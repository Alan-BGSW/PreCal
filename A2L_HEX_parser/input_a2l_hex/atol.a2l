ASAP2_VERSION 1 70
/begin PROJECT MDG1C "VC1CP091_STLA_N_D061I3"
/begin HEADER "" VERSION "VC1CP091_STLA_N_D061I3" PROJECT_NO MDG1C /end HEADER
/begin MODULE DIM ""
/begin MOD_COMMON "" BYTE_ORDER MSB_LAST ALIGNMENT_BYTE 1 ALIGNMENT_WORD 2 ALIGNMENT_LONG 4 ALIGNMENT_INT64 4 ALIGNMENT_FLOAT32_IEEE 4 ALIGNMENT_FLOAT64_IEEE 4 DATA_SIZE 32 /end MOD_COMMON
/begin CHARACTERISTIC ACCmpr_iDeltaOverCmprThd_C "Calibratable delta threshold current value for calculation of ac compressor limitation status based on ac compressor." VALUE 0x8024E718 RB_Val_Ws16 2047.969 RBPtCel_i_0p03125_1 -1024.000 1023.969 FORMAT "%8.3" /end CHARACTERISTIC
/begin CHARACTERISTIC ACCmpr_iElCmprHvActThd_C "Calibration for Validity of measured compressor current" VALUE 0x8024E71A RB_Val_Wu8 255.0 OneToOne 0.00 255.0 FORMAT "%5.1" /end CHARACTERISTIC
/begin CHARACTERISTIC ACCmpr_iOverCmprThd_C "Calibratable threshold over current above which over current bit in ac compressor limitation status will be set to TRUE" VALUE 0x8024E71C RB_Val_Ws16 2047.969 RBPtCel_i_0p03125_1 -1024.000 1023.969 FORMAT "%8.3" /end CHARACTERISTIC
/begin CHARACTERISTIC ACCmpr_maskRatSocVldSq_C "SOC signal validity mask" VALUE 0x8024E71E RB_Val_Wu16 65535.00 OneToOne 0.00 65535.00 FORMAT "%8.2" /end CHARACTERISTIC
/begin CHARACTERISTIC ACCmpr_maskVehVVldSq_C "Vehicle speed signal validity mask" VALUE 0x8024E720 RB_Val_Wu16 65535.00 OneToOne 0.00 65535.00 FORMAT "%8.2" /end CHARACTERISTIC
/begin CHARACTERISTIC ACCmpr_nCmprMaxDefogEco_C "Maximum compressor speed allowed in defog mode in eco drive" VALUE 0x8024E722 RB_Val_Wu16 65535.00 q1_DIV_min 0.00 65535.00 FORMAT "%8.2" /end CHARACTERISTIC
/begin CHARACTERISTIC ACCmpr_nCmprMaxDefog_C "Maximum compressor speed allowed in defog mode in normal drive" VALUE 0x8024E724 RB_Val_Wu16 65535.00 q1_DIV_min 0.00 65535.00 FORMAT "%8.2" /end CHARACTERISTIC
/begin CHARACTERISTIC ACCmpr_nCmprMaxDern_C "Maximum compressor speed allowed in derated operation" VALUE 0x8024E726 RB_Val_Wu16 65535.00 q1_DIV_min 0.00 65535.00 FORMAT "%8.2" /end CHARACTERISTIC
/begin CHARACTERISTIC ACCmpr_nCmprOverSpdThd_C "Calibratable threshold over speed above which over speed bit in ac compressor limitation status will be set to TRUE" VALUE 0x8024E728 RB_Val_Ws16 655350.0 RBPtCel_n_10p0_1 -327680.0 327670.0 FORMAT "%8.1" /end CHARACTERISTIC
/begin CHARACTERISTIC ACCmpr_nCmprPwrLim_T "Linear Speed of AC Compressor power limit" CURVE 0x8024E72A RB_Curve_S16_U16_sao 65535.00 q1_DIV_min 0.00 65535.00 FORMAT "%8.2"
 /begin AXIS_DESCR STD_AXIS ACCmpr_pwrCmprLimd RBPtCel_pwr_25p0_1 6 -819200.0 819175.0 FORMAT "%8.1" DEPOSIT ABSOLUTE /end AXIS_DESCR
/end CHARACTERISTIC
/begin CHARACTERISTIC ACCmpr_nCoolgCmprMaxEco_T "Maximum AC compressor cooling speed in Eco mode" CURVE 0x8024E744 RB_Curve_U8_U16_sao 65535.00 q1_DIV_min 0.00 65535.00 FORMAT "%8.2"
 /begin AXIS_DESCR STD_AXIS HvacHmi_stCoolgReq q1 6 0.00 255.0 FORMAT "%5.1" DEPOSIT ABSOLUTE /end AXIS_DESCR
/end CHARACTERISTIC
/begin CHARACTERISTIC ACCmpr_nCoolgCmprMax_T "Maximum AC compressor cooling speed" CURVE 0x8024E758 RB_Curve_U8_U16_sao 65535.00 q1_DIV_min 0.00 65535.00 FORMAT "%8.2"
 /begin AXIS_DESCR STD_AXIS HvacHmi_stCoolgReq q1 6 0.00 255.0 FORMAT "%5.1" DEPOSIT ABSOLUTE /end AXIS_DESCR
/end CHARACTERISTIC
/begin CHARACTERISTIC ACCmpr_nDesCoolgSaveDelta_C "Difference to ECO mode threshold during power saving in normal mode" VALUE 0x8024E76C RB_Val_Wu16 65535.00 q1_DIV_min 0.00 65535.00 FORMAT "%8.2" /end CHARACTERISTIC
/begin CHARACTERISTIC ACCmpr_nDesCoolgSaveMax_C "Minimum speed during power save mode when in normal cooling" VALUE 0x8024E76E RB_Val_Wu16 65535.00 q1_DIV_min 0.00 65535.00 FORMAT "%8.2" /end CHARACTERISTIC
/begin CHARACTERISTIC ACCmpr_nDesDefogSaveDelta_C "Difference to ECO mode threshold during power saving in defog mode" VALUE 0x8024E770 RB_Val_Wu16 65535.00 q1_DIV_min 0.00 65535.00 FORMAT "%8.2" /end CHARACTERISTIC
/begin CHARACTERISTIC ACCmpr_nDesDefogSaveMax_C "Minimum speed during power save mode when in defog heating" VALUE 0x8024E772 RB_Val_Wu16 65535.00 q1_DIV_min 0.00 65535.00 FORMAT "%8.2" /end CHARACTERISTIC
/begin CHARACTERISTIC ACCmpr_nSpdLim_T "Vehicle speed based compressor RPM limit" CURVE 0x8024E774 RB_Curve_S16_U16_sao 65535.00 q1_DIV_min 0.00 65535.00 FORMAT "%8.2"
 /begin AXIS_DESCR STD_AXIS VehV_v Vel 7 -327.6800 327.6700 FORMAT "%8.4" DEPOSIT ABSOLUTE /end AXIS_DESCR
/end CHARACTERISTIC
/begin CHARACTERISTIC ACCmpr_nVehSpdLimDft_C "Maximum compressor speed during vehicle speed signal invalid" VALUE 0x8024E792 RB_Val_Wu16 65535.00 q1_DIV_min 0.00 65535.00 FORMAT "%8.2" /end CHARACTERISTIC
/begin CHARACTERISTIC ACCmpr_pDeltaHiCmprThd_C "Calibratable delta high threshold pressure value for calculation of ac compressor limitation status based on ac compressor." VALUE 0x8024E794 RB_Val_Wr32 2.0000E+037 RBPtCel_p_1p0_1 -1.0000E+037 1.0000E+037 FORMAT "%8.4" EXTENDED_LIMITS -3.4028E+038 3.4028E+038 /end CHARACTERISTIC
/begin CHARACTERISTIC ACCmpr_pDeltaLoCmprThd_C "Calibratable delta low threshold pressure value for calculation of ac compressor limitation status based on ac compressor." VALUE 0x8024E798 RB_Val_Wr32 2.0000E+037 RBPtCel_p_1p0_1 -1.0000E+037 1.0000E+037 FORMAT "%8.4" EXTENDED_LIMITS -3.4028E+038 3.4028E+038 /end CHARACTERISTIC
/begin CHARACTERISTIC ACCmpr_pHiCmprThd_C "Calibratable threshold high pressure above which high pressure bit in ac compressor limitation status will be set to TRUE" VALUE 0x8024E79C RB_Val_Wr32 2.0000E+037 RBPtCel_p_1p0_1 -1.0000E+037 1.0000E+037 FORMAT "%8.4" EXTENDED_LIMITS -3.4028E+038 3.4028E+038 /end CHARACTERISTIC
/begin CHARACTERISTIC ACCmpr_pLoCmprThd_C "Calibratable threshold low pressure above which low pressure bit in ac compressor limitation status will be set to TRUE" VALUE 0x8024E7A0 RB_Val_Wr32 2.0000E+037 RBPtCel_p_1p0_1 -1.0000E+037 1.0000E+037 FORMAT "%8.4" EXTENDED_LIMITS -3.4028E+038 3.4028E+038 /end CHARACTERISTIC
/begin CHARACTERISTIC ACCmpr_pwrCmprMaxThd_C "Calibratable maximum compressor threshold above which considered as error." VALUE 0x8024E7A4 RB_Val_Wu16 655350.0 q10_W 0.00 655350.0 FORMAT "%8.1" /end CHARACTERISTIC
/begin CHARACTERISTIC ACCmpr_pwrHiCmprThd_C "Calibratable threshold power above which over power bit in ac compressor limitation status will be set to TRUE." VALUE 0x8024E7A6 RB_Val_Wu16 655350.0 q10_W 0.00 655350.0 FORMAT "%8.1" /end CHARACTERISTIC
/begin CHARACTERISTIC ACCmpr_pwrHvMaxDemist_C "Maximum high voltage power during demist" VALUE 0x8024E7A8 RB_Val_Ws16 1638375. RBPtCel_pwr_25p0_1 -819200.0 819175.0 FORMAT "%8.1" /end CHARACTERISTIC
/begin CHARACTERISTIC ACCmpr_pwrMinOn_C "Required minimum AC compressor power threshold" VALUE 0x8024E7AA RB_Val_Ws16 1638375. RBPtCel_pwr_25p0_1 -819200.0 819175.0 FORMAT "%8.1" /end CHARACTERISTIC
/begin CHARACTERISTIC ACCmpr_ratPwrLimDelta_C "AC compressor Power limit delta buffer ratio" VALUE 0x8024E7AC RB_Val_Wu8 127.5 RBPtCel_Perc_0p5_1 0.00 127.5 FORMAT "%5.1" /end CHARACTERISTIC
/begin CHARACTERISTIC ACCmpr_ratSocDeltaPwrSave_C "Delta SOC for releasing power limit mode" VALUE 0x8024E7AE RB_Val_Ws16 799.9878 Prc -400.0000 399.9878 FORMAT "%8.4" /end CHARACTERISTIC
/begin CHARACTERISTIC ACCmpr_ratSocLePwrSave_C "Lower threshold for activating power saving mode" VALUE 0x8024E7B0 RB_Val_Ws16 799.9878 Prc -400.0000 399.9878 FORMAT "%8.4" /end CHARACTERISTIC
/begin CHARACTERISTIC ACCmpr_stDsqFltThd_C "Signal quality status threshold above which CAN signals are considered as invalid" VALUE 0x8024E7B2 RB_Val_Wu8 255.0 OneToOne 0.00 255.0 FORMAT "%5.1" /end CHARACTERISTIC
/begin CHARACTERISTIC ACCmpr_stDsqThd_C "AC compressor quality threshold for status mapping." VALUE 0x8024E7B3 RB_Val_Wu8 255.0 q1 0.00 255.0 FORMAT "%5.1" /end CHARACTERISTIC
/begin CHARACTERISTIC ACCmpr_stElecCmprStatStEemMpg_CA "Calibration vector determining the mapping of AC compressor EEM status." VAL_BLK 0x8024E7B4 RB_ValA_Wu8 255.0 q1 0.00 255.0 FORMAT "%5.1" MATRIX_DIM 8 /end CHARACTERISTIC
/begin CHARACTERISTIC ACCmpr_stElecCmprStInvld_C "AC compressor status Signal Invalid." VALUE 0x8024E7BC RB_Val_Wu8 255.0 q1 0.00 255.0 FORMAT "%5.1" /end CHARACTERISTIC
/begin CHARACTERISTIC ACCmpr_stVehStDiagEna_C "Vehicle state selection to activate diagnosis" VALUE 0x8024E7BD RB_Val_Wu8 255.0 q1 0.00 255.0 FORMAT "%5.1" /end CHARACTERISTIC
/begin CHARACTERISTIC ACCmpr_tCmprOverTErr_C "Calibratable threshold over temperature value above which the ac compressor over tempe- rature status is set to 2 and compressor might turn off." VALUE 0x8024E7BE RB_Val_Ws16 655.3500 q0p01_DegCgrd -327.6800 327.6700 FORMAT "%8.4" /end CHARACTERISTIC
/begin CHARACTERISTIC ACCmpr_tCmprOverTWarn_C "Calibratable threshold out of range temperature value above which the ac compressor over temperature status is set to 1 and ac compressor might work in normal operation mode." VALUE 0x8024E7C0 RB_Val_Ws16 655.3500 q0p01_DegCgrd -327.6800 327.6700 FORMAT "%8.4" /end CHARACTERISTIC
/begin CHARACTERISTIC ACCmpr_tDeltaCmprOverTErr_C "Calibratable delta over temperature value for calculation of AC compressor over tempera- ture status." VALUE 0x8024E7C2 RB_Val_Ws16 655.3500 q0p01_K -327.6800 327.6700 FORMAT "%8.4" /end CHARACTERISTIC
/begin CHARACTERISTIC ACCmpr_tDeltaCmprOverTWarn_C "Calibratable delta out of range temperature for calculation of Ac compressor over tempera- ture status." VALUE 0x8024E7C4 RB_Val_Ws16 655.3500 q0p01_K -327.6800 327.6700 FORMAT "%8.4" /end CHARACTERISTIC
/begin CHARACTERISTIC ACCmpr_tiStHldMax_C "Maximum Holding time of AC compressor power" VALUE 0x8024E7C6 RB_Val_Ws16 655.3500 RBPtCel_ti_0p01_1 -327.6800 327.6700 FORMAT "%8.4" /end CHARACTERISTIC
/begin CHARACTERISTIC ACCmpr_uDeltaOverCmprThd_C "Calibratable delta over voltage value for calculation of ac compressor limitation status based on ac compressor voltage from CAN" VALUE 0x8024E7C8 RB_Val_Ws16 65535.00 q1_V -32768.00 32767.00 FORMAT "%8.2" /end CHARACTERISTIC
/begin CHARACTERISTIC ACCmpr_uOverCmprThd_C "Calibratable threshold voltage above which over voltage bit in ac compressor limitation sta- tus will be set to TRUE." VALUE 0x8024E7CA RB_Val_Ws16 65535.00 q1_V -32768.00 32767.00 FORMAT "%8.2" /end CHARACTERISTIC
/begin CHARACTERISTIC ACComp_pChillrDsDes_T "calculation of pressure set point for chiller only operation" CURVE 0x8024E7CC RB_Curve_S16_S16 131070.0 PresAC_hPa -65536.00 65534.00 FORMAT "%8.2"
 /begin AXIS_DESCR STD_AXIS RefgntCirc_pwrRefgntDes RBPtCel_pwr_25p0_1 6 -819200.0 819175.0 FORMAT "%8.1" DEPOSIT ABSOLUTE /end AXIS_DESCR
/end CHARACTERISTIC
/begin CHARACTERISTIC AccPedEv_aRecupNormOnePedlDrvg_M "Calibratable map for the recuperation when Drive mode is selected." MAP 0x8024E97C RB_Map_S16U8_S16_sao 65.53500 Acc -32.76800 32.76700 FORMAT "%8.5"
 /begin AXIS_DESCR STD_AXIS VehV_vSign Vel 16 -327.6800 327.6700 FORMAT "%8.4" DEPOSIT ABSOLUTE /end AXIS_DESCR
 /begin AXIS_DESCR STD_AXIS AccPedEv_stDrvModActv OneToOne 3 0.00 255.0 FORMAT "%5.1" DEPOSIT ABSOLUTE /end AXIS_DESCR
/end CHARACTERISTIC
/begin CHARACTERISTIC AccPedEv_aRecupRvsOnePedlDrvg_M "Calibratable map for the recuperation when Reverse mode is selected." MAP 0x8024EA04 RB_Map_S16U8_S16_sao 65.53500 Acc -32.76800 32.76700 FORMAT "%8.5"
 /begin AXIS_DESCR STD_AXIS AccPedEv_vRvs Vel 16 -327.6800 327.6700 FORMAT "%8.4" DEPOSIT ABSOLUTE /end AXIS_DESCR
 /begin AXIS_DESCR STD_AXIS AccPedEv_stDrvModActv OneToOne 3 0.00 255.0 FORMAT "%5.1" DEPOSIT ABSOLUTE /end AXIS_DESCR
/end CHARACTERISTIC
/begin CHARACTERISTIC AccPedEv_facDifModPerStep_T "Muliplication factor step per calculation step dependent from torque difference between the two modes" CURVE 0x8024EA8C RB_Curve_S16_S16 0.9990000 Fact1000 0.001000 1.000000 FORMAT "%8.6" EXTENDED_LIMITS -32.76800 32.76700
 /begin AXIS_DESCR STD_AXIS AccPedEv_tqDifMod TrqPrp 5 -52428.80 52427.20 FORMAT "%8.2" DEPOSIT ABSOLUTE /end AXIS_DESCR
/end CHARACTERISTIC
/begin CHARACTERISTIC AccPedEv_flgOnePedlDrvgExtReq_C "Application parameter for selecting the source of deceleration quantity for recuperation with one pedal." VALUE 0x8024EAA2 RB_Val_Wboolean 1.00000000000 B_TRUE 0.00 1.00000000000 FORMAT "%13.11" /end CHARACTERISTIC
/begin CHARACTERISTIC AccPedEv_tqPrpnActvThd_C "calibratable threshold of minimum propulsion torque" VALUE 0x8024EAA4 RB_Val_Ws32 429496729.500 TrqPrpHigh -214748364.800 214748364.700 FORMAT "%13.3" /end CHARACTERISTIC
/begin CHARACTERISTIC AccPedEv_tqRecupOnePedlPerStepMax_C "Change in one-pedal recuperation torque when there is shift in drive mode" VALUE 0x8024EAA8 RB_Val_Ws32 429496729.500 TrqPrpHigh -214748364.800 214748364.700 FORMAT "%13.3" /end CHARACTERISTIC
/begin CHARACTERISTIC AccPedEv_tqWhlEco_M "Pedal Map Eco" MAP 0x8024EAAC RB_Map_S16S16_S16 104856.0 TrqPrp -52428.80 52427.20 FORMAT "%8.2"
 /begin AXIS_DESCR STD_AXIS AccPed_rPrpOnePedlDrvg Prc 16 -400.0000 399.9878 FORMAT "%8.4" DEPOSIT ABSOLUTE /end AXIS_DESCR
 /begin AXIS_DESCR STD_AXIS VehV_vSign Vel 16 -327.6800 327.6700 FORMAT "%8.4" DEPOSIT ABSOLUTE /end AXIS_DESCR
/end CHARACTERISTIC
/begin CHARACTERISTIC AccPedEv_tqWhlNorm_M "Pedal Map" MAP 0x8024ECF0 RB_Map_S16S16_S16 104856.0 TrqPrp -52428.80 52427.20 FORMAT "%8.2"
 /begin AXIS_DESCR STD_AXIS AccPed_rPrpOnePedlDrvg Prc 16 -400.0000 399.9878 FORMAT "%8.4" DEPOSIT ABSOLUTE /end AXIS_DESCR
 /begin AXIS_DESCR STD_AXIS VehV_vSign Vel 16 -327.6800 327.6700 FORMAT "%8.4" DEPOSIT ABSOLUTE /end AXIS_DESCR
/end CHARACTERISTIC
/begin CHARACTERISTIC AccPedEv_tqWhlRvs_M "Pedal Map Reverse gear" MAP 0x8024EF34 RB_Map_S16S16_S16 104856.0 TrqPrp -52428.80 52427.20 FORMAT "%8.2"
 /begin AXIS_DESCR STD_AXIS AccPed_rPrpOnePedlDrvg Prc 16 -400.0000 399.9878 FORMAT "%8.4" DEPOSIT ABSOLUTE /end AXIS_DESCR
 /begin AXIS_DESCR STD_AXIS AccPedEv_vRvs Vel 16 -327.6800 327.6700 FORMAT "%8.4" DEPOSIT ABSOLUTE /end AXIS_DESCR
/end CHARACTERISTIC
/begin CHARACTERISTIC AccPedEv_tqWhlSpt_M "Pedal Map Sport" MAP 0x8024F178 RB_Map_S16S16_S16 104856.0 TrqPrp -52428.80 52427.20 FORMAT "%8.2"
 /begin AXIS_DESCR STD_AXIS AccPed_rPrpOnePedlDrvg Prc 16 -400.0000 399.9878 FORMAT "%8.4" DEPOSIT ABSOLUTE /end AXIS_DESCR
 /begin AXIS_DESCR STD_AXIS VehV_vSign Vel 16 -327.6800 327.6700 FORMAT "%8.4" DEPOSIT ABSOLUTE /end AXIS_DESCR
/end CHARACTERISTIC
/begin CHARACTERISTIC AccPed_drAppGrdtLvlRst_C "Calibratable resistance value of deviation from the accelerator pedal" VALUE 0x8024F3BC RB_Val_Ws16 39999.39 PrcPerSec -20000.00 19999.39 FORMAT "%8.2" /end CHARACTERISTIC
/begin CHARACTERISTIC AccPed_facAppGrdtLvl_T "Table of factor from the gradient of deviation on accelerator pedal position" CURVE 0x8024F3BE RB_Curve_S16_S16 7.999878 Fact -4.000000 3.999878 FORMAT "%8.6"
 /begin AXIS_DESCR STD_AXIS AccPed_drAppGrdtOld PrcPerSec 4 -20000.00 19999.39 FORMAT "%8.2" DEPOSIT ABSOLUTE /end AXIS_DESCR
/end CHARACTERISTIC
/begin CHARACTERISTIC AccPed_flgVirtZrPntExt_C "Calibratable flag for external virtual zero point." VALUE 0x8024F3D0 RB_Val_Wboolean 1.00000000000 B_TRUE 0.00 1.00000000000 FORMAT "%13.11" /end CHARACTERISTIC
/begin CHARACTERISTIC AccPed_rCoastGapOnePedlDrvg_M "Map of the coasting gap of one pedal driving" MAP 0x8024F3D2 RB_Map_S16U16_S16_sao 799.9878 Prc -400.0000 399.9878 FORMAT "%8.4"
 /begin AXIS_DESCR STD_AXIS VehV_vSign Vel 10 -327.6800 327.6700 FORMAT "%8.4" DEPOSIT ABSOLUTE /end AXIS_DESCR
 /begin AXIS_DESCR STD_AXIS MoFTqPtdVeh_stDrvProgReqMsg OneToOne 4 0.00 65535.00 FORMAT "%8.2" DEPOSIT ABSOLUTE /end AXIS_DESCR
/end CHARACTERISTIC
/begin CHARACTERISTIC AccPed_rCoastGapPerStepMax_C "Maximal Step per slope limitation of coasting gap" VALUE 0x8024F442 RB_Val_Ws16 799.9878 Prc -400.0000 399.9878 FORMAT "%8.4" /end CHARACTERISTIC
/begin CHARACTERISTIC AccPed_rCoastGapRvsOnePedlDrvg_M "Map of the coasting gap for reverse gear of one pedal driving" MAP 0x8024F444 RB_Map_S16U16_S16_sao 799.9878 Prc -400.0000 399.9878 FORMAT "%8.4"
 /begin AXIS_DESCR STD_AXIS AccPed_vSignCnvn Vel 10 -327.6800 327.6700 FORMAT "%8.4" DEPOSIT ABSOLUTE /end AXIS_DESCR
 /begin AXIS_DESCR STD_AXIS MoFTqPtdVeh_stDrvProgReqMsg OneToOne 4 0.00 65535.00 FORMAT "%8.2" DEPOSIT ABSOLUTE /end AXIS_DESCR
/end CHARACTERISTIC
/begin CHARACTERISTIC AccPed_rMinGapThd_C "Minium threshold gap, to avoid wrong calculated coasting gap" VALUE 0x8024F4B4 RB_Val_Ws16 799.9878 Prc -400.0000 399.9878 FORMAT "%8.4" /end CHARACTERISTIC
/begin CHARACTERISTIC AccPed_rVirtZrPntLim_C "Calibratable value to limit calculated virtual zero point, in order to be able to applicate different behaviour, depending on signed vehicle speed" VALUE 0x8024F4B6 RB_Val_Ws16 799.9878 Prc -400.0000 399.9878 FORMAT "%8.4" /end CHARACTERISTIC
/begin CHARACTERISTIC AccPed_rVirtZrPntOnePedlDrvg_M "Map of the virtual zero point of one pedal driving" MAP 0x8024F4B8 RB_Map_S16U16_S16_sao 799.9878 Prc -400.0000 399.9878 FORMAT "%8.4"
 /begin AXIS_DESCR STD_AXIS VehV_vSign Vel 10 -327.6800 327.6700 FORMAT "%8.4" DEPOSIT ABSOLUTE /end AXIS_DESCR
 /begin AXIS_DESCR STD_AXIS MoFTqPtdVeh_stDrvProgReqMsg OneToOne 4 0.00 65535.00 FORMAT "%8.2" DEPOSIT ABSOLUTE /end AXIS_DESCR
/end CHARACTERISTIC
/begin CHARACTERISTIC AccPed_rVirtZrPntPerStepMax_C "Maximal Step per slope limitation of virtual zero point" VALUE 0x8024F528 RB_Val_Ws16 799.9878 Prc -400.0000 399.9878 FORMAT "%8.4" /end CHARACTERISTIC
/begin CHARACTERISTIC AccPed_rVirtZrPntRvsOnePedlDrvg_M "Map of the virtual zero point for reverse gear of one pedal driving" MAP 0x8024F52A RB_Map_S16U16_S16_sao 799.9878 Prc -400.0000 399.9878 FORMAT "%8.4"
 /begin AXIS_DESCR STD_AXIS AccPed_vSignCnvn Vel 10 -327.6800 327.6700 FORMAT "%8.4" DEPOSIT ABSOLUTE /end AXIS_DESCR
 /begin AXIS_DESCR STD_AXIS MoFTqPtdVeh_stDrvProgReqMsg OneToOne 4 0.00 65535.00 FORMAT "%8.2" DEPOSIT ABSOLUTE /end AXIS_DESCR
/end CHARACTERISTIC
/begin CHARACTERISTIC AccPed_rZrPntOnePedlThd_C "Threshold for virtual zero point of one pedal driving to avoid divison through zero" VALUE 0x8024F59A RB_Val_Ws16 799.9878 Prc -400.0000 399.9878 FORMAT "%8.4" /end CHARACTERISTIC
/begin CHARACTERISTIC ACCtl_facKiRefgntCtrlr_C "KI factor of AC controler" VALUE 0x8024E7E8 RB_Val_Ws32 65535.9999847 q1p52587Em5_DIV_s -32768.0000000 32767.9999847 FORMAT "%13.7" /end CHARACTERISTIC
/begin CHARACTERISTIC ACCtl_facPCtrlIIntegdToN_C "conversion from integrated pressure deviation to compressor speed" VALUE 0x8024E7EC RB_Val_Ws16 131070.0 q2 -65536.00 65534.00 FORMAT "%8.2" /end CHARACTERISTIC
/begin CHARACTERISTIC ACCtl_nCmprMax_C "Max speed of AC compressor" VALUE 0x8024E7EE RB_Val_Ws16 65535.00 q1_DIV_min -32768.00 32767.00 FORMAT "%8.2" /end CHARACTERISTIC
/begin CHARACTERISTIC ACCtl_nCmprMin_C "minimum compressor speed" VALUE 0x8024E7F0 RB_Val_Ws16 65535.00 q1_DIV_min -32768.00 32767.00 FORMAT "%8.2" /end CHARACTERISTIC
/begin CHARACTERISTIC ACCtl_nCmprPreCtrlr_T "Pre-controller compressor speed" CURVE 0x8024E7F2 RB_Curve_S16_S16 65535.00 q1_DIV_min -32768.00 32767.00 FORMAT "%8.2"
 /begin AXIS_DESCR STD_AXIS RefgntCirc_pwrRefgntDes RBPtCel_pwr_25p0_1 6 -819200.0 819175.0 FORMAT "%8.1" DEPOSIT ABSOLUTE /end AXIS_DESCR
/end CHARACTERISTIC
/begin CHARACTERISTIC ACCtl_nGrdtLimMaxSpd_C "speed gradient limitation for maximum speed limit" VALUE 0x8024E80C RB_Val_Ws16 655350.0 q10_DIV_min_s -327680.0 327670.0 FORMAT "%8.1" /end CHARACTERISTIC
/begin CHARACTERISTIC ACCtl_nPDeLim_T "AC compressor maximum speed limit based on refrigerant pressure" CURVE 0x8024E80E RB_Curve_S16_S16 65535.00 q1_DIV_min -32768.00 32767.00 FORMAT "%8.2"
 /begin AXIS_DESCR STD_AXIS ACCtl_pCmprDsFld PresAC_hPa 5 -65536.00 65534.00 FORMAT "%8.2" DEPOSIT ABSOLUTE /end AXIS_DESCR
/end CHARACTERISTIC
/begin CHARACTERISTIC ACCtl_pRefgntSpDifMin_C "Calibratable dead band to activate the integration part of governer, if the deviation goes above dead band." VALUE 0x8024E824 RB_Val_Ws16 131070.0 PresAC_hPa -65536.00 65534.00 FORMAT "%8.2" /end CHARACTERISTIC
/begin CHARACTERISTIC ACCtl_pwrCmprReq_T "EEM power request of AC compressor" CURVE 0x8024E826 RB_Curve_S16_S16 1638375. RBPtCel_pwr_25p0_1 -819200.0 819175.0 FORMAT "%8.1"
 /begin AXIS_DESCR STD_AXIS ACCtl_nDes q1_DIV_min 6 -32768.00 32767.00 FORMAT "%8.2" DEPOSIT ABSOLUTE /end AXIS_DESCR
/end CHARACTERISTIC
/begin CHARACTERISTIC ACCtl_tiMinOff_C "Minimum deactivation time from logic box state ACCELERATION" VALUE 0x8024E840 RB_Val_Wu16 6553.500 q0p1_s 0.00 6553.500 FORMAT "%8.3" /end CHARACTERISTIC
/begin CHARACTERISTIC ACCtl_tiMinWaitOff_C "Minimum waiting time for switching off the compressor" VALUE 0x8024E842 RB_Val_Wu16 6553.500 q0p1_s 0.00 6553.500 FORMAT "%8.3" /end CHARACTERISTIC
/begin CHARACTERISTIC ACCtl_tiMinWaitPreCtrlOff_C "Minimum wait time for pre-control state" VALUE 0x8024E844 RB_Val_Wu16 6553.500 q0p1_s 0.00 6553.500 FORMAT "%8.3" /end CHARACTERISTIC
/begin CHARACTERISTIC ACCtl_tiPreCtrlSpdFild_C "Filter time constant for pre-control compressor speed" VALUE 0x8024E848 RB_Val_Ws32 4294.9672940000000 TimeDelay_s 0.0000020000000 4294.9672959999998 FORMAT "%19.14" EXTENDED_LIMITS 0.000002000000001 4294.9672959999998 /end CHARACTERISTIC
/begin CHARACTERISTIC ACCtl_tiPreCtrl_C "pre control time after controller activation" VALUE 0x8024E84C RB_Val_Wu16 6553.500 q0p1_s 0.00 6553.500 FORMAT "%8.3" /end CHARACTERISTIC
/begin CHARACTERISTIC AcExtChrgr_cntrCritErrMax_C "Maximal number of charging retries after a stop occurred due to a critical error." VALUE 0x8024E91C RB_Val_Wu8 255.0 OneToOne 0.00 255.0 FORMAT "%5.1" /end CHARACTERISTIC
/begin CHARACTERISTIC AcExtChrgr_cntrMnrErrMax_C "Max. number of charging retries after abort due to minor error" VALUE 0x8024E91D RB_Val_Wu8 255.0 OneToOne 0.00 255.0 FORMAT "%5.1" /end CHARACTERISTIC
/begin CHARACTERISTIC AcExtChrgr_cntrTryMax_C "Max. number of charging tries" VALUE 0x8024E91E RB_Val_Wu8 255.0 OneToOne 0.00 255.0 FORMAT "%5.1" /end CHARACTERISTIC
/begin CHARACTERISTIC AcExtChrgr_facChrgrInExcdTolr_C "OBC AC current input exceed tolerance factor" VALUE 0x8024E920 RB_Val_Ws16 655.3500 RBPtCel_fac_0p01_1 -327.6800 327.6700 FORMAT "%8.4" /end CHARACTERISTIC
/begin CHARACTERISTIC AcExtChrgr_flgAuxUnitLoadLoEna_C "Enable usage of auxiliary load low" VALUE 0x8024E922 RB_Val_Wboolean 1.00000000000 B_TRUE 0.00 1.00000000000 FORMAT "%13.11" /end CHARACTERISTIC
/begin CHARACTERISTIC AcExtChrgr_iActLoThd_C "Threshold of actual HV battery current to stop charging" VALUE 0x8024E924 RB_Val_Ws16 2047.969 RBPtCel_i_0p03125_1 -1024.000 1023.969 FORMAT "%8.3" /end CHARACTERISTIC
/begin CHARACTERISTIC AcExtChrgr_iAuxUnitLoadMax_C "Max. additional charging current for auxilliary loads" VALUE 0x8024E926 RB_Val_Ws16 2047.969 RBPtCel_i_0p03125_1 -1024.000 1023.969 FORMAT "%8.3" /end CHARACTERISTIC
/begin CHARACTERISTIC AcExtChrgr_iBattExcdTolr_C "Tolerance for actual current of HV battery deviation form HV battery current request to charge." VALUE 0x8024E928 RB_Val_Ws32 2047.96875000 RBPtCel_i_0p03125_1 -1024.00000000 1023.96875000 FORMAT "%13.8" EXTENDED_LIMITS -67108864.0000 67108863.9688 /end CHARACTERISTIC
/begin CHARACTERISTIC AcExtChrgr_iChrgnEndThdGrid_C "AC current threshold for end of current draw" VALUE 0x8024E92C RB_Val_Ws16 2047.969 RBPtCel_i_0p03125_1 -1024.000 1023.969 FORMAT "%8.3" /end CHARACTERISTIC
/begin CHARACTERISTIC AcExtChrgr_iChrgnLimMaxAc_C "Max. AC charging current capability" VALUE 0x8024E92E RB_Val_Ws16 2047.969 RBPtCel_i_0p03125_1 -1024.000 1023.969 FORMAT "%8.3" /end CHARACTERISTIC
/begin CHARACTERISTIC AcExtChrgr_iChrgnLimMax_C "Maximum charging current capability" VALUE 0x8024E930 RB_Val_Ws16 2047.969 RBPtCel_i_0p03125_1 -1024.000 1023.969 FORMAT "%8.3" /end CHARACTERISTIC
/begin CHARACTERISTIC AcExtChrgr_iChrgnLimMin_C "Minimum charging current capability" VALUE 0x8024E932 RB_Val_Ws16 2047.969 RBPtCel_i_0p03125_1 -1024.000 1023.969 FORMAT "%8.3" /end CHARACTERISTIC
/begin CHARACTERISTIC AcExtChrgr_iChrgnStrtThd_C "Threshold of maximal HV battery current limit to start charging" VALUE 0x8024E934 RB_Val_Ws16 2047.969 RBPtCel_i_0p03125_1 -1024.000 1023.969 FORMAT "%8.3" /end CHARACTERISTIC
/begin CHARACTERISTIC AcExtChrgr_iChrgrOutDeTolr_C "OBC DC output current deviation tolerance" VALUE 0x8024E936 RB_Val_Ws16 2047.969 RBPtCel_i_0p03125_1 -1024.000 1023.969 FORMAT "%8.3" /end CHARACTERISTIC
/begin CHARACTERISTIC AcExtChrgr_iChrgrOutExcdTolr_C "OBC DC output current exceed tolerance" VALUE 0x8024E938 RB_Val_Ws16 2047.969 RBPtCel_i_0p03125_1 -1024.000 1023.969 FORMAT "%8.3" /end CHARACTERISTIC
/begin CHARACTERISTIC AcExtChrgr_pwrChrgrOut_T "Maximum output power of OBC" CURVE 0x8024E93A RB_Curve_S16_S16 655350.0 RBPtCel_pwr_10p0_1 -327680.0 327670.0 FORMAT "%8.1"
 /begin AXIS_DESCR STD_AXIS AcExtChrgr_pwrChrgrIn RBPtCel_pwr_10p0_1 10 -327680.0 327670.0 FORMAT "%8.1" DEPOSIT ABSOLUTE /end AXIS_DESCR
/end CHARACTERISTIC
/begin CHARACTERISTIC AcExtChrgr_ratSocStrt_C "SOC threshold for charging start request" VALUE 0x8024E964 RB_Val_Ws16 799.9878 Prc -400.0000 399.9878 FORMAT "%8.4" /end CHARACTERISTIC
/begin CHARACTERISTIC AcExtChrgr_ratSocTar_C "SOC threshold for charging stop request" VALUE 0x8024E966 RB_Val_Ws16 799.9878 Prc -400.0000 399.9878 FORMAT "%8.4" /end CHARACTERISTIC
/begin CHARACTERISTIC AcExtChrgr_stSigQlyMsk_C "Signal quality mask" VALUE 0x8024E968 RB_Val_Wu16 65535.00 OneToOne 0.00 65535.00 FORMAT "%8.2" /end CHARACTERISTIC
/begin CHARACTERISTIC AcExtChrgr_tiChrgnRespTout_C "Max. time until charging components have to respond to charging request" VALUE 0x8024E96A RB_Val_Wu16 655.3500 RBPtCel_ti_0p01_1 0.00 655.3500 FORMAT "%8.4" /end CHARACTERISTIC
/begin CHARACTERISTIC AcExtChrgr_tiCtrlPltSwtDi_C "Max. time until CP S2 will be opened" VALUE 0x8024E96C RB_Val_Wu16 655.3500 RBPtCel_ti_0p01_1 0.00 655.3500 FORMAT "%8.4" /end CHARACTERISTIC
/begin CHARACTERISTIC AcExtChrgr_tiDlyActILo_C "Time delay for prevetion of HV battery discharge" VALUE 0x8024E96E RB_Val_Wu16 655.3500 RBPtCel_ti_0p01_1 0.00 655.3500 FORMAT "%8.4" /end CHARACTERISTIC
/begin CHARACTERISTIC AcExtChrgr_tiDlyChrgnRetry_C "Time delay between each charging retry" VALUE 0x8024E970 RB_Val_Wu16 655.3500 RBPtCel_ti_0p01_1 0.00 655.3500 FORMAT "%8.4" /end CHARACTERISTIC
/begin CHARACTERISTIC AcExtChrgr_tiDlyStopActILo_C "Time delay after charging start to ignore the charging stop due to low actual HV battery current" VALUE 0x8024E972 RB_Val_Wu16 655.3500 RBPtCel_ti_0p01_1 0.00 655.3500 FORMAT "%8.4" /end CHARACTERISTIC
/begin CHARACTERISTIC AcExtChrgr_tiDlyStopMaxILo_C "Time delay after charging start to ignore the charging stop due to low maximal HV battery current limit" VALUE 0x8024E974 RB_Val_Wu16 655.3500 RBPtCel_ti_0p01_1 0.00 655.3500 FORMAT "%8.4" /end CHARACTERISTIC
/begin CHARACTERISTIC AcExtChrgr_tiStrtReqTout_C "Max. charging start request timeout" VALUE 0x8024E976 RB_Val_Wu16 655.3500 RBPtCel_ti_0p01_1 0.00 655.3500 FORMAT "%8.4" /end CHARACTERISTIC
/begin CHARACTERISTIC AcExtChrgr_uChrgnStrtThdGrid_C "Voltage threshold to identify if EVSE enabled its mains supply" VALUE 0x8024E978 RB_Val_Ws16 6553.500 RBPtCel_u_0p1_1 -3276.800 3276.700 FORMAT "%8.3" /end CHARACTERISTIC
/begin CHARACTERISTIC AcExtChrgr_uChrgrOutDeTolr_C "OBC DC output voltage deviation tolerance" VALUE 0x8024E97A RB_Val_Ws16 6553.500 RBPtCel_u_0p1_1 -3276.800 3276.700 FORMAT "%8.3" /end CHARACTERISTIC
/begin CHARACTERISTIC AC_dmClgACOff_T "Cooling demand in case of AC off" CURVE 0x8024E850 RB_Curve_S16_S16 799.9878 Prc -400.0000 399.9878 FORMAT "%8.4"
 /begin AXIS_DESCR STD_AXIS AC_pClntHld PresAC_hPa 4 -65536.00 65534.00 FORMAT "%8.2" DEPOSIT ABSOLUTE /end AXIS_DESCR
/end CHARACTERISTIC
/begin CHARACTERISTIC AC_dmClgACOn_T "Cooling demand in case of AC on" CURVE 0x8024E862 RB_Curve_S16_S16 799.9878 Prc -400.0000 399.9878 FORMAT "%8.4"
 /begin AXIS_DESCR STD_AXIS AC_pClntHld PresAC_hPa 4 -65536.00 65534.00 FORMAT "%8.2" DEPOSIT ABSOLUTE /end AXIS_DESCR
/end CHARACTERISTIC
/begin CHARACTERISTIC AC_pClntHi_C "upper threshhold of air condition pressure" VALUE 0x8024E874 RB_Val_Ws16 131070.0 PresAC_hPa -65536.00 65534.00 FORMAT "%8.2" /end CHARACTERISTIC
/begin CHARACTERISTIC AC_pClntLo_C "lower threshhold of air condition pressure" VALUE 0x8024E876 RB_Val_Ws16 131070.0 PresAC_hPa -65536.00 65534.00 FORMAT "%8.2" /end CHARACTERISTIC
/begin CHARACTERISTIC AC_pClnt_C "default value for air condition pressure" VALUE 0x8024E878 RB_Val_Ws16 131070.0 PresAC_hPa -65536.00 65534.00 FORMAT "%8.2" /end CHARACTERISTIC
/begin CHARACTERISTIC AC_swtCoolgDmd_C "Calibration switch to select between AC cooling demands" VALUE 0x8024E87A RB_Val_Wu8 1.00000000000 B_TRUE 0.00 1.00000000000 FORMAT "%13.11" /end CHARACTERISTIC
/begin CHARACTERISTIC Airbg_CrashDeploy_ATS_ATS.LimitTypeMsk_C "" VALUE 0x80252E84 Val_Wu8 255.0 OneToOne 0.00 255.0 FORMAT "%5.1" /end CHARACTERISTIC
/begin CHARACTERISTIC Airbg_CrashDeploy_ATS_ATS.CnvNorm_C "" VALUE 0x80252E85 Val_Wu8 255.0 OneToOne 0.00 255.0 FORMAT "%5.1" /end CHARACTERISTIC
/begin CHARACTERISTIC Airbg_CrashDeploy_ATS_ATS.LowLim_C "" VALUE 0x80252E86 Val_Ws16 65535.00 dez -32768.00 32767.00 FORMAT "%8.2" /end CHARACTERISTIC
/begin CHARACTERISTIC Airbg_CrashDeploy_ATS_ATS.UpLim_C "" VALUE 0x80252E88 Val_Ws16 65535.00 dez -32768.00 32767.00 FORMAT "%8.2" /end CHARACTERISTIC
/begin CHARACTERISTIC Airbg_CrashDeploy_ATS_ATS.CnvFac_C "" VALUE 0x80252E8C Val_Ws32 4294967295.00 OneToOne -2147483648.00 2147483647.00 FORMAT "%13.2" /end CHARACTERISTIC
/begin CHARACTERISTIC Airbg_CrashDeploy_ATS_ATS.CnvOfs_C "" VALUE 0x80252E90 Val_Ws16 65535.00 OneToOne -32768.00 32767.00 FORMAT "%8.2" /end CHARACTERISTIC
/begin CHARACTERISTIC Airbg_CrashDeploy_ATS_ATS.DfltVal_C "" VALUE 0x80252E92 Val_Ws16 65535.00 OneToOne -32768.00 32767.00 FORMAT "%8.2" /end CHARACTERISTIC
/begin CHARACTERISTIC Airbg_rDycCrashDeployHi_C "PWM dutycycle for CRASH deployment detection - max range" VALUE 0x8024F59C RB_Val_Wu32 42949672.9500 rel_q0p01 0.00 42949672.9500 FORMAT "%13.4" /end CHARACTERISTIC
/begin CHARACTERISTIC Airbg_rDycCrashDeployLo_C "PWM dutycycle for CRASH deployment detection - min range" VALUE 0x8024F5A0 RB_Val_Wu32 42949672.9500 rel_q0p01 0.00 42949672.9500 FORMAT "%13.4" /end CHARACTERISTIC
/begin CHARACTERISTIC Airbg_rDycCrashOkHi_C "PWM dyty cycle - not deployed max range" VALUE 0x8024F5A4 RB_Val_Wu32 42949672.9500 rel_q0p01 0.00 42949672.9500 FORMAT "%13.4" /end CHARACTERISTIC
/begin CHARACTERISTIC Airbg_rDycCrashOkLo_C "PWM dyty cycle - not deployed min range" VALUE 0x8024F5A8 RB_Val_Wu32 42949672.9500 rel_q0p01 0.00 42949672.9500 FORMAT "%13.4" /end CHARACTERISTIC
/begin CHARACTERISTIC Airbg_swtCanHiPrio_C "Calibration switch to enable high priority for CAN" VALUE 0x8024F5D8 RB_Val_Wboolean 1.00000000000 B_TRUE 0.00 1.00000000000 FORMAT "%13.11" /end CHARACTERISTIC
/begin CHARACTERISTIC Airbg_SwtCrashSel_C "Calibration to choose between the CAN or Hardware message reporting of CRASH deploy information" VALUE 0x8024F5D9 RB_Val_Wboolean 1.00000000000 B_TRUE 0.00 1.00000000000 FORMAT "%13.11" /end CHARACTERISTIC
/begin CHARACTERISTIC Airbg_swtEnaTestDeploymt_C "Calibration to enable deployment for test purpose" VALUE 0x8024F5DA RB_Val_Wboolean 1.00000000000 B_TRUE 0.00 1.00000000000 FORMAT "%13.11" /end CHARACTERISTIC
/begin CHARACTERISTIC Airbg_swtEol_C "Calibratable switch to enable EOL function in Airbag" VALUE 0x8024F5DB RB_Val_Wboolean 1.00000000000 B_TRUE 0.00 1.00000000000 FORMAT "%13.11" /end CHARACTERISTIC
/begin CHARACTERISTIC Airbg_swtErrDft_C "Calibration switch to set the error if HWCAN error" VALUE 0x8024F5DC RB_Val_Wboolean 1.00000000000 B_TRUE 0.00 1.00000000000 FORMAT "%13.11" /end CHARACTERISTIC
/begin CHARACTERISTIC Airbg_swtMnrCrashEna_C "Switch to select the Minor Crash signal status" VALUE 0x8024F5DD RB_Val_Wboolean 1.00000000000 B_TRUE 0.00 1.00000000000 FORMAT "%13.11" /end CHARACTERISTIC
/begin CHARACTERISTIC Airbg_swtMonPrmsActv_C "Monitoring permission is active for airbag deplyment detection" VALUE 0x8024F5AC RB_Val_Wboolean 1.00000000000 B_TRUE 0.00 1.00000000000 FORMAT "%13.11" /end CHARACTERISTIC
/begin CHARACTERISTIC Airbg_swtPwmSigInvActv_C "Inversion active for PWM signal" VALUE 0x8024F5AD RB_Val_Wboolean 1.00000000000 B_TRUE 0.00 1.00000000000 FORMAT "%13.11" /end CHARACTERISTIC
/begin CHARACTERISTIC Airbg_swtTestDeploymt_C "Calibration to enable deployment for test purpose" VALUE 0x8024F5DE RB_Val_Wu8 255.0 OneToOne 0.00 255.0 FORMAT "%5.1" /end CHARACTERISTIC
/begin CHARACTERISTIC Airbg_tiComCrashDeploy_C "Time delay for updating the CRASH deployment information received from CAN message communication" VALUE 0x8024F5E0 RB_Val_Ws32 4294.96729500 Time_Dt -2147.48364800 2147.48364700 FORMAT "%13.8" /end CHARACTERISTIC
/begin CHARACTERISTIC Airbg_tiComMnrCrashDeploy_C "Time delay for updating the Minor CRASH deployment information received from CAN message communication" VALUE 0x8024F5E4 RB_Val_Ws32 4294.96729500 Time_Dt -2147.48364800 2147.48364700 FORMAT "%13.8" /end CHARACTERISTIC
/begin CHARACTERISTIC AirBg_tiCrashDeployEnaDly_C "Minimum time which PWM signal should stay in airbag deployment range." VALUE 0x8024F5B0 RB_Val_Ws32 4294.96729500 Time_Dt -2147.48364800 2147.48364700 FORMAT "%13.8" /end CHARACTERISTIC
/begin CHARACTERISTIC Airbg_tiCrashOkHi_C "Calibration for maximum time period for PWM input signal" VALUE 0x8024F5B4 RB_Val_Wu32 214748364.750 Time_PwmHigh 0.00 214748364.750 FORMAT "%13.3" /end CHARACTERISTIC
/begin CHARACTERISTIC Airbg_tiCrashOkLo_C "Calibration for minimum time period for PWM input signal" VALUE 0x8024F5B8 RB_Val_Wu32 214748364.750 Time_PwmHigh 0.00 214748364.750 FORMAT "%13.3" /end CHARACTERISTIC
/begin CHARACTERISTIC Airbg_tiDurCrashDeployHi_C "Calibration for maximum duration of PWM on time when airbag is deployed" VALUE 0x8024F5BC RB_Val_Ws32 107374182.350 Time_PwmHigh 0.00 107374182.350 FORMAT "%13.3" EXTENDED_LIMITS -107374182.400 107374182.350 /end CHARACTERISTIC
/begin CHARACTERISTIC Airbg_tiDurCrashDeployLo_C "Calibration for minimum duration of PWM on time when airbag is deployed" VALUE 0x8024F5C0 RB_Val_Ws32 107374182.350 Time_PwmHigh 0.00 107374182.350 FORMAT "%13.3" EXTENDED_LIMITS -107374182.400 107374182.350 /end CHARACTERISTIC
/begin CHARACTERISTIC Airbg_tiDurCrashOkHi_C "Calibration for maximum duration of PWM on time during no crash" VALUE 0x8024F5C4 RB_Val_Wu32 214748364.750 Time_PwmHigh 0.00 214748364.750 FORMAT "%13.3" /end CHARACTERISTIC
/begin CHARACTERISTIC Airbg_tiDurCrashOkLo_C "Calibration for minimum duration of PWM on time during no crash" VALUE 0x8024F5C8 RB_Val_Wu32 214748364.750 Time_PwmHigh 0.00 214748364.750 FORMAT "%13.3" /end CHARACTERISTIC
/begin CHARACTERISTIC Airbg_tiDurPWMMxLim_C "Upper limit for PWM on duration" VALUE 0x8024F5CC RB_Val_Wu32 214748364.750 Time_PwmHigh 0.00 214748364.750 FORMAT "%13.3" /end CHARACTERISTIC
/begin CHARACTERISTIC Airbg_tiEnaDel_C "Time delay for hardware airbag deployment evaluation after T15 on" VALUE 0x8024F5D0 RB_Val_Ws32 4294.96729500 Time_Dt -2147.48364800 2147.48364700 FORMAT "%13.8" /end CHARACTERISTIC
/begin CHARACTERISTIC Airbg_tiT15OnDly_C "Time delay for T15 on to report the SCG error" VALUE 0x8024F5E8 RB_Val_Ws32 4294.96729500 Time_Dt -2147.48364800 2147.48364700 FORMAT "%13.8" /end CHARACTERISTIC
/begin CHARACTERISTIC Airbg_uBattMax_C "Maximum battery voltage" VALUE 0x8024F5D4 RB_Val_Ws16 1310700. Volt_Batt -655360.0 655340.0 FORMAT "%8.1" /end CHARACTERISTIC
/begin CHARACTERISTIC Airbg_uBattMin_C "Minimum Battery voltage" VALUE 0x8024F5D6 RB_Val_Ws16 1310700. Volt_Batt -655360.0 655340.0 FORMAT "%8.1" /end CHARACTERISTIC
/begin CHARACTERISTIC APP_dRawSigFac_C "Factor between sensor raw values" VALUE 0x8024E8E2 RB_Val_Wu16 7.999878 Fact 0.00 7.999878 FORMAT "%8.6" /end CHARACTERISTIC
/begin CHARACTERISTIC APP_drLimNeg_C "Max. pedal value decrease per computation step during operation of brake" VALUE 0x8024E87C RB_Val_Ws16 39999.39 PrcPerSec -20000.00 19999.39 FORMAT "%8.2" /end CHARACTERISTIC
/begin CHARACTERISTIC APP_drLimpMax_C "Limit for APP gradient in limphome mode" VALUE 0x8024E87E RB_Val_Ws16 39999.39 PrcPerSec -20000.00 19999.39 FORMAT "%8.2" /end CHARACTERISTIC
/begin CHARACTERISTIC APP_drLimPos_C "Max. permissible pedal value increase per computation step after operating brake" VALUE 0x8024E880 RB_Val_Ws16 39999.39 PrcPerSec -20000.00 19999.39 FORMAT "%8.2" /end CHARACTERISTIC
/begin CHARACTERISTIC APP_drLinRmp_C "error ramp by the switch between the two sets of linearisation parameters" VALUE 0x8024E8E4 RB_Val_Ws16 39999.39 PrcPerSec -20000.00 19999.39 FORMAT "%8.2" /end CHARACTERISTIC
/begin CHARACTERISTIC APP_drUnFltLim_C "Threshold for APP gradient to reset plausibility with brake" VALUE 0x8024E8C4 RB_Val_Ws16 39999.39 PrcPerSec -20000.00 19999.39 FORMAT "%8.2" /end CHARACTERISTIC
/begin CHARACTERISTIC APP_duLimErrPos_C "Pos. voltage gradient at switching of signals in case of error on the pedal sensor" VALUE 0x8024E8D4 RB_Val_Wu32 655.358886719 RmpVolt 0.00 655.358886719 FORMAT "%13.9" EXTENDED_LIMITS 0.00 13107199.9969 /end CHARACTERISTIC
/begin CHARACTERISTIC APP_flgT15HealEnad_C "Calibration to enable SRC healing during T15 reset" VALUE 0x8024E886 RB_Val_Wu8 1.00000000000 B_TRUE 0.00 1.00000000000 FORMAT "%13.11" /end CHARACTERISTIC
/begin CHARACTERISTIC APP_rLimpMax_C "Limit for APP value in limphome mode" VALUE 0x8024E882 RB_Val_Ws16 799.9878 Prc -400.0000 399.9878 FORMAT "%8.4" /end CHARACTERISTIC
/begin CHARACTERISTIC APP_rThresFltLowNeg_C "Threshold for low/mid-range Filter parameter falling signal" VALUE 0x8024E890 RB_Val_Ws16 799.9878 Prc -400.0000 399.9878 FORMAT "%8.4" /end CHARACTERISTIC
/begin CHARACTERISTIC APP_rThresFltLowPos_C "Threshold for low/mid-range Filter parameter rising signal" VALUE 0x8024E892 RB_Val_Ws16 799.9878 Prc -400.0000 399.9878 FORMAT "%8.4" /end CHARACTERISTIC
/begin CHARACTERISTIC APP_rThresFltMidNeg_C "Threshold for mid/high-range Filter parameter falling signal" VALUE 0x8024E894 RB_Val_Ws16 799.9878 Prc -400.0000 399.9878 FORMAT "%8.4" /end CHARACTERISTIC
/begin CHARACTERISTIC APP_rThresFltMidPos_C "Threshold for mid/high-range Filter parameter rising signal" VALUE 0x8024E896 RB_Val_Ws16 799.9878 Prc -400.0000 399.9878 FORMAT "%8.4" /end CHARACTERISTIC
/begin CHARACTERISTIC APP_rUnFltPlausBrkMax_C "Maximum pedal ratio to detect brake plausibility" VALUE 0x8024E8C6 RB_Val_Ws16 799.9878 Prc -400.0000 399.9878 FORMAT "%8.4" /end CHARACTERISTIC
/begin CHARACTERISTIC APP_swtBrkStRedOff_C "Calibration to select brake light switch signal" VALUE 0x8024E8C8 RB_Val_Wboolean 1.00000000000 B_TRUE 0.00 1.00000000000 FORMAT "%13.11" /end CHARACTERISTIC
/begin CHARACTERISTIC APP_swtCfg_CW "codeword in APP" VALUE 0x8024E8E6 RB_Val_Wu16 65535.00 OneToOne 0.00 65535.00 FORMAT "%8.2" /end CHARACTERISTIC
/begin CHARACTERISTIC APP_swtExtIntvSel_C "calibration mask to select the source of external interventions" VALUE 0x8024E8C9 RB_Val_Wu8 255.0 OneToOne 0.00 255.0 FORMAT "%5.1" /end CHARACTERISTIC
/begin CHARACTERISTIC APP_tiAliveDebLoHi_C "debounce time for the acceleration pedal alive detection rising edge" VALUE 0x8024E884 RB_Val_Ws16 655350.0 Time_ms -327680.0 327670.0 FORMAT "%8.1" /end CHARACTERISTIC
/begin CHARACTERISTIC APP_tiGradCondDebHiLo_C "debounce time for the release of the acceleration brake plausibility by gradient falling edge" VALUE 0x8024E8CA RB_Val_Ws16 655350.0 Time_ms -327680.0 327670.0 FORMAT "%8.1" /end CHARACTERISTIC
/begin CHARACTERISTIC APP_tiGradCondDebLoHi_C "debounce time for the release of the acceleration brake plausibility by gradient rising edge" VALUE 0x8024E8CC RB_Val_Ws16 655350.0 Time_ms -327680.0 327670.0 FORMAT "%8.1" /end CHARACTERISTIC
/begin CHARACTERISTIC APP_tiLowNegPT1_C "Filter parameter falling signal low range" VALUE 0x8024E898 RB_Val_Ws32 42949672950.0 Time_ms -21474836480.0 21474836470.0 FORMAT "%13.1" /end CHARACTERISTIC
/begin CHARACTERISTIC APP_tiLowPosPT1_C "Filter parameter rising signal low range" VALUE 0x8024E89C RB_Val_Ws32 42949672950.0 Time_ms -21474836480.0 21474836470.0 FORMAT "%13.1" /end CHARACTERISTIC
/begin CHARACTERISTIC APP_tiMidNegPT1_C "Filter parameter falling signal mid range" VALUE 0x8024E8A0 RB_Val_Ws32 42949672950.0 Time_ms -21474836480.0 21474836470.0 FORMAT "%13.1" /end CHARACTERISTIC
/begin CHARACTERISTIC APP_tiMidPosPT1_C "Filter parameter rising signal mid range" VALUE 0x8024E8A4 RB_Val_Ws32 42949672950.0 Time_ms -21474836480.0 21474836470.0 FORMAT "%13.1" /end CHARACTERISTIC
/begin CHARACTERISTIC APP_tiPlaAPP12DebDef_C "debounce time fot the defect detection of sync check" VALUE 0x8024E8E8 RB_Val_Ws16 655350.0 Time_ms -327680.0 327670.0 FORMAT "%8.1" /end CHARACTERISTIC
/begin CHARACTERISTIC APP_tiPlaAPP12DebOk_C "debounce time for the healing of sync check" VALUE 0x8024E8EA RB_Val_Ws16 655350.0 Time_ms -327680.0 327670.0 FORMAT "%8.1" /end CHARACTERISTIC
/begin CHARACTERISTIC APP_tiPlaBrkActvtDeb_C "Debounce time to activate BOA" VALUE 0x8024E8CE RB_Val_Ws16 655350.0 Time_ms -327680.0 327670.0 FORMAT "%8.1" /end CHARACTERISTIC
/begin CHARACTERISTIC APP_tiPlaBrkDeactvtDeb_C "Debounce time to deactivate BOA" VALUE 0x8024E8D0 RB_Val_Ws16 655350.0 Time_ms -327680.0 327670.0 FORMAT "%8.1" /end CHARACTERISTIC
/begin CHARACTERISTIC APP_tiSRCHigh1DebDef_C "Duration of defect debouncing for check DFC_SRCHighAPP1" VALUE 0x8024E8EC RB_Val_Ws16 655350.0 Time_ms -327680.0 327670.0 FORMAT "%8.1" /end CHARACTERISTIC
/begin CHARACTERISTIC APP_tiSRCHigh1DebOk_C "Duration of healing debouncing for check DFC_SRCHighAPP1" VALUE 0x8024E8EE RB_Val_Ws16 655350.0 Time_ms -327680.0 327670.0 FORMAT "%8.1" /end CHARACTERISTIC
/begin CHARACTERISTIC APP_tiSRCHigh2DebDef_C "Duration of defect debouncing for check DFC_SRCHighAPP2" VALUE 0x8024E8F0 RB_Val_Ws16 655350.0 Time_ms -327680.0 327670.0 FORMAT "%8.1" /end CHARACTERISTIC
/begin CHARACTERISTIC APP_tiSRCHigh2DebOk_C "Duration of healing debouncing for check DFC_SRCHighAPP2" VALUE 0x8024E8F2 RB_Val_Ws16 655350.0 Time_ms -327680.0 327670.0 FORMAT "%8.1" /end CHARACTERISTIC
/begin CHARACTERISTIC APP_tiSRCLow1DebDef_C "Duration of defect debouncing for check DFC_SRCLowAPP1" VALUE 0x8024E8F4 RB_Val_Ws16 655350.0 Time_ms -327680.0 327670.0 FORMAT "%8.1" /end CHARACTERISTIC
/begin CHARACTERISTIC APP_tiSRCLow1DebOk_C "Duration of healing debouncing for check DFC_SRCLowAPP1" VALUE 0x8024E8F6 RB_Val_Ws16 655350.0 Time_ms -327680.0 327670.0 FORMAT "%8.1" /end CHARACTERISTIC
/begin CHARACTERISTIC APP_tiSRCLow2DebDef_C "Duration of defect debouncing for check DFC_SRCLowAPP2" VALUE 0x8024E8F8 RB_Val_Ws16 655350.0 Time_ms -327680.0 327670.0 FORMAT "%8.1" /end CHARACTERISTIC
/begin CHARACTERISTIC APP_tiSRCLow2DebOk_C "Duration of healing debouncing for check DFC_SRCLowAPP2" VALUE 0x8024E8FA RB_Val_Ws16 655350.0 Time_ms -327680.0 327670.0 FORMAT "%8.1" /end CHARACTERISTIC
/begin CHARACTERISTIC APP_tiUppNegPT1_C "Filter parameter falling signal high range" VALUE 0x8024E8A8 RB_Val_Ws32 42949672950.0 Time_ms -21474836480.0 21474836470.0 FORMAT "%13.1" /end CHARACTERISTIC
/begin CHARACTERISTIC APP_tiUppPosPT1_C "Filter parameter rising signal high range" VALUE 0x8024E8AC RB_Val_Ws32 42949672950.0 Time_ms -21474836480.0 21474836470.0 FORMAT "%13.1" /end CHARACTERISTIC
/begin CHARACTERISTIC APP_uJitter_C "Threshold for unjittering" VALUE 0x8024E8DC RB_Val_Ws16 13107.00 Volt -6553.600 6553.400 FORMAT "%8.3" /end CHARACTERISTIC
/begin CHARACTERISTIC APP_uKDHighAPP_C "Upper threshold for kickdown hysteresis" VALUE 0x8024E8B0 RB_Val_Ws16 13107.00 Volt -6553.600 6553.400 FORMAT "%8.3" /end CHARACTERISTIC
/begin CHARACTERISTIC APP_uKDLowAPP_C "Lower threshold for kickdown hysteresis" VALUE 0x8024E8B2 RB_Val_Ws16 13107.00 Volt -6553.600 6553.400 FORMAT "%8.3" /end CHARACTERISTIC
/begin CHARACTERISTIC APP_uPreUnJitter1_C "Threshold for unjittering sensor signal 1" VALUE 0x8024E8DE RB_Val_Ws16 13107.00 Volt -6553.600 6553.400 FORMAT "%8.3" /end CHARACTERISTIC
/begin CHARACTERISTIC APP_uPreUnJitter2_C "Threshold for unjittering sensor signal 2" VALUE 0x8024E8E0 RB_Val_Ws16 13107.00 Volt -6553.600 6553.400 FORMAT "%8.3" /end CHARACTERISTIC
/begin CHARACTERISTIC APP_uRaw1Def_C "Substitute value for sensor 1 defect" VALUE 0x8024E8FC RB_Val_Ws16 13107.00 Volt -6553.600 6553.400 FORMAT "%8.3" /end CHARACTERISTIC
/begin CHARACTERISTIC APP_uRaw1SRCHigh_C "Threshold for SRC high for sensor 1" VALUE 0x8024E888 RB_Val_Ws16 13107.00 Volt -6553.600 6553.400 FORMAT "%8.3" /end CHARACTERISTIC
/begin CHARACTERISTIC APP_uRaw1SRCLow_C "Threshold for SRC low for sensor 1" VALUE 0x8024E88A RB_Val_Ws16 13107.00 Volt -6553.600 6553.400 FORMAT "%8.3" /end CHARACTERISTIC
/begin CHARACTERISTIC APP_uRaw2Def_C "Substitute value for sensor 2 defect" VALUE 0x8024E8FE RB_Val_Ws16 13107.00 Volt -6553.600 6553.400 FORMAT "%8.3" /end CHARACTERISTIC
/begin CHARACTERISTIC APP_uRaw2Offset_C "Offset for sensor signal 2" VALUE 0x8024E8D8 RB_Val_Ws16 13107.00 Volt -6553.600 6553.400 FORMAT "%8.3" /end CHARACTERISTIC
/begin CHARACTERISTIC APP_uRaw2SRCHigh_C "Threshold for SRC high for sensor 2" VALUE 0x8024E88C RB_Val_Ws16 13107.00 Volt -6553.600 6553.400 FORMAT "%8.3" /end CHARACTERISTIC
/begin CHARACTERISTIC APP_uRaw2SRCLow_C "Threshold for SRC low for sensor 2" VALUE 0x8024E88E RB_Val_Ws16 13107.00 Volt -6553.600 6553.400 FORMAT "%8.3" /end CHARACTERISTIC
/begin CHARACTERISTIC APP_uRawFullLdLimp_C "upper normalisation parameter in case of limp modus" VALUE 0x8024E900 RB_Val_Ws16 13107.00 Volt -6553.600 6553.400 FORMAT "%8.3" /end CHARACTERISTIC
/begin CHARACTERISTIC APP_uRawFullLd_C "PWG voltage threshold for full-throttle range" VALUE 0x8024E902 RB_Val_Ws16 13107.00 Volt -6553.600 6553.400 FORMAT "%8.3" /end CHARACTERISTIC
/begin CHARACTERISTIC APP_uRawIdlLimp_C "PWG voltage threshold for partial throttle range in Limp mode" VALUE 0x8024E904 RB_Val_Ws16 13107.00 Volt -6553.600 6553.400 FORMAT "%8.3" /end CHARACTERISTIC
/begin CHARACTERISTIC APP_uRawIdl_C "PWG voltage threshold for partial throttle range" VALUE 0x8024E906 RB_Val_Ws16 13107.00 Volt -6553.600 6553.400 FORMAT "%8.3" /end CHARACTERISTIC
/begin CHARACTERISTIC APP_uSply_C "Sensor supply voltage" VALUE 0x8024E908 RB_Val_Ws16 13107.00 Volt -6553.600 6553.400 FORMAT "%8.3" /end CHARACTERISTIC
/begin CHARACTERISTIC APP_uSyncMin_C "Minimum voltage to enable sync check" VALUE 0x8024E8B4 RB_Val_Ws16 13107.00 Volt -6553.600 6553.400 FORMAT "%8.3" /end CHARACTERISTIC
/begin CHARACTERISTIC APP_uSync_CUR "Curve to calculate permitted maximum for difference of signal voltages of sensor 1 and sensor 2" CURVE 0x8024E8B6 RB_Curve_S16_S16 13107.00 Volt -6553.600 6553.400 FORMAT "%8.3"
 /begin AXIS_DESCR STD_AXIS APP_uMin12half Volt 3 -6553.600 6553.400 FORMAT "%8.3" DEPOSIT ABSOLUTE /end AXIS_DESCR
/end CHARACTERISTIC
/begin CHARACTERISTIC APP_vLim_C "threshold for vehicle speed to skip security check" VALUE 0x8024E8D2 RB_Val_Ws16 655.3500 Vel -327.6800 327.6700 FORMAT "%8.4" /end CHARACTERISTIC
/begin CHARACTERISTIC DDRC_DurDeb.ACCmpr_tiFltLvl1DebOk_C "" VALUE 0x802408A0 Val_Wu16 655350.0 DDRCTime_ms 0.00 655350.0 FORMAT "%8.1" /end CHARACTERISTIC
/begin CHARACTERISTIC DDRC_DurDeb.ACCmpr_tiFltLvl1DebDef_C "" VALUE 0x802408A2 Val_Wu16 655350.0 DDRCTime_ms 0.00 655350.0 FORMAT "%8.1" /end CHARACTERISTIC
/begin CHARACTERISTIC DDRC_DurDeb.ACCmpr_tiFltLvl2DebOk_C "" VALUE 0x802408A4 Val_Wu16 655350.0 DDRCTime_ms 0.00 655350.0 FORMAT "%8.1" /end CHARACTERISTIC
/begin CHARACTERISTIC DDRC_DurDeb.ACCmpr_tiFltLvl2DebDef_C "" VALUE 0x802408A6 Val_Wu16 655350.0 DDRCTime_ms 0.00 655350.0 FORMAT "%8.1" /end CHARACTERISTIC
/begin CHARACTERISTIC DDRC_DurDeb.ACCmpr_tiFltLvl3DebOk_C "" VALUE 0x802408A8 Val_Wu16 655350.0 DDRCTime_ms 0.00 655350.0 FORMAT "%8.1" /end CHARACTERISTIC
/begin CHARACTERISTIC DDRC_DurDeb.ACCmpr_tiFltLvl3DebDef_C "" VALUE 0x802408AA Val_Wu16 655350.0 DDRCTime_ms 0.00 655350.0 FORMAT "%8.1" /end CHARACTERISTIC
/begin CHARACTERISTIC DDRC_DurDeb.ACCmpr_tiFltLvl4DebOk_C "" VALUE 0x802408AC Val_Wu16 655350.0 DDRCTime_ms 0.00 655350.0 FORMAT "%8.1" /end CHARACTERISTIC
/begin CHARACTERISTIC DDRC_DurDeb.ACCmpr_tiFltLvl4DebDef_C "" VALUE 0x802408AE Val_Wu16 655350.0 DDRCTime_ms 0.00 655350.0 FORMAT "%8.1" /end CHARACTERISTIC
/begin CHARACTERISTIC DDRC_DurDeb.ACCmpr_tiHiPFltDebOk_C "" VALUE 0x802408B0 Val_Wu16 655350.0 DDRCTime_ms 0.00 655350.0 FORMAT "%8.1" /end CHARACTERISTIC
/begin CHARACTERISTIC DDRC_DurDeb.ACCmpr_tiHiPFltDebDef_C "" VALUE 0x802408B2 Val_Wu16 655350.0 DDRCTime_ms 0.00 655350.0 FORMAT "%8.1" /end CHARACTERISTIC
/begin CHARACTERISTIC DDRC_DurDeb.ACCmpr_tiInvldCmprStDebOk_C "" VALUE 0x802408B4 Val_Wu16 655350.0 DDRCTime_ms 0.00 655350.0 FORMAT "%8.1" /end CHARACTERISTIC
/begin CHARACTERISTIC DDRC_DurDeb.ACCmpr_tiInvldCmprStDebDef_C "" VALUE 0x802408B6 Val_Wu16 655350.0 DDRCTime_ms 0.00 655350.0 FORMAT "%8.1" /end CHARACTERISTIC
/begin CHARACTERISTIC DDRC_DurDeb.ACCmpr_tiInvldElecActPwrDebOk_C "" VALUE 0x802408B8 Val_Wu16 655350.0 DDRCTime_ms 0.00 655350.0 FORMAT "%8.1" /end CHARACTERISTIC
/begin CHARACTERISTIC DDRC_DurDeb.ACCmpr_tiInvldElecActPwrDebDef_C "" VALUE 0x802408BA Val_Wu16 655350.0 DDRCTime_ms 0.00 655350.0 FORMAT "%8.1" /end CHARACTERISTIC
/begin CHARACTERISTIC DDRC_DurDeb.ACCmpr_tiLoPFltDebOk_C "" VALUE 0x802408BC Val_Wu16 655350.0 DDRCTime_ms 0.00 655350.0 FORMAT "%8.1" /end CHARACTERISTIC
/begin CHARACTERISTIC DDRC_DurDeb.ACCmpr_tiLoPFltDebDef_C "" VALUE 0x802408BE Val_Wu16 655350.0 DDRCTime_ms 0.00 655350.0 FORMAT "%8.1" /end CHARACTERISTIC
/begin CHARACTERISTIC DDRC_DurDeb.AcExtChrgr_tiIBattExcddDebOk_C "" VALUE 0x80240AE4 Val_Wu16 655350.0 DDRCTime_ms 0.00 655350.0 FORMAT "%8.1" /end CHARACTERISTIC
/begin CHARACTERISTIC DDRC_DurDeb.AcExtChrgr_tiIBattExcddDebDef_C "" VALUE 0x80240AE6 Val_Wu16 655350.0 DDRCTime_ms 0.00 655350.0 FORMAT "%8.1" /end CHARACTERISTIC
/begin CHARACTERISTIC DDRC_DurDeb.AcExtChrgr_tiIInExcddDebOk_C "" VALUE 0x80240AE8 Val_Wu16 655350.0 DDRCTime_ms 0.00 655350.0 FORMAT "%8.1" /end CHARACTERISTIC
/begin CHARACTERISTIC DDRC_DurDeb.AcExtChrgr_tiIInExcddDebDef_C "" VALUE 0x80240AEA Val_Wu16 655350.0 DDRCTime_ms 0.00 655350.0 FORMAT "%8.1" /end CHARACTERISTIC
/begin CHARACTERISTIC DDRC_DurDeb.AcExtChrgr_tiIOutDeDebOk_C "" VALUE 0x80240AEC Val_Wu16 655350.0 DDRCTime_ms 0.00 655350.0 FORMAT "%8.1" /end CHARACTERISTIC
/begin CHARACTERISTIC DDRC_DurDeb.AcExtChrgr_tiIOutDeDebDef_C "" VALUE 0x80240AEE Val_Wu16 655350.0 DDRCTime_ms 0.00 655350.0 FORMAT "%8.1" /end CHARACTERISTIC
/begin CHARACTERISTIC DDRC_DurDeb.AcExtChrgr_tiIOutExcddDebOk_C "" VALUE 0x80240AF0 Val_Wu16 655350.0 DDRCTime_ms 0.00 655350.0 FORMAT "%8.1" /end CHARACTERISTIC
/begin CHARACTERISTIC DDRC_DurDeb.AcExtChrgr_tiIOutExcddDebDef_C "" VALUE 0x80240AF2 Val_Wu16 655350.0 DDRCTime_ms 0.00 655350.0 FORMAT "%8.1" /end CHARACTERISTIC
/begin CHARACTERISTIC DDRC_DurDeb.AcExtChrgr_tiUOutDeDebOk_C "" VALUE 0x80240AF4 Val_Wu16 655350.0 DDRCTime_ms 0.00 655350.0 FORMAT "%8.1" /end CHARACTERISTIC
/begin CHARACTERISTIC DDRC_DurDeb.AcExtChrgr_tiUOutDeDebDef_C "" VALUE 0x80240AF6 Val_Wu16 655350.0 DDRCTime_ms 0.00 655350.0 FORMAT "%8.1" /end CHARACTERISTIC
/begin CHARACTERISTIC DDRC_DurDeb.Airbg_tiAbgHiSigFltDebOk_C "" VALUE 0x80240AF8 Val_Wu16 655350.0 DDRCTime_ms 0.00 655350.0 FORMAT "%8.1" /end CHARACTERISTIC
/begin CHARACTERISTIC DDRC_DurDeb.Airbg_tiAbgHiSigFltDebDef_C "" VALUE 0x80240AFA Val_Wu16 655350.0 DDRCTime_ms 0.00 655350.0 FORMAT "%8.1" /end CHARACTERISTIC
/begin CHARACTERISTIC DDRC_DurDeb.Airbg_tiAbgIntPatFltDebOk_C "" VALUE 0x80240AFC Val_Wu16 655350.0 DDRCTime_ms 0.00 655350.0 FORMAT "%8.1" /end CHARACTERISTIC
/begin CHARACTERISTIC DDRC_DurDeb.Airbg_tiAbgIntPatFltDebDef_C "" VALUE 0x80240AFE Val_Wu16 655350.0 DDRCTime_ms 0.00 655350.0 FORMAT "%8.1" /end CHARACTERISTIC
/begin CHARACTERISTIC DDRC_DurDeb.Airbg_tiAbgLoSigFltDebOk_C "" VALUE 0x80240B00 Val_Wu16 655350.0 DDRCTime_ms 0.00 655350.0 FORMAT "%8.1" /end CHARACTERISTIC
/begin CHARACTERISTIC DDRC_DurDeb.Airbg_tiAbgLoSigFltDebDef_C "" VALUE 0x80240B02 Val_Wu16 655350.0 DDRCTime_ms 0.00 655350.0 FORMAT "%8.1" /end CHARACTERISTIC
/begin CHARACTERISTIC DDRC_DurDeb.Airbg_tiAbgUnkwnErrSigFltDebOk_C "" VALUE 0x80240B04 Val_Wu16 655350.0 DDRCTime_ms 0.00 655350.0 FORMAT "%8.1" /end CHARACTERISTIC
/begin CHARACTERISTIC DDRC_DurDeb.Airbg_tiAbgUnkwnErrSigFltDebDef_C "" VALUE 0x80240B06 Val_Wu16 655350.0 DDRCTime_ms 0.00 655350.0 FORMAT "%8.1" /end CHARACTERISTIC
/begin CHARACTERISTIC DDRC_DurDeb.Airbg_tiAirbgCanHWPlausDebOk_C "" VALUE 0x80240B08 Val_Wu16 655350.0 DDRCTime_ms 0.00 655350.0 FORMAT "%8.1" /end CHARACTERISTIC
/begin CHARACTERISTIC DDRC_DurDeb.Airbg_tiAirbgCanHWPlausDebDef_C "" VALUE 0x80240B0A Val_Wu16 655350.0 DDRCTime_ms 0.00 655350.0 FORMAT "%8.1" /end CHARACTERISTIC
/begin CHARACTERISTIC DDRC_DurDeb.Airbg_tiAirbgHWCanPlausDebOk_C "" VALUE 0x80240B0C Val_Wu16 655350.0 DDRCTime_ms 0.00 655350.0 FORMAT "%8.1" /end CHARACTERISTIC
/begin CHARACTERISTIC DDRC_DurDeb.Airbg_tiAirbgHWCanPlausDebDef_C "" VALUE 0x80240B0E Val_Wu16 655350.0 DDRCTime_ms 0.00 655350.0 FORMAT "%8.1" /end CHARACTERISTIC
/begin CHARACTERISTIC DDRC_DurDeb.Airbg_tiCrashEveOccDebOk_C "" VALUE 0x80240B10 Val_Wu16 655350.0 DDRCTime_ms 0.00 655350.0 FORMAT "%8.1" /end CHARACTERISTIC
/begin CHARACTERISTIC DDRC_DurDeb.Airbg_tiCrashEveOccDebDef_C "" VALUE 0x80240B12 Val_Wu16 655350.0 DDRCTime_ms 0.00 655350.0 FORMAT "%8.1" /end CHARACTERISTIC
/begin CHARACTERISTIC DDRC_DurDeb.Airbg_tiImpactDebOk_C "" VALUE 0x80240B14 Val_Wu16 655350.0 DDRCTime_ms 0.00 655350.0 FORMAT "%8.1" /end CHARACTERISTIC
/begin CHARACTERISTIC DDRC_DurDeb.Airbg_tiImpactDebDef_C "" VALUE 0x80240B16 Val_Wu16 655350.0 DDRCTime_ms 0.00 655350.0 FORMAT "%8.1" /end CHARACTERISTIC
/begin CHARACTERISTIC DDRC_DurDeb.Airbg_tiImpactMinorDebOk_C "" VALUE 0x80240B18 Val_Wu16 655350.0 DDRCTime_ms 0.00 655350.0 FORMAT "%8.1" /end CHARACTERISTIC
/begin CHARACTERISTIC DDRC_DurDeb.Airbg_tiImpactMinorDebDef_C "" VALUE 0x80240B1A Val_Wu16 655350.0 DDRCTime_ms 0.00 655350.0 FORMAT "%8.1" /end CHARACTERISTIC
/begin CHARACTERISTIC DDRC_DurDeb.Airbg_tiPerHiDebOk_C "" VALUE 0x80240B1C Val_Wu16 655350.0 DDRCTime_ms 0.00 655350.0 FORMAT "%8.1" /end CHARACTERISTIC
/begin CHARACTERISTIC DDRC_DurDeb.Airbg_tiPerHiDebDef_C "" VALUE 0x80240B1E Val_Wu16 655350.0 DDRCTime_ms 0.00 655350.0 FORMAT "%8.1" /end CHARACTERISTIC
/begin CHARACTERISTIC DDRC_DurDeb.Airbg_tiPerdRangeDebOk_C "" VALUE 0x80240B20 Val_Wu16 655350.0 DDRCTime_ms 0.00 655350.0 FORMAT "%8.1" /end CHARACTERISTIC
/begin CHARACTERISTIC DDRC_DurDeb.Airbg_tiPerdRangeDebDef_C "" VALUE 0x80240B22 Val_Wu16 655350.0 DDRCTime_ms 0.00 655350.0 FORMAT "%8.1" /end CHARACTERISTIC
/begin CHARACTERISTIC DDRC_RatDeb.ACCmpr_tiFltLvl1UDRat_C "" VALUE 0x80248A2C Val_Wu8 3.00000000000 DDRC_Ratio 1.00000000000 4.00000000000 FORMAT "%13.11" /end CHARACTERISTIC
/begin CHARACTERISTIC DDRC_RatDeb.ACCmpr_tiFltLvl2UDRat_C "" VALUE 0x80248A2D Val_Wu8 3.00000000000 DDRC_Ratio 1.00000000000 4.00000000000 FORMAT "%13.11" /end CHARACTERISTIC
/begin CHARACTERISTIC DDRC_RatDeb.ACCmpr_tiFltLvl3UDRat_C "" VALUE 0x80248A2E Val_Wu8 3.00000000000 DDRC_Ratio 1.00000000000 4.00000000000 FORMAT "%13.11" /end CHARACTERISTIC
/begin CHARACTERISTIC DDRC_RatDeb.ACCmpr_tiFltLvl4UDRat_C "" VALUE 0x80248A2F Val_Wu8 3.00000000000 DDRC_Ratio 1.00000000000 4.00000000000 FORMAT "%13.11" /end CHARACTERISTIC
/begin CHARACTERISTIC DDRC_RatDeb.ACCmpr_tiHiPFltUDRat_C "" VALUE 0x80248A30 Val_Wu8 3.00000000000 DDRC_Ratio 1.00000000000 4.00000000000 FORMAT "%13.11" /end CHARACTERISTIC
/begin CHARACTERISTIC DDRC_RatDeb.ACCmpr_tiInvldCmprStUDRat_C "" VALUE 0x80248A31 Val_Wu8 3.00000000000 DDRC_Ratio 1.00000000000 4.00000000000 FORMAT "%13.11" /end CHARACTERISTIC
/begin CHARACTERISTIC DDRC_RatDeb.ACCmpr_tiInvldElecActPwrUDRat_C "" VALUE 0x80248A32 Val_Wu8 3.00000000000 DDRC_Ratio 1.00000000000 4.00000000000 FORMAT "%13.11" /end CHARACTERISTIC
/begin CHARACTERISTIC DDRC_RatDeb.ACCmpr_tiLoPFltUDRat_C "" VALUE 0x80248A33 Val_Wu8 3.00000000000 DDRC_Ratio 1.00000000000 4.00000000000 FORMAT "%13.11" /end CHARACTERISTIC
/begin CHARACTERISTIC DFC_CtlMsk2.DFC_AbgHiSigFlt_C "" VALUE 0x802412EE Val_Wu8 255.0 DFES_OneToOne 0.00 255.0 FORMAT "%5.1" /end CHARACTERISTIC
/begin CHARACTERISTIC DFC_CtlMsk2.DFC_AbgIntPatFlt_C "" VALUE 0x802412EF Val_Wu8 255.0 DFES_OneToOne 0.00 255.0 FORMAT "%5.1" /end CHARACTERISTIC
/begin CHARACTERISTIC DFC_CtlMsk2.DFC_AbgLoSigFlt_C "" VALUE 0x802412F0 Val_Wu8 255.0 DFES_OneToOne 0.00 255.0 FORMAT "%5.1" /end CHARACTERISTIC
/begin CHARACTERISTIC DFC_CtlMsk2.DFC_AbgUnkwnErrSigFlt_C "" VALUE 0x802412F1 Val_Wu8 255.0 DFES_OneToOne 0.00 255.0 FORMAT "%5.1" /end CHARACTERISTIC
/begin CHARACTERISTIC DFC_CtlMsk2.DFC_AcExtChrgrIBattExcdd_C "" VALUE 0x802412F2 Val_Wu8 255.0 DFES_OneToOne 0.00 255.0 FORMAT "%5.1" /end CHARACTERISTIC
/begin CHARACTERISTIC DFC_CtlMsk2.DFC_AcExtChrgrIInExcdd_C "" VALUE 0x802412F3 Val_Wu8 255.0 DFES_OneToOne 0.00 255.0 FORMAT "%5.1" /end CHARACTERISTIC
/begin CHARACTERISTIC DFC_CtlMsk2.DFC_AcExtChrgrIOutDe_C "" VALUE 0x802412F4 Val_Wu8 255.0 DFES_OneToOne 0.00 255.0 FORMAT "%5.1" /end CHARACTERISTIC
/begin CHARACTERISTIC DFC_CtlMsk2.DFC_AcExtChrgrIOutExcdd_C "" VALUE 0x802412F5 Val_Wu8 255.0 DFES_OneToOne 0.00 255.0 FORMAT "%5.1" /end CHARACTERISTIC
/begin CHARACTERISTIC DFC_CtlMsk2.DFC_AcExtChrgrUOutDe_C "" VALUE 0x802412F6 Val_Wu8 255.0 DFES_OneToOne 0.00 255.0 FORMAT "%5.1" /end CHARACTERISTIC
/begin CHARACTERISTIC DFC_CtlMsk2.DFC_Airbg_C "" VALUE 0x802412F9 Val_Wu8 255.0 DFES_OneToOne 0.00 255.0 FORMAT "%5.1" /end CHARACTERISTIC
/begin CHARACTERISTIC DFC_CtlMsk2.DFC_AirbgCanHWPlaus_C "" VALUE 0x802412FB Val_Wu8 255.0 DFES_OneToOne 0.00 255.0 FORMAT "%5.1" /end CHARACTERISTIC
/begin CHARACTERISTIC DFC_CtlMsk2.DFC_AirbgHWCanPlaus_C "" VALUE 0x802412FC Val_Wu8 255.0 DFES_OneToOne 0.00 255.0 FORMAT "%5.1" /end CHARACTERISTIC
/begin CHARACTERISTIC DFC_CtlMsk2.DFC_AirbgMnr_C "" VALUE 0x802412FD Val_Wu8 255.0 DFES_OneToOne 0.00 255.0 FORMAT "%5.1" /end CHARACTERISTIC
/begin CHARACTERISTIC DFC_CtlMsk2.DFC_AirbgPerHi_C "" VALUE 0x802412FE Val_Wu8 255.0 DFES_OneToOne 0.00 255.0 FORMAT "%5.1" /end CHARACTERISTIC
/begin CHARACTERISTIC DFC_CtlMsk2.DFC_AirbgPerdRngFlt_C "" VALUE 0x802412FF Val_Wu8 255.0 DFES_OneToOne 0.00 255.0 FORMAT "%5.1" /end CHARACTERISTIC
/begin CHARACTERISTIC DFC_CtlMsk2.DFC_CrashEveOcc_C "" VALUE 0x80241358 Val_Wu8 255.0 DFES_OneToOne 0.00 255.0 FORMAT "%5.1" /end CHARACTERISTIC
/begin CHARACTERISTIC DFC_CtlMsk2.DFC_ACCmprFltLvl1_C "" VALUE 0x802414D9 Val_Wu8 255.0 DFES_OneToOne 0.00 255.0 FORMAT "%5.1" /end CHARACTERISTIC
/begin CHARACTERISTIC DFC_CtlMsk2.DFC_ACCmprFltLvl2_C "" VALUE 0x802414DA Val_Wu8 255.0 DFES_OneToOne 0.00 255.0 FORMAT "%5.1" /end CHARACTERISTIC
/begin CHARACTERISTIC DFC_CtlMsk2.DFC_ACCmprFltLvl3_C "" VALUE 0x802414DB Val_Wu8 255.0 DFES_OneToOne 0.00 255.0 FORMAT "%5.1" /end CHARACTERISTIC
/begin CHARACTERISTIC DFC_CtlMsk2.DFC_ACCmprFltLvl4_C "" VALUE 0x802414DC Val_Wu8 255.0 DFES_OneToOne 0.00 255.0 FORMAT "%5.1" /end CHARACTERISTIC
/begin CHARACTERISTIC DFC_CtlMsk2.DFC_ACCmprHiPFlt_C "" VALUE 0x802414DD Val_Wu8 255.0 DFES_OneToOne 0.00 255.0 FORMAT "%5.1" /end CHARACTERISTIC
/begin CHARACTERISTIC DFC_CtlMsk2.DFC_ACCmprInvldCmprSt_C "" VALUE 0x802414DE Val_Wu8 255.0 DFES_OneToOne 0.00 255.0 FORMAT "%5.1" /end CHARACTERISTIC
/begin CHARACTERISTIC DFC_CtlMsk2.DFC_ACCmprInvldElecActPwr_C "" VALUE 0x802414DF Val_Wu8 255.0 DFES_OneToOne 0.00 255.0 FORMAT "%5.1" /end CHARACTERISTIC
/begin CHARACTERISTIC DFC_CtlMsk2.DFC_ACCmprLoPFlt_C "" VALUE 0x802414E0 Val_Wu8 255.0 DFES_OneToOne 0.00 255.0 FORMAT "%5.1" /end CHARACTERISTIC
/begin CHARACTERISTIC DFC_CtlMsk2.DFC_AppAllSnsrDfct_C "" VALUE 0x802415CD Val_Wu8 255.0 DFES_OneToOne 0.00 255.0 FORMAT "%5.1" /end CHARACTERISTIC
/begin CHARACTERISTIC DFC_CtlMsk2.DFC_SRCHighAPP1_C "" VALUE 0x8024169F Val_Wu8 255.0 DFES_OneToOne 0.00 255.0 FORMAT "%5.1" /end CHARACTERISTIC
/begin CHARACTERISTIC DFC_CtlMsk2.DFC_SRCHighAPP2_C "" VALUE 0x802416A0 Val_Wu8 255.0 DFES_OneToOne 0.00 255.0 FORMAT "%5.1" /end CHARACTERISTIC
/begin CHARACTERISTIC DFC_CtlMsk2.DFC_SRCLowAPP1_C "" VALUE 0x802416A1 Val_Wu8 255.0 DFES_OneToOne 0.00 255.0 FORMAT "%5.1" /end CHARACTERISTIC
/begin CHARACTERISTIC DFC_CtlMsk2.DFC_SRCLowAPP2_C "" VALUE 0x802416A2 Val_Wu8 255.0 DFES_OneToOne 0.00 255.0 FORMAT "%5.1" /end CHARACTERISTIC
/begin CHARACTERISTIC DFC_CtlMsk2.DFC_SyncAPP_C "" VALUE 0x802416AB Val_Wu8 255.0 DFES_OneToOne 0.00 255.0 FORMAT "%5.1" /end CHARACTERISTIC
/begin CHARACTERISTIC DFC_DisblMsk2.DFC_AbgHiSigFlt_C "" VALUE 0x80248AC2 Val_Wu16 65535.00 DFES_OneToOne 0.00 65535.00 FORMAT "%8.2" /end CHARACTERISTIC
/begin CHARACTERISTIC DFC_DisblMsk2.DFC_AbgIntPatFlt_C "" VALUE 0x80248AC4 Val_Wu16 65535.00 DFES_OneToOne 0.00 65535.00 FORMAT "%8.2" /end CHARACTERISTIC
/begin CHARACTERISTIC DFC_DisblMsk2.DFC_AbgLoSigFlt_C "" VALUE 0x80248AC6 Val_Wu16 65535.00 DFES_OneToOne 0.00 65535.00 FORMAT "%8.2" /end CHARACTERISTIC
/begin CHARACTERISTIC DFC_DisblMsk2.DFC_AbgUnkwnErrSigFlt_C "" VALUE 0x80248AC8 Val_Wu16 65535.00 DFES_OneToOne 0.00 65535.00 FORMAT "%8.2" /end CHARACTERISTIC
/begin CHARACTERISTIC DFC_DisblMsk2.DFC_AcExtChrgrIBattExcdd_C "" VALUE 0x80248ACA Val_Wu16 65535.00 DFES_OneToOne 0.00 65535.00 FORMAT "%8.2" /end CHARACTERISTIC
/begin CHARACTERISTIC DFC_DisblMsk2.DFC_AcExtChrgrIInExcdd_C "" VALUE 0x80248ACC Val_Wu16 65535.00 DFES_OneToOne 0.00 65535.00 FORMAT "%8.2" /end CHARACTERISTIC
/begin CHARACTERISTIC DFC_DisblMsk2.DFC_AcExtChrgrIOutDe_C "" VALUE 0x80248ACE Val_Wu16 65535.00 DFES_OneToOne 0.00 65535.00 FORMAT "%8.2" /end CHARACTERISTIC
/begin CHARACTERISTIC DFC_DisblMsk2.DFC_AcExtChrgrIOutExcdd_C "" VALUE 0x80248AD0 Val_Wu16 65535.00 DFES_OneToOne 0.00 65535.00 FORMAT "%8.2" /end CHARACTERISTIC
/begin CHARACTERISTIC DFC_DisblMsk2.DFC_AcExtChrgrUOutDe_C "" VALUE 0x80248AD2 Val_Wu16 65535.00 DFES_OneToOne 0.00 65535.00 FORMAT "%8.2" /end CHARACTERISTIC
/begin CHARACTERISTIC DFC_DisblMsk2.DFC_Airbg_C "" VALUE 0x80248AD8 Val_Wu16 65535.00 DFES_OneToOne 0.00 65535.00 FORMAT "%8.2" /end CHARACTERISTIC
/begin CHARACTERISTIC DFC_DisblMsk2.DFC_AirbgCanHWPlaus_C "" VALUE 0x80248ADC Val_Wu16 65535.00 DFES_OneToOne 0.00 65535.00 FORMAT "%8.2" /end CHARACTERISTIC
/begin CHARACTERISTIC DFC_DisblMsk2.DFC_AirbgHWCanPlaus_C "" VALUE 0x80248ADE Val_Wu16 65535.00 DFES_OneToOne 0.00 65535.00 FORMAT "%8.2" /end CHARACTERISTIC
/begin CHARACTERISTIC DFC_DisblMsk2.DFC_AirbgMnr_C "" VALUE 0x80248AE0 Val_Wu16 65535.00 DFES_OneToOne 0.00 65535.00 FORMAT "%8.2" /end CHARACTERISTIC
/begin CHARACTERISTIC DFC_DisblMsk2.DFC_AirbgPerHi_C "" VALUE 0x80248AE2 Val_Wu16 65535.00 DFES_OneToOne 0.00 65535.00 FORMAT "%8.2" /end CHARACTERISTIC
/begin CHARACTERISTIC DFC_DisblMsk2.DFC_AirbgPerdRngFlt_C "" VALUE 0x80248AE4 Val_Wu16 65535.00 DFES_OneToOne 0.00 65535.00 FORMAT "%8.2" /end CHARACTERISTIC
/begin CHARACTERISTIC DFC_DisblMsk2.DFC_CrashEveOcc_C "" VALUE 0x80248B96 Val_Wu16 65535.00 DFES_OneToOne 0.00 65535.00 FORMAT "%8.2" /end CHARACTERISTIC
/begin CHARACTERISTIC DFC_DisblMsk2.DFC_ACCmprFltLvl1_C "" VALUE 0x80248E98 Val_Wu16 65535.00 DFES_OneToOne 0.00 65535.00 FORMAT "%8.2" /end CHARACTERISTIC
/begin CHARACTERISTIC DFC_DisblMsk2.DFC_ACCmprFltLvl2_C "" VALUE 0x80248E9A Val_Wu16 65535.00 DFES_OneToOne 0.00 65535.00 FORMAT "%8.2" /end CHARACTERISTIC
/begin CHARACTERISTIC DFC_DisblMsk2.DFC_ACCmprFltLvl3_C "" VALUE 0x80248E9C Val_Wu16 65535.00 DFES_OneToOne 0.00 65535.00 FORMAT "%8.2" /end CHARACTERISTIC
/begin CHARACTERISTIC DFC_DisblMsk2.DFC_ACCmprFltLvl4_C "" VALUE 0x80248E9E Val_Wu16 65535.00 DFES_OneToOne 0.00 65535.00 FORMAT "%8.2" /end CHARACTERISTIC
/begin CHARACTERISTIC DFC_DisblMsk2.DFC_ACCmprHiPFlt_C "" VALUE 0x80248EA0 Val_Wu16 65535.00 DFES_OneToOne 0.00 65535.00 FORMAT "%8.2" /end CHARACTERISTIC
/begin CHARACTERISTIC DFC_DisblMsk2.DFC_ACCmprInvldCmprSt_C "" VALUE 0x80248EA2 Val_Wu16 65535.00 DFES_OneToOne 0.00 65535.00 FORMAT "%8.2" /end CHARACTERISTIC
/begin CHARACTERISTIC DFC_DisblMsk2.DFC_ACCmprInvldElecActPwr_C "" VALUE 0x80248EA4 Val_Wu16 65535.00 DFES_OneToOne 0.00 65535.00 FORMAT "%8.2" /end CHARACTERISTIC
/begin CHARACTERISTIC DFC_DisblMsk2.DFC_ACCmprLoPFlt_C "" VALUE 0x80248EA6 Val_Wu16 65535.00 DFES_OneToOne 0.00 65535.00 FORMAT "%8.2" /end CHARACTERISTIC
/begin CHARACTERISTIC DFC_DisblMsk2.DFC_AppAllSnsrDfct_C "" VALUE 0x80249080 Val_Wu16 65535.00 DFES_OneToOne 0.00 65535.00 FORMAT "%8.2" /end CHARACTERISTIC
/begin CHARACTERISTIC DFC_DisblMsk2.DFC_SRCHighAPP1_C "" VALUE 0x80249224 Val_Wu16 65535.00 DFES_OneToOne 0.00 65535.00 FORMAT "%8.2" /end CHARACTERISTIC
/begin CHARACTERISTIC DFC_DisblMsk2.DFC_SRCHighAPP2_C "" VALUE 0x80249226 Val_Wu16 65535.00 DFES_OneToOne 0.00 65535.00 FORMAT "%8.2" /end CHARACTERISTIC
/begin CHARACTERISTIC DFC_DisblMsk2.DFC_SRCLowAPP1_C "" VALUE 0x80249228 Val_Wu16 65535.00 DFES_OneToOne 0.00 65535.00 FORMAT "%8.2" /end CHARACTERISTIC
/begin CHARACTERISTIC DFC_DisblMsk2.DFC_SRCLowAPP2_C "" VALUE 0x8024922A Val_Wu16 65535.00 DFES_OneToOne 0.00 65535.00 FORMAT "%8.2" /end CHARACTERISTIC
/begin CHARACTERISTIC DFC_DisblMsk2.DFC_SyncAPP_C "" VALUE 0x8024923C Val_Wu16 65535.00 DFES_OneToOne 0.00 65535.00 FORMAT "%8.2" /end CHARACTERISTIC
/begin MEASUREMENT ACCmpr_flgPwrLimActv "AC Compressor Active power limit flag" UBYTE B_TRUE 1 100 0.00 1.00000000000 BIT_MASK 0x1 FORMAT "%13.11" ECU_ADDRESS 0x700001E6
 /begin IF_DATA XCPplus 0x0102
  /begin DAQ_EVENT VARIABLE /end DAQ_EVENT
 /end IF_DATA
/end MEASUREMENT
/begin MEASUREMENT ACCmpr_flgPwrLo "AC Compressor Low power flag" UBYTE B_TRUE 1 100 0.00 1.00000000000 BIT_MASK 0x1 FORMAT "%13.11" ECU_ADDRESS 0x700001E5
 /begin IF_DATA XCPplus 0x0102
  /begin DAQ_EVENT VARIABLE /end DAQ_EVENT
 /end IF_DATA
/end MEASUREMENT
/begin MEASUREMENT ACCmpr_flgSocPwrSaveActv "Flag to indicate SOC power saving active" UBYTE B_TRUE 1 100 0.00 1.00000000000 BIT_MASK 0x1 FORMAT "%13.11" ECU_ADDRESS 0x700001E4
 /begin IF_DATA XCPplus 0x0102
  /begin DAQ_EVENT VARIABLE /end DAQ_EVENT
 /end IF_DATA
/end MEASUREMENT
/begin MEASUREMENT ACCmpr_iConsol "AC compressor current" SWORD RBPtCel_i_0p03125_1 1 100 -1024.000 1023.969 FORMAT "%8.3" ECU_ADDRESS 0x6001FC90
 /begin IF_DATA XCPplus 0x0102
  /begin DAQ_EVENT VARIABLE /end DAQ_EVENT
 /end IF_DATA
/end MEASUREMENT
/begin MEASUREMENT ACCmpr_nCoolgSaveModDes "Maximum compressor speed based on mode during normal cooling" UWORD q1_DIV_min 1 100 0.00 65535.00 FORMAT "%8.2" ECU_ADDRESS 0x6001F686
 /begin IF_DATA XCPplus 0x0102
  /begin DAQ_EVENT VARIABLE /end DAQ_EVENT
 /end IF_DATA
/end MEASUREMENT
/begin MEASUREMENT ACCmpr_nDefogSaveModDes "Maximum compressor speed based on mode during defog heating" UWORD q1_DIV_min 1 100 0.00 65535.00 FORMAT "%8.2" ECU_ADDRESS 0x6001F684
 /begin IF_DATA XCPplus 0x0102
  /begin DAQ_EVENT VARIABLE /end DAQ_EVENT
 /end IF_DATA
/end MEASUREMENT
/begin MEASUREMENT ACCmpr_nLimMax "maximum compressor speed due to component demands" UWORD q1_DIV_min 1 100 0.00 65535.00 FORMAT "%8.2" ECU_ADDRESS 0x6001FA48
 /begin IF_DATA XCPplus 0x0102
  /begin DAQ_EVENT VARIABLE /end DAQ_EVENT
 /end IF_DATA
/end MEASUREMENT
/begin MEASUREMENT ACCmpr_nModLimMax "Maximum compressor speed based on mode" UWORD q1_DIV_min 1 100 0.00 65535.00 FORMAT "%8.2" ECU_ADDRESS 0x6001F682
 /begin IF_DATA XCPplus 0x0102
  /begin DAQ_EVENT VARIABLE /end DAQ_EVENT
 /end IF_DATA
/end MEASUREMENT
/begin MEASUREMENT ACCmpr_nVehVLimMax "Maximum compressor speed based on vehicle speed" UWORD q1_DIV_min 1 100 0.00 65535.00 FORMAT "%8.2" ECU_ADDRESS 0x6001F680
 /begin IF_DATA XCPplus 0x0102
  /begin DAQ_EVENT VARIABLE /end DAQ_EVENT
 /end IF_DATA
/end MEASUREMENT
/begin MEASUREMENT ACCmpr_pwrCmprLimd "AC Compressor Power limited value" SWORD RBPtCel_pwr_25p0_1 1 100 -819200.0 819175.0 FORMAT "%8.1" ECU_ADDRESS 0x6001F67E
 /begin IF_DATA XCPplus 0x0102
  /begin DAQ_EVENT VARIABLE /end DAQ_EVENT
 /end IF_DATA
/end MEASUREMENT
/begin MEASUREMENT ACCmpr_pwrConsol "actual AC consumed compressor power" SWORD RBPtCel_pwr_25p0_1 1 100 -819200.0 819175.0 FORMAT "%8.1" ECU_ADDRESS 0x6001FC8E
 /begin IF_DATA XCPplus 0x0102
  /begin DAQ_EVENT VARIABLE /end DAQ_EVENT
 /end IF_DATA
/end MEASUREMENT
/begin MEASUREMENT ACCmpr_pwrLimMax "maximum compressor power due to component demands" SWORD q20_W_1 1 100 -655360.0 655340.0 FORMAT "%8.1" ECU_ADDRESS 0x6001FC8C
 /begin IF_DATA XCPplus 0x0102
  /begin DAQ_EVENT VARIABLE /end DAQ_EVENT
 /end IF_DATA
/end MEASUREMENT
/begin MEASUREMENT ACCmpr_pwrLimMaxDes "maximum desired compressor power due to component demands" SWORD RBPtCel_pwr_25p0_1 1 100 -819200.0 819175.0 FORMAT "%8.1" ECU_ADDRESS 0x6001F67C
 /begin IF_DATA XCPplus 0x0102
  /begin DAQ_EVENT VARIABLE /end DAQ_EVENT
 /end IF_DATA
/end MEASUREMENT
/begin MEASUREMENT ACCmpr_stEem "internal HV state of AC compressor" UBYTE q1 1 100 0.00 255.0 FORMAT "%5.1" ECU_ADDRESS 0x60023696
 /begin IF_DATA XCPplus 0x0102
  /begin DAQ_EVENT VARIABLE /end DAQ_EVENT
 /end IF_DATA
/end MEASUREMENT
/begin MEASUREMENT ACCmpr_stElecCmprOverT "AC compressor over temperature status" UBYTE q1 1 100 0.00 255.0 FORMAT "%5.1" ECU_ADDRESS 0x60023695
 /begin IF_DATA XCPplus 0x0102
  /begin DAQ_EVENT VARIABLE /end DAQ_EVENT
 /end IF_DATA
/end MEASUREMENT
/begin MEASUREMENT ACCmpr_stHiPFlt "Flag indicating high pressure fault" UBYTE B_TRUE 1 100 0.00 1.00000000000 BIT_MASK 0x1 FORMAT "%13.11" ECU_ADDRESS 0x700001E0
 /begin IF_DATA XCPplus 0x0102
  /begin DAQ_EVENT VARIABLE /end DAQ_EVENT
 /end IF_DATA
/end MEASUREMENT
/begin MEASUREMENT ACCmpr_stLim "status bar of AC compressor limitation" UWORD q1 1 100 0.00 65535.00 FORMAT "%8.2" ECU_ADDRESS 0x6001FA46
 /begin IF_DATA XCPplus 0x0102
  /begin DAQ_EVENT VARIABLE /end DAQ_EVENT
 /end IF_DATA
/end MEASUREMENT
/begin MEASUREMENT ACCmpr_stLoPFlt "Flag indicating low pressure fault" UBYTE B_TRUE 1 100 0.00 1.00000000000 BIT_MASK 0x1 FORMAT "%13.11" ECU_ADDRESS 0x700001DF
 /begin IF_DATA XCPplus 0x0102
  /begin DAQ_EVENT VARIABLE /end DAQ_EVENT
 /end IF_DATA
/end MEASUREMENT
/begin MEASUREMENT ACCmpr_stPwrLim "AC Compressor power limit state" UBYTE q1 1 100 0.00 255.0 FORMAT "%5.1" ECU_ADDRESS 0x6002322B
 /begin IF_DATA XCPplus 0x0102
  /begin DAQ_EVENT VARIABLE /end DAQ_EVENT
 /end IF_DATA
/end MEASUREMENT
/begin MEASUREMENT ACCmpr_tiStLim "AC compressor power limit state timer" SWORD RBPtCel_ti_0p01_1 1 100 -327.6800 327.6700 FORMAT "%8.4" ECU_ADDRESS 0x6001F67A
 /begin IF_DATA XCPplus 0x0102
  /begin DAQ_EVENT VARIABLE /end DAQ_EVENT
 /end IF_DATA
/end MEASUREMENT
/begin MEASUREMENT ACCmpr_uConsol "AC compressor voltage" SWORD RBPtCel_u_0p03125_1 1 100 -1024.000 1023.969 FORMAT "%8.3" ECU_ADDRESS 0x6001FC8A
 /begin IF_DATA XCPplus 0x0102
  /begin DAQ_EVENT VARIABLE /end DAQ_EVENT
 /end IF_DATA
/end MEASUREMENT
/begin MEASUREMENT ACComp_pDe "compressor pressure deviation" SWORD PresAC_hPa 1 100 -65536.00 65534.00 FORMAT "%8.2" ECU_ADDRESS 0x6001FA12
 /begin IF_DATA XCPplus 0x0102
  /begin DAQ_EVENT VARIABLE /end DAQ_EVENT
 /end IF_DATA
/end MEASUREMENT
/begin MEASUREMENT AccPedEv_aRecupOnePedlDrvg "Possible deceleration torque" SWORD Acc 1 100 -32.76800 32.76700 FORMAT "%8.5" ECU_ADDRESS 0x6001F678
 /begin IF_DATA XCPplus 0x0102
  /begin DAQ_EVENT VARIABLE /end DAQ_EVENT
 /end IF_DATA
/end MEASUREMENT
/begin MEASUREMENT AccPedEv_aRecupOnePedlDrvgTmp "Possible deceleration by one pedal driving temporary value" SWORD Acc 1 100 -32.76800 32.76700 FORMAT "%8.5" ECU_ADDRESS 0x6001F676
 /begin IF_DATA XCPplus 0x0102
  /begin DAQ_EVENT VARIABLE /end DAQ_EVENT
 /end IF_DATA
/end MEASUREMENT
/begin MEASUREMENT AccPedEv_facDif "Muliplication factor step per calculation step" UWORD Fact1000 1 100 0.00 1.000000 FORMAT "%8.6" ECU_ADDRESS 0x6001F674
 /begin IF_DATA XCPplus 0x0102
  /begin DAQ_EVENT VARIABLE /end DAQ_EVENT
 /end IF_DATA
/end MEASUREMENT
/begin MEASUREMENT AccPedEv_facTranMap "Blendingfactor between the acceleration pedal maps at mode change" SWORD Fact1000 1 100 0.00 1.000000 FORMAT "%8.6" ECU_ADDRESS 0x6001F672
 /begin IF_DATA XCPplus 0x0102
  /begin DAQ_EVENT VARIABLE /end DAQ_EVENT
 /end IF_DATA
/end MEASUREMENT
/begin MEASUREMENT AccPedEv_stDrvModActv "Drive program switch activ status" UBYTE OneToOne 1 100 0.00 255.0 FORMAT "%5.1" ECU_ADDRESS 0x6002368F
 /begin IF_DATA XCPplus 0x0102
  /begin DAQ_EVENT VARIABLE /end DAQ_EVENT
 /end IF_DATA
/end MEASUREMENT
/begin MEASUREMENT AccPedEv_stDrvModReq "Requested drive mode" UBYTE OneToOne 1 100 0.00 255.0 FORMAT "%5.1" ECU_ADDRESS 0x6002322A
 /begin IF_DATA XCPplus 0x0102
  /begin DAQ_EVENT VARIABLE /end DAQ_EVENT
 /end IF_DATA
/end MEASUREMENT
/begin MEASUREMENT AccPedEv_tqDifMod "torque differenz between the requested and actual drive mode" SWORD TrqPrp 1 100 -52428.80 52427.20 FORMAT "%8.2" ECU_ADDRESS 0x6001F670
 /begin IF_DATA XCPplus 0x0102
  /begin DAQ_EVENT VARIABLE /end DAQ_EVENT
 /end IF_DATA
/end MEASUREMENT
/begin MEASUREMENT AccPedEv_tqPrp "Propulsion torque derived based on drive mode position, accelerator pedal request and vehicle speed." SLONG TrqPrpHigh 1 100 -214748364.800 214748364.700 FORMAT "%13.3" ECU_ADDRESS 0x60000FCC
 /begin IF_DATA XCPplus 0x0102
  /begin DAQ_EVENT VARIABLE /end DAQ_EVENT
 /end IF_DATA
/end MEASUREMENT
/begin MEASUREMENT AccPedEv_tqRecupFacOnePedlDrvg "Unlimited one-pedal recuperation torque" SLONG TrqPrpHigh 1 100 -214748364.800 214748364.700 FORMAT "%13.3" ECU_ADDRESS 0x60000C4C
 /begin IF_DATA XCPplus 0x0102
  /begin DAQ_EVENT VARIABLE /end DAQ_EVENT
 /end IF_DATA
/end MEASUREMENT
/begin MEASUREMENT AccPedEv_tqRecupFacOnePedlDrvgLim "Final one-pedal recuperation torque" SLONG TrqPrpHigh 1 100 -214748364.800 214748364.700 FORMAT "%13.3" ECU_ADDRESS 0x60000C48
 /begin IF_DATA XCPplus 0x0102
  /begin DAQ_EVENT VARIABLE /end DAQ_EVENT
 /end IF_DATA
/end MEASUREMENT
/begin MEASUREMENT AccPedEv_tqRecupFacOnePedlLim "Ramped one-pedal recuperation torque" SLONG TrqPrpHigh 1 100 -214748364.800 214748364.700 FORMAT "%13.3" ECU_ADDRESS 0x60000FC8
 /begin IF_DATA XCPplus 0x0102
  /begin DAQ_EVENT VARIABLE /end DAQ_EVENT
 /end IF_DATA
/end MEASUREMENT
/begin MEASUREMENT AccPedEv_tqRecupOnePedlDrvg "Recuperation torque derived based on vehicle speed and drive modes." SLONG TrqPrpHigh 1 100 -214748364.800 214748364.700 FORMAT "%13.3" ECU_ADDRESS 0x60000FC4
 /begin IF_DATA XCPplus 0x0102
  /begin DAQ_EVENT VARIABLE /end DAQ_EVENT
 /end IF_DATA
/end MEASUREMENT
/begin MEASUREMENT AccPedEv_tqRecupOnePedlRamp "Ramped but unlimited one-pedal recuperation torque" SLONG TrqPrpHigh 1 100 -214748364.800 214748364.700 FORMAT "%13.3" ECU_ADDRESS 0x60000C44
 /begin IF_DATA XCPplus 0x0102
  /begin DAQ_EVENT VARIABLE /end DAQ_EVENT
 /end IF_DATA
/end MEASUREMENT
/begin MEASUREMENT AccPedEv_tqWhlDes "Desired wheel torque" SLONG TrqPrpHigh 1 100 -214748364.800 214748364.700 FORMAT "%13.3" ECU_ADDRESS 0x60000FC0
 /begin IF_DATA XCPplus 0x0102
  /begin DAQ_EVENT VARIABLE /end DAQ_EVENT
 /end IF_DATA
/end MEASUREMENT
/begin MEASUREMENT AccPedEv_vRvs "Sign swaped velecity for reverse gear pedal map" SWORD Vel 1 100 -327.6800 327.6700 FORMAT "%8.4" ECU_ADDRESS 0x6001F66E
 /begin IF_DATA XCPplus 0x0102
  /begin DAQ_EVENT VARIABLE /end DAQ_EVENT
 /end IF_DATA
/end MEASUREMENT
/begin MEASUREMENT AccPed_drAppGrdtOld "Old value of the gradient of deviation from the accelerator pedal" SWORD PrcPerSec 1 100 -20000.00 19999.39 FORMAT "%8.2" ECU_ADDRESS 0x6001F66C
 /begin IF_DATA XCPplus 0x0102
  /begin DAQ_EVENT VARIABLE /end DAQ_EVENT
 /end IF_DATA
/end MEASUREMENT
/begin MEASUREMENT AccPed_facRecupAppGrdt "Factor of recuperation from the gradient of deviation on accelerator pedal position" SWORD Fact 1 100 -4.000000 3.999878 FORMAT "%8.6" ECU_ADDRESS 0x6001FC50
 /begin IF_DATA XCPplus 0x0102
  /begin DAQ_EVENT VARIABLE /end DAQ_EVENT
 /end IF_DATA
/end MEASUREMENT
/begin MEASUREMENT AccPed_facRecupBas "Base value of recuperation factor" SWORD Fact 1 100 -4.000000 3.999878 FORMAT "%8.6" ECU_ADDRESS 0x6001FC4E
 /begin IF_DATA XCPplus 0x0102
  /begin DAQ_EVENT VARIABLE /end DAQ_EVENT
 /end IF_DATA
/end MEASUREMENT
/begin MEASUREMENT AccPed_facRecupOnePedlDrvg "Factor of recuperation on one pedal driving" SWORD Fact 1 100 -4.000000 3.999878 FORMAT "%8.6" ECU_ADDRESS 0x6001FC4C
 /begin IF_DATA XCPplus 0x0102
  /begin DAQ_EVENT VARIABLE /end DAQ_EVENT
 /end IF_DATA
/end MEASUREMENT
/begin MEASUREMENT AccPed_flgPrpnActv "propulsion active status" UBYTE B_TRUE 1 100 0.00 1.00000000000 BIT_MASK 0x1 FORMAT "%13.11" ECU_ADDRESS 0x600234EA
 /begin IF_DATA XCPplus 0x0102
  /begin DAQ_EVENT VARIABLE /end DAQ_EVENT
 /end IF_DATA
/end MEASUREMENT
/begin MEASUREMENT AccPed_rCoastGap "Applicable coasting gap" SWORD Prc 1 100 -400.0000 399.9878 FORMAT "%8.4" ECU_ADDRESS 0x6001FC4A
 /begin IF_DATA XCPplus 0x0102
  /begin DAQ_EVENT VARIABLE /end DAQ_EVENT
 /end IF_DATA
/end MEASUREMENT
/begin MEASUREMENT AccPed_rCoastGapUnlim "Unlimited Applicable coasting gap" SWORD Prc 1 100 -400.0000 399.9878 FORMAT "%8.4" ECU_ADDRESS 0x6001F66A
 /begin IF_DATA XCPplus 0x0102
  /begin DAQ_EVENT VARIABLE /end DAQ_EVENT
 /end IF_DATA
/end MEASUREMENT
/begin MEASUREMENT AccPed_rPrpOnePedlDrvg "Ratio of the propulsion torque on one pedal driving" SWORD Prc 1 100 -400.0000 399.9878 FORMAT "%8.4" ECU_ADDRESS 0x6001FC48
 /begin IF_DATA XCPplus 0x0102
  /begin DAQ_EVENT VARIABLE /end DAQ_EVENT
 /end IF_DATA
/end MEASUREMENT
/begin MEASUREMENT AccPed_rRecupOnePedlDrvgStrt "Starting point of recuperation on one pedal driving" SWORD Prc 1 100 -400.0000 399.9878 FORMAT "%8.4" ECU_ADDRESS 0x6001FC46
 /begin IF_DATA XCPplus 0x0102
  /begin DAQ_EVENT VARIABLE /end DAQ_EVENT
 /end IF_DATA
/end MEASUREMENT
/begin MEASUREMENT AccPed_rVirtZrPnt "Ratio of the virtual zero point" SWORD Prc 1 100 -400.0000 399.9878 FORMAT "%8.4" ECU_ADDRESS 0x6001FC44
 /begin IF_DATA XCPplus 0x0102
  /begin DAQ_EVENT VARIABLE /end DAQ_EVENT
 /end IF_DATA
/end MEASUREMENT
/begin MEASUREMENT AccPed_rVirtZrPntUnlim "Unlimited ratio of the virtual zero point" SWORD Prc 1 100 -400.0000 399.9878 FORMAT "%8.4" ECU_ADDRESS 0x6001F668
 /begin IF_DATA XCPplus 0x0102
  /begin DAQ_EVENT VARIABLE /end DAQ_EVENT
 /end IF_DATA
/end MEASUREMENT
/begin MEASUREMENT AccPed_vSignCnvn "Conversion of signed vehicle speed" SWORD Vel 1 100 -327.6800 327.6700 FORMAT "%8.4" ECU_ADDRESS 0x6001F666
 /begin IF_DATA XCPplus 0x0102
  /begin DAQ_EVENT VARIABLE /end DAQ_EVENT
 /end IF_DATA
/end MEASUREMENT
/begin MEASUREMENT ACCtl_facCmprLoad "relative loading of compressor" UBYTE RBPtCel_fac_3p921568em3_1 1 100 0.00 1.000 FORMAT "%5.3" ECU_ADDRESS 0x6002346E
 /begin IF_DATA XCPplus 0x0102
  /begin DAQ_EVENT VARIABLE /end DAQ_EVENT
 /end IF_DATA
/end MEASUREMENT
/begin MEASUREMENT ACCtl_flgAbvMinSpd "Condition if requested compressor speed is more than minimum threshold" UBYTE B_TRUE 1 100 0.00 1.00000000000 BIT_MASK 0x1 FORMAT "%13.11" ECU_ADDRESS 0x700001DD
 /begin IF_DATA XCPplus 0x0102
  /begin DAQ_EVENT VARIABLE /end DAQ_EVENT
 /end IF_DATA
/end MEASUREMENT
/begin MEASUREMENT ACCtl_nCmprReq "AC compressor speed request" UWORD q1_DIV_min 1 100 0.00 65535.00 FORMAT "%8.2" ECU_ADDRESS 0x6001F9BE
 /begin IF_DATA XCPplus 0x0102
  /begin DAQ_EVENT VARIABLE /end DAQ_EVENT
 /end IF_DATA
/end MEASUREMENT
/begin MEASUREMENT ACCtl_nCtrlr "AC compressor speed value of controler" SWORD q1_DIV_min 1 100 -32768.00 32767.00 FORMAT "%8.2" ECU_ADDRESS 0x6001F664
 /begin IF_DATA XCPplus 0x0102
  /begin DAQ_EVENT VARIABLE /end DAQ_EVENT
 /end IF_DATA
/end MEASUREMENT
/begin MEASUREMENT ACCtl_nDes "desired compressor spsed" SWORD q1_DIV_min 1 100 -32768.00 32767.00 FORMAT "%8.2" ECU_ADDRESS 0x6001F662
 /begin IF_DATA XCPplus 0x0102
  /begin DAQ_EVENT VARIABLE /end DAQ_EVENT
 /end IF_DATA
/end MEASUREMENT
/begin MEASUREMENT ACCtl_nLimSpdMax "maximum speed limitation" SWORD q1_DIV_min 1 100 -32768.00 32767.00 FORMAT "%8.2" ECU_ADDRESS 0x6001F660
 /begin IF_DATA XCPplus 0x0102
  /begin DAQ_EVENT VARIABLE /end DAQ_EVENT
 /end IF_DATA
/end MEASUREMENT
/begin MEASUREMENT ACCtl_nLimSpdMaxRaw "Raw value of maximum allowable compressor speed" SWORD q1_DIV_min 1 100 -32768.00 32767.00 FORMAT "%8.2" ECU_ADDRESS 0x6001F65E
 /begin IF_DATA XCPplus 0x0102
  /begin DAQ_EVENT VARIABLE /end DAQ_EVENT
 /end IF_DATA
/end MEASUREMENT
/begin MEASUREMENT ACCtl_nPreCtrlFild "Filtered pre-control compressor speed" SWORD q1_DIV_min 1 100 -32768.00 32767.00 FORMAT "%8.2" ECU_ADDRESS 0x6001F65C
 /begin IF_DATA XCPplus 0x0102
  /begin DAQ_EVENT VARIABLE /end DAQ_EVENT
 /end IF_DATA
/end MEASUREMENT
/begin MEASUREMENT ACCtl_nPreCtrlr "AC compressor speed value of pre controler" SWORD q1_DIV_min 1 100 -32768.00 32767.00 FORMAT "%8.2" ECU_ADDRESS 0x6001F65A
 /begin IF_DATA XCPplus 0x0102
  /begin DAQ_EVENT VARIABLE /end DAQ_EVENT
 /end IF_DATA
/end MEASUREMENT
/begin MEASUREMENT ACCtl_pCmprDsFld "Compressor downstream pressure" SWORD PresAC_hPa 1 100 -65536.00 65534.00 FORMAT "%8.2" ECU_ADDRESS 0x6001F658
 /begin IF_DATA XCPplus 0x0102
  /begin DAQ_EVENT VARIABLE /end DAQ_EVENT
 /end IF_DATA
/end MEASUREMENT
/begin MEASUREMENT ACCtl_pCtrlIntegd "intgrated compressor pressure deviation" SLONG RBPtCel_p_1p525em5_1 1 100 -32768.0000000 32767.9999847 FORMAT "%13.7" ECU_ADDRESS 0x60000C40
 /begin IF_DATA XCPplus 0x0102
  /begin DAQ_EVENT VARIABLE /end DAQ_EVENT
 /end IF_DATA
/end MEASUREMENT
/begin MEASUREMENT ACCtl_pMaxCtrlIntegd "Max I-controller pressure limit" SLONG RBPtCel_p_1p525em5_1 1 100 -32768.0000000 32767.9999847 FORMAT "%13.7" ECU_ADDRESS 0x60000C3C
 /begin IF_DATA XCPplus 0x0102
  /begin DAQ_EVENT VARIABLE /end DAQ_EVENT
 /end IF_DATA
/end MEASUREMENT
/begin MEASUREMENT ACCtl_pMinCtrlIntegd "Min I-controller pressure limit" SLONG RBPtCel_p_1p525em5_1 1 100 -32768.0000000 32767.9999847 FORMAT "%13.7" ECU_ADDRESS 0x60000C38
 /begin IF_DATA XCPplus 0x0102
  /begin DAQ_EVENT VARIABLE /end DAQ_EVENT
 /end IF_DATA
/end MEASUREMENT
/begin MEASUREMENT ACCtl_pwrChillrReqEem "power request of AC compressor for chiller path to EEM" SWORD RBPtCel_pwr_25p0_1 1 100 -819200.0 819175.0 FORMAT "%8.1" ECU_ADDRESS 0x6001FA10
 /begin IF_DATA XCPplus 0x0102
  /begin DAQ_EVENT VARIABLE /end DAQ_EVENT
 /end IF_DATA
/end MEASUREMENT
/begin MEASUREMENT ACCtl_pwrHvacFrntReqEem "power request of AC compressor for fron HVAC path to EEM" SWORD RBPtCel_pwr_25p0_1 1 100 -819200.0 819175.0 FORMAT "%8.1" ECU_ADDRESS 0x6001FA0E /end MEASUREMENT
/begin MEASUREMENT ACCtl_stAcCtrlr "status of AC controller" UBYTE q1 1 100 0.00 255.0 FORMAT "%5.1" ECU_ADDRESS 0x6002346C
 /begin IF_DATA XCPplus 0x0102
  /begin DAQ_EVENT VARIABLE /end DAQ_EVENT
 /end IF_DATA
/end MEASUREMENT
/begin MEASUREMENT ACCtl_tiAcCtrlr "state timer for current AC controller mode" UWORD q0p1_s 1 100 0.00 6553.500 FORMAT "%8.3" ECU_ADDRESS 0x6001F656
 /begin IF_DATA XCPplus 0x0102
  /begin DAQ_EVENT VARIABLE /end DAQ_EVENT
 /end IF_DATA
/end MEASUREMENT
/begin MEASUREMENT AcExtChrgrCtrl_StMac.cntrCritErr "Generic AC charging control / Counter for Critical Errors" UBYTE OneToOne 1 100 0.00 255.0 FORMAT "%5.1" ECU_ADDRESS 0x6001F63C
 /begin IF_DATA XCPplus 0x0102
  /begin DAQ_EVENT VARIABLE /end DAQ_EVENT
 /end IF_DATA
/end MEASUREMENT
/begin MEASUREMENT AcExtChrgrCtrl_StMac.cntrMnrErr "Generic AC charging control / Counter of occured recoverable errors" UBYTE OneToOne 1 100 0.00 255.0 FORMAT "%5.1" ECU_ADDRESS 0x6001F63D
 /begin IF_DATA XCPplus 0x0102
  /begin DAQ_EVENT VARIABLE /end DAQ_EVENT
 /end IF_DATA
/end MEASUREMENT
/begin MEASUREMENT AcExtChrgrCtrl_StMac.cntrTry "Generic AC charging control / Actual number of charging tries" UBYTE OneToOne 1 100 0.00 255.0 FORMAT "%5.1" ECU_ADDRESS 0x6001F63E
 /begin IF_DATA XCPplus 0x0102
  /begin DAQ_EVENT VARIABLE /end DAQ_EVENT
 /end IF_DATA
/end MEASUREMENT
/begin MEASUREMENT AcExtChrgrCtrl_StMac.flgChrgnRdy "Generic AC charging control / EV readiness" UBYTE B_TRUE 1 100 0.00 1.00000000000 BIT_MASK 0x1 FORMAT "%13.11" ECU_ADDRESS 0x6001F63F
 /begin IF_DATA XCPplus 0x0102
  /begin DAQ_EVENT VARIABLE /end DAQ_EVENT
 /end IF_DATA
/end MEASUREMENT
/begin MEASUREMENT AcExtChrgrCtrl_StMac.flgChrgnRetry "Generic AC charging control / Charging resume request" UBYTE B_TRUE 1 100 0.00 1.00000000000 BIT_MASK 0x1 FORMAT "%13.11" ECU_ADDRESS 0x6001F640
 /begin IF_DATA XCPplus 0x0102
  /begin DAQ_EVENT VARIABLE /end DAQ_EVENT
 /end IF_DATA
/end MEASUREMENT
/begin MEASUREMENT AcExtChrgrCtrl_StMac.iChrgnReq "Generic AC charging control / Requested charging current" SWORD RBPtCel_i_0p03125_1 1 100 -1024.000 1023.969 FORMAT "%8.3" ECU_ADDRESS 0x6001F642
 /begin IF_DATA XCPplus 0x0102
  /begin DAQ_EVENT VARIABLE /end DAQ_EVENT
 /end IF_DATA
/end MEASUREMENT
/begin MEASUREMENT AcExtChrgrCtrl_StMac.sm "Generic AC charging control / Current state of charging sequence control" UBYTE AcExtChrgrCtrl_StMac_sm_VERB 1 100 0.00 13.0000000000 FORMAT "%13.10" ECU_ADDRESS 0x6001F644
 /begin IF_DATA XCPplus 0x0102
  /begin DAQ_EVENT VARIABLE /end DAQ_EVENT
 /end IF_DATA
/end MEASUREMENT
/begin MEASUREMENT AcExtChrgrCtrl_StMac.stChrgn "Generic AC charging control / Charging sequence state" UBYTE ChrgCtrl_stChrgn_VERB 1 100 0.00 6.00000000000 FORMAT "%13.11" ECU_ADDRESS 0x6001F645
 /begin IF_DATA XCPplus 0x0102
  /begin DAQ_EVENT VARIABLE /end DAQ_EVENT
 /end IF_DATA
/end MEASUREMENT
/begin MEASUREMENT AcExtChrgrCtrl_StMac.stChrgnReq "Generic AC charging control / Requested charging sequence state" UBYTE ChrgCtrl_stChrgn_VERB 1 100 0.00 6.00000000000 FORMAT "%13.11" ECU_ADDRESS 0x6001F646
 /begin IF_DATA XCPplus 0x0102
  /begin DAQ_EVENT VARIABLE /end DAQ_EVENT
 /end IF_DATA
/end MEASUREMENT
/begin MEASUREMENT AcExtChrgrCtrl_StMac.tiGpt "Generic AC charging control / General purpose timer" UWORD RBPtCel_ti_0p01_1 1 100 0.00 655.3500 FORMAT "%8.4" ECU_ADDRESS 0x6001F648
 /begin IF_DATA XCPplus 0x0102
  /begin DAQ_EVENT VARIABLE /end DAQ_EVENT
 /end IF_DATA
/end MEASUREMENT
/begin MEASUREMENT AcExtChrgrCtrl_StMac.uChrgnReq "Generic AC charging control / Requested charging voltage" SWORD RBPtCel_u_0p1_1 1 100 -3276.800 3276.700 FORMAT "%8.3" ECU_ADDRESS 0x6001F64A
 /begin IF_DATA XCPplus 0x0102
  /begin DAQ_EVENT VARIABLE /end DAQ_EVENT
 /end IF_DATA
/end MEASUREMENT
/begin MEASUREMENT AcExtChrgr_flgChrgnRdy "Charging readiness of EV" UBYTE B_TRUE 1 100 0.00 1.00000000000 BIT_MASK 0x1 FORMAT "%13.11" ECU_ADDRESS 0x600234EC
 /begin IF_DATA XCPplus 0x0102
  /begin DAQ_EVENT VARIABLE /end DAQ_EVENT
 /end IF_DATA
/end MEASUREMENT
/begin MEASUREMENT AcExtChrgr_flgChrgnRetry "New charging try" UBYTE B_TRUE 1 100 0.00 1.00000000000 BIT_MASK 0x1 FORMAT "%13.11" ECU_ADDRESS 0x600234EB
 /begin IF_DATA XCPplus 0x0102
  /begin DAQ_EVENT VARIABLE /end DAQ_EVENT
 /end IF_DATA
/end MEASUREMENT
/begin MEASUREMENT AcExtChrgr_flgChrgnStopReq "Charging stop request" UBYTE B_TRUE 1 100 0.00 1.00000000000 BIT_MASK 0x1 FORMAT "%13.11" ECU_ADDRESS 0x60023229
 /begin IF_DATA XCPplus 0x0102
  /begin DAQ_EVENT VARIABLE /end DAQ_EVENT
 /end IF_DATA
/end MEASUREMENT
/begin MEASUREMENT AcExtChrgr_flgChrgnStopReqLoI "Charging stop request in case of low charging current" UBYTE B_TRUE 1 100 0.00 1.00000000000 BIT_MASK 0x1 FORMAT "%13.11" ECU_ADDRESS 0x60023228
 /begin IF_DATA XCPplus 0x0102
  /begin DAQ_EVENT VARIABLE /end DAQ_EVENT
 /end IF_DATA
/end MEASUREMENT
/begin MEASUREMENT AcExtChrgr_flgChrgnStrtReq "Charging start request" UBYTE B_TRUE 1 100 0.00 1.00000000000 BIT_MASK 0x1 FORMAT "%13.11" ECU_ADDRESS 0x60023227
 /begin IF_DATA XCPplus 0x0102
  /begin DAQ_EVENT VARIABLE /end DAQ_EVENT
 /end IF_DATA
/end MEASUREMENT
/begin MEASUREMENT AcExtChrgr_flgCritErr "Critical error" UBYTE B_TRUE 1 100 0.00 1.00000000000 BIT_MASK 0x1 FORMAT "%13.11" ECU_ADDRESS 0x60023226
 /begin IF_DATA XCPplus 0x0102
  /begin DAQ_EVENT VARIABLE /end DAQ_EVENT
 /end IF_DATA
/end MEASUREMENT
/begin MEASUREMENT AcExtChrgr_flgDiagErr "Error detected by diagnosis" UBYTE B_TRUE 1 100 0.00 1.00000000000 BIT_MASK 0x1 FORMAT "%13.11" ECU_ADDRESS 0x60023225
 /begin IF_DATA XCPplus 0x0102
  /begin DAQ_EVENT VARIABLE /end DAQ_EVENT
 /end IF_DATA
/end MEASUREMENT
/begin MEASUREMENT AcExtChrgr_flgMnrErr "Minor error" UBYTE B_TRUE 1 100 0.00 1.00000000000 BIT_MASK 0x1 FORMAT "%13.11" ECU_ADDRESS 0x60023224
 /begin IF_DATA XCPplus 0x0102
  /begin DAQ_EVENT VARIABLE /end DAQ_EVENT
 /end IF_DATA
/end MEASUREMENT
/begin MEASUREMENT AcExtChrgr_flgSigQlyErr "Signal quality error present" UBYTE B_TRUE 1 100 0.00 1.00000000000 BIT_MASK 0x1 FORMAT "%13.11" ECU_ADDRESS 0x60023223
 /begin IF_DATA XCPplus 0x0102
  /begin DAQ_EVENT VARIABLE /end DAQ_EVENT
 /end IF_DATA
/end MEASUREMENT
/begin MEASUREMENT AcExtChrgr_iAuxUnitLoad "Additional current demand by auxiliary loads" SWORD RBPtCel_i_0p03125_1 1 100 -1024.000 1023.969 FORMAT "%8.3" ECU_ADDRESS 0x6001F654
 /begin IF_DATA XCPplus 0x0102
  /begin DAQ_EVENT VARIABLE /end DAQ_EVENT
 /end IF_DATA
/end MEASUREMENT
/begin MEASUREMENT AcExtChrgr_iChrgnCalc "Calculated charging current" SWORD RBPtCel_i_0p03125_1 1 100 -1024.000 1023.969 FORMAT "%8.3" ECU_ADDRESS 0x6001F652
 /begin IF_DATA XCPplus 0x0102
  /begin DAQ_EVENT VARIABLE /end DAQ_EVENT
 /end IF_DATA
/end MEASUREMENT
/begin MEASUREMENT AcExtChrgr_iChrgnLimMax "Actual DC charging current maximum" SWORD RBPtCel_i_0p03125_1 1 100 -1024.000 1023.969 FORMAT "%8.3" ECU_ADDRESS 0x6001F650
 /begin IF_DATA XCPplus 0x0102
  /begin DAQ_EVENT VARIABLE /end DAQ_EVENT
 /end IF_DATA
/end MEASUREMENT
/begin MEASUREMENT AcExtChrgr_iChrgnLimMaxAc "Actual AC charging current maximum" SWORD RBPtCel_i_0p03125_1 1 100 -1024.000 1023.969 FORMAT "%8.3" ECU_ADDRESS 0x6001FC5E
 /begin IF_DATA XCPplus 0x0102
  /begin DAQ_EVENT VARIABLE /end DAQ_EVENT
 /end IF_DATA
/end MEASUREMENT
/begin MEASUREMENT AcExtChrgr_iChrgnLimMaxCnv "Actual DC charging current maximum converted from actual AC charging current maximum" SWORD RBPtCel_i_0p03125_1 1 100 -1024.000 1023.969 FORMAT "%8.3" ECU_ADDRESS 0x6001F64E
 /begin IF_DATA XCPplus 0x0102
  /begin DAQ_EVENT VARIABLE /end DAQ_EVENT
 /end IF_DATA
/end MEASUREMENT
/begin MEASUREMENT AcExtChrgr_iChrgnMaxAvl "Available charging current maximum" SWORD RBPtCel_i_0p03125_1 1 100 -1024.000 1023.969 FORMAT "%8.3" ECU_ADDRESS 0x6001FC5C
 /begin IF_DATA XCPplus 0x0102
  /begin DAQ_EVENT VARIABLE /end DAQ_EVENT
 /end IF_DATA
/end MEASUREMENT
/begin MEASUREMENT AcExtChrgr_iChrgnReq "Requested DC charging current" SWORD RBPtCel_i_0p03125_1 1 100 -1024.000 1023.969 FORMAT "%8.3" ECU_ADDRESS 0x6001FC5A
 /begin IF_DATA XCPplus 0x0102
  /begin DAQ_EVENT VARIABLE /end DAQ_EVENT
 /end IF_DATA
/end MEASUREMENT
/begin MEASUREMENT AcExtChrgr_pwrChrgnOut "Actual charging power" SWORD RBPtCel_pwr_25p0_1 1 100 -819200.0 819175.0 FORMAT "%8.1" ECU_ADDRESS 0x6001FC58
 /begin IF_DATA XCPplus 0x0102
  /begin DAQ_EVENT VARIABLE /end DAQ_EVENT
 /end IF_DATA
/end MEASUREMENT
/begin MEASUREMENT AcExtChrgr_pwrChrgrIn "Maximum input power of OBC" SWORD RBPtCel_pwr_10p0_1 1 100 -327680.0 327670.0 FORMAT "%8.1" ECU_ADDRESS 0x6001FC56
 /begin IF_DATA XCPplus 0x0102
  /begin DAQ_EVENT VARIABLE /end DAQ_EVENT
 /end IF_DATA
/end MEASUREMENT
/begin MEASUREMENT AcExtChrgr_ratSocChrgnStop "Target charging SOC" SWORD Prc 1 100 -400.0000 399.9878 FORMAT "%8.4" ECU_ADDRESS 0x6001FC54
 /begin IF_DATA XCPplus 0x0102
  /begin DAQ_EVENT VARIABLE /end DAQ_EVENT
 /end IF_DATA
/end MEASUREMENT
/begin MEASUREMENT AcExtChrgr_stChrgn "Charge control state" UBYTE ChrgCtrl_stChrgn_VERB 1 100 0.00 6.00000000000 FORMAT "%13.11" ECU_ADDRESS 0x60023691
 /begin IF_DATA XCPplus 0x0102
  /begin DAQ_EVENT VARIABLE /end DAQ_EVENT
 /end IF_DATA
/end MEASUREMENT
/begin MEASUREMENT AcExtChrgr_stChrgnReq "Requested state to charging components" UBYTE ChrgCtrl_stChrgn_VERB 1 100 0.00 6.00000000000 FORMAT "%13.11" ECU_ADDRESS 0x60023690
 /begin IF_DATA XCPplus 0x0102
  /begin DAQ_EVENT VARIABLE /end DAQ_EVENT
 /end IF_DATA
/end MEASUREMENT
/begin MEASUREMENT AcExtChrgr_uChrgnCalc "Calculated charging voltage" SWORD RBPtCel_u_0p1_1 1 100 -3276.800 3276.700 FORMAT "%8.3" ECU_ADDRESS 0x6001F64C
 /begin IF_DATA XCPplus 0x0102
  /begin DAQ_EVENT VARIABLE /end DAQ_EVENT
 /end IF_DATA
/end MEASUREMENT
/begin MEASUREMENT AcExtChrgr_uChrgnReq "Requested DC charging voltage" SWORD RBPtCel_u_0p1_1 1 100 -3276.800 3276.700 FORMAT "%8.3" ECU_ADDRESS 0x6001FC52
 /begin IF_DATA XCPplus 0x0102
  /begin DAQ_EVENT VARIABLE /end DAQ_EVENT
 /end IF_DATA
/end MEASUREMENT
/begin MEASUREMENT AC_pClntHld "Air condition pressure hold" SWORD PresAC_hPa 1 100 -65536.00 65534.00 FORMAT "%8.2" ECU_ADDRESS 0x6001F63A
 /begin IF_DATA XCPplus 0x0102
  /begin DAQ_EVENT VARIABLE /end DAQ_EVENT
 /end IF_DATA
/end MEASUREMENT
/begin MEASUREMENT AC_pHld "Air condition pressure hold" SWORD PresAC_hPa 1 100 -65536.00 65534.00 FORMAT "%8.2" ECU_ADDRESS 0x6001F638
 /begin IF_DATA XCPplus 0x0102
  /begin DAQ_EVENT VARIABLE /end DAQ_EVENT
 /end IF_DATA
/end MEASUREMENT
/begin MEASUREMENT AC_rClgACOff "Fan demand when the AC is Off (e.g. AC shut off conditions are active)" SWORD Prc 1 100 -400.0000 399.9878 FORMAT "%8.4" ECU_ADDRESS 0x6001F636
 /begin IF_DATA XCPplus 0x0102
  /begin DAQ_EVENT VARIABLE /end DAQ_EVENT
 /end IF_DATA
/end MEASUREMENT
/begin MEASUREMENT AC_rClgACOn "Fan demand when the AC is On (normal mode)" SWORD Prc 1 100 -400.0000 399.9878 FORMAT "%8.4" ECU_ADDRESS 0x6001F634
 /begin IF_DATA XCPplus 0x0102
  /begin DAQ_EVENT VARIABLE /end DAQ_EVENT
 /end IF_DATA
/end MEASUREMENT
/begin MEASUREMENT AC_rClgDem "Relative AC cooling demand" SWORD Prc 1 100 -400.0000 399.9878 FORMAT "%8.4" ECU_ADDRESS 0x6001FA0C
 /begin IF_DATA XCPplus 0x0102
  /begin DAQ_EVENT VARIABLE /end DAQ_EVENT
 /end IF_DATA
/end MEASUREMENT
/begin MEASUREMENT Aibg_stMnrCanDly "Airbag ECU delayed CAN Minor Signal Status" UBYTE B_TRUE 1 100 0.00 1.00000000000 BIT_MASK 0x1 FORMAT "%13.11" ECU_ADDRESS 0x6002321D
 /begin IF_DATA XCPplus 0x0102
  /begin DAQ_EVENT VARIABLE /end DAQ_EVENT
 /end IF_DATA
/end MEASUREMENT
/begin MEASUREMENT Airbg_ctPwmPerd "AIrbag PWM pulse count" ULONG OneToOne 1 100 0.00 4294967295.00 FORMAT "%13.2" ECU_ADDRESS 0x60000C1C
 /begin IF_DATA XCPplus 0x0102
  /begin DAQ_EVENT VARIABLE /end DAQ_EVENT
 /end IF_DATA
/end MEASUREMENT
/begin MEASUREMENT Airbg_flgDycCrashDeploy "Airbag is deployed" UBYTE B_TRUE 1 100 0.00 1.00000000000 BIT_MASK 0x1 FORMAT "%13.11" ECU_ADDRESS 0x60023222
 /begin IF_DATA XCPplus 0x0102
  /begin DAQ_EVENT VARIABLE /end DAQ_EVENT
 /end IF_DATA
/end MEASUREMENT
/begin MEASUREMENT Airbg_flgDycCrashNotOk "Airbag deployment signa is not within the deployment range or non deployment range" UBYTE B_TRUE 1 100 0.00 1.00000000000 BIT_MASK 0x1 FORMAT "%13.11" ECU_ADDRESS 0x60023221
 /begin IF_DATA XCPplus 0x0102
  /begin DAQ_EVENT VARIABLE /end DAQ_EVENT
 /end IF_DATA
/end MEASUREMENT
/begin MEASUREMENT Airbg_flgDycCrashOk "Airbag is not deployed" UBYTE B_TRUE 1 100 0.00 1.00000000000 BIT_MASK 0x1 FORMAT "%13.11" ECU_ADDRESS 0x60023220
 /begin IF_DATA XCPplus 0x0102
  /begin DAQ_EVENT VARIABLE /end DAQ_EVENT
 /end IF_DATA
/end MEASUREMENT
/begin MEASUREMENT Airbg_flgEepWriteLstFCO "flag to enable eep write" UBYTE B_TRUE 1 100 0.00 1.00000000000 BIT_MASK 0x1 FORMAT "%13.11" ECU_ADDRESS 0x6002321C
 /begin IF_DATA XCPplus 0x0102
  /begin DAQ_EVENT VARIABLE /end DAQ_EVENT
 /end IF_DATA
/end MEASUREMENT
/begin MEASUREMENT Airbg_flgFCO "FuelCutOff active" UBYTE B_TRUE 1 100 0.00 1.00000000000 BIT_MASK 0x1 FORMAT "%13.11" ECU_ADDRESS 0x6002321B
 /begin IF_DATA XCPplus 0x0102
  /begin DAQ_EVENT VARIABLE /end DAQ_EVENT
 /end IF_DATA
/end MEASUREMENT
/begin MEASUREMENT Airbg_flgLstDrvgCycFCO "Variable to Read and write the last driving cycle status of airbg" UBYTE B_TRUE 1 100 0.00 1.00000000000 BIT_MASK 0x1 FORMAT "%13.11" ECU_ADDRESS 0x6002321A
 /begin IF_DATA XCPplus 0x0102
  /begin DAQ_EVENT VARIABLE /end DAQ_EVENT
 /end IF_DATA
/end MEASUREMENT
/begin MEASUREMENT Airbg_rDftPwmInpRat "Default duty cycle of PWM signal input from ACU." ULONG rel_q0p01 1 100 0.00 42949672.9500 FORMAT "%13.4" ECU_ADDRESS 0x60000C2C
 /begin IF_DATA XCPplus 0x0102
  /begin DAQ_EVENT VARIABLE /end DAQ_EVENT
 /end IF_DATA
/end MEASUREMENT
/begin MEASUREMENT Airbg_rPwmInpRat "Duty cycle of PWM signal input from ACU" ULONG rel_q0p01 1 100 0.00 42949672.9500 FORMAT "%13.4" ECU_ADDRESS 0x60000C18
 /begin IF_DATA XCPplus 0x0102
  /begin DAQ_EVENT VARIABLE /end DAQ_EVENT
 /end IF_DATA
/end MEASUREMENT
/begin MEASUREMENT Airbg_rPwmInpRatPrevVld "Last valid PWM Duty cycle" ULONG rel_q0p01 1 100 0.00 42949672.9500 FORMAT "%13.4" ECU_ADDRESS 0x60000C28
 /begin IF_DATA XCPplus 0x0102
  /begin DAQ_EVENT VARIABLE /end DAQ_EVENT
 /end IF_DATA
/end MEASUREMENT
/begin MEASUREMENT Airbg_st "Status of Air bag explosion received on CAN." UBYTE OneToOne 1 100 0.00 255.0 FORMAT "%5.1" ECU_ADDRESS 0x6002368D
 /begin IF_DATA XCPplus 0x0102
  /begin DAQ_EVENT VARIABLE /end DAQ_EVENT
 /end IF_DATA
/end MEASUREMENT
/begin MEASUREMENT Airbg_stCanDly "Airbag ECU delayed CAN Signal Status" UBYTE B_TRUE 1 100 0.00 1.00000000000 BIT_MASK 0x1 FORMAT "%13.11" ECU_ADDRESS 0x60023219
 /begin IF_DATA XCPplus 0x0102
  /begin DAQ_EVENT VARIABLE /end DAQ_EVENT
 /end IF_DATA
/end MEASUREMENT
/begin MEASUREMENT Airbg_stCrash "AIRBAG deployment status in case of CRASH detected" UBYTE OneToOne 1 100 0.00 255.0 FORMAT "%5.1" ECU_ADDRESS 0x6002368C
 /begin IF_DATA XCPplus 0x0102
  /begin DAQ_EVENT VARIABLE /end DAQ_EVENT
 /end IF_DATA
/end MEASUREMENT
/begin MEASUREMENT Airbg_stCrashAVS "Status of CRASH deployment for AVS" UWORD OneToOne 1 100 0.00 65535.00 FORMAT "%8.2" ECU_ADDRESS 0x6001F632
 /begin IF_DATA XCPplus 0x0102
  /begin DAQ_EVENT VARIABLE /end DAQ_EVENT
 /end IF_DATA
/end MEASUREMENT
/begin MEASUREMENT Airbg_stCrashInfo "Airbag ECU Crash info Signal status" UBYTE OneToOne 1 100 0.00 255.0 FORMAT "%5.1" ECU_ADDRESS 0x6002368B
 /begin IF_DATA XCPplus 0x0102
  /begin DAQ_EVENT VARIABLE /end DAQ_EVENT
 /end IF_DATA
/end MEASUREMENT
/begin MEASUREMENT Airbg_stDlyPWMCalc "State representing that the PWM can be considered after initial T15 delay" UBYTE B_TRUE 1 100 0.00 1.00000000000 BIT_MASK 0x1 FORMAT "%13.11" ECU_ADDRESS 0x6002321F
 /begin IF_DATA XCPplus 0x0102
  /begin DAQ_EVENT VARIABLE /end DAQ_EVENT
 /end IF_DATA
/end MEASUREMENT
/begin MEASUREMENT Airbg_stDlyT15TOn "Terminal 15 On delay state for Air bag deployment" UBYTE B_TRUE 1 100 0.00 1.00000000000 BIT_MASK 0x1 FORMAT "%13.11" ECU_ADDRESS 0x60023218
 /begin IF_DATA XCPplus 0x0102
  /begin DAQ_EVENT VARIABLE /end DAQ_EVENT
 /end IF_DATA
/end MEASUREMENT
/begin MEASUREMENT Airbg_stEepOrderLstFCO "Image of the EEPROM state" UBYTE OneToOne 1 100 0.00 255.0 FORMAT "%5.1" ECU_ADDRESS 0x60023217 /end MEASUREMENT
/begin MEASUREMENT Airbg_stEepWriteLstFCO "EEP write status" UBYTE OneToOne 1 100 0.00 255.0 FORMAT "%5.1" ECU_ADDRESS 0x60023216
 /begin IF_DATA XCPplus 0x0102
  /begin DAQ_EVENT VARIABLE /end DAQ_EVENT
 /end IF_DATA
/end MEASUREMENT
/begin MEASUREMENT Airbg_stMoCrash "Crash status update for Monitoring package" UBYTE OneToOne 1 100 0.00 255.0 FORMAT "%5.1" ECU_ADDRESS 0x60023215
 /begin IF_DATA XCPplus 0x0102
  /begin DAQ_EVENT VARIABLE /end DAQ_EVENT
 /end IF_DATA
/end MEASUREMENT
/begin MEASUREMENT Airbg_stPwm "aIrbag deployment status from PWM input signal" UBYTE B_TRUE 1 100 0.00 1.00000000000 BIT_MASK 0x1 FORMAT "%13.11" ECU_ADDRESS 0x600234E7
 /begin IF_DATA XCPplus 0x0102
  /begin DAQ_EVENT VARIABLE /end DAQ_EVENT
 /end IF_DATA
/end MEASUREMENT
/begin MEASUREMENT Airbg_stPWMCrashDeploy "Variable to update the state of CRASH deployment once received from hardware PWM" UBYTE B_TRUE 1 100 0.00 1.00000000000 BIT_MASK 0x1 FORMAT "%13.11" ECU_ADDRESS 0x60023214
 /begin IF_DATA XCPplus 0x0102
  /begin DAQ_EVENT VARIABLE /end DAQ_EVENT
 /end IF_DATA
/end MEASUREMENT
/begin MEASUREMENT Airbg_stPwmInpSig "status of PWM PIN state" UBYTE OneToOne 1 100 0.00 255.0 FORMAT "%5.1" ECU_ADDRESS 0x6002368A
 /begin IF_DATA XCPplus 0x0102
  /begin DAQ_EVENT VARIABLE /end DAQ_EVENT
 /end IF_DATA
/end MEASUREMENT
/begin MEASUREMENT Airbg_tiDftPwmInpHiOnDurn "Default on time of PWM input signal from ACU" ULONG Time_PwmHigh 1 100 0.00 214748364.750 FORMAT "%13.3" ECU_ADDRESS 0x60000C24
 /begin IF_DATA XCPplus 0x0102
  /begin DAQ_EVENT VARIABLE /end DAQ_EVENT
 /end IF_DATA
/end MEASUREMENT
/begin MEASUREMENT Airbg_tiPwmInpHiOnDurn "ON time Duration of PWM signal from ACU" ULONG Time_PwmHigh 1 100 0.00 214748364.750 FORMAT "%13.3" ECU_ADDRESS 0x60000C14
 /begin IF_DATA XCPplus 0x0102
  /begin DAQ_EVENT VARIABLE /end DAQ_EVENT
 /end IF_DATA
/end MEASUREMENT
/begin MEASUREMENT Airbg_tiPwmInpPerd "Time period of PWM input signal from Airbag control unt" ULONG Time_PwmHigh 1 100 0.00 214748364.750 FORMAT "%13.3" ECU_ADDRESS 0x60000C10
 /begin IF_DATA XCPplus 0x0102
  /begin DAQ_EVENT VARIABLE /end DAQ_EVENT
 /end IF_DATA
/end MEASUREMENT
/begin MEASUREMENT Airbg_tiPwmInpPerdPrevVld "Last vaild time period of PWM input signal from Airbag control unit" ULONG Time_PwmHigh 1 100 0.00 214748364.750 FORMAT "%13.3" ECU_ADDRESS 0x60000C20
 /begin IF_DATA XCPplus 0x0102
  /begin DAQ_EVENT VARIABLE /end DAQ_EVENT
 /end IF_DATA
/end MEASUREMENT
/begin MEASUREMENT APP_bAlive "Status alive detection of the acceleration pedal" UBYTE B_TRUE 1 100 0.00 1.00000000000 BIT_MASK 0x1 FORMAT "%13.11" ECU_ADDRESS 0x60023213
 /begin IF_DATA XCPplus 0x0102
  /begin DAQ_EVENT VARIABLE /end DAQ_EVENT
 /end IF_DATA
/end MEASUREMENT
/begin MEASUREMENT APP_bAPP1FinalDef "Status Sensor 1 of the acceleration pedal finally defect" UBYTE B_TRUE 1 100 0.00 1.00000000000 BIT_MASK 0x1 FORMAT "%13.11" ECU_ADDRESS 0x60023212
 /begin IF_DATA XCPplus 0x0102
  /begin DAQ_EVENT VARIABLE /end DAQ_EVENT
 /end IF_DATA
/end MEASUREMENT
/begin MEASUREMENT APP_bAPP1ProvDef "Status Sensor 1 of the acceleration pedal temporary defect" UBYTE B_TRUE 1 100 0.00 1.00000000000 BIT_MASK 0x1 FORMAT "%13.11" ECU_ADDRESS 0x60023211
 /begin IF_DATA XCPplus 0x0102
  /begin DAQ_EVENT VARIABLE /end DAQ_EVENT
 /end IF_DATA
/end MEASUREMENT
/begin MEASUREMENT APP_bAPP2FinalDef "Status Sensor 2 of the acceleration pedal finally defect" UBYTE B_TRUE 1 100 0.00 1.00000000000 BIT_MASK 0x1 FORMAT "%13.11" ECU_ADDRESS 0x60023210
 /begin IF_DATA XCPplus 0x0102
  /begin DAQ_EVENT VARIABLE /end DAQ_EVENT
 /end IF_DATA
/end MEASUREMENT
/begin MEASUREMENT APP_bAPP2ProvDef "Status Sensor 2 of the acceleration pedal temporary defect" UBYTE B_TRUE 1 100 0.00 1.00000000000 BIT_MASK 0x1 FORMAT "%13.11" ECU_ADDRESS 0x6002320F
 /begin IF_DATA XCPplus 0x0102
  /begin DAQ_EVENT VARIABLE /end DAQ_EVENT
 /end IF_DATA
/end MEASUREMENT
/begin MEASUREMENT APP_bBrkActv "Status brake" UBYTE B_TRUE 1 100 0.00 1.00000000000 BIT_MASK 0x1 FORMAT "%13.11" ECU_ADDRESS 0x6002320A
 /begin IF_DATA XCPplus 0x0102
  /begin DAQ_EVENT VARIABLE /end DAQ_EVENT
 /end IF_DATA
/end MEASUREMENT
/begin MEASUREMENT APP_bKDInfo "Status Kickdown" UBYTE B_TRUE 1 100 0.00 1.00000000000 BIT_MASK 0x1 FORMAT "%13.11" ECU_ADDRESS 0x6002320E
 /begin IF_DATA XCPplus 0x0102
  /begin DAQ_EVENT VARIABLE /end DAQ_EVENT
 /end IF_DATA
/end MEASUREMENT
/begin MEASUREMENT APP_bPlaBrk "Status acceleration pedal brake plausibility" UBYTE B_TRUE 1 100 0.00 1.00000000000 BIT_MASK 0x1 FORMAT "%13.11" ECU_ADDRESS 0x600234F5
 /begin IF_DATA XCPplus 0x0102
  /begin DAQ_EVENT VARIABLE /end DAQ_EVENT
 /end IF_DATA
/end MEASUREMENT
/begin MEASUREMENT APP_bSRCHigh1 "Status temporary SRC-High error Sensor 1" UBYTE B_TRUE 1 100 0.00 1.00000000000 BIT_MASK 0x1 FORMAT "%13.11" ECU_ADDRESS 0x600234F4
 /begin IF_DATA XCPplus 0x0102
  /begin DAQ_EVENT VARIABLE /end DAQ_EVENT
 /end IF_DATA
/end MEASUREMENT
/begin MEASUREMENT APP_bSRCHigh1Deb "Status debounced SRC-High error Sensor 1" UBYTE B_TRUE 1 100 0.00 1.00000000000 BIT_MASK 0x1 FORMAT "%13.11" ECU_ADDRESS 0x600234F3
 /begin IF_DATA XCPplus 0x0102
  /begin DAQ_EVENT VARIABLE /end DAQ_EVENT
 /end IF_DATA
/end MEASUREMENT
/begin MEASUREMENT APP_bSRCHigh2 "Status temporary SRC-High error Sensor 2" UBYTE B_TRUE 1 100 0.00 1.00000000000 BIT_MASK 0x1 FORMAT "%13.11" ECU_ADDRESS 0x600234F2
 /begin IF_DATA XCPplus 0x0102
  /begin DAQ_EVENT VARIABLE /end DAQ_EVENT
 /end IF_DATA
/end MEASUREMENT
/begin MEASUREMENT APP_bSRCHigh2Deb "Status debounced SRC-High error Sensor 2" UBYTE B_TRUE 1 100 0.00 1.00000000000 BIT_MASK 0x1 FORMAT "%13.11" ECU_ADDRESS 0x600234F1
 /begin IF_DATA XCPplus 0x0102
  /begin DAQ_EVENT VARIABLE /end DAQ_EVENT
 /end IF_DATA
/end MEASUREMENT
/begin MEASUREMENT APP_bSRCLow1 "Status temporary SRC-Low error Sensor 1" UBYTE B_TRUE 1 100 0.00 1.00000000000 BIT_MASK 0x1 FORMAT "%13.11" ECU_ADDRESS 0x600234F0
 /begin IF_DATA XCPplus 0x0102
  /begin DAQ_EVENT VARIABLE /end DAQ_EVENT
 /end IF_DATA
/end MEASUREMENT
/begin MEASUREMENT APP_bSRCLow1Deb "Status debounced SRC-Low error Sensor 1" UBYTE B_TRUE 1 100 0.00 1.00000000000 BIT_MASK 0x1 FORMAT "%13.11" ECU_ADDRESS 0x600234EF
 /begin IF_DATA XCPplus 0x0102
  /begin DAQ_EVENT VARIABLE /end DAQ_EVENT
 /end IF_DATA
/end MEASUREMENT
/begin MEASUREMENT APP_bSRCLow2 "Status temporary SRC-Low error Sensor 2" UBYTE B_TRUE 1 100 0.00 1.00000000000 BIT_MASK 0x1 FORMAT "%13.11" ECU_ADDRESS 0x600234EE
 /begin IF_DATA XCPplus 0x0102
  /begin DAQ_EVENT VARIABLE /end DAQ_EVENT
 /end IF_DATA
/end MEASUREMENT
/begin MEASUREMENT APP_bSRCLow2Deb "Status debounced SRC-Low error Sensor 2" UBYTE B_TRUE 1 100 0.00 1.00000000000 BIT_MASK 0x1 FORMAT "%13.11" ECU_ADDRESS 0x600234ED
 /begin IF_DATA XCPplus 0x0102
  /begin DAQ_EVENT VARIABLE /end DAQ_EVENT
 /end IF_DATA
/end MEASUREMENT
/begin MEASUREMENT APP_bSync "Status temporary sync check" UBYTE B_TRUE 1 100 0.00 1.00000000000 BIT_MASK 0x1 FORMAT "%13.11" ECU_ADDRESS 0x6002320C
 /begin IF_DATA XCPplus 0x0102
  /begin DAQ_EVENT VARIABLE /end DAQ_EVENT
 /end IF_DATA
/end MEASUREMENT
/begin MEASUREMENT APP_bSyncChkOld "Status previous temporary sync check" UBYTE B_TRUE 1 100 0.00 1.00000000000 BIT_MASK 0x1 FORMAT "%13.11" ECU_ADDRESS 0x6002320D
 /begin IF_DATA XCPplus 0x0102
  /begin DAQ_EVENT VARIABLE /end DAQ_EVENT
 /end IF_DATA
/end MEASUREMENT
/begin MEASUREMENT APP_bSyncDeb "Status debounced sync check" UBYTE B_TRUE 1 100 0.00 1.00000000000 BIT_MASK 0x1 FORMAT "%13.11" ECU_ADDRESS 0x6002320B
 /begin IF_DATA XCPplus 0x0102
  /begin DAQ_EVENT VARIABLE /end DAQ_EVENT
 /end IF_DATA
/end MEASUREMENT
/begin MEASUREMENT APP_bT15Deb "Status T15 debounced with maximum debounce time" UBYTE B_TRUE 1 100 0.00 1.00000000000 BIT_MASK 0x1 FORMAT "%13.11" ECU_ADDRESS 0x60023201
 /begin IF_DATA XCPplus 0x0102
  /begin DAQ_EVENT VARIABLE /end DAQ_EVENT
 /end IF_DATA
/end MEASUREMENT
/begin MEASUREMENT APP_bTempErr "Status temporary error" UBYTE B_TRUE 1 100 0.00 1.00000000000 BIT_MASK 0x1 FORMAT "%13.11" ECU_ADDRESS 0x60023202
 /begin IF_DATA XCPplus 0x0102
  /begin DAQ_EVENT VARIABLE /end DAQ_EVENT
 /end IF_DATA
/end MEASUREMENT
/begin MEASUREMENT APP_dr "The deviation of accelerator pedal position at every 80ms" SWORD PrcPerSec 1 100 -20000.00 19999.39 FORMAT "%8.2" ECU_ADDRESS 0x6001FC88
 /begin IF_DATA XCPplus 0x0102
  /begin DAQ_EVENT VARIABLE /end DAQ_EVENT
 /end IF_DATA
/end MEASUREMENT
/begin MEASUREMENT APP_drUnFlt "Acceleration pedal position gradient of unfilterd value" SWORD PrcPerSec 1 100 -20000.00 19999.39 FORMAT "%8.2" ECU_ADDRESS 0x6001FC86
 /begin IF_DATA XCPplus 0x0102
  /begin DAQ_EVENT VARIABLE /end DAQ_EVENT
 /end IF_DATA
/end MEASUREMENT
/begin MEASUREMENT APP_flgBrkPlausyRst "Flag for reset of gas-brake plausibility check" UBYTE B_TRUE 1 100 0.00 1.00000000000 BIT_MASK 0x1 FORMAT "%13.11" ECU_ADDRESS 0x60023209
 /begin IF_DATA XCPplus 0x0102
  /begin DAQ_EVENT VARIABLE /end DAQ_EVENT
 /end IF_DATA
/end MEASUREMENT
/begin MEASUREMENT APP_flgHiGrdt "True: Gradient of acceleration pedal above threshold" UBYTE B_TRUE 1 100 0.00 1.00000000000 BIT_MASK 0x1 FORMAT "%13.11" ECU_ADDRESS 0x70000263
 /begin IF_DATA XCPplus 0x0102
  /begin DAQ_EVENT VARIABLE /end DAQ_EVENT
 /end IF_DATA
/end MEASUREMENT
/begin MEASUREMENT APP_flgIdlPosn "Flag for detection of APP low idle position" UBYTE B_TRUE 1 100 0.00 1.00000000000 BIT_MASK 0x1 FORMAT "%13.11" ECU_ADDRESS 0x60023208
 /begin IF_DATA XCPplus 0x0102
  /begin DAQ_EVENT VARIABLE /end DAQ_EVENT
 /end IF_DATA
/end MEASUREMENT
/begin MEASUREMENT APP_flgNoExtIntv "Flag for detection of no external interventions for the gas-brake plausibility check" UBYTE B_TRUE 1 100 0.00 1.00000000000 BIT_MASK 0x1 FORMAT "%13.11" ECU_ADDRESS 0x60023207
 /begin IF_DATA XCPplus 0x0102
  /begin DAQ_EVENT VARIABLE /end DAQ_EVENT
 /end IF_DATA
/end MEASUREMENT
/begin MEASUREMENT APP_flgPanicReactn "Flag for detection of a possible panic reaction for Reset of gas-brake plausibility check" UBYTE B_TRUE 1 100 0.00 1.00000000000 BIT_MASK 0x1 FORMAT "%13.11" ECU_ADDRESS 0x60023206
 /begin IF_DATA XCPplus 0x0102
  /begin DAQ_EVENT VARIABLE /end DAQ_EVENT
 /end IF_DATA
/end MEASUREMENT
/begin MEASUREMENT APP_flgPlausyBrkEnaCdn "Enable condition for the gas-brake plausibility check" UBYTE B_TRUE 1 100 0.00 1.00000000000 BIT_MASK 0x1 FORMAT "%13.11" ECU_ADDRESS 0x60023205
 /begin IF_DATA XCPplus 0x0102
  /begin DAQ_EVENT VARIABLE /end DAQ_EVENT
 /end IF_DATA
/end MEASUREMENT
/begin MEASUREMENT APP_flgPlausyBrkFinal "Flag for indication of final brake switch implausibility" UBYTE B_TRUE 1 100 0.00 1.00000000000 BIT_MASK 0x1 FORMAT "%13.11" ECU_ADDRESS 0x60023204
 /begin IF_DATA XCPplus 0x0102
  /begin DAQ_EVENT VARIABLE /end DAQ_EVENT
 /end IF_DATA
/end MEASUREMENT
/begin MEASUREMENT APP_flgPlausyBrkFltCdn "Fault condition for the gas-brake plausibility check" UBYTE B_TRUE 1 100 0.00 1.00000000000 BIT_MASK 0x1 FORMAT "%13.11" ECU_ADDRESS 0x60023203
 /begin IF_DATA XCPplus 0x0102
  /begin DAQ_EVENT VARIABLE /end DAQ_EVENT
 /end IF_DATA
/end MEASUREMENT
/begin MEASUREMENT APP_r "Standardized accelerator pedal position" SWORD Prc 1 100 -400.0000 399.9878 FORMAT "%8.4" ECU_ADDRESS 0x6001FC84
 /begin IF_DATA XCPplus 0x0102
  /begin DAQ_EVENT VARIABLE /end DAQ_EVENT
 /end IF_DATA
/end MEASUREMENT
/begin MEASUREMENT APP_rChk "APP value checked for brake plausibility and living signal" SWORD Prc 1 100 -400.0000 399.9878 FORMAT "%8.4" ECU_ADDRESS 0x6001F630
 /begin IF_DATA XCPplus 0x0102
  /begin DAQ_EVENT VARIABLE /end DAQ_EVENT
 /end IF_DATA
/end MEASUREMENT
/begin MEASUREMENT APP_rFlt "Acceleration pedal position filtered value" SWORD Prc 1 100 -400.0000 399.9878 FORMAT "%8.4" ECU_ADDRESS 0x6001F62C
 /begin IF_DATA XCPplus 0x0102
  /begin DAQ_EVENT VARIABLE /end DAQ_EVENT
 /end IF_DATA
/end MEASUREMENT
/begin MEASUREMENT APP_rLinRmp "acceleration pedal ratio by the switch between the two sets of linearisation parameters" SWORD Prc 1 100 -400.0000 399.9878 FORMAT "%8.4" ECU_ADDRESS 0x6001F620
 /begin IF_DATA XCPplus 0x0102
  /begin DAQ_EVENT VARIABLE /end DAQ_EVENT
 /end IF_DATA
/end MEASUREMENT
/begin MEASUREMENT APP_rOBDPID5A "Acceleration pedal OBD signal PID 5A" SWORD Prc 1 100 -400.0000 399.9878 FORMAT "%8.4" ECU_ADDRESS 0x6001F614
 /begin IF_DATA XCPplus 0x0102
  /begin DAQ_EVENT VARIABLE /end DAQ_EVENT
 /end IF_DATA
/end MEASUREMENT
/begin MEASUREMENT APP_rUnFlt "Unfiltered APP value" SWORD Prc 1 100 -400.0000 399.9878 FORMAT "%8.4" ECU_ADDRESS 0x6001FC82
 /begin IF_DATA XCPplus 0x0102
  /begin DAQ_EVENT VARIABLE /end DAQ_EVENT
 /end IF_DATA
/end MEASUREMENT
/begin MEASUREMENT APP_rUnLim "acceleration pedal ratio by the acceleration brake plausibility in normal and limp mode" SWORD Prc 1 100 -400.0000 399.9878 FORMAT "%8.4" ECU_ADDRESS 0x6001F62E
 /begin IF_DATA XCPplus 0x0102
  /begin DAQ_EVENT VARIABLE /end DAQ_EVENT
 /end IF_DATA
/end MEASUREMENT
/begin MEASUREMENT APP_stKD "State of accelerator pedal kick down" UBYTE dez 1 100 0.00 255.0 FORMAT "%5.1" ECU_ADDRESS 0x60023693
 /begin IF_DATA XCPplus 0x0102
  /begin DAQ_EVENT VARIABLE /end DAQ_EVENT
 /end IF_DATA
/end MEASUREMENT
/begin MEASUREMENT APP_stSigSrc "Status of accelerator pedal" UBYTE OneToOne 1 100 0.00 255.0 FORMAT "%5.1" ECU_ADDRESS 0x60023692
 /begin IF_DATA XCPplus 0x0102
  /begin DAQ_EVENT VARIABLE /end DAQ_EVENT
 /end IF_DATA
/end MEASUREMENT
/begin MEASUREMENT APP_tiSRCHigh1DebDef "Duration of defect debouncing for check DFC_SRCHighAPP1" SWORD Time_ms 1 100 -327680.0 327670.0 FORMAT "%8.1" ECU_ADDRESS 0x6001FC80
 /begin IF_DATA XCPplus 0x0102
  /begin DAQ_EVENT VARIABLE /end DAQ_EVENT
 /end IF_DATA
/end MEASUREMENT
/begin MEASUREMENT APP_tiSRCHigh1DebOk "Duration of healing debouncing for check DFC_SRCHighAPP1" SWORD Time_ms 1 100 -327680.0 327670.0 FORMAT "%8.1" ECU_ADDRESS 0x6001FC7E
 /begin IF_DATA XCPplus 0x0102
  /begin DAQ_EVENT VARIABLE /end DAQ_EVENT
 /end IF_DATA
/end MEASUREMENT
/begin MEASUREMENT APP_tiSRCHigh2DebDef "Duration of defect debouncing for check DFC_SRCHighAPP2" SWORD Time_ms 1 100 -327680.0 327670.0 FORMAT "%8.1" ECU_ADDRESS 0x6001FC7C
 /begin IF_DATA XCPplus 0x0102
  /begin DAQ_EVENT VARIABLE /end DAQ_EVENT
 /end IF_DATA
/end MEASUREMENT
/begin MEASUREMENT APP_tiSRCHigh2DebOk "Duration of healing debouncing for check DFC_SRCHighAPP2" SWORD Time_ms 1 100 -327680.0 327670.0 FORMAT "%8.1" ECU_ADDRESS 0x6001FC7A
 /begin IF_DATA XCPplus 0x0102
  /begin DAQ_EVENT VARIABLE /end DAQ_EVENT
 /end IF_DATA
/end MEASUREMENT
/begin MEASUREMENT APP_tiSRCLow1DebDef "Duration of defect debouncing for check DFC_SRCLowAPP1" SWORD Time_ms 1 100 -327680.0 327670.0 FORMAT "%8.1" ECU_ADDRESS 0x6001FC78
 /begin IF_DATA XCPplus 0x0102
  /begin DAQ_EVENT VARIABLE /end DAQ_EVENT
 /end IF_DATA
/end MEASUREMENT
/begin MEASUREMENT APP_tiSRCLow1DebOk "Duration of healing debouncing for check DFC_SRCLowAPP1" SWORD Time_ms 1 100 -327680.0 327670.0 FORMAT "%8.1" ECU_ADDRESS 0x6001FC76
 /begin IF_DATA XCPplus 0x0102
  /begin DAQ_EVENT VARIABLE /end DAQ_EVENT
 /end IF_DATA
/end MEASUREMENT
/begin MEASUREMENT APP_tiSRCLow2DebDef "Duration of defect debouncing for check DFC_SRCLowAPP2" SWORD Time_ms 1 100 -327680.0 327670.0 FORMAT "%8.1" ECU_ADDRESS 0x6001FC74
 /begin IF_DATA XCPplus 0x0102
  /begin DAQ_EVENT VARIABLE /end DAQ_EVENT
 /end IF_DATA
/end MEASUREMENT
/begin MEASUREMENT APP_tiSRCLow2DebOk "Duration of healing debouncing for check DFC_SRCLowAPP2" SWORD Time_ms 1 100 -327680.0 327670.0 FORMAT "%8.1" ECU_ADDRESS 0x6001FC72
 /begin IF_DATA XCPplus 0x0102
  /begin DAQ_EVENT VARIABLE /end DAQ_EVENT
 /end IF_DATA
/end MEASUREMENT
/begin MEASUREMENT APP_uDiff "difference signal voltage between sensor 1 and sensor 2" SWORD Volt 1 100 -6553.600 6553.400 FORMAT "%8.3" ECU_ADDRESS 0x6001F62A
 /begin IF_DATA XCPplus 0x0102
  /begin DAQ_EVENT VARIABLE /end DAQ_EVENT
 /end IF_DATA
/end MEASUREMENT
/begin MEASUREMENT APP_uDiffMax "permitted difference signal voltage between sensor 1 and sensor 2" SWORD Volt 1 100 -6553.600 6553.400 FORMAT "%8.3" ECU_ADDRESS 0x6001F628
 /begin IF_DATA XCPplus 0x0102
  /begin DAQ_EVENT VARIABLE /end DAQ_EVENT
 /end IF_DATA
/end MEASUREMENT
/begin MEASUREMENT APP_uMin12half "Minimum of signal 1 and signal 2 in range of signal 2" SWORD Volt 1 100 -6553.600 6553.400 FORMAT "%8.3" ECU_ADDRESS 0x6001F626
 /begin IF_DATA XCPplus 0x0102
  /begin DAQ_EVENT VARIABLE /end DAQ_EVENT
 /end IF_DATA
/end MEASUREMENT
/begin MEASUREMENT APP_uPreUnJit1 "Acceleration pedal sensor 1 unjitterd signal" SWORD Volt 1 100 -6553.600 6553.400 FORMAT "%8.3" ECU_ADDRESS 0x6001F61E
 /begin IF_DATA XCPplus 0x0102
  /begin DAQ_EVENT VARIABLE /end DAQ_EVENT
 /end IF_DATA
/end MEASUREMENT
/begin MEASUREMENT APP_uPreUnJit2 "Acceleration pedal sensor 2 unjitterd signal" SWORD Volt 1 100 -6553.600 6553.400 FORMAT "%8.3" ECU_ADDRESS 0x6001F61C
 /begin IF_DATA XCPplus 0x0102
  /begin DAQ_EVENT VARIABLE /end DAQ_EVENT
 /end IF_DATA
/end MEASUREMENT
/begin MEASUREMENT APP_uRaw "Acceleration pedal position raw value" SWORD Volt 1 100 -6553.600 6553.400 FORMAT "%8.3" ECU_ADDRESS 0x6001F624
 /begin IF_DATA XCPplus 0x0102
  /begin DAQ_EVENT VARIABLE /end DAQ_EVENT
 /end IF_DATA
/end MEASUREMENT
/begin MEASUREMENT APP_uRaw1 "Acceleration Pedal Position D" SWORD Volt 1 100 -6553.600 6553.400 FORMAT "%8.3" ECU_ADDRESS 0x6001FC70
 /begin IF_DATA XCPplus 0x0102
  /begin DAQ_EVENT VARIABLE /end DAQ_EVENT
 /end IF_DATA
/end MEASUREMENT
/begin MEASUREMENT APP_uRaw1ADC "raw value sensor 1" SWORD Volt 1 100 -6553.600 6553.400 FORMAT "%8.3" ECU_ADDRESS 0x6001FC6E
 /begin IF_DATA XCPplus 0x0102
  /begin DAQ_EVENT VARIABLE /end DAQ_EVENT
 /end IF_DATA
/end MEASUREMENT
/begin MEASUREMENT APP_uRaw1ADCRead "raw value sensor 1" SWORD Volt 1 100 -6553.600 6553.400 FORMAT "%8.3" ECU_ADDRESS 0x6001FC6C
 /begin IF_DATA XCPplus 0x0102
  /begin DAQ_EVENT VARIABLE /end DAQ_EVENT
 /end IF_DATA
/end MEASUREMENT
/begin MEASUREMENT APP_uRaw1Old "frozen value sensor 1" SWORD Volt 1 100 -6553.600 6553.400 FORMAT "%8.3" ECU_ADDRESS 0x6001F61A
 /begin IF_DATA XCPplus 0x0102
  /begin DAQ_EVENT VARIABLE /end DAQ_EVENT
 /end IF_DATA
/end MEASUREMENT
/begin MEASUREMENT APP_uRaw1unLim "Acceleration pedal sensor 1 unlimited raw value" SWORD Volt 1 100 -6553.600 6553.400 FORMAT "%8.3" ECU_ADDRESS 0x6001FC6A
 /begin IF_DATA XCPplus 0x0102
  /begin DAQ_EVENT VARIABLE /end DAQ_EVENT
 /end IF_DATA
/end MEASUREMENT
/begin MEASUREMENT APP_uRaw2 "Acceleration Pedal Position E" SWORD Volt 1 100 -6553.600 6553.400 FORMAT "%8.3" ECU_ADDRESS 0x6001FC68
 /begin IF_DATA XCPplus 0x0102
  /begin DAQ_EVENT VARIABLE /end DAQ_EVENT
 /end IF_DATA
/end MEASUREMENT
/begin MEASUREMENT APP_uRaw2ADC "raw value sensor 2 without NTP" SWORD Volt 1 100 -6553.600 6553.400 FORMAT "%8.3" ECU_ADDRESS 0x6001FC66
 /begin IF_DATA XCPplus 0x0102
  /begin DAQ_EVENT VARIABLE /end DAQ_EVENT
 /end IF_DATA
/end MEASUREMENT
/begin MEASUREMENT APP_uRaw2ADCRead "raw value sensor 2" SWORD Volt 1 100 -6553.600 6553.400 FORMAT "%8.3" ECU_ADDRESS 0x6001FC64
 /begin IF_DATA XCPplus 0x0102
  /begin DAQ_EVENT VARIABLE /end DAQ_EVENT
 /end IF_DATA
/end MEASUREMENT
/begin MEASUREMENT APP_uRaw2Old "frozen value sensor 2" SWORD Volt 1 100 -6553.600 6553.400 FORMAT "%8.3" ECU_ADDRESS 0x6001F618
 /begin IF_DATA XCPplus 0x0102
  /begin DAQ_EVENT VARIABLE /end DAQ_EVENT
 /end IF_DATA
/end MEASUREMENT
/begin MEASUREMENT APP_uRaw2unLim "Acceleration pedal sensor 2 unlimited raw value" SWORD Volt 1 100 -6553.600 6553.400 FORMAT "%8.3" ECU_ADDRESS 0x6001FC62
 /begin IF_DATA XCPplus 0x0102
  /begin DAQ_EVENT VARIABLE /end DAQ_EVENT
 /end IF_DATA
/end MEASUREMENT
/begin MEASUREMENT APP_uRawPre "Acceleration pedal position preliminary raw value" SWORD Volt 1 100 -6553.600 6553.400 FORMAT "%8.3" ECU_ADDRESS 0x6001F622
 /begin IF_DATA XCPplus 0x0102
  /begin DAQ_EVENT VARIABLE /end DAQ_EVENT
 /end IF_DATA
/end MEASUREMENT
/begin MEASUREMENT APP_uUnJit "Acceleration pedal position unjittered value" SWORD Volt 1 100 -6553.600 6553.400 FORMAT "%8.3" ECU_ADDRESS 0x6001F616
 /begin IF_DATA XCPplus 0x0102
  /begin DAQ_EVENT VARIABLE /end DAQ_EVENT
 /end IF_DATA
/end MEASUREMENT
/begin MEASUREMENT APP_uVirtZrPnt "Virtual Zero point Voltage" SWORD Volt 1 100 -6553.600 6553.400 FORMAT "%8.3" ECU_ADDRESS 0x6001FC60
 /begin IF_DATA XCPplus 0x0102
  /begin DAQ_EVENT VARIABLE /end DAQ_EVENT
 /end IF_DATA
/end MEASUREMENT
/begin MEASUREMENT B_airbag_msg "condition airbag activated" UBYTE B_TRUE 1 100 0.00 1.00000000000 BIT_MASK 0x1 FORMAT "%13.11" ECU_ADDRESS 0x70000261
 /begin IF_DATA XCPplus 0x0102
  /begin DAQ_EVENT VARIABLE /end DAQ_EVENT
 /end IF_DATA
/end MEASUREMENT
/begin MEASUREMENT CmprAvl_stEem "AC state regarding electrical supply HV" UBYTE q1 1 100 0.00 255.0 FORMAT "%5.1" ECU_ADDRESS 0x6002364A
 /begin IF_DATA XCPplus 0x0102
  /begin DAQ_EVENT VARIABLE /end DAQ_EVENT
 /end IF_DATA
/end MEASUREMENT
/begin MEASUREMENT DDRC_St.DFC_AbgHiSigFlt "" ULONG DFC_OneToOne 1 100 0.00 536870911.000 BIT_MASK 0x1fffffff FORMAT "%13.3" ECU_ADDRESS 0x6001C1B4 /end MEASUREMENT
/begin MEASUREMENT DDRC_St.DFC_AbgIntPatFlt "" ULONG DFC_OneToOne 1 100 0.00 536870911.000 BIT_MASK 0x1fffffff FORMAT "%13.3" ECU_ADDRESS 0x6001C1B8 /end MEASUREMENT
/begin MEASUREMENT DDRC_St.DFC_AbgLoSigFlt "" ULONG DFC_OneToOne 1 100 0.00 536870911.000 BIT_MASK 0x1fffffff FORMAT "%13.3" ECU_ADDRESS 0x6001C1BC /end MEASUREMENT
/begin MEASUREMENT DDRC_St.DFC_AbgUnkwnErrSigFlt "" ULONG DFC_OneToOne 1 100 0.00 536870911.000 BIT_MASK 0x1fffffff FORMAT "%13.3" ECU_ADDRESS 0x6001C1C0 /end MEASUREMENT
/begin MEASUREMENT DDRC_St.DFC_AcExtChrgrIBattExcdd "" ULONG DFC_OneToOne 1 100 0.00 536870911.000 BIT_MASK 0x1fffffff FORMAT "%13.3" ECU_ADDRESS 0x6001C1C4 /end MEASUREMENT
/begin MEASUREMENT DDRC_St.DFC_AcExtChrgrIInExcdd "" ULONG DFC_OneToOne 1 100 0.00 536870911.000 BIT_MASK 0x1fffffff FORMAT "%13.3" ECU_ADDRESS 0x6001C1C8 /end MEASUREMENT
/begin MEASUREMENT DDRC_St.DFC_AcExtChrgrIOutDe "" ULONG DFC_OneToOne 1 100 0.00 536870911.000 BIT_MASK 0x1fffffff FORMAT "%13.3" ECU_ADDRESS 0x6001C1CC /end MEASUREMENT
/begin MEASUREMENT DDRC_St.DFC_AcExtChrgrIOutExcdd "" ULONG DFC_OneToOne 1 100 0.00 536870911.000 BIT_MASK 0x1fffffff FORMAT "%13.3" ECU_ADDRESS 0x6001C1D0 /end MEASUREMENT
/begin MEASUREMENT DDRC_St.DFC_AcExtChrgrUOutDe "" ULONG DFC_OneToOne 1 100 0.00 536870911.000 BIT_MASK 0x1fffffff FORMAT "%13.3" ECU_ADDRESS 0x6001C1D4 /end MEASUREMENT
/begin MEASUREMENT DDRC_St.DFC_Airbg "" ULONG DFC_OneToOne 1 100 0.00 536870911.000 BIT_MASK 0x1fffffff FORMAT "%13.3" ECU_ADDRESS 0x6001C1E0 /end MEASUREMENT
/begin MEASUREMENT DDRC_St.DFC_AirbgCanHWPlaus "" ULONG DFC_OneToOne 1 100 0.00 536870911.000 BIT_MASK 0x1fffffff FORMAT "%13.3" ECU_ADDRESS 0x6001C1E8 /end MEASUREMENT
/begin MEASUREMENT DDRC_St.DFC_AirbgHWCanPlaus "" ULONG DFC_OneToOne 1 100 0.00 536870911.000 BIT_MASK 0x1fffffff FORMAT "%13.3" ECU_ADDRESS 0x6001C1EC /end MEASUREMENT
/begin MEASUREMENT DDRC_St.DFC_AirbgMnr "" ULONG DFC_OneToOne 1 100 0.00 536870911.000 BIT_MASK 0x1fffffff FORMAT "%13.3" ECU_ADDRESS 0x6001C1F0 /end MEASUREMENT
/begin MEASUREMENT DDRC_St.DFC_AirbgPerHi "" ULONG DFC_OneToOne 1 100 0.00 536870911.000 BIT_MASK 0x1fffffff FORMAT "%13.3" ECU_ADDRESS 0x6001C1F4 /end MEASUREMENT
/begin MEASUREMENT DDRC_St.DFC_AirbgPerdRngFlt "" ULONG DFC_OneToOne 1 100 0.00 536870911.000 BIT_MASK 0x1fffffff FORMAT "%13.3" ECU_ADDRESS 0x6001C1F8 /end MEASUREMENT
/begin MEASUREMENT DDRC_St.DFC_CrashEveOcc "" ULONG DFC_OneToOne 1 100 0.00 536870911.000 BIT_MASK 0x1fffffff FORMAT "%13.3" ECU_ADDRESS 0x6001C35C /end MEASUREMENT
/begin MEASUREMENT DDRC_St.DFC_ACCmprFltLvl1 "" ULONG DFC_OneToOne 1 100 0.00 536870911.000 BIT_MASK 0x1fffffff FORMAT "%13.3" ECU_ADDRESS 0x6001C960 /end MEASUREMENT
/begin MEASUREMENT DDRC_St.DFC_ACCmprFltLvl2 "" ULONG DFC_OneToOne 1 100 0.00 536870911.000 BIT_MASK 0x1fffffff FORMAT "%13.3" ECU_ADDRESS 0x6001C964 /end MEASUREMENT
/begin MEASUREMENT DDRC_St.DFC_ACCmprFltLvl3 "" ULONG DFC_OneToOne 1 100 0.00 536870911.000 BIT_MASK 0x1fffffff FORMAT "%13.3" ECU_ADDRESS 0x6001C968 /end MEASUREMENT
/begin MEASUREMENT DDRC_St.DFC_ACCmprFltLvl4 "" ULONG DFC_OneToOne 1 100 0.00 536870911.000 BIT_MASK 0x1fffffff FORMAT "%13.3" ECU_ADDRESS 0x6001C96C /end MEASUREMENT
/begin MEASUREMENT DDRC_St.DFC_ACCmprHiPFlt "" ULONG DFC_OneToOne 1 100 0.00 536870911.000 BIT_MASK 0x1fffffff FORMAT "%13.3" ECU_ADDRESS 0x6001C970 /end MEASUREMENT
/begin MEASUREMENT DDRC_St.DFC_ACCmprInvldCmprSt "" ULONG DFC_OneToOne 1 100 0.00 536870911.000 BIT_MASK 0x1fffffff FORMAT "%13.3" ECU_ADDRESS 0x6001C974 /end MEASUREMENT
/begin MEASUREMENT DDRC_St.DFC_ACCmprInvldElecActPwr "" ULONG DFC_OneToOne 1 100 0.00 536870911.000 BIT_MASK 0x1fffffff FORMAT "%13.3" ECU_ADDRESS 0x6001C978 /end MEASUREMENT
/begin MEASUREMENT DDRC_St.DFC_ACCmprLoPFlt "" ULONG DFC_OneToOne 1 100 0.00 536870911.000 BIT_MASK 0x1fffffff FORMAT "%13.3" ECU_ADDRESS 0x6001C97C /end MEASUREMENT
/begin MEASUREMENT DFC_st.DFC_AbgHiSigFlt "" UBYTE DFC_OneToOne 1 100 0.00 255.0 FORMAT "%5.1" ECU_ADDRESS 0x600349D0 /end MEASUREMENT
/begin MEASUREMENT DFC_st.DFC_AbgIntPatFlt "" UBYTE DFC_OneToOne 1 100 0.00 255.0 FORMAT "%5.1" ECU_ADDRESS 0x600349D1 /end MEASUREMENT
/begin MEASUREMENT DFC_st.DFC_AbgLoSigFlt "" UBYTE DFC_OneToOne 1 100 0.00 255.0 FORMAT "%5.1" ECU_ADDRESS 0x600349D2 /end MEASUREMENT
/begin MEASUREMENT DFC_st.DFC_AbgUnkwnErrSigFlt "" UBYTE DFC_OneToOne 1 100 0.00 255.0 FORMAT "%5.1" ECU_ADDRESS 0x600349D3 /end MEASUREMENT
/begin MEASUREMENT DFC_st.DFC_AcExtChrgrIBattExcdd "" UBYTE DFC_OneToOne 1 100 0.00 255.0 FORMAT "%5.1" ECU_ADDRESS 0x600349D4 /end MEASUREMENT
/begin MEASUREMENT DFC_st.DFC_AcExtChrgrIInExcdd "" UBYTE DFC_OneToOne 1 100 0.00 255.0 FORMAT "%5.1" ECU_ADDRESS 0x600349D5 /end MEASUREMENT
/begin MEASUREMENT DFC_st.DFC_AcExtChrgrIOutDe "" UBYTE DFC_OneToOne 1 100 0.00 255.0 FORMAT "%5.1" ECU_ADDRESS 0x600349D6 /end MEASUREMENT
/begin MEASUREMENT DFC_st.DFC_AcExtChrgrIOutExcdd "" UBYTE DFC_OneToOne 1 100 0.00 255.0 FORMAT "%5.1" ECU_ADDRESS 0x600349D7 /end MEASUREMENT
/begin MEASUREMENT DFC_st.DFC_AcExtChrgrUOutDe "" UBYTE DFC_OneToOne 1 100 0.00 255.0 FORMAT "%5.1" ECU_ADDRESS 0x600349D8 /end MEASUREMENT
/begin MEASUREMENT DFC_st.DFC_Airbg "" UBYTE DFC_OneToOne 1 100 0.00 255.0 FORMAT "%5.1" ECU_ADDRESS 0x600349DB /end MEASUREMENT
/begin MEASUREMENT DFC_st.DFC_AirbgCanHWPlaus "" UBYTE DFC_OneToOne 1 100 0.00 255.0 FORMAT "%5.1" ECU_ADDRESS 0x600349DD /end MEASUREMENT
/begin MEASUREMENT DFC_st.DFC_AirbgHWCanPlaus "" UBYTE DFC_OneToOne 1 100 0.00 255.0 FORMAT "%5.1" ECU_ADDRESS 0x600349DE /end MEASUREMENT
/begin MEASUREMENT DFC_st.DFC_AirbgMnr "" UBYTE DFC_OneToOne 1 100 0.00 255.0 FORMAT "%5.1" ECU_ADDRESS 0x600349DF /end MEASUREMENT
/begin MEASUREMENT DFC_st.DFC_AirbgPerHi "" UBYTE DFC_OneToOne 1 100 0.00 255.0 FORMAT "%5.1" ECU_ADDRESS 0x600349E0 /end MEASUREMENT
/begin MEASUREMENT DFC_st.DFC_AirbgPerdRngFlt "" UBYTE DFC_OneToOne 1 100 0.00 255.0 FORMAT "%5.1" ECU_ADDRESS 0x600349E1 /end MEASUREMENT
/begin MEASUREMENT DFC_st.DFC_CrashEveOcc "" UBYTE DFC_OneToOne 1 100 0.00 255.0 FORMAT "%5.1" ECU_ADDRESS 0x60034A3A /end MEASUREMENT
/begin MEASUREMENT DFC_st.DFC_ACCmprFltLvl1 "" UBYTE DFC_OneToOne 1 100 0.00 255.0 FORMAT "%5.1" ECU_ADDRESS 0x60034BBB /end MEASUREMENT
/begin MEASUREMENT DFC_st.DFC_ACCmprFltLvl2 "" UBYTE DFC_OneToOne 1 100 0.00 255.0 FORMAT "%5.1" ECU_ADDRESS 0x60034BBC /end MEASUREMENT
/begin MEASUREMENT DFC_st.DFC_ACCmprFltLvl3 "" UBYTE DFC_OneToOne 1 100 0.00 255.0 FORMAT "%5.1" ECU_ADDRESS 0x60034BBD /end MEASUREMENT
/begin MEASUREMENT DFC_st.DFC_ACCmprFltLvl4 "" UBYTE DFC_OneToOne 1 100 0.00 255.0 FORMAT "%5.1" ECU_ADDRESS 0x60034BBE /end MEASUREMENT
/begin MEASUREMENT DFC_st.DFC_ACCmprHiPFlt "" UBYTE DFC_OneToOne 1 100 0.00 255.0 FORMAT "%5.1" ECU_ADDRESS 0x60034BBF /end MEASUREMENT
/begin MEASUREMENT DFC_st.DFC_ACCmprInvldCmprSt "" UBYTE DFC_OneToOne 1 100 0.00 255.0 FORMAT "%5.1" ECU_ADDRESS 0x60034BC0 /end MEASUREMENT
/begin MEASUREMENT DFC_st.DFC_ACCmprInvldElecActPwr "" UBYTE DFC_OneToOne 1 100 0.00 255.0 FORMAT "%5.1" ECU_ADDRESS 0x60034BC1 /end MEASUREMENT
/begin MEASUREMENT DFC_st.DFC_ACCmprLoPFlt "" UBYTE DFC_OneToOne 1 100 0.00 255.0 FORMAT "%5.1" ECU_ADDRESS 0x60034BC2 /end MEASUREMENT
/begin MEASUREMENT DFC_st.DFC_AppAllSnsrDfct "" UBYTE DFC_OneToOne 1 100 0.00 255.0 FORMAT "%5.1" ECU_ADDRESS 0x60034CAF /end MEASUREMENT
/begin MEASUREMENT DFC_st.DFC_SRCHighAPP1 "" UBYTE DFC_OneToOne 1 100 0.00 255.0 FORMAT "%5.1" ECU_ADDRESS 0x60034D81 /end MEASUREMENT
/begin MEASUREMENT DFC_st.DFC_SRCHighAPP2 "" UBYTE DFC_OneToOne 1 100 0.00 255.0 FORMAT "%5.1" ECU_ADDRESS 0x60034D82 /end MEASUREMENT
/begin MEASUREMENT DFC_st.DFC_SRCLowAPP1 "" UBYTE DFC_OneToOne 1 100 0.00 255.0 FORMAT "%5.1" ECU_ADDRESS 0x60034D83 /end MEASUREMENT
/begin MEASUREMENT DFC_st.DFC_SRCLowAPP2 "" UBYTE DFC_OneToOne 1 100 0.00 255.0 FORMAT "%5.1" ECU_ADDRESS 0x60034D84 /end MEASUREMENT
/begin MEASUREMENT DFC_st.DFC_SyncAPP "" UBYTE DFC_OneToOne 1 100 0.00 255.0 FORMAT "%5.1" ECU_ADDRESS 0x60034D8D /end MEASUREMENT
/begin MEASUREMENT DINH_nrActvInhReas.FId_ACCmprFltPDiagEnad "" UWORD DINH_ct_Compu 1 100 -4095.000 4096.000 BIT_MASK 0x1fff FORMAT "%8.3" ECU_ADDRESS 0x600212F8 /end MEASUREMENT
/begin MEASUREMENT DINH_nrActvInhReas.FId_ACCmprInpErr "" UWORD DINH_ct_Compu 1 100 -4095.000 4096.000 BIT_MASK 0x1fff FORMAT "%8.3" ECU_ADDRESS 0x600212FA /end MEASUREMENT
/begin MEASUREMENT DINH_nrActvInhReas.FId_ACpAC "" UWORD DINH_ct_Compu 1 100 -4095.000 4096.000 BIT_MASK 0x1fff FORMAT "%8.3" ECU_ADDRESS 0x600212FC /end MEASUREMENT
/begin MEASUREMENT DINH_nrActvInhReas.FId_APP1SigPath "" UWORD DINH_ct_Compu 1 100 -4095.000 4096.000 BIT_MASK 0x1fff FORMAT "%8.3" ECU_ADDRESS 0x600212FE /end MEASUREMENT
/begin MEASUREMENT DINH_nrActvInhReas.FId_APP2SigPath "" UWORD DINH_ct_Compu 1 100 -4095.000 4096.000 BIT_MASK 0x1fff FORMAT "%8.3" ECU_ADDRESS 0x60021300 /end MEASUREMENT
/begin MEASUREMENT DINH_nrActvInhReas.FId_APPBrkErr "" UWORD DINH_ct_Compu 1 100 -4095.000 4096.000 BIT_MASK 0x1fff FORMAT "%8.3" ECU_ADDRESS 0x60021302 /end MEASUREMENT
/begin MEASUREMENT DINH_nrActvInhReas.FId_APPVehVErr "" UWORD DINH_ct_Compu 1 100 -4095.000 4096.000 BIT_MASK 0x1fff FORMAT "%8.3" ECU_ADDRESS 0x60021304 /end MEASUREMENT
/begin MEASUREMENT DINH_nrActvInhReas.FId_AcExtChrgrChrgn "" UWORD DINH_ct_Compu 1 100 -4095.000 4096.000 BIT_MASK 0x1fff FORMAT "%8.3" ECU_ADDRESS 0x60021312 /end MEASUREMENT
/begin MEASUREMENT DINH_nrActvInhReas.FId_Airbg2MED "" UWORD DINH_ct_Compu 1 100 -4095.000 4096.000 BIT_MASK 0x1fff FORMAT "%8.3" ECU_ADDRESS 0x60021314 /end MEASUREMENT
/begin MEASUREMENT DINH_nrActvInhReas.FId_AirbgAVSstCrash "" UWORD DINH_ct_Compu 1 100 -4095.000 4096.000 BIT_MASK 0x1fff FORMAT "%8.3" ECU_ADDRESS 0x60021316 /end MEASUREMENT
/begin MEASUREMENT DINH_nrActvInhReas.FId_AirbgCan "" UWORD DINH_ct_Compu 1 100 -4095.000 4096.000 BIT_MASK 0x1fff FORMAT "%8.3" ECU_ADDRESS 0x60021318 /end MEASUREMENT
/begin MEASUREMENT DINH_nrActvInhReas.FId_AirbgHw "" UWORD DINH_ct_Compu 1 100 -4095.000 4096.000 BIT_MASK 0x1fff FORMAT "%8.3" ECU_ADDRESS 0x6002131A /end MEASUREMENT
/begin MEASUREMENT DINH_nrActvInhReas.FId_AirbgInpSigErr "" UWORD DINH_ct_Compu 1 100 -4095.000 4096.000 BIT_MASK 0x1fff FORMAT "%8.3" ECU_ADDRESS 0x6002131C /end MEASUREMENT
/begin MEASUREMENT DINH_nrActvInhReas.FId_AirbgPWMErr "" UWORD DINH_ct_Compu 1 100 -4095.000 4096.000 BIT_MASK 0x1fff FORMAT "%8.3" ECU_ADDRESS 0x6002131E /end MEASUREMENT
/begin MEASUREMENT DINH_nrActvInhReas.FId_AirbgPwmSrcErr "" UWORD DINH_ct_Compu 1 100 -4095.000 4096.000 BIT_MASK 0x1fff FORMAT "%8.3" ECU_ADDRESS 0x60021320 /end MEASUREMENT
/begin MEASUREMENT DINH_stFId.FId_ACCmprFltPDiagEnad "" UWORD DFC_OneToOne 1 100 0.00 65535.00 FORMAT "%8.2" ECU_ADDRESS 0x600212F8 /end MEASUREMENT
/begin MEASUREMENT DINH_stFId.FId_ACCmprInpErr "" UWORD DFC_OneToOne 1 100 0.00 65535.00 FORMAT "%8.2" ECU_ADDRESS 0x600212FA /end MEASUREMENT
/begin MEASUREMENT DINH_stFId.FId_ACpAC "" UWORD DFC_OneToOne 1 100 0.00 65535.00 FORMAT "%8.2" ECU_ADDRESS 0x600212FC /end MEASUREMENT
/begin MEASUREMENT DINH_stFId.FId_APP1SigPath "" UWORD DFC_OneToOne 1 100 0.00 65535.00 FORMAT "%8.2" ECU_ADDRESS 0x600212FE /end MEASUREMENT
/begin MEASUREMENT DINH_stFId.FId_APP2SigPath "" UWORD DFC_OneToOne 1 100 0.00 65535.00 FORMAT "%8.2" ECU_ADDRESS 0x60021300 /end MEASUREMENT
/begin MEASUREMENT DINH_stFId.FId_APPBrkErr "" UWORD DFC_OneToOne 1 100 0.00 65535.00 FORMAT "%8.2" ECU_ADDRESS 0x60021302 /end MEASUREMENT
/begin MEASUREMENT DINH_stFId.FId_APPVehVErr "" UWORD DFC_OneToOne 1 100 0.00 65535.00 FORMAT "%8.2" ECU_ADDRESS 0x60021304 /end MEASUREMENT
/begin MEASUREMENT DINH_stFId.FId_AcExtChrgrChrgn "" UWORD DFC_OneToOne 1 100 0.00 65535.00 FORMAT "%8.2" ECU_ADDRESS 0x60021312 /end MEASUREMENT
/begin MEASUREMENT DINH_stFId.FId_Airbg2MED "" UWORD DFC_OneToOne 1 100 0.00 65535.00 FORMAT "%8.2" ECU_ADDRESS 0x60021314 /end MEASUREMENT
/begin MEASUREMENT DINH_stFId.FId_AirbgAVSstCrash "" UWORD DFC_OneToOne 1 100 0.00 65535.00 FORMAT "%8.2" ECU_ADDRESS 0x60021316 /end MEASUREMENT
/begin MEASUREMENT DINH_stFId.FId_AirbgCan "" UWORD DFC_OneToOne 1 100 0.00 65535.00 FORMAT "%8.2" ECU_ADDRESS 0x60021318 /end MEASUREMENT
/begin MEASUREMENT DINH_stFId.FId_AirbgHw "" UWORD DFC_OneToOne 1 100 0.00 65535.00 FORMAT "%8.2" ECU_ADDRESS 0x6002131A /end MEASUREMENT
/begin MEASUREMENT DINH_stFId.FId_AirbgInpSigErr "" UWORD DFC_OneToOne 1 100 0.00 65535.00 FORMAT "%8.2" ECU_ADDRESS 0x6002131C /end MEASUREMENT
/begin MEASUREMENT DINH_stFId.FId_AirbgPWMErr "" UWORD DFC_OneToOne 1 100 0.00 65535.00 FORMAT "%8.2" ECU_ADDRESS 0x6002131E /end MEASUREMENT
/begin MEASUREMENT DINH_stFId.FId_AirbgPwmSrcErr "" UWORD DFC_OneToOne 1 100 0.00 65535.00 FORMAT "%8.2" ECU_ADDRESS 0x60021320 /end MEASUREMENT
/begin MEASUREMENT DSQ_st.DSQ_ACCmprPwrConsol "" UBYTE DFC_OneToOne 1 100 0.00 255.0 FORMAT "%5.1" ECU_ADDRESS 0x60024661 /end MEASUREMENT
/begin MEASUREMENT DSQ_st.DSQ_ACCmprUConsol "" UBYTE DFC_OneToOne 1 100 0.00 255.0 FORMAT "%5.1" ECU_ADDRESS 0x60024662 /end MEASUREMENT
/begin MEASUREMENT flgCrashDeploy "Intermediate state of CRASh deployment" UBYTE B_TRUE 1 100 0.00 1.00000000000 BIT_MASK 0x1 FORMAT "%13.11" ECU_ADDRESS 0x6002321E
 /begin IF_DATA XCPplus 0x0102
  /begin DAQ_EVENT VARIABLE /end DAQ_EVENT
 /end IF_DATA
/end MEASUREMENT
/begin FUNCTION ACCmpr_DD "49.7.0    AC Compressor Device Driver"
 /begin DEF_CHARACTERISTIC ACCmpr_iDeltaOverCmprThd_C ACCmpr_iElCmprHvActThd_C ACCmpr_iOverCmprThd_C ACCmpr_maskRatSocVldSq_C ACCmpr_maskVehVVldSq_C ACCmpr_nCmprMaxDefogEco_C ACCmpr_nCmprMaxDefog_C ACCmpr_nCmprMaxDern_C ACCmpr_nCmprOverSpdThd_C ACCmpr_nCmprPwrLim_T ACCmpr_nCoolgCmprMaxEco_T ACCmpr_nCoolgCmprMax_T ACCmpr_nDesCoolgSaveDelta_C ACCmpr_nDesCoolgSaveMax_C ACCmpr_nDesDefogSaveDelta_C ACCmpr_nDesDefogSaveMax_C ACCmpr_nSpdLim_T ACCmpr_nVehSpdLimDft_C ACCmpr_pDeltaHiCmprThd_C ACCmpr_pDeltaLoCmprThd_C ACCmpr_pHiCmprThd_C ACCmpr_pLoCmprThd_C ACCmpr_pwrCmprMaxThd_C ACCmpr_pwrHiCmprThd_C ACCmpr_pwrHvMaxDemist_C ACCmpr_pwrMinOn_C ACCmpr_ratPwrLimDelta_C ACCmpr_ratSocDeltaPwrSave_C ACCmpr_ratSocLePwrSave_C ACCmpr_stDsqFltThd_C ACCmpr_stDsqThd_C ACCmpr_stElecCmprStatStEemMpg_CA ACCmpr_stElecCmprStInvld_C ACCmpr_stVehStDiagEna_C ACCmpr_tCmprOverTErr_C ACCmpr_tCmprOverTWarn_C ACCmpr_tDeltaCmprOverTErr_C ACCmpr_tDeltaCmprOverTWarn_C ACCmpr_tiStHldMax_C ACCmpr_uDeltaOverCmprThd_C ACCmpr_uOverCmprThd_C DDRC_DurDeb.ACCmpr_tiFltLvl1DebOk_C DDRC_DurDeb.ACCmpr_tiFltLvl1DebDef_C DDRC_DurDeb.ACCmpr_tiFltLvl2DebOk_C DDRC_DurDeb.ACCmpr_tiFltLvl2DebDef_C DDRC_DurDeb.ACCmpr_tiFltLvl3DebOk_C DDRC_DurDeb.ACCmpr_tiFltLvl3DebDef_C DDRC_DurDeb.ACCmpr_tiFltLvl4DebOk_C DDRC_DurDeb.ACCmpr_tiFltLvl4DebDef_C DDRC_DurDeb.ACCmpr_tiHiPFltDebOk_C DDRC_DurDeb.ACCmpr_tiHiPFltDebDef_C DDRC_DurDeb.ACCmpr_tiInvldCmprStDebOk_C DDRC_DurDeb.ACCmpr_tiInvldCmprStDebDef_C DDRC_DurDeb.ACCmpr_tiInvldElecActPwrDebOk_C DDRC_DurDeb.ACCmpr_tiInvldElecActPwrDebDef_C DDRC_DurDeb.ACCmpr_tiLoPFltDebOk_C DDRC_DurDeb.ACCmpr_tiLoPFltDebDef_C DDRC_RatDeb.ACCmpr_tiFltLvl1UDRat_C DDRC_RatDeb.ACCmpr_tiFltLvl2UDRat_C DDRC_RatDeb.ACCmpr_tiFltLvl3UDRat_C DDRC_RatDeb.ACCmpr_tiFltLvl4UDRat_C DDRC_RatDeb.ACCmpr_tiHiPFltUDRat_C DDRC_RatDeb.ACCmpr_tiInvldCmprStUDRat_C DDRC_RatDeb.ACCmpr_tiInvldElecActPwrUDRat_C DDRC_RatDeb.ACCmpr_tiLoPFltUDRat_C DFC_CtlMsk2.DFC_ACCmprFltLvl1_C DFC_CtlMsk2.DFC_ACCmprFltLvl2_C DFC_CtlMsk2.DFC_ACCmprFltLvl3_C DFC_CtlMsk2.DFC_ACCmprFltLvl4_C DFC_CtlMsk2.DFC_ACCmprHiPFlt_C DFC_CtlMsk2.DFC_ACCmprInvldCmprSt_C DFC_CtlMsk2.DFC_ACCmprInvldElecActPwr_C DFC_CtlMsk2.DFC_ACCmprLoPFlt_C DFC_DisblMsk2.DFC_ACCmprFltLvl1_C DFC_DisblMsk2.DFC_ACCmprFltLvl2_C DFC_DisblMsk2.DFC_ACCmprFltLvl3_C DFC_DisblMsk2.DFC_ACCmprFltLvl4_C DFC_DisblMsk2.DFC_ACCmprHiPFlt_C DFC_DisblMsk2.DFC_ACCmprInvldCmprSt_C DFC_DisblMsk2.DFC_ACCmprInvldElecActPwr_C DFC_DisblMsk2.DFC_ACCmprLoPFlt_C /end DEF_CHARACTERISTIC
 /begin IN_MEASUREMENT Com_iElCmprHvAct Com_iElCmprHvAct_Sq Com_nElCmprActl Com_pwrElCmprActl Com_stDsqElCmprFltLvl Com_stDsqpwrElCmprActl Com_stDsqstElCmprStat Com_stDsquElCmprHvAct Com_stElCmprFltLvl Com_stElCmprStat Com_tElCmprActl Com_uElCmprHvAct DrvPrgSwt_stReq Eem_stHv FreonP_p_f HvacHmi_stCoolgReq HvacMod_st HvBatt_ratSoc HvBatt_ratSoc_Sq HvGrid_pwrMaxAc HvGrid_pwrMaxPtc VehCoorn_st VehV_v VehV_v_Sq /end IN_MEASUREMENT
 /begin OUT_MEASUREMENT ACCmpr_iConsol ACCmpr_nLimMax ACCmpr_pwrConsol ACCmpr_pwrLimMax ACCmpr_stEem ACCmpr_stElecCmprOverT ACCmpr_stLim ACCmpr_uConsol CmprAvl_stEem DDRC_St.DFC_ACCmprFltLvl1 DDRC_St.DFC_ACCmprFltLvl2 DDRC_St.DFC_ACCmprFltLvl3 DDRC_St.DFC_ACCmprFltLvl4 DDRC_St.DFC_ACCmprHiPFlt DDRC_St.DFC_ACCmprInvldCmprSt DDRC_St.DFC_ACCmprInvldElecActPwr DDRC_St.DFC_ACCmprLoPFlt DFC_st.DFC_ACCmprFltLvl1 DFC_st.DFC_ACCmprFltLvl2 DFC_st.DFC_ACCmprFltLvl3 DFC_st.DFC_ACCmprFltLvl4 DFC_st.DFC_ACCmprHiPFlt DFC_st.DFC_ACCmprInvldCmprSt DFC_st.DFC_ACCmprInvldElecActPwr DFC_st.DFC_ACCmprLoPFlt DINH_nrActvInhReas.FId_ACCmprFltPDiagEnad DINH_nrActvInhReas.FId_ACCmprInpErr DINH_stFId.FId_ACCmprFltPDiagEnad DINH_stFId.FId_ACCmprInpErr DSQ_st.DSQ_ACCmprPwrConsol DSQ_st.DSQ_ACCmprUConsol /end OUT_MEASUREMENT
 /begin LOC_MEASUREMENT ACCmpr_flgPwrLimActv ACCmpr_flgPwrLo ACCmpr_flgSocPwrSaveActv ACCmpr_nCoolgSaveModDes ACCmpr_nDefogSaveModDes ACCmpr_nModLimMax ACCmpr_nVehVLimMax ACCmpr_pwrCmprLimd ACCmpr_pwrLimMaxDes ACCmpr_stHiPFlt ACCmpr_stLoPFlt ACCmpr_stPwrLim ACCmpr_tiStLim /end LOC_MEASUREMENT
 FUNCTION_VERSION "49.7.0" /end FUNCTION
/begin FUNCTION ACComp_Demand "43.1.0    Air conditioning compressor demand" /begin DEF_CHARACTERISTIC ACComp_pChillrDsDes_T /end DEF_CHARACTERISTIC
 /begin IN_MEASUREMENT CbnAirT_tEvapAct CbnAirT_tEvapDes RefgntCirc_pwrRefgntDes RefgntCirc_stAcFrntVlv RefgntP_pChillrDs /end IN_MEASUREMENT
 /begin OUT_MEASUREMENT ACComp_pDe /end OUT_MEASUREMENT
 FUNCTION_VERSION "43.1.0" /end FUNCTION
/begin FUNCTION AccPedEv_DrvDem "160.9.0   Calculation of driver command torque set path for the electric vehicle"
 /begin DEF_CHARACTERISTIC AccPedEv_aRecupNormOnePedlDrvg_M AccPedEv_aRecupRvsOnePedlDrvg_M AccPedEv_facDifModPerStep_T AccPedEv_flgOnePedlDrvgExtReq_C AccPedEv_tqPrpnActvThd_C AccPedEv_tqRecupOnePedlPerStepMax_C AccPedEv_tqWhlEco_M AccPedEv_tqWhlNorm_M AccPedEv_tqWhlRvs_M AccPedEv_tqWhlSpt_M /end DEF_CHARACTERISTIC
 /begin IN_MEASUREMENT AccPed_facRecupOnePedlDrvg AccPed_rPrpOnePedlDrvg Com_aRecupOnePedlDrvg Com_aRecupRvsOnePedlDrvg CoPOM_tqWhlQstyMin DrvMod_stPosn MoFTqPtdVeh_stDrvProgReqMsg VehMot_a2trq VehM_flgOnePedlDrvgOff VehV_vSign /end IN_MEASUREMENT
 /begin OUT_MEASUREMENT AccPedEv_stDrvModActv AccPedEv_tqPrp AccPedEv_tqRecupFacOnePedlLim AccPedEv_tqRecupOnePedlDrvg AccPedEv_tqWhlDes AccPed_flgPrpnActv /end OUT_MEASUREMENT
 /begin LOC_MEASUREMENT AccPedEv_aRecupOnePedlDrvg AccPedEv_aRecupOnePedlDrvgTmp AccPedEv_facDif AccPedEv_facTranMap AccPedEv_stDrvModReq AccPedEv_tqDifMod AccPedEv_tqRecupFacOnePedlDrvg AccPedEv_tqRecupFacOnePedlDrvgLim AccPedEv_tqRecupOnePedlRamp AccPedEv_vRvs /end LOC_MEASUREMENT
 FUNCTION_VERSION "160.9.0" /end FUNCTION
/begin FUNCTION AccPed_DoCoordOut "160.3.0   Accelerator pedal torque coordination"
 /begin DEF_CHARACTERISTIC AccPed_drAppGrdtLvlRst_C AccPed_facAppGrdtLvl_T AccPed_flgVirtZrPntExt_C AccPed_rCoastGapOnePedlDrvg_M AccPed_rCoastGapPerStepMax_C AccPed_rCoastGapRvsOnePedlDrvg_M AccPed_rMinGapThd_C AccPed_rVirtZrPntLim_C AccPed_rVirtZrPntOnePedlDrvg_M AccPed_rVirtZrPntPerStepMax_C AccPed_rVirtZrPntRvsOnePedlDrvg_M AccPed_rZrPntOnePedlThd_C /end DEF_CHARACTERISTIC
 /begin IN_MEASUREMENT APP_dr APP_r Com_rVirtZrPntExt DrvMod_stPosn MoFTqPtdVeh_stDrvProgReqMsg VehV_vSign /end IN_MEASUREMENT
 /begin OUT_MEASUREMENT AccPed_facRecupAppGrdt AccPed_facRecupBas AccPed_facRecupOnePedlDrvg AccPed_rCoastGap AccPed_rPrpOnePedlDrvg AccPed_rRecupOnePedlDrvgStrt AccPed_rVirtZrPnt /end OUT_MEASUREMENT
 /begin LOC_MEASUREMENT AccPed_drAppGrdtOld AccPed_rCoastGapUnlim AccPed_rVirtZrPntUnlim AccPed_vSignCnvn /end LOC_MEASUREMENT
 FUNCTION_VERSION "160.3.0" /end FUNCTION
/begin FUNCTION AccPr "189.0.0   Access Protection" FUNCTION_VERSION "189.0.0" /end FUNCTION
/begin FUNCTION ACCtl_Demand "77.4.0    Air Condition Compressor Control"
 /begin DEF_CHARACTERISTIC ACCtl_facKiRefgntCtrlr_C ACCtl_facPCtrlIIntegdToN_C ACCtl_nCmprMax_C ACCtl_nCmprMin_C ACCtl_nCmprPreCtrlr_T ACCtl_nGrdtLimMaxSpd_C ACCtl_nPDeLim_T ACCtl_pRefgntSpDifMin_C ACCtl_pwrCmprReq_T ACCtl_tiMinOff_C ACCtl_tiMinWaitOff_C ACCtl_tiMinWaitPreCtrlOff_C ACCtl_tiPreCtrlSpdFild_C ACCtl_tiPreCtrl_C /end DEF_CHARACTERISTIC
 /begin IN_MEASUREMENT ACCmpr_nLimMax ACCmpr_pwrConsol ACComp_pDe CmprDsFldP_p_f RefgntCirc_pwrRefgntDes RefgntCirc_stAcDes RefgntCirc_stCmprOvrdReq ThermSys_pwrLoTChillrMax /end IN_MEASUREMENT
 /begin OUT_MEASUREMENT ACCtl_facCmprLoad ACCtl_nCmprReq ACCtl_pwrChillrReqEem ACCtl_pwrHvacFrntReqEem ACCtl_stAcCtrlr /end OUT_MEASUREMENT
 /begin LOC_MEASUREMENT ACCtl_flgAbvMinSpd ACCtl_nCtrlr ACCtl_nDes ACCtl_nLimSpdMax ACCtl_nLimSpdMaxRaw ACCtl_nPreCtrlFild ACCtl_nPreCtrlr ACCtl_pCmprDsFld ACCtl_pCtrlIntegd ACCtl_pMaxCtrlIntegd ACCtl_pMinCtrlIntegd ACCtl_tiAcCtrlr /end LOC_MEASUREMENT
 FUNCTION_VERSION "77.4.0" /end FUNCTION
/begin FUNCTION AcExtChrgrCtrl "5610.2.0  AC Charging Control single-\ three-phase - external charger"
 /begin DEF_CHARACTERISTIC AcExtChrgr_cntrCritErrMax_C AcExtChrgr_cntrMnrErrMax_C AcExtChrgr_cntrTryMax_C AcExtChrgr_facChrgrInExcdTolr_C AcExtChrgr_flgAuxUnitLoadLoEna_C AcExtChrgr_iActLoThd_C AcExtChrgr_iAuxUnitLoadMax_C AcExtChrgr_iBattExcdTolr_C AcExtChrgr_iChrgnEndThdGrid_C AcExtChrgr_iChrgnLimMaxAc_C AcExtChrgr_iChrgnLimMax_C AcExtChrgr_iChrgnLimMin_C AcExtChrgr_iChrgnStrtThd_C AcExtChrgr_iChrgrOutDeTolr_C AcExtChrgr_iChrgrOutExcdTolr_C AcExtChrgr_pwrChrgrOut_T AcExtChrgr_ratSocStrt_C AcExtChrgr_ratSocTar_C AcExtChrgr_stSigQlyMsk_C AcExtChrgr_tiChrgnRespTout_C AcExtChrgr_tiCtrlPltSwtDi_C AcExtChrgr_tiDlyActILo_C AcExtChrgr_tiDlyChrgnRetry_C AcExtChrgr_tiDlyStopActILo_C AcExtChrgr_tiDlyStopMaxILo_C AcExtChrgr_tiStrtReqTout_C AcExtChrgr_uChrgnStrtThdGrid_C AcExtChrgr_uChrgrOutDeTolr_C DDRC_DurDeb.AcExtChrgr_tiIBattExcddDebOk_C DDRC_DurDeb.AcExtChrgr_tiIBattExcddDebDef_C DDRC_DurDeb.AcExtChrgr_tiIInExcddDebOk_C DDRC_DurDeb.AcExtChrgr_tiIInExcddDebDef_C DDRC_DurDeb.AcExtChrgr_tiIOutDeDebOk_C DDRC_DurDeb.AcExtChrgr_tiIOutDeDebDef_C DDRC_DurDeb.AcExtChrgr_tiIOutExcddDebOk_C DDRC_DurDeb.AcExtChrgr_tiIOutExcddDebDef_C DDRC_DurDeb.AcExtChrgr_tiUOutDeDebOk_C DDRC_DurDeb.AcExtChrgr_tiUOutDeDebDef_C DFC_CtlMsk2.DFC_AcExtChrgrIBattExcdd_C DFC_CtlMsk2.DFC_AcExtChrgrIInExcdd_C DFC_CtlMsk2.DFC_AcExtChrgrIOutDe_C DFC_CtlMsk2.DFC_AcExtChrgrIOutExcdd_C DFC_CtlMsk2.DFC_AcExtChrgrUOutDe_C DFC_DisblMsk2.DFC_AcExtChrgrIBattExcdd_C DFC_DisblMsk2.DFC_AcExtChrgrIInExcdd_C DFC_DisblMsk2.DFC_AcExtChrgrIOutDe_C DFC_DisblMsk2.DFC_AcExtChrgrIOutExcdd_C DFC_DisblMsk2.DFC_AcExtChrgrUOutDe_C /end DEF_CHARACTERISTIC
 /begin IN_MEASUREMENT ChgrPlug_flgCtPSwtVld ChgrPlug_flgDigComRqrd ChgrPlug_iCblLimCcs ChgrPlug_iCtPLim ChgrPlug_stCtP ChrgCIL_stHmiReq ChrgMod_flgUnplRqrd ChrgMod_stMod ChrgPlg_facDernI ChrgPlg_flgChrgnStopReq ChrgPlg_stChrgn ChrgrSt_stChrgn ChrgrVal_iGrid ChrgrVal_iGrid_Sq ChrgrVal_iOut ChrgrVal_iOut_Sq ChrgrVal_nrAcPha ChrgrVal_nrAcPha_Sq ChrgrVal_uGrid ChrgrVal_uGrid_Sq ChrgrVal_uOut ChrgrVal_uOut_Sq Eem_pwrAuxUnitLoad Eem_pwrAuxUnitLoadLo Eem_pwrBascAuxUnitLoad HvBatt_flgChrgTarRea HvBatt_iActMeasd HvBatt_iReqToChrgr HvBatt_ratSoc HvBatt_stFlt HvBatt_uActMeasd HvBatt_uMaxLim HvBatt_uNomChrgn VehCoorn_st /end IN_MEASUREMENT
 /begin OUT_MEASUREMENT AcExtChrgr_flgChrgnRdy AcExtChrgr_flgChrgnRetry AcExtChrgr_iChrgnLimMaxAc AcExtChrgr_iChrgnMaxAvl AcExtChrgr_iChrgnReq AcExtChrgr_pwrChrgnOut AcExtChrgr_pwrChrgrIn AcExtChrgr_ratSocChrgnStop AcExtChrgr_stChrgn AcExtChrgr_stChrgnReq AcExtChrgr_uChrgnReq DDRC_St.DFC_AcExtChrgrIBattExcdd DDRC_St.DFC_AcExtChrgrIInExcdd DDRC_St.DFC_AcExtChrgrIOutDe DDRC_St.DFC_AcExtChrgrIOutExcdd DDRC_St.DFC_AcExtChrgrUOutDe DFC_st.DFC_AcExtChrgrIBattExcdd DFC_st.DFC_AcExtChrgrIInExcdd DFC_st.DFC_AcExtChrgrIOutDe DFC_st.DFC_AcExtChrgrIOutExcdd DFC_st.DFC_AcExtChrgrUOutDe DINH_nrActvInhReas.FId_AcExtChrgrChrgn DINH_stFId.FId_AcExtChrgrChrgn /end OUT_MEASUREMENT
 /begin LOC_MEASUREMENT AcExtChrgrCtrl_StMac.cntrCritErr AcExtChrgrCtrl_StMac.cntrMnrErr AcExtChrgrCtrl_StMac.cntrTry AcExtChrgrCtrl_StMac.flgChrgnRdy AcExtChrgrCtrl_StMac.flgChrgnRetry AcExtChrgrCtrl_StMac.iChrgnReq AcExtChrgrCtrl_StMac.sm AcExtChrgrCtrl_StMac.stChrgn AcExtChrgrCtrl_StMac.stChrgnReq AcExtChrgrCtrl_StMac.tiGpt AcExtChrgrCtrl_StMac.uChrgnReq AcExtChrgr_flgChrgnStopReq AcExtChrgr_flgChrgnStopReqLoI AcExtChrgr_flgChrgnStrtReq AcExtChrgr_flgCritErr AcExtChrgr_flgDiagErr AcExtChrgr_flgMnrErr AcExtChrgr_flgSigQlyErr AcExtChrgr_iAuxUnitLoad AcExtChrgr_iChrgnCalc AcExtChrgr_iChrgnLimMax AcExtChrgr_iChrgnLimMaxCnv AcExtChrgr_uChrgnCalc /end LOC_MEASUREMENT
 FUNCTION_VERSION "5610.2.0" /end FUNCTION
/begin FUNCTION AC_Demand "16.3.0    Air Condition Compressor Demand"
 /begin DEF_CHARACTERISTIC AC_dmClgACOff_T AC_dmClgACOn_T AC_pClntHi_C AC_pClntLo_C AC_pClnt_C AC_swtCoolgDmd_C /end DEF_CHARACTERISTIC
 /begin IN_MEASUREMENT ACCtl_flgCmprEna AirC_pClnt AirC_rClgDem HvacMod_stAcReq /end IN_MEASUREMENT
 /begin OUT_MEASUREMENT AC_rClgDem DINH_nrActvInhReas.FId_ACpAC DINH_stFId.FId_ACpAC /end OUT_MEASUREMENT
 /begin LOC_MEASUREMENT AC_pClntHld AC_pHld AC_rClgACOff AC_rClgACOn /end LOC_MEASUREMENT
 FUNCTION_VERSION "16.3.0" /end FUNCTION
/begin FUNCTION Airbg2MED "5.0.0     adapter for mapping MED17 airbag-signals"
 /begin OUT_MEASUREMENT B_airbag_msg DINH_nrActvInhReas.FId_Airbg2MED DINH_stFId.FId_Airbg2MED /end OUT_MEASUREMENT
 FUNCTION_VERSION "5.0.0" /end FUNCTION
/begin FUNCTION Airbg_DD "27.6.0    Component driver airbag"
 /begin DEF_CHARACTERISTIC Airbg_rDycCrashDeployHi_C Airbg_rDycCrashDeployLo_C Airbg_rDycCrashOkHi_C Airbg_rDycCrashOkLo_C Airbg_swtMonPrmsActv_C Airbg_swtPwmSigInvActv_C AirBg_tiCrashDeployEnaDly_C Airbg_tiCrashOkHi_C Airbg_tiCrashOkLo_C Airbg_tiDurCrashDeployHi_C Airbg_tiDurCrashDeployLo_C Airbg_tiDurCrashOkHi_C Airbg_tiDurCrashOkLo_C Airbg_tiDurPWMMxLim_C Airbg_tiEnaDel_C Airbg_uBattMax_C Airbg_uBattMin_C DDRC_DurDeb.Airbg_tiAbgHiSigFltDebOk_C DDRC_DurDeb.Airbg_tiAbgHiSigFltDebDef_C DDRC_DurDeb.Airbg_tiAbgIntPatFltDebOk_C DDRC_DurDeb.Airbg_tiAbgIntPatFltDebDef_C DDRC_DurDeb.Airbg_tiAbgLoSigFltDebOk_C DDRC_DurDeb.Airbg_tiAbgLoSigFltDebDef_C DDRC_DurDeb.Airbg_tiAbgUnkwnErrSigFltDebOk_C DDRC_DurDeb.Airbg_tiAbgUnkwnErrSigFltDebDef_C DDRC_DurDeb.Airbg_tiCrashEveOccDebOk_C DDRC_DurDeb.Airbg_tiCrashEveOccDebDef_C DDRC_DurDeb.Airbg_tiPerHiDebOk_C DDRC_DurDeb.Airbg_tiPerHiDebDef_C DDRC_DurDeb.Airbg_tiPerdRangeDebOk_C DDRC_DurDeb.Airbg_tiPerdRangeDebDef_C DFC_CtlMsk2.DFC_AbgHiSigFlt_C DFC_CtlMsk2.DFC_AbgIntPatFlt_C DFC_CtlMsk2.DFC_AbgLoSigFlt_C DFC_CtlMsk2.DFC_AbgUnkwnErrSigFlt_C DFC_CtlMsk2.DFC_AirbgPerHi_C DFC_CtlMsk2.DFC_AirbgPerdRngFlt_C DFC_CtlMsk2.DFC_CrashEveOcc_C DFC_DisblMsk2.DFC_AbgHiSigFlt_C DFC_DisblMsk2.DFC_AbgIntPatFlt_C DFC_DisblMsk2.DFC_AbgLoSigFlt_C DFC_DisblMsk2.DFC_AbgUnkwnErrSigFlt_C DFC_DisblMsk2.DFC_AirbgPerHi_C DFC_DisblMsk2.DFC_AirbgPerdRngFlt_C DFC_DisblMsk2.DFC_CrashEveOcc_C /end DEF_CHARACTERISTIC
 /begin IN_MEASUREMENT BattU_u MoFEmgOff_stPWMCrashDeploy T15_st /end IN_MEASUREMENT
 /begin OUT_MEASUREMENT Airbg_ctPwmPerd Airbg_rPwmInpRat Airbg_stPwm Airbg_stPwmInpSig Airbg_tiPwmInpHiOnDurn Airbg_tiPwmInpPerd DDRC_St.DFC_AbgHiSigFlt DDRC_St.DFC_AbgIntPatFlt DDRC_St.DFC_AbgLoSigFlt DDRC_St.DFC_AbgUnkwnErrSigFlt DDRC_St.DFC_AirbgPerHi DDRC_St.DFC_AirbgPerdRngFlt DDRC_St.DFC_CrashEveOcc DFC_st.DFC_AbgHiSigFlt DFC_st.DFC_AbgIntPatFlt DFC_st.DFC_AbgLoSigFlt DFC_st.DFC_AbgUnkwnErrSigFlt DFC_st.DFC_AirbgPerHi DFC_st.DFC_AirbgPerdRngFlt DFC_st.DFC_CrashEveOcc DINH_nrActvInhReas.FId_AirbgPwmSrcErr DINH_stFId.FId_AirbgPwmSrcErr /end OUT_MEASUREMENT
 /begin LOC_MEASUREMENT Airbg_flgDycCrashDeploy Airbg_flgDycCrashNotOk Airbg_flgDycCrashOk Airbg_rDftPwmInpRat Airbg_rPwmInpRatPrevVld Airbg_stDlyPWMCalc Airbg_tiDftPwmInpHiOnDurn Airbg_tiPwmInpPerdPrevVld flgCrashDeploy /end LOC_MEASUREMENT
 FUNCTION_VERSION "27.6.0" /end FUNCTION
/begin FUNCTION Airbg_VD "12.11.1_1.0.0Airbag and anti-roll bar"
 /begin DEF_CHARACTERISTIC Airbg_CrashDeploy_ATS_ATS.LimitTypeMsk_C Airbg_CrashDeploy_ATS_ATS.CnvNorm_C Airbg_CrashDeploy_ATS_ATS.LowLim_C Airbg_CrashDeploy_ATS_ATS.UpLim_C Airbg_CrashDeploy_ATS_ATS.CnvFac_C Airbg_CrashDeploy_ATS_ATS.CnvOfs_C Airbg_CrashDeploy_ATS_ATS.DfltVal_C Airbg_swtCanHiPrio_C Airbg_SwtCrashSel_C Airbg_swtEnaTestDeploymt_C Airbg_swtEol_C Airbg_swtErrDft_C Airbg_swtMnrCrashEna_C Airbg_swtTestDeploymt_C Airbg_tiComCrashDeploy_C Airbg_tiComMnrCrashDeploy_C Airbg_tiT15OnDly_C DDRC_DurDeb.Airbg_tiAirbgCanHWPlausDebOk_C DDRC_DurDeb.Airbg_tiAirbgCanHWPlausDebDef_C DDRC_DurDeb.Airbg_tiAirbgHWCanPlausDebOk_C DDRC_DurDeb.Airbg_tiAirbgHWCanPlausDebDef_C DDRC_DurDeb.Airbg_tiImpactDebOk_C DDRC_DurDeb.Airbg_tiImpactDebDef_C DDRC_DurDeb.Airbg_tiImpactMinorDebOk_C DDRC_DurDeb.Airbg_tiImpactMinorDebDef_C DFC_CtlMsk2.DFC_Airbg_C DFC_CtlMsk2.DFC_AirbgCanHWPlaus_C DFC_CtlMsk2.DFC_AirbgHWCanPlaus_C DFC_CtlMsk2.DFC_AirbgMnr_C DFC_DisblMsk2.DFC_Airbg_C DFC_DisblMsk2.DFC_AirbgCanHWPlaus_C DFC_DisblMsk2.DFC_AirbgHWCanPlaus_C DFC_DisblMsk2.DFC_AirbgMnr_C /end DEF_CHARACTERISTIC
 /begin IN_MEASUREMENT AirBgECU_stAirBg Airbg_stPwm T15_st VehV_v /end IN_MEASUREMENT
 /begin OUT_MEASUREMENT Airbg_st Airbg_stCrash Airbg_stCrashInfo DDRC_St.DFC_Airbg DDRC_St.DFC_AirbgCanHWPlaus DDRC_St.DFC_AirbgHWCanPlaus DDRC_St.DFC_AirbgMnr DFC_st.DFC_Airbg DFC_st.DFC_AirbgCanHWPlaus DFC_st.DFC_AirbgHWCanPlaus DFC_st.DFC_AirbgMnr DINH_nrActvInhReas.FId_AirbgAVSstCrash DINH_nrActvInhReas.FId_AirbgCan DINH_nrActvInhReas.FId_AirbgHw DINH_nrActvInhReas.FId_AirbgInpSigErr DINH_nrActvInhReas.FId_AirbgPWMErr DINH_stFId.FId_AirbgAVSstCrash DINH_stFId.FId_AirbgCan DINH_stFId.FId_AirbgHw DINH_stFId.FId_AirbgInpSigErr DINH_stFId.FId_AirbgPWMErr /end OUT_MEASUREMENT
 /begin LOC_MEASUREMENT Aibg_stMnrCanDly Airbg_flgEepWriteLstFCO Airbg_flgFCO Airbg_flgLstDrvgCycFCO Airbg_stCanDly Airbg_stCrashAVS Airbg_stDlyT15TOn Airbg_stEepOrderLstFCO Airbg_stEepWriteLstFCO Airbg_stMoCrash Airbg_stPWMCrashDeploy /end LOC_MEASUREMENT
 FUNCTION_VERSION "12.11.1_1.0.0" /end FUNCTION
/begin FUNCTION APP_ADCRead "1.6.0     Device driver for accelerator pedal signals" /begin REF_CHARACTERISTIC APP_swtCfg_CW /end REF_CHARACTERISTIC /begin IN_MEASUREMENT MoCADC_stMsg /end IN_MEASUREMENT
 /begin OUT_MEASUREMENT APP_uRaw1ADC APP_uRaw1ADCRead APP_uRaw2ADC APP_uRaw2ADCRead /end OUT_MEASUREMENT
 FUNCTION_VERSION "1.6.0" /end FUNCTION
/begin FUNCTION APP_ChkSig "8.9.0     Acceleration Pedal Position error reaction"
 /begin DEF_CHARACTERISTIC APP_drLimNeg_C APP_drLimpMax_C APP_drLimPos_C APP_rLimpMax_C APP_tiAliveDebLoHi_C /end DEF_CHARACTERISTIC
 /begin REF_CHARACTERISTIC APP_swtCfg_CW /end REF_CHARACTERISTIC
 /begin IN_MEASUREMENT AccPed_rVirtZrPnt APP_stSigSrc Brk_st MoFAPP_stAPPMsg /end IN_MEASUREMENT
 /begin LOC_MEASUREMENT APP_bAlive APP_rChk APP_rUnLim /end LOC_MEASUREMENT
 FUNCTION_VERSION "8.9.0" /end FUNCTION
/begin FUNCTION APP_DD1 "7.15.0    Acceleration Pedal Position Device Driver Sensor 1"
 /begin DEF_CHARACTERISTIC APP_flgT15HealEnad_C APP_uRaw1SRCHigh_C APP_uRaw1SRCLow_C DFC_CtlMsk2.DFC_SRCHighAPP1_C DFC_CtlMsk2.DFC_SRCLowAPP1_C DFC_DisblMsk2.DFC_SRCHighAPP1_C DFC_DisblMsk2.DFC_SRCLowAPP1_C /end DEF_CHARACTERISTIC
 /begin IN_MEASUREMENT APP_bT15Deb APP_tiSRCHigh1DebDef APP_tiSRCHigh1DebOk APP_tiSRCLow1DebDef APP_tiSRCLow1DebOk MoCADC_stMsg T15_st /end IN_MEASUREMENT
 /begin OUT_MEASUREMENT APP_bAPP1FinalDef APP_bAPP1ProvDef APP_bSRCHigh1 APP_bSRCHigh1Deb APP_bSRCLow1 APP_bSRCLow1Deb DFC_st.DFC_SRCHighAPP1 DFC_st.DFC_SRCLowAPP1 DINH_nrActvInhReas.FId_APP1SigPath DINH_stFId.FId_APP1SigPath /end OUT_MEASUREMENT
 FUNCTION_VERSION "7.15.0" /end FUNCTION
/begin FUNCTION APP_DD2 "7.16.0    Acceleration Pedal Position Device Driver Sensor 2"
 /begin DEF_CHARACTERISTIC APP_uRaw2SRCHigh_C APP_uRaw2SRCLow_C DFC_CtlMsk2.DFC_SRCHighAPP2_C DFC_CtlMsk2.DFC_SRCLowAPP2_C DFC_DisblMsk2.DFC_SRCHighAPP2_C DFC_DisblMsk2.DFC_SRCLowAPP2_C /end DEF_CHARACTERISTIC
 /begin REF_CHARACTERISTIC APP_flgT15HealEnad_C /end REF_CHARACTERISTIC
 /begin IN_MEASUREMENT APP_bT15Deb APP_tiSRCHigh2DebDef APP_tiSRCHigh2DebOk APP_tiSRCLow2DebDef APP_tiSRCLow2DebOk MoCADC_stMsg T15_st /end IN_MEASUREMENT
 /begin OUT_MEASUREMENT APP_bAPP2FinalDef APP_bAPP2ProvDef APP_bSRCHigh2 APP_bSRCHigh2Deb APP_bSRCLow2 APP_bSRCLow2Deb DFC_st.DFC_SRCHighAPP2 DFC_st.DFC_SRCLowAPP2 DINH_nrActvInhReas.FId_APP2SigPath DINH_stFId.FId_APP2SigPath /end OUT_MEASUREMENT
 FUNCTION_VERSION "7.16.0" /end FUNCTION
/begin FUNCTION APP_Flt "5.5.0     Acceleration Pedal Filter"
 /begin DEF_CHARACTERISTIC APP_rThresFltLowNeg_C APP_rThresFltLowPos_C APP_rThresFltMidNeg_C APP_rThresFltMidPos_C APP_tiLowNegPT1_C APP_tiLowPosPT1_C APP_tiMidNegPT1_C APP_tiMidPosPT1_C APP_tiUppNegPT1_C APP_tiUppPosPT1_C /end DEF_CHARACTERISTIC
 /begin REF_CHARACTERISTIC APP_swtCfg_CW /end REF_CHARACTERISTIC
 /begin IN_MEASUREMENT APP_stSigSrc /end IN_MEASUREMENT
 /begin LOC_MEASUREMENT APP_rFlt /end LOC_MEASUREMENT
 FUNCTION_VERSION "5.5.0" /end FUNCTION
/begin FUNCTION APP_Kickdown "7.3.0     Acceleration Pedal Position Kickdown" /begin DEF_CHARACTERISTIC APP_uKDHighAPP_C APP_uKDLowAPP_C /end DEF_CHARACTERISTIC /begin REF_CHARACTERISTIC APP_swtCfg_CW /end REF_CHARACTERISTIC /begin IN_MEASUREMENT APP_stSigSrc /end IN_MEASUREMENT /begin OUT_MEASUREMENT APP_stKD /end OUT_MEASUREMENT /begin LOC_MEASUREMENT APP_bKDInfo /end LOC_MEASUREMENT FUNCTION_VERSION "7.3.0" /end FUNCTION
/begin FUNCTION APP_Plaus12 "6.7.0     Acceleration Pedal Position Plausibility"
 /begin DEF_CHARACTERISTIC APP_uSyncMin_C APP_uSync_CUR DFC_CtlMsk2.DFC_SyncAPP_C DFC_DisblMsk2.DFC_SyncAPP_C /end DEF_CHARACTERISTIC
 /begin REF_CHARACTERISTIC APP_dRawSigFac_C APP_flgT15HealEnad_C APP_swtCfg_CW APP_tiPlaAPP12DebDef_C APP_tiPlaAPP12DebOk_C /end REF_CHARACTERISTIC
 /begin IN_MEASUREMENT APP_bAPP1FinalDef APP_bAPP1ProvDef APP_bAPP2FinalDef APP_bAPP2ProvDef APP_bT15Deb T15_st /end IN_MEASUREMENT
 /begin OUT_MEASUREMENT APP_bSync APP_bSyncDeb DFC_st.DFC_SyncAPP /end OUT_MEASUREMENT
 /begin LOC_MEASUREMENT APP_bSyncChkOld APP_uDiff APP_uDiffMax APP_uMin12half /end LOC_MEASUREMENT
 FUNCTION_VERSION "6.7.0" /end FUNCTION
/begin FUNCTION APP_PlausBrk "6.16.0    Acceleration Pedal Position Brake Plausibility"
 /begin DEF_CHARACTERISTIC APP_drUnFltLim_C APP_rUnFltPlausBrkMax_C APP_swtBrkStRedOff_C APP_swtExtIntvSel_C APP_tiGradCondDebHiLo_C APP_tiGradCondDebLoHi_C APP_tiPlaBrkActvtDeb_C APP_tiPlaBrkDeactvtDeb_C APP_vLim_C /end DEF_CHARACTERISTIC
 /begin REF_CHARACTERISTIC APP_swtCfg_CW /end REF_CHARACTERISTIC
 /begin IN_MEASUREMENT Brk_st Brk_stMn Brk_stRed CoPTEv_stTqLimd MoFAccr_flgPlausBrkDetdMsg VehV_v /end IN_MEASUREMENT
 /begin OUT_MEASUREMENT APP_bPlaBrk APP_flgHiGrdt DINH_nrActvInhReas.FId_APPBrkErr DINH_nrActvInhReas.FId_APPVehVErr DINH_stFId.FId_APPBrkErr DINH_stFId.FId_APPVehVErr /end OUT_MEASUREMENT
 /begin LOC_MEASUREMENT APP_bBrkActv APP_flgBrkPlausyRst APP_flgIdlPosn APP_flgNoExtIntv APP_flgPanicReactn APP_flgPlausyBrkEnaCdn APP_flgPlausyBrkFinal APP_flgPlausyBrkFltCdn /end LOC_MEASUREMENT
 FUNCTION_VERSION "6.16.0" /end FUNCTION
/begin FUNCTION APP_SelSig "6.11.0    Acceleration Pedal Position Signal Selection" /begin DEF_CHARACTERISTIC APP_duLimErrPos_C APP_uRaw2Offset_C /end DEF_CHARACTERISTIC /begin REF_CHARACTERISTIC APP_dRawSigFac_C APP_swtCfg_CW /end REF_CHARACTERISTIC
 /begin IN_MEASUREMENT APP_bAPP1FinalDef APP_bAPP1ProvDef APP_bAPP2FinalDef APP_bAPP2ProvDef APP_bSync APP_bSyncDeb APP_uVirtZrPnt MoFAccr_stLimpMsg /end IN_MEASUREMENT
 /begin OUT_MEASUREMENT APP_stSigSrc /end OUT_MEASUREMENT
 /begin LOC_MEASUREMENT APP_bTempErr APP_uRaw APP_uRawPre /end LOC_MEASUREMENT
 FUNCTION_VERSION "6.11.0" /end FUNCTION
/begin FUNCTION APP_UnJit "1.3.0     Unjitter function" /begin DEF_CHARACTERISTIC APP_uJitter_C APP_uPreUnJitter1_C APP_uPreUnJitter2_C /end DEF_CHARACTERISTIC /begin REF_CHARACTERISTIC APP_swtCfg_CW /end REF_CHARACTERISTIC FUNCTION_VERSION "1.3.0" /end FUNCTION
/begin FUNCTION APP_VD "7.27.0    Acceleration Pedal Position Virtual Device"
 /begin DEF_CHARACTERISTIC APP_dRawSigFac_C APP_drLinRmp_C APP_swtCfg_CW APP_tiPlaAPP12DebDef_C APP_tiPlaAPP12DebOk_C APP_tiSRCHigh1DebDef_C APP_tiSRCHigh1DebOk_C APP_tiSRCHigh2DebDef_C APP_tiSRCHigh2DebOk_C APP_tiSRCLow1DebDef_C APP_tiSRCLow1DebOk_C APP_tiSRCLow2DebDef_C APP_tiSRCLow2DebOk_C APP_uRaw1Def_C APP_uRaw2Def_C APP_uRawFullLdLimp_C APP_uRawFullLd_C APP_uRawIdlLimp_C APP_uRawIdl_C APP_uSply_C DFC_CtlMsk2.DFC_AppAllSnsrDfct_C DFC_DisblMsk2.DFC_AppAllSnsrDfct_C /end DEF_CHARACTERISTIC
 /begin IN_MEASUREMENT AccPed_rVirtZrPnt APP_bAPP1FinalDef APP_bAPP1ProvDef APP_bAPP2FinalDef APP_bAPP2ProvDef APP_stSigSrc APP_uRaw1ADC APP_uRaw2ADC T15_st /end IN_MEASUREMENT
 /begin OUT_MEASUREMENT APP_bT15Deb APP_dr APP_drUnFlt APP_r APP_rOBDPID5A APP_rUnFlt APP_tiSRCHigh1DebDef APP_tiSRCHigh1DebOk APP_tiSRCHigh2DebDef APP_tiSRCHigh2DebOk APP_tiSRCLow1DebDef APP_tiSRCLow1DebOk APP_tiSRCLow2DebDef APP_tiSRCLow2DebOk APP_uRaw1 APP_uRaw1unLim APP_uRaw2 APP_uRaw2unLim APP_uVirtZrPnt DFC_st.DFC_AppAllSnsrDfct /end OUT_MEASUREMENT
 /begin LOC_MEASUREMENT APP_rLinRmp APP_uPreUnJit1 APP_uPreUnJit2 APP_uRaw1Old APP_uRaw2Old APP_uUnJit /end LOC_MEASUREMENT
 FUNCTION_VERSION "7.27.0" /end FUNCTION
/begin FUNCTION ATSExtd_Std "30000.0.0 Handling of actuator test demands with diagnostics extended" FUNCTION_VERSION "30000.0.0" /end FUNCTION
/*********** End of merged COMPU_METHOD blocks ***********/
/begin COMPU_METHOD Acc "" RAT_FUNC "%6.5" "m/s^2" COEFFS 0 1000 0 0 0 1 /end COMPU_METHOD
/begin COMPU_METHOD AcExtChrgrCtrl_StMac_sm_VERB "" TAB_VERB "%6.3" "" COMPU_TAB_REF AcExtChrgrCtrl_StMac_sm_VERB /end COMPU_METHOD
/begin COMPU_VTAB AcExtChrgrCtrl_StMac_sm_VERB "" TAB_VERB 14 0 "INI" 1 "ChrgnLoop" 10 "StrtEvln" 11 "Chrgn" 12 "Finsh" 13 "Prep" 2 "ChrgnRdy" 3 "ChrgnReq" 4 "CritErr" 5 "Finshd" 6 "PrepReq" 7 "Rstrt" 8 "Stopd" 9 "StopReq" /end COMPU_VTAB
/begin COMPU_METHOD AMPT_NOxRgn "" RAT_FUNC "%6.5" "g/s" COEFFS 0 2000 0 0 0 1 /end COMPU_METHOD
/begin COMPU_METHOD AMPT_SOx1 "" RAT_FUNC "%6.4" "mg/s" COEFFS 0 333.333333333333 0 0 0 1 /end COMPU_METHOD
/begin COMPU_METHOD AngleCrS "" RAT_FUNC "%6.4" "deg CrS" COEFFS 0 45.5111111111 0 0 0 1 /end COMPU_METHOD
/begin COMPU_METHOD AngleIndexCpp "" RAT_FUNC "%6.2" "AgCA" COEFFS 0 -1 180 0 0 1 /end COMPU_METHOD
/begin COMPU_METHOD AngleStWhl "" RAT_FUNC "%6.4" "deg StWhl" COEFFS 0 32 0 0 0 1 /end COMPU_METHOD
/begin COMPU_METHOD AngleVelStWhl "" RAT_FUNC "%6.4" "deg StWhl/s" COEFFS 0 32 0 0 0 1 /end COMPU_METHOD
/begin COMPU_METHOD APPVIRTZRPNTENAD_SC_Compu "" TAB_VERB "%6.3" "" COMPU_TAB_REF APPVIRTZRPNTENAD_SC_Compu /end COMPU_METHOD
/begin COMPU_VTAB APPVIRTZRPNTENAD_SC_Compu "" TAB_VERB 2 0 "False" 1 "True" /end COMPU_VTAB
/begin COMPU_METHOD APP_CHN1_SSPMONNUM_SY_Compu "" TAB_VERB "%6.3" "" COMPU_TAB_REF APP_CHN1_SSPMONNUM_SY_Compu /end COMPU_METHOD
/begin COMPU_VTAB APP_CHN1_SSPMONNUM_SY_Compu "" TAB_VERB 4 0 "NOTUSED" 1 "SSpMon1" 2 "SSpMon2" 3 "SSpMon3" /end COMPU_VTAB
/begin COMPU_METHOD APP_CHN2_SSPMONNUM_SY_Compu "" TAB_VERB "%6.3" "" COMPU_TAB_REF APP_CHN2_SSPMONNUM_SY_Compu /end COMPU_METHOD
/begin COMPU_VTAB APP_CHN2_SSPMONNUM_SY_Compu "" TAB_VERB 4 0 "NOTUSED" 1 "SSpMon1" 2 "SSpMon2" 3 "SSpMon3" /end COMPU_VTAB
/begin COMPU_METHOD APP_ENADFCPLAUSBRK_SY_Compu "" TAB_VERB "%6.3" "" COMPU_TAB_REF APP_ENADFCPLAUSBRK_SY_Compu /end COMPU_METHOD
/begin COMPU_VTAB APP_ENADFCPLAUSBRK_SY_Compu "" TAB_VERB 2 0 "0" 1 "1" /end COMPU_VTAB
/begin COMPU_METHOD APP_ENAFLT_SY_Compu "" TAB_VERB "%6.3" "" COMPU_TAB_REF APP_ENAFLT_SY_Compu /end COMPU_METHOD
/begin COMPU_VTAB APP_ENAFLT_SY_Compu "" TAB_VERB 2 0 "0" 1 "1" /end COMPU_VTAB
/begin COMPU_METHOD APP_ENAUNJIT_SY_Compu "" TAB_VERB "%6.3" "" COMPU_TAB_REF APP_ENAUNJIT_SY_Compu /end COMPU_METHOD
/begin COMPU_VTAB APP_ENAUNJIT_SY_Compu "" TAB_VERB 2 0 "0" 1 "1" /end COMPU_VTAB
/begin COMPU_METHOD APP_PLAUSBRKMONAVL_SC_Compu "" TAB_VERB "%6.3" "" COMPU_TAB_REF APP_PLAUSBRKMONAVL_SC_Compu /end COMPU_METHOD
/begin COMPU_VTAB APP_PLAUSBRKMONAVL_SC_Compu "" TAB_VERB 2 0 "False" 1 "True" /end COMPU_VTAB
/begin COMPU_METHOD APP_SC_Compu "" RAT_FUNC "%6.2" "" COEFFS 0 1 0 0 0 1 /end COMPU_METHOD
/begin COMPU_METHOD APP_SWTPLAUSBRKSRC_SC_Compu "" TAB_VERB "%6.3" "" COMPU_TAB_REF APP_SWTPLAUSBRKSRC_SC_Compu /end COMPU_METHOD
/begin COMPU_VTAB APP_SWTPLAUSBRKSRC_SC_Compu "" TAB_VERB 2 0 "0" 1 "1" /end COMPU_VTAB
/begin COMPU_METHOD ARBLD_SC_Compu "" TAB_VERB "%6.3" "" COMPU_TAB_REF ARBLD_SC_Compu /end COMPU_METHOD
/begin COMPU_VTAB ARBLD_SC_Compu "" TAB_VERB 4 0 "NonAR" 1 "PCLT" 2 "PBL" 3 "PBS" /end COMPU_VTAB
/begin COMPU_METHOD Area2EffGrad "" RAT_FUNC "%6.4" "1/(cm^2*s)" COEFFS 0 100 0 0 0 1 /end COMPU_METHOD
/begin COMPU_METHOD Area_cm2 "" RAT_FUNC "%6.5" "cm*cm" COEFFS 0 1000 0 0 0 1 /end COMPU_METHOD
/begin COMPU_METHOD Area_cm2_float "" RAT_FUNC "%6.2" "cm*cm" COEFFS 0 1 0 0 0 1 /end COMPU_METHOD
/begin COMPU_METHOD Area_cm2_Low "" RAT_FUNC "%6.4" "cm*cm" COEFFS 0 250 0 0 0 1 /end COMPU_METHOD
/begin COMPU_METHOD ARVERS_SC_Compu "" TAB_VERB "%6.3" "" COMPU_TAB_REF ARVERS_SC_Compu /end COMPU_METHOD
/begin COMPU_VTAB ARVERS_SC_Compu "" TAB_VERB 4 0 "0" 1 "1" 2 "2" 3 "3" /end COMPU_VTAB
/begin COMPU_METHOD AshEGMassPerTime "" RAT_FUNC "%6.5" "mg/s" COEFFS 0 2000 0 0 0 1 /end COMPU_METHOD
/begin COMPU_METHOD AshMassPerTime "" RAT_FUNC "%6.4" "mg/s" COEFFS 0 100 0 0 0 1 /end COMPU_METHOD
/begin COMPU_METHOD AshMs_g_p0q1_COMPU "" RAT_FUNC "%6.3" "g" COEFFS 0 10 0 0 0 1 /end COMPU_METHOD
/begin COMPU_METHOD AshMs_mg_p0q0016_COMPU "" RAT_FUNC "%6.4" "mg" COEFFS 0 625 0 0 0 1 /end COMPU_METHOD
/begin COMPU_METHOD ASModPrcPerSec_COMPU "" RAT_FUNC "%6.3" "%/s" COEFFS 0 1.6384 0 0 0 1 /end COMPU_METHOD
/begin COMPU_METHOD ATNMSPRKG_SC_Compu "" TAB_VERB "%6.3" "" COMPU_TAB_REF ATNMSPRKG_SC_Compu /end COMPU_METHOD
/begin COMPU_VTAB ATNMSPRKG_SC_Compu "" TAB_VERB 2 0 "disabled" 1 "enabled" /end COMPU_VTAB
/begin COMPU_METHOD ATS_BRK_APP_SC_Compu "" TAB_VERB "%6.3" "" COMPU_TAB_REF ATS_BRK_APP_SC_Compu /end COMPU_METHOD
/begin COMPU_VTAB ATS_BRK_APP_SC_Compu "" TAB_VERB 2 0 "False" 1 "True" /end COMPU_VTAB
/begin COMPU_METHOD BATTSENS_SY_Compu "" TAB_VERB "%6.3" "" COMPU_TAB_REF BATTSENS_SY_Compu /end COMPU_METHOD
/begin COMPU_VTAB BATTSENS_SY_Compu "" TAB_VERB 2 0 "False" 1 "True" /end COMPU_VTAB
/begin COMPU_METHOD BIDEV_PASSDOORSWTIFTYP_SC_Compu "" TAB_VERB "%6.3" "" COMPU_TAB_REF BIDEV_PASSDOORSWTIFTYP_SC_Compu /end COMPU_METHOD
/begin COMPU_VTAB BIDEV_PASSDOORSWTIFTYP_SC_Compu "" TAB_VERB 7 0 "SWT_NOT_AVL" 1 "DIG_PIN" 2 "ADC_PIN" 3 "MISC" 4 "BUS_SYS" 5 "BUS_SYS_AND_DIG_PIN" 6 "BUS_SYS_AND_ADC_PIN" /end COMPU_VTAB
/begin COMPU_METHOD BIDEV_POSTDRVLAMP_SC_Compu "" TAB_VERB "%6.3" "" COMPU_TAB_REF BIDEV_POSTDRVLAMP_SC_Compu /end COMPU_METHOD
/begin COMPU_VTAB BIDEV_POSTDRVLAMP_SC_Compu "" TAB_VERB 2 0 "Disable" 1 "Enable" /end COMPU_VTAB
/begin COMPU_METHOD BIDEV_WAKEUPCHRGR_SC_Compu "" TAB_VERB "%6.3" "" COMPU_TAB_REF BIDEV_WAKEUPCHRGR_SC_Compu /end COMPU_METHOD
/begin COMPU_VTAB BIDEV_WAKEUPCHRGR_SC_Compu "" TAB_VERB 2 0 "False" 1 "True" /end COMPU_VTAB
/begin COMPU_METHOD BLOWRIFTYP_SC_Compu "" TAB_VERB "%6.3" "" COMPU_TAB_REF BLOWRIFTYP_SC_Compu /end COMPU_METHOD
/begin COMPU_VTAB BLOWRIFTYP_SC_Compu "" TAB_VERB 7 0 "BLOWRIFTYP_NON" 1 "BLOWRIFTYP_DIG" 2 "BLOWRIFTYP_ADC" 3 "BLOWRIFTYP_MISC" 4 "BLOWRIFTYP_BUS" 5 "BLOWRIFTYP_BUS_DIG" 6 "BLOWRIFTYP_BUS_ADC" /end COMPU_VTAB
/begin COMPU_METHOD BRKBSTP2_TYPAVL_SC_Compu "" TAB_VERB "%6.3" "" COMPU_TAB_REF BRKBSTP2_TYPAVL_SC_Compu /end COMPU_METHOD
/begin COMPU_VTAB BRKBSTP2_TYPAVL_SC_Compu "" TAB_VERB 2 0 "False" 1 "True" /end COMPU_VTAB
/begin COMPU_METHOD BRKBSTPMDLENA_SC_Compu "" TAB_VERB "%6.3" "" COMPU_TAB_REF BRKBSTPMDLENA_SC_Compu /end COMPU_METHOD
/begin COMPU_VTAB BRKBSTPMDLENA_SC_Compu "" TAB_VERB 2 0 "No brake booster pressure model" 1 "Brake booster pressure Model" /end COMPU_VTAB
/begin COMPU_METHOD BRKBSTPMP_ATS_SC_Compu "" TAB_VERB "%6.3" "" COMPU_TAB_REF BRKBSTPMP_ATS_SC_Compu /end COMPU_METHOD
/begin COMPU_VTAB BRKBSTPMP_ATS_SC_Compu "" TAB_VERB 2 0 "False" 1 "True" /end COMPU_VTAB
/begin COMPU_METHOD BRKBSTPMP_LFTICNTRENA_SC_Compu "" TAB_VERB "%6.3" "" COMPU_TAB_REF BRKBSTPMP_LFTICNTRENA_SC_Compu /end COMPU_METHOD
/begin COMPU_VTAB BRKBSTPMP_LFTICNTRENA_SC_Compu "" TAB_VERB 2 0 "False" 1 "True" /end COMPU_VTAB
/begin COMPU_METHOD BRKBSTPMP_OVLDPROTNENA_SC_Compu "" TAB_VERB "%6.3" "" COMPU_TAB_REF BRKBSTPMP_OVLDPROTNENA_SC_Compu /end COMPU_METHOD
/begin COMPU_VTAB BRKBSTPMP_OVLDPROTNENA_SC_Compu "" TAB_VERB 2 0 "False" 1 "True" /end COMPU_VTAB
/begin COMPU_METHOD B_TRUE "" TAB_VERB "%6.3" "" COMPU_TAB_REF B_TRUE /end COMPU_METHOD
/begin COMPU_VTAB B_TRUE "" TAB_VERB 2 0 "FALSE" 1 "TRUE" /end COMPU_VTAB
/begin COMPU_METHOD ChrgCtrl_stChrgn_VERB "" TAB_VERB "%6.3" "" COMPU_TAB_REF ChrgCtrl_stChrgn_VERB /end COMPU_METHOD
/begin COMPU_VTAB ChrgCtrl_stChrgn_VERB "" TAB_VERB 7 0 "CHRGCTRL_INI" 1 "CHRGCTRL_PREP" 2 "CHRGCTRL_CHRGN" 3 "CHRGCTRL_STOP" 4 "CHRGCTRL_FINSH" 5 "CHRGCTRL_CRITERR" 6 "CHRGCTRL_MNRERR" /end COMPU_VTAB
/begin COMPU_METHOD DDRCTime_ms "" RAT_FUNC "%6.1" "ms" COEFFS 0 1 0 0 0 10 /end COMPU_METHOD
/begin COMPU_METHOD DDRC_Ratio "" TAB_VERB "%6.3" "-" COMPU_TAB_REF DDRC_Ratio /end COMPU_METHOD
/begin COMPU_VTAB DDRC_Ratio "" TAB_VERB 4 1 "Ratio1" 2 "Ratio2" 3 "Ratio3" 4 "Ratio4" /end COMPU_VTAB
/begin COMPU_METHOD dez "" RAT_FUNC "%6.2" "" COEFFS 0 1 0 0 0 1 /end COMPU_METHOD
/begin COMPU_METHOD DFC_OneToOne "" RAT_FUNC "%6.2" "-" COEFFS 0 1 0 0 0 1 /end COMPU_METHOD
/begin COMPU_METHOD DFES_OneToOne "" RAT_FUNC "%6.2" "-" COEFFS 0 1 0 0 0 1 /end COMPU_METHOD
/begin COMPU_METHOD DINH_ct_Compu "" RAT_FUNC "%6.0" "" COEFFS 0 -1 4096 0 0 1 /end COMPU_METHOD
/begin COMPU_METHOD Fact "" RAT_FUNC "%6.5" "-" COEFFS 0 8192 0 0 0 1 /end COMPU_METHOD
/begin COMPU_METHOD Fact1000 "" RAT_FUNC "%6.5" "-" COEFFS 0 1000 0 0 0 1 /end COMPU_METHOD
/begin COMPU_METHOD OneToOne "" RAT_FUNC "%6.2" "-" COEFFS 0 1 0 0 0 1 /end COMPU_METHOD
/begin COMPU_METHOD Prc "" RAT_FUNC "%6.4" "%" COEFFS 0 81.92 0 0 0 1 /end COMPU_METHOD
/begin COMPU_METHOD PrcPerSec "" RAT_FUNC "%6.3" "%/s" COEFFS 0 1.6384 0 0 0 1 /end COMPU_METHOD
/begin COMPU_METHOD PresAC_hPa "" RAT_FUNC "%6.2" "hPa" COEFFS 0 0.5 0 0 0 1 /end COMPU_METHOD
/begin COMPU_METHOD q0p01_DegCgrd "" RAT_FUNC "%6.4" "Deg C" COEFFS 0 100 0 0 0 1 /end COMPU_METHOD
/begin COMPU_METHOD q0p01_K "" RAT_FUNC "%6.4" "K" COEFFS 0 100 0 0 0 1 /end COMPU_METHOD
/begin COMPU_METHOD q0p1_s "" RAT_FUNC "%6.3" "s" COEFFS 0 10 0 0 0 1 /end COMPU_METHOD
/begin COMPU_METHOD q1 "" RAT_FUNC "%6.2" "-" COEFFS 0 1 0 0 0 1 /end COMPU_METHOD
/begin COMPU_METHOD q10_DIV_min_s "" RAT_FUNC "%6.1" "1/(min*s)" COEFFS 0 1 0 0 0 10 /end COMPU_METHOD
/begin COMPU_METHOD q10_W "" RAT_FUNC "%6.1" "W" COEFFS 0 1 0 0 0 10 /end COMPU_METHOD
/begin COMPU_METHOD q1p52587Em5_DIV_s "" RAT_FUNC "%7.6" "1/s" COEFFS 0 65536 0 0 0 1 /end COMPU_METHOD
/begin COMPU_METHOD q1_DIV_min "" RAT_FUNC "%6.2" "1/min" COEFFS 0 1 0 0 0 1 /end COMPU_METHOD
/begin COMPU_METHOD q1_V "" RAT_FUNC "%6.2" "V" COEFFS 0 1 0 0 0 1 /end COMPU_METHOD
/begin COMPU_METHOD q2 "" RAT_FUNC "%6.2" "-" COEFFS 0 1 0 0 0 2 /end COMPU_METHOD
/begin COMPU_METHOD q20_W_1 "" RAT_FUNC "%6.1" "W" COEFFS 0 1 0 0 0 20 /end COMPU_METHOD
/begin COMPU_METHOD RBPtCel_fac_0p01_1 "" RAT_FUNC "%6.4" "-" COEFFS 0 100 0 0 0 1 /end COMPU_METHOD
/begin COMPU_METHOD RBPtCel_fac_3p921568em3_1 "" RAT_FUNC "%6.4" "-" COEFFS 0 255 0 0 0 1 /end COMPU_METHOD
/begin COMPU_METHOD RBPtCel_i_0p03125_1 "" RAT_FUNC "%6.4" "A" COEFFS 0 32 0 0 0 1 /end COMPU_METHOD
/begin COMPU_METHOD RBPtCel_n_10p0_1 "" RAT_FUNC "%6.1" "rpm" COEFFS 0 1 0 0 0 10 /end COMPU_METHOD
/begin COMPU_METHOD RBPtCel_Perc_0p5_1 "" RAT_FUNC "%6.3" "%" COEFFS 0 2 0 0 0 1 /end COMPU_METHOD
/begin COMPU_METHOD RBPtCel_pwr_10p0_1 "" RAT_FUNC "%6.1" "W" COEFFS 0 1 0 0 0 10 /end COMPU_METHOD
/begin COMPU_METHOD RBPtCel_pwr_25p0_1 "" RAT_FUNC "%6.1" "W" COEFFS 0 1 0 0 0 25 /end COMPU_METHOD
/begin COMPU_METHOD RBPtCel_p_1p0_1 "" RAT_FUNC "%6.2" "hPa" COEFFS 0 1 0 0 0 1 /end COMPU_METHOD
/begin COMPU_METHOD RBPtCel_p_1p525em5_1 "" RAT_FUNC "%7.6" "hPa" COEFFS 0 65536 0 0 0 1 /end COMPU_METHOD
/begin COMPU_METHOD RBPtCel_ti_0p01_1 "" RAT_FUNC "%6.4" "s" COEFFS 0 100 0 0 0 1 /end COMPU_METHOD
/begin COMPU_METHOD RBPtCel_u_0p03125_1 "" RAT_FUNC "%6.4" "V" COEFFS 0 32 0 0 0 1 /end COMPU_METHOD
/begin COMPU_METHOD RBPtCel_u_0p1_1 "" RAT_FUNC "%6.3" "V" COEFFS 0 10 0 0 0 1 /end COMPU_METHOD
/begin COMPU_METHOD rel_q0p01 "" RAT_FUNC "%6.4" "%" COEFFS 0 100 0 0 0 1 /end COMPU_METHOD
/begin COMPU_METHOD RmpVolt "" RAT_FUNC "%6.4" "mV/s" COEFFS 0 327.68 0 0 0 1 /end COMPU_METHOD
/begin COMPU_METHOD TimeDelay_s "" RAT_FUNC "%6.1" "s" COEFFS 0 0 1 0 0.00023283064365387 0 /end COMPU_METHOD
/begin COMPU_METHOD Time_Dt "" RAT_FUNC "%9.8" "s" COEFFS 0 1000000 0 0 0 1 /end COMPU_METHOD
/begin COMPU_METHOD Time_ms "" RAT_FUNC "%6.1" "ms" COEFFS 0 0.1 0 0 0 1 /end COMPU_METHOD
/begin COMPU_METHOD Time_PwmHigh "" RAT_FUNC "%6.4" "us" COEFFS 0 20 0 0 0 1 /end COMPU_METHOD
/begin COMPU_METHOD TrqPrp "" RAT_FUNC "%6.2" "Nm" COEFFS 0 0.625 0 0 0 1 /end COMPU_METHOD
/begin COMPU_METHOD TrqPrpHigh "" RAT_FUNC "%6.3" "Nm" COEFFS 0 10 0 0 0 1 /end COMPU_METHOD
/begin COMPU_METHOD Vel "" RAT_FUNC "%6.4" "km/h" COEFFS 0 100 0 0 0 1 /end COMPU_METHOD
/begin COMPU_METHOD Volt "" RAT_FUNC "%6.3" "mV" COEFFS 0 5 0 0 0 1 /end COMPU_METHOD
/begin COMPU_METHOD Volt_Batt "" RAT_FUNC "%6.1" "mV" COEFFS 0 0.05 0 0 0 1 /end COMPU_METHOD
/begin RECORD_LAYOUT RB_Curve_S16_S16 NO_AXIS_PTS_X 1 SWORD AXIS_PTS_X 2 SWORD INDEX_INCR DIRECT FNC_VALUES 3 SWORD COLUMN_DIR DIRECT /end RECORD_LAYOUT
/begin RECORD_LAYOUT RB_Curve_S16_U16_sao NO_AXIS_PTS_X 1 SWORD AXIS_PTS_X 2 SWORD INDEX_INCR DIRECT FNC_VALUES 3 UWORD COLUMN_DIR DIRECT STATIC_ADDRESS_OFFSETS /end RECORD_LAYOUT
/begin RECORD_LAYOUT RB_Curve_U8_U16_sao NO_AXIS_PTS_X 1 UBYTE AXIS_PTS_X 2 UBYTE INDEX_INCR DIRECT FNC_VALUES 3 UWORD COLUMN_DIR DIRECT STATIC_ADDRESS_OFFSETS /end RECORD_LAYOUT
/begin RECORD_LAYOUT RB_Map_S16S16_S16 NO_AXIS_PTS_X 1 SWORD NO_AXIS_PTS_Y 2 SWORD AXIS_PTS_X 3 SWORD INDEX_INCR DIRECT AXIS_PTS_Y 4 SWORD INDEX_INCR DIRECT FNC_VALUES 5 SWORD COLUMN_DIR DIRECT /end RECORD_LAYOUT
/begin RECORD_LAYOUT RB_Map_S16U16_S16_sao NO_AXIS_PTS_X 1 SWORD NO_AXIS_PTS_Y 2 SWORD AXIS_PTS_X 3 SWORD INDEX_INCR DIRECT AXIS_PTS_Y 4 UWORD INDEX_INCR DIRECT FNC_VALUES 5 SWORD ROW_DIR DIRECT STATIC_ADDRESS_OFFSETS /end RECORD_LAYOUT
/begin RECORD_LAYOUT RB_Map_S16U8_S16_sao NO_AXIS_PTS_X 1 SWORD NO_AXIS_PTS_Y 2 SWORD AXIS_PTS_X 3 SWORD INDEX_INCR DIRECT AXIS_PTS_Y 4 UBYTE INDEX_INCR DIRECT FNC_VALUES 5 SWORD COLUMN_DIR DIRECT STATIC_ADDRESS_OFFSETS /end RECORD_LAYOUT
/begin RECORD_LAYOUT RB_ValA_Wu8 FNC_VALUES 1 UBYTE COLUMN_DIR DIRECT /end RECORD_LAYOUT
/begin RECORD_LAYOUT RB_Val_Wboolean FNC_VALUES 1 UBYTE COLUMN_DIR DIRECT /end RECORD_LAYOUT
/begin RECORD_LAYOUT RB_Val_Wr32 FNC_VALUES 1 FLOAT32_IEEE COLUMN_DIR DIRECT /end RECORD_LAYOUT
/begin RECORD_LAYOUT RB_Val_Ws16 FNC_VALUES 1 SWORD COLUMN_DIR DIRECT /end RECORD_LAYOUT
/begin RECORD_LAYOUT RB_Val_Ws32 FNC_VALUES 1 SLONG COLUMN_DIR DIRECT /end RECORD_LAYOUT
/begin RECORD_LAYOUT RB_Val_Wu16 FNC_VALUES 1 UWORD COLUMN_DIR DIRECT /end RECORD_LAYOUT
/begin RECORD_LAYOUT RB_Val_Wu32 FNC_VALUES 1 ULONG COLUMN_DIR DIRECT /end RECORD_LAYOUT
/begin RECORD_LAYOUT RB_Val_Wu8 FNC_VALUES 1 UBYTE COLUMN_DIR DIRECT /end RECORD_LAYOUT
/begin RECORD_LAYOUT Val_Ws16 FNC_VALUES 1 SWORD COLUMN_DIR DIRECT /end RECORD_LAYOUT
/begin RECORD_LAYOUT Val_Ws32 FNC_VALUES 1 SLONG COLUMN_DIR DIRECT /end RECORD_LAYOUT
/begin RECORD_LAYOUT Val_Wu16 FNC_VALUES 1 UWORD COLUMN_DIR DIRECT /end RECORD_LAYOUT
/begin RECORD_LAYOUT Val_Wu8 FNC_VALUES 1 UBYTE COLUMN_DIR DIRECT /end RECORD_LAYOUT
/end MODULE
/end PROJECT

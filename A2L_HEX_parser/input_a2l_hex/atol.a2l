ASAP2_VERSION 1 70
/begin PROJECT MDG1C "VC1CP091_STLA_N_D061I3"
/begin HEADER "" VERSION "VC1CP091_STLA_N_D061I3" PROJECT_NO MDG1C /end HEADER
/begin MODULE DIM ""
/begin MOD_COMMON "" BYTE_ORDER MSB_LAST ALIGNMENT_BYTE 1 ALIGNMENT_WORD 2 ALIGNMENT_LONG 4 ALIGNMENT_INT64 4 ALIGNMENT_FLOAT32_IEEE 4 ALIGNMENT_FLOAT64_IEEE 4 DATA_SIZE 32 /end MOD_COMMON
/begin CHARACTERISTIC DDRC_DurDeb.EmWakeupSig_tiMonDFCDebOk_C "" VALUE 0x80240968 Val_Wu16 655350.0 DDRCTime_ms 0.00 655350.0 FORMAT "%8.1" /end CHARACTERISTIC
/begin CHARACTERISTIC DDRC_DurDeb.EmWakeupSig_tiMonDFCDebDef_C "" VALUE 0x8024096A Val_Wu16 655350.0 DDRCTime_ms 0.00 655350.0 FORMAT "%8.1" /end CHARACTERISTIC
/begin CHARACTERISTIC DDRC_DurDeb.Fan1_tiOLDebOk_C "" VALUE 0x8024096C Val_Wu16 655350.0 DDRCTime_ms 0.00 655350.0 FORMAT "%8.1" /end CHARACTERISTIC
/begin CHARACTERISTIC DDRC_DurDeb.Fan1_tiOLDebDef_C "" VALUE 0x8024096E Val_Wu16 655350.0 DDRCTime_ms 0.00 655350.0 FORMAT "%8.1" /end CHARACTERISTIC
/begin CHARACTERISTIC DDRC_DurDeb.Fan1_tiOvrTempDebOk_C "" VALUE 0x80240970 Val_Wu16 655350.0 DDRCTime_ms 0.00 655350.0 FORMAT "%8.1" /end CHARACTERISTIC
/begin CHARACTERISTIC DDRC_DurDeb.Fan1_tiOvrTempDebDef_C "" VALUE 0x80240972 Val_Wu16 655350.0 DDRCTime_ms 0.00 655350.0 FORMAT "%8.1" /end CHARACTERISTIC
/begin CHARACTERISTIC DDRC_DurDeb.Fan1_tiSCBDebOk_C "" VALUE 0x80240974 Val_Wu16 655350.0 DDRCTime_ms 0.00 655350.0 FORMAT "%8.1" /end CHARACTERISTIC
/begin CHARACTERISTIC DDRC_DurDeb.Fan1_tiSCBDebDef_C "" VALUE 0x80240976 Val_Wu16 655350.0 DDRCTime_ms 0.00 655350.0 FORMAT "%8.1" /end CHARACTERISTIC
/begin CHARACTERISTIC DDRC_DurDeb.FanSpd_tiSRCMinDebOk_C "" VALUE 0x80240978 Val_Wu16 655350.0 DDRCTime_ms 0.00 655350.0 FORMAT "%8.1" /end CHARACTERISTIC
/begin CHARACTERISTIC DDRC_DurDeb.FanSpd_tiSRCMinDebDef_C "" VALUE 0x8024097A Val_Wu16 655350.0 DDRCTime_ms 0.00 655350.0 FORMAT "%8.1" /end CHARACTERISTIC
/begin CHARACTERISTIC DDRC_DurDeb.Fan1_tiSCGDebOk_C "" VALUE 0x80240A20 Val_Wu16 655350.0 DDRCTime_ms 0.00 655350.0 FORMAT "%8.1" /end CHARACTERISTIC
/begin CHARACTERISTIC DDRC_DurDeb.Fan1_tiSCGDebDef_C "" VALUE 0x80240A22 Val_Wu16 655350.0 DDRCTime_ms 0.00 655350.0 FORMAT "%8.1" /end CHARACTERISTIC
/begin CHARACTERISTIC DDRC_DurDeb.FanSpd_tiSRCOpnDebOk_C "" VALUE 0x80240A2C Val_Wu16 655350.0 DDRCTime_ms 0.00 655350.0 FORMAT "%8.1" /end CHARACTERISTIC
/begin CHARACTERISTIC DDRC_DurDeb.FanSpd_tiSRCOpnDebDef_C "" VALUE 0x80240A2E Val_Wu16 655350.0 DDRCTime_ms 0.00 655350.0 FORMAT "%8.1" /end CHARACTERISTIC
/begin CHARACTERISTIC DDRC_DurDeb.ElTS_tiPtSysLimDrvErrDebOk_C "" VALUE 0x80240D10 Val_Wu16 655350.0 DDRCTime_ms 0.00 655350.0 FORMAT "%8.1" /end CHARACTERISTIC
/begin CHARACTERISTIC DDRC_DurDeb.ElTS_tiPtSysLimDrvErrDebDef_C "" VALUE 0x80240D12 Val_Wu16 655350.0 DDRCTime_ms 0.00 655350.0 FORMAT "%8.1" /end CHARACTERISTIC
/begin CHARACTERISTIC DDRC_DurDeb.ElTS_tiPtSysLimRgnErrDebOk_C "" VALUE 0x80240D14 Val_Wu16 655350.0 DDRCTime_ms 0.00 655350.0 FORMAT "%8.1" /end CHARACTERISTIC
/begin CHARACTERISTIC DDRC_DurDeb.ElTS_tiPtSysLimRgnErrDebDef_C "" VALUE 0x80240D16 Val_Wu16 655350.0 DDRCTime_ms 0.00 655350.0 FORMAT "%8.1" /end CHARACTERISTIC
/begin CHARACTERISTIC DDRC_DurDeb.PEnv_tiSigRngChkDebOk_C "" VALUE 0x80240D9C Val_Wu16 655350.0 DDRCTime_ms 0.00 655350.0 FORMAT "%8.1" /end CHARACTERISTIC
/begin CHARACTERISTIC DDRC_DurDeb.PEnv_tiSigRngChkDebDef_C "" VALUE 0x80240D9E Val_Wu16 655350.0 DDRCTime_ms 0.00 655350.0 FORMAT "%8.1" /end CHARACTERISTIC
/begin CHARACTERISTIC DDRC_DurDeb.ElM_tiActvDchaFltDebOk_C "" VALUE 0x802412A0 Val_Wu16 655350.0 DDRCTime_ms 0.00 655350.0 FORMAT "%8.1" /end CHARACTERISTIC
/begin CHARACTERISTIC DDRC_DurDeb.ElM_tiActvDchaFltDebDef_C "" VALUE 0x802412A2 Val_Wu16 655350.0 DDRCTime_ms 0.00 655350.0 FORMAT "%8.1" /end CHARACTERISTIC
/begin CHARACTERISTIC DDRC_DurDeb.ElM_tiImobAuthentDebOk_C "" VALUE 0x802412A8 Val_Wu16 655350.0 DDRCTime_ms 0.00 655350.0 FORMAT "%8.1" /end CHARACTERISTIC
/begin CHARACTERISTIC DDRC_DurDeb.ElM_tiImobAuthentDebDef_C "" VALUE 0x802412AA Val_Wu16 655350.0 DDRCTime_ms 0.00 655350.0 FORMAT "%8.1" /end CHARACTERISTIC
/begin CHARACTERISTIC DDRC_DurDeb.ElM_tiIsoMonFltDebOk_C "" VALUE 0x802412AC Val_Wu16 655350.0 DDRCTime_ms 0.00 655350.0 FORMAT "%8.1" /end CHARACTERISTIC
/begin CHARACTERISTIC DDRC_DurDeb.ElM_tiIsoMonFltDebDef_C "" VALUE 0x802412AE Val_Wu16 655350.0 DDRCTime_ms 0.00 655350.0 FORMAT "%8.1" /end CHARACTERISTIC
/begin CHARACTERISTIC DDRC_DurDeb.ElM_tiIvtrCooltTDebOk_C "" VALUE 0x802412B4 Val_Wu16 655350.0 DDRCTime_ms 0.00 655350.0 FORMAT "%8.1" /end CHARACTERISTIC
/begin CHARACTERISTIC DDRC_DurDeb.ElM_tiIvtrCooltTDebDef_C "" VALUE 0x802412B6 Val_Wu16 655350.0 DDRCTime_ms 0.00 655350.0 FORMAT "%8.1" /end CHARACTERISTIC
/begin CHARACTERISTIC DDRC_DurDeb.ElM_tiIvtrEmgyShtDwnDebOk_C "" VALUE 0x802412B8 Val_Wu16 655350.0 DDRCTime_ms 0.00 655350.0 FORMAT "%8.1" /end CHARACTERISTIC
/begin CHARACTERISTIC DDRC_DurDeb.ElM_tiIvtrEmgyShtDwnDebDef_C "" VALUE 0x802412BA Val_Wu16 655350.0 DDRCTime_ms 0.00 655350.0 FORMAT "%8.1" /end CHARACTERISTIC
/begin CHARACTERISTIC DDRC_DurDeb.ElM_tiIvtrFailrDebOk_C "" VALUE 0x802412BC Val_Wu16 655350.0 DDRCTime_ms 0.00 655350.0 FORMAT "%8.1" /end CHARACTERISTIC
/begin CHARACTERISTIC DDRC_DurDeb.ElM_tiIvtrFailrDebDef_C "" VALUE 0x802412BE Val_Wu16 655350.0 DDRCTime_ms 0.00 655350.0 FORMAT "%8.1" /end CHARACTERISTIC
/begin CHARACTERISTIC DDRC_DurDeb.ElM_tiIvtrIntlckDebOk_C "" VALUE 0x802412C0 Val_Wu16 655350.0 DDRCTime_ms 0.00 655350.0 FORMAT "%8.1" /end CHARACTERISTIC
/begin CHARACTERISTIC DDRC_DurDeb.ElM_tiIvtrIntlckDebDef_C "" VALUE 0x802412C2 Val_Wu16 655350.0 DDRCTime_ms 0.00 655350.0 FORMAT "%8.1" /end CHARACTERISTIC
/begin CHARACTERISTIC DDRC_DurDeb.ElM_tiIvtrTErrDebOk_C "" VALUE 0x802412C4 Val_Wu16 655350.0 DDRCTime_ms 0.00 655350.0 FORMAT "%8.1" /end CHARACTERISTIC
/begin CHARACTERISTIC DDRC_DurDeb.ElM_tiIvtrTErrDebDef_C "" VALUE 0x802412C6 Val_Wu16 655350.0 DDRCTime_ms 0.00 655350.0 FORMAT "%8.1" /end CHARACTERISTIC
/begin CHARACTERISTIC DDRC_DurDeb.ElM_tiPwrAuthnDebOk_C "" VALUE 0x802412D8 Val_Wu16 655350.0 DDRCTime_ms 0.00 655350.0 FORMAT "%8.1" /end CHARACTERISTIC
/begin CHARACTERISTIC DDRC_DurDeb.ElM_tiPwrAuthnDebDef_C "" VALUE 0x802412DA Val_Wu16 655350.0 DDRCTime_ms 0.00 655350.0 FORMAT "%8.1" /end CHARACTERISTIC
/begin CHARACTERISTIC DDRC_DurDeb.ElM_tiSpdErrDebOk_C "" VALUE 0x802412DC Val_Wu16 655350.0 DDRCTime_ms 0.00 655350.0 FORMAT "%8.1" /end CHARACTERISTIC
/begin CHARACTERISTIC DDRC_DurDeb.ElM_tiSpdErrDebDef_C "" VALUE 0x802412DE Val_Wu16 655350.0 DDRCTime_ms 0.00 655350.0 FORMAT "%8.1" /end CHARACTERISTIC
/begin CHARACTERISTIC DDRC_DurDeb.ElM_tiSvsDebOk_C "" VALUE 0x802412E0 Val_Wu16 655350.0 DDRCTime_ms 0.00 655350.0 FORMAT "%8.1" /end CHARACTERISTIC
/begin CHARACTERISTIC DDRC_DurDeb.ElM_tiSvsDebDef_C "" VALUE 0x802412E2 Val_Wu16 655350.0 DDRCTime_ms 0.00 655350.0 FORMAT "%8.1" /end CHARACTERISTIC
/begin CHARACTERISTIC DDRC_DurDeb.PEnv_tiVDDiagDebOk_C "" VALUE 0x802412E4 Val_Wu16 655350.0 DDRCTime_ms 0.00 655350.0 FORMAT "%8.1" /end CHARACTERISTIC
/begin CHARACTERISTIC DDRC_DurDeb.PEnv_tiVDDiagDebDef_C "" VALUE 0x802412E6 Val_Wu16 655350.0 DDRCTime_ms 0.00 655350.0 FORMAT "%8.1" /end CHARACTERISTIC
/begin CHARACTERISTIC DDRC_RatDeb.EmWakeupSig_tiMonDFCUDRat_C "" VALUE 0x80248A5E Val_Wu8 3.00000000000 DDRC_Ratio 1.00000000000 4.00000000000 FORMAT "%13.11" /end CHARACTERISTIC
/begin CHARACTERISTIC DDRC_RatDeb.Fan1_tiOLUDRat_C "" VALUE 0x80248A5F Val_Wu8 3.00000000000 DDRC_Ratio 1.00000000000 4.00000000000 FORMAT "%13.11" /end CHARACTERISTIC
/begin CHARACTERISTIC DDRC_RatDeb.Fan1_tiOvrTempUDRat_C "" VALUE 0x80248A60 Val_Wu8 3.00000000000 DDRC_Ratio 1.00000000000 4.00000000000 FORMAT "%13.11" /end CHARACTERISTIC
/begin CHARACTERISTIC DDRC_RatDeb.Fan1_tiSCBUDRat_C "" VALUE 0x80248A61 Val_Wu8 3.00000000000 DDRC_Ratio 1.00000000000 4.00000000000 FORMAT "%13.11" /end CHARACTERISTIC
/begin CHARACTERISTIC DDRC_RatDeb.FanSpd_tiSRCMinUDRat_C "" VALUE 0x80248A62 Val_Wu8 3.00000000000 DDRC_Ratio 1.00000000000 4.00000000000 FORMAT "%13.11" /end CHARACTERISTIC
/begin CHARACTERISTIC DDRC_RatDeb.Fan1_tiSCGUDRat_C "" VALUE 0x80248A8C Val_Wu8 3.00000000000 DDRC_Ratio 1.00000000000 4.00000000000 FORMAT "%13.11" /end CHARACTERISTIC
/begin CHARACTERISTIC DDRC_RatDeb.FanSpd_tiSRCOpnUDRat_C "" VALUE 0x80248A8F Val_Wu8 3.00000000000 DDRC_Ratio 1.00000000000 4.00000000000 FORMAT "%13.11" /end CHARACTERISTIC
/begin CHARACTERISTIC DFC_CtlMsk2.DFC_ElTSPtSysLimDrvErr_C "" VALUE 0x8024136A Val_Wu8 255.0 DFES_OneToOne 0.00 255.0 FORMAT "%5.1" /end CHARACTERISTIC
/begin CHARACTERISTIC DFC_CtlMsk2.DFC_ElTSPtSysLimRgnErr_C "" VALUE 0x8024136B Val_Wu8 255.0 DFES_OneToOne 0.00 255.0 FORMAT "%5.1" /end CHARACTERISTIC
/begin CHARACTERISTIC DFC_CtlMsk2.DFC_PEnvSigRngMax_C "" VALUE 0x80241393 Val_Wu8 255.0 DFES_OneToOne 0.00 255.0 FORMAT "%5.1" /end CHARACTERISTIC
/begin CHARACTERISTIC DFC_CtlMsk2.DFC_PEnvSigRngMin_C "" VALUE 0x80241394 Val_Wu8 255.0 DFES_OneToOne 0.00 255.0 FORMAT "%5.1" /end CHARACTERISTIC
/begin CHARACTERISTIC DFC_CtlMsk2.DFC_EmWakeupSigOL_C "" VALUE 0x80241514 Val_Wu8 255.0 DFES_OneToOne 0.00 255.0 FORMAT "%5.1" /end CHARACTERISTIC
/begin CHARACTERISTIC DFC_CtlMsk2.DFC_EmWakeupSigOvrTemp_C "" VALUE 0x80241515 Val_Wu8 255.0 DFES_OneToOne 0.00 255.0 FORMAT "%5.1" /end CHARACTERISTIC
/begin CHARACTERISTIC DFC_CtlMsk2.DFC_EmWakeupSigSCB_C "" VALUE 0x80241516 Val_Wu8 255.0 DFES_OneToOne 0.00 255.0 FORMAT "%5.1" /end CHARACTERISTIC
/begin CHARACTERISTIC DFC_CtlMsk2.DFC_EmWakeupSigSCG_C "" VALUE 0x80241517 Val_Wu8 255.0 DFES_OneToOne 0.00 255.0 FORMAT "%5.1" /end CHARACTERISTIC
/begin CHARACTERISTIC DFC_CtlMsk2.DFC_Fan1OL_C "" VALUE 0x80241518 Val_Wu8 255.0 DFES_OneToOne 0.00 255.0 FORMAT "%5.1" /end CHARACTERISTIC
/begin CHARACTERISTIC DFC_CtlMsk2.DFC_Fan1OvrTemp_C "" VALUE 0x80241519 Val_Wu8 255.0 DFES_OneToOne 0.00 255.0 FORMAT "%5.1" /end CHARACTERISTIC
/begin CHARACTERISTIC DFC_CtlMsk2.DFC_Fan1SCB_C "" VALUE 0x8024151A Val_Wu8 255.0 DFES_OneToOne 0.00 255.0 FORMAT "%5.1" /end CHARACTERISTIC
/begin CHARACTERISTIC DFC_CtlMsk2.DFC_FanSpdSRCMin_C "" VALUE 0x8024151D Val_Wu8 255.0 DFES_OneToOne 0.00 255.0 FORMAT "%5.1" /end CHARACTERISTIC
/begin CHARACTERISTIC DFC_CtlMsk2.DFC_Fan1SCG_C "" VALUE 0x80241545 Val_Wu8 255.0 DFES_OneToOne 0.00 255.0 FORMAT "%5.1" /end CHARACTERISTIC
/begin CHARACTERISTIC DFC_CtlMsk2.DFC_FanSpdSRCOpn_C "" VALUE 0x80241548 Val_Wu8 255.0 DFES_OneToOne 0.00 255.0 FORMAT "%5.1" /end CHARACTERISTIC
/begin CHARACTERISTIC DFC_CtlMsk2.DFC_ElMActvDchaFlt_C "" VALUE 0x8024157A Val_Wu8 255.0 DFES_OneToOne 0.00 255.0 FORMAT "%5.1" /end CHARACTERISTIC
/begin CHARACTERISTIC DFC_CtlMsk2.DFC_ElMImobAuthent_C "" VALUE 0x8024157C Val_Wu8 255.0 DFES_OneToOne 0.00 255.0 FORMAT "%5.1" /end CHARACTERISTIC
/begin CHARACTERISTIC DFC_CtlMsk2.DFC_ElMIsoMonFlt_C "" VALUE 0x8024157D Val_Wu8 255.0 DFES_OneToOne 0.00 255.0 FORMAT "%5.1" /end CHARACTERISTIC
/begin CHARACTERISTIC DFC_CtlMsk2.DFC_ElMIvtrCooltT01_C "" VALUE 0x8024157F Val_Wu8 255.0 DFES_OneToOne 0.00 255.0 FORMAT "%5.1" /end CHARACTERISTIC
/begin CHARACTERISTIC DFC_CtlMsk2.DFC_ElMIvtrEmgyShtDwn01_C "" VALUE 0x80241580 Val_Wu8 255.0 DFES_OneToOne 0.00 255.0 FORMAT "%5.1" /end CHARACTERISTIC
/begin CHARACTERISTIC DFC_CtlMsk2.DFC_ElMIvtrFailr01_C "" VALUE 0x80241581 Val_Wu8 255.0 DFES_OneToOne 0.00 255.0 FORMAT "%5.1" /end CHARACTERISTIC
/begin CHARACTERISTIC DFC_CtlMsk2.DFC_ElMIvtrIntlck01_C "" VALUE 0x80241582 Val_Wu8 255.0 DFES_OneToOne 0.00 255.0 FORMAT "%5.1" /end CHARACTERISTIC
/begin CHARACTERISTIC DFC_CtlMsk2.DFC_ElMIvtrTErr01_C "" VALUE 0x80241583 Val_Wu8 255.0 DFES_OneToOne 0.00 255.0 FORMAT "%5.1" /end CHARACTERISTIC
/begin CHARACTERISTIC DFC_CtlMsk2.DFC_ElMPwrAuthn_C "" VALUE 0x80241588 Val_Wu8 255.0 DFES_OneToOne 0.00 255.0 FORMAT "%5.1" /end CHARACTERISTIC
/begin CHARACTERISTIC DFC_CtlMsk2.DFC_ElMSpdErr01_C "" VALUE 0x80241589 Val_Wu8 255.0 DFES_OneToOne 0.00 255.0 FORMAT "%5.1" /end CHARACTERISTIC
/begin CHARACTERISTIC DFC_CtlMsk2.DFC_ElMSvs01_C "" VALUE 0x8024158A Val_Wu8 255.0 DFES_OneToOne 0.00 255.0 FORMAT "%5.1" /end CHARACTERISTIC
/begin CHARACTERISTIC DFC_CtlMsk2.DFC_PEnvCcMax_C "" VALUE 0x8024158B Val_Wu8 255.0 DFES_OneToOne 0.00 255.0 FORMAT "%5.1" /end CHARACTERISTIC
/begin CHARACTERISTIC DFC_CtlMsk2.DFC_PEnvCcMin_C "" VALUE 0x8024158C Val_Wu8 255.0 DFES_OneToOne 0.00 255.0 FORMAT "%5.1" /end CHARACTERISTIC
/begin CHARACTERISTIC DFC_CtlMsk2.DFC_PEnvRngChkMax_C "" VALUE 0x8024158D Val_Wu8 255.0 DFES_OneToOne 0.00 255.0 FORMAT "%5.1" /end CHARACTERISTIC
/begin CHARACTERISTIC DFC_CtlMsk2.DFC_PEnvRngChkMin_C "" VALUE 0x8024158E Val_Wu8 255.0 DFES_OneToOne 0.00 255.0 FORMAT "%5.1" /end CHARACTERISTIC
/begin CHARACTERISTIC DFC_CtlMsk2.DFC_PEnvSnsrPlaus_C "" VALUE 0x8024158F Val_Wu8 255.0 DFES_OneToOne 0.00 255.0 FORMAT "%5.1" /end CHARACTERISTIC
/begin CHARACTERISTIC DFC_CtlMsk2.DFC_FanSpdSRCMax_C "" VALUE 0x802415F3 Val_Wu8 255.0 DFES_OneToOne 0.00 255.0 FORMAT "%5.1" /end CHARACTERISTIC
/begin CHARACTERISTIC DFC_CtlMsk2.DFC_PUmax_C "" VALUE 0x8024169A Val_Wu8 255.0 DFES_OneToOne 0.00 255.0 FORMAT "%5.1" /end CHARACTERISTIC
/begin CHARACTERISTIC DFC_DisblMsk2.DFC_ElTSPtSysLimDrvErr_C "" VALUE 0x80248BBA Val_Wu16 65535.00 DFES_OneToOne 0.00 65535.00 FORMAT "%8.2" /end CHARACTERISTIC
/begin CHARACTERISTIC DFC_DisblMsk2.DFC_ElTSPtSysLimRgnErr_C "" VALUE 0x80248BBC Val_Wu16 65535.00 DFES_OneToOne 0.00 65535.00 FORMAT "%8.2" /end CHARACTERISTIC
/begin CHARACTERISTIC DFC_DisblMsk2.DFC_PEnvSigRngMax_C "" VALUE 0x80248C0C Val_Wu16 65535.00 DFES_OneToOne 0.00 65535.00 FORMAT "%8.2" /end CHARACTERISTIC
/begin CHARACTERISTIC DFC_DisblMsk2.DFC_PEnvSigRngMin_C "" VALUE 0x80248C0E Val_Wu16 65535.00 DFES_OneToOne 0.00 65535.00 FORMAT "%8.2" /end CHARACTERISTIC
/begin CHARACTERISTIC DFC_DisblMsk2.DFC_EmWakeupSigOL_C "" VALUE 0x80248F0E Val_Wu16 65535.00 DFES_OneToOne 0.00 65535.00 FORMAT "%8.2" /end CHARACTERISTIC
/begin CHARACTERISTIC DFC_DisblMsk2.DFC_EmWakeupSigOvrTemp_C "" VALUE 0x80248F10 Val_Wu16 65535.00 DFES_OneToOne 0.00 65535.00 FORMAT "%8.2" /end CHARACTERISTIC
/begin CHARACTERISTIC DFC_DisblMsk2.DFC_EmWakeupSigSCB_C "" VALUE 0x80248F12 Val_Wu16 65535.00 DFES_OneToOne 0.00 65535.00 FORMAT "%8.2" /end CHARACTERISTIC
/begin CHARACTERISTIC DFC_DisblMsk2.DFC_EmWakeupSigSCG_C "" VALUE 0x80248F14 Val_Wu16 65535.00 DFES_OneToOne 0.00 65535.00 FORMAT "%8.2" /end CHARACTERISTIC
/begin CHARACTERISTIC DFC_DisblMsk2.DFC_Fan1OL_C "" VALUE 0x80248F16 Val_Wu16 65535.00 DFES_OneToOne 0.00 65535.00 FORMAT "%8.2" /end CHARACTERISTIC
/begin CHARACTERISTIC DFC_DisblMsk2.DFC_Fan1OvrTemp_C "" VALUE 0x80248F18 Val_Wu16 65535.00 DFES_OneToOne 0.00 65535.00 FORMAT "%8.2" /end CHARACTERISTIC
/begin CHARACTERISTIC DFC_DisblMsk2.DFC_Fan1SCB_C "" VALUE 0x80248F1A Val_Wu16 65535.00 DFES_OneToOne 0.00 65535.00 FORMAT "%8.2" /end CHARACTERISTIC
/begin CHARACTERISTIC DFC_DisblMsk2.DFC_FanSpdSRCMin_C "" VALUE 0x80248F20 Val_Wu16 65535.00 DFES_OneToOne 0.00 65535.00 FORMAT "%8.2" /end CHARACTERISTIC
/begin CHARACTERISTIC DFC_DisblMsk2.DFC_Fan1SCG_C "" VALUE 0x80248F70 Val_Wu16 65535.00 DFES_OneToOne 0.00 65535.00 FORMAT "%8.2" /end CHARACTERISTIC
/begin CHARACTERISTIC DFC_DisblMsk2.DFC_FanSpdSRCOpn_C "" VALUE 0x80248F76 Val_Wu16 65535.00 DFES_OneToOne 0.00 65535.00 FORMAT "%8.2" /end CHARACTERISTIC
/begin CHARACTERISTIC DFC_DisblMsk2.DFC_ElMActvDchaFlt_C "" VALUE 0x80248FDA Val_Wu16 65535.00 DFES_OneToOne 0.00 65535.00 FORMAT "%8.2" /end CHARACTERISTIC
/begin CHARACTERISTIC DFC_DisblMsk2.DFC_ElMImobAuthent_C "" VALUE 0x80248FDE Val_Wu16 65535.00 DFES_OneToOne 0.00 65535.00 FORMAT "%8.2" /end CHARACTERISTIC
/begin CHARACTERISTIC DFC_DisblMsk2.DFC_ElMIsoMonFlt_C "" VALUE 0x80248FE0 Val_Wu16 65535.00 DFES_OneToOne 0.00 65535.00 FORMAT "%8.2" /end CHARACTERISTIC
/begin CHARACTERISTIC DFC_DisblMsk2.DFC_ElMIvtrCooltT01_C "" VALUE 0x80248FE4 Val_Wu16 65535.00 DFES_OneToOne 0.00 65535.00 FORMAT "%8.2" /end CHARACTERISTIC
/begin CHARACTERISTIC DFC_DisblMsk2.DFC_ElMIvtrEmgyShtDwn01_C "" VALUE 0x80248FE6 Val_Wu16 65535.00 DFES_OneToOne 0.00 65535.00 FORMAT "%8.2" /end CHARACTERISTIC
/begin CHARACTERISTIC DFC_DisblMsk2.DFC_ElMIvtrFailr01_C "" VALUE 0x80248FE8 Val_Wu16 65535.00 DFES_OneToOne 0.00 65535.00 FORMAT "%8.2" /end CHARACTERISTIC
/begin CHARACTERISTIC DFC_DisblMsk2.DFC_ElMIvtrIntlck01_C "" VALUE 0x80248FEA Val_Wu16 65535.00 DFES_OneToOne 0.00 65535.00 FORMAT "%8.2" /end CHARACTERISTIC
/begin CHARACTERISTIC DFC_DisblMsk2.DFC_ElMIvtrTErr01_C "" VALUE 0x80248FEC Val_Wu16 65535.00 DFES_OneToOne 0.00 65535.00 FORMAT "%8.2" /end CHARACTERISTIC
/begin CHARACTERISTIC DFC_DisblMsk2.DFC_ElMPwrAuthn_C "" VALUE 0x80248FF6 Val_Wu16 65535.00 DFES_OneToOne 0.00 65535.00 FORMAT "%8.2" /end CHARACTERISTIC
/begin CHARACTERISTIC DFC_DisblMsk2.DFC_ElMSpdErr01_C "" VALUE 0x80248FF8 Val_Wu16 65535.00 DFES_OneToOne 0.00 65535.00 FORMAT "%8.2" /end CHARACTERISTIC
/begin CHARACTERISTIC DFC_DisblMsk2.DFC_ElMSvs01_C "" VALUE 0x80248FFA Val_Wu16 65535.00 DFES_OneToOne 0.00 65535.00 FORMAT "%8.2" /end CHARACTERISTIC
/begin CHARACTERISTIC DFC_DisblMsk2.DFC_PEnvCcMax_C "" VALUE 0x80248FFC Val_Wu16 65535.00 DFES_OneToOne 0.00 65535.00 FORMAT "%8.2" /end CHARACTERISTIC
/begin CHARACTERISTIC DFC_DisblMsk2.DFC_PEnvCcMin_C "" VALUE 0x80248FFE Val_Wu16 65535.00 DFES_OneToOne 0.00 65535.00 FORMAT "%8.2" /end CHARACTERISTIC
/begin CHARACTERISTIC DFC_DisblMsk2.DFC_PEnvRngChkMax_C "" VALUE 0x80249000 Val_Wu16 65535.00 DFES_OneToOne 0.00 65535.00 FORMAT "%8.2" /end CHARACTERISTIC
/begin CHARACTERISTIC DFC_DisblMsk2.DFC_PEnvRngChkMin_C "" VALUE 0x80249002 Val_Wu16 65535.00 DFES_OneToOne 0.00 65535.00 FORMAT "%8.2" /end CHARACTERISTIC
/begin CHARACTERISTIC DFC_DisblMsk2.DFC_PEnvSnsrPlaus_C "" VALUE 0x80249004 Val_Wu16 65535.00 DFES_OneToOne 0.00 65535.00 FORMAT "%8.2" /end CHARACTERISTIC
/begin CHARACTERISTIC DFC_DisblMsk2.DFC_FanSpdSRCMax_C "" VALUE 0x802490CC Val_Wu16 65535.00 DFES_OneToOne 0.00 65535.00 FORMAT "%8.2" /end CHARACTERISTIC
/begin CHARACTERISTIC DFC_DisblMsk2.DFC_PUmax_C "" VALUE 0x8024921A Val_Wu16 65535.00 DFES_OneToOne 0.00 65535.00 FORMAT "%8.2" /end CHARACTERISTIC
/begin CHARACTERISTIC EITS_facMeclPwrEIMCns_C "Efficiency factor for mechanical power consumption" VALUE 0x80250760 RB_Val_Ws16 7.999878 Fact -4.000000 3.999878 FORMAT "%8.6" /end CHARACTERISTIC
/begin CHARACTERISTIC EITS_facMeclPwrEIMRcpt_C "Efficiency factor for mechanical power recuperation" VALUE 0x80250762 RB_Val_Ws16 7.999878 Fact -4.000000 3.999878 FORMAT "%8.6" /end CHARACTERISTIC
/begin CHARACTERISTIC EITS_maxAbsltDrvPowEm01_T "Maximum Absolute drive power of electrical machine 01 based on its actual torque" CURVE 0x80250764 RB_Curve_S16_S16 1048560. leist_q16_W -524288.0 524272.0 FORMAT "%8.1"
 /begin AXIS_DESCR STD_AXIS Emac_tqAbsltMax01 Trq 5 -3276.800 3276.700 FORMAT "%8.3" DEPOSIT ABSOLUTE /end AXIS_DESCR
/end CHARACTERISTIC
/begin CHARACTERISTIC EITS_tiEmPowChrgnFil_C "Calibratable time constant for power charge" VALUE 0x8025077C RB_Val_Ws32 0.999990385564609 TimeDelay_s 0.000002000000001 0.999992385564610 FORMAT "%20.18" EXTENDED_LIMITS 0.000002000000001 4294.9672959999998 /end CHARACTERISTIC
/begin CHARACTERISTIC EITS_tiEmPowDchaFil_C "Calibratable time constant for power discharge" VALUE 0x80250780 RB_Val_Ws32 0.999990385564609 TimeDelay_s 0.000002000000001 0.999992385564610 FORMAT "%20.18" EXTENDED_LIMITS 0.000002000000001 4294.9672959999998 /end CHARACTERISTIC
/begin CHARACTERISTIC ElM_ActSt01_I.ElM_maskFlgEmgyShtDwnReqVldSq_C "Actual State mapping for e-machine / Bitmask to detect valid signal quality for ComEmac_flgEmgyShtDwnReq01_Sq" VALUE 0x802506A4 RB_Val_Wu16 65535.00 OneToOne 0.00 65535.00 FORMAT "%8.2" /end CHARACTERISTIC
/begin CHARACTERISTIC ElM_ActSt01_I.ElM_maskFlgIntlckClsdVldSq_C "Actual State mapping for e-machine / Bitmask to detect valid signal quality for ComEmac_flgIntlckClsd01_Sq" VALUE 0x802506A6 RB_Val_Wu16 65535.00 OneToOne 0.00 65535.00 FORMAT "%8.2" /end CHARACTERISTIC
/begin CHARACTERISTIC ElM_ActSt01_I.ElM_maskFlgSvsReqVldSq_C "Actual State mapping for e-machine / Bitmask to detect valid signal quality for ComEmac_flgSvsReq01_Sq" VALUE 0x802506A8 RB_Val_Wu16 65535.00 OneToOne 0.00 65535.00 FORMAT "%8.2" /end CHARACTERISTIC
/begin CHARACTERISTIC ElM_ActSt01_I.ElM_maskStModInvldSq_C "Actual State mapping for e-machine / Bitmask to detect Invalid signal quality for ComEmac_stMod01_Sq" VALUE 0x802506AA RB_Val_Wu16 65535.00 OneToOne 0.00 65535.00 FORMAT "%8.2" /end CHARACTERISTIC
/begin CHARACTERISTIC ElM_ActSt01_I.ElM_masknActInvldSq_C "Actual State mapping for e-machine / Bitmask to detect Invalid signal quality for ComEmac_nAct01_Sq" VALUE 0x802506AC RB_Val_Wu16 65535.00 OneToOne 0.00 65535.00 FORMAT "%8.2" /end CHARACTERISTIC
/begin CHARACTERISTIC ElM_ActSt01_I.ElM_masktInvrInvldSq_C "Actual State mapping for e-machine / Bitmask to detect Invalid signal quality for ComEmac_tInvr01_Sq" VALUE 0x802506AE RB_Val_Wu16 65535.00 OneToOne 0.00 65535.00 FORMAT "%8.2" /end CHARACTERISTIC
/begin CHARACTERISTIC ElM_ActSt01_I.ElM_masktIvtrCooltInvldSq_C "Actual State mapping for e-machine / Bitmask to detect Invalid signal quality for ComEmac_tIvtrCoolt01_Sq" VALUE 0x802506B0 RB_Val_Wu16 65535.00 OneToOne 0.00 65535.00 FORMAT "%8.2" /end CHARACTERISTIC
/begin CHARACTERISTIC ElM_ActSt01_I.ElM_stEem_T "Actual State mapping for e-machine / table for opermod mapping for EEM state" CURVE 0x802506B2 RB_Curve_U8_U8 255.0 OneToOne 0.00 255.0 FORMAT "%5.1"
 /begin AXIS_DESCR STD_AXIS ElM_ActSt01_I.ElM_stOperModAct RBPtElTrac_stEmOperMod_VERB 18 0.00 31.0000000000 FORMAT "%13.10" DEPOSIT ABSOLUTE /end AXIS_DESCR
/end CHARACTERISTIC
/begin CHARACTERISTIC ElM_ActSt01_I.ElM_stOperModAct_T "Actual State mapping for e-machine / Calibration parameter for mapping actual operation mode of inverter as per the specification values received over CAN." CURVE 0x802506D7 RB_Curve_U8_U8 31.0000000000 RBPtElTrac_stEmOperMod_VERB 0.00 31.0000000000 FORMAT "%13.10"
 /begin AXIS_DESCR STD_AXIS ElM_ActSt01_I.ComEmac_stMod OneToOne 16 0.00 255.0 FORMAT "%5.1" DEPOSIT ABSOLUTE /end AXIS_DESCR
/end CHARACTERISTIC
/begin CHARACTERISTIC ElM_DesSt01_I.ElM_stDesEem_T "Class / Curve to map desired states of inverter to CAN interface" CURVE 0x8025070C RB_Curve_U8_U8 255.0 OneToOne 0.00 255.0 FORMAT "%5.1"
 /begin AXIS_DESCR STD_AXIS ElM_DesSt01_I.ElM_stDesEemInt RBPtElTrac_stEmOperMod_VERB 18 0.00 31.0000000000 FORMAT "%13.10" DEPOSIT ABSOLUTE /end AXIS_DESCR
/end CHARACTERISTIC
/begin CHARACTERISTIC ElM_flgSwtIvtrWakeup_C "Calibration to wakeup the Inverter (applicable when ElM_stIvtrWakeupTyp_C = 2)" VALUE 0x802506F8 RB_Val_Wboolean 1.00000000000 B_TRUE 0.00 1.00000000000 FORMAT "%13.11" /end CHARACTERISTIC
/begin CHARACTERISTIC ElM_maskActvDchaVldSq_C "Calibration mask for Active discharge response signal quality" VALUE 0x80250680 RB_Val_Wu16 65535.00 OneToOne 0.00 65535.00 FORMAT "%8.2" /end CHARACTERISTIC
/begin CHARACTERISTIC ElM_maskImobAuthentVldSq_C "Calibration mask for Immobilizer authentication signal quality" VALUE 0x80250682 RB_Val_Wu16 65535.00 OneToOne 0.00 65535.00 FORMAT "%8.2" /end CHARACTERISTIC
/begin CHARACTERISTIC ElM_maskIsoMeasmtVldSq_C "Calibration mask for HV battery insulation resistance signal quality" VALUE 0x80250684 RB_Val_Wu16 65535.00 OneToOne 0.00 65535.00 FORMAT "%8.2" /end CHARACTERISTIC
/begin CHARACTERISTIC ElM_maskIsoMonSwtAckVldSq_C "Clibration mask for Insulation Monitoring Acknowledge Switch signal quality" VALUE 0x80250686 RB_Val_Wu16 65535.00 OneToOne 0.00 65535.00 FORMAT "%8.2" /end CHARACTERISTIC
/begin CHARACTERISTIC ElM_maskPwrAuthnVldSq_C "Calibration mask for Traction operation authorization signal quality" VALUE 0x80250688 RB_Val_Wu16 65535.00 OneToOne 0.00 65535.00 FORMAT "%8.2" /end CHARACTERISTIC
/begin CHARACTERISTIC ElM_rIsoMeasmtThd_C "Claibration parameterfor HV battery insulation resistance threshold" VALUE 0x8025068A RB_Val_Wu16 65535.00 q1_kOhm 0.00 65535.00 FORMAT "%8.2" /end CHARACTERISTIC
/begin CHARACTERISTIC ElM_stActvDchaFlt_T "Calibration table for Active discharge response" CURVE 0x8025068C RB_Curve_U8_U8 255.0 OneToOne 0.00 255.0 FORMAT "%5.1"
 /begin AXIS_DESCR STD_AXIS ComEmac_stActvDcha OneToOne 8 0.00 255.0 FORMAT "%5.1" DEPOSIT ABSOLUTE /end AXIS_DESCR
/end CHARACTERISTIC
/begin CHARACTERISTIC ElM_stIsoMonOn_C "calibaration parameter for Insulation monitoring On" VALUE 0x8025069D RB_Val_Wu8 255.0 OneToOne 0.00 255.0 FORMAT "%5.1" /end CHARACTERISTIC
/begin CHARACTERISTIC ElM_stIvtrWakeupTyp_C "Calibration to choose the type, for waking up the Inverter." VALUE 0x802506F9 RB_Val_Wu8 255.0 OneToOne 0.00 255.0 FORMAT "%5.1" /end CHARACTERISTIC
/begin CHARACTERISTIC ElM_stSelDchaReq_C "Selector for HV discharge request" VALUE 0x802506FA RB_Val_Wboolean 1.00000000000 B_TRUE 0.00 1.00000000000 FORMAT "%13.11" /end CHARACTERISTIC
/begin CHARACTERISTIC ElM_tiIsoMonDurn_C "isolation monitoring duration time" VALUE 0x802506FC RB_Val_Ws32 4294967295.00 Time_1s -2147483648.00 2147483647.00 FORMAT "%13.2" /end CHARACTERISTIC
/begin CHARACTERISTIC ElM_tiIsoMonStrt_C "isolation monitoring Start time" VALUE 0x80250700 RB_Val_Ws32 4294967295.00 Time_1s -2147483648.00 2147483647.00 FORMAT "%13.2" /end CHARACTERISTIC
/begin CHARACTERISTIC ElM_tiIvtrWakeupDly_C "Delay time to revoke the Inverter wakeup." VALUE 0x80250704 RB_Val_Ws32 4294.96729500 Time_Dt -2147.48364800 2147.48364700 FORMAT "%13.8" /end CHARACTERISTIC
/begin CHARACTERISTIC ElSS_iConsolAcCmprMinThd_C "Minimum threshold current above which AC Compressor Power measurement is enabled" VALUE 0x80250758 RB_Val_Ws16 2047.969 RBPtCel_i_0p03125_1 -1024.000 1023.969 FORMAT "%8.3" /end CHARACTERISTIC
/begin CHARACTERISTIC ElSS_maskuElCmprHvActSq_C "Calibaration mask for Com_uElCmprHvAct_Sq" VALUE 0x8025075A RB_Val_Wu16 65535.00 OneToOne 0.00 65535.00 FORMAT "%8.2" /end CHARACTERISTIC
/begin CHARACTERISTIC ElSS_maskUHvDcBusSq_C "Calibration mask for HV DC bus signal quality" VALUE 0x8025075C RB_Val_Wu16 65535.00 OneToOne 0.00 65535.00 FORMAT "%8.2" /end CHARACTERISTIC
/begin CHARACTERISTIC ElSS_maskuPtcActSq_C "Calibaration mask for Com_uPtcAct_Sq" VALUE 0x8025075E RB_Val_Wu16 65535.00 OneToOne 0.00 65535.00 FORMAT "%8.2" /end CHARACTERISTIC
/begin CHARACTERISTIC ElTS_facPtSysLimDrvThd_C "calibratable minimum threshold for power train system drive limit factor" VALUE 0x80250784 RB_Val_Ws16 7.999878 Fact -4.000000 3.999878 FORMAT "%8.6" /end CHARACTERISTIC
/begin CHARACTERISTIC ElTS_facPtSysLimRngThd_C "calibratable minimum threshold for power train system regeneration limit factor" VALUE 0x80250786 RB_Val_Ws16 7.999878 Fact -4.000000 3.999878 FORMAT "%8.6" /end CHARACTERISTIC
/begin CHARACTERISTIC ElTS_facPwrAcsyConv_C "Calibration parameter factor power accessory converter" VALUE 0x80250788 RB_Val_Ws16 7.999878 Fact -4.000000 3.999878 FORMAT "%8.6" /end CHARACTERISTIC
/begin CHARACTERISTIC ElTS_facPwrEIMConv_C "Factor for the convertion of electric machine actual power to respective energy." VALUE 0x8025078A RB_Val_Ws16 7.999878 Fact -4.000000 3.999878 FORMAT "%8.6" /end CHARACTERISTIC
/begin CHARACTERISTIC ElTS_facPwrRcptConv_C "Calibration parameter factor power recuperation converter" VALUE 0x8025078C RB_Val_Ws16 7.999878 Fact -4.000000 3.999878 FORMAT "%8.6" /end CHARACTERISTIC
/begin CHARACTERISTIC ElTS_maskComChrgrInAct_C "Calibratable mask for the signal quality" VALUE 0x8025078E RB_Val_Wu16 65535.00 OneToOne 0.00 65535.00 FORMAT "%8.2" /end CHARACTERISTIC
/begin CHARACTERISTIC ElTS_maxAbsltRgnPowEm01_T "Maximum Absolute regeneration power of electrical machine 01 based on its actual torque" CURVE 0x80250790 RB_Curve_S16_S16 1048560. leist_q16_W -524288.0 524272.0 FORMAT "%8.1"
 /begin AXIS_DESCR STD_AXIS Emac_tqAbsltMin01 Trq 5 -3276.800 3276.700 FORMAT "%8.3" DEPOSIT ABSOLUTE /end AXIS_DESCR
/end CHARACTERISTIC
/begin CHARACTERISTIC ElTS_maxDrvPowEm01_T "Maximum drive power of E-machine 01 based on its actual speed" CURVE 0x802507A6 RB_Curve_S16_S16 1048560. leist_q16_W -524288.0 524272.0 FORMAT "%8.1"
 /begin AXIS_DESCR STD_AXIS Emac_nAct01 nmot_q1 15 -32768.00 32767.00 FORMAT "%8.2" DEPOSIT ABSOLUTE /end AXIS_DESCR
/end CHARACTERISTIC
/begin CHARACTERISTIC ElTS_maxRgnPowEm01_T "Maximum regeneration power of E-machine 01 based on its actual speed" CURVE 0x802507E4 RB_Curve_S16_S16 1048560. leist_q16_W -524288.0 524272.0 FORMAT "%8.1"
 /begin AXIS_DESCR STD_AXIS Emac_nAct01 nmot_q1 15 -32768.00 32767.00 FORMAT "%8.2" DEPOSIT ABSOLUTE /end AXIS_DESCR
/end CHARACTERISTIC
/begin CHARACTERISTIC ElTS_ratSoc_CUR "Curve to indicate the ratio of the State of Charge" CURVE 0x80250822 RB_Curve_S16_S16 799.9878 Prc -400.0000 399.9878 FORMAT "%8.4"
 /begin AXIS_DESCR STD_AXIS HvBatt_ratSoc Prc 2 -400.0000 399.9878 FORMAT "%8.4" DEPOSIT ABSOLUTE /end AXIS_DESCR
/end CHARACTERISTIC
/begin CHARACTERISTIC ElTS_swtEgyRst_C "Switch to determine the reset behaviour of accumulated energies" VALUE 0x8025082C RB_Val_Wu8 255.0 OneToOne 0.00 255.0 FORMAT "%5.1" /end CHARACTERISTIC
/begin CHARACTERISTIC ElTS_tiChrgPlg_C "Calibratable delay for charge plug state" VALUE 0x8025082E RB_Val_Ws16 655.3500 Time_s -327.6800 327.6700 FORMAT "%8.4" /end CHARACTERISTIC
/begin CHARACTERISTIC Emac_TransEMS01_I.ElM_flgTqDmdNeutModEm_C "coordination of data transfer to electrical machine 1 / switch to set torque to 0 in N" VALUE 0x80250738 RB_Val_Wu8 1.00000000000 B_TRUE 0.00 1.00000000000 FORMAT "%13.11" /end CHARACTERISTIC
/begin CHARACTERISTIC Emac_TransEMS01_I.ElM_nMofMin_C "coordination of data transfer to electrical machine 1 / Minimum absolute torque, e-machine" VALUE 0x8025073A RB_Val_Ws16 65535.00 nmot_q1 -32768.00 32767.00 FORMAT "%8.2" /end CHARACTERISTIC
/begin CHARACTERISTIC Emac_TransEMS01_I.ElM_pwrTrqLim_C "coordination of data transfer to electrical machine 1 / Maximum torque in the case of error" VALUE 0x8025073C RB_Val_Ws16 1048560. leist_q16_W -524288.0 524272.0 FORMAT "%8.1" /end CHARACTERISTIC
/begin CHARACTERISTIC Emac_TransEMS01_I.ElM_trqMaxNoPrp_C "coordination of data transfer to electrical machine 1 / Maximal permissible torque during failure" VALUE 0x8025073E RB_Val_Ws16 6553.500 Trq -3276.800 3276.700 FORMAT "%8.3" /end CHARACTERISTIC
/begin CHARACTERISTIC Emac_TransEMS01_I.ElM_trqMinNoPrp_C "coordination of data transfer to electrical machine 1 / Minimal permissible torque during failure" VALUE 0x80250740 RB_Val_Ws16 6553.500 Trq -3276.800 3276.700 FORMAT "%8.3" /end CHARACTERISTIC
/begin CHARACTERISTIC Emac_TransEMS01_I.ElM_uDcMin_C "coordination of data transfer to electrical machine 1 / Min. DC link voltage for normal operation." VALUE 0x80250742 RB_Val_Ws16 963.9688 Volt_V_q0p03125_COMPU 60.000 1023.969 FORMAT "%8.3" EXTENDED_LIMITS -1024.000 1023.969 /end CHARACTERISTIC
/begin CHARACTERISTIC Emac_TransEMS01_I.Emac_dtqMaxLimCom_C "coordination of data transfer to electrical machine 1 / max. torque gradient of e-machine" VALUE 0x80250744 RB_Val_Ws16 65535.00 RBPtCel_dtq_1p0_1 -32768.00 32767.00 FORMAT "%8.2" /end CHARACTERISTIC
/begin CHARACTERISTIC Emac_TransEMS01_I.Emac_facKpHiCom_C "coordination of data transfer to electrical machine 1 / P-factor for speedcontrol mode - used for high deviations from setpoint." VALUE 0x80250746 RB_Val_Ws16 2621.400 fak_q0p04 -1310.720 1310.680 FORMAT "%8.3" /end CHARACTERISTIC
/begin CHARACTERISTIC Emac_TransEMS01_I.Emac_facKpLoCom_C "coordination of data transfer to electrical machine 1 / P-factor for speedcontrol mode - used for low deviations from setpoint." VALUE 0x80250748 RB_Val_Ws16 2621.400 fak_q0p04 -1310.720 1310.680 FORMAT "%8.3" /end CHARACTERISTIC
/begin CHARACTERISTIC Emac_TransEMS01_I.Emac_nDeThdCom_C "coordination of data transfer to electrical machine 1 / max. speed gradient of e-machine" VALUE 0x8025074A RB_Val_Ws16 65535.00 nmot_q1 -32768.00 32767.00 FORMAT "%8.2" /end CHARACTERISTIC
/begin CHARACTERISTIC Emac_TransEMS01_I.Emac_tiChgGear_C "coordination of data transfer to electrical machine 1 / Time constant of PT1 for ramping of desired torque during gear change" VALUE 0x8025074C RB_Val_Ws32 4294.9672940000000 TimeDelay_s 0.0000020000000 4294.9672959999998 FORMAT "%19.14" EXTENDED_LIMITS 0.000002000000001 4294.9672959999998 /end CHARACTERISTIC
/begin CHARACTERISTIC Emac_TransEMS01_I.Emac_tqMaxLimCom_C "coordination of data transfer to electrical machine 1 / Default value for max. permitted torque limit of e-machine inverter." VALUE 0x80250750 RB_Val_Ws16 6553.500 Trq -3276.800 3276.700 FORMAT "%8.3" /end CHARACTERISTIC
/begin CHARACTERISTIC Emac_TransEMS01_I.Emac_tqMinLimCom_C "coordination of data transfer to electrical machine 1 / Default value for min. permitted torque limit of e-machine inverter. Negative values only!" VALUE 0x80250752 RB_Val_Ws16 6553.500 Trq -3276.800 3276.700 FORMAT "%8.3" /end CHARACTERISTIC
/begin CHARACTERISTIC Emac_TransEMS01_I.Emac_tqSpdCtlMaxLimCom_C "coordination of data transfer to electrical machine 1 / Max. permitted torque of e-machine in speedcontrol mode." VALUE 0x80250754 RB_Val_Ws16 6553.500 Trq -3276.800 3276.700 FORMAT "%8.3" /end CHARACTERISTIC
/begin CHARACTERISTIC Emac_TransEMS01_I.Emac_tqSpdCtlMinLimCom_C "coordination of data transfer to electrical machine 1 / Min. permitted torque of e-machine in speedcontrol mode. Negative values only!" VALUE 0x80250756 RB_Val_Ws16 6553.500 Trq -3276.800 3276.700 FORMAT "%8.3" /end CHARACTERISTIC
/begin CHARACTERISTIC EmWakeupSig_psDiagDigOut.nrTstPls_C " / Maximum number of test impulses possible in one driving cycle." VALUE 0x8025EE50 Kw_Wu32 4294967295.00 OneToOne 0.00 4294967295.00 FORMAT "%13.2" /end CHARACTERISTIC
/begin CHARACTERISTIC EmWakeupSig_psDiagDigOut.tiBtwElecFlt_C " / Time between test in case a short circuit or open load is detected." VALUE 0x8025EE54 Kw_Ws16 655350.0 Time_ms -327680.0 327670.0 FORMAT "%8.1" /end CHARACTERISTIC
/begin CHARACTERISTIC EmWakeupSig_psDiagDigOut.tiBtwOTFlt_C " / Time between test when an over temperature error is detected." VALUE 0x8025EE56 Kw_Ws16 655.3500 Time_s -327.6800 327.6700 FORMAT "%8.4" /end CHARACTERISTIC
/begin CHARACTERISTIC EmWakeupSig_rCnv_CUR "" CURVE 0x80250834 RB_Curve_S16_S16 799.9878 Prc -400.0000 399.9878 FORMAT "%8.4"
 /begin AXIS_DESCR STD_AXIS EmWakeupSig_rActr Prc 25 -400.0000 399.9878 FORMAT "%8.4" DEPOSIT ABSOLUTE /end AXIS_DESCR
/end CHARACTERISTIC
/begin CHARACTERISTIC EmWakeupSig_stActrDis_C "" VALUE 0x80250830 RB_Val_Wu16 65535.00 OneToOne 0.00 65535.00 FORMAT "%8.2" /end CHARACTERISTIC
/begin CHARACTERISTIC EmWakeupSig_stPwrStgDiaDis_C "" VALUE 0x8025089E RB_Val_Wu16 65535.00 OneToOne 0.00 65535.00 FORMAT "%8.2" /end CHARACTERISTIC
/begin CHARACTERISTIC EmWakeupSig_stPwrStgDis_C "" VALUE 0x8025089A RB_Val_Wu16 65535.00 OneToOne 0.00 65535.00 FORMAT "%8.2" /end CHARACTERISTIC
/begin CHARACTERISTIC EmWakeupSig_swtConfActrCoorrSimple_C "" VALUE 0x80250832 RB_Val_Wu8 255.0 OneToOne 0.00 255.0 FORMAT "%5.1" /end CHARACTERISTIC
/begin CHARACTERISTIC EmWakeupSig_swtConfActrElecDrvrSimple_C "" VALUE 0x8025089C RB_Val_Wu8 255.0 OneToOne 0.00 255.0 FORMAT "%5.1" /end CHARACTERISTIC
/begin CHARACTERISTIC EmWakeupSig_swtConfActrElecMonSimple_C "" VALUE 0x802508A0 RB_Val_Wu8 255.0 OneToOne 0.00 255.0 FORMAT "%5.1" /end CHARACTERISTIC
/begin CHARACTERISTIC EmWakeupSig_swtConfActrPsDrvrSimple_C "" VALUE 0x802508A2 RB_Val_Wu8 255.0 OneToOne 0.00 255.0 FORMAT "%5.1" /end CHARACTERISTIC
/begin CHARACTERISTIC EmWakeupSig_tiPt1Mdl_C "" VALUE 0x802508A4 RB_Val_Ws32 4294.9672940000000 TimeDelay_s 0.0000020000000 4294.9672959999998 FORMAT "%19.14" EXTENDED_LIMITS 0.000002000000001 4294.9672959999998 /end CHARACTERISTIC
/begin CHARACTERISTIC Etc_MaxReqTO_C "" VALUE 0x8025EE4C Val_Wu16 32767.00 OneToOne 0.00 32767.00 FORMAT "%8.2" EXTENDED_LIMITS 0.00 65535.00 /end CHARACTERISTIC
/begin CHARACTERISTIC EVTherm_dTSpMedTHi_C "Higher temperature limit for MT circuit" VALUE 0x8025036A RB_Val_Ws16 6553.500 RBPtCel_t_0p1_1 -3276.800 3276.700 FORMAT "%8.3" /end CHARACTERISTIC
/begin CHARACTERISTIC EVTherm_dTSpMedTLo_C "Lower temperature limit for MT circuit" VALUE 0x8025036C RB_Val_Ws16 6553.500 RBPtCel_t_0p1_1 -3276.800 3276.700 FORMAT "%8.3" /end CHARACTERISTIC
/begin CHARACTERISTIC EVTherm_facMTCooltEnv_T "Correction factor curve to correct the relative fan speed request from MT circuit" CURVE 0x8025036E RB_Curve_S16_S8_sao 25.50 RBPtCel_fac_0p1_1 -12.80 12.70 FORMAT "%5.2"
 /begin AXIS_DESCR STD_AXIS EnvT_t Temp_Cels 3 -3549.940 3003.560 FORMAT "%8.3" DEPOSIT ABSOLUTE /end AXIS_DESCR
/end CHARACTERISTIC
/begin CHARACTERISTIC EVTherm_ratCtrlMTFanAR_T "curve to calculate the medium temperature fan ratio during afterrun depending on the setpoint delta" CURVE 0x8025037A RB_Curve_S16_S8_sao 255.0 RBPtCel_Perc_1p0_1 -128.0 127.0 FORMAT "%5.1"
 /begin AXIS_DESCR STD_AXIS ThermLvl_dTMTCooltSp RBPtCel_t_0p1_1 6 -3276.800 3276.700 FORMAT "%8.3" DEPOSIT ABSOLUTE /end AXIS_DESCR
/end CHARACTERISTIC
/begin CHARACTERISTIC EVTherm_ratCtrlMTFan_T "curve to calculate the medium temperature fan ratio depending on the setpoint delta" CURVE 0x8025038E RB_Curve_S16_S8_sao 255.0 RBPtCel_Perc_1p0_1 -128.0 127.0 FORMAT "%5.1"
 /begin AXIS_DESCR STD_AXIS ThermLvl_dTMTCooltSp RBPtCel_t_0p1_1 6 -3276.800 3276.700 FORMAT "%8.3" DEPOSIT ABSOLUTE /end AXIS_DESCR
/end CHARACTERISTIC
/begin CHARACTERISTIC EVTherm_ratMedTOff_C "turn off ratio for to high temperature fan request" VALUE 0x802503A2 RB_Val_Ws8 255.0 RBPtCel_Perc_1p0_1 -128.0 127.0 FORMAT "%5.1" /end CHARACTERISTIC
/begin CHARACTERISTIC EVTherm_ratMTClgReplcmt_C "Calibration threshold ratio for relative fan speed request of MT circuit in case communication error." VALUE 0x802503A3 RB_Val_Ws8 255.0 RBPtCel_Perc_1p0_1 -128.0 127.0 FORMAT "%5.1" /end CHARACTERISTIC
/begin CHARACTERISTIC Fan1_ActrPwrStgDrvr_Cal.swtConf_C "e_:Calibration Parameter Structure for Linear Governor limitation Feature:_e;d_:Applikationsstruktur für das lineare Reglerbegrenzungsfeature:_d / e_:Minimum allowable motor torque/ motor torque threshold in downward direction to activate ramping:_e;d_:Minimales erlaubtes Motormoment in Richtung unten um Rampe zu aktivieren:_d" VALUE 0x80250918 Val_Wu8 255.0 OneToOne 0.00 255.0 FORMAT "%5.1" /end CHARACTERISTIC
/begin CHARACTERISTIC Fan1_ActrPwrStgDrvr_Cal.stMOCSOPChk_C "e_:Calibration Parameter Structure for Linear Governor limitation Feature:_e;d_:Applikationsstruktur für das lineare Reglerbegrenzungsfeature:_d / e_:Minimum upper motor torque:_e;d_:Minimum des oberen Motordrehmoments:_d" VALUE 0x80250919 Val_Wu8 255.0 OneToOne 0.00 255.0 FORMAT "%5.1" /end CHARACTERISTIC
/begin CHARACTERISTIC Fan1_ActrPwrStgDrvr_Cal.swtPSDis_C "e_:Calibration Parameter Structure for Linear Governor limitation Feature:_e;d_:Applikationsstruktur für das lineare Reglerbegrenzungsfeature:_d / e_:Minimum motor initial torque:_e;d_:Minimum des initialen Motormoments:_d" VALUE 0x8025091A Val_Wu16 65535.00 OneToOne 0.00 65535.00 FORMAT "%8.2" /end CHARACTERISTIC
/begin CHARACTERISTIC Fan1_DevDrvrOutpDutyCycRampCal.swtConf_C " / e_:Configuration switch to activate Linear governor limitation:_e;d_:Konfigurationsschalter zum Aktivieren der Linearen Reglerbegrenzung:_d" VALUE 0x8025091C RB_Val_Wu8 7.000 OneToOne 0.00 7.000 FORMAT "%5.3" EXTENDED_LIMITS 0.00 255.0 /end CHARACTERISTIC
/begin CHARACTERISTIC Fan1_numStdActr_C "" VALUE 0x8025F4CC Val_Wu32 4294967295.00 OneToOne 0.00 4294967295.00 FORMAT "%13.2" /end CHARACTERISTIC
/begin CHARACTERISTIC Fan1_psDiagDigOut.nrTstPls_C " / Maximum number of test impulses possible in one driving cycle." VALUE 0x8025F4D0 Kw_Wu32 4294967295.00 OneToOne 0.00 4294967295.00 FORMAT "%13.2" /end CHARACTERISTIC
/begin CHARACTERISTIC Fan1_psDiagDigOut.tiBtwElecFlt_C " / Time between test in case a short circuit or open load is detected." VALUE 0x8025F4D4 Kw_Ws16 655350.0 Time_ms -327680.0 327670.0 FORMAT "%8.1" /end CHARACTERISTIC
/begin CHARACTERISTIC Fan1_psDiagDigOut.tiBtwOTFlt_C " / Time between test when an over temperature error is detected." VALUE 0x8025F4D6 Kw_Ws16 655.3500 Time_s -327.6800 327.6700 FORMAT "%8.4" /end CHARACTERISTIC
/begin CHARACTERISTIC Fan1_ratActLin_CUR "" CURVE 0x8025F464 RB_Curve_S16_S16 511.9922 rel_q0p0078125 -256.0000 255.9922 FORMAT "%8.4"
 /begin AXIS_DESCR STD_AXIS Fan1_rAct Prc 25 -400.0000 399.9878 FORMAT "%8.4" DEPOSIT ABSOLUTE /end AXIS_DESCR
/end CHARACTERISTIC
/begin CHARACTERISTIC Fan1_rCnv_MAP "" MAP 0x8025EF0C RB_Map_S16S16_S16 655.3500 DtyCyc -327.6800 327.6700 FORMAT "%8.4"
 /begin AXIS_DESCR STD_AXIS Fan1_rActr Prc 25 -400.0000 399.9878 FORMAT "%8.4" DEPOSIT ABSOLUTE /end AXIS_DESCR
 /begin AXIS_DESCR STD_AXIS EnvP_p Pres_hPa 25 -32768.00 32767.00 FORMAT "%8.2" DEPOSIT ABSOLUTE /end AXIS_DESCR
/end CHARACTERISTIC
/begin CHARACTERISTIC Fan1_rDesActr_CUR "" CURVE 0x8025EE58 RB_Curve_S16_S16 799.9878 Prc -400.0000 399.9878 FORMAT "%8.4"
 /begin AXIS_DESCR STD_AXIS Fan1_r Prc 25 -400.0000 399.9878 FORMAT "%8.4" DEPOSIT ABSOLUTE /end AXIS_DESCR
/end CHARACTERISTIC
/begin CHARACTERISTIC Fan1_StdCal.tiDesValFlt_C " / PT1 Filter time constant for setpoint to calculate simulated feedback" VALUE 0x8025EEC0 Val_Ws32 4294.9672940000000 TimeDelay_s 0.0000020000000 4294.9672959999998 FORMAT "%19.14" EXTENDED_LIMITS 0.000002000000001 4294.9672959999998 /end CHARACTERISTIC
/begin CHARACTERISTIC Fan1_StdCal.rPsOff_C " / Dutycycle value for actuator switch off" VALUE 0x8025EEC4 Val_Ws16 655.3500 DtyCyc -327.6800 327.6700 FORMAT "%8.4" /end CHARACTERISTIC
/begin CHARACTERISTIC Fan1_StdCal.rActrStop_C " / Actuator shut off PWM duty cycle" VALUE 0x8025EEC6 Val_Ws16 655.3500 DtyCyc -327.6800 327.6700 FORMAT "%8.4" /end CHARACTERISTIC
/begin CHARACTERISTIC Fan1_StdCal.rHysHigh_C " / e_:upper hysteresis threshold:_e;d_:Obere Hystereseschwelle:_d" VALUE 0x8025EEC8 Val_Ws16 655.3500 DtyCyc -327.6800 327.6700 FORMAT "%8.4" /end CHARACTERISTIC
/begin CHARACTERISTIC Fan1_StdCal.rHysLow_C " / e_:lower hysteresis threshold:_e;d_:Untere Hystereseschwelle:_d" VALUE 0x8025EECA Val_Ws16 655.3500 DtyCyc -327.6800 327.6700 FORMAT "%8.4" /end CHARACTERISTIC
/begin CHARACTERISTIC Fan1_StdCal.stPwrStgDiaDis_C " / Mask to disable powerstage diagnosis" VALUE 0x8025EECC Val_Wu16 65535.00 OneToOne 0.00 65535.00 FORMAT "%8.2" /end CHARACTERISTIC
/begin CHARACTERISTIC Fan1_StdCal.stPlausDiaDis_C " / e_:Mask to disable plausibility diagnosis:_e;d_:Maske zur Deaktivierung der Plausibilitätsdiagnose:_d" VALUE 0x8025EECE Val_Wu16 65535.00 OneToOne 0.00 65535.00 FORMAT "%8.2" /end CHARACTERISTIC
/begin CHARACTERISTIC Fan1_StdCal.stPwrStgDis_C " / Mask to disable powerstage actuation under different conditions" VALUE 0x8025EED0 Val_Wu16 65535.00 OneToOne 0.00 65535.00 FORMAT "%8.2" /end CHARACTERISTIC
/begin CHARACTERISTIC Fan1_StdCal.stActrStop_C " / Bitcoded value of the states where actuator switchoff signal should be sent" VALUE 0x8025EED2 Val_Wu16 65535.00 OneToOne 0.00 65535.00 FORMAT "%8.2" /end CHARACTERISTIC
/begin CHARACTERISTIC Fan1_StdCal.stAllPwrStgDiaEna_C " / Switch configuration for power stage diagnosis for digital actuators" VALUE 0x8025EED4 Val_Wu8 255.0 OneToOne 0.00 255.0 FORMAT "%5.1" /end CHARACTERISTIC
/begin CHARACTERISTIC Fan1_StdCal.swtDesVal_C " / Switch to select default setpoint" VALUE 0x8025EED5 Val_Wu8 255.0 OneToOne 0.00 255.0 FORMAT "%5.1" /end CHARACTERISTIC
/begin CHARACTERISTIC Fan1_StdCal.numDiagTry_C " / Counter to limit the number of active diagnosis" VALUE 0x8025EED6 Val_Wu8 255.0 OneToOne 0.00 255.0 FORMAT "%5.1" /end CHARACTERISTIC
/begin CHARACTERISTIC Fan1_StdCal.rDesValOff_C " / Default desired value in case of power stage errors" VALUE 0x8025EED8 Val_Ws16 799.9878 Prc -400.0000 399.9878 FORMAT "%8.4" /end CHARACTERISTIC
/begin CHARACTERISTIC Fan1_StdCal.rDesValOn_C " / Default desired value for On position" VALUE 0x8025EEDA Val_Ws16 799.9878 Prc -400.0000 399.9878 FORMAT "%8.4" /end CHARACTERISTIC
/begin CHARACTERISTIC Fan1_StdCal.numEngDaFrqPs_C " / variable frequency option in PWM signals" VALUE 0x8025EEDC Val_Wu16 255.000000000 DELIB_ALLTEMP_VERB_COMPU 0.00 255.000000000 FORMAT "%13.9" /end CHARACTERISTIC
/begin CHARACTERISTIC Fan1_StdCal.tiSlwRespSimPT1_C " / PT1 Filter time constant for slow response simulation" VALUE 0x8025EEE0 Val_Ws32 4294.9672940000000 TimeDelay_s 0.0000020000000 4294.9672959999998 FORMAT "%19.14" EXTENDED_LIMITS 0.000002000000001 4294.9672959999998 /end CHARACTERISTIC
/begin CHARACTERISTIC Fan1_StdCal.uHiBattThd_C " / Upper hysteresis threshold for BattU_u" VALUE 0x8025EEE4 Val_Ws16 1310700. Volt_Batt -655360.0 655340.0 FORMAT "%8.1" /end CHARACTERISTIC
/begin CHARACTERISTIC Fan1_StdCal.uLoBattThd_C " / Lower hysteresis threshold for BattU_u" VALUE 0x8025EEE6 Val_Ws16 1310700. Volt_Batt -655360.0 655340.0 FORMAT "%8.1" /end CHARACTERISTIC
/begin CHARACTERISTIC Fan1_StdCal.tiDebBattVoltOk_C " / Healing time of defected battery voltage" VALUE 0x8025EEE8 Val_Ws16 655350.0 Time_ms -327680.0 327670.0 FORMAT "%8.1" /end CHARACTERISTIC
/begin CHARACTERISTIC Fan1_StdCal.tiDebBattVoltDfct_C " / Debounce time to sense Battery voltage Defect" VALUE 0x8025EEEA Val_Ws16 655350.0 Time_ms -327680.0 327670.0 FORMAT "%8.1" /end CHARACTERISTIC
/begin CHARACTERISTIC Fan1_StdCal.mskActrActv_C " / Bitmask to choose in which engine states the actuator is activated" VALUE 0x8025EEEC Val_Wu8 255.0 OneToOne 0.00 255.0 FORMAT "%5.1" /end CHARACTERISTIC
/begin CHARACTERISTIC Fan1_StdCal.tiDlyActrActvn_C " / Delay for actuator activation" VALUE 0x8025EEEE Val_Wu16 6553.500 TiSec_q0p1_COMPU 0.00 6553.500 FORMAT "%8.3" /end CHARACTERISTIC
/begin CHARACTERISTIC Fan1_StdCal.rPsActrOff_C " / Replacement value for powerstage dutycycle when actuator is not activated" VALUE 0x8025EEF0 Val_Ws16 655.3500 DtyCyc -327.6800 327.6700 FORMAT "%8.4" /end CHARACTERISTIC
/begin CHARACTERISTIC Fan1_StdCal.uBattMin_C " / Minimum value of battery voltage to enable Clean and Verify" VALUE 0x8025EEF2 Val_Ws16 1310700. Volt_Batt -655360.0 655340.0 FORMAT "%8.1" /end CHARACTERISTIC
/begin CHARACTERISTIC Fan1_StdCal.uBattMax_C " / Maximum value of battery voltage to enable zero point adaption" VALUE 0x8025EEF4 Val_Ws16 1310700. Volt_Batt -655360.0 655340.0 FORMAT "%8.1" /end CHARACTERISTIC
/begin CHARACTERISTIC Fan1_StdCal.tiShOffCtrlDne_C " / Delay for deactivation of the actuator when shut off is done" VALUE 0x8025EEF6 Val_Ws16 655350.0 Time_ms -327680.0 327670.0 FORMAT "%8.1" /end CHARACTERISTIC
/begin CHARACTERISTIC Fan1_StdCal.swtDeactvn_C " / bitmask to deactivate the actuator by calibration" VALUE 0x8025EEF8 Val_Wu8 255.0 OneToOne 0.00 255.0 FORMAT "%5.1" /end CHARACTERISTIC
/begin CHARACTERISTIC Fan1_StdCal.tiSelfDiagStrt_C " / Delay time to start the self diagnosis of the powertstage once the engine state has reached the required state." VALUE 0x8025EEFA Val_Ws16 655350.0 Time_ms -327680.0 327670.0 FORMAT "%8.1" /end CHARACTERISTIC
/begin CHARACTERISTIC Fan1_StdCal.flgReacvnPostDrv_C " / e_:Reactivation of actuator at transition into POSTDRIVE.:_e;d_:Reaktivierung des Stellers beim Ã?bergang in den POSTDRIVE.:_d" VALUE 0x8025EEFC Val_Wu8 255.0 OneToOne 0.00 255.0 FORMAT "%5.1" /end CHARACTERISTIC
/begin CHARACTERISTIC Fan1_StdCal.rPsRlyOff_C " / e_:Calibration to indicate the switch-off dutycycle:_e;d_:Kalibrierung zur Anzeige des Ausschaltzyklus:_d" VALUE 0x8025EEFE Val_Ws16 655.3500 DtyCyc -327.6800 327.6700 FORMAT "%8.4" /end CHARACTERISTIC
/begin CHARACTERISTIC Fan1_StdCal.tiRlyOnDly_C " / e_:Calibration to delay the enabling of powerstage:_e;d_:Kalibrierung, um die Aktivierung der Endstufe zu verzögern:_d" VALUE 0x8025EF00 Val_Ws16 33.55392 RBPtCel_ti_5p12em4_1 -16.77722 16.77670 FORMAT "%8.5" /end CHARACTERISTIC
/begin CHARACTERISTIC Fan1_StdCal.nFMInWinMsk_C " / e_:Calibration mask to select the proper window representing the actuator jammed error:_e;d_:Maske für die Auswahl des Frequenzfensters für das blockierte Ventil:_d" VALUE 0x8025EF04 Val_Wu32 4294967295.00 OneToOne 0.00 4294967295.00 FORMAT "%13.2" /end CHARACTERISTIC
/begin CHARACTERISTIC Fan1_StdCal.tiFMInDeb_C " / e_:Time for debouncing the frequency window::_e;d_:Zeit zum Entprellen des Frequenzfensters:_d" VALUE 0x8025EF08 Val_Wu8 2550. Time_ms 0.00 2550. FORMAT "%5.0" /end CHARACTERISTIC
/begin CHARACTERISTIC Fan1_StdCal.tiJamActrWait_C " / e_:Time to start the jammed actuator debouncing after the preliminary error:_e;d_:Zeit zum Starten der Entprellung des blockierten Stellers nach dem vorläufigen Fehler:_d" VALUE 0x8025EF0A Val_Ws16 6553.500 t_q0p1 -3276.800 3276.700 FORMAT "%8.3" /end CHARACTERISTIC
/begin CHARACTERISTIC Fan1_swtConf2_C "" VALUE 0x8025F458 Val_Wu32 4294967295.00 OneToOne 0.00 4294967295.00 FORMAT "%13.2" /end CHARACTERISTIC
/begin CHARACTERISTIC Fan1_swtConfStdActrSwVers162_C "" VALUE 0x8025F45C Val_Wu32 4294967295.00 OneToOne 0.00 4294967295.00 FORMAT "%13.2" /end CHARACTERISTIC
/begin CHARACTERISTIC Fan1_swtConf_C "" VALUE 0x8025F460 Val_Wu32 4294967295.00 OneToOne 0.00 4294967295.00 FORMAT "%13.2" /end CHARACTERISTIC
/begin CHARACTERISTIC Fan1_swtPsDiag_C "" VALUE 0x8025F4D8 Val_Wu8 255.0 OneToOne 0.00 255.0 FORMAT "%5.1" /end CHARACTERISTIC
/begin CHARACTERISTIC FanCtl_ratCoolgDes1_T "curve to modify the control area depending on the caracteristic of fan 1" CURVE 0x8025091E RB_Curve_U8_U8 255.0 RBPtCel_Perc_1p0_1 0.00 255.0 FORMAT "%5.1"
 /begin AXIS_DESCR STD_AXIS NO_INPUT_QUANTITY RBPtCel_Perc_1p0_1 5 0.00 255.0 FORMAT "%5.1" DEPOSIT ABSOLUTE /end AXIS_DESCR
/end CHARACTERISTIC
/begin CHARACTERISTIC FanCtl_ratCoolgFan1Err_C "ratio which is sent during an error of input signals for fan 1" VALUE 0x80250929 RB_Val_Wu8 255.0 RBPtCel_Perc_1p0_1 0.00 255.0 FORMAT "%5.1" /end CHARACTERISTIC
/begin CHARACTERISTIC FanCtl_ratSpdFan1Win1L_C "lower threshold of the first resonanz area fade out of fan 1" VALUE 0x8025092A RB_Val_Wu8 255.0 RBPtCel_Perc_1p0_1 0.00 255.0 FORMAT "%5.1" /end CHARACTERISTIC
/begin CHARACTERISTIC FanCtl_ratSpdFan1Win1R_C "upper threshold of the first resonanz area fade out of fan 1" VALUE 0x8025092B RB_Val_Wu8 255.0 RBPtCel_Perc_1p0_1 0.00 255.0 FORMAT "%5.1" /end CHARACTERISTIC
/begin CHARACTERISTIC FanCtl_ratSpdFan1Win2L_C "lower threshold of the second resonanz area fade out of fan 1" VALUE 0x8025092C RB_Val_Wu8 255.0 RBPtCel_Perc_1p0_1 0.00 255.0 FORMAT "%5.1" /end CHARACTERISTIC
/begin CHARACTERISTIC FanCtl_ratSpdFan1Win2R_C "upper threshold of the second resonanz area fade out of fan 1" VALUE 0x8025092D RB_Val_Wu8 255.0 RBPtCel_Perc_1p0_1 0.00 255.0 FORMAT "%5.1" /end CHARACTERISTIC
/begin CHARACTERISTIC FanCtl_ratSpdFan1Win3L_C "lower threshold of the third resonanz area fade out of fan 1" VALUE 0x8025092E RB_Val_Wu8 255.0 RBPtCel_Perc_1p0_1 0.00 255.0 FORMAT "%5.1" /end CHARACTERISTIC
/begin CHARACTERISTIC FanCtl_ratSpdFan1Win3R_C "upper threshold of the third resonanz area fade out of fan 1" VALUE 0x8025092F RB_Val_Wu8 255.0 RBPtCel_Perc_1p0_1 0.00 255.0 FORMAT "%5.1" /end CHARACTERISTIC
/begin CHARACTERISTIC FanRly1Posn_SwtGDD_I.flgIvt_C "class for digital input acquisition / flag for inverting the status" VALUE 0x80250934 RB_Val_Wu8 255.0 boolean 0.00 255.0 FORMAT "%5.1" /end CHARACTERISTIC
/begin CHARACTERISTIC FanRly1Posn_SwtGDD_I.tiDebHiLo_C "class for digital input acquisition / debounce time for high to low transitions" VALUE 0x80250936 RB_Val_Ws16 655350.0 RBPtCel_ti_10p0_1 -327680.0 327670.0 FORMAT "%8.1" /end CHARACTERISTIC
/begin CHARACTERISTIC FanRly1Posn_SwtGDD_I.tiDebLoHi_C "class for digital input acquisition / debounce time for low to high transitions" VALUE 0x80250938 RB_Val_Ws16 655350.0 RBPtCel_ti_10p0_1 -327680.0 327670.0 FORMAT "%8.1" /end CHARACTERISTIC
/begin CHARACTERISTIC FanSpd_ADCCal.numSRCTempSel_C "Calibration structure for ADC and SENT / Selection of temperature for signal range check" VALUE 0x8025093C RB_Val_Wu8 255.000000000 DELIB_ALLTEMP_VERB_COMPU 0.00 255.000000000 FORMAT "%13.9" /end CHARACTERISTIC
/begin CHARACTERISTIC FanSpd_ADCCal.tiSRCMaxDebOK_C "Calibration structure for ADC and SENT / Error healing deounce time" VALUE 0x80250940 RB_Val_Ws32 42949672950.0 Time_ms -21474836480.0 21474836470.0 FORMAT "%13.1" /end CHARACTERISTIC
/begin CHARACTERISTIC FanSpd_ADCCal.uSRCMax_C "Calibration structure for ADC and SENT / Maximum threshold voltage for SRC" VALUE 0x80250944 RB_Val_Ws16 13107.00 Volt -6553.600 6553.400 FORMAT "%8.3" /end CHARACTERISTIC
/begin CHARACTERISTIC FanSpd_ADCCal.uSRCMin_C "Calibration structure for ADC and SENT / Minimum threshold voltage for SRC" VALUE 0x80250946 RB_Val_Ws16 13107.00 Volt -6553.600 6553.400 FORMAT "%8.3" /end CHARACTERISTIC
/begin CHARACTERISTIC FanSpd_ADCCal.uSRCOpn_C "Calibration structure for ADC and SENT / Maximum threshold for open SRC connection error." VALUE 0x80250948 RB_Val_Ws16 13107.00 Volt -6553.600 6553.400 FORMAT "%8.3" /end CHARACTERISTIC
/begin CHARACTERISTIC FanSpd_ADCSensTransf_f_CUR "" CURVE 0x8025F4DC RB_Curve_R32_R32_sao 2.00000000E+037 RBPtCel_n_1p0_1 -1.00000000E+037 1.00000000E+037 FORMAT "%13.3" EXTENDED_LIMITS -3.40282347E+038 3.40282347E+038
 /begin AXIS_DESCR STD_AXIS FanSpd_uRaw_f RBPtCel_u_1p0_2 25 -1.00000000E+037 1.00000000E+037 FORMAT "%13.3" EXTENDED_LIMITS -3.40282347E+038 3.40282347E+038 DEPOSIT ABSOLUTE /end AXIS_DESCR
/end CHARACTERISTIC
/begin CHARACTERISTIC FanSpd_tiPT1Fil_C "" VALUE 0x8025F640 Val_Ws32 4294.9672940000000 TimeDelay_s 0.0000020000000 4294.9672959999998 FORMAT "%19.14" EXTENDED_LIMITS 0.000002000000001 4294.9672959999998 /end CHARACTERISTIC
/begin CHARACTERISTIC FanSpd_tiSRCMaxDefDeb_CUR "" CURVE 0x8025F5A8 RB_Curve_S16_S32_sao 42949672950.0 Time_ms -21474836480.0 21474836470.0 FORMAT "%13.1"
 /begin AXIS_DESCR STD_AXIS FanSpd_tRefSnsr_mp Temp_Cels 25 -3549.940 3003.560 FORMAT "%8.3" DEPOSIT ABSOLUTE /end AXIS_DESCR
/end CHARACTERISTIC
/begin CHARACTERISTIC PEnv_facCnvnSlopDig_C "conversion slope for ambient air pressure sensor digital" VALUE 0x802508A8 RB_Val_Wu16 0.9999847 fak_uw_b1 0.00 0.9999847 FORMAT "%9.7" /end CHARACTERISTIC
/begin CHARACTERISTIC PEnv_flgDiSnsrPlaus_C "Switch of fault detection of sensor internal plausible diagnosis if TRUE" VALUE 0x802508AA RB_Val_Wu8 1.00000000000 B_TRUE 0.00 1.00000000000 FORMAT "%13.11" /end CHARACTERISTIC
/begin CHARACTERISTIC PEnv_flgErrStEna_C "Fault simulation and healing simulation in combination with PEnv_stSensErrVal_C if value True, use this only for tests in calibration mode." VALUE 0x802508AB RB_Val_Wu8 1.00000000000 B_TRUE 0.00 1.00000000000 FORMAT "%13.11" /end CHARACTERISTIC
/begin CHARACTERISTIC PEnv_pAirFil_T "pressure difference at air filter" CURVE 0x802508C0 RB_Curve_S16_S16 5119.922 p_q0p078 -2560.000 2559.922 FORMAT "%8.3"
 /begin AXIS_DESCR STD_AXIS NO_INPUT_QUANTITY m_uw_b6553p5 8 -3276.800 3276.700 FORMAT "%8.3" DEPOSIT ABSOLUTE /end AXIS_DESCR
/end CHARACTERISTIC
/begin CHARACTERISTIC PEnv_pCnvnOffs_C "conversion offset for ambient air pressure sensor" VALUE 0x802508AC RB_Val_Wu16 2559.961 p_q0p039 0.00 2559.961 FORMAT "%8.3" /end CHARACTERISTIC
/begin CHARACTERISTIC PEnv_pDft_C "substitute value for ambient pressure in case of sensor failure" VALUE 0x802508E2 RB_Val_Wu16 2559.961 p_q0p039 0.00 2559.961 FORMAT "%8.3" /end CHARACTERISTIC
/begin CHARACTERISTIC PEnv_pDifEnvThrVlvUsMax_C "Difference tolerance ambient pressure modell by boost pressure maximal" VALUE 0x802508E4 RB_Val_Wu16 2559.961 p_q0p039 0.00 2559.961 FORMAT "%8.3" /end CHARACTERISTIC
/begin CHARACTERISTIC PEnv_pDifJmpMax_C "upper limit for continuous check" VALUE 0x802508F8 RB_Val_Wu16 2559.961 p_q0p039 0.00 2559.961 FORMAT "%8.3" /end CHARACTERISTIC
/begin CHARACTERISTIC PEnv_pDifLdcMax_C "upper limit for comparison of ambient pressure from last-/actual driving cycle" VALUE 0x802508FA RB_Val_Wu16 2559.961 p_q0p039 0.00 2559.961 FORMAT "%8.3" /end CHARACTERISTIC
/begin CHARACTERISTIC PEnv_pEnvAirmfMdlTolrMax_C "Multiplicative tolerance ambient pressure modell by mass flow correction factor maximal" VALUE 0x802508E6 RB_Val_Wu16 1.999969 fak_uw_b2 0.00 1.999969 FORMAT "%8.6" /end CHARACTERISTIC
/begin CHARACTERISTIC PEnv_pEnvAirmfMdlTolrMin_C "Multiplicative tolerance ambient pressure modell by mass flow correction factor minimal" VALUE 0x802508E8 RB_Val_Wu16 1.999969 fak_uw_b2 0.00 1.999969 FORMAT "%8.6" /end CHARACTERISTIC
/begin CHARACTERISTIC PEnv_pMaxSnsrTolr_C "max tolerances of ambient pressure sensor" VALUE 0x802508FC RB_Val_Wu16 2559.961 p_q0p039 0.00 2559.961 FORMAT "%8.3" /end CHARACTERISTIC
/begin CHARACTERISTIC PEnv_pPlausThdMax_C "upper limit for range check ambient pressure" VALUE 0x802508FE RB_Val_Wu16 2559.961 p_q0p039 0.00 2559.961 FORMAT "%8.3" /end CHARACTERISTIC
/begin CHARACTERISTIC PEnv_pPlausThdMin_C "lower limit for range check ambient pressure" VALUE 0x80250900 RB_Val_Wu16 2559.961 p_q0p039 0.00 2559.961 FORMAT "%8.3" /end CHARACTERISTIC
/begin CHARACTERISTIC PEnv_stSensErrVal_C "Fault simulation and healing simulation in combination with PEnv_flgErrStEna_C, use this only for tests in calibration mode. Fault simulation with error masks, e.g. OBS_SPI_ERR_MASK__CRC_ERROR, healing with the value zero." VALUE 0x802508B0 RB_Val_Wu32 4294967295.00 OneToOne 0.00 4294967295.00 FORMAT "%13.2" /end CHARACTERISTIC
/begin CHARACTERISTIC PEnv_swtCodDiag_C "Codeword plausibilty diagnosis ambient air pressure sensor" VALUE 0x80250902 RB_Val_Wu8 255.0 dez 0.00 255.0 FORMAT "%5.1" /end CHARACTERISTIC
/begin CHARACTERISTIC PEnv_swtCodVd_C "Code word ambient presure adaptation via pressure sensor at the intake manifold" VALUE 0x802508EA RB_Val_Wu8 255.0 dez 0.00 255.0 FORMAT "%5.1" /end CHARACTERISTIC
/begin CHARACTERISTIC PEnv_tiCcLT_C "time constant for ambient pressure lowpass filter in continuity check" VALUE 0x80250904 RB_Val_Ws32 4294.9672940000000 TimeDelay_s 0.0000020000000 4294.9672959999998 FORMAT "%19.14" EXTENDED_LIMITS 0.000002000000001 4294.9672959999998 /end CHARACTERISTIC
/begin CHARACTERISTIC PEnv_tiConpEnvMdl_C "Time constant low pass ambient pressure modell by mass flow correction factor" VALUE 0x802508EC RB_Val_Ws32 4294.9672940000000 TimeDelay_s 0.0000020000000 4294.9672959999998 FORMAT "%19.14" EXTENDED_LIMITS 0.000002000000001 4294.9672959999998 /end CHARACTERISTIC
/begin CHARACTERISTIC PEnv_tiDebSnsrPlaus_C "Debounce time for sensor reset due to plausibility faults" VALUE 0x802508B4 RB_Val_Ws32 2147.48364700 Time_Dt 0.00 2147.48364700 FORMAT "%13.8" EXTENDED_LIMITS -2147.48364800 2147.48364700 /end CHARACTERISTIC
/begin CHARACTERISTIC PEnv_tiDlycfIntkVlvAdjmt_C "Time delay for zyklus from throttle adaption" VALUE 0x802508F0 RB_Val_Ws32 2147.48364600 Time_Dt 0.00000100 2147.48364700 FORMAT "%13.8" EXTENDED_LIMITS -2147.48364800 2147.48364700 /end CHARACTERISTIC
/begin CHARACTERISTIC PEnv_tiDlyRawVld_C "delay for condition ambient pressure signal valid" VALUE 0x80250908 RB_Val_Ws32 4294.96729500 Time_Dt -2147.48364800 2147.48364700 FORMAT "%13.8" /end CHARACTERISTIC
/begin CHARACTERISTIC PEnv_tiDrvDly_C "Time delay for sensor reset in drive" VALUE 0x802508B8 RB_Val_Ws32 2147.48364700 Time_Dt 0.00 2147.48364700 FORMAT "%13.8" EXTENDED_LIMITS -2147.48364800 2147.48364700 /end CHARACTERISTIC
/begin CHARACTERISTIC PEnv_tiPLT_C "time constant for filtering PEnv_p and PEnv_FacCorrAlti" VALUE 0x802508F4 RB_Val_Ws32 2147.48364700 Time_Dt 0.00 2147.48364700 FORMAT "%13.8" EXTENDED_LIMITS -2147.48364800 2147.48364700 /end CHARACTERISTIC
/begin CHARACTERISTIC PEnv_tiSnsrBootDly_C "Time delay for sensor boot up after reset" VALUE 0x802508BC RB_Val_Ws32 2147.48364700 Time_Dt 0.00 2147.48364700 FORMAT "%13.8" EXTENDED_LIMITS -2147.48364800 2147.48364700 /end CHARACTERISTIC
/begin CHARACTERISTIC SF_PU "Sum Fault PU" VAL_BLK 0x8025090C RB_ValA_Wu16 5.00000000000 dfp_verbal 0.00 5.00000000000 FORMAT "%13.11" READ_ONLY MATRIX_DIM 5 /end CHARACTERISTIC
/begin MEASUREMENT B_pugg_msg "condition: ambient pressure from sensor valid" UBYTE B_TRUE 1 100 0.00 1.00000000000 BIT_MASK 0x1 FORMAT "%13.11" ECU_ADDRESS 0x7000025E
 /begin IF_DATA XCPplus 0x0102
  /begin DAQ_EVENT VARIABLE /end DAQ_EVENT
 /end IF_DATA
/end MEASUREMENT
/begin MEASUREMENT B_pug_msg "condition: ambient pressure valid" UBYTE B_TRUE 1 100 0.00 1.00000000000 BIT_MASK 0x1 FORMAT "%13.11" ECU_ADDRESS 0x6002342D
 /begin IF_DATA XCPplus 0x0102
  /begin DAQ_EVENT VARIABLE /end DAQ_EVENT
 /end IF_DATA
/end MEASUREMENT
/begin MEASUREMENT B_purg_msg "Condition ambient pressure sensor valid" UBYTE B_TRUE 1 100 0.00 1.00000000000 BIT_MASK 0x1 FORMAT "%13.11" ECU_ADDRESS 0x7000025D
 /begin IF_DATA XCPplus 0x0102
  /begin DAQ_EVENT VARIABLE /end DAQ_EVENT
 /end IF_DATA
/end MEASUREMENT
/begin MEASUREMENT DDRC_St.DFC_ElTSPtSysLimDrvErr "" ULONG DFC_OneToOne 1 100 0.00 536870911.000 BIT_MASK 0x1fffffff FORMAT "%13.3" ECU_ADDRESS 0x6001C3A4 /end MEASUREMENT
/begin MEASUREMENT DDRC_St.DFC_ElTSPtSysLimRgnErr "" ULONG DFC_OneToOne 1 100 0.00 536870911.000 BIT_MASK 0x1fffffff FORMAT "%13.3" ECU_ADDRESS 0x6001C3A8 /end MEASUREMENT
/begin MEASUREMENT DDRC_St.DFC_PEnvSigRngMax "" ULONG DFC_OneToOne 1 100 0.00 536870911.000 BIT_MASK 0x1fffffff FORMAT "%13.3" ECU_ADDRESS 0x6001C448 /end MEASUREMENT
/begin MEASUREMENT DDRC_St.DFC_PEnvSigRngMin "" ULONG DFC_OneToOne 1 100 0.00 536870911.000 BIT_MASK 0x1fffffff FORMAT "%13.3" ECU_ADDRESS 0x6001C44C /end MEASUREMENT
/begin MEASUREMENT DDRC_St.DFC_EmWakeupSigOL "" ULONG DFC_OneToOne 1 100 0.00 536870911.000 BIT_MASK 0x1fffffff FORMAT "%13.3" ECU_ADDRESS 0x6001CA4C /end MEASUREMENT
/begin MEASUREMENT DDRC_St.DFC_EmWakeupSigOvrTemp "" ULONG DFC_OneToOne 1 100 0.00 536870911.000 BIT_MASK 0x1fffffff FORMAT "%13.3" ECU_ADDRESS 0x6001CA50 /end MEASUREMENT
/begin MEASUREMENT DDRC_St.DFC_EmWakeupSigSCB "" ULONG DFC_OneToOne 1 100 0.00 536870911.000 BIT_MASK 0x1fffffff FORMAT "%13.3" ECU_ADDRESS 0x6001CA54 /end MEASUREMENT
/begin MEASUREMENT DDRC_St.DFC_EmWakeupSigSCG "" ULONG DFC_OneToOne 1 100 0.00 536870911.000 BIT_MASK 0x1fffffff FORMAT "%13.3" ECU_ADDRESS 0x6001CA58 /end MEASUREMENT
/begin MEASUREMENT DDRC_St.DFC_Fan1OL "" ULONG DFC_OneToOne 1 100 0.00 536870911.000 BIT_MASK 0x1fffffff FORMAT "%13.3" ECU_ADDRESS 0x6001CA5C /end MEASUREMENT
/begin MEASUREMENT DDRC_St.DFC_Fan1OvrTemp "" ULONG DFC_OneToOne 1 100 0.00 536870911.000 BIT_MASK 0x1fffffff FORMAT "%13.3" ECU_ADDRESS 0x6001CA60 /end MEASUREMENT
/begin MEASUREMENT DDRC_St.DFC_Fan1SCB "" ULONG DFC_OneToOne 1 100 0.00 536870911.000 BIT_MASK 0x1fffffff FORMAT "%13.3" ECU_ADDRESS 0x6001CA64 /end MEASUREMENT
/begin MEASUREMENT DDRC_St.DFC_FanSpdSRCMin "" ULONG DFC_OneToOne 1 100 0.00 536870911.000 BIT_MASK 0x1fffffff FORMAT "%13.3" ECU_ADDRESS 0x6001CA70 /end MEASUREMENT
/begin MEASUREMENT DDRC_St.DFC_Fan1SCG "" UWORD DFC_OneToOne 1 100 0.00 8191.000 BIT_MASK 0x1fff FORMAT "%8.3" ECU_ADDRESS 0x60021FA0 /end MEASUREMENT
/begin MEASUREMENT DDRC_St.DFC_FanSpdSRCOpn "" UWORD DFC_OneToOne 1 100 0.00 8191.000 BIT_MASK 0x1fff FORMAT "%8.3" ECU_ADDRESS 0x60021FA6 /end MEASUREMENT
/begin MEASUREMENT DDRC_St.DFC_ElMActvDchaFlt "" UWORD DFC_OneToOne 1 100 0.00 8191.000 BIT_MASK 0x1fff FORMAT "%8.3" ECU_ADDRESS 0x6002200A /end MEASUREMENT
/begin MEASUREMENT DDRC_St.DFC_ElMImobAuthent "" UWORD DFC_OneToOne 1 100 0.00 8191.000 BIT_MASK 0x1fff FORMAT "%8.3" ECU_ADDRESS 0x6002200E /end MEASUREMENT
/begin MEASUREMENT DDRC_St.DFC_ElMIsoMonFlt "" UWORD DFC_OneToOne 1 100 0.00 8191.000 BIT_MASK 0x1fff FORMAT "%8.3" ECU_ADDRESS 0x60022010 /end MEASUREMENT
/begin MEASUREMENT DDRC_St.DFC_ElMIvtrCooltT01 "" UWORD DFC_OneToOne 1 100 0.00 8191.000 BIT_MASK 0x1fff FORMAT "%8.3" ECU_ADDRESS 0x60022014 /end MEASUREMENT
/begin MEASUREMENT DDRC_St.DFC_ElMIvtrEmgyShtDwn01 "" UWORD DFC_OneToOne 1 100 0.00 8191.000 BIT_MASK 0x1fff FORMAT "%8.3" ECU_ADDRESS 0x60022016 /end MEASUREMENT
/begin MEASUREMENT DDRC_St.DFC_ElMIvtrFailr01 "" UWORD DFC_OneToOne 1 100 0.00 8191.000 BIT_MASK 0x1fff FORMAT "%8.3" ECU_ADDRESS 0x60022018 /end MEASUREMENT
/begin MEASUREMENT DDRC_St.DFC_ElMIvtrIntlck01 "" UWORD DFC_OneToOne 1 100 0.00 8191.000 BIT_MASK 0x1fff FORMAT "%8.3" ECU_ADDRESS 0x6002201A /end MEASUREMENT
/begin MEASUREMENT DDRC_St.DFC_ElMIvtrTErr01 "" UWORD DFC_OneToOne 1 100 0.00 8191.000 BIT_MASK 0x1fff FORMAT "%8.3" ECU_ADDRESS 0x6002201C /end MEASUREMENT
/begin MEASUREMENT DDRC_St.DFC_ElMPwrAuthn "" UWORD DFC_OneToOne 1 100 0.00 8191.000 BIT_MASK 0x1fff FORMAT "%8.3" ECU_ADDRESS 0x60022026 /end MEASUREMENT
/begin MEASUREMENT DDRC_St.DFC_ElMSpdErr01 "" UWORD DFC_OneToOne 1 100 0.00 8191.000 BIT_MASK 0x1fff FORMAT "%8.3" ECU_ADDRESS 0x60022028 /end MEASUREMENT
/begin MEASUREMENT DDRC_St.DFC_ElMSvs01 "" UWORD DFC_OneToOne 1 100 0.00 8191.000 BIT_MASK 0x1fff FORMAT "%8.3" ECU_ADDRESS 0x6002202A /end MEASUREMENT
/begin MEASUREMENT DDRC_St.DFC_PEnvCcMax "" UWORD DFC_OneToOne 1 100 0.00 8191.000 BIT_MASK 0x1fff FORMAT "%8.3" ECU_ADDRESS 0x6002202C /end MEASUREMENT
/begin MEASUREMENT DDRC_St.DFC_PEnvCcMin "" UWORD DFC_OneToOne 1 100 0.00 8191.000 BIT_MASK 0x1fff FORMAT "%8.3" ECU_ADDRESS 0x6002202E /end MEASUREMENT
/begin MEASUREMENT DDRC_St.DFC_PEnvRngChkMax "" UWORD DFC_OneToOne 1 100 0.00 8191.000 BIT_MASK 0x1fff FORMAT "%8.3" ECU_ADDRESS 0x60022030 /end MEASUREMENT
/begin MEASUREMENT DDRC_St.DFC_PEnvRngChkMin "" UWORD DFC_OneToOne 1 100 0.00 8191.000 BIT_MASK 0x1fff FORMAT "%8.3" ECU_ADDRESS 0x60022032 /end MEASUREMENT
/begin MEASUREMENT DDRC_St.DFC_PEnvSnsrPlaus "" UWORD DFC_OneToOne 1 100 0.00 8191.000 BIT_MASK 0x1fff FORMAT "%8.3" ECU_ADDRESS 0x60022034 /end MEASUREMENT
/begin MEASUREMENT DFC_st.DFC_ElTSPtSysLimDrvErr "" UBYTE DFC_OneToOne 1 100 0.00 255.0 FORMAT "%5.1" ECU_ADDRESS 0x60034A4C /end MEASUREMENT
/begin MEASUREMENT DFC_st.DFC_ElTSPtSysLimRgnErr "" UBYTE DFC_OneToOne 1 100 0.00 255.0 FORMAT "%5.1" ECU_ADDRESS 0x60034A4D /end MEASUREMENT
/begin MEASUREMENT DFC_st.DFC_PEnvSigRngMax "" UBYTE DFC_OneToOne 1 100 0.00 255.0 FORMAT "%5.1" ECU_ADDRESS 0x60034A75 /end MEASUREMENT
/begin MEASUREMENT DFC_st.DFC_PEnvSigRngMin "" UBYTE DFC_OneToOne 1 100 0.00 255.0 FORMAT "%5.1" ECU_ADDRESS 0x60034A76 /end MEASUREMENT
/begin MEASUREMENT DFC_st.DFC_EmWakeupSigOL "" UBYTE DFC_OneToOne 1 100 0.00 255.0 FORMAT "%5.1" ECU_ADDRESS 0x60034BF6 /end MEASUREMENT
/begin MEASUREMENT DFC_st.DFC_EmWakeupSigOvrTemp "" UBYTE DFC_OneToOne 1 100 0.00 255.0 FORMAT "%5.1" ECU_ADDRESS 0x60034BF7 /end MEASUREMENT
/begin MEASUREMENT DFC_st.DFC_EmWakeupSigSCB "" UBYTE DFC_OneToOne 1 100 0.00 255.0 FORMAT "%5.1" ECU_ADDRESS 0x60034BF8 /end MEASUREMENT
/begin MEASUREMENT DFC_st.DFC_EmWakeupSigSCG "" UBYTE DFC_OneToOne 1 100 0.00 255.0 FORMAT "%5.1" ECU_ADDRESS 0x60034BF9 /end MEASUREMENT
/begin MEASUREMENT DFC_st.DFC_Fan1OL "" UBYTE DFC_OneToOne 1 100 0.00 255.0 FORMAT "%5.1" ECU_ADDRESS 0x60034BFA /end MEASUREMENT
/begin MEASUREMENT DFC_st.DFC_Fan1OvrTemp "" UBYTE DFC_OneToOne 1 100 0.00 255.0 FORMAT "%5.1" ECU_ADDRESS 0x60034BFB /end MEASUREMENT
/begin MEASUREMENT DFC_st.DFC_Fan1SCB "" UBYTE DFC_OneToOne 1 100 0.00 255.0 FORMAT "%5.1" ECU_ADDRESS 0x60034BFC /end MEASUREMENT
/begin MEASUREMENT DFC_st.DFC_FanSpdSRCMin "" UBYTE DFC_OneToOne 1 100 0.00 255.0 FORMAT "%5.1" ECU_ADDRESS 0x60034BFF /end MEASUREMENT
/begin MEASUREMENT DFC_st.DFC_Fan1SCG "" UBYTE DFC_OneToOne 1 100 0.00 255.0 FORMAT "%5.1" ECU_ADDRESS 0x60034C27 /end MEASUREMENT
/begin MEASUREMENT DFC_st.DFC_FanSpdSRCOpn "" UBYTE DFC_OneToOne 1 100 0.00 255.0 FORMAT "%5.1" ECU_ADDRESS 0x60034C2A /end MEASUREMENT
/begin MEASUREMENT DFC_st.DFC_ElMActvDchaFlt "" UBYTE DFC_OneToOne 1 100 0.00 255.0 FORMAT "%5.1" ECU_ADDRESS 0x60034C5C /end MEASUREMENT
/begin MEASUREMENT DFC_st.DFC_ElMImobAuthent "" UBYTE DFC_OneToOne 1 100 0.00 255.0 FORMAT "%5.1" ECU_ADDRESS 0x60034C5E /end MEASUREMENT
/begin MEASUREMENT DFC_st.DFC_ElMIsoMonFlt "" UBYTE DFC_OneToOne 1 100 0.00 255.0 FORMAT "%5.1" ECU_ADDRESS 0x60034C5F /end MEASUREMENT
/begin MEASUREMENT DFC_st.DFC_ElMIvtrCooltT01 "" UBYTE DFC_OneToOne 1 100 0.00 255.0 FORMAT "%5.1" ECU_ADDRESS 0x60034C61 /end MEASUREMENT
/begin MEASUREMENT DFC_st.DFC_ElMIvtrEmgyShtDwn01 "" UBYTE DFC_OneToOne 1 100 0.00 255.0 FORMAT "%5.1" ECU_ADDRESS 0x60034C62 /end MEASUREMENT
/begin MEASUREMENT DFC_st.DFC_ElMIvtrFailr01 "" UBYTE DFC_OneToOne 1 100 0.00 255.0 FORMAT "%5.1" ECU_ADDRESS 0x60034C63 /end MEASUREMENT
/begin MEASUREMENT DFC_st.DFC_ElMIvtrIntlck01 "" UBYTE DFC_OneToOne 1 100 0.00 255.0 FORMAT "%5.1" ECU_ADDRESS 0x60034C64 /end MEASUREMENT
/begin MEASUREMENT DFC_st.DFC_ElMIvtrTErr01 "" UBYTE DFC_OneToOne 1 100 0.00 255.0 FORMAT "%5.1" ECU_ADDRESS 0x60034C65 /end MEASUREMENT
/begin MEASUREMENT DFC_st.DFC_ElMPwrAuthn "" UBYTE DFC_OneToOne 1 100 0.00 255.0 FORMAT "%5.1" ECU_ADDRESS 0x60034C6A /end MEASUREMENT
/begin MEASUREMENT DFC_st.DFC_ElMSpdErr01 "" UBYTE DFC_OneToOne 1 100 0.00 255.0 FORMAT "%5.1" ECU_ADDRESS 0x60034C6B /end MEASUREMENT
/begin MEASUREMENT DFC_st.DFC_ElMSvs01 "" UBYTE DFC_OneToOne 1 100 0.00 255.0 FORMAT "%5.1" ECU_ADDRESS 0x60034C6C /end MEASUREMENT
/begin MEASUREMENT DFC_st.DFC_PEnvCcMax "" UBYTE DFC_OneToOne 1 100 0.00 255.0 FORMAT "%5.1" ECU_ADDRESS 0x60034C6D /end MEASUREMENT
/begin MEASUREMENT DFC_st.DFC_PEnvCcMin "" UBYTE DFC_OneToOne 1 100 0.00 255.0 FORMAT "%5.1" ECU_ADDRESS 0x60034C6E /end MEASUREMENT
/begin MEASUREMENT DFC_st.DFC_PEnvRngChkMax "" UBYTE DFC_OneToOne 1 100 0.00 255.0 FORMAT "%5.1" ECU_ADDRESS 0x60034C6F /end MEASUREMENT
/begin MEASUREMENT DFC_st.DFC_PEnvRngChkMin "" UBYTE DFC_OneToOne 1 100 0.00 255.0 FORMAT "%5.1" ECU_ADDRESS 0x60034C70 /end MEASUREMENT
/begin MEASUREMENT DFC_st.DFC_PEnvSnsrPlaus "" UBYTE DFC_OneToOne 1 100 0.00 255.0 FORMAT "%5.1" ECU_ADDRESS 0x60034C71 /end MEASUREMENT
/begin MEASUREMENT DFC_st.DFC_FanSpdSRCMax "" UBYTE DFC_OneToOne 1 100 0.00 255.0 FORMAT "%5.1" ECU_ADDRESS 0x60034CD5 /end MEASUREMENT
/begin MEASUREMENT DFC_st.DFC_PUmax "" UBYTE DFC_OneToOne 1 100 0.00 255.0 FORMAT "%5.1" ECU_ADDRESS 0x60034D7C /end MEASUREMENT
/begin MEASUREMENT DINH_nrActvInhReas.FID_ElTSPwrChrgnOutErr "" UWORD DINH_ct_Compu 1 100 -4095.000 4096.000 BIT_MASK 0x1fff FORMAT "%8.3" ECU_ADDRESS 0x600212F4 /end MEASUREMENT
/begin MEASUREMENT DINH_nrActvInhReas.FID_ElTSPwrInActErr "" UWORD DINH_ct_Compu 1 100 -4095.000 4096.000 BIT_MASK 0x1fff FORMAT "%8.3" ECU_ADDRESS 0x600212F6 /end MEASUREMENT
/begin MEASUREMENT DINH_nrActvInhReas.FId_ElMNoPrp01 "" UWORD DINH_ct_Compu 1 100 -4095.000 4096.000 BIT_MASK 0x1fff FORMAT "%8.3" ECU_ADDRESS 0x6002144E /end MEASUREMENT
/begin MEASUREMENT DINH_nrActvInhReas.FId_ElMtrqLim01 "" UWORD DINH_ct_Compu 1 100 -4095.000 4096.000 BIT_MASK 0x1fff FORMAT "%8.3" ECU_ADDRESS 0x60021452 /end MEASUREMENT
/begin MEASUREMENT DINH_nrActvInhReas.FId_ElSSACCmprUFlt "" UWORD DINH_ct_Compu 1 100 -4095.000 4096.000 BIT_MASK 0x1fff FORMAT "%8.3" ECU_ADDRESS 0x60021454 /end MEASUREMENT
/begin MEASUREMENT DINH_nrActvInhReas.FId_ElSSCabAirHtUFlt "" UWORD DINH_ct_Compu 1 100 -4095.000 4096.000 BIT_MASK 0x1fff FORMAT "%8.3" ECU_ADDRESS 0x60021456 /end MEASUREMENT
/begin MEASUREMENT DINH_nrActvInhReas.FId_ElSSHvReqEna "" UWORD DINH_ct_Compu 1 100 -4095.000 4096.000 BIT_MASK 0x1fff FORMAT "%8.3" ECU_ADDRESS 0x60021458 /end MEASUREMENT
/begin MEASUREMENT DINH_nrActvInhReas.FId_ElSSUHvDcBus "" UWORD DINH_ct_Compu 1 100 -4095.000 4096.000 BIT_MASK 0x1fff FORMAT "%8.3" ECU_ADDRESS 0x6002145A /end MEASUREMENT
/begin MEASUREMENT DINH_nrActvInhReas.FId_ElTSHvIntlck "" UWORD DINH_ct_Compu 1 100 -4095.000 4096.000 BIT_MASK 0x1fff FORMAT "%8.3" ECU_ADDRESS 0x6002145C /end MEASUREMENT
/begin MEASUREMENT DINH_nrActvInhReas.FId_EmWakeupSigMonOff "" UWORD DINH_ct_Compu 1 100 -4095.000 4096.000 BIT_MASK 0x1fff FORMAT "%8.3" ECU_ADDRESS 0x6002145E /end MEASUREMENT
/begin MEASUREMENT DINH_nrActvInhReas.FId_EmWakeupSigOff "" UWORD DINH_ct_Compu 1 100 -4095.000 4096.000 BIT_MASK 0x1fff FORMAT "%8.3" ECU_ADDRESS 0x60021460 /end MEASUREMENT
/begin MEASUREMENT DINH_nrActvInhReas.FId_EmWakeupSigPsOff "" UWORD DINH_ct_Compu 1 100 -4095.000 4096.000 BIT_MASK 0x1fff FORMAT "%8.3" ECU_ADDRESS 0x60021462 /end MEASUREMENT
/begin MEASUREMENT DINH_nrActvInhReas.FId_EmWakeupSigSnsr "" UWORD DINH_ct_Compu 1 100 -4095.000 4096.000 BIT_MASK 0x1fff FORMAT "%8.3" ECU_ADDRESS 0x60021464 /end MEASUREMENT
/begin MEASUREMENT DINH_nrActvInhReas.FId_EvThermLTClgDmdErr "" UWORD DINH_ct_Compu 1 100 -4095.000 4096.000 BIT_MASK 0x1fff FORMAT "%8.3" ECU_ADDRESS 0x60021468 /end MEASUREMENT
/begin MEASUREMENT DINH_nrActvInhReas.FId_EvThermMTClgDmdErr "" UWORD DINH_ct_Compu 1 100 -4095.000 4096.000 BIT_MASK 0x1fff FORMAT "%8.3" ECU_ADDRESS 0x6002146A /end MEASUREMENT
/begin MEASUREMENT DINH_nrActvInhReas.FId_Fan1ActrOff "" UWORD DINH_ct_Compu 1 100 -4095.000 4096.000 BIT_MASK 0x1fff FORMAT "%8.3" ECU_ADDRESS 0x6002146C /end MEASUREMENT
/begin MEASUREMENT DINH_nrActvInhReas.FId_Fan1Mon "" UWORD DINH_ct_Compu 1 100 -4095.000 4096.000 BIT_MASK 0x1fff FORMAT "%8.3" ECU_ADDRESS 0x6002146E /end MEASUREMENT
/begin MEASUREMENT DINH_nrActvInhReas.FId_Fan1Off "" UWORD DINH_ct_Compu 1 100 -4095.000 4096.000 BIT_MASK 0x1fff FORMAT "%8.3" ECU_ADDRESS 0x60021470 /end MEASUREMENT
/begin MEASUREMENT DINH_nrActvInhReas.FId_Fan1PwrStg "" UWORD DINH_ct_Compu 1 100 -4095.000 4096.000 BIT_MASK 0x1fff FORMAT "%8.3" ECU_ADDRESS 0x60021474 /end MEASUREMENT
/begin MEASUREMENT DINH_nrActvInhReas.FId_FanCtlFan1Err "" UWORD DINH_ct_Compu 1 100 -4095.000 4096.000 BIT_MASK 0x1fff FORMAT "%8.3" ECU_ADDRESS 0x60021476 /end MEASUREMENT
/begin MEASUREMENT DINH_nrActvInhReas.FId_FanSpdEnhdSRCMax "" UWORD DINH_ct_Compu 1 100 -4095.000 4096.000 BIT_MASK 0x1fff FORMAT "%8.3" ECU_ADDRESS 0x6002147A /end MEASUREMENT
/begin MEASUREMENT DINH_nrActvInhReas.FId_FanSpdSSpMon "" UWORD DINH_ct_Compu 1 100 -4095.000 4096.000 BIT_MASK 0x1fff FORMAT "%8.3" ECU_ADDRESS 0x60021482 /end MEASUREMENT
/begin MEASUREMENT DINH_nrActvInhReas.FId_PEnvCc "" UWORD DINH_ct_Compu 1 100 -4095.000 4096.000 BIT_MASK 0x1fff FORMAT "%8.3" ECU_ADDRESS 0x6002150A /end MEASUREMENT
/begin MEASUREMENT DINH_nrActvInhReas.FId_PEnvEnaBndMdl "" UWORD DINH_ct_Compu 1 100 -4095.000 4096.000 BIT_MASK 0x1fff FORMAT "%8.3" ECU_ADDRESS 0x6002150C /end MEASUREMENT
/begin MEASUREMENT DINH_nrActvInhReas.FId_PEnvMeasVld "" UWORD DINH_ct_Compu 1 100 -4095.000 4096.000 BIT_MASK 0x1fff FORMAT "%8.3" ECU_ADDRESS 0x6002150E /end MEASUREMENT
/begin MEASUREMENT DINH_nrActvInhReas.FId_PEnvPlaus "" UWORD DINH_ct_Compu 1 100 -4095.000 4096.000 BIT_MASK 0x1fff FORMAT "%8.3" ECU_ADDRESS 0x60021510 /end MEASUREMENT
/begin MEASUREMENT DINH_nrActvInhReas.FId_PEnvPrc "" UWORD DINH_ct_Compu 1 100 -4095.000 4096.000 BIT_MASK 0x1fff FORMAT "%8.3" ECU_ADDRESS 0x60021512 /end MEASUREMENT
/begin MEASUREMENT DINH_nrActvInhReas.FId_PEnvSigRngVld "" UWORD DINH_ct_Compu 1 100 -4095.000 4096.000 BIT_MASK 0x1fff FORMAT "%8.3" ECU_ADDRESS 0x60021516 /end MEASUREMENT
/begin MEASUREMENT DINH_nrActvInhReas.FId_PEnvSnsrPlaus "" UWORD DINH_ct_Compu 1 100 -4095.000 4096.000 BIT_MASK 0x1fff FORMAT "%8.3" ECU_ADDRESS 0x60021518 /end MEASUREMENT
/begin MEASUREMENT DINH_stFId.FID_ElTSPwrChrgnOutErr "" UWORD DFC_OneToOne 1 100 0.00 65535.00 FORMAT "%8.2" ECU_ADDRESS 0x600212F4 /end MEASUREMENT
/begin MEASUREMENT DINH_stFId.FID_ElTSPwrInActErr "" UWORD DFC_OneToOne 1 100 0.00 65535.00 FORMAT "%8.2" ECU_ADDRESS 0x600212F6 /end MEASUREMENT
/begin MEASUREMENT DINH_stFId.FId_ElMNoPrp01 "" UWORD DFC_OneToOne 1 100 0.00 65535.00 FORMAT "%8.2" ECU_ADDRESS 0x6002144E /end MEASUREMENT
/begin MEASUREMENT DINH_stFId.FId_ElMtrqLim01 "" UWORD DFC_OneToOne 1 100 0.00 65535.00 FORMAT "%8.2" ECU_ADDRESS 0x60021452 /end MEASUREMENT
/begin MEASUREMENT DINH_stFId.FId_ElSSACCmprUFlt "" UWORD DFC_OneToOne 1 100 0.00 65535.00 FORMAT "%8.2" ECU_ADDRESS 0x60021454 /end MEASUREMENT
/begin MEASUREMENT DINH_stFId.FId_ElSSCabAirHtUFlt "" UWORD DFC_OneToOne 1 100 0.00 65535.00 FORMAT "%8.2" ECU_ADDRESS 0x60021456 /end MEASUREMENT
/begin MEASUREMENT DINH_stFId.FId_ElSSHvReqEna "" UWORD DFC_OneToOne 1 100 0.00 65535.00 FORMAT "%8.2" ECU_ADDRESS 0x60021458 /end MEASUREMENT
/begin MEASUREMENT DINH_stFId.FId_ElSSUHvDcBus "" UWORD DFC_OneToOne 1 100 0.00 65535.00 FORMAT "%8.2" ECU_ADDRESS 0x6002145A /end MEASUREMENT
/begin MEASUREMENT DINH_stFId.FId_ElTSHvIntlck "" UWORD DFC_OneToOne 1 100 0.00 65535.00 FORMAT "%8.2" ECU_ADDRESS 0x6002145C /end MEASUREMENT
/begin MEASUREMENT DINH_stFId.FId_EmWakeupSigMonOff "" UWORD DFC_OneToOne 1 100 0.00 65535.00 FORMAT "%8.2" ECU_ADDRESS 0x6002145E /end MEASUREMENT
/begin MEASUREMENT DINH_stFId.FId_EmWakeupSigOff "" UWORD DFC_OneToOne 1 100 0.00 65535.00 FORMAT "%8.2" ECU_ADDRESS 0x60021460 /end MEASUREMENT
/begin MEASUREMENT DINH_stFId.FId_EmWakeupSigPsOff "" UWORD DFC_OneToOne 1 100 0.00 65535.00 FORMAT "%8.2" ECU_ADDRESS 0x60021462 /end MEASUREMENT
/begin MEASUREMENT DINH_stFId.FId_EmWakeupSigSnsr "" UWORD DFC_OneToOne 1 100 0.00 65535.00 FORMAT "%8.2" ECU_ADDRESS 0x60021464 /end MEASUREMENT
/begin MEASUREMENT DINH_stFId.FId_EvThermLTClgDmdErr "" UWORD DFC_OneToOne 1 100 0.00 65535.00 FORMAT "%8.2" ECU_ADDRESS 0x60021468 /end MEASUREMENT
/begin MEASUREMENT DINH_stFId.FId_EvThermMTClgDmdErr "" UWORD DFC_OneToOne 1 100 0.00 65535.00 FORMAT "%8.2" ECU_ADDRESS 0x6002146A /end MEASUREMENT
/begin MEASUREMENT DINH_stFId.FId_Fan1ActrOff "" UWORD DFC_OneToOne 1 100 0.00 65535.00 FORMAT "%8.2" ECU_ADDRESS 0x6002146C /end MEASUREMENT
/begin MEASUREMENT DINH_stFId.FId_Fan1Mon "" UWORD DFC_OneToOne 1 100 0.00 65535.00 FORMAT "%8.2" ECU_ADDRESS 0x6002146E /end MEASUREMENT
/begin MEASUREMENT DINH_stFId.FId_Fan1Off "" UWORD DFC_OneToOne 1 100 0.00 65535.00 FORMAT "%8.2" ECU_ADDRESS 0x60021470 /end MEASUREMENT
/begin MEASUREMENT DINH_stFId.FId_Fan1PwrStg "" UWORD DFC_OneToOne 1 100 0.00 65535.00 FORMAT "%8.2" ECU_ADDRESS 0x60021474 /end MEASUREMENT
/begin MEASUREMENT DINH_stFId.FId_FanCtlFan1Err "" UWORD DFC_OneToOne 1 100 0.00 65535.00 FORMAT "%8.2" ECU_ADDRESS 0x60021476 /end MEASUREMENT
/begin MEASUREMENT DINH_stFId.FId_FanSpdEnhdSRCMax "" UWORD DFC_OneToOne 1 100 0.00 65535.00 FORMAT "%8.2" ECU_ADDRESS 0x6002147A /end MEASUREMENT
/begin MEASUREMENT DINH_stFId.FId_FanSpdSSpMon "" UWORD DFC_OneToOne 1 100 0.00 65535.00 FORMAT "%8.2" ECU_ADDRESS 0x60021482 /end MEASUREMENT
/begin MEASUREMENT DINH_stFId.FId_PEnvCc "" UWORD DFC_OneToOne 1 100 0.00 65535.00 FORMAT "%8.2" ECU_ADDRESS 0x6002150A /end MEASUREMENT
/begin MEASUREMENT DINH_stFId.FId_PEnvEnaBndMdl "" UWORD DFC_OneToOne 1 100 0.00 65535.00 FORMAT "%8.2" ECU_ADDRESS 0x6002150C /end MEASUREMENT
/begin MEASUREMENT DINH_stFId.FId_PEnvMeasVld "" UWORD DFC_OneToOne 1 100 0.00 65535.00 FORMAT "%8.2" ECU_ADDRESS 0x6002150E /end MEASUREMENT
/begin MEASUREMENT DINH_stFId.FId_PEnvPlaus "" UWORD DFC_OneToOne 1 100 0.00 65535.00 FORMAT "%8.2" ECU_ADDRESS 0x60021510 /end MEASUREMENT
/begin MEASUREMENT DINH_stFId.FId_PEnvPrc "" UWORD DFC_OneToOne 1 100 0.00 65535.00 FORMAT "%8.2" ECU_ADDRESS 0x60021512 /end MEASUREMENT
/begin MEASUREMENT DINH_stFId.FId_PEnvSigRngVld "" UWORD DFC_OneToOne 1 100 0.00 65535.00 FORMAT "%8.2" ECU_ADDRESS 0x60021516 /end MEASUREMENT
/begin MEASUREMENT DINH_stFId.FId_PEnvSnsrPlaus "" UWORD DFC_OneToOne 1 100 0.00 65535.00 FORMAT "%8.2" ECU_ADDRESS 0x60021518 /end MEASUREMENT
/begin MEASUREMENT Eem_pwrHvAct01 "Actual power of HV consumer" SWORD RBPtCel_pwr_25p0_1 1 100 -819200.0 819175.0 FORMAT "%8.1" ECU_ADDRESS 0x6001FB72
 /begin IF_DATA XCPplus 0x0102
  /begin DAQ_EVENT VARIABLE /end DAQ_EVENT
 /end IF_DATA
/end MEASUREMENT
/begin MEASUREMENT Eem_pwrHvAct02 "Actual power of HV consumer" SWORD RBPtCel_pwr_25p0_1 1 100 -819200.0 819175.0 FORMAT "%8.1" ECU_ADDRESS 0x6001FB70
 /begin IF_DATA XCPplus 0x0102
  /begin DAQ_EVENT VARIABLE /end DAQ_EVENT
 /end IF_DATA
/end MEASUREMENT
/begin MEASUREMENT Eem_pwrHvAct03 "Actual power of HV consumer" SWORD RBPtCel_pwr_25p0_1 1 100 -819200.0 819175.0 FORMAT "%8.1" ECU_ADDRESS 0x6001FB6E
 /begin IF_DATA XCPplus 0x0102
  /begin DAQ_EVENT VARIABLE /end DAQ_EVENT
 /end IF_DATA
/end MEASUREMENT
/begin MEASUREMENT Eem_pwrHvAct04 "Actual power of HV consumer" SWORD RBPtCel_pwr_25p0_1 1 100 -819200.0 819175.0 FORMAT "%8.1" ECU_ADDRESS 0x6001FB6C
 /begin IF_DATA XCPplus 0x0102
  /begin DAQ_EVENT VARIABLE /end DAQ_EVENT
 /end IF_DATA
/end MEASUREMENT
/begin MEASUREMENT EITS_pwrTotEm "Total power sum of Electrical machine" SWORD leist_q16_W 1 100 -524288.0 524272.0 FORMAT "%8.1" ECU_ADDRESS 0x6001F4CE
 /begin IF_DATA XCPplus 0x0102
  /begin DAQ_EVENT VARIABLE /end DAQ_EVENT
 /end IF_DATA
/end MEASUREMENT
/begin MEASUREMENT ElM_ActSt01_I.ComEmac_flgEmgyShtDwnReq "Actual State mapping for e-machine / Emergency shutdown request from inverter" UBYTE B_TRUE 1 100 0.00 1.00000000000 BIT_MASK 0x1 FORMAT "%13.11" ECU_ADDRESS 0x6001F4D6
 /begin IF_DATA XCPplus 0x0102
  /begin DAQ_EVENT VARIABLE /end DAQ_EVENT
 /end IF_DATA
/end MEASUREMENT
/begin MEASUREMENT ElM_ActSt01_I.ComEmac_flgEmgyShtDwnReq_Sq "Actual State mapping for e-machine / Signal quality for shutdown of the HV network requests" UBYTE SigQly_COMPU_VERB 1 100 0.00 15.0000000000 FORMAT "%13.10" ECU_ADDRESS 0x6001F4D7
 /begin IF_DATA XCPplus 0x0102
  /begin DAQ_EVENT VARIABLE /end DAQ_EVENT
 /end IF_DATA
/end MEASUREMENT
/begin MEASUREMENT ElM_ActSt01_I.ComEmac_stMod "Actual State mapping for e-machine / Operation mode, e-machine" UBYTE OneToOne 1 100 0.00 255.0 FORMAT "%5.1" ECU_ADDRESS 0x6001F4D8
 /begin IF_DATA XCPplus 0x0102
  /begin DAQ_EVENT VARIABLE /end DAQ_EVENT
 /end IF_DATA
/end MEASUREMENT
/begin MEASUREMENT ElM_ActSt01_I.ComEmac_stMod_Sq "Actual State mapping for e-machine / Operation mode, e-machine" UBYTE SigQly_COMPU_VERB 1 100 0.00 15.0000000000 FORMAT "%13.10" ECU_ADDRESS 0x6001F4D9
 /begin IF_DATA XCPplus 0x0102
  /begin DAQ_EVENT VARIABLE /end DAQ_EVENT
 /end IF_DATA
/end MEASUREMENT
/begin MEASUREMENT ElM_ActSt01_I.ElM_flgIvtrComSucc "Actual State mapping for e-machine / This flag is set as soon as the inverter communication is valid and no failure occured" UBYTE B_TRUE 1 100 0.00 1.00000000000 BIT_MASK 0x1 FORMAT "%13.11" ECU_ADDRESS 0x6001F4DA
 /begin IF_DATA XCPplus 0x0102
  /begin DAQ_EVENT VARIABLE /end DAQ_EVENT
 /end IF_DATA
/end MEASUREMENT
/begin MEASUREMENT ElM_ActSt01_I.ElM_stEem "Actual State mapping for e-machine / Actual state of inverter and e-machine" UBYTE OneToOne 1 100 0.00 255.0 FORMAT "%5.1" ECU_ADDRESS 0x6001F4DB
 /begin IF_DATA XCPplus 0x0102
  /begin DAQ_EVENT VARIABLE /end DAQ_EVENT
 /end IF_DATA
/end MEASUREMENT
/begin MEASUREMENT ElM_ActSt01_I.ElM_stOperModAct "Actual State mapping for e-machine / actual operation mode of e-machine" UBYTE RBPtElTrac_stEmOperMod_VERB 1 100 0.00 31.0000000000 FORMAT "%13.10" ECU_ADDRESS 0x6001F4DC
 /begin IF_DATA XCPplus 0x0102
  /begin DAQ_EVENT VARIABLE /end DAQ_EVENT
 /end IF_DATA
/end MEASUREMENT
/begin MEASUREMENT ElM_ActSt01_I.T15_st "Actual State mapping for e-machine / Terminal 15 status" UBYTE B_TRUE 1 100 0.00 1.00000000000 BIT_MASK 0x1 FORMAT "%13.11" ECU_ADDRESS 0x6001F4DD
 /begin IF_DATA XCPplus 0x0102
  /begin DAQ_EVENT VARIABLE /end DAQ_EVENT
 /end IF_DATA
/end MEASUREMENT
/begin MEASUREMENT ElM_DesSt01_I.Eem_flgDchaReq "Class / Flag discharge Request" UBYTE B_TRUE 1 100 0.00 1.00000000000 BIT_MASK 0x1 FORMAT "%13.11" ECU_ADDRESS 0x6001F4D0
 /begin IF_DATA XCPplus 0x0102
  /begin DAQ_EVENT VARIABLE /end DAQ_EVENT
 /end IF_DATA
/end MEASUREMENT
/begin MEASUREMENT ElM_DesSt01_I.ElM_stDesEem "Class / Desired state of Inverter" UBYTE OneToOne 1 100 0.00 255.0 FORMAT "%5.1" ECU_ADDRESS 0x6001F4D1
 /begin IF_DATA XCPplus 0x0102
  /begin DAQ_EVENT VARIABLE /end DAQ_EVENT
 /end IF_DATA
/end MEASUREMENT
/begin MEASUREMENT ElM_DesSt01_I.ElM_stDesEemInt "Class / Desired state of e-machine and inverter used internal to ElTrac" UBYTE RBPtElTrac_stEmOperMod_VERB 1 100 0.00 31.0000000000 FORMAT "%13.10" ECU_ADDRESS 0x6001F4D2
 /begin IF_DATA XCPplus 0x0102
  /begin DAQ_EVENT VARIABLE /end DAQ_EVENT
 /end IF_DATA
/end MEASUREMENT
/begin MEASUREMENT ElM_DesSt01_I.Emac_stIsoMonSwtReqLoc "Class / isolation monitoring request" UBYTE OneToOne 1 100 0.00 255.0 FORMAT "%5.1" ECU_ADDRESS 0x6001F4D3
 /begin IF_DATA XCPplus 0x0102
  /begin DAQ_EVENT VARIABLE /end DAQ_EVENT
 /end IF_DATA
/end MEASUREMENT
/begin MEASUREMENT ElM_DesSt01_I.Emac_stLogl "Class / State of coordinator of electrical machine" UBYTE RBPtElTrac_stEmOperMod_VERB 1 100 0.00 31.0000000000 FORMAT "%13.10" ECU_ADDRESS 0x6001F4D4
 /begin IF_DATA XCPplus 0x0102
  /begin DAQ_EVENT VARIABLE /end DAQ_EVENT
 /end IF_DATA
/end MEASUREMENT
/begin MEASUREMENT ElM_flgDchaReq "Flag for discharge HV battery during comfort and emergenceny discharge" UBYTE B_TRUE 1 100 0.00 1.00000000000 BIT_MASK 0x1 FORMAT "%13.11" ECU_ADDRESS 0x60023156
 /begin IF_DATA XCPplus 0x0102
  /begin DAQ_EVENT VARIABLE /end DAQ_EVENT
 /end IF_DATA
/end MEASUREMENT
/begin MEASUREMENT ElM_flgIsoMonSwtOffReq "isolation monitoring request switch off flag" UBYTE B_TRUE 1 100 0.00 1.00000000000 BIT_MASK 0x1 FORMAT "%13.11" ECU_ADDRESS 0x60023155
 /begin IF_DATA XCPplus 0x0102
  /begin DAQ_EVENT VARIABLE /end DAQ_EVENT
 /end IF_DATA
/end MEASUREMENT
/begin MEASUREMENT ElM_flgIsoMonSwtOnReq "isolation monitoring request switch on flag" UBYTE B_TRUE 1 100 0.00 1.00000000000 BIT_MASK 0x1 FORMAT "%13.11" ECU_ADDRESS 0x60023154
 /begin IF_DATA XCPplus 0x0102
  /begin DAQ_EVENT VARIABLE /end DAQ_EVENT
 /end IF_DATA
/end MEASUREMENT
/begin MEASUREMENT ElM_flgSwtIvtrWakeup "Flag for Inverter wakeup" UBYTE B_TRUE 1 100 0.00 1.00000000000 BIT_MASK 0x1 FORMAT "%13.11" ECU_ADDRESS 0x60023153
 /begin IF_DATA XCPplus 0x0102
  /begin DAQ_EVENT VARIABLE /end DAQ_EVENT
 /end IF_DATA
/end MEASUREMENT
/begin MEASUREMENT ElM_iDcLnkIvtrMax01 "Max. HV current allowed to the inverter." SWORD Curr_A_q0p03125_COMPU 1 100 -1024.000 1023.969 FORMAT "%8.3" ECU_ADDRESS 0x6001FB6A
 /begin IF_DATA XCPplus 0x0102
  /begin DAQ_EVENT VARIABLE /end DAQ_EVENT
 /end IF_DATA
/end MEASUREMENT
/begin MEASUREMENT ElM_iDcLnkIvtrMin01 "Min. HV current allowed to the inverter." SWORD Curr_A_q0p03125_COMPU 1 100 -1024.000 1023.969 FORMAT "%8.3" ECU_ADDRESS 0x6001FB68
 /begin IF_DATA XCPplus 0x0102
  /begin DAQ_EVENT VARIABLE /end DAQ_EVENT
 /end IF_DATA
/end MEASUREMENT
/begin MEASUREMENT ElM_IvtrWakeupTOffD_I.time "Turn off Delay for invertor wakeup / Pointer to internal timer value" SLONG Time_Dt 1 100 -2147.48364800 2147.48364700 FORMAT "%13.8" ECU_ADDRESS 0x60000900 /end MEASUREMENT
/begin MEASUREMENT ElM_stDesEem01 "Desired state of inverter and e-machine 01" UBYTE OneToOne 1 100 0.00 255.0 FORMAT "%5.1" ECU_ADDRESS 0x600235A5
 /begin IF_DATA XCPplus 0x0102
  /begin DAQ_EVENT VARIABLE /end DAQ_EVENT
 /end IF_DATA
/end MEASUREMENT
/begin MEASUREMENT ElM_stDesEemInt01 "Desired state of inverter and e-machine 01" UBYTE RBPtElTrac_stEmOperMod_VERB 1 100 0.00 31.0000000000 FORMAT "%13.10" ECU_ADDRESS 0x600235A3
 /begin IF_DATA XCPplus 0x0102
  /begin DAQ_EVENT VARIABLE /end DAQ_EVENT
 /end IF_DATA
/end MEASUREMENT
/begin MEASUREMENT ElM_stEem01 "Actual state of inverter and e-machine 01" UBYTE OneToOne 1 100 0.00 255.0 FORMAT "%5.1" ECU_ADDRESS 0x600235A2
 /begin IF_DATA XCPplus 0x0102
  /begin DAQ_EVENT VARIABLE /end DAQ_EVENT
 /end IF_DATA
/end MEASUREMENT
/begin MEASUREMENT ElM_stIvtrWakeup "Inverter wakeup status of 5- inverters (Bit0-inverter 01,Bit1 -Inverter 02,....Bit4-Inverter 05)" UBYTE OneToOne 1 100 0.00 255.0 FORMAT "%5.1" ECU_ADDRESS 0x600235A1
 /begin IF_DATA XCPplus 0x0102
  /begin DAQ_EVENT VARIABLE /end DAQ_EVENT
 /end IF_DATA
/end MEASUREMENT
/begin MEASUREMENT ElM_stMaiSwtOn "Main contactor status of the HV Battery" UBYTE OneToOne 1 100 0.00 255.0 FORMAT "%5.1" ECU_ADDRESS 0x600235A0
 /begin IF_DATA XCPplus 0x0102
  /begin DAQ_EVENT VARIABLE /end DAQ_EVENT
 /end IF_DATA
/end MEASUREMENT
/begin MEASUREMENT ElM_stOperModAct01 "actual operation mode of e-machine" UBYTE RBPtElTrac_stEmOperMod_VERB 1 100 0.00 31.0000000000 FORMAT "%13.10" ECU_ADDRESS 0x6002359E
 /begin IF_DATA XCPplus 0x0102
  /begin DAQ_EVENT VARIABLE /end DAQ_EVENT
 /end IF_DATA
/end MEASUREMENT
/begin MEASUREMENT ElM_uMaxLim "Max. DC link voltage (charging)" SWORD Volt_V_q0p03125_COMPU 1 100 -1024.000 1023.969 FORMAT "%8.3" ECU_ADDRESS 0x6001FB5E
 /begin IF_DATA XCPplus 0x0102
  /begin DAQ_EVENT VARIABLE /end DAQ_EVENT
 /end IF_DATA
/end MEASUREMENT
/begin MEASUREMENT ElM_uMinLim "Min. DC link voltage (discharging)" SWORD Volt_V_q0p03125_COMPU 1 100 -1024.000 1023.969 FORMAT "%8.3" ECU_ADDRESS 0x6001FB5C
 /begin IF_DATA XCPplus 0x0102
  /begin DAQ_EVENT VARIABLE /end DAQ_EVENT
 /end IF_DATA
/end MEASUREMENT
/begin MEASUREMENT ElSS_flgHvReq "HV-Request from ElSS" UBYTE B_TRUE 1 100 0.00 1.00000000000 BIT_MASK 0x1 FORMAT "%13.11" ECU_ADDRESS 0x60023497
 /begin IF_DATA XCPplus 0x0102
  /begin DAQ_EVENT VARIABLE /end DAQ_EVENT
 /end IF_DATA
/end MEASUREMENT
/begin MEASUREMENT ElSS_pwrHvAct01 "Local power consumtion of auxillary HV component" SWORD RBPtCel_pwr_25p0_1 1 100 -819200.0 819175.0 FORMAT "%8.1" ECU_ADDRESS 0x6001FB5A
 /begin IF_DATA XCPplus 0x0102
  /begin DAQ_EVENT VARIABLE /end DAQ_EVENT
 /end IF_DATA
/end MEASUREMENT
/begin MEASUREMENT ElSS_pwrHvAct02 "Local power consumtion of auxillary HV component" SWORD RBPtCel_pwr_25p0_1 1 100 -819200.0 819175.0 FORMAT "%8.1" ECU_ADDRESS 0x6001FB58
 /begin IF_DATA XCPplus 0x0102
  /begin DAQ_EVENT VARIABLE /end DAQ_EVENT
 /end IF_DATA
/end MEASUREMENT
/begin MEASUREMENT ElSS_pwrHvAct03 "Local power consumtion of auxillary HV component" SWORD RBPtCel_pwr_25p0_1 1 100 -819200.0 819175.0 FORMAT "%8.1" ECU_ADDRESS 0x6001FB56
 /begin IF_DATA XCPplus 0x0102
  /begin DAQ_EVENT VARIABLE /end DAQ_EVENT
 /end IF_DATA
/end MEASUREMENT
/begin MEASUREMENT ElSS_pwrHvAct04 "Local power consumtion of auxillary HV component" SWORD RBPtCel_pwr_25p0_1 1 100 -819200.0 819175.0 FORMAT "%8.1" ECU_ADDRESS 0x6001FB54
 /begin IF_DATA XCPplus 0x0102
  /begin DAQ_EVENT VARIABLE /end DAQ_EVENT
 /end IF_DATA
/end MEASUREMENT
/begin MEASUREMENT ElSS_stEem01 "HV device state in common naming convention" UBYTE OneToOne 1 100 0.00 255.0 FORMAT "%5.1" ECU_ADDRESS 0x60023599
 /begin IF_DATA XCPplus 0x0102
  /begin DAQ_EVENT VARIABLE /end DAQ_EVENT
 /end IF_DATA
/end MEASUREMENT
/begin MEASUREMENT ElSS_stEem02 "HV device state in common naming convention" UBYTE OneToOne 1 100 0.00 255.0 FORMAT "%5.1" ECU_ADDRESS 0x60023598
 /begin IF_DATA XCPplus 0x0102
  /begin DAQ_EVENT VARIABLE /end DAQ_EVENT
 /end IF_DATA
/end MEASUREMENT
/begin MEASUREMENT ElSS_stEem03 "HV device state in common naming convention" UBYTE OneToOne 1 100 0.00 255.0 FORMAT "%5.1" ECU_ADDRESS 0x60023597
 /begin IF_DATA XCPplus 0x0102
  /begin DAQ_EVENT VARIABLE /end DAQ_EVENT
 /end IF_DATA
/end MEASUREMENT
/begin MEASUREMENT ElSS_stEem04 "HV device state in common naming convention" UBYTE OneToOne 1 100 0.00 255.0 FORMAT "%5.1" ECU_ADDRESS 0x60023596
 /begin IF_DATA XCPplus 0x0102
  /begin DAQ_EVENT VARIABLE /end DAQ_EVENT
 /end IF_DATA
/end MEASUREMENT
/begin MEASUREMENT ElSS_stEem05 "HV device state in common naming convention" UBYTE OneToOne 1 100 0.00 255.0 FORMAT "%5.1" ECU_ADDRESS 0x60023595
 /begin IF_DATA XCPplus 0x0102
  /begin DAQ_EVENT VARIABLE /end DAQ_EVENT
 /end IF_DATA
/end MEASUREMENT
/begin MEASUREMENT ElSS_stEem06 "HV device state in common naming convention" UBYTE OneToOne 1 100 0.00 255.0 FORMAT "%5.1" ECU_ADDRESS 0x60023594
 /begin IF_DATA XCPplus 0x0102
  /begin DAQ_EVENT VARIABLE /end DAQ_EVENT
 /end IF_DATA
/end MEASUREMENT
/begin MEASUREMENT ElSS_stEem07 "HV device state in common naming convention" UBYTE OneToOne 1 100 0.00 255.0 FORMAT "%5.1" ECU_ADDRESS 0x60023593
 /begin IF_DATA XCPplus 0x0102
  /begin DAQ_EVENT VARIABLE /end DAQ_EVENT
 /end IF_DATA
/end MEASUREMENT
/begin MEASUREMENT ElSS_stEem08 "HV device state in common naming convention" UBYTE OneToOne 1 100 0.00 255.0 FORMAT "%5.1" ECU_ADDRESS 0x60023592
 /begin IF_DATA XCPplus 0x0102
  /begin DAQ_EVENT VARIABLE /end DAQ_EVENT
 /end IF_DATA
/end MEASUREMENT
/begin MEASUREMENT ElSS_uHvActMeasd01 "HV supply voltage in common naming convention" SWORD Volt_V_q0p03125_COMPU 1 100 -1024.000 1023.969 FORMAT "%8.3" ECU_ADDRESS 0x6001FB52
 /begin IF_DATA XCPplus 0x0102
  /begin DAQ_EVENT VARIABLE /end DAQ_EVENT
 /end IF_DATA
/end MEASUREMENT
/begin MEASUREMENT ElSS_uHvActMeasd02 "HV supply voltage in common naming convention" SWORD Volt_V_q0p03125_COMPU 1 100 -1024.000 1023.969 FORMAT "%8.3" ECU_ADDRESS 0x6001FB50
 /begin IF_DATA XCPplus 0x0102
  /begin DAQ_EVENT VARIABLE /end DAQ_EVENT
 /end IF_DATA
/end MEASUREMENT
/begin MEASUREMENT ElSS_uHvActMeasd03 "HV supply voltage in common naming convention" SWORD Volt_V_q0p03125_COMPU 1 100 -1024.000 1023.969 FORMAT "%8.3" ECU_ADDRESS 0x6001FB4E
 /begin IF_DATA XCPplus 0x0102
  /begin DAQ_EVENT VARIABLE /end DAQ_EVENT
 /end IF_DATA
/end MEASUREMENT
/begin MEASUREMENT ElSS_uHvActMeasd04 "HV supply voltage in common naming convention" SWORD Volt_V_q0p03125_COMPU 1 100 -1024.000 1023.969 FORMAT "%8.3" ECU_ADDRESS 0x6001FB4C
 /begin IF_DATA XCPplus 0x0102
  /begin DAQ_EVENT VARIABLE /end DAQ_EVENT
 /end IF_DATA
/end MEASUREMENT
/begin MEASUREMENT ElTS_egyAcsyCns "Energy consumed by auxliary loads" SWORD q4_W_h 1 100 -131072.0 131068.0 FORMAT "%8.1" ECU_ADDRESS 0x6001FB4A
 /begin IF_DATA XCPplus 0x0102
  /begin DAQ_EVENT VARIABLE /end DAQ_EVENT
 /end IF_DATA
/end MEASUREMENT
/begin MEASUREMENT ElTS_egyElMMotCns "Driving Work of electric machine" SWORD q4_W_h 1 100 -131072.0 131068.0 FORMAT "%8.1" ECU_ADDRESS 0x6001FB48
 /begin IF_DATA XCPplus 0x0102
  /begin DAQ_EVENT VARIABLE /end DAQ_EVENT
 /end IF_DATA
/end MEASUREMENT
/begin MEASUREMENT ElTS_egyElMRcptCns "Generative Work of electric machine" SWORD q4_W_h 1 100 -131072.0 131068.0 FORMAT "%8.1" ECU_ADDRESS 0x6001FB46
 /begin IF_DATA XCPplus 0x0102
  /begin DAQ_EVENT VARIABLE /end DAQ_EVENT
 /end IF_DATA
/end MEASUREMENT
/begin MEASUREMENT ElTS_egyTotChrgCyc "Total energy calculated during the charging cycle" SWORD q4_W_h 1 100 -131072.0 131068.0 FORMAT "%8.1" ECU_ADDRESS 0x6001FB44
 /begin IF_DATA XCPplus 0x0102
  /begin DAQ_EVENT VARIABLE /end DAQ_EVENT
 /end IF_DATA
/end MEASUREMENT
/begin MEASUREMENT ElTS_egyTotChrgCycNVM "Total energy calculated during the charging cycle stored in NVM" SWORD q4_W_h 1 100 -131072.0 131068.0 FORMAT "%8.1" ECU_ADDRESS 0x60035FE2
 /begin IF_DATA XCPplus 0x0102
  /begin DAQ_EVENT VARIABLE /end DAQ_EVENT
 /end IF_DATA
/end MEASUREMENT
/begin MEASUREMENT ElTS_EVInfo_AcsyFltEgy_INST.X1 "Zubehör Energie / Input value at one time step before" FLOAT32_IEEE OneToOne 1 100 -1.00000000E+037 1.00000000E+037 FORMAT "%13.3" ECU_ADDRESS 0x600008A4 /end MEASUREMENT
/begin MEASUREMENT ElTS_EVInfo_AcsyFltEgy_INST.Y1 "Zubehör Energie / Output value at one time step before" FLOAT32_IEEE OneToOne 1 100 -1.00000000E+037 1.00000000E+037 FORMAT "%13.3" ECU_ADDRESS 0x600008A8 /end MEASUREMENT
/begin MEASUREMENT ElTS_EVInfo_ElMFltEgy_INST.X1 "Integrator Motorleistung / Input value at one time step before" FLOAT32_IEEE OneToOne 1 100 -1.00000000E+037 1.00000000E+037 FORMAT "%13.3" ECU_ADDRESS 0x6000089C /end MEASUREMENT
/begin MEASUREMENT ElTS_EVInfo_ElMFltEgy_INST.Y1 "Integrator Motorleistung / Output value at one time step before" FLOAT32_IEEE OneToOne 1 100 -1.00000000E+037 1.00000000E+037 FORMAT "%13.3" ECU_ADDRESS 0x600008A0 /end MEASUREMENT
/begin MEASUREMENT ElTS_EVInfo_ElMFltRcptEgy_INST.X1 "Rekuperationsenergie / Input value at one time step before" FLOAT32_IEEE OneToOne 1 100 -1.00000000E+037 1.00000000E+037 FORMAT "%13.3" ECU_ADDRESS 0x60000894 /end MEASUREMENT
/begin MEASUREMENT ElTS_EVInfo_ElMFltRcptEgy_INST.Y1 "Rekuperationsenergie / Output value at one time step before" FLOAT32_IEEE OneToOne 1 100 -1.00000000E+037 1.00000000E+037 FORMAT "%13.3" ECU_ADDRESS 0x60000898 /end MEASUREMENT
/begin MEASUREMENT ElTS_EVInfo_TotEgyChrgCyc_INST.X1 "Integrator for calculating total energy during charging cycle / Input value at one time step before" FLOAT32_IEEE OneToOne 1 100 -1.00000000E+037 1.00000000E+037 FORMAT "%13.3" ECU_ADDRESS 0x6000088C /end MEASUREMENT
/begin MEASUREMENT ElTS_EVInfo_TotEgyChrgCyc_INST.Y1 "Integrator for calculating total energy during charging cycle / Output value at one time step before" FLOAT32_IEEE OneToOne 1 100 -1.00000000E+037 1.00000000E+037 FORMAT "%13.3" ECU_ADDRESS 0x60000890 /end MEASUREMENT
/begin MEASUREMENT ElTS_flgHvIntlck "High voltage interlock for HMI" UBYTE B_TRUE 1 100 0.00 1.00000000000 BIT_MASK 0x1 FORMAT "%13.11" ECU_ADDRESS 0x70000282
 /begin IF_DATA XCPplus 0x0102
  /begin DAQ_EVENT VARIABLE /end DAQ_EVENT
 /end IF_DATA
/end MEASUREMENT
/begin MEASUREMENT ElTS_pwrMeclAct "Actual Mechanical Power" SWORD leist_q16_W 1 100 -524288.0 524272.0 FORMAT "%8.1" ECU_ADDRESS 0x6001FB42
 /begin IF_DATA XCPplus 0x0102
  /begin DAQ_EVENT VARIABLE /end DAQ_EVENT
 /end IF_DATA
/end MEASUREMENT
/begin MEASUREMENT ElTS_pwrSumEmLimd "Actual electric power of electric machines" SWORD leist_q16_W 1 100 -524288.0 524272.0 FORMAT "%8.1" ECU_ADDRESS 0x6001FB40
 /begin IF_DATA XCPplus 0x0102
  /begin DAQ_EVENT VARIABLE /end DAQ_EVENT
 /end IF_DATA
/end MEASUREMENT
/begin MEASUREMENT ElTS_pwrTotHvAct "Actual electrical power consumed in HV System" SWORD RBPtCel_pwr_25p0_1 1 100 -819200.0 819175.0 FORMAT "%8.1" ECU_ADDRESS 0x6001FB3E
 /begin IF_DATA XCPplus 0x0102
  /begin DAQ_EVENT VARIABLE /end DAQ_EVENT
 /end IF_DATA
/end MEASUREMENT
/begin MEASUREMENT ElTS_ratEmPowChrgn "Emachine power ratio during charging phase" SWORD Prc 1 100 -400.0000 399.9878 FORMAT "%8.4" ECU_ADDRESS 0x6001FB3C
 /begin IF_DATA XCPplus 0x0102
  /begin DAQ_EVENT VARIABLE /end DAQ_EVENT
 /end IF_DATA
/end MEASUREMENT
/begin MEASUREMENT ElTS_ratEmPowDcha "Emachine power ratio during discharging phase" SWORD Prc 1 100 -400.0000 399.9878 FORMAT "%8.4" ECU_ADDRESS 0x6001FB3A
 /begin IF_DATA XCPplus 0x0102
  /begin DAQ_EVENT VARIABLE /end DAQ_EVENT
 /end IF_DATA
/end MEASUREMENT
/begin MEASUREMENT ElTS_ratSoc "ration for relative the State of Charge for HMI" SWORD Prc 1 100 -400.0000 399.9878 FORMAT "%8.4" ECU_ADDRESS 0x6001FB38
 /begin IF_DATA XCPplus 0x0102
  /begin DAQ_EVENT VARIABLE /end DAQ_EVENT
 /end IF_DATA
/end MEASUREMENT
/begin MEASUREMENT ElTS_stChrgCyc "Charging cycle state" UBYTE OneToOne 1 100 0.00 255.0 FORMAT "%5.1" ECU_ADDRESS 0x60023591
 /begin IF_DATA XCPplus 0x0102
  /begin DAQ_EVENT VARIABLE /end DAQ_EVENT
 /end IF_DATA
/end MEASUREMENT
/begin MEASUREMENT ElTS_stChrgCycNVM "Charging cycle state stored in the NVM" UBYTE OneToOne 1 100 0.00 255.0 FORMAT "%5.1" ECU_ADDRESS 0x60035FE0
 /begin IF_DATA XCPplus 0x0102
  /begin DAQ_EVENT VARIABLE /end DAQ_EVENT
 /end IF_DATA
/end MEASUREMENT
/begin MEASUREMENT ElTS_stChrgCycOld "State of old charging cycle" UBYTE OneToOne 1 100 0.00 255.0 FORMAT "%5.1" ECU_ADDRESS 0x60023152
 /begin IF_DATA XCPplus 0x0102
  /begin DAQ_EVENT VARIABLE /end DAQ_EVENT
 /end IF_DATA
/end MEASUREMENT
/begin MEASUREMENT Emac_dtqMaxLimCom01 "Maximum allowed torque gradient of electric machine 01" SWORD RBPtCel_dtq_1p0_1 1 100 -32768.00 32767.00 FORMAT "%8.2" ECU_ADDRESS 0x6001FB2A
 /begin IF_DATA XCPplus 0x0102
  /begin DAQ_EVENT VARIABLE /end DAQ_EVENT
 /end IF_DATA
/end MEASUREMENT
/begin MEASUREMENT Emac_facKpHiCom01 "Amplification factor (P-component) of speed control at large engine speed difference, e-machine 01" SWORD fak_q0p04 1 100 -1310.720 1310.680 FORMAT "%8.3" ECU_ADDRESS 0x6001FB26
 /begin IF_DATA XCPplus 0x0102
  /begin DAQ_EVENT VARIABLE /end DAQ_EVENT
 /end IF_DATA
/end MEASUREMENT
/begin MEASUREMENT Emac_facKpLoCom01 "Amplification factor (P-component) of speed control at small engine speed difference, e-machine 01" SWORD fak_q0p04 1 100 -1310.720 1310.680 FORMAT "%8.3" ECU_ADDRESS 0x6001FB24
 /begin IF_DATA XCPplus 0x0102
  /begin DAQ_EVENT VARIABLE /end DAQ_EVENT
 /end IF_DATA
/end MEASUREMENT
/begin MEASUREMENT Emac_nDesCom01 "Desired engine speed of e-machine 01" SWORD nmot_q1 1 100 -32768.00 32767.00 FORMAT "%8.2" ECU_ADDRESS 0x6001FB1A
 /begin IF_DATA XCPplus 0x0102
  /begin DAQ_EVENT VARIABLE /end DAQ_EVENT
 /end IF_DATA
/end MEASUREMENT
/begin MEASUREMENT Emac_nDeThdCom01 "Engine speed limit for distinction between high and low area, e-machine 01" SWORD nmot_q1 1 100 -32768.00 32767.00 FORMAT "%8.2" ECU_ADDRESS 0x6001FB1C
 /begin IF_DATA XCPplus 0x0102
  /begin DAQ_EVENT VARIABLE /end DAQ_EVENT
 /end IF_DATA
/end MEASUREMENT
/begin MEASUREMENT Emac_stIsoMonSwtReq "isolation monitoring request" UBYTE OneToOne 1 100 0.00 255.0 FORMAT "%5.1" ECU_ADDRESS 0x60023582
 /begin IF_DATA XCPplus 0x0102
  /begin DAQ_EVENT VARIABLE /end DAQ_EVENT
 /end IF_DATA
/end MEASUREMENT
/begin MEASUREMENT Emac_tqDesCom01 "desired torque e-machine 01" SWORD Trq 1 100 -3276.800 3276.700 FORMAT "%8.3" ECU_ADDRESS 0x6001FB06
 /begin IF_DATA XCPplus 0x0102
  /begin DAQ_EVENT VARIABLE /end DAQ_EVENT
 /end IF_DATA
/end MEASUREMENT
/begin MEASUREMENT Emac_tqMaxLimCom01 "Limited maximum torque, e-machine 01" SWORD Trq 1 100 -3276.800 3276.700 FORMAT "%8.3" ECU_ADDRESS 0x6001FB00
 /begin IF_DATA XCPplus 0x0102
  /begin DAQ_EVENT VARIABLE /end DAQ_EVENT
 /end IF_DATA
/end MEASUREMENT
/begin MEASUREMENT Emac_tqMinLimCom01 "Limited minimum torque, e-machine 01" SWORD Trq 1 100 -3276.800 3276.700 FORMAT "%8.3" ECU_ADDRESS 0x6001FAFE
 /begin IF_DATA XCPplus 0x0102
  /begin DAQ_EVENT VARIABLE /end DAQ_EVENT
 /end IF_DATA
/end MEASUREMENT
/begin MEASUREMENT Emac_tqSpdCtlMaxLimCom01 "Limited maximum torque at speed control, e-machine 01" SWORD Trq 1 100 -3276.800 3276.700 FORMAT "%8.3" ECU_ADDRESS 0x6001FAFC
 /begin IF_DATA XCPplus 0x0102
  /begin DAQ_EVENT VARIABLE /end DAQ_EVENT
 /end IF_DATA
/end MEASUREMENT
/begin MEASUREMENT Emac_tqSpdCtlMinLimCom01 "Limited minimum torque at speed control, e-machine 01" SWORD Trq 1 100 -3276.800 3276.700 FORMAT "%8.3" ECU_ADDRESS 0x6001FAFA
 /begin IF_DATA XCPplus 0x0102
  /begin DAQ_EVENT VARIABLE /end DAQ_EVENT
 /end IF_DATA
/end MEASUREMENT
/begin MEASUREMENT Emac_TransEMS01_I.CoPOM_pwrElecEmDynMax "coordination of data transfer to electrical machine 1 / max. power limit for e-machine" SWORD RBPtCel_pwr_25p0_1 1 100 -819200.0 819175.0 FORMAT "%8.1" ECU_ADDRESS 0x600008C4
 /begin IF_DATA XCPplus 0x0102
  /begin DAQ_EVENT VARIABLE /end DAQ_EVENT
 /end IF_DATA
/end MEASUREMENT
/begin MEASUREMENT Emac_TransEMS01_I.CoPOM_pwrElecEmDynMin "coordination of data transfer to electrical machine 1 / min power limit for e-machine" SWORD RBPtCel_pwr_25p0_1 1 100 -819200.0 819175.0 FORMAT "%8.1" ECU_ADDRESS 0x600008C6
 /begin IF_DATA XCPplus 0x0102
  /begin DAQ_EVENT VARIABLE /end DAQ_EVENT
 /end IF_DATA
/end MEASUREMENT
/begin MEASUREMENT Emac_TransEMS01_I.DrvMod_stPosn "coordination of data transfer to electrical machine 1 / Drive Mode Gear Position status based on Actual Gear status and Gear Lever Position" UBYTE DrvMod_stPosn_VERB 1 100 0.00 6.00000000000 FORMAT "%13.11" ECU_ADDRESS 0x600008C8
 /begin IF_DATA XCPplus 0x0102
  /begin DAQ_EVENT VARIABLE /end DAQ_EVENT
 /end IF_DATA
/end MEASUREMENT
/begin MEASUREMENT Emac_TransEMS01_I.ElM_facChgGearFild "coordination of data transfer to electrical machine 1 / factor from PT1 to ensure smooth torque increase from 0Nm after gear change" SWORD FactLow 1 100 -32.00000 31.99902 FORMAT "%8.5" ECU_ADDRESS 0x600008CA
 /begin IF_DATA XCPplus 0x0102
  /begin DAQ_EVENT VARIABLE /end DAQ_EVENT
 /end IF_DATA
/end MEASUREMENT
/begin MEASUREMENT Emac_TransEMS01_I.ElM_flgChgGear "coordination of data transfer to electrical machine 1 / e-machine speed above threshold" UBYTE B_TRUE 1 100 0.00 1.00000000000 BIT_MASK 0x1 FORMAT "%13.11" ECU_ADDRESS 0x600008CC
 /begin IF_DATA XCPplus 0x0102
  /begin DAQ_EVENT VARIABLE /end DAQ_EVENT
 /end IF_DATA
/end MEASUREMENT
/begin MEASUREMENT Emac_TransEMS01_I.ElM_flgEnaFrbdnQdrLockg "coordination of data transfer to electrical machine 1 / Flag to indicate the forbidden quadrant locking status" UBYTE B_TRUE 1 100 0.00 1.00000000000 BIT_MASK 0x1 FORMAT "%13.11" ECU_ADDRESS 0x600008CD
 /begin IF_DATA XCPplus 0x0102
  /begin DAQ_EVENT VARIABLE /end DAQ_EVENT
 /end IF_DATA
/end MEASUREMENT
/begin MEASUREMENT Emac_TransEMS01_I.ElM_flgEnaQdrMpg "coordination of data transfer to electrical machine 1 / Flag to indicate the quadrant mapping status" UBYTE B_TRUE 1 100 0.00 1.00000000000 BIT_MASK 0x1 FORMAT "%13.11" ECU_ADDRESS 0x600008CE
 /begin IF_DATA XCPplus 0x0102
  /begin DAQ_EVENT VARIABLE /end DAQ_EVENT
 /end IF_DATA
/end MEASUREMENT
/begin MEASUREMENT Emac_TransEMS01_I.ElM_flgGearMpgActv "coordination of data transfer to electrical machine 1 / gear lever mapping active" UBYTE B_TRUE 1 100 0.00 1.00000000000 BIT_MASK 0x1 FORMAT "%13.11" ECU_ADDRESS 0x600008CF
 /begin IF_DATA XCPplus 0x0102
  /begin DAQ_EVENT VARIABLE /end DAQ_EVENT
 /end IF_DATA
/end MEASUREMENT
/begin MEASUREMENT Emac_TransEMS01_I.ElM_flgSignMpgActv "coordination of data transfer to electrical machine 1 / Flag to indicate the activation of sign mapping status" UBYTE B_TRUE 1 100 0.00 1.00000000000 BIT_MASK 0x1 FORMAT "%13.11" ECU_ADDRESS 0x600008D0
 /begin IF_DATA XCPplus 0x0102
  /begin DAQ_EVENT VARIABLE /end DAQ_EVENT
 /end IF_DATA
/end MEASUREMENT
/begin MEASUREMENT Emac_TransEMS01_I.ElM_flgSwtIvtDirEm "coordination of data transfer to electrical machine 1 / Switch to invert direction of rotation of e-machine." UBYTE B_TRUE 1 100 0.00 1.00000000000 BIT_MASK 0x1 FORMAT "%13.11" ECU_ADDRESS 0x600008D1
 /begin IF_DATA XCPplus 0x0102
  /begin DAQ_EVENT VARIABLE /end DAQ_EVENT
 /end IF_DATA
/end MEASUREMENT
/begin MEASUREMENT Emac_TransEMS01_I.ElM_iDcLnkIvtrMax "coordination of data transfer to electrical machine 1 / Max. HV current allowed to the inverter." SWORD Curr_A_q0p03125_COMPU 1 100 -1024.000 1023.969 FORMAT "%8.3" ECU_ADDRESS 0x600008D2
 /begin IF_DATA XCPplus 0x0102
  /begin DAQ_EVENT VARIABLE /end DAQ_EVENT
 /end IF_DATA
/end MEASUREMENT
/begin MEASUREMENT Emac_TransEMS01_I.ElM_iDcLnkIvtrMin "coordination of data transfer to electrical machine 1 / Min. HV current allowed to the inverter." SWORD Curr_A_q0p03125_COMPU 1 100 -1024.000 1023.969 FORMAT "%8.3" ECU_ADDRESS 0x600008D4
 /begin IF_DATA XCPplus 0x0102
  /begin DAQ_EVENT VARIABLE /end DAQ_EVENT
 /end IF_DATA
/end MEASUREMENT
/begin MEASUREMENT Emac_TransEMS01_I.Emac_bFIdElMNoPrp "coordination of data transfer to electrical machine 1 / No limit for Emac torque" UBYTE B_TRUE 1 100 0.00 1.00000000000 BIT_MASK 0x1 FORMAT "%13.11" ECU_ADDRESS 0x600008D6
 /begin IF_DATA XCPplus 0x0102
  /begin DAQ_EVENT VARIABLE /end DAQ_EVENT
 /end IF_DATA
/end MEASUREMENT
/begin MEASUREMENT Emac_TransEMS01_I.Emac_bFIdElMtrqLim "coordination of data transfer to electrical machine 1 / FId for torque limitation" UBYTE B_TRUE 1 100 0.00 1.00000000000 BIT_MASK 0x1 FORMAT "%13.11" ECU_ADDRESS 0x600008D7
 /begin IF_DATA XCPplus 0x0102
  /begin DAQ_EVENT VARIABLE /end DAQ_EVENT
 /end IF_DATA
/end MEASUREMENT
/begin MEASUREMENT Emac_TransEMS01_I.Emac_dtqMaxLimCom "coordination of data transfer to electrical machine 1 / maximum allowed torque gradient of Emac for communication" SWORD RBPtCel_dtq_1p0_1 1 100 -32768.00 32767.00 FORMAT "%8.2" ECU_ADDRESS 0x600008D8
 /begin IF_DATA XCPplus 0x0102
  /begin DAQ_EVENT VARIABLE /end DAQ_EVENT
 /end IF_DATA
/end MEASUREMENT
/begin MEASUREMENT Emac_TransEMS01_I.Emac_facKpHiCom "coordination of data transfer to electrical machine 1 / high Kp factor for controller" SWORD fak_q0p04 1 100 -1310.720 1310.680 FORMAT "%8.3" ECU_ADDRESS 0x600008DA
 /begin IF_DATA XCPplus 0x0102
  /begin DAQ_EVENT VARIABLE /end DAQ_EVENT
 /end IF_DATA
/end MEASUREMENT
/begin MEASUREMENT Emac_TransEMS01_I.Emac_facKpLoCom "coordination of data transfer to electrical machine 1 / low Kp factor for controller" SWORD fak_q0p04 1 100 -1310.720 1310.680 FORMAT "%8.3" ECU_ADDRESS 0x600008DC
 /begin IF_DATA XCPplus 0x0102
  /begin DAQ_EVENT VARIABLE /end DAQ_EVENT
 /end IF_DATA
/end MEASUREMENT
/begin MEASUREMENT Emac_TransEMS01_I.Emac_nAct "coordination of data transfer to electrical machine 1 / Actual speed of electrical machine" SWORD nmot_q1 1 100 -32768.00 32767.00 FORMAT "%8.2" ECU_ADDRESS 0x600008DE
 /begin IF_DATA XCPplus 0x0102
  /begin DAQ_EVENT VARIABLE /end DAQ_EVENT
 /end IF_DATA
/end MEASUREMENT
/begin MEASUREMENT Emac_TransEMS01_I.Emac_nDeThdCom "coordination of data transfer to electrical machine 1 / Max. allowed speed difference for e-machine." SWORD nmot_q1 1 100 -32768.00 32767.00 FORMAT "%8.2" ECU_ADDRESS 0x600008E0
 /begin IF_DATA XCPplus 0x0102
  /begin DAQ_EVENT VARIABLE /end DAQ_EVENT
 /end IF_DATA
/end MEASUREMENT
/begin MEASUREMENT Emac_TransEMS01_I.Emac_nDesCom "coordination of data transfer to electrical machine 1 / Desired engine speed of e-machine for communication" SWORD nmot_q1 1 100 -32768.00 32767.00 FORMAT "%8.2" ECU_ADDRESS 0x600008E2
 /begin IF_DATA XCPplus 0x0102
  /begin DAQ_EVENT VARIABLE /end DAQ_EVENT
 /end IF_DATA
/end MEASUREMENT
/begin MEASUREMENT Emac_TransEMS01_I.Emac_stLogl "coordination of data transfer to electrical machine 1 / State of coordinator of electrical machine" UBYTE RBPtElTrac_stEmOperMod_VERB 1 100 0.00 31.0000000000 FORMAT "%13.10" ECU_ADDRESS 0x600008E4
 /begin IF_DATA XCPplus 0x0102
  /begin DAQ_EVENT VARIABLE /end DAQ_EVENT
 /end IF_DATA
/end MEASUREMENT
/begin MEASUREMENT Emac_TransEMS01_I.Emac_tqDesCom "coordination of data transfer to electrical machine 1 / desired torque e-machine" SWORD Trq 1 100 -3276.800 3276.700 FORMAT "%8.3" ECU_ADDRESS 0x600008E6
 /begin IF_DATA XCPplus 0x0102
  /begin DAQ_EVENT VARIABLE /end DAQ_EVENT
 /end IF_DATA
/end MEASUREMENT
/begin MEASUREMENT Emac_TransEMS01_I.Emac_tqDesInterTmp "coordination of data transfer to electrical machine 1 / intermediate value for torque demand" SWORD Trq 1 100 -3276.800 3276.700 FORMAT "%8.3" ECU_ADDRESS 0x600008E8
 /begin IF_DATA XCPplus 0x0102
  /begin DAQ_EVENT VARIABLE /end DAQ_EVENT
 /end IF_DATA
/end MEASUREMENT
/begin MEASUREMENT Emac_TransEMS01_I.Emac_tqDesTmp "coordination of data transfer to electrical machine 1 / intermediate value for torque demand" SWORD Trq 1 100 -3276.800 3276.700 FORMAT "%8.3" ECU_ADDRESS 0x600008EA
 /begin IF_DATA XCPplus 0x0102
  /begin DAQ_EVENT VARIABLE /end DAQ_EVENT
 /end IF_DATA
/end MEASUREMENT
/begin MEASUREMENT Emac_TransEMS01_I.Emac_tqMaxLimCom "coordination of data transfer to electrical machine 1 / Limited maximum torque, e-machine" SWORD Trq 1 100 -3276.800 3276.700 FORMAT "%8.3" ECU_ADDRESS 0x600008EC
 /begin IF_DATA XCPplus 0x0102
  /begin DAQ_EVENT VARIABLE /end DAQ_EVENT
 /end IF_DATA
/end MEASUREMENT
/begin MEASUREMENT Emac_TransEMS01_I.Emac_tqMinLimCom "coordination of data transfer to electrical machine 1 / Limited minimum torque, e-machine" SWORD Trq 1 100 -3276.800 3276.700 FORMAT "%8.3" ECU_ADDRESS 0x600008EE
 /begin IF_DATA XCPplus 0x0102
  /begin DAQ_EVENT VARIABLE /end DAQ_EVENT
 /end IF_DATA
/end MEASUREMENT
/begin MEASUREMENT Emac_TransEMS01_I.Emac_tqSpdCtlMaxLimCom "coordination of data transfer to electrical machine 1 / Max. torque limit of e-machine in speedcontrol mode." SWORD Trq 1 100 -3276.800 3276.700 FORMAT "%8.3" ECU_ADDRESS 0x600008F0
 /begin IF_DATA XCPplus 0x0102
  /begin DAQ_EVENT VARIABLE /end DAQ_EVENT
 /end IF_DATA
/end MEASUREMENT
/begin MEASUREMENT Emac_TransEMS01_I.Emac_tqSpdCtlMinLimCom "coordination of data transfer to electrical machine 1 / Min. torque limit of e-machine in speedcontrol mode." SWORD Trq 1 100 -3276.800 3276.700 FORMAT "%8.3" ECU_ADDRESS 0x600008F2
 /begin IF_DATA XCPplus 0x0102
  /begin DAQ_EVENT VARIABLE /end DAQ_EVENT
 /end IF_DATA
/end MEASUREMENT
/begin MEASUREMENT Emac_TransEMS01_I.HvBatt_uActMeasd "coordination of data transfer to electrical machine 1 / Actual voltage of the high voltage battery" SWORD Volt_V_q0p03125_COMPU 1 100 -1024.000 1023.969 FORMAT "%8.3" ECU_ADDRESS 0x600008F4
 /begin IF_DATA XCPplus 0x0102
  /begin DAQ_EVENT VARIABLE /end DAQ_EVENT
 /end IF_DATA
/end MEASUREMENT
/begin MEASUREMENT Emac_TransEMS01_I.PT_nDesEm "coordination of data transfer to electrical machine 1 / desired speed of e-machine" SWORD nmot_q1 1 100 -32768.00 32767.00 FORMAT "%8.2" ECU_ADDRESS 0x600008F6
 /begin IF_DATA XCPplus 0x0102
  /begin DAQ_EVENT VARIABLE /end DAQ_EVENT
 /end IF_DATA
/end MEASUREMENT
/begin MEASUREMENT Emac_TransEMS01_I.PT_tqDesEmac "coordination of data transfer to electrical machine 1 / desired torque of e-machine" SWORD Trq 1 100 -3276.800 3276.700 FORMAT "%8.3" ECU_ADDRESS 0x600008F8
 /begin IF_DATA XCPplus 0x0102
  /begin DAQ_EVENT VARIABLE /end DAQ_EVENT
 /end IF_DATA
/end MEASUREMENT
/begin MEASUREMENT EmWakeupSig_r "Control value provided by governor" SWORD Prc 1 100 -400.0000 399.9878 FORMAT "%8.4" ECU_ADDRESS 0x6001FB36
 /begin IF_DATA XCPplus 0x0102
  /begin DAQ_EVENT VARIABLE /end DAQ_EVENT
 /end IF_DATA
/end MEASUREMENT
/begin MEASUREMENT EmWakeupSig_rAct "" SWORD Prc 1 100 -400.0000 399.9878 FORMAT "%8.4" ECU_ADDRESS 0x6001FB34
 /begin IF_DATA XCPplus 0x0102
  /begin DAQ_EVENT VARIABLE /end DAQ_EVENT
 /end IF_DATA
/end MEASUREMENT
/begin MEASUREMENT EmWakeupSig_rActr "" SWORD Prc 1 100 -400.0000 399.9878 FORMAT "%8.4" ECU_ADDRESS 0x6001FB32
 /begin IF_DATA XCPplus 0x0102
  /begin DAQ_EVENT VARIABLE /end DAQ_EVENT
 /end IF_DATA
/end MEASUREMENT
/begin MEASUREMENT EmWakeupSig_rAct_Sq "" UBYTE SigQly_COMPU_VERB 1 100 0.00 15.0000000000 FORMAT "%13.10" ECU_ADDRESS 0x60023590
 /begin IF_DATA XCPplus 0x0102
  /begin DAQ_EVENT VARIABLE /end DAQ_EVENT
 /end IF_DATA
/end MEASUREMENT
/begin MEASUREMENT EmWakeupSig_rDesVal "" SWORD Prc 1 100 -400.0000 399.9878 FORMAT "%8.4" ECU_ADDRESS 0x6001FB30
 /begin IF_DATA XCPplus 0x0102
  /begin DAQ_EVENT VARIABLE /end DAQ_EVENT
 /end IF_DATA
/end MEASUREMENT
/begin MEASUREMENT EmWakeupSig_rDtyCyc "" SWORD Prc 1 100 -400.0000 399.9878 FORMAT "%8.4" ECU_ADDRESS 0x6001FB2E
 /begin IF_DATA XCPplus 0x0102
  /begin DAQ_EVENT VARIABLE /end DAQ_EVENT
 /end IF_DATA
/end MEASUREMENT
/begin MEASUREMENT EmWakeupSig_rPs "" SWORD DtyCyc 1 100 -327.6800 327.6700 FORMAT "%8.4" ECU_ADDRESS 0x6001FB2C
 /begin IF_DATA XCPplus 0x0102
  /begin DAQ_EVENT VARIABLE /end DAQ_EVENT
 /end IF_DATA
/end MEASUREMENT
/begin MEASUREMENT EmWakeupSig_stMonActrCoorrSimple "" UBYTE OneToOne 1 100 0.00 255.0 FORMAT "%5.1" ECU_ADDRESS 0x6002358F
 /begin IF_DATA XCPplus 0x0102
  /begin DAQ_EVENT VARIABLE /end DAQ_EVENT
 /end IF_DATA
/end MEASUREMENT
/begin MEASUREMENT EmWakeupSig_stMonActrElecDrvrSimple "" UBYTE OneToOne 1 100 0.00 255.0 FORMAT "%5.1" ECU_ADDRESS 0x6002358E
 /begin IF_DATA XCPplus 0x0102
  /begin DAQ_EVENT VARIABLE /end DAQ_EVENT
 /end IF_DATA
/end MEASUREMENT
/begin MEASUREMENT EmWakeupSig_swtConfActrCoorrSimpleC "" UBYTE OneToOne 1 100 0.00 255.0 FORMAT "%5.1" ECU_ADDRESS 0x6002358D /end MEASUREMENT
/begin MEASUREMENT EmWakeupSig_swtConfActrElecDrvrSimpleC "" UBYTE OneToOne 1 100 0.00 255.0 FORMAT "%5.1" ECU_ADDRESS 0x6002358C /end MEASUREMENT
/begin MEASUREMENT EmWakeupSig_swtConfActrElecMonSimpleC "" UBYTE OneToOne 1 100 0.00 255.0 FORMAT "%5.1" ECU_ADDRESS 0x6002358B /end MEASUREMENT
/begin MEASUREMENT EmWakeupSig_swtConfActrPsDrvrSimpleC "" UBYTE OneToOne 1 100 0.00 255.0 FORMAT "%5.1" ECU_ADDRESS 0x6002358A /end MEASUREMENT
/begin MEASUREMENT EnvP_p "Ambient pressure" SWORD Pres_hPa 1 100 -32768.00 2560.00 FORMAT "%8.2" ECU_ADDRESS 0x6001F9E8
 /begin IF_DATA XCPplus 0x0102
  /begin DAQ_EVENT VARIABLE /end DAQ_EVENT
 /end IF_DATA
/end MEASUREMENT
/begin MEASUREMENT ESC_stStackErr "Sampling time stack overflow or underflow error status" UBYTE OneToOne 1 100 0.00 255.0 BIT_MASK 0x1 FORMAT "%5.1" ECU_ADDRESS 0x6002314F
 /begin IF_DATA XCPplus 0x0102
  /begin DAQ_EVENT VARIABLE /end DAQ_EVENT
 /end IF_DATA
/end MEASUREMENT
/begin MEASUREMENT Etc_ctCurRunTst "Stores the number of actual running engine tests" UBYTE OneToOne 1 100 0.00 255.0 FORMAT "%5.1" ECU_ADDRESS 0x600237EF
 /begin IF_DATA XCPplus 0x0102
  /begin DAQ_EVENT VARIABLE /end DAQ_EVENT
 /end IF_DATA
/end MEASUREMENT
/begin MEASUREMENT EVTherm_ratLTClgDmd "requested ratio for the low temperature fan request" SBYTE RBPtCel_Perc_1p0_1 1 100 -128.0 127.0 FORMAT "%5.1" ECU_ADDRESS 0x60023476
 /begin IF_DATA XCPplus 0x0102
  /begin DAQ_EVENT VARIABLE /end DAQ_EVENT
 /end IF_DATA
/end MEASUREMENT
/begin MEASUREMENT EVTherm_ratMTClgDmd "requested ratio for the medium temperature fan request" SBYTE RBPtCel_Perc_1p0_1 1 100 -128.0 127.0 FORMAT "%5.1" ECU_ADDRESS 0x60023475
 /begin IF_DATA XCPplus 0x0102
  /begin DAQ_EVENT VARIABLE /end DAQ_EVENT
 /end IF_DATA
/end MEASUREMENT
/begin MEASUREMENT Fan1_flgActrReq "" UBYTE OneToOne 1 100 0.00 255.0 BIT_MASK 0x1 FORMAT "%5.1" ECU_ADDRESS 0x60023494 /end MEASUREMENT
/begin MEASUREMENT Fan1_flgActrSwtOffReq "" UBYTE OneToOne 1 100 0.00 255.0 FORMAT "%5.1" ECU_ADDRESS 0x60023578
 /begin IF_DATA XCPplus 0x0102
  /begin DAQ_EVENT VARIABLE /end DAQ_EVENT
 /end IF_DATA
/end MEASUREMENT
/begin MEASUREMENT Fan1_flgElecDiagSwtOffReq "" UBYTE OneToOne 1 100 0.00 255.0 FORMAT "%5.1" ECU_ADDRESS 0x60023577
 /begin IF_DATA XCPplus 0x0102
  /begin DAQ_EVENT VARIABLE /end DAQ_EVENT
 /end IF_DATA
/end MEASUREMENT
/begin MEASUREMENT Fan1_flgMonXPostDrv_mp "" UBYTE OneToOne 1 100 0.00 255.0 FORMAT "%5.1" ECU_ADDRESS 0x70006C0A /end MEASUREMENT
/begin MEASUREMENT Fan1_flgPwrStgReq "" UBYTE OneToOne 1 100 0.00 1.000 FORMAT "%5.3" ECU_ADDRESS 0x60023576
 /begin IF_DATA XCPplus 0x0102
  /begin DAQ_EVENT VARIABLE /end DAQ_EVENT
 /end IF_DATA
/end MEASUREMENT
/begin MEASUREMENT Fan1_numSigID "" UWORD OneToOne 1 100 0.00 65535.00 FORMAT "%8.2" ECU_ADDRESS 0x6001F4C4 /end MEASUREMENT
/begin MEASUREMENT Fan1_r "Fan demand fan 1" SWORD Prc 1 100 -400.0000 399.9878 FORMAT "%8.4" ECU_ADDRESS 0x6001FDF2
 /begin IF_DATA XCPplus 0x0102
  /begin DAQ_EVENT VARIABLE /end DAQ_EVENT
 /end IF_DATA
/end MEASUREMENT
/begin MEASUREMENT Fan1_rAct "" SWORD Prc 1 100 -400.0000 399.9878 FORMAT "%8.4" ECU_ADDRESS 0x6001FDF0
 /begin IF_DATA XCPplus 0x0102
  /begin DAQ_EVENT VARIABLE /end DAQ_EVENT
 /end IF_DATA
/end MEASUREMENT
/begin MEASUREMENT Fan1_rActr "" SWORD Prc 1 100 -400.0000 399.9878 FORMAT "%8.4" ECU_ADDRESS 0x6001FDEE
 /begin IF_DATA XCPplus 0x0102
  /begin DAQ_EVENT VARIABLE /end DAQ_EVENT
 /end IF_DATA
/end MEASUREMENT
/begin MEASUREMENT Fan1_rAct_Sq "" UBYTE SigQly_COMPU_VERB 1 100 0.00 15.0000000000 FORMAT "%13.10" ECU_ADDRESS 0x600237ED
 /begin IF_DATA XCPplus 0x0102
  /begin DAQ_EVENT VARIABLE /end DAQ_EVENT
 /end IF_DATA
/end MEASUREMENT
/begin MEASUREMENT Fan1_ratActPosnB1 "" SWORD rel_q0p0078125 1 100 -256.0000 255.9922 FORMAT "%8.4" ECU_ADDRESS 0x6001FDE4
 /begin IF_DATA XCPplus 0x0102
  /begin DAQ_EVENT VARIABLE /end DAQ_EVENT
 /end IF_DATA
/end MEASUREMENT
/begin MEASUREMENT Fan1_rDesVal "" SWORD Prc 1 100 -400.0000 399.9878 FORMAT "%8.4" ECU_ADDRESS 0x6001FDEC
 /begin IF_DATA XCPplus 0x0102
  /begin DAQ_EVENT VARIABLE /end DAQ_EVENT
 /end IF_DATA
/end MEASUREMENT
/begin MEASUREMENT Fan1_rGovActr "" SWORD Prc 1 100 -400.0000 399.9878 FORMAT "%8.4" ECU_ADDRESS 0x70001536
 /begin IF_DATA XCPplus 0x0102
  /begin DAQ_EVENT VARIABLE /end DAQ_EVENT
 /end IF_DATA
/end MEASUREMENT
/begin MEASUREMENT Fan1_rMax "" SWORD DtyCyc 1 100 -327.6800 327.6700 FORMAT "%8.4" ECU_ADDRESS 0x6001FDEA
 /begin IF_DATA XCPplus 0x0102
  /begin DAQ_EVENT VARIABLE /end DAQ_EVENT
 /end IF_DATA
/end MEASUREMENT
/begin MEASUREMENT Fan1_rMin "" SWORD DtyCyc 1 100 -327.6800 327.6700 FORMAT "%8.4" ECU_ADDRESS 0x6001FDE8
 /begin IF_DATA XCPplus 0x0102
  /begin DAQ_EVENT VARIABLE /end DAQ_EVENT
 /end IF_DATA
/end MEASUREMENT
/begin MEASUREMENT Fan1_rPs "" SWORD DtyCyc 1 100 -327.6800 327.6700 FORMAT "%8.4" ECU_ADDRESS 0x6001FDE6
 /begin IF_DATA XCPplus 0x0102
  /begin DAQ_EVENT VARIABLE /end DAQ_EVENT
 /end IF_DATA
/end MEASUREMENT
/begin MEASUREMENT Fan1_selfDiagPostDrv_mp "" UBYTE OneToOne 1 100 0.00 255.0 FORMAT "%5.1" ECU_ADDRESS 0x70006C09 /end MEASUREMENT
/begin MEASUREMENT Fan1_SigTyp "" UBYTE OneToOne 1 100 0.00 255.0 FORMAT "%5.1" ECU_ADDRESS 0x6002314E
 /begin IF_DATA XCPplus 0x0102
  /begin DAQ_EVENT VARIABLE /end DAQ_EVENT
 /end IF_DATA
/end MEASUREMENT
/begin MEASUREMENT Fan1_stCoEng "" UBYTE OneToOne 1 100 0.00 255.0 FORMAT "%5.1" ECU_ADDRESS 0x600237EC
 /begin IF_DATA XCPplus 0x0102
  /begin DAQ_EVENT VARIABLE /end DAQ_EVENT
 /end IF_DATA
/end MEASUREMENT
/begin MEASUREMENT Fan1_stDeactvn "" UBYTE OneToOne 1 100 0.00 255.0 FORMAT "%5.1" ECU_ADDRESS 0x600237EB
 /begin IF_DATA XCPplus 0x0102
  /begin DAQ_EVENT VARIABLE /end DAQ_EVENT
 /end IF_DATA
/end MEASUREMENT
/begin MEASUREMENT Fan1_stDesVal "" UBYTE OneToOne 1 100 0.00 255.0 FORMAT "%5.1" ECU_ADDRESS 0x600237EA
 /begin IF_DATA XCPplus 0x0102
  /begin DAQ_EVENT VARIABLE /end DAQ_EVENT
 /end IF_DATA
/end MEASUREMENT
/begin MEASUREMENT Fan1_stElecDiag "" UBYTE OneToOne 1 100 0.00 255.0 FORMAT "%5.1" ECU_ADDRESS 0x60023575
 /begin IF_DATA XCPplus 0x0102
  /begin DAQ_EVENT VARIABLE /end DAQ_EVENT
 /end IF_DATA
/end MEASUREMENT
/begin MEASUREMENT Fan1_stErrInfo "" ULONG OneToOne 1 100 0.00 4294967295.00 FORMAT "%13.2" ECU_ADDRESS 0x6000105C
 /begin IF_DATA XCPplus 0x0102
  /begin DAQ_EVENT VARIABLE /end DAQ_EVENT
 /end IF_DATA
/end MEASUREMENT
/begin MEASUREMENT Fan1_stMon "" ULONG OneToOne 1 100 0.00 4294967295.00 FORMAT "%13.2" ECU_ADDRESS 0x60001058
 /begin IF_DATA XCPplus 0x0102
  /begin DAQ_EVENT VARIABLE /end DAQ_EVENT
 /end IF_DATA
/end MEASUREMENT
/begin MEASUREMENT Fan1_stMonActrPwrStgDrvr "" ULONG OneToOne 1 100 0.00 2147483647.00 FORMAT "%13.2" ECU_ADDRESS 0x60000EF8
 /begin IF_DATA XCPplus 0x0102
  /begin DAQ_EVENT VARIABLE /end DAQ_EVENT
 /end IF_DATA
/end MEASUREMENT
/begin MEASUREMENT Fan1_stMonCo "" ULONG OneToOne 1 100 0.00 4294967295.00 FORMAT "%13.2" ECU_ADDRESS 0x60001054
 /begin IF_DATA XCPplus 0x0102
  /begin DAQ_EVENT VARIABLE /end DAQ_EVENT
 /end IF_DATA
/end MEASUREMENT
/begin MEASUREMENT Fan1_stMonDD "" ULONG OneToOne 1 100 0.00 4294967295.00 FORMAT "%13.2" ECU_ADDRESS 0x60001050
 /begin IF_DATA XCPplus 0x0102
  /begin DAQ_EVENT VARIABLE /end DAQ_EVENT
 /end IF_DATA
/end MEASUREMENT
/begin MEASUREMENT Fan1_stMonDDSens "" ULONG OneToOne 1 100 0.00 4294967295.00 FORMAT "%13.2" ECU_ADDRESS 0x6000104C
 /begin IF_DATA XCPplus 0x0102
  /begin DAQ_EVENT VARIABLE /end DAQ_EVENT
 /end IF_DATA
/end MEASUREMENT
/begin MEASUREMENT Fan1_stMonGlbElecdd "" ULONG OneToOne 1 100 0.00 2147483647.00 FORMAT "%13.2" ECU_ADDRESS 0x60000EF4
 /begin IF_DATA XCPplus 0x0102
  /begin DAQ_EVENT VARIABLE /end DAQ_EVENT
 /end IF_DATA
/end MEASUREMENT
/begin MEASUREMENT Fan1_stPs "Output signal to actuator" UBYTE OneToOne 1 100 0.00 255.0 FORMAT "%5.1" ECU_ADDRESS 0x600237E9
 /begin IF_DATA XCPplus 0x0102
  /begin DAQ_EVENT VARIABLE /end DAQ_EVENT
 /end IF_DATA
/end MEASUREMENT
/begin MEASUREMENT Fan1_stPwrStgDrvr "" UBYTE OneToOne 1 100 0.00 255.0 FORMAT "%5.1" ECU_ADDRESS 0x60023574
 /begin IF_DATA XCPplus 0x0102
  /begin DAQ_EVENT VARIABLE /end DAQ_EVENT
 /end IF_DATA
/end MEASUREMENT
/begin MEASUREMENT Fan1_stPwrStgEnaCond "" UBYTE OneToOne 1 100 0.00 255.0 FORMAT "%5.1" ECU_ADDRESS 0x600237E8
 /begin IF_DATA XCPplus 0x0102
  /begin DAQ_EVENT VARIABLE /end DAQ_EVENT
 /end IF_DATA
/end MEASUREMENT
/begin MEASUREMENT Fan1_swtConf2C "" ULONG OneToOne 1 100 0.00 4294967295.00 FORMAT "%13.2" ECU_ADDRESS 0x60000880 /end MEASUREMENT
/begin MEASUREMENT Fan1_swtConfActrPwrStgDrvr "" UBYTE OneToOne 1 100 0.00 255.0 FORMAT "%5.1" ECU_ADDRESS 0x60023573 /end MEASUREMENT
/begin MEASUREMENT Fan1_swtConfC "" ULONG OneToOne 1 100 0.00 4294967295.00 FORMAT "%13.2" ECU_ADDRESS 0x6000087C /end MEASUREMENT
/begin MEASUREMENT Fan1_swtConfDevDrvrOutpDutyCycRampC "" UBYTE OneToOne 1 100 0.00 255.0 FORMAT "%5.1" ECU_ADDRESS 0x700014BB /end MEASUREMENT
/begin MEASUREMENT Fan1_swtConfStdActrSwVersC "" ULONG OneToOne 1 100 0.00 4294967295.00 FORMAT "%13.2" ECU_ADDRESS 0x60000878 /end MEASUREMENT
/begin MEASUREMENT FanCtl_Fan1Win1HystLR_I "hysteresis for the first resonanz area fade out of fan 1" UBYTE B_TRUE 1 100 0.00 1.00000000000 BIT_MASK 0x1 FORMAT "%13.11" ECU_ADDRESS 0x7000017F
 /begin IF_DATA XCPplus 0x0102
  /begin DAQ_EVENT VARIABLE /end DAQ_EVENT
 /end IF_DATA
/end MEASUREMENT
/begin MEASUREMENT FanCtl_Fan1Win2HystLR_I "hysteresis for the second resonanz area fade out of fan 1" UBYTE B_TRUE 1 100 0.00 1.00000000000 BIT_MASK 0x1 FORMAT "%13.11" ECU_ADDRESS 0x7000017E
 /begin IF_DATA XCPplus 0x0102
  /begin DAQ_EVENT VARIABLE /end DAQ_EVENT
 /end IF_DATA
/end MEASUREMENT
/begin MEASUREMENT FanCtl_Fan1Win3HystLR_I "hysteresis for the third resonanz area fade out of fan 1" UBYTE B_TRUE 1 100 0.00 1.00000000000 BIT_MASK 0x1 FORMAT "%13.11" ECU_ADDRESS 0x7000017D
 /begin IF_DATA XCPplus 0x0102
  /begin DAQ_EVENT VARIABLE /end DAQ_EVENT
 /end IF_DATA
/end MEASUREMENT
/begin MEASUREMENT FanCtl_ratCoolgDes1 "desired ratio of fan 1" UBYTE RBPtCel_Perc_1p0_1 1 100 0.00 255.0 FORMAT "%5.1" ECU_ADDRESS 0x6002314D
 /begin IF_DATA XCPplus 0x0102
  /begin DAQ_EVENT VARIABLE /end DAQ_EVENT
 /end IF_DATA
/end MEASUREMENT
/begin MEASUREMENT FanRly1Posn_st "Debounced switch status" UBYTE B_TRUE 1 100 0.00 1.00000000000 BIT_MASK 0x1 FORMAT "%13.11" ECU_ADDRESS 0x70000254
 /begin IF_DATA XCPplus 0x0102
  /begin DAQ_EVENT VARIABLE /end DAQ_EVENT
 /end IF_DATA
/end MEASUREMENT
/begin MEASUREMENT FanRly1Posn_stRaw "" UBYTE B_TRUE 1 100 0.00 1.00000000000 BIT_MASK 0x1 FORMAT "%13.11" ECU_ADDRESS 0x70000253
 /begin IF_DATA XCPplus 0x0102
  /begin DAQ_EVENT VARIABLE /end DAQ_EVENT
 /end IF_DATA
/end MEASUREMENT
/begin MEASUREMENT FanRly1Posn_st_Sq "" UBYTE SigQly_COMPU_VERB 1 100 0.00 15.0000000000 FORMAT "%13.10" ECU_ADDRESS 0x700014BA
 /begin IF_DATA XCPplus 0x0102
  /begin DAQ_EVENT VARIABLE /end DAQ_EVENT
 /end IF_DATA
/end MEASUREMENT
/begin MEASUREMENT FanSpd_DDstSnsrState_mp "" UBYTE OneToOne 1 100 0.00 255.0 FORMAT "%5.1" ECU_ADDRESS 0x70006C08 /end MEASUREMENT
/begin MEASUREMENT FanSpd_FirCalc.cntrAvrgZr " / Counter for 0-division in FIR (indicates failure)" UBYTE OneToOne 1 100 0.00 255.0 FORMAT "%5.1" ECU_ADDRESS 0x6001F4BE /end MEASUREMENT
/begin MEASUREMENT FanSpd_FirCalc.flgRdDne " / FIR: reading from uRaw-sum done" UBYTE OneToOne 1 100 0.00 1.000 BIT_MASK 0x1 FORMAT "%5.3" ECU_ADDRESS 0x6001F4BF /end MEASUREMENT
/begin MEASUREMENT FanSpd_FirCalc.uRawAvrg " / FIR: simple average calculated uRaw" SWORD Volt 1 100 -6553.600 6553.400 FORMAT "%8.3" ECU_ADDRESS 0x6001F4C0 /end MEASUREMENT
/begin MEASUREMENT FanSpd_FirCalc.uRawFir " / FIR: Calculated uRaw" SWORD Volt 1 100 -6553.600 6553.400 FORMAT "%8.3" ECU_ADDRESS 0x6001F4C2 /end MEASUREMENT
/begin MEASUREMENT FanSpd_FirRead.cntr " / Counter for simple average FIR" UBYTE OneToOne 1 100 0.00 255.0 FORMAT "%5.1" ECU_ADDRESS 0x6000086C /end MEASUREMENT
/begin MEASUREMENT FanSpd_FirRead.flgFirstRun " / FIR: 1st run after init" UBYTE OneToOne 1 100 0.00 1.000 BIT_MASK 0x1 FORMAT "%5.3" ECU_ADDRESS 0x6000086D /end MEASUREMENT
/begin MEASUREMENT FanSpd_FirRead.idxArr " / FIR ringbuffer: actual index" UBYTE OneToOne 1 100 0.00 255.0 FORMAT "%5.1" ECU_ADDRESS 0x6000086E /end MEASUREMENT
/begin MEASUREMENT FanSpd_FirRead.uSum " / Simple average FIR: sum of uRaws" SLONG Volt 1 100 -429496729.600 429496729.400 FORMAT "%13.3" ECU_ADDRESS 0x60000870 /end MEASUREMENT
/begin MEASUREMENT FanSpd_nAct "" SWORD TurboN 1 100 -327680.0 327670.0 FORMAT "%8.1" ECU_ADDRESS 0x6001FDE2
 /begin IF_DATA XCPplus 0x0102
  /begin DAQ_EVENT VARIABLE /end DAQ_EVENT
 /end IF_DATA
/end MEASUREMENT
/begin MEASUREMENT FanSpd_nActSens "" SWORD TurboN 1 100 -327680.0 327670.0 FORMAT "%8.1" ECU_ADDRESS 0x6001FDE0
 /begin IF_DATA XCPplus 0x0102
  /begin DAQ_EVENT VARIABLE /end DAQ_EVENT
 /end IF_DATA
/end MEASUREMENT
/begin MEASUREMENT FanSpd_nActSensCpl "" SWORD OneToOne 1 100 -32768.00 32767.00 FORMAT "%8.2" ECU_ADDRESS 0x6001FDDE
 /begin IF_DATA XCPplus 0x0102
  /begin DAQ_EVENT VARIABLE /end DAQ_EVENT
 /end IF_DATA
/end MEASUREMENT
/begin MEASUREMENT FanSpd_nActSensUnFltd "" SWORD RBPtCel_n_1p0_1 1 100 -32768.00 32767.00 FORMAT "%8.2" ECU_ADDRESS 0x6001FDDC
 /begin IF_DATA XCPplus 0x0102
  /begin DAQ_EVENT VARIABLE /end DAQ_EVENT
 /end IF_DATA
/end MEASUREMENT
/begin MEASUREMENT FanSpd_nActSens_f "" FLOAT32_IEEE RBPtCel_n_1p0_1 1 100 -1.00000000E+037 1.00000000E+037 FORMAT "%13.3" ECU_ADDRESS 0x600011A4
 /begin IF_DATA XCPplus 0x0102
  /begin DAQ_EVENT VARIABLE /end DAQ_EVENT
 /end IF_DATA
/end MEASUREMENT
/begin MEASUREMENT FanSpd_stSnsrDdCalc "" UBYTE OneToOne 1 100 0.00 255.0 BIT_MASK 0x1 FORMAT "%5.1" ECU_ADDRESS 0x600236B3
 /begin IF_DATA XCPplus 0x0102
  /begin DAQ_EVENT VARIABLE /end DAQ_EVENT
 /end IF_DATA
/end MEASUREMENT
/begin MEASUREMENT FanSpd_stSnsrDdReadCalc "" UBYTE OneToOne 1 100 0.00 255.0 BIT_MASK 0x1 FORMAT "%5.1" ECU_ADDRESS 0x600236B2
 /begin IF_DATA XCPplus 0x0102
  /begin DAQ_EVENT VARIABLE /end DAQ_EVENT
 /end IF_DATA
/end MEASUREMENT
/begin MEASUREMENT FanSpd_swtSensPres "" UBYTE OneToOne 1 100 0.00 255.0 FORMAT "%5.1" ECU_ADDRESS 0x600237E5
 /begin IF_DATA XCPplus 0x0102
  /begin DAQ_EVENT VARIABLE /end DAQ_EVENT
 /end IF_DATA
/end MEASUREMENT
/begin MEASUREMENT FanSpd_tiSRCMaxDefDeb "" SLONG Time_ms 1 100 -21474836480.0 21474836470.0 FORMAT "%13.1" ECU_ADDRESS 0x600010B0
 /begin IF_DATA XCPplus 0x0102
  /begin DAQ_EVENT VARIABLE /end DAQ_EVENT
 /end IF_DATA
/end MEASUREMENT
/begin MEASUREMENT FanSpd_tRefSnsr_mp "" SWORD Temp_Cels 1 100 -3549.940 3003.560 FORMAT "%8.3" ECU_ADDRESS 0x7000698E /end MEASUREMENT
/begin MEASUREMENT FanSpd_tSensPT1Fltd_mp "" SWORD RBPtCel_n_1p0_1 1 100 -32768.00 32767.00 FORMAT "%8.2" ECU_ADDRESS 0x7000698C /end MEASUREMENT
/begin MEASUREMENT FanSpd_uRaw "" SWORD Volt 1 100 -6553.600 6553.400 FORMAT "%8.3" ECU_ADDRESS 0x6001FDD8
 /begin IF_DATA XCPplus 0x0102
  /begin DAQ_EVENT VARIABLE /end DAQ_EVENT
 /end IF_DATA
/end MEASUREMENT
/begin MEASUREMENT FanSpd_uRawPT1Fltd "" SWORD Volt 1 100 -6553.600 6553.400 FORMAT "%8.3" ECU_ADDRESS 0x6001FDD6
 /begin IF_DATA XCPplus 0x0102
  /begin DAQ_EVENT VARIABLE /end DAQ_EVENT
 /end IF_DATA
/end MEASUREMENT
/begin MEASUREMENT FanSpd_uRawPT1FltdSens "" SWORD Volt 1 100 -6553.600 6553.400 FORMAT "%8.3" ECU_ADDRESS 0x6001FDD4
 /begin IF_DATA XCPplus 0x0102
  /begin DAQ_EVENT VARIABLE /end DAQ_EVENT
 /end IF_DATA
/end MEASUREMENT
/begin MEASUREMENT FanSpd_uRawUnFltd "" SWORD Volt 1 100 -6553.600 6553.400 FORMAT "%8.3" ECU_ADDRESS 0x6001FDD2
 /begin IF_DATA XCPplus 0x0102
  /begin DAQ_EVENT VARIABLE /end DAQ_EVENT
 /end IF_DATA
/end MEASUREMENT
/begin MEASUREMENT FanSpd_uRaw_f "" FLOAT32_IEEE RBPtCel_u_1p0_2 1 100 -1.00000000E+037 1.00000000E+037 FORMAT "%13.3" ECU_ADDRESS 0x60001198
 /begin IF_DATA XCPplus 0x0102
  /begin DAQ_EVENT VARIABLE /end DAQ_EVENT
 /end IF_DATA
/end MEASUREMENT
/begin MEASUREMENT fho_msg "Altitude correction factor" UBYTE fak_ub_b4 1 100 0.00 3.984 FORMAT "%5.3" ECU_ADDRESS 0x6002342F
 /begin IF_DATA XCPplus 0x0102
  /begin DAQ_EVENT VARIABLE /end DAQ_EVENT
 /end IF_DATA
/end MEASUREMENT
/begin MEASUREMENT frhol_w_msg "Factor: air density f(intake air temp., altitude), 16-bit" UWORD fak_uw_b2 1 100 0.00 1.999969 FORMAT "%8.6" ECU_ADDRESS 0x6001F9A2
 /begin IF_DATA XCPplus 0x0102
  /begin DAQ_EVENT VARIABLE /end DAQ_EVENT
 /end IF_DATA
/end MEASUREMENT
/begin MEASUREMENT PEnv_ctDrvEnter "drive state counter" UBYTE OneToOne 1 100 0.00 255.0 FORMAT "%5.1" ECU_ADDRESS 0x60023151
 /begin IF_DATA XCPplus 0x0102
  /begin DAQ_EVENT VARIABLE /end DAQ_EVENT
 /end IF_DATA
/end MEASUREMENT
/begin MEASUREMENT PEnv_ctPostDrvLeave "post drive state counter" UBYTE OneToOne 1 100 0.00 255.0 FORMAT "%5.1" ECU_ADDRESS 0x60023150
 /begin IF_DATA XCPplus 0x0102
  /begin DAQ_EVENT VARIABLE /end DAQ_EVENT
 /end IF_DATA
/end MEASUREMENT
/begin MEASUREMENT PEnv_dataDigSnsr "Digital raw data from ambient pressure sensor" ULONG OneToOne 1 100 0.00 4294967295.00 FORMAT "%13.2" ECU_ADDRESS 0x60000888 /end MEASUREMENT
/begin MEASUREMENT PEnv_DD_ctPostDrvLeave "Local drive cycle counter which is incremented when system state SyC_PostDrive is left" UWORD OneToOne 1 100 0.00 256.0000 FORMAT "%8.4" ECU_ADDRESS 0x6001F4CC
 /begin IF_DATA XCPplus 0x0102
  /begin DAQ_EVENT VARIABLE /end DAQ_EVENT
 /end IF_DATA
/end MEASUREMENT
/begin MEASUREMENT PEnv_dpAirFilThr "pressure loss at air filter depending on air mass flow" UWORD p_q0p078 1 100 0.00 5119.922 FORMAT "%8.3" ECU_ADDRESS 0x6001F9B6
 /begin IF_DATA XCPplus 0x0102
  /begin DAQ_EVENT VARIABLE /end DAQ_EVENT
 /end IF_DATA
/end MEASUREMENT
/begin MEASUREMENT PEnv_facCorrAlti "Altitude correction factor" UWORD fak_uw_b4 1 100 0.00 3.999939 FORMAT "%8.6" ECU_ADDRESS 0x6001F9B4
 /begin IF_DATA XCPplus 0x0102
  /begin DAQ_EVENT VARIABLE /end DAQ_EVENT
 /end IF_DATA
/end MEASUREMENT
/begin MEASUREMENT PEnv_flgBndMdlRngVld "Healing of continuity check with additional value" UBYTE B_TRUE 1 100 0.00 1.00000000000 BIT_MASK 0x1 FORMAT "%13.11" ECU_ADDRESS 0x70000220
 /begin IF_DATA XCPplus 0x0102
  /begin DAQ_EVENT VARIABLE /end DAQ_EVENT
 /end IF_DATA
/end MEASUREMENT
/begin MEASUREMENT PEnv_flgBndMdlVirtVld "Condition threshold modells for ambient pressure valid virtuelly" UBYTE B_TRUE 1 100 0.00 1.00000000000 BIT_MASK 0x1 FORMAT "%13.11" ECU_ADDRESS 0x7000021F
 /begin IF_DATA XCPplus 0x0102
  /begin DAQ_EVENT VARIABLE /end DAQ_EVENT
 /end IF_DATA
/end MEASUREMENT
/begin MEASUREMENT PEnv_flgBndMdlVld "Condition threshold modells for ambient pressure valid" UBYTE B_TRUE 1 100 0.00 1.00000000000 BIT_MASK 0x1 FORMAT "%13.11" ECU_ADDRESS 0x7000021E
 /begin IF_DATA XCPplus 0x0102
  /begin DAQ_EVENT VARIABLE /end DAQ_EVENT
 /end IF_DATA
/end MEASUREMENT
/begin MEASUREMENT PEnv_flgCcLdcCmpl "Cycle flag ambient pressure from current driving cycle adopted" UBYTE B_TRUE 1 100 0.00 1.00000000000 BIT_MASK 0x1 FORMAT "%13.11" ECU_ADDRESS 0x7000021D
 /begin IF_DATA XCPplus 0x0102
  /begin DAQ_EVENT VARIABLE /end DAQ_EVENT
 /end IF_DATA
/end MEASUREMENT
/begin MEASUREMENT PEnv_flgCcLdcDiagCmpl "zyklus flag for diagnosis by comparing actual and last driving cycle ambient pressure" UBYTE B_TRUE 1 100 0.00 1.00000000000 BIT_MASK 0x1 FORMAT "%13.11" ECU_ADDRESS 0x70000186
 /begin IF_DATA XCPplus 0x0102
  /begin DAQ_EVENT VARIABLE /end DAQ_EVENT
 /end IF_DATA
/end MEASUREMENT
/begin MEASUREMENT PEnv_flgCcLdcInvld "Condition: Fault suspicion from continuity check between the drives" UBYTE B_TRUE 1 100 0.00 1.00000000000 BIT_MASK 0x1 FORMAT "%13.11" ECU_ADDRESS 0x70000185
 /begin IF_DATA XCPplus 0x0102
  /begin DAQ_EVENT VARIABLE /end DAQ_EVENT
 /end IF_DATA
/end MEASUREMENT
/begin MEASUREMENT PEnv_flgCcLdcVld "Condition: Healing from continuity check between the drives" UBYTE B_TRUE 1 100 0.00 1.00000000000 BIT_MASK 0x1 FORMAT "%13.11" ECU_ADDRESS 0x70000184
 /begin IF_DATA XCPplus 0x0102
  /begin DAQ_EVENT VARIABLE /end DAQ_EVENT
 /end IF_DATA
/end MEASUREMENT
/begin MEASUREMENT PEnv_flgCcMaxInvld "Condition discontinuity ambient air pressure downwards" UBYTE B_TRUE 1 100 0.00 1.00000000000 BIT_MASK 0x1 FORMAT "%13.11" ECU_ADDRESS 0x7000021C
 /begin IF_DATA XCPplus 0x0102
  /begin DAQ_EVENT VARIABLE /end DAQ_EVENT
 /end IF_DATA
/end MEASUREMENT
/begin MEASUREMENT PEnv_flgCcMinInvld "Condition discontinuity ambient air pressure upwards" UBYTE B_TRUE 1 100 0.00 1.00000000000 BIT_MASK 0x1 FORMAT "%13.11" ECU_ADDRESS 0x7000021B
 /begin IF_DATA XCPplus 0x0102
  /begin DAQ_EVENT VARIABLE /end DAQ_EVENT
 /end IF_DATA
/end MEASUREMENT
/begin MEASUREMENT PEnv_flgCcVld "Condition: Healing from continuity check while driving" UBYTE B_TRUE 1 100 0.00 1.00000000000 BIT_MASK 0x1 FORMAT "%13.11" ECU_ADDRESS 0x7000021A
 /begin IF_DATA XCPplus 0x0102
  /begin DAQ_EVENT VARIABLE /end DAQ_EVENT
 /end IF_DATA
/end MEASUREMENT
/begin MEASUREMENT PEnv_flgDeadLockPrevn "Condition deadlock threshold modells for ambient pressure valid" UBYTE B_TRUE 1 100 0.00 1.00000000000 BIT_MASK 0x1 FORMAT "%13.11" ECU_ADDRESS 0x70000219
 /begin IF_DATA XCPplus 0x0102
  /begin DAQ_EVENT VARIABLE /end DAQ_EVENT
 /end IF_DATA
/end MEASUREMENT
/begin MEASUREMENT PEnv_flgDsmClrTrig "Trigger flag to clear diagnosis relevant elements" UBYTE B_TRUE 1 100 0.00 1.00000000000 BIT_MASK 0x1 FORMAT "%13.11" ECU_ADDRESS 0x70000189
 /begin IF_DATA XCPplus 0x0102
  /begin DAQ_EVENT VARIABLE /end DAQ_EVENT
 /end IF_DATA
/end MEASUREMENT
/begin MEASUREMENT PEnv_flgErrSuspcCc "Condition: Error suspision from contionious check" UBYTE B_TRUE 1 100 0.00 1.00000000000 BIT_MASK 0x1 FORMAT "%13.11" ECU_ADDRESS 0x60034950
 /begin IF_DATA XCPplus 0x0102
  /begin DAQ_EVENT VARIABLE /end DAQ_EVENT
 /end IF_DATA
/end MEASUREMENT
/begin MEASUREMENT PEnv_flgGetData "Status bit valid data received form digital ambient pressure sensor" UBYTE B_TRUE 1 100 0.00 1.00000000000 BIT_MASK 0x1 FORMAT "%13.11" ECU_ADDRESS 0x70000188
 /begin IF_DATA XCPplus 0x0102
  /begin DAQ_EVENT VARIABLE /end DAQ_EVENT
 /end IF_DATA
/end MEASUREMENT
/begin MEASUREMENT PEnv_flgHealSuspcCc "Condition: Healing of error suspision from contionious check" UBYTE B_TRUE 1 100 0.00 1.00000000000 BIT_MASK 0x1 FORMAT "%13.11" ECU_ADDRESS 0x70000218
 /begin IF_DATA XCPplus 0x0102
  /begin DAQ_EVENT VARIABLE /end DAQ_EVENT
 /end IF_DATA
/end MEASUREMENT
/begin MEASUREMENT PEnv_flgInctRatCmpl "condition numerator complete for rationality diagnostic of ambient pressure sensor" UBYTE B_TRUE 1 100 0.00 1.00000000000 BIT_MASK 0x1 FORMAT "%13.11" ECU_ADDRESS 0x70000183
 /begin IF_DATA XCPplus 0x0102
  /begin DAQ_EVENT VARIABLE /end DAQ_EVENT
 /end IF_DATA
/end MEASUREMENT
/begin MEASUREMENT PEnv_flgPLdcVld "ambient pressure from last driving cycle valid" UBYTE B_TRUE 1 100 0.00 1.00000000000 BIT_MASK 0x1 FORMAT "%13.11" ECU_ADDRESS 0x6003494F
 /begin IF_DATA XCPplus 0x0102
  /begin DAQ_EVENT VARIABLE /end DAQ_EVENT
 /end IF_DATA
/end MEASUREMENT
/begin MEASUREMENT PEnv_flgPMdlVld "condition: modelled ambient pressure valid" UBYTE B_TRUE 1 100 0.00 1.00000000000 BIT_MASK 0x1 FORMAT "%13.11" ECU_ADDRESS 0x6003494D /end MEASUREMENT
/begin MEASUREMENT PEnv_flgPMeasdVld "condition: ambient pressure from sensor valid" UBYTE B_TRUE 1 100 0.00 1.00000000000 BIT_MASK 0x1 FORMAT "%13.11" ECU_ADDRESS 0x70000217
 /begin IF_DATA XCPplus 0x0102
  /begin DAQ_EVENT VARIABLE /end DAQ_EVENT
 /end IF_DATA
/end MEASUREMENT
/begin MEASUREMENT PEnv_flgPPlaus "status indicates the signal is plausible" UBYTE B_TRUE 1 100 0.00 1.00000000000 BIT_MASK 0x1 FORMAT "%13.11" ECU_ADDRESS 0x70000216
 /begin IF_DATA XCPplus 0x0102
  /begin DAQ_EVENT VARIABLE /end DAQ_EVENT
 /end IF_DATA
/end MEASUREMENT
/begin MEASUREMENT PEnv_flgPRawVld "Validity flag for the raw ambient pressure sensor" UBYTE B_TRUE 1 100 0.00 1.00000000000 BIT_MASK 0x1 FORMAT "%13.11" ECU_ADDRESS 0x60023490
 /begin IF_DATA XCPplus 0x0102
  /begin DAQ_EVENT VARIABLE /end DAQ_EVENT
 /end IF_DATA
/end MEASUREMENT
/begin MEASUREMENT PEnv_flgPRawVldDiag "Condition ambient pressure sensor valid delayed" UBYTE B_TRUE 1 100 0.00 1.00000000000 BIT_MASK 0x1 FORMAT "%13.11" ECU_ADDRESS 0x70000182
 /begin IF_DATA XCPplus 0x0102
  /begin DAQ_EVENT VARIABLE /end DAQ_EVENT
 /end IF_DATA
/end MEASUREMENT
/begin MEASUREMENT PEnv_flgPVld "condition: ambient pressure valid" UBYTE B_TRUE 1 100 0.00 1.00000000000 BIT_MASK 0x1 FORMAT "%13.11" ECU_ADDRESS 0x70000215
 /begin IF_DATA XCPplus 0x0102
  /begin DAQ_EVENT VARIABLE /end DAQ_EVENT
 /end IF_DATA
/end MEASUREMENT
/begin MEASUREMENT PEnv_flgRngChkMaxInvld "Error condition max from physical range check" UBYTE B_TRUE 1 100 0.00 1.00000000000 BIT_MASK 0x1 FORMAT "%13.11" ECU_ADDRESS 0x70000214
 /begin IF_DATA XCPplus 0x0102
  /begin DAQ_EVENT VARIABLE /end DAQ_EVENT
 /end IF_DATA
/end MEASUREMENT
/begin MEASUREMENT PEnv_flgRngChkMaxVld "Healing condition max from physical range check" UBYTE B_TRUE 1 100 0.00 1.00000000000 BIT_MASK 0x1 FORMAT "%13.11" ECU_ADDRESS 0x70000213
 /begin IF_DATA XCPplus 0x0102
  /begin DAQ_EVENT VARIABLE /end DAQ_EVENT
 /end IF_DATA
/end MEASUREMENT
/begin MEASUREMENT PEnv_flgRngChkMinInvld "Error condition min from physical range check" UBYTE B_TRUE 1 100 0.00 1.00000000000 BIT_MASK 0x1 FORMAT "%13.11" ECU_ADDRESS 0x70000212
 /begin IF_DATA XCPplus 0x0102
  /begin DAQ_EVENT VARIABLE /end DAQ_EVENT
 /end IF_DATA
/end MEASUREMENT
/begin MEASUREMENT PEnv_flgRngChkMinVld "Healing condition min from physical range check" UBYTE B_TRUE 1 100 0.00 1.00000000000 BIT_MASK 0x1 FORMAT "%13.11" ECU_ADDRESS 0x70000211
 /begin IF_DATA XCPplus 0x0102
  /begin DAQ_EVENT VARIABLE /end DAQ_EVENT
 /end IF_DATA
/end MEASUREMENT
/begin MEASUREMENT PEnv_flgSnsrBootRdy "Status of Sensor readiness" UBYTE B_TRUE 1 100 0.00 1.00000000000 BIT_MASK 0x1 FORMAT "%13.11" ECU_ADDRESS 0x70000210
 /begin IF_DATA XCPplus 0x0102
  /begin DAQ_EVENT VARIABLE /end DAQ_EVENT
 /end IF_DATA
/end MEASUREMENT
/begin MEASUREMENT PEnv_flgSnsrPlausInvld "status plausible error information from digital ambient air pressure sensor" UBYTE B_TRUE 1 100 0.00 1.00000000000 BIT_MASK 0x1 FORMAT "%13.11" ECU_ADDRESS 0x7000020F
 /begin IF_DATA XCPplus 0x0102
  /begin DAQ_EVENT VARIABLE /end DAQ_EVENT
 /end IF_DATA
/end MEASUREMENT
/begin MEASUREMENT PEnv_flgSnsrRst "Sensor reset has been triggered" UBYTE B_TRUE 1 100 0.00 1.00000000000 BIT_MASK 0x1 FORMAT "%13.11" ECU_ADDRESS 0x7000020E
 /begin IF_DATA XCPplus 0x0102
  /begin DAQ_EVENT VARIABLE /end DAQ_EVENT
 /end IF_DATA
/end MEASUREMENT
/begin MEASUREMENT PEnv_flgUseIniAftStrtEnd "condition for valid ambient pressure model based on manifold pressure" UBYTE B_TRUE 1 100 0.00 1.00000000000 BIT_MASK 0x1 FORMAT "%13.11" ECU_ADDRESS 0x70000187
 /begin IF_DATA XCPplus 0x0102
  /begin DAQ_EVENT VARIABLE /end DAQ_EVENT
 /end IF_DATA
/end MEASUREMENT
/begin MEASUREMENT PEnv_p "Ambient pressure" UWORD p_q0p039 1 100 0.00 2559.961 FORMAT "%8.3" ECU_ADDRESS 0x6001F9B2
 /begin IF_DATA XCPplus 0x0102
  /begin DAQ_EVENT VARIABLE /end DAQ_EVENT
 /end IF_DATA
/end MEASUREMENT
/begin MEASUREMENT PEnv_pBndMdlMax "maximum modelled ambient pressure" UWORD p_q0p039 1 100 0.00 2559.961 FORMAT "%8.3" ECU_ADDRESS 0x6001F9B0
 /begin IF_DATA XCPplus 0x0102
  /begin DAQ_EVENT VARIABLE /end DAQ_EVENT
 /end IF_DATA
/end MEASUREMENT
/begin MEASUREMENT PEnv_pBndMdlMin "minimal modelled ambient pressure" UWORD p_q0p039 1 100 0.00 2559.961 FORMAT "%8.3" ECU_ADDRESS 0x6001F9AE
 /begin IF_DATA XCPplus 0x0102
  /begin DAQ_EVENT VARIABLE /end DAQ_EVENT
 /end IF_DATA
/end MEASUREMENT
/begin MEASUREMENT PEnv_pCurrDrvCyc "electr. valid ambient pressure from actual driving cycle" UWORD p_q0p039 1 100 0.00 2559.961 FORMAT "%8.3" ECU_ADDRESS 0x6001F4CA
 /begin IF_DATA XCPplus 0x0102
  /begin DAQ_EVENT VARIABLE /end DAQ_EVENT
 /end IF_DATA
/end MEASUREMENT
/begin MEASUREMENT PEnv_pDly "delayed ambient pressure" UWORD p_q0p039 1 100 0.00 2559.961 FORMAT "%8.3" ECU_ADDRESS 0x6001F4C8
 /begin IF_DATA XCPplus 0x0102
  /begin DAQ_EVENT VARIABLE /end DAQ_EVENT
 /end IF_DATA
/end MEASUREMENT
/begin MEASUREMENT PEnv_pLdc "ambient pressure from last driving cycle" UWORD p_q0p039 1 100 0.00 2559.961 FORMAT "%8.3" ECU_ADDRESS 0x60036004
 /begin IF_DATA XCPplus 0x0102
  /begin DAQ_EVENT VARIABLE /end DAQ_EVENT
 /end IF_DATA
/end MEASUREMENT
/begin MEASUREMENT PEnv_pMdl "Ambient pressure from model" UWORD p_q0p039 1 100 0.00 2559.961 FORMAT "%8.3" ECU_ADDRESS 0x6001F9AC /end MEASUREMENT
/begin MEASUREMENT PEnv_pMeas "Ambient pressure measured" UWORD p_q0p039 1 100 0.00 2559.961 FORMAT "%8.3" ECU_ADDRESS 0x6001F9AA
 /begin IF_DATA XCPplus 0x0102
  /begin DAQ_EVENT VARIABLE /end DAQ_EVENT
 /end IF_DATA
/end MEASUREMENT
/begin MEASUREMENT PEnv_pRaw "ambient air pressure raw value measured" UWORD p_q0p039 1 100 0.00 2559.961 FORMAT "%8.3" ECU_ADDRESS 0x6001F9A8
 /begin IF_DATA XCPplus 0x0102
  /begin DAQ_EVENT VARIABLE /end DAQ_EVENT
 /end IF_DATA
/end MEASUREMENT
/begin MEASUREMENT PEnv_pRawFild "filtered ambient pressure" UWORD p_q0p039 1 100 0.00 2559.961 FORMAT "%8.3" ECU_ADDRESS 0x6001F4C6
 /begin IF_DATA XCPplus 0x0102
  /begin DAQ_EVENT VARIABLE /end DAQ_EVENT
 /end IF_DATA
/end MEASUREMENT
/begin MEASUREMENT PEnv_stErrMsgSens "bit coded error information from digital ambient air pressure sensor" ULONG OneToOne 1 100 0.00 4294967295.00 FORMAT "%13.2" ECU_ADDRESS 0x60000884
 /begin IF_DATA XCPplus 0x0102
  /begin DAQ_EVENT VARIABLE /end DAQ_EVENT
 /end IF_DATA
/end MEASUREMENT
/begin MEASUREMENT PEnv_stSigP "Signalstatus ambient pressure" UBYTE OneToOne 1 100 0.00 255.0 FORMAT "%5.1" ECU_ADDRESS 0x60023443
 /begin IF_DATA XCPplus 0x0102
  /begin DAQ_EVENT VARIABLE /end DAQ_EVENT
 /end IF_DATA
/end MEASUREMENT
/begin MEASUREMENT PEnv_VDDiag_flgDsmClrTrig "Trigger flag to clear diagnosis relevant elements" UBYTE B_TRUE 1 100 0.00 1.00000000000 BIT_MASK 0x1 FORMAT "%13.11" ECU_ADDRESS 0x70000181
 /begin IF_DATA XCPplus 0x0102
  /begin DAQ_EVENT VARIABLE /end DAQ_EVENT
 /end IF_DATA
/end MEASUREMENT
/begin MEASUREMENT PT_nDesEm01 "Desired speed for e-machine 01" SWORD nmot_q1 1 100 -32768.00 32767.00 FORMAT "%8.2" ECU_ADDRESS 0x6001FA76
 /begin IF_DATA XCPplus 0x0102
  /begin DAQ_EVENT VARIABLE /end DAQ_EVENT
 /end IF_DATA
/end MEASUREMENT
/begin MEASUREMENT PT_stOperModeDesEm01 "Desired operation mode of e-machine 01." UBYTE OneToOne 1 100 0.00 255.0 FORMAT "%5.1" ECU_ADDRESS 0x60023513
 /begin IF_DATA XCPplus 0x0102
  /begin DAQ_EVENT VARIABLE /end DAQ_EVENT
 /end IF_DATA
/end MEASUREMENT
/begin MEASUREMENT pum_w_msg "Ambient pressure from model" UWORD p_q0p039 1 100 0.00 2559.961 FORMAT "%8.3" ECU_ADDRESS 0x60036002
 /begin IF_DATA XCPplus 0x0102
  /begin DAQ_EVENT VARIABLE /end DAQ_EVENT
 /end IF_DATA
/end MEASUREMENT
/begin MEASUREMENT pur_w_msg "Ambient pressure from sensor" UWORD p_q0p039 1 100 0.00 2559.961 FORMAT "%8.3" ECU_ADDRESS 0x6001F9A0
 /begin IF_DATA XCPplus 0x0102
  /begin DAQ_EVENT VARIABLE /end DAQ_EVENT
 /end IF_DATA
/end MEASUREMENT
/begin MEASUREMENT pu_msg "Ambient pressure" UBYTE p_ub_q5 1 100 0.00 1275. FORMAT "%5.0" ECU_ADDRESS 0x6002342E
 /begin IF_DATA XCPplus 0x0102
  /begin DAQ_EVENT VARIABLE /end DAQ_EVENT
 /end IF_DATA
/end MEASUREMENT
/begin FUNCTION ElM_StAct "1400.3.0  Actual states of inverter and e-machine"
 /begin DEF_CHARACTERISTIC DDRC_DurDeb.ElM_tiActvDchaFltDebOk_C DDRC_DurDeb.ElM_tiActvDchaFltDebDef_C DDRC_DurDeb.ElM_tiImobAuthentDebOk_C DDRC_DurDeb.ElM_tiImobAuthentDebDef_C DDRC_DurDeb.ElM_tiIsoMonFltDebOk_C DDRC_DurDeb.ElM_tiIsoMonFltDebDef_C DDRC_DurDeb.ElM_tiIvtrCooltTDebOk_C DDRC_DurDeb.ElM_tiIvtrCooltTDebDef_C DDRC_DurDeb.ElM_tiIvtrEmgyShtDwnDebOk_C DDRC_DurDeb.ElM_tiIvtrEmgyShtDwnDebDef_C DDRC_DurDeb.ElM_tiIvtrFailrDebOk_C DDRC_DurDeb.ElM_tiIvtrFailrDebDef_C DDRC_DurDeb.ElM_tiIvtrIntlckDebOk_C DDRC_DurDeb.ElM_tiIvtrIntlckDebDef_C DDRC_DurDeb.ElM_tiIvtrTErrDebOk_C DDRC_DurDeb.ElM_tiIvtrTErrDebDef_C DDRC_DurDeb.ElM_tiPwrAuthnDebOk_C DDRC_DurDeb.ElM_tiPwrAuthnDebDef_C DDRC_DurDeb.ElM_tiSpdErrDebOk_C DDRC_DurDeb.ElM_tiSpdErrDebDef_C DDRC_DurDeb.ElM_tiSvsDebOk_C DDRC_DurDeb.ElM_tiSvsDebDef_C DFC_CtlMsk2.DFC_ElMActvDchaFlt_C DFC_CtlMsk2.DFC_ElMImobAuthent_C DFC_CtlMsk2.DFC_ElMIsoMonFlt_C DFC_CtlMsk2.DFC_ElMIvtrCooltT01_C DFC_CtlMsk2.DFC_ElMIvtrEmgyShtDwn01_C DFC_CtlMsk2.DFC_ElMIvtrFailr01_C DFC_CtlMsk2.DFC_ElMIvtrIntlck01_C DFC_CtlMsk2.DFC_ElMIvtrTErr01_C DFC_CtlMsk2.DFC_ElMPwrAuthn_C DFC_CtlMsk2.DFC_ElMSpdErr01_C DFC_CtlMsk2.DFC_ElMSvs01_C DFC_DisblMsk2.DFC_ElMActvDchaFlt_C DFC_DisblMsk2.DFC_ElMImobAuthent_C DFC_DisblMsk2.DFC_ElMIsoMonFlt_C DFC_DisblMsk2.DFC_ElMIvtrCooltT01_C DFC_DisblMsk2.DFC_ElMIvtrEmgyShtDwn01_C DFC_DisblMsk2.DFC_ElMIvtrFailr01_C DFC_DisblMsk2.DFC_ElMIvtrIntlck01_C DFC_DisblMsk2.DFC_ElMIvtrTErr01_C DFC_DisblMsk2.DFC_ElMPwrAuthn_C DFC_DisblMsk2.DFC_ElMSpdErr01_C DFC_DisblMsk2.DFC_ElMSvs01_C ElM_ActSt01_I.ElM_maskFlgEmgyShtDwnReqVldSq_C ElM_ActSt01_I.ElM_maskFlgIntlckClsdVldSq_C ElM_ActSt01_I.ElM_maskFlgSvsReqVldSq_C ElM_ActSt01_I.ElM_maskStModInvldSq_C ElM_ActSt01_I.ElM_masknActInvldSq_C ElM_ActSt01_I.ElM_masktInvrInvldSq_C ElM_ActSt01_I.ElM_masktIvtrCooltInvldSq_C ElM_ActSt01_I.ElM_stEem_T ElM_ActSt01_I.ElM_stOperModAct_T ElM_maskActvDchaVldSq_C ElM_maskImobAuthentVldSq_C ElM_maskIsoMeasmtVldSq_C ElM_maskIsoMonSwtAckVldSq_C ElM_maskPwrAuthnVldSq_C ElM_rIsoMeasmtThd_C ElM_stActvDchaFlt_T ElM_stIsoMonOn_C /end DEF_CHARACTERISTIC
 /begin IN_MEASUREMENT ComEmac_flgEmgyShtDwnReq01 ComEmac_flgEmgyShtDwnReq01_Sq ComEmac_flgImobAuthent ComEmac_flgImobAuthent_Sq ComEmac_flgIntlckClsd01 ComEmac_flgIntlckClsd01_Sq ComEmac_flgSvsReq01 ComEmac_flgSvsReq01_Sq ComEmac_nAct01_Sq ComEmac_stActvDcha ComEmac_stActvDcha_Sq ComEmac_stIsoMonSwtAck ComEmac_stIsoMonSwtAck_Sq ComEmac_stMod01 ComEmac_stMod01_Sq ComEmac_stPwrAuthn ComEmac_stPwrAuthn_Sq ComEmac_tInvr01_Sq ComEmac_tIvtrCoolt01_Sq HvBatt_rIsoMeasmt HvBatt_rIsoMeasmt_Sq HvBatt_stMaiSwtAct T15_st /end IN_MEASUREMENT
 /begin OUT_MEASUREMENT DDRC_St.DFC_ElMActvDchaFlt DDRC_St.DFC_ElMImobAuthent DDRC_St.DFC_ElMIsoMonFlt DDRC_St.DFC_ElMIvtrCooltT01 DDRC_St.DFC_ElMIvtrEmgyShtDwn01 DDRC_St.DFC_ElMIvtrFailr01 DDRC_St.DFC_ElMIvtrIntlck01 DDRC_St.DFC_ElMIvtrTErr01 DDRC_St.DFC_ElMPwrAuthn DDRC_St.DFC_ElMSpdErr01 DDRC_St.DFC_ElMSvs01 DFC_st.DFC_ElMActvDchaFlt DFC_st.DFC_ElMImobAuthent DFC_st.DFC_ElMIsoMonFlt DFC_st.DFC_ElMIvtrCooltT01 DFC_st.DFC_ElMIvtrEmgyShtDwn01 DFC_st.DFC_ElMIvtrFailr01 DFC_st.DFC_ElMIvtrIntlck01 DFC_st.DFC_ElMIvtrTErr01 DFC_st.DFC_ElMPwrAuthn DFC_st.DFC_ElMSpdErr01 DFC_st.DFC_ElMSvs01 ElM_stEem01 ElM_stOperModAct01 /end OUT_MEASUREMENT
 /begin LOC_MEASUREMENT ElM_ActSt01_I.ComEmac_flgEmgyShtDwnReq ElM_ActSt01_I.ComEmac_flgEmgyShtDwnReq_Sq ElM_ActSt01_I.ComEmac_stMod ElM_ActSt01_I.ComEmac_stMod_Sq ElM_ActSt01_I.ElM_flgIvtrComSucc ElM_ActSt01_I.ElM_stEem ElM_ActSt01_I.ElM_stOperModAct ElM_ActSt01_I.T15_st /end LOC_MEASUREMENT
 FUNCTION_VERSION "1400.3.0" /end FUNCTION
/begin FUNCTION ElM_StDes "1400.4.0  Desired states of inverter and e-machine"
 /begin DEF_CHARACTERISTIC ElM_DesSt01_I.ElM_stDesEem_T ElM_flgSwtIvtrWakeup_C ElM_stIvtrWakeupTyp_C ElM_stSelDchaReq_C ElM_tiIsoMonDurn_C ElM_tiIsoMonStrt_C ElM_tiIvtrWakeupDly_C /end DEF_CHARACTERISTIC
 /begin IN_MEASUREMENT Com_bPostOperationWkuReq Eem_flgFltHvDchaReq Eem_flgHvDchaReq Eem_flgSetMaiSwtHvBattClsd Emac_stLogl01 HvBatt_stMaiSwtAct T15_st VehCoorn_tiThdDebHvReq /end IN_MEASUREMENT
 /begin OUT_MEASUREMENT ElM_stDesEem01 ElM_stDesEemInt01 ElM_stIvtrWakeup ElM_stMaiSwtOn Emac_stIsoMonSwtReq /end OUT_MEASUREMENT
 /begin LOC_MEASUREMENT ElM_DesSt01_I.Eem_flgDchaReq ElM_DesSt01_I.ElM_stDesEem ElM_DesSt01_I.ElM_stDesEemInt ElM_DesSt01_I.Emac_stIsoMonSwtReqLoc ElM_DesSt01_I.Emac_stLogl ElM_flgDchaReq ElM_flgIsoMonSwtOffReq ElM_flgIsoMonSwtOnReq ElM_flgSwtIvtrWakeup ElM_IvtrWakeupTOffD_I.time /end LOC_MEASUREMENT
 FUNCTION_VERSION "1400.4.0" /end FUNCTION
/begin FUNCTION ElM_TransEMS "1400.0.0  coordination of data transfer to electrical machine"
 /begin DEF_CHARACTERISTIC Emac_TransEMS01_I.ElM_flgTqDmdNeutModEm_C Emac_TransEMS01_I.ElM_nMofMin_C Emac_TransEMS01_I.ElM_pwrTrqLim_C Emac_TransEMS01_I.ElM_trqMaxNoPrp_C Emac_TransEMS01_I.ElM_trqMinNoPrp_C Emac_TransEMS01_I.ElM_uDcMin_C Emac_TransEMS01_I.Emac_dtqMaxLimCom_C Emac_TransEMS01_I.Emac_facKpHiCom_C Emac_TransEMS01_I.Emac_facKpLoCom_C Emac_TransEMS01_I.Emac_nDeThdCom_C Emac_TransEMS01_I.Emac_tiChgGear_C Emac_TransEMS01_I.Emac_tqMaxLimCom_C Emac_TransEMS01_I.Emac_tqMinLimCom_C Emac_TransEMS01_I.Emac_tqSpdCtlMaxLimCom_C Emac_TransEMS01_I.Emac_tqSpdCtlMinLimCom_C /end DEF_CHARACTERISTIC
 /begin IN_MEASUREMENT CoPOM_pwrElecEm01DynMax CoPOM_pwrElecEm01DynMin DrvMod_stPosn ElM_flgEnaFrbdnQdrLockgOddAxles ElM_flgEnaQdrMpgOddAxles ElM_flgGearMpgActv ElM_flgSwtIvtDirEm01 Emac_nAct01 Emac_stLogl01 HvBatt_uActMeasd HvGrid_uMaxElM HvGrid_uMinElM PT_nDesEm01 PT_tqDesEmac01 /end IN_MEASUREMENT
 /begin OUT_MEASUREMENT DINH_nrActvInhReas.FId_ElMNoPrp01 DINH_nrActvInhReas.FId_ElMtrqLim01 DINH_stFId.FId_ElMNoPrp01 DINH_stFId.FId_ElMtrqLim01 ElM_iDcLnkIvtrMax01 ElM_iDcLnkIvtrMin01 ElM_uMaxLim ElM_uMinLim Emac_dtqMaxLimCom01 Emac_facKpHiCom01 Emac_facKpLoCom01 Emac_nDesCom01 Emac_nDeThdCom01 Emac_tqDesCom01 Emac_tqMaxLimCom01 Emac_tqMinLimCom01 Emac_tqSpdCtlMaxLimCom01 Emac_tqSpdCtlMinLimCom01 /end OUT_MEASUREMENT
 /begin LOC_MEASUREMENT Emac_TransEMS01_I.CoPOM_pwrElecEmDynMax Emac_TransEMS01_I.CoPOM_pwrElecEmDynMin Emac_TransEMS01_I.DrvMod_stPosn Emac_TransEMS01_I.ElM_facChgGearFild Emac_TransEMS01_I.ElM_flgChgGear Emac_TransEMS01_I.ElM_flgEnaFrbdnQdrLockg Emac_TransEMS01_I.ElM_flgEnaQdrMpg Emac_TransEMS01_I.ElM_flgGearMpgActv Emac_TransEMS01_I.ElM_flgSignMpgActv Emac_TransEMS01_I.ElM_flgSwtIvtDirEm Emac_TransEMS01_I.ElM_iDcLnkIvtrMax Emac_TransEMS01_I.ElM_iDcLnkIvtrMin Emac_TransEMS01_I.Emac_bFIdElMNoPrp Emac_TransEMS01_I.Emac_bFIdElMtrqLim Emac_TransEMS01_I.Emac_dtqMaxLimCom Emac_TransEMS01_I.Emac_facKpHiCom Emac_TransEMS01_I.Emac_facKpLoCom Emac_TransEMS01_I.Emac_nAct Emac_TransEMS01_I.Emac_nDeThdCom Emac_TransEMS01_I.Emac_nDesCom Emac_TransEMS01_I.Emac_stLogl Emac_TransEMS01_I.Emac_tqDesCom Emac_TransEMS01_I.Emac_tqDesInterTmp Emac_TransEMS01_I.Emac_tqDesTmp Emac_TransEMS01_I.Emac_tqMaxLimCom Emac_TransEMS01_I.Emac_tqMinLimCom Emac_TransEMS01_I.Emac_tqSpdCtlMaxLimCom Emac_TransEMS01_I.Emac_tqSpdCtlMinLimCom Emac_TransEMS01_I.HvBatt_uActMeasd Emac_TransEMS01_I.PT_nDesEm Emac_TransEMS01_I.PT_tqDesEmac /end LOC_MEASUREMENT
 FUNCTION_VERSION "1400.0.0" /end FUNCTION
/begin FUNCTION ElSS_Adpr "1400.2.0  Interface Adapter of ElSS"
 /begin DEF_CHARACTERISTIC ElSS_iConsolAcCmprMinThd_C ElSS_maskuElCmprHvActSq_C ElSS_maskUHvDcBusSq_C ElSS_maskuPtcActSq_C /end DEF_CHARACTERISTIC
 /begin IN_MEASUREMENT ACCmpr_iConsol ACCmpr_pwrConsol ACCmpr_stEem ACCmpr_uConsol CabAirHt_pwrConsol CabAirHt_stEem CabAirHt_uConsol Com_uElCmprHvAct_Sq Com_uPtcAct_Sq Dcdc_stEem ElM_stEem01 HvBatt_uActMeasd HvBatt_uDcBus HvBatt_uDcBus_Sq /end IN_MEASUREMENT
 /begin OUT_MEASUREMENT DINH_nrActvInhReas.FId_ElSSACCmprUFlt DINH_nrActvInhReas.FId_ElSSCabAirHtUFlt DINH_nrActvInhReas.FId_ElSSHvReqEna DINH_nrActvInhReas.FId_ElSSUHvDcBus DINH_stFId.FId_ElSSACCmprUFlt DINH_stFId.FId_ElSSCabAirHtUFlt DINH_stFId.FId_ElSSHvReqEna DINH_stFId.FId_ElSSUHvDcBus Eem_pwrHvAct01 Eem_pwrHvAct02 Eem_pwrHvAct03 Eem_pwrHvAct04 ElSS_flgHvReq ElSS_pwrHvAct01 ElSS_pwrHvAct02 ElSS_pwrHvAct03 ElSS_pwrHvAct04 ElSS_stEem01 ElSS_stEem02 ElSS_stEem03 ElSS_stEem04 ElSS_stEem05 ElSS_stEem06 ElSS_stEem07 ElSS_stEem08 ElSS_uHvActMeasd01 ElSS_uHvActMeasd02 ElSS_uHvActMeasd03 ElSS_uHvActMeasd04 /end OUT_MEASUREMENT
 FUNCTION_VERSION "1400.2.0" /end FUNCTION
/begin FUNCTION ElTrac_AdprMplEmac "35.4.0    Topology Specific Adapter for multiple electric machines" /begin OUT_MEASUREMENT PT_nDesEm01 PT_stOperModeDesEm01 /end OUT_MEASUREMENT FUNCTION_VERSION "35.4.0" /end FUNCTION
/begin FUNCTION ElTrac_GlbDef "1400.0.0  Global definitions for BC ElTrac" FUNCTION_VERSION "1400.0.0" /end FUNCTION
/begin FUNCTION ElTS_EVInfo "1400.4.0  Supplier for general informations for display or LED"
 /begin DEF_CHARACTERISTIC DDRC_DurDeb.ElTS_tiPtSysLimDrvErrDebOk_C DDRC_DurDeb.ElTS_tiPtSysLimDrvErrDebDef_C DDRC_DurDeb.ElTS_tiPtSysLimRgnErrDebOk_C DDRC_DurDeb.ElTS_tiPtSysLimRgnErrDebDef_C DFC_CtlMsk2.DFC_ElTSPtSysLimDrvErr_C DFC_CtlMsk2.DFC_ElTSPtSysLimRgnErr_C DFC_DisblMsk2.DFC_ElTSPtSysLimDrvErr_C DFC_DisblMsk2.DFC_ElTSPtSysLimRgnErr_C EITS_facMeclPwrEIMCns_C EITS_facMeclPwrEIMRcpt_C EITS_maxAbsltDrvPowEm01_T EITS_tiEmPowChrgnFil_C EITS_tiEmPowDchaFil_C ElTS_facPtSysLimDrvThd_C ElTS_facPtSysLimRngThd_C ElTS_facPwrAcsyConv_C ElTS_facPwrEIMConv_C ElTS_facPwrRcptConv_C ElTS_maskComChrgrInAct_C ElTS_maxAbsltRgnPowEm01_T ElTS_maxDrvPowEm01_T ElTS_maxRgnPowEm01_T ElTS_ratSoc_CUR ElTS_swtEgyRst_C ElTS_tiChrgPlg_C /end DEF_CHARACTERISTIC
 /begin IN_MEASUREMENT ChrgMod_pwrChrgnOut ChrgMod_stMod ChrgPlg_stPlg ComChrgr_pwrInAct ComChrgr_pwrInAct_Sq CoPOM_pwrLimdRecup CoPOM_pwrPrpnRed Eem_pwrAuxUnitLoadLo Emac_nAct01 Emac_pwrAct01 Emac_tqAbsltMax01 Emac_tqAbsltMin01 Emac_tqAct01 HvBatt_ratSoc T15_st TrsmEmac_tqLoss01 VehCoorn_st /end IN_MEASUREMENT
 /begin OUT_MEASUREMENT DDRC_St.DFC_ElTSPtSysLimDrvErr DDRC_St.DFC_ElTSPtSysLimRgnErr DFC_st.DFC_ElTSPtSysLimDrvErr DFC_st.DFC_ElTSPtSysLimRgnErr DINH_nrActvInhReas.FID_ElTSPwrChrgnOutErr DINH_nrActvInhReas.FID_ElTSPwrInActErr DINH_nrActvInhReas.FId_ElTSHvIntlck DINH_stFId.FID_ElTSPwrChrgnOutErr DINH_stFId.FID_ElTSPwrInActErr DINH_stFId.FId_ElTSHvIntlck ElTS_egyAcsyCns ElTS_egyElMMotCns ElTS_egyElMRcptCns ElTS_egyTotChrgCyc ElTS_flgHvIntlck ElTS_pwrMeclAct ElTS_pwrSumEmLimd ElTS_pwrTotHvAct ElTS_ratEmPowChrgn ElTS_ratEmPowDcha ElTS_ratSoc ElTS_stChrgCyc /end OUT_MEASUREMENT
 /begin LOC_MEASUREMENT EITS_pwrTotEm ElTS_egyTotChrgCycNVM ElTS_EVInfo_AcsyFltEgy_INST.X1 ElTS_EVInfo_AcsyFltEgy_INST.Y1 ElTS_EVInfo_ElMFltEgy_INST.X1 ElTS_EVInfo_ElMFltEgy_INST.Y1 ElTS_EVInfo_ElMFltRcptEgy_INST.X1 ElTS_EVInfo_ElMFltRcptEgy_INST.Y1 ElTS_EVInfo_TotEgyChrgCyc_INST.X1 ElTS_EVInfo_TotEgyChrgCyc_INST.Y1 ElTS_stChrgCycNVM ElTS_stChrgCycOld /end LOC_MEASUREMENT
 FUNCTION_VERSION "1400.4.0" /end FUNCTION
/begin FUNCTION EmWakeupSig_DELib_ActrCoorrSimple "1.3.0"
 /begin DEF_CHARACTERISTIC EmWakeupSig_stActrDis_C EmWakeupSig_swtConfActrCoorrSimple_C /end DEF_CHARACTERISTIC
 /begin IN_MEASUREMENT DevLib_stPwrStgEnaCond EmWakeupSig_rDesVal EmWakeupSig_stMonActrElecDrvrSimple /end IN_MEASUREMENT
 /begin OUT_MEASUREMENT DINH_nrActvInhReas.FId_EmWakeupSigOff DINH_stFId.FId_EmWakeupSigOff EmWakeupSig_r EmWakeupSig_stMonActrCoorrSimple /end OUT_MEASUREMENT
 /begin LOC_MEASUREMENT EmWakeupSig_swtConfActrCoorrSimpleC /end LOC_MEASUREMENT
 FUNCTION_VERSION "1.3.0" /end FUNCTION
/begin FUNCTION EmWakeupSig_DELib_ActrDevDrvrSimple "1.1.0" /begin IN_MEASUREMENT EmWakeupSig_rActr /end IN_MEASUREMENT /begin OUT_MEASUREMENT EmWakeupSig_rDesVal /end OUT_MEASUREMENT FUNCTION_VERSION "1.1.0" /end FUNCTION
/begin FUNCTION EmWakeupSig_DELib_ActrElecDrvrSimple "1.4.0"
 /begin DEF_CHARACTERISTIC EmWakeupSig_rCnv_CUR EmWakeupSig_stPwrStgDis_C EmWakeupSig_swtConfActrElecDrvrSimple_C /end DEF_CHARACTERISTIC
 /begin IN_MEASUREMENT DevLib_stPwrStgEnaCond EmWakeupSig_rDtyCyc EmWakeupSig_stMonActrCoorrSimple /end IN_MEASUREMENT
 /begin OUT_MEASUREMENT DINH_nrActvInhReas.FId_EmWakeupSigPsOff DINH_stFId.FId_EmWakeupSigPsOff EmWakeupSig_rActr EmWakeupSig_stMonActrElecDrvrSimple /end OUT_MEASUREMENT
 /begin LOC_MEASUREMENT EmWakeupSig_swtConfActrElecDrvrSimpleC /end LOC_MEASUREMENT
 FUNCTION_VERSION "1.4.0" /end FUNCTION
/begin FUNCTION EmWakeupSig_DELib_ActrElecMonSimple "1.4.0"
 /begin DEF_CHARACTERISTIC DDRC_DurDeb.EmWakeupSig_tiMonDFCDebOk_C DDRC_DurDeb.EmWakeupSig_tiMonDFCDebDef_C DDRC_RatDeb.EmWakeupSig_tiMonDFCUDRat_C DFC_CtlMsk2.DFC_EmWakeupSigOL_C DFC_CtlMsk2.DFC_EmWakeupSigOvrTemp_C DFC_CtlMsk2.DFC_EmWakeupSigSCB_C DFC_CtlMsk2.DFC_EmWakeupSigSCG_C DFC_DisblMsk2.DFC_EmWakeupSigOL_C DFC_DisblMsk2.DFC_EmWakeupSigOvrTemp_C DFC_DisblMsk2.DFC_EmWakeupSigSCB_C DFC_DisblMsk2.DFC_EmWakeupSigSCG_C EmWakeupSig_psDiagDigOut.nrTstPls_C EmWakeupSig_psDiagDigOut.tiBtwElecFlt_C EmWakeupSig_psDiagDigOut.tiBtwOTFlt_C EmWakeupSig_stPwrStgDiaDis_C EmWakeupSig_swtConfActrElecMonSimple_C /end DEF_CHARACTERISTIC
 /begin IN_MEASUREMENT DevLib_stPwrStgEnaCond EmWakeupSig_stMonActrCoorrSimple /end IN_MEASUREMENT
 /begin OUT_MEASUREMENT DDRC_St.DFC_EmWakeupSigOL DDRC_St.DFC_EmWakeupSigOvrTemp DDRC_St.DFC_EmWakeupSigSCB DDRC_St.DFC_EmWakeupSigSCG DFC_st.DFC_EmWakeupSigOL DFC_st.DFC_EmWakeupSigOvrTemp DFC_st.DFC_EmWakeupSigSCB DFC_st.DFC_EmWakeupSigSCG DINH_nrActvInhReas.FId_EmWakeupSigMonOff DINH_stFId.FId_EmWakeupSigMonOff /end OUT_MEASUREMENT
 /begin LOC_MEASUREMENT EmWakeupSig_swtConfActrElecMonSimpleC /end LOC_MEASUREMENT
 FUNCTION_VERSION "1.4.0" /end FUNCTION
/begin FUNCTION EmWakeupSig_DELib_ActrHldILimnSimple "1.3.0" FUNCTION_VERSION "1.3.0" /end FUNCTION
/begin FUNCTION EmWakeupSig_DELib_ActrPsDrvrSimple "1.5.0" /begin DEF_CHARACTERISTIC EmWakeupSig_swtConfActrPsDrvrSimple_C /end DEF_CHARACTERISTIC /begin IN_MEASUREMENT EmWakeupSig_stMonActrElecDrvrSimple /end IN_MEASUREMENT /begin OUT_MEASUREMENT EmWakeupSig_rDtyCyc EmWakeupSig_rPs /end OUT_MEASUREMENT /begin LOC_MEASUREMENT EmWakeupSig_swtConfActrPsDrvrSimpleC /end LOC_MEASUREMENT FUNCTION_VERSION "1.5.0" /end FUNCTION
/begin FUNCTION EmWakeupSig_DELib_ActrSnsrSimple "1.4.0" /begin DEF_CHARACTERISTIC EmWakeupSig_tiPt1Mdl_C /end DEF_CHARACTERISTIC /begin IN_MEASUREMENT EmWakeupSig_rDesVal EmWakeupSig_stMonActrElecDrvrSimple /end IN_MEASUREMENT
 /begin OUT_MEASUREMENT DINH_nrActvInhReas.FId_EmWakeupSigSnsr DINH_stFId.FId_EmWakeupSigSnsr EmWakeupSig_rAct EmWakeupSig_rAct_Sq /end OUT_MEASUREMENT
 FUNCTION_VERSION "1.4.0" /end FUNCTION
/begin FUNCTION EmWakeupSig_DELib_SimpleActr "5.8.0" FUNCTION_VERSION "5.8.0" /end FUNCTION
/begin FUNCTION EmWakeupSig_DELib_VrntCodSimple "1.3.0" FUNCTION_VERSION "1.3.0" /end FUNCTION
/begin FUNCTION EnvP_DD "24.12.0   Environment pressure sensor (device driver)"
 /begin DEF_CHARACTERISTIC DDRC_DurDeb.PEnv_tiSigRngChkDebOk_C DDRC_DurDeb.PEnv_tiSigRngChkDebDef_C DFC_CtlMsk2.DFC_PEnvSigRngMax_C DFC_CtlMsk2.DFC_PEnvSigRngMin_C DFC_DisblMsk2.DFC_PEnvSigRngMax_C DFC_DisblMsk2.DFC_PEnvSigRngMin_C PEnv_facCnvnSlopDig_C PEnv_flgDiSnsrPlaus_C PEnv_flgErrStEna_C PEnv_pCnvnOffs_C PEnv_stSensErrVal_C PEnv_tiDebSnsrPlaus_C PEnv_tiDrvDly_C PEnv_tiSnsrBootDly_C /end DEF_CHARACTERISTIC
 /begin IN_MEASUREMENT DSM_TripChgFinshd SyC_ctPostDrvLeave SyC_stSub /end IN_MEASUREMENT
 /begin OUT_MEASUREMENT B_purg_msg DDRC_St.DFC_PEnvSigRngMax DDRC_St.DFC_PEnvSigRngMin DFC_st.DFC_PEnvSigRngMax DFC_st.DFC_PEnvSigRngMin DINH_nrActvInhReas.FId_PEnvSigRngVld DINH_stFId.FId_PEnvSigRngVld PEnv_flgPRawVld PEnv_flgSnsrBootRdy PEnv_flgSnsrPlausInvld PEnv_flgSnsrRst PEnv_pRaw pur_w_msg /end OUT_MEASUREMENT
 /begin LOC_MEASUREMENT PEnv_dataDigSnsr PEnv_DD_ctPostDrvLeave PEnv_flgDsmClrTrig PEnv_flgGetData PEnv_stErrMsgSens /end LOC_MEASUREMENT
 FUNCTION_VERSION "24.12.0" /end FUNCTION
/begin FUNCTION EnvP_VD "26.19.0   Environment pressure sensor (virtual device)"
 /begin DEF_CHARACTERISTIC PEnv_pAirFil_T PEnv_pDft_C PEnv_pDifEnvThrVlvUsMax_C PEnv_pEnvAirmfMdlTolrMax_C PEnv_pEnvAirmfMdlTolrMin_C PEnv_swtCodVd_C PEnv_tiConpEnvMdl_C PEnv_tiDlycfIntkVlvAdjmt_C PEnv_tiPLT_C /end DEF_CHARACTERISTIC
 /begin REF_CHARACTERISTIC PEnv_pPlausThdMax_C PEnv_pPlausThdMin_C /end REF_CHARACTERISTIC
 /begin IN_MEASUREMENT B_fgfmsdh_msg B_msdkhfmg_msg Eep_EnvRamHist Eep_EnvRamInvld fmsdhfs_w_msg ftu_msg mshfmdk_w_msg ofpu_w_msg PEnv_flgCcLdcCmpl PEnv_flgErrSuspcCc PEnv_flgPPlaus PEnv_pRaw PThrVlvUs_pB1 SyC_ctDrvEnter SyC_ctPostDrvLeave SyC_stSub ThrVlv_ratActPosnB1 /end IN_MEASUREMENT
 /begin OUT_MEASUREMENT B_pug_msg DINH_nrActvInhReas.FId_PEnvEnaBndMdl DINH_nrActvInhReas.FId_PEnvMeasVld DINH_stFId.FId_PEnvEnaBndMdl DINH_stFId.FId_PEnvMeasVld EnvP_p fho_msg frhol_w_msg PEnv_dpAirFilThr PEnv_facCorrAlti PEnv_flgBndMdlVirtVld PEnv_flgBndMdlVld PEnv_flgDeadLockPrevn PEnv_flgPLdcVld PEnv_flgPMeasdVld PEnv_flgPVld PEnv_p PEnv_pBndMdlMax PEnv_pBndMdlMin PEnv_pLdc PEnv_pMeas PEnv_stSigP pum_w_msg pu_msg /end OUT_MEASUREMENT
 /begin LOC_MEASUREMENT PEnv_ctDrvEnter PEnv_ctPostDrvLeave PEnv_flgPMdlVld PEnv_flgUseIniAftStrtEnd PEnv_pMdl /end LOC_MEASUREMENT
 FUNCTION_VERSION "26.19.0" /end FUNCTION
/begin FUNCTION EnvP_VDDiag "2.12.0    Plausibility diagnosis of environmental pressure sensor"
 /begin DEF_CHARACTERISTIC DDRC_DurDeb.PEnv_tiVDDiagDebOk_C DDRC_DurDeb.PEnv_tiVDDiagDebDef_C DFC_CtlMsk2.DFC_PEnvCcMax_C DFC_CtlMsk2.DFC_PEnvCcMin_C DFC_CtlMsk2.DFC_PEnvRngChkMax_C DFC_CtlMsk2.DFC_PEnvRngChkMin_C DFC_CtlMsk2.DFC_PEnvSnsrPlaus_C DFC_CtlMsk2.DFC_PUmax_C DFC_DisblMsk2.DFC_PEnvCcMax_C DFC_DisblMsk2.DFC_PEnvCcMin_C DFC_DisblMsk2.DFC_PEnvRngChkMax_C DFC_DisblMsk2.DFC_PEnvRngChkMin_C DFC_DisblMsk2.DFC_PEnvSnsrPlaus_C DFC_DisblMsk2.DFC_PUmax_C PEnv_pDifJmpMax_C PEnv_pDifLdcMax_C PEnv_pMaxSnsrTolr_C PEnv_pPlausThdMax_C PEnv_pPlausThdMin_C PEnv_swtCodDiag_C PEnv_tiCcLT_C PEnv_tiDlyRawVld_C SF_PU /end DEF_CHARACTERISTIC
 /begin REF_CHARACTERISTIC PEnv_tiStrtReplVld_C /end REF_CHARACTERISTIC
 /begin IN_MEASUREMENT CoEng_tiNormal DSM_TripChgFinshd PEnv_flgBndMdlVirtVld PEnv_flgBndMdlVld PEnv_flgDeadLockPrevn PEnv_flgPLdcVld PEnv_flgPRawVld PEnv_flgSnsrPlausInvld PEnv_flgSnsrRst PEnv_pBndMdlMax PEnv_pBndMdlMin PEnv_pLdc PEnv_pRaw SyC_ctPostDrvLeave SyC_stSub /end IN_MEASUREMENT
 /begin OUT_MEASUREMENT B_pugg_msg DDRC_St.DFC_PEnvCcMax DDRC_St.DFC_PEnvCcMin DDRC_St.DFC_PEnvRngChkMax DDRC_St.DFC_PEnvRngChkMin DDRC_St.DFC_PEnvSnsrPlaus DFC_st.DFC_PEnvCcMax DFC_st.DFC_PEnvCcMin DFC_st.DFC_PEnvRngChkMax DFC_st.DFC_PEnvRngChkMin DFC_st.DFC_PEnvSnsrPlaus DFC_st.DFC_PUmax DINH_nrActvInhReas.FId_PEnvCc DINH_nrActvInhReas.FId_PEnvPlaus DINH_nrActvInhReas.FId_PEnvPrc DINH_nrActvInhReas.FId_PEnvSnsrPlaus DINH_stFId.FId_PEnvCc DINH_stFId.FId_PEnvPlaus DINH_stFId.FId_PEnvPrc DINH_stFId.FId_PEnvSnsrPlaus PEnv_flgBndMdlRngVld PEnv_flgCcLdcCmpl PEnv_flgCcMaxInvld PEnv_flgCcMinInvld PEnv_flgCcVld PEnv_flgErrSuspcCc PEnv_flgHealSuspcCc PEnv_flgPPlaus PEnv_flgRngChkMaxInvld PEnv_flgRngChkMaxVld PEnv_flgRngChkMinInvld PEnv_flgRngChkMinVld /end OUT_MEASUREMENT
 /begin LOC_MEASUREMENT PEnv_flgCcLdcDiagCmpl PEnv_flgCcLdcInvld PEnv_flgCcLdcVld PEnv_flgInctRatCmpl PEnv_flgPRawVldDiag PEnv_pCurrDrvCyc PEnv_pDly PEnv_pRawFild PEnv_VDDiag_flgDsmClrTrig /end LOC_MEASUREMENT
 FUNCTION_VERSION "2.12.0" /end FUNCTION
/begin FUNCTION ESC_Stack "30000.15.0Functional component to provide sampling time for both time and angle synchronous rasters" /begin LOC_MEASUREMENT ESC_stStackErr /end LOC_MEASUREMENT FUNCTION_VERSION "30000.15.0" /end FUNCTION
/begin FUNCTION ETC_Std "30000.18.0Engine Test Coordinator" /begin DEF_CHARACTERISTIC Etc_MaxReqTO_C /end DEF_CHARACTERISTIC /begin OUT_MEASUREMENT Etc_ctCurRunTst /end OUT_MEASUREMENT FUNCTION_VERSION "30000.18.0" /end FUNCTION
/begin FUNCTION EVTherm_CoolgDmd "12.4.0    thermal demand from electric vehicle"
 /begin DEF_CHARACTERISTIC EVTherm_dTSpMedTHi_C EVTherm_dTSpMedTLo_C EVTherm_facMTCooltEnv_T EVTherm_ratCtrlMTFanAR_T EVTherm_ratCtrlMTFan_T EVTherm_ratMedTOff_C EVTherm_ratMTClgReplcmt_C /end DEF_CHARACTERISTIC
 /begin IN_MEASUREMENT EnvT_t ThermCoorn_flgMTFanRels ThermCoorn_stCtrl ThermLvl_dTMTCooltSp /end IN_MEASUREMENT
 /begin OUT_MEASUREMENT DINH_nrActvInhReas.FId_EvThermLTClgDmdErr DINH_nrActvInhReas.FId_EvThermMTClgDmdErr DINH_stFId.FId_EvThermLTClgDmdErr DINH_stFId.FId_EvThermMTClgDmdErr EVTherm_ratLTClgDmd EVTherm_ratMTClgDmd /end OUT_MEASUREMENT
 FUNCTION_VERSION "12.4.0" /end FUNCTION
/begin FUNCTION Fan1_DELib_ActrPwrStgDrvr "1.0.0"
 /begin DEF_CHARACTERISTIC Fan1_ActrPwrStgDrvr_Cal.swtConf_C Fan1_ActrPwrStgDrvr_Cal.stMOCSOPChk_C Fan1_ActrPwrStgDrvr_Cal.swtPSDis_C /end DEF_CHARACTERISTIC
 /begin IN_MEASUREMENT DevLib_stPwrStgEnaCond Fan1_rPs Fan1_stElecDiag Fan1_stPs /end IN_MEASUREMENT
 /begin OUT_MEASUREMENT Fan1_flgActrSwtOffReq Fan1_flgElecDiagSwtOffReq Fan1_flgPwrStgReq Fan1_stMonActrPwrStgDrvr Fan1_stPwrStgDrvr Fan1_swtConfActrPwrStgDrvr /end OUT_MEASUREMENT
 /begin LOC_MEASUREMENT Fan1_numSigID Fan1_SigTyp Fan1_stMonGlbElecdd /end LOC_MEASUREMENT
 FUNCTION_VERSION "1.0.0" /end FUNCTION
/begin FUNCTION Fan1_DELib_DevDrvrOutpDutyCycRamp "1.0.0" /begin DEF_CHARACTERISTIC Fan1_DevDrvrOutpDutyCycRampCal.swtConf_C /end DEF_CHARACTERISTIC /begin IN_MEASUREMENT Fan1_rActr /end IN_MEASUREMENT /begin OUT_MEASUREMENT Fan1_rGovActr Fan1_swtConfDevDrvrOutpDutyCycRampC /end OUT_MEASUREMENT FUNCTION_VERSION "1.0.0" /end FUNCTION
/begin FUNCTION Fan1_DELib_StdActrAvs "2.0.0" /begin IN_MEASUREMENT Fan1_swtConfC /end IN_MEASUREMENT FUNCTION_VERSION "2.0.0" /end FUNCTION
/begin FUNCTION Fan1_DELib_StdActrCoorr "8.1.0"
 /begin DEF_CHARACTERISTIC Fan1_rDesActr_CUR Fan1_StdCal.tiDesValFlt_C Fan1_StdCal.rPsOff_C Fan1_StdCal.rActrStop_C Fan1_StdCal.rHysHigh_C Fan1_StdCal.rHysLow_C Fan1_StdCal.stPwrStgDiaDis_C Fan1_StdCal.stPlausDiaDis_C Fan1_StdCal.stPwrStgDis_C Fan1_StdCal.stActrStop_C Fan1_StdCal.stAllPwrStgDiaEna_C Fan1_StdCal.swtDesVal_C Fan1_StdCal.numDiagTry_C Fan1_StdCal.rDesValOff_C Fan1_StdCal.rDesValOn_C Fan1_StdCal.numEngDaFrqPs_C Fan1_StdCal.tiSlwRespSimPT1_C Fan1_StdCal.uHiBattThd_C Fan1_StdCal.uLoBattThd_C Fan1_StdCal.tiDebBattVoltOk_C Fan1_StdCal.tiDebBattVoltDfct_C Fan1_StdCal.mskActrActv_C Fan1_StdCal.tiDlyActrActvn_C Fan1_StdCal.rPsActrOff_C Fan1_StdCal.uBattMin_C Fan1_StdCal.uBattMax_C Fan1_StdCal.tiShOffCtrlDne_C Fan1_StdCal.swtDeactvn_C Fan1_StdCal.tiSelfDiagStrt_C Fan1_StdCal.flgReacvnPostDrv_C Fan1_StdCal.rPsRlyOff_C Fan1_StdCal.tiRlyOnDly_C Fan1_StdCal.nFMInWinMsk_C Fan1_StdCal.tiFMInDeb_C Fan1_StdCal.tiJamActrWait_C /end DEF_CHARACTERISTIC
 /begin IN_MEASUREMENT BattU_u CoEng_st CoEng_stOld DELib_idxArrSnsr DELib_xArrSnsr Epm_nEng Epm_stSpd Fan1_rDesVal Fan1_rPs Fan1_stMon Fan1_swtConf2C Fan1_swtConfC Fan1_swtConfStdActrSwVersC SyC_stSub /end IN_MEASUREMENT
 /begin OUT_MEASUREMENT DINH_nrActvInhReas.FId_Fan1Off DINH_stFId.FId_Fan1Off Fan1_r Fan1_stDesVal Fan1_stMonCo /end OUT_MEASUREMENT
 /begin LOC_MEASUREMENT Fan1_flgMonXPostDrv_mp Fan1_stCoEng Fan1_stDeactvn /end LOC_MEASUREMENT
 FUNCTION_VERSION "8.1.0" /end FUNCTION
/begin FUNCTION Fan1_DELib_StdActrDd "8.2.0" /begin DEF_CHARACTERISTIC Fan1_rCnv_MAP /end DEF_CHARACTERISTIC
 /begin REF_CHARACTERISTIC Fan1_StdCal.tiDesValFlt_C Fan1_StdCal.rPsOff_C Fan1_StdCal.rActrStop_C Fan1_StdCal.rHysHigh_C Fan1_StdCal.rHysLow_C Fan1_StdCal.stPwrStgDiaDis_C Fan1_StdCal.stPlausDiaDis_C Fan1_StdCal.stPwrStgDis_C Fan1_StdCal.stActrStop_C Fan1_StdCal.stAllPwrStgDiaEna_C Fan1_StdCal.swtDesVal_C Fan1_StdCal.numDiagTry_C Fan1_StdCal.rDesValOff_C Fan1_StdCal.rDesValOn_C Fan1_StdCal.numEngDaFrqPs_C Fan1_StdCal.tiSlwRespSimPT1_C Fan1_StdCal.uHiBattThd_C Fan1_StdCal.uLoBattThd_C Fan1_StdCal.tiDebBattVoltOk_C Fan1_StdCal.tiDebBattVoltDfct_C Fan1_StdCal.mskActrActv_C Fan1_StdCal.tiDlyActrActvn_C Fan1_StdCal.rPsActrOff_C Fan1_StdCal.uBattMin_C Fan1_StdCal.uBattMax_C Fan1_StdCal.tiShOffCtrlDne_C Fan1_StdCal.swtDeactvn_C Fan1_StdCal.tiSelfDiagStrt_C Fan1_StdCal.flgReacvnPostDrv_C Fan1_StdCal.rPsRlyOff_C Fan1_StdCal.tiRlyOnDly_C Fan1_StdCal.nFMInWinMsk_C Fan1_StdCal.tiFMInDeb_C Fan1_StdCal.tiJamActrWait_C /end REF_CHARACTERISTIC
 /begin IN_MEASUREMENT BattU_facCor DELib_idxArrSnsr DELib_xArrSnsr DevLib_stPwrStgEnaCond EnvP_p Fan1_flgPwrStgReq Fan1_stMon Fan1_stMonCo Fan1_swtConf2C Fan1_swtConfC Fan1_swtConfStdActrSwVersC /end IN_MEASUREMENT
 /begin OUT_MEASUREMENT DINH_nrActvInhReas.FId_Fan1ActrOff DINH_stFId.FId_Fan1ActrOff Fan1_flgActrReq Fan1_rActr Fan1_rMax Fan1_rMin Fan1_rPs Fan1_stMonDD Fan1_stPs /end OUT_MEASUREMENT
 FUNCTION_VERSION "8.2.0" /end FUNCTION
/begin FUNCTION Fan1_DELib_StdActrDesValCntr "3.0.0" FUNCTION_VERSION "3.0.0" /end FUNCTION
/begin FUNCTION Fan1_DELib_StdActrInin "9.5.0"
 /begin DEF_CHARACTERISTIC Fan1_swtConf2_C Fan1_swtConfStdActrSwVers162_C Fan1_swtConf_C /end DEF_CHARACTERISTIC
 /begin OUT_MEASUREMENT Fan1_swtConf2C Fan1_swtConfC Fan1_swtConfStdActrSwVersC /end OUT_MEASUREMENT
 FUNCTION_VERSION "9.5.0" /end FUNCTION
/begin FUNCTION Fan1_DELib_StdActrSnsrDd "6.4.0" /begin DEF_CHARACTERISTIC Fan1_ratActLin_CUR /end DEF_CHARACTERISTIC
 /begin REF_CHARACTERISTIC Fan1_StdCal.tiDesValFlt_C Fan1_StdCal.rPsOff_C Fan1_StdCal.rActrStop_C Fan1_StdCal.rHysHigh_C Fan1_StdCal.rHysLow_C Fan1_StdCal.stPwrStgDiaDis_C Fan1_StdCal.stPlausDiaDis_C Fan1_StdCal.stPwrStgDis_C Fan1_StdCal.stActrStop_C Fan1_StdCal.stAllPwrStgDiaEna_C Fan1_StdCal.swtDesVal_C Fan1_StdCal.numDiagTry_C Fan1_StdCal.rDesValOff_C Fan1_StdCal.rDesValOn_C Fan1_StdCal.numEngDaFrqPs_C Fan1_StdCal.tiSlwRespSimPT1_C Fan1_StdCal.uHiBattThd_C Fan1_StdCal.uLoBattThd_C Fan1_StdCal.tiDebBattVoltOk_C Fan1_StdCal.tiDebBattVoltDfct_C Fan1_StdCal.mskActrActv_C Fan1_StdCal.tiDlyActrActvn_C Fan1_StdCal.rPsActrOff_C Fan1_StdCal.uBattMin_C Fan1_StdCal.uBattMax_C Fan1_StdCal.tiShOffCtrlDne_C Fan1_StdCal.swtDeactvn_C Fan1_StdCal.tiSelfDiagStrt_C Fan1_StdCal.flgReacvnPostDrv_C Fan1_StdCal.rPsRlyOff_C Fan1_StdCal.tiRlyOnDly_C Fan1_StdCal.nFMInWinMsk_C Fan1_StdCal.tiFMInDeb_C Fan1_StdCal.tiJamActrWait_C Fan1_swtConf2_C Fan1_swtConf_C /end REF_CHARACTERISTIC
 /begin IN_MEASUREMENT Fan1_rDesVal Fan1_stDesVal Fan1_stMon Fan1_swtConf2C Fan1_swtConfC Fan1_swtConfStdActrSwVersC /end IN_MEASUREMENT
 /begin OUT_MEASUREMENT Fan1_rAct Fan1_rAct_Sq Fan1_ratActPosnB1 Fan1_stMonDDSens /end OUT_MEASUREMENT
 FUNCTION_VERSION "6.4.0" /end FUNCTION
/begin FUNCTION Fan1_DELib_StdActrVd "5.0.0" /begin IN_MEASUREMENT Fan1_rGovActr Fan1_swtConfC /end IN_MEASUREMENT /begin OUT_MEASUREMENT Fan1_rDesVal /end OUT_MEASUREMENT FUNCTION_VERSION "5.0.0" /end FUNCTION
/begin FUNCTION Fan1_DELib_StdActrVdMon "9.3.0"
 /begin DEF_CHARACTERISTIC DDRC_DurDeb.Fan1_tiOLDebOk_C DDRC_DurDeb.Fan1_tiOLDebDef_C DDRC_DurDeb.Fan1_tiOvrTempDebOk_C DDRC_DurDeb.Fan1_tiOvrTempDebDef_C DDRC_DurDeb.Fan1_tiSCBDebOk_C DDRC_DurDeb.Fan1_tiSCBDebDef_C DDRC_DurDeb.Fan1_tiSCGDebOk_C DDRC_DurDeb.Fan1_tiSCGDebDef_C DDRC_RatDeb.Fan1_tiOLUDRat_C DDRC_RatDeb.Fan1_tiOvrTempUDRat_C DDRC_RatDeb.Fan1_tiSCBUDRat_C DDRC_RatDeb.Fan1_tiSCGUDRat_C DFC_CtlMsk2.DFC_Fan1OL_C DFC_CtlMsk2.DFC_Fan1OvrTemp_C DFC_CtlMsk2.DFC_Fan1SCB_C DFC_CtlMsk2.DFC_Fan1SCG_C DFC_DisblMsk2.DFC_Fan1OL_C DFC_DisblMsk2.DFC_Fan1OvrTemp_C DFC_DisblMsk2.DFC_Fan1SCB_C DFC_DisblMsk2.DFC_Fan1SCG_C Fan1_numStdActr_C Fan1_psDiagDigOut.nrTstPls_C Fan1_psDiagDigOut.tiBtwElecFlt_C Fan1_psDiagDigOut.tiBtwOTFlt_C Fan1_swtPsDiag_C /end DEF_CHARACTERISTIC
 /begin REF_CHARACTERISTIC Fan1_StdCal.tiDesValFlt_C Fan1_StdCal.rPsOff_C Fan1_StdCal.rActrStop_C Fan1_StdCal.rHysHigh_C Fan1_StdCal.rHysLow_C Fan1_StdCal.stPwrStgDiaDis_C Fan1_StdCal.stPlausDiaDis_C Fan1_StdCal.stPwrStgDis_C Fan1_StdCal.stActrStop_C Fan1_StdCal.stAllPwrStgDiaEna_C Fan1_StdCal.swtDesVal_C Fan1_StdCal.numDiagTry_C Fan1_StdCal.rDesValOff_C Fan1_StdCal.rDesValOn_C Fan1_StdCal.numEngDaFrqPs_C Fan1_StdCal.tiSlwRespSimPT1_C Fan1_StdCal.uHiBattThd_C Fan1_StdCal.uLoBattThd_C Fan1_StdCal.tiDebBattVoltOk_C Fan1_StdCal.tiDebBattVoltDfct_C Fan1_StdCal.mskActrActv_C Fan1_StdCal.tiDlyActrActvn_C Fan1_StdCal.rPsActrOff_C Fan1_StdCal.uBattMin_C Fan1_StdCal.uBattMax_C Fan1_StdCal.tiShOffCtrlDne_C Fan1_StdCal.swtDeactvn_C Fan1_StdCal.tiSelfDiagStrt_C Fan1_StdCal.flgReacvnPostDrv_C Fan1_StdCal.rPsRlyOff_C Fan1_StdCal.tiRlyOnDly_C Fan1_StdCal.nFMInWinMsk_C Fan1_StdCal.tiFMInDeb_C Fan1_StdCal.tiJamActrWait_C /end REF_CHARACTERISTIC
 /begin IN_MEASUREMENT BattU_facCor BattU_u CoEng_st CoEng_tiNormal DELib_idxArrSnsr DELib_xArrSnsr DevLib_stPwrStgEnaCond EnvT_t Fan1_rPs Fan1_stMonCo Fan1_stMonDDSens Fan1_stPs Fan1_stPwrStgDrvr Fan1_swtConf2C Fan1_swtConfC Fan1_swtConfStdActrSwVersC /end IN_MEASUREMENT
 /begin OUT_MEASUREMENT DDRC_St.DFC_Fan1OL DDRC_St.DFC_Fan1OvrTemp DDRC_St.DFC_Fan1SCB DDRC_St.DFC_Fan1SCG DFC_st.DFC_Fan1OL DFC_st.DFC_Fan1OvrTemp DFC_st.DFC_Fan1SCB DFC_st.DFC_Fan1SCG DINH_nrActvInhReas.FId_Fan1Mon DINH_nrActvInhReas.FId_Fan1PwrStg DINH_stFId.FId_Fan1Mon DINH_stFId.FId_Fan1PwrStg Fan1_stElecDiag Fan1_stErrInfo Fan1_stMon Fan1_stPwrStgEnaCond /end OUT_MEASUREMENT
 /begin LOC_MEASUREMENT Fan1_selfDiagPostDrv_mp /end LOC_MEASUREMENT
 FUNCTION_VERSION "9.3.0" /end FUNCTION
/begin FUNCTION FanCtl_Spd "92.2.0    Fan Control"
 /begin DEF_CHARACTERISTIC FanCtl_ratCoolgDes1_T FanCtl_ratCoolgFan1Err_C FanCtl_ratSpdFan1Win1L_C FanCtl_ratSpdFan1Win1R_C FanCtl_ratSpdFan1Win2L_C FanCtl_ratSpdFan1Win2R_C FanCtl_ratSpdFan1Win3L_C FanCtl_ratSpdFan1Win3R_C /end DEF_CHARACTERISTIC
 /begin IN_MEASUREMENT Fan1_r Fans_ratCoolgDes1 /end IN_MEASUREMENT
 /begin OUT_MEASUREMENT DINH_nrActvInhReas.FId_FanCtlFan1Err DINH_stFId.FId_FanCtlFan1Err /end OUT_MEASUREMENT
 /begin LOC_MEASUREMENT FanCtl_Fan1Win1HystLR_I FanCtl_Fan1Win2HystLR_I FanCtl_Fan1Win3HystLR_I FanCtl_ratCoolgDes1 /end LOC_MEASUREMENT
 FUNCTION_VERSION "92.2.0" /end FUNCTION
/begin FUNCTION FanRly1Posn_DELib_SimpleSwt "4.6.0"
 /begin DEF_CHARACTERISTIC FanRly1Posn_SwtGDD_I.flgIvt_C FanRly1Posn_SwtGDD_I.tiDebHiLo_C FanRly1Posn_SwtGDD_I.tiDebLoHi_C /end DEF_CHARACTERISTIC
 /begin OUT_MEASUREMENT FanRly1Posn_st FanRly1Posn_stRaw FanRly1Posn_st_Sq /end OUT_MEASUREMENT
 FUNCTION_VERSION "4.6.0" /end FUNCTION
/begin FUNCTION FanSpd_DELib_GlbAdprOutp "1.1.0" /begin IN_MEASUREMENT FanSpd_nActSens_f FanSpd_nAct_f /end IN_MEASUREMENT /begin OUT_MEASUREMENT FanSpd_nAct FanSpd_nActSens /end OUT_MEASUREMENT FUNCTION_VERSION "1.1.0" /end FUNCTION
/begin FUNCTION FanSpd_DELib_StdSensDd "10.2.0"
 /begin DEF_CHARACTERISTIC DDRC_DurDeb.FanSpd_tiSRCMinDebOk_C DDRC_DurDeb.FanSpd_tiSRCMinDebDef_C DDRC_DurDeb.FanSpd_tiSRCOpnDebOk_C DDRC_DurDeb.FanSpd_tiSRCOpnDebDef_C DDRC_RatDeb.FanSpd_tiSRCMinUDRat_C DDRC_RatDeb.FanSpd_tiSRCOpnUDRat_C DFC_CtlMsk2.DFC_FanSpdSRCMin_C DFC_CtlMsk2.DFC_FanSpdSRCOpn_C DFC_CtlMsk2.DFC_FanSpdSRCMax_C DFC_DisblMsk2.DFC_FanSpdSRCMin_C DFC_DisblMsk2.DFC_FanSpdSRCOpn_C DFC_DisblMsk2.DFC_FanSpdSRCMax_C FanSpd_ADCCal.numSRCTempSel_C FanSpd_ADCCal.tiSRCMaxDebOK_C FanSpd_ADCCal.uSRCMax_C FanSpd_ADCCal.uSRCMin_C FanSpd_ADCCal.uSRCOpn_C FanSpd_ADCSensTransf_f_CUR FanSpd_tiSRCMaxDefDeb_CUR /end DEF_CHARACTERISTIC
 /begin REF_CHARACTERISTIC FanSpd_tiPT1Fil_C FanSpd_TransStg_f.Dfl_r32_C FanSpd_TransStg_f.stSensId_C /end REF_CHARACTERISTIC
 /begin IN_MEASUREMENT DELib_idxArrSnsr DELib_xArrSnsr FanSpd_FirRead.cntr FanSpd_FirRead.flgFirstRun FanSpd_FirRead.idxArr FanSpd_FirRead.uSum FanSpd_stSnsrDdReadCalc FanSpd_swtConfStdSens2C FanSpd_swtConfStdSensC FanSpd_swtConfStdSensSwVersC FanSpd_uRawPT1FltdSens FanSpd_uRawUnFltd /end IN_MEASUREMENT
 /begin OUT_MEASUREMENT DDRC_St.DFC_FanSpdSRCMin DDRC_St.DFC_FanSpdSRCOpn DFC_st.DFC_FanSpdSRCMin DFC_st.DFC_FanSpdSRCOpn DFC_st.DFC_FanSpdSRCMax DINH_nrActvInhReas.FId_FanSpdEnhdSRCMax DINH_nrActvInhReas.FId_FanSpdSSpMon DINH_stFId.FId_FanSpdEnhdSRCMax DINH_stFId.FId_FanSpdSSpMon FanSpd_FirCalc.cntrAvrgZr FanSpd_FirCalc.flgRdDne FanSpd_FirCalc.uRawAvrg FanSpd_FirCalc.uRawFir FanSpd_nActSensCpl FanSpd_nActSensUnFltd FanSpd_nActSens_f FanSpd_stSnsrDdCalc FanSpd_swtSensPres FanSpd_tiSRCMaxDefDeb FanSpd_uRaw FanSpd_uRaw_f /end OUT_MEASUREMENT
 /begin LOC_MEASUREMENT FanSpd_DDstSnsrState_mp FanSpd_tRefSnsr_mp FanSpd_tSensPT1Fltd_mp /end LOC_MEASUREMENT
 FUNCTION_VERSION "10.2.0" /end FUNCTION
/begin FUNCTION FanSpd_DELib_StdSensDdRead "10.4.0" /begin DEF_CHARACTERISTIC FanSpd_tiPT1Fil_C /end DEF_CHARACTERISTIC
 /begin IN_MEASUREMENT FanSpd_FirCalc.cntrAvrgZr FanSpd_FirCalc.flgRdDne FanSpd_FirCalc.uRawAvrg FanSpd_FirCalc.uRawFir FanSpd_swtConfStdSens2C FanSpd_swtConfStdSensC /end IN_MEASUREMENT
 /begin OUT_MEASUREMENT FanSpd_FirRead.cntr FanSpd_FirRead.flgFirstRun FanSpd_FirRead.idxArr FanSpd_FirRead.uSum FanSpd_stSnsrDdReadCalc FanSpd_uRawPT1Fltd FanSpd_uRawPT1FltdSens FanSpd_uRawUnFltd /end OUT_MEASUREMENT
 FUNCTION_VERSION "10.4.0" /end FUNCTION
/begin FUNCTION FanSpd_DELib_StdSensDdSENTSlowRead "3.2.0"
 /begin IN_MEASUREMENT FanSpd_swtConfStdSens2C FanSpd_swtConfStdSensC FanSpd_swtConfStdSensSwVersC /end IN_MEASUREMENT
 FUNCTION_VERSION "3.2.0" /end FUNCTION
/begin COMPU_METHOD boolean "" RAT_FUNC "%6.2" "-" COEFFS 0 1 0 0 0 1 /end COMPU_METHOD
/begin COMPU_METHOD B_TRUE "" TAB_VERB "%6.3" "" COMPU_TAB_REF B_TRUE /end COMPU_METHOD
/begin COMPU_VTAB B_TRUE "" TAB_VERB 2 0 "FALSE" 1 "TRUE" /end COMPU_VTAB
/begin COMPU_METHOD Curr_A_q0p03125_COMPU "" RAT_FUNC "%6.4" "A" COEFFS 0 32 0 0 0 1 /end COMPU_METHOD
/begin COMPU_METHOD DDRCTime_ms "" RAT_FUNC "%6.1" "ms" COEFFS 0 1 0 0 0 10 /end COMPU_METHOD
/begin COMPU_METHOD DDRC_Ratio "" TAB_VERB "%6.3" "-" COMPU_TAB_REF DDRC_Ratio /end COMPU_METHOD
/begin COMPU_VTAB DDRC_Ratio "" TAB_VERB 4 1 "Ratio1" 2 "Ratio2" 3 "Ratio3" 4 "Ratio4" /end COMPU_VTAB
/begin COMPU_METHOD DELIB_ALLTEMP_VERB_COMPU "" TAB_VERB "%6.3" "" COMPU_TAB_REF DELIB_ALLTEMP_VERB_COMPU /end COMPU_METHOD
/begin COMPU_VTAB DELIB_ALLTEMP_VERB_COMPU "" TAB_VERB 6 85 "ACCHRGRINTKT" 86 "DCCHRGRINTKT" 0 "ENVT" 89 "HEATRCORET" 254 "DFLTEMP" 255 "NOTEMP" /end COMPU_VTAB
/begin COMPU_METHOD dez "" RAT_FUNC "%6.2" "" COEFFS 0 1 0 0 0 1 /end COMPU_METHOD
/begin COMPU_METHOD DFC_OneToOne "" RAT_FUNC "%6.2" "-" COEFFS 0 1 0 0 0 1 /end COMPU_METHOD
/begin COMPU_METHOD DFES_OneToOne "" RAT_FUNC "%6.2" "-" COEFFS 0 1 0 0 0 1 /end COMPU_METHOD
/begin COMPU_METHOD dfp_verbal "" TAB_VERB "%6.3" "-" COMPU_TAB_REF dfp_verbal /end COMPU_METHOD
/begin COMPU_VTAB dfp_verbal "" TAB_VERB 6 0 "DFP_AAA" 1 "DFP_PU" 2 "DFP_PUE" 3 "DFP_PUPL" 4 "DFP_PUR" 5 "DFP_ZZZ" DEFAULT_VALUE "---" /end COMPU_VTAB
/begin COMPU_METHOD DINH_ct_Compu "" RAT_FUNC "%6.0" "" COEFFS 0 -1 4096 0 0 1 /end COMPU_METHOD
/begin COMPU_METHOD DrvMod_stPosn_VERB "" TAB_VERB "%6.3" "" COMPU_TAB_REF DrvMod_stPosn_VERB /end COMPU_METHOD
/begin COMPU_VTAB DrvMod_stPosn_VERB "" TAB_VERB 5 0 "DRVMOD_PRK" 1 "DRVMOD_RVS" 2 "DRVMOD_NEUT" 3 "DRVMOD_DRV" 6 "DRVMOD_NOREQ" /end COMPU_VTAB
/begin COMPU_METHOD DtyCyc "" RAT_FUNC "%6.4" "%" COEFFS 0 100 0 0 0 1 /end COMPU_METHOD
/begin COMPU_METHOD Fact "" RAT_FUNC "%6.5" "-" COEFFS 0 8192 0 0 0 1 /end COMPU_METHOD
/begin COMPU_METHOD FactLow "" RAT_FUNC "%6.5" "-" COEFFS 0 1024 0 0 0 1 /end COMPU_METHOD
/begin COMPU_METHOD fak_q0p04 "" RAT_FUNC "%6.4" "" COEFFS 0 25 0 0 0 1 /end COMPU_METHOD
/begin COMPU_METHOD fak_ub_b4 "" RAT_FUNC "%6.4" "-" COEFFS 0 256 0 0 0 4 /end COMPU_METHOD
/begin COMPU_METHOD fak_uw_b1 "" RAT_FUNC "%7.6" "-" COEFFS 0 65536 0 0 0 1 /end COMPU_METHOD
/begin COMPU_METHOD fak_uw_b2 "" RAT_FUNC "%7.6" "-" COEFFS 0 65536 0 0 0 2 /end COMPU_METHOD
/begin COMPU_METHOD fak_uw_b4 "" RAT_FUNC "%7.6" "-" COEFFS 0 65536 0 0 0 4 /end COMPU_METHOD
/begin COMPU_METHOD FlConsum_l_s "" RAT_FUNC "%8.7" "l/s" COEFFS 0 360000 0 0 0 1 /end COMPU_METHOD
/begin COMPU_METHOD FlConsum_ul "" RAT_FUNC "%6.2" "ul" COEFFS 0 1 0 0 0 1 /end COMPU_METHOD
/begin COMPU_METHOD FlConsum_ul_1 "" RAT_FUNC "%6.5" "ul" COEFFS 0 1000 0 0 0 1 /end COMPU_METHOD
/begin COMPU_METHOD FlConsum_ul_High_COMPU "" RAT_FUNC "%6.1" "ul" COEFFS 0 0.05 0 0 0 1 /end COMPU_METHOD
/begin COMPU_METHOD FlCons_lps_q0p0001 "" RAT_FUNC "%7.6" "l/s" COEFFS 0 10000 0 0 0 1 /end COMPU_METHOD
/begin COMPU_METHOD FLEXPSCTRLRNR_SC_Compu "" TAB_VERB "%6.3" "" COMPU_TAB_REF FLEXPSCTRLRNR_SC_Compu /end COMPU_METHOD
/begin COMPU_VTAB FLEXPSCTRLRNR_SC_Compu "" TAB_VERB 2 0 "0" 1 "1" /end COMPU_VTAB
/begin COMPU_METHOD FLFLTDSP_TYPAVL_SC_Compu "" TAB_VERB "%6.3" "" COMPU_TAB_REF FLFLTDSP_TYPAVL_SC_Compu /end COMPU_METHOD
/begin COMPU_VTAB FLFLTDSP_TYPAVL_SC_Compu "" TAB_VERB 2 0 "False" 1 "True" /end COMPU_VTAB
/begin COMPU_METHOD FLOATIFRESLSELN_SC_Compu "" TAB_VERB "%6.3" "" COMPU_TAB_REF FLOATIFRESLSELN_SC_Compu /end COMPU_METHOD
/begin COMPU_VTAB FLOATIFRESLSELN_SC_Compu "" TAB_VERB 2 0 "Integer_calculation" 1 "Floating_point_calculation" /end COMPU_VTAB
/begin COMPU_METHOD FlVolFlw_COMPU "" RAT_FUNC "%6.3" "l/h" COEFFS 0 10 0 0 0 1 /end COMPU_METHOD
/begin COMPU_METHOD FLXR_SY_Compu "" TAB_VERB "%6.3" "" COMPU_TAB_REF FLXR_SY_Compu /end COMPU_METHOD
/begin COMPU_VTAB FLXR_SY_Compu "" TAB_VERB 2 0 "FALSE" 1 "TRUE" /end COMPU_VTAB
/begin COMPU_METHOD Fl_2 "" RAT_FUNC "%6.1" "l" COEFFS 0 0.1 0 0 0 1 /end COMPU_METHOD
/begin COMPU_METHOD Fl_Half_L "" RAT_FUNC "%6.3" "l" COEFFS 0 2 0 0 0 1 /end COMPU_METHOD
/begin COMPU_METHOD Fl_L "" RAT_FUNC "%6.4" "l" COEFFS 0 100 0 0 0 1 /end COMPU_METHOD
/begin COMPU_METHOD Fl_Vol "" RAT_FUNC "%6.5" "l/100km" COEFFS 0 1000 0 0 0 1 /end COMPU_METHOD
/begin COMPU_METHOD Fl_Vol_q0p05 "" RAT_FUNC "%6.4" "l" COEFFS 0 20 0 0 0 1 /end COMPU_METHOD
/begin COMPU_METHOD FREONP_TYPAVL_SC_Compu "" TAB_VERB "%6.3" "" COMPU_TAB_REF FREONP_TYPAVL_SC_Compu /end COMPU_METHOD
/begin COMPU_VTAB FREONP_TYPAVL_SC_Compu "" TAB_VERB 2 0 "False" 1 "True" /end COMPU_VTAB
/begin COMPU_METHOD FRIPCORETYPE_SC_Compu "" TAB_VERB "%6.3" "" COMPU_TAB_REF FRIPCORETYPE_SC_Compu /end COMPU_METHOD
/begin COMPU_VTAB FRIPCORETYPE_SC_Compu "" TAB_VERB 2 0 "0" 1 "1" /end COMPU_VTAB
/begin COMPU_METHOD FRNM_SC_Compu "" TAB_VERB "%6.3" "" COMPU_TAB_REF FRNM_SC_Compu /end COMPU_METHOD
/begin COMPU_VTAB FRNM_SC_Compu "" TAB_VERB 2 0 "False" 1 "True" /end COMPU_VTAB
/begin COMPU_METHOD FrqCylPres "" RAT_FUNC "%6.2" "Hz" COEFFS 0 1 0 0 0 1 /end COMPU_METHOD
/begin COMPU_METHOD FRTP_SC_Compu "" TAB_VERB "%6.3" "" COMPU_TAB_REF FRTP_SC_Compu /end COMPU_METHOD
/begin COMPU_VTAB FRTP_SC_Compu "" TAB_VERB 2 0 "False" 1 "True" /end COMPU_VTAB
/begin COMPU_METHOD FRTSYN_SC_Compu "" TAB_VERB "%6.3" "" COMPU_TAB_REF FRTSYN_SC_Compu /end COMPU_METHOD
/begin COMPU_VTAB FRTSYN_SC_Compu "" TAB_VERB 2 0 "False" 1 "True" /end COMPU_VTAB
/begin COMPU_METHOD FSPDSFLDP_TYPAVL_SC_Compu "" TAB_VERB "%6.3" "" COMPU_TAB_REF FSPDSFLDP_TYPAVL_SC_Compu /end COMPU_METHOD
/begin COMPU_VTAB FSPDSFLDP_TYPAVL_SC_Compu "" TAB_VERB 2 0 "False" 1 "True" /end COMPU_VTAB
/begin COMPU_METHOD FUELP_TYPAVL_SY_Compu "" TAB_VERB "%6.3" "" COMPU_TAB_REF FUELP_TYPAVL_SY_Compu /end COMPU_METHOD
/begin COMPU_VTAB FUELP_TYPAVL_SY_Compu "" TAB_VERB 2 0 "False" 1 "True" /end COMPU_VTAB
/begin COMPU_METHOD FUELT2_TYPAVL_SC_Compu "" TAB_VERB "%6.3" "" COMPU_TAB_REF FUELT2_TYPAVL_SC_Compu /end COMPU_METHOD
/begin COMPU_VTAB FUELT2_TYPAVL_SC_Compu "" TAB_VERB 2 0 "False" 1 "True" /end COMPU_VTAB
/begin COMPU_METHOD FUELT_TYPAVL_SY_Compu "" TAB_VERB "%6.3" "" COMPU_TAB_REF FUELT_TYPAVL_SY_Compu /end COMPU_METHOD
/begin COMPU_VTAB FUELT_TYPAVL_SY_Compu "" TAB_VERB 2 0 "False" 1 "True" /end COMPU_VTAB
/begin COMPU_METHOD GBXOILP_TYPAVL_SY_Compu "" TAB_VERB "%6.3" "" COMPU_TAB_REF GBXOILP_TYPAVL_SY_Compu /end COMPU_METHOD
/begin COMPU_VTAB GBXOILP_TYPAVL_SY_Compu "" TAB_VERB 2 0 "False" 1 "True" /end COMPU_VTAB
/begin COMPU_METHOD GBXOILT_TYPAVL_SY_Compu "" TAB_VERB "%6.3" "" COMPU_TAB_REF GBXOILT_TYPAVL_SY_Compu /end COMPU_METHOD
/begin COMPU_VTAB GBXOILT_TYPAVL_SY_Compu "" TAB_VERB 2 0 "False" 1 "True" /end COMPU_VTAB
/begin COMPU_METHOD GC_Volt "" RAT_FUNC "%6.2" "mV" COEFFS 0 0.2046 0 0 0 1 /end COMPU_METHOD
/begin COMPU_METHOD GDI_SY_Compu "" TAB_VERB "%6.3" "" COMPU_TAB_REF GDI_SY_Compu /end COMPU_METHOD
/begin COMPU_VTAB GDI_SY_Compu "" TAB_VERB 2 0 "GDI_NO" 1 "GDI" /end COMPU_VTAB
/begin COMPU_METHOD GLBDALSUMAVS_SY_Compu "" TAB_VERB "%6.3" "" COMPU_TAB_REF GLBDALSUMAVS_SY_Compu /end COMPU_METHOD
/begin COMPU_VTAB GLBDALSUMAVS_SY_Compu "" TAB_VERB 2 0 "False" 1 "True" /end COMPU_VTAB
/begin COMPU_METHOD GLBDA_ACTRACTVN_SC_Compu "" TAB_VERB "%6.3" "" COMPU_TAB_REF GLBDA_ACTRACTVN_SC_Compu /end COMPU_METHOD
/begin COMPU_VTAB GLBDA_ACTRACTVN_SC_Compu "" TAB_VERB 2 0 "Disable_Actuator_Activation" 1 "Enable_Actuator_Activation" /end COMPU_VTAB
/begin COMPU_METHOD GLBDA_LSUMMODE_SC_Compu "" TAB_VERB "%6.3" "" COMPU_TAB_REF GLBDA_LSUMMODE_SC_Compu /end COMPU_METHOD
/begin COMPU_VTAB GLBDA_LSUMMODE_SC_Compu "" TAB_VERB 3 0 "0" 1 "1" 2 "2" /end COMPU_VTAB
/begin COMPU_METHOD GrpDlyTime "" RAT_FUNC "%6.3" "usec" COEFFS 0 10 0 0 0 1 /end COMPU_METHOD
/begin COMPU_METHOD GSSYS_TYPEEXHFLW_SY_Compu "" TAB_VERB "%6.3" "" COMPU_TAB_REF GSSYS_TYPEEXHFLW_SY_Compu /end COMPU_METHOD
/begin COMPU_VTAB GSSYS_TYPEEXHFLW_SY_Compu "" TAB_VERB 2 1 "HESRV_SNGLFLW" 2 "HESRV_TWFLW" /end COMPU_VTAB
/begin COMPU_METHOD GSSYS_TYPPCR_SY_Compu "" TAB_VERB "%6.3" "" COMPU_TAB_REF GSSYS_TYPPCR_SY_Compu /end COMPU_METHOD
/begin COMPU_VTAB GSSYS_TYPPCR_SY_Compu "" TAB_VERB 2 1 "HESRV_SNGLFLW" 2 "HESRV_TWFLW" /end COMPU_VTAB
/begin COMPU_METHOD HCMassPerTime "" RAT_FUNC "%6.3" "mg/s" COEFFS 0 10 0 0 0 1 /end COMPU_METHOD
/begin COMPU_METHOD HCMassPerTime_q0p0000004 "" RAT_FUNC "%9.8" "kg/s" COEFFS 0 2500000 0 0 0 1 /end COMPU_METHOD
/begin COMPU_METHOD HCMassPerTime_q0p4 "" RAT_FUNC "%6.3" "mg/s" COEFFS 0 2.5 0 0 0 1 /end COMPU_METHOD
/begin COMPU_METHOD HCMassPerTime_q0p8 "" RAT_FUNC "%6.2" "mg/s" COEFFS 0 1.25 0 0 0 1 /end COMPU_METHOD
/begin COMPU_METHOD HCMass_q0p005 "" RAT_FUNC "%6.4" "g" COEFFS 0 200 0 0 0 1 /end COMPU_METHOD
/begin COMPU_METHOD HeatCapacity "" RAT_FUNC "%6.3" "J/K" COEFFS 0 10 0 0 0 1 /end COMPU_METHOD
/begin COMPU_METHOD HEATRCORET_TYPAVL_SC_Compu "" TAB_VERB "%6.3" "" COMPU_TAB_REF HEATRCORET_TYPAVL_SC_Compu /end COMPU_METHOD
/begin COMPU_VTAB HEATRCORET_TYPAVL_SC_Compu "" TAB_VERB 2 0 "False" 1 "True" /end COMPU_VTAB
/begin COMPU_METHOD HEATRRLY1_TYPAVL_SC_Compu "" TAB_VERB "%6.3" "" COMPU_TAB_REF HEATRRLY1_TYPAVL_SC_Compu /end COMPU_METHOD
/begin COMPU_VTAB HEATRRLY1_TYPAVL_SC_Compu "" TAB_VERB 2 0 "False" 1 "True" /end COMPU_VTAB
/begin COMPU_METHOD HEM_SY_Compu "" TAB_VERB "%6.3" "" COMPU_TAB_REF HEM_SY_Compu /end COMPU_METHOD
/begin COMPU_VTAB HEM_SY_Compu "" TAB_VERB 3 0 "NO_HEM" 1 "HEM_CYL" 2 "HEM_BNK" /end COMPU_VTAB
/begin COMPU_METHOD HESRV_HETYP_SY_Compu "" TAB_VERB "%6.3" "" COMPU_TAB_REF HESRV_HETYP_SY_Compu /end COMPU_METHOD
/begin COMPU_VTAB HESRV_HETYP_SY_Compu "" TAB_VERB 4 1 "HESRV_MASTERSLAVE" 2 "HESRV_VCU" 3 "HESRV_HCU" 255 "HESRV_ONEBOX" /end COMPU_VTAB
/begin COMPU_METHOD HEVPLINAVL_SC_Compu "" TAB_VERB "%6.3" "" COMPU_TAB_REF HEVPLINAVL_SC_Compu /end COMPU_METHOD
/begin COMPU_VTAB HEVPLINAVL_SC_Compu "" TAB_VERB 2 0 "False" 1 "True" /end COMPU_VTAB
/begin COMPU_METHOD HEVTYP_SY_Compu "" TAB_VERB "%6.3" "" COMPU_TAB_REF HEVTYP_SY_Compu /end COMPU_METHOD
/begin COMPU_VTAB HEVTYP_SY_Compu "" TAB_VERB 8 0 "0" 1 "HEVTYP_SER" 2 "HEVTYP_SERPARL" 3 "HEVTYP_PWRSPLT" 4 "HEVTYP_PARL" 5 "HEVTYP_EAD" 6 "HEVTYP_EDCT" 7 "HEVTYP_PARLSER" /end COMPU_VTAB
/begin COMPU_METHOD HOODSWTIFTYP_SC_Compu "" TAB_VERB "%6.3" "" COMPU_TAB_REF HOODSWTIFTYP_SC_Compu /end COMPU_METHOD
/begin COMPU_VTAB HOODSWTIFTYP_SC_Compu "" TAB_VERB 7 0 "HOODSWTIFTYP_NON" 1 "HOODSWTIFTYP_DIG" 2 "HOODSWTIFTYP_ADC" 3 "HOODSWTIFTYP_MISC" 4 "HOODSWTIFTYP_BUS" 5 "HOODSWTIFTYP_BUS_DIG" 6 "HOODSWTIFTYP_BUS_ADC" /end COMPU_VTAB
/begin COMPU_METHOD hPa_to_bar_COMPU "" RAT_FUNC "%7.0" "-" COEFFS 0 0.001 0 0 0 1 /end COMPU_METHOD
/begin COMPU_METHOD HPDIFF_TYPAVL_SC_Compu "" TAB_VERB "%6.3" "" COMPU_TAB_REF HPDIFF_TYPAVL_SC_Compu /end COMPU_METHOD
/begin COMPU_VTAB HPDIFF_TYPAVL_SC_Compu "" TAB_VERB 2 0 "False" 1 "True" /end COMPU_VTAB
/begin COMPU_METHOD HPIN_TYPAVL_SC_Compu "" TAB_VERB "%6.3" "" COMPU_TAB_REF HPIN_TYPAVL_SC_Compu /end COMPU_METHOD
/begin COMPU_VTAB HPIN_TYPAVL_SC_Compu "" TAB_VERB 2 0 "False" 1 "True" /end COMPU_VTAB
/begin COMPU_METHOD HPOUTPRR_TYPAVL_SY_Compu "" TAB_VERB "%6.3" "" COMPU_TAB_REF HPOUTPRR_TYPAVL_SY_Compu /end COMPU_METHOD
/begin COMPU_VTAB HPOUTPRR_TYPAVL_SY_Compu "" TAB_VERB 2 0 "False" 1 "True" /end COMPU_VTAB
/begin COMPU_METHOD HTANKP_TYPAVL_SY_Compu "" TAB_VERB "%6.3" "" COMPU_TAB_REF HTANKP_TYPAVL_SY_Compu /end COMPU_METHOD
/begin COMPU_VTAB HTANKP_TYPAVL_SY_Compu "" TAB_VERB 2 0 "False" 1 "True" /end COMPU_VTAB
/begin COMPU_METHOD HTANKT_TYPAVL_SY_Compu "" TAB_VERB "%6.3" "" COMPU_TAB_REF HTANKT_TYPAVL_SY_Compu /end COMPU_METHOD
/begin COMPU_VTAB HTANKT_TYPAVL_SY_Compu "" TAB_VERB 2 0 "False" 1 "True" /end COMPU_VTAB
/begin COMPU_METHOD HTIN_TYPAVL_SC_Compu "" TAB_VERB "%6.3" "" COMPU_TAB_REF HTIN_TYPAVL_SC_Compu /end COMPU_METHOD
/begin COMPU_VTAB HTIN_TYPAVL_SC_Compu "" TAB_VERB 2 0 "False" 1 "True" /end COMPU_VTAB
/begin COMPU_METHOD HTOUT_TYPAVL_SC_Compu "" TAB_VERB "%6.3" "" COMPU_TAB_REF HTOUT_TYPAVL_SC_Compu /end COMPU_METHOD
/begin COMPU_VTAB HTOUT_TYPAVL_SC_Compu "" TAB_VERB 2 0 "False" 1 "True" /end COMPU_VTAB
/begin COMPU_METHOD HVACHEATPMPP_TYPAVL_SC_Compu "" TAB_VERB "%6.3" "" COMPU_TAB_REF HVACHEATPMPP_TYPAVL_SC_Compu /end COMPU_METHOD
/begin COMPU_VTAB HVACHEATPMPP_TYPAVL_SC_Compu "" TAB_VERB 2 0 "False" 1 "True" /end COMPU_VTAB
/begin COMPU_METHOD HVACHEATPMPT_TYPAVL_SC_Compu "" TAB_VERB "%6.3" "" COMPU_TAB_REF HVACHEATPMPT_TYPAVL_SC_Compu /end COMPU_METHOD
/begin COMPU_VTAB HVACHEATPMPT_TYPAVL_SC_Compu "" TAB_VERB 2 0 "False" 1 "True" /end COMPU_VTAB
/begin COMPU_METHOD HVACSPT_TYPAVL_SC_Compu "" TAB_VERB "%6.3" "" COMPU_TAB_REF HVACSPT_TYPAVL_SC_Compu /end COMPU_METHOD
/begin COMPU_VTAB HVACSPT_TYPAVL_SC_Compu "" TAB_VERB 2 0 "False" 1 "True" /end COMPU_VTAB
/begin COMPU_METHOD HVINTLCKOUT1_TYPAVL_SC_Compu "" TAB_VERB "%6.3" "" COMPU_TAB_REF HVINTLCKOUT1_TYPAVL_SC_Compu /end COMPU_METHOD
/begin COMPU_VTAB HVINTLCKOUT1_TYPAVL_SC_Compu "" TAB_VERB 2 0 "False" 1 "True" /end COMPU_VTAB
/begin COMPU_METHOD leist_q16_W "" RAT_FUNC "%6.1" "W" COEFFS 0 1 0 0 0 16 /end COMPU_METHOD
/begin COMPU_METHOD m_uw_b6553p5 "" RAT_FUNC "%6.3" "kg/h" COEFFS 0 1 0 0 0 0.1 /end COMPU_METHOD
/begin COMPU_METHOD nmot_q1 "" RAT_FUNC "%6.2" "1/min" COEFFS 0 1 0 0 0 1 /end COMPU_METHOD
/begin COMPU_METHOD OneToOne "" RAT_FUNC "%6.2" "-" COEFFS 0 1 0 0 0 1 /end COMPU_METHOD
/begin COMPU_METHOD Prc "" RAT_FUNC "%6.4" "%" COEFFS 0 81.92 0 0 0 1 /end COMPU_METHOD
/begin COMPU_METHOD Pres_hPa "" RAT_FUNC "%6.2" "hPa" COEFFS 0 1 0 0 0 1 /end COMPU_METHOD
/begin COMPU_METHOD p_q0p039 "" RAT_FUNC "%6.4" "hPa" COEFFS 0 256 0 0 0 10 /end COMPU_METHOD
/begin COMPU_METHOD p_q0p078 "" RAT_FUNC "%6.4" "hPa" COEFFS 0 64 0 0 0 5 /end COMPU_METHOD
/begin COMPU_METHOD p_ub_q5 "" RAT_FUNC "%6.2" "hPa" COEFFS 0 1 0 0 0 5 /end COMPU_METHOD
/begin COMPU_METHOD q1_kOhm "" RAT_FUNC "%6.2" "kOhm" COEFFS 0 1 0 0 0 1 /end COMPU_METHOD
/begin COMPU_METHOD q4_W_h "" RAT_FUNC "%6.2" "W*h" COEFFS 0 1 0 0 0 4 /end COMPU_METHOD
/begin COMPU_METHOD RBPtCel_dtq_1p0_1 "" RAT_FUNC "%6.2" "Nm/s" COEFFS 0 1 0 0 0 1 /end COMPU_METHOD
/begin COMPU_METHOD RBPtCel_fac_0p1_1 "" RAT_FUNC "%6.3" "-" COEFFS 0 10 0 0 0 1 /end COMPU_METHOD
/begin COMPU_METHOD RBPtCel_i_0p03125_1 "" RAT_FUNC "%6.4" "A" COEFFS 0 32 0 0 0 1 /end COMPU_METHOD
/begin COMPU_METHOD RBPtCel_n_1p0_1 "" RAT_FUNC "%6.2" "rpm" COEFFS 0 1 0 0 0 1 /end COMPU_METHOD
/begin COMPU_METHOD RBPtCel_Perc_1p0_1 "" RAT_FUNC "%6.2" "%" COEFFS 0 1 0 0 0 1 /end COMPU_METHOD
/begin COMPU_METHOD RBPtCel_pwr_25p0_1 "" RAT_FUNC "%6.1" "W" COEFFS 0 1 0 0 0 25 /end COMPU_METHOD
/begin COMPU_METHOD RBPtCel_ti_10p0_1 "" RAT_FUNC "%6.1" "ms" COEFFS 0 1 0 0 0 10 /end COMPU_METHOD
/begin COMPU_METHOD RBPtCel_ti_5p12em4_1 "" RAT_FUNC "%6.5" "s" COEFFS 0 15625 0 0 0 8 /end COMPU_METHOD
/begin COMPU_METHOD RBPtCel_t_0p1_1 "" RAT_FUNC "%6.3" "K" COEFFS 0 10 0 0 0 1 /end COMPU_METHOD
/begin COMPU_METHOD RBPtCel_u_1p0_2 "" RAT_FUNC "%6.2" "mV" COEFFS 0 1 0 0 0 1 /end COMPU_METHOD
/begin COMPU_METHOD RBPtElTrac_stEmOperMod_VERB "" TAB_VERB "%6.3" "" COMPU_TAB_REF RBPtElTrac_stEmOperMod_VERB /end COMPU_METHOD
/begin COMPU_VTAB RBPtElTrac_stEmOperMod_VERB "" TAB_VERB 19 0 "INI" 1 "PRERUN" 2 "STANDBY" 3 "ENG_STRT" 4 "TORQUE_CTRL" 5 "SPEED_CTRL" 6 "OFFSET_CALIB" 7 "U_CTRL" 8 "I_CTRL" 9 "IDLE_CTRL" 10 "ISO_MON" 15 "HILLHOLD" 20 "FREEWHL" 21 "ACTV_SC" 27 "DISCHARGE" 28 "SHUTDOWN" 29 "OFF" 30 "EMGY_SHTDWN" 31 "FAILURE" /end COMPU_VTAB
/begin COMPU_METHOD rel_q0p0078125 "" RAT_FUNC "%6.4" "%" COEFFS 0 128 0 0 0 1 /end COMPU_METHOD
/begin COMPU_METHOD SigQly_COMPU_VERB "" TAB_VERB "%6.3" "" COMPU_TAB_REF SigQly_COMPU_VERB /end COMPU_METHOD
/begin COMPU_VTAB SigQly_COMPU_VERB "" TAB_VERB 16 0 "SIGQLY_NOTCALC" 1 "SIGQLY_INIT" 2 "SIGQLY_OK" 3 "SIGQLY_MODEL" 4 "SIGQLY_REPLACEMENT" 5 "SIGQLY_FROZEN" 6 "SIGQLY_INVALID" 7 "SIGQLY_RESERVED_7" 8 "SIGQLY_RESERVED_8" 9 "SIGQLY_RESERVED_9" 10 "SIGQLY_RESERVED_10" 11 "SIGQLY_RESERVED_11" 12 "SIGQLY_RESERVED_12" 13 "SIGQLY_RESERVED_13" 14 "SIGQLY_RESERVED_14" 15 "SIGQLY_RESERVED_15" /end COMPU_VTAB
/begin COMPU_METHOD Temp_Cels "" RAT_FUNC "%6.1" "deg C" COEFFS 0 10 2731.4 0 0 1 /end COMPU_METHOD
/begin COMPU_METHOD TimeDelay_s "" RAT_FUNC "%6.1" "s" COEFFS 0 0 1 0 0.00023283064365387 0 /end COMPU_METHOD
/begin COMPU_METHOD Time_1s "" RAT_FUNC "%6.2" "s" COEFFS 0 1 0 0 0 1 /end COMPU_METHOD
/begin COMPU_METHOD Time_Dt "" RAT_FUNC "%9.8" "s" COEFFS 0 1000000 0 0 0 1 /end COMPU_METHOD
/begin COMPU_METHOD Time_ms "" RAT_FUNC "%6.1" "ms" COEFFS 0 0.1 0 0 0 1 /end COMPU_METHOD
/begin COMPU_METHOD Time_s "" RAT_FUNC "%6.4" "s" COEFFS 0 100 0 0 0 1 /end COMPU_METHOD
/begin COMPU_METHOD TiSec_q0p1_COMPU "" RAT_FUNC "%6.3" "s" COEFFS 0 10 0 0 0 1 /end COMPU_METHOD
/begin COMPU_METHOD Trq "" RAT_FUNC "%6.3" "Nm" COEFFS 0 10 0 0 0 1 /end COMPU_METHOD
/begin COMPU_METHOD TurboN "" RAT_FUNC "%6.1" "rpm" COEFFS 0 0.1 0 0 0 1 /end COMPU_METHOD
/begin COMPU_METHOD t_q0p1 "" RAT_FUNC "%6.3" "s" COEFFS 0 10 0 0 0 1 /end COMPU_METHOD
/begin COMPU_METHOD Volt "" RAT_FUNC "%6.3" "mV" COEFFS 0 5 0 0 0 1 /end COMPU_METHOD
/begin COMPU_METHOD Volt_Batt "" RAT_FUNC "%6.1" "mV" COEFFS 0 0.05 0 0 0 1 /end COMPU_METHOD
/begin COMPU_METHOD Volt_V_q0p03125_COMPU "" RAT_FUNC "%6.4" "V" COEFFS 0 32 0 0 0 1 /end COMPU_METHOD
/begin RECORD_LAYOUT Kw_Ws16 FNC_VALUES 1 SWORD COLUMN_DIR DIRECT /end RECORD_LAYOUT
/begin RECORD_LAYOUT Kw_Wu32 FNC_VALUES 1 ULONG COLUMN_DIR DIRECT /end RECORD_LAYOUT
/begin RECORD_LAYOUT RB_Curve_R32_R32_sao NO_AXIS_PTS_X 1 ULONG AXIS_PTS_X 2 FLOAT32_IEEE INDEX_INCR DIRECT FNC_VALUES 3 FLOAT32_IEEE COLUMN_DIR DIRECT STATIC_ADDRESS_OFFSETS /end RECORD_LAYOUT
/begin RECORD_LAYOUT RB_Curve_S16_S16 NO_AXIS_PTS_X 1 SWORD AXIS_PTS_X 2 SWORD INDEX_INCR DIRECT FNC_VALUES 3 SWORD COLUMN_DIR DIRECT /end RECORD_LAYOUT
/begin RECORD_LAYOUT RB_Curve_S16_S32_sao NO_AXIS_PTS_X 1 SWORD AXIS_PTS_X 2 SWORD INDEX_INCR DIRECT FNC_VALUES 3 SLONG COLUMN_DIR DIRECT STATIC_ADDRESS_OFFSETS /end RECORD_LAYOUT
/begin RECORD_LAYOUT RB_Curve_S16_S8_sao NO_AXIS_PTS_X 1 SWORD AXIS_PTS_X 2 SWORD INDEX_INCR DIRECT FNC_VALUES 3 SBYTE COLUMN_DIR DIRECT STATIC_ADDRESS_OFFSETS /end RECORD_LAYOUT
/begin RECORD_LAYOUT RB_Curve_U8_U8 NO_AXIS_PTS_X 1 UBYTE AXIS_PTS_X 2 UBYTE INDEX_INCR DIRECT FNC_VALUES 3 UBYTE COLUMN_DIR DIRECT /end RECORD_LAYOUT
/begin RECORD_LAYOUT RB_Map_S16S16_S16 NO_AXIS_PTS_X 1 SWORD NO_AXIS_PTS_Y 2 SWORD AXIS_PTS_X 3 SWORD INDEX_INCR DIRECT AXIS_PTS_Y 4 SWORD INDEX_INCR DIRECT FNC_VALUES 5 SWORD COLUMN_DIR DIRECT /end RECORD_LAYOUT
/begin RECORD_LAYOUT RB_ValA_Wu16 FNC_VALUES 1 UWORD COLUMN_DIR DIRECT /end RECORD_LAYOUT
/begin RECORD_LAYOUT RB_Val_Wboolean FNC_VALUES 1 UBYTE COLUMN_DIR DIRECT /end RECORD_LAYOUT
/begin RECORD_LAYOUT RB_Val_Ws16 FNC_VALUES 1 SWORD COLUMN_DIR DIRECT /end RECORD_LAYOUT
/begin RECORD_LAYOUT RB_Val_Ws32 FNC_VALUES 1 SLONG COLUMN_DIR DIRECT /end RECORD_LAYOUT
/begin RECORD_LAYOUT RB_Val_Ws8 FNC_VALUES 1 SBYTE COLUMN_DIR DIRECT /end RECORD_LAYOUT
/begin RECORD_LAYOUT RB_Val_Wu16 FNC_VALUES 1 UWORD COLUMN_DIR DIRECT /end RECORD_LAYOUT
/begin RECORD_LAYOUT RB_Val_Wu32 FNC_VALUES 1 ULONG COLUMN_DIR DIRECT /end RECORD_LAYOUT
/begin RECORD_LAYOUT RB_Val_Wu8 FNC_VALUES 1 UBYTE COLUMN_DIR DIRECT /end RECORD_LAYOUT
/begin RECORD_LAYOUT Val_Ws16 FNC_VALUES 1 SWORD COLUMN_DIR DIRECT /end RECORD_LAYOUT
/begin RECORD_LAYOUT Val_Ws32 FNC_VALUES 1 SLONG COLUMN_DIR DIRECT /end RECORD_LAYOUT
/begin RECORD_LAYOUT Val_Wu16 FNC_VALUES 1 UWORD COLUMN_DIR DIRECT /end RECORD_LAYOUT
/begin RECORD_LAYOUT Val_Wu32 FNC_VALUES 1 ULONG COLUMN_DIR DIRECT /end RECORD_LAYOUT
/begin RECORD_LAYOUT Val_Wu8 FNC_VALUES 1 UBYTE COLUMN_DIR DIRECT /end RECORD_LAYOUT
/end MODULE
/end PROJECT

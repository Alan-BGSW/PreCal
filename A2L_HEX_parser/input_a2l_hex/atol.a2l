ASAP2_VERSION 1 70
/begin PROJECT MDG1C "VC1CP091_STLA_N_D061I3"
/begin HEADER "" VERSION "VC1CP091_STLA_N_D061I3" PROJECT_NO MDG1C /end HEADER
/begin MODULE DIM ""
/begin MOD_COMMON "" BYTE_ORDER MSB_LAST ALIGNMENT_BYTE 1 ALIGNMENT_WORD 2 ALIGNMENT_LONG 4 ALIGNMENT_INT64 4 ALIGNMENT_FLOAT32_IEEE 4 ALIGNMENT_FLOAT64_IEEE 4 DATA_SIZE 32 /end MOD_COMMON
/begin CHARACTERISTIC CoPOM_fac60Div2PI_C "fixed calibration value =9.549 to convert power(in W) to trque" VALUE 0x8024FEE4 RB_Val_Ws32 21474.8364700 Fact_100000 0.00 21474.8364700 FORMAT "%13.7" EXTENDED_LIMITS -21474.8364800 21474.8364700 /end CHARACTERISTIC
/begin CHARACTERISTIC CoPOM_flgPrimFltDetnRampInitEna_C "Switch to initialize ramp old torque value when fault is detected in primary axle. This feature can be used to initialize ramp states to the older final torque limits value before the error was reported." VALUE 0x8024FF08 RB_Val_Wboolean 1.00000000000 B_TRUE 0.00 1.00000000000 FORMAT "%13.11" /end CHARACTERISTIC
/begin CHARACTERISTIC CoPOM_maskNActPhy01VldSq_C "Bitmask to detect valid signal quality at Emac_nActPhy01_Sq" VALUE 0x8024FF0A RB_Val_Wu16 65535.00 OneToOne 0.00 65535.00 FORMAT "%8.2" /end CHARACTERISTIC
/begin CHARACTERISTIC CoPOM_maskVehVVldSq_C "Bitmask to detect valid signal quality at VehV_v_Sq" VALUE 0x8024FF0C RB_Val_Wu16 65535.00 OneToOne 0.00 65535.00 FORMAT "%8.2" /end CHARACTERISTIC
/begin CHARACTERISTIC CoPOM_nMinPwrTqCnvn_C "Minimim calibration threshold above which actual E-motor speed is considered for Power to torque conversion." VALUE 0x8024FEE8 RB_Val_Ws16 65535.00 nmot_q1 -32768.00 32767.00 FORMAT "%8.2" /end CHARACTERISTIC
/begin CHARACTERISTIC CoPOM_nNom_C "Maximum allowed Electric machine speed to calculate the available electric power on the powertrain" VALUE 0x8024FED8 RB_Val_Ws16 65535.00 nmot_q1 -32768.00 32767.00 FORMAT "%8.2" /end CHARACTERISTIC
/begin CHARACTERISTIC CoPOM_nRvsDir_C "Minimum Speed below which Quasi stationary charge torque limit are inverted and provided to Quasi stationary discharge torque limit in case of rolling back of vehicle." VALUE 0x8024FEEA RB_Val_Ws16 65535.00 nmot_q1 -32768.00 32767.00 FORMAT "%8.2" /end CHARACTERISTIC
/begin CHARACTERISTIC CoPOM_pwrNoRecupHi_C "Upper hysteresis threshold for permissible recuperation power above which no recuperation warning will be sent to the display unit" VALUE 0x8024FEDA RB_Val_Ws16 1048560. leist_q16_W -524288.0 524272.0 FORMAT "%8.1" /end CHARACTERISTIC
/begin CHARACTERISTIC CoPOM_pwrNoRecupLo_C "Lower hysteresis threshold for permissible recuperation power below which no recuperation warning will not be sent to the display unit" VALUE 0x8024FEDC RB_Val_Ws16 1048560. leist_q16_W -524288.0 524272.0 FORMAT "%8.1" /end CHARACTERISTIC
/begin CHARACTERISTIC CoPOM_pwrPrpnRedHi_C "Upper hysteresis threshold for Electric power available on the power train above which reduced power warning will not be send to the display unit" VALUE 0x8024FEDE RB_Val_Ws16 1048560. leist_q16_W -524288.0 524272.0 FORMAT "%8.1" /end CHARACTERISTIC
/begin CHARACTERISTIC CoPOM_pwrPrpnRedLo_C "Lower hysteresis threshold for Electric power available on the power train below which reduced power warning will be send to the display unit" VALUE 0x8024FEE0 RB_Val_Ws16 1048560. leist_q16_W -524288.0 524272.0 FORMAT "%8.1" /end CHARACTERISTIC
/begin CHARACTERISTIC CoPOM_swtPrimErrHndlgInactv_C "Switch to disable fault handling on the e-motor limits for the primary axle." VALUE 0x8024FF0E RB_Val_Wboolean 1.00000000000 B_TRUE 0.00 1.00000000000 FORMAT "%13.11" /end CHARACTERISTIC
/begin CHARACTERISTIC CoPOM_tqMaxBattPwrBasdLim_T "Application parameter for Quasi stationary discharge torque limit based on long-term maximum HV power limit" CURVE 0x8024FEEC RB_Curve_S16_S16 6553.500 Trq -3276.800 3276.700 FORMAT "%8.3"
 /begin AXIS_DESCR STD_AXIS HVGrid_pwrMaxMotTiLong RBPtCel_pwr_25p0_1 6 -819200.0 819175.0 FORMAT "%8.1" DEPOSIT ABSOLUTE /end AXIS_DESCR
/end CHARACTERISTIC
/begin CHARACTERISTIC CoPOM_tqMinRgnInhbnNegSlop_C "Negative ramp slope for the minimum torque of the E Motors in case of the inhibition of the recuperation torque" VALUE 0x8024FF10 RB_Val_Ws32 6553599.99847 RmpTrq -3276800.00000 3276799.99847 FORMAT "%13.5" /end CHARACTERISTIC
/begin CHARACTERISTIC CoPOM_tqMinRgnInhbnPosSlop_C "positive ramp slope for the minimum torque of the E Motors in case of the inhibition of the recuperation torque" VALUE 0x8024FF14 RB_Val_Ws32 6553599.99847 RmpTrq -3276800.00000 3276799.99847 FORMAT "%13.5" /end CHARACTERISTIC
/begin CHARACTERISTIC CoPOM_tqPrimMaxErrNegSlop_C "Ramp Down slope for limiting torque of the Maximum torque limit of the E motor on the primary axle when the system errors are detected(e.g., Fault from Monitoring L2)" VALUE 0x8024FF18 RB_Val_Ws32 6553599.99847 RmpTrq -3276800.00000 3276799.99847 FORMAT "%13.5" /end CHARACTERISTIC
/begin CHARACTERISTIC CoPOM_tqPrimMaxErrPosSlop_C "Ramp up slope for Maximim torque limit of the E motor on the primary axle when the system errors are removed(e.g., Fault from Monitoring L2)." VALUE 0x8024FF1C RB_Val_Ws32 6553599.99847 RmpTrq -3276800.00000 3276799.99847 FORMAT "%13.5" /end CHARACTERISTIC
/begin CHARACTERISTIC CoPOM_tqPrimMaxFltDetn_C "Substitute value for the E motor maximum torque limit of primary axle when there are errors in the system (e.g., Fault from Monitoring L2)" VALUE 0x8024FF20 RB_Val_Ws16 6553.500 Trq -3276.800 3276.700 FORMAT "%8.3" /end CHARACTERISTIC
/begin CHARACTERISTIC CoPOM_tqPrimMinErrNegSlop_C "Ramp Down slope for limiting torque of the Minimum torque limit of the E motor on the primary axle when the system errors are detected(e.g., Fault from Monitoring L2)" VALUE 0x8024FF24 RB_Val_Ws32 6553599.99847 RmpTrq -3276800.00000 3276799.99847 FORMAT "%13.5" /end CHARACTERISTIC
/begin CHARACTERISTIC CoPOM_tqPrimMinErrPosSlop_C "Ramp up slope for Minimum torque limit of the E motor on the primary axle when the system errors are removed(e.g., Fault from Monitoring L2)." VALUE 0x8024FF28 RB_Val_Ws32 6553599.99847 RmpTrq -3276800.00000 3276799.99847 FORMAT "%13.5" /end CHARACTERISTIC
/begin CHARACTERISTIC CoPOM_tqPrimMinFltDetn_C "Substitute value for the E motor minimum torque limit of primary axle when there are errors in the system (e.g., Fault from Monitoring L2)" VALUE 0x8024FF2C RB_Val_Ws16 6553.500 Trq -3276.800 3276.700 FORMAT "%8.3" /end CHARACTERISTIC
/begin CHARACTERISTIC CoVMD_tqThdSpdLimL_C "Below that torque difference the state -speed limiter active- gets deactive" VALUE 0x8024FF30 RB_Val_Ws32 429496729.500 TrqPrpHigh -214748364.800 214748364.700 FORMAT "%13.3" /end CHARACTERISTIC
/begin CHARACTERISTIC CoVMD_tqThdSpdLimR_C "Above that torque difference the state -speed limiter active- gets active" VALUE 0x8024FF34 RB_Val_Ws32 429496729.500 TrqPrpHigh -214748364.800 214748364.700 FORMAT "%13.3" /end CHARACTERISTIC
/begin CHARACTERISTIC CoVMD_tqWhlMinDrvrAssc_M "Calibratable map for computing the minimum torque limit derived based on the drive mode from the drive program status and vehicle velocity" MAP 0x8024FF38 RB_Map_U16S16_S16_sao 104856.0 TrqPrp -52428.80 52427.20 FORMAT "%8.2"
 /begin AXIS_DESCR STD_AXIS MoFTqPtdVeh_stDrvProgReqMsg OneToOne 3 0.00 65535.00 FORMAT "%8.2" DEPOSIT ABSOLUTE /end AXIS_DESCR
 /begin AXIS_DESCR STD_AXIS VehV_v Vel 10 -327.6800 327.6700 FORMAT "%8.4" DEPOSIT ABSOLUTE /end AXIS_DESCR
/end CHARACTERISTIC
/begin CHARACTERISTIC DDRC_DurDeb.Com_numComInvld_473h_DCDC_TEMPERATUREDebOk_C "" VALUE 0x802411DC Val_Wu16 65535.00 OneToOne 0.00 65535.00 FORMAT "%8.2" /end CHARACTERISTIC
/begin CHARACTERISTIC DDRC_DurDeb.Com_numComInvld_473h_DCDC_TEMPERATUREDebDef_C "" VALUE 0x802411DE Val_Wu16 65535.00 OneToOne 0.00 65535.00 FORMAT "%8.2" /end CHARACTERISTIC
/begin CHARACTERISTIC DDRC_DurDeb.Com_numComInvld_47Bh_eCOMP_BusBarCurrentDebOk_C "" VALUE 0x802411E0 Val_Wu16 65535.00 OneToOne 0.00 65535.00 FORMAT "%8.2" /end CHARACTERISTIC
/begin CHARACTERISTIC DDRC_DurDeb.Com_numComInvld_47Bh_eCOMP_BusBarCurrentDebDef_C "" VALUE 0x802411E2 Val_Wu16 65535.00 OneToOne 0.00 65535.00 FORMAT "%8.2" /end CHARACTERISTIC
/begin CHARACTERISTIC DDRC_DurDeb.Com_numComInvld_47Bh_eCOMP_BusBarVoltageDebOk_C "" VALUE 0x802411E4 Val_Wu16 65535.00 OneToOne 0.00 65535.00 FORMAT "%8.2" /end CHARACTERISTIC
/begin CHARACTERISTIC DDRC_DurDeb.Com_numComInvld_47Bh_eCOMP_BusBarVoltageDebDef_C "" VALUE 0x802411E6 Val_Wu16 65535.00 OneToOne 0.00 65535.00 FORMAT "%8.2" /end CHARACTERISTIC
/begin CHARACTERISTIC DDRC_DurDeb.Com_numComInvld_47Bh_eCOMP_CompressorSpeedDebOk_C "" VALUE 0x802411E8 Val_Wu16 65535.00 OneToOne 0.00 65535.00 FORMAT "%8.2" /end CHARACTERISTIC
/begin CHARACTERISTIC DDRC_DurDeb.Com_numComInvld_47Bh_eCOMP_CompressorSpeedDebDef_C "" VALUE 0x802411EA Val_Wu16 65535.00 OneToOne 0.00 65535.00 FORMAT "%8.2" /end CHARACTERISTIC
/begin CHARACTERISTIC DDRC_DurDeb.Com_numComInvld_47Bh_eCOMP_IGBT_TempDebOk_C "" VALUE 0x802411EC Val_Wu16 65535.00 OneToOne 0.00 65535.00 FORMAT "%8.2" /end CHARACTERISTIC
/begin CHARACTERISTIC DDRC_DurDeb.Com_numComInvld_47Bh_eCOMP_IGBT_TempDebDef_C "" VALUE 0x802411EE Val_Wu16 65535.00 OneToOne 0.00 65535.00 FORMAT "%8.2" /end CHARACTERISTIC
/begin CHARACTERISTIC DDRC_DurDeb.Com_numComInvld_47Bh_eCOMP_PeakPhaCurrentDebOk_C "" VALUE 0x802411F0 Val_Wu16 65535.00 OneToOne 0.00 65535.00 FORMAT "%8.2" /end CHARACTERISTIC
/begin CHARACTERISTIC DDRC_DurDeb.Com_numComInvld_47Bh_eCOMP_PeakPhaCurrentDebDef_C "" VALUE 0x802411F2 Val_Wu16 65535.00 OneToOne 0.00 65535.00 FORMAT "%8.2" /end CHARACTERISTIC
/begin CHARACTERISTIC DDRC_DurDeb.Com_numComInvld_47Bh_eCOMP_Power_consumptionDebOk_C "" VALUE 0x802411F4 Val_Wu16 65535.00 OneToOne 0.00 65535.00 FORMAT "%8.2" /end CHARACTERISTIC
/begin CHARACTERISTIC DDRC_DurDeb.Com_numComInvld_47Bh_eCOMP_Power_consumptionDebDef_C "" VALUE 0x802411F6 Val_Wu16 65535.00 OneToOne 0.00 65535.00 FORMAT "%8.2" /end CHARACTERISTIC
/begin CHARACTERISTIC DDRC_DurDeb.Com_numComInvld_4F2h_STATUS_SOCDebOk_C "" VALUE 0x802411F8 Val_Wu16 65535.00 OneToOne 0.00 65535.00 FORMAT "%8.2" /end CHARACTERISTIC
/begin CHARACTERISTIC DDRC_DurDeb.Com_numComInvld_4F2h_STATUS_SOCDebDef_C "" VALUE 0x802411FA Val_Wu16 65535.00 OneToOne 0.00 65535.00 FORMAT "%8.2" /end CHARACTERISTIC
/begin CHARACTERISTIC DDRC_DurDeb.Com_numComInvld_4F2h_TEMP_BATT_STATUSDebOk_C "" VALUE 0x802411FC Val_Wu16 65535.00 OneToOne 0.00 65535.00 FORMAT "%8.2" /end CHARACTERISTIC
/begin CHARACTERISTIC DDRC_DurDeb.Com_numComInvld_4F2h_TEMP_BATT_STATUSDebDef_C "" VALUE 0x802411FE Val_Wu16 65535.00 OneToOne 0.00 65535.00 FORMAT "%8.2" /end CHARACTERISTIC
/begin CHARACTERISTIC DDRC_DurDeb.Com_numComInvld_4F2h_VALEUR_SOC_ETENDUEDebOk_C "" VALUE 0x80241200 Val_Wu16 65535.00 OneToOne 0.00 65535.00 FORMAT "%8.2" /end CHARACTERISTIC
/begin CHARACTERISTIC DDRC_DurDeb.Com_numComInvld_4F2h_VALEUR_SOC_ETENDUEDebDef_C "" VALUE 0x80241202 Val_Wu16 65535.00 OneToOne 0.00 65535.00 FORMAT "%8.2" /end CHARACTERISTIC
/begin CHARACTERISTIC DDRC_DurDeb.Com_numComInvld_535h_HV_BATT_TEMP_AVGDebOk_C "" VALUE 0x80241204 Val_Wu16 65535.00 OneToOne 0.00 65535.00 FORMAT "%8.2" /end CHARACTERISTIC
/begin CHARACTERISTIC DDRC_DurDeb.Com_numComInvld_535h_HV_BATT_TEMP_AVGDebDef_C "" VALUE 0x80241206 Val_Wu16 65535.00 OneToOne 0.00 65535.00 FORMAT "%8.2" /end CHARACTERISTIC
/begin CHARACTERISTIC DDRC_DurDeb.Com_numComInvld_543h_HVBAT_RESTBATTENERGYDebOk_C "" VALUE 0x80241208 Val_Wu16 65535.00 OneToOne 0.00 65535.00 FORMAT "%8.2" /end CHARACTERISTIC
/begin CHARACTERISTIC DDRC_DurDeb.Com_numComInvld_543h_HVBAT_RESTBATTENERGYDebDef_C "" VALUE 0x8024120A Val_Wu16 65535.00 OneToOne 0.00 65535.00 FORMAT "%8.2" /end CHARACTERISTIC
/begin CHARACTERISTIC DDRC_DurDeb.Com_numComInvld_543h_HVBAT_SOHDebOk_C "" VALUE 0x8024120C Val_Wu16 65535.00 OneToOne 0.00 65535.00 FORMAT "%8.2" /end CHARACTERISTIC
/begin CHARACTERISTIC DDRC_DurDeb.Com_numComInvld_543h_HVBAT_SOHDebDef_C "" VALUE 0x8024120E Val_Wu16 65535.00 OneToOne 0.00 65535.00 FORMAT "%8.2" /end CHARACTERISTIC
/begin CHARACTERISTIC DDRC_DurDeb.Com_numComInvld_543h_HV_BATT_SOH_RESDebOk_C "" VALUE 0x80241210 Val_Wu16 65535.00 OneToOne 0.00 65535.00 FORMAT "%8.2" /end CHARACTERISTIC
/begin CHARACTERISTIC DDRC_DurDeb.Com_numComInvld_543h_HV_BATT_SOH_RESDebDef_C "" VALUE 0x80241212 Val_Wu16 65535.00 OneToOne 0.00 65535.00 FORMAT "%8.2" /end CHARACTERISTIC
/begin CHARACTERISTIC DDRC_DurDeb.Com_numComInvld_552h_CPT_TEMPORELDebOk_C "" VALUE 0x80241214 Val_Wu16 65535.00 OneToOne 0.00 65535.00 FORMAT "%8.2" /end CHARACTERISTIC
/begin CHARACTERISTIC DDRC_DurDeb.Com_numComInvld_552h_CPT_TEMPORELDebDef_C "" VALUE 0x80241216 Val_Wu16 65535.00 OneToOne 0.00 65535.00 FORMAT "%8.2" /end CHARACTERISTIC
/begin CHARACTERISTIC DDRC_DurDeb.Com_numComInvld_552h_KILOMETRAGEDebOk_C "" VALUE 0x80241218 Val_Wu16 65535.00 OneToOne 0.00 65535.00 FORMAT "%8.2" /end CHARACTERISTIC
/begin CHARACTERISTIC DDRC_DurDeb.Com_numComInvld_552h_KILOMETRAGEDebDef_C "" VALUE 0x8024121A Val_Wu16 65535.00 OneToOne 0.00 65535.00 FORMAT "%8.2" /end CHARACTERISTIC
/begin CHARACTERISTIC DDRC_DurDeb.Com_numComInvld_583h_HV_BATT_DISCONT_CSE_OPENDebOk_C "" VALUE 0x8024121C Val_Wu16 65535.00 OneToOne 0.00 65535.00 FORMAT "%8.2" /end CHARACTERISTIC
/begin CHARACTERISTIC DDRC_DurDeb.Com_numComInvld_583h_HV_BATT_DISCONT_CSE_OPENDebDef_C "" VALUE 0x8024121E Val_Wu16 65535.00 OneToOne 0.00 65535.00 FORMAT "%8.2" /end CHARACTERISTIC
/begin CHARACTERISTIC DDRC_DurDeb.Com_numComInvld_592h_CALIBRE_IBATTDebOk_C "" VALUE 0x80241220 Val_Wu16 65535.00 OneToOne 0.00 65535.00 FORMAT "%8.2" /end CHARACTERISTIC
/begin CHARACTERISTIC DDRC_DurDeb.Com_numComInvld_592h_CALIBRE_IBATTDebDef_C "" VALUE 0x80241222 Val_Wu16 65535.00 OneToOne 0.00 65535.00 FORMAT "%8.2" /end CHARACTERISTIC
/begin CHARACTERISTIC DDRC_DurDeb.Com_numComInvld_592h_IBATT_1DebOk_C "" VALUE 0x80241224 Val_Wu16 65535.00 OneToOne 0.00 65535.00 FORMAT "%8.2" /end CHARACTERISTIC
/begin CHARACTERISTIC DDRC_DurDeb.Com_numComInvld_592h_IBATT_1DebDef_C "" VALUE 0x80241226 Val_Wu16 65535.00 OneToOne 0.00 65535.00 FORMAT "%8.2" /end CHARACTERISTIC
/begin CHARACTERISTIC DDRC_DurDeb.Com_numComInvld_592h_IBATT_2DebOk_C "" VALUE 0x80241228 Val_Wu16 65535.00 OneToOne 0.00 65535.00 FORMAT "%8.2" /end CHARACTERISTIC
/begin CHARACTERISTIC DDRC_DurDeb.Com_numComInvld_592h_IBATT_2DebDef_C "" VALUE 0x8024122A Val_Wu16 65535.00 OneToOne 0.00 65535.00 FORMAT "%8.2" /end CHARACTERISTIC
/begin CHARACTERISTIC DDRC_DurDeb.Com_numComInvld_592h_IBATT_3DebOk_C "" VALUE 0x8024122C Val_Wu16 65535.00 OneToOne 0.00 65535.00 FORMAT "%8.2" /end CHARACTERISTIC
/begin CHARACTERISTIC DDRC_DurDeb.Com_numComInvld_592h_IBATT_3DebDef_C "" VALUE 0x8024122E Val_Wu16 65535.00 OneToOne 0.00 65535.00 FORMAT "%8.2" /end CHARACTERISTIC
/begin CHARACTERISTIC DDRC_DurDeb.Com_numComInvld_592h_TEMP_BATTDebOk_C "" VALUE 0x80241230 Val_Wu16 65535.00 OneToOne 0.00 65535.00 FORMAT "%8.2" /end CHARACTERISTIC
/begin CHARACTERISTIC DDRC_DurDeb.Com_numComInvld_592h_TEMP_BATTDebDef_C "" VALUE 0x80241232 Val_Wu16 65535.00 OneToOne 0.00 65535.00 FORMAT "%8.2" /end CHARACTERISTIC
/begin CHARACTERISTIC DDRC_DurDeb.Com_numComInvld_592h_U_BATT_BECBDebOk_C "" VALUE 0x80241234 Val_Wu16 65535.00 OneToOne 0.00 65535.00 FORMAT "%8.2" /end CHARACTERISTIC
/begin CHARACTERISTIC DDRC_DurDeb.Com_numComInvld_592h_U_BATT_BECBDebDef_C "" VALUE 0x80241236 Val_Wu16 65535.00 OneToOne 0.00 65535.00 FORMAT "%8.2" /end CHARACTERISTIC
/begin CHARACTERISTIC DDRC_DurDeb.Com_numComInvld_595h_HVBAT_TIME_TO_CHRG_80DebOk_C "" VALUE 0x80241238 Val_Wu16 65535.00 OneToOne 0.00 65535.00 FORMAT "%8.2" /end CHARACTERISTIC
/begin CHARACTERISTIC DDRC_DurDeb.Com_numComInvld_595h_HVBAT_TIME_TO_CHRG_80DebDef_C "" VALUE 0x8024123A Val_Wu16 65535.00 OneToOne 0.00 65535.00 FORMAT "%8.2" /end CHARACTERISTIC
/begin CHARACTERISTIC DDRC_DurDeb.Com_numComInvld_5B2h_TEMP_AIR_EXTDebOk_C "" VALUE 0x8024123C Val_Wu16 65535.00 OneToOne 0.00 65535.00 FORMAT "%8.2" /end CHARACTERISTIC
/begin CHARACTERISTIC DDRC_DurDeb.Com_numComInvld_5B2h_TEMP_AIR_EXTDebDef_C "" VALUE 0x8024123E Val_Wu16 65535.00 OneToOne 0.00 65535.00 FORMAT "%8.2" /end CHARACTERISTIC
/begin CHARACTERISTIC DDRC_DurDeb.Com_numComInvld_5B5h_HVBAT_THERMAL_RUNAWAYDebOk_C "" VALUE 0x80241240 Val_Wu16 65535.00 OneToOne 0.00 65535.00 FORMAT "%8.2" /end CHARACTERISTIC
/begin CHARACTERISTIC DDRC_DurDeb.Com_numComInvld_5B5h_HVBAT_THERMAL_RUNAWAYDebDef_C "" VALUE 0x80241242 Val_Wu16 65535.00 OneToOne 0.00 65535.00 FORMAT "%8.2" /end CHARACTERISTIC
/begin CHARACTERISTIC DDRC_DurDeb.Com_numComInvld_635h_HVBAT_NEG_CONT_COUNT_SEG1DebOk_C "" VALUE 0x80241244 Val_Wu16 65535.00 OneToOne 0.00 65535.00 FORMAT "%8.2" /end CHARACTERISTIC
/begin CHARACTERISTIC DDRC_DurDeb.Com_numComInvld_635h_HVBAT_NEG_CONT_COUNT_SEG1DebDef_C "" VALUE 0x80241246 Val_Wu16 65535.00 OneToOne 0.00 65535.00 FORMAT "%8.2" /end CHARACTERISTIC
/begin CHARACTERISTIC DDRC_DurDeb.Com_numComInvld_635h_HVBAT_NEG_CONT_COUNT_SEG3DebOk_C "" VALUE 0x80241248 Val_Wu16 65535.00 OneToOne 0.00 65535.00 FORMAT "%8.2" /end CHARACTERISTIC
/begin CHARACTERISTIC DDRC_DurDeb.Com_numComInvld_635h_HVBAT_NEG_CONT_COUNT_SEG3DebDef_C "" VALUE 0x8024124A Val_Wu16 65535.00 OneToOne 0.00 65535.00 FORMAT "%8.2" /end CHARACTERISTIC
/begin CHARACTERISTIC DDRC_DurDeb.Com_numComInvld_635h_HVBAT_NEG_CONT_COUNT_SEG4DebOk_C "" VALUE 0x8024124C Val_Wu16 65535.00 OneToOne 0.00 65535.00 FORMAT "%8.2" /end CHARACTERISTIC
/begin CHARACTERISTIC DDRC_DurDeb.Com_numComInvld_635h_HVBAT_NEG_CONT_COUNT_SEG4DebDef_C "" VALUE 0x8024124E Val_Wu16 65535.00 OneToOne 0.00 65535.00 FORMAT "%8.2" /end CHARACTERISTIC
/begin CHARACTERISTIC DDRC_DurDeb.Com_numComInvld_635h_HVBAT_PST_CONT_COUNT_SEG1DebOk_C "" VALUE 0x80241250 Val_Wu16 65535.00 OneToOne 0.00 65535.00 FORMAT "%8.2" /end CHARACTERISTIC
/begin CHARACTERISTIC DDRC_DurDeb.Com_numComInvld_635h_HVBAT_PST_CONT_COUNT_SEG1DebDef_C "" VALUE 0x80241252 Val_Wu16 65535.00 OneToOne 0.00 65535.00 FORMAT "%8.2" /end CHARACTERISTIC
/begin CHARACTERISTIC DDRC_DurDeb.Com_numComInvld_635h_HVBAT_PST_CONT_COUNT_SEG3DebOk_C "" VALUE 0x80241254 Val_Wu16 65535.00 OneToOne 0.00 65535.00 FORMAT "%8.2" /end CHARACTERISTIC
/begin CHARACTERISTIC DDRC_DurDeb.Com_numComInvld_635h_HVBAT_PST_CONT_COUNT_SEG3DebDef_C "" VALUE 0x80241256 Val_Wu16 65535.00 OneToOne 0.00 65535.00 FORMAT "%8.2" /end CHARACTERISTIC
/begin CHARACTERISTIC DDRC_DurDeb.Com_numComInvld_635h_HVBAT_PST_CONT_COUNT_SEG4DebOk_C "" VALUE 0x80241258 Val_Wu16 65535.00 OneToOne 0.00 65535.00 FORMAT "%8.2" /end CHARACTERISTIC
/begin CHARACTERISTIC DDRC_DurDeb.Com_numComInvld_635h_HVBAT_PST_CONT_COUNT_SEG4DebDef_C "" VALUE 0x8024125A Val_Wu16 65535.00 OneToOne 0.00 65535.00 FORMAT "%8.2" /end CHARACTERISTIC
/begin CHARACTERISTIC DDRC_DurDeb.Com_numComInvld_645h_HVBAT_PRECHRGE_CONT_COUNT_SEG1DebOk_C "" VALUE 0x8024125C Val_Wu16 65535.00 OneToOne 0.00 65535.00 FORMAT "%8.2" /end CHARACTERISTIC
/begin CHARACTERISTIC DDRC_DurDeb.Com_numComInvld_645h_HVBAT_PRECHRGE_CONT_COUNT_SEG1DebDef_C "" VALUE 0x8024125E Val_Wu16 65535.00 OneToOne 0.00 65535.00 FORMAT "%8.2" /end CHARACTERISTIC
/begin CHARACTERISTIC DDRC_DurDeb.Com_numComInvld_645h_HVBAT_PRECHRGE_CONT_COUNT_SEG2DebOk_C "" VALUE 0x80241260 Val_Wu16 65535.00 OneToOne 0.00 65535.00 FORMAT "%8.2" /end CHARACTERISTIC
/begin CHARACTERISTIC DDRC_DurDeb.Com_numComInvld_645h_HVBAT_PRECHRGE_CONT_COUNT_SEG2DebDef_C "" VALUE 0x80241262 Val_Wu16 65535.00 OneToOne 0.00 65535.00 FORMAT "%8.2" /end CHARACTERISTIC
/begin CHARACTERISTIC DDRC_DurDeb.Com_numComInvld_675h_HVBAT_REMAININGBATTCAPACITYDebOk_C "" VALUE 0x80241264 Val_Wu16 65535.00 OneToOne 0.00 65535.00 FORMAT "%8.2" /end CHARACTERISTIC
/begin CHARACTERISTIC DDRC_DurDeb.Com_numComInvld_675h_HVBAT_REMAININGBATTCAPACITYDebDef_C "" VALUE 0x80241266 Val_Wu16 65535.00 OneToOne 0.00 65535.00 FORMAT "%8.2" /end CHARACTERISTIC
/begin CHARACTERISTIC DDRC_DurDeb.Com_tiDFC_Com26hAbsentDebOk_C "" VALUE 0x80241268 Val_Wu16 65535.00 OneToOne 0.00 65535.00 FORMAT "%8.2" /end CHARACTERISTIC
/begin CHARACTERISTIC DDRC_DurDeb.Com_tiDFC_Com26hAbsentDebDef_C "" VALUE 0x8024126A Val_Wu16 65535.00 OneToOne 0.00 65535.00 FORMAT "%8.2" /end CHARACTERISTIC
/begin CHARACTERISTIC DDRC_DurDeb.Com_tiDFC_Com26hTooShortDebOk_C "" VALUE 0x8024126C Val_Wu16 65535.00 OneToOne 0.00 65535.00 FORMAT "%8.2" /end CHARACTERISTIC
/begin CHARACTERISTIC DDRC_DurDeb.Com_tiDFC_Com26hTooShortDebDef_C "" VALUE 0x8024126E Val_Wu16 65535.00 OneToOne 0.00 65535.00 FORMAT "%8.2" /end CHARACTERISTIC
/begin CHARACTERISTIC DDRC_DurDeb.Com_tiDFC_Com5B2hAbsentDebDef_CDebOk_C "" VALUE 0x80241270 Val_Wu16 65535.00 OneToOne 0.00 65535.00 FORMAT "%8.2" /end CHARACTERISTIC
/begin CHARACTERISTIC DDRC_DurDeb.Com_tiDFC_Com5B2hAbsentDebDef_CDebDef_C "" VALUE 0x80241272 Val_Wu16 65535.00 OneToOne 0.00 65535.00 FORMAT "%8.2" /end CHARACTERISTIC
/begin CHARACTERISTIC DDRC_DurDeb.Com_tiDFC_ComInvld_26h_AC_SWITCH_REQDebOk_C "" VALUE 0x80241274 Val_Wu16 65535.00 OneToOne 0.00 65535.00 FORMAT "%8.2" /end CHARACTERISTIC
/begin CHARACTERISTIC DDRC_DurDeb.Com_tiDFC_ComInvld_26h_AC_SWITCH_REQDebDef_C "" VALUE 0x80241276 Val_Wu16 65535.00 OneToOne 0.00 65535.00 FORMAT "%8.2" /end CHARACTERISTIC
/begin CHARACTERISTIC DDRC_DurDeb.Com_tiDFC_ComInvld_26h_BLOWER_POSITIONDebOk_C "" VALUE 0x80241278 Val_Wu16 65535.00 OneToOne 0.00 65535.00 FORMAT "%8.2" /end CHARACTERISTIC
/begin CHARACTERISTIC DDRC_DurDeb.Com_tiDFC_ComInvld_26h_BLOWER_POSITIONDebDef_C "" VALUE 0x8024127A Val_Wu16 65535.00 OneToOne 0.00 65535.00 FORMAT "%8.2" /end CHARACTERISTIC
/begin CHARACTERISTIC DDRC_DurDeb.Com_tiDFC_ComInvld_26h_EVAP_SENSOR_FAULTDebOk_C "" VALUE 0x8024127C Val_Wu16 65535.00 OneToOne 0.00 65535.00 FORMAT "%8.2" /end CHARACTERISTIC
/begin CHARACTERISTIC DDRC_DurDeb.Com_tiDFC_ComInvld_26h_EVAP_SENSOR_FAULTDebDef_C "" VALUE 0x8024127E Val_Wu16 65535.00 OneToOne 0.00 65535.00 FORMAT "%8.2" /end CHARACTERISTIC
/begin CHARACTERISTIC DDRC_DurDeb.Com_tiDFC_ComInvld_26h_EVAP_SENSOR_VALUEDebOk_C "" VALUE 0x80241280 Val_Wu16 65535.00 OneToOne 0.00 65535.00 FORMAT "%8.2" /end CHARACTERISTIC
/begin CHARACTERISTIC DDRC_DurDeb.Com_tiDFC_ComInvld_26h_EVAP_SENSOR_VALUEDebDef_C "" VALUE 0x80241282 Val_Wu16 65535.00 OneToOne 0.00 65535.00 FORMAT "%8.2" /end CHARACTERISTIC
/begin CHARACTERISTIC DDRC_DurDeb.Com_tiDFC_ComInvld_26h_POTENTIOMETER_FAULTDebOk_C "" VALUE 0x80241284 Val_Wu16 65535.00 OneToOne 0.00 65535.00 FORMAT "%8.2" /end CHARACTERISTIC
/begin CHARACTERISTIC DDRC_DurDeb.Com_tiDFC_ComInvld_26h_POTENTIOMETER_FAULTDebDef_C "" VALUE 0x80241286 Val_Wu16 65535.00 OneToOne 0.00 65535.00 FORMAT "%8.2" /end CHARACTERISTIC
/begin CHARACTERISTIC DDRC_DurDeb.Com_tiDFC_ComInvld_26h_REAR_DEFOG_REQDebOk_C "" VALUE 0x80241288 Val_Wu16 65535.00 OneToOne 0.00 65535.00 FORMAT "%8.2" /end CHARACTERISTIC
/begin CHARACTERISTIC DDRC_DurDeb.Com_tiDFC_ComInvld_26h_REAR_DEFOG_REQDebDef_C "" VALUE 0x8024128A Val_Wu16 65535.00 OneToOne 0.00 65535.00 FORMAT "%8.2" /end CHARACTERISTIC
/begin CHARACTERISTIC DDRC_DurDeb.Com_tiDFC_ComInvld_26h_TEMP_POSITIONDebOk_C "" VALUE 0x8024128C Val_Wu16 65535.00 OneToOne 0.00 65535.00 FORMAT "%8.2" /end CHARACTERISTIC
/begin CHARACTERISTIC DDRC_DurDeb.Com_tiDFC_ComInvld_26h_TEMP_POSITIONDebDef_C "" VALUE 0x8024128E Val_Wu16 65535.00 OneToOne 0.00 65535.00 FORMAT "%8.2" /end CHARACTERISTIC
/begin CHARACTERISTIC DFC_CtlMsk2.DFC_Com082hTooShort_C "" VALUE 0x802413A2 Val_Wu8 255.0 DFES_OneToOne 0.00 255.0 FORMAT "%5.1" /end CHARACTERISTIC
/begin CHARACTERISTIC DFC_CtlMsk2.DFC_Com092hTooShort_C "" VALUE 0x802413A3 Val_Wu8 255.0 DFES_OneToOne 0.00 255.0 FORMAT "%5.1" /end CHARACTERISTIC
/begin CHARACTERISTIC DFC_CtlMsk2.DFC_Com205hAbsent_C "" VALUE 0x802413A4 Val_Wu8 255.0 DFES_OneToOne 0.00 255.0 FORMAT "%5.1" /end CHARACTERISTIC
/begin CHARACTERISTIC DFC_CtlMsk2.DFC_Com205hChecksum_C "" VALUE 0x802413A5 Val_Wu8 255.0 DFES_OneToOne 0.00 255.0 FORMAT "%5.1" /end CHARACTERISTIC
/begin CHARACTERISTIC DFC_CtlMsk2.DFC_Com205hCounter_C "" VALUE 0x802413A6 Val_Wu8 255.0 DFES_OneToOne 0.00 255.0 FORMAT "%5.1" /end CHARACTERISTIC
/begin CHARACTERISTIC DFC_CtlMsk2.DFC_Com205hTooShort_C "" VALUE 0x802413A7 Val_Wu8 255.0 DFES_OneToOne 0.00 255.0 FORMAT "%5.1" /end CHARACTERISTIC
/begin CHARACTERISTIC DFC_CtlMsk2.DFC_Com217hAbsent_C "" VALUE 0x802413A8 Val_Wu8 255.0 DFES_OneToOne 0.00 255.0 FORMAT "%5.1" /end CHARACTERISTIC
/begin CHARACTERISTIC DFC_CtlMsk2.DFC_Com217hChecksum_C "" VALUE 0x802413A9 Val_Wu8 255.0 DFES_OneToOne 0.00 255.0 FORMAT "%5.1" /end CHARACTERISTIC
/begin CHARACTERISTIC DFC_CtlMsk2.DFC_Com217hCounter_C "" VALUE 0x802413AA Val_Wu8 255.0 DFES_OneToOne 0.00 255.0 FORMAT "%5.1" /end CHARACTERISTIC
/begin CHARACTERISTIC DFC_CtlMsk2.DFC_Com217hTooShort_C "" VALUE 0x802413AB Val_Wu8 255.0 DFES_OneToOne 0.00 255.0 FORMAT "%5.1" /end CHARACTERISTIC
/begin CHARACTERISTIC DFC_CtlMsk2.DFC_Com227hAbsent_C "" VALUE 0x802413AC Val_Wu8 255.0 DFES_OneToOne 0.00 255.0 FORMAT "%5.1" /end CHARACTERISTIC
/begin CHARACTERISTIC DFC_CtlMsk2.DFC_Com227hTooShort_C "" VALUE 0x802413AD Val_Wu8 255.0 DFES_OneToOne 0.00 255.0 FORMAT "%5.1" /end CHARACTERISTIC
/begin CHARACTERISTIC DFC_CtlMsk2.DFC_Com237hAbsent_C "" VALUE 0x802413AE Val_Wu8 255.0 DFES_OneToOne 0.00 255.0 FORMAT "%5.1" /end CHARACTERISTIC
/begin CHARACTERISTIC DFC_CtlMsk2.DFC_Com237hChecksum_C "" VALUE 0x802413AF Val_Wu8 255.0 DFES_OneToOne 0.00 255.0 FORMAT "%5.1" /end CHARACTERISTIC
/begin CHARACTERISTIC DFC_CtlMsk2.DFC_Com237hCounter_C "" VALUE 0x802413B0 Val_Wu8 255.0 DFES_OneToOne 0.00 255.0 FORMAT "%5.1" /end CHARACTERISTIC
/begin CHARACTERISTIC DFC_CtlMsk2.DFC_Com237hTooShort_C "" VALUE 0x802413B1 Val_Wu8 255.0 DFES_OneToOne 0.00 255.0 FORMAT "%5.1" /end CHARACTERISTIC
/begin CHARACTERISTIC DFC_CtlMsk2.DFC_Com259hAbsent_C "" VALUE 0x802413B2 Val_Wu8 255.0 DFES_OneToOne 0.00 255.0 FORMAT "%5.1" /end CHARACTERISTIC
/begin CHARACTERISTIC DFC_CtlMsk2.DFC_Com259hChecksum_C "" VALUE 0x802413B3 Val_Wu8 255.0 DFES_OneToOne 0.00 255.0 FORMAT "%5.1" /end CHARACTERISTIC
/begin CHARACTERISTIC DFC_CtlMsk2.DFC_Com259hCounter_C "" VALUE 0x802413B4 Val_Wu8 255.0 DFES_OneToOne 0.00 255.0 FORMAT "%5.1" /end CHARACTERISTIC
/begin CHARACTERISTIC DFC_CtlMsk2.DFC_Com259hTooShort_C "" VALUE 0x802413B5 Val_Wu8 255.0 DFES_OneToOne 0.00 255.0 FORMAT "%5.1" /end CHARACTERISTIC
/begin CHARACTERISTIC DFC_CtlMsk2.DFC_Com26hAbsent_C "" VALUE 0x802413B6 Val_Wu8 255.0 DFES_OneToOne 0.00 255.0 FORMAT "%5.1" /end CHARACTERISTIC
/begin CHARACTERISTIC DFC_CtlMsk2.DFC_Com26hTooShort_C "" VALUE 0x802413B7 Val_Wu8 255.0 DFES_OneToOne 0.00 255.0 FORMAT "%5.1" /end CHARACTERISTIC
/begin CHARACTERISTIC DFC_CtlMsk2.DFC_Com273hAbsent_C "" VALUE 0x802413B8 Val_Wu8 255.0 DFES_OneToOne 0.00 255.0 FORMAT "%5.1" /end CHARACTERISTIC
/begin CHARACTERISTIC DFC_CtlMsk2.DFC_Com273hChecksum_C "" VALUE 0x802413B9 Val_Wu8 255.0 DFES_OneToOne 0.00 255.0 FORMAT "%5.1" /end CHARACTERISTIC
/begin CHARACTERISTIC DFC_CtlMsk2.DFC_Com273hCounter_C "" VALUE 0x802413BA Val_Wu8 255.0 DFES_OneToOne 0.00 255.0 FORMAT "%5.1" /end CHARACTERISTIC
/begin CHARACTERISTIC DFC_CtlMsk2.DFC_Com273hTooShort_C "" VALUE 0x802413BB Val_Wu8 255.0 DFES_OneToOne 0.00 255.0 FORMAT "%5.1" /end CHARACTERISTIC
/begin CHARACTERISTIC DFC_CtlMsk2.DFC_Com275hAbsent_C "" VALUE 0x802413BC Val_Wu8 255.0 DFES_OneToOne 0.00 255.0 FORMAT "%5.1" /end CHARACTERISTIC
/begin CHARACTERISTIC DFC_CtlMsk2.DFC_Com275hChecksum_C "" VALUE 0x802413BD Val_Wu8 255.0 DFES_OneToOne 0.00 255.0 FORMAT "%5.1" /end CHARACTERISTIC
/begin CHARACTERISTIC DFC_CtlMsk2.DFC_Com275hCounter_C "" VALUE 0x802413BE Val_Wu8 255.0 DFES_OneToOne 0.00 255.0 FORMAT "%5.1" /end CHARACTERISTIC
/begin CHARACTERISTIC DFC_CtlMsk2.DFC_Com275hTooShort_C "" VALUE 0x802413BF Val_Wu8 255.0 DFES_OneToOne 0.00 255.0 FORMAT "%5.1" /end CHARACTERISTIC
/begin CHARACTERISTIC DFC_CtlMsk2.DFC_Com283hAbsent_C "" VALUE 0x802413C0 Val_Wu8 255.0 DFES_OneToOne 0.00 255.0 FORMAT "%5.1" /end CHARACTERISTIC
/begin CHARACTERISTIC DFC_CtlMsk2.DFC_Com283hTooShort_C "" VALUE 0x802413C1 Val_Wu8 255.0 DFES_OneToOne 0.00 255.0 FORMAT "%5.1" /end CHARACTERISTIC
/begin CHARACTERISTIC DFC_CtlMsk2.DFC_Com285hAbsent_C "" VALUE 0x802413C2 Val_Wu8 255.0 DFES_OneToOne 0.00 255.0 FORMAT "%5.1" /end CHARACTERISTIC
/begin CHARACTERISTIC DFC_CtlMsk2.DFC_Com285hChecksum_C "" VALUE 0x802413C3 Val_Wu8 255.0 DFES_OneToOne 0.00 255.0 FORMAT "%5.1" /end CHARACTERISTIC
/begin CHARACTERISTIC DFC_CtlMsk2.DFC_Com285hCounter_C "" VALUE 0x802413C4 Val_Wu8 255.0 DFES_OneToOne 0.00 255.0 FORMAT "%5.1" /end CHARACTERISTIC
/begin CHARACTERISTIC DFC_CtlMsk2.DFC_Com285hTooShort_C "" VALUE 0x802413C5 Val_Wu8 255.0 DFES_OneToOne 0.00 255.0 FORMAT "%5.1" /end CHARACTERISTIC
/begin CHARACTERISTIC DFC_CtlMsk2.DFC_Com293hAbsent_C "" VALUE 0x802413C6 Val_Wu8 255.0 DFES_OneToOne 0.00 255.0 FORMAT "%5.1" /end CHARACTERISTIC
/begin CHARACTERISTIC DFC_CtlMsk2.DFC_Com293hChecksum_C "" VALUE 0x802413C7 Val_Wu8 255.0 DFES_OneToOne 0.00 255.0 FORMAT "%5.1" /end CHARACTERISTIC
/begin CHARACTERISTIC DFC_CtlMsk2.DFC_Com293hCounter_C "" VALUE 0x802413C8 Val_Wu8 255.0 DFES_OneToOne 0.00 255.0 FORMAT "%5.1" /end CHARACTERISTIC
/begin CHARACTERISTIC DFC_CtlMsk2.DFC_Com293hTooShort_C "" VALUE 0x802413C9 Val_Wu8 255.0 DFES_OneToOne 0.00 255.0 FORMAT "%5.1" /end CHARACTERISTIC
/begin CHARACTERISTIC DFC_CtlMsk2.DFC_Com308hAbsent_C "" VALUE 0x802413CA Val_Wu8 255.0 DFES_OneToOne 0.00 255.0 FORMAT "%5.1" /end CHARACTERISTIC
/begin CHARACTERISTIC DFC_CtlMsk2.DFC_Com308hChecksum_C "" VALUE 0x802413CB Val_Wu8 255.0 DFES_OneToOne 0.00 255.0 FORMAT "%5.1" /end CHARACTERISTIC
/begin CHARACTERISTIC DFC_CtlMsk2.DFC_Com308hCounter_C "" VALUE 0x802413CC Val_Wu8 255.0 DFES_OneToOne 0.00 255.0 FORMAT "%5.1" /end CHARACTERISTIC
/begin CHARACTERISTIC DFC_CtlMsk2.DFC_Com308hTooShort_C "" VALUE 0x802413CD Val_Wu8 255.0 DFES_OneToOne 0.00 255.0 FORMAT "%5.1" /end CHARACTERISTIC
/begin CHARACTERISTIC DFC_CtlMsk2.DFC_Com318hAbsent_C "" VALUE 0x802413CE Val_Wu8 255.0 DFES_OneToOne 0.00 255.0 FORMAT "%5.1" /end CHARACTERISTIC
/begin CHARACTERISTIC DFC_CtlMsk2.DFC_Com318hChecksum_C "" VALUE 0x802413CF Val_Wu8 255.0 DFES_OneToOne 0.00 255.0 FORMAT "%5.1" /end CHARACTERISTIC
/begin CHARACTERISTIC DFC_CtlMsk2.DFC_Com318hCounter_C "" VALUE 0x802413D0 Val_Wu8 255.0 DFES_OneToOne 0.00 255.0 FORMAT "%5.1" /end CHARACTERISTIC
/begin CHARACTERISTIC DFC_CtlMsk2.DFC_Com318hTooShort_C "" VALUE 0x802413D1 Val_Wu8 255.0 DFES_OneToOne 0.00 255.0 FORMAT "%5.1" /end CHARACTERISTIC
/begin CHARACTERISTIC DFC_CtlMsk2.DFC_Com325hAbsent_C "" VALUE 0x802413D2 Val_Wu8 255.0 DFES_OneToOne 0.00 255.0 FORMAT "%5.1" /end CHARACTERISTIC
/begin CHARACTERISTIC DFC_CtlMsk2.DFC_Com325hChecksum_C "" VALUE 0x802413D3 Val_Wu8 255.0 DFES_OneToOne 0.00 255.0 FORMAT "%5.1" /end CHARACTERISTIC
/begin CHARACTERISTIC DFC_CtlMsk2.DFC_Com325hCounter_C "" VALUE 0x802413D4 Val_Wu8 255.0 DFES_OneToOne 0.00 255.0 FORMAT "%5.1" /end CHARACTERISTIC
/begin CHARACTERISTIC DFC_CtlMsk2.DFC_Com325hTooShort_C "" VALUE 0x802413D5 Val_Wu8 255.0 DFES_OneToOne 0.00 255.0 FORMAT "%5.1" /end CHARACTERISTIC
/begin CHARACTERISTIC DFC_CtlMsk2.DFC_Com335hAbsent_C "" VALUE 0x802413D6 Val_Wu8 255.0 DFES_OneToOne 0.00 255.0 FORMAT "%5.1" /end CHARACTERISTIC
/begin CHARACTERISTIC DFC_CtlMsk2.DFC_Com335hChecksum_C "" VALUE 0x802413D7 Val_Wu8 255.0 DFES_OneToOne 0.00 255.0 FORMAT "%5.1" /end CHARACTERISTIC
/begin CHARACTERISTIC DFC_CtlMsk2.DFC_Com335hCounter_C "" VALUE 0x802413D8 Val_Wu8 255.0 DFES_OneToOne 0.00 255.0 FORMAT "%5.1" /end CHARACTERISTIC
/begin CHARACTERISTIC DFC_CtlMsk2.DFC_Com335hTooShort_C "" VALUE 0x802413D9 Val_Wu8 255.0 DFES_OneToOne 0.00 255.0 FORMAT "%5.1" /end CHARACTERISTIC
/begin CHARACTERISTIC DFC_CtlMsk2.DFC_Com351hAbsent_C "" VALUE 0x802413DA Val_Wu8 255.0 DFES_OneToOne 0.00 255.0 FORMAT "%5.1" /end CHARACTERISTIC
/begin CHARACTERISTIC DFC_CtlMsk2.DFC_Com351hTooShort_C "" VALUE 0x802413DB Val_Wu8 255.0 DFES_OneToOne 0.00 255.0 FORMAT "%5.1" /end CHARACTERISTIC
/begin CHARACTERISTIC DFC_CtlMsk2.DFC_Com38DhAbsent_C "" VALUE 0x802413DC Val_Wu8 255.0 DFES_OneToOne 0.00 255.0 FORMAT "%5.1" /end CHARACTERISTIC
/begin CHARACTERISTIC DFC_CtlMsk2.DFC_Com38DhChecksum_C "" VALUE 0x802413DD Val_Wu8 255.0 DFES_OneToOne 0.00 255.0 FORMAT "%5.1" /end CHARACTERISTIC
/begin CHARACTERISTIC DFC_CtlMsk2.DFC_Com38DhCounter_C "" VALUE 0x802413DE Val_Wu8 255.0 DFES_OneToOne 0.00 255.0 FORMAT "%5.1" /end CHARACTERISTIC
/begin CHARACTERISTIC DFC_CtlMsk2.DFC_Com38DhTooShort_C "" VALUE 0x802413DF Val_Wu8 255.0 DFES_OneToOne 0.00 255.0 FORMAT "%5.1" /end CHARACTERISTIC
/begin CHARACTERISTIC DFC_CtlMsk2.DFC_Com412hAbsent_C "" VALUE 0x802413E0 Val_Wu8 255.0 DFES_OneToOne 0.00 255.0 FORMAT "%5.1" /end CHARACTERISTIC
/begin CHARACTERISTIC DFC_CtlMsk2.DFC_Com412hChecksum_C "" VALUE 0x802413E1 Val_Wu8 255.0 DFES_OneToOne 0.00 255.0 FORMAT "%5.1" /end CHARACTERISTIC
/begin CHARACTERISTIC DFC_CtlMsk2.DFC_Com412hCounter_C "" VALUE 0x802413E2 Val_Wu8 255.0 DFES_OneToOne 0.00 255.0 FORMAT "%5.1" /end CHARACTERISTIC
/begin CHARACTERISTIC DFC_CtlMsk2.DFC_Com412hTooShort_C "" VALUE 0x802413E3 Val_Wu8 255.0 DFES_OneToOne 0.00 255.0 FORMAT "%5.1" /end CHARACTERISTIC
/begin CHARACTERISTIC DFC_CtlMsk2.DFC_Com427hAbsent_C "" VALUE 0x802413E4 Val_Wu8 255.0 DFES_OneToOne 0.00 255.0 FORMAT "%5.1" /end CHARACTERISTIC
/begin CHARACTERISTIC DFC_CtlMsk2.DFC_Com427hTooShort_C "" VALUE 0x802413E5 Val_Wu8 255.0 DFES_OneToOne 0.00 255.0 FORMAT "%5.1" /end CHARACTERISTIC
/begin CHARACTERISTIC DFC_CtlMsk2.DFC_Com432hAbsent_C "" VALUE 0x802413E6 Val_Wu8 255.0 DFES_OneToOne 0.00 255.0 FORMAT "%5.1" /end CHARACTERISTIC
/begin CHARACTERISTIC DFC_CtlMsk2.DFC_Com432hChecksum_C "" VALUE 0x802413E7 Val_Wu8 255.0 DFES_OneToOne 0.00 255.0 FORMAT "%5.1" /end CHARACTERISTIC
/begin CHARACTERISTIC DFC_CtlMsk2.DFC_Com432hCounter_C "" VALUE 0x802413E8 Val_Wu8 255.0 DFES_OneToOne 0.00 255.0 FORMAT "%5.1" /end CHARACTERISTIC
/begin CHARACTERISTIC DFC_CtlMsk2.DFC_Com432hTooShort_C "" VALUE 0x802413E9 Val_Wu8 255.0 DFES_OneToOne 0.00 255.0 FORMAT "%5.1" /end CHARACTERISTIC
/begin CHARACTERISTIC DFC_CtlMsk2.DFC_Com435hAbsent_C "" VALUE 0x802413EA Val_Wu8 255.0 DFES_OneToOne 0.00 255.0 FORMAT "%5.1" /end CHARACTERISTIC
/begin CHARACTERISTIC DFC_CtlMsk2.DFC_Com435hTooShort_C "" VALUE 0x802413EB Val_Wu8 255.0 DFES_OneToOne 0.00 255.0 FORMAT "%5.1" /end CHARACTERISTIC
/begin CHARACTERISTIC DFC_CtlMsk2.DFC_Com442hAbsent_C "" VALUE 0x802413EC Val_Wu8 255.0 DFES_OneToOne 0.00 255.0 FORMAT "%5.1" /end CHARACTERISTIC
/begin CHARACTERISTIC DFC_CtlMsk2.DFC_Com442hTooShort_C "" VALUE 0x802413ED Val_Wu8 255.0 DFES_OneToOne 0.00 255.0 FORMAT "%5.1" /end CHARACTERISTIC
/begin CHARACTERISTIC DFC_CtlMsk2.DFC_Com453hAbsent_C "" VALUE 0x802413EE Val_Wu8 255.0 DFES_OneToOne 0.00 255.0 FORMAT "%5.1" /end CHARACTERISTIC
/begin CHARACTERISTIC DFC_CtlMsk2.DFC_Com453hTooShort_C "" VALUE 0x802413EF Val_Wu8 255.0 DFES_OneToOne 0.00 255.0 FORMAT "%5.1" /end CHARACTERISTIC
/begin CHARACTERISTIC DFC_CtlMsk2.DFC_Com455hAbsent_C "" VALUE 0x802413F0 Val_Wu8 255.0 DFES_OneToOne 0.00 255.0 FORMAT "%5.1" /end CHARACTERISTIC
/begin CHARACTERISTIC DFC_CtlMsk2.DFC_Com455hTooShort_C "" VALUE 0x802413F1 Val_Wu8 255.0 DFES_OneToOne 0.00 255.0 FORMAT "%5.1" /end CHARACTERISTIC
/begin CHARACTERISTIC DFC_CtlMsk2.DFC_Com463hAbsent_C "" VALUE 0x802413F2 Val_Wu8 255.0 DFES_OneToOne 0.00 255.0 FORMAT "%5.1" /end CHARACTERISTIC
/begin CHARACTERISTIC DFC_CtlMsk2.DFC_Com463hTooShort_C "" VALUE 0x802413F3 Val_Wu8 255.0 DFES_OneToOne 0.00 255.0 FORMAT "%5.1" /end CHARACTERISTIC
/begin CHARACTERISTIC DFC_CtlMsk2.DFC_Com473hAbsent_C "" VALUE 0x802413F4 Val_Wu8 255.0 DFES_OneToOne 0.00 255.0 FORMAT "%5.1" /end CHARACTERISTIC
/begin CHARACTERISTIC DFC_CtlMsk2.DFC_Com473hTooShort_C "" VALUE 0x802413F5 Val_Wu8 255.0 DFES_OneToOne 0.00 255.0 FORMAT "%5.1" /end CHARACTERISTIC
/begin CHARACTERISTIC DFC_CtlMsk2.DFC_Com47BhAbsent_C "" VALUE 0x802413F6 Val_Wu8 255.0 DFES_OneToOne 0.00 255.0 FORMAT "%5.1" /end CHARACTERISTIC
/begin CHARACTERISTIC DFC_CtlMsk2.DFC_Com47BhTooShort_C "" VALUE 0x802413F7 Val_Wu8 255.0 DFES_OneToOne 0.00 255.0 FORMAT "%5.1" /end CHARACTERISTIC
/begin CHARACTERISTIC DFC_CtlMsk2.DFC_Com48BhAbsent_C "" VALUE 0x802413F8 Val_Wu8 255.0 DFES_OneToOne 0.00 255.0 FORMAT "%5.1" /end CHARACTERISTIC
/begin CHARACTERISTIC DFC_CtlMsk2.DFC_Com48BhTooShort_C "" VALUE 0x802413F9 Val_Wu8 255.0 DFES_OneToOne 0.00 255.0 FORMAT "%5.1" /end CHARACTERISTIC
/begin CHARACTERISTIC DFC_CtlMsk2.DFC_Com497hTooShort_C "" VALUE 0x802413FA Val_Wu8 255.0 DFES_OneToOne 0.00 255.0 FORMAT "%5.1" /end CHARACTERISTIC
/begin CHARACTERISTIC DFC_CtlMsk2.DFC_Com4F2hAbsent_C "" VALUE 0x802413FB Val_Wu8 255.0 DFES_OneToOne 0.00 255.0 FORMAT "%5.1" /end CHARACTERISTIC
/begin CHARACTERISTIC DFC_CtlMsk2.DFC_Com4F2hChecksum_C "" VALUE 0x802413FC Val_Wu8 255.0 DFES_OneToOne 0.00 255.0 FORMAT "%5.1" /end CHARACTERISTIC
/begin CHARACTERISTIC DFC_CtlMsk2.DFC_Com4F2hCounter_C "" VALUE 0x802413FD Val_Wu8 255.0 DFES_OneToOne 0.00 255.0 FORMAT "%5.1" /end CHARACTERISTIC
/begin CHARACTERISTIC DFC_CtlMsk2.DFC_Com4F2hTooShort_C "" VALUE 0x802413FE Val_Wu8 255.0 DFES_OneToOne 0.00 255.0 FORMAT "%5.1" /end CHARACTERISTIC
/begin CHARACTERISTIC DFC_CtlMsk2.DFC_Com50DhAbsent_C "" VALUE 0x802413FF Val_Wu8 255.0 DFES_OneToOne 0.00 255.0 FORMAT "%5.1" /end CHARACTERISTIC
/begin CHARACTERISTIC DFC_CtlMsk2.DFC_Com50DhTooShort_C "" VALUE 0x80241400 Val_Wu8 255.0 DFES_OneToOne 0.00 255.0 FORMAT "%5.1" /end CHARACTERISTIC
/begin CHARACTERISTIC DFC_CtlMsk2.DFC_Com535hAbsent_C "" VALUE 0x80241401 Val_Wu8 255.0 DFES_OneToOne 0.00 255.0 FORMAT "%5.1" /end CHARACTERISTIC
/begin CHARACTERISTIC DFC_CtlMsk2.DFC_Com535hTooShort_C "" VALUE 0x80241402 Val_Wu8 255.0 DFES_OneToOne 0.00 255.0 FORMAT "%5.1" /end CHARACTERISTIC
/begin CHARACTERISTIC DFC_CtlMsk2.DFC_Com543hAbsent_C "" VALUE 0x80241403 Val_Wu8 255.0 DFES_OneToOne 0.00 255.0 FORMAT "%5.1" /end CHARACTERISTIC
/begin CHARACTERISTIC DFC_CtlMsk2.DFC_Com543hTooShort_C "" VALUE 0x80241404 Val_Wu8 255.0 DFES_OneToOne 0.00 255.0 FORMAT "%5.1" /end CHARACTERISTIC
/begin CHARACTERISTIC DFC_CtlMsk2.DFC_Com552hAbsent_C "" VALUE 0x80241405 Val_Wu8 255.0 DFES_OneToOne 0.00 255.0 FORMAT "%5.1" /end CHARACTERISTIC
/begin CHARACTERISTIC DFC_CtlMsk2.DFC_Com552hTooShort_C "" VALUE 0x80241406 Val_Wu8 255.0 DFES_OneToOne 0.00 255.0 FORMAT "%5.1" /end CHARACTERISTIC
/begin CHARACTERISTIC DFC_CtlMsk2.DFC_Com583hAbsent_C "" VALUE 0x80241407 Val_Wu8 255.0 DFES_OneToOne 0.00 255.0 FORMAT "%5.1" /end CHARACTERISTIC
/begin CHARACTERISTIC DFC_CtlMsk2.DFC_Com583hTooShort_C "" VALUE 0x80241408 Val_Wu8 255.0 DFES_OneToOne 0.00 255.0 FORMAT "%5.1" /end CHARACTERISTIC
/begin CHARACTERISTIC DFC_CtlMsk2.DFC_Com592hAbsent_C "" VALUE 0x80241409 Val_Wu8 255.0 DFES_OneToOne 0.00 255.0 FORMAT "%5.1" /end CHARACTERISTIC
/begin CHARACTERISTIC DFC_CtlMsk2.DFC_Com592hChecksum_C "" VALUE 0x8024140A Val_Wu8 255.0 DFES_OneToOne 0.00 255.0 FORMAT "%5.1" /end CHARACTERISTIC
/begin CHARACTERISTIC DFC_CtlMsk2.DFC_Com592hCounter_C "" VALUE 0x8024140B Val_Wu8 255.0 DFES_OneToOne 0.00 255.0 FORMAT "%5.1" /end CHARACTERISTIC
/begin CHARACTERISTIC DFC_CtlMsk2.DFC_Com592hTooShort_C "" VALUE 0x8024140C Val_Wu8 255.0 DFES_OneToOne 0.00 255.0 FORMAT "%5.1" /end CHARACTERISTIC
/begin CHARACTERISTIC DFC_CtlMsk2.DFC_Com595hAbsent_C "" VALUE 0x8024140D Val_Wu8 255.0 DFES_OneToOne 0.00 255.0 FORMAT "%5.1" /end CHARACTERISTIC
/begin CHARACTERISTIC DFC_CtlMsk2.DFC_Com595hChecksum_C "" VALUE 0x8024140E Val_Wu8 255.0 DFES_OneToOne 0.00 255.0 FORMAT "%5.1" /end CHARACTERISTIC
/begin CHARACTERISTIC DFC_CtlMsk2.DFC_Com595hCounter_C "" VALUE 0x8024140F Val_Wu8 255.0 DFES_OneToOne 0.00 255.0 FORMAT "%5.1" /end CHARACTERISTIC
/begin CHARACTERISTIC DFC_CtlMsk2.DFC_Com595hTooShort_C "" VALUE 0x80241410 Val_Wu8 255.0 DFES_OneToOne 0.00 255.0 FORMAT "%5.1" /end CHARACTERISTIC
/begin CHARACTERISTIC DFC_CtlMsk2.DFC_Com5B2hAbsent_C "" VALUE 0x80241411 Val_Wu8 255.0 DFES_OneToOne 0.00 255.0 FORMAT "%5.1" /end CHARACTERISTIC
/begin CHARACTERISTIC DFC_CtlMsk2.DFC_Com5B2hTooShort_C "" VALUE 0x80241412 Val_Wu8 255.0 DFES_OneToOne 0.00 255.0 FORMAT "%5.1" /end CHARACTERISTIC
/begin CHARACTERISTIC DFC_CtlMsk2.DFC_Com5B5hAbsent_C "" VALUE 0x80241413 Val_Wu8 255.0 DFES_OneToOne 0.00 255.0 FORMAT "%5.1" /end CHARACTERISTIC
/begin CHARACTERISTIC DFC_CtlMsk2.DFC_Com5B5hChecksum_C "" VALUE 0x80241414 Val_Wu8 255.0 DFES_OneToOne 0.00 255.0 FORMAT "%5.1" /end CHARACTERISTIC
/begin CHARACTERISTIC DFC_CtlMsk2.DFC_Com5B5hCounter_C "" VALUE 0x80241415 Val_Wu8 255.0 DFES_OneToOne 0.00 255.0 FORMAT "%5.1" /end CHARACTERISTIC
/begin CHARACTERISTIC DFC_CtlMsk2.DFC_Com5B5hTooShort_C "" VALUE 0x80241416 Val_Wu8 255.0 DFES_OneToOne 0.00 255.0 FORMAT "%5.1" /end CHARACTERISTIC
/begin CHARACTERISTIC DFC_CtlMsk2.DFC_Com5C7hTooShort_C "" VALUE 0x80241417 Val_Wu8 255.0 DFES_OneToOne 0.00 255.0 FORMAT "%5.1" /end CHARACTERISTIC
/begin CHARACTERISTIC DFC_CtlMsk2.DFC_Com5E7hAbsent_C "" VALUE 0x80241418 Val_Wu8 255.0 DFES_OneToOne 0.00 255.0 FORMAT "%5.1" /end CHARACTERISTIC
/begin CHARACTERISTIC DFC_CtlMsk2.DFC_Com5E7hTooShort_C "" VALUE 0x80241419 Val_Wu8 255.0 DFES_OneToOne 0.00 255.0 FORMAT "%5.1" /end CHARACTERISTIC
/begin CHARACTERISTIC DFC_CtlMsk2.DFC_Com635hTooShort_C "" VALUE 0x8024141A Val_Wu8 255.0 DFES_OneToOne 0.00 255.0 FORMAT "%5.1" /end CHARACTERISTIC
/begin CHARACTERISTIC DFC_CtlMsk2.DFC_Com645hTooShort_C "" VALUE 0x8024141B Val_Wu8 255.0 DFES_OneToOne 0.00 255.0 FORMAT "%5.1" /end CHARACTERISTIC
/begin CHARACTERISTIC DFC_CtlMsk2.DFC_Com663hAbsent_C "" VALUE 0x8024141C Val_Wu8 255.0 DFES_OneToOne 0.00 255.0 FORMAT "%5.1" /end CHARACTERISTIC
/begin CHARACTERISTIC DFC_CtlMsk2.DFC_Com663hTooShort_C "" VALUE 0x8024141D Val_Wu8 255.0 DFES_OneToOne 0.00 255.0 FORMAT "%5.1" /end CHARACTERISTIC
/begin CHARACTERISTIC DFC_CtlMsk2.DFC_Com665hAbsent_C "" VALUE 0x8024141E Val_Wu8 255.0 DFES_OneToOne 0.00 255.0 FORMAT "%5.1" /end CHARACTERISTIC
/begin CHARACTERISTIC DFC_CtlMsk2.DFC_Com665hTooShort_C "" VALUE 0x8024141F Val_Wu8 255.0 DFES_OneToOne 0.00 255.0 FORMAT "%5.1" /end CHARACTERISTIC
/begin CHARACTERISTIC DFC_CtlMsk2.DFC_Com675hAbsent_C "" VALUE 0x80241420 Val_Wu8 255.0 DFES_OneToOne 0.00 255.0 FORMAT "%5.1" /end CHARACTERISTIC
/begin CHARACTERISTIC DFC_CtlMsk2.DFC_Com675hTooShort_C "" VALUE 0x80241421 Val_Wu8 255.0 DFES_OneToOne 0.00 255.0 FORMAT "%5.1" /end CHARACTERISTIC
/begin CHARACTERISTIC DFC_CtlMsk2.DFC_ComFrbd_205h_HVBAT_PACK_CURRENT_C "" VALUE 0x80241422 Val_Wu8 255.0 DFES_OneToOne 0.00 255.0 FORMAT "%5.1" /end CHARACTERISTIC
/begin CHARACTERISTIC DFC_CtlMsk2.DFC_ComFrbd_205h_HVBAT_SOC_DISPLAY_C "" VALUE 0x80241423 Val_Wu8 255.0 DFES_OneToOne 0.00 255.0 FORMAT "%5.1" /end CHARACTERISTIC
/begin CHARACTERISTIC DFC_CtlMsk2.DFC_ComFrbd_205h_HVBAT_VOLTAGE_C "" VALUE 0x80241424 Val_Wu8 255.0 DFES_OneToOne 0.00 255.0 FORMAT "%5.1" /end CHARACTERISTIC
/begin CHARACTERISTIC DFC_CtlMsk2.DFC_ComFrbd_217h_INV_DC_BUS_VOLTAGE_C "" VALUE 0x80241425 Val_Wu8 255.0 DFES_OneToOne 0.00 255.0 FORMAT "%5.1" /end CHARACTERISTIC
/begin CHARACTERISTIC DFC_CtlMsk2.DFC_ComFrbd_217h_INV_MTR_ACTUAL_TRQ_C "" VALUE 0x80241426 Val_Wu8 255.0 DFES_OneToOne 0.00 255.0 FORMAT "%5.1" /end CHARACTERISTIC
/begin CHARACTERISTIC DFC_CtlMsk2.DFC_ComFrbd_217h_INV_MTR_SPEED_C "" VALUE 0x80241427 Val_Wu8 255.0 DFES_OneToOne 0.00 255.0 FORMAT "%5.1" /end CHARACTERISTIC
/begin CHARACTERISTIC DFC_CtlMsk2.DFC_ComFrbd_217h_INV_MTR_TRQ_C "" VALUE 0x80241428 Val_Wu8 255.0 DFES_OneToOne 0.00 255.0 FORMAT "%5.1" /end CHARACTERISTIC
/begin CHARACTERISTIC DFC_CtlMsk2.DFC_ComFrbd_227h_INV_DC_CURRENT_C "" VALUE 0x80241429 Val_Wu8 255.0 DFES_OneToOne 0.00 255.0 FORMAT "%5.1" /end CHARACTERISTIC
/begin CHARACTERISTIC DFC_CtlMsk2.DFC_ComFrbd_227h_INV_MOTORING_PEAK_TRQ_C "" VALUE 0x8024142A Val_Wu8 255.0 DFES_OneToOne 0.00 255.0 FORMAT "%5.1" /end CHARACTERISTIC
/begin CHARACTERISTIC DFC_CtlMsk2.DFC_ComFrbd_227h_INV_MTR_INST_INPUT_POWER_C "" VALUE 0x8024142B Val_Wu8 255.0 DFES_OneToOne 0.00 255.0 FORMAT "%5.1" /end CHARACTERISTIC
/begin CHARACTERISTIC DFC_CtlMsk2.DFC_ComFrbd_227h_INV_REGEN_PEAK_TRQ_C "" VALUE 0x8024142C Val_Wu8 255.0 DFES_OneToOne 0.00 255.0 FORMAT "%5.1" /end CHARACTERISTIC
/begin CHARACTERISTIC DFC_CtlMsk2.DFC_ComFrbd_237h_INV_ACTIVE_DISCHARGE_STATUS_C "" VALUE 0x8024142D Val_Wu8 255.0 DFES_OneToOne 0.00 255.0 FORMAT "%5.1" /end CHARACTERISTIC
/begin CHARACTERISTIC DFC_CtlMsk2.DFC_ComFrbd_237h_INV_CTRL_MODE_ACK_C "" VALUE 0x8024142E Val_Wu8 255.0 DFES_OneToOne 0.00 255.0 FORMAT "%5.1" /end CHARACTERISTIC
/begin CHARACTERISTIC DFC_CtlMsk2.DFC_ComFrbd_237h_INV_EV_WARNING_C "" VALUE 0x8024142F Val_Wu8 255.0 DFES_OneToOne 0.00 255.0 FORMAT "%5.1" /end CHARACTERISTIC
/begin CHARACTERISTIC DFC_CtlMsk2.DFC_ComFrbd_237h_INV_FAULT_LEVEL_C "" VALUE 0x80241430 Val_Wu8 255.0 DFES_OneToOne 0.00 255.0 FORMAT "%5.1" /end CHARACTERISTIC
/begin CHARACTERISTIC DFC_CtlMsk2.DFC_ComFrbd_237h_INV_MASTER_STOP_C "" VALUE 0x80241431 Val_Wu8 255.0 DFES_OneToOne 0.00 255.0 FORMAT "%5.1" /end CHARACTERISTIC
/begin CHARACTERISTIC DFC_CtlMsk2.DFC_ComFrbd_237h_INV_SERVICE_DUE_C "" VALUE 0x80241432 Val_Wu8 255.0 DFES_OneToOne 0.00 255.0 FORMAT "%5.1" /end CHARACTERISTIC
/begin CHARACTERISTIC DFC_CtlMsk2.DFC_ComFrbd_237h_INV_STAB_MIN_TRQ_C "" VALUE 0x80241433 Val_Wu8 255.0 DFES_OneToOne 0.00 255.0 FORMAT "%5.1" /end CHARACTERISTIC
/begin CHARACTERISTIC DFC_CtlMsk2.DFC_ComFrbd_259h_TGLM_FAILURE_STATE_C "" VALUE 0x80241434 Val_Wu8 255.0 DFES_OneToOne 0.00 255.0 FORMAT "%5.1" /end CHARACTERISTIC
/begin CHARACTERISTIC DFC_CtlMsk2.DFC_ComFrbd_259h_TGLM_MODE_PUSH_C "" VALUE 0x80241435 Val_Wu8 255.0 DFES_OneToOne 0.00 255.0 FORMAT "%5.1" /end CHARACTERISTIC
/begin CHARACTERISTIC DFC_CtlMsk2.DFC_ComFrbd_259h_TOGGLE_MONOSTABLE_POS_C "" VALUE 0x80241436 Val_Wu8 255.0 DFES_OneToOne 0.00 255.0 FORMAT "%5.1" /end CHARACTERISTIC
/begin CHARACTERISTIC DFC_CtlMsk2.DFC_ComFrbd_273h_OBC_outputpower_capability_C "" VALUE 0x80241437 Val_Wu8 255.0 DFES_OneToOne 0.00 255.0 FORMAT "%5.1" /end CHARACTERISTIC
/begin CHARACTERISTIC DFC_CtlMsk2.DFC_ComFrbd_275h_HVBAT_DISCHARGE_30S_AVAILABLE_CURRENT_C "" VALUE 0x80241438 Val_Wu8 255.0 DFES_OneToOne 0.00 255.0 FORMAT "%5.1" /end CHARACTERISTIC
/begin CHARACTERISTIC DFC_CtlMsk2.DFC_ComFrbd_275h_HVBAT_DISCHARGE_30S_AVAILABLE_POWER_C "" VALUE 0x80241439 Val_Wu8 255.0 DFES_OneToOne 0.00 255.0 FORMAT "%5.1" /end CHARACTERISTIC
/begin CHARACTERISTIC DFC_CtlMsk2.DFC_ComFrbd_283h_DCDC_IN_CURRENT_C "" VALUE 0x8024143A Val_Wu8 255.0 DFES_OneToOne 0.00 255.0 FORMAT "%5.1" /end CHARACTERISTIC
/begin CHARACTERISTIC DFC_CtlMsk2.DFC_ComFrbd_283h_DCDC_IN_VOLTAGE_C "" VALUE 0x8024143B Val_Wu8 255.0 DFES_OneToOne 0.00 255.0 FORMAT "%5.1" /end CHARACTERISTIC
/begin CHARACTERISTIC DFC_CtlMsk2.DFC_ComFrbd_283h_DCDC_OUT_CURRENT_C "" VALUE 0x8024143C Val_Wu8 255.0 DFES_OneToOne 0.00 255.0 FORMAT "%5.1" /end CHARACTERISTIC
/begin CHARACTERISTIC DFC_CtlMsk2.DFC_ComFrbd_283h_DCDC_OUT_VOLTAGE_C "" VALUE 0x8024143D Val_Wu8 255.0 DFES_OneToOne 0.00 255.0 FORMAT "%5.1" /end CHARACTERISTIC
/begin CHARACTERISTIC DFC_CtlMsk2.DFC_ComFrbd_285h_HVBAT_REGEN_CHG_30S_CURRENT_LIMIT_C "" VALUE 0x8024143E Val_Wu8 255.0 DFES_OneToOne 0.00 255.0 FORMAT "%5.1" /end CHARACTERISTIC
/begin CHARACTERISTIC DFC_CtlMsk2.DFC_ComFrbd_285h_HVBAT_REGEN_CHRG_30S_POWER_LIMIT_C "" VALUE 0x8024143F Val_Wu8 255.0 DFES_OneToOne 0.00 255.0 FORMAT "%5.1" /end CHARACTERISTIC
/begin CHARACTERISTIC DFC_CtlMsk2.DFC_ComFrbd_293h_DCDC_outputpower_capability_C "" VALUE 0x80241440 Val_Wu8 255.0 DFES_OneToOne 0.00 255.0 FORMAT "%5.1" /end CHARACTERISTIC
/begin CHARACTERISTIC DFC_CtlMsk2.DFC_ComFrbd_325h_HVBAT_INSULATION_RESISTANCE_C "" VALUE 0x80241441 Val_Wu8 255.0 DFES_OneToOne 0.00 255.0 FORMAT "%5.1" /end CHARACTERISTIC
/begin CHARACTERISTIC DFC_CtlMsk2.DFC_ComFrbd_325h_HVBAT_TEMPERATURE_C "" VALUE 0x80241442 Val_Wu8 255.0 DFES_OneToOne 0.00 255.0 FORMAT "%5.1" /end CHARACTERISTIC
/begin CHARACTERISTIC DFC_CtlMsk2.DFC_ComFrbd_335h_HVBAT_CHRG_CONTINUOUS_CURR_MAX_C "" VALUE 0x80241443 Val_Wu8 255.0 DFES_OneToOne 0.00 255.0 FORMAT "%5.1" /end CHARACTERISTIC
/begin CHARACTERISTIC DFC_CtlMsk2.DFC_ComFrbd_335h_HVBAT_CHRG_COTINUOUS_CURR_REQ_C "" VALUE 0x80241444 Val_Wu8 255.0 DFES_OneToOne 0.00 255.0 FORMAT "%5.1" /end CHARACTERISTIC
/begin CHARACTERISTIC DFC_CtlMsk2.DFC_ComFrbd_335h_HVBAT_CHRG_MAX_VOLT_C "" VALUE 0x80241445 Val_Wu8 255.0 DFES_OneToOne 0.00 255.0 FORMAT "%5.1" /end CHARACTERISTIC
/begin CHARACTERISTIC DFC_CtlMsk2.DFC_ComFrbd_335h_HVBAT_DC_BUS_VOLTAGE_C "" VALUE 0x80241446 Val_Wu8 255.0 DFES_OneToOne 0.00 255.0 FORMAT "%5.1" /end CHARACTERISTIC
/begin CHARACTERISTIC DFC_CtlMsk2.DFC_ComFrbd_427h_INV_OP_MODE_C "" VALUE 0x80241447 Val_Wu8 255.0 DFES_OneToOne 0.00 255.0 FORMAT "%5.1" /end CHARACTERISTIC
/begin CHARACTERISTIC DFC_CtlMsk2.DFC_ComFrbd_427h_INV_PERMISIBLE_TORQUE_C "" VALUE 0x80241448 Val_Wu8 255.0 DFES_OneToOne 0.00 255.0 FORMAT "%5.1" /end CHARACTERISTIC
/begin CHARACTERISTIC DFC_CtlMsk2.DFC_ComFrbd_435h_HVBAT_MAX_CELL_VOLT_C "" VALUE 0x80241449 Val_Wu8 255.0 DFES_OneToOne 0.00 255.0 FORMAT "%5.1" /end CHARACTERISTIC
/begin CHARACTERISTIC DFC_CtlMsk2.DFC_ComFrbd_435h_HVBAT_MAX_CELL_VOLT_NUM_C "" VALUE 0x8024144A Val_Wu8 255.0 DFES_OneToOne 0.00 255.0 FORMAT "%5.1" /end CHARACTERISTIC
/begin CHARACTERISTIC DFC_CtlMsk2.DFC_ComFrbd_435h_HVBAT_MAX_SENSOR_TEMP_C "" VALUE 0x8024144B Val_Wu8 255.0 DFES_OneToOne 0.00 255.0 FORMAT "%5.1" /end CHARACTERISTIC
/begin CHARACTERISTIC DFC_CtlMsk2.DFC_ComFrbd_435h_HVBAT_MIN_CELL_VOLT_C "" VALUE 0x8024144C Val_Wu8 255.0 DFES_OneToOne 0.00 255.0 FORMAT "%5.1" /end CHARACTERISTIC
/begin CHARACTERISTIC DFC_CtlMsk2.DFC_ComFrbd_435h_HVBAT_MIN_CELL_VOLT_NUM_C "" VALUE 0x8024144D Val_Wu8 255.0 DFES_OneToOne 0.00 255.0 FORMAT "%5.1" /end CHARACTERISTIC
/begin CHARACTERISTIC DFC_CtlMsk2.DFC_ComFrbd_453h_OBC_IN_CURRENT_C "" VALUE 0x8024144E Val_Wu8 255.0 DFES_OneToOne 0.00 255.0 FORMAT "%5.1" /end CHARACTERISTIC
/begin CHARACTERISTIC DFC_CtlMsk2.DFC_ComFrbd_453h_OBC_IN_VOLTAGE_C "" VALUE 0x8024144F Val_Wu8 255.0 DFES_OneToOne 0.00 255.0 FORMAT "%5.1" /end CHARACTERISTIC
/begin CHARACTERISTIC DFC_CtlMsk2.DFC_ComFrbd_453h_OBC_IP_POWER_C "" VALUE 0x80241450 Val_Wu8 255.0 DFES_OneToOne 0.00 255.0 FORMAT "%5.1" /end CHARACTERISTIC
/begin CHARACTERISTIC DFC_CtlMsk2.DFC_ComFrbd_455h_HVBAT_NOMINAL_VOLTAGE_C "" VALUE 0x80241451 Val_Wu8 255.0 DFES_OneToOne 0.00 255.0 FORMAT "%5.1" /end CHARACTERISTIC
/begin CHARACTERISTIC DFC_CtlMsk2.DFC_ComFrbd_463h_OBC_OUT_CURRENT_C "" VALUE 0x80241452 Val_Wu8 255.0 DFES_OneToOne 0.00 255.0 FORMAT "%5.1" /end CHARACTERISTIC
/begin CHARACTERISTIC DFC_CtlMsk2.DFC_ComFrbd_463h_OBC_OUT_VOLTAGE_C "" VALUE 0x80241453 Val_Wu8 255.0 DFES_OneToOne 0.00 255.0 FORMAT "%5.1" /end CHARACTERISTIC
/begin CHARACTERISTIC DFC_CtlMsk2.DFC_ComFrbd_463h_OBC_TEMPERATURE_C "" VALUE 0x80241454 Val_Wu8 255.0 DFES_OneToOne 0.00 255.0 FORMAT "%5.1" /end CHARACTERISTIC
/begin CHARACTERISTIC DFC_CtlMsk2.DFC_ComFrbd_473h_DCDC_Coolant_Temperature_C "" VALUE 0x80241455 Val_Wu8 255.0 DFES_OneToOne 0.00 255.0 FORMAT "%5.1" /end CHARACTERISTIC
/begin CHARACTERISTIC DFC_CtlMsk2.DFC_ComFrbd_473h_DCDC_TEMPERATURE_C "" VALUE 0x80241456 Val_Wu8 255.0 DFES_OneToOne 0.00 255.0 FORMAT "%5.1" /end CHARACTERISTIC
/begin CHARACTERISTIC DFC_CtlMsk2.DFC_ComFrbd_47Bh_eCOMP_BusBarCurrent_C "" VALUE 0x80241457 Val_Wu8 255.0 DFES_OneToOne 0.00 255.0 FORMAT "%5.1" /end CHARACTERISTIC
/begin CHARACTERISTIC DFC_CtlMsk2.DFC_ComFrbd_47Bh_eCOMP_BusBarVoltage_C "" VALUE 0x80241458 Val_Wu8 255.0 DFES_OneToOne 0.00 255.0 FORMAT "%5.1" /end CHARACTERISTIC
/begin CHARACTERISTIC DFC_CtlMsk2.DFC_ComFrbd_47Bh_eCOMP_CompressorSpeed_C "" VALUE 0x80241459 Val_Wu8 255.0 DFES_OneToOne 0.00 255.0 FORMAT "%5.1" /end CHARACTERISTIC
/begin CHARACTERISTIC DFC_CtlMsk2.DFC_ComFrbd_47Bh_eCOMP_IGBT_Temp_C "" VALUE 0x8024145A Val_Wu8 255.0 DFES_OneToOne 0.00 255.0 FORMAT "%5.1" /end CHARACTERISTIC
/begin CHARACTERISTIC DFC_CtlMsk2.DFC_ComFrbd_47Bh_eCOMP_PeakPhaCurrent_C "" VALUE 0x8024145B Val_Wu8 255.0 DFES_OneToOne 0.00 255.0 FORMAT "%5.1" /end CHARACTERISTIC
/begin CHARACTERISTIC DFC_CtlMsk2.DFC_ComFrbd_47Bh_eCOMP_Power_consumption_C "" VALUE 0x8024145C Val_Wu8 255.0 DFES_OneToOne 0.00 255.0 FORMAT "%5.1" /end CHARACTERISTIC
/begin CHARACTERISTIC DFC_CtlMsk2.DFC_ComFrbd_48Bh_eCOMP_Fault_Level_C "" VALUE 0x8024145D Val_Wu8 255.0 DFES_OneToOne 0.00 255.0 FORMAT "%5.1" /end CHARACTERISTIC
/begin CHARACTERISTIC DFC_CtlMsk2.DFC_ComFrbd_4F2h_VALEUR_SOC_ETENDUE_C "" VALUE 0x8024145E Val_Wu8 255.0 DFES_OneToOne 0.00 255.0 FORMAT "%5.1" /end CHARACTERISTIC
/begin CHARACTERISTIC DFC_CtlMsk2.DFC_ComFrbd_535h_HV_BATT_TEMP_AVG_C "" VALUE 0x8024145F Val_Wu8 255.0 DFES_OneToOne 0.00 255.0 FORMAT "%5.1" /end CHARACTERISTIC
/begin CHARACTERISTIC DFC_CtlMsk2.DFC_ComFrbd_543h_HVBAT_RESTBATTENERGY_C "" VALUE 0x80241460 Val_Wu8 255.0 DFES_OneToOne 0.00 255.0 FORMAT "%5.1" /end CHARACTERISTIC
/begin CHARACTERISTIC DFC_CtlMsk2.DFC_ComFrbd_543h_HVBAT_SOH_C "" VALUE 0x80241461 Val_Wu8 255.0 DFES_OneToOne 0.00 255.0 FORMAT "%5.1" /end CHARACTERISTIC
/begin CHARACTERISTIC DFC_CtlMsk2.DFC_ComFrbd_543h_HV_BATT_SOH_RES_C "" VALUE 0x80241462 Val_Wu8 255.0 DFES_OneToOne 0.00 255.0 FORMAT "%5.1" /end CHARACTERISTIC
/begin CHARACTERISTIC DFC_CtlMsk2.DFC_ComFrbd_592h_IBATT_1_C "" VALUE 0x80241463 Val_Wu8 255.0 DFES_OneToOne 0.00 255.0 FORMAT "%5.1" /end CHARACTERISTIC
/begin CHARACTERISTIC DFC_CtlMsk2.DFC_ComFrbd_592h_IBATT_2_C "" VALUE 0x80241464 Val_Wu8 255.0 DFES_OneToOne 0.00 255.0 FORMAT "%5.1" /end CHARACTERISTIC
/begin CHARACTERISTIC DFC_CtlMsk2.DFC_ComFrbd_592h_IBATT_3_C "" VALUE 0x80241465 Val_Wu8 255.0 DFES_OneToOne 0.00 255.0 FORMAT "%5.1" /end CHARACTERISTIC
/begin CHARACTERISTIC DFC_CtlMsk2.DFC_ComFrbd_592h_TEMP_BATT_C "" VALUE 0x80241466 Val_Wu8 255.0 DFES_OneToOne 0.00 255.0 FORMAT "%5.1" /end CHARACTERISTIC
/begin CHARACTERISTIC DFC_CtlMsk2.DFC_ComFrbd_592h_U_BATT_BECB_C "" VALUE 0x80241467 Val_Wu8 255.0 DFES_OneToOne 0.00 255.0 FORMAT "%5.1" /end CHARACTERISTIC
/begin CHARACTERISTIC DFC_CtlMsk2.DFC_ComFrbd_595h_HVBAT_TIME_TO_CHRG_80_C "" VALUE 0x80241468 Val_Wu8 255.0 DFES_OneToOne 0.00 255.0 FORMAT "%5.1" /end CHARACTERISTIC
/begin CHARACTERISTIC DFC_CtlMsk2.DFC_ComFrbd_5B2h_TEMP_AIR_EXT_C "" VALUE 0x80241469 Val_Wu8 255.0 DFES_OneToOne 0.00 255.0 FORMAT "%5.1" /end CHARACTERISTIC
/begin CHARACTERISTIC DFC_CtlMsk2.DFC_ComFrbd_635h_HVBAT_NEG_CONT_COUNT_SEG1_C "" VALUE 0x8024146A Val_Wu8 255.0 DFES_OneToOne 0.00 255.0 FORMAT "%5.1" /end CHARACTERISTIC
/begin CHARACTERISTIC DFC_CtlMsk2.DFC_ComFrbd_635h_HVBAT_NEG_CONT_COUNT_SEG3_C "" VALUE 0x8024146B Val_Wu8 255.0 DFES_OneToOne 0.00 255.0 FORMAT "%5.1" /end CHARACTERISTIC
/begin CHARACTERISTIC DFC_CtlMsk2.DFC_ComFrbd_635h_HVBAT_NEG_CONT_COUNT_SEG4_C "" VALUE 0x8024146C Val_Wu8 255.0 DFES_OneToOne 0.00 255.0 FORMAT "%5.1" /end CHARACTERISTIC
/begin CHARACTERISTIC DFC_CtlMsk2.DFC_ComFrbd_635h_HVBAT_PST_CONT_COUNT_SEG1_C "" VALUE 0x8024146D Val_Wu8 255.0 DFES_OneToOne 0.00 255.0 FORMAT "%5.1" /end CHARACTERISTIC
/begin CHARACTERISTIC DFC_CtlMsk2.DFC_ComFrbd_635h_HVBAT_PST_CONT_COUNT_SEG3_C "" VALUE 0x8024146E Val_Wu8 255.0 DFES_OneToOne 0.00 255.0 FORMAT "%5.1" /end CHARACTERISTIC
/begin CHARACTERISTIC DFC_CtlMsk2.DFC_ComFrbd_635h_HVBAT_PST_CONT_COUNT_SEG4_C "" VALUE 0x8024146F Val_Wu8 255.0 DFES_OneToOne 0.00 255.0 FORMAT "%5.1" /end CHARACTERISTIC
/begin CHARACTERISTIC DFC_CtlMsk2.DFC_ComFrbd_645h_HVBAT_PRECHRGE_CONT_COUNT_SEG1_C "" VALUE 0x80241470 Val_Wu8 255.0 DFES_OneToOne 0.00 255.0 FORMAT "%5.1" /end CHARACTERISTIC
/begin CHARACTERISTIC DFC_CtlMsk2.DFC_ComFrbd_645h_HVBAT_PRECHRGE_CONT_COUNT_SEG2_C "" VALUE 0x80241471 Val_Wu8 255.0 DFES_OneToOne 0.00 255.0 FORMAT "%5.1" /end CHARACTERISTIC
/begin CHARACTERISTIC DFC_CtlMsk2.DFC_ComFrbd_675h_HVBAT_REMAININGBATTCAPACITY_C "" VALUE 0x80241472 Val_Wu8 255.0 DFES_OneToOne 0.00 255.0 FORMAT "%5.1" /end CHARACTERISTIC
/begin CHARACTERISTIC DFC_CtlMsk2.DFC_ComInvld_205h_HVBAT_CHARGING_STATUS_C "" VALUE 0x80241473 Val_Wu8 255.0 DFES_OneToOne 0.00 255.0 FORMAT "%5.1" /end CHARACTERISTIC
/begin CHARACTERISTIC DFC_CtlMsk2.DFC_ComInvld_205h_HVBAT_PACK_CURRENT_C "" VALUE 0x80241474 Val_Wu8 255.0 DFES_OneToOne 0.00 255.0 FORMAT "%5.1" /end CHARACTERISTIC
/begin CHARACTERISTIC DFC_CtlMsk2.DFC_ComInvld_205h_HVBAT_SOC_DISPLAY_C "" VALUE 0x80241475 Val_Wu8 255.0 DFES_OneToOne 0.00 255.0 FORMAT "%5.1" /end CHARACTERISTIC
/begin CHARACTERISTIC DFC_CtlMsk2.DFC_ComInvld_205h_HVBAT_VOLTAGE_C "" VALUE 0x80241476 Val_Wu8 255.0 DFES_OneToOne 0.00 255.0 FORMAT "%5.1" /end CHARACTERISTIC
/begin CHARACTERISTIC DFC_CtlMsk2.DFC_ComInvld_217h_INV_DC_BUS_VOLTAGE_C "" VALUE 0x80241477 Val_Wu8 255.0 DFES_OneToOne 0.00 255.0 FORMAT "%5.1" /end CHARACTERISTIC
/begin CHARACTERISTIC DFC_CtlMsk2.DFC_ComInvld_217h_INV_MTR_ACTUAL_TRQ_C "" VALUE 0x80241478 Val_Wu8 255.0 DFES_OneToOne 0.00 255.0 FORMAT "%5.1" /end CHARACTERISTIC
/begin CHARACTERISTIC DFC_CtlMsk2.DFC_ComInvld_217h_INV_MTR_SPEED_C "" VALUE 0x80241479 Val_Wu8 255.0 DFES_OneToOne 0.00 255.0 FORMAT "%5.1" /end CHARACTERISTIC
/begin CHARACTERISTIC DFC_CtlMsk2.DFC_ComInvld_217h_INV_MTR_TRQ_C "" VALUE 0x8024147A Val_Wu8 255.0 DFES_OneToOne 0.00 255.0 FORMAT "%5.1" /end CHARACTERISTIC
/begin CHARACTERISTIC DFC_CtlMsk2.DFC_ComInvld_227h_INV_DC_CURRENT_C "" VALUE 0x8024147B Val_Wu8 255.0 DFES_OneToOne 0.00 255.0 FORMAT "%5.1" /end CHARACTERISTIC
/begin CHARACTERISTIC DFC_CtlMsk2.DFC_ComInvld_227h_INV_MOTORING_PEAK_TRQ_C "" VALUE 0x8024147C Val_Wu8 255.0 DFES_OneToOne 0.00 255.0 FORMAT "%5.1" /end CHARACTERISTIC
/begin CHARACTERISTIC DFC_CtlMsk2.DFC_ComInvld_227h_INV_MTR_INST_INPUT_POWER_C "" VALUE 0x8024147D Val_Wu8 255.0 DFES_OneToOne 0.00 255.0 FORMAT "%5.1" /end CHARACTERISTIC
/begin CHARACTERISTIC DFC_CtlMsk2.DFC_ComInvld_227h_INV_REGEN_PEAK_TRQ_C "" VALUE 0x8024147E Val_Wu8 255.0 DFES_OneToOne 0.00 255.0 FORMAT "%5.1" /end CHARACTERISTIC
/begin CHARACTERISTIC DFC_CtlMsk2.DFC_ComInvld_237h_INV_ACTIVE_DISCHARGE_STATUS_C "" VALUE 0x8024147F Val_Wu8 255.0 DFES_OneToOne 0.00 255.0 FORMAT "%5.1" /end CHARACTERISTIC
/begin CHARACTERISTIC DFC_CtlMsk2.DFC_ComInvld_237h_INV_FAULT_LEVEL_C "" VALUE 0x80241480 Val_Wu8 255.0 DFES_OneToOne 0.00 255.0 FORMAT "%5.1" /end CHARACTERISTIC
/begin CHARACTERISTIC DFC_CtlMsk2.DFC_ComInvld_237h_INV_STAB_MIN_TRQ_C "" VALUE 0x80241481 Val_Wu8 255.0 DFES_OneToOne 0.00 255.0 FORMAT "%5.1" /end CHARACTERISTIC
/begin CHARACTERISTIC DFC_CtlMsk2.DFC_ComInvld_259h_TGLM_MODE_PUSH_C "" VALUE 0x80241482 Val_Wu8 255.0 DFES_OneToOne 0.00 255.0 FORMAT "%5.1" /end CHARACTERISTIC
/begin CHARACTERISTIC DFC_CtlMsk2.DFC_ComInvld_259h_TOGGLE_MONOSTABLE_POS_C "" VALUE 0x80241483 Val_Wu8 255.0 DFES_OneToOne 0.00 255.0 FORMAT "%5.1" /end CHARACTERISTIC
/begin CHARACTERISTIC DFC_CtlMsk2.DFC_ComInvld_26h_AC_SWITCH_REQ_C "" VALUE 0x80241484 Val_Wu8 255.0 DFES_OneToOne 0.00 255.0 FORMAT "%5.1" /end CHARACTERISTIC
/begin CHARACTERISTIC DFC_CtlMsk2.DFC_ComInvld_26h_BLOWER_POSITION_C "" VALUE 0x80241485 Val_Wu8 255.0 DFES_OneToOne 0.00 255.0 FORMAT "%5.1" /end CHARACTERISTIC
/begin CHARACTERISTIC DFC_CtlMsk2.DFC_ComInvld_26h_EVAP_SENSOR_FAULT_C "" VALUE 0x80241486 Val_Wu8 255.0 DFES_OneToOne 0.00 255.0 FORMAT "%5.1" /end CHARACTERISTIC
/begin CHARACTERISTIC DFC_CtlMsk2.DFC_ComInvld_26h_EVAP_SENSOR_VALUE_C "" VALUE 0x80241487 Val_Wu8 255.0 DFES_OneToOne 0.00 255.0 FORMAT "%5.1" /end CHARACTERISTIC
/begin CHARACTERISTIC DFC_CtlMsk2.DFC_ComInvld_26h_POTENTIOMETER_FAULT_C "" VALUE 0x80241488 Val_Wu8 255.0 DFES_OneToOne 0.00 255.0 FORMAT "%5.1" /end CHARACTERISTIC
/begin CHARACTERISTIC DFC_CtlMsk2.DFC_ComInvld_26h_REAR_DEFOG_REQ_C "" VALUE 0x80241489 Val_Wu8 255.0 DFES_OneToOne 0.00 255.0 FORMAT "%5.1" /end CHARACTERISTIC
/begin CHARACTERISTIC DFC_CtlMsk2.DFC_ComInvld_26h_TEMP_POSITION_C "" VALUE 0x8024148A Val_Wu8 255.0 DFES_OneToOne 0.00 255.0 FORMAT "%5.1" /end CHARACTERISTIC
/begin CHARACTERISTIC DFC_CtlMsk2.DFC_ComInvld_273h_OBC_FAULT_LEVEL_C "" VALUE 0x8024148B Val_Wu8 255.0 DFES_OneToOne 0.00 255.0 FORMAT "%5.1" /end CHARACTERISTIC
/begin CHARACTERISTIC DFC_CtlMsk2.DFC_ComInvld_273h_OBC_outputpower_capability_C "" VALUE 0x8024148C Val_Wu8 255.0 DFES_OneToOne 0.00 255.0 FORMAT "%5.1" /end CHARACTERISTIC
/begin CHARACTERISTIC DFC_CtlMsk2.DFC_ComInvld_275h_HVBAT_DISCHARGE_30S_AVAILABLE_CURRENT_C "" VALUE 0x8024148D Val_Wu8 255.0 DFES_OneToOne 0.00 255.0 FORMAT "%5.1" /end CHARACTERISTIC
/begin CHARACTERISTIC DFC_CtlMsk2.DFC_ComInvld_275h_HVBAT_DISCHARGE_30S_AVAILABLE_POWER_C "" VALUE 0x8024148E Val_Wu8 255.0 DFES_OneToOne 0.00 255.0 FORMAT "%5.1" /end CHARACTERISTIC
/begin CHARACTERISTIC DFC_CtlMsk2.DFC_ComInvld_283h_DCDC_IN_CURRENT_C "" VALUE 0x8024148F Val_Wu8 255.0 DFES_OneToOne 0.00 255.0 FORMAT "%5.1" /end CHARACTERISTIC
/begin CHARACTERISTIC DFC_CtlMsk2.DFC_ComInvld_283h_DCDC_IN_VOLTAGE_C "" VALUE 0x80241490 Val_Wu8 255.0 DFES_OneToOne 0.00 255.0 FORMAT "%5.1" /end CHARACTERISTIC
/begin CHARACTERISTIC DFC_CtlMsk2.DFC_ComInvld_283h_DCDC_OUT_CURRENT_C "" VALUE 0x80241491 Val_Wu8 255.0 DFES_OneToOne 0.00 255.0 FORMAT "%5.1" /end CHARACTERISTIC
/begin CHARACTERISTIC DFC_CtlMsk2.DFC_ComInvld_283h_DCDC_OUT_VOLTAGE_C "" VALUE 0x80241492 Val_Wu8 255.0 DFES_OneToOne 0.00 255.0 FORMAT "%5.1" /end CHARACTERISTIC
/begin CHARACTERISTIC DFC_CtlMsk2.DFC_ComInvld_285h_HVBAT_REGEN_CHG_30S_CURRENT_LIMIT_C "" VALUE 0x80241493 Val_Wu8 255.0 DFES_OneToOne 0.00 255.0 FORMAT "%5.1" /end CHARACTERISTIC
/begin CHARACTERISTIC DFC_CtlMsk2.DFC_ComInvld_285h_HVBAT_REGEN_CHRG_30S_POWER_LIMIT_C "" VALUE 0x80241494 Val_Wu8 255.0 DFES_OneToOne 0.00 255.0 FORMAT "%5.1" /end CHARACTERISTIC
/begin CHARACTERISTIC DFC_CtlMsk2.DFC_ComInvld_293h_DCDC_FAULT_LEVEL_C "" VALUE 0x80241495 Val_Wu8 255.0 DFES_OneToOne 0.00 255.0 FORMAT "%5.1" /end CHARACTERISTIC
/begin CHARACTERISTIC DFC_CtlMsk2.DFC_ComInvld_293h_DCDC_outputpower_capability_C "" VALUE 0x80241496 Val_Wu8 255.0 DFES_OneToOne 0.00 255.0 FORMAT "%5.1" /end CHARACTERISTIC
/begin CHARACTERISTIC DFC_CtlMsk2.DFC_ComInvld_325h_HVBAT_EPLUG_STATUS_C "" VALUE 0x80241497 Val_Wu8 255.0 DFES_OneToOne 0.00 255.0 FORMAT "%5.1" /end CHARACTERISTIC
/begin CHARACTERISTIC DFC_CtlMsk2.DFC_ComInvld_325h_HVBAT_HVIL_STS_C "" VALUE 0x80241498 Val_Wu8 255.0 DFES_OneToOne 0.00 255.0 FORMAT "%5.1" /end CHARACTERISTIC
/begin CHARACTERISTIC DFC_CtlMsk2.DFC_ComInvld_325h_HVBAT_INSULATION_FAULT_C "" VALUE 0x80241499 Val_Wu8 255.0 DFES_OneToOne 0.00 255.0 FORMAT "%5.1" /end CHARACTERISTIC
/begin CHARACTERISTIC DFC_CtlMsk2.DFC_ComInvld_325h_HVBAT_INSULATION_RESISTANCE_C "" VALUE 0x8024149A Val_Wu8 255.0 DFES_OneToOne 0.00 255.0 FORMAT "%5.1" /end CHARACTERISTIC
/begin CHARACTERISTIC DFC_CtlMsk2.DFC_ComInvld_325h_HVBAT_TEMPERATURE_C "" VALUE 0x8024149B Val_Wu8 255.0 DFES_OneToOne 0.00 255.0 FORMAT "%5.1" /end CHARACTERISTIC
/begin CHARACTERISTIC DFC_CtlMsk2.DFC_ComInvld_335h_HVBAT_CHRG_CONTINUOUS_CURR_MAX_C "" VALUE 0x8024149C Val_Wu8 255.0 DFES_OneToOne 0.00 255.0 FORMAT "%5.1" /end CHARACTERISTIC
/begin CHARACTERISTIC DFC_CtlMsk2.DFC_ComInvld_335h_HVBAT_CHRG_COTINUOUS_CURR_REQ_C "" VALUE 0x8024149D Val_Wu8 255.0 DFES_OneToOne 0.00 255.0 FORMAT "%5.1" /end CHARACTERISTIC
/begin CHARACTERISTIC DFC_CtlMsk2.DFC_ComInvld_335h_HVBAT_CHRG_MAX_VOLT_C "" VALUE 0x8024149E Val_Wu8 255.0 DFES_OneToOne 0.00 255.0 FORMAT "%5.1" /end CHARACTERISTIC
/begin CHARACTERISTIC DFC_CtlMsk2.DFC_ComInvld_335h_HVBAT_DC_BUS_VOLTAGE_C "" VALUE 0x8024149F Val_Wu8 255.0 DFES_OneToOne 0.00 255.0 FORMAT "%5.1" /end CHARACTERISTIC
/begin CHARACTERISTIC DFC_CtlMsk2.DFC_ComInvld_38Dh_VITESSE_VEHICULE_ROUES_C "" VALUE 0x802414A0 Val_Wu8 255.0 DFES_OneToOne 0.00 255.0 FORMAT "%5.1" /end CHARACTERISTIC
/begin CHARACTERISTIC DFC_CtlMsk2.DFC_ComInvld_38Dh_VVH_INDISP_C "" VALUE 0x802414A1 Val_Wu8 255.0 DFES_OneToOne 0.00 255.0 FORMAT "%5.1" /end CHARACTERISTIC
/begin CHARACTERISTIC DFC_CtlMsk2.DFC_ComInvld_427h_INV_COOLANT_TEMP_C "" VALUE 0x802414A2 Val_Wu8 255.0 DFES_OneToOne 0.00 255.0 FORMAT "%5.1" /end CHARACTERISTIC
/begin CHARACTERISTIC DFC_CtlMsk2.DFC_ComInvld_427h_INV_MOTOR_TEMP_C "" VALUE 0x802414A3 Val_Wu8 255.0 DFES_OneToOne 0.00 255.0 FORMAT "%5.1" /end CHARACTERISTIC
/begin CHARACTERISTIC DFC_CtlMsk2.DFC_ComInvld_427h_INV_OP_MODE_C "" VALUE 0x802414A4 Val_Wu8 255.0 DFES_OneToOne 0.00 255.0 FORMAT "%5.1" /end CHARACTERISTIC
/begin CHARACTERISTIC DFC_CtlMsk2.DFC_ComInvld_427h_INV_PERMISIBLE_TORQUE_C "" VALUE 0x802414A5 Val_Wu8 255.0 DFES_OneToOne 0.00 255.0 FORMAT "%5.1" /end CHARACTERISTIC
/begin CHARACTERISTIC DFC_CtlMsk2.DFC_ComInvld_427h_INV_TEMP_C "" VALUE 0x802414A6 Val_Wu8 255.0 DFES_OneToOne 0.00 255.0 FORMAT "%5.1" /end CHARACTERISTIC
/begin CHARACTERISTIC DFC_CtlMsk2.DFC_ComInvld_432h_REVEIL_PRINCIPAL_C "" VALUE 0x802414A7 Val_Wu8 255.0 DFES_OneToOne 0.00 255.0 FORMAT "%5.1" /end CHARACTERISTIC
/begin CHARACTERISTIC DFC_CtlMsk2.DFC_ComInvld_435h_HVBAT_MAX_CELL_VOLT_C "" VALUE 0x802414A8 Val_Wu8 255.0 DFES_OneToOne 0.00 255.0 FORMAT "%5.1" /end CHARACTERISTIC
/begin CHARACTERISTIC DFC_CtlMsk2.DFC_ComInvld_435h_HVBAT_MAX_CELL_VOLT_NUM_C "" VALUE 0x802414A9 Val_Wu8 255.0 DFES_OneToOne 0.00 255.0 FORMAT "%5.1" /end CHARACTERISTIC
/begin CHARACTERISTIC DFC_CtlMsk2.DFC_ComInvld_435h_HVBAT_MAX_SENSOR_TEMP_C "" VALUE 0x802414AA Val_Wu8 255.0 DFES_OneToOne 0.00 255.0 FORMAT "%5.1" /end CHARACTERISTIC
/begin CHARACTERISTIC DFC_CtlMsk2.DFC_ComInvld_435h_HVBAT_MIN_CELL_VOLT_C "" VALUE 0x802414AB Val_Wu8 255.0 DFES_OneToOne 0.00 255.0 FORMAT "%5.1" /end CHARACTERISTIC
/begin CHARACTERISTIC DFC_CtlMsk2.DFC_ComInvld_435h_HVBAT_MIN_CELL_VOLT_NUM_C "" VALUE 0x802414AC Val_Wu8 255.0 DFES_OneToOne 0.00 255.0 FORMAT "%5.1" /end CHARACTERISTIC
/begin CHARACTERISTIC DFC_CtlMsk2.DFC_ComInvld_442h_BCCM_BLOWER_RELAY_STS_C "" VALUE 0x802414AD Val_Wu8 255.0 DFES_OneToOne 0.00 255.0 FORMAT "%5.1" /end CHARACTERISTIC
/begin CHARACTERISTIC DFC_CtlMsk2.DFC_ComInvld_453h_OBC_IN_CURRENT_C "" VALUE 0x802414AE Val_Wu8 255.0 DFES_OneToOne 0.00 255.0 FORMAT "%5.1" /end CHARACTERISTIC
/begin CHARACTERISTIC DFC_CtlMsk2.DFC_ComInvld_453h_OBC_IN_VOLTAGE_C "" VALUE 0x802414AF Val_Wu8 255.0 DFES_OneToOne 0.00 255.0 FORMAT "%5.1" /end CHARACTERISTIC
/begin CHARACTERISTIC DFC_CtlMsk2.DFC_ComInvld_453h_OBC_IP_POWER_C "" VALUE 0x802414B0 Val_Wu8 255.0 DFES_OneToOne 0.00 255.0 FORMAT "%5.1" /end CHARACTERISTIC
/begin CHARACTERISTIC DFC_CtlMsk2.DFC_ComInvld_455h_HVBAT_NOMINAL_VOLTAGE_C "" VALUE 0x802414B1 Val_Wu8 255.0 DFES_OneToOne 0.00 255.0 FORMAT "%5.1" /end CHARACTERISTIC
/begin CHARACTERISTIC DFC_CtlMsk2.DFC_ComInvld_463h_OBC_OUT_CURRENT_C "" VALUE 0x802414B2 Val_Wu8 255.0 DFES_OneToOne 0.00 255.0 FORMAT "%5.1" /end CHARACTERISTIC
/begin CHARACTERISTIC DFC_CtlMsk2.DFC_ComInvld_463h_OBC_OUT_VOLTAGE_C "" VALUE 0x802414B3 Val_Wu8 255.0 DFES_OneToOne 0.00 255.0 FORMAT "%5.1" /end CHARACTERISTIC
/begin CHARACTERISTIC DFC_CtlMsk2.DFC_ComInvld_463h_OBC_TEMPERATURE_C "" VALUE 0x802414B4 Val_Wu8 255.0 DFES_OneToOne 0.00 255.0 FORMAT "%5.1" /end CHARACTERISTIC
/begin CHARACTERISTIC DFC_CtlMsk2.DFC_ComInvld_473h_DCDC_Coolant_Temperature_C "" VALUE 0x802414B5 Val_Wu8 255.0 DFES_OneToOne 0.00 255.0 FORMAT "%5.1" /end CHARACTERISTIC
/begin CHARACTERISTIC DFC_CtlMsk2.DFC_ComInvld_473h_DCDC_TEMPERATURE_C "" VALUE 0x802414B6 Val_Wu8 255.0 DFES_OneToOne 0.00 255.0 FORMAT "%5.1" /end CHARACTERISTIC
/begin CHARACTERISTIC DFC_CtlMsk2.DFC_ComInvld_47Bh_eCOMP_BusBarCurrent_C "" VALUE 0x802414B7 Val_Wu8 255.0 DFES_OneToOne 0.00 255.0 FORMAT "%5.1" /end CHARACTERISTIC
/begin CHARACTERISTIC DFC_CtlMsk2.DFC_ComInvld_47Bh_eCOMP_BusBarVoltage_C "" VALUE 0x802414B8 Val_Wu8 255.0 DFES_OneToOne 0.00 255.0 FORMAT "%5.1" /end CHARACTERISTIC
/begin CHARACTERISTIC DFC_CtlMsk2.DFC_ComInvld_47Bh_eCOMP_CompressorSpeed_C "" VALUE 0x802414B9 Val_Wu8 255.0 DFES_OneToOne 0.00 255.0 FORMAT "%5.1" /end CHARACTERISTIC
/begin CHARACTERISTIC DFC_CtlMsk2.DFC_ComInvld_47Bh_eCOMP_IGBT_Temp_C "" VALUE 0x802414BA Val_Wu8 255.0 DFES_OneToOne 0.00 255.0 FORMAT "%5.1" /end CHARACTERISTIC
/begin CHARACTERISTIC DFC_CtlMsk2.DFC_ComInvld_47Bh_eCOMP_PeakPhaCurrent_C "" VALUE 0x802414BB Val_Wu8 255.0 DFES_OneToOne 0.00 255.0 FORMAT "%5.1" /end CHARACTERISTIC
/begin CHARACTERISTIC DFC_CtlMsk2.DFC_ComInvld_47Bh_eCOMP_Power_consumption_C "" VALUE 0x802414BC Val_Wu8 255.0 DFES_OneToOne 0.00 255.0 FORMAT "%5.1" /end CHARACTERISTIC
/begin CHARACTERISTIC DFC_CtlMsk2.DFC_ComInvld_4F2h_STATUS_SOC_C "" VALUE 0x802414BD Val_Wu8 255.0 DFES_OneToOne 0.00 255.0 FORMAT "%5.1" /end CHARACTERISTIC
/begin CHARACTERISTIC DFC_CtlMsk2.DFC_ComInvld_4F2h_TEMP_BATT_STATUS_C "" VALUE 0x802414BE Val_Wu8 255.0 DFES_OneToOne 0.00 255.0 FORMAT "%5.1" /end CHARACTERISTIC
/begin CHARACTERISTIC DFC_CtlMsk2.DFC_ComInvld_4F2h_VALEUR_SOC_ETENDUE_C "" VALUE 0x802414BF Val_Wu8 255.0 DFES_OneToOne 0.00 255.0 FORMAT "%5.1" /end CHARACTERISTIC
/begin CHARACTERISTIC DFC_CtlMsk2.DFC_ComInvld_535h_HV_BATT_TEMP_AVG_C "" VALUE 0x802414C0 Val_Wu8 255.0 DFES_OneToOne 0.00 255.0 FORMAT "%5.1" /end CHARACTERISTIC
/begin CHARACTERISTIC DFC_CtlMsk2.DFC_ComInvld_543h_HVBAT_RESTBATTENERGY_C "" VALUE 0x802414C1 Val_Wu8 255.0 DFES_OneToOne 0.00 255.0 FORMAT "%5.1" /end CHARACTERISTIC
/begin CHARACTERISTIC DFC_CtlMsk2.DFC_ComInvld_543h_HVBAT_SOH_C "" VALUE 0x802414C2 Val_Wu8 255.0 DFES_OneToOne 0.00 255.0 FORMAT "%5.1" /end CHARACTERISTIC
/begin CHARACTERISTIC DFC_CtlMsk2.DFC_ComInvld_543h_HV_BATT_SOH_RES_C "" VALUE 0x802414C3 Val_Wu8 255.0 DFES_OneToOne 0.00 255.0 FORMAT "%5.1" /end CHARACTERISTIC
/begin CHARACTERISTIC DFC_CtlMsk2.DFC_ComInvld_552h_CPT_TEMPOREL_C "" VALUE 0x802414C4 Val_Wu8 255.0 DFES_OneToOne 0.00 255.0 FORMAT "%5.1" /end CHARACTERISTIC
/begin CHARACTERISTIC DFC_CtlMsk2.DFC_ComInvld_552h_KILOMETRAGE_C "" VALUE 0x802414C5 Val_Wu8 255.0 DFES_OneToOne 0.00 255.0 FORMAT "%5.1" /end CHARACTERISTIC
/begin CHARACTERISTIC DFC_CtlMsk2.DFC_ComInvld_583h_HV_BATT_DISCONT_CSE_OPEN_C "" VALUE 0x802414C6 Val_Wu8 255.0 DFES_OneToOne 0.00 255.0 FORMAT "%5.1" /end CHARACTERISTIC
/begin CHARACTERISTIC DFC_CtlMsk2.DFC_ComInvld_592h_CALIBRE_IBATT_C "" VALUE 0x802414C7 Val_Wu8 255.0 DFES_OneToOne 0.00 255.0 FORMAT "%5.1" /end CHARACTERISTIC
/begin CHARACTERISTIC DFC_CtlMsk2.DFC_ComInvld_592h_IBATT_1_C "" VALUE 0x802414C8 Val_Wu8 255.0 DFES_OneToOne 0.00 255.0 FORMAT "%5.1" /end CHARACTERISTIC
/begin CHARACTERISTIC DFC_CtlMsk2.DFC_ComInvld_592h_IBATT_2_C "" VALUE 0x802414C9 Val_Wu8 255.0 DFES_OneToOne 0.00 255.0 FORMAT "%5.1" /end CHARACTERISTIC
/begin CHARACTERISTIC DFC_CtlMsk2.DFC_ComInvld_592h_IBATT_3_C "" VALUE 0x802414CA Val_Wu8 255.0 DFES_OneToOne 0.00 255.0 FORMAT "%5.1" /end CHARACTERISTIC
/begin CHARACTERISTIC DFC_CtlMsk2.DFC_ComInvld_592h_TEMP_BATT_C "" VALUE 0x802414CB Val_Wu8 255.0 DFES_OneToOne 0.00 255.0 FORMAT "%5.1" /end CHARACTERISTIC
/begin CHARACTERISTIC DFC_CtlMsk2.DFC_ComInvld_592h_U_BATT_BECB_C "" VALUE 0x802414CC Val_Wu8 255.0 DFES_OneToOne 0.00 255.0 FORMAT "%5.1" /end CHARACTERISTIC
/begin CHARACTERISTIC DFC_CtlMsk2.DFC_ComInvld_595h_HVBAT_TIME_TO_CHRG_80_C "" VALUE 0x802414CD Val_Wu8 255.0 DFES_OneToOne 0.00 255.0 FORMAT "%5.1" /end CHARACTERISTIC
/begin CHARACTERISTIC DFC_CtlMsk2.DFC_ComInvld_5B2h_TEMP_AIR_EXT_C "" VALUE 0x802414CE Val_Wu8 255.0 DFES_OneToOne 0.00 255.0 FORMAT "%5.1" /end CHARACTERISTIC
/begin CHARACTERISTIC DFC_CtlMsk2.DFC_ComInvld_5B5h_HVBAT_THERMAL_RUNAWAY_C "" VALUE 0x802414CF Val_Wu8 255.0 DFES_OneToOne 0.00 255.0 FORMAT "%5.1" /end CHARACTERISTIC
/begin CHARACTERISTIC DFC_CtlMsk2.DFC_ComInvld_635h_HVBAT_NEG_CONT_COUNT_SEG1_C "" VALUE 0x802414D0 Val_Wu8 255.0 DFES_OneToOne 0.00 255.0 FORMAT "%5.1" /end CHARACTERISTIC
/begin CHARACTERISTIC DFC_CtlMsk2.DFC_ComInvld_635h_HVBAT_NEG_CONT_COUNT_SEG3_C "" VALUE 0x802414D1 Val_Wu8 255.0 DFES_OneToOne 0.00 255.0 FORMAT "%5.1" /end CHARACTERISTIC
/begin CHARACTERISTIC DFC_CtlMsk2.DFC_ComInvld_635h_HVBAT_NEG_CONT_COUNT_SEG4_C "" VALUE 0x802414D2 Val_Wu8 255.0 DFES_OneToOne 0.00 255.0 FORMAT "%5.1" /end CHARACTERISTIC
/begin CHARACTERISTIC DFC_CtlMsk2.DFC_ComInvld_635h_HVBAT_PST_CONT_COUNT_SEG1_C "" VALUE 0x802414D3 Val_Wu8 255.0 DFES_OneToOne 0.00 255.0 FORMAT "%5.1" /end CHARACTERISTIC
/begin CHARACTERISTIC DFC_CtlMsk2.DFC_ComInvld_635h_HVBAT_PST_CONT_COUNT_SEG3_C "" VALUE 0x802414D4 Val_Wu8 255.0 DFES_OneToOne 0.00 255.0 FORMAT "%5.1" /end CHARACTERISTIC
/begin CHARACTERISTIC DFC_CtlMsk2.DFC_ComInvld_635h_HVBAT_PST_CONT_COUNT_SEG4_C "" VALUE 0x802414D5 Val_Wu8 255.0 DFES_OneToOne 0.00 255.0 FORMAT "%5.1" /end CHARACTERISTIC
/begin CHARACTERISTIC DFC_CtlMsk2.DFC_ComInvld_645h_HVBAT_PRECHRGE_CONT_COUNT_SEG1_C "" VALUE 0x802414D6 Val_Wu8 255.0 DFES_OneToOne 0.00 255.0 FORMAT "%5.1" /end CHARACTERISTIC
/begin CHARACTERISTIC DFC_CtlMsk2.DFC_ComInvld_645h_HVBAT_PRECHRGE_CONT_COUNT_SEG2_C "" VALUE 0x802414D7 Val_Wu8 255.0 DFES_OneToOne 0.00 255.0 FORMAT "%5.1" /end CHARACTERISTIC
/begin CHARACTERISTIC DFC_CtlMsk2.DFC_ComInvld_675h_HVBAT_REMAININGBATTCAPACITY_C "" VALUE 0x802414D8 Val_Wu8 255.0 DFES_OneToOne 0.00 255.0 FORMAT "%5.1" /end CHARACTERISTIC
/begin CHARACTERISTIC DFC_DisblMsk2.DFC_Com082hTooShort_C "" VALUE 0x80248C2A Val_Wu16 65535.00 DFES_OneToOne 0.00 65535.00 FORMAT "%8.2" /end CHARACTERISTIC
/begin CHARACTERISTIC DFC_DisblMsk2.DFC_Com092hTooShort_C "" VALUE 0x80248C2C Val_Wu16 65535.00 DFES_OneToOne 0.00 65535.00 FORMAT "%8.2" /end CHARACTERISTIC
/begin CHARACTERISTIC DFC_DisblMsk2.DFC_Com205hAbsent_C "" VALUE 0x80248C2E Val_Wu16 65535.00 DFES_OneToOne 0.00 65535.00 FORMAT "%8.2" /end CHARACTERISTIC
/begin CHARACTERISTIC DFC_DisblMsk2.DFC_Com205hChecksum_C "" VALUE 0x80248C30 Val_Wu16 65535.00 DFES_OneToOne 0.00 65535.00 FORMAT "%8.2" /end CHARACTERISTIC
/begin CHARACTERISTIC DFC_DisblMsk2.DFC_Com205hCounter_C "" VALUE 0x80248C32 Val_Wu16 65535.00 DFES_OneToOne 0.00 65535.00 FORMAT "%8.2" /end CHARACTERISTIC
/begin CHARACTERISTIC DFC_DisblMsk2.DFC_Com205hTooShort_C "" VALUE 0x80248C34 Val_Wu16 65535.00 DFES_OneToOne 0.00 65535.00 FORMAT "%8.2" /end CHARACTERISTIC
/begin CHARACTERISTIC DFC_DisblMsk2.DFC_Com217hAbsent_C "" VALUE 0x80248C36 Val_Wu16 65535.00 DFES_OneToOne 0.00 65535.00 FORMAT "%8.2" /end CHARACTERISTIC
/begin CHARACTERISTIC DFC_DisblMsk2.DFC_Com217hChecksum_C "" VALUE 0x80248C38 Val_Wu16 65535.00 DFES_OneToOne 0.00 65535.00 FORMAT "%8.2" /end CHARACTERISTIC
/begin CHARACTERISTIC DFC_DisblMsk2.DFC_Com217hCounter_C "" VALUE 0x80248C3A Val_Wu16 65535.00 DFES_OneToOne 0.00 65535.00 FORMAT "%8.2" /end CHARACTERISTIC
/begin CHARACTERISTIC DFC_DisblMsk2.DFC_Com217hTooShort_C "" VALUE 0x80248C3C Val_Wu16 65535.00 DFES_OneToOne 0.00 65535.00 FORMAT "%8.2" /end CHARACTERISTIC
/begin CHARACTERISTIC DFC_DisblMsk2.DFC_Com227hAbsent_C "" VALUE 0x80248C3E Val_Wu16 65535.00 DFES_OneToOne 0.00 65535.00 FORMAT "%8.2" /end CHARACTERISTIC
/begin CHARACTERISTIC DFC_DisblMsk2.DFC_Com227hTooShort_C "" VALUE 0x80248C40 Val_Wu16 65535.00 DFES_OneToOne 0.00 65535.00 FORMAT "%8.2" /end CHARACTERISTIC
/begin CHARACTERISTIC DFC_DisblMsk2.DFC_Com237hAbsent_C "" VALUE 0x80248C42 Val_Wu16 65535.00 DFES_OneToOne 0.00 65535.00 FORMAT "%8.2" /end CHARACTERISTIC
/begin CHARACTERISTIC DFC_DisblMsk2.DFC_Com237hChecksum_C "" VALUE 0x80248C44 Val_Wu16 65535.00 DFES_OneToOne 0.00 65535.00 FORMAT "%8.2" /end CHARACTERISTIC
/begin CHARACTERISTIC DFC_DisblMsk2.DFC_Com237hCounter_C "" VALUE 0x80248C46 Val_Wu16 65535.00 DFES_OneToOne 0.00 65535.00 FORMAT "%8.2" /end CHARACTERISTIC
/begin CHARACTERISTIC DFC_DisblMsk2.DFC_Com237hTooShort_C "" VALUE 0x80248C48 Val_Wu16 65535.00 DFES_OneToOne 0.00 65535.00 FORMAT "%8.2" /end CHARACTERISTIC
/begin CHARACTERISTIC DFC_DisblMsk2.DFC_Com259hAbsent_C "" VALUE 0x80248C4A Val_Wu16 65535.00 DFES_OneToOne 0.00 65535.00 FORMAT "%8.2" /end CHARACTERISTIC
/begin CHARACTERISTIC DFC_DisblMsk2.DFC_Com259hChecksum_C "" VALUE 0x80248C4C Val_Wu16 65535.00 DFES_OneToOne 0.00 65535.00 FORMAT "%8.2" /end CHARACTERISTIC
/begin CHARACTERISTIC DFC_DisblMsk2.DFC_Com259hCounter_C "" VALUE 0x80248C4E Val_Wu16 65535.00 DFES_OneToOne 0.00 65535.00 FORMAT "%8.2" /end CHARACTERISTIC
/begin CHARACTERISTIC DFC_DisblMsk2.DFC_Com259hTooShort_C "" VALUE 0x80248C50 Val_Wu16 65535.00 DFES_OneToOne 0.00 65535.00 FORMAT "%8.2" /end CHARACTERISTIC
/begin CHARACTERISTIC DFC_DisblMsk2.DFC_Com26hAbsent_C "" VALUE 0x80248C52 Val_Wu16 65535.00 DFES_OneToOne 0.00 65535.00 FORMAT "%8.2" /end CHARACTERISTIC
/begin CHARACTERISTIC DFC_DisblMsk2.DFC_Com26hTooShort_C "" VALUE 0x80248C54 Val_Wu16 65535.00 DFES_OneToOne 0.00 65535.00 FORMAT "%8.2" /end CHARACTERISTIC
/begin CHARACTERISTIC DFC_DisblMsk2.DFC_Com273hAbsent_C "" VALUE 0x80248C56 Val_Wu16 65535.00 DFES_OneToOne 0.00 65535.00 FORMAT "%8.2" /end CHARACTERISTIC
/begin CHARACTERISTIC DFC_DisblMsk2.DFC_Com273hChecksum_C "" VALUE 0x80248C58 Val_Wu16 65535.00 DFES_OneToOne 0.00 65535.00 FORMAT "%8.2" /end CHARACTERISTIC
/begin CHARACTERISTIC DFC_DisblMsk2.DFC_Com273hCounter_C "" VALUE 0x80248C5A Val_Wu16 65535.00 DFES_OneToOne 0.00 65535.00 FORMAT "%8.2" /end CHARACTERISTIC
/begin CHARACTERISTIC DFC_DisblMsk2.DFC_Com273hTooShort_C "" VALUE 0x80248C5C Val_Wu16 65535.00 DFES_OneToOne 0.00 65535.00 FORMAT "%8.2" /end CHARACTERISTIC
/begin CHARACTERISTIC DFC_DisblMsk2.DFC_Com275hAbsent_C "" VALUE 0x80248C5E Val_Wu16 65535.00 DFES_OneToOne 0.00 65535.00 FORMAT "%8.2" /end CHARACTERISTIC
/begin CHARACTERISTIC DFC_DisblMsk2.DFC_Com275hChecksum_C "" VALUE 0x80248C60 Val_Wu16 65535.00 DFES_OneToOne 0.00 65535.00 FORMAT "%8.2" /end CHARACTERISTIC
/begin CHARACTERISTIC DFC_DisblMsk2.DFC_Com275hCounter_C "" VALUE 0x80248C62 Val_Wu16 65535.00 DFES_OneToOne 0.00 65535.00 FORMAT "%8.2" /end CHARACTERISTIC
/begin CHARACTERISTIC DFC_DisblMsk2.DFC_Com275hTooShort_C "" VALUE 0x80248C64 Val_Wu16 65535.00 DFES_OneToOne 0.00 65535.00 FORMAT "%8.2" /end CHARACTERISTIC
/begin CHARACTERISTIC DFC_DisblMsk2.DFC_Com283hAbsent_C "" VALUE 0x80248C66 Val_Wu16 65535.00 DFES_OneToOne 0.00 65535.00 FORMAT "%8.2" /end CHARACTERISTIC
/begin CHARACTERISTIC DFC_DisblMsk2.DFC_Com283hTooShort_C "" VALUE 0x80248C68 Val_Wu16 65535.00 DFES_OneToOne 0.00 65535.00 FORMAT "%8.2" /end CHARACTERISTIC
/begin CHARACTERISTIC DFC_DisblMsk2.DFC_Com285hAbsent_C "" VALUE 0x80248C6A Val_Wu16 65535.00 DFES_OneToOne 0.00 65535.00 FORMAT "%8.2" /end CHARACTERISTIC
/begin CHARACTERISTIC DFC_DisblMsk2.DFC_Com285hChecksum_C "" VALUE 0x80248C6C Val_Wu16 65535.00 DFES_OneToOne 0.00 65535.00 FORMAT "%8.2" /end CHARACTERISTIC
/begin CHARACTERISTIC DFC_DisblMsk2.DFC_Com285hCounter_C "" VALUE 0x80248C6E Val_Wu16 65535.00 DFES_OneToOne 0.00 65535.00 FORMAT "%8.2" /end CHARACTERISTIC
/begin CHARACTERISTIC DFC_DisblMsk2.DFC_Com285hTooShort_C "" VALUE 0x80248C70 Val_Wu16 65535.00 DFES_OneToOne 0.00 65535.00 FORMAT "%8.2" /end CHARACTERISTIC
/begin CHARACTERISTIC DFC_DisblMsk2.DFC_Com293hAbsent_C "" VALUE 0x80248C72 Val_Wu16 65535.00 DFES_OneToOne 0.00 65535.00 FORMAT "%8.2" /end CHARACTERISTIC
/begin CHARACTERISTIC DFC_DisblMsk2.DFC_Com293hChecksum_C "" VALUE 0x80248C74 Val_Wu16 65535.00 DFES_OneToOne 0.00 65535.00 FORMAT "%8.2" /end CHARACTERISTIC
/begin CHARACTERISTIC DFC_DisblMsk2.DFC_Com293hCounter_C "" VALUE 0x80248C76 Val_Wu16 65535.00 DFES_OneToOne 0.00 65535.00 FORMAT "%8.2" /end CHARACTERISTIC
/begin CHARACTERISTIC DFC_DisblMsk2.DFC_Com293hTooShort_C "" VALUE 0x80248C78 Val_Wu16 65535.00 DFES_OneToOne 0.00 65535.00 FORMAT "%8.2" /end CHARACTERISTIC
/begin CHARACTERISTIC DFC_DisblMsk2.DFC_Com308hAbsent_C "" VALUE 0x80248C7A Val_Wu16 65535.00 DFES_OneToOne 0.00 65535.00 FORMAT "%8.2" /end CHARACTERISTIC
/begin CHARACTERISTIC DFC_DisblMsk2.DFC_Com308hChecksum_C "" VALUE 0x80248C7C Val_Wu16 65535.00 DFES_OneToOne 0.00 65535.00 FORMAT "%8.2" /end CHARACTERISTIC
/begin CHARACTERISTIC DFC_DisblMsk2.DFC_Com308hCounter_C "" VALUE 0x80248C7E Val_Wu16 65535.00 DFES_OneToOne 0.00 65535.00 FORMAT "%8.2" /end CHARACTERISTIC
/begin CHARACTERISTIC DFC_DisblMsk2.DFC_Com308hTooShort_C "" VALUE 0x80248C80 Val_Wu16 65535.00 DFES_OneToOne 0.00 65535.00 FORMAT "%8.2" /end CHARACTERISTIC
/begin CHARACTERISTIC DFC_DisblMsk2.DFC_Com318hAbsent_C "" VALUE 0x80248C82 Val_Wu16 65535.00 DFES_OneToOne 0.00 65535.00 FORMAT "%8.2" /end CHARACTERISTIC
/begin CHARACTERISTIC DFC_DisblMsk2.DFC_Com318hChecksum_C "" VALUE 0x80248C84 Val_Wu16 65535.00 DFES_OneToOne 0.00 65535.00 FORMAT "%8.2" /end CHARACTERISTIC
/begin CHARACTERISTIC DFC_DisblMsk2.DFC_Com318hCounter_C "" VALUE 0x80248C86 Val_Wu16 65535.00 DFES_OneToOne 0.00 65535.00 FORMAT "%8.2" /end CHARACTERISTIC
/begin CHARACTERISTIC DFC_DisblMsk2.DFC_Com318hTooShort_C "" VALUE 0x80248C88 Val_Wu16 65535.00 DFES_OneToOne 0.00 65535.00 FORMAT "%8.2" /end CHARACTERISTIC
/begin CHARACTERISTIC DFC_DisblMsk2.DFC_Com325hAbsent_C "" VALUE 0x80248C8A Val_Wu16 65535.00 DFES_OneToOne 0.00 65535.00 FORMAT "%8.2" /end CHARACTERISTIC
/begin CHARACTERISTIC DFC_DisblMsk2.DFC_Com325hChecksum_C "" VALUE 0x80248C8C Val_Wu16 65535.00 DFES_OneToOne 0.00 65535.00 FORMAT "%8.2" /end CHARACTERISTIC
/begin CHARACTERISTIC DFC_DisblMsk2.DFC_Com325hCounter_C "" VALUE 0x80248C8E Val_Wu16 65535.00 DFES_OneToOne 0.00 65535.00 FORMAT "%8.2" /end CHARACTERISTIC
/begin CHARACTERISTIC DFC_DisblMsk2.DFC_Com325hTooShort_C "" VALUE 0x80248C90 Val_Wu16 65535.00 DFES_OneToOne 0.00 65535.00 FORMAT "%8.2" /end CHARACTERISTIC
/begin CHARACTERISTIC DFC_DisblMsk2.DFC_Com335hAbsent_C "" VALUE 0x80248C92 Val_Wu16 65535.00 DFES_OneToOne 0.00 65535.00 FORMAT "%8.2" /end CHARACTERISTIC
/begin CHARACTERISTIC DFC_DisblMsk2.DFC_Com335hChecksum_C "" VALUE 0x80248C94 Val_Wu16 65535.00 DFES_OneToOne 0.00 65535.00 FORMAT "%8.2" /end CHARACTERISTIC
/begin CHARACTERISTIC DFC_DisblMsk2.DFC_Com335hCounter_C "" VALUE 0x80248C96 Val_Wu16 65535.00 DFES_OneToOne 0.00 65535.00 FORMAT "%8.2" /end CHARACTERISTIC
/begin CHARACTERISTIC DFC_DisblMsk2.DFC_Com335hTooShort_C "" VALUE 0x80248C98 Val_Wu16 65535.00 DFES_OneToOne 0.00 65535.00 FORMAT "%8.2" /end CHARACTERISTIC
/begin CHARACTERISTIC DFC_DisblMsk2.DFC_Com351hAbsent_C "" VALUE 0x80248C9A Val_Wu16 65535.00 DFES_OneToOne 0.00 65535.00 FORMAT "%8.2" /end CHARACTERISTIC
/begin CHARACTERISTIC DFC_DisblMsk2.DFC_Com351hTooShort_C "" VALUE 0x80248C9C Val_Wu16 65535.00 DFES_OneToOne 0.00 65535.00 FORMAT "%8.2" /end CHARACTERISTIC
/begin CHARACTERISTIC DFC_DisblMsk2.DFC_Com38DhAbsent_C "" VALUE 0x80248C9E Val_Wu16 65535.00 DFES_OneToOne 0.00 65535.00 FORMAT "%8.2" /end CHARACTERISTIC
/begin CHARACTERISTIC DFC_DisblMsk2.DFC_Com38DhChecksum_C "" VALUE 0x80248CA0 Val_Wu16 65535.00 DFES_OneToOne 0.00 65535.00 FORMAT "%8.2" /end CHARACTERISTIC
/begin CHARACTERISTIC DFC_DisblMsk2.DFC_Com38DhCounter_C "" VALUE 0x80248CA2 Val_Wu16 65535.00 DFES_OneToOne 0.00 65535.00 FORMAT "%8.2" /end CHARACTERISTIC
/begin CHARACTERISTIC DFC_DisblMsk2.DFC_Com38DhTooShort_C "" VALUE 0x80248CA4 Val_Wu16 65535.00 DFES_OneToOne 0.00 65535.00 FORMAT "%8.2" /end CHARACTERISTIC
/begin CHARACTERISTIC DFC_DisblMsk2.DFC_Com412hAbsent_C "" VALUE 0x80248CA6 Val_Wu16 65535.00 DFES_OneToOne 0.00 65535.00 FORMAT "%8.2" /end CHARACTERISTIC
/begin CHARACTERISTIC DFC_DisblMsk2.DFC_Com412hChecksum_C "" VALUE 0x80248CA8 Val_Wu16 65535.00 DFES_OneToOne 0.00 65535.00 FORMAT "%8.2" /end CHARACTERISTIC
/begin CHARACTERISTIC DFC_DisblMsk2.DFC_Com412hCounter_C "" VALUE 0x80248CAA Val_Wu16 65535.00 DFES_OneToOne 0.00 65535.00 FORMAT "%8.2" /end CHARACTERISTIC
/begin CHARACTERISTIC DFC_DisblMsk2.DFC_Com412hTooShort_C "" VALUE 0x80248CAC Val_Wu16 65535.00 DFES_OneToOne 0.00 65535.00 FORMAT "%8.2" /end CHARACTERISTIC
/begin CHARACTERISTIC DFC_DisblMsk2.DFC_Com427hAbsent_C "" VALUE 0x80248CAE Val_Wu16 65535.00 DFES_OneToOne 0.00 65535.00 FORMAT "%8.2" /end CHARACTERISTIC
/begin CHARACTERISTIC DFC_DisblMsk2.DFC_Com427hTooShort_C "" VALUE 0x80248CB0 Val_Wu16 65535.00 DFES_OneToOne 0.00 65535.00 FORMAT "%8.2" /end CHARACTERISTIC
/begin CHARACTERISTIC DFC_DisblMsk2.DFC_Com432hAbsent_C "" VALUE 0x80248CB2 Val_Wu16 65535.00 DFES_OneToOne 0.00 65535.00 FORMAT "%8.2" /end CHARACTERISTIC
/begin CHARACTERISTIC DFC_DisblMsk2.DFC_Com432hChecksum_C "" VALUE 0x80248CB4 Val_Wu16 65535.00 DFES_OneToOne 0.00 65535.00 FORMAT "%8.2" /end CHARACTERISTIC
/begin CHARACTERISTIC DFC_DisblMsk2.DFC_Com432hCounter_C "" VALUE 0x80248CB6 Val_Wu16 65535.00 DFES_OneToOne 0.00 65535.00 FORMAT "%8.2" /end CHARACTERISTIC
/begin CHARACTERISTIC DFC_DisblMsk2.DFC_Com432hTooShort_C "" VALUE 0x80248CB8 Val_Wu16 65535.00 DFES_OneToOne 0.00 65535.00 FORMAT "%8.2" /end CHARACTERISTIC
/begin CHARACTERISTIC DFC_DisblMsk2.DFC_Com435hAbsent_C "" VALUE 0x80248CBA Val_Wu16 65535.00 DFES_OneToOne 0.00 65535.00 FORMAT "%8.2" /end CHARACTERISTIC
/begin CHARACTERISTIC DFC_DisblMsk2.DFC_Com435hTooShort_C "" VALUE 0x80248CBC Val_Wu16 65535.00 DFES_OneToOne 0.00 65535.00 FORMAT "%8.2" /end CHARACTERISTIC
/begin CHARACTERISTIC DFC_DisblMsk2.DFC_Com442hAbsent_C "" VALUE 0x80248CBE Val_Wu16 65535.00 DFES_OneToOne 0.00 65535.00 FORMAT "%8.2" /end CHARACTERISTIC
/begin CHARACTERISTIC DFC_DisblMsk2.DFC_Com442hTooShort_C "" VALUE 0x80248CC0 Val_Wu16 65535.00 DFES_OneToOne 0.00 65535.00 FORMAT "%8.2" /end CHARACTERISTIC
/begin CHARACTERISTIC DFC_DisblMsk2.DFC_Com453hAbsent_C "" VALUE 0x80248CC2 Val_Wu16 65535.00 DFES_OneToOne 0.00 65535.00 FORMAT "%8.2" /end CHARACTERISTIC
/begin CHARACTERISTIC DFC_DisblMsk2.DFC_Com453hTooShort_C "" VALUE 0x80248CC4 Val_Wu16 65535.00 DFES_OneToOne 0.00 65535.00 FORMAT "%8.2" /end CHARACTERISTIC
/begin CHARACTERISTIC DFC_DisblMsk2.DFC_Com455hAbsent_C "" VALUE 0x80248CC6 Val_Wu16 65535.00 DFES_OneToOne 0.00 65535.00 FORMAT "%8.2" /end CHARACTERISTIC
/begin CHARACTERISTIC DFC_DisblMsk2.DFC_Com455hTooShort_C "" VALUE 0x80248CC8 Val_Wu16 65535.00 DFES_OneToOne 0.00 65535.00 FORMAT "%8.2" /end CHARACTERISTIC
/begin CHARACTERISTIC DFC_DisblMsk2.DFC_Com463hAbsent_C "" VALUE 0x80248CCA Val_Wu16 65535.00 DFES_OneToOne 0.00 65535.00 FORMAT "%8.2" /end CHARACTERISTIC
/begin CHARACTERISTIC DFC_DisblMsk2.DFC_Com463hTooShort_C "" VALUE 0x80248CCC Val_Wu16 65535.00 DFES_OneToOne 0.00 65535.00 FORMAT "%8.2" /end CHARACTERISTIC
/begin CHARACTERISTIC DFC_DisblMsk2.DFC_Com473hAbsent_C "" VALUE 0x80248CCE Val_Wu16 65535.00 DFES_OneToOne 0.00 65535.00 FORMAT "%8.2" /end CHARACTERISTIC
/begin CHARACTERISTIC DFC_DisblMsk2.DFC_Com473hTooShort_C "" VALUE 0x80248CD0 Val_Wu16 65535.00 DFES_OneToOne 0.00 65535.00 FORMAT "%8.2" /end CHARACTERISTIC
/begin CHARACTERISTIC DFC_DisblMsk2.DFC_Com47BhAbsent_C "" VALUE 0x80248CD2 Val_Wu16 65535.00 DFES_OneToOne 0.00 65535.00 FORMAT "%8.2" /end CHARACTERISTIC
/begin CHARACTERISTIC DFC_DisblMsk2.DFC_Com47BhTooShort_C "" VALUE 0x80248CD4 Val_Wu16 65535.00 DFES_OneToOne 0.00 65535.00 FORMAT "%8.2" /end CHARACTERISTIC
/begin CHARACTERISTIC DFC_DisblMsk2.DFC_Com48BhAbsent_C "" VALUE 0x80248CD6 Val_Wu16 65535.00 DFES_OneToOne 0.00 65535.00 FORMAT "%8.2" /end CHARACTERISTIC
/begin CHARACTERISTIC DFC_DisblMsk2.DFC_Com48BhTooShort_C "" VALUE 0x80248CD8 Val_Wu16 65535.00 DFES_OneToOne 0.00 65535.00 FORMAT "%8.2" /end CHARACTERISTIC
/begin CHARACTERISTIC DFC_DisblMsk2.DFC_Com497hTooShort_C "" VALUE 0x80248CDA Val_Wu16 65535.00 DFES_OneToOne 0.00 65535.00 FORMAT "%8.2" /end CHARACTERISTIC
/begin CHARACTERISTIC DFC_DisblMsk2.DFC_Com4F2hAbsent_C "" VALUE 0x80248CDC Val_Wu16 65535.00 DFES_OneToOne 0.00 65535.00 FORMAT "%8.2" /end CHARACTERISTIC
/begin CHARACTERISTIC DFC_DisblMsk2.DFC_Com4F2hChecksum_C "" VALUE 0x80248CDE Val_Wu16 65535.00 DFES_OneToOne 0.00 65535.00 FORMAT "%8.2" /end CHARACTERISTIC
/begin CHARACTERISTIC DFC_DisblMsk2.DFC_Com4F2hCounter_C "" VALUE 0x80248CE0 Val_Wu16 65535.00 DFES_OneToOne 0.00 65535.00 FORMAT "%8.2" /end CHARACTERISTIC
/begin CHARACTERISTIC DFC_DisblMsk2.DFC_Com4F2hTooShort_C "" VALUE 0x80248CE2 Val_Wu16 65535.00 DFES_OneToOne 0.00 65535.00 FORMAT "%8.2" /end CHARACTERISTIC
/begin CHARACTERISTIC DFC_DisblMsk2.DFC_Com50DhAbsent_C "" VALUE 0x80248CE4 Val_Wu16 65535.00 DFES_OneToOne 0.00 65535.00 FORMAT "%8.2" /end CHARACTERISTIC
/begin CHARACTERISTIC DFC_DisblMsk2.DFC_Com50DhTooShort_C "" VALUE 0x80248CE6 Val_Wu16 65535.00 DFES_OneToOne 0.00 65535.00 FORMAT "%8.2" /end CHARACTERISTIC
/begin CHARACTERISTIC DFC_DisblMsk2.DFC_Com535hAbsent_C "" VALUE 0x80248CE8 Val_Wu16 65535.00 DFES_OneToOne 0.00 65535.00 FORMAT "%8.2" /end CHARACTERISTIC
/begin CHARACTERISTIC DFC_DisblMsk2.DFC_Com535hTooShort_C "" VALUE 0x80248CEA Val_Wu16 65535.00 DFES_OneToOne 0.00 65535.00 FORMAT "%8.2" /end CHARACTERISTIC
/begin CHARACTERISTIC DFC_DisblMsk2.DFC_Com543hAbsent_C "" VALUE 0x80248CEC Val_Wu16 65535.00 DFES_OneToOne 0.00 65535.00 FORMAT "%8.2" /end CHARACTERISTIC
/begin CHARACTERISTIC DFC_DisblMsk2.DFC_Com543hTooShort_C "" VALUE 0x80248CEE Val_Wu16 65535.00 DFES_OneToOne 0.00 65535.00 FORMAT "%8.2" /end CHARACTERISTIC
/begin CHARACTERISTIC DFC_DisblMsk2.DFC_Com552hAbsent_C "" VALUE 0x80248CF0 Val_Wu16 65535.00 DFES_OneToOne 0.00 65535.00 FORMAT "%8.2" /end CHARACTERISTIC
/begin CHARACTERISTIC DFC_DisblMsk2.DFC_Com552hTooShort_C "" VALUE 0x80248CF2 Val_Wu16 65535.00 DFES_OneToOne 0.00 65535.00 FORMAT "%8.2" /end CHARACTERISTIC
/begin CHARACTERISTIC DFC_DisblMsk2.DFC_Com583hAbsent_C "" VALUE 0x80248CF4 Val_Wu16 65535.00 DFES_OneToOne 0.00 65535.00 FORMAT "%8.2" /end CHARACTERISTIC
/begin CHARACTERISTIC DFC_DisblMsk2.DFC_Com583hTooShort_C "" VALUE 0x80248CF6 Val_Wu16 65535.00 DFES_OneToOne 0.00 65535.00 FORMAT "%8.2" /end CHARACTERISTIC
/begin CHARACTERISTIC DFC_DisblMsk2.DFC_Com592hAbsent_C "" VALUE 0x80248CF8 Val_Wu16 65535.00 DFES_OneToOne 0.00 65535.00 FORMAT "%8.2" /end CHARACTERISTIC
/begin CHARACTERISTIC DFC_DisblMsk2.DFC_Com592hChecksum_C "" VALUE 0x80248CFA Val_Wu16 65535.00 DFES_OneToOne 0.00 65535.00 FORMAT "%8.2" /end CHARACTERISTIC
/begin CHARACTERISTIC DFC_DisblMsk2.DFC_Com592hCounter_C "" VALUE 0x80248CFC Val_Wu16 65535.00 DFES_OneToOne 0.00 65535.00 FORMAT "%8.2" /end CHARACTERISTIC
/begin CHARACTERISTIC DFC_DisblMsk2.DFC_Com592hTooShort_C "" VALUE 0x80248CFE Val_Wu16 65535.00 DFES_OneToOne 0.00 65535.00 FORMAT "%8.2" /end CHARACTERISTIC
/begin CHARACTERISTIC DFC_DisblMsk2.DFC_Com595hAbsent_C "" VALUE 0x80248D00 Val_Wu16 65535.00 DFES_OneToOne 0.00 65535.00 FORMAT "%8.2" /end CHARACTERISTIC
/begin CHARACTERISTIC DFC_DisblMsk2.DFC_Com595hChecksum_C "" VALUE 0x80248D02 Val_Wu16 65535.00 DFES_OneToOne 0.00 65535.00 FORMAT "%8.2" /end CHARACTERISTIC
/begin CHARACTERISTIC DFC_DisblMsk2.DFC_Com595hCounter_C "" VALUE 0x80248D04 Val_Wu16 65535.00 DFES_OneToOne 0.00 65535.00 FORMAT "%8.2" /end CHARACTERISTIC
/begin CHARACTERISTIC DFC_DisblMsk2.DFC_Com595hTooShort_C "" VALUE 0x80248D06 Val_Wu16 65535.00 DFES_OneToOne 0.00 65535.00 FORMAT "%8.2" /end CHARACTERISTIC
/begin CHARACTERISTIC DFC_DisblMsk2.DFC_Com5B2hAbsent_C "" VALUE 0x80248D08 Val_Wu16 65535.00 DFES_OneToOne 0.00 65535.00 FORMAT "%8.2" /end CHARACTERISTIC
/begin CHARACTERISTIC DFC_DisblMsk2.DFC_Com5B2hTooShort_C "" VALUE 0x80248D0A Val_Wu16 65535.00 DFES_OneToOne 0.00 65535.00 FORMAT "%8.2" /end CHARACTERISTIC
/begin CHARACTERISTIC DFC_DisblMsk2.DFC_Com5B5hAbsent_C "" VALUE 0x80248D0C Val_Wu16 65535.00 DFES_OneToOne 0.00 65535.00 FORMAT "%8.2" /end CHARACTERISTIC
/begin CHARACTERISTIC DFC_DisblMsk2.DFC_Com5B5hChecksum_C "" VALUE 0x80248D0E Val_Wu16 65535.00 DFES_OneToOne 0.00 65535.00 FORMAT "%8.2" /end CHARACTERISTIC
/begin CHARACTERISTIC DFC_DisblMsk2.DFC_Com5B5hCounter_C "" VALUE 0x80248D10 Val_Wu16 65535.00 DFES_OneToOne 0.00 65535.00 FORMAT "%8.2" /end CHARACTERISTIC
/begin CHARACTERISTIC DFC_DisblMsk2.DFC_Com5B5hTooShort_C "" VALUE 0x80248D12 Val_Wu16 65535.00 DFES_OneToOne 0.00 65535.00 FORMAT "%8.2" /end CHARACTERISTIC
/begin CHARACTERISTIC DFC_DisblMsk2.DFC_Com5C7hTooShort_C "" VALUE 0x80248D14 Val_Wu16 65535.00 DFES_OneToOne 0.00 65535.00 FORMAT "%8.2" /end CHARACTERISTIC
/begin CHARACTERISTIC DFC_DisblMsk2.DFC_Com5E7hAbsent_C "" VALUE 0x80248D16 Val_Wu16 65535.00 DFES_OneToOne 0.00 65535.00 FORMAT "%8.2" /end CHARACTERISTIC
/begin CHARACTERISTIC DFC_DisblMsk2.DFC_Com5E7hTooShort_C "" VALUE 0x80248D18 Val_Wu16 65535.00 DFES_OneToOne 0.00 65535.00 FORMAT "%8.2" /end CHARACTERISTIC
/begin CHARACTERISTIC DFC_DisblMsk2.DFC_Com635hTooShort_C "" VALUE 0x80248D1A Val_Wu16 65535.00 DFES_OneToOne 0.00 65535.00 FORMAT "%8.2" /end CHARACTERISTIC
/begin CHARACTERISTIC DFC_DisblMsk2.DFC_Com645hTooShort_C "" VALUE 0x80248D1C Val_Wu16 65535.00 DFES_OneToOne 0.00 65535.00 FORMAT "%8.2" /end CHARACTERISTIC
/begin CHARACTERISTIC DFC_DisblMsk2.DFC_Com663hAbsent_C "" VALUE 0x80248D1E Val_Wu16 65535.00 DFES_OneToOne 0.00 65535.00 FORMAT "%8.2" /end CHARACTERISTIC
/begin CHARACTERISTIC DFC_DisblMsk2.DFC_Com663hTooShort_C "" VALUE 0x80248D20 Val_Wu16 65535.00 DFES_OneToOne 0.00 65535.00 FORMAT "%8.2" /end CHARACTERISTIC
/begin CHARACTERISTIC DFC_DisblMsk2.DFC_Com665hAbsent_C "" VALUE 0x80248D22 Val_Wu16 65535.00 DFES_OneToOne 0.00 65535.00 FORMAT "%8.2" /end CHARACTERISTIC
/begin CHARACTERISTIC DFC_DisblMsk2.DFC_Com665hTooShort_C "" VALUE 0x80248D24 Val_Wu16 65535.00 DFES_OneToOne 0.00 65535.00 FORMAT "%8.2" /end CHARACTERISTIC
/begin CHARACTERISTIC DFC_DisblMsk2.DFC_Com675hAbsent_C "" VALUE 0x80248D26 Val_Wu16 65535.00 DFES_OneToOne 0.00 65535.00 FORMAT "%8.2" /end CHARACTERISTIC
/begin CHARACTERISTIC DFC_DisblMsk2.DFC_Com675hTooShort_C "" VALUE 0x80248D28 Val_Wu16 65535.00 DFES_OneToOne 0.00 65535.00 FORMAT "%8.2" /end CHARACTERISTIC
/begin CHARACTERISTIC DFC_DisblMsk2.DFC_ComFrbd_205h_HVBAT_PACK_CURRENT_C "" VALUE 0x80248D2A Val_Wu16 65535.00 DFES_OneToOne 0.00 65535.00 FORMAT "%8.2" /end CHARACTERISTIC
/begin CHARACTERISTIC DFC_DisblMsk2.DFC_ComFrbd_205h_HVBAT_SOC_DISPLAY_C "" VALUE 0x80248D2C Val_Wu16 65535.00 DFES_OneToOne 0.00 65535.00 FORMAT "%8.2" /end CHARACTERISTIC
/begin CHARACTERISTIC DFC_DisblMsk2.DFC_ComFrbd_205h_HVBAT_VOLTAGE_C "" VALUE 0x80248D2E Val_Wu16 65535.00 DFES_OneToOne 0.00 65535.00 FORMAT "%8.2" /end CHARACTERISTIC
/begin CHARACTERISTIC DFC_DisblMsk2.DFC_ComFrbd_217h_INV_DC_BUS_VOLTAGE_C "" VALUE 0x80248D30 Val_Wu16 65535.00 DFES_OneToOne 0.00 65535.00 FORMAT "%8.2" /end CHARACTERISTIC
/begin CHARACTERISTIC DFC_DisblMsk2.DFC_ComFrbd_217h_INV_MTR_ACTUAL_TRQ_C "" VALUE 0x80248D32 Val_Wu16 65535.00 DFES_OneToOne 0.00 65535.00 FORMAT "%8.2" /end CHARACTERISTIC
/begin CHARACTERISTIC DFC_DisblMsk2.DFC_ComFrbd_217h_INV_MTR_SPEED_C "" VALUE 0x80248D34 Val_Wu16 65535.00 DFES_OneToOne 0.00 65535.00 FORMAT "%8.2" /end CHARACTERISTIC
/begin CHARACTERISTIC DFC_DisblMsk2.DFC_ComFrbd_217h_INV_MTR_TRQ_C "" VALUE 0x80248D36 Val_Wu16 65535.00 DFES_OneToOne 0.00 65535.00 FORMAT "%8.2" /end CHARACTERISTIC
/begin CHARACTERISTIC DFC_DisblMsk2.DFC_ComFrbd_227h_INV_DC_CURRENT_C "" VALUE 0x80248D38 Val_Wu16 65535.00 DFES_OneToOne 0.00 65535.00 FORMAT "%8.2" /end CHARACTERISTIC
/begin CHARACTERISTIC DFC_DisblMsk2.DFC_ComFrbd_227h_INV_MOTORING_PEAK_TRQ_C "" VALUE 0x80248D3A Val_Wu16 65535.00 DFES_OneToOne 0.00 65535.00 FORMAT "%8.2" /end CHARACTERISTIC
/begin CHARACTERISTIC DFC_DisblMsk2.DFC_ComFrbd_227h_INV_MTR_INST_INPUT_POWER_C "" VALUE 0x80248D3C Val_Wu16 65535.00 DFES_OneToOne 0.00 65535.00 FORMAT "%8.2" /end CHARACTERISTIC
/begin CHARACTERISTIC DFC_DisblMsk2.DFC_ComFrbd_227h_INV_REGEN_PEAK_TRQ_C "" VALUE 0x80248D3E Val_Wu16 65535.00 DFES_OneToOne 0.00 65535.00 FORMAT "%8.2" /end CHARACTERISTIC
/begin CHARACTERISTIC DFC_DisblMsk2.DFC_ComFrbd_237h_INV_ACTIVE_DISCHARGE_STATUS_C "" VALUE 0x80248D40 Val_Wu16 65535.00 DFES_OneToOne 0.00 65535.00 FORMAT "%8.2" /end CHARACTERISTIC
/begin CHARACTERISTIC DFC_DisblMsk2.DFC_ComFrbd_237h_INV_CTRL_MODE_ACK_C "" VALUE 0x80248D42 Val_Wu16 65535.00 DFES_OneToOne 0.00 65535.00 FORMAT "%8.2" /end CHARACTERISTIC
/begin CHARACTERISTIC DFC_DisblMsk2.DFC_ComFrbd_237h_INV_EV_WARNING_C "" VALUE 0x80248D44 Val_Wu16 65535.00 DFES_OneToOne 0.00 65535.00 FORMAT "%8.2" /end CHARACTERISTIC
/begin CHARACTERISTIC DFC_DisblMsk2.DFC_ComFrbd_237h_INV_FAULT_LEVEL_C "" VALUE 0x80248D46 Val_Wu16 65535.00 DFES_OneToOne 0.00 65535.00 FORMAT "%8.2" /end CHARACTERISTIC
/begin CHARACTERISTIC DFC_DisblMsk2.DFC_ComFrbd_237h_INV_MASTER_STOP_C "" VALUE 0x80248D48 Val_Wu16 65535.00 DFES_OneToOne 0.00 65535.00 FORMAT "%8.2" /end CHARACTERISTIC
/begin CHARACTERISTIC DFC_DisblMsk2.DFC_ComFrbd_237h_INV_SERVICE_DUE_C "" VALUE 0x80248D4A Val_Wu16 65535.00 DFES_OneToOne 0.00 65535.00 FORMAT "%8.2" /end CHARACTERISTIC
/begin CHARACTERISTIC DFC_DisblMsk2.DFC_ComFrbd_237h_INV_STAB_MIN_TRQ_C "" VALUE 0x80248D4C Val_Wu16 65535.00 DFES_OneToOne 0.00 65535.00 FORMAT "%8.2" /end CHARACTERISTIC
/begin CHARACTERISTIC DFC_DisblMsk2.DFC_ComFrbd_259h_TGLM_FAILURE_STATE_C "" VALUE 0x80248D4E Val_Wu16 65535.00 DFES_OneToOne 0.00 65535.00 FORMAT "%8.2" /end CHARACTERISTIC
/begin CHARACTERISTIC DFC_DisblMsk2.DFC_ComFrbd_259h_TGLM_MODE_PUSH_C "" VALUE 0x80248D50 Val_Wu16 65535.00 DFES_OneToOne 0.00 65535.00 FORMAT "%8.2" /end CHARACTERISTIC
/begin CHARACTERISTIC DFC_DisblMsk2.DFC_ComFrbd_259h_TOGGLE_MONOSTABLE_POS_C "" VALUE 0x80248D52 Val_Wu16 65535.00 DFES_OneToOne 0.00 65535.00 FORMAT "%8.2" /end CHARACTERISTIC
/begin CHARACTERISTIC DFC_DisblMsk2.DFC_ComFrbd_273h_OBC_outputpower_capability_C "" VALUE 0x80248D54 Val_Wu16 65535.00 DFES_OneToOne 0.00 65535.00 FORMAT "%8.2" /end CHARACTERISTIC
/begin CHARACTERISTIC DFC_DisblMsk2.DFC_ComFrbd_275h_HVBAT_DISCHARGE_30S_AVAILABLE_CURRENT_C "" VALUE 0x80248D56 Val_Wu16 65535.00 DFES_OneToOne 0.00 65535.00 FORMAT "%8.2" /end CHARACTERISTIC
/begin CHARACTERISTIC DFC_DisblMsk2.DFC_ComFrbd_275h_HVBAT_DISCHARGE_30S_AVAILABLE_POWER_C "" VALUE 0x80248D58 Val_Wu16 65535.00 DFES_OneToOne 0.00 65535.00 FORMAT "%8.2" /end CHARACTERISTIC
/begin CHARACTERISTIC DFC_DisblMsk2.DFC_ComFrbd_283h_DCDC_IN_CURRENT_C "" VALUE 0x80248D5A Val_Wu16 65535.00 DFES_OneToOne 0.00 65535.00 FORMAT "%8.2" /end CHARACTERISTIC
/begin CHARACTERISTIC DFC_DisblMsk2.DFC_ComFrbd_283h_DCDC_IN_VOLTAGE_C "" VALUE 0x80248D5C Val_Wu16 65535.00 DFES_OneToOne 0.00 65535.00 FORMAT "%8.2" /end CHARACTERISTIC
/begin CHARACTERISTIC DFC_DisblMsk2.DFC_ComFrbd_283h_DCDC_OUT_CURRENT_C "" VALUE 0x80248D5E Val_Wu16 65535.00 DFES_OneToOne 0.00 65535.00 FORMAT "%8.2" /end CHARACTERISTIC
/begin CHARACTERISTIC DFC_DisblMsk2.DFC_ComFrbd_283h_DCDC_OUT_VOLTAGE_C "" VALUE 0x80248D60 Val_Wu16 65535.00 DFES_OneToOne 0.00 65535.00 FORMAT "%8.2" /end CHARACTERISTIC
/begin CHARACTERISTIC DFC_DisblMsk2.DFC_ComFrbd_285h_HVBAT_REGEN_CHG_30S_CURRENT_LIMIT_C "" VALUE 0x80248D62 Val_Wu16 65535.00 DFES_OneToOne 0.00 65535.00 FORMAT "%8.2" /end CHARACTERISTIC
/begin CHARACTERISTIC DFC_DisblMsk2.DFC_ComFrbd_285h_HVBAT_REGEN_CHRG_30S_POWER_LIMIT_C "" VALUE 0x80248D64 Val_Wu16 65535.00 DFES_OneToOne 0.00 65535.00 FORMAT "%8.2" /end CHARACTERISTIC
/begin CHARACTERISTIC DFC_DisblMsk2.DFC_ComFrbd_293h_DCDC_outputpower_capability_C "" VALUE 0x80248D66 Val_Wu16 65535.00 DFES_OneToOne 0.00 65535.00 FORMAT "%8.2" /end CHARACTERISTIC
/begin CHARACTERISTIC DFC_DisblMsk2.DFC_ComFrbd_325h_HVBAT_INSULATION_RESISTANCE_C "" VALUE 0x80248D68 Val_Wu16 65535.00 DFES_OneToOne 0.00 65535.00 FORMAT "%8.2" /end CHARACTERISTIC
/begin CHARACTERISTIC DFC_DisblMsk2.DFC_ComFrbd_325h_HVBAT_TEMPERATURE_C "" VALUE 0x80248D6A Val_Wu16 65535.00 DFES_OneToOne 0.00 65535.00 FORMAT "%8.2" /end CHARACTERISTIC
/begin CHARACTERISTIC DFC_DisblMsk2.DFC_ComFrbd_335h_HVBAT_CHRG_CONTINUOUS_CURR_MAX_C "" VALUE 0x80248D6C Val_Wu16 65535.00 DFES_OneToOne 0.00 65535.00 FORMAT "%8.2" /end CHARACTERISTIC
/begin CHARACTERISTIC DFC_DisblMsk2.DFC_ComFrbd_335h_HVBAT_CHRG_COTINUOUS_CURR_REQ_C "" VALUE 0x80248D6E Val_Wu16 65535.00 DFES_OneToOne 0.00 65535.00 FORMAT "%8.2" /end CHARACTERISTIC
/begin CHARACTERISTIC DFC_DisblMsk2.DFC_ComFrbd_335h_HVBAT_CHRG_MAX_VOLT_C "" VALUE 0x80248D70 Val_Wu16 65535.00 DFES_OneToOne 0.00 65535.00 FORMAT "%8.2" /end CHARACTERISTIC
/begin CHARACTERISTIC DFC_DisblMsk2.DFC_ComFrbd_335h_HVBAT_DC_BUS_VOLTAGE_C "" VALUE 0x80248D72 Val_Wu16 65535.00 DFES_OneToOne 0.00 65535.00 FORMAT "%8.2" /end CHARACTERISTIC
/begin CHARACTERISTIC DFC_DisblMsk2.DFC_ComFrbd_427h_INV_OP_MODE_C "" VALUE 0x80248D74 Val_Wu16 65535.00 DFES_OneToOne 0.00 65535.00 FORMAT "%8.2" /end CHARACTERISTIC
/begin CHARACTERISTIC DFC_DisblMsk2.DFC_ComFrbd_427h_INV_PERMISIBLE_TORQUE_C "" VALUE 0x80248D76 Val_Wu16 65535.00 DFES_OneToOne 0.00 65535.00 FORMAT "%8.2" /end CHARACTERISTIC
/begin CHARACTERISTIC DFC_DisblMsk2.DFC_ComFrbd_435h_HVBAT_MAX_CELL_VOLT_C "" VALUE 0x80248D78 Val_Wu16 65535.00 DFES_OneToOne 0.00 65535.00 FORMAT "%8.2" /end CHARACTERISTIC
/begin CHARACTERISTIC DFC_DisblMsk2.DFC_ComFrbd_435h_HVBAT_MAX_CELL_VOLT_NUM_C "" VALUE 0x80248D7A Val_Wu16 65535.00 DFES_OneToOne 0.00 65535.00 FORMAT "%8.2" /end CHARACTERISTIC
/begin CHARACTERISTIC DFC_DisblMsk2.DFC_ComFrbd_435h_HVBAT_MAX_SENSOR_TEMP_C "" VALUE 0x80248D7C Val_Wu16 65535.00 DFES_OneToOne 0.00 65535.00 FORMAT "%8.2" /end CHARACTERISTIC
/begin CHARACTERISTIC DFC_DisblMsk2.DFC_ComFrbd_435h_HVBAT_MIN_CELL_VOLT_C "" VALUE 0x80248D7E Val_Wu16 65535.00 DFES_OneToOne 0.00 65535.00 FORMAT "%8.2" /end CHARACTERISTIC
/begin CHARACTERISTIC DFC_DisblMsk2.DFC_ComFrbd_435h_HVBAT_MIN_CELL_VOLT_NUM_C "" VALUE 0x80248D80 Val_Wu16 65535.00 DFES_OneToOne 0.00 65535.00 FORMAT "%8.2" /end CHARACTERISTIC
/begin CHARACTERISTIC DFC_DisblMsk2.DFC_ComFrbd_453h_OBC_IN_CURRENT_C "" VALUE 0x80248D82 Val_Wu16 65535.00 DFES_OneToOne 0.00 65535.00 FORMAT "%8.2" /end CHARACTERISTIC
/begin CHARACTERISTIC DFC_DisblMsk2.DFC_ComFrbd_453h_OBC_IN_VOLTAGE_C "" VALUE 0x80248D84 Val_Wu16 65535.00 DFES_OneToOne 0.00 65535.00 FORMAT "%8.2" /end CHARACTERISTIC
/begin CHARACTERISTIC DFC_DisblMsk2.DFC_ComFrbd_453h_OBC_IP_POWER_C "" VALUE 0x80248D86 Val_Wu16 65535.00 DFES_OneToOne 0.00 65535.00 FORMAT "%8.2" /end CHARACTERISTIC
/begin CHARACTERISTIC DFC_DisblMsk2.DFC_ComFrbd_455h_HVBAT_NOMINAL_VOLTAGE_C "" VALUE 0x80248D88 Val_Wu16 65535.00 DFES_OneToOne 0.00 65535.00 FORMAT "%8.2" /end CHARACTERISTIC
/begin CHARACTERISTIC DFC_DisblMsk2.DFC_ComFrbd_463h_OBC_OUT_CURRENT_C "" VALUE 0x80248D8A Val_Wu16 65535.00 DFES_OneToOne 0.00 65535.00 FORMAT "%8.2" /end CHARACTERISTIC
/begin CHARACTERISTIC DFC_DisblMsk2.DFC_ComFrbd_463h_OBC_OUT_VOLTAGE_C "" VALUE 0x80248D8C Val_Wu16 65535.00 DFES_OneToOne 0.00 65535.00 FORMAT "%8.2" /end CHARACTERISTIC
/begin CHARACTERISTIC DFC_DisblMsk2.DFC_ComFrbd_463h_OBC_TEMPERATURE_C "" VALUE 0x80248D8E Val_Wu16 65535.00 DFES_OneToOne 0.00 65535.00 FORMAT "%8.2" /end CHARACTERISTIC
/begin CHARACTERISTIC DFC_DisblMsk2.DFC_ComFrbd_473h_DCDC_Coolant_Temperature_C "" VALUE 0x80248D90 Val_Wu16 65535.00 DFES_OneToOne 0.00 65535.00 FORMAT "%8.2" /end CHARACTERISTIC
/begin CHARACTERISTIC DFC_DisblMsk2.DFC_ComFrbd_473h_DCDC_TEMPERATURE_C "" VALUE 0x80248D92 Val_Wu16 65535.00 DFES_OneToOne 0.00 65535.00 FORMAT "%8.2" /end CHARACTERISTIC
/begin CHARACTERISTIC DFC_DisblMsk2.DFC_ComFrbd_47Bh_eCOMP_BusBarCurrent_C "" VALUE 0x80248D94 Val_Wu16 65535.00 DFES_OneToOne 0.00 65535.00 FORMAT "%8.2" /end CHARACTERISTIC
/begin CHARACTERISTIC DFC_DisblMsk2.DFC_ComFrbd_47Bh_eCOMP_BusBarVoltage_C "" VALUE 0x80248D96 Val_Wu16 65535.00 DFES_OneToOne 0.00 65535.00 FORMAT "%8.2" /end CHARACTERISTIC
/begin CHARACTERISTIC DFC_DisblMsk2.DFC_ComFrbd_47Bh_eCOMP_CompressorSpeed_C "" VALUE 0x80248D98 Val_Wu16 65535.00 DFES_OneToOne 0.00 65535.00 FORMAT "%8.2" /end CHARACTERISTIC
/begin CHARACTERISTIC DFC_DisblMsk2.DFC_ComFrbd_47Bh_eCOMP_IGBT_Temp_C "" VALUE 0x80248D9A Val_Wu16 65535.00 DFES_OneToOne 0.00 65535.00 FORMAT "%8.2" /end CHARACTERISTIC
/begin CHARACTERISTIC DFC_DisblMsk2.DFC_ComFrbd_47Bh_eCOMP_PeakPhaCurrent_C "" VALUE 0x80248D9C Val_Wu16 65535.00 DFES_OneToOne 0.00 65535.00 FORMAT "%8.2" /end CHARACTERISTIC
/begin CHARACTERISTIC DFC_DisblMsk2.DFC_ComFrbd_47Bh_eCOMP_Power_consumption_C "" VALUE 0x80248D9E Val_Wu16 65535.00 DFES_OneToOne 0.00 65535.00 FORMAT "%8.2" /end CHARACTERISTIC
/begin CHARACTERISTIC DFC_DisblMsk2.DFC_ComFrbd_48Bh_eCOMP_Fault_Level_C "" VALUE 0x80248DA0 Val_Wu16 65535.00 DFES_OneToOne 0.00 65535.00 FORMAT "%8.2" /end CHARACTERISTIC
/begin CHARACTERISTIC DFC_DisblMsk2.DFC_ComFrbd_4F2h_VALEUR_SOC_ETENDUE_C "" VALUE 0x80248DA2 Val_Wu16 65535.00 DFES_OneToOne 0.00 65535.00 FORMAT "%8.2" /end CHARACTERISTIC
/begin CHARACTERISTIC DFC_DisblMsk2.DFC_ComFrbd_535h_HV_BATT_TEMP_AVG_C "" VALUE 0x80248DA4 Val_Wu16 65535.00 DFES_OneToOne 0.00 65535.00 FORMAT "%8.2" /end CHARACTERISTIC
/begin CHARACTERISTIC DFC_DisblMsk2.DFC_ComFrbd_543h_HVBAT_RESTBATTENERGY_C "" VALUE 0x80248DA6 Val_Wu16 65535.00 DFES_OneToOne 0.00 65535.00 FORMAT "%8.2" /end CHARACTERISTIC
/begin CHARACTERISTIC DFC_DisblMsk2.DFC_ComFrbd_543h_HVBAT_SOH_C "" VALUE 0x80248DA8 Val_Wu16 65535.00 DFES_OneToOne 0.00 65535.00 FORMAT "%8.2" /end CHARACTERISTIC
/begin CHARACTERISTIC DFC_DisblMsk2.DFC_ComFrbd_543h_HV_BATT_SOH_RES_C "" VALUE 0x80248DAA Val_Wu16 65535.00 DFES_OneToOne 0.00 65535.00 FORMAT "%8.2" /end CHARACTERISTIC
/begin CHARACTERISTIC DFC_DisblMsk2.DFC_ComFrbd_592h_IBATT_1_C "" VALUE 0x80248DAC Val_Wu16 65535.00 DFES_OneToOne 0.00 65535.00 FORMAT "%8.2" /end CHARACTERISTIC
/begin CHARACTERISTIC DFC_DisblMsk2.DFC_ComFrbd_592h_IBATT_2_C "" VALUE 0x80248DAE Val_Wu16 65535.00 DFES_OneToOne 0.00 65535.00 FORMAT "%8.2" /end CHARACTERISTIC
/begin CHARACTERISTIC DFC_DisblMsk2.DFC_ComFrbd_592h_IBATT_3_C "" VALUE 0x80248DB0 Val_Wu16 65535.00 DFES_OneToOne 0.00 65535.00 FORMAT "%8.2" /end CHARACTERISTIC
/begin CHARACTERISTIC DFC_DisblMsk2.DFC_ComFrbd_592h_TEMP_BATT_C "" VALUE 0x80248DB2 Val_Wu16 65535.00 DFES_OneToOne 0.00 65535.00 FORMAT "%8.2" /end CHARACTERISTIC
/begin CHARACTERISTIC DFC_DisblMsk2.DFC_ComFrbd_592h_U_BATT_BECB_C "" VALUE 0x80248DB4 Val_Wu16 65535.00 DFES_OneToOne 0.00 65535.00 FORMAT "%8.2" /end CHARACTERISTIC
/begin CHARACTERISTIC DFC_DisblMsk2.DFC_ComFrbd_595h_HVBAT_TIME_TO_CHRG_80_C "" VALUE 0x80248DB6 Val_Wu16 65535.00 DFES_OneToOne 0.00 65535.00 FORMAT "%8.2" /end CHARACTERISTIC
/begin CHARACTERISTIC DFC_DisblMsk2.DFC_ComFrbd_5B2h_TEMP_AIR_EXT_C "" VALUE 0x80248DB8 Val_Wu16 65535.00 DFES_OneToOne 0.00 65535.00 FORMAT "%8.2" /end CHARACTERISTIC
/begin CHARACTERISTIC DFC_DisblMsk2.DFC_ComFrbd_635h_HVBAT_NEG_CONT_COUNT_SEG1_C "" VALUE 0x80248DBA Val_Wu16 65535.00 DFES_OneToOne 0.00 65535.00 FORMAT "%8.2" /end CHARACTERISTIC
/begin CHARACTERISTIC DFC_DisblMsk2.DFC_ComFrbd_635h_HVBAT_NEG_CONT_COUNT_SEG3_C "" VALUE 0x80248DBC Val_Wu16 65535.00 DFES_OneToOne 0.00 65535.00 FORMAT "%8.2" /end CHARACTERISTIC
/begin CHARACTERISTIC DFC_DisblMsk2.DFC_ComFrbd_635h_HVBAT_NEG_CONT_COUNT_SEG4_C "" VALUE 0x80248DBE Val_Wu16 65535.00 DFES_OneToOne 0.00 65535.00 FORMAT "%8.2" /end CHARACTERISTIC
/begin CHARACTERISTIC DFC_DisblMsk2.DFC_ComFrbd_635h_HVBAT_PST_CONT_COUNT_SEG1_C "" VALUE 0x80248DC0 Val_Wu16 65535.00 DFES_OneToOne 0.00 65535.00 FORMAT "%8.2" /end CHARACTERISTIC
/begin CHARACTERISTIC DFC_DisblMsk2.DFC_ComFrbd_635h_HVBAT_PST_CONT_COUNT_SEG3_C "" VALUE 0x80248DC2 Val_Wu16 65535.00 DFES_OneToOne 0.00 65535.00 FORMAT "%8.2" /end CHARACTERISTIC
/begin CHARACTERISTIC DFC_DisblMsk2.DFC_ComFrbd_635h_HVBAT_PST_CONT_COUNT_SEG4_C "" VALUE 0x80248DC4 Val_Wu16 65535.00 DFES_OneToOne 0.00 65535.00 FORMAT "%8.2" /end CHARACTERISTIC
/begin CHARACTERISTIC DFC_DisblMsk2.DFC_ComFrbd_645h_HVBAT_PRECHRGE_CONT_COUNT_SEG1_C "" VALUE 0x80248DC6 Val_Wu16 65535.00 DFES_OneToOne 0.00 65535.00 FORMAT "%8.2" /end CHARACTERISTIC
/begin CHARACTERISTIC DFC_DisblMsk2.DFC_ComFrbd_645h_HVBAT_PRECHRGE_CONT_COUNT_SEG2_C "" VALUE 0x80248DC8 Val_Wu16 65535.00 DFES_OneToOne 0.00 65535.00 FORMAT "%8.2" /end CHARACTERISTIC
/begin CHARACTERISTIC DFC_DisblMsk2.DFC_ComFrbd_675h_HVBAT_REMAININGBATTCAPACITY_C "" VALUE 0x80248DCA Val_Wu16 65535.00 DFES_OneToOne 0.00 65535.00 FORMAT "%8.2" /end CHARACTERISTIC
/begin CHARACTERISTIC DFC_DisblMsk2.DFC_ComInvld_205h_HVBAT_CHARGING_STATUS_C "" VALUE 0x80248DCC Val_Wu16 65535.00 DFES_OneToOne 0.00 65535.00 FORMAT "%8.2" /end CHARACTERISTIC
/begin CHARACTERISTIC DFC_DisblMsk2.DFC_ComInvld_205h_HVBAT_PACK_CURRENT_C "" VALUE 0x80248DCE Val_Wu16 65535.00 DFES_OneToOne 0.00 65535.00 FORMAT "%8.2" /end CHARACTERISTIC
/begin CHARACTERISTIC DFC_DisblMsk2.DFC_ComInvld_205h_HVBAT_SOC_DISPLAY_C "" VALUE 0x80248DD0 Val_Wu16 65535.00 DFES_OneToOne 0.00 65535.00 FORMAT "%8.2" /end CHARACTERISTIC
/begin CHARACTERISTIC DFC_DisblMsk2.DFC_ComInvld_205h_HVBAT_VOLTAGE_C "" VALUE 0x80248DD2 Val_Wu16 65535.00 DFES_OneToOne 0.00 65535.00 FORMAT "%8.2" /end CHARACTERISTIC
/begin CHARACTERISTIC DFC_DisblMsk2.DFC_ComInvld_217h_INV_DC_BUS_VOLTAGE_C "" VALUE 0x80248DD4 Val_Wu16 65535.00 DFES_OneToOne 0.00 65535.00 FORMAT "%8.2" /end CHARACTERISTIC
/begin CHARACTERISTIC DFC_DisblMsk2.DFC_ComInvld_217h_INV_MTR_ACTUAL_TRQ_C "" VALUE 0x80248DD6 Val_Wu16 65535.00 DFES_OneToOne 0.00 65535.00 FORMAT "%8.2" /end CHARACTERISTIC
/begin CHARACTERISTIC DFC_DisblMsk2.DFC_ComInvld_217h_INV_MTR_SPEED_C "" VALUE 0x80248DD8 Val_Wu16 65535.00 DFES_OneToOne 0.00 65535.00 FORMAT "%8.2" /end CHARACTERISTIC
/begin CHARACTERISTIC DFC_DisblMsk2.DFC_ComInvld_217h_INV_MTR_TRQ_C "" VALUE 0x80248DDA Val_Wu16 65535.00 DFES_OneToOne 0.00 65535.00 FORMAT "%8.2" /end CHARACTERISTIC
/begin CHARACTERISTIC DFC_DisblMsk2.DFC_ComInvld_227h_INV_DC_CURRENT_C "" VALUE 0x80248DDC Val_Wu16 65535.00 DFES_OneToOne 0.00 65535.00 FORMAT "%8.2" /end CHARACTERISTIC
/begin CHARACTERISTIC DFC_DisblMsk2.DFC_ComInvld_227h_INV_MOTORING_PEAK_TRQ_C "" VALUE 0x80248DDE Val_Wu16 65535.00 DFES_OneToOne 0.00 65535.00 FORMAT "%8.2" /end CHARACTERISTIC
/begin CHARACTERISTIC DFC_DisblMsk2.DFC_ComInvld_227h_INV_MTR_INST_INPUT_POWER_C "" VALUE 0x80248DE0 Val_Wu16 65535.00 DFES_OneToOne 0.00 65535.00 FORMAT "%8.2" /end CHARACTERISTIC
/begin CHARACTERISTIC DFC_DisblMsk2.DFC_ComInvld_227h_INV_REGEN_PEAK_TRQ_C "" VALUE 0x80248DE2 Val_Wu16 65535.00 DFES_OneToOne 0.00 65535.00 FORMAT "%8.2" /end CHARACTERISTIC
/begin CHARACTERISTIC DFC_DisblMsk2.DFC_ComInvld_237h_INV_ACTIVE_DISCHARGE_STATUS_C "" VALUE 0x80248DE4 Val_Wu16 65535.00 DFES_OneToOne 0.00 65535.00 FORMAT "%8.2" /end CHARACTERISTIC
/begin CHARACTERISTIC DFC_DisblMsk2.DFC_ComInvld_237h_INV_FAULT_LEVEL_C "" VALUE 0x80248DE6 Val_Wu16 65535.00 DFES_OneToOne 0.00 65535.00 FORMAT "%8.2" /end CHARACTERISTIC
/begin CHARACTERISTIC DFC_DisblMsk2.DFC_ComInvld_237h_INV_STAB_MIN_TRQ_C "" VALUE 0x80248DE8 Val_Wu16 65535.00 DFES_OneToOne 0.00 65535.00 FORMAT "%8.2" /end CHARACTERISTIC
/begin CHARACTERISTIC DFC_DisblMsk2.DFC_ComInvld_259h_TGLM_MODE_PUSH_C "" VALUE 0x80248DEA Val_Wu16 65535.00 DFES_OneToOne 0.00 65535.00 FORMAT "%8.2" /end CHARACTERISTIC
/begin CHARACTERISTIC DFC_DisblMsk2.DFC_ComInvld_259h_TOGGLE_MONOSTABLE_POS_C "" VALUE 0x80248DEC Val_Wu16 65535.00 DFES_OneToOne 0.00 65535.00 FORMAT "%8.2" /end CHARACTERISTIC
/begin CHARACTERISTIC DFC_DisblMsk2.DFC_ComInvld_26h_AC_SWITCH_REQ_C "" VALUE 0x80248DEE Val_Wu16 65535.00 DFES_OneToOne 0.00 65535.00 FORMAT "%8.2" /end CHARACTERISTIC
/begin CHARACTERISTIC DFC_DisblMsk2.DFC_ComInvld_26h_BLOWER_POSITION_C "" VALUE 0x80248DF0 Val_Wu16 65535.00 DFES_OneToOne 0.00 65535.00 FORMAT "%8.2" /end CHARACTERISTIC
/begin CHARACTERISTIC DFC_DisblMsk2.DFC_ComInvld_26h_EVAP_SENSOR_FAULT_C "" VALUE 0x80248DF2 Val_Wu16 65535.00 DFES_OneToOne 0.00 65535.00 FORMAT "%8.2" /end CHARACTERISTIC
/begin CHARACTERISTIC DFC_DisblMsk2.DFC_ComInvld_26h_EVAP_SENSOR_VALUE_C "" VALUE 0x80248DF4 Val_Wu16 65535.00 DFES_OneToOne 0.00 65535.00 FORMAT "%8.2" /end CHARACTERISTIC
/begin CHARACTERISTIC DFC_DisblMsk2.DFC_ComInvld_26h_POTENTIOMETER_FAULT_C "" VALUE 0x80248DF6 Val_Wu16 65535.00 DFES_OneToOne 0.00 65535.00 FORMAT "%8.2" /end CHARACTERISTIC
/begin CHARACTERISTIC DFC_DisblMsk2.DFC_ComInvld_26h_REAR_DEFOG_REQ_C "" VALUE 0x80248DF8 Val_Wu16 65535.00 DFES_OneToOne 0.00 65535.00 FORMAT "%8.2" /end CHARACTERISTIC
/begin CHARACTERISTIC DFC_DisblMsk2.DFC_ComInvld_26h_TEMP_POSITION_C "" VALUE 0x80248DFA Val_Wu16 65535.00 DFES_OneToOne 0.00 65535.00 FORMAT "%8.2" /end CHARACTERISTIC
/begin CHARACTERISTIC DFC_DisblMsk2.DFC_ComInvld_273h_OBC_FAULT_LEVEL_C "" VALUE 0x80248DFC Val_Wu16 65535.00 DFES_OneToOne 0.00 65535.00 FORMAT "%8.2" /end CHARACTERISTIC
/begin CHARACTERISTIC DFC_DisblMsk2.DFC_ComInvld_273h_OBC_outputpower_capability_C "" VALUE 0x80248DFE Val_Wu16 65535.00 DFES_OneToOne 0.00 65535.00 FORMAT "%8.2" /end CHARACTERISTIC
/begin CHARACTERISTIC DFC_DisblMsk2.DFC_ComInvld_275h_HVBAT_DISCHARGE_30S_AVAILABLE_CURRENT_C "" VALUE 0x80248E00 Val_Wu16 65535.00 DFES_OneToOne 0.00 65535.00 FORMAT "%8.2" /end CHARACTERISTIC
/begin CHARACTERISTIC DFC_DisblMsk2.DFC_ComInvld_275h_HVBAT_DISCHARGE_30S_AVAILABLE_POWER_C "" VALUE 0x80248E02 Val_Wu16 65535.00 DFES_OneToOne 0.00 65535.00 FORMAT "%8.2" /end CHARACTERISTIC
/begin CHARACTERISTIC DFC_DisblMsk2.DFC_ComInvld_283h_DCDC_IN_CURRENT_C "" VALUE 0x80248E04 Val_Wu16 65535.00 DFES_OneToOne 0.00 65535.00 FORMAT "%8.2" /end CHARACTERISTIC
/begin CHARACTERISTIC DFC_DisblMsk2.DFC_ComInvld_283h_DCDC_IN_VOLTAGE_C "" VALUE 0x80248E06 Val_Wu16 65535.00 DFES_OneToOne 0.00 65535.00 FORMAT "%8.2" /end CHARACTERISTIC
/begin CHARACTERISTIC DFC_DisblMsk2.DFC_ComInvld_283h_DCDC_OUT_CURRENT_C "" VALUE 0x80248E08 Val_Wu16 65535.00 DFES_OneToOne 0.00 65535.00 FORMAT "%8.2" /end CHARACTERISTIC
/begin CHARACTERISTIC DFC_DisblMsk2.DFC_ComInvld_283h_DCDC_OUT_VOLTAGE_C "" VALUE 0x80248E0A Val_Wu16 65535.00 DFES_OneToOne 0.00 65535.00 FORMAT "%8.2" /end CHARACTERISTIC
/begin CHARACTERISTIC DFC_DisblMsk2.DFC_ComInvld_285h_HVBAT_REGEN_CHG_30S_CURRENT_LIMIT_C "" VALUE 0x80248E0C Val_Wu16 65535.00 DFES_OneToOne 0.00 65535.00 FORMAT "%8.2" /end CHARACTERISTIC
/begin CHARACTERISTIC DFC_DisblMsk2.DFC_ComInvld_285h_HVBAT_REGEN_CHRG_30S_POWER_LIMIT_C "" VALUE 0x80248E0E Val_Wu16 65535.00 DFES_OneToOne 0.00 65535.00 FORMAT "%8.2" /end CHARACTERISTIC
/begin CHARACTERISTIC DFC_DisblMsk2.DFC_ComInvld_293h_DCDC_FAULT_LEVEL_C "" VALUE 0x80248E10 Val_Wu16 65535.00 DFES_OneToOne 0.00 65535.00 FORMAT "%8.2" /end CHARACTERISTIC
/begin CHARACTERISTIC DFC_DisblMsk2.DFC_ComInvld_293h_DCDC_outputpower_capability_C "" VALUE 0x80248E12 Val_Wu16 65535.00 DFES_OneToOne 0.00 65535.00 FORMAT "%8.2" /end CHARACTERISTIC
/begin CHARACTERISTIC DFC_DisblMsk2.DFC_ComInvld_325h_HVBAT_EPLUG_STATUS_C "" VALUE 0x80248E14 Val_Wu16 65535.00 DFES_OneToOne 0.00 65535.00 FORMAT "%8.2" /end CHARACTERISTIC
/begin CHARACTERISTIC DFC_DisblMsk2.DFC_ComInvld_325h_HVBAT_HVIL_STS_C "" VALUE 0x80248E16 Val_Wu16 65535.00 DFES_OneToOne 0.00 65535.00 FORMAT "%8.2" /end CHARACTERISTIC
/begin CHARACTERISTIC DFC_DisblMsk2.DFC_ComInvld_325h_HVBAT_INSULATION_FAULT_C "" VALUE 0x80248E18 Val_Wu16 65535.00 DFES_OneToOne 0.00 65535.00 FORMAT "%8.2" /end CHARACTERISTIC
/begin CHARACTERISTIC DFC_DisblMsk2.DFC_ComInvld_325h_HVBAT_INSULATION_RESISTANCE_C "" VALUE 0x80248E1A Val_Wu16 65535.00 DFES_OneToOne 0.00 65535.00 FORMAT "%8.2" /end CHARACTERISTIC
/begin CHARACTERISTIC DFC_DisblMsk2.DFC_ComInvld_325h_HVBAT_TEMPERATURE_C "" VALUE 0x80248E1C Val_Wu16 65535.00 DFES_OneToOne 0.00 65535.00 FORMAT "%8.2" /end CHARACTERISTIC
/begin CHARACTERISTIC DFC_DisblMsk2.DFC_ComInvld_335h_HVBAT_CHRG_CONTINUOUS_CURR_MAX_C "" VALUE 0x80248E1E Val_Wu16 65535.00 DFES_OneToOne 0.00 65535.00 FORMAT "%8.2" /end CHARACTERISTIC
/begin CHARACTERISTIC DFC_DisblMsk2.DFC_ComInvld_335h_HVBAT_CHRG_COTINUOUS_CURR_REQ_C "" VALUE 0x80248E20 Val_Wu16 65535.00 DFES_OneToOne 0.00 65535.00 FORMAT "%8.2" /end CHARACTERISTIC
/begin CHARACTERISTIC DFC_DisblMsk2.DFC_ComInvld_335h_HVBAT_CHRG_MAX_VOLT_C "" VALUE 0x80248E22 Val_Wu16 65535.00 DFES_OneToOne 0.00 65535.00 FORMAT "%8.2" /end CHARACTERISTIC
/begin CHARACTERISTIC DFC_DisblMsk2.DFC_ComInvld_335h_HVBAT_DC_BUS_VOLTAGE_C "" VALUE 0x80248E24 Val_Wu16 65535.00 DFES_OneToOne 0.00 65535.00 FORMAT "%8.2" /end CHARACTERISTIC
/begin CHARACTERISTIC DFC_DisblMsk2.DFC_ComInvld_38Dh_VITESSE_VEHICULE_ROUES_C "" VALUE 0x80248E26 Val_Wu16 65535.00 DFES_OneToOne 0.00 65535.00 FORMAT "%8.2" /end CHARACTERISTIC
/begin CHARACTERISTIC DFC_DisblMsk2.DFC_ComInvld_38Dh_VVH_INDISP_C "" VALUE 0x80248E28 Val_Wu16 65535.00 DFES_OneToOne 0.00 65535.00 FORMAT "%8.2" /end CHARACTERISTIC
/begin CHARACTERISTIC DFC_DisblMsk2.DFC_ComInvld_427h_INV_COOLANT_TEMP_C "" VALUE 0x80248E2A Val_Wu16 65535.00 DFES_OneToOne 0.00 65535.00 FORMAT "%8.2" /end CHARACTERISTIC
/begin CHARACTERISTIC DFC_DisblMsk2.DFC_ComInvld_427h_INV_MOTOR_TEMP_C "" VALUE 0x80248E2C Val_Wu16 65535.00 DFES_OneToOne 0.00 65535.00 FORMAT "%8.2" /end CHARACTERISTIC
/begin CHARACTERISTIC DFC_DisblMsk2.DFC_ComInvld_427h_INV_OP_MODE_C "" VALUE 0x80248E2E Val_Wu16 65535.00 DFES_OneToOne 0.00 65535.00 FORMAT "%8.2" /end CHARACTERISTIC
/begin CHARACTERISTIC DFC_DisblMsk2.DFC_ComInvld_427h_INV_PERMISIBLE_TORQUE_C "" VALUE 0x80248E30 Val_Wu16 65535.00 DFES_OneToOne 0.00 65535.00 FORMAT "%8.2" /end CHARACTERISTIC
/begin CHARACTERISTIC DFC_DisblMsk2.DFC_ComInvld_427h_INV_TEMP_C "" VALUE 0x80248E32 Val_Wu16 65535.00 DFES_OneToOne 0.00 65535.00 FORMAT "%8.2" /end CHARACTERISTIC
/begin CHARACTERISTIC DFC_DisblMsk2.DFC_ComInvld_432h_REVEIL_PRINCIPAL_C "" VALUE 0x80248E34 Val_Wu16 65535.00 DFES_OneToOne 0.00 65535.00 FORMAT "%8.2" /end CHARACTERISTIC
/begin CHARACTERISTIC DFC_DisblMsk2.DFC_ComInvld_435h_HVBAT_MAX_CELL_VOLT_C "" VALUE 0x80248E36 Val_Wu16 65535.00 DFES_OneToOne 0.00 65535.00 FORMAT "%8.2" /end CHARACTERISTIC
/begin CHARACTERISTIC DFC_DisblMsk2.DFC_ComInvld_435h_HVBAT_MAX_CELL_VOLT_NUM_C "" VALUE 0x80248E38 Val_Wu16 65535.00 DFES_OneToOne 0.00 65535.00 FORMAT "%8.2" /end CHARACTERISTIC
/begin CHARACTERISTIC DFC_DisblMsk2.DFC_ComInvld_435h_HVBAT_MAX_SENSOR_TEMP_C "" VALUE 0x80248E3A Val_Wu16 65535.00 DFES_OneToOne 0.00 65535.00 FORMAT "%8.2" /end CHARACTERISTIC
/begin CHARACTERISTIC DFC_DisblMsk2.DFC_ComInvld_435h_HVBAT_MIN_CELL_VOLT_C "" VALUE 0x80248E3C Val_Wu16 65535.00 DFES_OneToOne 0.00 65535.00 FORMAT "%8.2" /end CHARACTERISTIC
/begin CHARACTERISTIC DFC_DisblMsk2.DFC_ComInvld_435h_HVBAT_MIN_CELL_VOLT_NUM_C "" VALUE 0x80248E3E Val_Wu16 65535.00 DFES_OneToOne 0.00 65535.00 FORMAT "%8.2" /end CHARACTERISTIC
/begin CHARACTERISTIC DFC_DisblMsk2.DFC_ComInvld_442h_BCCM_BLOWER_RELAY_STS_C "" VALUE 0x80248E40 Val_Wu16 65535.00 DFES_OneToOne 0.00 65535.00 FORMAT "%8.2" /end CHARACTERISTIC
/begin CHARACTERISTIC DFC_DisblMsk2.DFC_ComInvld_453h_OBC_IN_CURRENT_C "" VALUE 0x80248E42 Val_Wu16 65535.00 DFES_OneToOne 0.00 65535.00 FORMAT "%8.2" /end CHARACTERISTIC
/begin CHARACTERISTIC DFC_DisblMsk2.DFC_ComInvld_453h_OBC_IN_VOLTAGE_C "" VALUE 0x80248E44 Val_Wu16 65535.00 DFES_OneToOne 0.00 65535.00 FORMAT "%8.2" /end CHARACTERISTIC
/begin CHARACTERISTIC DFC_DisblMsk2.DFC_ComInvld_453h_OBC_IP_POWER_C "" VALUE 0x80248E46 Val_Wu16 65535.00 DFES_OneToOne 0.00 65535.00 FORMAT "%8.2" /end CHARACTERISTIC
/begin CHARACTERISTIC DFC_DisblMsk2.DFC_ComInvld_455h_HVBAT_NOMINAL_VOLTAGE_C "" VALUE 0x80248E48 Val_Wu16 65535.00 DFES_OneToOne 0.00 65535.00 FORMAT "%8.2" /end CHARACTERISTIC
/begin CHARACTERISTIC DFC_DisblMsk2.DFC_ComInvld_463h_OBC_OUT_CURRENT_C "" VALUE 0x80248E4A Val_Wu16 65535.00 DFES_OneToOne 0.00 65535.00 FORMAT "%8.2" /end CHARACTERISTIC
/begin CHARACTERISTIC DFC_DisblMsk2.DFC_ComInvld_463h_OBC_OUT_VOLTAGE_C "" VALUE 0x80248E4C Val_Wu16 65535.00 DFES_OneToOne 0.00 65535.00 FORMAT "%8.2" /end CHARACTERISTIC
/begin CHARACTERISTIC DFC_DisblMsk2.DFC_ComInvld_463h_OBC_TEMPERATURE_C "" VALUE 0x80248E4E Val_Wu16 65535.00 DFES_OneToOne 0.00 65535.00 FORMAT "%8.2" /end CHARACTERISTIC
/begin CHARACTERISTIC DFC_DisblMsk2.DFC_ComInvld_473h_DCDC_Coolant_Temperature_C "" VALUE 0x80248E50 Val_Wu16 65535.00 DFES_OneToOne 0.00 65535.00 FORMAT "%8.2" /end CHARACTERISTIC
/begin CHARACTERISTIC DFC_DisblMsk2.DFC_ComInvld_473h_DCDC_TEMPERATURE_C "" VALUE 0x80248E52 Val_Wu16 65535.00 DFES_OneToOne 0.00 65535.00 FORMAT "%8.2" /end CHARACTERISTIC
/begin CHARACTERISTIC DFC_DisblMsk2.DFC_ComInvld_47Bh_eCOMP_BusBarCurrent_C "" VALUE 0x80248E54 Val_Wu16 65535.00 DFES_OneToOne 0.00 65535.00 FORMAT "%8.2" /end CHARACTERISTIC
/begin CHARACTERISTIC DFC_DisblMsk2.DFC_ComInvld_47Bh_eCOMP_BusBarVoltage_C "" VALUE 0x80248E56 Val_Wu16 65535.00 DFES_OneToOne 0.00 65535.00 FORMAT "%8.2" /end CHARACTERISTIC
/begin CHARACTERISTIC DFC_DisblMsk2.DFC_ComInvld_47Bh_eCOMP_CompressorSpeed_C "" VALUE 0x80248E58 Val_Wu16 65535.00 DFES_OneToOne 0.00 65535.00 FORMAT "%8.2" /end CHARACTERISTIC
/begin CHARACTERISTIC DFC_DisblMsk2.DFC_ComInvld_47Bh_eCOMP_IGBT_Temp_C "" VALUE 0x80248E5A Val_Wu16 65535.00 DFES_OneToOne 0.00 65535.00 FORMAT "%8.2" /end CHARACTERISTIC
/begin CHARACTERISTIC DFC_DisblMsk2.DFC_ComInvld_47Bh_eCOMP_PeakPhaCurrent_C "" VALUE 0x80248E5C Val_Wu16 65535.00 DFES_OneToOne 0.00 65535.00 FORMAT "%8.2" /end CHARACTERISTIC
/begin CHARACTERISTIC DFC_DisblMsk2.DFC_ComInvld_47Bh_eCOMP_Power_consumption_C "" VALUE 0x80248E5E Val_Wu16 65535.00 DFES_OneToOne 0.00 65535.00 FORMAT "%8.2" /end CHARACTERISTIC
/begin CHARACTERISTIC DFC_DisblMsk2.DFC_ComInvld_4F2h_STATUS_SOC_C "" VALUE 0x80248E60 Val_Wu16 65535.00 DFES_OneToOne 0.00 65535.00 FORMAT "%8.2" /end CHARACTERISTIC
/begin CHARACTERISTIC DFC_DisblMsk2.DFC_ComInvld_4F2h_TEMP_BATT_STATUS_C "" VALUE 0x80248E62 Val_Wu16 65535.00 DFES_OneToOne 0.00 65535.00 FORMAT "%8.2" /end CHARACTERISTIC
/begin CHARACTERISTIC DFC_DisblMsk2.DFC_ComInvld_4F2h_VALEUR_SOC_ETENDUE_C "" VALUE 0x80248E64 Val_Wu16 65535.00 DFES_OneToOne 0.00 65535.00 FORMAT "%8.2" /end CHARACTERISTIC
/begin CHARACTERISTIC DFC_DisblMsk2.DFC_ComInvld_535h_HV_BATT_TEMP_AVG_C "" VALUE 0x80248E66 Val_Wu16 65535.00 DFES_OneToOne 0.00 65535.00 FORMAT "%8.2" /end CHARACTERISTIC
/begin CHARACTERISTIC DFC_DisblMsk2.DFC_ComInvld_543h_HVBAT_RESTBATTENERGY_C "" VALUE 0x80248E68 Val_Wu16 65535.00 DFES_OneToOne 0.00 65535.00 FORMAT "%8.2" /end CHARACTERISTIC
/begin CHARACTERISTIC DFC_DisblMsk2.DFC_ComInvld_543h_HVBAT_SOH_C "" VALUE 0x80248E6A Val_Wu16 65535.00 DFES_OneToOne 0.00 65535.00 FORMAT "%8.2" /end CHARACTERISTIC
/begin CHARACTERISTIC DFC_DisblMsk2.DFC_ComInvld_543h_HV_BATT_SOH_RES_C "" VALUE 0x80248E6C Val_Wu16 65535.00 DFES_OneToOne 0.00 65535.00 FORMAT "%8.2" /end CHARACTERISTIC
/begin CHARACTERISTIC DFC_DisblMsk2.DFC_ComInvld_552h_CPT_TEMPOREL_C "" VALUE 0x80248E6E Val_Wu16 65535.00 DFES_OneToOne 0.00 65535.00 FORMAT "%8.2" /end CHARACTERISTIC
/begin CHARACTERISTIC DFC_DisblMsk2.DFC_ComInvld_552h_KILOMETRAGE_C "" VALUE 0x80248E70 Val_Wu16 65535.00 DFES_OneToOne 0.00 65535.00 FORMAT "%8.2" /end CHARACTERISTIC
/begin CHARACTERISTIC DFC_DisblMsk2.DFC_ComInvld_583h_HV_BATT_DISCONT_CSE_OPEN_C "" VALUE 0x80248E72 Val_Wu16 65535.00 DFES_OneToOne 0.00 65535.00 FORMAT "%8.2" /end CHARACTERISTIC
/begin CHARACTERISTIC DFC_DisblMsk2.DFC_ComInvld_592h_CALIBRE_IBATT_C "" VALUE 0x80248E74 Val_Wu16 65535.00 DFES_OneToOne 0.00 65535.00 FORMAT "%8.2" /end CHARACTERISTIC
/begin CHARACTERISTIC DFC_DisblMsk2.DFC_ComInvld_592h_IBATT_1_C "" VALUE 0x80248E76 Val_Wu16 65535.00 DFES_OneToOne 0.00 65535.00 FORMAT "%8.2" /end CHARACTERISTIC
/begin CHARACTERISTIC DFC_DisblMsk2.DFC_ComInvld_592h_IBATT_2_C "" VALUE 0x80248E78 Val_Wu16 65535.00 DFES_OneToOne 0.00 65535.00 FORMAT "%8.2" /end CHARACTERISTIC
/begin CHARACTERISTIC DFC_DisblMsk2.DFC_ComInvld_592h_IBATT_3_C "" VALUE 0x80248E7A Val_Wu16 65535.00 DFES_OneToOne 0.00 65535.00 FORMAT "%8.2" /end CHARACTERISTIC
/begin CHARACTERISTIC DFC_DisblMsk2.DFC_ComInvld_592h_TEMP_BATT_C "" VALUE 0x80248E7C Val_Wu16 65535.00 DFES_OneToOne 0.00 65535.00 FORMAT "%8.2" /end CHARACTERISTIC
/begin CHARACTERISTIC DFC_DisblMsk2.DFC_ComInvld_592h_U_BATT_BECB_C "" VALUE 0x80248E7E Val_Wu16 65535.00 DFES_OneToOne 0.00 65535.00 FORMAT "%8.2" /end CHARACTERISTIC
/begin CHARACTERISTIC DFC_DisblMsk2.DFC_ComInvld_595h_HVBAT_TIME_TO_CHRG_80_C "" VALUE 0x80248E80 Val_Wu16 65535.00 DFES_OneToOne 0.00 65535.00 FORMAT "%8.2" /end CHARACTERISTIC
/begin CHARACTERISTIC DFC_DisblMsk2.DFC_ComInvld_5B2h_TEMP_AIR_EXT_C "" VALUE 0x80248E82 Val_Wu16 65535.00 DFES_OneToOne 0.00 65535.00 FORMAT "%8.2" /end CHARACTERISTIC
/begin CHARACTERISTIC DFC_DisblMsk2.DFC_ComInvld_5B5h_HVBAT_THERMAL_RUNAWAY_C "" VALUE 0x80248E84 Val_Wu16 65535.00 DFES_OneToOne 0.00 65535.00 FORMAT "%8.2" /end CHARACTERISTIC
/begin CHARACTERISTIC DFC_DisblMsk2.DFC_ComInvld_635h_HVBAT_NEG_CONT_COUNT_SEG1_C "" VALUE 0x80248E86 Val_Wu16 65535.00 DFES_OneToOne 0.00 65535.00 FORMAT "%8.2" /end CHARACTERISTIC
/begin CHARACTERISTIC DFC_DisblMsk2.DFC_ComInvld_635h_HVBAT_NEG_CONT_COUNT_SEG3_C "" VALUE 0x80248E88 Val_Wu16 65535.00 DFES_OneToOne 0.00 65535.00 FORMAT "%8.2" /end CHARACTERISTIC
/begin CHARACTERISTIC DFC_DisblMsk2.DFC_ComInvld_635h_HVBAT_NEG_CONT_COUNT_SEG4_C "" VALUE 0x80248E8A Val_Wu16 65535.00 DFES_OneToOne 0.00 65535.00 FORMAT "%8.2" /end CHARACTERISTIC
/begin CHARACTERISTIC DFC_DisblMsk2.DFC_ComInvld_635h_HVBAT_PST_CONT_COUNT_SEG1_C "" VALUE 0x80248E8C Val_Wu16 65535.00 DFES_OneToOne 0.00 65535.00 FORMAT "%8.2" /end CHARACTERISTIC
/begin CHARACTERISTIC DFC_DisblMsk2.DFC_ComInvld_635h_HVBAT_PST_CONT_COUNT_SEG3_C "" VALUE 0x80248E8E Val_Wu16 65535.00 DFES_OneToOne 0.00 65535.00 FORMAT "%8.2" /end CHARACTERISTIC
/begin CHARACTERISTIC DFC_DisblMsk2.DFC_ComInvld_635h_HVBAT_PST_CONT_COUNT_SEG4_C "" VALUE 0x80248E90 Val_Wu16 65535.00 DFES_OneToOne 0.00 65535.00 FORMAT "%8.2" /end CHARACTERISTIC
/begin CHARACTERISTIC DFC_DisblMsk2.DFC_ComInvld_645h_HVBAT_PRECHRGE_CONT_COUNT_SEG1_C "" VALUE 0x80248E92 Val_Wu16 65535.00 DFES_OneToOne 0.00 65535.00 FORMAT "%8.2" /end CHARACTERISTIC
/begin CHARACTERISTIC DFC_DisblMsk2.DFC_ComInvld_645h_HVBAT_PRECHRGE_CONT_COUNT_SEG2_C "" VALUE 0x80248E94 Val_Wu16 65535.00 DFES_OneToOne 0.00 65535.00 FORMAT "%8.2" /end CHARACTERISTIC
/begin CHARACTERISTIC DFC_DisblMsk2.DFC_ComInvld_675h_HVBAT_REMAININGBATTCAPACITY_C "" VALUE 0x80248E96 Val_Wu16 65535.00 DFES_OneToOne 0.00 65535.00 FORMAT "%8.2" /end CHARACTERISTIC
/begin CHARACTERISTIC DrvInfo_wTotTripEgy_5A2hIni_C "" VALUE 0x80257FB4 Val_Ws16 2047.000 OneToOne -1024.000 1023.000 FORMAT "%8.3" EXTENDED_LIMITS -32768.00 32767.00 /end CHARACTERISTIC
/begin CHARACTERISTIC DrvInfo_wTotTripEgy_5A2hInvld_C "" VALUE 0x80257FB6 Val_Ws16 2047.000 OneToOne -1024.000 1023.000 FORMAT "%8.3" EXTENDED_LIMITS -32768.00 32767.00 /end CHARACTERISTIC
/begin CHARACTERISTIC EChrDv_cntPlin_481hIni_C "" VALUE 0x80257FB8 Val_Wu16 32767.00 OneToOne 0.00 32767.00 FORMAT "%8.2" EXTENDED_LIMITS 0.00 65535.00 /end CHARACTERISTIC
/begin CHARACTERISTIC EChrDv_cntPlin_481hInvld_C "" VALUE 0x80257FBA Val_Wu16 32767.00 OneToOne 0.00 32767.00 FORMAT "%8.2" EXTENDED_LIMITS 0.00 65535.00 /end CHARACTERISTIC
/begin CHARACTERISTIC Eem_flgFstHvShdwn_241hIni_C "" VALUE 0x80257FBC Val_Wu8 1.000 OneToOne 0.00 1.000 FORMAT "%5.3" EXTENDED_LIMITS 0.00 255.0 /end CHARACTERISTIC
/begin CHARACTERISTIC ElM_stDesEem01_208hIni_C "" VALUE 0x80257FBD Val_Wu8 7.000 OneToOne 0.00 7.000 FORMAT "%5.3" EXTENDED_LIMITS 0.00 255.0 /end CHARACTERISTIC
/begin CHARACTERISTIC ElTS_egyTotChrgCyc_50FhIni_C "" VALUE 0x80257FBE Val_Wu16 2047.000 OneToOne 0.00 2047.000 FORMAT "%8.3" EXTENDED_LIMITS 0.00 65535.00 /end CHARACTERISTIC
/begin CHARACTERISTIC ElTS_egyTotChrgCyc_50FhInvld_C "" VALUE 0x80257FC0 Val_Wu16 2047.000 OneToOne 0.00 2047.000 FORMAT "%8.3" EXTENDED_LIMITS 0.00 65535.00 /end CHARACTERISTIC
/begin CHARACTERISTIC ElTS_ratEmPowChrgn_221hIni_C "" VALUE 0x80257FC2 Val_Wu8 127.0 OneToOne 0.00 127.0 FORMAT "%5.1" EXTENDED_LIMITS 0.00 255.0 /end CHARACTERISTIC
/begin CHARACTERISTIC ElTS_ratEmPowChrgn_221hInvld_C "" VALUE 0x80257FC3 Val_Wu8 127.0 OneToOne 0.00 127.0 FORMAT "%5.1" EXTENDED_LIMITS 0.00 255.0 /end CHARACTERISTIC
/begin CHARACTERISTIC ElTS_ratEmPowDcha_221hIni_C "" VALUE 0x80257FC4 Val_Wu8 127.0 OneToOne 0.00 127.0 FORMAT "%5.1" EXTENDED_LIMITS 0.00 255.0 /end CHARACTERISTIC
/begin CHARACTERISTIC ElTS_ratEmPowDcha_221hInvld_C "" VALUE 0x80257FC5 Val_Wu8 127.0 OneToOne 0.00 127.0 FORMAT "%5.1" EXTENDED_LIMITS 0.00 255.0 /end CHARACTERISTIC
/begin CHARACTERISTIC ElTS_stChrgCyc_50FhIni_C "" VALUE 0x80257FC6 Val_Wu8 3.000 OneToOne 0.00 3.000 FORMAT "%5.3" EXTENDED_LIMITS 0.00 255.0 /end CHARACTERISTIC
/begin CHARACTERISTIC Emac_stIsoMonSwtReq_208hIni_C "" VALUE 0x80257FC7 Val_Wu8 3.000 OneToOne 0.00 3.000 FORMAT "%5.3" EXTENDED_LIMITS 0.00 255.0 /end CHARACTERISTIC
/begin CHARACTERISTIC Emac_tqDesCom01_208hIni_C "" VALUE 0x80257FC8 Val_Ws16 4095.000 OneToOne -2048.000 2047.000 FORMAT "%8.3" EXTENDED_LIMITS -32768.00 32767.00 /end CHARACTERISTIC
/begin CHARACTERISTIC Emac_tqDesCom01_208hInvld_C "" VALUE 0x80257FCA Val_Ws16 4095.000 OneToOne -2048.000 2047.000 FORMAT "%8.3" EXTENDED_LIMITS -32768.00 32767.00 /end CHARACTERISTIC
/begin CHARACTERISTIC Ext_bSyncGPC_211hIni_C "" VALUE 0x80257FCC Val_Wu8 1.000 OneToOne 0.00 1.000 FORMAT "%5.3" EXTENDED_LIMITS 0.00 255.0 /end CHARACTERISTIC
/begin CHARACTERISTIC HvBatt_flgIsoMeasmtDiReq_211hIni_C "" VALUE 0x80257FCD Val_Wu8 1.000 OneToOne 0.00 1.000 FORMAT "%5.3" EXTENDED_LIMITS 0.00 255.0 /end CHARACTERISTIC
/begin CHARACTERISTIC HvBatt_ratSoc_201hIni_C "" VALUE 0x80257FCE Val_Wu16 1023.000 OneToOne 0.00 1023.000 FORMAT "%8.3" EXTENDED_LIMITS 0.00 65535.00 /end CHARACTERISTIC
/begin CHARACTERISTIC HvBatt_ratSoc_201hInvld_C "" VALUE 0x80257FD0 Val_Wu16 1023.000 OneToOne 0.00 1023.000 FORMAT "%8.3" EXTENDED_LIMITS 0.00 65535.00 /end CHARACTERISTIC
/begin CHARACTERISTIC HvGrid_pwrMaxDcdc_281hIni_C "" VALUE 0x80257FD2 Val_Wu16 511.0000 OneToOne 0.00 511.0000 FORMAT "%8.4" EXTENDED_LIMITS 0.00 65535.00 /end CHARACTERISTIC
/begin CHARACTERISTIC HvGrid_pwrMaxDcdc_281hInvld_C "" VALUE 0x80257FD4 Val_Wu16 511.0000 OneToOne 0.00 511.0000 FORMAT "%8.4" EXTENDED_LIMITS 0.00 65535.00 /end CHARACTERISTIC
/begin CHARACTERISTIC ThermHvac_stRemPrecndn_5A2hIni_C "" VALUE 0x80257FD6 Val_Wu8 15.00 OneToOne 0.00 15.00 FORMAT "%5.2" EXTENDED_LIMITS 0.00 255.0 /end CHARACTERISTIC
/begin CHARACTERISTIC VehCoorn_dstRngPrdcDispTx_221hIni_C "" VALUE 0x80257FD8 Val_Wu16 511.0000 OneToOne 0.00 511.0000 FORMAT "%8.4" EXTENDED_LIMITS 0.00 65535.00 /end CHARACTERISTIC
/begin CHARACTERISTIC VehCoorn_dstRngPrdcDispTx_221hInvld_C "" VALUE 0x80257FDA Val_Wu16 511.0000 OneToOne 0.00 511.0000 FORMAT "%8.4" EXTENDED_LIMITS 0.00 65535.00 /end CHARACTERISTIC
/begin CHARACTERISTIC VehCoorn_wCnsTotWghtAvrgEffTx_201hIni_C "" VALUE 0x80257FDC Val_Wu16 511.0000 OneToOne 0.00 511.0000 FORMAT "%8.4" EXTENDED_LIMITS 0.00 65535.00 /end CHARACTERISTIC
/begin CHARACTERISTIC VehCoorn_wCnsTotWghtAvrgEffTx_201hInvld_C "" VALUE 0x80257FDE Val_Wu16 511.0000 OneToOne 0.00 511.0000 FORMAT "%8.4" EXTENDED_LIMITS 0.00 65535.00 /end CHARACTERISTIC
/begin CHARACTERISTIC VehCoorn_wCnsTotWghtTripAvrgEffTx_5A2hIni_C "" VALUE 0x80257FE0 Val_Wu16 511.0000 OneToOne 0.00 511.0000 FORMAT "%8.4" EXTENDED_LIMITS 0.00 65535.00 /end CHARACTERISTIC
/begin CHARACTERISTIC VehCoorn_wCnsTotWghtTripAvrgEffTx_5A2hInvld_C "" VALUE 0x80257FE2 Val_Wu16 511.0000 OneToOne 0.00 511.0000 FORMAT "%8.4" EXTENDED_LIMITS 0.00 65535.00 /end CHARACTERISTIC
/begin CHARACTERISTIC VehCoorn_wCnsWghtAvrgEffTripA_5A2hIni_C "" VALUE 0x80257FE4 Val_Wu16 511.0000 OneToOne 0.00 511.0000 FORMAT "%8.4" EXTENDED_LIMITS 0.00 65535.00 /end CHARACTERISTIC
/begin CHARACTERISTIC VehCoorn_wCnsWghtAvrgEffTripB_5A2hIni_C "" VALUE 0x80257FE6 Val_Wu16 511.0000 OneToOne 0.00 511.0000 FORMAT "%8.4" EXTENDED_LIMITS 0.00 65535.00 /end CHARACTERISTIC
/begin MEASUREMENT CoPOM_facCnvnPwrTqEm01 "power to torque conversion factor based on EM01 rotational speed" SLONG Fact_100000 1 100 -21474.8364800 21474.8364700 FORMAT "%13.7" ECU_ADDRESS 0x60000AB4
 /begin IF_DATA XCPplus 0x0102
  /begin DAQ_EVENT VARIABLE /end DAQ_EVENT
 /end IF_DATA
/end MEASUREMENT
/begin MEASUREMENT CoPOM_flgPrpnPwrRedHmi "Flag which indicates the warning propulsion power reduced in case permissible propulsion power is below threshold OR a failure reaction limits the propulsion torque" UBYTE B_TRUE 1 100 0.00 1.00000000000 BIT_MASK 0x1 FORMAT "%13.11" ECU_ADDRESS 0x600234C6
 /begin IF_DATA XCPplus 0x0102
  /begin DAQ_EVENT VARIABLE /end DAQ_EVENT
 /end IF_DATA
/end MEASUREMENT
/begin MEASUREMENT CoPOM_flgPrpPwrInhbHmi "Flag which indicates the warning propulsion inhibited in case a failure reaction inhibit the propulsion torque" UBYTE B_TRUE 1 100 0.00 1.00000000000 BIT_MASK 0x1 FORMAT "%13.11" ECU_ADDRESS 0x600234C7
 /begin IF_DATA XCPplus 0x0102
  /begin DAQ_EVENT VARIABLE /end DAQ_EVENT
 /end IF_DATA
/end MEASUREMENT
/begin MEASUREMENT CoPOM_flgRecupPwrRedHmi "Flag which indicates the warning no recuperation in case Reduced Recuperation Power or a failure reaction inhibits the recuperation torque" UBYTE B_TRUE 1 100 0.00 1.00000000000 BIT_MASK 0x1 FORMAT "%13.11" ECU_ADDRESS 0x600234C5
 /begin IF_DATA XCPplus 0x0102
  /begin DAQ_EVENT VARIABLE /end DAQ_EVENT
 /end IF_DATA
/end MEASUREMENT
/begin MEASUREMENT CoPOM_pwrAct01Tmp "temporary variable to change resolution of EM01 powerfrom 16 to 25" SWORD RBPtCel_pwr_25p0_1 1 100 -819200.0 819175.0 FORMAT "%8.1" ECU_ADDRESS 0x6001F518
 /begin IF_DATA XCPplus 0x0102
  /begin DAQ_EVENT VARIABLE /end DAQ_EVENT
 /end IF_DATA
/end MEASUREMENT
/begin MEASUREMENT CoPOM_pwrElecEm01DynMax "Maximum possible short term discharge power allocated to Em01 considering electrical system" SWORD RBPtCel_pwr_25p0_1 1 100 -819200.0 819175.0 FORMAT "%8.1" ECU_ADDRESS 0x6001FBE8
 /begin IF_DATA XCPplus 0x0102
  /begin DAQ_EVENT VARIABLE /end DAQ_EVENT
 /end IF_DATA
/end MEASUREMENT
/begin MEASUREMENT CoPOM_pwrElecEm01DynMin "Minimum possible short term power (maximum charge power as a negative value) allocated to Em01 considering electrical system" SWORD RBPtCel_pwr_25p0_1 1 100 -819200.0 819175.0 FORMAT "%8.1" ECU_ADDRESS 0x6001FBE6
 /begin IF_DATA XCPplus 0x0102
  /begin DAQ_EVENT VARIABLE /end DAQ_EVENT
 /end IF_DATA
/end MEASUREMENT
/begin MEASUREMENT CoPOM_pwrElecQstyMax "long-term maximum HV power limit (same as Long Term Motoring Power Limit for Powertrain)" SWORD RBPtCel_pwr_25p0_1 1 100 -819200.0 819175.0 FORMAT "%8.1" ECU_ADDRESS 0x6001FBE4
 /begin IF_DATA XCPplus 0x0102
  /begin DAQ_EVENT VARIABLE /end DAQ_EVENT
 /end IF_DATA
/end MEASUREMENT
/begin MEASUREMENT CoPOM_pwrElecQstyMin "long-term minimum HV power limit (Same as Long Term Generator Power Limit for Powertrain)" SWORD RBPtCel_pwr_25p0_1 1 100 -819200.0 819175.0 FORMAT "%8.1" ECU_ADDRESS 0x6001FBE2
 /begin IF_DATA XCPplus 0x0102
  /begin DAQ_EVENT VARIABLE /end DAQ_EVENT
 /end IF_DATA
/end MEASUREMENT
/begin MEASUREMENT CoPOM_pwrLimdRecup "permissible recuperation power obtained as the sum of powers for primary and secondary axle" SWORD leist_q16_W 1 100 -524288.0 524272.0 FORMAT "%8.1" ECU_ADDRESS 0x6001FBE0
 /begin IF_DATA XCPplus 0x0102
  /begin DAQ_EVENT VARIABLE /end DAQ_EVENT
 /end IF_DATA
/end MEASUREMENT
/begin MEASUREMENT CoPOM_pwrPrpnMax "maximum permissible propulsion power obtained as the sum of powers for primary and secondary axle" SWORD leist_q16_W 1 100 -524288.0 524272.0 FORMAT "%8.1" ECU_ADDRESS 0x6001F51C
 /begin IF_DATA XCPplus 0x0102
  /begin DAQ_EVENT VARIABLE /end DAQ_EVENT
 /end IF_DATA
/end MEASUREMENT
/begin MEASUREMENT CoPOM_pwrPrpnRed "permissible propulsion power obtained as the sum of powers for primary and secondary axle" SWORD leist_q16_W 1 100 -524288.0 524272.0 FORMAT "%8.1" ECU_ADDRESS 0x6001FBDE
 /begin IF_DATA XCPplus 0x0102
  /begin DAQ_EVENT VARIABLE /end DAQ_EVENT
 /end IF_DATA
/end MEASUREMENT
/begin MEASUREMENT CoPOM_pwrRecupMin "minimum permissible recuperation power obtained as the sum of powers for primary and secondary axle" SWORD leist_q16_W 1 100 -524288.0 524272.0 FORMAT "%8.1" ECU_ADDRESS 0x6001F51A
 /begin IF_DATA XCPplus 0x0102
  /begin DAQ_EVENT VARIABLE /end DAQ_EVENT
 /end IF_DATA
/end MEASUREMENT
/begin MEASUREMENT CoPOM_tqElecPrimQstyMax "Quasi stationary discharge torque limit for primary axle" SWORD Trq 1 100 -3276.800 3276.700 FORMAT "%8.3" ECU_ADDRESS 0x6001FBDC
 /begin IF_DATA XCPplus 0x0102
  /begin DAQ_EVENT VARIABLE /end DAQ_EVENT
 /end IF_DATA
/end MEASUREMENT
/begin MEASUREMENT CoPOM_tqElecPrimQstyMaxTemp "Temporary value for the calculation of Quasi stationary discharge torque limit for primary axle" SLONG Trq 1 100 -214748364.800 214748364.700 FORMAT "%13.3" ECU_ADDRESS 0x60000AB0
 /begin IF_DATA XCPplus 0x0102
  /begin DAQ_EVENT VARIABLE /end DAQ_EVENT
 /end IF_DATA
/end MEASUREMENT
/begin MEASUREMENT CoPOM_tqElecPrimQstyMin "Quasi stationary charge torque limit for primary axle" SWORD Trq 1 100 -3276.800 3276.700 FORMAT "%8.3" ECU_ADDRESS 0x6001FBDA
 /begin IF_DATA XCPplus 0x0102
  /begin DAQ_EVENT VARIABLE /end DAQ_EVENT
 /end IF_DATA
/end MEASUREMENT
/begin MEASUREMENT CoPOM_tqElecPrimQstyMinTemp "Temporary value for the calculation of Quasi stationary charge torque limit for primary axle" SLONG Trq 1 100 -214748364.800 214748364.700 FORMAT "%13.3" ECU_ADDRESS 0x60000AAC
 /begin IF_DATA XCPplus 0x0102
  /begin DAQ_EVENT VARIABLE /end DAQ_EVENT
 /end IF_DATA
/end MEASUREMENT
/begin MEASUREMENT CoPOM_tqEmacDynMax01 "Maximum dynamic torque of e-machine 1" SWORD Trq 1 100 -3276.800 3276.700 FORMAT "%8.3" ECU_ADDRESS 0x6001FBD8
 /begin IF_DATA XCPplus 0x0102
  /begin DAQ_EVENT VARIABLE /end DAQ_EVENT
 /end IF_DATA
/end MEASUREMENT
/begin MEASUREMENT CoPOM_tqEmacDynMin01 "Maximum dynamic torque of e-machine 1" SWORD Trq 1 100 -3276.800 3276.700 FORMAT "%8.3" ECU_ADDRESS 0x6001FBD6
 /begin IF_DATA XCPplus 0x0102
  /begin DAQ_EVENT VARIABLE /end DAQ_EVENT
 /end IF_DATA
/end MEASUREMENT
/begin MEASUREMENT CoPOM_tqMaxBattPwrLim "Quasi stationary discharge torque limit based on long-term maximum HV power limit" SWORD Trq 1 100 -3276.800 3276.700 FORMAT "%8.3" ECU_ADDRESS 0x6001F516
 /begin IF_DATA XCPplus 0x0102
  /begin DAQ_EVENT VARIABLE /end DAQ_EVENT
 /end IF_DATA
/end MEASUREMENT
/begin MEASUREMENT CoPOM_tqPrimMaxErrHndlg "Limiting torque for the Maximum torque limit of the e-motor on the primary axle during fault detection" SWORD Trq 1 100 -3276.800 3276.700 FORMAT "%8.3" ECU_ADDRESS 0x6001F514
 /begin IF_DATA XCPplus 0x0102
  /begin DAQ_EVENT VARIABLE /end DAQ_EVENT
 /end IF_DATA
/end MEASUREMENT
/begin MEASUREMENT CoPOM_tqPrimMinErrHndlg "Limiting torque for the Minimum torque limit of the e-motor on the primary axle during fault detection" SWORD Trq 1 100 -3276.800 3276.700 FORMAT "%8.3" ECU_ADDRESS 0x6001F512
 /begin IF_DATA XCPplus 0x0102
  /begin DAQ_EVENT VARIABLE /end DAQ_EVENT
 /end IF_DATA
/end MEASUREMENT
/begin MEASUREMENT CoPOM_tqWhlElecPrimQstyMax "Maximum quasi stationary Electric torque limit for Primary axle at wheel level" SLONG TrqPrpHigh 1 100 -214748364.800 214748364.700 FORMAT "%13.3" ECU_ADDRESS 0x60000AA8
 /begin IF_DATA XCPplus 0x0102
  /begin DAQ_EVENT VARIABLE /end DAQ_EVENT
 /end IF_DATA
/end MEASUREMENT
/begin MEASUREMENT CoPOM_tqWhlElecPrimQstyMin "Minimum quasi stationary Electric torque limit for Primary axle at wheel level" SLONG TrqPrpHigh 1 100 -214748364.800 214748364.700 FORMAT "%13.3" ECU_ADDRESS 0x60000AA4
 /begin IF_DATA XCPplus 0x0102
  /begin DAQ_EVENT VARIABLE /end DAQ_EVENT
 /end IF_DATA
/end MEASUREMENT
/begin MEASUREMENT CoPOM_tqWhlMeclPrimQstyMax "Maximum quasi stationary mechanical torque limit for Primary axle at wheel level" SLONG TrqPrpHigh 1 100 -214748364.800 214748364.700 FORMAT "%13.3" ECU_ADDRESS 0x60000FB0
 /begin IF_DATA XCPplus 0x0102
  /begin DAQ_EVENT VARIABLE /end DAQ_EVENT
 /end IF_DATA
/end MEASUREMENT
/begin MEASUREMENT CoPOM_tqWhlMeclPrimQstyMin "Minimum quasi stationary mechanical torque limit for Primary axle at wheel level" SLONG TrqPrpHigh 1 100 -214748364.800 214748364.700 FORMAT "%13.3" ECU_ADDRESS 0x60000FAC
 /begin IF_DATA XCPplus 0x0102
  /begin DAQ_EVENT VARIABLE /end DAQ_EVENT
 /end IF_DATA
/end MEASUREMENT
/begin MEASUREMENT CoPOM_tqWhlPrimAxleQstyMax "maximum axle torque of the primary axle (quasi stationary limit)" SLONG TrqPrpHigh 1 100 -214748364.800 214748364.700 FORMAT "%13.3" ECU_ADDRESS 0x60000FA8
 /begin IF_DATA XCPplus 0x0102
  /begin DAQ_EVENT VARIABLE /end DAQ_EVENT
 /end IF_DATA
/end MEASUREMENT
/begin MEASUREMENT CoPOM_tqWhlPrimAxleQstyMaxPre "Pre-calculated value for the calculation of Maximum quasi-stationary torque limit of primary axle at wheel level" SLONG TrqPrpHigh 1 100 -214748364.800 214748364.700 FORMAT "%13.3" ECU_ADDRESS 0x60000AA0
 /begin IF_DATA XCPplus 0x0102
  /begin DAQ_EVENT VARIABLE /end DAQ_EVENT
 /end IF_DATA
/end MEASUREMENT
/begin MEASUREMENT CoPOM_tqWhlPrimAxleQstyMin "minimum axle torque of the primary axle (quasi stationary limit)" SLONG TrqPrpHigh 1 100 -214748364.800 214748364.700 FORMAT "%13.3" ECU_ADDRESS 0x60000FA4
 /begin IF_DATA XCPplus 0x0102
  /begin DAQ_EVENT VARIABLE /end DAQ_EVENT
 /end IF_DATA
/end MEASUREMENT
/begin MEASUREMENT CoPOM_tqWhlPrimAxleQstyMinPre "Pre-calculated value for the calculation of Minimum quasi-stationary torque limit of primary axle at wheel level" SLONG TrqPrpHigh 1 100 -214748364.800 214748364.700 FORMAT "%13.3" ECU_ADDRESS 0x60000A9C
 /begin IF_DATA XCPplus 0x0102
  /begin DAQ_EVENT VARIABLE /end DAQ_EVENT
 /end IF_DATA
/end MEASUREMENT
/begin MEASUREMENT CoPOM_tqWhlQstyMax "Maximum quasistationary sum wheel torque" SLONG TrqPrpHigh 1 100 -214748364.800 214748364.700 FORMAT "%13.3" ECU_ADDRESS 0x60000FA0
 /begin IF_DATA XCPplus 0x0102
  /begin DAQ_EVENT VARIABLE /end DAQ_EVENT
 /end IF_DATA
/end MEASUREMENT
/begin MEASUREMENT CoPOM_tqWhlQstyMin "Minimum quasistationary sum wheel torque" SLONG TrqPrpHigh 1 100 -214748364.800 214748364.700 FORMAT "%13.3" ECU_ADDRESS 0x60000F9C
 /begin IF_DATA XCPplus 0x0102
  /begin DAQ_EVENT VARIABLE /end DAQ_EVENT
 /end IF_DATA
/end MEASUREMENT
/begin MEASUREMENT CoPTEv_stTqLimd "indicates which torque limitation is active for all motors" UBYTE OneToOne 1 100 0.00 255.0 FORMAT "%5.1" ECU_ADDRESS 0x60023646
 /begin IF_DATA XCPplus 0x0102
  /begin DAQ_EVENT VARIABLE /end DAQ_EVENT
 /end IF_DATA
/end MEASUREMENT
/begin MEASUREMENT CoPTEv_stTqLimd01 "indicates which torque limitation is active for motor 1" UBYTE OneToOne 1 100 0.00 255.0 FORMAT "%5.1" ECU_ADDRESS 0x60023647
 /begin IF_DATA XCPplus 0x0102
  /begin DAQ_EVENT VARIABLE /end DAQ_EVENT
 /end IF_DATA
/end MEASUREMENT
/begin MEASUREMENT CoPTEv_tqEmac01 "desired e-machine torque before transmission intervention (e-machine 1)" SWORD Trq 1 100 -3276.800 3276.700 FORMAT "%8.3" ECU_ADDRESS 0x6001F510
 /begin IF_DATA XCPplus 0x0102
  /begin DAQ_EVENT VARIABLE /end DAQ_EVENT
 /end IF_DATA
/end MEASUREMENT
/begin MEASUREMENT CoPTEv_tqIntvCoord01 "Driver Demand Torque Intervention Coordination of Emachine01" SLONG TrqPrpHigh 1 100 -214748364.800 214748364.700 FORMAT "%13.3" ECU_ADDRESS 0x60000F98
 /begin IF_DATA XCPplus 0x0102
  /begin DAQ_EVENT VARIABLE /end DAQ_EVENT
 /end IF_DATA
/end MEASUREMENT
/begin MEASUREMENT CoPTEv_tqIntvInc01 "Driver Demand Increasing Torque Intervention on EM01" SLONG TrqPrpHigh 1 100 -214748364.800 214748364.700 FORMAT "%13.3" ECU_ADDRESS 0x60000F94
 /begin IF_DATA XCPplus 0x0102
  /begin DAQ_EVENT VARIABLE /end DAQ_EVENT
 /end IF_DATA
/end MEASUREMENT
/begin MEASUREMENT CoPTEv_tqWithTrsmProtn01 "desired e-machine torque with transmission protection (e-machine 1)" SWORD Trq 1 100 -3276.800 3276.700 FORMAT "%8.3" ECU_ADDRESS 0x6001F50E
 /begin IF_DATA XCPplus 0x0102
  /begin DAQ_EVENT VARIABLE /end DAQ_EVENT
 /end IF_DATA
/end MEASUREMENT
/begin MEASUREMENT CoVMDEv_tqDrvrDmd "Coordinated Driver demand torque" SLONG TrqPrpHigh 1 100 -214748364.800 214748364.700 FORMAT "%13.3" ECU_ADDRESS 0x60000F90
 /begin IF_DATA XCPplus 0x0102
  /begin DAQ_EVENT VARIABLE /end DAQ_EVENT
 /end IF_DATA
/end MEASUREMENT
/begin MEASUREMENT CoVMDEv_tqWithStrtUp "Driver wish with consideration of start up controller" SLONG TrqPrpHigh 1 100 -214748364.800 214748364.700 FORMAT "%13.3" ECU_ADDRESS 0x60000A98
 /begin IF_DATA XCPplus 0x0102
  /begin DAQ_EVENT VARIABLE /end DAQ_EVENT
 /end IF_DATA
/end MEASUREMENT
/begin MEASUREMENT CoVMDEv_tqWoBrkgToZr "coordinated torque without hillhold mode" SLONG TrqPrpHigh 1 100 -214748364.800 214748364.700 FORMAT "%13.3" ECU_ADDRESS 0x60000F8C
 /begin IF_DATA XCPplus 0x0102
  /begin DAQ_EVENT VARIABLE /end DAQ_EVENT
 /end IF_DATA
/end MEASUREMENT
/begin MEASUREMENT CoVMD_flgDrvDmdHiPrio "Flag indicating Driver Demand as High Priority" UBYTE B_TRUE 1 100 0.00 1.00000000000 BIT_MASK 0x1 FORMAT "%13.11" ECU_ADDRESS 0x7000025A
 /begin IF_DATA XCPplus 0x0102
  /begin DAQ_EVENT VARIABLE /end DAQ_EVENT
 /end IF_DATA
/end MEASUREMENT
/begin MEASUREMENT CoVMD_tqPrpLLim "Propulsion torque of longitudinal limiter" SLONG TrqPrpHigh 1 100 -214748364.800 214748364.700 FORMAT "%13.3" ECU_ADDRESS 0x60000A94
 /begin IF_DATA XCPplus 0x0102
  /begin DAQ_EVENT VARIABLE /end DAQ_EVENT
 /end IF_DATA
/end MEASUREMENT
/begin MEASUREMENT CoVMD_tqWhlMinDrvrAssc "Minimum torque limit for driver assistance torque at wheel level" SLONG TrqPrpHigh 1 100 -214748364.800 214748364.700 FORMAT "%13.3" ECU_ADDRESS 0x60000F88
 /begin IF_DATA XCPplus 0x0102
  /begin DAQ_EVENT VARIABLE /end DAQ_EVENT
 /end IF_DATA
/end MEASUREMENT
/begin MEASUREMENT CoVMD_trqLLim "Propulsion torque of longitudinal limiter" SLONG TrqPrpHigh 1 100 -214748364.800 214748364.700 FORMAT "%13.3" ECU_ADDRESS 0x60000F84
 /begin IF_DATA XCPplus 0x0102
  /begin DAQ_EVENT VARIABLE /end DAQ_EVENT
 /end IF_DATA
/end MEASUREMENT
/begin MEASUREMENT DINH_nrActvInhReas.FId_CoPOMLimdPrpnHmi "" UWORD DINH_ct_Compu 1 100 -4095.000 4096.000 BIT_MASK 0x1fff FORMAT "%8.3" ECU_ADDRESS 0x600213BE /end MEASUREMENT
/begin MEASUREMENT DINH_nrActvInhReas.FId_CoPOMMaxLimFltDetnPrim "" UWORD DINH_ct_Compu 1 100 -4095.000 4096.000 BIT_MASK 0x1fff FORMAT "%8.3" ECU_ADDRESS 0x600213C0 /end MEASUREMENT
/begin MEASUREMENT DINH_nrActvInhReas.FId_CoPOMMinLimFltDetnPrim "" UWORD DINH_ct_Compu 1 100 -4095.000 4096.000 BIT_MASK 0x1fff FORMAT "%8.3" ECU_ADDRESS 0x600213C2 /end MEASUREMENT
/begin MEASUREMENT DINH_nrActvInhReas.FId_CoPOMNoPrpnHmi "" UWORD DINH_ct_Compu 1 100 -4095.000 4096.000 BIT_MASK 0x1fff FORMAT "%8.3" ECU_ADDRESS 0x600213C4 /end MEASUREMENT
/begin MEASUREMENT DINH_nrActvInhReas.FId_CoPOMRecupPwrRednHmi "" UWORD DINH_ct_Compu 1 100 -4095.000 4096.000 BIT_MASK 0x1fff FORMAT "%8.3" ECU_ADDRESS 0x600213C6 /end MEASUREMENT
/begin MEASUREMENT DINH_nrActvInhReas.FId_CoPOMRgnInhbnPrim "" UWORD DINH_ct_Compu 1 100 -4095.000 4096.000 BIT_MASK 0x1fff FORMAT "%8.3" ECU_ADDRESS 0x600213C8 /end MEASUREMENT
/begin MEASUREMENT DINH_stFId.FId_CoPOMLimdPrpnHmi "" UWORD DFC_OneToOne 1 100 0.00 65535.00 FORMAT "%8.2" ECU_ADDRESS 0x600213BE /end MEASUREMENT
/begin MEASUREMENT DINH_stFId.FId_CoPOMMaxLimFltDetnPrim "" UWORD DFC_OneToOne 1 100 0.00 65535.00 FORMAT "%8.2" ECU_ADDRESS 0x600213C0 /end MEASUREMENT
/begin MEASUREMENT DINH_stFId.FId_CoPOMMinLimFltDetnPrim "" UWORD DFC_OneToOne 1 100 0.00 65535.00 FORMAT "%8.2" ECU_ADDRESS 0x600213C2 /end MEASUREMENT
/begin MEASUREMENT DINH_stFId.FId_CoPOMNoPrpnHmi "" UWORD DFC_OneToOne 1 100 0.00 65535.00 FORMAT "%8.2" ECU_ADDRESS 0x600213C4 /end MEASUREMENT
/begin MEASUREMENT DINH_stFId.FId_CoPOMRecupPwrRednHmi "" UWORD DFC_OneToOne 1 100 0.00 65535.00 FORMAT "%8.2" ECU_ADDRESS 0x600213C6 /end MEASUREMENT
/begin MEASUREMENT DINH_stFId.FId_CoPOMRgnInhbnPrim "" UWORD DFC_OneToOne 1 100 0.00 65535.00 FORMAT "%8.2" ECU_ADDRESS 0x600213C8 /end MEASUREMENT
/begin MEASUREMENT PT_tqDesEmac01 "Desired torque e machine 1" SWORD Trq 1 100 -3276.800 3276.700 FORMAT "%8.3" ECU_ADDRESS 0x6001FA74
 /begin IF_DATA XCPplus 0x0102
  /begin DAQ_EVENT VARIABLE /end DAQ_EVENT
 /end IF_DATA
/end MEASUREMENT
/begin MEASUREMENT VehMot_stPrpLLim "Status longitudinal limiter controls propulsion torque" UBYTE OneToOne 1 100 0.00 255.0 FORMAT "%5.1" ECU_ADDRESS 0x600234FC
 /begin IF_DATA XCPplus 0x0102
  /begin DAQ_EVENT VARIABLE /end DAQ_EVENT
 /end IF_DATA
/end MEASUREMENT
/begin MEASUREMENT VMDEv_tqDes "Coordinated propulsion torque" SLONG TrqPrpHigh 1 100 -214748364.800 214748364.700 FORMAT "%13.3" ECU_ADDRESS 0x60000F48
 /begin IF_DATA XCPplus 0x0102
  /begin DAQ_EVENT VARIABLE /end DAQ_EVENT
 /end IF_DATA
/end MEASUREMENT
/begin FUNCTION ComScl_NetMtrx "850.8.0   Configuration of network matrix"
 /begin DEF_CHARACTERISTIC DDRC_DurDeb.Com_numComInvld_473h_DCDC_TEMPERATUREDebOk_C DDRC_DurDeb.Com_numComInvld_473h_DCDC_TEMPERATUREDebDef_C DDRC_DurDeb.Com_numComInvld_47Bh_eCOMP_BusBarCurrentDebOk_C DDRC_DurDeb.Com_numComInvld_47Bh_eCOMP_BusBarCurrentDebDef_C DDRC_DurDeb.Com_numComInvld_47Bh_eCOMP_BusBarVoltageDebOk_C DDRC_DurDeb.Com_numComInvld_47Bh_eCOMP_BusBarVoltageDebDef_C DDRC_DurDeb.Com_numComInvld_47Bh_eCOMP_CompressorSpeedDebOk_C DDRC_DurDeb.Com_numComInvld_47Bh_eCOMP_CompressorSpeedDebDef_C DDRC_DurDeb.Com_numComInvld_47Bh_eCOMP_IGBT_TempDebOk_C DDRC_DurDeb.Com_numComInvld_47Bh_eCOMP_IGBT_TempDebDef_C DDRC_DurDeb.Com_numComInvld_47Bh_eCOMP_PeakPhaCurrentDebOk_C DDRC_DurDeb.Com_numComInvld_47Bh_eCOMP_PeakPhaCurrentDebDef_C DDRC_DurDeb.Com_numComInvld_47Bh_eCOMP_Power_consumptionDebOk_C DDRC_DurDeb.Com_numComInvld_47Bh_eCOMP_Power_consumptionDebDef_C DDRC_DurDeb.Com_numComInvld_4F2h_STATUS_SOCDebOk_C DDRC_DurDeb.Com_numComInvld_4F2h_STATUS_SOCDebDef_C DDRC_DurDeb.Com_numComInvld_4F2h_TEMP_BATT_STATUSDebOk_C DDRC_DurDeb.Com_numComInvld_4F2h_TEMP_BATT_STATUSDebDef_C DDRC_DurDeb.Com_numComInvld_4F2h_VALEUR_SOC_ETENDUEDebOk_C DDRC_DurDeb.Com_numComInvld_4F2h_VALEUR_SOC_ETENDUEDebDef_C DDRC_DurDeb.Com_numComInvld_535h_HV_BATT_TEMP_AVGDebOk_C DDRC_DurDeb.Com_numComInvld_535h_HV_BATT_TEMP_AVGDebDef_C DDRC_DurDeb.Com_numComInvld_543h_HVBAT_RESTBATTENERGYDebOk_C DDRC_DurDeb.Com_numComInvld_543h_HVBAT_RESTBATTENERGYDebDef_C DDRC_DurDeb.Com_numComInvld_543h_HVBAT_SOHDebOk_C DDRC_DurDeb.Com_numComInvld_543h_HVBAT_SOHDebDef_C DDRC_DurDeb.Com_numComInvld_543h_HV_BATT_SOH_RESDebOk_C DDRC_DurDeb.Com_numComInvld_543h_HV_BATT_SOH_RESDebDef_C DDRC_DurDeb.Com_numComInvld_552h_CPT_TEMPORELDebOk_C DDRC_DurDeb.Com_numComInvld_552h_CPT_TEMPORELDebDef_C DDRC_DurDeb.Com_numComInvld_552h_KILOMETRAGEDebOk_C DDRC_DurDeb.Com_numComInvld_552h_KILOMETRAGEDebDef_C DDRC_DurDeb.Com_numComInvld_583h_HV_BATT_DISCONT_CSE_OPENDebOk_C DDRC_DurDeb.Com_numComInvld_583h_HV_BATT_DISCONT_CSE_OPENDebDef_C DDRC_DurDeb.Com_numComInvld_592h_CALIBRE_IBATTDebOk_C DDRC_DurDeb.Com_numComInvld_592h_CALIBRE_IBATTDebDef_C DDRC_DurDeb.Com_numComInvld_592h_IBATT_1DebOk_C DDRC_DurDeb.Com_numComInvld_592h_IBATT_1DebDef_C DDRC_DurDeb.Com_numComInvld_592h_IBATT_2DebOk_C DDRC_DurDeb.Com_numComInvld_592h_IBATT_2DebDef_C DDRC_DurDeb.Com_numComInvld_592h_IBATT_3DebOk_C DDRC_DurDeb.Com_numComInvld_592h_IBATT_3DebDef_C DDRC_DurDeb.Com_numComInvld_592h_TEMP_BATTDebOk_C DDRC_DurDeb.Com_numComInvld_592h_TEMP_BATTDebDef_C DDRC_DurDeb.Com_numComInvld_592h_U_BATT_BECBDebOk_C DDRC_DurDeb.Com_numComInvld_592h_U_BATT_BECBDebDef_C DDRC_DurDeb.Com_numComInvld_595h_HVBAT_TIME_TO_CHRG_80DebOk_C DDRC_DurDeb.Com_numComInvld_595h_HVBAT_TIME_TO_CHRG_80DebDef_C DDRC_DurDeb.Com_numComInvld_5B2h_TEMP_AIR_EXTDebOk_C DDRC_DurDeb.Com_numComInvld_5B2h_TEMP_AIR_EXTDebDef_C DDRC_DurDeb.Com_numComInvld_5B5h_HVBAT_THERMAL_RUNAWAYDebOk_C DDRC_DurDeb.Com_numComInvld_5B5h_HVBAT_THERMAL_RUNAWAYDebDef_C DDRC_DurDeb.Com_numComInvld_635h_HVBAT_NEG_CONT_COUNT_SEG1DebOk_C DDRC_DurDeb.Com_numComInvld_635h_HVBAT_NEG_CONT_COUNT_SEG1DebDef_C DDRC_DurDeb.Com_numComInvld_635h_HVBAT_NEG_CONT_COUNT_SEG3DebOk_C DDRC_DurDeb.Com_numComInvld_635h_HVBAT_NEG_CONT_COUNT_SEG3DebDef_C DDRC_DurDeb.Com_numComInvld_635h_HVBAT_NEG_CONT_COUNT_SEG4DebOk_C DDRC_DurDeb.Com_numComInvld_635h_HVBAT_NEG_CONT_COUNT_SEG4DebDef_C DDRC_DurDeb.Com_numComInvld_635h_HVBAT_PST_CONT_COUNT_SEG1DebOk_C DDRC_DurDeb.Com_numComInvld_635h_HVBAT_PST_CONT_COUNT_SEG1DebDef_C DDRC_DurDeb.Com_numComInvld_635h_HVBAT_PST_CONT_COUNT_SEG3DebOk_C DDRC_DurDeb.Com_numComInvld_635h_HVBAT_PST_CONT_COUNT_SEG3DebDef_C DDRC_DurDeb.Com_numComInvld_635h_HVBAT_PST_CONT_COUNT_SEG4DebOk_C DDRC_DurDeb.Com_numComInvld_635h_HVBAT_PST_CONT_COUNT_SEG4DebDef_C DDRC_DurDeb.Com_numComInvld_645h_HVBAT_PRECHRGE_CONT_COUNT_SEG1DebOk_C DDRC_DurDeb.Com_numComInvld_645h_HVBAT_PRECHRGE_CONT_COUNT_SEG1DebDef_C DDRC_DurDeb.Com_numComInvld_645h_HVBAT_PRECHRGE_CONT_COUNT_SEG2DebOk_C DDRC_DurDeb.Com_numComInvld_645h_HVBAT_PRECHRGE_CONT_COUNT_SEG2DebDef_C DDRC_DurDeb.Com_numComInvld_675h_HVBAT_REMAININGBATTCAPACITYDebOk_C DDRC_DurDeb.Com_numComInvld_675h_HVBAT_REMAININGBATTCAPACITYDebDef_C DDRC_DurDeb.Com_tiDFC_Com26hAbsentDebOk_C DDRC_DurDeb.Com_tiDFC_Com26hAbsentDebDef_C DDRC_DurDeb.Com_tiDFC_Com26hTooShortDebOk_C DDRC_DurDeb.Com_tiDFC_Com26hTooShortDebDef_C DDRC_DurDeb.Com_tiDFC_Com5B2hAbsentDebDef_CDebOk_C DDRC_DurDeb.Com_tiDFC_Com5B2hAbsentDebDef_CDebDef_C DDRC_DurDeb.Com_tiDFC_ComInvld_26h_AC_SWITCH_REQDebOk_C DDRC_DurDeb.Com_tiDFC_ComInvld_26h_AC_SWITCH_REQDebDef_C DDRC_DurDeb.Com_tiDFC_ComInvld_26h_BLOWER_POSITIONDebOk_C DDRC_DurDeb.Com_tiDFC_ComInvld_26h_BLOWER_POSITIONDebDef_C DDRC_DurDeb.Com_tiDFC_ComInvld_26h_EVAP_SENSOR_FAULTDebOk_C DDRC_DurDeb.Com_tiDFC_ComInvld_26h_EVAP_SENSOR_FAULTDebDef_C DDRC_DurDeb.Com_tiDFC_ComInvld_26h_EVAP_SENSOR_VALUEDebOk_C DDRC_DurDeb.Com_tiDFC_ComInvld_26h_EVAP_SENSOR_VALUEDebDef_C DDRC_DurDeb.Com_tiDFC_ComInvld_26h_POTENTIOMETER_FAULTDebOk_C DDRC_DurDeb.Com_tiDFC_ComInvld_26h_POTENTIOMETER_FAULTDebDef_C DDRC_DurDeb.Com_tiDFC_ComInvld_26h_REAR_DEFOG_REQDebOk_C DDRC_DurDeb.Com_tiDFC_ComInvld_26h_REAR_DEFOG_REQDebDef_C DDRC_DurDeb.Com_tiDFC_ComInvld_26h_TEMP_POSITIONDebOk_C DDRC_DurDeb.Com_tiDFC_ComInvld_26h_TEMP_POSITIONDebDef_C DFC_CtlMsk2.DFC_Com082hTooShort_C DFC_CtlMsk2.DFC_Com092hTooShort_C DFC_CtlMsk2.DFC_Com205hAbsent_C DFC_CtlMsk2.DFC_Com205hChecksum_C DFC_CtlMsk2.DFC_Com205hCounter_C DFC_CtlMsk2.DFC_Com205hTooShort_C DFC_CtlMsk2.DFC_Com217hAbsent_C DFC_CtlMsk2.DFC_Com217hChecksum_C DFC_CtlMsk2.DFC_Com217hCounter_C DFC_CtlMsk2.DFC_Com217hTooShort_C DFC_CtlMsk2.DFC_Com227hAbsent_C DFC_CtlMsk2.DFC_Com227hTooShort_C DFC_CtlMsk2.DFC_Com237hAbsent_C DFC_CtlMsk2.DFC_Com237hChecksum_C DFC_CtlMsk2.DFC_Com237hCounter_C DFC_CtlMsk2.DFC_Com237hTooShort_C DFC_CtlMsk2.DFC_Com259hAbsent_C DFC_CtlMsk2.DFC_Com259hChecksum_C DFC_CtlMsk2.DFC_Com259hCounter_C DFC_CtlMsk2.DFC_Com259hTooShort_C DFC_CtlMsk2.DFC_Com26hAbsent_C DFC_CtlMsk2.DFC_Com26hTooShort_C DFC_CtlMsk2.DFC_Com273hAbsent_C DFC_CtlMsk2.DFC_Com273hChecksum_C DFC_CtlMsk2.DFC_Com273hCounter_C DFC_CtlMsk2.DFC_Com273hTooShort_C DFC_CtlMsk2.DFC_Com275hAbsent_C DFC_CtlMsk2.DFC_Com275hChecksum_C DFC_CtlMsk2.DFC_Com275hCounter_C DFC_CtlMsk2.DFC_Com275hTooShort_C DFC_CtlMsk2.DFC_Com283hAbsent_C DFC_CtlMsk2.DFC_Com283hTooShort_C DFC_CtlMsk2.DFC_Com285hAbsent_C DFC_CtlMsk2.DFC_Com285hChecksum_C DFC_CtlMsk2.DFC_Com285hCounter_C DFC_CtlMsk2.DFC_Com285hTooShort_C DFC_CtlMsk2.DFC_Com293hAbsent_C DFC_CtlMsk2.DFC_Com293hChecksum_C DFC_CtlMsk2.DFC_Com293hCounter_C DFC_CtlMsk2.DFC_Com293hTooShort_C DFC_CtlMsk2.DFC_Com308hAbsent_C DFC_CtlMsk2.DFC_Com308hChecksum_C DFC_CtlMsk2.DFC_Com308hCounter_C DFC_CtlMsk2.DFC_Com308hTooShort_C DFC_CtlMsk2.DFC_Com318hAbsent_C DFC_CtlMsk2.DFC_Com318hChecksum_C DFC_CtlMsk2.DFC_Com318hCounter_C DFC_CtlMsk2.DFC_Com318hTooShort_C DFC_CtlMsk2.DFC_Com325hAbsent_C DFC_CtlMsk2.DFC_Com325hChecksum_C DFC_CtlMsk2.DFC_Com325hCounter_C DFC_CtlMsk2.DFC_Com325hTooShort_C DFC_CtlMsk2.DFC_Com335hAbsent_C DFC_CtlMsk2.DFC_Com335hChecksum_C DFC_CtlMsk2.DFC_Com335hCounter_C DFC_CtlMsk2.DFC_Com335hTooShort_C DFC_CtlMsk2.DFC_Com351hAbsent_C DFC_CtlMsk2.DFC_Com351hTooShort_C DFC_CtlMsk2.DFC_Com38DhAbsent_C DFC_CtlMsk2.DFC_Com38DhChecksum_C DFC_CtlMsk2.DFC_Com38DhCounter_C DFC_CtlMsk2.DFC_Com38DhTooShort_C DFC_CtlMsk2.DFC_Com412hAbsent_C DFC_CtlMsk2.DFC_Com412hChecksum_C DFC_CtlMsk2.DFC_Com412hCounter_C DFC_CtlMsk2.DFC_Com412hTooShort_C DFC_CtlMsk2.DFC_Com427hAbsent_C DFC_CtlMsk2.DFC_Com427hTooShort_C DFC_CtlMsk2.DFC_Com432hAbsent_C DFC_CtlMsk2.DFC_Com432hChecksum_C DFC_CtlMsk2.DFC_Com432hCounter_C DFC_CtlMsk2.DFC_Com432hTooShort_C DFC_CtlMsk2.DFC_Com435hAbsent_C DFC_CtlMsk2.DFC_Com435hTooShort_C DFC_CtlMsk2.DFC_Com442hAbsent_C DFC_CtlMsk2.DFC_Com442hTooShort_C DFC_CtlMsk2.DFC_Com453hAbsent_C DFC_CtlMsk2.DFC_Com453hTooShort_C DFC_CtlMsk2.DFC_Com455hAbsent_C DFC_CtlMsk2.DFC_Com455hTooShort_C DFC_CtlMsk2.DFC_Com463hAbsent_C DFC_CtlMsk2.DFC_Com463hTooShort_C DFC_CtlMsk2.DFC_Com473hAbsent_C DFC_CtlMsk2.DFC_Com473hTooShort_C DFC_CtlMsk2.DFC_Com47BhAbsent_C DFC_CtlMsk2.DFC_Com47BhTooShort_C DFC_CtlMsk2.DFC_Com48BhAbsent_C DFC_CtlMsk2.DFC_Com48BhTooShort_C DFC_CtlMsk2.DFC_Com497hTooShort_C DFC_CtlMsk2.DFC_Com4F2hAbsent_C DFC_CtlMsk2.DFC_Com4F2hChecksum_C DFC_CtlMsk2.DFC_Com4F2hCounter_C DFC_CtlMsk2.DFC_Com4F2hTooShort_C DFC_CtlMsk2.DFC_Com50DhAbsent_C DFC_CtlMsk2.DFC_Com50DhTooShort_C DFC_CtlMsk2.DFC_Com535hAbsent_C DFC_CtlMsk2.DFC_Com535hTooShort_C DFC_CtlMsk2.DFC_Com543hAbsent_C DFC_CtlMsk2.DFC_Com543hTooShort_C DFC_CtlMsk2.DFC_Com552hAbsent_C DFC_CtlMsk2.DFC_Com552hTooShort_C DFC_CtlMsk2.DFC_Com583hAbsent_C DFC_CtlMsk2.DFC_Com583hTooShort_C DFC_CtlMsk2.DFC_Com592hAbsent_C DFC_CtlMsk2.DFC_Com592hChecksum_C DFC_CtlMsk2.DFC_Com592hCounter_C DFC_CtlMsk2.DFC_Com592hTooShort_C DFC_CtlMsk2.DFC_Com595hAbsent_C DFC_CtlMsk2.DFC_Com595hChecksum_C DFC_CtlMsk2.DFC_Com595hCounter_C DFC_CtlMsk2.DFC_Com595hTooShort_C DFC_CtlMsk2.DFC_Com5B2hAbsent_C DFC_CtlMsk2.DFC_Com5B2hTooShort_C DFC_CtlMsk2.DFC_Com5B5hAbsent_C DFC_CtlMsk2.DFC_Com5B5hChecksum_C DFC_CtlMsk2.DFC_Com5B5hCounter_C DFC_CtlMsk2.DFC_Com5B5hTooShort_C DFC_CtlMsk2.DFC_Com5C7hTooShort_C DFC_CtlMsk2.DFC_Com5E7hAbsent_C DFC_CtlMsk2.DFC_Com5E7hTooShort_C DFC_CtlMsk2.DFC_Com635hTooShort_C DFC_CtlMsk2.DFC_Com645hTooShort_C DFC_CtlMsk2.DFC_Com663hAbsent_C DFC_CtlMsk2.DFC_Com663hTooShort_C DFC_CtlMsk2.DFC_Com665hAbsent_C DFC_CtlMsk2.DFC_Com665hTooShort_C DFC_CtlMsk2.DFC_Com675hAbsent_C DFC_CtlMsk2.DFC_Com675hTooShort_C DFC_CtlMsk2.DFC_ComFrbd_205h_HVBAT_PACK_CURRENT_C DFC_CtlMsk2.DFC_ComFrbd_205h_HVBAT_SOC_DISPLAY_C DFC_CtlMsk2.DFC_ComFrbd_205h_HVBAT_VOLTAGE_C DFC_CtlMsk2.DFC_ComFrbd_217h_INV_DC_BUS_VOLTAGE_C DFC_CtlMsk2.DFC_ComFrbd_217h_INV_MTR_ACTUAL_TRQ_C DFC_CtlMsk2.DFC_ComFrbd_217h_INV_MTR_SPEED_C DFC_CtlMsk2.DFC_ComFrbd_217h_INV_MTR_TRQ_C DFC_CtlMsk2.DFC_ComFrbd_227h_INV_DC_CURRENT_C DFC_CtlMsk2.DFC_ComFrbd_227h_INV_MOTORING_PEAK_TRQ_C DFC_CtlMsk2.DFC_ComFrbd_227h_INV_MTR_INST_INPUT_POWER_C DFC_CtlMsk2.DFC_ComFrbd_227h_INV_REGEN_PEAK_TRQ_C DFC_CtlMsk2.DFC_ComFrbd_237h_INV_ACTIVE_DISCHARGE_STATUS_C DFC_CtlMsk2.DFC_ComFrbd_237h_INV_CTRL_MODE_ACK_C DFC_CtlMsk2.DFC_ComFrbd_237h_INV_EV_WARNING_C DFC_CtlMsk2.DFC_ComFrbd_237h_INV_FAULT_LEVEL_C DFC_CtlMsk2.DFC_ComFrbd_237h_INV_MASTER_STOP_C DFC_CtlMsk2.DFC_ComFrbd_237h_INV_SERVICE_DUE_C DFC_CtlMsk2.DFC_ComFrbd_237h_INV_STAB_MIN_TRQ_C DFC_CtlMsk2.DFC_ComFrbd_259h_TGLM_FAILURE_STATE_C DFC_CtlMsk2.DFC_ComFrbd_259h_TGLM_MODE_PUSH_C DFC_CtlMsk2.DFC_ComFrbd_259h_TOGGLE_MONOSTABLE_POS_C DFC_CtlMsk2.DFC_ComFrbd_273h_OBC_outputpower_capability_C DFC_CtlMsk2.DFC_ComFrbd_275h_HVBAT_DISCHARGE_30S_AVAILABLE_CURRENT_C DFC_CtlMsk2.DFC_ComFrbd_275h_HVBAT_DISCHARGE_30S_AVAILABLE_POWER_C DFC_CtlMsk2.DFC_ComFrbd_283h_DCDC_IN_CURRENT_C DFC_CtlMsk2.DFC_ComFrbd_283h_DCDC_IN_VOLTAGE_C DFC_CtlMsk2.DFC_ComFrbd_283h_DCDC_OUT_CURRENT_C DFC_CtlMsk2.DFC_ComFrbd_283h_DCDC_OUT_VOLTAGE_C DFC_CtlMsk2.DFC_ComFrbd_285h_HVBAT_REGEN_CHG_30S_CURRENT_LIMIT_C DFC_CtlMsk2.DFC_ComFrbd_285h_HVBAT_REGEN_CHRG_30S_POWER_LIMIT_C DFC_CtlMsk2.DFC_ComFrbd_293h_DCDC_outputpower_capability_C DFC_CtlMsk2.DFC_ComFrbd_325h_HVBAT_INSULATION_RESISTANCE_C DFC_CtlMsk2.DFC_ComFrbd_325h_HVBAT_TEMPERATURE_C DFC_CtlMsk2.DFC_ComFrbd_335h_HVBAT_CHRG_CONTINUOUS_CURR_MAX_C DFC_CtlMsk2.DFC_ComFrbd_335h_HVBAT_CHRG_COTINUOUS_CURR_REQ_C DFC_CtlMsk2.DFC_ComFrbd_335h_HVBAT_CHRG_MAX_VOLT_C DFC_CtlMsk2.DFC_ComFrbd_335h_HVBAT_DC_BUS_VOLTAGE_C DFC_CtlMsk2.DFC_ComFrbd_427h_INV_OP_MODE_C DFC_CtlMsk2.DFC_ComFrbd_427h_INV_PERMISIBLE_TORQUE_C DFC_CtlMsk2.DFC_ComFrbd_435h_HVBAT_MAX_CELL_VOLT_C DFC_CtlMsk2.DFC_ComFrbd_435h_HVBAT_MAX_CELL_VOLT_NUM_C DFC_CtlMsk2.DFC_ComFrbd_435h_HVBAT_MAX_SENSOR_TEMP_C DFC_CtlMsk2.DFC_ComFrbd_435h_HVBAT_MIN_CELL_VOLT_C DFC_CtlMsk2.DFC_ComFrbd_435h_HVBAT_MIN_CELL_VOLT_NUM_C DFC_CtlMsk2.DFC_ComFrbd_453h_OBC_IN_CURRENT_C DFC_CtlMsk2.DFC_ComFrbd_453h_OBC_IN_VOLTAGE_C DFC_CtlMsk2.DFC_ComFrbd_453h_OBC_IP_POWER_C DFC_CtlMsk2.DFC_ComFrbd_455h_HVBAT_NOMINAL_VOLTAGE_C DFC_CtlMsk2.DFC_ComFrbd_463h_OBC_OUT_CURRENT_C DFC_CtlMsk2.DFC_ComFrbd_463h_OBC_OUT_VOLTAGE_C DFC_CtlMsk2.DFC_ComFrbd_463h_OBC_TEMPERATURE_C DFC_CtlMsk2.DFC_ComFrbd_473h_DCDC_Coolant_Temperature_C DFC_CtlMsk2.DFC_ComFrbd_473h_DCDC_TEMPERATURE_C DFC_CtlMsk2.DFC_ComFrbd_47Bh_eCOMP_BusBarCurrent_C DFC_CtlMsk2.DFC_ComFrbd_47Bh_eCOMP_BusBarVoltage_C DFC_CtlMsk2.DFC_ComFrbd_47Bh_eCOMP_CompressorSpeed_C DFC_CtlMsk2.DFC_ComFrbd_47Bh_eCOMP_IGBT_Temp_C DFC_CtlMsk2.DFC_ComFrbd_47Bh_eCOMP_PeakPhaCurrent_C DFC_CtlMsk2.DFC_ComFrbd_47Bh_eCOMP_Power_consumption_C DFC_CtlMsk2.DFC_ComFrbd_48Bh_eCOMP_Fault_Level_C DFC_CtlMsk2.DFC_ComFrbd_4F2h_VALEUR_SOC_ETENDUE_C DFC_CtlMsk2.DFC_ComFrbd_535h_HV_BATT_TEMP_AVG_C DFC_CtlMsk2.DFC_ComFrbd_543h_HVBAT_RESTBATTENERGY_C DFC_CtlMsk2.DFC_ComFrbd_543h_HVBAT_SOH_C DFC_CtlMsk2.DFC_ComFrbd_543h_HV_BATT_SOH_RES_C DFC_CtlMsk2.DFC_ComFrbd_592h_IBATT_1_C DFC_CtlMsk2.DFC_ComFrbd_592h_IBATT_2_C DFC_CtlMsk2.DFC_ComFrbd_592h_IBATT_3_C DFC_CtlMsk2.DFC_ComFrbd_592h_TEMP_BATT_C DFC_CtlMsk2.DFC_ComFrbd_592h_U_BATT_BECB_C DFC_CtlMsk2.DFC_ComFrbd_595h_HVBAT_TIME_TO_CHRG_80_C DFC_CtlMsk2.DFC_ComFrbd_5B2h_TEMP_AIR_EXT_C DFC_CtlMsk2.DFC_ComFrbd_635h_HVBAT_NEG_CONT_COUNT_SEG1_C DFC_CtlMsk2.DFC_ComFrbd_635h_HVBAT_NEG_CONT_COUNT_SEG3_C DFC_CtlMsk2.DFC_ComFrbd_635h_HVBAT_NEG_CONT_COUNT_SEG4_C DFC_CtlMsk2.DFC_ComFrbd_635h_HVBAT_PST_CONT_COUNT_SEG1_C DFC_CtlMsk2.DFC_ComFrbd_635h_HVBAT_PST_CONT_COUNT_SEG3_C DFC_CtlMsk2.DFC_ComFrbd_635h_HVBAT_PST_CONT_COUNT_SEG4_C DFC_CtlMsk2.DFC_ComFrbd_645h_HVBAT_PRECHRGE_CONT_COUNT_SEG1_C DFC_CtlMsk2.DFC_ComFrbd_645h_HVBAT_PRECHRGE_CONT_COUNT_SEG2_C DFC_CtlMsk2.DFC_ComFrbd_675h_HVBAT_REMAININGBATTCAPACITY_C DFC_CtlMsk2.DFC_ComInvld_205h_HVBAT_CHARGING_STATUS_C DFC_CtlMsk2.DFC_ComInvld_205h_HVBAT_PACK_CURRENT_C DFC_CtlMsk2.DFC_ComInvld_205h_HVBAT_SOC_DISPLAY_C DFC_CtlMsk2.DFC_ComInvld_205h_HVBAT_VOLTAGE_C DFC_CtlMsk2.DFC_ComInvld_217h_INV_DC_BUS_VOLTAGE_C DFC_CtlMsk2.DFC_ComInvld_217h_INV_MTR_ACTUAL_TRQ_C DFC_CtlMsk2.DFC_ComInvld_217h_INV_MTR_SPEED_C DFC_CtlMsk2.DFC_ComInvld_217h_INV_MTR_TRQ_C DFC_CtlMsk2.DFC_ComInvld_227h_INV_DC_CURRENT_C DFC_CtlMsk2.DFC_ComInvld_227h_INV_MOTORING_PEAK_TRQ_C DFC_CtlMsk2.DFC_ComInvld_227h_INV_MTR_INST_INPUT_POWER_C DFC_CtlMsk2.DFC_ComInvld_227h_INV_REGEN_PEAK_TRQ_C DFC_CtlMsk2.DFC_ComInvld_237h_INV_ACTIVE_DISCHARGE_STATUS_C DFC_CtlMsk2.DFC_ComInvld_237h_INV_FAULT_LEVEL_C DFC_CtlMsk2.DFC_ComInvld_237h_INV_STAB_MIN_TRQ_C DFC_CtlMsk2.DFC_ComInvld_259h_TGLM_MODE_PUSH_C DFC_CtlMsk2.DFC_ComInvld_259h_TOGGLE_MONOSTABLE_POS_C DFC_CtlMsk2.DFC_ComInvld_26h_AC_SWITCH_REQ_C DFC_CtlMsk2.DFC_ComInvld_26h_BLOWER_POSITION_C DFC_CtlMsk2.DFC_ComInvld_26h_EVAP_SENSOR_FAULT_C DFC_CtlMsk2.DFC_ComInvld_26h_EVAP_SENSOR_VALUE_C DFC_CtlMsk2.DFC_ComInvld_26h_POTENTIOMETER_FAULT_C DFC_CtlMsk2.DFC_ComInvld_26h_REAR_DEFOG_REQ_C DFC_CtlMsk2.DFC_ComInvld_26h_TEMP_POSITION_C DFC_CtlMsk2.DFC_ComInvld_273h_OBC_FAULT_LEVEL_C DFC_CtlMsk2.DFC_ComInvld_273h_OBC_outputpower_capability_C DFC_CtlMsk2.DFC_ComInvld_275h_HVBAT_DISCHARGE_30S_AVAILABLE_CURRENT_C DFC_CtlMsk2.DFC_ComInvld_275h_HVBAT_DISCHARGE_30S_AVAILABLE_POWER_C DFC_CtlMsk2.DFC_ComInvld_283h_DCDC_IN_CURRENT_C DFC_CtlMsk2.DFC_ComInvld_283h_DCDC_IN_VOLTAGE_C DFC_CtlMsk2.DFC_ComInvld_283h_DCDC_OUT_CURRENT_C DFC_CtlMsk2.DFC_ComInvld_283h_DCDC_OUT_VOLTAGE_C DFC_CtlMsk2.DFC_ComInvld_285h_HVBAT_REGEN_CHG_30S_CURRENT_LIMIT_C DFC_CtlMsk2.DFC_ComInvld_285h_HVBAT_REGEN_CHRG_30S_POWER_LIMIT_C DFC_CtlMsk2.DFC_ComInvld_293h_DCDC_FAULT_LEVEL_C DFC_CtlMsk2.DFC_ComInvld_293h_DCDC_outputpower_capability_C DFC_CtlMsk2.DFC_ComInvld_325h_HVBAT_EPLUG_STATUS_C DFC_CtlMsk2.DFC_ComInvld_325h_HVBAT_HVIL_STS_C DFC_CtlMsk2.DFC_ComInvld_325h_HVBAT_INSULATION_FAULT_C DFC_CtlMsk2.DFC_ComInvld_325h_HVBAT_INSULATION_RESISTANCE_C DFC_CtlMsk2.DFC_ComInvld_325h_HVBAT_TEMPERATURE_C DFC_CtlMsk2.DFC_ComInvld_335h_HVBAT_CHRG_CONTINUOUS_CURR_MAX_C DFC_CtlMsk2.DFC_ComInvld_335h_HVBAT_CHRG_COTINUOUS_CURR_REQ_C DFC_CtlMsk2.DFC_ComInvld_335h_HVBAT_CHRG_MAX_VOLT_C DFC_CtlMsk2.DFC_ComInvld_335h_HVBAT_DC_BUS_VOLTAGE_C DFC_CtlMsk2.DFC_ComInvld_38Dh_VITESSE_VEHICULE_ROUES_C DFC_CtlMsk2.DFC_ComInvld_38Dh_VVH_INDISP_C DFC_CtlMsk2.DFC_ComInvld_427h_INV_COOLANT_TEMP_C DFC_CtlMsk2.DFC_ComInvld_427h_INV_MOTOR_TEMP_C DFC_CtlMsk2.DFC_ComInvld_427h_INV_OP_MODE_C DFC_CtlMsk2.DFC_ComInvld_427h_INV_PERMISIBLE_TORQUE_C DFC_CtlMsk2.DFC_ComInvld_427h_INV_TEMP_C DFC_CtlMsk2.DFC_ComInvld_432h_REVEIL_PRINCIPAL_C DFC_CtlMsk2.DFC_ComInvld_435h_HVBAT_MAX_CELL_VOLT_C DFC_CtlMsk2.DFC_ComInvld_435h_HVBAT_MAX_CELL_VOLT_NUM_C DFC_CtlMsk2.DFC_ComInvld_435h_HVBAT_MAX_SENSOR_TEMP_C DFC_CtlMsk2.DFC_ComInvld_435h_HVBAT_MIN_CELL_VOLT_C DFC_CtlMsk2.DFC_ComInvld_435h_HVBAT_MIN_CELL_VOLT_NUM_C DFC_CtlMsk2.DFC_ComInvld_442h_BCCM_BLOWER_RELAY_STS_C DFC_CtlMsk2.DFC_ComInvld_453h_OBC_IN_CURRENT_C DFC_CtlMsk2.DFC_ComInvld_453h_OBC_IN_VOLTAGE_C DFC_CtlMsk2.DFC_ComInvld_453h_OBC_IP_POWER_C DFC_CtlMsk2.DFC_ComInvld_455h_HVBAT_NOMINAL_VOLTAGE_C DFC_CtlMsk2.DFC_ComInvld_463h_OBC_OUT_CURRENT_C DFC_CtlMsk2.DFC_ComInvld_463h_OBC_OUT_VOLTAGE_C DFC_CtlMsk2.DFC_ComInvld_463h_OBC_TEMPERATURE_C DFC_CtlMsk2.DFC_ComInvld_473h_DCDC_Coolant_Temperature_C DFC_CtlMsk2.DFC_ComInvld_473h_DCDC_TEMPERATURE_C DFC_CtlMsk2.DFC_ComInvld_47Bh_eCOMP_BusBarCurrent_C DFC_CtlMsk2.DFC_ComInvld_47Bh_eCOMP_BusBarVoltage_C DFC_CtlMsk2.DFC_ComInvld_47Bh_eCOMP_CompressorSpeed_C DFC_CtlMsk2.DFC_ComInvld_47Bh_eCOMP_IGBT_Temp_C DFC_CtlMsk2.DFC_ComInvld_47Bh_eCOMP_PeakPhaCurrent_C DFC_CtlMsk2.DFC_ComInvld_47Bh_eCOMP_Power_consumption_C DFC_CtlMsk2.DFC_ComInvld_4F2h_STATUS_SOC_C DFC_CtlMsk2.DFC_ComInvld_4F2h_TEMP_BATT_STATUS_C DFC_CtlMsk2.DFC_ComInvld_4F2h_VALEUR_SOC_ETENDUE_C DFC_CtlMsk2.DFC_ComInvld_535h_HV_BATT_TEMP_AVG_C DFC_CtlMsk2.DFC_ComInvld_543h_HVBAT_RESTBATTENERGY_C DFC_CtlMsk2.DFC_ComInvld_543h_HVBAT_SOH_C DFC_CtlMsk2.DFC_ComInvld_543h_HV_BATT_SOH_RES_C DFC_CtlMsk2.DFC_ComInvld_552h_CPT_TEMPOREL_C DFC_CtlMsk2.DFC_ComInvld_552h_KILOMETRAGE_C DFC_CtlMsk2.DFC_ComInvld_583h_HV_BATT_DISCONT_CSE_OPEN_C DFC_CtlMsk2.DFC_ComInvld_592h_CALIBRE_IBATT_C DFC_CtlMsk2.DFC_ComInvld_592h_IBATT_1_C DFC_CtlMsk2.DFC_ComInvld_592h_IBATT_2_C DFC_CtlMsk2.DFC_ComInvld_592h_IBATT_3_C DFC_CtlMsk2.DFC_ComInvld_592h_TEMP_BATT_C DFC_CtlMsk2.DFC_ComInvld_592h_U_BATT_BECB_C DFC_CtlMsk2.DFC_ComInvld_595h_HVBAT_TIME_TO_CHRG_80_C DFC_CtlMsk2.DFC_ComInvld_5B2h_TEMP_AIR_EXT_C DFC_CtlMsk2.DFC_ComInvld_5B5h_HVBAT_THERMAL_RUNAWAY_C DFC_CtlMsk2.DFC_ComInvld_635h_HVBAT_NEG_CONT_COUNT_SEG1_C DFC_CtlMsk2.DFC_ComInvld_635h_HVBAT_NEG_CONT_COUNT_SEG3_C DFC_CtlMsk2.DFC_ComInvld_635h_HVBAT_NEG_CONT_COUNT_SEG4_C DFC_CtlMsk2.DFC_ComInvld_635h_HVBAT_PST_CONT_COUNT_SEG1_C DFC_CtlMsk2.DFC_ComInvld_635h_HVBAT_PST_CONT_COUNT_SEG3_C DFC_CtlMsk2.DFC_ComInvld_635h_HVBAT_PST_CONT_COUNT_SEG4_C DFC_CtlMsk2.DFC_ComInvld_645h_HVBAT_PRECHRGE_CONT_COUNT_SEG1_C DFC_CtlMsk2.DFC_ComInvld_645h_HVBAT_PRECHRGE_CONT_COUNT_SEG2_C DFC_CtlMsk2.DFC_ComInvld_675h_HVBAT_REMAININGBATTCAPACITY_C DFC_DisblMsk2.DFC_Com082hTooShort_C DFC_DisblMsk2.DFC_Com092hTooShort_C DFC_DisblMsk2.DFC_Com205hAbsent_C DFC_DisblMsk2.DFC_Com205hChecksum_C DFC_DisblMsk2.DFC_Com205hCounter_C DFC_DisblMsk2.DFC_Com205hTooShort_C DFC_DisblMsk2.DFC_Com217hAbsent_C DFC_DisblMsk2.DFC_Com217hChecksum_C DFC_DisblMsk2.DFC_Com217hCounter_C DFC_DisblMsk2.DFC_Com217hTooShort_C DFC_DisblMsk2.DFC_Com227hAbsent_C DFC_DisblMsk2.DFC_Com227hTooShort_C DFC_DisblMsk2.DFC_Com237hAbsent_C DFC_DisblMsk2.DFC_Com237hChecksum_C DFC_DisblMsk2.DFC_Com237hCounter_C DFC_DisblMsk2.DFC_Com237hTooShort_C DFC_DisblMsk2.DFC_Com259hAbsent_C DFC_DisblMsk2.DFC_Com259hChecksum_C DFC_DisblMsk2.DFC_Com259hCounter_C DFC_DisblMsk2.DFC_Com259hTooShort_C DFC_DisblMsk2.DFC_Com26hAbsent_C DFC_DisblMsk2.DFC_Com26hTooShort_C DFC_DisblMsk2.DFC_Com273hAbsent_C DFC_DisblMsk2.DFC_Com273hChecksum_C DFC_DisblMsk2.DFC_Com273hCounter_C DFC_DisblMsk2.DFC_Com273hTooShort_C DFC_DisblMsk2.DFC_Com275hAbsent_C DFC_DisblMsk2.DFC_Com275hChecksum_C DFC_DisblMsk2.DFC_Com275hCounter_C DFC_DisblMsk2.DFC_Com275hTooShort_C DFC_DisblMsk2.DFC_Com283hAbsent_C DFC_DisblMsk2.DFC_Com283hTooShort_C DFC_DisblMsk2.DFC_Com285hAbsent_C DFC_DisblMsk2.DFC_Com285hChecksum_C DFC_DisblMsk2.DFC_Com285hCounter_C DFC_DisblMsk2.DFC_Com285hTooShort_C DFC_DisblMsk2.DFC_Com293hAbsent_C DFC_DisblMsk2.DFC_Com293hChecksum_C DFC_DisblMsk2.DFC_Com293hCounter_C DFC_DisblMsk2.DFC_Com293hTooShort_C DFC_DisblMsk2.DFC_Com308hAbsent_C DFC_DisblMsk2.DFC_Com308hChecksum_C DFC_DisblMsk2.DFC_Com308hCounter_C DFC_DisblMsk2.DFC_Com308hTooShort_C DFC_DisblMsk2.DFC_Com318hAbsent_C DFC_DisblMsk2.DFC_Com318hChecksum_C DFC_DisblMsk2.DFC_Com318hCounter_C DFC_DisblMsk2.DFC_Com318hTooShort_C DFC_DisblMsk2.DFC_Com325hAbsent_C DFC_DisblMsk2.DFC_Com325hChecksum_C DFC_DisblMsk2.DFC_Com325hCounter_C DFC_DisblMsk2.DFC_Com325hTooShort_C DFC_DisblMsk2.DFC_Com335hAbsent_C DFC_DisblMsk2.DFC_Com335hChecksum_C DFC_DisblMsk2.DFC_Com335hCounter_C DFC_DisblMsk2.DFC_Com335hTooShort_C DFC_DisblMsk2.DFC_Com351hAbsent_C DFC_DisblMsk2.DFC_Com351hTooShort_C DFC_DisblMsk2.DFC_Com38DhAbsent_C DFC_DisblMsk2.DFC_Com38DhChecksum_C DFC_DisblMsk2.DFC_Com38DhCounter_C DFC_DisblMsk2.DFC_Com38DhTooShort_C DFC_DisblMsk2.DFC_Com412hAbsent_C DFC_DisblMsk2.DFC_Com412hChecksum_C DFC_DisblMsk2.DFC_Com412hCounter_C DFC_DisblMsk2.DFC_Com412hTooShort_C DFC_DisblMsk2.DFC_Com427hAbsent_C DFC_DisblMsk2.DFC_Com427hTooShort_C DFC_DisblMsk2.DFC_Com432hAbsent_C DFC_DisblMsk2.DFC_Com432hChecksum_C DFC_DisblMsk2.DFC_Com432hCounter_C DFC_DisblMsk2.DFC_Com432hTooShort_C DFC_DisblMsk2.DFC_Com435hAbsent_C DFC_DisblMsk2.DFC_Com435hTooShort_C DFC_DisblMsk2.DFC_Com442hAbsent_C DFC_DisblMsk2.DFC_Com442hTooShort_C DFC_DisblMsk2.DFC_Com453hAbsent_C DFC_DisblMsk2.DFC_Com453hTooShort_C DFC_DisblMsk2.DFC_Com455hAbsent_C DFC_DisblMsk2.DFC_Com455hTooShort_C DFC_DisblMsk2.DFC_Com463hAbsent_C DFC_DisblMsk2.DFC_Com463hTooShort_C DFC_DisblMsk2.DFC_Com473hAbsent_C DFC_DisblMsk2.DFC_Com473hTooShort_C DFC_DisblMsk2.DFC_Com47BhAbsent_C DFC_DisblMsk2.DFC_Com47BhTooShort_C DFC_DisblMsk2.DFC_Com48BhAbsent_C DFC_DisblMsk2.DFC_Com48BhTooShort_C DFC_DisblMsk2.DFC_Com497hTooShort_C DFC_DisblMsk2.DFC_Com4F2hAbsent_C DFC_DisblMsk2.DFC_Com4F2hChecksum_C DFC_DisblMsk2.DFC_Com4F2hCounter_C DFC_DisblMsk2.DFC_Com4F2hTooShort_C DFC_DisblMsk2.DFC_Com50DhAbsent_C DFC_DisblMsk2.DFC_Com50DhTooShort_C DFC_DisblMsk2.DFC_Com535hAbsent_C DFC_DisblMsk2.DFC_Com535hTooShort_C DFC_DisblMsk2.DFC_Com543hAbsent_C DFC_DisblMsk2.DFC_Com543hTooShort_C DFC_DisblMsk2.DFC_Com552hAbsent_C DFC_DisblMsk2.DFC_Com552hTooShort_C DFC_DisblMsk2.DFC_Com583hAbsent_C DFC_DisblMsk2.DFC_Com583hTooShort_C DFC_DisblMsk2.DFC_Com592hAbsent_C DFC_DisblMsk2.DFC_Com592hChecksum_C DFC_DisblMsk2.DFC_Com592hCounter_C DFC_DisblMsk2.DFC_Com592hTooShort_C DFC_DisblMsk2.DFC_Com595hAbsent_C DFC_DisblMsk2.DFC_Com595hChecksum_C DFC_DisblMsk2.DFC_Com595hCounter_C DFC_DisblMsk2.DFC_Com595hTooShort_C DFC_DisblMsk2.DFC_Com5B2hAbsent_C DFC_DisblMsk2.DFC_Com5B2hTooShort_C DFC_DisblMsk2.DFC_Com5B5hAbsent_C DFC_DisblMsk2.DFC_Com5B5hChecksum_C DFC_DisblMsk2.DFC_Com5B5hCounter_C DFC_DisblMsk2.DFC_Com5B5hTooShort_C DFC_DisblMsk2.DFC_Com5C7hTooShort_C DFC_DisblMsk2.DFC_Com5E7hAbsent_C DFC_DisblMsk2.DFC_Com5E7hTooShort_C DFC_DisblMsk2.DFC_Com635hTooShort_C DFC_DisblMsk2.DFC_Com645hTooShort_C DFC_DisblMsk2.DFC_Com663hAbsent_C DFC_DisblMsk2.DFC_Com663hTooShort_C DFC_DisblMsk2.DFC_Com665hAbsent_C DFC_DisblMsk2.DFC_Com665hTooShort_C DFC_DisblMsk2.DFC_Com675hAbsent_C DFC_DisblMsk2.DFC_Com675hTooShort_C DFC_DisblMsk2.DFC_ComFrbd_205h_HVBAT_PACK_CURRENT_C DFC_DisblMsk2.DFC_ComFrbd_205h_HVBAT_SOC_DISPLAY_C DFC_DisblMsk2.DFC_ComFrbd_205h_HVBAT_VOLTAGE_C DFC_DisblMsk2.DFC_ComFrbd_217h_INV_DC_BUS_VOLTAGE_C DFC_DisblMsk2.DFC_ComFrbd_217h_INV_MTR_ACTUAL_TRQ_C DFC_DisblMsk2.DFC_ComFrbd_217h_INV_MTR_SPEED_C DFC_DisblMsk2.DFC_ComFrbd_217h_INV_MTR_TRQ_C DFC_DisblMsk2.DFC_ComFrbd_227h_INV_DC_CURRENT_C DFC_DisblMsk2.DFC_ComFrbd_227h_INV_MOTORING_PEAK_TRQ_C DFC_DisblMsk2.DFC_ComFrbd_227h_INV_MTR_INST_INPUT_POWER_C DFC_DisblMsk2.DFC_ComFrbd_227h_INV_REGEN_PEAK_TRQ_C DFC_DisblMsk2.DFC_ComFrbd_237h_INV_ACTIVE_DISCHARGE_STATUS_C DFC_DisblMsk2.DFC_ComFrbd_237h_INV_CTRL_MODE_ACK_C DFC_DisblMsk2.DFC_ComFrbd_237h_INV_EV_WARNING_C DFC_DisblMsk2.DFC_ComFrbd_237h_INV_FAULT_LEVEL_C DFC_DisblMsk2.DFC_ComFrbd_237h_INV_MASTER_STOP_C DFC_DisblMsk2.DFC_ComFrbd_237h_INV_SERVICE_DUE_C DFC_DisblMsk2.DFC_ComFrbd_237h_INV_STAB_MIN_TRQ_C DFC_DisblMsk2.DFC_ComFrbd_259h_TGLM_FAILURE_STATE_C DFC_DisblMsk2.DFC_ComFrbd_259h_TGLM_MODE_PUSH_C DFC_DisblMsk2.DFC_ComFrbd_259h_TOGGLE_MONOSTABLE_POS_C DFC_DisblMsk2.DFC_ComFrbd_273h_OBC_outputpower_capability_C DFC_DisblMsk2.DFC_ComFrbd_275h_HVBAT_DISCHARGE_30S_AVAILABLE_CURRENT_C DFC_DisblMsk2.DFC_ComFrbd_275h_HVBAT_DISCHARGE_30S_AVAILABLE_POWER_C DFC_DisblMsk2.DFC_ComFrbd_283h_DCDC_IN_CURRENT_C DFC_DisblMsk2.DFC_ComFrbd_283h_DCDC_IN_VOLTAGE_C DFC_DisblMsk2.DFC_ComFrbd_283h_DCDC_OUT_CURRENT_C DFC_DisblMsk2.DFC_ComFrbd_283h_DCDC_OUT_VOLTAGE_C DFC_DisblMsk2.DFC_ComFrbd_285h_HVBAT_REGEN_CHG_30S_CURRENT_LIMIT_C DFC_DisblMsk2.DFC_ComFrbd_285h_HVBAT_REGEN_CHRG_30S_POWER_LIMIT_C DFC_DisblMsk2.DFC_ComFrbd_293h_DCDC_outputpower_capability_C DFC_DisblMsk2.DFC_ComFrbd_325h_HVBAT_INSULATION_RESISTANCE_C DFC_DisblMsk2.DFC_ComFrbd_325h_HVBAT_TEMPERATURE_C DFC_DisblMsk2.DFC_ComFrbd_335h_HVBAT_CHRG_CONTINUOUS_CURR_MAX_C DFC_DisblMsk2.DFC_ComFrbd_335h_HVBAT_CHRG_COTINUOUS_CURR_REQ_C DFC_DisblMsk2.DFC_ComFrbd_335h_HVBAT_CHRG_MAX_VOLT_C DFC_DisblMsk2.DFC_ComFrbd_335h_HVBAT_DC_BUS_VOLTAGE_C DFC_DisblMsk2.DFC_ComFrbd_427h_INV_OP_MODE_C DFC_DisblMsk2.DFC_ComFrbd_427h_INV_PERMISIBLE_TORQUE_C DFC_DisblMsk2.DFC_ComFrbd_435h_HVBAT_MAX_CELL_VOLT_C DFC_DisblMsk2.DFC_ComFrbd_435h_HVBAT_MAX_CELL_VOLT_NUM_C DFC_DisblMsk2.DFC_ComFrbd_435h_HVBAT_MAX_SENSOR_TEMP_C DFC_DisblMsk2.DFC_ComFrbd_435h_HVBAT_MIN_CELL_VOLT_C DFC_DisblMsk2.DFC_ComFrbd_435h_HVBAT_MIN_CELL_VOLT_NUM_C DFC_DisblMsk2.DFC_ComFrbd_453h_OBC_IN_CURRENT_C DFC_DisblMsk2.DFC_ComFrbd_453h_OBC_IN_VOLTAGE_C DFC_DisblMsk2.DFC_ComFrbd_453h_OBC_IP_POWER_C DFC_DisblMsk2.DFC_ComFrbd_455h_HVBAT_NOMINAL_VOLTAGE_C DFC_DisblMsk2.DFC_ComFrbd_463h_OBC_OUT_CURRENT_C DFC_DisblMsk2.DFC_ComFrbd_463h_OBC_OUT_VOLTAGE_C DFC_DisblMsk2.DFC_ComFrbd_463h_OBC_TEMPERATURE_C DFC_DisblMsk2.DFC_ComFrbd_473h_DCDC_Coolant_Temperature_C DFC_DisblMsk2.DFC_ComFrbd_473h_DCDC_TEMPERATURE_C DFC_DisblMsk2.DFC_ComFrbd_47Bh_eCOMP_BusBarCurrent_C DFC_DisblMsk2.DFC_ComFrbd_47Bh_eCOMP_BusBarVoltage_C DFC_DisblMsk2.DFC_ComFrbd_47Bh_eCOMP_CompressorSpeed_C DFC_DisblMsk2.DFC_ComFrbd_47Bh_eCOMP_IGBT_Temp_C DFC_DisblMsk2.DFC_ComFrbd_47Bh_eCOMP_PeakPhaCurrent_C DFC_DisblMsk2.DFC_ComFrbd_47Bh_eCOMP_Power_consumption_C DFC_DisblMsk2.DFC_ComFrbd_48Bh_eCOMP_Fault_Level_C DFC_DisblMsk2.DFC_ComFrbd_4F2h_VALEUR_SOC_ETENDUE_C DFC_DisblMsk2.DFC_ComFrbd_535h_HV_BATT_TEMP_AVG_C DFC_DisblMsk2.DFC_ComFrbd_543h_HVBAT_RESTBATTENERGY_C DFC_DisblMsk2.DFC_ComFrbd_543h_HVBAT_SOH_C DFC_DisblMsk2.DFC_ComFrbd_543h_HV_BATT_SOH_RES_C DFC_DisblMsk2.DFC_ComFrbd_592h_IBATT_1_C DFC_DisblMsk2.DFC_ComFrbd_592h_IBATT_2_C DFC_DisblMsk2.DFC_ComFrbd_592h_IBATT_3_C DFC_DisblMsk2.DFC_ComFrbd_592h_TEMP_BATT_C DFC_DisblMsk2.DFC_ComFrbd_592h_U_BATT_BECB_C DFC_DisblMsk2.DFC_ComFrbd_595h_HVBAT_TIME_TO_CHRG_80_C DFC_DisblMsk2.DFC_ComFrbd_5B2h_TEMP_AIR_EXT_C DFC_DisblMsk2.DFC_ComFrbd_635h_HVBAT_NEG_CONT_COUNT_SEG1_C DFC_DisblMsk2.DFC_ComFrbd_635h_HVBAT_NEG_CONT_COUNT_SEG3_C DFC_DisblMsk2.DFC_ComFrbd_635h_HVBAT_NEG_CONT_COUNT_SEG4_C DFC_DisblMsk2.DFC_ComFrbd_635h_HVBAT_PST_CONT_COUNT_SEG1_C DFC_DisblMsk2.DFC_ComFrbd_635h_HVBAT_PST_CONT_COUNT_SEG3_C DFC_DisblMsk2.DFC_ComFrbd_635h_HVBAT_PST_CONT_COUNT_SEG4_C DFC_DisblMsk2.DFC_ComFrbd_645h_HVBAT_PRECHRGE_CONT_COUNT_SEG1_C DFC_DisblMsk2.DFC_ComFrbd_645h_HVBAT_PRECHRGE_CONT_COUNT_SEG2_C DFC_DisblMsk2.DFC_ComFrbd_675h_HVBAT_REMAININGBATTCAPACITY_C DFC_DisblMsk2.DFC_ComInvld_205h_HVBAT_CHARGING_STATUS_C DFC_DisblMsk2.DFC_ComInvld_205h_HVBAT_PACK_CURRENT_C DFC_DisblMsk2.DFC_ComInvld_205h_HVBAT_SOC_DISPLAY_C DFC_DisblMsk2.DFC_ComInvld_205h_HVBAT_VOLTAGE_C DFC_DisblMsk2.DFC_ComInvld_217h_INV_DC_BUS_VOLTAGE_C DFC_DisblMsk2.DFC_ComInvld_217h_INV_MTR_ACTUAL_TRQ_C DFC_DisblMsk2.DFC_ComInvld_217h_INV_MTR_SPEED_C DFC_DisblMsk2.DFC_ComInvld_217h_INV_MTR_TRQ_C DFC_DisblMsk2.DFC_ComInvld_227h_INV_DC_CURRENT_C DFC_DisblMsk2.DFC_ComInvld_227h_INV_MOTORING_PEAK_TRQ_C DFC_DisblMsk2.DFC_ComInvld_227h_INV_MTR_INST_INPUT_POWER_C DFC_DisblMsk2.DFC_ComInvld_227h_INV_REGEN_PEAK_TRQ_C DFC_DisblMsk2.DFC_ComInvld_237h_INV_ACTIVE_DISCHARGE_STATUS_C DFC_DisblMsk2.DFC_ComInvld_237h_INV_FAULT_LEVEL_C DFC_DisblMsk2.DFC_ComInvld_237h_INV_STAB_MIN_TRQ_C DFC_DisblMsk2.DFC_ComInvld_259h_TGLM_MODE_PUSH_C DFC_DisblMsk2.DFC_ComInvld_259h_TOGGLE_MONOSTABLE_POS_C DFC_DisblMsk2.DFC_ComInvld_26h_AC_SWITCH_REQ_C DFC_DisblMsk2.DFC_ComInvld_26h_BLOWER_POSITION_C DFC_DisblMsk2.DFC_ComInvld_26h_EVAP_SENSOR_FAULT_C DFC_DisblMsk2.DFC_ComInvld_26h_EVAP_SENSOR_VALUE_C DFC_DisblMsk2.DFC_ComInvld_26h_POTENTIOMETER_FAULT_C DFC_DisblMsk2.DFC_ComInvld_26h_REAR_DEFOG_REQ_C DFC_DisblMsk2.DFC_ComInvld_26h_TEMP_POSITION_C DFC_DisblMsk2.DFC_ComInvld_273h_OBC_FAULT_LEVEL_C DFC_DisblMsk2.DFC_ComInvld_273h_OBC_outputpower_capability_C DFC_DisblMsk2.DFC_ComInvld_275h_HVBAT_DISCHARGE_30S_AVAILABLE_CURRENT_C DFC_DisblMsk2.DFC_ComInvld_275h_HVBAT_DISCHARGE_30S_AVAILABLE_POWER_C DFC_DisblMsk2.DFC_ComInvld_283h_DCDC_IN_CURRENT_C DFC_DisblMsk2.DFC_ComInvld_283h_DCDC_IN_VOLTAGE_C DFC_DisblMsk2.DFC_ComInvld_283h_DCDC_OUT_CURRENT_C DFC_DisblMsk2.DFC_ComInvld_283h_DCDC_OUT_VOLTAGE_C DFC_DisblMsk2.DFC_ComInvld_285h_HVBAT_REGEN_CHG_30S_CURRENT_LIMIT_C DFC_DisblMsk2.DFC_ComInvld_285h_HVBAT_REGEN_CHRG_30S_POWER_LIMIT_C DFC_DisblMsk2.DFC_ComInvld_293h_DCDC_FAULT_LEVEL_C DFC_DisblMsk2.DFC_ComInvld_293h_DCDC_outputpower_capability_C DFC_DisblMsk2.DFC_ComInvld_325h_HVBAT_EPLUG_STATUS_C DFC_DisblMsk2.DFC_ComInvld_325h_HVBAT_HVIL_STS_C DFC_DisblMsk2.DFC_ComInvld_325h_HVBAT_INSULATION_FAULT_C DFC_DisblMsk2.DFC_ComInvld_325h_HVBAT_INSULATION_RESISTANCE_C DFC_DisblMsk2.DFC_ComInvld_325h_HVBAT_TEMPERATURE_C DFC_DisblMsk2.DFC_ComInvld_335h_HVBAT_CHRG_CONTINUOUS_CURR_MAX_C DFC_DisblMsk2.DFC_ComInvld_335h_HVBAT_CHRG_COTINUOUS_CURR_REQ_C DFC_DisblMsk2.DFC_ComInvld_335h_HVBAT_CHRG_MAX_VOLT_C DFC_DisblMsk2.DFC_ComInvld_335h_HVBAT_DC_BUS_VOLTAGE_C DFC_DisblMsk2.DFC_ComInvld_38Dh_VITESSE_VEHICULE_ROUES_C DFC_DisblMsk2.DFC_ComInvld_38Dh_VVH_INDISP_C DFC_DisblMsk2.DFC_ComInvld_427h_INV_COOLANT_TEMP_C DFC_DisblMsk2.DFC_ComInvld_427h_INV_MOTOR_TEMP_C DFC_DisblMsk2.DFC_ComInvld_427h_INV_OP_MODE_C DFC_DisblMsk2.DFC_ComInvld_427h_INV_PERMISIBLE_TORQUE_C DFC_DisblMsk2.DFC_ComInvld_427h_INV_TEMP_C DFC_DisblMsk2.DFC_ComInvld_432h_REVEIL_PRINCIPAL_C DFC_DisblMsk2.DFC_ComInvld_435h_HVBAT_MAX_CELL_VOLT_C DFC_DisblMsk2.DFC_ComInvld_435h_HVBAT_MAX_CELL_VOLT_NUM_C DFC_DisblMsk2.DFC_ComInvld_435h_HVBAT_MAX_SENSOR_TEMP_C DFC_DisblMsk2.DFC_ComInvld_435h_HVBAT_MIN_CELL_VOLT_C DFC_DisblMsk2.DFC_ComInvld_435h_HVBAT_MIN_CELL_VOLT_NUM_C DFC_DisblMsk2.DFC_ComInvld_442h_BCCM_BLOWER_RELAY_STS_C DFC_DisblMsk2.DFC_ComInvld_453h_OBC_IN_CURRENT_C DFC_DisblMsk2.DFC_ComInvld_453h_OBC_IN_VOLTAGE_C DFC_DisblMsk2.DFC_ComInvld_453h_OBC_IP_POWER_C DFC_DisblMsk2.DFC_ComInvld_455h_HVBAT_NOMINAL_VOLTAGE_C DFC_DisblMsk2.DFC_ComInvld_463h_OBC_OUT_CURRENT_C DFC_DisblMsk2.DFC_ComInvld_463h_OBC_OUT_VOLTAGE_C DFC_DisblMsk2.DFC_ComInvld_463h_OBC_TEMPERATURE_C DFC_DisblMsk2.DFC_ComInvld_473h_DCDC_Coolant_Temperature_C DFC_DisblMsk2.DFC_ComInvld_473h_DCDC_TEMPERATURE_C DFC_DisblMsk2.DFC_ComInvld_47Bh_eCOMP_BusBarCurrent_C DFC_DisblMsk2.DFC_ComInvld_47Bh_eCOMP_BusBarVoltage_C DFC_DisblMsk2.DFC_ComInvld_47Bh_eCOMP_CompressorSpeed_C DFC_DisblMsk2.DFC_ComInvld_47Bh_eCOMP_IGBT_Temp_C DFC_DisblMsk2.DFC_ComInvld_47Bh_eCOMP_PeakPhaCurrent_C DFC_DisblMsk2.DFC_ComInvld_47Bh_eCOMP_Power_consumption_C DFC_DisblMsk2.DFC_ComInvld_4F2h_STATUS_SOC_C DFC_DisblMsk2.DFC_ComInvld_4F2h_TEMP_BATT_STATUS_C DFC_DisblMsk2.DFC_ComInvld_4F2h_VALEUR_SOC_ETENDUE_C DFC_DisblMsk2.DFC_ComInvld_535h_HV_BATT_TEMP_AVG_C DFC_DisblMsk2.DFC_ComInvld_543h_HVBAT_RESTBATTENERGY_C DFC_DisblMsk2.DFC_ComInvld_543h_HVBAT_SOH_C DFC_DisblMsk2.DFC_ComInvld_543h_HV_BATT_SOH_RES_C DFC_DisblMsk2.DFC_ComInvld_552h_CPT_TEMPOREL_C DFC_DisblMsk2.DFC_ComInvld_552h_KILOMETRAGE_C DFC_DisblMsk2.DFC_ComInvld_583h_HV_BATT_DISCONT_CSE_OPEN_C DFC_DisblMsk2.DFC_ComInvld_592h_CALIBRE_IBATT_C DFC_DisblMsk2.DFC_ComInvld_592h_IBATT_1_C DFC_DisblMsk2.DFC_ComInvld_592h_IBATT_2_C DFC_DisblMsk2.DFC_ComInvld_592h_IBATT_3_C DFC_DisblMsk2.DFC_ComInvld_592h_TEMP_BATT_C DFC_DisblMsk2.DFC_ComInvld_592h_U_BATT_BECB_C DFC_DisblMsk2.DFC_ComInvld_595h_HVBAT_TIME_TO_CHRG_80_C DFC_DisblMsk2.DFC_ComInvld_5B2h_TEMP_AIR_EXT_C DFC_DisblMsk2.DFC_ComInvld_5B5h_HVBAT_THERMAL_RUNAWAY_C DFC_DisblMsk2.DFC_ComInvld_635h_HVBAT_NEG_CONT_COUNT_SEG1_C DFC_DisblMsk2.DFC_ComInvld_635h_HVBAT_NEG_CONT_COUNT_SEG3_C DFC_DisblMsk2.DFC_ComInvld_635h_HVBAT_NEG_CONT_COUNT_SEG4_C DFC_DisblMsk2.DFC_ComInvld_635h_HVBAT_PST_CONT_COUNT_SEG1_C DFC_DisblMsk2.DFC_ComInvld_635h_HVBAT_PST_CONT_COUNT_SEG3_C DFC_DisblMsk2.DFC_ComInvld_635h_HVBAT_PST_CONT_COUNT_SEG4_C DFC_DisblMsk2.DFC_ComInvld_645h_HVBAT_PRECHRGE_CONT_COUNT_SEG1_C DFC_DisblMsk2.DFC_ComInvld_645h_HVBAT_PRECHRGE_CONT_COUNT_SEG2_C DFC_DisblMsk2.DFC_ComInvld_675h_HVBAT_REMAININGBATTCAPACITY_C DrvInfo_wTotTripEgy_5A2hIni_C DrvInfo_wTotTripEgy_5A2hInvld_C EChrDv_cntPlin_481hIni_C EChrDv_cntPlin_481hInvld_C Eem_flgFstHvShdwn_241hIni_C ElM_stDesEem01_208hIni_C ElTS_egyTotChrgCyc_50FhIni_C ElTS_egyTotChrgCyc_50FhInvld_C ElTS_ratEmPowChrgn_221hIni_C ElTS_ratEmPowChrgn_221hInvld_C ElTS_ratEmPowDcha_221hIni_C ElTS_ratEmPowDcha_221hInvld_C ElTS_stChrgCyc_50FhIni_C Emac_stIsoMonSwtReq_208hIni_C Emac_tqDesCom01_208hIni_C Emac_tqDesCom01_208hInvld_C Ext_bSyncGPC_211hIni_C HvBatt_flgIsoMeasmtDiReq_211hIni_C HvBatt_ratSoc_201hIni_C HvBatt_ratSoc_201hInvld_C HvGrid_pwrMaxDcdc_281hIni_C HvGrid_pwrMaxDcdc_281hInvld_C ThermHvac_stRemPrecndn_5A2hIni_C VehCoorn_dstRngPrdcDispTx_221hIni_C VehCoorn_dstRngPrdcDispTx_221hInvld_C VehCoorn_wCnsTotWghtAvrgEffTx_201hIni_C VehCoorn_wCnsTotWghtAvrgEffTx_201hInvld_C VehCoorn_wCnsTotWghtTripAvrgEffTx_5A2hIni_C VehCoorn_wCnsTotWghtTripAvrgEffTx_5A2hInvld_C VehCoorn_wCnsWghtAvrgEffTripA_5A2hIni_C VehCoorn_wCnsWghtAvrgEffTripB_5A2hIni_C /end DEF_CHARACTERISTIC
 FUNCTION_VERSION "850.8.0" /end FUNCTION
/begin FUNCTION ConversionSpecial_CELPrj "30059.0.0 Conversion Formulas Special, which are migrated from GS" FUNCTION_VERSION "30059.0.0" /end FUNCTION
/begin FUNCTION Conversion_CELPrj "30096.0.0 Conversion Formulas, which are migrated from GS classic" FUNCTION_VERSION "30096.0.0" /end FUNCTION
/begin FUNCTION CoPOM_LimCalcnHmi "160.1.0   Provision of the Powertrain - Limits to the driver"
 /begin DEF_CHARACTERISTIC CoPOM_nNom_C CoPOM_pwrNoRecupHi_C CoPOM_pwrNoRecupLo_C CoPOM_pwrPrpnRedHi_C CoPOM_pwrPrpnRedLo_C /end DEF_CHARACTERISTIC
 /begin IN_MEASUREMENT CoPOM_pwrElecQstyMax CoPOM_pwrElecQstyMin CoPOM_tqWhlPrimAxleQstyMax CoPOM_tqWhlPrimAxleQstyMin Emac_nActPhy01 TrsmEmac_ratTqPrimAxle TrsmEmac_tqLoss01 TrsmEmac_tqProtnMax01 TrsmEmac_tqProtnMin01 /end IN_MEASUREMENT
 /begin OUT_MEASUREMENT CoPOM_flgPrpnPwrRedHmi CoPOM_flgPrpPwrInhbHmi CoPOM_flgRecupPwrRedHmi CoPOM_pwrLimdRecup CoPOM_pwrPrpnRed DINH_nrActvInhReas.FId_CoPOMLimdPrpnHmi DINH_nrActvInhReas.FId_CoPOMNoPrpnHmi DINH_nrActvInhReas.FId_CoPOMRecupPwrRednHmi DINH_stFId.FId_CoPOMLimdPrpnHmi DINH_stFId.FId_CoPOMNoPrpnHmi DINH_stFId.FId_CoPOMRecupPwrRednHmi /end OUT_MEASUREMENT
 /begin LOC_MEASUREMENT CoPOM_pwrPrpnMax CoPOM_pwrRecupMin /end LOC_MEASUREMENT
 FUNCTION_VERSION "160.1.0" /end FUNCTION
/begin FUNCTION CoPOM_PwrLimCalcn "160.3.0   Calculation of Power Limits for Power train"
 /begin DEF_CHARACTERISTIC CoPOM_fac60Div2PI_C CoPOM_nMinPwrTqCnvn_C CoPOM_nRvsDir_C CoPOM_tqMaxBattPwrBasdLim_T /end DEF_CHARACTERISTIC
 /begin IN_MEASUREMENT Emac_facEff01 Emac_nAct01 Emac_pwrAct01 HVGrid_pwrMaxGenrTiLong HVGrid_pwrMaxGenrTiSho HVGrid_pwrMaxMotTiLong HVGrid_pwrMaxMotTiSho /end IN_MEASUREMENT
 /begin OUT_MEASUREMENT CoPOM_pwrElecEm01DynMax CoPOM_pwrElecEm01DynMin CoPOM_pwrElecQstyMax CoPOM_pwrElecQstyMin CoPOM_tqElecPrimQstyMax CoPOM_tqElecPrimQstyMin /end OUT_MEASUREMENT
 /begin LOC_MEASUREMENT CoPOM_facCnvnPwrTqEm01 CoPOM_pwrAct01Tmp CoPOM_tqElecPrimQstyMaxTemp CoPOM_tqElecPrimQstyMinTemp CoPOM_tqMaxBattPwrLim /end LOC_MEASUREMENT
 FUNCTION_VERSION "160.3.0" /end FUNCTION
/begin FUNCTION CoPOM_TrqLimCalc "160.7.0   Calculation of Limits for electric and combustion engine, Calculation of drag t"
 /begin DEF_CHARACTERISTIC CoPOM_flgPrimFltDetnRampInitEna_C CoPOM_maskNActPhy01VldSq_C CoPOM_maskVehVVldSq_C CoPOM_swtPrimErrHndlgInactv_C CoPOM_tqMinRgnInhbnNegSlop_C CoPOM_tqMinRgnInhbnPosSlop_C CoPOM_tqPrimMaxErrNegSlop_C CoPOM_tqPrimMaxErrPosSlop_C CoPOM_tqPrimMaxFltDetn_C CoPOM_tqPrimMinErrNegSlop_C CoPOM_tqPrimMinErrPosSlop_C CoPOM_tqPrimMinFltDetn_C /end DEF_CHARACTERISTIC
 /begin IN_MEASUREMENT CoPOM_tqElecPrimQstyMax CoPOM_tqElecPrimQstyMin CoVMEv_tqSysErrLimnMaxPrimAxle CoVMEv_tqSysErrLimnMinPrimAxle Emac_nActPhy01_Sq Emac_tqAbsltMax01 Emac_tqAbsltMin01 MoFTqPtdOut_tqMaxAllwdMsg MoFTqPtdOut_tqMinAllwdMsg TrsmEmac_ratTqPrimAxle TrsmEmac_tqLoss01 TrsmEmac_tqProtnMax01 TrsmEmac_tqProtnMin01 VehMot_tqWhlRecupLimPrimAxle VehV_v_Sq /end IN_MEASUREMENT
 /begin OUT_MEASUREMENT CoPOM_tqEmacDynMax01 CoPOM_tqEmacDynMin01 CoPOM_tqWhlMeclPrimQstyMax CoPOM_tqWhlMeclPrimQstyMin CoPOM_tqWhlPrimAxleQstyMax CoPOM_tqWhlPrimAxleQstyMin CoPOM_tqWhlQstyMax CoPOM_tqWhlQstyMin DINH_nrActvInhReas.FId_CoPOMMaxLimFltDetnPrim DINH_nrActvInhReas.FId_CoPOMMinLimFltDetnPrim DINH_nrActvInhReas.FId_CoPOMRgnInhbnPrim DINH_stFId.FId_CoPOMMaxLimFltDetnPrim DINH_stFId.FId_CoPOMMinLimFltDetnPrim DINH_stFId.FId_CoPOMRgnInhbnPrim /end OUT_MEASUREMENT
 /begin LOC_MEASUREMENT CoPOM_tqPrimMaxErrHndlg CoPOM_tqPrimMinErrHndlg CoPOM_tqWhlElecPrimQstyMax CoPOM_tqWhlElecPrimQstyMin CoPOM_tqWhlPrimAxleQstyMaxPre CoPOM_tqWhlPrimAxleQstyMinPre /end LOC_MEASUREMENT
 FUNCTION_VERSION "160.7.0" /end FUNCTION
/begin FUNCTION CoPTEv_TqDesCoorr "160.4.0   coordination GearBox-intervention for an e-driven axle with integrated transmission and conversion of engine-torque to wheeltorque"
 /begin IN_MEASUREMENT CoPOM_tqEmacDynMax01 CoPOM_tqEmacDynMin01 CoVMEv_tqDes01 TrsmEmac_ratTqPrimAxle TrsmEmac_tqLoss01 TrsmEmac_tqProtnMax01 TrsmEmac_tqProtnMin01 VMSIEv_tqDesMax01 VMSIEv_tqDesMin01 /end IN_MEASUREMENT
 /begin OUT_MEASUREMENT CoPTEv_stTqLimd CoPTEv_stTqLimd01 CoPTEv_tqIntvCoord01 CoPTEv_tqIntvInc01 PT_tqDesEmac01 /end OUT_MEASUREMENT
 /begin LOC_MEASUREMENT CoPTEv_tqEmac01 CoPTEv_tqWithTrsmProtn01 /end LOC_MEASUREMENT
 FUNCTION_VERSION "160.4.0" /end FUNCTION
/begin FUNCTION CoVMDEv_TqCoorr "160.5.0   Coordination of propulsion torque in electric vehicle motion demand" /begin DEF_CHARACTERISTIC CoVMD_tqThdSpdLimL_C CoVMD_tqThdSpdLimR_C /end DEF_CHARACTERISTIC /begin IN_MEASUREMENT AccPedEv_tqWhlDes CoVMD_trqLLim LLim_stReq StrtUpEv_tqDes /end IN_MEASUREMENT
 /begin OUT_MEASUREMENT CoVMDEv_tqDrvrDmd CoVMDEv_tqWoBrkgToZr CoVMD_flgDrvDmdHiPrio VehMot_stPrpLLim VMDEv_tqDes /end OUT_MEASUREMENT
 /begin LOC_MEASUREMENT CoVMDEv_tqWithStrtUp /end LOC_MEASUREMENT
 FUNCTION_VERSION "160.5.0" /end FUNCTION
/begin FUNCTION CoVMD_TrqCalc "160.5.0   Torque Calculation of Vehicle Motion Demand" /begin DEF_CHARACTERISTIC CoVMD_tqWhlMinDrvrAssc_M /end DEF_CHARACTERISTIC
 /begin IN_MEASUREMENT CoPOM_tqWhlQstyMax CoPOM_tqWhlQstyMin LLim_aReq LLim_stReq MoFTqPtdVeh_stDrvProgReqMsg VehMot_a2trq VehMot_trqDrag VehV_v /end IN_MEASUREMENT
 /begin OUT_MEASUREMENT CoVMD_tqWhlMinDrvrAssc CoVMD_trqLLim /end OUT_MEASUREMENT
 /begin LOC_MEASUREMENT CoVMD_tqPrpLLim /end LOC_MEASUREMENT
 FUNCTION_VERSION "160.5.0" /end FUNCTION
/begin COMPU_METHOD B_TRUE "" TAB_VERB "%6.3" "" COMPU_TAB_REF B_TRUE /end COMPU_METHOD
/begin COMPU_VTAB B_TRUE "" TAB_VERB 2 0 "FALSE" 1 "TRUE" /end COMPU_VTAB
/begin COMPU_METHOD DDRC_DTRFRZINFHEALDEB_SY_Compu "" TAB_VERB "%6.3" "" COMPU_TAB_REF DDRC_DTRFRZINFHEALDEB_SY_Compu /end COMPU_METHOD
/begin COMPU_VTAB DDRC_DTRFRZINFHEALDEB_SY_Compu "" TAB_VERB 2 0 "False" 1 "True" /end COMPU_VTAB
/begin COMPU_METHOD DDRC_DTRUPDSUP_SY_Compu "" TAB_VERB "%6.3" "" COMPU_TAB_REF DDRC_DTRUPDSUP_SY_Compu /end COMPU_METHOD
/begin COMPU_VTAB DDRC_DTRUPDSUP_SY_Compu "" TAB_VERB 2 0 "False" 1 "True" /end COMPU_VTAB
/begin COMPU_METHOD DEDIA_DBG_SC_Compu "" TAB_VERB "%6.3" "" COMPU_TAB_REF DEDIA_DBG_SC_Compu /end COMPU_METHOD
/begin COMPU_VTAB DEDIA_DBG_SC_Compu "" TAB_VERB 2 0 "0" 1 "1" /end COMPU_VTAB
/begin COMPU_METHOD DEDIA_VRNTCONF_SY_Compu "" TAB_VERB "%6.3" "" COMPU_TAB_REF DEDIA_VRNTCONF_SY_Compu /end COMPU_METHOD
/begin COMPU_VTAB DEDIA_VRNTCONF_SY_Compu "" TAB_VERB 3 0 "DEDIA_VRNTCONF_ALL" 1 "DEDIA_VRNTCONF_DS" 2 "DEDIA_VRNTCONF_GS" /end COMPU_VTAB
/begin COMPU_METHOD DELIB_DBG_SC_Compu "" RAT_FUNC "%6.2" "" COEFFS 0 1 0 0 0 1 /end COMPU_METHOD
/begin COMPU_METHOD DELIB_DSQACTVT_SC_Compu "" TAB_VERB "%6.3" "" COMPU_TAB_REF DELIB_DSQACTVT_SC_Compu /end COMPU_METHOD
/begin COMPU_VTAB DELIB_DSQACTVT_SC_Compu "" TAB_VERB 2 0 "Inactive" 1 "Active" /end COMPU_VTAB
/begin COMPU_METHOD DELIB_DYNSDLDEACTV_SC_Compu "" TAB_VERB "%6.3" "" COMPU_TAB_REF DELIB_DYNSDLDEACTV_SC_Compu /end COMPU_METHOD
/begin COMPU_VTAB DELIB_DYNSDLDEACTV_SC_Compu "" TAB_VERB 2 0 "False" 1 "True" /end COMPU_VTAB
/begin COMPU_METHOD DELIB_ELECACTRTYPAVL_SC_Compu "" TAB_VERB "%6.3" "" COMPU_TAB_REF DELIB_ELECACTRTYPAVL_SC_Compu /end COMPU_METHOD
/begin COMPU_VTAB DELIB_ELECACTRTYPAVL_SC_Compu "" TAB_VERB 2 0 "False" 1 "True" /end COMPU_VTAB
/begin COMPU_METHOD DELIB_ENGDATENG_TYPAVL_SC_Compu "" TAB_VERB "%6.3" "" COMPU_TAB_REF DELIB_ENGDATENG_TYPAVL_SC_Compu /end COMPU_METHOD
/begin COMPU_VTAB DELIB_ENGDATENG_TYPAVL_SC_Compu "" TAB_VERB 2 0 "False" 1 "True" /end COMPU_VTAB
/begin COMPU_METHOD DELIB_FACPRECTLDWNTEMPCORRSIZECUR_SC_Compu "" RAT_FUNC "%6.2" "" COEFFS 0 1 0 0 0 1 /end COMPU_METHOD
/begin COMPU_METHOD DELIB_FACPRECTLUPTEMPCORRSIZECUR_SC_Compu "" RAT_FUNC "%6.2" "" COEFFS 0 1 0 0 0 1 /end COMPU_METHOD
/begin COMPU_METHOD DELIB_FACTQLOSSCMPSIZECUR_SC_Compu "" RAT_FUNC "%6.2" "" COEFFS 0 1 0 0 0 1 /end COMPU_METHOD
/begin COMPU_METHOD DELIB_HVDDC_TYPAVL_SC_Compu "" TAB_VERB "%6.3" "" COMPU_TAB_REF DELIB_HVDDC_TYPAVL_SC_Compu /end COMPU_METHOD
/begin COMPU_VTAB DELIB_HVDDC_TYPAVL_SC_Compu "" TAB_VERB 2 0 "False" 1 "True" /end COMPU_VTAB
/begin COMPU_METHOD DELIB_MDLEXHSNSRAVL_SC_Compu "" TAB_VERB "%6.3" "" COMPU_TAB_REF DELIB_MDLEXHSNSRAVL_SC_Compu /end COMPU_METHOD
/begin COMPU_VTAB DELIB_MDLEXHSNSRAVL_SC_Compu "" TAB_VERB 2 0 "False" 1 "True" /end COMPU_VTAB
/begin COMPU_METHOD DELIB_PMINLRNSIZECUR_SC_Compu "" RAT_FUNC "%6.2" "" COEFFS 0 1 0 0 0 1 /end COMPU_METHOD
/begin COMPU_METHOD DFC_OneToOne "" RAT_FUNC "%6.2" "-" COEFFS 0 1 0 0 0 1 /end COMPU_METHOD
/begin COMPU_METHOD DFES_OneToOne "" RAT_FUNC "%6.2" "-" COEFFS 0 1 0 0 0 1 /end COMPU_METHOD
/begin COMPU_METHOD DINH_ct_Compu "" RAT_FUNC "%6.0" "" COEFFS 0 -1 4096 0 0 1 /end COMPU_METHOD
/begin COMPU_METHOD Fact_100000 "" RAT_FUNC "%8.7" "-" COEFFS 0 100000 0 0 0 1 /end COMPU_METHOD
/begin COMPU_METHOD leist_q16_W "" RAT_FUNC "%6.1" "W" COEFFS 0 1 0 0 0 16 /end COMPU_METHOD
/begin COMPU_METHOD nmot_q1 "" RAT_FUNC "%6.2" "1/min" COEFFS 0 1 0 0 0 1 /end COMPU_METHOD
/begin COMPU_METHOD OneToOne "" RAT_FUNC "%6.2" "-" COEFFS 0 1 0 0 0 1 /end COMPU_METHOD
/begin COMPU_METHOD RBPtCel_pwr_25p0_1 "" RAT_FUNC "%6.1" "W" COEFFS 0 1 0 0 0 25 /end COMPU_METHOD
/begin COMPU_METHOD RmpTrq "" RAT_FUNC "%6.4" "Nm/s" COEFFS 0 655.36 0 0 0 1 /end COMPU_METHOD
/begin COMPU_METHOD Trq "" RAT_FUNC "%6.3" "Nm" COEFFS 0 10 0 0 0 1 /end COMPU_METHOD
/begin COMPU_METHOD TrqPrp "" RAT_FUNC "%6.2" "Nm" COEFFS 0 0.625 0 0 0 1 /end COMPU_METHOD
/begin COMPU_METHOD TrqPrpHigh "" RAT_FUNC "%6.3" "Nm" COEFFS 0 10 0 0 0 1 /end COMPU_METHOD
/begin COMPU_METHOD Vel "" RAT_FUNC "%6.4" "km/h" COEFFS 0 100 0 0 0 1 /end COMPU_METHOD
/begin RECORD_LAYOUT RB_Curve_S16_S16 NO_AXIS_PTS_X 1 SWORD AXIS_PTS_X 2 SWORD INDEX_INCR DIRECT FNC_VALUES 3 SWORD COLUMN_DIR DIRECT /end RECORD_LAYOUT
/begin RECORD_LAYOUT RB_Map_U16S16_S16_sao NO_AXIS_PTS_X 1 UWORD NO_AXIS_PTS_Y 2 UWORD AXIS_PTS_X 3 UWORD INDEX_INCR DIRECT AXIS_PTS_Y 4 SWORD INDEX_INCR DIRECT FNC_VALUES 5 SWORD COLUMN_DIR DIRECT STATIC_ADDRESS_OFFSETS /end RECORD_LAYOUT
/begin RECORD_LAYOUT RB_Val_Wboolean FNC_VALUES 1 UBYTE COLUMN_DIR DIRECT /end RECORD_LAYOUT
/begin RECORD_LAYOUT RB_Val_Ws16 FNC_VALUES 1 SWORD COLUMN_DIR DIRECT /end RECORD_LAYOUT
/begin RECORD_LAYOUT RB_Val_Ws32 FNC_VALUES 1 SLONG COLUMN_DIR DIRECT /end RECORD_LAYOUT
/begin RECORD_LAYOUT RB_Val_Wu16 FNC_VALUES 1 UWORD COLUMN_DIR DIRECT /end RECORD_LAYOUT
/begin RECORD_LAYOUT Val_Ws16 FNC_VALUES 1 SWORD COLUMN_DIR DIRECT /end RECORD_LAYOUT
/begin RECORD_LAYOUT Val_Wu16 FNC_VALUES 1 UWORD COLUMN_DIR DIRECT /end RECORD_LAYOUT
/begin RECORD_LAYOUT Val_Wu8 FNC_VALUES 1 UBYTE COLUMN_DIR DIRECT /end RECORD_LAYOUT
/end MODULE
/end PROJECT

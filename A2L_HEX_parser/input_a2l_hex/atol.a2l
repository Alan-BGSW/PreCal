ASAP2_VERSION 1 70
/begin PROJECT MDG1C "VC1CP091_STLA_N_D061I3"
/begin HEADER "" VERSION "VC1CP091_STLA_N_D061I3" PROJECT_NO MDG1C /end HEADER
/begin MODULE DIM ""
/begin MOD_COMMON "" BYTE_ORDER MSB_LAST ALIGNMENT_BYTE 1 ALIGNMENT_WORD 2 ALIGNMENT_LONG 4 ALIGNMENT_INT64 4 ALIGNMENT_FLOAT32_IEEE 4 ALIGNMENT_FLOAT64_IEEE 4 DATA_SIZE 32 /end MOD_COMMON
/begin CHARACTERISTIC DFC_CtlMsk2.DFC_MoFEvMngtBms_C "" VALUE 0x80241666 Val_Wu8 255.0 DFES_OneToOne 0.00 255.0 FORMAT "%5.1" /end CHARACTERISTIC
/begin CHARACTERISTIC DFC_CtlMsk2.DFC_MoFEvMngtDcdc_C "" VALUE 0x80241667 Val_Wu8 255.0 DFES_OneToOne 0.00 255.0 FORMAT "%5.1" /end CHARACTERISTIC
/begin CHARACTERISTIC DFC_CtlMsk2.DFC_MoFEvMngtEm01_C "" VALUE 0x80241668 Val_Wu8 255.0 DFES_OneToOne 0.00 255.0 FORMAT "%5.1" /end CHARACTERISTIC
/begin CHARACTERISTIC DFC_CtlMsk2.DFC_MoFEvMngtEm01BrkgToZr_C "" VALUE 0x80241669 Val_Wu8 255.0 DFES_OneToOne 0.00 255.0 FORMAT "%5.1" /end CHARACTERISTIC
/begin CHARACTERISTIC DFC_CtlMsk2.DFC_MoFEvMngtEm01EngSpd_C "" VALUE 0x8024166A Val_Wu8 255.0 DFES_OneToOne 0.00 255.0 FORMAT "%5.1" /end CHARACTERISTIC
/begin CHARACTERISTIC DFC_CtlMsk2.DFC_MoFEvMngtEm02EngSpd_C "" VALUE 0x8024166B Val_Wu8 255.0 DFES_OneToOne 0.00 255.0 FORMAT "%5.1" /end CHARACTERISTIC
/begin CHARACTERISTIC DFC_CtlMsk2.DFC_MoFEvMngtEm02Lvl1_C "" VALUE 0x8024166C Val_Wu8 255.0 DFES_OneToOne 0.00 255.0 FORMAT "%5.1" /end CHARACTERISTIC
/begin CHARACTERISTIC DFC_CtlMsk2.DFC_MoFEvMngtEm02Lvl2_C "" VALUE 0x8024166D Val_Wu8 255.0 DFES_OneToOne 0.00 255.0 FORMAT "%5.1" /end CHARACTERISTIC
/begin CHARACTERISTIC DFC_CtlMsk2.DFC_MoFExtCptAuxCpt_C "" VALUE 0x8024166E Val_Wu8 255.0 DFES_OneToOne 0.00 255.0 FORMAT "%5.1" /end CHARACTERISTIC
/begin CHARACTERISTIC DFC_DisblMsk2.DFC_MoFEvMngtBms_C "" VALUE 0x802491B2 Val_Wu16 65535.00 DFES_OneToOne 0.00 65535.00 FORMAT "%8.2" /end CHARACTERISTIC
/begin CHARACTERISTIC DFC_DisblMsk2.DFC_MoFEvMngtDcdc_C "" VALUE 0x802491B4 Val_Wu16 65535.00 DFES_OneToOne 0.00 65535.00 FORMAT "%8.2" /end CHARACTERISTIC
/begin CHARACTERISTIC DFC_DisblMsk2.DFC_MoFEvMngtEm01_C "" VALUE 0x802491B6 Val_Wu16 65535.00 DFES_OneToOne 0.00 65535.00 FORMAT "%8.2" /end CHARACTERISTIC
/begin CHARACTERISTIC DFC_DisblMsk2.DFC_MoFEvMngtEm01BrkgToZr_C "" VALUE 0x802491B8 Val_Wu16 65535.00 DFES_OneToOne 0.00 65535.00 FORMAT "%8.2" /end CHARACTERISTIC
/begin CHARACTERISTIC DFC_DisblMsk2.DFC_MoFEvMngtEm01EngSpd_C "" VALUE 0x802491BA Val_Wu16 65535.00 DFES_OneToOne 0.00 65535.00 FORMAT "%8.2" /end CHARACTERISTIC
/begin CHARACTERISTIC DFC_DisblMsk2.DFC_MoFEvMngtEm02EngSpd_C "" VALUE 0x802491BC Val_Wu16 65535.00 DFES_OneToOne 0.00 65535.00 FORMAT "%8.2" /end CHARACTERISTIC
/begin CHARACTERISTIC DFC_DisblMsk2.DFC_MoFEvMngtEm02Lvl1_C "" VALUE 0x802491BE Val_Wu16 65535.00 DFES_OneToOne 0.00 65535.00 FORMAT "%8.2" /end CHARACTERISTIC
/begin CHARACTERISTIC DFC_DisblMsk2.DFC_MoFEvMngtEm02Lvl2_C "" VALUE 0x802491C0 Val_Wu16 65535.00 DFES_OneToOne 0.00 65535.00 FORMAT "%8.2" /end CHARACTERISTIC
/begin CHARACTERISTIC DFC_DisblMsk2.DFC_MoFExtCptAuxCpt_C "" VALUE 0x802491C2 Val_Wu16 65535.00 DFES_OneToOne 0.00 65535.00 FORMAT "%8.2" /end CHARACTERISTIC
/begin CHARACTERISTIC MoFEvMngtEm_stSwtCfgFltCfm_C "Calibration for enable configuration for Em faults" VALUE 0x8026CC94 Val_Wu8 255.0 OneToOne 0.00 255.0 FORMAT "%5.1" /end CHARACTERISTIC
/begin CHARACTERISTIC MoFEvMngt_AdcDefVal_C "ADC default value" VALUE 0x8026CC62 Val_Ws8 255.0 OneToOne -128.0 127.0 FORMAT "%5.1" /end CHARACTERISTIC
/begin CHARACTERISTIC MoFEvMngt_ADCSnsrCnvr_T "ADC conversion curve table" CURVE 0x8026D04C Mo_DataCurveSstS32WS32 65535.0000000 RBPtCel_t_1p0_3 -32768.0000000 32767.0000000 FORMAT "%13.7" EXTENDED_LIMITS -2147483648.00 2147483647.00
 /begin AXIS_DESCR STD_AXIS MoFEvMngt_uAdcCnvrVal spg_q0p00488 25 0.00 319.995117188 FORMAT "%13.9" EXTENDED_LIMITS -10485760.0000 10485759.9951 DEPOSIT ABSOLUTE /end AXIS_DESCR
/end CHARACTERISTIC
/begin CHARACTERISTIC MoFEvMngt_AdcSnsrEna_C "Calibtration for ADC sensor enable" VALUE 0x8026CC63 Val_Wu8 255.0 OneToOne 0.00 255.0 FORMAT "%5.1" /end CHARACTERISTIC
/begin CHARACTERISTIC MoFEvMngt_Bms_DataDebErrReactn_I.cntErrDebMax_C "Error handling class instance to debounce error and handle error reaction / Calibratable debounce count for class DataDeb with error reaction." VALUE 0x80270010 Val_Wu16 65535.00 OneToOne 0.00 65535.00 FORMAT "%8.2" /end CHARACTERISTIC
/begin CHARACTERISTIC MoFEvMngt_Bms_DataDebErrReactn_I.stCfgErrHndlg_C "Error handling class instance to debounce error and handle error reaction / Calibratable error handling configuration class DataDeb with error reaction." VALUE 0x80270012 Val_Wu8 255.0 OneToOne 0.00 255.0 FORMAT "%5.1" /end CHARACTERISTIC
/begin CHARACTERISTIC MoFEvMngt_Bms_DataDebErrReactn_I.stCfgErrReactn_C "Error handling class instance to debounce error and handle error reaction / Calibratable parameter for error reaction class DataDeb with error reaction." VALUE 0x80270013 Val_Wu8 255.0 OneToOne 0.00 255.0 FORMAT "%5.1" /end CHARACTERISTIC
/begin CHARACTERISTIC MoFEvMngt_cntrClsElMMaxEm01_C "Calibration for MoFEvMngt_cntrClsElMMaxEm01" VALUE 0x8026CC95 Val_Wu8 255.0 OneToOne 0.00 255.0 FORMAT "%5.1" /end CHARACTERISTIC
/begin CHARACTERISTIC MoFEvMngt_cntrClsFltBms1_C "Debounce closed calibration for Fault HvBatt" VALUE 0x8026CC64 Val_Wu8 255.0 OneToOne 0.00 255.0 FORMAT "%5.1" /end CHARACTERISTIC
/begin CHARACTERISTIC MoFEvMngt_cntrClsFltBms2_C "Debounce closed calibration for Fault Inverter" VALUE 0x8026CC65 Val_Wu8 255.0 OneToOne 0.00 255.0 FORMAT "%5.1" /end CHARACTERISTIC
/begin CHARACTERISTIC MoFEvMngt_cntrClsFltBms3_C "Debounce closed calibration for Fault DCDC" VALUE 0x8026CC66 Val_Wu8 255.0 OneToOne 0.00 255.0 FORMAT "%5.1" /end CHARACTERISTIC
/begin CHARACTERISTIC MoFEvMngt_cntrClsMaxActvDcha_C "Calibration for Counter variable for Active Discharge timeout" VALUE 0x8026D2E2 Val_Wu16 65535.00 OneToOne 0.00 65535.00 FORMAT "%8.2" /end CHARACTERISTIC
/begin CHARACTERISTIC MoFEvMngt_cntrClsMaxBms1_C "Calibration for MoFEvMngt_cntrClsMaxBms1" VALUE 0x8026CC67 Val_Wu8 255.0 OneToOne 0.00 255.0 FORMAT "%5.1" /end CHARACTERISTIC
/begin CHARACTERISTIC MoFEvMngt_cntrClsMaxBms2_C "Calibration for MoFEvMngt_cntrClsMaxBms2" VALUE 0x8026CC68 Val_Wu8 255.0 OneToOne 0.00 255.0 FORMAT "%5.1" /end CHARACTERISTIC
/begin CHARACTERISTIC MoFEvMngt_cntrClsMaxBms3_C "Calibration for closed counter for debounce block3" VALUE 0x8026CC69 Val_Wu8 255.0 OneToOne 0.00 255.0 FORMAT "%5.1" /end CHARACTERISTIC
/begin CHARACTERISTIC MoFEvMngt_cntrClsMaxBms_C "Maximum Debounce counter threshold for HV Battery mode when it transits True to False" VALUE 0x8026CC6A Val_Wu8 255.0 OneToOne 0.00 255.0 FORMAT "%5.1" /end CHARACTERISTIC
/begin CHARACTERISTIC MoFEvMngt_cntrClsStMaxEm01BrkgToZr1_C "Maximum Debounce counter threshold for inverter in mode-1 when it transits True to False for e-braking to zero functionality (errors present)" VALUE 0x8026CC96 Val_Wu8 255.0 OneToOne 0.00 255.0 FORMAT "%5.1" /end CHARACTERISTIC
/begin CHARACTERISTIC MoFEvMngt_cntrClsStMaxEm01BrkgToZr2_C "Maximum Debounce counter threshold for inverter in mode-1 when it transits True to False for e-braking to zero functionality (active and no errors present)" VALUE 0x8026CC97 Val_Wu8 255.0 OneToOne 0.00 255.0 FORMAT "%5.1" /end CHARACTERISTIC
/begin CHARACTERISTIC MoFEvMngt_cntrClsStMaxEm01_C "Maximum Debounce counter threshold for inverter in mode-1 when it transits True to False" VALUE 0x8026CC98 Val_Wu8 255.0 OneToOne 0.00 255.0 FORMAT "%5.1" /end CHARACTERISTIC
/begin CHARACTERISTIC MoFEvMngt_cntrClsStMaxEm02SafeIvtr_C "Maximum Debounce counter threshold for safe inverter in mode-2 when it transits True to False" VALUE 0x8026CC99 Val_Wu8 255.0 OneToOne 0.00 255.0 FORMAT "%5.1" /end CHARACTERISTIC
/begin CHARACTERISTIC MoFEvMngt_cntrClsStMaxEm02_C "Maximum Debounce counter threshold for inverter in mode-2 when it transits True to False" VALUE 0x8026CC9A Val_Wu8 255.0 OneToOne 0.00 255.0 FORMAT "%5.1" /end CHARACTERISTIC
/begin CHARACTERISTIC MoFEvMngt_cntrDcdcHiLoErrDeb_C "Debounce counter threshold for DCDC error healing" VALUE 0x8026CC86 Val_Wu8 255.0 OneToOne 0.00 255.0 FORMAT "%5.1" /end CHARACTERISTIC
/begin CHARACTERISTIC MoFEvMngt_cntrDcdcLoHiErrDeb_C "Debounce counter threshold for DCDC error setting" VALUE 0x8026CC87 Val_Wu8 255.0 OneToOne 0.00 255.0 FORMAT "%5.1" /end CHARACTERISTIC
/begin CHARACTERISTIC MoFEvMngt_cntrErrDebMaxEngSpdEM01_C "Diagnosis cycle flag debounce counter threshold for EM01 e-braking to zero functionality (errors present)" VALUE 0x8026CC9B Val_Wu8 255.0 OneToOne 0.00 255.0 FORMAT "%5.1" /end CHARACTERISTIC
/begin CHARACTERISTIC MoFEvMngt_cntrErrDebMaxEngSpdEM02_C "Diagnosis cycle flag debounce counter threshold for EM01 e-braking to zero functionality (active and no errors present)" VALUE 0x8026CC9C Val_Wu8 255.0 OneToOne 0.00 255.0 FORMAT "%5.1" /end CHARACTERISTIC
/begin CHARACTERISTIC MoFEvMngt_cntrOpnElMMaxEm01_C "Calibration for MoFEvMngt_cntrOpnElMMaxEm01" VALUE 0x8026CC9D Val_Wu8 255.0 OneToOne 0.00 255.0 FORMAT "%5.1" /end CHARACTERISTIC
/begin CHARACTERISTIC MoFEvMngt_cntrOpnFltBms1_C "Debounce open calibration for Fault HvBatt" VALUE 0x8026CC6B Val_Wu8 255.0 OneToOne 0.00 255.0 FORMAT "%5.1" /end CHARACTERISTIC
/begin CHARACTERISTIC MoFEvMngt_cntrOpnFltBms2_C "Debounce open calibration for Fault Inverter" VALUE 0x8026CC6C Val_Wu8 255.0 OneToOne 0.00 255.0 FORMAT "%5.1" /end CHARACTERISTIC
/begin CHARACTERISTIC MoFEvMngt_cntrOpnFltBms3_C "Debounce open calibration for Fault DCDC" VALUE 0x8026CC6D Val_Wu8 255.0 OneToOne 0.00 255.0 FORMAT "%5.1" /end CHARACTERISTIC
/begin CHARACTERISTIC MoFEvMngt_cntrOpnMaxBms1_C "Calibration for open counter for debounce block1" VALUE 0x8026CC6E Val_Wu8 255.0 OneToOne 0.00 255.0 FORMAT "%5.1" /end CHARACTERISTIC
/begin CHARACTERISTIC MoFEvMngt_cntrOpnMaxBms2_C "Calibration for open counter for debounce block2" VALUE 0x8026CC6F Val_Wu8 255.0 OneToOne 0.00 255.0 FORMAT "%5.1" /end CHARACTERISTIC
/begin CHARACTERISTIC MoFEvMngt_cntrOpnMaxBms3_C "Calibration for open counter for debounce block3" VALUE 0x8026CC70 Val_Wu8 255.0 OneToOne 0.00 255.0 FORMAT "%5.1" /end CHARACTERISTIC
/begin CHARACTERISTIC MoFEvMngt_cntrOpnMaxBms_C "Maximum Debounce counter threshold for HV Battery mode when it transits False to True" VALUE 0x8026CC71 Val_Wu8 255.0 OneToOne 0.00 255.0 FORMAT "%5.1" /end CHARACTERISTIC
/begin CHARACTERISTIC MoFEvMngt_cntrOpnStMaxEm01BrkgToZr1_C "Maximum Debounce counter threshold for inverter in mode-1 when it transits False to True for e-braking to zero functionality (errors present)" VALUE 0x8026CC9E Val_Wu8 255.0 OneToOne 0.00 255.0 FORMAT "%5.1" /end CHARACTERISTIC
/begin CHARACTERISTIC MoFEvMngt_cntrOpnStMaxEm01BrkgToZr2_C "Maximum Debounce counter threshold for inverter in mode-1 when it transits False to True for e-braking to zero functionality (active and no errors present)" VALUE 0x8026CC9F Val_Wu8 255.0 OneToOne 0.00 255.0 FORMAT "%5.1" /end CHARACTERISTIC
/begin CHARACTERISTIC MoFEvMngt_cntrOpnStMaxEm01_C "Maximum Debounce counter threshold for inverter in mode-1 when it transits False to True" VALUE 0x8026CCA0 Val_Wu8 255.0 OneToOne 0.00 255.0 FORMAT "%5.1" /end CHARACTERISTIC
/begin CHARACTERISTIC MoFEvMngt_cntrOpnStMaxEm02SafeIvtr_C "Maximum Debounce counter threshold for safe inverter in mode-2 when it transits False to True" VALUE 0x8026CCA1 Val_Wu8 255.0 OneToOne 0.00 255.0 FORMAT "%5.1" /end CHARACTERISTIC
/begin CHARACTERISTIC MoFEvMngt_cntrOpnStMaxEm02_C "Maximum Debounce counter threshold for inverter in mode-2 when it transits False to True" VALUE 0x8026CCA2 Val_Wu8 255.0 OneToOne 0.00 255.0 FORMAT "%5.1" /end CHARACTERISTIC
/begin CHARACTERISTIC MoFEvMngt_Dcdc_DataDebErrReactn_I.cntErrDebMax_C "Class instance for DCDC error handling / Calibratable debounce count for class DataDeb with error reaction." VALUE 0x8027001C Val_Wu16 65535.00 OneToOne 0.00 65535.00 FORMAT "%8.2" /end CHARACTERISTIC
/begin CHARACTERISTIC MoFEvMngt_Dcdc_DataDebErrReactn_I.stCfgErrHndlg_C "Class instance for DCDC error handling / Calibratable error handling configuration class DataDeb with error reaction." VALUE 0x8027001E Val_Wu8 255.0 OneToOne 0.00 255.0 FORMAT "%5.1" /end CHARACTERISTIC
/begin CHARACTERISTIC MoFEvMngt_Dcdc_DataDebErrReactn_I.stCfgErrReactn_C "Class instance for DCDC error handling / Calibratable parameter for error reaction class DataDeb with error reaction." VALUE 0x8027001F Val_Wu8 255.0 OneToOne 0.00 255.0 FORMAT "%5.1" /end CHARACTERISTIC
/begin CHARACTERISTIC MoFEvMngt_Em01BrkgToZr_DataDebErrReactn_I.cntErrDebMax_C "Error handling class instance to debounce e-braking to zero error and handle error reaction / Calibratable debounce count for class DataDeb with error reaction." VALUE 0x80270028 Val_Wu16 65535.00 OneToOne 0.00 65535.00 FORMAT "%8.2" /end CHARACTERISTIC
/begin CHARACTERISTIC MoFEvMngt_Em01BrkgToZr_DataDebErrReactn_I.stCfgErrHndlg_C "Error handling class instance to debounce e-braking to zero error and handle error reaction / Calibratable error handling configuration class DataDeb with error reaction." VALUE 0x8027002A Val_Wu8 255.0 OneToOne 0.00 255.0 FORMAT "%5.1" /end CHARACTERISTIC
/begin CHARACTERISTIC MoFEvMngt_Em01BrkgToZr_DataDebErrReactn_I.stCfgErrReactn_C "Error handling class instance to debounce e-braking to zero error and handle error reaction / Calibratable parameter for error reaction class DataDeb with error reaction." VALUE 0x8027002B Val_Wu8 255.0 OneToOne 0.00 255.0 FORMAT "%5.1" /end CHARACTERISTIC
/begin CHARACTERISTIC MoFEvMngt_Em01EngSpd_DataErrReactn_I.stCfgErrHndlg_C "Error handling class instance to handle EM01 engine speed error reaction without debouncing / Calibration parameter for configutation of error handling in class error reaction." VALUE 0x80270034 Val_Wu8 255.0 OneToOne 0.00 255.0 FORMAT "%5.1" /end CHARACTERISTIC
/begin CHARACTERISTIC MoFEvMngt_Em01EngSpd_DataErrReactn_I.stCfgErrReactn_C "Error handling class instance to handle EM01 engine speed error reaction without debouncing / Calibration of error reaction in class error reaction." VALUE 0x80270035 Val_Wu8 255.0 OneToOne 0.00 255.0 FORMAT "%5.1" /end CHARACTERISTIC
/begin CHARACTERISTIC MoFEvMngt_Em01_DataDebErrReactn_I.cntErrDebMax_C "Error handling class instance to debounce error and handle error reaction / Calibratable debounce count for class DataDeb with error reaction." VALUE 0x80270040 Val_Wu16 65535.00 OneToOne 0.00 65535.00 FORMAT "%8.2" /end CHARACTERISTIC
/begin CHARACTERISTIC MoFEvMngt_Em01_DataDebErrReactn_I.stCfgErrHndlg_C "Error handling class instance to debounce error and handle error reaction / Calibratable error handling configuration class DataDeb with error reaction." VALUE 0x80270042 Val_Wu8 255.0 OneToOne 0.00 255.0 FORMAT "%5.1" /end CHARACTERISTIC
/begin CHARACTERISTIC MoFEvMngt_Em01_DataDebErrReactn_I.stCfgErrReactn_C "Error handling class instance to debounce error and handle error reaction / Calibratable parameter for error reaction class DataDeb with error reaction." VALUE 0x80270043 Val_Wu8 255.0 OneToOne 0.00 255.0 FORMAT "%5.1" /end CHARACTERISTIC
/begin CHARACTERISTIC MoFEvMngt_Em02EngSpd_DataErrReactn_I.stCfgErrHndlg_C "Error handling class instance to handle EM02 engine speed error reaction without debouncing / Calibration parameter for configutation of error handling in class error reaction." VALUE 0x8027004C Val_Wu8 255.0 OneToOne 0.00 255.0 FORMAT "%5.1" /end CHARACTERISTIC
/begin CHARACTERISTIC MoFEvMngt_Em02EngSpd_DataErrReactn_I.stCfgErrReactn_C "Error handling class instance to handle EM02 engine speed error reaction without debouncing / Calibration of error reaction in class error reaction." VALUE 0x8027004D Val_Wu8 255.0 OneToOne 0.00 255.0 FORMAT "%5.1" /end CHARACTERISTIC
/begin CHARACTERISTIC MoFEvMngt_Em02Lvl1_DataDebErrReactn_I.cntErrDebMax_C "Error handling class instance to debounce error and handle error reaction / Calibratable debounce count for class DataDeb with error reaction." VALUE 0x80270058 Val_Wu16 65535.00 OneToOne 0.00 65535.00 FORMAT "%8.2" /end CHARACTERISTIC
/begin CHARACTERISTIC MoFEvMngt_Em02Lvl1_DataDebErrReactn_I.stCfgErrHndlg_C "Error handling class instance to debounce error and handle error reaction / Calibratable error handling configuration class DataDeb with error reaction." VALUE 0x8027005A Val_Wu8 255.0 OneToOne 0.00 255.0 FORMAT "%5.1" /end CHARACTERISTIC
/begin CHARACTERISTIC MoFEvMngt_Em02Lvl1_DataDebErrReactn_I.stCfgErrReactn_C "Error handling class instance to debounce error and handle error reaction / Calibratable parameter for error reaction class DataDeb with error reaction." VALUE 0x8027005B Val_Wu8 255.0 OneToOne 0.00 255.0 FORMAT "%5.1" /end CHARACTERISTIC
/begin CHARACTERISTIC MoFEvMngt_Em02Lvl2_DataDebErrReactn_I.cntErrDebMax_C "Error handling class instance to debounce error and handle error reaction / Calibratable debounce count for class DataDeb with error reaction." VALUE 0x80270064 Val_Wu16 65535.00 OneToOne 0.00 65535.00 FORMAT "%8.2" /end CHARACTERISTIC
/begin CHARACTERISTIC MoFEvMngt_Em02Lvl2_DataDebErrReactn_I.stCfgErrHndlg_C "Error handling class instance to debounce error and handle error reaction / Calibratable error handling configuration class DataDeb with error reaction." VALUE 0x80270066 Val_Wu8 255.0 OneToOne 0.00 255.0 FORMAT "%5.1" /end CHARACTERISTIC
/begin CHARACTERISTIC MoFEvMngt_Em02Lvl2_DataDebErrReactn_I.stCfgErrReactn_C "Error handling class instance to debounce error and handle error reaction / Calibratable parameter for error reaction class DataDeb with error reaction." VALUE 0x80270067 Val_Wu8 255.0 OneToOne 0.00 255.0 FORMAT "%5.1" /end CHARACTERISTIC
/begin CHARACTERISTIC MoFEvMngt_facTqDistbnThres_C "Calibration parameter for torque distribution factor" VALUE 0x8026D2E4 Val_Ws16 1.000000 fak_q1p22Em4 0.00 1.000000 FORMAT "%8.6" EXTENDED_LIMITS -4.000000 3.999878 /end CHARACTERISTIC
/begin CHARACTERISTIC MoFEvMngt_flgEmgyShtActv_C "Calibration to set safe mode for Emergency shutdown" VALUE 0x8026CC72 Val_Wu8 1.00000000000 B_TRUE 0.00 1.00000000000 FORMAT "%13.11" /end CHARACTERISTIC
/begin CHARACTERISTIC MoFEvMngt_flgFstHvShdwn_C "Calibration to compare emergency shutdown activated from level1" VALUE 0x8026CC73 Val_Wu8 1.00000000000 B_TRUE 0.00 1.00000000000 FORMAT "%13.11" /end CHARACTERISTIC
/begin CHARACTERISTIC MoFEvMngt_nDesEm01OffsMinus_C "Offset calibration parameter subtracted from MoFEvMngt_nDes01Signd for maximum limitation of level 1 Emac_nDesCom01" VALUE 0x8026D2E6 Val_Ws16 65535.00 nmot_q1 -32768.00 32767.00 FORMAT "%8.2" /end CHARACTERISTIC
/begin CHARACTERISTIC MoFEvMngt_nDesEm01OffsPlus_C "Offset calibration parameter added MoFEvMngt_nDes01Signd for minimum limitation of level 1 Emac_nDesCom01" VALUE 0x8026D2E8 Val_Ws16 65535.00 nmot_q1 -32768.00 32767.00 FORMAT "%8.2" /end CHARACTERISTIC
/begin CHARACTERISTIC MoFEvMngt_nDesThresInct_T "EM01 engine speed setpoint request threshold increment with which the engine speed setpoint request threshold is changed in each timestep depending on the engine gear" CURVE 0x8026D2EA Mo_DataCurveSstS16WS16 32767.00 nmot_q1 0.00 32767.00 FORMAT "%8.2" EXTENDED_LIMITS -32768.00 32767.00
 /begin AXIS_DESCR STD_AXIS MoFPtSt_ratPT TransR 11 -327.6800 327.6700 FORMAT "%8.4" DEPOSIT ABSOLUTE /end AXIS_DESCR
/end CHARACTERISTIC
/begin CHARACTERISTIC MoFEvMngt_nDesThresMax_T "EM01 engine speed setpoint request threshold initial maximum value depending on engine gear" CURVE 0x8026D318 Mo_DataCurveSstS16WS16 32767.00 nmot_q1 0.00 32767.00 FORMAT "%8.2" EXTENDED_LIMITS -32768.00 32767.00
 /begin AXIS_DESCR STD_AXIS MoFPtSt_ratPT TransR 11 -327.6800 327.6700 FORMAT "%8.4" DEPOSIT ABSOLUTE /end AXIS_DESCR
/end CHARACTERISTIC
/begin CHARACTERISTIC MoFEvMngt_nEm01Dfct_C "Defect value for e.-machine speed in case of CAN error" VALUE 0x8026D346 Val_Ws16 65535.00 nmot_q1 -32768.00 32767.00 FORMAT "%8.2" /end CHARACTERISTIC
/begin CHARACTERISTIC MoFEvMngt_nEm02Dfct_C "Defect value for rotatonal speed of E-Machine 02 in case of CAN error" VALUE 0x8026D348 Val_Ws16 65535.00 nmot_q1 -32768.00 32767.00 FORMAT "%8.2" /end CHARACTERISTIC
/begin CHARACTERISTIC MoFEvMngt_nrSmplAvrgFlt_C "Number of samples in average filter" VALUE 0x8026CCA3 Val_Wu8 19.00 OneToOne 1.00 20.00 FORMAT "%5.2" EXTENDED_LIMITS 0.00 255.0 /end CHARACTERISTIC
/begin CHARACTERISTIC MoFEvMngt_nSpdDesThresLim_C "Engine speed setpoint request threshold limit" VALUE 0x8026D34A Val_Ws16 32767.00 nmot_q1 0.00 32767.00 FORMAT "%8.2" EXTENDED_LIMITS -32768.00 32767.00 /end CHARACTERISTIC
/begin CHARACTERISTIC MoFEvMngt_stActvDchaMod1_C "Caliration to compare active discharge mode1" VALUE 0x8026CCA4 Val_Wu8 255.0 OneToOne 0.00 255.0 FORMAT "%5.1" /end CHARACTERISTIC
/begin CHARACTERISTIC MoFEvMngt_stActvDchaMod2_C "Caliration to compare active discharge mode2" VALUE 0x8026CCA5 Val_Wu8 255.0 OneToOne 0.00 255.0 FORMAT "%5.1" /end CHARACTERISTIC
/begin CHARACTERISTIC MoFEvMngt_stBmsCritMod1_C "Application state parameter for critical mode-01 of requested HV Battery mode" VALUE 0x8026CC74 Val_Wu8 255.0 OneToOne 0.00 255.0 FORMAT "%5.1" /end CHARACTERISTIC
/begin CHARACTERISTIC MoFEvMngt_stBmsCritMod2_C "Application state parameter for critical mode-02 of requested HV Battery mode" VALUE 0x8026CC75 Val_Wu8 255.0 OneToOne 0.00 255.0 FORMAT "%5.1" /end CHARACTERISTIC
/begin CHARACTERISTIC MoFEvMngt_stBmsCritMod3_C "Application state parameter for critical mode-03 of requested HV Battery mode" VALUE 0x8026CC76 Val_Wu8 255.0 OneToOne 0.00 255.0 FORMAT "%5.1" /end CHARACTERISTIC
/begin CHARACTERISTIC MoFEvMngt_stBmsCritMod4_C "Application state parameter for critical mode-04 of requested HV Battery mode" VALUE 0x8026CC77 Val_Wu8 255.0 OneToOne 0.00 255.0 FORMAT "%5.1" /end CHARACTERISTIC
/begin CHARACTERISTIC MoFEvMngt_stCrash_C "Calibration for MoFEvMngt_stCrash" VALUE 0x8026CCA6 Val_Wu8 255.0 OneToOne 0.00 255.0 FORMAT "%5.1" /end CHARACTERISTIC
/begin CHARACTERISTIC MoFEvMngt_stDcdcCritMod1_C "Application state parameter for critical mode-01 of requested DCDC operating mode" VALUE 0x8026CC88 Val_Wu8 255.0 OneToOne 0.00 255.0 FORMAT "%5.1" /end CHARACTERISTIC
/begin CHARACTERISTIC MoFEvMngt_stDcdcCritMod2_C "Application state parameter for critical mode-02 of requested DCDC operating mode" VALUE 0x8026CC89 Val_Wu8 255.0 OneToOne 0.00 255.0 FORMAT "%5.1" /end CHARACTERISTIC
/begin CHARACTERISTIC MoFEvMngt_stDcdcCritMod3_C "Application state parameter for critical mode-03 of requested DCDC operating mode" VALUE 0x8026CC8A Val_Wu8 255.0 OneToOne 0.00 255.0 FORMAT "%5.1" /end CHARACTERISTIC
/begin CHARACTERISTIC MoFEvMngt_stDcdcCritMod4_C "Application state parameter for critical mode-04 of requested DCDC operating mode" VALUE 0x8026CC8B Val_Wu8 255.0 OneToOne 0.00 255.0 FORMAT "%5.1" /end CHARACTERISTIC
/begin CHARACTERISTIC MoFEvMngt_stDcdcErrCfgd_C "Bit Mask Calibration for configuring DCDC error states to be considered to decide DCDC operating mode" VALUE 0x8026D118 Val_Wu32 4294967295.00 OneToOne 0.00 4294967295.00 FORMAT "%13.2" /end CHARACTERISTIC
/begin CHARACTERISTIC MoFEvMngt_stDcdcFltLvl1_C "Calibration DCDC Fault level4" VALUE 0x8026CC78 Val_Wu8 255.0 OneToOne 0.00 255.0 FORMAT "%5.1" /end CHARACTERISTIC
/begin CHARACTERISTIC MoFEvMngt_stDcdcFltLvl2_C "Calibration DCDC Fault level5" VALUE 0x8026CC79 Val_Wu8 255.0 OneToOne 0.00 255.0 FORMAT "%5.1" /end CHARACTERISTIC
/begin CHARACTERISTIC MoFEvMngt_stDcdcModDft_C "Calibratable safe mode of operation for DCDC converter during error" VALUE 0x8026CC8C Val_Wu8 255.0 OneToOne 0.00 255.0 FORMAT "%5.1" /end CHARACTERISTIC
/begin CHARACTERISTIC MoFEvMngt_stElMDesEem_C "Calibration for MoFEvMngt_stElMDesEem" VALUE 0x8026CCA7 Val_Wu8 255.0 OneToOne 0.00 255.0 FORMAT "%5.1" /end CHARACTERISTIC
/begin CHARACTERISTIC MoFEvMngt_stEmCritMod1_C "Application state parameter for critical mode-01 of E-machine" VALUE 0x8026CCA8 Val_Wu8 255.0 OneToOne 0.00 255.0 FORMAT "%5.1" /end CHARACTERISTIC
/begin CHARACTERISTIC MoFEvMngt_stEmCritMod2_C "Application state parameter for critical mode-02 of E-machine" VALUE 0x8026CCA9 Val_Wu8 255.0 OneToOne 0.00 255.0 FORMAT "%5.1" /end CHARACTERISTIC
/begin CHARACTERISTIC MoFEvMngt_stEmCritMod3_C "Application state parameter for critical mode-03 of E-machine" VALUE 0x8026CCAA Val_Wu8 255.0 OneToOne 0.00 255.0 FORMAT "%5.1" /end CHARACTERISTIC
/begin CHARACTERISTIC MoFEvMngt_stEmCritMod4_C "Application state parameter for critical mode-04 of E-machine" VALUE 0x8026CCAB Val_Wu8 255.0 OneToOne 0.00 255.0 FORMAT "%5.1" /end CHARACTERISTIC
/begin CHARACTERISTIC MoFEvMngt_stEmCritModBrkgToZr1_C "Critical inverter mode in case there are errors in the e-braking to zero functionality present" VALUE 0x8026CCAC Val_Wu8 255.0 OneToOne 0.00 255.0 FORMAT "%5.1" /end CHARACTERISTIC
/begin CHARACTERISTIC MoFEvMngt_stEmCritModBrkgToZr2_C "Critical inverter mode in case the e-braking to zero functionality is active and no errors are present" VALUE 0x8026CCAD Val_Wu8 255.0 OneToOne 0.00 255.0 FORMAT "%5.1" /end CHARACTERISTIC
/begin CHARACTERISTIC MoFEvMngt_stEmCritModEM02_C "Calibration parameter for critical inverter mode for EM02" VALUE 0x8026CCAE Val_Wu8 255.0 OneToOne 0.00 255.0 FORMAT "%5.1" /end CHARACTERISTIC
/begin CHARACTERISTIC MoFEvMngt_stEmModDftBrkgToZr1_C "Safe inverter mode in case there are errors in the e-braking to zero functionality present" VALUE 0x8026CCAF Val_Wu8 255.0 OneToOne 0.00 255.0 FORMAT "%5.1" /end CHARACTERISTIC
/begin CHARACTERISTIC MoFEvMngt_stEmModDftBrkgToZr2_C "Safe inverter mode in case the e-braking to zero functionality is active and no errors are present" VALUE 0x8026CCB0 Val_Wu8 255.0 OneToOne 0.00 255.0 FORMAT "%5.1" /end CHARACTERISTIC
/begin CHARACTERISTIC MoFEvMngt_stEmModDftEm02_C "Safe inverter sate for EM02 when there is high voltage error" VALUE 0x8026CCB1 Val_Wu8 255.0 OneToOne 0.00 255.0 FORMAT "%5.1" /end CHARACTERISTIC
/begin CHARACTERISTIC MoFEvMngt_stEmModDft_C "Application parameter for safe state during error fromTerminal 30c and High voltage interlock status in E-machine" VALUE 0x8026CCB2 Val_Wu8 255.0 OneToOne 0.00 255.0 FORMAT "%5.1" /end CHARACTERISTIC
/begin CHARACTERISTIC MoFEvMngt_stHvbCnctnOpn_C "Calibration for MoFEvMngt_stHvbCnctnOpn" VALUE 0x8026CCB3 Val_Wu8 255.0 OneToOne 0.00 255.0 FORMAT "%5.1" /end CHARACTERISTIC
/begin CHARACTERISTIC MoFEvMngt_stHvbFltLvl1_C "Calibration for HvBatt Fault level4" VALUE 0x8026CC7A Val_Wu8 255.0 OneToOne 0.00 255.0 FORMAT "%5.1" /end CHARACTERISTIC
/begin CHARACTERISTIC MoFEvMngt_stHvbFltLvl2_C "Calibration for HvBatt Fault level5" VALUE 0x8026CC7B Val_Wu8 255.0 OneToOne 0.00 255.0 FORMAT "%5.1" /end CHARACTERISTIC
/begin CHARACTERISTIC MoFEvMngt_stHVIntlckClsd_C "Calibration for closed state ofHigh Voltage Inter lock state" VALUE 0x8026CC8D Val_Wu8 255.0 OneToOne 0.00 255.0 FORMAT "%5.1" /end CHARACTERISTIC
/begin CHARACTERISTIC MoFEvMngt_stHvIntlckOpnEm_C "Application parameter for high voltage inter lock open state enable.This should be calibrated with value 0 for enabling open state" VALUE 0x8026CCB4 Val_Wu8 255.0 OneToOne 0.00 255.0 FORMAT "%5.1" /end CHARACTERISTIC
/begin CHARACTERISTIC MoFEvMngt_stIvtr1IntlckClsd_C "Calibration for closed state of Decentralized interlock state of inverter 1" VALUE 0x8026CC8E Val_Wu8 255.0 OneToOne 0.00 255.0 FORMAT "%5.1" /end CHARACTERISTIC
/begin CHARACTERISTIC MoFEvMngt_stIvtr1IntlckOpnBms_C "Application parameter for decentralized interlock state of inverter1 open state enable.This should be calibrated with value 0 for enabling open state" VALUE 0x8026CC7C Val_Wu8 255.0 OneToOne 0.00 255.0 FORMAT "%5.1" /end CHARACTERISTIC
/begin CHARACTERISTIC MoFEvMngt_stIvtr2IntlckClsd_C "Calibration for closed state of Decentralized interlock state of inverter 2" VALUE 0x8026CC8F Val_Wu8 255.0 OneToOne 0.00 255.0 FORMAT "%5.1" /end CHARACTERISTIC
/begin CHARACTERISTIC MoFEvMngt_stIvtr2IntlckOpnBms_C "Application parameter for decentralized interlock state of inverter2 open state enable.This should be calibrated with value 0 for enabling open state" VALUE 0x8026CC7D Val_Wu8 255.0 OneToOne 0.00 255.0 FORMAT "%5.1" /end CHARACTERISTIC
/begin CHARACTERISTIC MoFEvMngt_stIvtrFltLvl1_C "Calibration for Inverter fault Level4" VALUE 0x8026CC7E Val_Wu8 255.0 OneToOne 0.00 255.0 FORMAT "%5.1" /end CHARACTERISTIC
/begin CHARACTERISTIC MoFEvMngt_stIvtrFltLvl2_C "Calibration for Inverter fault Level5" VALUE 0x8026CC7F Val_Wu8 255.0 OneToOne 0.00 255.0 FORMAT "%5.1" /end CHARACTERISTIC
/begin CHARACTERISTIC MoFEvMngt_stIvtrIntlckErrCfgd_C "Calibration to select Inverter interlock state for DCDC error" VALUE 0x8026CC90 Val_Wu8 255.0 OneToOne 0.00 255.0 FORMAT "%5.1" /end CHARACTERISTIC
/begin CHARACTERISTIC MoFEvMngt_stIvtrIntlckOpnBms_C "Calibration for MoFEvMngt_stIvtrIntlckOpnBms" VALUE 0x8026CC80 Val_Wu8 255.0 OneToOne 0.00 255.0 FORMAT "%5.1" /end CHARACTERISTIC
/begin CHARACTERISTIC MoFEvMngt_stSetOperModBms_C "Calibration for MoFEvMngt_stSetOperModBms" VALUE 0x8026CC81 Val_Wu8 255.0 OneToOne 0.00 255.0 FORMAT "%5.1" /end CHARACTERISTIC
/begin CHARACTERISTIC MoFEvMngt_stSwtCfgFltCfm_C "Calibration to enable configuration for confirm faults" VALUE 0x8026CC82 Val_Wu8 255.0 OneToOne 0.00 255.0 FORMAT "%5.1" /end CHARACTERISTIC
/begin CHARACTERISTIC MoFEvMngt_stT30cErrBms_C "Application parameter for error state enable.This should be calibrated with value 3 for enabling error state" VALUE 0x8026CC83 Val_Wu8 255.0 OneToOne 0.00 255.0 FORMAT "%5.1" /end CHARACTERISTIC
/begin CHARACTERISTIC MoFEvMngt_stT30cErrEm_C "Application parameter for error state enable.This should be calibrated with value 3 for enabling error state" VALUE 0x8026CCB5 Val_Wu8 255.0 OneToOne 0.00 255.0 FORMAT "%5.1" /end CHARACTERISTIC
/begin CHARACTERISTIC MoFEvMngt_stT30cErr_C "Calibration to disable DCDC mode request consideration in function monitoring when T30c state is error" VALUE 0x8026CC91 Val_Wu8 255.0 OneToOne 0.00 255.0 FORMAT "%5.1" /end CHARACTERISTIC
/begin CHARACTERISTIC MoFEvMngt_stT30cInitBms_C "Application parameter for init state enable.This should be calibrated with value 2 for enabling init state" VALUE 0x8026CC84 Val_Wu8 255.0 OneToOne 0.00 255.0 FORMAT "%5.1" /end CHARACTERISTIC
/begin CHARACTERISTIC MoFEvMngt_stT30cInitEm_C "Application parameter for init state enable.This should be calibrated with value 2 for enabling init state" VALUE 0x8026CCB6 Val_Wu8 255.0 OneToOne 0.00 255.0 FORMAT "%5.1" /end CHARACTERISTIC
/begin CHARACTERISTIC MoFEvMngt_stT30cInit_C "Calibration to disable DCDC mode request consideration in function monitoring when T30c state is init" VALUE 0x8026CC92 Val_Wu8 255.0 OneToOne 0.00 255.0 FORMAT "%5.1" /end CHARACTERISTIC
/begin CHARACTERISTIC MoFEvMngt_stT30cOpen_C "Calibration to disable DCDC mode request consideration in function monitoring when T30c state is Open" VALUE 0x8026CC93 Val_Wu8 255.0 OneToOne 0.00 255.0 FORMAT "%5.1" /end CHARACTERISTIC
/begin CHARACTERISTIC MoFEvMngt_stT30cOpnBms_C "Application parameter for terminal 30c open state enable.This should be calibrated with value 0 for enabling open state" VALUE 0x8026CC85 Val_Wu8 255.0 OneToOne 0.00 255.0 FORMAT "%5.1" /end CHARACTERISTIC
/begin CHARACTERISTIC MoFEvMngt_stT30cOpnEm_C "Application parameter for terminal 30c open state enable.This should be calibrated with value 0 for enabling open state" VALUE 0x8026CCB7 Val_Wu8 255.0 OneToOne 0.00 255.0 FORMAT "%5.1" /end CHARACTERISTIC
/begin CHARACTERISTIC MoFEvMngt_swtDiEM01_C "Calibration switch to check E- machine 01 present or not." VALUE 0x8026CCB8 Val_Wu8 1.00000000000 B_TRUE 0.00 1.00000000000 FORMAT "%13.11" /end CHARACTERISTIC
/begin CHARACTERISTIC MoFEvMngt_swtDiEM02_C "Calibration switch to check E- machine 02 present or not." VALUE 0x8026CCB9 Val_Wu8 1.00000000000 B_TRUE 0.00 1.00000000000 FORMAT "%13.11" /end CHARACTERISTIC
/begin CHARACTERISTIC MoFEvMngt_swtEnaBrkgToZr_C "Switch to enable the e-braking to zero functionality and monitoring of inverter mode" VALUE 0x8026CCBA Val_Wu8 1.00000000000 B_TRUE 0.00 1.00000000000 FORMAT "%13.11" /end CHARACTERISTIC
/begin CHARACTERISTIC MoFEvMngt_swtGbxWithMeclRvsGearPrsnt_C "Calibration switch to check whether a gear box with mechanical reverse gear is present or not" VALUE 0x8026CCBB Val_Wu8 1.00000000000 B_TRUE 0.00 1.00000000000 FORMAT "%13.11" /end CHARACTERISTIC
/begin CHARACTERISTIC MoFEvMngt_swtSignChgBrkgToZr_C "Calibration switch to change the sign of the EM01 speed when e-braking to zero functionality is enabled" VALUE 0x8026CCBC Val_Wu8 1.00000000000 B_TRUE 0.00 1.00000000000 FORMAT "%13.11" /end CHARACTERISTIC
/begin CHARACTERISTIC MoFEvMngt_swtSignChgEM01_C "Calibration switch to change the sign of the EM01 speed." VALUE 0x8026CCBD Val_Wu8 1.00000000000 B_TRUE 0.00 1.00000000000 FORMAT "%13.11" /end CHARACTERISTIC
/begin CHARACTERISTIC MoFEvMngt_swtSignChgEM02_C "Calibration switch to change the sign of the EM02 speed." VALUE 0x8026CCBE Val_Wu8 1.00000000000 B_TRUE 0.00 1.00000000000 FORMAT "%13.11" /end CHARACTERISTIC
/begin CHARACTERISTIC MoFEvMngt_TBusBarThd02_C "Threshold02 for Bus Bar Temperature" VALUE 0x8026D2D6 Val_Ws16 65535.00 RBPtCel_t_1p0_3 -32768.00 32767.00 FORMAT "%8.2" /end CHARACTERISTIC
/begin CHARACTERISTIC MoFEvMngt_tiNActPhyFlt_C "Filter time for PT1 filter for e-machine speed" VALUE 0x8026D34C Val_Wu16 655.34000000 zk10msxs_uw_b655p36PT1 0.01000000 655.35000000 FORMAT "%12.8" EXTENDED_LIMITS 0.000000152590219 655.35000000 /end CHARACTERISTIC
/begin CHARACTERISTIC MoFEvMngt_uAdcMaxVal_C "Calibration for Max ADC value" VALUE 0x8026D2D8 Val_Wu16 319.9951 spg_q0p00488 0.00 319.9951 FORMAT "%8.4" /end CHARACTERISTIC
/begin CHARACTERISTIC MoFEvMngt_uAdcMinVal_C "Calibration for Min ADC value" VALUE 0x8026D2DA Val_Wu16 319.9951 spg_q0p00488 0.00 319.9951 FORMAT "%8.4" /end CHARACTERISTIC
/begin CHARACTERISTIC MoFEvMngt_uDcdcHvAct_C "" VALUE 0x8026D34E Val_Wu16 65535.00 RBPtCel_u_1p0_1 0.00 65535.00 FORMAT "%8.2" /end CHARACTERISTIC
/begin CHARACTERISTIC MoFEvMngt_uDcLinkThd_C "" VALUE 0x8026D350 Val_Wu16 65535.00 RBPtCel_u_1p0_1 0.00 65535.00 FORMAT "%8.2" /end CHARACTERISTIC
/begin CHARACTERISTIC MoFEvMngt_vVehBrkgToZrThres_C "Vehicle velocity threshold at which the e-braking to zero functionality is deactivated" VALUE 0x8026D352 Val_Wu16 655.3500 Vel 0.00 655.3500 FORMAT "%8.4" /end CHARACTERISTIC
/begin CHARACTERISTIC MoFEvMngt_vVehDcdcThd_C "Vehicle speed threshold for setting the tested flag status of DFC_MoFEvMngtDcdc" VALUE 0x8026D2DE Val_Ws16 655.3500 Vel -327.6800 327.6700 FORMAT "%8.4" /end CHARACTERISTIC
/begin CHARACTERISTIC MoFEvMngt_vVehPrecThd_C "Vehicle speed threshold above which Precharge operation mode is not allowed for DCDC converter" VALUE 0x8026D2E0 Val_Ws16 655.3500 Vel -327.6800 327.6700 FORMAT "%8.4" /end CHARACTERISTIC
/begin CHARACTERISTIC MoFEvMngt_vVehRlsBms_C "Minimum vehicle speed threshold expected to set diagnosis cycle flag(tested status flag)" VALUE 0x8026D2DC Val_Ws16 655.3500 Vel -327.6800 327.6700 FORMAT "%8.4" /end CHARACTERISTIC
/begin CHARACTERISTIC MoFEvMngt_vVehRlsEm_C "Minimum vehicle speed threshold expected to set diagnosis cycle flag(tested status flag)" VALUE 0x8026D354 Val_Ws16 655.3500 Vel -327.6800 327.6700 FORMAT "%8.4" /end CHARACTERISTIC
/begin CHARACTERISTIC MoFExtCpt_AuxCpt_DataDebErrReactn_I.cntErrDebMax_C "Error handling class instance to debounce error and handle error reaction / Calibratable debounce count for class DataDeb with error reaction." VALUE 0x80270070 Val_Wu16 65535.00 OneToOne 0.00 65535.00 FORMAT "%8.2" /end CHARACTERISTIC
/begin CHARACTERISTIC MoFExtCpt_AuxCpt_DataDebErrReactn_I.stCfgErrHndlg_C "Error handling class instance to debounce error and handle error reaction / Calibratable error handling configuration class DataDeb with error reaction." VALUE 0x80270072 Val_Wu8 255.0 OneToOne 0.00 255.0 FORMAT "%5.1" /end CHARACTERISTIC
/begin CHARACTERISTIC MoFExtCpt_AuxCpt_DataDebErrReactn_I.stCfgErrReactn_C "Error handling class instance to debounce error and handle error reaction / Calibratable parameter for error reaction class DataDeb with error reaction." VALUE 0x80270073 Val_Wu8 255.0 OneToOne 0.00 255.0 FORMAT "%5.1" /end CHARACTERISTIC
/begin CHARACTERISTIC MoFExtCpt_cntrTurnOffMaxAuxCpt_C "Maximum Debounce counter threshold for power supply error when it transits True to False" VALUE 0x8026CCC0 Val_Wu8 255.0 OneToOne 0.00 255.0 FORMAT "%5.1" /end CHARACTERISTIC
/begin CHARACTERISTIC MoFExtCpt_cntrTurnOnMaxAuxCpt_C "Maximum Debounce counter threshold for power supply error when it transits False to True" VALUE 0x8026CCC1 Val_Wu8 255.0 OneToOne 0.00 255.0 FORMAT "%5.1" /end CHARACTERISTIC
/begin CHARACTERISTIC MoFExtCpt_stDcdcErrAuxCpt_C "Value or bit position representing DCDC error state in Battery sensor error information" VALUE 0x8026D11C Val_Wu32 4294967295.00 OneToOne 0.00 4294967295.00 FORMAT "%13.2" /end CHARACTERISTIC
/begin CHARACTERISTIC MoFExtCpt_stErrLvPwrSplyLvl1AuxCpt_C "Value or bit position representing power supply error from function level(MoFIn_stErrLvPwrSply)." VALUE 0x8026CCC2 Val_Wu8 1.000 OneToOne 0.00 1.000 FORMAT "%5.3" EXTENDED_LIMITS 0.00 255.0 /end CHARACTERISTIC
/begin CHARACTERISTIC MoFExtCpt_stSafePredAuxCpt_C "Safe predicted value for Battery sensor error information" VALUE 0x8026CCC3 Val_Wu8 255.0 OneToOne 0.00 255.0 FORMAT "%5.1" /end CHARACTERISTIC
/begin CHARACTERISTIC MoFExtCpt_stSofAsilRawInvld_C "Invalid logical value of remaining battery voltage in function monitoring" VALUE 0x8026D356 Val_Wu16 65535.00 OneToOne 0.00 65535.00 FORMAT "%8.2" /end CHARACTERISTIC
/begin CHARACTERISTIC MoFExtCpt_stSofUErrAuxCpt_C "Threshold value of Battery sensor error information considered as valid." VALUE 0x8026CCC4 Val_Wu8 255.0 OneToOne 0.00 255.0 FORMAT "%5.1" /end CHARACTERISTIC
/begin CHARACTERISTIC MoFExtCpt_uBattSofAsilMinRmnAuxCpt_C "Minimum remaing battery volatge threshold in function monitoring" VALUE 0x8026D358 Val_Wu16 4095.938 spg_q0p0625_V 0.00 4095.938 FORMAT "%8.3" /end CHARACTERISTIC
/begin CHARACTERISTIC MoFExtCpt_uSofAsilErrAuxCpt_T "Curve used to calculate remaining battery voltage in function monitoring." CURVE 0x8026D35A Mo_DataCurveSstU16WU16 4095.938 spg_q0p0625_V 0.00 4095.938 FORMAT "%8.3"
 /begin AXIS_DESCR STD_AXIS MoFFrm_stSofErr OneToOne 13 0.00 255.0000 FORMAT "%8.4" EXTENDED_LIMITS 0.00 65535.00 DEPOSIT ABSOLUTE /end AXIS_DESCR
/end CHARACTERISTIC
/begin CHARACTERISTIC MoFExtCpt_vVehMinErrLvPwrSplyAuxCpt_C "Maximum vehicle speed allowed when DCDC error state is set or Battery voltage value too less or Battery voltage value is invalid" VALUE 0x8026D390 Val_Ws16 655.3500 Vel -327.6800 327.6700 FORMAT "%8.4" /end CHARACTERISTIC
/begin CHARACTERISTIC MoFExtCpt_vVehSigndRlsAuxCpt_C "Minimum vehicle speed threshold expected to set diagnosis cycle flag(tested status flag)" VALUE 0x8026D392 Val_Ws16 655.3500 Vel -327.6800 327.6700 FORMAT "%8.4" /end CHARACTERISTIC
/begin MEASUREMENT DFC_st.DFC_MoFEvMngtBms "" UBYTE DFC_OneToOne 1 100 0.00 255.0 FORMAT "%5.1" ECU_ADDRESS 0x60034D48 /end MEASUREMENT
/begin MEASUREMENT DFC_st.DFC_MoFEvMngtDcdc "" UBYTE DFC_OneToOne 1 100 0.00 255.0 FORMAT "%5.1" ECU_ADDRESS 0x60034D49 /end MEASUREMENT
/begin MEASUREMENT DFC_st.DFC_MoFEvMngtEm01 "" UBYTE DFC_OneToOne 1 100 0.00 255.0 FORMAT "%5.1" ECU_ADDRESS 0x60034D4A /end MEASUREMENT
/begin MEASUREMENT DFC_st.DFC_MoFEvMngtEm01BrkgToZr "" UBYTE DFC_OneToOne 1 100 0.00 255.0 FORMAT "%5.1" ECU_ADDRESS 0x60034D4B /end MEASUREMENT
/begin MEASUREMENT DFC_st.DFC_MoFEvMngtEm01EngSpd "" UBYTE DFC_OneToOne 1 100 0.00 255.0 FORMAT "%5.1" ECU_ADDRESS 0x60034D4C /end MEASUREMENT
/begin MEASUREMENT DFC_st.DFC_MoFEvMngtEm02EngSpd "" UBYTE DFC_OneToOne 1 100 0.00 255.0 FORMAT "%5.1" ECU_ADDRESS 0x60034D4D /end MEASUREMENT
/begin MEASUREMENT DFC_st.DFC_MoFEvMngtEm02Lvl1 "" UBYTE DFC_OneToOne 1 100 0.00 255.0 FORMAT "%5.1" ECU_ADDRESS 0x60034D4E /end MEASUREMENT
/begin MEASUREMENT DFC_st.DFC_MoFEvMngtEm02Lvl2 "" UBYTE DFC_OneToOne 1 100 0.00 255.0 FORMAT "%5.1" ECU_ADDRESS 0x60034D4F /end MEASUREMENT
/begin MEASUREMENT DFC_st.DFC_MoFExtCptAuxCpt "" UBYTE DFC_OneToOne 1 100 0.00 255.0 FORMAT "%5.1" ECU_ADDRESS 0x60034D50 /end MEASUREMENT
/begin MEASUREMENT MoFEvMngtBms_bbLoc1Cpl "Complement of MoFEvMngtBms_bbLoc1" UBYTE OneToOne 1 100 0.00 255.0 FORMAT "%5.1" ECU_ADDRESS 0x6002BF91
 /begin IF_DATA XCPplus 0x0102
  /begin DAQ_EVENT VARIABLE /end DAQ_EVENT
 /end IF_DATA
/end MEASUREMENT
/begin MEASUREMENT MoFEvMngtBms_bbLocCpl "complement of local bit word of MoFEvMngt_Bms" UBYTE OneToOne 1 100 0.00 255.0 FORMAT "%5.1" ECU_ADDRESS 0x6002BF90
 /begin IF_DATA XCPplus 0x0102
  /begin DAQ_EVENT VARIABLE /end DAQ_EVENT
 /end IF_DATA
/end MEASUREMENT
/begin MEASUREMENT MoFEvMngtBms_bbOutFltCfm "Export variable containing confirm faults bit mapped" UBYTE OneToOne 1 100 0.00 255.0 FORMAT "%5.1" ECU_ADDRESS 0x6002C9D8
 /begin IF_DATA XCPplus 0x0102
  /begin DAQ_EVENT VARIABLE /end DAQ_EVENT
 /end IF_DATA
/end MEASUREMENT
/begin MEASUREMENT MoFEvMngtBms_bbOutFltCfmCpl "Complement of MoFEvMngtBms_bbOutFltCfm" UBYTE OneToOne 1 100 0.00 255.0 FORMAT "%5.1" ECU_ADDRESS 0x6002BF8F
 /begin IF_DATA XCPplus 0x0102
  /begin DAQ_EVENT VARIABLE /end DAQ_EVENT
 /end IF_DATA
/end MEASUREMENT
/begin MEASUREMENT MoFEvMngtBms_bbOutFltLvl "Ouport Fault level values" UBYTE OneToOne 1 100 0.00 255.0 FORMAT "%5.1" ECU_ADDRESS 0x6002C9D7
 /begin IF_DATA XCPplus 0x0102
  /begin DAQ_EVENT VARIABLE /end DAQ_EVENT
 /end IF_DATA
/end MEASUREMENT
/begin MEASUREMENT MoFEvMngtBms_bbOutFltLvlCpl "Complement of MoFEvMngtBms_bbOutFltLvl" UBYTE OneToOne 1 100 0.00 255.0 FORMAT "%5.1" ECU_ADDRESS 0x6002BF8E
 /begin IF_DATA XCPplus 0x0102
  /begin DAQ_EVENT VARIABLE /end DAQ_EVENT
 /end IF_DATA
/end MEASUREMENT
/begin MEASUREMENT MoFEvMngtDcdc_bbLocCpl "Complement of local bit basis for MoFEvMngt_Dcdc" UBYTE OneToOne 1 100 0.00 255.0 FORMAT "%5.1" ECU_ADDRESS 0x6002BF75
 /begin IF_DATA XCPplus 0x0102
  /begin DAQ_EVENT VARIABLE /end DAQ_EVENT
 /end IF_DATA
/end MEASUREMENT
/begin MEASUREMENT MoFEvMngtDcdc_bbOutCpl "RAM data redundancy for MoFEvMngtDcdc_bbOut" UBYTE OneToOne 1 100 0.00 255.0 FORMAT "%5.1" ECU_ADDRESS 0x6002BF74
 /begin IF_DATA XCPplus 0x0102
  /begin DAQ_EVENT VARIABLE /end DAQ_EVENT
 /end IF_DATA
/end MEASUREMENT
/begin MEASUREMENT MoFEvMngtEm_bbLoc1Cpl "complement of local bit word of MoFEvMngt_Em" UBYTE OneToOne 1 100 0.00 255.0 FORMAT "%5.1" ECU_ADDRESS 0x6002BF6A
 /begin IF_DATA XCPplus 0x0102
  /begin DAQ_EVENT VARIABLE /end DAQ_EVENT
 /end IF_DATA
/end MEASUREMENT
/begin MEASUREMENT MoFEvMngtEm_bbLoc2Cpl "RAM data redudancy for MoFEvMngtEm_bbLoc2" UBYTE OneToOne 1 100 0.00 255.0 FORMAT "%5.1" ECU_ADDRESS 0x6002BF69
 /begin IF_DATA XCPplus 0x0102
  /begin DAQ_EVENT VARIABLE /end DAQ_EVENT
 /end IF_DATA
/end MEASUREMENT
/begin MEASUREMENT MoFEvMngtEm_bbLoc3Cpl "RAM data redudancy for MoFEvMngtEm_bbLoc3" UBYTE OneToOne 1 100 0.00 255.0 FORMAT "%5.1" ECU_ADDRESS 0x6002BF68
 /begin IF_DATA XCPplus 0x0102
  /begin DAQ_EVENT VARIABLE /end DAQ_EVENT
 /end IF_DATA
/end MEASUREMENT
/begin MEASUREMENT MoFEvMngtEm_bbLoc4Cpl "Complement of MoFEvMngtEm_bbLoc4" UBYTE OneToOne 1 100 0.00 255.0 FORMAT "%5.1" ECU_ADDRESS 0x6002BF67
 /begin IF_DATA XCPplus 0x0102
  /begin DAQ_EVENT VARIABLE /end DAQ_EVENT
 /end IF_DATA
/end MEASUREMENT
/begin MEASUREMENT MoFEvMngtEm_bbOut1Cpl "Complement of MoFEvMngtEm_bbOut1" UBYTE OneToOne 1 100 0.00 255.0 FORMAT "%5.1" ECU_ADDRESS 0x6002BF66
 /begin IF_DATA XCPplus 0x0102
  /begin DAQ_EVENT VARIABLE /end DAQ_EVENT
 /end IF_DATA
/end MEASUREMENT
/begin MEASUREMENT MoFEvMngtEm_bbOutFltCfm "Exported variable containg Em faults bit mapped." UBYTE OneToOne 1 100 0.00 255.0 FORMAT "%5.1" ECU_ADDRESS 0x6002C9A1
 /begin IF_DATA XCPplus 0x0102
  /begin DAQ_EVENT VARIABLE /end DAQ_EVENT
 /end IF_DATA
/end MEASUREMENT
/begin MEASUREMENT MoFEvMngtEm_bbOutFltCfmCpl "Complement of MoFEvMngtEm_bbOutFltCfm" UBYTE OneToOne 1 100 0.00 255.0 FORMAT "%5.1" ECU_ADDRESS 0x6002BF65
 /begin IF_DATA XCPplus 0x0102
  /begin DAQ_EVENT VARIABLE /end DAQ_EVENT
 /end IF_DATA
/end MEASUREMENT
/begin MEASUREMENT MoFEvMngt_Bms_DataDebErrReactn_I.cntErrDeb "Error handling class instance to debounce error and handle error reaction / Debounce count in class DataDeb with error reaction." UWORD OneToOne 1 100 0.00 65535.00 FORMAT "%8.2" ECU_ADDRESS 0x6002C9CC /end MEASUREMENT
/begin MEASUREMENT MoFEvMngt_Bms_DataDebErrReactn_I.cntErrDebCpl "Error handling class instance to debounce error and handle error reaction / Complement for debounce count for class DataDeb with error reaction." UWORD OneToOne 1 100 0.00 65535.00 FORMAT "%8.2" ECU_ADDRESS 0x6002BF76 /end MEASUREMENT
/begin MEASUREMENT MoFEvMngt_Bms_DataDebErrReactn_I.stErrDeb "Error handling class instance to debounce error and handle error reaction / Status of debounced error in class DataDeb with error reaction." UBYTE OneToOne 1 100 0.00 255.0 FORMAT "%5.1" ECU_ADDRESS 0x6002C9CE /end MEASUREMENT
/begin MEASUREMENT MoFEvMngt_Bms_DataDebErrReactn_I.stErrDebCpl "Error handling class instance to debounce error and handle error reaction / Complement for status of debounced error in class DataDeb with error reaction." UBYTE OneToOne 1 100 0.00 255.0 FORMAT "%5.1" ECU_ADDRESS 0x6002BF78 /end MEASUREMENT
/begin MEASUREMENT MoFEvMngt_Bms_DataDebErrReactn_I.stErrLockRels "Error handling class instance to debounce error and handle error reaction / Status of lock release class DataDeb with error reaction." UBYTE OneToOne 1 100 0.00 255.0 FORMAT "%5.1" ECU_ADDRESS 0x6002C9CF /end MEASUREMENT
/begin MEASUREMENT MoFEvMngt_Bms_DataDebErrReactn_I.stErrLockRelsCpl "Error handling class instance to debounce error and handle error reaction / Complement for Status of lock release class DataDeb with error reaction." UBYTE OneToOne 1 100 0.00 255.0 FORMAT "%5.1" ECU_ADDRESS 0x6002BF79 /end MEASUREMENT
/begin MEASUREMENT MoFEvMngt_Bms_DataDebErrReactn_I.stErrReactn "Error handling class instance to debounce error and handle error reaction / Status of error reaction in class DataDeb with error reaction." UBYTE OneToOne 1 100 0.00 255.0 FORMAT "%5.1" ECU_ADDRESS 0x6002C9D0 /end MEASUREMENT
/begin MEASUREMENT MoFEvMngt_cntrDcdcDiagDeb "Debounce Counter for setting the tested flag in DCDC diagnosis" UBYTE OneToOne 1 100 0.00 255.0 FORMAT "%5.1" ECU_ADDRESS 0x60023125
 /begin IF_DATA XCPplus 0x0102
  /begin DAQ_EVENT VARIABLE /end DAQ_EVENT
 /end IF_DATA
/end MEASUREMENT
/begin MEASUREMENT MoFEvMngt_cntrDcdcErrDeb "Debounce counter for Dcdc mode error" UBYTE OneToOne 1 100 0.00 255.0 FORMAT "%5.1" ECU_ADDRESS 0x6002C9CA
 /begin IF_DATA XCPplus 0x0102
  /begin DAQ_EVENT VARIABLE /end DAQ_EVENT
 /end IF_DATA
/end MEASUREMENT
/begin MEASUREMENT MoFEvMngt_cntrDcdcErrDebCpl "Complement of MoFEvMngt_cntrDcdcErrDeb" UBYTE OneToOne 1 100 0.00 255.0 FORMAT "%5.1" ECU_ADDRESS 0x6002BF73
 /begin IF_DATA XCPplus 0x0102
  /begin DAQ_EVENT VARIABLE /end DAQ_EVENT
 /end IF_DATA
/end MEASUREMENT
/begin MEASUREMENT MoFEvMngt_cntrDesEem "Counter MoFEvMngt_cntrDesEem" UBYTE OneToOne 1 100 0.00 255.0 FORMAT "%5.1" ECU_ADDRESS 0x6002C9BA
 /begin IF_DATA XCPplus 0x0102
  /begin DAQ_EVENT VARIABLE /end DAQ_EVENT
 /end IF_DATA
/end MEASUREMENT
/begin MEASUREMENT MoFEvMngt_cntrDesEemCpl "Complement for MoFEvMngt_cntrDesEem" UBYTE OneToOne 1 100 0.00 255.0 FORMAT "%5.1" ECU_ADDRESS 0x6002BF64
 /begin IF_DATA XCPplus 0x0102
  /begin DAQ_EVENT VARIABLE /end DAQ_EVENT
 /end IF_DATA
/end MEASUREMENT
/begin MEASUREMENT MoFEvMngt_cntrDiagDebBms "Debounce counter for condition tested status (cycle flag) for diagnosis in function MoFEvMngt_Bms of function monitoring" UBYTE OneToOne 1 100 0.00 255.0 FORMAT "%5.1" ECU_ADDRESS 0x60023126
 /begin IF_DATA XCPplus 0x0102
  /begin DAQ_EVENT VARIABLE /end DAQ_EVENT
 /end IF_DATA
/end MEASUREMENT
/begin MEASUREMENT MoFEvMngt_cntrDiagDebEm01 "Counter for setting the test status flag in diagnosis E-machine 01" UWORD OneToOne 1 100 0.00 65535.00 FORMAT "%8.2" ECU_ADDRESS 0x6001F40E
 /begin IF_DATA XCPplus 0x0102
  /begin DAQ_EVENT VARIABLE /end DAQ_EVENT
 /end IF_DATA
/end MEASUREMENT
/begin MEASUREMENT MoFEvMngt_cntrDiagDebEm01BrkgToZr "Counter for setting the test status flag in e-braking to zero diagnosis E-machine 01" UWORD OneToOne 1 100 0.00 65535.00 FORMAT "%8.2" ECU_ADDRESS 0x6001F40C
 /begin IF_DATA XCPplus 0x0102
  /begin DAQ_EVENT VARIABLE /end DAQ_EVENT
 /end IF_DATA
/end MEASUREMENT
/begin MEASUREMENT MoFEvMngt_cntrDiagDebEm01EngSpd "Counter for setting the test status flag in engine speed diagnosis E-machine 01" UBYTE OneToOne 1 100 0.00 255.0 FORMAT "%5.1" ECU_ADDRESS 0x60023124
 /begin IF_DATA XCPplus 0x0102
  /begin DAQ_EVENT VARIABLE /end DAQ_EVENT
 /end IF_DATA
/end MEASUREMENT
/begin MEASUREMENT MoFEvMngt_cntrDiagDebEm02EngSpd "Counter for setting the test status flag in engine speed diagnosis E-machine 02" UBYTE OneToOne 1 100 0.00 255.0 FORMAT "%5.1" ECU_ADDRESS 0x60023123
 /begin IF_DATA XCPplus 0x0102
  /begin DAQ_EVENT VARIABLE /end DAQ_EVENT
 /end IF_DATA
/end MEASUREMENT
/begin MEASUREMENT MoFEvMngt_cntrDiagDebEm02Lvl1 "Counter for setting the test status flag in diagnosis E-machine 02 when level 1 desired inverter state not equal to level 2 desired inverter state after evaluating high voltage errors" UWORD OneToOne 1 100 0.00 65535.00 FORMAT "%8.2" ECU_ADDRESS 0x6001F40A
 /begin IF_DATA XCPplus 0x0102
  /begin DAQ_EVENT VARIABLE /end DAQ_EVENT
 /end IF_DATA
/end MEASUREMENT
/begin MEASUREMENT MoFEvMngt_cntrDiagDebEm02Lvl2 "Counter for setting the test status flag in diagnosis E-machine 02 when level 2 desired inverter state not equal to level 2 desired inverter state after evaluating high voltage errors" UWORD OneToOne 1 100 0.00 65535.00 FORMAT "%8.2" ECU_ADDRESS 0x6001F408
 /begin IF_DATA XCPplus 0x0102
  /begin DAQ_EVENT VARIABLE /end DAQ_EVENT
 /end IF_DATA
/end MEASUREMENT
/begin MEASUREMENT MoFEvMngt_cntrEm01 "Debounce counter for inverter in mode-1 when it transits True to False and vice versa" UBYTE OneToOne 1 100 0.00 255.0 FORMAT "%5.1" ECU_ADDRESS 0x6002C9B9
 /begin IF_DATA XCPplus 0x0102
  /begin DAQ_EVENT VARIABLE /end DAQ_EVENT
 /end IF_DATA
/end MEASUREMENT
/begin MEASUREMENT MoFEvMngt_cntrEm01BrkgToZr1 "Debounce counter for inverter in mode-1 when it transits True to False and vice versa for e-braking to zero functionality (errors present)" UBYTE OneToOne 1 100 0.00 255.0 FORMAT "%5.1" ECU_ADDRESS 0x6002C9B8
 /begin IF_DATA XCPplus 0x0102
  /begin DAQ_EVENT VARIABLE /end DAQ_EVENT
 /end IF_DATA
/end MEASUREMENT
/begin MEASUREMENT MoFEvMngt_cntrEm01BrkgToZr1Cpl "Complement of MoFEvMngt_cntrEm01BrkgToZr1" UBYTE OneToOne 1 100 0.00 255.0 FORMAT "%5.1" ECU_ADDRESS 0x6002BF63
 /begin IF_DATA XCPplus 0x0102
  /begin DAQ_EVENT VARIABLE /end DAQ_EVENT
 /end IF_DATA
/end MEASUREMENT
/begin MEASUREMENT MoFEvMngt_cntrEm01BrkgToZr2 "Debounce counter for inverter in mode-1 when it transits True to False and vice versa for e-braking to zero functionality (active and no errors present)" UBYTE OneToOne 1 100 0.00 255.0 FORMAT "%5.1" ECU_ADDRESS 0x6002C9B7
 /begin IF_DATA XCPplus 0x0102
  /begin DAQ_EVENT VARIABLE /end DAQ_EVENT
 /end IF_DATA
/end MEASUREMENT
/begin MEASUREMENT MoFEvMngt_cntrEm01BrkgToZr2Cpl "Complement of MoFEvMngt_cntrEm01BrkgToZr2" UBYTE OneToOne 1 100 0.00 255.0 FORMAT "%5.1" ECU_ADDRESS 0x6002BF62
 /begin IF_DATA XCPplus 0x0102
  /begin DAQ_EVENT VARIABLE /end DAQ_EVENT
 /end IF_DATA
/end MEASUREMENT
/begin MEASUREMENT MoFEvMngt_cntrEm01Cpl "RAM data redundancy for MoFEvMngt_cntrEm01" UBYTE OneToOne 1 100 0.00 255.0 FORMAT "%5.1" ECU_ADDRESS 0x6002BF61
 /begin IF_DATA XCPplus 0x0102
  /begin DAQ_EVENT VARIABLE /end DAQ_EVENT
 /end IF_DATA
/end MEASUREMENT
/begin MEASUREMENT MoFEvMngt_cntrEm02 "Debounce counter for inverter in mode-2 when it transits True to False and vice versa" UBYTE OneToOne 1 100 0.00 255.0 FORMAT "%5.1" ECU_ADDRESS 0x6002C9B6
 /begin IF_DATA XCPplus 0x0102
  /begin DAQ_EVENT VARIABLE /end DAQ_EVENT
 /end IF_DATA
/end MEASUREMENT
/begin MEASUREMENT MoFEvMngt_cntrEm02Cpl "RAM data redundancy for MoFEvMngt_cntrEm02" UBYTE OneToOne 1 100 0.00 255.0 FORMAT "%5.1" ECU_ADDRESS 0x6002BF60
 /begin IF_DATA XCPplus 0x0102
  /begin DAQ_EVENT VARIABLE /end DAQ_EVENT
 /end IF_DATA
/end MEASUREMENT
/begin MEASUREMENT MoFEvMngt_cntrEm02SafeInvtr "Debounce counter for safe inverter in mode-2 when it transits True to False and vice versa" UBYTE OneToOne 1 100 0.00 255.0 FORMAT "%5.1" ECU_ADDRESS 0x6002C9B5
 /begin IF_DATA XCPplus 0x0102
  /begin DAQ_EVENT VARIABLE /end DAQ_EVENT
 /end IF_DATA
/end MEASUREMENT
/begin MEASUREMENT MoFEvMngt_cntrEm02SafeInvtrCpl "Complement of MoFEvMngt_cntrEm02SafeInvtr" UBYTE OneToOne 1 100 0.00 255.0 FORMAT "%5.1" ECU_ADDRESS 0x6002BF5F
 /begin IF_DATA XCPplus 0x0102
  /begin DAQ_EVENT VARIABLE /end DAQ_EVENT
 /end IF_DATA
/end MEASUREMENT
/begin MEASUREMENT MoFEvMngt_cntrOpnBms "Debounce counter for HV Battery mode when it transits True to False and vice versa" UBYTE OneToOne 1 100 0.00 255.0 FORMAT "%5.1" ECU_ADDRESS 0x6002C9E7
 /begin IF_DATA XCPplus 0x0102
  /begin DAQ_EVENT VARIABLE /end DAQ_EVENT
 /end IF_DATA
/end MEASUREMENT
/begin MEASUREMENT MoFEvMngt_cntrOpnBms1 "Open Counter variable for debounce block1" UBYTE OneToOne 1 100 0.00 255.0 FORMAT "%5.1" ECU_ADDRESS 0x6002C9E6
 /begin IF_DATA XCPplus 0x0102
  /begin DAQ_EVENT VARIABLE /end DAQ_EVENT
 /end IF_DATA
/end MEASUREMENT
/begin MEASUREMENT MoFEvMngt_cntrOpnBms1Cpl "Complement of MoFEvMngt_cntrOpnBms1" UBYTE OneToOne 1 100 0.00 255.0 FORMAT "%5.1" ECU_ADDRESS 0x6002BF8D
 /begin IF_DATA XCPplus 0x0102
  /begin DAQ_EVENT VARIABLE /end DAQ_EVENT
 /end IF_DATA
/end MEASUREMENT
/begin MEASUREMENT MoFEvMngt_cntrOpnBms2 "Open Counter variable for debounce block2" UBYTE OneToOne 1 100 0.00 255.0 FORMAT "%5.1" ECU_ADDRESS 0x6002C9E5
 /begin IF_DATA XCPplus 0x0102
  /begin DAQ_EVENT VARIABLE /end DAQ_EVENT
 /end IF_DATA
/end MEASUREMENT
/begin MEASUREMENT MoFEvMngt_cntrOpnBms2Cpl "Complement of MoFEvMngt_cntrOpnBms2" UBYTE OneToOne 1 100 0.00 255.0 FORMAT "%5.1" ECU_ADDRESS 0x6002BF8C
 /begin IF_DATA XCPplus 0x0102
  /begin DAQ_EVENT VARIABLE /end DAQ_EVENT
 /end IF_DATA
/end MEASUREMENT
/begin MEASUREMENT MoFEvMngt_cntrOpnBms3 "Open Counter variable for debounce block3" UBYTE OneToOne 1 100 0.00 255.0 FORMAT "%5.1" ECU_ADDRESS 0x6002C9E4
 /begin IF_DATA XCPplus 0x0102
  /begin DAQ_EVENT VARIABLE /end DAQ_EVENT
 /end IF_DATA
/end MEASUREMENT
/begin MEASUREMENT MoFEvMngt_cntrOpnBms3Cpl "Complement of MoFEvMngt_cntrOpnBms3" UBYTE OneToOne 1 100 0.00 255.0 FORMAT "%5.1" ECU_ADDRESS 0x6002BF8B
 /begin IF_DATA XCPplus 0x0102
  /begin DAQ_EVENT VARIABLE /end DAQ_EVENT
 /end IF_DATA
/end MEASUREMENT
/begin MEASUREMENT MoFEvMngt_cntrOpnBmsCpl "RAM data redundancy for MoFEvMngt_cntrOpnBms" UBYTE OneToOne 1 100 0.00 255.0 FORMAT "%5.1" ECU_ADDRESS 0x6002BF8A
 /begin IF_DATA XCPplus 0x0102
  /begin DAQ_EVENT VARIABLE /end DAQ_EVENT
 /end IF_DATA
/end MEASUREMENT
/begin MEASUREMENT MoFEvMngt_cntrOpnFltBms1 "Open Counter debounce variable for HvBatt" UBYTE OneToOne 1 100 0.00 255.0 FORMAT "%5.1" ECU_ADDRESS 0x6002C9E3
 /begin IF_DATA XCPplus 0x0102
  /begin DAQ_EVENT VARIABLE /end DAQ_EVENT
 /end IF_DATA
/end MEASUREMENT
/begin MEASUREMENT MoFEvMngt_cntrOpnFltBms1Cpl "Complement for MoFEvMngt_cntrOpnFltBms1" UBYTE OneToOne 1 100 0.00 255.0 FORMAT "%5.1" ECU_ADDRESS 0x6002BF89
 /begin IF_DATA XCPplus 0x0102
  /begin DAQ_EVENT VARIABLE /end DAQ_EVENT
 /end IF_DATA
/end MEASUREMENT
/begin MEASUREMENT MoFEvMngt_cntrOpnFltBms2 "Open Counter debounce variable for Inverter" UBYTE OneToOne 1 100 0.00 255.0 FORMAT "%5.1" ECU_ADDRESS 0x6002C9E2
 /begin IF_DATA XCPplus 0x0102
  /begin DAQ_EVENT VARIABLE /end DAQ_EVENT
 /end IF_DATA
/end MEASUREMENT
/begin MEASUREMENT MoFEvMngt_cntrOpnFltBms2Cpl "Complement for MoFEvMngt_cntrOpnFltBms2" UBYTE OneToOne 1 100 0.00 255.0 FORMAT "%5.1" ECU_ADDRESS 0x6002BF88
 /begin IF_DATA XCPplus 0x0102
  /begin DAQ_EVENT VARIABLE /end DAQ_EVENT
 /end IF_DATA
/end MEASUREMENT
/begin MEASUREMENT MoFEvMngt_cntrOpnFltBms3 "Open Counter debounce variable for DCDC" UBYTE OneToOne 1 100 0.00 255.0 FORMAT "%5.1" ECU_ADDRESS 0x6002C9E1
 /begin IF_DATA XCPplus 0x0102
  /begin DAQ_EVENT VARIABLE /end DAQ_EVENT
 /end IF_DATA
/end MEASUREMENT
/begin MEASUREMENT MoFEvMngt_cntrOpnFltBms3Cpl "Complement for MoFEvMngt_cntrOpnFltBms3" UBYTE OneToOne 1 100 0.00 255.0 FORMAT "%5.1" ECU_ADDRESS 0x6002BF87
 /begin IF_DATA XCPplus 0x0102
  /begin DAQ_EVENT VARIABLE /end DAQ_EVENT
 /end IF_DATA
/end MEASUREMENT
/begin MEASUREMENT MoFEvMngt_Dcdc_DataDebErrReactn_I.cntErrDeb "Class instance for DCDC error handling / Debounce count in class DataDeb with error reaction." UWORD OneToOne 1 100 0.00 65535.00 FORMAT "%8.2" ECU_ADDRESS 0x6002C9C0 /end MEASUREMENT
/begin MEASUREMENT MoFEvMngt_Dcdc_DataDebErrReactn_I.cntErrDebCpl "Class instance for DCDC error handling / Complement for debounce count for class DataDeb with error reaction." UWORD OneToOne 1 100 0.00 65535.00 FORMAT "%8.2" ECU_ADDRESS 0x6002BF6C /end MEASUREMENT
/begin MEASUREMENT MoFEvMngt_Dcdc_DataDebErrReactn_I.stErrDeb "Class instance for DCDC error handling / Status of debounced error in class DataDeb with error reaction." UBYTE OneToOne 1 100 0.00 255.0 FORMAT "%5.1" ECU_ADDRESS 0x6002C9C2 /end MEASUREMENT
/begin MEASUREMENT MoFEvMngt_Dcdc_DataDebErrReactn_I.stErrDebCpl "Class instance for DCDC error handling / Complement for status of debounced error in class DataDeb with error reaction." UBYTE OneToOne 1 100 0.00 255.0 FORMAT "%5.1" ECU_ADDRESS 0x6002BF6E /end MEASUREMENT
/begin MEASUREMENT MoFEvMngt_Dcdc_DataDebErrReactn_I.stErrLockRels "Class instance for DCDC error handling / Status of lock release class DataDeb with error reaction." UBYTE OneToOne 1 100 0.00 255.0 FORMAT "%5.1" ECU_ADDRESS 0x6002C9C3 /end MEASUREMENT
/begin MEASUREMENT MoFEvMngt_Dcdc_DataDebErrReactn_I.stErrLockRelsCpl "Class instance for DCDC error handling / Complement for Status of lock release class DataDeb with error reaction." UBYTE OneToOne 1 100 0.00 255.0 FORMAT "%5.1" ECU_ADDRESS 0x6002BF6F /end MEASUREMENT
/begin MEASUREMENT MoFEvMngt_Dcdc_DataDebErrReactn_I.stErrReactn "Class instance for DCDC error handling / Status of error reaction in class DataDeb with error reaction." UBYTE OneToOne 1 100 0.00 255.0 FORMAT "%5.1" ECU_ADDRESS 0x6002C9C4 /end MEASUREMENT
/begin MEASUREMENT MoFEvMngt_Em01BrkgToZr_DataDebErrReactn_I.cntErrDeb "Error handling class instance to debounce e-braking to zero error and handle error reaction / Debounce count in class DataDeb with error reaction." UWORD OneToOne 1 100 0.00 65535.00 FORMAT "%8.2" ECU_ADDRESS 0x6002C908 /end MEASUREMENT
/begin MEASUREMENT MoFEvMngt_Em01BrkgToZr_DataDebErrReactn_I.cntErrDebCpl "Error handling class instance to debounce e-braking to zero error and handle error reaction / Complement for debounce count for class DataDeb with error reaction." UWORD OneToOne 1 100 0.00 65535.00 FORMAT "%8.2" ECU_ADDRESS 0x6002BEB4 /end MEASUREMENT
/begin MEASUREMENT MoFEvMngt_Em01BrkgToZr_DataDebErrReactn_I.stErrDeb "Error handling class instance to debounce e-braking to zero error and handle error reaction / Status of debounced error in class DataDeb with error reaction." UBYTE OneToOne 1 100 0.00 255.0 FORMAT "%5.1" ECU_ADDRESS 0x6002C90A /end MEASUREMENT
/begin MEASUREMENT MoFEvMngt_Em01BrkgToZr_DataDebErrReactn_I.stErrDebCpl "Error handling class instance to debounce e-braking to zero error and handle error reaction / Complement for status of debounced error in class DataDeb with error reaction." UBYTE OneToOne 1 100 0.00 255.0 FORMAT "%5.1" ECU_ADDRESS 0x6002BEB6 /end MEASUREMENT
/begin MEASUREMENT MoFEvMngt_Em01BrkgToZr_DataDebErrReactn_I.stErrLockRels "Error handling class instance to debounce e-braking to zero error and handle error reaction / Status of lock release class DataDeb with error reaction." UBYTE OneToOne 1 100 0.00 255.0 FORMAT "%5.1" ECU_ADDRESS 0x6002C90B /end MEASUREMENT
/begin MEASUREMENT MoFEvMngt_Em01BrkgToZr_DataDebErrReactn_I.stErrLockRelsCpl "Error handling class instance to debounce e-braking to zero error and handle error reaction / Complement for Status of lock release class DataDeb with error reaction." UBYTE OneToOne 1 100 0.00 255.0 FORMAT "%5.1" ECU_ADDRESS 0x6002BEB7 /end MEASUREMENT
/begin MEASUREMENT MoFEvMngt_Em01BrkgToZr_DataDebErrReactn_I.stErrReactn "Error handling class instance to debounce e-braking to zero error and handle error reaction / Status of error reaction in class DataDeb with error reaction." UBYTE OneToOne 1 100 0.00 255.0 FORMAT "%5.1" ECU_ADDRESS 0x6002C90C /end MEASUREMENT
/begin MEASUREMENT MoFEvMngt_Em01EngSpd_DataErrReactn_I.stErrLockRels "Error handling class instance to handle EM01 engine speed error reaction without debouncing / Status of lock release in class error reaction." UBYTE OneToOne 1 100 0.00 255.0 FORMAT "%5.1" ECU_ADDRESS 0x6002C906 /end MEASUREMENT
/begin MEASUREMENT MoFEvMngt_Em01EngSpd_DataErrReactn_I.stErrLockRelsCpl "Error handling class instance to handle EM01 engine speed error reaction without debouncing / Complement for status of lock release in class error reaction." UBYTE OneToOne 1 100 0.00 255.0 FORMAT "%5.1" ECU_ADDRESS 0x6002BEB2 /end MEASUREMENT
/begin MEASUREMENT MoFEvMngt_Em01EngSpd_DataErrReactn_I.stErrReactn "Error handling class instance to handle EM01 engine speed error reaction without debouncing / Status of error reaction in class error reaction." UBYTE OneToOne 1 100 0.00 255.0 FORMAT "%5.1" ECU_ADDRESS 0x6002C907 /end MEASUREMENT
/begin MEASUREMENT MoFEvMngt_Em01_DataDebErrReactn_I.cntErrDeb "Error handling class instance to debounce error and handle error reaction / Debounce count in class DataDeb with error reaction." UWORD OneToOne 1 100 0.00 65535.00 FORMAT "%8.2" ECU_ADDRESS 0x6002C900 /end MEASUREMENT
/begin MEASUREMENT MoFEvMngt_Em01_DataDebErrReactn_I.cntErrDebCpl "Error handling class instance to debounce error and handle error reaction / Complement for debounce count for class DataDeb with error reaction." UWORD OneToOne 1 100 0.00 65535.00 FORMAT "%8.2" ECU_ADDRESS 0x6002BEAE /end MEASUREMENT
/begin MEASUREMENT MoFEvMngt_Em01_DataDebErrReactn_I.stErrDeb "Error handling class instance to debounce error and handle error reaction / Status of debounced error in class DataDeb with error reaction." UBYTE OneToOne 1 100 0.00 255.0 FORMAT "%5.1" ECU_ADDRESS 0x6002C902 /end MEASUREMENT
/begin MEASUREMENT MoFEvMngt_Em01_DataDebErrReactn_I.stErrDebCpl "Error handling class instance to debounce error and handle error reaction / Complement for status of debounced error in class DataDeb with error reaction." UBYTE OneToOne 1 100 0.00 255.0 FORMAT "%5.1" ECU_ADDRESS 0x6002BEB0 /end MEASUREMENT
/begin MEASUREMENT MoFEvMngt_Em01_DataDebErrReactn_I.stErrLockRels "Error handling class instance to debounce error and handle error reaction / Status of lock release class DataDeb with error reaction." UBYTE OneToOne 1 100 0.00 255.0 FORMAT "%5.1" ECU_ADDRESS 0x6002C903 /end MEASUREMENT
/begin MEASUREMENT MoFEvMngt_Em01_DataDebErrReactn_I.stErrLockRelsCpl "Error handling class instance to debounce error and handle error reaction / Complement for Status of lock release class DataDeb with error reaction." UBYTE OneToOne 1 100 0.00 255.0 FORMAT "%5.1" ECU_ADDRESS 0x6002BEB1 /end MEASUREMENT
/begin MEASUREMENT MoFEvMngt_Em01_DataDebErrReactn_I.stErrReactn "Error handling class instance to debounce error and handle error reaction / Status of error reaction in class DataDeb with error reaction." UBYTE OneToOne 1 100 0.00 255.0 FORMAT "%5.1" ECU_ADDRESS 0x6002C904 /end MEASUREMENT
/begin MEASUREMENT MoFEvMngt_Em02EngSpd_DataErrReactn_I.stErrLockRels "Error handling class instance to handle EM02 engine speed error reaction without debouncing / Status of lock release in class error reaction." UBYTE OneToOne 1 100 0.00 255.0 FORMAT "%5.1" ECU_ADDRESS 0x6002C8FE /end MEASUREMENT
/begin MEASUREMENT MoFEvMngt_Em02EngSpd_DataErrReactn_I.stErrLockRelsCpl "Error handling class instance to handle EM02 engine speed error reaction without debouncing / Complement for status of lock release in class error reaction." UBYTE OneToOne 1 100 0.00 255.0 FORMAT "%5.1" ECU_ADDRESS 0x6002BEAC /end MEASUREMENT
/begin MEASUREMENT MoFEvMngt_Em02EngSpd_DataErrReactn_I.stErrReactn "Error handling class instance to handle EM02 engine speed error reaction without debouncing / Status of error reaction in class error reaction." UBYTE OneToOne 1 100 0.00 255.0 FORMAT "%5.1" ECU_ADDRESS 0x6002C8FF /end MEASUREMENT
/begin MEASUREMENT MoFEvMngt_Em02Lvl1_DataDebErrReactn_I.cntErrDeb "Error handling class instance to debounce error and handle error reaction / Debounce count in class DataDeb with error reaction." UWORD OneToOne 1 100 0.00 65535.00 FORMAT "%8.2" ECU_ADDRESS 0x6002C8F8 /end MEASUREMENT
/begin MEASUREMENT MoFEvMngt_Em02Lvl1_DataDebErrReactn_I.cntErrDebCpl "Error handling class instance to debounce error and handle error reaction / Complement for debounce count for class DataDeb with error reaction." UWORD OneToOne 1 100 0.00 65535.00 FORMAT "%8.2" ECU_ADDRESS 0x6002BEA8 /end MEASUREMENT
/begin MEASUREMENT MoFEvMngt_Em02Lvl1_DataDebErrReactn_I.stErrDeb "Error handling class instance to debounce error and handle error reaction / Status of debounced error in class DataDeb with error reaction." UBYTE OneToOne 1 100 0.00 255.0 FORMAT "%5.1" ECU_ADDRESS 0x6002C8FA /end MEASUREMENT
/begin MEASUREMENT MoFEvMngt_Em02Lvl1_DataDebErrReactn_I.stErrDebCpl "Error handling class instance to debounce error and handle error reaction / Complement for status of debounced error in class DataDeb with error reaction." UBYTE OneToOne 1 100 0.00 255.0 FORMAT "%5.1" ECU_ADDRESS 0x6002BEAA /end MEASUREMENT
/begin MEASUREMENT MoFEvMngt_Em02Lvl1_DataDebErrReactn_I.stErrLockRels "Error handling class instance to debounce error and handle error reaction / Status of lock release class DataDeb with error reaction." UBYTE OneToOne 1 100 0.00 255.0 FORMAT "%5.1" ECU_ADDRESS 0x6002C8FB /end MEASUREMENT
/begin MEASUREMENT MoFEvMngt_Em02Lvl1_DataDebErrReactn_I.stErrLockRelsCpl "Error handling class instance to debounce error and handle error reaction / Complement for Status of lock release class DataDeb with error reaction." UBYTE OneToOne 1 100 0.00 255.0 FORMAT "%5.1" ECU_ADDRESS 0x6002BEAB /end MEASUREMENT
/begin MEASUREMENT MoFEvMngt_Em02Lvl1_DataDebErrReactn_I.stErrReactn "Error handling class instance to debounce error and handle error reaction / Status of error reaction in class DataDeb with error reaction." UBYTE OneToOne 1 100 0.00 255.0 FORMAT "%5.1" ECU_ADDRESS 0x6002C8FC /end MEASUREMENT
/begin MEASUREMENT MoFEvMngt_Em02Lvl2_DataDebErrReactn_I.cntErrDeb "Error handling class instance to debounce error and handle error reaction / Debounce count in class DataDeb with error reaction." UWORD OneToOne 1 100 0.00 65535.00 FORMAT "%8.2" ECU_ADDRESS 0x6002C8F2 /end MEASUREMENT
/begin MEASUREMENT MoFEvMngt_Em02Lvl2_DataDebErrReactn_I.cntErrDebCpl "Error handling class instance to debounce error and handle error reaction / Complement for debounce count for class DataDeb with error reaction." UWORD OneToOne 1 100 0.00 65535.00 FORMAT "%8.2" ECU_ADDRESS 0x6002BEA4 /end MEASUREMENT
/begin MEASUREMENT MoFEvMngt_Em02Lvl2_DataDebErrReactn_I.stErrDeb "Error handling class instance to debounce error and handle error reaction / Status of debounced error in class DataDeb with error reaction." UBYTE OneToOne 1 100 0.00 255.0 FORMAT "%5.1" ECU_ADDRESS 0x6002C8F4 /end MEASUREMENT
/begin MEASUREMENT MoFEvMngt_Em02Lvl2_DataDebErrReactn_I.stErrDebCpl "Error handling class instance to debounce error and handle error reaction / Complement for status of debounced error in class DataDeb with error reaction." UBYTE OneToOne 1 100 0.00 255.0 FORMAT "%5.1" ECU_ADDRESS 0x6002BEA6 /end MEASUREMENT
/begin MEASUREMENT MoFEvMngt_Em02Lvl2_DataDebErrReactn_I.stErrLockRels "Error handling class instance to debounce error and handle error reaction / Status of lock release class DataDeb with error reaction." UBYTE OneToOne 1 100 0.00 255.0 FORMAT "%5.1" ECU_ADDRESS 0x6002C8F5 /end MEASUREMENT
/begin MEASUREMENT MoFEvMngt_Em02Lvl2_DataDebErrReactn_I.stErrLockRelsCpl "Error handling class instance to debounce error and handle error reaction / Complement for Status of lock release class DataDeb with error reaction." UBYTE OneToOne 1 100 0.00 255.0 FORMAT "%5.1" ECU_ADDRESS 0x6002BEA7 /end MEASUREMENT
/begin MEASUREMENT MoFEvMngt_Em02Lvl2_DataDebErrReactn_I.stErrReactn "Error handling class instance to debounce error and handle error reaction / Status of error reaction in class DataDeb with error reaction." UBYTE OneToOne 1 100 0.00 255.0 FORMAT "%5.1" ECU_ADDRESS 0x6002C8F6 /end MEASUREMENT
/begin MEASUREMENT MoFEvMngt_flgActvDchaFlt "Flag is set after Active Discharge timeout" UBYTE B_TRUE 1 100 0.00 1.00000000000 BIT_MASK 0x40 FORMAT "%13.11" ECU_ADDRESS 0x6002C9BB
 /begin IF_DATA XCPplus 0x0102
  /begin DAQ_EVENT VARIABLE /end DAQ_EVENT
 /end IF_DATA
/end MEASUREMENT
/begin MEASUREMENT MoFEvMngt_flgAdcErr "stores ADC sensor error" UBYTE B_TRUE 1 100 0.00 1.00000000000 BIT_MASK 0x20 FORMAT "%13.11" ECU_ADDRESS 0x6002C9E9
 /begin IF_DATA XCPplus 0x0102
  /begin DAQ_EVENT VARIABLE /end DAQ_EVENT
 /end IF_DATA
/end MEASUREMENT
/begin MEASUREMENT MoFEvMngt_flgBrkgToZrActvd "Braking to zero activated flag" UBYTE B_TRUE 1 100 0.00 1.00000000000 BIT_MASK 0x1 FORMAT "%13.11" ECU_ADDRESS 0x6002C9A2
 /begin IF_DATA XCPplus 0x0102
  /begin DAQ_EVENT VARIABLE /end DAQ_EVENT
 /end IF_DATA
/end MEASUREMENT
/begin MEASUREMENT MoFEvMngt_flgBrkgToZrActvdLvl1 "Flag for indication braking to zero activated in level 1" UBYTE B_TRUE 1 100 0.00 1.00000000000 BIT_MASK 0x80 FORMAT "%13.11" ECU_ADDRESS 0x6002C9BC
 /begin IF_DATA XCPplus 0x0102
  /begin DAQ_EVENT VARIABLE /end DAQ_EVENT
 /end IF_DATA
/end MEASUREMENT
/begin MEASUREMENT MoFEvMngt_flgClrBMS "Condition DSM clearing in function monitoring" UBYTE B_TRUE 1 100 0.00 1.00000000000 BIT_MASK 0x1 FORMAT "%13.11" ECU_ADDRESS 0x70000131
 /begin IF_DATA XCPplus 0x0102
  /begin DAQ_EVENT VARIABLE /end DAQ_EVENT
 /end IF_DATA
/end MEASUREMENT
/begin MEASUREMENT MoFEvMngt_flgClrEm01 "E-machine 01 condition DSM clearing in function monitoring" UBYTE B_TRUE 1 100 0.00 1.00000000000 BIT_MASK 0x1 FORMAT "%13.11" ECU_ADDRESS 0x7000012D
 /begin IF_DATA XCPplus 0x0102
  /begin DAQ_EVENT VARIABLE /end DAQ_EVENT
 /end IF_DATA
/end MEASUREMENT
/begin MEASUREMENT MoFEvMngt_flgClrEm01BrkgToZr "E-machine 01 condition DSM clearing for e-braking to zero in function monitoring" UBYTE B_TRUE 1 100 0.00 1.00000000000 BIT_MASK 0x1 FORMAT "%13.11" ECU_ADDRESS 0x7000012C
 /begin IF_DATA XCPplus 0x0102
  /begin DAQ_EVENT VARIABLE /end DAQ_EVENT
 /end IF_DATA
/end MEASUREMENT
/begin MEASUREMENT MoFEvMngt_flgClrEm01EngSpd "E-machine 01 condition DSM clearing for engine speed in function monitoring" UBYTE B_TRUE 1 100 0.00 1.00000000000 BIT_MASK 0x1 FORMAT "%13.11" ECU_ADDRESS 0x7000012B
 /begin IF_DATA XCPplus 0x0102
  /begin DAQ_EVENT VARIABLE /end DAQ_EVENT
 /end IF_DATA
/end MEASUREMENT
/begin MEASUREMENT MoFEvMngt_flgClrEm02EngSpd "E-machine 02 condition DSM clearing for engine speed in function monitoring" UBYTE B_TRUE 1 100 0.00 1.00000000000 BIT_MASK 0x1 FORMAT "%13.11" ECU_ADDRESS 0x7000012A
 /begin IF_DATA XCPplus 0x0102
  /begin DAQ_EVENT VARIABLE /end DAQ_EVENT
 /end IF_DATA
/end MEASUREMENT
/begin MEASUREMENT MoFEvMngt_flgClrEm02Lvl1 "E-machine 02 condition DSM clearing in function monitoring when DFC is set for MoFEvMngt_flgDiagSetCycEm02Lvl1" UBYTE B_TRUE 1 100 0.00 1.00000000000 BIT_MASK 0x1 FORMAT "%13.11" ECU_ADDRESS 0x70000129
 /begin IF_DATA XCPplus 0x0102
  /begin DAQ_EVENT VARIABLE /end DAQ_EVENT
 /end IF_DATA
/end MEASUREMENT
/begin MEASUREMENT MoFEvMngt_flgClrEm02Lvl2 "E-machine 02 condition DSM clearing in function monitoring when DFC is set for MoFEvMngt_flgDiagSetCycEm02Lvl2" UBYTE B_TRUE 1 100 0.00 1.00000000000 BIT_MASK 0x1 FORMAT "%13.11" ECU_ADDRESS 0x70000128
 /begin IF_DATA XCPplus 0x0102
  /begin DAQ_EVENT VARIABLE /end DAQ_EVENT
 /end IF_DATA
/end MEASUREMENT
/begin MEASUREMENT MoFEvMngt_flgCritModStBms "Flag to indicate the critical mode value of requested desired battery operation mode in function monitoring" UBYTE B_TRUE 1 100 0.00 1.00000000000 BIT_MASK 0x2 FORMAT "%13.11" ECU_ADDRESS 0x6002C9E9
 /begin IF_DATA XCPplus 0x0102
  /begin DAQ_EVENT VARIABLE /end DAQ_EVENT
 /end IF_DATA
/end MEASUREMENT
/begin MEASUREMENT MoFEvMngt_flgCritModStEm01 "Flag to indicate the E-Machine 01 critical mode value of requested desired battery operation mode in function monitoring" UBYTE B_TRUE 1 100 0.00 1.00000000000 BIT_MASK 0x1 FORMAT "%13.11" ECU_ADDRESS 0x6002C9BC
 /begin IF_DATA XCPplus 0x0102
  /begin DAQ_EVENT VARIABLE /end DAQ_EVENT
 /end IF_DATA
/end MEASUREMENT
/begin MEASUREMENT MoFEvMngt_flgCritModStEm02 "Flag to indicate the E-Machine 02 critical mode value of requested desired battery operation mode in function monitoring" UBYTE B_TRUE 1 100 0.00 1.00000000000 BIT_MASK 0x2 FORMAT "%13.11" ECU_ADDRESS 0x6002C9BC
 /begin IF_DATA XCPplus 0x0102
  /begin DAQ_EVENT VARIABLE /end DAQ_EVENT
 /end IF_DATA
/end MEASUREMENT
/begin MEASUREMENT MoFEvMngt_flgDcdc "Flag is set for DCDC fault" UBYTE B_TRUE 1 100 0.00 1.00000000000 BIT_MASK 0x20 FORMAT "%13.11" ECU_ADDRESS 0x6002C9E8
 /begin IF_DATA XCPplus 0x0102
  /begin DAQ_EVENT VARIABLE /end DAQ_EVENT
 /end IF_DATA
/end MEASUREMENT
/begin MEASUREMENT MoFEvMngt_flgDcdcDiagSetCyc "Condition tested status (cycle flag) for diagnosis in function MoFEvMngt_Dcdc of function monitoring" UBYTE B_TRUE 1 100 0.00 1.00000000000 BIT_MASK 0x1 FORMAT "%13.11" ECU_ADDRESS 0x7000012F
 /begin IF_DATA XCPplus 0x0102
  /begin DAQ_EVENT VARIABLE /end DAQ_EVENT
 /end IF_DATA
/end MEASUREMENT
/begin MEASUREMENT MoFEvMngt_flgDcdcErr "Flag to indicate that the requested DCDC converter mode in function monitoring is different from Level 1 requested value" UBYTE B_TRUE 1 100 0.00 1.00000000000 BIT_MASK 0x2 FORMAT "%13.11" ECU_ADDRESS 0x6002C9CB
 /begin IF_DATA XCPplus 0x0102
  /begin DAQ_EVENT VARIABLE /end DAQ_EVENT
 /end IF_DATA
/end MEASUREMENT
/begin MEASUREMENT MoFEvMngt_flgDcdcErrStDeb "Debounced DCDC error status" UBYTE B_TRUE 1 100 0.00 1.00000000000 BIT_MASK 0x1 FORMAT "%13.11" ECU_ADDRESS 0x6002C9CB
 /begin IF_DATA XCPplus 0x0102
  /begin DAQ_EVENT VARIABLE /end DAQ_EVENT
 /end IF_DATA
/end MEASUREMENT
/begin MEASUREMENT MoFEvMngt_flgDcdcFltLvl "Flag set from DCDC Fault level is 4 or 5" UBYTE B_TRUE 1 100 0.00 1.00000000000 BIT_MASK 0x4 FORMAT "%13.11" ECU_ADDRESS 0x6002C9D7
 /begin IF_DATA XCPplus 0x0102
  /begin DAQ_EVENT VARIABLE /end DAQ_EVENT
 /end IF_DATA
/end MEASUREMENT
/begin MEASUREMENT MoFEvMngt_flgDcVoltDchaChk "" UBYTE B_TRUE 1 100 0.00 1.00000000000 BIT_MASK 0x80 FORMAT "%13.11" ECU_ADDRESS 0x6002C9BB
 /begin IF_DATA XCPplus 0x0102
  /begin DAQ_EVENT VARIABLE /end DAQ_EVENT
 /end IF_DATA
/end MEASUREMENT
/begin MEASUREMENT MoFEvMngt_flgDiagSetCycBms "Condition tested status (cycle flag) for diagnosis in function MoFEvMngt_Bms of function monitoring" UBYTE B_TRUE 1 100 0.00 1.00000000000 BIT_MASK 0x1 FORMAT "%13.11" ECU_ADDRESS 0x70000130
 /begin IF_DATA XCPplus 0x0102
  /begin DAQ_EVENT VARIABLE /end DAQ_EVENT
 /end IF_DATA
/end MEASUREMENT
/begin MEASUREMENT MoFEvMngt_flgDiagSetCycEm01 "Condition tested status (cycle flag) for E-machine 01 diagnosis in function monitoring" UBYTE B_TRUE 1 100 0.00 1.00000000000 BIT_MASK 0x1 FORMAT "%13.11" ECU_ADDRESS 0x70000127
 /begin IF_DATA XCPplus 0x0102
  /begin DAQ_EVENT VARIABLE /end DAQ_EVENT
 /end IF_DATA
/end MEASUREMENT
/begin MEASUREMENT MoFEvMngt_flgDiagSetCycEm01BrkgToZr "Condition tested status (cycle flag) for E-machine 01 e-braking to zero diagnosis in function monitoring" UBYTE B_TRUE 1 100 0.00 1.00000000000 BIT_MASK 0x1 FORMAT "%13.11" ECU_ADDRESS 0x70000126
 /begin IF_DATA XCPplus 0x0102
  /begin DAQ_EVENT VARIABLE /end DAQ_EVENT
 /end IF_DATA
/end MEASUREMENT
/begin MEASUREMENT MoFEvMngt_flgDiagSetCycEm01EngSpd "Condition tested status (cycle flag) for E-machine 01 engine speed diagnosis in function monitoring" UBYTE B_TRUE 1 100 0.00 1.00000000000 BIT_MASK 0x1 FORMAT "%13.11" ECU_ADDRESS 0x70000125
 /begin IF_DATA XCPplus 0x0102
  /begin DAQ_EVENT VARIABLE /end DAQ_EVENT
 /end IF_DATA
/end MEASUREMENT
/begin MEASUREMENT MoFEvMngt_flgDiagSetCycEm02EngSpd "Condition tested status (cycle flag) for E-machine 02 engine speed diagnosis in function monitoring" UBYTE B_TRUE 1 100 0.00 1.00000000000 BIT_MASK 0x1 FORMAT "%13.11" ECU_ADDRESS 0x70000124
 /begin IF_DATA XCPplus 0x0102
  /begin DAQ_EVENT VARIABLE /end DAQ_EVENT
 /end IF_DATA
/end MEASUREMENT
/begin MEASUREMENT MoFEvMngt_flgDiagSetCycEm02Lvl1 "Condition tested status (cycle flag) for E-machine 0-2 diagnosis in function monitoring" UBYTE B_TRUE 1 100 0.00 1.00000000000 BIT_MASK 0x1 FORMAT "%13.11" ECU_ADDRESS 0x70000123
 /begin IF_DATA XCPplus 0x0102
  /begin DAQ_EVENT VARIABLE /end DAQ_EVENT
 /end IF_DATA
/end MEASUREMENT
/begin MEASUREMENT MoFEvMngt_flgDiagSetCycEm02Lvl2 "Condition tested status (cycle flag) for E-machine 0-2 diagnosis in function monitoring" UBYTE B_TRUE 1 100 0.00 1.00000000000 BIT_MASK 0x1 FORMAT "%13.11" ECU_ADDRESS 0x70000122
 /begin IF_DATA XCPplus 0x0102
  /begin DAQ_EVENT VARIABLE /end DAQ_EVENT
 /end IF_DATA
/end MEASUREMENT
/begin MEASUREMENT MoFEvMngt_flgDSMClrDcdc "DSM-Clear request in function monitoring for DCDC error" UBYTE B_TRUE 1 100 0.00 1.00000000000 BIT_MASK 0x1 FORMAT "%13.11" ECU_ADDRESS 0x7000012E
 /begin IF_DATA XCPplus 0x0102
  /begin DAQ_EVENT VARIABLE /end DAQ_EVENT
 /end IF_DATA
/end MEASUREMENT
/begin MEASUREMENT MoFEvMngt_flgElMDesEemFlt "Flag is set when active discharge fault present" UBYTE B_TRUE 1 100 0.00 1.00000000000 BIT_MASK 0x20 FORMAT "%13.11" ECU_ADDRESS 0x6002C9BB
 /begin IF_DATA XCPplus 0x0102
  /begin DAQ_EVENT VARIABLE /end DAQ_EVENT
 /end IF_DATA
/end MEASUREMENT
/begin MEASUREMENT MoFEvMngt_flgElMDesEemFltCfm "Flag is set after debounce block" UBYTE B_TRUE 1 100 0.00 1.00000000000 BIT_MASK 0x2 FORMAT "%13.11" ECU_ADDRESS 0x6002C9A1
 /begin IF_DATA XCPplus 0x0102
  /begin DAQ_EVENT VARIABLE /end DAQ_EVENT
 /end IF_DATA
/end MEASUREMENT
/begin MEASUREMENT MoFEvMngt_flgEmAlvErr "e-machine message counter error is active and debounced" UBYTE B_TRUE 1 100 0.00 1.00000000000 BIT_MASK 0x1 FORMAT "%13.11" ECU_ADDRESS 0x6002C9BE
 /begin IF_DATA XCPplus 0x0102
  /begin DAQ_EVENT VARIABLE /end DAQ_EVENT
 /end IF_DATA
/end MEASUREMENT
/begin MEASUREMENT MoFEvMngt_flgEmAlvErr02 "EM02 message counter error is active and debounced" UBYTE B_TRUE 1 100 0.00 1.00000000000 BIT_MASK 0x20 FORMAT "%13.11" ECU_ADDRESS 0x6002C9BE
 /begin IF_DATA XCPplus 0x0102
  /begin DAQ_EVENT VARIABLE /end DAQ_EVENT
 /end IF_DATA
/end MEASUREMENT
/begin MEASUREMENT MoFEvMngt_flgEmAlvFrz "e-machine message counter error is debouncing" UBYTE B_TRUE 1 100 0.00 1.00000000000 BIT_MASK 0x2 FORMAT "%13.11" ECU_ADDRESS 0x6002C9BE
 /begin IF_DATA XCPplus 0x0102
  /begin DAQ_EVENT VARIABLE /end DAQ_EVENT
 /end IF_DATA
/end MEASUREMENT
/begin MEASUREMENT MoFEvMngt_flgEmAlvFrz02 "EM02 message counter error is debouncing" UBYTE B_TRUE 1 100 0.00 1.00000000000 BIT_MASK 0x40 FORMAT "%13.11" ECU_ADDRESS 0x6002C9BE
 /begin IF_DATA XCPplus 0x0102
  /begin DAQ_EVENT VARIABLE /end DAQ_EVENT
 /end IF_DATA
/end MEASUREMENT
/begin MEASUREMENT MoFEvMngt_flgEmChksErr "e-machine checksum error is active and debounced" UBYTE B_TRUE 1 100 0.00 1.00000000000 BIT_MASK 0x4 FORMAT "%13.11" ECU_ADDRESS 0x6002C9BE
 /begin IF_DATA XCPplus 0x0102
  /begin DAQ_EVENT VARIABLE /end DAQ_EVENT
 /end IF_DATA
/end MEASUREMENT
/begin MEASUREMENT MoFEvMngt_flgEmChksErr02 "EM02 checksum error is active and debounced" UBYTE B_TRUE 1 100 0.00 1.00000000000 BIT_MASK 0x80 FORMAT "%13.11" ECU_ADDRESS 0x6002C9BE
 /begin IF_DATA XCPplus 0x0102
  /begin DAQ_EVENT VARIABLE /end DAQ_EVENT
 /end IF_DATA
/end MEASUREMENT
/begin MEASUREMENT MoFEvMngt_flgEmChksFrz "e-machine checksum error is debouncing" UBYTE B_TRUE 1 100 0.00 1.00000000000 BIT_MASK 0x8 FORMAT "%13.11" ECU_ADDRESS 0x6002C9BE
 /begin IF_DATA XCPplus 0x0102
  /begin DAQ_EVENT VARIABLE /end DAQ_EVENT
 /end IF_DATA
/end MEASUREMENT
/begin MEASUREMENT MoFEvMngt_flgEmChksFrz02 "EM02 checksum error is debouncing" UBYTE B_TRUE 1 100 0.00 1.00000000000 BIT_MASK 0x1 FORMAT "%13.11" ECU_ADDRESS 0x6002C9BD
 /begin IF_DATA XCPplus 0x0102
  /begin DAQ_EVENT VARIABLE /end DAQ_EVENT
 /end IF_DATA
/end MEASUREMENT
/begin MEASUREMENT MoFEvMngt_flgEmgyShdwnFlt "Flag set if Emergency Shutdown is 1" UBYTE B_TRUE 1 100 0.00 1.00000000000 BIT_MASK 0x40 FORMAT "%13.11" ECU_ADDRESS 0x6002C9E9
 /begin IF_DATA XCPplus 0x0102
  /begin DAQ_EVENT VARIABLE /end DAQ_EVENT
 /end IF_DATA
/end MEASUREMENT
/begin MEASUREMENT MoFEvMngt_flgEmgyShdwnFltCfm "Flag set if fault is confirm after debounce block" UBYTE B_TRUE 1 100 0.00 1.00000000000 BIT_MASK 0x8 FORMAT "%13.11" ECU_ADDRESS 0x6002C9D8
 /begin IF_DATA XCPplus 0x0102
  /begin DAQ_EVENT VARIABLE /end DAQ_EVENT
 /end IF_DATA
/end MEASUREMENT
/begin MEASUREMENT MoFEvMngt_flgEmgyShtActv "Exported variable when emergency shutdown trggered from level2" UBYTE B_TRUE 1 100 0.00 1.00000000000 BIT_MASK 0x10 FORMAT "%13.11" ECU_ADDRESS 0x6002C9D7
 /begin IF_DATA XCPplus 0x0102
  /begin DAQ_EVENT VARIABLE /end DAQ_EVENT
 /end IF_DATA
/end MEASUREMENT
/begin MEASUREMENT MoFEvMngt_flgEmInvldVal "invalid value received from e-machine" UBYTE B_TRUE 1 100 0.00 1.00000000000 BIT_MASK 0x10 FORMAT "%13.11" ECU_ADDRESS 0x6002C9BE
 /begin IF_DATA XCPplus 0x0102
  /begin DAQ_EVENT VARIABLE /end DAQ_EVENT
 /end IF_DATA
/end MEASUREMENT
/begin MEASUREMENT MoFEvMngt_flgEmInvldVal02 "invalid value received from EM02" UBYTE B_TRUE 1 100 0.00 1.00000000000 BIT_MASK 0x2 FORMAT "%13.11" ECU_ADDRESS 0x6002C9BD
 /begin IF_DATA XCPplus 0x0102
  /begin DAQ_EVENT VARIABLE /end DAQ_EVENT
 /end IF_DATA
/end MEASUREMENT
/begin MEASUREMENT MoFEvMngt_flgEngSpdDesSignNeg "Engine speed setpoint request negative sign flag" UBYTE B_TRUE 1 100 0.00 1.00000000000 BIT_MASK 0x4 FORMAT "%13.11" ECU_ADDRESS 0x6002C9BC
 /begin IF_DATA XCPplus 0x0102
  /begin DAQ_EVENT VARIABLE /end DAQ_EVENT
 /end IF_DATA
/end MEASUREMENT
/begin MEASUREMENT MoFEvMngt_flgErrBmsMsg "Error bit of requested HV Battery mode" UBYTE B_TRUE 1 100 0.00 1.00000000000 BIT_MASK 0x1 FORMAT "%13.11" ECU_ADDRESS 0x70000244
 /begin IF_DATA XCPplus 0x0102
  /begin DAQ_EVENT VARIABLE /end DAQ_EVENT
 /end IF_DATA
/end MEASUREMENT
/begin MEASUREMENT MoFEvMngt_flgErrBrkgToZr "Flag to indicate Error in E-braking to zero function" UBYTE B_TRUE 1 100 0.00 1.00000000000 BIT_MASK 0x2 FORMAT "%13.11" ECU_ADDRESS 0x6002C9BB
 /begin IF_DATA XCPplus 0x0102
  /begin DAQ_EVENT VARIABLE /end DAQ_EVENT
 /end IF_DATA
/end MEASUREMENT
/begin MEASUREMENT MoFEvMngt_flgErrBrkgToZrEngSpdDesSignd "E-Braking to zero error flag for engine speed setpoint request Signed" UBYTE B_TRUE 1 100 0.00 1.00000000000 BIT_MASK 0x4 FORMAT "%13.11" ECU_ADDRESS 0x6002C9BB
 /begin IF_DATA XCPplus 0x0102
  /begin DAQ_EVENT VARIABLE /end DAQ_EVENT
 /end IF_DATA
/end MEASUREMENT
/begin MEASUREMENT MoFEvMngt_flgErrBrkgToZrEngSpdDesUnSignd "E-Braking to zero error flag for engine speed setpoint request Unsigned" UBYTE B_TRUE 1 100 0.00 1.00000000000 BIT_MASK 0x8 FORMAT "%13.11" ECU_ADDRESS 0x6002C9BC
 /begin IF_DATA XCPplus 0x0102
  /begin DAQ_EVENT VARIABLE /end DAQ_EVENT
 /end IF_DATA
/end MEASUREMENT
/begin MEASUREMENT MoFEvMngt_flgErrBrkgToZrPtRels "E-Braking to zero error flag for Powertrain release condition" UBYTE B_TRUE 1 100 0.00 1.00000000000 BIT_MASK 0x10 FORMAT "%13.11" ECU_ADDRESS 0x6002C9BB
 /begin IF_DATA XCPplus 0x0102
  /begin DAQ_EVENT VARIABLE /end DAQ_EVENT
 /end IF_DATA
/end MEASUREMENT
/begin MEASUREMENT MoFEvMngt_flgErrBrkgToZrTqDistbn "E-Braking to zero error flag for torque distribution factor" UBYTE B_TRUE 1 100 0.00 1.00000000000 BIT_MASK 0x8 FORMAT "%13.11" ECU_ADDRESS 0x6002C9BB
 /begin IF_DATA XCPplus 0x0102
  /begin DAQ_EVENT VARIABLE /end DAQ_EVENT
 /end IF_DATA
/end MEASUREMENT
/begin MEASUREMENT MoFEvMngt_flgErrBrkgToZrVVeh "E-Braking to zero error flag for vehicle velocity" UBYTE B_TRUE 1 100 0.00 1.00000000000 BIT_MASK 0x10 FORMAT "%13.11" ECU_ADDRESS 0x6002C9BC
 /begin IF_DATA XCPplus 0x0102
  /begin DAQ_EVENT VARIABLE /end DAQ_EVENT
 /end IF_DATA
/end MEASUREMENT
/begin MEASUREMENT MoFEvMngt_flgErrEm01 "Flag to indicate that the requested E-Machine 01 status value in function monitoring is different from Level 1 requested value" UBYTE B_TRUE 1 100 0.00 1.00000000000 BIT_MASK 0x10 FORMAT "%13.11" ECU_ADDRESS 0x6002C9BD
 /begin IF_DATA XCPplus 0x0102
  /begin DAQ_EVENT VARIABLE /end DAQ_EVENT
 /end IF_DATA
/end MEASUREMENT
/begin MEASUREMENT MoFEvMngt_flgErrEm01BrkgToZrMsg "Flag for a debounced error in the e-braking to zero functionality" UBYTE B_TRUE 1 100 0.00 1.00000000000 BIT_MASK 0x1 FORMAT "%13.11" ECU_ADDRESS 0x70000243
 /begin IF_DATA XCPplus 0x0102
  /begin DAQ_EVENT VARIABLE /end DAQ_EVENT
 /end IF_DATA
/end MEASUREMENT
/begin MEASUREMENT MoFEvMngt_flgErrEm01EngSpdMsg "Flag for a debounced EM01 engine speed error" UBYTE B_TRUE 1 100 0.00 1.00000000000 BIT_MASK 0x1 FORMAT "%13.11" ECU_ADDRESS 0x70000242
 /begin IF_DATA XCPplus 0x0102
  /begin DAQ_EVENT VARIABLE /end DAQ_EVENT
 /end IF_DATA
/end MEASUREMENT
/begin MEASUREMENT MoFEvMngt_flgErrEm01Msg "Mode 01 error bit of E-machine" UBYTE B_TRUE 1 100 0.00 1.00000000000 BIT_MASK 0x1 FORMAT "%13.11" ECU_ADDRESS 0x70000241
 /begin IF_DATA XCPplus 0x0102
  /begin DAQ_EVENT VARIABLE /end DAQ_EVENT
 /end IF_DATA
/end MEASUREMENT
/begin MEASUREMENT MoFEvMngt_flgErrEm02 "Flag to indicate that the requested E-Machine 02 status value in function monitoring is different from Level 1 requested value" UBYTE B_TRUE 1 100 0.00 1.00000000000 BIT_MASK 0x80 FORMAT "%13.11" ECU_ADDRESS 0x6002C9BD
 /begin IF_DATA XCPplus 0x0102
  /begin DAQ_EVENT VARIABLE /end DAQ_EVENT
 /end IF_DATA
/end MEASUREMENT
/begin MEASUREMENT MoFEvMngt_flgErrEm02EngSpdMsg "Flag for a debounced EM02 engine speed error" UBYTE B_TRUE 1 100 0.00 1.00000000000 BIT_MASK 0x1 FORMAT "%13.11" ECU_ADDRESS 0x70000240
 /begin IF_DATA XCPplus 0x0102
  /begin DAQ_EVENT VARIABLE /end DAQ_EVENT
 /end IF_DATA
/end MEASUREMENT
/begin MEASUREMENT MoFEvMngt_flgErrEm02Lvl1Msg "Mode 02 error bit of E-machine" UBYTE B_TRUE 1 100 0.00 1.00000000000 BIT_MASK 0x1 FORMAT "%13.11" ECU_ADDRESS 0x7000023F
 /begin IF_DATA XCPplus 0x0102
  /begin DAQ_EVENT VARIABLE /end DAQ_EVENT
 /end IF_DATA
/end MEASUREMENT
/begin MEASUREMENT MoFEvMngt_flgErrEm02Lvl2Msg "Mode 02 error bit of E-machine" UBYTE B_TRUE 1 100 0.00 1.00000000000 BIT_MASK 0x1 FORMAT "%13.11" ECU_ADDRESS 0x7000023E
 /begin IF_DATA XCPplus 0x0102
  /begin DAQ_EVENT VARIABLE /end DAQ_EVENT
 /end IF_DATA
/end MEASUREMENT
/begin MEASUREMENT MoFEvMngt_flgErrStDcdc "DCDC error status based on operating conditions" UBYTE B_TRUE 1 100 0.00 1.00000000000 BIT_MASK 0x4 FORMAT "%13.11" ECU_ADDRESS 0x6002C9CB
 /begin IF_DATA XCPplus 0x0102
  /begin DAQ_EVENT VARIABLE /end DAQ_EVENT
 /end IF_DATA
/end MEASUREMENT
/begin MEASUREMENT MoFEvMngt_flgFstHvShdwnLvl1 "Flg is set for Emergency Shutdown Level1 Fault" UBYTE B_TRUE 1 100 0.00 1.00000000000 BIT_MASK 0x80 FORMAT "%13.11" ECU_ADDRESS 0x6002C9E9
 /begin IF_DATA XCPplus 0x0102
  /begin DAQ_EVENT VARIABLE /end DAQ_EVENT
 /end IF_DATA
/end MEASUREMENT
/begin MEASUREMENT MoFEvMngt_flgHvb "Flag is set for HvBatt Fault" UBYTE B_TRUE 1 100 0.00 1.00000000000 BIT_MASK 0x8 FORMAT "%13.11" ECU_ADDRESS 0x6002C9E8
 /begin IF_DATA XCPplus 0x0102
  /begin DAQ_EVENT VARIABLE /end DAQ_EVENT
 /end IF_DATA
/end MEASUREMENT
/begin MEASUREMENT MoFEvMngt_flgHvbFltLvl "HVBat Fault level" UBYTE B_TRUE 1 100 0.00 1.00000000000 BIT_MASK 0x1 FORMAT "%13.11" ECU_ADDRESS 0x6002C9D7
 /begin IF_DATA XCPplus 0x0102
  /begin DAQ_EVENT VARIABLE /end DAQ_EVENT
 /end IF_DATA
/end MEASUREMENT
/begin MEASUREMENT MoFEvMngt_flgHvbLvl1Flt "Flag set based on HVBat Fault and Level1 condition" UBYTE B_TRUE 1 100 0.00 1.00000000000 BIT_MASK 0x8 FORMAT "%13.11" ECU_ADDRESS 0x6002C9E9
 /begin IF_DATA XCPplus 0x0102
  /begin DAQ_EVENT VARIABLE /end DAQ_EVENT
 /end IF_DATA
/end MEASUREMENT
/begin MEASUREMENT MoFEvMngt_flgHvbLvl1FltCfm "Flag set if fault is confirm after debounce block" UBYTE B_TRUE 1 100 0.00 1.00000000000 BIT_MASK 0x2 FORMAT "%13.11" ECU_ADDRESS 0x6002C9D8
 /begin IF_DATA XCPplus 0x0102
  /begin DAQ_EVENT VARIABLE /end DAQ_EVENT
 /end IF_DATA
/end MEASUREMENT
/begin MEASUREMENT MoFEvMngt_flgHvIntlckLvl1Flt "Flag set based on HV Interlock Fault Level1 conditon." UBYTE B_TRUE 1 100 0.00 1.00000000000 BIT_MASK 0x4 FORMAT "%13.11" ECU_ADDRESS 0x6002C9E9
 /begin IF_DATA XCPplus 0x0102
  /begin DAQ_EVENT VARIABLE /end DAQ_EVENT
 /end IF_DATA
/end MEASUREMENT
/begin MEASUREMENT MoFEvMngt_flgHvIntlckLvl1FltCfm "Flag set if fault is confirm after debounce block" UBYTE B_TRUE 1 100 0.00 1.00000000000 BIT_MASK 0x1 FORMAT "%13.11" ECU_ADDRESS 0x6002C9D8
 /begin IF_DATA XCPplus 0x0102
  /begin DAQ_EVENT VARIABLE /end DAQ_EVENT
 /end IF_DATA
/end MEASUREMENT
/begin MEASUREMENT MoFEvMngt_flgInvtr "Flag is set for Inverter Fault" UBYTE B_TRUE 1 100 0.00 1.00000000000 BIT_MASK 0x10 FORMAT "%13.11" ECU_ADDRESS 0x6002C9E8
 /begin IF_DATA XCPplus 0x0102
  /begin DAQ_EVENT VARIABLE /end DAQ_EVENT
 /end IF_DATA
/end MEASUREMENT
/begin MEASUREMENT MoFEvMngt_flgIrrvDcdcErr "Irreversible DCDC error status" UBYTE B_TRUE 1 100 0.00 1.00000000000 BIT_MASK 0x1 FORMAT "%13.11" ECU_ADDRESS 0x6002C9C7
 /begin IF_DATA XCPplus 0x0102
  /begin DAQ_EVENT VARIABLE /end DAQ_EVENT
 /end IF_DATA
/end MEASUREMENT
/begin MEASUREMENT MoFEvMngt_flgIrrvDcdcErrMsg "Irreversible DCDC error status message" UBYTE B_TRUE 1 100 0.00 1.00000000000 BIT_MASK 0x1 FORMAT "%13.11" ECU_ADDRESS 0x7000023D
 /begin IF_DATA XCPplus 0x0102
  /begin DAQ_EVENT VARIABLE /end DAQ_EVENT
 /end IF_DATA
/end MEASUREMENT
/begin MEASUREMENT MoFEvMngt_flgIvtrFltLvl "Flag set from DCDC Fault level is 4 or 5" UBYTE B_TRUE 1 100 0.00 1.00000000000 BIT_MASK 0x2 FORMAT "%13.11" ECU_ADDRESS 0x6002C9D7
 /begin IF_DATA XCPplus 0x0102
  /begin DAQ_EVENT VARIABLE /end DAQ_EVENT
 /end IF_DATA
/end MEASUREMENT
/begin MEASUREMENT MoFEvMngt_flgOpnHvCircBms "Terminal 30c and Inverter Inter lock requested HV Battery status value" UBYTE B_TRUE 1 100 0.00 1.00000000000 BIT_MASK 0x1 FORMAT "%13.11" ECU_ADDRESS 0x6002C9E9
 /begin IF_DATA XCPplus 0x0102
  /begin DAQ_EVENT VARIABLE /end DAQ_EVENT
 /end IF_DATA
/end MEASUREMENT
/begin MEASUREMENT MoFEvMngt_flgOpnHvCircEm01 "Terminal 30c and High Voltage Inter lock E-machine 01 status value" UBYTE B_TRUE 1 100 0.00 1.00000000000 BIT_MASK 0x4 FORMAT "%13.11" ECU_ADDRESS 0x6002C9BD
 /begin IF_DATA XCPplus 0x0102
  /begin DAQ_EVENT VARIABLE /end DAQ_EVENT
 /end IF_DATA
/end MEASUREMENT
/begin MEASUREMENT MoFEvMngt_flgOpnHvCircEm02 "Terminal 30c and High Voltage Inter lock E-machine 02 status value" UBYTE B_TRUE 1 100 0.00 1.00000000000 BIT_MASK 0x20 FORMAT "%13.11" ECU_ADDRESS 0x6002C9BD
 /begin IF_DATA XCPplus 0x0102
  /begin DAQ_EVENT VARIABLE /end DAQ_EVENT
 /end IF_DATA
/end MEASUREMENT
/begin MEASUREMENT MoFEvMngt_flgSetEmgyShdwnBms "Flag set from Emergency Shudown level1 interface" UBYTE B_TRUE 1 100 0.00 1.00000000000 BIT_MASK 0x1 FORMAT "%13.11" ECU_ADDRESS 0x6002C9E8
 /begin IF_DATA XCPplus 0x0102
  /begin DAQ_EVENT VARIABLE /end DAQ_EVENT
 /end IF_DATA
/end MEASUREMENT
/begin MEASUREMENT MoFEvMngt_flgSetOperModBms "Flag set from Operating mode set from Level1" UBYTE B_TRUE 1 100 0.00 1.00000000000 BIT_MASK 0x4 FORMAT "%13.11" ECU_ADDRESS 0x6002C9E8
 /begin IF_DATA XCPplus 0x0102
  /begin DAQ_EVENT VARIABLE /end DAQ_EVENT
 /end IF_DATA
/end MEASUREMENT
/begin MEASUREMENT MoFEvMngt_flgTBusBarFlt "Flag set from Bus Bar Temperature fault occurs" UBYTE B_TRUE 1 100 0.00 1.00000000000 BIT_MASK 0x10 FORMAT "%13.11" ECU_ADDRESS 0x6002C9E9
 /begin IF_DATA XCPplus 0x0102
  /begin DAQ_EVENT VARIABLE /end DAQ_EVENT
 /end IF_DATA
/end MEASUREMENT
/begin MEASUREMENT MoFEvMngt_flgTBusBarFltCfm "Flag set if fault is confirm after debounce block" UBYTE B_TRUE 1 100 0.00 1.00000000000 BIT_MASK 0x4 FORMAT "%13.11" ECU_ADDRESS 0x6002C9D8
 /begin IF_DATA XCPplus 0x0102
  /begin DAQ_EVENT VARIABLE /end DAQ_EVENT
 /end IF_DATA
/end MEASUREMENT
/begin MEASUREMENT MoFEvMngt_flgTSetModBms "Flag is set Bus Bar Temperature is greater than Threshold2" UBYTE B_TRUE 1 100 0.00 1.00000000000 BIT_MASK 0x2 FORMAT "%13.11" ECU_ADDRESS 0x6002C9E8
 /begin IF_DATA XCPplus 0x0102
  /begin DAQ_EVENT VARIABLE /end DAQ_EVENT
 /end IF_DATA
/end MEASUREMENT
/begin MEASUREMENT MoFEvMngt_flgTurnOnOffStEm01 "Debounce counter status bit of desired state of inverter mode-1" UBYTE B_TRUE 1 100 0.00 1.00000000000 BIT_MASK 0x1 FORMAT "%13.11" ECU_ADDRESS 0x6002C9A1
 /begin IF_DATA XCPplus 0x0102
  /begin DAQ_EVENT VARIABLE /end DAQ_EVENT
 /end IF_DATA
/end MEASUREMENT
/begin MEASUREMENT MoFEvMngt_flgTurnOnOffStEm01BrkgToZr1 "Debounce counter status bit of desired state of inverter mode-1 regarding e-braking to zero functionality (errors present)" UBYTE B_TRUE 1 100 0.00 1.00000000000 BIT_MASK 0x20 FORMAT "%13.11" ECU_ADDRESS 0x6002C9BC
 /begin IF_DATA XCPplus 0x0102
  /begin DAQ_EVENT VARIABLE /end DAQ_EVENT
 /end IF_DATA
/end MEASUREMENT
/begin MEASUREMENT MoFEvMngt_flgTurnOnOffStEm01BrkgToZr2 "Debounce counter status bit of desired state of inverter mode-1 regarding e-braking to zero functionality (active and no errors present)" UBYTE B_TRUE 1 100 0.00 1.00000000000 BIT_MASK 0x40 FORMAT "%13.11" ECU_ADDRESS 0x6002C9BC
 /begin IF_DATA XCPplus 0x0102
  /begin DAQ_EVENT VARIABLE /end DAQ_EVENT
 /end IF_DATA
/end MEASUREMENT
/begin MEASUREMENT MoFEvMngt_flgTurnOnOffStEm02 "Debounce counter status bit of desired state of inverter mode-2" UBYTE B_TRUE 1 100 0.00 1.00000000000 BIT_MASK 0x40 FORMAT "%13.11" ECU_ADDRESS 0x6002C9BD
 /begin IF_DATA XCPplus 0x0102
  /begin DAQ_EVENT VARIABLE /end DAQ_EVENT
 /end IF_DATA
/end MEASUREMENT
/begin MEASUREMENT MoFEvMngt_flgTurnOnOffStEm02SafeIvtr "Debounce counter status bit of desired state of safe inverter mode-2" UBYTE B_TRUE 1 100 0.00 1.00000000000 BIT_MASK 0x1 FORMAT "%13.11" ECU_ADDRESS 0x6002C9BB
 /begin IF_DATA XCPplus 0x0102
  /begin DAQ_EVENT VARIABLE /end DAQ_EVENT
 /end IF_DATA
/end MEASUREMENT
/begin MEASUREMENT MoFEvMngt_idxnActAry "current position on which is written the new value" UBYTE OneToOne 1 100 0.00 255.0 FORMAT "%5.1" ECU_ADDRESS 0x6002C9B4
 /begin IF_DATA XCPplus 0x0102
  /begin DAQ_EVENT VARIABLE /end DAQ_EVENT
 /end IF_DATA
/end MEASUREMENT
/begin MEASUREMENT MoFEvMngt_idxnActAryCpl "complement: current position on which is written the new value" UBYTE OneToOne 1 100 0.00 255.0 FORMAT "%5.1" ECU_ADDRESS 0x6002BF5E
 /begin IF_DATA XCPplus 0x0102
  /begin DAQ_EVENT VARIABLE /end DAQ_EVENT
 /end IF_DATA
/end MEASUREMENT
/begin MEASUREMENT MoFEvMngt_idxnActAryEm02 "current position on which is written the new value for EM02 moving average" UBYTE OneToOne 1 100 0.00 255.0 FORMAT "%5.1" ECU_ADDRESS 0x6002C9B3
 /begin IF_DATA XCPplus 0x0102
  /begin DAQ_EVENT VARIABLE /end DAQ_EVENT
 /end IF_DATA
/end MEASUREMENT
/begin MEASUREMENT MoFEvMngt_idxnActAryEm02Cpl "Double storage for MoFEvMngt_idxnActAryEm02" UBYTE OneToOne 1 100 0.00 255.0 FORMAT "%5.1" ECU_ADDRESS 0x6002BF5D
 /begin IF_DATA XCPplus 0x0102
  /begin DAQ_EVENT VARIABLE /end DAQ_EVENT
 /end IF_DATA
/end MEASUREMENT
/begin MEASUREMENT MoFEvMngt_idxnActAvrg "current position from which is read" UBYTE OneToOne 1 100 0.00 255.0 FORMAT "%5.1" ECU_ADDRESS 0x6002C9B2
 /begin IF_DATA XCPplus 0x0102
  /begin DAQ_EVENT VARIABLE /end DAQ_EVENT
 /end IF_DATA
/end MEASUREMENT
/begin MEASUREMENT MoFEvMngt_idxnActAvrgCpl "complement: current position from which is read" UBYTE OneToOne 1 100 0.00 255.0 FORMAT "%5.1" ECU_ADDRESS 0x6002BF5C
 /begin IF_DATA XCPplus 0x0102
  /begin DAQ_EVENT VARIABLE /end DAQ_EVENT
 /end IF_DATA
/end MEASUREMENT
/begin MEASUREMENT MoFEvMngt_idxnAvrg "moving average array index used" UBYTE OneToOne 1 100 0.00 255.0 FORMAT "%5.1" ECU_ADDRESS 0x6002C9B1
 /begin IF_DATA XCPplus 0x0102
  /begin DAQ_EVENT VARIABLE /end DAQ_EVENT
 /end IF_DATA
/end MEASUREMENT
/begin MEASUREMENT MoFEvMngt_idxnAvrgCpl "complement: moving average array index used" UBYTE OneToOne 1 100 0.00 255.0 FORMAT "%5.1" ECU_ADDRESS 0x6002BF5B
 /begin IF_DATA XCPplus 0x0102
  /begin DAQ_EVENT VARIABLE /end DAQ_EVENT
 /end IF_DATA
/end MEASUREMENT
/begin MEASUREMENT MoFEvMngt_nActSum01 "sum of all sample values in filter" SLONG nmot_q1 1 100 -2147483648.00 2147483647.00 FORMAT "%13.2" ECU_ADDRESS 0x6002C998
 /begin IF_DATA XCPplus 0x0102
  /begin DAQ_EVENT VARIABLE /end DAQ_EVENT
 /end IF_DATA
/end MEASUREMENT
/begin MEASUREMENT MoFEvMngt_nActSum01Cpl "complement: sum of all sample values in filter" ULONG OneToOne 1 100 0.00 4294967295.00 FORMAT "%13.2" ECU_ADDRESS 0x6002BF44
 /begin IF_DATA XCPplus 0x0102
  /begin DAQ_EVENT VARIABLE /end DAQ_EVENT
 /end IF_DATA
/end MEASUREMENT
/begin MEASUREMENT MoFEvMngt_nActSum02 "sum of all sample values in filter for EM02" SLONG nmot_q1 1 100 -2147483648.00 2147483647.00 FORMAT "%13.2" ECU_ADDRESS 0x6002C994
 /begin IF_DATA XCPplus 0x0102
  /begin DAQ_EVENT VARIABLE /end DAQ_EVENT
 /end IF_DATA
/end MEASUREMENT
/begin MEASUREMENT MoFEvMngt_nActSum02Cpl "RAM data redundancy for MoFEvMngt_nActSum02" ULONG OneToOne 1 100 0.00 4294967295.00 FORMAT "%13.2" ECU_ADDRESS 0x6002BF40
 /begin IF_DATA XCPplus 0x0102
  /begin DAQ_EVENT VARIABLE /end DAQ_EVENT
 /end IF_DATA
/end MEASUREMENT
/begin MEASUREMENT MoFEvMngt_nDes01 "EM01 engine speed setpoint request" SWORD nmot_q1 1 100 -32768.00 32767.00 FORMAT "%8.2" ECU_ADDRESS 0x6002C916
 /begin IF_DATA XCPplus 0x0102
  /begin DAQ_EVENT VARIABLE /end DAQ_EVENT
 /end IF_DATA
/end MEASUREMENT
/begin MEASUREMENT MoFEvmngt_nDes01BrkgToZrLvl1 "EM01 engine speed setpoint request in level 1" SWORD nmot_q1 1 100 0.00 32767.00 FORMAT "%8.2" ECU_ADDRESS 0x6002C992
 /begin IF_DATA XCPplus 0x0102
  /begin DAQ_EVENT VARIABLE /end DAQ_EVENT
 /end IF_DATA
/end MEASUREMENT
/begin MEASUREMENT MoFEvmngt_nDes01BrkgToZrLvl1Cpl "Complement of EM01 engine speed setpoint request in level 1" UWORD OneToOne 1 100 0.00 65535.00 FORMAT "%8.2" ECU_ADDRESS 0x6002BF3C
 /begin IF_DATA XCPplus 0x0102
  /begin DAQ_EVENT VARIABLE /end DAQ_EVENT
 /end IF_DATA
/end MEASUREMENT
/begin MEASUREMENT MoFEvMngt_nDes01Cpl "Complement of MoFEvMngt_nDes01" UWORD OneToOne 1 100 0.00 65535.00 FORMAT "%8.2" ECU_ADDRESS 0x6002BF3A
 /begin IF_DATA XCPplus 0x0102
  /begin DAQ_EVENT VARIABLE /end DAQ_EVENT
 /end IF_DATA
/end MEASUREMENT
/begin MEASUREMENT MoFEvMngt_nDes01SigndLimd "Limited EM01 engine speed setpoint request signed" SWORD nmot_q1 1 100 -32768.00 32767.00 FORMAT "%8.2" ECU_ADDRESS 0x6002C990
 /begin IF_DATA XCPplus 0x0102
  /begin DAQ_EVENT VARIABLE /end DAQ_EVENT
 /end IF_DATA
/end MEASUREMENT
/begin MEASUREMENT MoFEvMngt_nDes01SigndLimdCpl "Complement of MoFEvMngt_nDes01SigndLimd" UWORD OneToOne 1 100 0.00 65535.00 FORMAT "%8.2" ECU_ADDRESS 0x6002BF38
 /begin IF_DATA XCPplus 0x0102
  /begin DAQ_EVENT VARIABLE /end DAQ_EVENT
 /end IF_DATA
/end MEASUREMENT
/begin MEASUREMENT MoFEvMngt_nDesCom01Lvl1 "EM01 engine speed setpoint request signed in level 1" SWORD nmot_q1 1 100 -32768.00 32767.00 FORMAT "%8.2" ECU_ADDRESS 0x6002C98E
 /begin IF_DATA XCPplus 0x0102
  /begin DAQ_EVENT VARIABLE /end DAQ_EVENT
 /end IF_DATA
/end MEASUREMENT
/begin MEASUREMENT MoFEvMngt_nDesCom01Lvl1Cpl "Complement of MoFEvMngt_nDesCom01Lvl1" UWORD OneToOne 1 100 0.00 65535.00 FORMAT "%8.2" ECU_ADDRESS 0x6002BF36
 /begin IF_DATA XCPplus 0x0102
  /begin DAQ_EVENT VARIABLE /end DAQ_EVENT
 /end IF_DATA
/end MEASUREMENT
/begin MEASUREMENT MoFEvMngt_nDesNotSignd "EM01 engine speed setpoint request unsigned" SWORD nmot_q1 1 100 0.00 32767.00 FORMAT "%8.2" ECU_ADDRESS 0x6002C98C
 /begin IF_DATA XCPplus 0x0102
  /begin DAQ_EVENT VARIABLE /end DAQ_EVENT
 /end IF_DATA
/end MEASUREMENT
/begin MEASUREMENT MoFEvMngt_nDesNotSigndCpl "Complement of MoFEvMngt_nDesNotSignd" UWORD OneToOne 1 100 0.00 65535.00 FORMAT "%8.2" ECU_ADDRESS 0x6002BF34
 /begin IF_DATA XCPplus 0x0102
  /begin DAQ_EVENT VARIABLE /end DAQ_EVENT
 /end IF_DATA
/end MEASUREMENT
/begin MEASUREMENT MoFEvMngt_nDesSignd "EM01 engine speed setpoint request signed" SWORD nmot_q1 1 100 -32768.00 32767.00 FORMAT "%8.2" ECU_ADDRESS 0x6002C98A
 /begin IF_DATA XCPplus 0x0102
  /begin DAQ_EVENT VARIABLE /end DAQ_EVENT
 /end IF_DATA
/end MEASUREMENT
/begin MEASUREMENT MoFEvMngt_nDesSigndCpl "Complement of MoFEvMngt_nDesSignd" UWORD OneToOne 1 100 0.00 65535.00 FORMAT "%8.2" ECU_ADDRESS 0x6002BF32
 /begin IF_DATA XCPplus 0x0102
  /begin DAQ_EVENT VARIABLE /end DAQ_EVENT
 /end IF_DATA
/end MEASUREMENT
/begin MEASUREMENT MoFEvMngt_nDesThres "EM01 engine speed setpoint request threshold" SWORD nmot_q1 1 100 0.00 32767.00 FORMAT "%8.2" ECU_ADDRESS 0x6002C988
 /begin IF_DATA XCPplus 0x0102
  /begin DAQ_EVENT VARIABLE /end DAQ_EVENT
 /end IF_DATA
/end MEASUREMENT
/begin MEASUREMENT MoFEvMngt_nDesThresCpl "Complement of MoFEvMngt_nDesThes" UWORD OneToOne 1 100 0.00 65535.00 FORMAT "%8.2" ECU_ADDRESS 0x6002BF30
 /begin IF_DATA XCPplus 0x0102
  /begin DAQ_EVENT VARIABLE /end DAQ_EVENT
 /end IF_DATA
/end MEASUREMENT
/begin MEASUREMENT MoFEvMngt_nDesThresDif "EM01 engine speed setpoint request threshold difference between threshold maximum value and current threshold" SWORD nmot_q1 1 100 0.00 32767.00 FORMAT "%8.2" ECU_ADDRESS 0x6002C986
 /begin IF_DATA XCPplus 0x0102
  /begin DAQ_EVENT VARIABLE /end DAQ_EVENT
 /end IF_DATA
/end MEASUREMENT
/begin MEASUREMENT MoFEvMngt_nDesThresDifCpl "Complement of MoFEvMngt_nDesThesDif" UWORD OneToOne 1 100 0.00 65535.00 FORMAT "%8.2" ECU_ADDRESS 0x6002BF2E
 /begin IF_DATA XCPplus 0x0102
  /begin DAQ_EVENT VARIABLE /end DAQ_EVENT
 /end IF_DATA
/end MEASUREMENT
/begin MEASUREMENT MoFEvMngt_nDesThresInct "EM01 engine speed setpoint request threshold increment with which the engine speed setpoint request threshold is changed in each timestep" SWORD nmot_q1 1 100 0.00 32767.00 FORMAT "%8.2" ECU_ADDRESS 0x6002C984
 /begin IF_DATA XCPplus 0x0102
  /begin DAQ_EVENT VARIABLE /end DAQ_EVENT
 /end IF_DATA
/end MEASUREMENT
/begin MEASUREMENT MoFEvMngt_nDesThresInctCpl "Complement of MoFEvMngt_nDesThesInct" UWORD OneToOne 1 100 0.00 65535.00 FORMAT "%8.2" ECU_ADDRESS 0x6002BF2C
 /begin IF_DATA XCPplus 0x0102
  /begin DAQ_EVENT VARIABLE /end DAQ_EVENT
 /end IF_DATA
/end MEASUREMENT
/begin MEASUREMENT MoFEvMngt_nDesThresMax "EM01 engine speed setpoint request threshold initial maximum value" SWORD nmot_q1 1 100 0.00 32767.00 FORMAT "%8.2" ECU_ADDRESS 0x6002C982
 /begin IF_DATA XCPplus 0x0102
  /begin DAQ_EVENT VARIABLE /end DAQ_EVENT
 /end IF_DATA
/end MEASUREMENT
/begin MEASUREMENT MoFEvMngt_nDesThresMaxCpl "Complement of MoFEvMngt_nDesThesMax" UWORD OneToOne 1 100 0.00 65535.00 FORMAT "%8.2" ECU_ADDRESS 0x6002BF2A
 /begin IF_DATA XCPplus 0x0102
  /begin DAQ_EVENT VARIABLE /end DAQ_EVENT
 /end IF_DATA
/end MEASUREMENT
/begin MEASUREMENT MoFEvMngt_nEm01 "Engine Speed EM01" SWORD nmot_q1 1 100 -32768.00 32767.00 FORMAT "%8.2" ECU_ADDRESS 0x6002C914
 /begin IF_DATA XCPplus 0x0102
  /begin DAQ_EVENT VARIABLE /end DAQ_EVENT
 /end IF_DATA
/end MEASUREMENT
/begin MEASUREMENT MoFEvMngt_nEm01Cpl "RAM data redundancy for MoFEvMngt_nEm01" UWORD OneToOne 1 100 0.00 65535.00 FORMAT "%8.2" ECU_ADDRESS 0x6002BF28
 /begin IF_DATA XCPplus 0x0102
  /begin DAQ_EVENT VARIABLE /end DAQ_EVENT
 /end IF_DATA
/end MEASUREMENT
/begin MEASUREMENT MoFEvMngt_nEm02 "Rotational speed of E-Machine 02" SWORD nmot_q1 1 100 -32768.00 32767.00 FORMAT "%8.2" ECU_ADDRESS 0x6002C912
 /begin IF_DATA XCPplus 0x0102
  /begin DAQ_EVENT VARIABLE /end DAQ_EVENT
 /end IF_DATA
/end MEASUREMENT
/begin MEASUREMENT MoFEvMngt_nEm02Cpl "Complement: Rotational speed of E-Machine 02" UWORD OneToOne 1 100 0.00 65535.00 FORMAT "%8.2" ECU_ADDRESS 0x6002BF26
 /begin IF_DATA XCPplus 0x0102
  /begin DAQ_EVENT VARIABLE /end DAQ_EVENT
 /end IF_DATA
/end MEASUREMENT
/begin MEASUREMENT MoFEvMngt_nEmAvrg01 "average value of the e-machine speed" SWORD nmot_q1 1 100 -32768.00 32767.00 FORMAT "%8.2" ECU_ADDRESS 0x6002C980
 /begin IF_DATA XCPplus 0x0102
  /begin DAQ_EVENT VARIABLE /end DAQ_EVENT
 /end IF_DATA
/end MEASUREMENT
/begin MEASUREMENT MoFEvMngt_nEmAvrg01Cpl "complement: average value of the e-machine speed" UWORD OneToOne 1 100 0.00 65535.00 FORMAT "%8.2" ECU_ADDRESS 0x6002BF24
 /begin IF_DATA XCPplus 0x0102
  /begin DAQ_EVENT VARIABLE /end DAQ_EVENT
 /end IF_DATA
/end MEASUREMENT
/begin MEASUREMENT MoFEvMngt_nEmAvrg02 "average value of the EM02 speed" SWORD nmot_q1 1 100 -32768.00 32767.00 FORMAT "%8.2" ECU_ADDRESS 0x6002C97E
 /begin IF_DATA XCPplus 0x0102
  /begin DAQ_EVENT VARIABLE /end DAQ_EVENT
 /end IF_DATA
/end MEASUREMENT
/begin MEASUREMENT MoFEvMngt_nEmAvrg02Cpl "RAM data redundancy for MoFEvMngt_nEmAvrg02" UWORD OneToOne 1 100 0.00 65535.00 FORMAT "%8.2" ECU_ADDRESS 0x6002BF22
 /begin IF_DATA XCPplus 0x0102
  /begin DAQ_EVENT VARIABLE /end DAQ_EVENT
 /end IF_DATA
/end MEASUREMENT
/begin MEASUREMENT MoFEvMngt_nEmFlt1Hi01 "Filter value of e-machine-speed" SWORD nmot_q1 1 100 -32768.00 32767.00 FORMAT "%8.2" ECU_ADDRESS 0x6002C97C
 /begin IF_DATA XCPplus 0x0102
  /begin DAQ_EVENT VARIABLE /end DAQ_EVENT
 /end IF_DATA
/end MEASUREMENT
/begin MEASUREMENT MoFEvMngt_nEmFlt1Hi01Cpl "complement: Filter value of e-machine-speed" UWORD OneToOne 1 100 0.00 65535.00 FORMAT "%8.2" ECU_ADDRESS 0x6002BF20
 /begin IF_DATA XCPplus 0x0102
  /begin DAQ_EVENT VARIABLE /end DAQ_EVENT
 /end IF_DATA
/end MEASUREMENT
/begin MEASUREMENT MoFEvMngt_nEmFlt1Hi02 "Filter value of EM02-speed" SWORD nmot_q1 1 100 -32768.00 32767.00 FORMAT "%8.2" ECU_ADDRESS 0x6002C97A
 /begin IF_DATA XCPplus 0x0102
  /begin DAQ_EVENT VARIABLE /end DAQ_EVENT
 /end IF_DATA
/end MEASUREMENT
/begin MEASUREMENT MoFEvMngt_nEmFlt1Hi02Cpl "RAM data redundancy for MoFEvMngt_nEmFlt1Hi02" UWORD OneToOne 1 100 0.00 65535.00 FORMAT "%8.2" ECU_ADDRESS 0x6002BF1E
 /begin IF_DATA XCPplus 0x0102
  /begin DAQ_EVENT VARIABLE /end DAQ_EVENT
 /end IF_DATA
/end MEASUREMENT
/begin MEASUREMENT MoFEvMngt_nEmFlt2Hi01 "Filter value of e-machine-speed" SWORD nmot_q1 1 100 -32768.00 32767.00 FORMAT "%8.2" ECU_ADDRESS 0x6002C978
 /begin IF_DATA XCPplus 0x0102
  /begin DAQ_EVENT VARIABLE /end DAQ_EVENT
 /end IF_DATA
/end MEASUREMENT
/begin MEASUREMENT MoFEvMngt_nEmFlt2Hi01Cpl "complement: Filter value of e-machine-speed" UWORD OneToOne 1 100 0.00 65535.00 FORMAT "%8.2" ECU_ADDRESS 0x6002BF1C
 /begin IF_DATA XCPplus 0x0102
  /begin DAQ_EVENT VARIABLE /end DAQ_EVENT
 /end IF_DATA
/end MEASUREMENT
/begin MEASUREMENT MoFEvMngt_nEmFlt2Hi02 "Filter value of EM02-speed" SWORD nmot_q1 1 100 -32768.00 32767.00 FORMAT "%8.2" ECU_ADDRESS 0x6002C976
 /begin IF_DATA XCPplus 0x0102
  /begin DAQ_EVENT VARIABLE /end DAQ_EVENT
 /end IF_DATA
/end MEASUREMENT
/begin MEASUREMENT MoFEvMngt_nEmFlt2Hi02Cpl "RAM data redundancy for MoFEvMngt_nEmFlt2Hi02" UWORD OneToOne 1 100 0.00 65535.00 FORMAT "%8.2" ECU_ADDRESS 0x6002BF1A
 /begin IF_DATA XCPplus 0x0102
  /begin DAQ_EVENT VARIABLE /end DAQ_EVENT
 /end IF_DATA
/end MEASUREMENT
/begin MEASUREMENT MoFEvMngt_nEmPhy01 "filtered e-machine speed" SWORD nmot_q1 1 100 -32768.00 32767.00 FORMAT "%8.2" ECU_ADDRESS 0x6002C910
 /begin IF_DATA XCPplus 0x0102
  /begin DAQ_EVENT VARIABLE /end DAQ_EVENT
 /end IF_DATA
/end MEASUREMENT
/begin MEASUREMENT MoFEvMngt_nEmPhy01Cpl "complement: filtered e-machine speed" UWORD OneToOne 1 100 0.00 65535.00 FORMAT "%8.2" ECU_ADDRESS 0x6002BF18
 /begin IF_DATA XCPplus 0x0102
  /begin DAQ_EVENT VARIABLE /end DAQ_EVENT
 /end IF_DATA
/end MEASUREMENT
/begin MEASUREMENT MoFEvMngt_nEmPhy02 "Filtered speed of E-Machine 02" SWORD nmot_q1 1 100 -32768.00 32767.00 FORMAT "%8.2" ECU_ADDRESS 0x6002C90E
 /begin IF_DATA XCPplus 0x0102
  /begin DAQ_EVENT VARIABLE /end DAQ_EVENT
 /end IF_DATA
/end MEASUREMENT
/begin MEASUREMENT MoFEvMngt_nEmPhy02Cpl "Complement: Filtered speed of E-Machine 02" UWORD OneToOne 1 100 0.00 65535.00 FORMAT "%8.2" ECU_ADDRESS 0x6002BF16
 /begin IF_DATA XCPplus 0x0102
  /begin DAQ_EVENT VARIABLE /end DAQ_EVENT
 /end IF_DATA
/end MEASUREMENT
/begin MEASUREMENT MoFEvMngt_nrSmplArr "average filter array to hold sample values" SWORD nmot_q1 1 100 -32768.00 32767.00 FORMAT "%8.2" MATRIX_DIM 20 ECU_ADDRESS 0x6002C94E
 /begin IF_DATA XCPplus 0x0102
  /begin DAQ_EVENT VARIABLE /end DAQ_EVENT
 /end IF_DATA
/end MEASUREMENT
/begin MEASUREMENT MoFEvMngt_nrSmplArrCpl "complement: average filter array to hold sample values" UWORD OneToOne 1 100 0.00 65535.00 FORMAT "%8.2" MATRIX_DIM 20 ECU_ADDRESS 0x6002BEEE
 /begin IF_DATA XCPplus 0x0102
  /begin DAQ_EVENT VARIABLE /end DAQ_EVENT
 /end IF_DATA
/end MEASUREMENT
/begin MEASUREMENT MoFEvMngt_nrSmplArrEM02 "average filter array to hold sample values for EM02" SWORD nmot_q1 1 100 -32768.00 32767.00 FORMAT "%8.2" MATRIX_DIM 20 ECU_ADDRESS 0x6002C926
 /begin IF_DATA XCPplus 0x0102
  /begin DAQ_EVENT VARIABLE /end DAQ_EVENT
 /end IF_DATA
/end MEASUREMENT
/begin MEASUREMENT MoFEvMngt_nrSmplArrEM02Cpl "RAM Data Redundancy for MoFEvMngt_nrSmplArrEM02" UWORD OneToOne 1 100 0.00 65535.00 FORMAT "%8.2" MATRIX_DIM 20 ECU_ADDRESS 0x6002BEC6
 /begin IF_DATA XCPplus 0x0102
  /begin DAQ_EVENT VARIABLE /end DAQ_EVENT
 /end IF_DATA
/end MEASUREMENT
/begin MEASUREMENT MoFEvMngt_nSpdEm01 "EM01 engine speed" SWORD nmot_q1 1 100 -32768.00 32767.00 FORMAT "%8.2" ECU_ADDRESS 0x6002C924
 /begin IF_DATA XCPplus 0x0102
  /begin DAQ_EVENT VARIABLE /end DAQ_EVENT
 /end IF_DATA
/end MEASUREMENT
/begin MEASUREMENT MoFEvMngt_nSpdEm01Cpl "complement of EM01engine speed" UWORD OneToOne 1 100 0.00 65535.00 FORMAT "%8.2" ECU_ADDRESS 0x6002BEC4
 /begin IF_DATA XCPplus 0x0102
  /begin DAQ_EVENT VARIABLE /end DAQ_EVENT
 /end IF_DATA
/end MEASUREMENT
/begin MEASUREMENT MoFEvMngt_nSpdEm02 "EM02 engine speed" SWORD nmot_q1 1 100 -32768.00 32767.00 FORMAT "%8.2" ECU_ADDRESS 0x6002C922
 /begin IF_DATA XCPplus 0x0102
  /begin DAQ_EVENT VARIABLE /end DAQ_EVENT
 /end IF_DATA
/end MEASUREMENT
/begin MEASUREMENT MoFEvMngt_nSpdEm02Cpl "Complement of EM02 engine speed" UWORD OneToOne 1 100 0.00 65535.00 FORMAT "%8.2" ECU_ADDRESS 0x6002BEC2
 /begin IF_DATA XCPplus 0x0102
  /begin DAQ_EVENT VARIABLE /end DAQ_EVENT
 /end IF_DATA
/end MEASUREMENT
/begin MEASUREMENT MoFEvMngt_ptrEmFlt1Lo01 "internal Filter value of PT1" UWORD OneToOne 1 100 0.00 65535.00 FORMAT "%8.2" ECU_ADDRESS 0x6002C920
 /begin IF_DATA XCPplus 0x0102
  /begin DAQ_EVENT VARIABLE /end DAQ_EVENT
 /end IF_DATA
/end MEASUREMENT
/begin MEASUREMENT MoFEvMngt_ptrEmFlt1Lo01Cpl "complement: internal Filter value of PT1" UWORD OneToOne 1 100 0.00 65535.00 FORMAT "%8.2" ECU_ADDRESS 0x6002BEC0
 /begin IF_DATA XCPplus 0x0102
  /begin DAQ_EVENT VARIABLE /end DAQ_EVENT
 /end IF_DATA
/end MEASUREMENT
/begin MEASUREMENT MoFEvMngt_ptrEmFlt1Lo02 "internal Filter value of PT1" UWORD OneToOne 1 100 0.00 65535.00 FORMAT "%8.2" ECU_ADDRESS 0x6002C91E
 /begin IF_DATA XCPplus 0x0102
  /begin DAQ_EVENT VARIABLE /end DAQ_EVENT
 /end IF_DATA
/end MEASUREMENT
/begin MEASUREMENT MoFEvMngt_ptrEmFlt1Lo02Cpl "RAM Data Redundancy for MoFEvMngt_ptrEmFlt1Lo02" UWORD OneToOne 1 100 0.00 65535.00 FORMAT "%8.2" ECU_ADDRESS 0x6002BEBE
 /begin IF_DATA XCPplus 0x0102
  /begin DAQ_EVENT VARIABLE /end DAQ_EVENT
 /end IF_DATA
/end MEASUREMENT
/begin MEASUREMENT MoFEvMngt_ptrEmFlt2Lo01 "internal Filter value of PT1" UWORD OneToOne 1 100 0.00 65535.00 FORMAT "%8.2" ECU_ADDRESS 0x6002C91C
 /begin IF_DATA XCPplus 0x0102
  /begin DAQ_EVENT VARIABLE /end DAQ_EVENT
 /end IF_DATA
/end MEASUREMENT
/begin MEASUREMENT MoFEvMngt_ptrEmFlt2Lo01Cpl "complement: internal Filter value of PT1" UWORD OneToOne 1 100 0.00 65535.00 FORMAT "%8.2" ECU_ADDRESS 0x6002BEBC
 /begin IF_DATA XCPplus 0x0102
  /begin DAQ_EVENT VARIABLE /end DAQ_EVENT
 /end IF_DATA
/end MEASUREMENT
/begin MEASUREMENT MoFEvMngt_ptrEmFlt2Lo02 "internal Filter value of PT1" UWORD OneToOne 1 100 0.00 65535.00 FORMAT "%8.2" ECU_ADDRESS 0x6002C91A
 /begin IF_DATA XCPplus 0x0102
  /begin DAQ_EVENT VARIABLE /end DAQ_EVENT
 /end IF_DATA
/end MEASUREMENT
/begin MEASUREMENT MoFEvMngt_ptrEmFlt2Lo02Cpl "RAM Data Redundancy for MoFEvMngt_ptrEmFlt2Lo02" UWORD OneToOne 1 100 0.00 65535.00 FORMAT "%8.2" ECU_ADDRESS 0x6002BEBA
 /begin IF_DATA XCPplus 0x0102
  /begin DAQ_EVENT VARIABLE /end DAQ_EVENT
 /end IF_DATA
/end MEASUREMENT
/begin MEASUREMENT MoFEvMngt_stActvDchaCntrVal "Variable to increment Active Discharge counter value" UWORD OneToOne 1 100 0.00 65535.00 FORMAT "%8.2" ECU_ADDRESS 0x6002C918
 /begin IF_DATA XCPplus 0x0102
  /begin DAQ_EVENT VARIABLE /end DAQ_EVENT
 /end IF_DATA
/end MEASUREMENT
/begin MEASUREMENT MoFEvMngt_stActvDchaCntrValCpl "Complement of MoFEvMngt_stActvDchaCntrVal" UWORD OneToOne 1 100 0.00 65535.00 FORMAT "%8.2" ECU_ADDRESS 0x6002BEB8
 /begin IF_DATA XCPplus 0x0102
  /begin DAQ_EVENT VARIABLE /end DAQ_EVENT
 /end IF_DATA
/end MEASUREMENT
/begin MEASUREMENT MoFEvMngt_stDcdcErrDeb "Debounced DCDC error status" UBYTE OneToOne 1 100 0.00 255.0 FORMAT "%5.1" ECU_ADDRESS 0x6002C9C9
 /begin IF_DATA XCPplus 0x0102
  /begin DAQ_EVENT VARIABLE /end DAQ_EVENT
 /end IF_DATA
/end MEASUREMENT
/begin MEASUREMENT MoFEvMngt_stDcdcErrDebCpl "Complement of MoFEvMngt_stDcdcErrDeb" UBYTE OneToOne 1 100 0.00 255.0 FORMAT "%5.1" ECU_ADDRESS 0x6002BF72
 /begin IF_DATA XCPplus 0x0102
  /begin DAQ_EVENT VARIABLE /end DAQ_EVENT
 /end IF_DATA
/end MEASUREMENT
/begin MEASUREMENT MoFEvMngt_stDcdcModReq "Requested DCDC operation mode from Function monitoring" UBYTE OneToOne 1 100 0.00 255.0 FORMAT "%5.1" ECU_ADDRESS 0x6002C9C6
 /begin IF_DATA XCPplus 0x0102
  /begin DAQ_EVENT VARIABLE /end DAQ_EVENT
 /end IF_DATA
/end MEASUREMENT
/begin MEASUREMENT MoFEvMngt_stDcdcModReqCpl "Complement of Requested DCDC operation mode from Function monitoring" UBYTE OneToOne 1 100 0.00 255.0 FORMAT "%5.1" ECU_ADDRESS 0x6002BF71
 /begin IF_DATA XCPplus 0x0102
  /begin DAQ_EVENT VARIABLE /end DAQ_EVENT
 /end IF_DATA
/end MEASUREMENT
/begin MEASUREMENT MoFEvMngt_stDebDesEem "State for MoFEvMngt_stDebDesEem" UBYTE OneToOne 1 100 0.00 255.0 FORMAT "%5.1" ECU_ADDRESS 0x6002C9B0
 /begin IF_DATA XCPplus 0x0102
  /begin DAQ_EVENT VARIABLE /end DAQ_EVENT
 /end IF_DATA
/end MEASUREMENT
/begin MEASUREMENT MoFEvMngt_stDebDesEemCpl "Complement for MoFEvMngt_stDebDesEem" UBYTE OneToOne 1 100 0.00 255.0 FORMAT "%5.1" ECU_ADDRESS 0x6002BF5A
 /begin IF_DATA XCPplus 0x0102
  /begin DAQ_EVENT VARIABLE /end DAQ_EVENT
 /end IF_DATA
/end MEASUREMENT
/begin MEASUREMENT MoFEvMngt_stDebFltBms1 "Debounce state for HvBatt Fault" UBYTE OneToOne 1 100 0.00 255.0 FORMAT "%5.1" ECU_ADDRESS 0x6002C9E0
 /begin IF_DATA XCPplus 0x0102
  /begin DAQ_EVENT VARIABLE /end DAQ_EVENT
 /end IF_DATA
/end MEASUREMENT
/begin MEASUREMENT MoFEvMngt_stDebFltBms1Cpl "Complement for MoFEvMngt_stDebFltBms1" UBYTE OneToOne 1 100 0.00 255.0 FORMAT "%5.1" ECU_ADDRESS 0x6002BF86
 /begin IF_DATA XCPplus 0x0102
  /begin DAQ_EVENT VARIABLE /end DAQ_EVENT
 /end IF_DATA
/end MEASUREMENT
/begin MEASUREMENT MoFEvMngt_stDebFltBms2 "Debounce state for HvBatt Fault" UBYTE OneToOne 1 100 0.00 255.0 FORMAT "%5.1" ECU_ADDRESS 0x6002C9DF
 /begin IF_DATA XCPplus 0x0102
  /begin DAQ_EVENT VARIABLE /end DAQ_EVENT
 /end IF_DATA
/end MEASUREMENT
/begin MEASUREMENT MoFEvMngt_stDebFltBms2Cpl "Complement for MoFEvMngt_stDebFltBms2" UBYTE OneToOne 1 100 0.00 255.0 FORMAT "%5.1" ECU_ADDRESS 0x6002BF85
 /begin IF_DATA XCPplus 0x0102
  /begin DAQ_EVENT VARIABLE /end DAQ_EVENT
 /end IF_DATA
/end MEASUREMENT
/begin MEASUREMENT MoFEvMngt_stDebFltBms3 "Debounce state for HvBatt Fault" UBYTE OneToOne 1 100 0.00 255.0 FORMAT "%5.1" ECU_ADDRESS 0x6002C9DE
 /begin IF_DATA XCPplus 0x0102
  /begin DAQ_EVENT VARIABLE /end DAQ_EVENT
 /end IF_DATA
/end MEASUREMENT
/begin MEASUREMENT MoFEvMngt_stDebFltBms3Cpl "Complement for MoFEvMngt_stDebFltBms3" UBYTE OneToOne 1 100 0.00 255.0 FORMAT "%5.1" ECU_ADDRESS 0x6002BF84
 /begin IF_DATA XCPplus 0x0102
  /begin DAQ_EVENT VARIABLE /end DAQ_EVENT
 /end IF_DATA
/end MEASUREMENT
/begin MEASUREMENT MoFEvMngt_stDebMemBms "Memory state for turn onoff HV Battery mode error debounce" UBYTE OneToOne 1 100 0.00 255.0 FORMAT "%5.1" ECU_ADDRESS 0x6002C9DD
 /begin IF_DATA XCPplus 0x0102
  /begin DAQ_EVENT VARIABLE /end DAQ_EVENT
 /end IF_DATA
/end MEASUREMENT
/begin MEASUREMENT MoFEvMngt_stDebMemBms1 "State for devbounce block1" UBYTE OneToOne 1 100 0.00 255.0 FORMAT "%5.1" ECU_ADDRESS 0x6002C9DC
 /begin IF_DATA XCPplus 0x0102
  /begin DAQ_EVENT VARIABLE /end DAQ_EVENT
 /end IF_DATA
/end MEASUREMENT
/begin MEASUREMENT MoFEvMngt_stDebMemBms1Cpl "Complement for MoFEvMngt_stDebMemBms1" UBYTE OneToOne 1 100 0.00 255.0 FORMAT "%5.1" ECU_ADDRESS 0x6002BF83
 /begin IF_DATA XCPplus 0x0102
  /begin DAQ_EVENT VARIABLE /end DAQ_EVENT
 /end IF_DATA
/end MEASUREMENT
/begin MEASUREMENT MoFEvMngt_stDebMemBms2 "State for devbounce block2" UBYTE OneToOne 1 100 0.00 255.0 FORMAT "%5.1" ECU_ADDRESS 0x6002C9DB
 /begin IF_DATA XCPplus 0x0102
  /begin DAQ_EVENT VARIABLE /end DAQ_EVENT
 /end IF_DATA
/end MEASUREMENT
/begin MEASUREMENT MoFEvMngt_stDebMemBms2Cpl "Complement for MoFEvMngt_stDebMemBms2" UBYTE OneToOne 1 100 0.00 255.0 FORMAT "%5.1" ECU_ADDRESS 0x6002BF82
 /begin IF_DATA XCPplus 0x0102
  /begin DAQ_EVENT VARIABLE /end DAQ_EVENT
 /end IF_DATA
/end MEASUREMENT
/begin MEASUREMENT MoFEvMngt_stDebMemBms3 "State for devbounce block3" UBYTE OneToOne 1 100 0.00 255.0 FORMAT "%5.1" ECU_ADDRESS 0x6002C9DA
 /begin IF_DATA XCPplus 0x0102
  /begin DAQ_EVENT VARIABLE /end DAQ_EVENT
 /end IF_DATA
/end MEASUREMENT
/begin MEASUREMENT MoFEvMngt_stDebMemBms3Cpl "Complement for MoFEvMngt_stDebMemBms3" UBYTE OneToOne 1 100 0.00 255.0 FORMAT "%5.1" ECU_ADDRESS 0x6002BF81
 /begin IF_DATA XCPplus 0x0102
  /begin DAQ_EVENT VARIABLE /end DAQ_EVENT
 /end IF_DATA
/end MEASUREMENT
/begin MEASUREMENT MoFEvMngt_stDebMemBmsCpl "RAM data redundancy for MoFEvMngt_stDebMemBms" UBYTE OneToOne 1 100 0.00 255.0 FORMAT "%5.1" ECU_ADDRESS 0x6002BF80
 /begin IF_DATA XCPplus 0x0102
  /begin DAQ_EVENT VARIABLE /end DAQ_EVENT
 /end IF_DATA
/end MEASUREMENT
/begin MEASUREMENT MoFEvMngt_stDebMemEm01 "Memory state for turn onoff inverter in mode-1 error debounce" UBYTE OneToOne 1 100 0.00 255.0 FORMAT "%5.1" ECU_ADDRESS 0x6002C9AF
 /begin IF_DATA XCPplus 0x0102
  /begin DAQ_EVENT VARIABLE /end DAQ_EVENT
 /end IF_DATA
/end MEASUREMENT
/begin MEASUREMENT MoFEvMngt_stDebMemEm01BrkgToZr1 "Memory state for turn onoff inverter in mode-1 error debounce for e-braking to zero functionality (errors present)" UBYTE OneToOne 1 100 0.00 255.0 FORMAT "%5.1" ECU_ADDRESS 0x6002C9AE
 /begin IF_DATA XCPplus 0x0102
  /begin DAQ_EVENT VARIABLE /end DAQ_EVENT
 /end IF_DATA
/end MEASUREMENT
/begin MEASUREMENT MoFEvMngt_stDebMemEm01BrkgToZr1Cpl "Complement of MoFEvMngt_stDebMemEm01BrkgToZr1" UBYTE OneToOne 1 100 0.00 255.0 FORMAT "%5.1" ECU_ADDRESS 0x6002BF59
 /begin IF_DATA XCPplus 0x0102
  /begin DAQ_EVENT VARIABLE /end DAQ_EVENT
 /end IF_DATA
/end MEASUREMENT
/begin MEASUREMENT MoFEvMngt_stDebMemEm01BrkgToZr2 "Memory state for turn onoff inverter in mode-1 error debounce for e-braking to zero functionality (active and no errors present)" UBYTE OneToOne 1 100 0.00 255.0 FORMAT "%5.1" ECU_ADDRESS 0x6002C9AD
 /begin IF_DATA XCPplus 0x0102
  /begin DAQ_EVENT VARIABLE /end DAQ_EVENT
 /end IF_DATA
/end MEASUREMENT
/begin MEASUREMENT MoFEvMngt_stDebMemEm01BrkgToZr2Cpl "Complement of MoFEvMngt_stDebMemEm01BrkgToZr2" UBYTE OneToOne 1 100 0.00 255.0 FORMAT "%5.1" ECU_ADDRESS 0x6002BF58
 /begin IF_DATA XCPplus 0x0102
  /begin DAQ_EVENT VARIABLE /end DAQ_EVENT
 /end IF_DATA
/end MEASUREMENT
/begin MEASUREMENT MoFEvMngt_stDebMemEm01Cpl "RAM data redundancy for MoFEvMngt_stDebMemEm01" UBYTE OneToOne 1 100 0.00 255.0 FORMAT "%5.1" ECU_ADDRESS 0x6002BF57
 /begin IF_DATA XCPplus 0x0102
  /begin DAQ_EVENT VARIABLE /end DAQ_EVENT
 /end IF_DATA
/end MEASUREMENT
/begin MEASUREMENT MoFEvMngt_stDebMemEm02 "Memory state for turn onoff inverter in mode-2 error debounce" UBYTE OneToOne 1 100 0.00 255.0 FORMAT "%5.1" ECU_ADDRESS 0x6002C9AC
 /begin IF_DATA XCPplus 0x0102
  /begin DAQ_EVENT VARIABLE /end DAQ_EVENT
 /end IF_DATA
/end MEASUREMENT
/begin MEASUREMENT MoFEvMngt_stDebMemEm02Cpl "RAM data redundancy for MoFEvMngt_stDebMemEm02" UBYTE OneToOne 1 100 0.00 255.0 FORMAT "%5.1" ECU_ADDRESS 0x6002BF56
 /begin IF_DATA XCPplus 0x0102
  /begin DAQ_EVENT VARIABLE /end DAQ_EVENT
 /end IF_DATA
/end MEASUREMENT
/begin MEASUREMENT MoFEvMngt_stDebMemEm02SafeInvtr "Memory state for turn onoff inverter in mode-2 error debounce for safe inverter sate" UBYTE OneToOne 1 100 0.00 255.0 FORMAT "%5.1" ECU_ADDRESS 0x6002C9AB
 /begin IF_DATA XCPplus 0x0102
  /begin DAQ_EVENT VARIABLE /end DAQ_EVENT
 /end IF_DATA
/end MEASUREMENT
/begin MEASUREMENT MoFEvMngt_stDebMemEm02SafeInvtrCpl "Complement of MoFEvMngt_stDebMemEm02SafeInvtr" UBYTE OneToOne 1 100 0.00 255.0 FORMAT "%5.1" ECU_ADDRESS 0x6002BF55
 /begin IF_DATA XCPplus 0x0102
  /begin DAQ_EVENT VARIABLE /end DAQ_EVENT
 /end IF_DATA
/end MEASUREMENT
/begin MEASUREMENT MofEvMngt_stDesDcdcLvl1 "Desired operating mode of the DCDC converter received from Level 1" UBYTE OneToOne 1 100 0.00 255.0 FORMAT "%5.1" ECU_ADDRESS 0x6002C9C8
 /begin IF_DATA XCPplus 0x0102
  /begin DAQ_EVENT VARIABLE /end DAQ_EVENT
 /end IF_DATA
/end MEASUREMENT
/begin MEASUREMENT MofEvMngt_stDesDcdcLvl1Cpl "Complement of Desired operating mode of the DCDC converter received from Level 1" UBYTE OneToOne 1 100 0.00 255.0 FORMAT "%5.1" ECU_ADDRESS 0x6002BF70
 /begin IF_DATA XCPplus 0x0102
  /begin DAQ_EVENT VARIABLE /end DAQ_EVENT
 /end IF_DATA
/end MEASUREMENT
/begin MEASUREMENT MoFEvMngt_stDesEem01 "Desired state of inverter and e-machine 01 in level 2" UBYTE OneToOne 1 100 0.00 255.0 FORMAT "%5.1" ECU_ADDRESS 0x6002C9A0
 /begin IF_DATA XCPplus 0x0102
  /begin DAQ_EVENT VARIABLE /end DAQ_EVENT
 /end IF_DATA
/end MEASUREMENT
/begin MEASUREMENT MoFEvMngt_stDesEem01BrkgToZrLvl2 "Desired state of inverter and e-machine 01 in level 2 after evaluation of errors in the e-braking to zero functionality" UBYTE OneToOne 1 100 0.00 255.0 FORMAT "%5.1" ECU_ADDRESS 0x6002C9AA
 /begin IF_DATA XCPplus 0x0102
  /begin DAQ_EVENT VARIABLE /end DAQ_EVENT
 /end IF_DATA
/end MEASUREMENT
/begin MEASUREMENT MoFEvMngt_stDesEem01BrkgToZrLvl2Cpl "Complement of MoFEvMngt_stDesEem01BrkgToZrLvl2" UBYTE OneToOne 1 100 0.00 255.0 FORMAT "%5.1" ECU_ADDRESS 0x6002BF54
 /begin IF_DATA XCPplus 0x0102
  /begin DAQ_EVENT VARIABLE /end DAQ_EVENT
 /end IF_DATA
/end MEASUREMENT
/begin MEASUREMENT MoFEvMngt_stDesEem01Cpl "Complement variable of MoFEvMngt_stDesEem01" UBYTE OneToOne 1 100 0.00 255.0 FORMAT "%5.1" ECU_ADDRESS 0x6002BF53
 /begin IF_DATA XCPplus 0x0102
  /begin DAQ_EVENT VARIABLE /end DAQ_EVENT
 /end IF_DATA
/end MEASUREMENT
/begin MEASUREMENT MoFEvMngt_stDesEem01HvLvl2 "Desired state of inverter and e-machine 01 in level 2 after evaluation of high voltage errors" UBYTE OneToOne 1 100 0.00 255.0 FORMAT "%5.1" ECU_ADDRESS 0x6002C9A9
 /begin IF_DATA XCPplus 0x0102
  /begin DAQ_EVENT VARIABLE /end DAQ_EVENT
 /end IF_DATA
/end MEASUREMENT
/begin MEASUREMENT MoFEvMngt_stDesEem01HvLvl2Cpl "Complement of MoFEvMngt_stDesEem01HvLvl2" UBYTE OneToOne 1 100 0.00 255.0 FORMAT "%5.1" ECU_ADDRESS 0x6002BF52
 /begin IF_DATA XCPplus 0x0102
  /begin DAQ_EVENT VARIABLE /end DAQ_EVENT
 /end IF_DATA
/end MEASUREMENT
/begin MEASUREMENT MoFEvMngt_stDesEem01Lvl1 "Desired state of inverter and e-machine 01" UBYTE OneToOne 1 100 0.00 255.0 FORMAT "%5.1" ECU_ADDRESS 0x6002C9A8
 /begin IF_DATA XCPplus 0x0102
  /begin DAQ_EVENT VARIABLE /end DAQ_EVENT
 /end IF_DATA
/end MEASUREMENT
/begin MEASUREMENT MoFEvMngt_stDesEem01Lvl1Cpl "complement of MoFEvMngt_stDesEem01Lvl1" UBYTE OneToOne 1 100 0.00 255.0 FORMAT "%5.1" ECU_ADDRESS 0x6002BF51
 /begin IF_DATA XCPplus 0x0102
  /begin DAQ_EVENT VARIABLE /end DAQ_EVENT
 /end IF_DATA
/end MEASUREMENT
/begin MEASUREMENT MoFEvMngt_stDesEem02 "Desired state of inverter and e-machine 02 in level 2" UBYTE OneToOne 1 100 0.00 255.0 FORMAT "%5.1" ECU_ADDRESS 0x6002C99F
 /begin IF_DATA XCPplus 0x0102
  /begin DAQ_EVENT VARIABLE /end DAQ_EVENT
 /end IF_DATA
/end MEASUREMENT
/begin MEASUREMENT MoFEvMngt_stDesEem02Cpl "Complement variable of MoFEvMngt_stDesEem02" UBYTE OneToOne 1 100 0.00 255.0 FORMAT "%5.1" ECU_ADDRESS 0x6002BF50
 /begin IF_DATA XCPplus 0x0102
  /begin DAQ_EVENT VARIABLE /end DAQ_EVENT
 /end IF_DATA
/end MEASUREMENT
/begin MEASUREMENT MoFEvMngt_stDesEem02HvLvl2 "Desired state of inverter and e-machine 02 in level 2 after evaluation of high voltage errors" UBYTE OneToOne 1 100 0.00 255.0 FORMAT "%5.1" ECU_ADDRESS 0x6002C9A7
 /begin IF_DATA XCPplus 0x0102
  /begin DAQ_EVENT VARIABLE /end DAQ_EVENT
 /end IF_DATA
/end MEASUREMENT
/begin MEASUREMENT MoFEvMngt_stDesEem02HvLvl2Cpl "Complement of MoFEvMngt_stDesEem02HvLvl2" UBYTE OneToOne 1 100 0.00 255.0 FORMAT "%5.1" ECU_ADDRESS 0x6002BF4F
 /begin IF_DATA XCPplus 0x0102
  /begin DAQ_EVENT VARIABLE /end DAQ_EVENT
 /end IF_DATA
/end MEASUREMENT
/begin MEASUREMENT MoFEvMngt_stDesEem02Lvl1 "Desired state of inverter and e-machine 02" UBYTE OneToOne 1 100 0.00 255.0 FORMAT "%5.1" ECU_ADDRESS 0x6002C9A6
 /begin IF_DATA XCPplus 0x0102
  /begin DAQ_EVENT VARIABLE /end DAQ_EVENT
 /end IF_DATA
/end MEASUREMENT
/begin MEASUREMENT MoFEvMngt_stDesEem02Lvl1Cpl "complement of MoFEvMngt_stDesEem02Lvl1" UBYTE OneToOne 1 100 0.00 255.0 FORMAT "%5.1" ECU_ADDRESS 0x6002BF4E
 /begin IF_DATA XCPplus 0x0102
  /begin DAQ_EVENT VARIABLE /end DAQ_EVENT
 /end IF_DATA
/end MEASUREMENT
/begin MEASUREMENT MoFEvMngt_stElMDesEem "State for MoFEvMngt_stElMDesEem" UBYTE OneToOne 1 100 0.00 255.0 FORMAT "%5.1" ECU_ADDRESS 0x6002C99E
 /begin IF_DATA XCPplus 0x0102
  /begin DAQ_EVENT VARIABLE /end DAQ_EVENT
 /end IF_DATA
/end MEASUREMENT
/begin MEASUREMENT MoFEvMngt_stElMDesEem01Lvl1 "Level1 Active Discharge value" UBYTE OneToOne 1 100 0.00 255.0 FORMAT "%5.1" ECU_ADDRESS 0x6002C9A5
 /begin IF_DATA XCPplus 0x0102
  /begin DAQ_EVENT VARIABLE /end DAQ_EVENT
 /end IF_DATA
/end MEASUREMENT
/begin MEASUREMENT MoFEvMngt_stElMDesEem01Lvl1Cpl "Complement of MoFEvMngt_stElMDesEem01Lvl1" UBYTE OneToOne 1 100 0.00 255.0 FORMAT "%5.1" ECU_ADDRESS 0x6002BF4D
 /begin IF_DATA XCPplus 0x0102
  /begin DAQ_EVENT VARIABLE /end DAQ_EVENT
 /end IF_DATA
/end MEASUREMENT
/begin MEASUREMENT MoFEvMngt_stElMDesEemCpl "Complement for MoFEvMngt_stElMDesEem" UBYTE OneToOne 1 100 0.00 255.0 FORMAT "%5.1" ECU_ADDRESS 0x6002BF4C
 /begin IF_DATA XCPplus 0x0102
  /begin DAQ_EVENT VARIABLE /end DAQ_EVENT
 /end IF_DATA
/end MEASUREMENT
/begin MEASUREMENT MoFEvMngt_stErrEmSig "Export CAN error status" UBYTE OneToOne 1 100 0.00 255.0 FORMAT "%5.1" ECU_ADDRESS 0x6002C99D
 /begin IF_DATA XCPplus 0x0102
  /begin DAQ_EVENT VARIABLE /end DAQ_EVENT
 /end IF_DATA
/end MEASUREMENT
/begin MEASUREMENT MoFEvMngt_stErrEmSig02 "CAN Error status for speed of E-Machine 02" UBYTE OneToOne 1 100 0.00 255.0 FORMAT "%5.1" ECU_ADDRESS 0x6002C99C
 /begin IF_DATA XCPplus 0x0102
  /begin DAQ_EVENT VARIABLE /end DAQ_EVENT
 /end IF_DATA
/end MEASUREMENT
/begin MEASUREMENT MoFEvMngt_stErrEmSig02Cpl "Complement: CAN Error status for speed of E-Machine 02" UBYTE OneToOne 1 100 0.00 255.0 FORMAT "%5.1" ECU_ADDRESS 0x6002BF4B
 /begin IF_DATA XCPplus 0x0102
  /begin DAQ_EVENT VARIABLE /end DAQ_EVENT
 /end IF_DATA
/end MEASUREMENT
/begin MEASUREMENT MoFEvMngt_stErrEmSigCpl "RAM data redundancy for MoFEvMngt_stErrEmSig" UBYTE OneToOne 1 100 0.00 255.0 FORMAT "%5.1" ECU_ADDRESS 0x6002BF4A
 /begin IF_DATA XCPplus 0x0102
  /begin DAQ_EVENT VARIABLE /end DAQ_EVENT
 /end IF_DATA
/end MEASUREMENT
/begin MEASUREMENT MoFEvMngt_stErrEngSpdEm01 "EM01 engine speed CAN error status" UBYTE OneToOne 1 100 0.00 255.0 FORMAT "%5.1" ECU_ADDRESS 0x6002C9A4
 /begin IF_DATA XCPplus 0x0102
  /begin DAQ_EVENT VARIABLE /end DAQ_EVENT
 /end IF_DATA
/end MEASUREMENT
/begin MEASUREMENT MoFEvMngt_stErrEngSpdEm01Cpl "Complement of MoFEvMngt_stErrEngSpdEm01" UBYTE OneToOne 1 100 0.00 255.0 FORMAT "%5.1" ECU_ADDRESS 0x6002BF49
 /begin IF_DATA XCPplus 0x0102
  /begin DAQ_EVENT VARIABLE /end DAQ_EVENT
 /end IF_DATA
/end MEASUREMENT
/begin MEASUREMENT MoFEvMngt_stErrEngSpdEm02 "EM02 engine speed CAN error status" UBYTE OneToOne 1 100 0.00 255.0 FORMAT "%5.1" ECU_ADDRESS 0x6002C9A3
 /begin IF_DATA XCPplus 0x0102
  /begin DAQ_EVENT VARIABLE /end DAQ_EVENT
 /end IF_DATA
/end MEASUREMENT
/begin MEASUREMENT MoFEvMngt_stErrEngSpdEm02Cpl "Complement of MoFEvMngt_stErrEngSpdEm02" UBYTE OneToOne 1 100 0.00 255.0 FORMAT "%5.1" ECU_ADDRESS 0x6002BF48
 /begin IF_DATA XCPplus 0x0102
  /begin DAQ_EVENT VARIABLE /end DAQ_EVENT
 /end IF_DATA
/end MEASUREMENT
/begin MEASUREMENT MoFEvMngt_stOperModDes "Requested HV Battery mode in function monitoring" UBYTE OneToOne 1 100 0.00 255.0 FORMAT "%5.1" ECU_ADDRESS 0x6002C9D6
 /begin IF_DATA XCPplus 0x0102
  /begin DAQ_EVENT VARIABLE /end DAQ_EVENT
 /end IF_DATA
/end MEASUREMENT
/begin MEASUREMENT MoFEvMngt_stOperModDesBmsLvl1 "desired battery operation mode" UBYTE OneToOne 1 100 0.00 255.0 FORMAT "%5.1" ECU_ADDRESS 0x6002C9D9
 /begin IF_DATA XCPplus 0x0102
  /begin DAQ_EVENT VARIABLE /end DAQ_EVENT
 /end IF_DATA
/end MEASUREMENT
/begin MEASUREMENT MoFEvMngt_stOperModDesBmsLvl1Cpl "Complement of MoFEvMngt_stOperModDesBmsLvl1" UBYTE OneToOne 1 100 0.00 255.0 FORMAT "%5.1" ECU_ADDRESS 0x6002BF7F
 /begin IF_DATA XCPplus 0x0102
  /begin DAQ_EVENT VARIABLE /end DAQ_EVENT
 /end IF_DATA
/end MEASUREMENT
/begin MEASUREMENT MoFEvMngt_stOperModDesCpl "RAM data redundancy for MoFEvMngt_stOperModDes" UBYTE OneToOne 1 100 0.00 255.0 FORMAT "%5.1" ECU_ADDRESS 0x6002BF7E
 /begin IF_DATA XCPplus 0x0102
  /begin DAQ_EVENT VARIABLE /end DAQ_EVENT
 /end IF_DATA
/end MEASUREMENT
/begin MEASUREMENT MoFEvMngt_TAdcSnsrVal "Temperature for Adc Sensor val" SWORD RBPtCel_t_1p0_3 1 100 -32768.00 32767.00 FORMAT "%8.2" ECU_ADDRESS 0x6002C9D4
 /begin IF_DATA XCPplus 0x0102
  /begin DAQ_EVENT VARIABLE /end DAQ_EVENT
 /end IF_DATA
/end MEASUREMENT
/begin MEASUREMENT MoFEvMngt_TAdcSnsrValCpl "Complement for Temperature for Adc Sensor val" UWORD OneToOne 1 100 0.00 65535.00 FORMAT "%8.2" ECU_ADDRESS 0x6002BF7C
 /begin IF_DATA XCPplus 0x0102
  /begin DAQ_EVENT VARIABLE /end DAQ_EVENT
 /end IF_DATA
/end MEASUREMENT
/begin MEASUREMENT MoFEvMngt_uAdcCnvrVal "ADC converted value from raw digital value to Volts" UWORD spg_q0p00488 1 100 0.00 319.9951 FORMAT "%8.4" ECU_ADDRESS 0x6002C9D2
 /begin IF_DATA XCPplus 0x0102
  /begin DAQ_EVENT VARIABLE /end DAQ_EVENT
 /end IF_DATA
/end MEASUREMENT
/begin MEASUREMENT MoFEvMngt_uAdcCnvrValCpl "Complement for MoFEvMngt_uAdcCnvrVal" UWORD OneToOne 1 100 0.00 65535.00 FORMAT "%8.2" ECU_ADDRESS 0x6002BF7A
 /begin IF_DATA XCPplus 0x0102
  /begin DAQ_EVENT VARIABLE /end DAQ_EVENT
 /end IF_DATA
/end MEASUREMENT
/begin MEASUREMENT MoFExtCptAuxCpt_bbLocCpl "RAM data redundancy for MoFExtCptAuxCpt_bbLoc" UBYTE OneToOne 1 100 0.00 255.0 FORMAT "%5.1" ECU_ADDRESS 0x6002BEA3
 /begin IF_DATA XCPplus 0x0102
  /begin DAQ_EVENT VARIABLE /end DAQ_EVENT
 /end IF_DATA
/end MEASUREMENT
/begin MEASUREMENT MoFExtCptAuxCpt_bbOutCpl "RAM data redundancy for MoFExtCptAuxCpt_bbOut" UBYTE OneToOne 1 100 0.00 255.0 FORMAT "%5.1" ECU_ADDRESS 0x6002BEA2
 /begin IF_DATA XCPplus 0x0102
  /begin DAQ_EVENT VARIABLE /end DAQ_EVENT
 /end IF_DATA
/end MEASUREMENT
/begin MEASUREMENT MoFExtCpt_AuxCpt_DataDebErrReactn_I.cntErrDeb "Error handling class instance to debounce error and handle error reaction / Debounce count in class DataDeb with error reaction." UWORD OneToOne 1 100 0.00 65535.00 FORMAT "%8.2" ECU_ADDRESS 0x6002C8E4 /end MEASUREMENT
/begin MEASUREMENT MoFExtCpt_AuxCpt_DataDebErrReactn_I.cntErrDebCpl "Error handling class instance to debounce error and handle error reaction / Complement for debounce count for class DataDeb with error reaction." UWORD OneToOne 1 100 0.00 65535.00 FORMAT "%8.2" ECU_ADDRESS 0x6002BE98 /end MEASUREMENT
/begin MEASUREMENT MoFExtCpt_AuxCpt_DataDebErrReactn_I.stErrDeb "Error handling class instance to debounce error and handle error reaction / Status of debounced error in class DataDeb with error reaction." UBYTE OneToOne 1 100 0.00 255.0 FORMAT "%5.1" ECU_ADDRESS 0x6002C8E6 /end MEASUREMENT
/begin MEASUREMENT MoFExtCpt_AuxCpt_DataDebErrReactn_I.stErrDebCpl "Error handling class instance to debounce error and handle error reaction / Complement for status of debounced error in class DataDeb with error reaction." UBYTE OneToOne 1 100 0.00 255.0 FORMAT "%5.1" ECU_ADDRESS 0x6002BE9A /end MEASUREMENT
/begin MEASUREMENT MoFExtCpt_AuxCpt_DataDebErrReactn_I.stErrLockRels "Error handling class instance to debounce error and handle error reaction / Status of lock release class DataDeb with error reaction." UBYTE OneToOne 1 100 0.00 255.0 FORMAT "%5.1" ECU_ADDRESS 0x6002C8E7 /end MEASUREMENT
/begin MEASUREMENT MoFExtCpt_AuxCpt_DataDebErrReactn_I.stErrLockRelsCpl "Error handling class instance to debounce error and handle error reaction / Complement for Status of lock release class DataDeb with error reaction." UBYTE OneToOne 1 100 0.00 255.0 FORMAT "%5.1" ECU_ADDRESS 0x6002BE9B /end MEASUREMENT
/begin MEASUREMENT MoFExtCpt_AuxCpt_DataDebErrReactn_I.stErrReactn "Error handling class instance to debounce error and handle error reaction / Status of error reaction in class DataDeb with error reaction." UBYTE OneToOne 1 100 0.00 255.0 FORMAT "%5.1" ECU_ADDRESS 0x6002C8E8 /end MEASUREMENT
/begin MEASUREMENT MoFExtCpt_cntrDiagSetCyc "Debounce counter for condition tested status (cycle flag) for diagnosis in function MoFExtCpt_AuxCpt of function monitoring" UBYTE OneToOne 1 100 0.00 255.0 FORMAT "%5.1" ECU_ADDRESS 0x60023122
 /begin IF_DATA XCPplus 0x0102
  /begin DAQ_EVENT VARIABLE /end DAQ_EVENT
 /end IF_DATA
/end MEASUREMENT
/begin MEASUREMENT MoFExtCpt_cntrTurnOnOffDly "Debounce counter for power supply error when it transits False to True and vice versa" UBYTE OneToOne 1 100 0.00 255.0 FORMAT "%5.1" ECU_ADDRESS 0x6002C8F0
 /begin IF_DATA XCPplus 0x0102
  /begin DAQ_EVENT VARIABLE /end DAQ_EVENT
 /end IF_DATA
/end MEASUREMENT
/begin MEASUREMENT MoFExtCpt_cntrTurnOnOffDlyCpl "RAM data redundancy for MoFExtCpt_cntrTurnOnOffDly" UBYTE OneToOne 1 100 0.00 255.0 FORMAT "%5.1" ECU_ADDRESS 0x6002BEA1
 /begin IF_DATA XCPplus 0x0102
  /begin DAQ_EVENT VARIABLE /end DAQ_EVENT
 /end IF_DATA
/end MEASUREMENT
/begin MEASUREMENT MoFExtCpt_flgDiagSetCyc "Condition tested status (cycle flag) for diagnosis infunction MoFExtCpt_AuxCpt of function monitoring" UBYTE B_TRUE 1 100 0.00 1.00000000000 BIT_MASK 0x1 FORMAT "%13.11" ECU_ADDRESS 0x70000121
 /begin IF_DATA XCPplus 0x0102
  /begin DAQ_EVENT VARIABLE /end DAQ_EVENT
 /end IF_DATA
/end MEASUREMENT
/begin MEASUREMENT MoFExtCpt_flgDSMClr "Condition DSM clearing in function monitoring" UBYTE B_TRUE 1 100 0.00 1.00000000000 BIT_MASK 0x1 FORMAT "%13.11" ECU_ADDRESS 0x70000120
 /begin IF_DATA XCPplus 0x0102
  /begin DAQ_EVENT VARIABLE /end DAQ_EVENT
 /end IF_DATA
/end MEASUREMENT
/begin MEASUREMENT MoFExtCpt_flgErrLvPwrSply "Power Supply Error" UBYTE B_TRUE 1 100 0.00 1.00000000000 BIT_MASK 0x1 FORMAT "%13.11" ECU_ADDRESS 0x6002C8EE
 /begin IF_DATA XCPplus 0x0102
  /begin DAQ_EVENT VARIABLE /end DAQ_EVENT
 /end IF_DATA
/end MEASUREMENT
/begin MEASUREMENT MoFExtCpt_flgErrLvPwrSplyDeb "Debounced Power Supply Error" UBYTE B_TRUE 1 100 0.00 1.00000000000 BIT_MASK 0x1 FORMAT "%13.11" ECU_ADDRESS 0x6002C8F1
 /begin IF_DATA XCPplus 0x0102
  /begin DAQ_EVENT VARIABLE /end DAQ_EVENT
 /end IF_DATA
/end MEASUREMENT
/begin MEASUREMENT MoFExtCpt_flgErrLvPwrSplyDifMsg "Flag to indicate power supply error in function monitoring is set and power supply error from function level(Level 1) is not set" UBYTE B_TRUE 1 100 0.00 1.00000000000 BIT_MASK 0x1 FORMAT "%13.11" ECU_ADDRESS 0x7000023C
 /begin IF_DATA XCPplus 0x0102
  /begin DAQ_EVENT VARIABLE /end DAQ_EVENT
 /end IF_DATA
/end MEASUREMENT
/begin MEASUREMENT MoFExtCpt_flgErrLvPwrSplyMsg "Power Supply Error to function level(Level 1)" UBYTE B_TRUE 1 100 0.00 1.00000000000 BIT_MASK 0x1 FORMAT "%13.11" ECU_ADDRESS 0x7000023B
 /begin IF_DATA XCPplus 0x0102
  /begin DAQ_EVENT VARIABLE /end DAQ_EVENT
 /end IF_DATA
/end MEASUREMENT
/begin MEASUREMENT MoFExtCpt_flgErrLvPwrSplyRaw "Flag to indicate power supply error before debouncing" UBYTE B_TRUE 1 100 0.00 1.00000000000 BIT_MASK 0x2 FORMAT "%13.11" ECU_ADDRESS 0x6002C8F1
 /begin IF_DATA XCPplus 0x0102
  /begin DAQ_EVENT VARIABLE /end DAQ_EVENT
 /end IF_DATA
/end MEASUREMENT
/begin MEASUREMENT MoFExtCpt_flgUSofAsilErr "Flag to indicate remaining battery voltage is less than threshold or invalid voltage value occurance" UBYTE B_TRUE 1 100 0.00 1.00000000000 BIT_MASK 0x4 FORMAT "%13.11" ECU_ADDRESS 0x6002C8F1
 /begin IF_DATA XCPplus 0x0102
  /begin DAQ_EVENT VARIABLE /end DAQ_EVENT
 /end IF_DATA
/end MEASUREMENT
/begin MEASUREMENT MoFExtCpt_stDebMemAuxCpt "Memory state for turn onoff power supply error debounce." UBYTE OneToOne 1 100 0.00 255.0 FORMAT "%5.1" ECU_ADDRESS 0x6002C8EF
 /begin IF_DATA XCPplus 0x0102
  /begin DAQ_EVENT VARIABLE /end DAQ_EVENT
 /end IF_DATA
/end MEASUREMENT
/begin MEASUREMENT MoFExtCpt_stDebMemAuxCptCpl "RAM data redundancy for MoFExtCpt_stDebMemAuxCpt" UBYTE OneToOne 1 100 0.00 255.0 FORMAT "%5.1" ECU_ADDRESS 0x6002BEA0
 /begin IF_DATA XCPplus 0x0102
  /begin DAQ_EVENT VARIABLE /end DAQ_EVENT
 /end IF_DATA
/end MEASUREMENT
/begin MEASUREMENT MoFExtCpt_stSofAsilRawInvld "Logical value of remaining battery voltage in function monitoring" UWORD OneToOne 1 100 0.00 65535.00 FORMAT "%8.2" ECU_ADDRESS 0x6002C8EC
 /begin IF_DATA XCPplus 0x0102
  /begin DAQ_EVENT VARIABLE /end DAQ_EVENT
 /end IF_DATA
/end MEASUREMENT
/begin MEASUREMENT MoFExtCpt_stSofAsilRawInvldCpl "RAM data redundancy for MoFExtCpt_stSofAsilRawInvld" UWORD OneToOne 1 100 0.00 65535.00 FORMAT "%8.2" ECU_ADDRESS 0x6002BE9E
 /begin IF_DATA XCPplus 0x0102
  /begin DAQ_EVENT VARIABLE /end DAQ_EVENT
 /end IF_DATA
/end MEASUREMENT
/begin MEASUREMENT MoFExtCpt_uSofAsilRmn "Remaining battery voltage value calculated in function monitoring" UWORD spg_q0p0625_V 1 100 0.00 4095.938 FORMAT "%8.3" ECU_ADDRESS 0x6002C8EA
 /begin IF_DATA XCPplus 0x0102
  /begin DAQ_EVENT VARIABLE /end DAQ_EVENT
 /end IF_DATA
/end MEASUREMENT
/begin MEASUREMENT MoFExtCpt_uSofAsilRmnCpl "RAM data redundancy for MoFExtCpt_uSofAsilRmn" UWORD OneToOne 1 100 0.00 65535.00 FORMAT "%8.2" ECU_ADDRESS 0x6002BE9C
 /begin IF_DATA XCPplus 0x0102
  /begin DAQ_EVENT VARIABLE /end DAQ_EVENT
 /end IF_DATA
/end MEASUREMENT
/begin FUNCTION MoFEvMngt_Bms "3.0.1     Function monitoring Battery management"
 /begin DEF_CHARACTERISTIC DFC_CtlMsk2.DFC_MoFEvMngtBms_C DFC_DisblMsk2.DFC_MoFEvMngtBms_C MoFEvMngt_AdcDefVal_C MoFEvMngt_ADCSnsrCnvr_T MoFEvMngt_AdcSnsrEna_C MoFEvMngt_Bms_DataDebErrReactn_I.cntErrDebMax_C MoFEvMngt_Bms_DataDebErrReactn_I.stCfgErrHndlg_C MoFEvMngt_Bms_DataDebErrReactn_I.stCfgErrReactn_C MoFEvMngt_cntrClsFltBms1_C MoFEvMngt_cntrClsFltBms2_C MoFEvMngt_cntrClsFltBms3_C MoFEvMngt_cntrClsMaxBms1_C MoFEvMngt_cntrClsMaxBms2_C MoFEvMngt_cntrClsMaxBms3_C MoFEvMngt_cntrClsMaxBms_C MoFEvMngt_cntrOpnFltBms1_C MoFEvMngt_cntrOpnFltBms2_C MoFEvMngt_cntrOpnFltBms3_C MoFEvMngt_cntrOpnMaxBms1_C MoFEvMngt_cntrOpnMaxBms2_C MoFEvMngt_cntrOpnMaxBms3_C MoFEvMngt_cntrOpnMaxBms_C MoFEvMngt_flgEmgyShtActv_C MoFEvMngt_flgFstHvShdwn_C MoFEvMngt_stBmsCritMod1_C MoFEvMngt_stBmsCritMod2_C MoFEvMngt_stBmsCritMod3_C MoFEvMngt_stBmsCritMod4_C MoFEvMngt_stDcdcFltLvl1_C MoFEvMngt_stDcdcFltLvl2_C MoFEvMngt_stHvbFltLvl1_C MoFEvMngt_stHvbFltLvl2_C MoFEvMngt_stIvtr1IntlckOpnBms_C MoFEvMngt_stIvtr2IntlckOpnBms_C MoFEvMngt_stIvtrFltLvl1_C MoFEvMngt_stIvtrFltLvl2_C MoFEvMngt_stIvtrIntlckOpnBms_C MoFEvMngt_stSetOperModBms_C MoFEvMngt_stSwtCfgFltCfm_C MoFEvMngt_stT30cErrBms_C MoFEvMngt_stT30cInitBms_C MoFEvMngt_stT30cOpnBms_C MoFEvMngt_TBusBarThd02_C MoFEvMngt_uAdcMaxVal_C MoFEvMngt_uAdcMinVal_C MoFEvMngt_vVehRlsBms_C /end DEF_CHARACTERISTIC
 /begin IN_MEASUREMENT Com_stHvBattOperModDes Eem_flgFstHvShdwn MoFBas_vVehSignd MoFFrm_stDcdcErr MoFFrm_stHvbFltLvl MoFFrm_stHvIntlck MoFFrm_stIIvtrFltLvl01 MoFFrm_stIvtr1Intlck MoFFrm_stIvtr2Intlck MoFFrm_stT30c Mo_stCplChk Mo_stMoC Mo_stMoCCpl /end IN_MEASUREMENT
 /begin OUT_MEASUREMENT DFC_st.DFC_MoFEvMngtBms MoFEvMngtBms_bbOutFltCfm MoFEvMngtBms_bbOutFltLvl MoFEvMngt_flgDcdcFltLvl MoFEvMngt_flgEmgyShdwnFltCfm MoFEvMngt_flgEmgyShtActv MoFEvMngt_flgHvbFltLvl MoFEvMngt_flgHvbLvl1FltCfm MoFEvMngt_flgHvIntlckLvl1FltCfm MoFEvMngt_flgIvtrFltLvl MoFEvMngt_flgTBusBarFltCfm MoFEvMngt_stOperModDes /end OUT_MEASUREMENT
 /begin LOC_MEASUREMENT MoFEvMngtBms_bbLoc1Cpl MoFEvMngtBms_bbLocCpl MoFEvMngtBms_bbOutFltCfmCpl MoFEvMngtBms_bbOutFltLvlCpl MoFEvMngt_Bms_DataDebErrReactn_I.cntErrDeb MoFEvMngt_Bms_DataDebErrReactn_I.cntErrDebCpl MoFEvMngt_Bms_DataDebErrReactn_I.stErrDeb MoFEvMngt_Bms_DataDebErrReactn_I.stErrDebCpl MoFEvMngt_Bms_DataDebErrReactn_I.stErrLockRels MoFEvMngt_Bms_DataDebErrReactn_I.stErrLockRelsCpl MoFEvMngt_Bms_DataDebErrReactn_I.stErrReactn MoFEvMngt_cntrDiagDebBms MoFEvMngt_cntrOpnBms MoFEvMngt_cntrOpnBms1 MoFEvMngt_cntrOpnBms1Cpl MoFEvMngt_cntrOpnBms2 MoFEvMngt_cntrOpnBms2Cpl MoFEvMngt_cntrOpnBms3 MoFEvMngt_cntrOpnBms3Cpl MoFEvMngt_cntrOpnBmsCpl MoFEvMngt_cntrOpnFltBms1 MoFEvMngt_cntrOpnFltBms1Cpl MoFEvMngt_cntrOpnFltBms2 MoFEvMngt_cntrOpnFltBms2Cpl MoFEvMngt_cntrOpnFltBms3 MoFEvMngt_cntrOpnFltBms3Cpl MoFEvMngt_flgAdcErr MoFEvMngt_flgClrBMS MoFEvMngt_flgCritModStBms MoFEvMngt_flgDcdc MoFEvMngt_flgDiagSetCycBms MoFEvMngt_flgEmgyShdwnFlt MoFEvMngt_flgErrBmsMsg MoFEvMngt_flgFstHvShdwnLvl1 MoFEvMngt_flgHvb MoFEvMngt_flgHvbLvl1Flt MoFEvMngt_flgHvIntlckLvl1Flt MoFEvMngt_flgInvtr MoFEvMngt_flgOpnHvCircBms MoFEvMngt_flgSetEmgyShdwnBms MoFEvMngt_flgSetOperModBms MoFEvMngt_flgTBusBarFlt MoFEvMngt_flgTSetModBms MoFEvMngt_stDebFltBms1 MoFEvMngt_stDebFltBms1Cpl MoFEvMngt_stDebFltBms2 MoFEvMngt_stDebFltBms2Cpl MoFEvMngt_stDebFltBms3 MoFEvMngt_stDebFltBms3Cpl MoFEvMngt_stDebMemBms MoFEvMngt_stDebMemBms1 MoFEvMngt_stDebMemBms1Cpl MoFEvMngt_stDebMemBms2 MoFEvMngt_stDebMemBms2Cpl MoFEvMngt_stDebMemBms3 MoFEvMngt_stDebMemBms3Cpl MoFEvMngt_stDebMemBmsCpl MoFEvMngt_stOperModDesBmsLvl1 MoFEvMngt_stOperModDesBmsLvl1Cpl MoFEvMngt_stOperModDesCpl MoFEvMngt_TAdcSnsrVal MoFEvMngt_TAdcSnsrValCpl MoFEvMngt_uAdcCnvrVal MoFEvMngt_uAdcCnvrValCpl /end LOC_MEASUREMENT
 FUNCTION_VERSION "3.0.1" /end FUNCTION
/begin FUNCTION MoFEvMngt_Dcdc "2.0.0     Function Monitoring DCDC Converter"
 /begin DEF_CHARACTERISTIC DFC_CtlMsk2.DFC_MoFEvMngtDcdc_C DFC_DisblMsk2.DFC_MoFEvMngtDcdc_C MoFEvMngt_cntrDcdcHiLoErrDeb_C MoFEvMngt_cntrDcdcLoHiErrDeb_C MoFEvMngt_Dcdc_DataDebErrReactn_I.cntErrDebMax_C MoFEvMngt_Dcdc_DataDebErrReactn_I.stCfgErrHndlg_C MoFEvMngt_Dcdc_DataDebErrReactn_I.stCfgErrReactn_C MoFEvMngt_stDcdcCritMod1_C MoFEvMngt_stDcdcCritMod2_C MoFEvMngt_stDcdcCritMod3_C MoFEvMngt_stDcdcCritMod4_C MoFEvMngt_stDcdcErrCfgd_C MoFEvMngt_stDcdcModDft_C MoFEvMngt_stHVIntlckClsd_C MoFEvMngt_stIvtr1IntlckClsd_C MoFEvMngt_stIvtr2IntlckClsd_C MoFEvMngt_stIvtrIntlckErrCfgd_C MoFEvMngt_stT30cErr_C MoFEvMngt_stT30cInit_C MoFEvMngt_stT30cOpen_C MoFEvMngt_vVehDcdcThd_C MoFEvMngt_vVehPrecThd_C /end DEF_CHARACTERISTIC
 /begin IN_MEASUREMENT Dcdc_stDesDcdc MoFBas_flgErrVSig MoFBas_vVehSignd MoFFrm_stDcdcErr MoFFrm_stHvIntlck MoFFrm_stIvtr1Intlck MoFFrm_stIvtr2Intlck MoFFrm_stT30c MoFRelsMngt_flgPtActv Mo_stCplChk Mo_stMoC Mo_stMoCCpl /end IN_MEASUREMENT
 /begin OUT_MEASUREMENT DFC_st.DFC_MoFEvMngtDcdc MoFEvMngt_flgIrrvDcdcErr MoFEvMngt_stDcdcModReq /end OUT_MEASUREMENT
 /begin LOC_MEASUREMENT MoFEvMngtDcdc_bbLocCpl MoFEvMngtDcdc_bbOutCpl MoFEvMngt_cntrDcdcDiagDeb MoFEvMngt_cntrDcdcErrDeb MoFEvMngt_cntrDcdcErrDebCpl MoFEvMngt_Dcdc_DataDebErrReactn_I.cntErrDeb MoFEvMngt_Dcdc_DataDebErrReactn_I.cntErrDebCpl MoFEvMngt_Dcdc_DataDebErrReactn_I.stErrDeb MoFEvMngt_Dcdc_DataDebErrReactn_I.stErrDebCpl MoFEvMngt_Dcdc_DataDebErrReactn_I.stErrLockRels MoFEvMngt_Dcdc_DataDebErrReactn_I.stErrLockRelsCpl MoFEvMngt_Dcdc_DataDebErrReactn_I.stErrReactn MoFEvMngt_flgDcdcDiagSetCyc MoFEvMngt_flgDcdcErr MoFEvMngt_flgDcdcErrStDeb MoFEvMngt_flgDSMClrDcdc MoFEvMngt_flgErrStDcdc MoFEvMngt_flgIrrvDcdcErrMsg MoFEvMngt_stDcdcErrDeb MoFEvMngt_stDcdcErrDebCpl MoFEvMngt_stDcdcModReqCpl MofEvMngt_stDesDcdcLvl1 MofEvMngt_stDesDcdcLvl1Cpl /end LOC_MEASUREMENT
 FUNCTION_VERSION "2.0.0" /end FUNCTION
/begin FUNCTION MoFEvMngt_Em "14.1.0    Function monitoring Electrical machine"
 /begin DEF_CHARACTERISTIC DFC_CtlMsk2.DFC_MoFEvMngtEm01_C DFC_CtlMsk2.DFC_MoFEvMngtEm01BrkgToZr_C DFC_CtlMsk2.DFC_MoFEvMngtEm01EngSpd_C DFC_CtlMsk2.DFC_MoFEvMngtEm02EngSpd_C DFC_CtlMsk2.DFC_MoFEvMngtEm02Lvl1_C DFC_CtlMsk2.DFC_MoFEvMngtEm02Lvl2_C DFC_DisblMsk2.DFC_MoFEvMngtEm01_C DFC_DisblMsk2.DFC_MoFEvMngtEm01BrkgToZr_C DFC_DisblMsk2.DFC_MoFEvMngtEm01EngSpd_C DFC_DisblMsk2.DFC_MoFEvMngtEm02EngSpd_C DFC_DisblMsk2.DFC_MoFEvMngtEm02Lvl1_C DFC_DisblMsk2.DFC_MoFEvMngtEm02Lvl2_C MoFEvMngtEm_stSwtCfgFltCfm_C MoFEvMngt_cntrClsElMMaxEm01_C MoFEvMngt_cntrClsMaxActvDcha_C MoFEvMngt_cntrClsStMaxEm01BrkgToZr1_C MoFEvMngt_cntrClsStMaxEm01BrkgToZr2_C MoFEvMngt_cntrClsStMaxEm01_C MoFEvMngt_cntrClsStMaxEm02SafeIvtr_C MoFEvMngt_cntrClsStMaxEm02_C MoFEvMngt_cntrErrDebMaxEngSpdEM01_C MoFEvMngt_cntrErrDebMaxEngSpdEM02_C MoFEvMngt_cntrOpnElMMaxEm01_C MoFEvMngt_cntrOpnStMaxEm01BrkgToZr1_C MoFEvMngt_cntrOpnStMaxEm01BrkgToZr2_C MoFEvMngt_cntrOpnStMaxEm01_C MoFEvMngt_cntrOpnStMaxEm02SafeIvtr_C MoFEvMngt_cntrOpnStMaxEm02_C MoFEvMngt_Em01BrkgToZr_DataDebErrReactn_I.cntErrDebMax_C MoFEvMngt_Em01BrkgToZr_DataDebErrReactn_I.stCfgErrHndlg_C MoFEvMngt_Em01BrkgToZr_DataDebErrReactn_I.stCfgErrReactn_C MoFEvMngt_Em01EngSpd_DataErrReactn_I.stCfgErrHndlg_C MoFEvMngt_Em01EngSpd_DataErrReactn_I.stCfgErrReactn_C MoFEvMngt_Em01_DataDebErrReactn_I.cntErrDebMax_C MoFEvMngt_Em01_DataDebErrReactn_I.stCfgErrHndlg_C MoFEvMngt_Em01_DataDebErrReactn_I.stCfgErrReactn_C MoFEvMngt_Em02EngSpd_DataErrReactn_I.stCfgErrHndlg_C MoFEvMngt_Em02EngSpd_DataErrReactn_I.stCfgErrReactn_C MoFEvMngt_Em02Lvl1_DataDebErrReactn_I.cntErrDebMax_C MoFEvMngt_Em02Lvl1_DataDebErrReactn_I.stCfgErrHndlg_C MoFEvMngt_Em02Lvl1_DataDebErrReactn_I.stCfgErrReactn_C MoFEvMngt_Em02Lvl2_DataDebErrReactn_I.cntErrDebMax_C MoFEvMngt_Em02Lvl2_DataDebErrReactn_I.stCfgErrHndlg_C MoFEvMngt_Em02Lvl2_DataDebErrReactn_I.stCfgErrReactn_C MoFEvMngt_facTqDistbnThres_C MoFEvMngt_nDesEm01OffsMinus_C MoFEvMngt_nDesEm01OffsPlus_C MoFEvMngt_nDesThresInct_T MoFEvMngt_nDesThresMax_T MoFEvMngt_nEm01Dfct_C MoFEvMngt_nEm02Dfct_C MoFEvMngt_nrSmplAvrgFlt_C MoFEvMngt_nSpdDesThresLim_C MoFEvMngt_stActvDchaMod1_C MoFEvMngt_stActvDchaMod2_C MoFEvMngt_stCrash_C MoFEvMngt_stElMDesEem_C MoFEvMngt_stEmCritMod1_C MoFEvMngt_stEmCritMod2_C MoFEvMngt_stEmCritMod3_C MoFEvMngt_stEmCritMod4_C MoFEvMngt_stEmCritModBrkgToZr1_C MoFEvMngt_stEmCritModBrkgToZr2_C MoFEvMngt_stEmCritModEM02_C MoFEvMngt_stEmModDftBrkgToZr1_C MoFEvMngt_stEmModDftBrkgToZr2_C MoFEvMngt_stEmModDftEm02_C MoFEvMngt_stEmModDft_C MoFEvMngt_stHvbCnctnOpn_C MoFEvMngt_stHvIntlckOpnEm_C MoFEvMngt_stT30cErrEm_C MoFEvMngt_stT30cInitEm_C MoFEvMngt_stT30cOpnEm_C MoFEvMngt_swtDiEM01_C MoFEvMngt_swtDiEM02_C MoFEvMngt_swtEnaBrkgToZr_C MoFEvMngt_swtGbxWithMeclRvsGearPrsnt_C MoFEvMngt_swtSignChgBrkgToZr_C MoFEvMngt_swtSignChgEM01_C MoFEvMngt_swtSignChgEM02_C MoFEvMngt_tiNActPhyFlt_C MoFEvMngt_uDcdcHvAct_C MoFEvMngt_uDcLinkThd_C MoFEvMngt_vVehBrkgToZrThres_C MoFEvMngt_vVehRlsEm_C /end DEF_CHARACTERISTIC
 /begin IN_MEASUREMENT BrkgToZr_flgActvd BrkgToZr_nDes01 Com_stElMDesEem ElM_stDesEem01 ElM_stDesEem02 Emac_nDesCom01 MoFBas_vVehSignd MoFEmgyOff_stCrash MoFFrm_nEm01CANRaw MoFFrm_nEm01CANRawQlfr MoFFrm_nEm02CANRaw MoFFrm_nEm02CANRawQlfr MoFFrm_stHvbCnctn MoFFrm_stHvIntlck MoFFrm_stT30c MoFFrm_uDcdcHvAct MoFFrm_uDcdcHvActQlfr MoFFrm_uDcLnk01 MoFFrm_uDcLnk01Qlfr MoFPtSt_ratPT MoFRelsMngt_flgPtActv MoFTqPtdAxle_facTqDistbn MoFTrsmAssc_flgGearLvrNeut MoFTrsmAssc_flgGearLvrPark MoFTrsmAssc_flgGearLvrRe Mo_stCplChk Mo_stMoC Mo_stMoCCpl /end IN_MEASUREMENT
 /begin OUT_MEASUREMENT DFC_st.DFC_MoFEvMngtEm01 DFC_st.DFC_MoFEvMngtEm01BrkgToZr DFC_st.DFC_MoFEvMngtEm01EngSpd DFC_st.DFC_MoFEvMngtEm02EngSpd DFC_st.DFC_MoFEvMngtEm02Lvl1 DFC_st.DFC_MoFEvMngtEm02Lvl2 MoFEvMngtEm_bbOutFltCfm MoFEvMngt_flgBrkgToZrActvd MoFEvMngt_flgElMDesEemFltCfm MoFEvMngt_flgTurnOnOffStEm01 MoFEvMngt_nDes01 MoFEvMngt_nEm01 MoFEvMngt_nEm02 MoFEvMngt_nEmPhy01 MoFEvMngt_nEmPhy02 MoFEvMngt_stDesEem01 MoFEvMngt_stDesEem02 MoFEvMngt_stElMDesEem MoFEvMngt_stErrEmSig MoFEvMngt_stErrEmSig02 /end OUT_MEASUREMENT
 /begin LOC_MEASUREMENT MoFEvMngtEm_bbLoc1Cpl MoFEvMngtEm_bbLoc2Cpl MoFEvMngtEm_bbLoc3Cpl MoFEvMngtEm_bbLoc4Cpl MoFEvMngtEm_bbOut1Cpl MoFEvMngtEm_bbOutFltCfmCpl MoFEvMngt_cntrDesEem MoFEvMngt_cntrDesEemCpl MoFEvMngt_cntrDiagDebEm01 MoFEvMngt_cntrDiagDebEm01BrkgToZr MoFEvMngt_cntrDiagDebEm01EngSpd MoFEvMngt_cntrDiagDebEm02EngSpd MoFEvMngt_cntrDiagDebEm02Lvl1 MoFEvMngt_cntrDiagDebEm02Lvl2 MoFEvMngt_cntrEm01 MoFEvMngt_cntrEm01BrkgToZr1 MoFEvMngt_cntrEm01BrkgToZr1Cpl MoFEvMngt_cntrEm01BrkgToZr2 MoFEvMngt_cntrEm01BrkgToZr2Cpl MoFEvMngt_cntrEm01Cpl MoFEvMngt_cntrEm02 MoFEvMngt_cntrEm02Cpl MoFEvMngt_cntrEm02SafeInvtr MoFEvMngt_cntrEm02SafeInvtrCpl MoFEvMngt_Em01BrkgToZr_DataDebErrReactn_I.cntErrDeb MoFEvMngt_Em01BrkgToZr_DataDebErrReactn_I.cntErrDebCpl MoFEvMngt_Em01BrkgToZr_DataDebErrReactn_I.stErrDeb MoFEvMngt_Em01BrkgToZr_DataDebErrReactn_I.stErrDebCpl MoFEvMngt_Em01BrkgToZr_DataDebErrReactn_I.stErrLockRels MoFEvMngt_Em01BrkgToZr_DataDebErrReactn_I.stErrLockRelsCpl MoFEvMngt_Em01BrkgToZr_DataDebErrReactn_I.stErrReactn MoFEvMngt_Em01EngSpd_DataErrReactn_I.stErrLockRels MoFEvMngt_Em01EngSpd_DataErrReactn_I.stErrLockRelsCpl MoFEvMngt_Em01EngSpd_DataErrReactn_I.stErrReactn MoFEvMngt_Em01_DataDebErrReactn_I.cntErrDeb MoFEvMngt_Em01_DataDebErrReactn_I.cntErrDebCpl MoFEvMngt_Em01_DataDebErrReactn_I.stErrDeb MoFEvMngt_Em01_DataDebErrReactn_I.stErrDebCpl MoFEvMngt_Em01_DataDebErrReactn_I.stErrLockRels MoFEvMngt_Em01_DataDebErrReactn_I.stErrLockRelsCpl MoFEvMngt_Em01_DataDebErrReactn_I.stErrReactn MoFEvMngt_Em02EngSpd_DataErrReactn_I.stErrLockRels MoFEvMngt_Em02EngSpd_DataErrReactn_I.stErrLockRelsCpl MoFEvMngt_Em02EngSpd_DataErrReactn_I.stErrReactn MoFEvMngt_Em02Lvl1_DataDebErrReactn_I.cntErrDeb MoFEvMngt_Em02Lvl1_DataDebErrReactn_I.cntErrDebCpl MoFEvMngt_Em02Lvl1_DataDebErrReactn_I.stErrDeb MoFEvMngt_Em02Lvl1_DataDebErrReactn_I.stErrDebCpl MoFEvMngt_Em02Lvl1_DataDebErrReactn_I.stErrLockRels MoFEvMngt_Em02Lvl1_DataDebErrReactn_I.stErrLockRelsCpl MoFEvMngt_Em02Lvl1_DataDebErrReactn_I.stErrReactn MoFEvMngt_Em02Lvl2_DataDebErrReactn_I.cntErrDeb MoFEvMngt_Em02Lvl2_DataDebErrReactn_I.cntErrDebCpl MoFEvMngt_Em02Lvl2_DataDebErrReactn_I.stErrDeb MoFEvMngt_Em02Lvl2_DataDebErrReactn_I.stErrDebCpl MoFEvMngt_Em02Lvl2_DataDebErrReactn_I.stErrLockRels MoFEvMngt_Em02Lvl2_DataDebErrReactn_I.stErrLockRelsCpl MoFEvMngt_Em02Lvl2_DataDebErrReactn_I.stErrReactn MoFEvMngt_flgActvDchaFlt MoFEvMngt_flgBrkgToZrActvdLvl1 MoFEvMngt_flgClrEm01 MoFEvMngt_flgClrEm01BrkgToZr MoFEvMngt_flgClrEm01EngSpd MoFEvMngt_flgClrEm02EngSpd MoFEvMngt_flgClrEm02Lvl1 MoFEvMngt_flgClrEm02Lvl2 MoFEvMngt_flgCritModStEm01 MoFEvMngt_flgCritModStEm02 MoFEvMngt_flgDcVoltDchaChk MoFEvMngt_flgDiagSetCycEm01 MoFEvMngt_flgDiagSetCycEm01BrkgToZr MoFEvMngt_flgDiagSetCycEm01EngSpd MoFEvMngt_flgDiagSetCycEm02EngSpd MoFEvMngt_flgDiagSetCycEm02Lvl1 MoFEvMngt_flgDiagSetCycEm02Lvl2 MoFEvMngt_flgElMDesEemFlt MoFEvMngt_flgEmAlvErr MoFEvMngt_flgEmAlvErr02 MoFEvMngt_flgEmAlvFrz MoFEvMngt_flgEmAlvFrz02 MoFEvMngt_flgEmChksErr MoFEvMngt_flgEmChksErr02 MoFEvMngt_flgEmChksFrz MoFEvMngt_flgEmChksFrz02 MoFEvMngt_flgEmInvldVal MoFEvMngt_flgEmInvldVal02 MoFEvMngt_flgEngSpdDesSignNeg MoFEvMngt_flgErrBrkgToZr MoFEvMngt_flgErrBrkgToZrEngSpdDesSignd MoFEvMngt_flgErrBrkgToZrEngSpdDesUnSignd MoFEvMngt_flgErrBrkgToZrPtRels MoFEvMngt_flgErrBrkgToZrTqDistbn MoFEvMngt_flgErrBrkgToZrVVeh MoFEvMngt_flgErrEm01 MoFEvMngt_flgErrEm01BrkgToZrMsg MoFEvMngt_flgErrEm01EngSpdMsg MoFEvMngt_flgErrEm01Msg MoFEvMngt_flgErrEm02 MoFEvMngt_flgErrEm02EngSpdMsg MoFEvMngt_flgErrEm02Lvl1Msg MoFEvMngt_flgErrEm02Lvl2Msg MoFEvMngt_flgOpnHvCircEm01 MoFEvMngt_flgOpnHvCircEm02 MoFEvMngt_flgTurnOnOffStEm01BrkgToZr1 MoFEvMngt_flgTurnOnOffStEm01BrkgToZr2 MoFEvMngt_flgTurnOnOffStEm02 MoFEvMngt_flgTurnOnOffStEm02SafeIvtr MoFEvMngt_idxnActAry MoFEvMngt_idxnActAryCpl MoFEvMngt_idxnActAryEm02 MoFEvMngt_idxnActAryEm02Cpl MoFEvMngt_idxnActAvrg MoFEvMngt_idxnActAvrgCpl MoFEvMngt_idxnAvrg MoFEvMngt_idxnAvrgCpl MoFEvMngt_nActSum01 MoFEvMngt_nActSum01Cpl MoFEvMngt_nActSum02 MoFEvMngt_nActSum02Cpl MoFEvmngt_nDes01BrkgToZrLvl1 MoFEvmngt_nDes01BrkgToZrLvl1Cpl MoFEvMngt_nDes01Cpl MoFEvMngt_nDes01SigndLimd MoFEvMngt_nDes01SigndLimdCpl MoFEvMngt_nDesCom01Lvl1 MoFEvMngt_nDesCom01Lvl1Cpl MoFEvMngt_nDesNotSignd MoFEvMngt_nDesNotSigndCpl MoFEvMngt_nDesSignd MoFEvMngt_nDesSigndCpl MoFEvMngt_nDesThres MoFEvMngt_nDesThresCpl MoFEvMngt_nDesThresDif MoFEvMngt_nDesThresDifCpl MoFEvMngt_nDesThresInct MoFEvMngt_nDesThresInctCpl MoFEvMngt_nDesThresMax MoFEvMngt_nDesThresMaxCpl MoFEvMngt_nEm01Cpl MoFEvMngt_nEm02Cpl MoFEvMngt_nEmAvrg01 MoFEvMngt_nEmAvrg01Cpl MoFEvMngt_nEmAvrg02 MoFEvMngt_nEmAvrg02Cpl MoFEvMngt_nEmFlt1Hi01 MoFEvMngt_nEmFlt1Hi01Cpl MoFEvMngt_nEmFlt1Hi02 MoFEvMngt_nEmFlt1Hi02Cpl MoFEvMngt_nEmFlt2Hi01 MoFEvMngt_nEmFlt2Hi01Cpl MoFEvMngt_nEmFlt2Hi02 MoFEvMngt_nEmFlt2Hi02Cpl MoFEvMngt_nEmPhy01Cpl MoFEvMngt_nEmPhy02Cpl MoFEvMngt_nrSmplArr MoFEvMngt_nrSmplArrCpl MoFEvMngt_nrSmplArrEM02 MoFEvMngt_nrSmplArrEM02Cpl MoFEvMngt_nSpdEm01 MoFEvMngt_nSpdEm01Cpl MoFEvMngt_nSpdEm02 MoFEvMngt_nSpdEm02Cpl MoFEvMngt_ptrEmFlt1Lo01 MoFEvMngt_ptrEmFlt1Lo01Cpl MoFEvMngt_ptrEmFlt1Lo02 MoFEvMngt_ptrEmFlt1Lo02Cpl MoFEvMngt_ptrEmFlt2Lo01 MoFEvMngt_ptrEmFlt2Lo01Cpl MoFEvMngt_ptrEmFlt2Lo02 MoFEvMngt_ptrEmFlt2Lo02Cpl MoFEvMngt_stActvDchaCntrVal MoFEvMngt_stActvDchaCntrValCpl MoFEvMngt_stDebDesEem MoFEvMngt_stDebDesEemCpl MoFEvMngt_stDebMemEm01 MoFEvMngt_stDebMemEm01BrkgToZr1 MoFEvMngt_stDebMemEm01BrkgToZr1Cpl MoFEvMngt_stDebMemEm01BrkgToZr2 MoFEvMngt_stDebMemEm01BrkgToZr2Cpl MoFEvMngt_stDebMemEm01Cpl MoFEvMngt_stDebMemEm02 MoFEvMngt_stDebMemEm02Cpl MoFEvMngt_stDebMemEm02SafeInvtr MoFEvMngt_stDebMemEm02SafeInvtrCpl MoFEvMngt_stDesEem01BrkgToZrLvl2 MoFEvMngt_stDesEem01BrkgToZrLvl2Cpl MoFEvMngt_stDesEem01Cpl MoFEvMngt_stDesEem01HvLvl2 MoFEvMngt_stDesEem01HvLvl2Cpl MoFEvMngt_stDesEem01Lvl1 MoFEvMngt_stDesEem01Lvl1Cpl MoFEvMngt_stDesEem02Cpl MoFEvMngt_stDesEem02HvLvl2 MoFEvMngt_stDesEem02HvLvl2Cpl MoFEvMngt_stDesEem02Lvl1 MoFEvMngt_stDesEem02Lvl1Cpl MoFEvMngt_stElMDesEem01Lvl1 MoFEvMngt_stElMDesEem01Lvl1Cpl MoFEvMngt_stElMDesEemCpl MoFEvMngt_stErrEmSig02Cpl MoFEvMngt_stErrEmSigCpl MoFEvMngt_stErrEngSpdEm01 MoFEvMngt_stErrEngSpdEm01Cpl MoFEvMngt_stErrEngSpdEm02 MoFEvMngt_stErrEngSpdEm02Cpl /end LOC_MEASUREMENT
 FUNCTION_VERSION "14.1.0" /end FUNCTION
/begin FUNCTION MoFExtCpt_AuxCpt "1.0.0     Function Monitoring: Auxiliary Components"
 /begin DEF_CHARACTERISTIC DFC_CtlMsk2.DFC_MoFExtCptAuxCpt_C DFC_DisblMsk2.DFC_MoFExtCptAuxCpt_C MoFExtCpt_AuxCpt_DataDebErrReactn_I.cntErrDebMax_C MoFExtCpt_AuxCpt_DataDebErrReactn_I.stCfgErrHndlg_C MoFExtCpt_AuxCpt_DataDebErrReactn_I.stCfgErrReactn_C MoFExtCpt_cntrTurnOffMaxAuxCpt_C MoFExtCpt_cntrTurnOnMaxAuxCpt_C MoFExtCpt_stDcdcErrAuxCpt_C MoFExtCpt_stErrLvPwrSplyLvl1AuxCpt_C MoFExtCpt_stSafePredAuxCpt_C MoFExtCpt_stSofAsilRawInvld_C MoFExtCpt_stSofUErrAuxCpt_C MoFExtCpt_uBattSofAsilMinRmnAuxCpt_C MoFExtCpt_uSofAsilErrAuxCpt_T MoFExtCpt_vVehMinErrLvPwrSplyAuxCpt_C MoFExtCpt_vVehSigndRlsAuxCpt_C /end DEF_CHARACTERISTIC
 /begin IN_MEASUREMENT MoFBas_flgErrVSig MoFBas_vVehSignd MoFFrm_stDcdcErr MoFFrm_stSofErr MoFFrm_uSofAsilRaw MoFIn_stErrLvPwrSply Mo_stCplChk Mo_stMoC Mo_stMoCCpl /end IN_MEASUREMENT
 /begin OUT_MEASUREMENT DFC_st.DFC_MoFExtCptAuxCpt MoFExtCpt_flgErrLvPwrSply MoFExtCpt_flgErrLvPwrSplyMsg /end OUT_MEASUREMENT
 /begin LOC_MEASUREMENT MoFExtCptAuxCpt_bbLocCpl MoFExtCptAuxCpt_bbOutCpl MoFExtCpt_AuxCpt_DataDebErrReactn_I.cntErrDeb MoFExtCpt_AuxCpt_DataDebErrReactn_I.cntErrDebCpl MoFExtCpt_AuxCpt_DataDebErrReactn_I.stErrDeb MoFExtCpt_AuxCpt_DataDebErrReactn_I.stErrDebCpl MoFExtCpt_AuxCpt_DataDebErrReactn_I.stErrLockRels MoFExtCpt_AuxCpt_DataDebErrReactn_I.stErrLockRelsCpl MoFExtCpt_AuxCpt_DataDebErrReactn_I.stErrReactn MoFExtCpt_cntrDiagSetCyc MoFExtCpt_cntrTurnOnOffDly MoFExtCpt_cntrTurnOnOffDlyCpl MoFExtCpt_flgDiagSetCyc MoFExtCpt_flgDSMClr MoFExtCpt_flgErrLvPwrSplyDeb MoFExtCpt_flgErrLvPwrSplyDifMsg MoFExtCpt_flgErrLvPwrSplyRaw MoFExtCpt_flgUSofAsilErr MoFExtCpt_stDebMemAuxCpt MoFExtCpt_stDebMemAuxCptCpl MoFExtCpt_stSofAsilRawInvld MoFExtCpt_stSofAsilRawInvldCpl MoFExtCpt_uSofAsilRmn MoFExtCpt_uSofAsilRmnCpl /end LOC_MEASUREMENT
 FUNCTION_VERSION "1.0.0" /end FUNCTION
/begin COMPU_METHOD B_TRUE "" TAB_VERB "%6.3" "" COMPU_TAB_REF B_TRUE /end COMPU_METHOD
/begin COMPU_VTAB B_TRUE "" TAB_VERB 2 0 "FALSE" 1 "TRUE" /end COMPU_VTAB
/begin COMPU_METHOD DFC_OneToOne "" RAT_FUNC "%6.2" "-" COEFFS 0 1 0 0 0 1 /end COMPU_METHOD
/begin COMPU_METHOD DFES_OneToOne "" RAT_FUNC "%6.2" "-" COEFFS 0 1 0 0 0 1 /end COMPU_METHOD
/begin COMPU_METHOD fak_q1p22Em4 "" RAT_FUNC "%6.5" "-" COEFFS 0 8192 0 0 0 1 /end COMPU_METHOD
/begin COMPU_METHOD nmot_q1 "" RAT_FUNC "%6.2" "1/min" COEFFS 0 1 0 0 0 1 /end COMPU_METHOD
/begin COMPU_METHOD OneToOne "" RAT_FUNC "%6.2" "-" COEFFS 0 1 0 0 0 1 /end COMPU_METHOD
/begin COMPU_METHOD PosMCKp_32 "" RAT_FUNC "%6.5" "%/AgCA" COEFFS 0 2250.00000000055 0 0 0 1 /end COMPU_METHOD
/begin COMPU_METHOD POSTDRV_SOFTRST_SY_Compu "" TAB_VERB "%6.3" "" COMPU_TAB_REF POSTDRV_SOFTRST_SY_Compu /end COMPU_METHOD
/begin COMPU_VTAB POSTDRV_SOFTRST_SY_Compu "" TAB_VERB 2 0 "false" 1 "true" /end COMPU_VTAB
/begin COMPU_METHOD POUTLVLVDS_TYPAVL_SC_Compu "" TAB_VERB "%6.3" "" COMPU_TAB_REF POUTLVLVDS_TYPAVL_SC_Compu /end COMPU_METHOD
/begin COMPU_VTAB POUTLVLVDS_TYPAVL_SC_Compu "" TAB_VERB 2 0 "FALSE" 1 "TRUE" /end COMPU_VTAB
/begin COMPU_METHOD PPFLTDIFFASICT_TYPAVL_SC_Compu "" TAB_VERB "%6.3" "" COMPU_TAB_REF PPFLTDIFFASICT_TYPAVL_SC_Compu /end COMPU_METHOD
/begin COMPU_VTAB PPFLTDIFFASICT_TYPAVL_SC_Compu "" TAB_VERB 2 0 "False" 1 "True" /end COMPU_VTAB
/begin COMPU_METHOD PPFLTDIFFCH1_TYPAVL_SC_Compu "" TAB_VERB "%6.3" "" COMPU_TAB_REF PPFLTDIFFCH1_TYPAVL_SC_Compu /end COMPU_METHOD
/begin COMPU_VTAB PPFLTDIFFCH1_TYPAVL_SC_Compu "" TAB_VERB 2 0 "False" 1 "True" /end COMPU_VTAB
/begin COMPU_METHOD PPFLTDIFFCH2_TYPAVL_SC_Compu "" TAB_VERB "%6.3" "" COMPU_TAB_REF PPFLTDIFFCH2_TYPAVL_SC_Compu /end COMPU_METHOD
/begin COMPU_VTAB PPFLTDIFFCH2_TYPAVL_SC_Compu "" TAB_VERB 2 0 "False" 1 "True" /end COMPU_VTAB
/begin COMPU_METHOD PPFLTDIFF_TYPAVL_SY_Compu "" TAB_VERB "%6.3" "" COMPU_TAB_REF PPFLTDIFF_TYPAVL_SY_Compu /end COMPU_METHOD
/begin COMPU_VTAB PPFLTDIFF_TYPAVL_SY_Compu "" TAB_VERB 2 0 "False" 1 "True" /end COMPU_VTAB
/begin COMPU_METHOD RBPtCel_t_1p0_3 "" RAT_FUNC "%6.2" "Deg C" COEFFS 0 1 0 0 0 1 /end COMPU_METHOD
/begin COMPU_METHOD RBPtCel_u_1p0_1 "" RAT_FUNC "%6.2" "V" COEFFS 0 1 0 0 0 1 /end COMPU_METHOD
/begin COMPU_METHOD spg_q0p00488 "" RAT_FUNC "%6.4" "V" COEFFS 0 1024 0 0 0 5 /end COMPU_METHOD
/begin COMPU_METHOD spg_q0p0625_V "" RAT_FUNC "%6.4" "V" COEFFS 0 16 0 0 0 1 /end COMPU_METHOD
/begin COMPU_METHOD TransR "" RAT_FUNC "%6.4" "-" COEFFS 0 100 0 0 0 1 /end COMPU_METHOD
/begin COMPU_METHOD Vel "" RAT_FUNC "%6.4" "km/h" COEFFS 0 100 0 0 0 1 /end COMPU_METHOD
/begin COMPU_METHOD zk10msxs_uw_b655p36PT1 "" RAT_FUNC "%6.2" "s" COEFFS 0 0 65536 0 100 1 /end COMPU_METHOD
/begin RECORD_LAYOUT Mo_DataCurveSstS16WS16 NO_AXIS_PTS_X 1 SWORD AXIS_PTS_X 2 SWORD INDEX_INCR DIRECT FNC_VALUES 3 SWORD COLUMN_DIR DIRECT /end RECORD_LAYOUT
/begin RECORD_LAYOUT Mo_DataCurveSstS32WS32 NO_AXIS_PTS_X 1 SLONG AXIS_PTS_X 2 SLONG INDEX_INCR DIRECT FNC_VALUES 3 SLONG COLUMN_DIR DIRECT /end RECORD_LAYOUT
/begin RECORD_LAYOUT Mo_DataCurveSstU16WU16 NO_AXIS_PTS_X 1 UWORD AXIS_PTS_X 2 UWORD INDEX_INCR DIRECT FNC_VALUES 3 UWORD COLUMN_DIR DIRECT /end RECORD_LAYOUT
/begin RECORD_LAYOUT Val_Ws16 FNC_VALUES 1 SWORD COLUMN_DIR DIRECT /end RECORD_LAYOUT
/begin RECORD_LAYOUT Val_Ws8 FNC_VALUES 1 SBYTE COLUMN_DIR DIRECT /end RECORD_LAYOUT
/begin RECORD_LAYOUT Val_Wu16 FNC_VALUES 1 UWORD COLUMN_DIR DIRECT /end RECORD_LAYOUT
/begin RECORD_LAYOUT Val_Wu32 FNC_VALUES 1 ULONG COLUMN_DIR DIRECT /end RECORD_LAYOUT
/begin RECORD_LAYOUT Val_Wu8 FNC_VALUES 1 UBYTE COLUMN_DIR DIRECT /end RECORD_LAYOUT
/end MODULE
/end PROJECT

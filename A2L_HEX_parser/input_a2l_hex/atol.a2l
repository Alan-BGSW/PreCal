ASAP2_VERSION 1 70
/begin PROJECT MDG1C "VC1CP091_STLA_N_D061I3"
/begin HEADER "" VERSION "VC1CP091_STLA_N_D061I3" PROJECT_NO MDG1C /end HEADER
/begin MODULE DIM ""
/begin MOD_COMMON "" BYTE_ORDER MSB_LAST ALIGNMENT_BYTE 1 ALIGNMENT_WORD 2 ALIGNMENT_LONG 4 ALIGNMENT_INT64 4 ALIGNMENT_FLOAT32_IEEE 4 ALIGNMENT_FLOAT64_IEEE 4 DATA_SIZE 32 /end MOD_COMMON
/begin CHARACTERISTIC Com_stCANxComReqByps_C "bypassing the Com_stCANxComReq interface" VALUE 0x8024E6EA Val_Wu8 255.0 OneToOne 0.00 255.0 FORMAT "%5.1" /end CHARACTERISTIC
/begin CHARACTERISTIC Com_tiDlyNetOn_C "Time delay to set Net_On." VALUE 0x8024E6EC Val_Wu16 2.550000 t_q0p005 0.00 2.550000 FORMAT "%8.6" EXTENDED_LIMITS 0.00 327.6750 /end CHARACTERISTIC
/begin CHARACTERISTIC Com_tiRstrtDlyDiagMuxCAN_C "counter for the CAN Diagnostic delay in case of engine restart." VALUE 0x8024E6EE Val_Wu16 6.000000 t_q0p005 0.00 6.000000 FORMAT "%8.6" EXTENDED_LIMITS 0.00 327.6750 /end CHARACTERISTIC
/begin CHARACTERISTIC Com_tiStrtDlyDiagMuxCAN_C "counter for the CAN Diagnostic delay" VALUE 0x8024E6F0 Val_Wu16 6.000000 t_q0p005 0.00 6.000000 FORMAT "%8.6" EXTENDED_LIMITS 0.00 327.6750 /end CHARACTERISTIC
/begin CHARACTERISTIC DDRC_DurDeb.Inm_numHSN1MuteDebOk_C "" VALUE 0x802409C4 Val_Wu16 65535.00 OneToOne 0.00 65535.00 FORMAT "%8.2" /end CHARACTERISTIC
/begin CHARACTERISTIC DDRC_DurDeb.Inm_numHSN1MuteDebDef_C "" VALUE 0x802409C6 Val_Wu16 65535.00 OneToOne 0.00 65535.00 FORMAT "%8.2" /end CHARACTERISTIC
/begin CHARACTERISTIC DDRC_DurDeb.Inm_numHSN3MuteDebOk_C "" VALUE 0x802409C8 Val_Wu16 65535.00 OneToOne 0.00 65535.00 FORMAT "%8.2" /end CHARACTERISTIC
/begin CHARACTERISTIC DDRC_DurDeb.Inm_numHSN3MuteDebDef_C "" VALUE 0x802409CA Val_Wu16 65535.00 OneToOne 0.00 65535.00 FORMAT "%8.2" /end CHARACTERISTIC
/begin CHARACTERISTIC DDRC_DurDeb.HvGrid_tiUMaxSdtyLimThdDebOk_C "" VALUE 0x80240A48 Val_Wu16 655350.0 DDRCTime_ms 0.00 655350.0 FORMAT "%8.1" /end CHARACTERISTIC
/begin CHARACTERISTIC DDRC_DurDeb.HvGrid_tiUMaxSdtyLimThdDebDef_C "" VALUE 0x80240A4A Val_Wu16 655350.0 DDRCTime_ms 0.00 655350.0 FORMAT "%8.1" /end CHARACTERISTIC
/begin CHARACTERISTIC DDRC_DurDeb.HvGrid_tiUMinSftyLimThdDebOk_C "" VALUE 0x80240A4C Val_Wu16 655350.0 DDRCTime_ms 0.00 655350.0 FORMAT "%8.1" /end CHARACTERISTIC
/begin CHARACTERISTIC DDRC_DurDeb.HvGrid_tiUMinSftyLimThdDebDef_C "" VALUE 0x80240A4E Val_Wu16 655350.0 DDRCTime_ms 0.00 655350.0 FORMAT "%8.1" /end CHARACTERISTIC
/begin CHARACTERISTIC DDRC_DurDeb.HvGrid_tiUPlausyThdDebOk_C "" VALUE 0x80240A50 Val_Wu16 655350.0 DDRCTime_ms 0.00 655350.0 FORMAT "%8.1" /end CHARACTERISTIC
/begin CHARACTERISTIC DDRC_DurDeb.HvGrid_tiUPlausyThdDebDef_C "" VALUE 0x80240A52 Val_Wu16 655350.0 DDRCTime_ms 0.00 655350.0 FORMAT "%8.1" /end CHARACTERISTIC
/begin CHARACTERISTIC DDRC_DurDeb.Com_tiLINBusBlkDebOk_C "" VALUE 0x80240CB0 Val_Wu16 655350.0 DDRCTime_ms 0.00 655350.0 FORMAT "%8.1" /end CHARACTERISTIC
/begin CHARACTERISTIC DDRC_DurDeb.Com_tiLINBusBlkDebDef_C "" VALUE 0x80240CB2 Val_Wu16 655350.0 DDRCTime_ms 0.00 655350.0 FORMAT "%8.1" /end CHARACTERISTIC
/begin CHARACTERISTIC DDRC_DurDeb.HvBatt_tiChrgPwrMaxDebOk_C "" VALUE 0x80240D1C Val_Wu16 655350.0 DDRCTime_ms 0.00 655350.0 FORMAT "%8.1" /end CHARACTERISTIC
/begin CHARACTERISTIC DDRC_DurDeb.HvBatt_tiChrgPwrMaxDebDef_C "" VALUE 0x80240D1E Val_Wu16 655350.0 DDRCTime_ms 0.00 655350.0 FORMAT "%8.1" /end CHARACTERISTIC
/begin CHARACTERISTIC DDRC_DurDeb.HvBatt_tiCrashDetdDebOk_C "" VALUE 0x80240D20 Val_Wu16 655350.0 DDRCTime_ms 0.00 655350.0 FORMAT "%8.1" /end CHARACTERISTIC
/begin CHARACTERISTIC DDRC_DurDeb.HvBatt_tiCrashDetdDebDef_C "" VALUE 0x80240D22 Val_Wu16 655350.0 DDRCTime_ms 0.00 655350.0 FORMAT "%8.1" /end CHARACTERISTIC
/begin CHARACTERISTIC DDRC_DurDeb.HvBatt_tiDchaPwrMaxDebOk_C "" VALUE 0x80240D24 Val_Wu16 655350.0 DDRCTime_ms 0.00 655350.0 FORMAT "%8.1" /end CHARACTERISTIC
/begin CHARACTERISTIC DDRC_DurDeb.HvBatt_tiDchaPwrMaxDebDef_C "" VALUE 0x80240D26 Val_Wu16 655350.0 DDRCTime_ms 0.00 655350.0 FORMAT "%8.1" /end CHARACTERISTIC
/begin CHARACTERISTIC DDRC_DurDeb.HvBatt_tiEmgyOffDebOk_C "" VALUE 0x80240D28 Val_Wu16 655350.0 DDRCTime_ms 0.00 655350.0 FORMAT "%8.1" /end CHARACTERISTIC
/begin CHARACTERISTIC DDRC_DurDeb.HvBatt_tiEmgyOffDebDef_C "" VALUE 0x80240D2A Val_Wu16 655350.0 DDRCTime_ms 0.00 655350.0 FORMAT "%8.1" /end CHARACTERISTIC
/begin CHARACTERISTIC DDRC_DurDeb.HvBatt_tiEmgyOffIntlckDebOk_C "" VALUE 0x80240D2C Val_Wu16 655350.0 DDRCTime_ms 0.00 655350.0 FORMAT "%8.1" /end CHARACTERISTIC
/begin CHARACTERISTIC DDRC_DurDeb.HvBatt_tiEmgyOffIntlckDebDef_C "" VALUE 0x80240D2E Val_Wu16 655350.0 DDRCTime_ms 0.00 655350.0 FORMAT "%8.1" /end CHARACTERISTIC
/begin CHARACTERISTIC DDRC_DurDeb.HvBatt_tiEmgyOffReqDebOk_C "" VALUE 0x80240D30 Val_Wu16 655350.0 DDRCTime_ms 0.00 655350.0 FORMAT "%8.1" /end CHARACTERISTIC
/begin CHARACTERISTIC DDRC_DurDeb.HvBatt_tiEmgyOffReqDebDef_C "" VALUE 0x80240D32 Val_Wu16 655350.0 DDRCTime_ms 0.00 655350.0 FORMAT "%8.1" /end CHARACTERISTIC
/begin CHARACTERISTIC DDRC_DurDeb.HvBatt_tiFltModDebOk_C "" VALUE 0x80240D34 Val_Wu16 655350.0 DDRCTime_ms 0.00 655350.0 FORMAT "%8.1" /end CHARACTERISTIC
/begin CHARACTERISTIC DDRC_DurDeb.HvBatt_tiFltModDebDef_C "" VALUE 0x80240D36 Val_Wu16 655350.0 DDRCTime_ms 0.00 655350.0 FORMAT "%8.1" /end CHARACTERISTIC
/begin CHARACTERISTIC DDRC_DurDeb.HvBatt_tiIninToutDebOk_C "" VALUE 0x80240D40 Val_Wu16 655350.0 DDRCTime_ms 0.00 655350.0 FORMAT "%8.1" /end CHARACTERISTIC
/begin CHARACTERISTIC DDRC_DurDeb.HvBatt_tiIninToutDebDef_C "" VALUE 0x80240D42 Val_Wu16 655350.0 DDRCTime_ms 0.00 655350.0 FORMAT "%8.1" /end CHARACTERISTIC
/begin CHARACTERISTIC DDRC_DurDeb.HvBatt_tiIntlckStDebOk_C "" VALUE 0x80240D44 Val_Wu16 655350.0 DDRCTime_ms 0.00 655350.0 FORMAT "%8.1" /end CHARACTERISTIC
/begin CHARACTERISTIC DDRC_DurDeb.HvBatt_tiIntlckStDebDef_C "" VALUE 0x80240D46 Val_Wu16 655350.0 DDRCTime_ms 0.00 655350.0 FORMAT "%8.1" /end CHARACTERISTIC
/begin CHARACTERISTIC DDRC_DurDeb.HvBatt_tiIsoFltDebOk_C "" VALUE 0x80240D48 Val_Wu16 655350.0 DDRCTime_ms 0.00 655350.0 FORMAT "%8.1" /end CHARACTERISTIC
/begin CHARACTERISTIC DDRC_DurDeb.HvBatt_tiIsoFltDebDef_C "" VALUE 0x80240D4A Val_Wu16 655350.0 DDRCTime_ms 0.00 655350.0 FORMAT "%8.1" /end CHARACTERISTIC
/begin CHARACTERISTIC DDRC_DurDeb.HvBatt_tiLimdPwrDebOk_C "" VALUE 0x80240D4C Val_Wu16 655350.0 DDRCTime_ms 0.00 655350.0 FORMAT "%8.1" /end CHARACTERISTIC
/begin CHARACTERISTIC DDRC_DurDeb.HvBatt_tiLimdPwrDebDef_C "" VALUE 0x80240D4E Val_Wu16 655350.0 DDRCTime_ms 0.00 655350.0 FORMAT "%8.1" /end CHARACTERISTIC
/begin CHARACTERISTIC DDRC_DurDeb.HvBatt_tiMaiSwtClsngDebOk_C "" VALUE 0x80240D50 Val_Wu16 655350.0 DDRCTime_ms 0.00 655350.0 FORMAT "%8.1" /end CHARACTERISTIC
/begin CHARACTERISTIC DDRC_DurDeb.HvBatt_tiMaiSwtClsngDebDef_C "" VALUE 0x80240D52 Val_Wu16 655350.0 DDRCTime_ms 0.00 655350.0 FORMAT "%8.1" /end CHARACTERISTIC
/begin CHARACTERISTIC DDRC_DurDeb.HvBatt_tiMaiSwtFltDebOk_C "" VALUE 0x80240D54 Val_Wu16 655350.0 DDRCTime_ms 0.00 655350.0 FORMAT "%8.1" /end CHARACTERISTIC
/begin CHARACTERISTIC DDRC_DurDeb.HvBatt_tiMaiSwtFltDebDef_C "" VALUE 0x80240D56 Val_Wu16 655350.0 DDRCTime_ms 0.00 655350.0 FORMAT "%8.1" /end CHARACTERISTIC
/begin CHARACTERISTIC DDRC_DurDeb.HvBatt_tiMaiSwtOpenDebOk_C "" VALUE 0x80240D58 Val_Wu16 655350.0 DDRCTime_ms 0.00 655350.0 FORMAT "%8.1" /end CHARACTERISTIC
/begin CHARACTERISTIC DDRC_DurDeb.HvBatt_tiMaiSwtOpenDebDef_C "" VALUE 0x80240D5A Val_Wu16 655350.0 DDRCTime_ms 0.00 655350.0 FORMAT "%8.1" /end CHARACTERISTIC
/begin CHARACTERISTIC DDRC_DurDeb.HvBatt_tiMaiSwtOpngDebOk_C "" VALUE 0x80240D5C Val_Wu16 655350.0 DDRCTime_ms 0.00 655350.0 FORMAT "%8.1" /end CHARACTERISTIC
/begin CHARACTERISTIC DDRC_DurDeb.HvBatt_tiMaiSwtOpngDebDef_C "" VALUE 0x80240D5E Val_Wu16 655350.0 DDRCTime_ms 0.00 655350.0 FORMAT "%8.1" /end CHARACTERISTIC
/begin CHARACTERISTIC DDRC_DurDeb.HvBatt_tiMaiSwtWlddDebOk_C "" VALUE 0x80240D60 Val_Wu16 655350.0 DDRCTime_ms 0.00 655350.0 FORMAT "%8.1" /end CHARACTERISTIC
/begin CHARACTERISTIC DDRC_DurDeb.HvBatt_tiMaiSwtWlddDebDef_C "" VALUE 0x80240D62 Val_Wu16 655350.0 DDRCTime_ms 0.00 655350.0 FORMAT "%8.1" /end CHARACTERISTIC
/begin CHARACTERISTIC DDRC_DurDeb.HvBatt_tiNegCntctrCntErrDebOk_C "" VALUE 0x80240D64 Val_Wu16 655350.0 DDRCTime_ms 0.00 655350.0 FORMAT "%8.1" /end CHARACTERISTIC
/begin CHARACTERISTIC DDRC_DurDeb.HvBatt_tiNegCntctrCntErrDebDef_C "" VALUE 0x80240D66 Val_Wu16 655350.0 DDRCTime_ms 0.00 655350.0 FORMAT "%8.1" /end CHARACTERISTIC
/begin CHARACTERISTIC DDRC_DurDeb.HvBatt_tiOperModChrgPlausyDebOk_C "" VALUE 0x80240D68 Val_Wu16 655350.0 DDRCTime_ms 0.00 655350.0 FORMAT "%8.1" /end CHARACTERISTIC
/begin CHARACTERISTIC DDRC_DurDeb.HvBatt_tiOperModChrgPlausyDebDef_C "" VALUE 0x80240D6A Val_Wu16 655350.0 DDRCTime_ms 0.00 655350.0 FORMAT "%8.1" /end CHARACTERISTIC
/begin CHARACTERISTIC DDRC_DurDeb.HvBatt_tiOverTDernDebOk_C "" VALUE 0x80240D6C Val_Wu16 655350.0 DDRCTime_ms 0.00 655350.0 FORMAT "%8.1" /end CHARACTERISTIC
/begin CHARACTERISTIC DDRC_DurDeb.HvBatt_tiOverTDernDebDef_C "" VALUE 0x80240D6E Val_Wu16 655350.0 DDRCTime_ms 0.00 655350.0 FORMAT "%8.1" /end CHARACTERISTIC
/begin CHARACTERISTIC DDRC_DurDeb.HvBatt_tiPosCntctrCntErrDebOk_C "" VALUE 0x80240D70 Val_Wu16 655350.0 DDRCTime_ms 0.00 655350.0 FORMAT "%8.1" /end CHARACTERISTIC
/begin CHARACTERISTIC DDRC_DurDeb.HvBatt_tiPosCntctrCntErrDebDef_C "" VALUE 0x80240D72 Val_Wu16 655350.0 DDRCTime_ms 0.00 655350.0 FORMAT "%8.1" /end CHARACTERISTIC
/begin CHARACTERISTIC DDRC_DurDeb.HvBatt_tiPrecCntctrCntErrDebOk_C "" VALUE 0x80240D74 Val_Wu16 655350.0 DDRCTime_ms 0.00 655350.0 FORMAT "%8.1" /end CHARACTERISTIC
/begin CHARACTERISTIC DDRC_DurDeb.HvBatt_tiPrecCntctrCntErrDebDef_C "" VALUE 0x80240D76 Val_Wu16 655350.0 DDRCTime_ms 0.00 655350.0 FORMAT "%8.1" /end CHARACTERISTIC
/begin CHARACTERISTIC DDRC_DurDeb.HvBatt_tiPwrDistbnTDernDebOk_C "" VALUE 0x80240D78 Val_Wu16 655350.0 DDRCTime_ms 0.00 655350.0 FORMAT "%8.1" /end CHARACTERISTIC
/begin CHARACTERISTIC DDRC_DurDeb.HvBatt_tiPwrDistbnTDernDebDef_C "" VALUE 0x80240D7A Val_Wu16 655350.0 DDRCTime_ms 0.00 655350.0 FORMAT "%8.1" /end CHARACTERISTIC
/begin CHARACTERISTIC DDRC_DurDeb.HvBatt_tiPwrDistbnTInhbnDebOk_C "" VALUE 0x80240D7C Val_Wu16 655350.0 DDRCTime_ms 0.00 655350.0 FORMAT "%8.1" /end CHARACTERISTIC
/begin CHARACTERISTIC DDRC_DurDeb.HvBatt_tiPwrDistbnTInhbnDebDef_C "" VALUE 0x80240D7E Val_Wu16 655350.0 DDRCTime_ms 0.00 655350.0 FORMAT "%8.1" /end CHARACTERISTIC
/begin CHARACTERISTIC DDRC_DurDeb.HvBatt_tiRatRSohErrDebOk_C "" VALUE 0x80240D80 Val_Wu16 655350.0 DDRCTime_ms 0.00 655350.0 FORMAT "%8.1" /end CHARACTERISTIC
/begin CHARACTERISTIC DDRC_DurDeb.HvBatt_tiRatRSohErrDebDef_C "" VALUE 0x80240D82 Val_Wu16 655350.0 DDRCTime_ms 0.00 655350.0 FORMAT "%8.1" /end CHARACTERISTIC
/begin CHARACTERISTIC DDRC_DurDeb.HvBatt_tiRatSohErrDebOk_C "" VALUE 0x80240D84 Val_Wu16 655350.0 DDRCTime_ms 0.00 655350.0 FORMAT "%8.1" /end CHARACTERISTIC
/begin CHARACTERISTIC DDRC_DurDeb.HvBatt_tiRatSohErrDebDef_C "" VALUE 0x80240D86 Val_Wu16 655350.0 DDRCTime_ms 0.00 655350.0 FORMAT "%8.1" /end CHARACTERISTIC
/begin CHARACTERISTIC DDRC_DurDeb.HvBatt_tiSngIsoWarnDebOk_C "" VALUE 0x80240D88 Val_Wu16 655350.0 DDRCTime_ms 0.00 655350.0 FORMAT "%8.1" /end CHARACTERISTIC
/begin CHARACTERISTIC DDRC_DurDeb.HvBatt_tiSngIsoWarnDebDef_C "" VALUE 0x80240D8A Val_Wu16 655350.0 DDRCTime_ms 0.00 655350.0 FORMAT "%8.1" /end CHARACTERISTIC
/begin CHARACTERISTIC DDRC_DurDeb.HvBatt_tiSrvPlgDiscntDebOk_C "" VALUE 0x80240D8C Val_Wu16 655350.0 DDRCTime_ms 0.00 655350.0 FORMAT "%8.1" /end CHARACTERISTIC
/begin CHARACTERISTIC DDRC_DurDeb.HvBatt_tiSrvPlgDiscntDebDef_C "" VALUE 0x80240D8E Val_Wu16 655350.0 DDRCTime_ms 0.00 655350.0 FORMAT "%8.1" /end CHARACTERISTIC
/begin CHARACTERISTIC DDRC_DurDeb.HvBatt_tiUnderTDernDebOk_C "" VALUE 0x80240D98 Val_Wu16 655350.0 DDRCTime_ms 0.00 655350.0 FORMAT "%8.1" /end CHARACTERISTIC
/begin CHARACTERISTIC DDRC_DurDeb.HvBatt_tiUnderTDernDebDef_C "" VALUE 0x80240D9A Val_Wu16 655350.0 DDRCTime_ms 0.00 655350.0 FORMAT "%8.1" /end CHARACTERISTIC
/begin CHARACTERISTIC DDRC_RatDeb.Inm_numHSN1MuteUDRat_C "" VALUE 0x80248A75 Val_Wu8 3.00000000000 DDRC_Ratio 1.00000000000 4.00000000000 FORMAT "%13.11" /end CHARACTERISTIC
/begin CHARACTERISTIC DDRC_RatDeb.Inm_numHSN3MuteUDRat_C "" VALUE 0x80248A76 Val_Wu8 3.00000000000 DDRC_Ratio 1.00000000000 4.00000000000 FORMAT "%13.11" /end CHARACTERISTIC
/begin CHARACTERISTIC DDRC_RatDeb.HvGrid_tiUMaxSdtyLimThdUDRat_C "" VALUE 0x80248A96 Val_Wu8 3.00000000000 DDRC_Ratio 1.00000000000 4.00000000000 FORMAT "%13.11" /end CHARACTERISTIC
/begin CHARACTERISTIC DDRC_RatDeb.HvGrid_tiUMinSftyLimThdUDRat_C "" VALUE 0x80248A97 Val_Wu8 3.00000000000 DDRC_Ratio 1.00000000000 4.00000000000 FORMAT "%13.11" /end CHARACTERISTIC
/begin CHARACTERISTIC DDRC_RatDeb.HvGrid_tiUPlausyThdUDRat_C "" VALUE 0x80248A98 Val_Wu8 3.00000000000 DDRC_Ratio 1.00000000000 4.00000000000 FORMAT "%13.11" /end CHARACTERISTIC
/begin CHARACTERISTIC DFC_CtlMsk2.DFC_HvBattChrgPwrMax_C "" VALUE 0x8024136D Val_Wu8 255.0 DFES_OneToOne 0.00 255.0 FORMAT "%5.1" /end CHARACTERISTIC
/begin CHARACTERISTIC DFC_CtlMsk2.DFC_HvBattCrashDetd_C "" VALUE 0x8024136E Val_Wu8 255.0 DFES_OneToOne 0.00 255.0 FORMAT "%5.1" /end CHARACTERISTIC
/begin CHARACTERISTIC DFC_CtlMsk2.DFC_HvBattDchaPwrMax_C "" VALUE 0x8024136F Val_Wu8 255.0 DFES_OneToOne 0.00 255.0 FORMAT "%5.1" /end CHARACTERISTIC
/begin CHARACTERISTIC DFC_CtlMsk2.DFC_HvBattEmgyOff_C "" VALUE 0x80241370 Val_Wu8 255.0 DFES_OneToOne 0.00 255.0 FORMAT "%5.1" /end CHARACTERISTIC
/begin CHARACTERISTIC DFC_CtlMsk2.DFC_HvBattEmgyOffIntlck_C "" VALUE 0x80241371 Val_Wu8 255.0 DFES_OneToOne 0.00 255.0 FORMAT "%5.1" /end CHARACTERISTIC
/begin CHARACTERISTIC DFC_CtlMsk2.DFC_HvBattEmgyOffReq_C "" VALUE 0x80241372 Val_Wu8 255.0 DFES_OneToOne 0.00 255.0 FORMAT "%5.1" /end CHARACTERISTIC
/begin CHARACTERISTIC DFC_CtlMsk2.DFC_HvBattFltMod_C "" VALUE 0x80241373 Val_Wu8 255.0 DFES_OneToOne 0.00 255.0 FORMAT "%5.1" /end CHARACTERISTIC
/begin CHARACTERISTIC DFC_CtlMsk2.DFC_HvBattIninTout_C "" VALUE 0x80241376 Val_Wu8 255.0 DFES_OneToOne 0.00 255.0 FORMAT "%5.1" /end CHARACTERISTIC
/begin CHARACTERISTIC DFC_CtlMsk2.DFC_HvBattIntlckSt_C "" VALUE 0x80241377 Val_Wu8 255.0 DFES_OneToOne 0.00 255.0 FORMAT "%5.1" /end CHARACTERISTIC
/begin CHARACTERISTIC DFC_CtlMsk2.DFC_HvBattIsoFlt_C "" VALUE 0x80241378 Val_Wu8 255.0 DFES_OneToOne 0.00 255.0 FORMAT "%5.1" /end CHARACTERISTIC
/begin CHARACTERISTIC DFC_CtlMsk2.DFC_HvBattLimdPwr_C "" VALUE 0x80241379 Val_Wu8 255.0 DFES_OneToOne 0.00 255.0 FORMAT "%5.1" /end CHARACTERISTIC
/begin CHARACTERISTIC DFC_CtlMsk2.DFC_HvBattMaiSwtClsngFlt_C "" VALUE 0x8024137A Val_Wu8 255.0 DFES_OneToOne 0.00 255.0 FORMAT "%5.1" /end CHARACTERISTIC
/begin CHARACTERISTIC DFC_CtlMsk2.DFC_HvBattMaiSwtFlt_C "" VALUE 0x8024137B Val_Wu8 255.0 DFES_OneToOne 0.00 255.0 FORMAT "%5.1" /end CHARACTERISTIC
/begin CHARACTERISTIC DFC_CtlMsk2.DFC_HvBattMaiSwtOpen_C "" VALUE 0x8024137C Val_Wu8 255.0 DFES_OneToOne 0.00 255.0 FORMAT "%5.1" /end CHARACTERISTIC
/begin CHARACTERISTIC DFC_CtlMsk2.DFC_HvBattMaiSwtOpngFlt_C "" VALUE 0x8024137D Val_Wu8 255.0 DFES_OneToOne 0.00 255.0 FORMAT "%5.1" /end CHARACTERISTIC
/begin CHARACTERISTIC DFC_CtlMsk2.DFC_HvBattMaiSwtWldd_C "" VALUE 0x8024137E Val_Wu8 255.0 DFES_OneToOne 0.00 255.0 FORMAT "%5.1" /end CHARACTERISTIC
/begin CHARACTERISTIC DFC_CtlMsk2.DFC_HvBattNegCntctrCntErr_C "" VALUE 0x8024137F Val_Wu8 255.0 DFES_OneToOne 0.00 255.0 FORMAT "%5.1" /end CHARACTERISTIC
/begin CHARACTERISTIC DFC_CtlMsk2.DFC_HvBattOperModChrgPlausy_C "" VALUE 0x80241380 Val_Wu8 255.0 DFES_OneToOne 0.00 255.0 FORMAT "%5.1" /end CHARACTERISTIC
/begin CHARACTERISTIC DFC_CtlMsk2.DFC_HvBattOverTDern_C "" VALUE 0x80241381 Val_Wu8 255.0 DFES_OneToOne 0.00 255.0 FORMAT "%5.1" /end CHARACTERISTIC
/begin CHARACTERISTIC DFC_CtlMsk2.DFC_HvBattPosCntctrCntErr_C "" VALUE 0x80241382 Val_Wu8 255.0 DFES_OneToOne 0.00 255.0 FORMAT "%5.1" /end CHARACTERISTIC
/begin CHARACTERISTIC DFC_CtlMsk2.DFC_HvBattPrecCntctrCntErr_C "" VALUE 0x80241383 Val_Wu8 255.0 DFES_OneToOne 0.00 255.0 FORMAT "%5.1" /end CHARACTERISTIC
/begin CHARACTERISTIC DFC_CtlMsk2.DFC_HvBattPwrDistbnTDern_C "" VALUE 0x80241384 Val_Wu8 255.0 DFES_OneToOne 0.00 255.0 FORMAT "%5.1" /end CHARACTERISTIC
/begin CHARACTERISTIC DFC_CtlMsk2.DFC_HvBattPwrDistbnTInhbn_C "" VALUE 0x80241385 Val_Wu8 255.0 DFES_OneToOne 0.00 255.0 FORMAT "%5.1" /end CHARACTERISTIC
/begin CHARACTERISTIC DFC_CtlMsk2.DFC_HvBattRatRSohErr_C "" VALUE 0x80241386 Val_Wu8 255.0 DFES_OneToOne 0.00 255.0 FORMAT "%5.1" /end CHARACTERISTIC
/begin CHARACTERISTIC DFC_CtlMsk2.DFC_HvBattRatSohErr_C "" VALUE 0x80241387 Val_Wu8 255.0 DFES_OneToOne 0.00 255.0 FORMAT "%5.1" /end CHARACTERISTIC
/begin CHARACTERISTIC DFC_CtlMsk2.DFC_HvBattSngIsoWarn_C "" VALUE 0x80241388 Val_Wu8 255.0 DFES_OneToOne 0.00 255.0 FORMAT "%5.1" /end CHARACTERISTIC
/begin CHARACTERISTIC DFC_CtlMsk2.DFC_HvBattSrvPlgDiscnct_C "" VALUE 0x80241389 Val_Wu8 255.0 DFES_OneToOne 0.00 255.0 FORMAT "%5.1" /end CHARACTERISTIC
/begin CHARACTERISTIC DFC_CtlMsk2.DFC_HvBattUnderTDern_C "" VALUE 0x8024138C Val_Wu8 255.0 DFES_OneToOne 0.00 255.0 FORMAT "%5.1" /end CHARACTERISTIC
/begin CHARACTERISTIC DFC_CtlMsk2.DFC_InmLINBusBlk_C "" VALUE 0x80241391 Val_Wu8 255.0 DFES_OneToOne 0.00 255.0 FORMAT "%5.1" /end CHARACTERISTIC
/begin CHARACTERISTIC DFC_CtlMsk2.DFC_ComHSN1CANMute_C "" VALUE 0x8024152E Val_Wu8 255.0 DFES_OneToOne 0.00 255.0 FORMAT "%5.1" /end CHARACTERISTIC
/begin CHARACTERISTIC DFC_CtlMsk2.DFC_ComHSN3CANMute_C "" VALUE 0x8024152F Val_Wu8 255.0 DFES_OneToOne 0.00 255.0 FORMAT "%5.1" /end CHARACTERISTIC
/begin CHARACTERISTIC DFC_CtlMsk2.DFC_HvGridUMaxSftyLim_C "" VALUE 0x8024154F Val_Wu8 255.0 DFES_OneToOne 0.00 255.0 FORMAT "%5.1" /end CHARACTERISTIC
/begin CHARACTERISTIC DFC_CtlMsk2.DFC_HvGridUMinSftyLim_C "" VALUE 0x80241550 Val_Wu8 255.0 DFES_OneToOne 0.00 255.0 FORMAT "%5.1" /end CHARACTERISTIC
/begin CHARACTERISTIC DFC_CtlMsk2.DFC_HvGridUPlausy_C "" VALUE 0x80241551 Val_Wu8 255.0 DFES_OneToOne 0.00 255.0 FORMAT "%5.1" /end CHARACTERISTIC
/begin CHARACTERISTIC DFC_CtlMsk2.DFC_ComHSN1BusOff_C "" VALUE 0x80241597 Val_Wu8 255.0 DFES_OneToOne 0.00 255.0 FORMAT "%5.1" /end CHARACTERISTIC
/begin CHARACTERISTIC DFC_CtlMsk2.DFC_ComHSN3BusOff_C "" VALUE 0x80241598 Val_Wu8 255.0 DFES_OneToOne 0.00 255.0 FORMAT "%5.1" /end CHARACTERISTIC
/begin CHARACTERISTIC DFC_CtlMsk2.DFC_InmLINNodeHVACPanelAbsnt_C "" VALUE 0x8024159E Val_Wu8 255.0 DFES_OneToOne 0.00 255.0 FORMAT "%5.1" /end CHARACTERISTIC
/begin CHARACTERISTIC DFC_CtlMsk2.DFC_HvGridSocMinLim_C "" VALUE 0x802415F9 Val_Wu8 255.0 DFES_OneToOne 0.00 255.0 FORMAT "%5.1" /end CHARACTERISTIC
/begin CHARACTERISTIC DFC_DisblMsk2.DFC_HvBattChrgPwrMax_C "" VALUE 0x80248BC0 Val_Wu16 65535.00 DFES_OneToOne 0.00 65535.00 FORMAT "%8.2" /end CHARACTERISTIC
/begin CHARACTERISTIC DFC_DisblMsk2.DFC_HvBattCrashDetd_C "" VALUE 0x80248BC2 Val_Wu16 65535.00 DFES_OneToOne 0.00 65535.00 FORMAT "%8.2" /end CHARACTERISTIC
/begin CHARACTERISTIC DFC_DisblMsk2.DFC_HvBattDchaPwrMax_C "" VALUE 0x80248BC4 Val_Wu16 65535.00 DFES_OneToOne 0.00 65535.00 FORMAT "%8.2" /end CHARACTERISTIC
/begin CHARACTERISTIC DFC_DisblMsk2.DFC_HvBattEmgyOff_C "" VALUE 0x80248BC6 Val_Wu16 65535.00 DFES_OneToOne 0.00 65535.00 FORMAT "%8.2" /end CHARACTERISTIC
/begin CHARACTERISTIC DFC_DisblMsk2.DFC_HvBattEmgyOffIntlck_C "" VALUE 0x80248BC8 Val_Wu16 65535.00 DFES_OneToOne 0.00 65535.00 FORMAT "%8.2" /end CHARACTERISTIC
/begin CHARACTERISTIC DFC_DisblMsk2.DFC_HvBattEmgyOffReq_C "" VALUE 0x80248BCA Val_Wu16 65535.00 DFES_OneToOne 0.00 65535.00 FORMAT "%8.2" /end CHARACTERISTIC
/begin CHARACTERISTIC DFC_DisblMsk2.DFC_HvBattFltMod_C "" VALUE 0x80248BCC Val_Wu16 65535.00 DFES_OneToOne 0.00 65535.00 FORMAT "%8.2" /end CHARACTERISTIC
/begin CHARACTERISTIC DFC_DisblMsk2.DFC_HvBattIninTout_C "" VALUE 0x80248BD2 Val_Wu16 65535.00 DFES_OneToOne 0.00 65535.00 FORMAT "%8.2" /end CHARACTERISTIC
/begin CHARACTERISTIC DFC_DisblMsk2.DFC_HvBattIntlckSt_C "" VALUE 0x80248BD4 Val_Wu16 65535.00 DFES_OneToOne 0.00 65535.00 FORMAT "%8.2" /end CHARACTERISTIC
/begin CHARACTERISTIC DFC_DisblMsk2.DFC_HvBattIsoFlt_C "" VALUE 0x80248BD6 Val_Wu16 65535.00 DFES_OneToOne 0.00 65535.00 FORMAT "%8.2" /end CHARACTERISTIC
/begin CHARACTERISTIC DFC_DisblMsk2.DFC_HvBattLimdPwr_C "" VALUE 0x80248BD8 Val_Wu16 65535.00 DFES_OneToOne 0.00 65535.00 FORMAT "%8.2" /end CHARACTERISTIC
/begin CHARACTERISTIC DFC_DisblMsk2.DFC_HvBattMaiSwtClsngFlt_C "" VALUE 0x80248BDA Val_Wu16 65535.00 DFES_OneToOne 0.00 65535.00 FORMAT "%8.2" /end CHARACTERISTIC
/begin CHARACTERISTIC DFC_DisblMsk2.DFC_HvBattMaiSwtFlt_C "" VALUE 0x80248BDC Val_Wu16 65535.00 DFES_OneToOne 0.00 65535.00 FORMAT "%8.2" /end CHARACTERISTIC
/begin CHARACTERISTIC DFC_DisblMsk2.DFC_HvBattMaiSwtOpen_C "" VALUE 0x80248BDE Val_Wu16 65535.00 DFES_OneToOne 0.00 65535.00 FORMAT "%8.2" /end CHARACTERISTIC
/begin CHARACTERISTIC DFC_DisblMsk2.DFC_HvBattMaiSwtOpngFlt_C "" VALUE 0x80248BE0 Val_Wu16 65535.00 DFES_OneToOne 0.00 65535.00 FORMAT "%8.2" /end CHARACTERISTIC
/begin CHARACTERISTIC DFC_DisblMsk2.DFC_HvBattMaiSwtWldd_C "" VALUE 0x80248BE2 Val_Wu16 65535.00 DFES_OneToOne 0.00 65535.00 FORMAT "%8.2" /end CHARACTERISTIC
/begin CHARACTERISTIC DFC_DisblMsk2.DFC_HvBattNegCntctrCntErr_C "" VALUE 0x80248BE4 Val_Wu16 65535.00 DFES_OneToOne 0.00 65535.00 FORMAT "%8.2" /end CHARACTERISTIC
/begin CHARACTERISTIC DFC_DisblMsk2.DFC_HvBattOperModChrgPlausy_C "" VALUE 0x80248BE6 Val_Wu16 65535.00 DFES_OneToOne 0.00 65535.00 FORMAT "%8.2" /end CHARACTERISTIC
/begin CHARACTERISTIC DFC_DisblMsk2.DFC_HvBattOverTDern_C "" VALUE 0x80248BE8 Val_Wu16 65535.00 DFES_OneToOne 0.00 65535.00 FORMAT "%8.2" /end CHARACTERISTIC
/begin CHARACTERISTIC DFC_DisblMsk2.DFC_HvBattPosCntctrCntErr_C "" VALUE 0x80248BEA Val_Wu16 65535.00 DFES_OneToOne 0.00 65535.00 FORMAT "%8.2" /end CHARACTERISTIC
/begin CHARACTERISTIC DFC_DisblMsk2.DFC_HvBattPrecCntctrCntErr_C "" VALUE 0x80248BEC Val_Wu16 65535.00 DFES_OneToOne 0.00 65535.00 FORMAT "%8.2" /end CHARACTERISTIC
/begin CHARACTERISTIC DFC_DisblMsk2.DFC_HvBattPwrDistbnTDern_C "" VALUE 0x80248BEE Val_Wu16 65535.00 DFES_OneToOne 0.00 65535.00 FORMAT "%8.2" /end CHARACTERISTIC
/begin CHARACTERISTIC DFC_DisblMsk2.DFC_HvBattPwrDistbnTInhbn_C "" VALUE 0x80248BF0 Val_Wu16 65535.00 DFES_OneToOne 0.00 65535.00 FORMAT "%8.2" /end CHARACTERISTIC
/begin CHARACTERISTIC DFC_DisblMsk2.DFC_HvBattRatRSohErr_C "" VALUE 0x80248BF2 Val_Wu16 65535.00 DFES_OneToOne 0.00 65535.00 FORMAT "%8.2" /end CHARACTERISTIC
/begin CHARACTERISTIC DFC_DisblMsk2.DFC_HvBattRatSohErr_C "" VALUE 0x80248BF4 Val_Wu16 65535.00 DFES_OneToOne 0.00 65535.00 FORMAT "%8.2" /end CHARACTERISTIC
/begin CHARACTERISTIC DFC_DisblMsk2.DFC_HvBattSngIsoWarn_C "" VALUE 0x80248BF6 Val_Wu16 65535.00 DFES_OneToOne 0.00 65535.00 FORMAT "%8.2" /end CHARACTERISTIC
/begin CHARACTERISTIC DFC_DisblMsk2.DFC_HvBattSrvPlgDiscnct_C "" VALUE 0x80248BF8 Val_Wu16 65535.00 DFES_OneToOne 0.00 65535.00 FORMAT "%8.2" /end CHARACTERISTIC
/begin CHARACTERISTIC DFC_DisblMsk2.DFC_HvBattUnderTDern_C "" VALUE 0x80248BFE Val_Wu16 65535.00 DFES_OneToOne 0.00 65535.00 FORMAT "%8.2" /end CHARACTERISTIC
/begin CHARACTERISTIC DFC_DisblMsk2.DFC_InmLINBusBlk_C "" VALUE 0x80248C08 Val_Wu16 65535.00 DFES_OneToOne 0.00 65535.00 FORMAT "%8.2" /end CHARACTERISTIC
/begin CHARACTERISTIC DFC_DisblMsk2.DFC_ComHSN1CANMute_C "" VALUE 0x80248F42 Val_Wu16 65535.00 DFES_OneToOne 0.00 65535.00 FORMAT "%8.2" /end CHARACTERISTIC
/begin CHARACTERISTIC DFC_DisblMsk2.DFC_ComHSN3CANMute_C "" VALUE 0x80248F44 Val_Wu16 65535.00 DFES_OneToOne 0.00 65535.00 FORMAT "%8.2" /end CHARACTERISTIC
/begin CHARACTERISTIC DFC_DisblMsk2.DFC_HvGridUMaxSftyLim_C "" VALUE 0x80248F84 Val_Wu16 65535.00 DFES_OneToOne 0.00 65535.00 FORMAT "%8.2" /end CHARACTERISTIC
/begin CHARACTERISTIC DFC_DisblMsk2.DFC_HvGridUMinSftyLim_C "" VALUE 0x80248F86 Val_Wu16 65535.00 DFES_OneToOne 0.00 65535.00 FORMAT "%8.2" /end CHARACTERISTIC
/begin CHARACTERISTIC DFC_DisblMsk2.DFC_HvGridUPlausy_C "" VALUE 0x80248F88 Val_Wu16 65535.00 DFES_OneToOne 0.00 65535.00 FORMAT "%8.2" /end CHARACTERISTIC
/begin CHARACTERISTIC DFC_DisblMsk2.DFC_ComHSN1BusOff_C "" VALUE 0x80249014 Val_Wu16 65535.00 DFES_OneToOne 0.00 65535.00 FORMAT "%8.2" /end CHARACTERISTIC
/begin CHARACTERISTIC DFC_DisblMsk2.DFC_ComHSN3BusOff_C "" VALUE 0x80249016 Val_Wu16 65535.00 DFES_OneToOne 0.00 65535.00 FORMAT "%8.2" /end CHARACTERISTIC
/begin CHARACTERISTIC DFC_DisblMsk2.DFC_InmLINNodeHVACPanelAbsnt_C "" VALUE 0x80249022 Val_Wu16 65535.00 DFES_OneToOne 0.00 65535.00 FORMAT "%8.2" /end CHARACTERISTIC
/begin CHARACTERISTIC DFC_DisblMsk2.DFC_HvGridSocMinLim_C "" VALUE 0x802490D8 Val_Wu16 65535.00 DFES_OneToOne 0.00 65535.00 FORMAT "%8.2" /end CHARACTERISTIC
/begin CHARACTERISTIC GMP_actif_C "calibration to simulate the HYB_DIAG_ON condition" VALUE 0x8024E6F2 Val_Wu8 15.0000000000 CoPtFH_stPwt_VERB 0.00 15.0000000000 FORMAT "%13.10" /end CHARACTERISTIC
/begin CHARACTERISTIC HvBatt_cntNegSeg1ReplcmtVal_C "Replacement value for segment1 count of negative contactor." VALUE 0x80250A2C RB_Val_Wu32 274877906880. q64 0.00 274877906880. FORMAT "%13.0" /end CHARACTERISTIC
/begin CHARACTERISTIC HvBatt_cntNegSeg2ReplcmtVal_C "Replacement value for segment2 count of negative contactor." VALUE 0x80250A30 RB_Val_Wu16 1048560. q16 0.00 1048560. FORMAT "%8.0" /end CHARACTERISTIC
/begin CHARACTERISTIC HvBatt_cntNegSeg3ReplcmtVal_C "Replacement value for segment3 count of negative contactor." VALUE 0x80250A32 RB_Val_Wu16 524280.0 q8 0.00 524280.0 FORMAT "%8.1" /end CHARACTERISTIC
/begin CHARACTERISTIC HvBatt_cntNegSeg4ReplcmtVal_C "Replacement value for segment4 count of negative contactor." VALUE 0x80250A34 RB_Val_Wu8 255.0 OneToOne 0.00 255.0 FORMAT "%5.1" /end CHARACTERISTIC
/begin CHARACTERISTIC HvBatt_cntNegSeg5ReplcmtVal_C "Replacement value for segment5 count of negative contactor." VALUE 0x80250A35 RB_Val_Wu8 255.0 OneToOne 0.00 255.0 FORMAT "%5.1" /end CHARACTERISTIC
/begin CHARACTERISTIC HvBatt_cntPosSeg1ReplcmtVal_C "Replacement value for segment1 count of positive contactor." VALUE 0x80250A38 RB_Val_Wu32 274877906880. q64 0.00 274877906880. FORMAT "%13.0" /end CHARACTERISTIC
/begin CHARACTERISTIC HvBatt_cntPosSeg2ReplcmtVal_C "Replacement value for segment2 count of positive contactor." VALUE 0x80250A3C RB_Val_Wu16 1048560. q16 0.00 1048560. FORMAT "%8.0" /end CHARACTERISTIC
/begin CHARACTERISTIC HvBatt_cntPosSeg3ReplcmtVal_C "Replacement value for segment3 count of positive contactor." VALUE 0x80250A3E RB_Val_Wu16 524280.0 q8 0.00 524280.0 FORMAT "%8.1" /end CHARACTERISTIC
/begin CHARACTERISTIC HvBatt_cntPosSeg4ReplcmtVal_C "Replacement value for segment4 count of positive contactor." VALUE 0x80250A40 RB_Val_Wu8 255.0 OneToOne 0.00 255.0 FORMAT "%5.1" /end CHARACTERISTIC
/begin CHARACTERISTIC HvBatt_cntPosSeg5ReplcmtVal_C "Replacement value for segment5 count of positive contactor." VALUE 0x80250A41 RB_Val_Wu8 255.0 OneToOne 0.00 255.0 FORMAT "%5.1" /end CHARACTERISTIC
/begin CHARACTERISTIC HvBatt_cntPrecSeg1ReplcmtVal_C "Replacement value for segment1 count of precharge contactor." VALUE 0x80250A44 RB_Val_Wu32 274877906880. q64 0.00 274877906880. FORMAT "%13.0" /end CHARACTERISTIC
/begin CHARACTERISTIC HvBatt_cntPrecSeg2ReplcmtVal_C "Replacement value for segment2 count of precharge contactor." VALUE 0x80250A48 RB_Val_Wu16 524280.0 q8 0.00 524280.0 FORMAT "%8.1" /end CHARACTERISTIC
/begin CHARACTERISTIC HvBatt_dpwrChrgContnsRmpMaxNeg_C "Calibratable slope value for negative ramping during continous charging" VALUE 0x80250A68 RB_Val_Ws32 6553599.99847 q0p001525_W_DIV_s -3276800.00000 3276799.99847 FORMAT "%13.5" /end CHARACTERISTIC
/begin CHARACTERISTIC HvBatt_dpwrChrgContnsRmpMaxPos_C "Calibratable slope value for positive ramping during continous charging" VALUE 0x80250A6C RB_Val_Ws32 6553599.99847 q0p001525_W_DIV_s -3276800.00000 3276799.99847 FORMAT "%13.5" /end CHARACTERISTIC
/begin CHARACTERISTIC HvBatt_dpwrChrgShoRmpMaxNeg_C "Calibratable slope value for negative ramping during short charging" VALUE 0x80250A70 RB_Val_Ws32 6553599.99847 q0p001525_W_DIV_s -3276800.00000 3276799.99847 FORMAT "%13.5" /end CHARACTERISTIC
/begin CHARACTERISTIC HvBatt_dpwrChrgShoRmpMaxPos_C "Calibratable slope value for positive ramping during short charging" VALUE 0x80250A74 RB_Val_Ws32 6553599.99847 q0p001525_W_DIV_s -3276800.00000 3276799.99847 FORMAT "%13.5" /end CHARACTERISTIC
/begin CHARACTERISTIC HvBatt_dpwrDchaContnsRmpMaxNeg_C "Calibratable slope value for negative ramping during continous discharging" VALUE 0x80250A78 RB_Val_Ws32 6553599.99847 q0p001525_W_DIV_s -3276800.00000 3276799.99847 FORMAT "%13.5" /end CHARACTERISTIC
/begin CHARACTERISTIC HvBatt_dpwrDchaContnsRmpMaxPos_C "Calibratable slope value for positive ramping during continous discharging" VALUE 0x80250A7C RB_Val_Ws32 6553599.99847 q0p001525_W_DIV_s -3276800.00000 3276799.99847 FORMAT "%13.5" /end CHARACTERISTIC
/begin CHARACTERISTIC HvBatt_dpwrDchaShoRmpMaxNeg_C "Calibratable slope value for negative ramping during short discharging" VALUE 0x80250A80 RB_Val_Ws32 6553599.99847 q0p001525_W_DIV_s -3276800.00000 3276799.99847 FORMAT "%13.5" /end CHARACTERISTIC
/begin CHARACTERISTIC HvBatt_dpwrDchaShoRmpMaxPos_C "Calibratable slope value for positive ramping during short discharging" VALUE 0x80250A84 RB_Val_Ws32 6553599.99847 q0p001525_W_DIV_s -3276800.00000 3276799.99847 FORMAT "%13.5" /end CHARACTERISTIC
/begin CHARACTERISTIC HvBatt_egyAvlSrcSoC_T "Curve to calculate the remaining HV Battery energy based on SoC" CURVE 0x80250A88 RB_Curve_S16_R32_sao 2.000E+037 RBPtCel_pwr_1p0_4 -1.000E+037 1.000E+037 FORMAT "%8.3" EXTENDED_LIMITS -3.403E+038 3.403E+038
 /begin AXIS_DESCR STD_AXIS HvBatt_ratSoc Prc 5 -400.0000 399.9878 FORMAT "%8.4" DEPOSIT ABSOLUTE /end AXIS_DESCR
/end CHARACTERISTIC
/begin CHARACTERISTIC HvBatt_facChrgContnsDifLimTau_T "Factor for time constant in charge continuous limits" CURVE 0x80250AA8 RB_Curve_S16_S32_sao 4294.9672940000000 TimeDelay_s 0.0000020000000 4294.9672959999998 FORMAT "%19.14" EXTENDED_LIMITS 0.000002000000001 4294.9672959999998
 /begin AXIS_DESCR STD_AXIS HvBatt_pwrMaxChrgContnsDif RBPtCel_pwr_25p0_1 9 -819200.0 819175.0 FORMAT "%8.1" DEPOSIT ABSOLUTE /end AXIS_DESCR
/end CHARACTERISTIC
/begin CHARACTERISTIC HvBatt_facChrgContnsLimPwrSoC_M "The map defines the continous charging SoC Limit factor" MAP 0x80250AE0 RB_Map_S16S16_S16 655.3500 Fact100 -327.6800 327.6700 FORMAT "%8.4"
 /begin AXIS_DESCR STD_AXIS HvBatt_ratSoc Prc 9 -400.0000 399.9878 FORMAT "%8.4" DEPOSIT ABSOLUTE /end AXIS_DESCR
 /begin AXIS_DESCR STD_AXIS HvBatt_pwrMaxChrgContnsDif RBPtCel_pwr_25p0_1 9 -819200.0 819175.0 FORMAT "%8.1" DEPOSIT ABSOLUTE /end AXIS_DESCR
/end CHARACTERISTIC
/begin CHARACTERISTIC HvBatt_facChrgShoDifLimTau_T "Factor for time constant in short term charge limits" CURVE 0x80250BAC RB_Curve_S16_S32_sao 4294.9672940000000 TimeDelay_s 0.0000020000000 4294.9672959999998 FORMAT "%19.14" EXTENDED_LIMITS 0.000002000000001 4294.9672959999998
 /begin AXIS_DESCR STD_AXIS HvBatt_pwrMaxChrgShoDif RBPtCel_pwr_25p0_1 9 -819200.0 819175.0 FORMAT "%8.1" DEPOSIT ABSOLUTE /end AXIS_DESCR
/end CHARACTERISTIC
/begin CHARACTERISTIC HvBatt_facChrgShoLimPwrSoC_M "The map defines the short charging SoC Limit factor" MAP 0x80250BE4 RB_Map_S16S16_S16 655.3500 Fact100 -327.6800 327.6700 FORMAT "%8.4"
 /begin AXIS_DESCR STD_AXIS HvBatt_ratSoc Prc 9 -400.0000 399.9878 FORMAT "%8.4" DEPOSIT ABSOLUTE /end AXIS_DESCR
 /begin AXIS_DESCR STD_AXIS HvBatt_pwrMaxChrgShoDif RBPtCel_pwr_25p0_1 9 -819200.0 819175.0 FORMAT "%8.1" DEPOSIT ABSOLUTE /end AXIS_DESCR
/end CHARACTERISTIC
/begin CHARACTERISTIC HvBatt_facDchaContnsDifLimTau_T "Factor for time constant in discharge continuous limits" CURVE 0x80250CB0 RB_Curve_S16_S32_sao 4294.9672940000000 TimeDelay_s 0.0000020000000 4294.9672959999998 FORMAT "%19.14" EXTENDED_LIMITS 0.000002000000001 4294.9672959999998
 /begin AXIS_DESCR STD_AXIS HvBatt_pwrDchaContnsActMeasd RBPtCel_pwr_25p0_1 9 -819200.0 819175.0 FORMAT "%8.1" DEPOSIT ABSOLUTE /end AXIS_DESCR
/end CHARACTERISTIC
/begin CHARACTERISTIC HvBatt_facDchaContnsLimPwrSoC_M "The map defines the continous discharging SoC Limit factor" MAP 0x80250CE8 RB_Map_S16S16_S16 655.3500 Fact100 -327.6800 327.6700 FORMAT "%8.4"
 /begin AXIS_DESCR STD_AXIS HvBatt_ratSoc Prc 9 -400.0000 399.9878 FORMAT "%8.4" DEPOSIT ABSOLUTE /end AXIS_DESCR
 /begin AXIS_DESCR STD_AXIS HvBatt_pwrDchaContnsActMeasd RBPtCel_pwr_25p0_1 9 -819200.0 819175.0 FORMAT "%8.1" DEPOSIT ABSOLUTE /end AXIS_DESCR
/end CHARACTERISTIC
/begin CHARACTERISTIC HvBatt_facDchaShoDifLimTau_T "Factor for time constant in short term discharge limits" CURVE 0x80250DB4 RB_Curve_S16_S32_sao 4294.9672940000000 TimeDelay_s 0.0000020000000 4294.9672959999998 FORMAT "%19.14" EXTENDED_LIMITS 0.000002000000001 4294.9672959999998
 /begin AXIS_DESCR STD_AXIS HvBatt_pwrMaxDchaShoDif RBPtCel_pwr_25p0_1 9 -819200.0 819175.0 FORMAT "%8.1" DEPOSIT ABSOLUTE /end AXIS_DESCR
/end CHARACTERISTIC
/begin CHARACTERISTIC HvBatt_facDchaShoLimPwrSoC_M "The map defines the short discharging SoC Limit factor" MAP 0x80250DEC RB_Map_S16S16_S16 655.3500 Fact100 -327.6800 327.6700 FORMAT "%8.4"
 /begin AXIS_DESCR STD_AXIS HvBatt_ratSoc Prc 9 -400.0000 399.9878 FORMAT "%8.4" DEPOSIT ABSOLUTE /end AXIS_DESCR
 /begin AXIS_DESCR STD_AXIS HvBatt_pwrMaxDchaShoDif RBPtCel_pwr_25p0_1 9 -819200.0 819175.0 FORMAT "%8.1" DEPOSIT ABSOLUTE /end AXIS_DESCR
/end CHARACTERISTIC
/begin CHARACTERISTIC HvBatt_facMaxChrgBusTDern_T "Curve for busbar temperature derating factor when charing limits" CURVE 0x80250EB8 RB_Curve_R32_S16_sao 655.3500 Fact100 -327.6800 327.6700 FORMAT "%8.4"
 /begin AXIS_DESCR STD_AXIS PwrDistbnUnitT_t_f RBPtCel_t_1p0_3 11 -1.00000000E+037 1.00000000E+037 FORMAT "%13.3" EXTENDED_LIMITS -3.40282347E+038 3.40282347E+038 DEPOSIT ABSOLUTE /end AXIS_DESCR
/end CHARACTERISTIC
/begin CHARACTERISTIC HvBatt_facMaxDchaBusTDern_T "Curve for busbar temperature derating factor when discharing limits" CURVE 0x80250F00 RB_Curve_R32_S16_sao 655.3500 Fact100 -327.6800 327.6700 FORMAT "%8.4"
 /begin AXIS_DESCR STD_AXIS PwrDistbnUnitT_t_f RBPtCel_t_1p0_3 11 -1.00000000E+037 1.00000000E+037 FORMAT "%13.3" EXTENDED_LIMITS -3.40282347E+038 3.40282347E+038 DEPOSIT ABSOLUTE /end AXIS_DESCR
/end CHARACTERISTIC
/begin CHARACTERISTIC HvBatt_facPwrChrgContnsDifInp_T "Curve with respect to power difference and differential input to integrator for discharge continuous power limit" CURVE 0x80250F48 RB_Curve_S16_R32_sao 2.0000E+037 RBPtCel_frq_1p0_1 -1.0000E+037 1.0000E+037 FORMAT "%9.4" EXTENDED_LIMITS -3.4028E+038 3.4028E+038
 /begin AXIS_DESCR STD_AXIS HvBatt_pwrMaxChrgContnsDif RBPtCel_pwr_25p0_1 9 -819200.0 819175.0 FORMAT "%8.1" DEPOSIT ABSOLUTE /end AXIS_DESCR
/end CHARACTERISTIC
/begin CHARACTERISTIC HvBatt_facPwrChrgShoDifInp_T "Charge short difference input map" CURVE 0x80250F80 RB_Curve_S16_R32_sao 2.0000E+037 RBPtCel_frq_1p0_1 -1.0000E+037 1.0000E+037 FORMAT "%9.4" EXTENDED_LIMITS -3.4028E+038 3.4028E+038
 /begin AXIS_DESCR STD_AXIS HvBatt_pwrMaxChrgShoDif RBPtCel_pwr_25p0_1 9 -819200.0 819175.0 FORMAT "%8.1" DEPOSIT ABSOLUTE /end AXIS_DESCR
/end CHARACTERISTIC
/begin CHARACTERISTIC HvBatt_facPwrDchaContnsDifInp_T "Discharge continous input map to integrator" CURVE 0x80250FB8 RB_Curve_S16_R32_sao 2.0000E+037 RBPtCel_frq_1p0_1 -1.0000E+037 1.0000E+037 FORMAT "%9.4" EXTENDED_LIMITS -3.4028E+038 3.4028E+038
 /begin AXIS_DESCR STD_AXIS HvBatt_pwrDchaContnsActMeasd RBPtCel_pwr_25p0_1 9 -819200.0 819175.0 FORMAT "%8.1" DEPOSIT ABSOLUTE /end AXIS_DESCR
/end CHARACTERISTIC
/begin CHARACTERISTIC HvBatt_facPwrDchaShoDifInp_T "Curve for discharge short term difference input" CURVE 0x80250FF0 RB_Curve_S16_R32_sao 2.0000E+037 RBPtCel_frq_1p0_1 -1.0000E+037 1.0000E+037 FORMAT "%9.4" EXTENDED_LIMITS -3.4028E+038 3.4028E+038
 /begin AXIS_DESCR STD_AXIS HvBatt_pwrMaxDchaShoDif RBPtCel_pwr_25p0_1 9 -819200.0 819175.0 FORMAT "%8.1" DEPOSIT ABSOLUTE /end AXIS_DESCR
/end CHARACTERISTIC
/begin CHARACTERISTIC HvBatt_facPwrMaxChrgContnsGainCon_T "curve for Gain constant for charge continuous power limit" CURVE 0x80251028 RB_Curve_S16_R32_sao 2.000000E+037 RBPtCel_ti_1p0_2 -1.000000E+037 1.000000E+037 FORMAT "%9.6" EXTENDED_LIMITS -3.402823E+038 3.402823E+038
 /begin AXIS_DESCR STD_AXIS HvBatt_pwrMaxChrgContnsDif RBPtCel_pwr_25p0_1 9 -819200.0 819175.0 FORMAT "%8.1" DEPOSIT ABSOLUTE /end AXIS_DESCR
/end CHARACTERISTIC
/begin CHARACTERISTIC HvBatt_facPwrMaxChrgShoGainCon_T "curve for Gain constant for charge short power limit" CURVE 0x80251060 RB_Curve_S16_R32_sao 2.000000E+037 RBPtCel_ti_1p0_2 -1.000000E+037 1.000000E+037 FORMAT "%9.6" EXTENDED_LIMITS -3.402823E+038 3.402823E+038
 /begin AXIS_DESCR STD_AXIS HvBatt_pwrMaxChrgShoDif RBPtCel_pwr_25p0_1 9 -819200.0 819175.0 FORMAT "%8.1" DEPOSIT ABSOLUTE /end AXIS_DESCR
/end CHARACTERISTIC
/begin CHARACTERISTIC HvBatt_facPwrMaxDchaContnsGainCon_T "curve for Gain constant for discharge continuous power limit" CURVE 0x80251098 RB_Curve_S16_R32_sao 2.000000E+037 RBPtCel_ti_1p0_2 -1.000000E+037 1.000000E+037 FORMAT "%9.6" EXTENDED_LIMITS -3.402823E+038 3.402823E+038
 /begin AXIS_DESCR STD_AXIS HvBatt_pwrDchaContnsActMeasd RBPtCel_pwr_25p0_1 9 -819200.0 819175.0 FORMAT "%8.1" DEPOSIT ABSOLUTE /end AXIS_DESCR
/end CHARACTERISTIC
/begin CHARACTERISTIC HvBatt_facPwrMaxDchaShoGainCon_T "curve for Gain constant for discharge short power limit" CURVE 0x802510D0 RB_Curve_S16_R32_sao 2.000000E+037 RBPtCel_ti_1p0_2 -1.000000E+037 1.000000E+037 FORMAT "%9.6" EXTENDED_LIMITS -3.402823E+038 3.402823E+038
 /begin AXIS_DESCR STD_AXIS HvBatt_pwrMaxDchaShoDif RBPtCel_pwr_25p0_1 9 -819200.0 819175.0 FORMAT "%8.1" DEPOSIT ABSOLUTE /end AXIS_DESCR
/end CHARACTERISTIC
/begin CHARACTERISTIC HvBatt_facPwrMaxGen_C "Factor to calculate maximum power limit which can be given to generator at any point of time" VALUE 0x80251108 RB_Val_Ws16 7.999878 Fact -4.000000 3.999878 FORMAT "%8.6" /end CHARACTERISTIC
/begin CHARACTERISTIC HvBatt_flgChrgContnsLimPwrIntegDi_C "Calibration to disable integrator for charge continuous limit" VALUE 0x8025110A RB_Val_Wu8 1.00000000000 B_TRUE 0.00 1.00000000000 FORMAT "%13.11" /end CHARACTERISTIC
/begin CHARACTERISTIC HvBatt_flgChrgShoLimPwrIntegDi_C "Calibration to disable integrator for charge short limit" VALUE 0x8025110B RB_Val_Wu8 1.00000000000 B_TRUE 0.00 1.00000000000 FORMAT "%13.11" /end CHARACTERISTIC
/begin CHARACTERISTIC HvBatt_flgDchaContnsLimPwrIntegDi_C "Calibration to disable integrator for discharge continuous limit" VALUE 0x8025110C RB_Val_Wu8 1.00000000000 B_TRUE 0.00 1.00000000000 FORMAT "%13.11" /end CHARACTERISTIC
/begin CHARACTERISTIC HvBatt_flgDchaShoLimPwrIntegDi_C "Calibration to disable integrator for discharge short limit" VALUE 0x8025110D RB_Val_Wu8 1.00000000000 B_TRUE 0.00 1.00000000000 FORMAT "%13.11" /end CHARACTERISTIC
/begin CHARACTERISTIC HvBatt_flgPwrLimPrdnAvl_C "power limit pridiction flag" VALUE 0x8025110E RB_Val_Wu8 1.00000000000 B_TRUE 0.00 1.00000000000 FORMAT "%13.11" /end CHARACTERISTIC
/begin CHARACTERISTIC HvBatt_maskDernMaxTSq_C "HV Battery derating due to maximum temperature" VALUE 0x80250A4A RB_Val_Wu16 65535.00 OneToOne 0.00 65535.00 FORMAT "%8.2" /end CHARACTERISTIC
/begin CHARACTERISTIC HvBatt_maskDernMinTSq_C "HV Battery derating due to minimum temperature" VALUE 0x80250A4C RB_Val_Wu16 65535.00 OneToOne 0.00 65535.00 FORMAT "%8.2" /end CHARACTERISTIC
/begin CHARACTERISTIC HvBatt_maskHvbCntctSq_C "Mask to select the signal quality of the contact status of the HV battery" VALUE 0x80251150 RB_Val_Wu16 65535.00 OneToOne 0.00 65535.00 FORMAT "%8.2" /end CHARACTERISTIC
/begin CHARACTERISTIC HvBatt_maskHvbFltDiagSq_C "HV Battery Fault Diganosis" VALUE 0x80250A4E RB_Val_Wu16 65535.00 OneToOne 0.00 65535.00 FORMAT "%8.2" /end CHARACTERISTIC
/begin CHARACTERISTIC HvBatt_maskHvbFltSq_C "Mask to select the signal quality of HV battery error status message" VALUE 0x80251152 RB_Val_Wu16 65535.00 OneToOne 0.00 65535.00 FORMAT "%8.2" /end CHARACTERISTIC
/begin CHARACTERISTIC HvBatt_maskHvbIntlckSq_C "HV Battery Interlock" VALUE 0x80250A50 RB_Val_Wu16 65535.00 OneToOne 0.00 65535.00 FORMAT "%8.2" /end CHARACTERISTIC
/begin CHARACTERISTIC HvBatt_maskHvbIsoFltSq_C "HV Battery Isolation Fault" VALUE 0x80250A52 RB_Val_Wu16 65535.00 OneToOne 0.00 65535.00 FORMAT "%8.2" /end CHARACTERISTIC
/begin CHARACTERISTIC HvBatt_maskHvbModSq_C "Mask to select the signal quality of status of HV battery" VALUE 0x80251154 RB_Val_Wu16 65535.00 OneToOne 0.00 65535.00 FORMAT "%8.2" /end CHARACTERISTIC
/begin CHARACTERISTIC HvBatt_maskpwrActMeasdVldySq_C "Calibration mask to detect signal validity of actual measured power" VALUE 0x80251110 RB_Val_Wu16 65535.00 OneToOne 0.00 65535.00 FORMAT "%8.2" /end CHARACTERISTIC
/begin CHARACTERISTIC HvBatt_maskpwrMaxChrgContnsVldySq_C "Calibration mask to detect signal validity of maximum power during short charging" VALUE 0x80251112 RB_Val_Wu16 65535.00 OneToOne 0.00 65535.00 FORMAT "%8.2" /end CHARACTERISTIC
/begin CHARACTERISTIC HvBatt_maskpwrMaxChrgShoVldySq_C "Calibration mask to detect signal validity of maximum power during short charging" VALUE 0x80251114 RB_Val_Wu16 65535.00 OneToOne 0.00 65535.00 FORMAT "%8.2" /end CHARACTERISTIC
/begin CHARACTERISTIC HvBatt_maskpwrMaxDchaContnsVldySq_C "Calibration mask to detect signal validity of maximum power during continuous discharging" VALUE 0x80251116 RB_Val_Wu16 65535.00 OneToOne 0.00 65535.00 FORMAT "%8.2" /end CHARACTERISTIC
/begin CHARACTERISTIC HvBatt_maskpwrMaxDchaShoVldySq_C "Calibration mask to detect signal validity of maximum power during short discharging" VALUE 0x80251118 RB_Val_Wu16 65535.00 OneToOne 0.00 65535.00 FORMAT "%8.2" /end CHARACTERISTIC
/begin CHARACTERISTIC HvBatt_maskratSocVldySq_C "Calibration mask to detect signal validity of State of Charge ratio" VALUE 0x8025111A RB_Val_Wu16 65535.00 OneToOne 0.00 65535.00 FORMAT "%8.2" /end CHARACTERISTIC
/begin CHARACTERISTIC HvBatt_maskSpdErrSq_C "Calibration mask for signal Speed" VALUE 0x80250A54 RB_Val_Wu16 65535.00 OneToOne 0.00 65535.00 FORMAT "%8.2" /end CHARACTERISTIC
/begin CHARACTERISTIC HvBatt_maskSrvPlgErrSq_C "Calibration mask for signal Service plug" VALUE 0x80250A56 RB_Val_Wu16 65535.00 OneToOne 0.00 65535.00 FORMAT "%8.2" /end CHARACTERISTIC
/begin CHARACTERISTIC HvBatt_PwrChrgContnsLimMax_C "Calibration forcharge continuous power limits" VALUE 0x8025111C RB_Val_Ws16 65535.00 OneToOne -32768.00 32767.00 FORMAT "%8.2" /end CHARACTERISTIC
/begin CHARACTERISTIC HvBatt_PwrChrgContnsLimMin_C "Calibration for minimum power limit for charge continuous" VALUE 0x8025111E RB_Val_Ws16 65535.00 OneToOne -32768.00 32767.00 FORMAT "%8.2" /end CHARACTERISTIC
/begin CHARACTERISTIC HvBatt_PwrChrgContnsMeasd_C "Calibration for charge continous measured power limits" VALUE 0x80251120 RB_Val_Ws16 1638375. RBPtCel_pwr_25p0_1 -819200.0 819175.0 FORMAT "%8.1" /end CHARACTERISTIC
/begin CHARACTERISTIC HvBatt_pwrChrgLvl3Dern_C "Calibratable derating power when Level 3 fault during charging" VALUE 0x80251122 RB_Val_Ws16 1638375. RBPtCel_pwr_25p0_1 -819200.0 819175.0 FORMAT "%8.1" /end CHARACTERISTIC
/begin CHARACTERISTIC HvBatt_PwrChrgShoActMeasd_C "Calibration for charge short measured power limits" VALUE 0x80251124 RB_Val_Ws16 1638375. RBPtCel_pwr_25p0_1 -819200.0 819175.0 FORMAT "%8.1" /end CHARACTERISTIC
/begin CHARACTERISTIC HvBatt_PwrChrgShoLimMax_C "Calibration for short term charge max limit" VALUE 0x80251126 RB_Val_Ws16 65535.00 OneToOne -32768.00 32767.00 FORMAT "%8.2" /end CHARACTERISTIC
/begin CHARACTERISTIC HvBatt_PwrChrgShoLimMin_C "Calibration for short term charge minimum power limit" VALUE 0x80251128 RB_Val_Ws16 65535.00 OneToOne -32768.00 32767.00 FORMAT "%8.2" /end CHARACTERISTIC
/begin CHARACTERISTIC HvBatt_PwrDchaContnsLimMax_C "Calibration for maximum discharge continuous power limit" VALUE 0x8025112A RB_Val_Ws16 65535.00 OneToOne -32768.00 32767.00 FORMAT "%8.2" /end CHARACTERISTIC
/begin CHARACTERISTIC HvBatt_PwrDchaContnsLimMin_C "Calibration for minimum discharge continuous power limit" VALUE 0x8025112C RB_Val_Ws16 65535.00 OneToOne -32768.00 32767.00 FORMAT "%8.2" /end CHARACTERISTIC
/begin CHARACTERISTIC HvBatt_PwrDchaContnsMeasd_C "Calibration for discharge continous measured power limits" VALUE 0x8025112E RB_Val_Ws16 1638375. RBPtCel_pwr_25p0_1 -819200.0 819175.0 FORMAT "%8.1" /end CHARACTERISTIC
/begin CHARACTERISTIC HvBatt_pwrDchaLvl3Dern_C "Calibratable derating power when Level 3 fault during discharging" VALUE 0x80251130 RB_Val_Ws16 1638375. RBPtCel_pwr_25p0_1 -819200.0 819175.0 FORMAT "%8.1" /end CHARACTERISTIC
/begin CHARACTERISTIC HvBatt_PwrDchaShoActMeasd_C "Calibration for discharge short measured power limits" VALUE 0x80251132 RB_Val_Ws16 1638375. RBPtCel_pwr_25p0_1 -819200.0 819175.0 FORMAT "%8.1" /end CHARACTERISTIC
/begin CHARACTERISTIC HvBatt_PwrDchaShoLimMax_C "Calibration for max discharge short power limit" VALUE 0x80251134 RB_Val_Ws16 65535.00 OneToOne -32768.00 32767.00 FORMAT "%8.2" /end CHARACTERISTIC
/begin CHARACTERISTIC HvBatt_PwrDchaShoLimMin_C "Calibration for Minimum limit for discharge short power limit" VALUE 0x80251136 RB_Val_Ws16 65535.00 OneToOne -32768.00 32767.00 FORMAT "%8.2" /end CHARACTERISTIC
/begin CHARACTERISTIC HvBatt_pwrDiffActTarChrgContns_C "Calibration for maximum actual and taget power difference in short discharging" VALUE 0x80251138 RB_Val_Ws16 1638375. RBPtCel_pwr_25p0_1 -819200.0 819175.0 FORMAT "%8.1" /end CHARACTERISTIC
/begin CHARACTERISTIC HvBatt_pwrDiffActTarChrgSho_C "Calibration for maximum actual and taget power difference in short charging" VALUE 0x8025113A RB_Val_Ws16 1638375. RBPtCel_pwr_25p0_1 -819200.0 819175.0 FORMAT "%8.1" /end CHARACTERISTIC
/begin CHARACTERISTIC HvBatt_pwrDiffActTarDchaContns_C "Calibration for maximum actual and taget power difference in continuous discharging" VALUE 0x8025113C RB_Val_Ws16 1638375. RBPtCel_pwr_25p0_1 -819200.0 819175.0 FORMAT "%8.1" /end CHARACTERISTIC
/begin CHARACTERISTIC HvBatt_pwrDiffActTarDchaSho_C "Calibration for maximum actual and taget power difference in short discharging" VALUE 0x8025113E RB_Val_Ws16 1638375. RBPtCel_pwr_25p0_1 -819200.0 819175.0 FORMAT "%8.1" /end CHARACTERISTIC
/begin CHARACTERISTIC HvBatt_pwrMaxDchaContnsLim_C "Calibration to limit Maximum Discharge Power Continuous" VALUE 0x80251140 RB_Val_Ws16 1638375. RBPtCel_pwr_25p0_1 -819200.0 819175.0 FORMAT "%8.1" /end CHARACTERISTIC
/begin CHARACTERISTIC HvBatt_pwrMaxDchaShoLim_C "Calibration to limit Maximum Short-term Discharge Power" VALUE 0x80251142 RB_Val_Ws16 1638375. RBPtCel_pwr_25p0_1 -819200.0 819175.0 FORMAT "%8.1" /end CHARACTERISTIC
/begin CHARACTERISTIC HvBatt_pwrOffsChrgMax_C "Maximum Offset power value in charging" VALUE 0x80251144 RB_Val_Ws16 1638375. RBPtCel_pwr_25p0_1 -819200.0 819175.0 FORMAT "%8.1" /end CHARACTERISTIC
/begin CHARACTERISTIC HvBatt_pwrOffsDchaMax_C "Maximum Offset power value in discharging" VALUE 0x80251146 RB_Val_Ws16 1638375. RBPtCel_pwr_25p0_1 -819200.0 819175.0 FORMAT "%8.1" /end CHARACTERISTIC
/begin CHARACTERISTIC HvBatt_pwrOffsMaxGen_C "Offset to calculate maximum power limit which can be given to generator at any point of time" VALUE 0x80251148 RB_Val_Ws16 1638375. RBPtCel_pwr_25p0_1 -819200.0 819175.0 FORMAT "%8.1" /end CHARACTERISTIC
/begin CHARACTERISTIC HvBatt_ratRSohReplcmtVal_C "Replacement value for the SOH linked to battery internal resistance." VALUE 0x80250A58 RB_Val_Wu8 255.0 RBPtCel_Perc_1p0_1 0.00 255.0 FORMAT "%5.1" /end CHARACTERISTIC
/begin CHARACTERISTIC HvBatt_ratSocThd_C "Calibration for SOC rotio threshold" VALUE 0x8025114A RB_Val_Ws16 799.9878 Prc -400.0000 399.9878 FORMAT "%8.4" /end CHARACTERISTIC
/begin CHARACTERISTIC HvBatt_ratSohReplcmtVal_C "Replacement value for the estimated SOH of HV Battery." VALUE 0x80250A59 RB_Val_Wu8 255.0 RBPtCel_Perc_1p0_1 0.00 255.0 FORMAT "%5.1" /end CHARACTERISTIC
/begin CHARACTERISTIC HvBatt_stOperModChrgSeln_T "curve for operation mode charge selection" CURVE 0x80251156 RB_Curve_U8_U8 255.0 OneToOne 0.00 255.0 FORMAT "%5.1"
 /begin AXIS_DESCR STD_AXIS HvBatt_stChrgMod OneToOne 10 0.00 255.0 FORMAT "%5.1" DEPOSIT ABSOLUTE /end AXIS_DESCR
/end CHARACTERISTIC
/begin CHARACTERISTIC HvBatt_stPlausySwtSeln_C "Selection Switch for plausibility" VALUE 0x8025116B RB_Val_Wu8 255.0 OneToOne 0.00 255.0 FORMAT "%5.1" /end CHARACTERISTIC
/begin CHARACTERISTIC HvBatt_swtEgyAvlSrcSel_C "Calibration switch for source selection of HV battery remaining energy calculation" VALUE 0x8025114C RB_Val_Wu8 1.00000000000 B_TRUE 0.00 1.00000000000 FORMAT "%13.11" /end CHARACTERISTIC
/begin CHARACTERISTIC HvBatt_tiThdSrvPlgErr_C "Delay time for deciding service plug fault" VALUE 0x80250A5A RB_Val_Ws16 655.3500 Time_s -327.6800 327.6700 FORMAT "%8.4" /end CHARACTERISTIC
/begin CHARACTERISTIC HvBatt_tPwrDistbnDern_C "Temperature of the bus barPDU above which derating of battery power could be started." VALUE 0x80250A5C RB_Val_Wr32 2.0000E+037 RBPtCel_t_1p0_3 -1.0000E+037 1.0000E+037 FORMAT "%10.4" EXTENDED_LIMITS -3.4028E+038 3.4028E+038 /end CHARACTERISTIC
/begin CHARACTERISTIC HvBatt_tPwrDistbnInhbn_C "Temperature of the bus barPDU (even after derating above which the system could be inhibited" VALUE 0x80250A60 RB_Val_Wr32 2.0000E+037 RBPtCel_t_1p0_3 -1.0000E+037 1.0000E+037 FORMAT "%10.4" EXTENDED_LIMITS -3.4028E+038 3.4028E+038 /end CHARACTERISTIC
/begin CHARACTERISTIC HvBatt_vThdSrvPlgErr_C "Vehicle speed threshold for deciding service plug fault" VALUE 0x80250A64 RB_Val_Ws16 655.3500 Vel -327.6800 327.6700 FORMAT "%8.4" /end CHARACTERISTIC
/begin CHARACTERISTIC HvGrid_facPwrMaxGen_C "Factor to calculate maximum power limit which can be given to generator at any point of time" VALUE 0x802511D2 RB_Val_Ws16 7.999878 Fact -4.000000 3.999878 FORMAT "%8.6" /end CHARACTERISTIC
/begin CHARACTERISTIC HvGrid_flgAuxPwr01ActZr_C "Set power to zero" VALUE 0x802511E4 RB_Val_Wboolean 1.00000000000 B_TRUE 0.00 1.00000000000 FORMAT "%13.11" /end CHARACTERISTIC
/begin CHARACTERISTIC HvGrid_flgAuxPwr01Avl_C "Power of HV consumer available" VALUE 0x802511E5 RB_Val_Wboolean 1.00000000000 B_TRUE 0.00 1.00000000000 FORMAT "%13.11" /end CHARACTERISTIC
/begin CHARACTERISTIC HvGrid_flgAuxPwr02ActZr_C "Set power to zero" VALUE 0x802511E6 RB_Val_Wboolean 1.00000000000 B_TRUE 0.00 1.00000000000 FORMAT "%13.11" /end CHARACTERISTIC
/begin CHARACTERISTIC HvGrid_flgAuxPwr02Avl_C "Power of HV consumer available" VALUE 0x802511E7 RB_Val_Wboolean 1.00000000000 B_TRUE 0.00 1.00000000000 FORMAT "%13.11" /end CHARACTERISTIC
/begin CHARACTERISTIC HvGrid_flgAuxPwr03ActZr_C "Set power to zero" VALUE 0x802511E8 RB_Val_Wboolean 1.00000000000 B_TRUE 0.00 1.00000000000 FORMAT "%13.11" /end CHARACTERISTIC
/begin CHARACTERISTIC HvGrid_flgAuxPwr03Avl_C "Power of HV consumer available" VALUE 0x802511E9 RB_Val_Wboolean 1.00000000000 B_TRUE 0.00 1.00000000000 FORMAT "%13.11" /end CHARACTERISTIC
/begin CHARACTERISTIC HvGrid_flgAuxPwr04ActZr_C "Set power to zero" VALUE 0x802511EA RB_Val_Wboolean 1.00000000000 B_TRUE 0.00 1.00000000000 FORMAT "%13.11" /end CHARACTERISTIC
/begin CHARACTERISTIC HvGrid_flgAuxPwr04Avl_C "Power of HV consumer available" VALUE 0x802511EB RB_Val_Wboolean 1.00000000000 B_TRUE 0.00 1.00000000000 FORMAT "%13.11" /end CHARACTERISTIC
/begin CHARACTERISTIC HvGrid_flgDcdcPwrActZr_C "Set power to zero" VALUE 0x802511EC RB_Val_Wboolean 1.00000000000 B_TRUE 0.00 1.00000000000 FORMAT "%13.11" /end CHARACTERISTIC
/begin CHARACTERISTIC HvGrid_flgDcdcPwrOk_C "For test only" VALUE 0x802511ED RB_Val_Wboolean 1.00000000000 B_TRUE 0.00 1.00000000000 FORMAT "%13.11" /end CHARACTERISTIC
/begin CHARACTERISTIC HvGrid_idxChrg_T "Index table for VehCoorn state charging" CURVE 0x80251186 RB_Curve_U8_U8 255.0 OneToOne 0.00 255.0 FORMAT "%5.1"
 /begin AXIS_DESCR STD_AXIS HvGrid_idxVehCoorn OneToOne 12 0.00 255.0 FORMAT "%5.1" DEPOSIT ABSOLUTE /end AXIS_DESCR
/end CHARACTERISTIC
/begin CHARACTERISTIC HvGrid_idxDrv_T "Index table for VehCoorn state driving" CURVE 0x8025119F RB_Curve_U8_U8 255.0 OneToOne 0.00 255.0 FORMAT "%5.1"
 /begin AXIS_DESCR STD_AXIS HvGrid_idxVehCoorn OneToOne 12 0.00 255.0 FORMAT "%5.1" DEPOSIT ABSOLUTE /end AXIS_DESCR
/end CHARACTERISTIC
/begin CHARACTERISTIC HvGrid_idxHvReady_T "Index table for VehCoorn state HV ready" CURVE 0x802511B8 RB_Curve_U8_U8 255.0 OneToOne 0.00 255.0 FORMAT "%5.1"
 /begin AXIS_DESCR STD_AXIS HvGrid_idxVehCoorn OneToOne 12 0.00 255.0 FORMAT "%5.1" DEPOSIT ABSOLUTE /end AXIS_DESCR
/end CHARACTERISTIC
/begin CHARACTERISTIC HvGrid_maskComEmacUDcLink01Sq_C "Calibration mask to determineComEmac_uDcLnk01_Sq validity" VALUE 0x802511FA RB_Val_Wu16 65535.00 OneToOne 0.00 65535.00 FORMAT "%8.2" /end CHARACTERISTIC
/begin CHARACTERISTIC HvGrid_maskComStHvbCntctSq_C "Calibration mask to determine Main contactor status of the HV battery validity" VALUE 0x802511FC RB_Val_Wu16 65535.00 OneToOne 0.00 65535.00 FORMAT "%8.2" /end CHARACTERISTIC
/begin CHARACTERISTIC HvGrid_maskDcdcPwrHvActSq_C "Calibration mask to determine DCDC convertor Actual HV power validity" VALUE 0x802511EE RB_Val_Wu16 65535.00 OneToOne 0.00 65535.00 FORMAT "%8.2" /end CHARACTERISTIC
/begin CHARACTERISTIC HvGrid_maskDcdcUHvActSq_C "Calibration mask to determineActual HV voltage of DCDC convertor validity" VALUE 0x802511FE RB_Val_Wu16 65535.00 OneToOne 0.00 65535.00 FORMAT "%8.2" /end CHARACTERISTIC
/begin CHARACTERISTIC HvGrid_maskHvBattUActMeasdSq_C "Calibration mask to determine the signal quality of HV battery voltage" VALUE 0x80251200 RB_Val_Wu16 65535.00 OneToOne 0.00 65535.00 FORMAT "%8.2" /end CHARACTERISTIC
/begin CHARACTERISTIC HvGrid_maskpwrMaxChrgContnsSq_C "Calibration mask for HvBatt_pwrMaxChrg-Contns_Sq" VALUE 0x802511D4 RB_Val_Wu16 65535.00 OneToOne 0.00 65535.00 FORMAT "%8.2" /end CHARACTERISTIC
/begin CHARACTERISTIC HvGrid_maskpwrMaxChrgShoSq_C "Calibration mask for HvBatt_pwrMaxChrgSho_Sq" VALUE 0x802511D6 RB_Val_Wu16 65535.00 OneToOne 0.00 65535.00 FORMAT "%8.2" /end CHARACTERISTIC
/begin CHARACTERISTIC HvGrid_maskpwrMaxDchaContnsSq_C "Calibration mask for HvBatt_pwrMaxDcha-Contns_Sq" VALUE 0x802511D8 RB_Val_Wu16 65535.00 OneToOne 0.00 65535.00 FORMAT "%8.2" /end CHARACTERISTIC
/begin CHARACTERISTIC HvGrid_maskpwrMaxDchaShoSq_C "Calibration mask for HvBatt_pwrMaxDchaSho_Sq" VALUE 0x802511DA RB_Val_Wu16 65535.00 OneToOne 0.00 65535.00 FORMAT "%8.2" /end CHARACTERISTIC
/begin CHARACTERISTIC HvGrid_pwrAuxPwr01Nom_C "Nominal power max of HV consumer" VALUE 0x802511F0 RB_Val_Ws16 1638375. RBPtCel_pwr_25p0_1 -819200.0 819175.0 FORMAT "%8.1" /end CHARACTERISTIC
/begin CHARACTERISTIC HvGrid_pwrAuxPwr02Nom_C "Nominal power max of HV consumer" VALUE 0x802511F2 RB_Val_Ws16 1638375. RBPtCel_pwr_25p0_1 -819200.0 819175.0 FORMAT "%8.1" /end CHARACTERISTIC
/begin CHARACTERISTIC HvGrid_pwrAuxPwr03Nom_C "Nominal power max of HV consumer" VALUE 0x802511F4 RB_Val_Ws16 1638375. RBPtCel_pwr_25p0_1 -819200.0 819175.0 FORMAT "%8.1" /end CHARACTERISTIC
/begin CHARACTERISTIC HvGrid_pwrAuxPwr04Nom_C "Nominal power max of HV consumer" VALUE 0x802511F6 RB_Val_Ws16 1638375. RBPtCel_pwr_25p0_1 -819200.0 819175.0 FORMAT "%8.1" /end CHARACTERISTIC
/begin CHARACTERISTIC HvGrid_pwrDcdcPwrNom_C "Nominal power max of Dcdc" VALUE 0x802511F8 RB_Val_Ws16 1638375. RBPtCel_pwr_25p0_1 -819200.0 819175.0 FORMAT "%8.1" /end CHARACTERISTIC
/begin CHARACTERISTIC HvGrid_pwrLoadMngMaxPred_T "HV battery load request" CURVE 0x80251174 RB_Curve_S16_S16 1638375. RBPtCel_pwr_25p0_1 -819200.0 819175.0 FORMAT "%8.1"
 /begin AXIS_DESCR STD_AXIS HvBatt_pwrActMeasd RBPtCel_pwr_25p0_1 4 -819200.0 819175.0 FORMAT "%8.1" DEPOSIT ABSOLUTE /end AXIS_DESCR
/end CHARACTERISTIC
/begin CHARACTERISTIC HvGrid_pwrMaxGenNegBuf_C "Buffer limit below which generator power limit is set to 0" VALUE 0x802511DC RB_Val_Ws16 1638375. RBPtCel_pwr_25p0_1 -819200.0 819175.0 FORMAT "%8.1" /end CHARACTERISTIC
/begin CHARACTERISTIC HvGrid_pwrMaxGenNegLim_C "Negative generator limit in case of fault" VALUE 0x802511DE RB_Val_Ws16 1638375. RBPtCel_pwr_25p0_1 -819200.0 819175.0 FORMAT "%8.1" /end CHARACTERISTIC
/begin CHARACTERISTIC HvGrid_pwrMaxGenOffs_C "Offset to calculate maximum power limit which can be given to generator at any point of time" VALUE 0x802511E0 RB_Val_Ws16 1638375. RBPtCel_pwr_25p0_1 -819200.0 819175.0 FORMAT "%8.1" /end CHARACTERISTIC
/begin CHARACTERISTIC HvGrid_pwrMaxMotPosLim_C "Positive motor limit in case of fault" VALUE 0x802511E2 RB_Val_Ws16 1638375. RBPtCel_pwr_25p0_1 -819200.0 819175.0 FORMAT "%8.1" /end CHARACTERISTIC
/begin CHARACTERISTIC HvGrid_ratSocLimDel_C "Delta threshold limit for HV Battery SOC low" VALUE 0x8025116C RB_Val_Ws16 799.9878 Prc -400.0000 399.9878 FORMAT "%8.4" /end CHARACTERISTIC
/begin CHARACTERISTIC HvGrid_ratSocLim_C "Threshold limit to set diagnostic error for low Actual HV Battery SOC" VALUE 0x8025116E RB_Val_Ws16 799.9878 Prc -400.0000 399.9878 FORMAT "%8.4" /end CHARACTERISTIC
/begin CHARACTERISTIC HvGrid_uPlausyThd_C "Maximum allowed deviation of HV voltages" VALUE 0x80251202 RB_Val_Ws16 2047.969 Volt_V_q0p03125_COMPU -1024.000 1023.969 FORMAT "%8.3" /end CHARACTERISTIC
/begin CHARACTERISTIC HvGrid_uSysMax_C "Limit for maximum system voltage allowed in HV grid" VALUE 0x80251170 RB_Val_Ws16 2047.969 Volt_V_q0p03125_COMPU -1024.000 1023.969 FORMAT "%8.3" /end CHARACTERISTIC
/begin CHARACTERISTIC HvGrid_uSysMin_C "Limit for minimum system voltage allowed in HV grid" VALUE 0x80251172 RB_Val_Ws16 2047.969 Volt_V_q0p03125_COMPU -1024.000 1023.969 FORMAT "%8.3" /end CHARACTERISTIC
/begin CHARACTERISTIC I15031_nMaxSrv4_C "Maximum engine speed for Mode$04 Clear Diagnostic Information" VALUE 0x80263FC4 Val_Ws16 10000.00 EngN 0.00 10000.00 FORMAT "%8.2" EXTENDED_LIMITS -16384.00 16383.50 /end CHARACTERISTIC
/begin CHARACTERISTIC I15031_PID13_C "Location of oxigen sensor" VALUE 0x80263FE0 Val_Wu8 255.0 OneToOne 0.00 255.0 FORMAT "%5.1" /end CHARACTERISTIC
/begin CHARACTERISTIC I15031_PID1C_C "" VALUE 0x80263FE1 Val_Wu8 42.0000000000 I15031_PID1CVerb 1.0000000000 43.0000000000 FORMAT "%13.10" /end CHARACTERISTIC
/begin CHARACTERISTIC I15031_PID1D_C "Location of oxygen sensors" VALUE 0x80263FE2 Val_Wu8 255.0 OneToOne 0.00 255.0 FORMAT "%5.1" /end CHARACTERISTIC
/begin CHARACTERISTIC I15031_PID4FA_C "External Test Equipment Configuration Information. Maximum value for Equivalence Ratio" VALUE 0x80263FE3 Val_Wu8 255.0 OneToOne 0.00 255.0 FORMAT "%5.1" /end CHARACTERISTIC
/begin CHARACTERISTIC I15031_PID4FB_C "External Test Equipment Configuration Information. Maximum value for Oxygen Sensor Voltage" VALUE 0x80263FE4 Val_Wu8 255.0 OneToOne 0.00 255.0 FORMAT "%5.1" /end CHARACTERISTIC
/begin CHARACTERISTIC I15031_PID4FC_C "External Test Equipment Configuration Information. Maximum value for Oxygen Sensor Current" VALUE 0x80263FE5 Val_Wu8 255.0 OneToOne 0.00 255.0 FORMAT "%5.1" /end CHARACTERISTIC
/begin CHARACTERISTIC I15031_PID4FD_C "External Test Equipment Configuration Information. Maximum value for Intake Manifold Absolute Pressure." VALUE 0x80263FE6 Val_Wu8 2550. OneToTenCarb 0.00 2550. FORMAT "%5.0" /end CHARACTERISTIC
/begin CHARACTERISTIC I15031_PID50A_C "External Test Equipment Configuration Information. Maximum value for ""Air Flow Rate from Mass Air Flow Sensor""" VALUE 0x80263FE7 Val_Wu8 2550. OneToTenCarb 0.00 2550. FORMAT "%5.0" /end CHARACTERISTIC
/begin CHARACTERISTIC I15031_PID5F_C "OBD requirements to which vehicle is designed" VALUE 0x80263FE8 Val_Wu8 3.00000000000 I15031_PID5FVerb 14.0000000000 17.0000000000 FORMAT "%13.10" /end CHARACTERISTIC
/begin CHARACTERISTIC I15031_PID65A_C "Shows which Auxiliary Inputs / Outputs are supported in PID65" VALUE 0x80263FE9 Val_Wu8 255.0 OneToOne 0.00 255.0 FORMAT "%5.1" /end CHARACTERISTIC
/begin CHARACTERISTIC I15031_PID66A_C "Shows which Mass Air Flow Sensor data are supported in PID66" VALUE 0x80263FEA Val_Wu8 255.0 OneToOne 0.00 255.0 FORMAT "%5.1" /end CHARACTERISTIC
/begin CHARACTERISTIC I15031_PID67A_C "Shows which Engine Coolant Temperature data are supported in PID67" VALUE 0x80263FEB Val_Wu8 255.0 OneToOne 0.00 255.0 FORMAT "%5.1" /end CHARACTERISTIC
/begin CHARACTERISTIC I15031_PID68A_C "Shows which Intake Air Temperature Sensor data are supported in PID68" VALUE 0x80263FEC Val_Wu8 255.0 OneToOne 0.00 255.0 FORMAT "%5.1" /end CHARACTERISTIC
/begin CHARACTERISTIC I15031_PID69A_C "Shows which Commanded EGR System data are supported in PID69" VALUE 0x80263FED Val_Wu8 255.0 OneToOne 0.00 255.0 FORMAT "%5.1" /end CHARACTERISTIC
/begin CHARACTERISTIC I15031_PID6AA_C "Shows which Commanded Diesel Intake Air Flow Control and Relative Intake Air Flow Position data are supported in PID6A" VALUE 0x80263FEE Val_Wu8 255.0 OneToOne 0.00 255.0 FORMAT "%5.1" /end CHARACTERISTIC
/begin CHARACTERISTIC I15031_PID6BA_C "Shows which Exhaust Gas Recirculation Temperature data are supported in PID6B" VALUE 0x80263FEF Val_Wu8 255.0 OneToOne 0.00 255.0 FORMAT "%5.1" /end CHARACTERISTIC
/begin CHARACTERISTIC I15031_PID6CA_C "Shows which Commanded Throttle Actuator Control and Relative Throttle Position data are supported in PID6C" VALUE 0x80263FF0 Val_Wu8 255.0 OneToOne 0.00 255.0 FORMAT "%5.1" /end CHARACTERISTIC
/begin CHARACTERISTIC I15031_PID6DA_C "Shows which Fuel Pressure Control System data are supported in PID6D" VALUE 0x80263FF1 Val_Wu8 255.0 OneToOne 0.00 255.0 FORMAT "%5.1" /end CHARACTERISTIC
/begin CHARACTERISTIC I15031_PID6EA_C "Shows which Injection Pressure Control System data are supported in PID6E" VALUE 0x80263FF2 Val_Wu8 255.0 OneToOne 0.00 255.0 FORMAT "%5.1" /end CHARACTERISTIC
/begin CHARACTERISTIC I15031_PID6FA_C "Shows which Turbocharger Compressor Inlet Pressure data are supported in PID6F" VALUE 0x80263FF3 Val_Wu8 255.0 OneToOne 0.00 255.0 FORMAT "%5.1" /end CHARACTERISTIC
/begin CHARACTERISTIC I15031_PID70A_C "Shows which Boost Pressure Control data are supported in PID70" VALUE 0x80263FF4 Val_Wu8 255.0 OneToOne 0.00 255.0 FORMAT "%5.1" /end CHARACTERISTIC
/begin CHARACTERISTIC I15031_PID71A_C "Shows which Variable Geometry Turbo (VGT) Control data are supported in PID71" VALUE 0x80263FF5 Val_Wu8 255.0 OneToOne 0.00 255.0 FORMAT "%5.1" /end CHARACTERISTIC
/begin CHARACTERISTIC I15031_PID72A_C "Shows which Wastegate Control data are supported in PID72" VALUE 0x80263FF6 Val_Wu8 255.0 OneToOne 0.00 255.0 FORMAT "%5.1" /end CHARACTERISTIC
/begin CHARACTERISTIC I15031_PID73A_C "Shows which Exhaust Pressure data are supported in PID73" VALUE 0x80263FF7 Val_Wu8 255.0 OneToOne 0.00 255.0 FORMAT "%5.1" /end CHARACTERISTIC
/begin CHARACTERISTIC I15031_PID74A_C "Shows which Turbocharger RPM data are supported in PID74" VALUE 0x80263FF8 Val_Wu8 255.0 OneToOne 0.00 255.0 FORMAT "%5.1" /end CHARACTERISTIC
/begin CHARACTERISTIC I15031_PID75A_C "Shows which Turbocharger A Temperature data are supported in PID75" VALUE 0x80263FF9 Val_Wu8 255.0 OneToOne 0.00 255.0 FORMAT "%5.1" /end CHARACTERISTIC
/begin CHARACTERISTIC I15031_PID76A_C "Shows which Turbocharger B Temperature data are supported in PID76" VALUE 0x80263FFA Val_Wu8 255.0 OneToOne 0.00 255.0 FORMAT "%5.1" /end CHARACTERISTIC
/begin CHARACTERISTIC I15031_PID77A_C "Shows which Charge Air Cooler Temperature (CACT) data are supported in PID77" VALUE 0x80263FFB Val_Wu8 255.0 OneToOne 0.00 255.0 FORMAT "%5.1" /end CHARACTERISTIC
/begin CHARACTERISTIC I15031_PID78A_C "Shows which Exhaust Gas Temperature (EGT) Bank 1 data are supported in PID78" VALUE 0x80263FFC Val_Wu8 255.0 OneToOne 0.00 255.0 FORMAT "%5.1" /end CHARACTERISTIC
/begin CHARACTERISTIC I15031_PID79A_C "Shows which Exhaust Gas Temperature (EGT) Bank 2 data are supported in PID79" VALUE 0x80263FFD Val_Wu8 255.0 OneToOne 0.00 255.0 FORMAT "%5.1" /end CHARACTERISTIC
/begin CHARACTERISTIC I15031_PID7AA_C "Shows which Particulate Filter (PF) Bank 1 data are supported in PID7A" VALUE 0x80263FFE Val_Wu8 255.0 OneToOne 0.00 255.0 FORMAT "%5.1" /end CHARACTERISTIC
/begin CHARACTERISTIC I15031_PID7BA_C "Shows which Particulate Filter (PF) Bank 2 data are supported in PID7B" VALUE 0x80263FFF Val_Wu8 255.0 OneToOne 0.00 255.0 FORMAT "%5.1" /end CHARACTERISTIC
/begin CHARACTERISTIC I15031_PID7CA_C "Shows which Particulate Filter (PF) Temperature data are supported in PID7C" VALUE 0x80264000 Val_Wu8 255.0 OneToOne 0.00 255.0 FORMAT "%5.1" /end CHARACTERISTIC
/begin CHARACTERISTIC I15031_PID7FA_C "Shows which Engine Run Time is supported in PID7F" VALUE 0x80264001 Val_Wu8 255.0 OneToOne 0.00 255.0 FORMAT "%5.1" /end CHARACTERISTIC
/begin CHARACTERISTIC I15031_PID81A_C "Shows which Engine Run Time for AECD #1 - #5 is supported in PID81" VALUE 0x80264002 Val_Wu8 255.0 OneToOne 0.00 255.0 FORMAT "%5.1" /end CHARACTERISTIC
/begin CHARACTERISTIC I15031_PID82A_C "Shows which Engine Run Time for AECD #6 - #10 is supported in PID82" VALUE 0x80264003 Val_Wu8 255.0 OneToOne 0.00 255.0 FORMAT "%5.1" /end CHARACTERISTIC
/begin CHARACTERISTIC I15031_PID83A_C "Shows which NOx Sensor data are supported in PID83" VALUE 0x80264004 Val_Wu8 255.0 OneToOne 0.00 255.0 FORMAT "%5.1" /end CHARACTERISTIC
/begin CHARACTERISTIC I15031_PID85A_C "Shows which NOx Control System data are supported in PID85" VALUE 0x80264005 Val_Wu8 255.0 OneToOne 0.00 255.0 FORMAT "%5.1" /end CHARACTERISTIC
/begin CHARACTERISTIC I15031_PID86A_C "Shows which Particulate Matter (PM) Sensor data are supported in PID86" VALUE 0x80264006 Val_Wu8 255.0 OneToOne 0.00 255.0 FORMAT "%5.1" /end CHARACTERISTIC
/begin CHARACTERISTIC I15031_PID87A_C "Shows which Intake Manifold Absolute Pressure data are supported in PID87" VALUE 0x80264007 Val_Wu8 255.0 OneToOne 0.00 255.0 FORMAT "%5.1" /end CHARACTERISTIC
/begin CHARACTERISTIC I15031_PID89A_C "Shows which Engine Run Time for AECD #11 - #15 is supported in PID89" VALUE 0x80264008 Val_Wu8 255.0 OneToOne 0.00 255.0 FORMAT "%5.1" /end CHARACTERISTIC
/begin CHARACTERISTIC I15031_PID8AA_C "Shows which Engine Run Time for AECD #16 - #20 is supported in PID8A" VALUE 0x80264009 Val_Wu8 255.0 OneToOne 0.00 255.0 FORMAT "%5.1" /end CHARACTERISTIC
/begin CHARACTERISTIC I15031_PID8BA_C "Shows which Aftertreatment Status is supported in PID8B ByteB." VALUE 0x8026400A Val_Wu8 255.0 OneToOne 0.00 255.0 FORMAT "%5.1" /end CHARACTERISTIC
/begin CHARACTERISTIC I15031_PID8CA_C "Calibration for O2 Sensor Data support information(Sensor 1, Sensor 2)" VALUE 0x8026400B Val_Wu8 255.0 OneToOne 0.00 255.0 FORMAT "%5.1" /end CHARACTERISTIC
/begin CHARACTERISTIC I15031_PID8FA_C "Shows which PM (Particulate Matter) Sensor Output is supported in PID8F" VALUE 0x8026400C Val_Wu8 255.0 OneToOne 0.00 255.0 FORMAT "%5.1" /end CHARACTERISTIC
/begin CHARACTERISTIC I15031_PID92A_C "Calibration for Fuel System Status support information" VALUE 0x8026400D Val_Wu8 255.0 OneToOne 0.00 255.0 FORMAT "%5.1" /end CHARACTERISTIC
/begin CHARACTERISTIC I15031_PID93A_C "Calibration for WWH B1 counter support information" VALUE 0x8026400E Val_Wu8 255.0 OneToOne 0.00 255.0 FORMAT "%5.1" /end CHARACTERISTIC
/begin CHARACTERISTIC I15031_PID94A_C "Calibration for Inducement Counters support information" VALUE 0x8026400F Val_Wu8 255.0 OneToOne 0.00 255.0 FORMAT "%5.1" /end CHARACTERISTIC
/begin CHARACTERISTIC I15031_PID97A_C "Calibration for Signal carrying NOx Mass Emission Rate" VALUE 0x80264010 Val_Wu8 255.0 OneToOne 0.00 255.0 FORMAT "%5.1" /end CHARACTERISTIC
/begin CHARACTERISTIC I15031_PID98A_C "Shows which exhaust gas temperature for bank 1 data are supported in PID98" VALUE 0x80264011 Val_Wu8 255.0 OneToOne 0.00 255.0 FORMAT "%5.1" /end CHARACTERISTIC
/begin CHARACTERISTIC I15031_PID99A_C "Calibration for Exhaust Gas Temperature Sensor Data support information" VALUE 0x80264012 Val_Wu8 255.0 OneToOne 0.00 255.0 FORMAT "%5.1" /end CHARACTERISTIC
/begin CHARACTERISTIC I15031_PID9AA_C "Shows if HybridEV Vehicle State is supported in PID9A" VALUE 0x80264013 Val_Wu8 255.0 OneToOne 0.00 255.0 FORMAT "%5.1" /end CHARACTERISTIC
/begin CHARACTERISTIC I15031_PID9BA_C "Diesel exhaust fluid sensor output" VALUE 0x80264014 Val_Wu8 255.0 OneToOne 0.00 255.0 FORMAT "%5.1" /end CHARACTERISTIC
/begin CHARACTERISTIC I15031_PID9CA_C "Calibration for O2 Sensor Data support information(Sensor 3, Sensor 4)" VALUE 0x80264015 Val_Wu8 255.0 OneToOne 0.00 255.0 FORMAT "%5.1" /end CHARACTERISTIC
/begin CHARACTERISTIC I15031_PID9FA_C "Support of fuel system percentage use" VALUE 0x80264016 Val_Wu8 255.0 OneToOne 0.00 255.0 FORMAT "%5.1" /end CHARACTERISTIC
/begin CHARACTERISTIC I15031_PIDA1A_C "Displays the NOx Sensor Corrected Data supported in PIDA1" VALUE 0x80264017 Val_Wu8 255.0 OneToOne 0.00 255.0 FORMAT "%5.1" /end CHARACTERISTIC
/begin CHARACTERISTIC I15031_PIDA3A_C "Evap System Vapor Pressure" VALUE 0x80264018 Val_Wu8 255.0 OneToOne 0.00 255.0 FORMAT "%5.1" /end CHARACTERISTIC
/begin CHARACTERISTIC I15031_PIDA4A_C "Transmission Actual Gear" VALUE 0x80264019 Val_Wu8 255.0 OneToOne 0.00 255.0 FORMAT "%5.1" /end CHARACTERISTIC
/begin CHARACTERISTIC I15031_PIDA5A_C "calibration parameter to update message of byte A ini PIDA5 for Diesel Exhaust Fluid Dosing" VALUE 0x8026401A Val_Wu8 255.0 OneToOne 0.00 255.0 FORMAT "%5.1" /end CHARACTERISTIC
/begin CHARACTERISTIC I15031_PIDA7A_C "Support of NOx Sensor Data" VALUE 0x8026401B Val_Wu8 255.0 OneToOne 0.00 255.0 FORMAT "%5.1" /end CHARACTERISTIC
/begin CHARACTERISTIC I15031_PIDA8A_C "NOx Sensor Corrected" VALUE 0x8026401C Val_Wu8 255.0 OneToOne 0.00 255.0 FORMAT "%5.1" /end CHARACTERISTIC
/begin CHARACTERISTIC I15031_PIDA9A_C "Motorcycle InputOutput Status" VALUE 0x8026401D Val_Wu8 255.0 OneToOne 0.00 255.0 FORMAT "%5.1" /end CHARACTERISTIC
/begin CHARACTERISTIC I15031_PIDACA_C "Shows Support of DEF Dosing Rate or Mode" VALUE 0x8026401E Val_Wu8 255.0 OneToOne 0.00 255.0 FORMAT "%5.1" /end CHARACTERISTIC
/begin CHARACTERISTIC I15031_srv9PIDTable.PID0_C "" VALUE 0x80263FC6 Val_Wu8 255.0 OneToOne 0.00 255.0 FORMAT "%5.1" /end CHARACTERISTIC
/begin CHARACTERISTIC I15031_srv9PIDTable.PID2_C "" VALUE 0x80263FC8 Val_Wu8 255.0 OneToOne 0.00 255.0 FORMAT "%5.1" /end CHARACTERISTIC
/begin CHARACTERISTIC I15031_srv9PIDTable.PID4_C "" VALUE 0x80263FCA Val_Wu8 255.0 OneToOne 0.00 255.0 FORMAT "%5.1" /end CHARACTERISTIC
/begin CHARACTERISTIC I15031_srv9PIDTable.PID6_C "" VALUE 0x80263FCC Val_Wu8 255.0 OneToOne 0.00 255.0 FORMAT "%5.1" /end CHARACTERISTIC
/begin CHARACTERISTIC I15031_srv9PIDTable.PIDA_C "" VALUE 0x80263FD0 Val_Wu8 255.0 OneToOne 0.00 255.0 FORMAT "%5.1" /end CHARACTERISTIC
/begin CHARACTERISTIC I15031_srv9PIDTable.PIDF_C "" VALUE 0x80263FD5 Val_Wu8 255.0 OneToOne 0.00 255.0 FORMAT "%5.1" /end CHARACTERISTIC
/begin CHARACTERISTIC I15031_stRfrshCal_C "Start of support calculation for Service0102" VALUE 0x8026401F Val_Wu8 1.000 OneToOne 0.00 1.000 FORMAT "%5.3" EXTENDED_LIMITS 0.00 255.0 /end CHARACTERISTIC
/begin CHARACTERISTIC I15031_stSrvSuppMode_CA "Supported Modes for CARB services" VAL_BLK 0x80263FD6 ValA_Wu8 10.00 OneToOne 0.00 10.00 FORMAT "%5.2" EXTENDED_LIMITS 0.00 255.0 MATRIX_DIM 10 /end CHARACTERISTIC
/begin CHARACTERISTIC Inm_ctHVACPanelAbsntThres_C "Threshold of the counter to declare HVAC node to be absent" VALUE 0x80251292 RB_Val_Wu8 255.0 OneToOne 0.00 255.0 FORMAT "%5.1" /end CHARACTERISTIC
/begin CHARACTERISTIC Inm_EngRestrtOn_C "Engine restart state value" VALUE 0x8024E6F3 Val_Wu8 14.0000000000 C126_stEng_COMPU 1.0000000000 15.0000000000 FORMAT "%13.10" /end CHARACTERISTIC
/begin CHARACTERISTIC Inm_TmrSwtSel_C "Timer to delay resetting switch message which in turn selects delay time for INM Can monitoring message" VALUE 0x8024E6F4 Val_Wu16 327.6750 t_q0p005 0.00 327.6750 FORMAT "%8.4" /end CHARACTERISTIC
/begin CHARACTERISTIC Inm_XTransMax_C "Number of unsuccessful transmitted frames to declare CMM mute." VALUE 0x8024E6FE Val_Wu8 255.0 dez 0.00 255.0 FORMAT "%5.1" /end CHARACTERISTIC
/begin CHARACTERISTIC Nm_uBatMaxOff_C "Maximum battery voltage threshold to switch to LowBatt" VALUE 0x8024E6F6 Val_Ws16 1310700. Volt_Batt -655360.0 655340.0 FORMAT "%8.1" /end CHARACTERISTIC
/begin CHARACTERISTIC Nm_uBatMaxOn_C "Maximum battery voltage threshold to switch to LowBatt" VALUE 0x8024E6F8 Val_Ws16 1310700. Volt_Batt -655360.0 655340.0 FORMAT "%8.1" /end CHARACTERISTIC
/begin CHARACTERISTIC Nm_uBatMinOff_C "Minimum battery voltage threshold to switch to LowBatt" VALUE 0x8024E6FA Val_Ws16 1310700. Volt_Batt -655360.0 655340.0 FORMAT "%8.1" /end CHARACTERISTIC
/begin CHARACTERISTIC Nm_uBatMinOn_C "Minimum battery voltage threshold to switch to LowBatt" VALUE 0x8024E6FC Val_Ws16 1310700. Volt_Batt -655360.0 655340.0 FORMAT "%8.1" /end CHARACTERISTIC
/begin MEASUREMENT B_rcdHW_msg "" UBYTE B_TRUE 1 100 0.00 1.00000000000 BIT_MASK 0x1 FORMAT "%13.11" ECU_ADDRESS 0x7000025C /end MEASUREMENT
/begin MEASUREMENT B_rcd_msg "" UBYTE B_TRUE 1 100 0.00 1.00000000000 BIT_MASK 0x1 FORMAT "%13.11" ECU_ADDRESS 0x7000025B /end MEASUREMENT
/begin MEASUREMENT CanSM_HSN1BOffCntr "counter to create 2sec delay for HSN1 busoff confirmation and healing" UBYTE OneToOne 1 100 0.00 255.0 FORMAT "%5.1" ECU_ADDRESS 0x60023878
 /begin IF_DATA XCPplus 0x0102
  /begin DAQ_EVENT VARIABLE /end DAQ_EVENT
 /end IF_DATA
/end MEASUREMENT
/begin MEASUREMENT CanSM_HSN3BOffCntr "counter to create 2sec delay for HSN3 busoff confirmation and healing" UBYTE OneToOne 1 100 0.00 255.0 FORMAT "%5.1" ECU_ADDRESS 0x60023877
 /begin IF_DATA XCPplus 0x0102
  /begin DAQ_EVENT VARIABLE /end DAQ_EVENT
 /end IF_DATA
/end MEASUREMENT
/begin MEASUREMENT ComM_stComModeCANHSN1 "Interface to check if HSN1_CAN channel is active" UBYTE ModeType_VERB 1 100 0.00 2.00000000000 FORMAT "%13.11" ECU_ADDRESS 0x6002385E
 /begin IF_DATA XCPplus 0x0102
  /begin DAQ_EVENT VARIABLE /end DAQ_EVENT
 /end IF_DATA
/end MEASUREMENT
/begin MEASUREMENT ComM_stComModeCANHSN3 "Interface to check if HSN3_CAN channel is active" UBYTE ModeType_VERB 1 100 0.00 2.00000000000 FORMAT "%13.11" ECU_ADDRESS 0x6002385D
 /begin IF_DATA XCPplus 0x0102
  /begin DAQ_EVENT VARIABLE /end DAQ_EVENT
 /end IF_DATA
/end MEASUREMENT
/begin MEASUREMENT ComM_stComModeCANHSN4 "Interface to check if HSN4_CAN channel is active" UBYTE ModeType_VERB 1 100 0.00 2.00000000000 FORMAT "%13.11" ECU_ADDRESS 0x6002385C
 /begin IF_DATA XCPplus 0x0102
  /begin DAQ_EVENT VARIABLE /end DAQ_EVENT
 /end IF_DATA
/end MEASUREMENT
/begin MEASUREMENT ComM_stComModeCANXCP "Interface to check if XCP_CAN channel is active" UBYTE ModeType_VERB 1 100 0.00 2.00000000000 FORMAT "%13.11" ECU_ADDRESS 0x6002385B
 /begin IF_DATA XCPplus 0x0102
  /begin DAQ_EVENT VARIABLE /end DAQ_EVENT
 /end IF_DATA
/end MEASUREMENT
/begin MEASUREMENT ComM_stComModeLIN "Interface to check if LIN is active" UBYTE ModeType_VERB 1 100 0.00 2.00000000000 FORMAT "%13.11" ECU_ADDRESS 0x6002385A
 /begin IF_DATA XCPplus 0x0102
  /begin DAQ_EVENT VARIABLE /end DAQ_EVENT
 /end IF_DATA
/end MEASUREMENT
/begin MEASUREMENT Com_bDiagCANHSN1 "Flag indicating CAN bus state" UBYTE OneToOne 1 100 0.00 1.000 BIT_MASK 0x1 FORMAT "%5.3" ECU_ADDRESS 0x60023894
 /begin IF_DATA XCPplus 0x0102
  /begin DAQ_EVENT VARIABLE /end DAQ_EVENT
 /end IF_DATA
/end MEASUREMENT
/begin MEASUREMENT Com_bDiagCANHSN3 "Flag indicating CAN bus state" UBYTE OneToOne 1 100 0.00 1.000 BIT_MASK 0x1 FORMAT "%5.3" ECU_ADDRESS 0x60023893
 /begin IF_DATA XCPplus 0x0102
  /begin DAQ_EVENT VARIABLE /end DAQ_EVENT
 /end IF_DATA
/end MEASUREMENT
/begin MEASUREMENT Com_bDiagMuxCAN "CAN communication supervision in order" UBYTE OneToOne 1 100 0.00 1.000 BIT_MASK 0x1 FORMAT "%5.3" ECU_ADDRESS 0x60023892
 /begin IF_DATA XCPplus 0x0102
  /begin DAQ_EVENT VARIABLE /end DAQ_EVENT
 /end IF_DATA
/end MEASUREMENT
/begin MEASUREMENT Com_LinAllTxTO "LIN all TX Timeout flag" UBYTE B_TRUE 1 100 0.00 1.00000000000 BIT_MASK 0x1 FORMAT "%13.11" ECU_ADDRESS 0x6002342B
 /begin IF_DATA XCPplus 0x0102
  /begin DAQ_EVENT VARIABLE /end DAQ_EVENT
 /end IF_DATA
/end MEASUREMENT
/begin MEASUREMENT ctHVACPanelAbsnt "Counter to detect node absent" UBYTE dez 1 100 0.00 255.0 FORMAT "%5.1" ECU_ADDRESS 0x60023430 /end MEASUREMENT
/begin MEASUREMENT DDRC_St.DFC_HvBattChrgPwrMax "" ULONG DFC_OneToOne 1 100 0.00 536870911.000 BIT_MASK 0x1fffffff FORMAT "%13.3" ECU_ADDRESS 0x6001C3B0 /end MEASUREMENT
/begin MEASUREMENT DDRC_St.DFC_HvBattCrashDetd "" ULONG DFC_OneToOne 1 100 0.00 536870911.000 BIT_MASK 0x1fffffff FORMAT "%13.3" ECU_ADDRESS 0x6001C3B4 /end MEASUREMENT
/begin MEASUREMENT DDRC_St.DFC_HvBattDchaPwrMax "" ULONG DFC_OneToOne 1 100 0.00 536870911.000 BIT_MASK 0x1fffffff FORMAT "%13.3" ECU_ADDRESS 0x6001C3B8 /end MEASUREMENT
/begin MEASUREMENT DDRC_St.DFC_HvBattEmgyOff "" ULONG DFC_OneToOne 1 100 0.00 536870911.000 BIT_MASK 0x1fffffff FORMAT "%13.3" ECU_ADDRESS 0x6001C3BC /end MEASUREMENT
/begin MEASUREMENT DDRC_St.DFC_HvBattEmgyOffIntlck "" ULONG DFC_OneToOne 1 100 0.00 536870911.000 BIT_MASK 0x1fffffff FORMAT "%13.3" ECU_ADDRESS 0x6001C3C0 /end MEASUREMENT
/begin MEASUREMENT DDRC_St.DFC_HvBattEmgyOffReq "" ULONG DFC_OneToOne 1 100 0.00 536870911.000 BIT_MASK 0x1fffffff FORMAT "%13.3" ECU_ADDRESS 0x6001C3C4 /end MEASUREMENT
/begin MEASUREMENT DDRC_St.DFC_HvBattFltMod "" ULONG DFC_OneToOne 1 100 0.00 536870911.000 BIT_MASK 0x1fffffff FORMAT "%13.3" ECU_ADDRESS 0x6001C3C8 /end MEASUREMENT
/begin MEASUREMENT DDRC_St.DFC_HvBattIninTout "" ULONG DFC_OneToOne 1 100 0.00 536870911.000 BIT_MASK 0x1fffffff FORMAT "%13.3" ECU_ADDRESS 0x6001C3D4 /end MEASUREMENT
/begin MEASUREMENT DDRC_St.DFC_HvBattIntlckSt "" ULONG DFC_OneToOne 1 100 0.00 536870911.000 BIT_MASK 0x1fffffff FORMAT "%13.3" ECU_ADDRESS 0x6001C3D8 /end MEASUREMENT
/begin MEASUREMENT DDRC_St.DFC_HvBattIsoFlt "" ULONG DFC_OneToOne 1 100 0.00 536870911.000 BIT_MASK 0x1fffffff FORMAT "%13.3" ECU_ADDRESS 0x6001C3DC /end MEASUREMENT
/begin MEASUREMENT DDRC_St.DFC_HvBattLimdPwr "" ULONG DFC_OneToOne 1 100 0.00 536870911.000 BIT_MASK 0x1fffffff FORMAT "%13.3" ECU_ADDRESS 0x6001C3E0 /end MEASUREMENT
/begin MEASUREMENT DDRC_St.DFC_HvBattMaiSwtClsngFlt "" ULONG DFC_OneToOne 1 100 0.00 536870911.000 BIT_MASK 0x1fffffff FORMAT "%13.3" ECU_ADDRESS 0x6001C3E4 /end MEASUREMENT
/begin MEASUREMENT DDRC_St.DFC_HvBattMaiSwtFlt "" ULONG DFC_OneToOne 1 100 0.00 536870911.000 BIT_MASK 0x1fffffff FORMAT "%13.3" ECU_ADDRESS 0x6001C3E8 /end MEASUREMENT
/begin MEASUREMENT DDRC_St.DFC_HvBattMaiSwtOpen "" ULONG DFC_OneToOne 1 100 0.00 536870911.000 BIT_MASK 0x1fffffff FORMAT "%13.3" ECU_ADDRESS 0x6001C3EC /end MEASUREMENT
/begin MEASUREMENT DDRC_St.DFC_HvBattMaiSwtOpngFlt "" ULONG DFC_OneToOne 1 100 0.00 536870911.000 BIT_MASK 0x1fffffff FORMAT "%13.3" ECU_ADDRESS 0x6001C3F0 /end MEASUREMENT
/begin MEASUREMENT DDRC_St.DFC_HvBattMaiSwtWldd "" ULONG DFC_OneToOne 1 100 0.00 536870911.000 BIT_MASK 0x1fffffff FORMAT "%13.3" ECU_ADDRESS 0x6001C3F4 /end MEASUREMENT
/begin MEASUREMENT DDRC_St.DFC_HvBattNegCntctrCntErr "" ULONG DFC_OneToOne 1 100 0.00 536870911.000 BIT_MASK 0x1fffffff FORMAT "%13.3" ECU_ADDRESS 0x6001C3F8 /end MEASUREMENT
/begin MEASUREMENT DDRC_St.DFC_HvBattOperModChrgPlausy "" ULONG DFC_OneToOne 1 100 0.00 536870911.000 BIT_MASK 0x1fffffff FORMAT "%13.3" ECU_ADDRESS 0x6001C3FC /end MEASUREMENT
/begin MEASUREMENT DDRC_St.DFC_HvBattOverTDern "" ULONG DFC_OneToOne 1 100 0.00 536870911.000 BIT_MASK 0x1fffffff FORMAT "%13.3" ECU_ADDRESS 0x6001C400 /end MEASUREMENT
/begin MEASUREMENT DDRC_St.DFC_HvBattPosCntctrCntErr "" ULONG DFC_OneToOne 1 100 0.00 536870911.000 BIT_MASK 0x1fffffff FORMAT "%13.3" ECU_ADDRESS 0x6001C404 /end MEASUREMENT
/begin MEASUREMENT DDRC_St.DFC_HvBattPrecCntctrCntErr "" ULONG DFC_OneToOne 1 100 0.00 536870911.000 BIT_MASK 0x1fffffff FORMAT "%13.3" ECU_ADDRESS 0x6001C408 /end MEASUREMENT
/begin MEASUREMENT DDRC_St.DFC_HvBattPwrDistbnTDern "" ULONG DFC_OneToOne 1 100 0.00 536870911.000 BIT_MASK 0x1fffffff FORMAT "%13.3" ECU_ADDRESS 0x6001C40C /end MEASUREMENT
/begin MEASUREMENT DDRC_St.DFC_HvBattPwrDistbnTInhbn "" ULONG DFC_OneToOne 1 100 0.00 536870911.000 BIT_MASK 0x1fffffff FORMAT "%13.3" ECU_ADDRESS 0x6001C410 /end MEASUREMENT
/begin MEASUREMENT DDRC_St.DFC_HvBattRatRSohErr "" ULONG DFC_OneToOne 1 100 0.00 536870911.000 BIT_MASK 0x1fffffff FORMAT "%13.3" ECU_ADDRESS 0x6001C414 /end MEASUREMENT
/begin MEASUREMENT DDRC_St.DFC_HvBattRatSohErr "" ULONG DFC_OneToOne 1 100 0.00 536870911.000 BIT_MASK 0x1fffffff FORMAT "%13.3" ECU_ADDRESS 0x6001C418 /end MEASUREMENT
/begin MEASUREMENT DDRC_St.DFC_HvBattSngIsoWarn "" ULONG DFC_OneToOne 1 100 0.00 536870911.000 BIT_MASK 0x1fffffff FORMAT "%13.3" ECU_ADDRESS 0x6001C41C /end MEASUREMENT
/begin MEASUREMENT DDRC_St.DFC_HvBattSrvPlgDiscnct "" ULONG DFC_OneToOne 1 100 0.00 536870911.000 BIT_MASK 0x1fffffff FORMAT "%13.3" ECU_ADDRESS 0x6001C420 /end MEASUREMENT
/begin MEASUREMENT DDRC_St.DFC_HvBattUnderTDern "" ULONG DFC_OneToOne 1 100 0.00 536870911.000 BIT_MASK 0x1fffffff FORMAT "%13.3" ECU_ADDRESS 0x6001C42C /end MEASUREMENT
/begin MEASUREMENT DDRC_St.DFC_InmLINBusBlk "" ULONG DFC_OneToOne 1 100 0.00 536870911.000 BIT_MASK 0x1fffffff FORMAT "%13.3" ECU_ADDRESS 0x6001C440 /end MEASUREMENT
/begin MEASUREMENT DDRC_St.DFC_ComHSN1CANMute "" ULONG DFC_OneToOne 1 100 0.00 536870911.000 BIT_MASK 0x1fffffff FORMAT "%13.3" ECU_ADDRESS 0x6001CAB4 /end MEASUREMENT
/begin MEASUREMENT DDRC_St.DFC_ComHSN3CANMute "" ULONG DFC_OneToOne 1 100 0.00 536870911.000 BIT_MASK 0x1fffffff FORMAT "%13.3" ECU_ADDRESS 0x6001CAB8 /end MEASUREMENT
/begin MEASUREMENT DDRC_St.DFC_HvGridUMaxSftyLim "" UWORD DFC_OneToOne 1 100 0.00 8191.000 BIT_MASK 0x1fff FORMAT "%8.3" ECU_ADDRESS 0x60021FB4 /end MEASUREMENT
/begin MEASUREMENT DDRC_St.DFC_HvGridUMinSftyLim "" UWORD DFC_OneToOne 1 100 0.00 8191.000 BIT_MASK 0x1fff FORMAT "%8.3" ECU_ADDRESS 0x60021FB6 /end MEASUREMENT
/begin MEASUREMENT DDRC_St.DFC_HvGridUPlausy "" UWORD DFC_OneToOne 1 100 0.00 8191.000 BIT_MASK 0x1fff FORMAT "%8.3" ECU_ADDRESS 0x60021FB8 /end MEASUREMENT
/begin MEASUREMENT debRepCheck "DFC Check" ULONG OneToOne 1 100 0.00 4294967295.00 FORMAT "%13.2" ECU_ADDRESS 0x6000076C /end MEASUREMENT
/begin MEASUREMENT DFC_st.DFC_HvBattChrgPwrMax "" UBYTE DFC_OneToOne 1 100 0.00 255.0 FORMAT "%5.1" ECU_ADDRESS 0x60034A4F /end MEASUREMENT
/begin MEASUREMENT DFC_st.DFC_HvBattCrashDetd "" UBYTE DFC_OneToOne 1 100 0.00 255.0 FORMAT "%5.1" ECU_ADDRESS 0x60034A50 /end MEASUREMENT
/begin MEASUREMENT DFC_st.DFC_HvBattDchaPwrMax "" UBYTE DFC_OneToOne 1 100 0.00 255.0 FORMAT "%5.1" ECU_ADDRESS 0x60034A51 /end MEASUREMENT
/begin MEASUREMENT DFC_st.DFC_HvBattEmgyOff "" UBYTE DFC_OneToOne 1 100 0.00 255.0 FORMAT "%5.1" ECU_ADDRESS 0x60034A52 /end MEASUREMENT
/begin MEASUREMENT DFC_st.DFC_HvBattEmgyOffIntlck "" UBYTE DFC_OneToOne 1 100 0.00 255.0 FORMAT "%5.1" ECU_ADDRESS 0x60034A53 /end MEASUREMENT
/begin MEASUREMENT DFC_st.DFC_HvBattEmgyOffReq "" UBYTE DFC_OneToOne 1 100 0.00 255.0 FORMAT "%5.1" ECU_ADDRESS 0x60034A54 /end MEASUREMENT
/begin MEASUREMENT DFC_st.DFC_HvBattFltMod "" UBYTE DFC_OneToOne 1 100 0.00 255.0 FORMAT "%5.1" ECU_ADDRESS 0x60034A55 /end MEASUREMENT
/begin MEASUREMENT DFC_st.DFC_HvBattIninTout "" UBYTE DFC_OneToOne 1 100 0.00 255.0 FORMAT "%5.1" ECU_ADDRESS 0x60034A58 /end MEASUREMENT
/begin MEASUREMENT DFC_st.DFC_HvBattIntlckSt "" UBYTE DFC_OneToOne 1 100 0.00 255.0 FORMAT "%5.1" ECU_ADDRESS 0x60034A59 /end MEASUREMENT
/begin MEASUREMENT DFC_st.DFC_HvBattIsoFlt "" UBYTE DFC_OneToOne 1 100 0.00 255.0 FORMAT "%5.1" ECU_ADDRESS 0x60034A5A /end MEASUREMENT
/begin MEASUREMENT DFC_st.DFC_HvBattLimdPwr "" UBYTE DFC_OneToOne 1 100 0.00 255.0 FORMAT "%5.1" ECU_ADDRESS 0x60034A5B /end MEASUREMENT
/begin MEASUREMENT DFC_st.DFC_HvBattMaiSwtClsngFlt "" UBYTE DFC_OneToOne 1 100 0.00 255.0 FORMAT "%5.1" ECU_ADDRESS 0x60034A5C /end MEASUREMENT
/begin MEASUREMENT DFC_st.DFC_HvBattMaiSwtFlt "" UBYTE DFC_OneToOne 1 100 0.00 255.0 FORMAT "%5.1" ECU_ADDRESS 0x60034A5D /end MEASUREMENT
/begin MEASUREMENT DFC_st.DFC_HvBattMaiSwtOpen "" UBYTE DFC_OneToOne 1 100 0.00 255.0 FORMAT "%5.1" ECU_ADDRESS 0x60034A5E /end MEASUREMENT
/begin MEASUREMENT DFC_st.DFC_HvBattMaiSwtOpngFlt "" UBYTE DFC_OneToOne 1 100 0.00 255.0 FORMAT "%5.1" ECU_ADDRESS 0x60034A5F /end MEASUREMENT
/begin MEASUREMENT DFC_st.DFC_HvBattMaiSwtWldd "" UBYTE DFC_OneToOne 1 100 0.00 255.0 FORMAT "%5.1" ECU_ADDRESS 0x60034A60 /end MEASUREMENT
/begin MEASUREMENT DFC_st.DFC_HvBattNegCntctrCntErr "" UBYTE DFC_OneToOne 1 100 0.00 255.0 FORMAT "%5.1" ECU_ADDRESS 0x60034A61 /end MEASUREMENT
/begin MEASUREMENT DFC_st.DFC_HvBattOperModChrgPlausy "" UBYTE DFC_OneToOne 1 100 0.00 255.0 FORMAT "%5.1" ECU_ADDRESS 0x60034A62 /end MEASUREMENT
/begin MEASUREMENT DFC_st.DFC_HvBattOverTDern "" UBYTE DFC_OneToOne 1 100 0.00 255.0 FORMAT "%5.1" ECU_ADDRESS 0x60034A63 /end MEASUREMENT
/begin MEASUREMENT DFC_st.DFC_HvBattPosCntctrCntErr "" UBYTE DFC_OneToOne 1 100 0.00 255.0 FORMAT "%5.1" ECU_ADDRESS 0x60034A64 /end MEASUREMENT
/begin MEASUREMENT DFC_st.DFC_HvBattPrecCntctrCntErr "" UBYTE DFC_OneToOne 1 100 0.00 255.0 FORMAT "%5.1" ECU_ADDRESS 0x60034A65 /end MEASUREMENT
/begin MEASUREMENT DFC_st.DFC_HvBattPwrDistbnTDern "" UBYTE DFC_OneToOne 1 100 0.00 255.0 FORMAT "%5.1" ECU_ADDRESS 0x60034A66 /end MEASUREMENT
/begin MEASUREMENT DFC_st.DFC_HvBattPwrDistbnTInhbn "" UBYTE DFC_OneToOne 1 100 0.00 255.0 FORMAT "%5.1" ECU_ADDRESS 0x60034A67 /end MEASUREMENT
/begin MEASUREMENT DFC_st.DFC_HvBattRatRSohErr "" UBYTE DFC_OneToOne 1 100 0.00 255.0 FORMAT "%5.1" ECU_ADDRESS 0x60034A68 /end MEASUREMENT
/begin MEASUREMENT DFC_st.DFC_HvBattRatSohErr "" UBYTE DFC_OneToOne 1 100 0.00 255.0 FORMAT "%5.1" ECU_ADDRESS 0x60034A69 /end MEASUREMENT
/begin MEASUREMENT DFC_st.DFC_HvBattSngIsoWarn "" UBYTE DFC_OneToOne 1 100 0.00 255.0 FORMAT "%5.1" ECU_ADDRESS 0x60034A6A /end MEASUREMENT
/begin MEASUREMENT DFC_st.DFC_HvBattSrvPlgDiscnct "" UBYTE DFC_OneToOne 1 100 0.00 255.0 FORMAT "%5.1" ECU_ADDRESS 0x60034A6B /end MEASUREMENT
/begin MEASUREMENT DFC_st.DFC_HvBattUnderTDern "" UBYTE DFC_OneToOne 1 100 0.00 255.0 FORMAT "%5.1" ECU_ADDRESS 0x60034A6E /end MEASUREMENT
/begin MEASUREMENT DFC_st.DFC_InmLINBusBlk "" UBYTE DFC_OneToOne 1 100 0.00 255.0 FORMAT "%5.1" ECU_ADDRESS 0x60034A73 /end MEASUREMENT
/begin MEASUREMENT DFC_st.DFC_ComHSN1CANMute "" UBYTE DFC_OneToOne 1 100 0.00 255.0 FORMAT "%5.1" ECU_ADDRESS 0x60034C10 /end MEASUREMENT
/begin MEASUREMENT DFC_st.DFC_ComHSN3CANMute "" UBYTE DFC_OneToOne 1 100 0.00 255.0 FORMAT "%5.1" ECU_ADDRESS 0x60034C11 /end MEASUREMENT
/begin MEASUREMENT DFC_st.DFC_HvGridUMaxSftyLim "" UBYTE DFC_OneToOne 1 100 0.00 255.0 FORMAT "%5.1" ECU_ADDRESS 0x60034C31 /end MEASUREMENT
/begin MEASUREMENT DFC_st.DFC_HvGridUMinSftyLim "" UBYTE DFC_OneToOne 1 100 0.00 255.0 FORMAT "%5.1" ECU_ADDRESS 0x60034C32 /end MEASUREMENT
/begin MEASUREMENT DFC_st.DFC_HvGridUPlausy "" UBYTE DFC_OneToOne 1 100 0.00 255.0 FORMAT "%5.1" ECU_ADDRESS 0x60034C33 /end MEASUREMENT
/begin MEASUREMENT DFC_st.DFC_ComHSN1BusOff "" UBYTE DFC_OneToOne 1 100 0.00 255.0 FORMAT "%5.1" ECU_ADDRESS 0x60034C79 /end MEASUREMENT
/begin MEASUREMENT DFC_st.DFC_ComHSN3BusOff "" UBYTE DFC_OneToOne 1 100 0.00 255.0 FORMAT "%5.1" ECU_ADDRESS 0x60034C7A /end MEASUREMENT
/begin MEASUREMENT DFC_st.DFC_InmLINNodeHVACPanelAbsnt "" UBYTE DFC_OneToOne 1 100 0.00 255.0 FORMAT "%5.1" ECU_ADDRESS 0x60034C80 /end MEASUREMENT
/begin MEASUREMENT DFC_st.DFC_HvGridSocMinLim "" UBYTE DFC_OneToOne 1 100 0.00 255.0 FORMAT "%5.1" ECU_ADDRESS 0x60034CDB /end MEASUREMENT
/begin MEASUREMENT DINH_nrActvInhReas.FId_HvBattChrgLvl3DernFlt "" UWORD DINH_ct_Compu 1 100 -4095.000 4096.000 BIT_MASK 0x1fff FORMAT "%8.3" ECU_ADDRESS 0x600214AA /end MEASUREMENT
/begin MEASUREMENT DINH_nrActvInhReas.FId_HvBattDchaLvl3DernFlt "" UWORD DINH_ct_Compu 1 100 -4095.000 4096.000 BIT_MASK 0x1fff FORMAT "%8.3" ECU_ADDRESS 0x600214AC /end MEASUREMENT
/begin MEASUREMENT DINH_nrActvInhReas.FId_HvBattMaiSwtDiagEna "" UWORD DINH_ct_Compu 1 100 -4095.000 4096.000 BIT_MASK 0x1fff FORMAT "%8.3" ECU_ADDRESS 0x600214B0 /end MEASUREMENT
/begin MEASUREMENT DINH_nrActvInhReas.FId_HvBattMaxPwrBusTDern "" UWORD DINH_ct_Compu 1 100 -4095.000 4096.000 BIT_MASK 0x1fff FORMAT "%8.3" ECU_ADDRESS 0x600214B2 /end MEASUREMENT
/begin MEASUREMENT DINH_nrActvInhReas.FId_HvBattNegCntctrCnt "" UWORD DINH_ct_Compu 1 100 -4095.000 4096.000 BIT_MASK 0x1fff FORMAT "%8.3" ECU_ADDRESS 0x600214B4 /end MEASUREMENT
/begin MEASUREMENT DINH_nrActvInhReas.FId_HvBattPosCntctrCnt "" UWORD DINH_ct_Compu 1 100 -4095.000 4096.000 BIT_MASK 0x1fff FORMAT "%8.3" ECU_ADDRESS 0x600214B6 /end MEASUREMENT
/begin MEASUREMENT DINH_nrActvInhReas.FId_HvBattPrecCntctrCnt "" UWORD DINH_ct_Compu 1 100 -4095.000 4096.000 BIT_MASK 0x1fff FORMAT "%8.3" ECU_ADDRESS 0x600214B8 /end MEASUREMENT
/begin MEASUREMENT DINH_nrActvInhReas.FId_HvBattPwrDistbnTDern "" UWORD DINH_ct_Compu 1 100 -4095.000 4096.000 BIT_MASK 0x1fff FORMAT "%8.3" ECU_ADDRESS 0x600214BA /end MEASUREMENT
/begin MEASUREMENT DINH_nrActvInhReas.FId_HvBattPwrDistbnTInhbn "" UWORD DINH_ct_Compu 1 100 -4095.000 4096.000 BIT_MASK 0x1fff FORMAT "%8.3" ECU_ADDRESS 0x600214BC /end MEASUREMENT
/begin MEASUREMENT DINH_nrActvInhReas.FId_HvBattRatRSoh "" UWORD DINH_ct_Compu 1 100 -4095.000 4096.000 BIT_MASK 0x1fff FORMAT "%8.3" ECU_ADDRESS 0x600214BE /end MEASUREMENT
/begin MEASUREMENT DINH_nrActvInhReas.FId_HvBattRatSoh "" UWORD DINH_ct_Compu 1 100 -4095.000 4096.000 BIT_MASK 0x1fff FORMAT "%8.3" ECU_ADDRESS 0x600214C0 /end MEASUREMENT
/begin MEASUREMENT DINH_nrActvInhReas.FId_HvGridAuxPwr01 "" UWORD DINH_ct_Compu 1 100 -4095.000 4096.000 BIT_MASK 0x1fff FORMAT "%8.3" ECU_ADDRESS 0x600214C2 /end MEASUREMENT
/begin MEASUREMENT DINH_nrActvInhReas.FId_HvGridAuxPwr02 "" UWORD DINH_ct_Compu 1 100 -4095.000 4096.000 BIT_MASK 0x1fff FORMAT "%8.3" ECU_ADDRESS 0x600214C4 /end MEASUREMENT
/begin MEASUREMENT DINH_nrActvInhReas.FId_HvGridAuxPwr03 "" UWORD DINH_ct_Compu 1 100 -4095.000 4096.000 BIT_MASK 0x1fff FORMAT "%8.3" ECU_ADDRESS 0x600214C6 /end MEASUREMENT
/begin MEASUREMENT DINH_nrActvInhReas.FId_HvGridAuxPwr04 "" UWORD DINH_ct_Compu 1 100 -4095.000 4096.000 BIT_MASK 0x1fff FORMAT "%8.3" ECU_ADDRESS 0x600214C8 /end MEASUREMENT
/begin MEASUREMENT DINH_nrActvInhReas.FId_HvGridDcdcPwr "" UWORD DINH_ct_Compu 1 100 -4095.000 4096.000 BIT_MASK 0x1fff FORMAT "%8.3" ECU_ADDRESS 0x600214CA /end MEASUREMENT
/begin MEASUREMENT DINH_nrActvInhReas.FId_HvGridDcdcUSftyErr "" UWORD DINH_ct_Compu 1 100 -4095.000 4096.000 BIT_MASK 0x1fff FORMAT "%8.3" ECU_ADDRESS 0x600214CC /end MEASUREMENT
/begin MEASUREMENT DINH_nrActvInhReas.FId_HvGridElM01USftyErr "" UWORD DINH_ct_Compu 1 100 -4095.000 4096.000 BIT_MASK 0x1fff FORMAT "%8.3" ECU_ADDRESS 0x600214CE /end MEASUREMENT
/begin MEASUREMENT DINH_nrActvInhReas.FId_HvGridHvBattSftyLimErr "" UWORD DINH_ct_Compu 1 100 -4095.000 4096.000 BIT_MASK 0x1fff FORMAT "%8.3" ECU_ADDRESS 0x600214D0 /end MEASUREMENT
/begin MEASUREMENT DINH_nrActvInhReas.FId_HvGridMaiSwtErr "" UWORD DINH_ct_Compu 1 100 -4095.000 4096.000 BIT_MASK 0x1fff FORMAT "%8.3" ECU_ADDRESS 0x600214D2 /end MEASUREMENT
/begin MEASUREMENT DINH_nrActvInhReas.FId_HvGridPwrMaxChrgContnsErr "" UWORD DINH_ct_Compu 1 100 -4095.000 4096.000 BIT_MASK 0x1fff FORMAT "%8.3" ECU_ADDRESS 0x600214D4 /end MEASUREMENT
/begin MEASUREMENT DINH_nrActvInhReas.FId_HvGridPwrMaxChrgShoErr "" UWORD DINH_ct_Compu 1 100 -4095.000 4096.000 BIT_MASK 0x1fff FORMAT "%8.3" ECU_ADDRESS 0x600214D6 /end MEASUREMENT
/begin MEASUREMENT DINH_nrActvInhReas.FId_HvGridPwrMaxDchaContnsErr "" UWORD DINH_ct_Compu 1 100 -4095.000 4096.000 BIT_MASK 0x1fff FORMAT "%8.3" ECU_ADDRESS 0x600214D8 /end MEASUREMENT
/begin MEASUREMENT DINH_nrActvInhReas.FId_HvGridPwrMaxDchaShoErr "" UWORD DINH_ct_Compu 1 100 -4095.000 4096.000 BIT_MASK 0x1fff FORMAT "%8.3" ECU_ADDRESS 0x600214DA /end MEASUREMENT
/begin MEASUREMENT DINH_stFId.FId_HvBattChrgLvl3DernFlt "" UWORD DFC_OneToOne 1 100 0.00 65535.00 FORMAT "%8.2" ECU_ADDRESS 0x600214AA /end MEASUREMENT
/begin MEASUREMENT DINH_stFId.FId_HvBattDchaLvl3DernFlt "" UWORD DFC_OneToOne 1 100 0.00 65535.00 FORMAT "%8.2" ECU_ADDRESS 0x600214AC /end MEASUREMENT
/begin MEASUREMENT DINH_stFId.FId_HvBattMaiSwtDiagEna "" UWORD DFC_OneToOne 1 100 0.00 65535.00 FORMAT "%8.2" ECU_ADDRESS 0x600214B0 /end MEASUREMENT
/begin MEASUREMENT DINH_stFId.FId_HvBattMaxPwrBusTDern "" UWORD DFC_OneToOne 1 100 0.00 65535.00 FORMAT "%8.2" ECU_ADDRESS 0x600214B2 /end MEASUREMENT
/begin MEASUREMENT DINH_stFId.FId_HvBattNegCntctrCnt "" UWORD DFC_OneToOne 1 100 0.00 65535.00 FORMAT "%8.2" ECU_ADDRESS 0x600214B4 /end MEASUREMENT
/begin MEASUREMENT DINH_stFId.FId_HvBattPosCntctrCnt "" UWORD DFC_OneToOne 1 100 0.00 65535.00 FORMAT "%8.2" ECU_ADDRESS 0x600214B6 /end MEASUREMENT
/begin MEASUREMENT DINH_stFId.FId_HvBattPrecCntctrCnt "" UWORD DFC_OneToOne 1 100 0.00 65535.00 FORMAT "%8.2" ECU_ADDRESS 0x600214B8 /end MEASUREMENT
/begin MEASUREMENT DINH_stFId.FId_HvBattPwrDistbnTDern "" UWORD DFC_OneToOne 1 100 0.00 65535.00 FORMAT "%8.2" ECU_ADDRESS 0x600214BA /end MEASUREMENT
/begin MEASUREMENT DINH_stFId.FId_HvBattPwrDistbnTInhbn "" UWORD DFC_OneToOne 1 100 0.00 65535.00 FORMAT "%8.2" ECU_ADDRESS 0x600214BC /end MEASUREMENT
/begin MEASUREMENT DINH_stFId.FId_HvBattRatRSoh "" UWORD DFC_OneToOne 1 100 0.00 65535.00 FORMAT "%8.2" ECU_ADDRESS 0x600214BE /end MEASUREMENT
/begin MEASUREMENT DINH_stFId.FId_HvBattRatSoh "" UWORD DFC_OneToOne 1 100 0.00 65535.00 FORMAT "%8.2" ECU_ADDRESS 0x600214C0 /end MEASUREMENT
/begin MEASUREMENT DINH_stFId.FId_HvGridAuxPwr01 "" UWORD DFC_OneToOne 1 100 0.00 65535.00 FORMAT "%8.2" ECU_ADDRESS 0x600214C2 /end MEASUREMENT
/begin MEASUREMENT DINH_stFId.FId_HvGridAuxPwr02 "" UWORD DFC_OneToOne 1 100 0.00 65535.00 FORMAT "%8.2" ECU_ADDRESS 0x600214C4 /end MEASUREMENT
/begin MEASUREMENT DINH_stFId.FId_HvGridAuxPwr03 "" UWORD DFC_OneToOne 1 100 0.00 65535.00 FORMAT "%8.2" ECU_ADDRESS 0x600214C6 /end MEASUREMENT
/begin MEASUREMENT DINH_stFId.FId_HvGridAuxPwr04 "" UWORD DFC_OneToOne 1 100 0.00 65535.00 FORMAT "%8.2" ECU_ADDRESS 0x600214C8 /end MEASUREMENT
/begin MEASUREMENT DINH_stFId.FId_HvGridDcdcPwr "" UWORD DFC_OneToOne 1 100 0.00 65535.00 FORMAT "%8.2" ECU_ADDRESS 0x600214CA /end MEASUREMENT
/begin MEASUREMENT DINH_stFId.FId_HvGridDcdcUSftyErr "" UWORD DFC_OneToOne 1 100 0.00 65535.00 FORMAT "%8.2" ECU_ADDRESS 0x600214CC /end MEASUREMENT
/begin MEASUREMENT DINH_stFId.FId_HvGridElM01USftyErr "" UWORD DFC_OneToOne 1 100 0.00 65535.00 FORMAT "%8.2" ECU_ADDRESS 0x600214CE /end MEASUREMENT
/begin MEASUREMENT DINH_stFId.FId_HvGridHvBattSftyLimErr "" UWORD DFC_OneToOne 1 100 0.00 65535.00 FORMAT "%8.2" ECU_ADDRESS 0x600214D0 /end MEASUREMENT
/begin MEASUREMENT DINH_stFId.FId_HvGridMaiSwtErr "" UWORD DFC_OneToOne 1 100 0.00 65535.00 FORMAT "%8.2" ECU_ADDRESS 0x600214D2 /end MEASUREMENT
/begin MEASUREMENT DINH_stFId.FId_HvGridPwrMaxChrgContnsErr "" UWORD DFC_OneToOne 1 100 0.00 65535.00 FORMAT "%8.2" ECU_ADDRESS 0x600214D4 /end MEASUREMENT
/begin MEASUREMENT DINH_stFId.FId_HvGridPwrMaxChrgShoErr "" UWORD DFC_OneToOne 1 100 0.00 65535.00 FORMAT "%8.2" ECU_ADDRESS 0x600214D6 /end MEASUREMENT
/begin MEASUREMENT DINH_stFId.FId_HvGridPwrMaxDchaContnsErr "" UWORD DFC_OneToOne 1 100 0.00 65535.00 FORMAT "%8.2" ECU_ADDRESS 0x600214D8 /end MEASUREMENT
/begin MEASUREMENT DINH_stFId.FId_HvGridPwrMaxDchaShoErr "" UWORD DFC_OneToOne 1 100 0.00 65535.00 FORMAT "%8.2" ECU_ADDRESS 0x600214DA /end MEASUREMENT
/begin MEASUREMENT filteringCtr20ms_tmp "local variable to store the value of filtering counter" UBYTE OneToOne 1 100 0.00 255.0 FORMAT "%5.1" ECU_ADDRESS 0x700015E0 /end MEASUREMENT
/begin MEASUREMENT HvBatt_cntNegCntctrSeg1EepVal "Eep stored value of operation counts of negative contactor from 0A to 5A" ULONG q64 1 100 0.00 274877906880. FORMAT "%13.0" ECU_ADDRESS 0x60000EEC
 /begin IF_DATA XCPplus 0x0102
  /begin DAQ_EVENT VARIABLE /end DAQ_EVENT
 /end IF_DATA
/end MEASUREMENT
/begin MEASUREMENT HvBatt_cntNegCntctrSeg2EepVal "Eep stored value of operation counts of negative contactor from 5A to 150A" UWORD q16 1 100 0.00 1048560. FORMAT "%8.0" ECU_ADDRESS 0x6001FA30
 /begin IF_DATA XCPplus 0x0102
  /begin DAQ_EVENT VARIABLE /end DAQ_EVENT
 /end IF_DATA
/end MEASUREMENT
/begin MEASUREMENT HvBatt_cntNegCntctrSeg3EepVal "Eep stored value of operation counts of negative contactor from 150A to 200A" UWORD q8 1 100 0.00 524280.0 FORMAT "%8.1" ECU_ADDRESS 0x6001FA2E
 /begin IF_DATA XCPplus 0x0102
  /begin DAQ_EVENT VARIABLE /end DAQ_EVENT
 /end IF_DATA
/end MEASUREMENT
/begin MEASUREMENT HvBatt_cntNegCntctrSeg4EepVal "Eep stored value of operation counts of negative contactor from 200A to 500A" UBYTE OneToOne 1 100 0.00 255.0 FORMAT "%5.1" ECU_ADDRESS 0x60023553
 /begin IF_DATA XCPplus 0x0102
  /begin DAQ_EVENT VARIABLE /end DAQ_EVENT
 /end IF_DATA
/end MEASUREMENT
/begin MEASUREMENT HvBatt_cntNegCntctrSeg5EepVal "Eep stored value of operation counts of negative contactor from 500A to 1200A" UBYTE OneToOne 1 100 0.00 255.0 FORMAT "%5.1" ECU_ADDRESS 0x60023552
 /begin IF_DATA XCPplus 0x0102
  /begin DAQ_EVENT VARIABLE /end DAQ_EVENT
 /end IF_DATA
/end MEASUREMENT
/begin MEASUREMENT HvBatt_cntPosCntctrSeg1EepVal "Eep stored value of operation counts of positive contactor from 0A to 5A" ULONG q64 1 100 0.00 274877906880. FORMAT "%13.0" ECU_ADDRESS 0x60000EE8
 /begin IF_DATA XCPplus 0x0102
  /begin DAQ_EVENT VARIABLE /end DAQ_EVENT
 /end IF_DATA
/end MEASUREMENT
/begin MEASUREMENT HvBatt_cntPosCntctrSeg2EepVal "Eep stored value of operation counts of positive contactor from 5A to 150A" UWORD q16 1 100 0.00 1048560. FORMAT "%8.0" ECU_ADDRESS 0x6001FA2C
 /begin IF_DATA XCPplus 0x0102
  /begin DAQ_EVENT VARIABLE /end DAQ_EVENT
 /end IF_DATA
/end MEASUREMENT
/begin MEASUREMENT HvBatt_cntPosCntctrSeg3EepVal "Eep stored value of operation counts of positive contactor from 150A to 200A" UWORD q8 1 100 0.00 524280.0 FORMAT "%8.1" ECU_ADDRESS 0x6001FA2A
 /begin IF_DATA XCPplus 0x0102
  /begin DAQ_EVENT VARIABLE /end DAQ_EVENT
 /end IF_DATA
/end MEASUREMENT
/begin MEASUREMENT HvBatt_cntPosCntctrSeg4EepVal "Eep stored value of operation counts of positive contactor from 200A to 500A" UBYTE OneToOne 1 100 0.00 255.0 FORMAT "%5.1" ECU_ADDRESS 0x60023551
 /begin IF_DATA XCPplus 0x0102
  /begin DAQ_EVENT VARIABLE /end DAQ_EVENT
 /end IF_DATA
/end MEASUREMENT
/begin MEASUREMENT HvBatt_cntPosCntctrSeg5EepVal "Eep stored value of operation counts of positive contactor from 500A to 1200A" UBYTE OneToOne 1 100 0.00 255.0 FORMAT "%5.1" ECU_ADDRESS 0x60023550
 /begin IF_DATA XCPplus 0x0102
  /begin DAQ_EVENT VARIABLE /end DAQ_EVENT
 /end IF_DATA
/end MEASUREMENT
/begin MEASUREMENT HvBatt_cntPrecCntctrSeg1EepVal "Eep stored value of close operation counts of precharge contactor" ULONG q64 1 100 0.00 274877906880. FORMAT "%13.0" ECU_ADDRESS 0x60000EE4
 /begin IF_DATA XCPplus 0x0102
  /begin DAQ_EVENT VARIABLE /end DAQ_EVENT
 /end IF_DATA
/end MEASUREMENT
/begin MEASUREMENT HvBatt_cntPrecCntctrSeg2EepVal "Eep stored value of open operation counts of precharge contactor" UWORD q8 1 100 0.00 524280.0 FORMAT "%8.1" ECU_ADDRESS 0x6001FA28
 /begin IF_DATA XCPplus 0x0102
  /begin DAQ_EVENT VARIABLE /end DAQ_EVENT
 /end IF_DATA
/end MEASUREMENT
/begin MEASUREMENT HvBatt_egyAvl_f "Available HV Battery Energy" FLOAT32_IEEE RBPtCel_pwr_1p0_4 1 100 -1.000E+037 1.000E+037 FORMAT "%8.3" ECU_ADDRESS 0x60000FD0
 /begin IF_DATA XCPplus 0x0102
  /begin DAQ_EVENT VARIABLE /end DAQ_EVENT
 /end IF_DATA
/end MEASUREMENT
/begin MEASUREMENT HvBatt_egyAvl_Sq "Signal quality of available energy of Hv battery" UBYTE SigQly_COMPU_VERB 1 100 0.00 15.0000000000 FORMAT "%13.10" ECU_ADDRESS 0x6002354F
 /begin IF_DATA XCPplus 0x0102
  /begin DAQ_EVENT VARIABLE /end DAQ_EVENT
 /end IF_DATA
/end MEASUREMENT
/begin MEASUREMENT HvBatt_facPwrChrgContnsInteg "Integration factor for charge continuous power limit" FLOAT32_IEEE RBPtCel_fac_1p0_1 1 100 -1.0000E+037 1.0000E+037 FORMAT "%9.4" ECU_ADDRESS 0x600007D0
 /begin IF_DATA XCPplus 0x0102
  /begin DAQ_EVENT VARIABLE /end DAQ_EVENT
 /end IF_DATA
/end MEASUREMENT
/begin MEASUREMENT HvBatt_facPwrChrgContnsProp "proportional factor for charge continuous power limit" SWORD Fact100 1 100 -327.6800 327.6700 FORMAT "%8.4" ECU_ADDRESS 0x6001F4A0
 /begin IF_DATA XCPplus 0x0102
  /begin DAQ_EVENT VARIABLE /end DAQ_EVENT
 /end IF_DATA
/end MEASUREMENT
/begin MEASUREMENT HvBatt_facPwrChrgShoActMeasdInteg "Integration factor for charge short measured" FLOAT32_IEEE RBPtCel_fac_1p0_1 1 100 -1.0000E+037 1.0000E+037 FORMAT "%9.4" ECU_ADDRESS 0x600007CC
 /begin IF_DATA XCPplus 0x0102
  /begin DAQ_EVENT VARIABLE /end DAQ_EVENT
 /end IF_DATA
/end MEASUREMENT
/begin MEASUREMENT HvBatt_facPwrChrgShoActMeasdProp "Proportional factor for charge short measured" SWORD Fact100 1 100 -327.6800 327.6700 FORMAT "%8.4" ECU_ADDRESS 0x6001F49E
 /begin IF_DATA XCPplus 0x0102
  /begin DAQ_EVENT VARIABLE /end DAQ_EVENT
 /end IF_DATA
/end MEASUREMENT
/begin MEASUREMENT HvBatt_facPwrDchaContnsInteg "factor for discharge continuous integrator" FLOAT32_IEEE RBPtCel_fac_1p0_1 1 100 -1.0000E+037 1.0000E+037 FORMAT "%9.4" ECU_ADDRESS 0x600007C8
 /begin IF_DATA XCPplus 0x0102
  /begin DAQ_EVENT VARIABLE /end DAQ_EVENT
 /end IF_DATA
/end MEASUREMENT
/begin MEASUREMENT HvBatt_facPwrDchaContnsProp "factor for discharge continuous proportionality input" SWORD Fact100 1 100 -327.6800 327.6700 FORMAT "%8.4" ECU_ADDRESS 0x6001F49C
 /begin IF_DATA XCPplus 0x0102
  /begin DAQ_EVENT VARIABLE /end DAQ_EVENT
 /end IF_DATA
/end MEASUREMENT
/begin MEASUREMENT HvBatt_facPwrDchaShoActMeasdInteg "factor for discharge short integrator" FLOAT32_IEEE RBPtCel_fac_1p0_1 1 100 -1.0000E+037 1.0000E+037 FORMAT "%9.4" ECU_ADDRESS 0x600007C4
 /begin IF_DATA XCPplus 0x0102
  /begin DAQ_EVENT VARIABLE /end DAQ_EVENT
 /end IF_DATA
/end MEASUREMENT
/begin MEASUREMENT HvBatt_facPwrDchaShoActMeasdProp "factor for discharge short proportionality input" SWORD Fact100 1 100 -327.6800 327.6700 FORMAT "%8.4" ECU_ADDRESS 0x6001F49A
 /begin IF_DATA XCPplus 0x0102
  /begin DAQ_EVENT VARIABLE /end DAQ_EVENT
 /end IF_DATA
/end MEASUREMENT
/begin MEASUREMENT HvBatt_flgERChrgContns "Flag to indicate the Edge Rising of Continuous charging" UBYTE B_TRUE 1 100 0.00 1.00000000000 BIT_MASK 0x1 FORMAT "%13.11" ECU_ADDRESS 0x70000157
 /begin IF_DATA XCPplus 0x0102
  /begin DAQ_EVENT VARIABLE /end DAQ_EVENT
 /end IF_DATA
/end MEASUREMENT
/begin MEASUREMENT HvBatt_flgERChrgSho "Flag to indicate the Edge Rising of short charging" UBYTE B_TRUE 1 100 0.00 1.00000000000 BIT_MASK 0x1 FORMAT "%13.11" ECU_ADDRESS 0x70000156
 /begin IF_DATA XCPplus 0x0102
  /begin DAQ_EVENT VARIABLE /end DAQ_EVENT
 /end IF_DATA
/end MEASUREMENT
/begin MEASUREMENT HvBatt_flgERDchaContns "Flag to indicate the Edge Rising of Continuous discharging" UBYTE B_TRUE 1 100 0.00 1.00000000000 BIT_MASK 0x1 FORMAT "%13.11" ECU_ADDRESS 0x70000155
 /begin IF_DATA XCPplus 0x0102
  /begin DAQ_EVENT VARIABLE /end DAQ_EVENT
 /end IF_DATA
/end MEASUREMENT
/begin MEASUREMENT HvBatt_flgERDchaSho "Flag to indicate the Edge Rising of short discharging" UBYTE B_TRUE 1 100 0.00 1.00000000000 BIT_MASK 0x1 FORMAT "%13.11" ECU_ADDRESS 0x70000154
 /begin IF_DATA XCPplus 0x0102
  /begin DAQ_EVENT VARIABLE /end DAQ_EVENT
 /end IF_DATA
/end MEASUREMENT
/begin MEASUREMENT HvBatt_flgHvActvnEnad "High Voltage Activation Enabled" UBYTE B_TRUE 1 100 0.00 1.00000000000 BIT_MASK 0x1 FORMAT "%13.11" ECU_ADDRESS 0x70000278
 /begin IF_DATA XCPplus 0x0102
  /begin DAQ_EVENT VARIABLE /end DAQ_EVENT
 /end IF_DATA
/end MEASUREMENT
/begin MEASUREMENT HvBatt_flgNegCntctrCntEepWrite "Flag to enable the EEP write of negative contactor count segments" UBYTE B_TRUE 1 100 0.00 1.00000000000 BIT_MASK 0x1 FORMAT "%13.11" ECU_ADDRESS 0x70000165
 /begin IF_DATA XCPplus 0x0102
  /begin DAQ_EVENT VARIABLE /end DAQ_EVENT
 /end IF_DATA
/end MEASUREMENT
/begin MEASUREMENT HvBatt_flgNegCntctrCntErr "Flag to indicate the received negative contactor count value is less than the stored value" UBYTE B_TRUE 1 100 0.00 1.00000000000 BIT_MASK 0x1 FORMAT "%13.11" ECU_ADDRESS 0x70000164
 /begin IF_DATA XCPplus 0x0102
  /begin DAQ_EVENT VARIABLE /end DAQ_EVENT
 /end IF_DATA
/end MEASUREMENT
/begin MEASUREMENT HvBatt_flgPosCntctrCntEepWrite "Flag to enable the EEP write of positive contactor count segments" UBYTE B_TRUE 1 100 0.00 1.00000000000 BIT_MASK 0x1 FORMAT "%13.11" ECU_ADDRESS 0x70000163
 /begin IF_DATA XCPplus 0x0102
  /begin DAQ_EVENT VARIABLE /end DAQ_EVENT
 /end IF_DATA
/end MEASUREMENT
/begin MEASUREMENT HvBatt_flgPosCntctrCntErr "Flag to indicate the received positive contactor count value is less than the stored value" UBYTE B_TRUE 1 100 0.00 1.00000000000 BIT_MASK 0x1 FORMAT "%13.11" ECU_ADDRESS 0x70000162
 /begin IF_DATA XCPplus 0x0102
  /begin DAQ_EVENT VARIABLE /end DAQ_EVENT
 /end IF_DATA
/end MEASUREMENT
/begin MEASUREMENT HvBatt_flgPrecCntctrCntEepWrite "Flag to enable the EEP write of precharge contactor count segments" UBYTE B_TRUE 1 100 0.00 1.00000000000 BIT_MASK 0x1 FORMAT "%13.11" ECU_ADDRESS 0x70000161
 /begin IF_DATA XCPplus 0x0102
  /begin DAQ_EVENT VARIABLE /end DAQ_EVENT
 /end IF_DATA
/end MEASUREMENT
/begin MEASUREMENT HvBatt_flgPrecCntctrCntErr "Flag to indicate the received precharge contactor count value is less than the stored value" UBYTE B_TRUE 1 100 0.00 1.00000000000 BIT_MASK 0x1 FORMAT "%13.11" ECU_ADDRESS 0x70000160
 /begin IF_DATA XCPplus 0x0102
  /begin DAQ_EVENT VARIABLE /end DAQ_EVENT
 /end IF_DATA
/end MEASUREMENT
/begin MEASUREMENT HvBatt_flgRatRSohEepWrite "Flag to enable the EEP write of SOH-R value" UBYTE B_TRUE 1 100 0.00 1.00000000000 BIT_MASK 0x1 FORMAT "%13.11" ECU_ADDRESS 0x7000015F
 /begin IF_DATA XCPplus 0x0102
  /begin DAQ_EVENT VARIABLE /end DAQ_EVENT
 /end IF_DATA
/end MEASUREMENT
/begin MEASUREMENT HvBatt_flgRatRSohErr "Flag to indicate the received SOH-R value is greater than the stored value" UBYTE B_TRUE 1 100 0.00 1.00000000000 BIT_MASK 0x1 FORMAT "%13.11" ECU_ADDRESS 0x7000015E
 /begin IF_DATA XCPplus 0x0102
  /begin DAQ_EVENT VARIABLE /end DAQ_EVENT
 /end IF_DATA
/end MEASUREMENT
/begin MEASUREMENT HvBatt_flgRatSohEepWrite "Flag to enable the EEP write of SOH-C value" UBYTE B_TRUE 1 100 0.00 1.00000000000 BIT_MASK 0x1 FORMAT "%13.11" ECU_ADDRESS 0x7000015D
 /begin IF_DATA XCPplus 0x0102
  /begin DAQ_EVENT VARIABLE /end DAQ_EVENT
 /end IF_DATA
/end MEASUREMENT
/begin MEASUREMENT HvBatt_flgRatSohErr "Flag to indicate the received SOH-C value is greater than the stored value" UBYTE B_TRUE 1 100 0.00 1.00000000000 BIT_MASK 0x1 FORMAT "%13.11" ECU_ADDRESS 0x7000015C
 /begin IF_DATA XCPplus 0x0102
  /begin DAQ_EVENT VARIABLE /end DAQ_EVENT
 /end IF_DATA
/end MEASUREMENT
/begin MEASUREMENT HvBatt_flgRmpChrgContnsActv "Active status of continuous charging ramp" UBYTE B_TRUE 1 100 0.00 1.00000000000 BIT_MASK 0x1 FORMAT "%13.11" ECU_ADDRESS 0x70000153
 /begin IF_DATA XCPplus 0x0102
  /begin DAQ_EVENT VARIABLE /end DAQ_EVENT
 /end IF_DATA
/end MEASUREMENT
/begin MEASUREMENT HvBatt_flgRmpChrgContnsActvOld "Active old status of continuous charging ramp" UBYTE B_TRUE 1 100 0.00 1.00000000000 BIT_MASK 0x1 FORMAT "%13.11" ECU_ADDRESS 0x70000152
 /begin IF_DATA XCPplus 0x0102
  /begin DAQ_EVENT VARIABLE /end DAQ_EVENT
 /end IF_DATA
/end MEASUREMENT
/begin MEASUREMENT HvBatt_flgRmpChrgShoActv "Active status of short charging ramp" UBYTE B_TRUE 1 100 0.00 1.00000000000 BIT_MASK 0x1 FORMAT "%13.11" ECU_ADDRESS 0x70000151
 /begin IF_DATA XCPplus 0x0102
  /begin DAQ_EVENT VARIABLE /end DAQ_EVENT
 /end IF_DATA
/end MEASUREMENT
/begin MEASUREMENT HvBatt_flgRmpChrgShoActvOld "Active old status of short charging ramp" UBYTE B_TRUE 1 100 0.00 1.00000000000 BIT_MASK 0x1 FORMAT "%13.11" ECU_ADDRESS 0x70000150
 /begin IF_DATA XCPplus 0x0102
  /begin DAQ_EVENT VARIABLE /end DAQ_EVENT
 /end IF_DATA
/end MEASUREMENT
/begin MEASUREMENT HvBatt_flgRmpDchaContnsActv "Active status of continuous discharging ramp" UBYTE B_TRUE 1 100 0.00 1.00000000000 BIT_MASK 0x1 FORMAT "%13.11" ECU_ADDRESS 0x7000014F
 /begin IF_DATA XCPplus 0x0102
  /begin DAQ_EVENT VARIABLE /end DAQ_EVENT
 /end IF_DATA
/end MEASUREMENT
/begin MEASUREMENT HvBatt_flgRmpDchaContnsActvOld "Active old status of continuous discharging ramp" UBYTE B_TRUE 1 100 0.00 1.00000000000 BIT_MASK 0x1 FORMAT "%13.11" ECU_ADDRESS 0x7000014E
 /begin IF_DATA XCPplus 0x0102
  /begin DAQ_EVENT VARIABLE /end DAQ_EVENT
 /end IF_DATA
/end MEASUREMENT
/begin MEASUREMENT HvBatt_flgRmpDchaShoActv "Active status of short discharging ramp" UBYTE B_TRUE 1 100 0.00 1.00000000000 BIT_MASK 0x1 FORMAT "%13.11" ECU_ADDRESS 0x7000014D
 /begin IF_DATA XCPplus 0x0102
  /begin DAQ_EVENT VARIABLE /end DAQ_EVENT
 /end IF_DATA
/end MEASUREMENT
/begin MEASUREMENT HvBatt_flgRmpDchaShoActvOld "Active old status of short discharging ramp" UBYTE B_TRUE 1 100 0.00 1.00000000000 BIT_MASK 0x1 FORMAT "%13.11" ECU_ADDRESS 0x7000014C
 /begin IF_DATA XCPplus 0x0102
  /begin DAQ_EVENT VARIABLE /end DAQ_EVENT
 /end IF_DATA
/end MEASUREMENT
/begin MEASUREMENT HvBatt_flgRstChrgContnsLim "Reset status of Continuous charging limit" UBYTE B_TRUE 1 100 0.00 1.00000000000 BIT_MASK 0x1 FORMAT "%13.11" ECU_ADDRESS 0x7000014B
 /begin IF_DATA XCPplus 0x0102
  /begin DAQ_EVENT VARIABLE /end DAQ_EVENT
 /end IF_DATA
/end MEASUREMENT
/begin MEASUREMENT HvBatt_flgRstChrgShoLim "Flag to indicate the reset condition of short charge limit" UBYTE B_TRUE 1 100 0.00 1.00000000000 BIT_MASK 0x1 FORMAT "%13.11" ECU_ADDRESS 0x7000014A
 /begin IF_DATA XCPplus 0x0102
  /begin DAQ_EVENT VARIABLE /end DAQ_EVENT
 /end IF_DATA
/end MEASUREMENT
/begin MEASUREMENT HvBatt_flgRstDchaContnsLim "Flag to indicate the reset condition of continuous discharge limit" UBYTE B_TRUE 1 100 0.00 1.00000000000 BIT_MASK 0x1 FORMAT "%13.11" ECU_ADDRESS 0x70000149
 /begin IF_DATA XCPplus 0x0102
  /begin DAQ_EVENT VARIABLE /end DAQ_EVENT
 /end IF_DATA
/end MEASUREMENT
/begin MEASUREMENT HvBatt_flgRstDchaShoLim "Flag to indicate the reset condition of short discharge limit" UBYTE B_TRUE 1 100 0.00 1.00000000000 BIT_MASK 0x1 FORMAT "%13.11" ECU_ADDRESS 0x70000148
 /begin IF_DATA XCPplus 0x0102
  /begin DAQ_EVENT VARIABLE /end DAQ_EVENT
 /end IF_DATA
/end MEASUREMENT
/begin MEASUREMENT HvBatt_flgSigQlyChrgContns "Flag to indicate Signal quality status of continous charging" UBYTE B_TRUE 1 100 0.00 1.00000000000 BIT_MASK 0x1 FORMAT "%13.11" ECU_ADDRESS 0x70000147
 /begin IF_DATA XCPplus 0x0102
  /begin DAQ_EVENT VARIABLE /end DAQ_EVENT
 /end IF_DATA
/end MEASUREMENT
/begin MEASUREMENT HvBatt_flgSigQlyChrgSho "Flag to indicate Signal quality status of short charging" UBYTE B_TRUE 1 100 0.00 1.00000000000 BIT_MASK 0x1 FORMAT "%13.11" ECU_ADDRESS 0x70000146
 /begin IF_DATA XCPplus 0x0102
  /begin DAQ_EVENT VARIABLE /end DAQ_EVENT
 /end IF_DATA
/end MEASUREMENT
/begin MEASUREMENT HvBatt_flgSigQlyDchaContns "Flag to indicate Signal quality status of continous discharging" UBYTE B_TRUE 1 100 0.00 1.00000000000 BIT_MASK 0x1 FORMAT "%13.11" ECU_ADDRESS 0x70000145
 /begin IF_DATA XCPplus 0x0102
  /begin DAQ_EVENT VARIABLE /end DAQ_EVENT
 /end IF_DATA
/end MEASUREMENT
/begin MEASUREMENT HvBatt_flgSigQlyDchaSho "Flag to indicate Signal quality status of short discharging" UBYTE B_TRUE 1 100 0.00 1.00000000000 BIT_MASK 0x1 FORMAT "%13.11" ECU_ADDRESS 0x70000144
 /begin IF_DATA XCPplus 0x0102
  /begin DAQ_EVENT VARIABLE /end DAQ_EVENT
 /end IF_DATA
/end MEASUREMENT
/begin MEASUREMENT HvBatt_iActMeasd "Actual current of the high voltage battery" SWORD Curr_A_q0p03125_COMPU 1 100 -1024.000 1023.969 FORMAT "%8.3" ECU_ADDRESS 0x6001FADA
 /begin IF_DATA XCPplus 0x0102
  /begin DAQ_EVENT VARIABLE /end DAQ_EVENT
 /end IF_DATA
/end MEASUREMENT
/begin MEASUREMENT HvBatt_iActMeasd_Sq "Signal Quality of actual current of Hv Battery" UBYTE SigQly_COMPU_VERB 1 100 0.00 15.0000000000 FORMAT "%13.10" ECU_ADDRESS 0x6002354E
 /begin IF_DATA XCPplus 0x0102
  /begin DAQ_EVENT VARIABLE /end DAQ_EVENT
 /end IF_DATA
/end MEASUREMENT
/begin MEASUREMENT HvBatt_pwrActMeasd "Actual power of the high voltage battery" SWORD RBPtCel_pwr_25p0_1 1 100 -819200.0 819175.0 FORMAT "%8.1" ECU_ADDRESS 0x6001FAD4
 /begin IF_DATA XCPplus 0x0102
  /begin DAQ_EVENT VARIABLE /end DAQ_EVENT
 /end IF_DATA
/end MEASUREMENT
/begin MEASUREMENT HvBatt_pwrActMeasd_Sq "Signal quality of actual power of Hv battery" UBYTE SigQly_COMPU_VERB 1 100 0.00 15.0000000000 FORMAT "%13.10" ECU_ADDRESS 0x6002354D
 /begin IF_DATA XCPplus 0x0102
  /begin DAQ_EVENT VARIABLE /end DAQ_EVENT
 /end IF_DATA
/end MEASUREMENT
/begin MEASUREMENT HvBatt_pwrDchaContnsActMeasd "Actual measured power while continous discharging" SWORD RBPtCel_pwr_25p0_1 1 100 -819200.0 819175.0 FORMAT "%8.1" ECU_ADDRESS 0x6001F498
 /begin IF_DATA XCPplus 0x0102
  /begin DAQ_EVENT VARIABLE /end DAQ_EVENT
 /end IF_DATA
/end MEASUREMENT
/begin MEASUREMENT HvBatt_pwrMaxChrgContns "Continuous Maximum Charging Power of HV Battery" SWORD RBPtCel_pwr_25p0_1 1 100 -819200.0 819175.0 FORMAT "%8.1" ECU_ADDRESS 0x6001FAD2
 /begin IF_DATA XCPplus 0x0102
  /begin DAQ_EVENT VARIABLE /end DAQ_EVENT
 /end IF_DATA
/end MEASUREMENT
/begin MEASUREMENT HvBatt_pwrMaxChrgContnsDern "Derating of maximum power when continous charging" SWORD RBPtCel_pwr_25p0_1 1 100 -819200.0 819175.0 FORMAT "%8.1" ECU_ADDRESS 0x6001F496
 /begin IF_DATA XCPplus 0x0102
  /begin DAQ_EVENT VARIABLE /end DAQ_EVENT
 /end IF_DATA
/end MEASUREMENT
/begin MEASUREMENT HvBatt_pwrMaxChrgContnsDernPropInteg "PI factor for charge continous derating" SWORD RBPtCel_pwr_25p0_1 1 100 -819200.0 819175.0 FORMAT "%8.1" ECU_ADDRESS 0x6001F494
 /begin IF_DATA XCPplus 0x0102
  /begin DAQ_EVENT VARIABLE /end DAQ_EVENT
 /end IF_DATA
/end MEASUREMENT
/begin MEASUREMENT HvBatt_pwrMaxChrgContnsDif "Factor for difference of continous power limit" SWORD RBPtCel_pwr_25p0_1 1 100 -819200.0 819175.0 FORMAT "%8.1" ECU_ADDRESS 0x6001F492
 /begin IF_DATA XCPplus 0x0102
  /begin DAQ_EVENT VARIABLE /end DAQ_EVENT
 /end IF_DATA
/end MEASUREMENT
/begin MEASUREMENT HvBatt_pwrMaxChrgContnsLimNearDern "Neareast maximum power limit dearting when continous charging" SWORD RBPtCel_pwr_25p0_1 1 100 -819200.0 819175.0 FORMAT "%8.1" ECU_ADDRESS 0x6001F490
 /begin IF_DATA XCPplus 0x0102
  /begin DAQ_EVENT VARIABLE /end DAQ_EVENT
 /end IF_DATA
/end MEASUREMENT
/begin MEASUREMENT HvBatt_pwrMaxChrgContnsLvl3FltDern "Level 3 fault derating maximum power when continous charging" SWORD RBPtCel_pwr_25p0_1 1 100 -819200.0 819175.0 FORMAT "%8.1" ECU_ADDRESS 0x6001F48E
 /begin IF_DATA XCPplus 0x0102
  /begin DAQ_EVENT VARIABLE /end DAQ_EVENT
 /end IF_DATA
/end MEASUREMENT
/begin MEASUREMENT HvBatt_pwrMaxChrgContnsRaw "Raw maximum power when continous charging" SWORD RBPtCel_pwr_25p0_1 1 100 -819200.0 819175.0 FORMAT "%8.1" ECU_ADDRESS 0x6001F48C
 /begin IF_DATA XCPplus 0x0102
  /begin DAQ_EVENT VARIABLE /end DAQ_EVENT
 /end IF_DATA
/end MEASUREMENT
/begin MEASUREMENT HvBatt_pwrMaxChrgContnsTDern "Temperature derated maximum power when continous charging" SWORD RBPtCel_pwr_25p0_1 1 100 -819200.0 819175.0 FORMAT "%8.1" ECU_ADDRESS 0x6001F48A
 /begin IF_DATA XCPplus 0x0102
  /begin DAQ_EVENT VARIABLE /end DAQ_EVENT
 /end IF_DATA
/end MEASUREMENT
/begin MEASUREMENT HvBatt_pwrMaxChrgContns_Sq "Signal quality of Maximum continuous chanrging power of Hv battery" UBYTE SigQly_COMPU_VERB 1 100 0.00 15.0000000000 FORMAT "%13.10" ECU_ADDRESS 0x6002354C
 /begin IF_DATA XCPplus 0x0102
  /begin DAQ_EVENT VARIABLE /end DAQ_EVENT
 /end IF_DATA
/end MEASUREMENT
/begin MEASUREMENT HvBatt_pwrMaxChrgSho "Short-term Maximum Charging Power of HV Battery" SWORD RBPtCel_pwr_25p0_1 1 100 -819200.0 819175.0 FORMAT "%8.1" ECU_ADDRESS 0x6001FAD0
 /begin IF_DATA XCPplus 0x0102
  /begin DAQ_EVENT VARIABLE /end DAQ_EVENT
 /end IF_DATA
/end MEASUREMENT
/begin MEASUREMENT HvBatt_pwrMaxChrgShoDern "Derating of maximum power when short charging" FLOAT32_IEEE OneToOne 1 100 -1.0000E+037 1.0000E+037 FORMAT "%9.4" ECU_ADDRESS 0x600007B0
 /begin IF_DATA XCPplus 0x0102
  /begin DAQ_EVENT VARIABLE /end DAQ_EVENT
 /end IF_DATA
/end MEASUREMENT
/begin MEASUREMENT HvBatt_pwrMaxChrgShoDernPropInteg "PI Factor for charge short derating power limit" SWORD RBPtCel_pwr_25p0_1 1 100 -819200.0 819175.0 FORMAT "%8.1" ECU_ADDRESS 0x6001F488
 /begin IF_DATA XCPplus 0x0102
  /begin DAQ_EVENT VARIABLE /end DAQ_EVENT
 /end IF_DATA
/end MEASUREMENT
/begin MEASUREMENT HvBatt_pwrMaxChrgShoDif "charge short difference of power limit" SWORD RBPtCel_pwr_25p0_1 1 100 -819200.0 819175.0 FORMAT "%8.1" ECU_ADDRESS 0x6001F486
 /begin IF_DATA XCPplus 0x0102
  /begin DAQ_EVENT VARIABLE /end DAQ_EVENT
 /end IF_DATA
/end MEASUREMENT
/begin MEASUREMENT HvBatt_pwrMaxChrgShoLimNearDern "Neareast maximum power limit dearting when short charging" SWORD RBPtCel_pwr_25p0_1 1 100 -819200.0 819175.0 FORMAT "%8.1" ECU_ADDRESS 0x6001F484
 /begin IF_DATA XCPplus 0x0102
  /begin DAQ_EVENT VARIABLE /end DAQ_EVENT
 /end IF_DATA
/end MEASUREMENT
/begin MEASUREMENT HvBatt_pwrMaxChrgShoLvl3FltDern "Level 3 fault derating maximum power when short charging" SWORD RBPtCel_pwr_25p0_1 1 100 -819200.0 819175.0 FORMAT "%8.1" ECU_ADDRESS 0x6001F482
 /begin IF_DATA XCPplus 0x0102
  /begin DAQ_EVENT VARIABLE /end DAQ_EVENT
 /end IF_DATA
/end MEASUREMENT
/begin MEASUREMENT HvBatt_pwrMaxChrgShoRaw "Raw maximum power when short charging" SWORD RBPtCel_pwr_25p0_1 1 100 -819200.0 819175.0 FORMAT "%8.1" ECU_ADDRESS 0x6001F480
 /begin IF_DATA XCPplus 0x0102
  /begin DAQ_EVENT VARIABLE /end DAQ_EVENT
 /end IF_DATA
/end MEASUREMENT
/begin MEASUREMENT HvBatt_pwrMaxChrgShoTDern "Temperature derated maximum power when short charging" SWORD RBPtCel_pwr_25p0_1 1 100 -819200.0 819175.0 FORMAT "%8.1" ECU_ADDRESS 0x6001F47E
 /begin IF_DATA XCPplus 0x0102
  /begin DAQ_EVENT VARIABLE /end DAQ_EVENT
 /end IF_DATA
/end MEASUREMENT
/begin MEASUREMENT HvBatt_pwrMaxChrgSho_Sq "Signal quality of Maximum short-term charging power of Hv Battery" UBYTE SigQly_COMPU_VERB 1 100 0.00 15.0000000000 FORMAT "%13.10" ECU_ADDRESS 0x6002354B
 /begin IF_DATA XCPplus 0x0102
  /begin DAQ_EVENT VARIABLE /end DAQ_EVENT
 /end IF_DATA
/end MEASUREMENT
/begin MEASUREMENT HvBatt_pwrMaxDchaContns "Continuous Maximum Discharging Power of HV Battery" SWORD RBPtCel_pwr_25p0_1 1 100 -819200.0 819175.0 FORMAT "%8.1" ECU_ADDRESS 0x6001FACE
 /begin IF_DATA XCPplus 0x0102
  /begin DAQ_EVENT VARIABLE /end DAQ_EVENT
 /end IF_DATA
/end MEASUREMENT
/begin MEASUREMENT HvBatt_pwrMaxDchaContnsDern "Derating of maximum power when continous discharging" SWORD RBPtCel_pwr_25p0_1 1 100 -819200.0 819175.0 FORMAT "%8.1" ECU_ADDRESS 0x6001F47C
 /begin IF_DATA XCPplus 0x0102
  /begin DAQ_EVENT VARIABLE /end DAQ_EVENT
 /end IF_DATA
/end MEASUREMENT
/begin MEASUREMENT HvBatt_pwrMaxDchaContnsDernPropInteg "PI Factor for discharge continuous derating power limit" SWORD RBPtCel_pwr_25p0_1 1 100 -819200.0 819175.0 FORMAT "%8.1" ECU_ADDRESS 0x6001F47A
 /begin IF_DATA XCPplus 0x0102
  /begin DAQ_EVENT VARIABLE /end DAQ_EVENT
 /end IF_DATA
/end MEASUREMENT
/begin MEASUREMENT HvBatt_pwrMaxDchaContnsLimNearDern "Neareast maximum power limit dearting when continous discharging" SWORD RBPtCel_pwr_25p0_1 1 100 -819200.0 819175.0 FORMAT "%8.1" ECU_ADDRESS 0x6001F478
 /begin IF_DATA XCPplus 0x0102
  /begin DAQ_EVENT VARIABLE /end DAQ_EVENT
 /end IF_DATA
/end MEASUREMENT
/begin MEASUREMENT HvBatt_pwrMaxDchaContnsLvl3FltDern "Level 3 fault derating maximum power when continous discharging" SWORD RBPtCel_pwr_25p0_1 1 100 -819200.0 819175.0 FORMAT "%8.1" ECU_ADDRESS 0x6001F476
 /begin IF_DATA XCPplus 0x0102
  /begin DAQ_EVENT VARIABLE /end DAQ_EVENT
 /end IF_DATA
/end MEASUREMENT
/begin MEASUREMENT HvBatt_pwrMaxDchaContnsRaw "Raw maximum power when continous discharging" SWORD RBPtCel_pwr_25p0_1 1 100 -819200.0 819175.0 FORMAT "%8.1" ECU_ADDRESS 0x6001F474
 /begin IF_DATA XCPplus 0x0102
  /begin DAQ_EVENT VARIABLE /end DAQ_EVENT
 /end IF_DATA
/end MEASUREMENT
/begin MEASUREMENT HvBatt_pwrMaxDchaContnsTDern "Temperature derated maximum power when continuous discharging" SWORD RBPtCel_pwr_25p0_1 1 100 -819200.0 819175.0 FORMAT "%8.1" ECU_ADDRESS 0x6001F472
 /begin IF_DATA XCPplus 0x0102
  /begin DAQ_EVENT VARIABLE /end DAQ_EVENT
 /end IF_DATA
/end MEASUREMENT
/begin MEASUREMENT HvBatt_pwrMaxDchaContns_Sq "Signal quality of Maximum continuous discharge power of Hv Battery" UBYTE SigQly_COMPU_VERB 1 100 0.00 15.0000000000 FORMAT "%13.10" ECU_ADDRESS 0x6002354A
 /begin IF_DATA XCPplus 0x0102
  /begin DAQ_EVENT VARIABLE /end DAQ_EVENT
 /end IF_DATA
/end MEASUREMENT
/begin MEASUREMENT HvBatt_pwrMaxDchaSho "Short-term Maximum Discharging Power of HV Battery" SWORD RBPtCel_pwr_25p0_1 1 100 -819200.0 819175.0 FORMAT "%8.1" ECU_ADDRESS 0x6001FACC
 /begin IF_DATA XCPplus 0x0102
  /begin DAQ_EVENT VARIABLE /end DAQ_EVENT
 /end IF_DATA
/end MEASUREMENT
/begin MEASUREMENT HvBatt_pwrMaxDchaShoDern "Derating of maximum power when short discharging" SWORD RBPtCel_pwr_25p0_1 1 100 -819200.0 819175.0 FORMAT "%8.1" ECU_ADDRESS 0x6001F470
 /begin IF_DATA XCPplus 0x0102
  /begin DAQ_EVENT VARIABLE /end DAQ_EVENT
 /end IF_DATA
/end MEASUREMENT
/begin MEASUREMENT HvBatt_pwrMaxDchaShoDernPropInteg "PI Factor for discharge short derating power limit" SWORD RBPtCel_pwr_25p0_1 1 100 -819200.0 819175.0 FORMAT "%8.1" ECU_ADDRESS 0x6001F46E
 /begin IF_DATA XCPplus 0x0102
  /begin DAQ_EVENT VARIABLE /end DAQ_EVENT
 /end IF_DATA
/end MEASUREMENT
/begin MEASUREMENT HvBatt_pwrMaxDchaShoDif "discharge short difference of power limit" SWORD RBPtCel_pwr_25p0_1 1 100 -819200.0 819175.0 FORMAT "%8.1" ECU_ADDRESS 0x6001F46C
 /begin IF_DATA XCPplus 0x0102
  /begin DAQ_EVENT VARIABLE /end DAQ_EVENT
 /end IF_DATA
/end MEASUREMENT
/begin MEASUREMENT HvBatt_pwrMaxDchaShoLimNearDern "Neareast maximum power limit dearting when short discharging" SWORD RBPtCel_pwr_25p0_1 1 100 -819200.0 819175.0 FORMAT "%8.1" ECU_ADDRESS 0x6001F46A
 /begin IF_DATA XCPplus 0x0102
  /begin DAQ_EVENT VARIABLE /end DAQ_EVENT
 /end IF_DATA
/end MEASUREMENT
/begin MEASUREMENT HvBatt_pwrMaxDchaShoLvl3FltDern "Level 3 fault derating maximum power when short discharging" SWORD RBPtCel_pwr_25p0_1 1 100 -819200.0 819175.0 FORMAT "%8.1" ECU_ADDRESS 0x6001F468
 /begin IF_DATA XCPplus 0x0102
  /begin DAQ_EVENT VARIABLE /end DAQ_EVENT
 /end IF_DATA
/end MEASUREMENT
/begin MEASUREMENT HvBatt_pwrMaxDchaShoRaw "Raw maximum power when short discharging" SWORD RBPtCel_pwr_25p0_1 1 100 -819200.0 819175.0 FORMAT "%8.1" ECU_ADDRESS 0x6001F466
 /begin IF_DATA XCPplus 0x0102
  /begin DAQ_EVENT VARIABLE /end DAQ_EVENT
 /end IF_DATA
/end MEASUREMENT
/begin MEASUREMENT HvBatt_pwrMaxDchaShoTDern "Temperature derated maximum power when short discharging" SWORD RBPtCel_pwr_25p0_1 1 100 -819200.0 819175.0 FORMAT "%8.1" ECU_ADDRESS 0x6001F464
 /begin IF_DATA XCPplus 0x0102
  /begin DAQ_EVENT VARIABLE /end DAQ_EVENT
 /end IF_DATA
/end MEASUREMENT
/begin MEASUREMENT HvBatt_pwrMaxDchaSho_Sq "Signal quality of short term discharge power of Hv Battery" UBYTE SigQly_COMPU_VERB 1 100 0.00 15.0000000000 FORMAT "%13.10" ECU_ADDRESS 0x60023549
 /begin IF_DATA XCPplus 0x0102
  /begin DAQ_EVENT VARIABLE /end DAQ_EVENT
 /end IF_DATA
/end MEASUREMENT
/begin MEASUREMENT HvBatt_ratRSohEepVal "Eep stored value of SOH linked to battery internal resistance" UBYTE RBPtCel_Perc_1p0_1 1 100 0.00 255.0 FORMAT "%5.1" ECU_ADDRESS 0x60023547
 /begin IF_DATA XCPplus 0x0102
  /begin DAQ_EVENT VARIABLE /end DAQ_EVENT
 /end IF_DATA
/end MEASUREMENT
/begin MEASUREMENT HvBatt_ratSoc "State of charge of the high voltage battery" SWORD Prc 1 100 -400.0000 399.9878 FORMAT "%8.4" ECU_ADDRESS 0x6001FAC8
 /begin IF_DATA XCPplus 0x0102
  /begin DAQ_EVENT VARIABLE /end DAQ_EVENT
 /end IF_DATA
/end MEASUREMENT
/begin MEASUREMENT HvBatt_ratSoc_Sq "Signal quality of state of charge of Hv battery" UBYTE SigQly_COMPU_VERB 1 100 0.00 15.0000000000 FORMAT "%13.10" ECU_ADDRESS 0x60023546
 /begin IF_DATA XCPplus 0x0102
  /begin DAQ_EVENT VARIABLE /end DAQ_EVENT
 /end IF_DATA
/end MEASUREMENT
/begin MEASUREMENT HvBatt_ratSoh "Battery state of health" SWORD Prc 1 100 -400.0000 399.9878 FORMAT "%8.4" ECU_ADDRESS 0x6001FAC6
 /begin IF_DATA XCPplus 0x0102
  /begin DAQ_EVENT VARIABLE /end DAQ_EVENT
 /end IF_DATA
/end MEASUREMENT
/begin MEASUREMENT HvBatt_ratSohEepVal "Eep stored value of SOH linked to battery capacity" UBYTE RBPtCel_Perc_1p0_1 1 100 0.00 255.0 FORMAT "%5.1" ECU_ADDRESS 0x60023545
 /begin IF_DATA XCPplus 0x0102
  /begin DAQ_EVENT VARIABLE /end DAQ_EVENT
 /end IF_DATA
/end MEASUREMENT
/begin MEASUREMENT HvBatt_ratSoh_Sq "Signal quality for HV Battery State of health" UBYTE SigQly_COMPU_VERB 1 100 0.00 15.0000000000 FORMAT "%13.10" ECU_ADDRESS 0x60023544
 /begin IF_DATA XCPplus 0x0102
  /begin DAQ_EVENT VARIABLE /end DAQ_EVENT
 /end IF_DATA
/end MEASUREMENT
/begin MEASUREMENT HvBatt_rIsoMeasmt "islolation measerment resistance" UWORD q1_kOhm 1 100 0.00 65535.00 FORMAT "%8.2" ECU_ADDRESS 0x6001FA26
 /begin IF_DATA XCPplus 0x0102
  /begin DAQ_EVENT VARIABLE /end DAQ_EVENT
 /end IF_DATA
/end MEASUREMENT
/begin MEASUREMENT HvBatt_rIsoMeasmt_Sq "islolation measerment resistance signal quality" UBYTE SigQly_COMPU_VERB 1 100 0.00 15.0000000000 FORMAT "%13.10" ECU_ADDRESS 0x60023548
 /begin IF_DATA XCPplus 0x0102
  /begin DAQ_EVENT VARIABLE /end DAQ_EVENT
 /end IF_DATA
/end MEASUREMENT
/begin MEASUREMENT HvBatt_stChrgMod "Actual charge mode reported from HV Battery" UBYTE OneToOne 1 100 0.00 255.0 FORMAT "%5.1" ECU_ADDRESS 0x6002313F
 /begin IF_DATA XCPplus 0x0102
  /begin DAQ_EVENT VARIABLE /end DAQ_EVENT
 /end IF_DATA
/end MEASUREMENT
/begin MEASUREMENT HvBatt_stMaiSwtAct "HV Battery Main Switch Contact Actual Status" UBYTE OneToOne 1 100 0.00 255.0 FORMAT "%5.1" ECU_ADDRESS 0x60023542
 /begin IF_DATA XCPplus 0x0102
  /begin DAQ_EVENT VARIABLE /end DAQ_EVENT
 /end IF_DATA
/end MEASUREMENT
/begin MEASUREMENT HvBatt_stOperModDes "desired battery operation mode" UBYTE OneToOne 1 100 0.00 255.0 FORMAT "%5.1" ECU_ADDRESS 0x60023541
 /begin IF_DATA XCPplus 0x0102
  /begin DAQ_EVENT VARIABLE /end DAQ_EVENT
 /end IF_DATA
/end MEASUREMENT
/begin MEASUREMENT HvBatt_tActMeasd "Actual temperature of the high voltage battery" SWORD Temp_Cels 1 100 -3549.940 3003.560 FORMAT "%8.3" ECU_ADDRESS 0x6001FAC4
 /begin IF_DATA XCPplus 0x0102
  /begin DAQ_EVENT VARIABLE /end DAQ_EVENT
 /end IF_DATA
/end MEASUREMENT
/begin MEASUREMENT HvBatt_tActMeasd_Sq "signal quality of actual temperature of the high voltage battery" UBYTE SigQly_COMPU_VERB 1 100 0.00 15.0000000000 FORMAT "%13.10" ECU_ADDRESS 0x6002353F
 /begin IF_DATA XCPplus 0x0102
  /begin DAQ_EVENT VARIABLE /end DAQ_EVENT
 /end IF_DATA
/end MEASUREMENT
/begin MEASUREMENT HvBatt_uActMeasd "Actual voltage of the high voltage battery" SWORD Volt_V_q0p03125_COMPU 1 100 -1024.000 1023.969 FORMAT "%8.3" ECU_ADDRESS 0x6001FAC0
 /begin IF_DATA XCPplus 0x0102
  /begin DAQ_EVENT VARIABLE /end DAQ_EVENT
 /end IF_DATA
/end MEASUREMENT
/begin MEASUREMENT HvBatt_uActMeasd_Sq "Signal quality of actual voltage of Hv Battery" UBYTE SigQly_COMPU_VERB 1 100 0.00 15.0000000000 FORMAT "%13.10" ECU_ADDRESS 0x6002353D
 /begin IF_DATA XCPplus 0x0102
  /begin DAQ_EVENT VARIABLE /end DAQ_EVENT
 /end IF_DATA
/end MEASUREMENT
/begin MEASUREMENT HvBatt_uDcBus "HV bat DC bus voltage" SWORD Volt_V_q0p03125_COMPU 1 100 -1024.000 1023.969 FORMAT "%8.3" ECU_ADDRESS 0x6001FABE
 /begin IF_DATA XCPplus 0x0102
  /begin DAQ_EVENT VARIABLE /end DAQ_EVENT
 /end IF_DATA
/end MEASUREMENT
/begin MEASUREMENT HvBatt_uDcBus_Sq "HV bat DC bus voltage signal quality" UBYTE SigQly_COMPU_VERB 1 100 0.00 15.0000000000 FORMAT "%13.10" ECU_ADDRESS 0x6002353C
 /begin IF_DATA XCPplus 0x0102
  /begin DAQ_EVENT VARIABLE /end DAQ_EVENT
 /end IF_DATA
/end MEASUREMENT
/begin MEASUREMENT HvBatt_uMaxLim "Maximum Voltage of HV Battery" SWORD Volt_V_q0p03125_COMPU 1 100 -1024.000 1023.969 FORMAT "%8.3" ECU_ADDRESS 0x6001FABC
 /begin IF_DATA XCPplus 0x0102
  /begin DAQ_EVENT VARIABLE /end DAQ_EVENT
 /end IF_DATA
/end MEASUREMENT
/begin MEASUREMENT HvBatt_uMaxLim_Sq "Signal quality of Maximum voltage of Hv Battery" UBYTE SigQly_COMPU_VERB 1 100 0.00 15.0000000000 FORMAT "%13.10" ECU_ADDRESS 0x6002353B
 /begin IF_DATA XCPplus 0x0102
  /begin DAQ_EVENT VARIABLE /end DAQ_EVENT
 /end IF_DATA
/end MEASUREMENT
/begin MEASUREMENT HvBatt_uMinLim "Minimum Voltage of HV Battery" SWORD Volt_V_q0p03125_COMPU 1 100 -1024.000 1023.969 FORMAT "%8.3" ECU_ADDRESS 0x6001FABA
 /begin IF_DATA XCPplus 0x0102
  /begin DAQ_EVENT VARIABLE /end DAQ_EVENT
 /end IF_DATA
/end MEASUREMENT
/begin MEASUREMENT HvBatt_uMinLim_Sq "Signal quality of Minimum voltage of Hv Battery" UBYTE SigQly_COMPU_VERB 1 100 0.00 15.0000000000 FORMAT "%13.10" ECU_ADDRESS 0x6002353A
 /begin IF_DATA XCPplus 0x0102
  /begin DAQ_EVENT VARIABLE /end DAQ_EVENT
 /end IF_DATA
/end MEASUREMENT
/begin MEASUREMENT HvGrid_idxList "Index storage for for output list order" UBYTE OneToOne 1 100 0.00 255.0 FORMAT "%5.1" MATRIX_DIM 12 ECU_ADDRESS 0x60023133
 /begin IF_DATA XCPplus 0x0102
  /begin DAQ_EVENT VARIABLE /end DAQ_EVENT
 /end IF_DATA
/end MEASUREMENT
/begin MEASUREMENT HvGrid_idxVehCoorn "Indication of table location" UBYTE OneToOne 1 100 0.00 255.0 FORMAT "%5.1" ECU_ADDRESS 0x60023132
 /begin IF_DATA XCPplus 0x0102
  /begin DAQ_EVENT VARIABLE /end DAQ_EVENT
 /end IF_DATA
/end MEASUREMENT
/begin MEASUREMENT HvGrid_pwrAcsyAct "Minimum power consumption of all highvoltage consumers" SWORD RBPtCel_pwr_25p0_1 1 100 -819200.0 819175.0 FORMAT "%8.1" ECU_ADDRESS 0x6001FAB6
 /begin IF_DATA XCPplus 0x0102
  /begin DAQ_EVENT VARIABLE /end DAQ_EVENT
 /end IF_DATA
/end MEASUREMENT
/begin MEASUREMENT HvGrid_pwrAcsyCalc "Maximum power consumtion of all HV consumers" SWORD RBPtCel_pwr_25p0_1 1 100 -819200.0 819175.0 FORMAT "%8.1" ECU_ADDRESS 0x6001FAB4
 /begin IF_DATA XCPplus 0x0102
  /begin DAQ_EVENT VARIABLE /end DAQ_EVENT
 /end IF_DATA
/end MEASUREMENT
/begin MEASUREMENT HvGrid_pwrAvl "Array for available power" SWORD RBPtCel_pwr_25p0_1 1 100 -819200.0 819175.0 FORMAT "%8.1" MATRIX_DIM 13 ECU_ADDRESS 0x6001F44A
 /begin IF_DATA XCPplus 0x0102
  /begin DAQ_EVENT VARIABLE /end DAQ_EVENT
 /end IF_DATA
/end MEASUREMENT
/begin MEASUREMENT HvGrid_pwrDes "Array for desired power" SWORD RBPtCel_pwr_25p0_1 1 100 -819200.0 819175.0 FORMAT "%8.1" MATRIX_DIM 12 ECU_ADDRESS 0x6001F432
 /begin IF_DATA XCPplus 0x0102
  /begin DAQ_EVENT VARIABLE /end DAQ_EVENT
 /end IF_DATA
/end MEASUREMENT
/begin MEASUREMENT HvGrid_pwrDesIn "Input array for desired power of HV component" SWORD RBPtCel_pwr_25p0_1 1 100 -819200.0 819175.0 FORMAT "%8.1" MATRIX_DIM 12 ECU_ADDRESS 0x6001FA9C
 /begin IF_DATA XCPplus 0x0102
  /begin DAQ_EVENT VARIABLE /end DAQ_EVENT
 /end IF_DATA
/end MEASUREMENT
/begin MEASUREMENT HvGrid_pwrMaxAc "Power consumtion limit of AC compressor" SWORD RBPtCel_pwr_25p0_1 1 100 -819200.0 819175.0 FORMAT "%8.1" ECU_ADDRESS 0x700015F2
 /begin IF_DATA XCPplus 0x0102
  /begin DAQ_EVENT VARIABLE /end DAQ_EVENT
 /end IF_DATA
/end MEASUREMENT
/begin MEASUREMENT HvGrid_pwrMaxDcdc "Power consumtion limit of DCDC" SWORD RBPtCel_pwr_25p0_1 1 100 -819200.0 819175.0 FORMAT "%8.1" ECU_ADDRESS 0x700015F0
 /begin IF_DATA XCPplus 0x0102
  /begin DAQ_EVENT VARIABLE /end DAQ_EVENT
 /end IF_DATA
/end MEASUREMENT
/begin MEASUREMENT HVGrid_pwrMaxGenrTiLong "Long Term Generator Power Limit for Powertrain based on electrical system" SWORD RBPtCel_pwr_25p0_1 1 100 -819200.0 819175.0 FORMAT "%8.1" ECU_ADDRESS 0x6001FAE2
 /begin IF_DATA XCPplus 0x0102
  /begin DAQ_EVENT VARIABLE /end DAQ_EVENT
 /end IF_DATA
/end MEASUREMENT
/begin MEASUREMENT HVGrid_pwrMaxGenrTiSho "Short Term Generator Power Limit for Powertrain based on electrical system" SWORD RBPtCel_pwr_25p0_1 1 100 -819200.0 819175.0 FORMAT "%8.1" ECU_ADDRESS 0x6001FAE0
 /begin IF_DATA XCPplus 0x0102
  /begin DAQ_EVENT VARIABLE /end DAQ_EVENT
 /end IF_DATA
/end MEASUREMENT
/begin MEASUREMENT HvGrid_pwrMaxLim "Array for max power limit (prio order) of HV component" SWORD RBPtCel_pwr_25p0_1 1 100 -819200.0 819175.0 FORMAT "%8.1" MATRIX_DIM 12 ECU_ADDRESS 0x6001F41A
 /begin IF_DATA XCPplus 0x0102
  /begin DAQ_EVENT VARIABLE /end DAQ_EVENT
 /end IF_DATA
/end MEASUREMENT
/begin MEASUREMENT HvGrid_pwrMaxLimOut "Output array for max power limit of HV component" SWORD RBPtCel_pwr_25p0_1 1 100 -819200.0 819175.0 FORMAT "%8.1" MATRIX_DIM 12 ECU_ADDRESS 0x6001FA84
 /begin IF_DATA XCPplus 0x0102
  /begin DAQ_EVENT VARIABLE /end DAQ_EVENT
 /end IF_DATA
/end MEASUREMENT
/begin MEASUREMENT HVGrid_pwrMaxMotTiLong "Long Term Motoring Power Limit for Powertrain based on electrical system" SWORD RBPtCel_pwr_25p0_1 1 100 -819200.0 819175.0 FORMAT "%8.1" ECU_ADDRESS 0x6001FADE
 /begin IF_DATA XCPplus 0x0102
  /begin DAQ_EVENT VARIABLE /end DAQ_EVENT
 /end IF_DATA
/end MEASUREMENT
/begin MEASUREMENT HVGrid_pwrMaxMotTiSho "Short Term Motoring Power Limit for Powertrain based on electrical system" SWORD RBPtCel_pwr_25p0_1 1 100 -819200.0 819175.0 FORMAT "%8.1" ECU_ADDRESS 0x6001FADC
 /begin IF_DATA XCPplus 0x0102
  /begin DAQ_EVENT VARIABLE /end DAQ_EVENT
 /end IF_DATA
/end MEASUREMENT
/begin MEASUREMENT HvGrid_pwrMaxPtc "Power consumption limit of PTC" SWORD RBPtCel_pwr_25p0_1 1 100 -819200.0 819175.0 FORMAT "%8.1" ECU_ADDRESS 0x700015EE
 /begin IF_DATA XCPplus 0x0102
  /begin DAQ_EVENT VARIABLE /end DAQ_EVENT
 /end IF_DATA
/end MEASUREMENT
/begin MEASUREMENT HvGrid_pwrTotAvl "Maximum available HV supply power" SWORD RBPtCel_pwr_25p0_1 1 100 -819200.0 819175.0 FORMAT "%8.1" ECU_ADDRESS 0x700015EC
 /begin IF_DATA XCPplus 0x0102
  /begin DAQ_EVENT VARIABLE /end DAQ_EVENT
 /end IF_DATA
/end MEASUREMENT
/begin MEASUREMENT HvGrid_stSocLimHLD "HV battery State of Change is Low" UBYTE B_TRUE 1 100 0.00 1.00000000000 BIT_MASK 0x1 FORMAT "%13.11" ECU_ADDRESS 0x7000013B
 /begin IF_DATA XCPplus 0x0102
  /begin DAQ_EVENT VARIABLE /end DAQ_EVENT
 /end IF_DATA
/end MEASUREMENT
/begin MEASUREMENT HvGrid_stSocLimHLD_I "Hysteresis for HV battery SOC low" UBYTE B_TRUE 1 100 0.00 1.00000000000 BIT_MASK 0x1 FORMAT "%13.11" ECU_ADDRESS 0x7000013A
 /begin IF_DATA XCPplus 0x0102
  /begin DAQ_EVENT VARIABLE /end DAQ_EVENT
 /end IF_DATA
/end MEASUREMENT
/begin MEASUREMENT HvGrid_uMaxElM "Maximum system voltage allowed in HV grid" SWORD Volt_V_q0p03125_COMPU 1 100 -1024.000 1023.969 FORMAT "%8.3" ECU_ADDRESS 0x6001FA82
 /begin IF_DATA XCPplus 0x0102
  /begin DAQ_EVENT VARIABLE /end DAQ_EVENT
 /end IF_DATA
/end MEASUREMENT
/begin MEASUREMENT HvGrid_uMinElM "Minimum system voltage allowed in HV grid" SWORD Volt_V_q0p03125_COMPU 1 100 -1024.000 1023.969 FORMAT "%8.3" ECU_ADDRESS 0x6001FA80
 /begin IF_DATA XCPplus 0x0102
  /begin DAQ_EVENT VARIABLE /end DAQ_EVENT
 /end IF_DATA
/end MEASUREMENT
/begin MEASUREMENT I15031_FILLSIG1 "Fillsignal for not supported signals with the size of 1 Byte" UBYTE OneToOne 1 100 0.00 255.0 FORMAT "%5.1" ECU_ADDRESS 0x600237DE /end MEASUREMENT
/begin MEASUREMENT I15031_FILLSIG2 "Fillsignal for not supported signals with the size of 2 Bytes" UWORD OneToOne 1 100 0.00 65535.00 FORMAT "%8.2" ECU_ADDRESS 0x6001FC9A /end MEASUREMENT
/begin MEASUREMENT I15031_FILLSIG4 "Fillsignal for not supported signals with the size of 4 Bytes" ULONG OneToOne 1 100 0.00 4294967295.00 FORMAT "%13.2" ECU_ADDRESS 0x6000103C /end MEASUREMENT
/begin MEASUREMENT I15031_ITIDSuppSrv9 "To store support infotype bits in mode9" ULONG OneToOne 1 100 0.00 4294967295.00 FORMAT "%13.2" MATRIX_DIM 8 ECU_ADDRESS 0x6001BA04 /end MEASUREMENT
/begin MEASUREMENT I15031_PID13 "Location of oxigen sensor" UBYTE OneToOne 1 100 0.00 255.0 FORMAT "%5.1" ECU_ADDRESS 0x600237DD /end MEASUREMENT
/begin MEASUREMENT I15031_PID1C "OBD requirements to which vehicle is designed" UBYTE I15031_PID1CVerb 1 100 1.0000000000 43.0000000000 FORMAT "%13.10" ECU_ADDRESS 0x600237DC /end MEASUREMENT
/begin MEASUREMENT I15031_PID1D "Location of oxygen sensors" UBYTE OneToOne 1 100 0.00 255.0 FORMAT "%5.1" ECU_ADDRESS 0x600237DB /end MEASUREMENT
/begin MEASUREMENT I15031_PID4FA "External Test Equipment Configuration Information. Maximum value for Equivalence Ratio." UBYTE OneToOne 1 100 0.00 255.0 FORMAT "%5.1" ECU_ADDRESS 0x600237DA /end MEASUREMENT
/begin MEASUREMENT I15031_PID4FB "External Test Equipment Configuration Information. Maximum value for Oxygen Sensor Voltage." UBYTE OneToOne 1 100 0.00 255.0 FORMAT "%5.1" ECU_ADDRESS 0x600237D9 /end MEASUREMENT
/begin MEASUREMENT I15031_PID4FC "External Test Equipment Configuration Information. Maximum value for Oxygen Sensor Current." UBYTE OneToOne 1 100 0.00 255.0 FORMAT "%5.1" ECU_ADDRESS 0x600237D8 /end MEASUREMENT
/begin MEASUREMENT I15031_PID4FD "External Test Equipment Configuration Information. Maximum value for Intake Manifold Absolute Pressure." UBYTE OneToTenCarb 1 100 0.00 2550. FORMAT "%5.0" ECU_ADDRESS 0x600237D7 /end MEASUREMENT
/begin MEASUREMENT I15031_PID50A "External Test Equipment Configuration Information. Maximum value for Air Flow Rate from Mass Air Flow Sensor" UBYTE OneToTenCarb 1 100 0.00 2550. FORMAT "%5.0" ECU_ADDRESS 0x600237D6 /end MEASUREMENT
/begin MEASUREMENT I15031_PID50B "External Test Equipment Configuration Information. Demanded manifold Pressure" UBYTE OneToOne 1 100 0.00 255.0 FORMAT "%5.1" ECU_ADDRESS 0x600237D5 /end MEASUREMENT
/begin MEASUREMENT I15031_PID50C "External Test Equipment Configuration Information. Engine Oil Level" UBYTE OneToOne 1 100 0.00 255.0 FORMAT "%5.1" ECU_ADDRESS 0x600237D4 /end MEASUREMENT
/begin MEASUREMENT I15031_PID50D "External Test Equipment Configuration Information. Fuel Rail pressure control" UBYTE OneToOne 1 100 0.00 255.0 FORMAT "%5.1" ECU_ADDRESS 0x600237D3 /end MEASUREMENT
/begin MEASUREMENT I15031_PID5F "Emission requirements to which vehicle is designed" UBYTE OneToOne 1 100 0.00 255.0 FORMAT "%5.1" ECU_ADDRESS 0x600237D2 /end MEASUREMENT
/begin MEASUREMENT I15031_PID65A "Shows which Auxiliary Inputs / Outputs are supported in PID65" UBYTE OneToOne 1 100 0.00 255.0 FORMAT "%5.1" ECU_ADDRESS 0x600237D1 /end MEASUREMENT
/begin MEASUREMENT I15031_PID66A "Shows which Mass Air Flow Sensor data are supported in PID66" UBYTE OneToOne 1 100 0.00 255.0 FORMAT "%5.1" ECU_ADDRESS 0x600237D0 /end MEASUREMENT
/begin MEASUREMENT I15031_PID67A "Shows which Engine Coolant Temperature data are supported in PID67" UBYTE OneToOne 1 100 0.00 255.0 FORMAT "%5.1" ECU_ADDRESS 0x600237CF /end MEASUREMENT
/begin MEASUREMENT I15031_PID68A "Shows which Intake Air Temperature Sensor data are supported in PID68" UBYTE OneToOne 1 100 0.00 255.0 FORMAT "%5.1" ECU_ADDRESS 0x600237CE /end MEASUREMENT
/begin MEASUREMENT I15031_PID69A "Shows which Commanded EGR System data are supported in PID69" UBYTE OneToOne 1 100 0.00 255.0 FORMAT "%5.1" ECU_ADDRESS 0x600237CD /end MEASUREMENT
/begin MEASUREMENT I15031_PID6AA "Shows which Commanded Diesel Intake Air Flow Control and Relative Intake Air Flow Position data are supported in PID6A" UBYTE OneToOne 1 100 0.00 255.0 FORMAT "%5.1" ECU_ADDRESS 0x600237CC /end MEASUREMENT
/begin MEASUREMENT I15031_PID6BA "Shows which Exhaust Gas Recirculation Temperature data are supported in PID6B" UBYTE OneToOne 1 100 0.00 255.0 FORMAT "%5.1" ECU_ADDRESS 0x600237CB /end MEASUREMENT
/begin MEASUREMENT I15031_PID6CA "Shows which Commanded Throttle Actuator Control and Relative Throttle Position data are supported in PID6C" UBYTE OneToOne 1 100 0.00 255.0 FORMAT "%5.1" ECU_ADDRESS 0x600237CA /end MEASUREMENT
/begin MEASUREMENT I15031_PID6DA "Shows which Fuel Pressure Control System data are supported in PID6D" UBYTE OneToOne 1 100 0.00 255.0 FORMAT "%5.1" ECU_ADDRESS 0x600237C9 /end MEASUREMENT
/begin MEASUREMENT I15031_PID6EA "Shows which Injection Pressure Control System data are supported in PID6E" UBYTE OneToOne 1 100 0.00 255.0 FORMAT "%5.1" ECU_ADDRESS 0x600237C8 /end MEASUREMENT
/begin MEASUREMENT I15031_PID6FA "Shows which Turbocharger Compressor Inlet Pressure data are supported in PID6F" UBYTE OneToOne 1 100 0.00 255.0 FORMAT "%5.1" ECU_ADDRESS 0x600237C7 /end MEASUREMENT
/begin MEASUREMENT I15031_PID70A "Shows which Boost Pressure Control data are supported in PID70" UBYTE OneToOne 1 100 0.00 255.0 FORMAT "%5.1" ECU_ADDRESS 0x600237C6 /end MEASUREMENT
/begin MEASUREMENT I15031_PID71A "Shows which Variable Geometry Turbo (VGT) Control data are supported in PID71" UBYTE OneToOne 1 100 0.00 255.0 FORMAT "%5.1" ECU_ADDRESS 0x600237C5 /end MEASUREMENT
/begin MEASUREMENT I15031_PID72A "Shows which Wastegate Control data are supported in PID72" UBYTE OneToOne 1 100 0.00 255.0 FORMAT "%5.1" ECU_ADDRESS 0x600237C4 /end MEASUREMENT
/begin MEASUREMENT I15031_PID73A "Shows which Exhaust Pressure data are supported in PID73" UBYTE OneToOne 1 100 0.00 255.0 FORMAT "%5.1" ECU_ADDRESS 0x600237C3 /end MEASUREMENT
/begin MEASUREMENT I15031_PID74A "Shows which Turbocharger RPM data are supported in PID74" UBYTE OneToOne 1 100 0.00 255.0 FORMAT "%5.1" ECU_ADDRESS 0x600237C2 /end MEASUREMENT
/begin MEASUREMENT I15031_PID75A "Shows which Turbocharger A Temperature data are supported in PID75" UBYTE OneToOne 1 100 0.00 255.0 FORMAT "%5.1" ECU_ADDRESS 0x600237C1 /end MEASUREMENT
/begin MEASUREMENT I15031_PID76A "Shows which Turbocharger B Temperature data are supported in PID76" UBYTE OneToOne 1 100 0.00 255.0 FORMAT "%5.1" ECU_ADDRESS 0x600237C0 /end MEASUREMENT
/begin MEASUREMENT I15031_PID77A "Shows which Charge Air Cooler Temperature (CACT) data are supported in PID77" UBYTE OneToOne 1 100 0.00 255.0 FORMAT "%5.1" ECU_ADDRESS 0x600237BF /end MEASUREMENT
/begin MEASUREMENT I15031_PID78A "Shows which Exhaust Gas Temperature (EGT) Bank 1 data are supported in PID78" UBYTE OneToOne 1 100 0.00 255.0 FORMAT "%5.1" ECU_ADDRESS 0x600237BE /end MEASUREMENT
/begin MEASUREMENT I15031_PID79A "Shows which Exhaust Gas Temperature (EGT) Bank 2 data are supported in PID79" UBYTE OneToOne 1 100 0.00 255.0 FORMAT "%5.1" ECU_ADDRESS 0x600237BD /end MEASUREMENT
/begin MEASUREMENT I15031_PID7AA "Shows which Particulate Filter (PF) Bank 1 data are supported in PID7A" UBYTE OneToOne 1 100 0.00 255.0 FORMAT "%5.1" ECU_ADDRESS 0x600237BC /end MEASUREMENT
/begin MEASUREMENT I15031_PID7BA "Shows which Particulate Filter (PF) Bank 2 data are supported in PID7B" UBYTE OneToOne 1 100 0.00 255.0 FORMAT "%5.1" ECU_ADDRESS 0x600237BB /end MEASUREMENT
/begin MEASUREMENT I15031_PID7CA "Shows which Particulate Filter (PF) Temperature data are supported in PID7C" UBYTE OneToOne 1 100 0.00 255.0 FORMAT "%5.1" ECU_ADDRESS 0x600237BA /end MEASUREMENT
/begin MEASUREMENT I15031_PID7FA "Shows which Engine Run Time is supported in PID7F" UBYTE OneToOne 1 100 0.00 255.0 FORMAT "%5.1" ECU_ADDRESS 0x600237B9 /end MEASUREMENT
/begin MEASUREMENT I15031_PID81A "Shows which Engine Run Time for AECD #1 - #5 is supported in PID81" UBYTE OneToOne 1 100 0.00 255.0 FORMAT "%5.1" ECU_ADDRESS 0x600237B8 /end MEASUREMENT
/begin MEASUREMENT I15031_PID82A "Shows which Engine Run Time for AECD #6 - #10 is supported in PID82" UBYTE OneToOne 1 100 0.00 255.0 FORMAT "%5.1" ECU_ADDRESS 0x600237B7 /end MEASUREMENT
/begin MEASUREMENT I15031_PID83A "Shows which NOx Sensor data are supported in PID83" UBYTE OneToOne 1 100 0.00 255.0 FORMAT "%5.1" ECU_ADDRESS 0x600237B6 /end MEASUREMENT
/begin MEASUREMENT I15031_PID85A "Shows which NOx Control System data are supported in PID85" UBYTE OneToOne 1 100 0.00 255.0 FORMAT "%5.1" ECU_ADDRESS 0x600237B5 /end MEASUREMENT
/begin MEASUREMENT I15031_PID86A "Shows which Particulate Matter (PM) Sensor data are supported in PID86" UBYTE OneToOne 1 100 0.00 255.0 FORMAT "%5.1" ECU_ADDRESS 0x600237B4 /end MEASUREMENT
/begin MEASUREMENT I15031_PID87A "Shows which Intake Manifold Absolute Pressure data are supported in PID87" UBYTE OneToOne 1 100 0.00 255.0 FORMAT "%5.1" ECU_ADDRESS 0x600237B3 /end MEASUREMENT
/begin MEASUREMENT I15031_PID89A "Shows which Engine Run Time for AECD #11 - #15 is supported in PID89" UBYTE OneToOne 1 100 0.00 255.0 FORMAT "%5.1" ECU_ADDRESS 0x600237B2 /end MEASUREMENT
/begin MEASUREMENT I15031_PID8AA "Shows which Engine Run Time for AECD #16 - #20 is supported in PID8A" UBYTE OneToOne 1 100 0.00 255.0 FORMAT "%5.1" ECU_ADDRESS 0x600237B1 /end MEASUREMENT
/begin MEASUREMENT I15031_PID8BA "Shows which Aftertreatment Status is supported in PID8B ByteB." UBYTE OneToOne 1 100 0.00 255.0 FORMAT "%5.1" ECU_ADDRESS 0x600237B0 /end MEASUREMENT
/begin MEASUREMENT I15031_PID8CA "Calibration for O2 Sensor Data support information(Sensor 1, Sensor 2)" UBYTE OneToOne 1 100 0.00 255.0 FORMAT "%5.1" ECU_ADDRESS 0x600237AF /end MEASUREMENT
/begin MEASUREMENT I15031_PID8FA "Shows which PM (Particulate Matter) Sensor Output is supported in PID8F" UBYTE OneToOne 1 100 0.00 255.0 FORMAT "%5.1" ECU_ADDRESS 0x600237AE /end MEASUREMENT
/begin MEASUREMENT I15031_PID92A "Fuel System Status support information" UBYTE OneToOne 1 100 0.00 255.0 FORMAT "%5.1" ECU_ADDRESS 0x600237AD /end MEASUREMENT
/begin MEASUREMENT I15031_PID93A "WWH B1 counter support information" UBYTE OneToOne 1 100 0.00 255.0 FORMAT "%5.1" ECU_ADDRESS 0x600237AC /end MEASUREMENT
/begin MEASUREMENT I15031_PID94A "Inducement Counters support information" UBYTE OneToOne 1 100 0.00 255.0 FORMAT "%5.1" ECU_ADDRESS 0x600237AB /end MEASUREMENT
/begin MEASUREMENT I15031_PID97A "Message for Signal carrying NOx Mass Emission Rate" UBYTE OneToOne 1 100 0.00 255.0 FORMAT "%5.1" ECU_ADDRESS 0x600237AA /end MEASUREMENT
/begin MEASUREMENT I15031_PID98A "Exhaust Gas Temperature Sensor Data support information(Bank 1)" UBYTE OneToOne 1 100 0.00 255.0 FORMAT "%5.1" ECU_ADDRESS 0x600237A9 /end MEASUREMENT
/begin MEASUREMENT I15031_PID99A "Exhaust Gas Temperature Sensor Data support information" UBYTE OneToOne 1 100 0.00 255.0 FORMAT "%5.1" ECU_ADDRESS 0x600237A8 /end MEASUREMENT
/begin MEASUREMENT I15031_PID9AA "Shows if HybridEV Vehicle State is supported in PID9A" UBYTE OneToOne 1 100 0.00 255.0 FORMAT "%5.1" ECU_ADDRESS 0x600237A7 /end MEASUREMENT
/begin MEASUREMENT I15031_PID9BA "Diesel exhaust fluid sensor output" UBYTE OneToOne 1 100 0.00 255.0 FORMAT "%5.1" ECU_ADDRESS 0x600237A6 /end MEASUREMENT
/begin MEASUREMENT I15031_PID9CA "O2 Sensor Data support information(Sensor 3, Sensor 4)" UBYTE OneToOne 1 100 0.00 255.0 FORMAT "%5.1" ECU_ADDRESS 0x600237A5 /end MEASUREMENT
/begin MEASUREMENT I15031_PID9FA "Fuel system percentage use" UBYTE OneToOne 1 100 0.00 255.0 FORMAT "%5.1" ECU_ADDRESS 0x600237A4 /end MEASUREMENT
/begin MEASUREMENT I15031_PIDA1A "Displays the NOx Sensor Corrected Data supported in PIDA1" UBYTE OneToOne 1 100 0.00 255.0 FORMAT "%5.1" ECU_ADDRESS 0x600237A3 /end MEASUREMENT
/begin MEASUREMENT I15031_PIDA3A "Evap System Vapor Pressure" UBYTE OneToOne 1 100 0.00 255.0 FORMAT "%5.1" ECU_ADDRESS 0x600237A2 /end MEASUREMENT
/begin MEASUREMENT I15031_PIDA4A "Transmission Actual Gear" UBYTE OneToOne 1 100 0.00 255.0 FORMAT "%5.1" ECU_ADDRESS 0x600237A1 /end MEASUREMENT
/begin MEASUREMENT I15031_PIDA5A "message to update byte A ini PIDA5 for Diesel Exhaust Fluid Dosing" UBYTE OneToOne 1 100 0.00 255.0 FORMAT "%5.1" ECU_ADDRESS 0x600237A0 /end MEASUREMENT
/begin MEASUREMENT I15031_PIDA7A "Support of NOx Sensor Data" UBYTE OneToOne 1 100 0.00 255.0 FORMAT "%5.1" ECU_ADDRESS 0x6002379F /end MEASUREMENT
/begin MEASUREMENT I15031_PIDA8A "NOx Sensor Corrected" UBYTE OneToOne 1 100 0.00 255.0 FORMAT "%5.1" ECU_ADDRESS 0x6002379E /end MEASUREMENT
/begin MEASUREMENT I15031_PIDA9A "Motorcycle InputOutput Status" UBYTE OneToOne 1 100 0.00 255.0 FORMAT "%5.1" ECU_ADDRESS 0x6002379D /end MEASUREMENT
/begin MEASUREMENT I15031_PIDACA "Shows Support of DEF Dosing Rate or Mode" UBYTE OneToOne 1 100 0.00 255.0 FORMAT "%5.1" ECU_ADDRESS 0x6002379C /end MEASUREMENT
/begin MEASUREMENT I15031_PIDSuppSrv1 "PIDs supported in Service 1 are indicated in 32 bit measurement array" ULONG OneToOne 1 100 0.00 4294967295.00 FORMAT "%13.2" MATRIX_DIM 8 ECU_ADDRESS 0x6001E550 /end MEASUREMENT
/begin MEASUREMENT I15031_PIDSuppSrv2 "PIDs supported in Service 2 are indicated in 32 bit measurement array" ULONG OneToOne 1 100 0.00 4294967295.00 FORMAT "%13.2" MATRIX_DIM 8 ECU_ADDRESS 0x6001E530 /end MEASUREMENT
/begin MEASUREMENT I15031_Srv12_Ext_DisablPIDSupp "PIDs requested for dynamic support switch off are indicated in 32 bit measurement array" ULONG OneToOne 1 100 0.00 4294967295.00 FORMAT "%13.2" MATRIX_DIM 8 ECU_ADDRESS 0x6001E510 /end MEASUREMENT
/begin MEASUREMENT i15031_srv9_CVN_Calc_ui "State of CVN calculation" UBYTE I15031_srv9_CVN_CalcVerb 1 100 0.00 6. FORMAT "%2.0" ECU_ADDRESS 0x60023761 /end MEASUREMENT
/begin MEASUREMENT I15031_srv9_stCVNRecalc "Recalculation of CVN" UBYTE OneToOne 1 100 0.00 255.0 FORMAT "%5.1" ECU_ADDRESS 0x6002379A /end MEASUREMENT
/begin MEASUREMENT I15031_srv9_ValidCVN "" UBYTE OneToOne 1 100 0.00 255.0 FORMAT "%5.1" ECU_ADDRESS 0x6002379B /end MEASUREMENT
/begin MEASUREMENT Inm_221ToutMsgCntr "counter used for HSN1 node mute error" UBYTE dez 1 100 0.00 255.0 FORMAT "%5.1" ECU_ADDRESS 0x60023799 /end MEASUREMENT
/begin MEASUREMENT Inm_241ToutMsgCntr "counter used for HSn3 node mute error" UBYTE dez 1 100 0.00 255.0 FORMAT "%5.1" ECU_ADDRESS 0x60023798 /end MEASUREMENT
/begin MEASUREMENT Inm_25TxTout "interface to indicate timeout error" UBYTE B_TRUE 1 100 0.00 1.00000000000 BIT_MASK 0x1 FORMAT "%13.11" ECU_ADDRESS 0x60023429 /end MEASUREMENT
/begin MEASUREMENT Inm_bFullcomReqHSN1 "Full Communication status of HSN1 CAN" UBYTE OneToOne 1 100 0.00 1.000 BIT_MASK 0x1 FORMAT "%5.3" ECU_ADDRESS 0x600236AB
 /begin IF_DATA XCPplus 0x0102
  /begin DAQ_EVENT VARIABLE /end DAQ_EVENT
 /end IF_DATA
/end MEASUREMENT
/begin MEASUREMENT Inm_bFullcomReqHSN3 "Full Communication status of HSN3 CAN" UBYTE OneToOne 1 100 0.00 1.000 BIT_MASK 0x1 FORMAT "%5.3" ECU_ADDRESS 0x600236AA
 /begin IF_DATA XCPplus 0x0102
  /begin DAQ_EVENT VARIABLE /end DAQ_EVENT
 /end IF_DATA
/end MEASUREMENT
/begin MEASUREMENT Inm_ctHVACPanelAbsnt_mp "Counter to monitor the lin node HVAC" UWORD OneToOne 1 100 0.00 65535.00 FORMAT "%8.2" ECU_ADDRESS 0x6001F9B8
 /begin IF_DATA XCPplus 0x0102
  /begin DAQ_EVENT VARIABLE /end DAQ_EVENT
 /end IF_DATA
/end MEASUREMENT
/begin MEASUREMENT Inm_stNm "Indicates the state of INM state machine" UBYTE Inm_SM_t_sm_VERB 1 100 0.00 3.00000000000 FORMAT "%13.11" ECU_ADDRESS 0x60023880
 /begin IF_DATA XCPplus 0x0102
  /begin DAQ_EVENT VARIABLE /end DAQ_EVENT
 /end IF_DATA
/end MEASUREMENT
/begin MEASUREMENT LinNm_debRepCheck "LIN DFC Check" ULONG OneToOne 1 100 0.00 4294967295.00 FORMAT "%13.2" ECU_ADDRESS 0x60000768
 /begin IF_DATA XCPplus 0x0102
  /begin DAQ_EVENT VARIABLE /end DAQ_EVENT
 /end IF_DATA
/end MEASUREMENT
/begin MEASUREMENT Lin_bDgoLINBlock "Error message for Inm_stLIN" UBYTE B_TRUE 1 100 0.00 1.00000000000 BIT_MASK 0x1 FORMAT "%13.11" ECU_ADDRESS 0x60023426
 /begin IF_DATA XCPplus 0x0102
  /begin DAQ_EVENT VARIABLE /end DAQ_EVENT
 /end IF_DATA
/end MEASUREMENT
/begin MEASUREMENT LIN_bDgoLostHVACPanel "Flag to check HVAC node absent" UBYTE B_TRUE 1 100 0.00 1.00000000000 BIT_MASK 0x1 FORMAT "%13.11" ECU_ADDRESS 0x60023428 /end MEASUREMENT
/begin MEASUREMENT Lin_bMonRunLINBlock "Error message for Inm_stLIN" UBYTE B_TRUE 1 100 0.00 1.00000000000 BIT_MASK 0x1 FORMAT "%13.11" ECU_ADDRESS 0x60023425
 /begin IF_DATA XCPplus 0x0102
  /begin DAQ_EVENT VARIABLE /end DAQ_EVENT
 /end IF_DATA
/end MEASUREMENT
/begin MEASUREMENT LIN_bMonRunLostHVACPanel "Window condition flag to indicate HVAC absent" UBYTE B_TRUE 1 100 0.00 1.00000000000 BIT_MASK 0x1 FORMAT "%13.11" ECU_ADDRESS 0x60023427
 /begin IF_DATA XCPplus 0x0102
  /begin DAQ_EVENT VARIABLE /end DAQ_EVENT
 /end IF_DATA
/end MEASUREMENT
/begin MEASUREMENT Nm_bHSN1BusOn "CAN HSN1 Bus On Status" UBYTE OneToOne 1 100 0.00 1.000 BIT_MASK 0x1 FORMAT "%5.3" ECU_ADDRESS 0x6002388B
 /begin IF_DATA XCPplus 0x0102
  /begin DAQ_EVENT VARIABLE /end DAQ_EVENT
 /end IF_DATA
/end MEASUREMENT
/begin MEASUREMENT Nm_bHSN3BusOn "CAN HSN3 Bus On Status" UBYTE OneToOne 1 100 0.00 1.000 BIT_MASK 0x1 FORMAT "%5.3" ECU_ADDRESS 0x6002388A
 /begin IF_DATA XCPplus 0x0102
  /begin DAQ_EVENT VARIABLE /end DAQ_EVENT
 /end IF_DATA
/end MEASUREMENT
/begin MEASUREMENT Nm_bNetOn "Bit set to TRUE after the confirmation of the (Degraded/Main) Wake Up for RCD or APC high level." UBYTE OneToOne 1 100 0.00 1.000 BIT_MASK 0x1 FORMAT "%5.3" ECU_ADDRESS 0x600236A8
 /begin IF_DATA XCPplus 0x0102
  /begin DAQ_EVENT VARIABLE /end DAQ_EVENT
 /end IF_DATA
/end MEASUREMENT
/begin MEASUREMENT Nm_bStBatt "State of the battery voltage responding to normal or low condition." UBYTE OneToOne 1 100 0.00 1.000 BIT_MASK 0x1 FORMAT "%5.3" ECU_ADDRESS 0x60023889
 /begin IF_DATA XCPplus 0x0102
  /begin DAQ_EVENT VARIABLE /end DAQ_EVENT
 /end IF_DATA
/end MEASUREMENT
/begin MEASUREMENT old_CanSM_HSN1BOffCntr "counter to store the previous value of counter related to HSN1 busoff" UBYTE OneToOne 1 100 0.00 255.0 FORMAT "%5.1" ECU_ADDRESS 0x60023131
 /begin IF_DATA XCPplus 0x0102
  /begin DAQ_EVENT VARIABLE /end DAQ_EVENT
 /end IF_DATA
/end MEASUREMENT
/begin MEASUREMENT old_CanSM_HSN3BOffCntr "counter to store the previous value of counter related to HSn3 busoff" UBYTE OneToOne 1 100 0.00 255.0 FORMAT "%5.1" ECU_ADDRESS 0x60023130
 /begin IF_DATA XCPplus 0x0102
  /begin DAQ_EVENT VARIABLE /end DAQ_EVENT
 /end IF_DATA
/end MEASUREMENT
/begin FUNCTION HvBatt_ElecDiag "1400.3.0  High Voltage Battery Diagnosis Electric System"
 /begin DEF_CHARACTERISTIC DDRC_DurDeb.HvBatt_tiCrashDetdDebOk_C DDRC_DurDeb.HvBatt_tiCrashDetdDebDef_C DDRC_DurDeb.HvBatt_tiEmgyOffDebOk_C DDRC_DurDeb.HvBatt_tiEmgyOffDebDef_C DDRC_DurDeb.HvBatt_tiEmgyOffIntlckDebOk_C DDRC_DurDeb.HvBatt_tiEmgyOffIntlckDebDef_C DDRC_DurDeb.HvBatt_tiEmgyOffReqDebOk_C DDRC_DurDeb.HvBatt_tiEmgyOffReqDebDef_C DDRC_DurDeb.HvBatt_tiIntlckStDebOk_C DDRC_DurDeb.HvBatt_tiIntlckStDebDef_C DDRC_DurDeb.HvBatt_tiIsoFltDebOk_C DDRC_DurDeb.HvBatt_tiIsoFltDebDef_C DDRC_DurDeb.HvBatt_tiLimdPwrDebOk_C DDRC_DurDeb.HvBatt_tiLimdPwrDebDef_C DDRC_DurDeb.HvBatt_tiNegCntctrCntErrDebOk_C DDRC_DurDeb.HvBatt_tiNegCntctrCntErrDebDef_C DDRC_DurDeb.HvBatt_tiOverTDernDebOk_C DDRC_DurDeb.HvBatt_tiOverTDernDebDef_C DDRC_DurDeb.HvBatt_tiPosCntctrCntErrDebOk_C DDRC_DurDeb.HvBatt_tiPosCntctrCntErrDebDef_C DDRC_DurDeb.HvBatt_tiPrecCntctrCntErrDebOk_C DDRC_DurDeb.HvBatt_tiPrecCntctrCntErrDebDef_C DDRC_DurDeb.HvBatt_tiPwrDistbnTDernDebOk_C DDRC_DurDeb.HvBatt_tiPwrDistbnTDernDebDef_C DDRC_DurDeb.HvBatt_tiPwrDistbnTInhbnDebOk_C DDRC_DurDeb.HvBatt_tiPwrDistbnTInhbnDebDef_C DDRC_DurDeb.HvBatt_tiRatRSohErrDebOk_C DDRC_DurDeb.HvBatt_tiRatRSohErrDebDef_C DDRC_DurDeb.HvBatt_tiRatSohErrDebOk_C DDRC_DurDeb.HvBatt_tiRatSohErrDebDef_C DDRC_DurDeb.HvBatt_tiSngIsoWarnDebOk_C DDRC_DurDeb.HvBatt_tiSngIsoWarnDebDef_C DDRC_DurDeb.HvBatt_tiSrvPlgDiscntDebOk_C DDRC_DurDeb.HvBatt_tiSrvPlgDiscntDebDef_C DDRC_DurDeb.HvBatt_tiUnderTDernDebOk_C DDRC_DurDeb.HvBatt_tiUnderTDernDebDef_C DFC_CtlMsk2.DFC_HvBattCrashDetd_C DFC_CtlMsk2.DFC_HvBattEmgyOff_C DFC_CtlMsk2.DFC_HvBattEmgyOffIntlck_C DFC_CtlMsk2.DFC_HvBattEmgyOffReq_C DFC_CtlMsk2.DFC_HvBattIntlckSt_C DFC_CtlMsk2.DFC_HvBattIsoFlt_C DFC_CtlMsk2.DFC_HvBattLimdPwr_C DFC_CtlMsk2.DFC_HvBattNegCntctrCntErr_C DFC_CtlMsk2.DFC_HvBattOverTDern_C DFC_CtlMsk2.DFC_HvBattPosCntctrCntErr_C DFC_CtlMsk2.DFC_HvBattPrecCntctrCntErr_C DFC_CtlMsk2.DFC_HvBattPwrDistbnTDern_C DFC_CtlMsk2.DFC_HvBattPwrDistbnTInhbn_C DFC_CtlMsk2.DFC_HvBattRatRSohErr_C DFC_CtlMsk2.DFC_HvBattRatSohErr_C DFC_CtlMsk2.DFC_HvBattSngIsoWarn_C DFC_CtlMsk2.DFC_HvBattSrvPlgDiscnct_C DFC_CtlMsk2.DFC_HvBattUnderTDern_C DFC_DisblMsk2.DFC_HvBattCrashDetd_C DFC_DisblMsk2.DFC_HvBattEmgyOff_C DFC_DisblMsk2.DFC_HvBattEmgyOffIntlck_C DFC_DisblMsk2.DFC_HvBattEmgyOffReq_C DFC_DisblMsk2.DFC_HvBattIntlckSt_C DFC_DisblMsk2.DFC_HvBattIsoFlt_C DFC_DisblMsk2.DFC_HvBattLimdPwr_C DFC_DisblMsk2.DFC_HvBattNegCntctrCntErr_C DFC_DisblMsk2.DFC_HvBattOverTDern_C DFC_DisblMsk2.DFC_HvBattPosCntctrCntErr_C DFC_DisblMsk2.DFC_HvBattPrecCntctrCntErr_C DFC_DisblMsk2.DFC_HvBattPwrDistbnTDern_C DFC_DisblMsk2.DFC_HvBattPwrDistbnTInhbn_C DFC_DisblMsk2.DFC_HvBattRatRSohErr_C DFC_DisblMsk2.DFC_HvBattRatSohErr_C DFC_DisblMsk2.DFC_HvBattSngIsoWarn_C DFC_DisblMsk2.DFC_HvBattSrvPlgDiscnct_C DFC_DisblMsk2.DFC_HvBattUnderTDern_C HvBatt_cntNegSeg1ReplcmtVal_C HvBatt_cntNegSeg2ReplcmtVal_C HvBatt_cntNegSeg3ReplcmtVal_C HvBatt_cntNegSeg4ReplcmtVal_C HvBatt_cntNegSeg5ReplcmtVal_C HvBatt_cntPosSeg1ReplcmtVal_C HvBatt_cntPosSeg2ReplcmtVal_C HvBatt_cntPosSeg3ReplcmtVal_C HvBatt_cntPosSeg4ReplcmtVal_C HvBatt_cntPosSeg5ReplcmtVal_C HvBatt_cntPrecSeg1ReplcmtVal_C HvBatt_cntPrecSeg2ReplcmtVal_C HvBatt_maskDernMaxTSq_C HvBatt_maskDernMinTSq_C HvBatt_maskHvbFltDiagSq_C HvBatt_maskHvbIntlckSq_C HvBatt_maskHvbIsoFltSq_C HvBatt_maskSpdErrSq_C HvBatt_maskSrvPlgErrSq_C HvBatt_ratRSohReplcmtVal_C HvBatt_ratSohReplcmtVal_C HvBatt_tiThdSrvPlgErr_C HvBatt_tPwrDistbnDern_C HvBatt_tPwrDistbnInhbn_C HvBatt_vThdSrvPlgErr_C /end DEF_CHARACTERISTIC
 /begin IN_MEASUREMENT Com_ctHvbNegCntctrSeg1 Com_ctHvbNegCntctrSeg2 Com_ctHvbNegCntctrSeg3 Com_ctHvbNegCntctrSeg4 Com_ctHvbNegCntctrSeg5 Com_ctHvbPosCntctrSeg1 Com_ctHvbPosCntctrSeg2 Com_ctHvbPosCntctrSeg3 Com_ctHvbPosCntctrSeg4 Com_ctHvbPosCntctrSeg5 Com_ctHvbPrecCntctrSeg1 Com_ctHvbPrecCntctrSeg2 Com_ratHvbSoh Com_ratRHvbSoh Com_stHvbDernMaxT Com_stHvbDernMaxT_Sq Com_stHvbDernMinT Com_stHvbDernMinT_Sq Com_stHvbFlt Com_stHvbFlt_Sq Com_stHvbIntlck Com_stHvbIntlck_Sq Com_stHvbIsoFlt Com_stHvbIsoFlt_Sq Com_stHvbSrvPlg Com_stHvbSrvPlg_Sq PwrDistbnUnitT_t_f VehV_v VehV_v_Sq /end IN_MEASUREMENT
 /begin OUT_MEASUREMENT DDRC_St.DFC_HvBattCrashDetd DDRC_St.DFC_HvBattEmgyOff DDRC_St.DFC_HvBattEmgyOffIntlck DDRC_St.DFC_HvBattEmgyOffReq DDRC_St.DFC_HvBattIntlckSt DDRC_St.DFC_HvBattIsoFlt DDRC_St.DFC_HvBattLimdPwr DDRC_St.DFC_HvBattNegCntctrCntErr DDRC_St.DFC_HvBattOverTDern DDRC_St.DFC_HvBattPosCntctrCntErr DDRC_St.DFC_HvBattPrecCntctrCntErr DDRC_St.DFC_HvBattPwrDistbnTDern DDRC_St.DFC_HvBattPwrDistbnTInhbn DDRC_St.DFC_HvBattRatRSohErr DDRC_St.DFC_HvBattRatSohErr DDRC_St.DFC_HvBattSngIsoWarn DDRC_St.DFC_HvBattSrvPlgDiscnct DDRC_St.DFC_HvBattUnderTDern DFC_st.DFC_HvBattCrashDetd DFC_st.DFC_HvBattEmgyOff DFC_st.DFC_HvBattEmgyOffIntlck DFC_st.DFC_HvBattEmgyOffReq DFC_st.DFC_HvBattIntlckSt DFC_st.DFC_HvBattIsoFlt DFC_st.DFC_HvBattLimdPwr DFC_st.DFC_HvBattNegCntctrCntErr DFC_st.DFC_HvBattOverTDern DFC_st.DFC_HvBattPosCntctrCntErr DFC_st.DFC_HvBattPrecCntctrCntErr DFC_st.DFC_HvBattPwrDistbnTDern DFC_st.DFC_HvBattPwrDistbnTInhbn DFC_st.DFC_HvBattRatRSohErr DFC_st.DFC_HvBattRatSohErr DFC_st.DFC_HvBattSngIsoWarn DFC_st.DFC_HvBattSrvPlgDiscnct DFC_st.DFC_HvBattUnderTDern DINH_nrActvInhReas.FId_HvBattNegCntctrCnt DINH_nrActvInhReas.FId_HvBattPosCntctrCnt DINH_nrActvInhReas.FId_HvBattPrecCntctrCnt DINH_nrActvInhReas.FId_HvBattPwrDistbnTDern DINH_nrActvInhReas.FId_HvBattPwrDistbnTInhbn DINH_nrActvInhReas.FId_HvBattRatRSoh DINH_nrActvInhReas.FId_HvBattRatSoh DINH_stFId.FId_HvBattNegCntctrCnt DINH_stFId.FId_HvBattPosCntctrCnt DINH_stFId.FId_HvBattPrecCntctrCnt DINH_stFId.FId_HvBattPwrDistbnTDern DINH_stFId.FId_HvBattPwrDistbnTInhbn DINH_stFId.FId_HvBattRatRSoh DINH_stFId.FId_HvBattRatSoh HvBatt_cntNegCntctrSeg1EepVal HvBatt_cntNegCntctrSeg2EepVal HvBatt_cntNegCntctrSeg3EepVal HvBatt_cntNegCntctrSeg4EepVal HvBatt_cntNegCntctrSeg5EepVal HvBatt_cntPosCntctrSeg1EepVal HvBatt_cntPosCntctrSeg2EepVal HvBatt_cntPosCntctrSeg3EepVal HvBatt_cntPosCntctrSeg4EepVal HvBatt_cntPosCntctrSeg5EepVal HvBatt_cntPrecCntctrSeg1EepVal HvBatt_cntPrecCntctrSeg2EepVal HvBatt_ratRSohEepVal HvBatt_ratSohEepVal /end OUT_MEASUREMENT
 /begin LOC_MEASUREMENT HvBatt_flgNegCntctrCntEepWrite HvBatt_flgNegCntctrCntErr HvBatt_flgPosCntctrCntEepWrite HvBatt_flgPosCntctrCntErr HvBatt_flgPrecCntctrCntEepWrite HvBatt_flgPrecCntctrCntErr HvBatt_flgRatRSohEepWrite HvBatt_flgRatRSohErr HvBatt_flgRatSohEepWrite HvBatt_flgRatSohErr /end LOC_MEASUREMENT
 FUNCTION_VERSION "1400.3.0" /end FUNCTION
/begin FUNCTION HvBatt_ElecVd "1400.5.0  High Voltage Battery Virtual Device Electric System"
 /begin DEF_CHARACTERISTIC DDRC_DurDeb.HvBatt_tiChrgPwrMaxDebOk_C DDRC_DurDeb.HvBatt_tiChrgPwrMaxDebDef_C DDRC_DurDeb.HvBatt_tiDchaPwrMaxDebOk_C DDRC_DurDeb.HvBatt_tiDchaPwrMaxDebDef_C DFC_CtlMsk2.DFC_HvBattChrgPwrMax_C DFC_CtlMsk2.DFC_HvBattDchaPwrMax_C DFC_DisblMsk2.DFC_HvBattChrgPwrMax_C DFC_DisblMsk2.DFC_HvBattDchaPwrMax_C HvBatt_dpwrChrgContnsRmpMaxNeg_C HvBatt_dpwrChrgContnsRmpMaxPos_C HvBatt_dpwrChrgShoRmpMaxNeg_C HvBatt_dpwrChrgShoRmpMaxPos_C HvBatt_dpwrDchaContnsRmpMaxNeg_C HvBatt_dpwrDchaContnsRmpMaxPos_C HvBatt_dpwrDchaShoRmpMaxNeg_C HvBatt_dpwrDchaShoRmpMaxPos_C HvBatt_egyAvlSrcSoC_T HvBatt_facChrgContnsDifLimTau_T HvBatt_facChrgContnsLimPwrSoC_M HvBatt_facChrgShoDifLimTau_T HvBatt_facChrgShoLimPwrSoC_M HvBatt_facDchaContnsDifLimTau_T HvBatt_facDchaContnsLimPwrSoC_M HvBatt_facDchaShoDifLimTau_T HvBatt_facDchaShoLimPwrSoC_M HvBatt_facMaxChrgBusTDern_T HvBatt_facMaxDchaBusTDern_T HvBatt_facPwrChrgContnsDifInp_T HvBatt_facPwrChrgShoDifInp_T HvBatt_facPwrDchaContnsDifInp_T HvBatt_facPwrDchaShoDifInp_T HvBatt_facPwrMaxChrgContnsGainCon_T HvBatt_facPwrMaxChrgShoGainCon_T HvBatt_facPwrMaxDchaContnsGainCon_T HvBatt_facPwrMaxDchaShoGainCon_T HvBatt_facPwrMaxGen_C HvBatt_flgChrgContnsLimPwrIntegDi_C HvBatt_flgChrgShoLimPwrIntegDi_C HvBatt_flgDchaContnsLimPwrIntegDi_C HvBatt_flgDchaShoLimPwrIntegDi_C HvBatt_flgPwrLimPrdnAvl_C HvBatt_maskpwrActMeasdVldySq_C HvBatt_maskpwrMaxChrgContnsVldySq_C HvBatt_maskpwrMaxChrgShoVldySq_C HvBatt_maskpwrMaxDchaContnsVldySq_C HvBatt_maskpwrMaxDchaShoVldySq_C HvBatt_maskratSocVldySq_C HvBatt_PwrChrgContnsLimMax_C HvBatt_PwrChrgContnsLimMin_C HvBatt_PwrChrgContnsMeasd_C HvBatt_pwrChrgLvl3Dern_C HvBatt_PwrChrgShoActMeasd_C HvBatt_PwrChrgShoLimMax_C HvBatt_PwrChrgShoLimMin_C HvBatt_PwrDchaContnsLimMax_C HvBatt_PwrDchaContnsLimMin_C HvBatt_PwrDchaContnsMeasd_C HvBatt_pwrDchaLvl3Dern_C HvBatt_PwrDchaShoActMeasd_C HvBatt_PwrDchaShoLimMax_C HvBatt_PwrDchaShoLimMin_C HvBatt_pwrDiffActTarChrgContns_C HvBatt_pwrDiffActTarChrgSho_C HvBatt_pwrDiffActTarDchaContns_C HvBatt_pwrDiffActTarDchaSho_C HvBatt_pwrMaxDchaContnsLim_C HvBatt_pwrMaxDchaShoLim_C HvBatt_pwrOffsChrgMax_C HvBatt_pwrOffsDchaMax_C HvBatt_pwrOffsMaxGen_C HvBatt_ratSocThd_C HvBatt_swtEgyAvlSrcSel_C /end DEF_CHARACTERISTIC
 /begin IN_MEASUREMENT Com_egyHvbAvl_f Com_egyHvbAvl_Sq Com_iHvbAct Com_iHvbAct_Sq Com_iHvbChrgMaxContns Com_iHvbChrgMaxContns_Sq Com_iHvbChrgMaxSho Com_iHvbChrgMaxSho_Sq Com_iHvbDchaMaxContns Com_iHvbDchaMaxContns_Sq Com_iHvbDchaMaxSho Com_iHvbDchaMaxSho_Sq Com_pwrMaxChrgContns Com_pwrMaxChrgContns_Sq Com_pwrMaxChrgSho Com_pwrMaxChrgSho_Sq Com_pwrMaxDchaContns Com_pwrMaxDchaContns_Sq Com_pwrMaxDchaSho Com_pwrMaxDchaSho_Sq Com_ratHvbSoc Com_ratHvbSoc_Sq Com_ratHvbSoh Com_ratHvbSoh_Sq Com_rHvbIsoMeasmt Com_rHvbIsoMeasmt_Sq Com_uHvbAct Com_uHvbAct_Sq Com_uHvbChrgMaxContns Com_uHvbChrgMaxContns_Sq Com_uHvbChrgMaxSho Com_uHvbChrgMaxSho_Sq Com_uHvbDcBus Com_uHvbDcBus_Sq Com_uHvbDchaMaxContns Com_uHvbDchaMaxContns_Sq Com_uHvbDchaMaxSho Com_uHvbDchaMaxSho_Sq Com_uHvbLimHi Com_uHvbLimHi_Sq Com_uHvbLimLo Com_uHvbLimLo_Sq PwrDistbnUnitT_t_f /end IN_MEASUREMENT
 /begin OUT_MEASUREMENT DDRC_St.DFC_HvBattChrgPwrMax DDRC_St.DFC_HvBattDchaPwrMax DFC_st.DFC_HvBattChrgPwrMax DFC_st.DFC_HvBattDchaPwrMax DINH_nrActvInhReas.FId_HvBattChrgLvl3DernFlt DINH_nrActvInhReas.FId_HvBattDchaLvl3DernFlt DINH_nrActvInhReas.FId_HvBattMaxPwrBusTDern DINH_stFId.FId_HvBattChrgLvl3DernFlt DINH_stFId.FId_HvBattDchaLvl3DernFlt DINH_stFId.FId_HvBattMaxPwrBusTDern HvBatt_egyAvl_f HvBatt_egyAvl_Sq HvBatt_iActMeasd HvBatt_iActMeasd_Sq HvBatt_pwrActMeasd HvBatt_pwrActMeasd_Sq HvBatt_pwrMaxChrgContns HvBatt_pwrMaxChrgContns_Sq HvBatt_pwrMaxChrgSho HvBatt_pwrMaxChrgSho_Sq HvBatt_pwrMaxDchaContns HvBatt_pwrMaxDchaContns_Sq HvBatt_pwrMaxDchaSho HvBatt_pwrMaxDchaSho_Sq HvBatt_ratSoc HvBatt_ratSoc_Sq HvBatt_ratSoh HvBatt_ratSoh_Sq HvBatt_rIsoMeasmt HvBatt_rIsoMeasmt_Sq HvBatt_uActMeasd HvBatt_uActMeasd_Sq HvBatt_uDcBus HvBatt_uDcBus_Sq HvBatt_uMaxLim HvBatt_uMaxLim_Sq HvBatt_uMinLim HvBatt_uMinLim_Sq /end OUT_MEASUREMENT
 /begin LOC_MEASUREMENT HvBatt_facPwrChrgContnsInteg HvBatt_facPwrChrgContnsProp HvBatt_facPwrChrgShoActMeasdInteg HvBatt_facPwrChrgShoActMeasdProp HvBatt_facPwrDchaContnsInteg HvBatt_facPwrDchaContnsProp HvBatt_facPwrDchaShoActMeasdInteg HvBatt_facPwrDchaShoActMeasdProp HvBatt_flgERChrgContns HvBatt_flgERChrgSho HvBatt_flgERDchaContns HvBatt_flgERDchaSho HvBatt_flgRmpChrgContnsActv HvBatt_flgRmpChrgContnsActvOld HvBatt_flgRmpChrgShoActv HvBatt_flgRmpChrgShoActvOld HvBatt_flgRmpDchaContnsActv HvBatt_flgRmpDchaContnsActvOld HvBatt_flgRmpDchaShoActv HvBatt_flgRmpDchaShoActvOld HvBatt_flgRstChrgContnsLim HvBatt_flgRstChrgShoLim HvBatt_flgRstDchaContnsLim HvBatt_flgRstDchaShoLim HvBatt_flgSigQlyChrgContns HvBatt_flgSigQlyChrgSho HvBatt_flgSigQlyDchaContns HvBatt_flgSigQlyDchaSho HvBatt_pwrDchaContnsActMeasd HvBatt_pwrMaxChrgContnsDern HvBatt_pwrMaxChrgContnsDernPropInteg HvBatt_pwrMaxChrgContnsDif HvBatt_pwrMaxChrgContnsLimNearDern HvBatt_pwrMaxChrgContnsLvl3FltDern HvBatt_pwrMaxChrgContnsRaw HvBatt_pwrMaxChrgContnsTDern HvBatt_pwrMaxChrgShoDern HvBatt_pwrMaxChrgShoDernPropInteg HvBatt_pwrMaxChrgShoDif HvBatt_pwrMaxChrgShoLimNearDern HvBatt_pwrMaxChrgShoLvl3FltDern HvBatt_pwrMaxChrgShoRaw HvBatt_pwrMaxChrgShoTDern HvBatt_pwrMaxDchaContnsDern HvBatt_pwrMaxDchaContnsDernPropInteg HvBatt_pwrMaxDchaContnsLimNearDern HvBatt_pwrMaxDchaContnsLvl3FltDern HvBatt_pwrMaxDchaContnsRaw HvBatt_pwrMaxDchaContnsTDern HvBatt_pwrMaxDchaShoDern HvBatt_pwrMaxDchaShoDernPropInteg HvBatt_pwrMaxDchaShoDif HvBatt_pwrMaxDchaShoLimNearDern HvBatt_pwrMaxDchaShoLvl3FltDern HvBatt_pwrMaxDchaShoRaw HvBatt_pwrMaxDchaShoTDern /end LOC_MEASUREMENT
 FUNCTION_VERSION "1400.5.0" /end FUNCTION
/begin FUNCTION HvBatt_MaiSwtVd "1400.2.0  High Voltage Battery Virtual Device Main Switch"
 /begin DEF_CHARACTERISTIC DDRC_DurDeb.HvBatt_tiFltModDebOk_C DDRC_DurDeb.HvBatt_tiFltModDebDef_C DDRC_DurDeb.HvBatt_tiIninToutDebOk_C DDRC_DurDeb.HvBatt_tiIninToutDebDef_C DDRC_DurDeb.HvBatt_tiMaiSwtClsngDebOk_C DDRC_DurDeb.HvBatt_tiMaiSwtClsngDebDef_C DDRC_DurDeb.HvBatt_tiMaiSwtFltDebOk_C DDRC_DurDeb.HvBatt_tiMaiSwtFltDebDef_C DDRC_DurDeb.HvBatt_tiMaiSwtOpenDebOk_C DDRC_DurDeb.HvBatt_tiMaiSwtOpenDebDef_C DDRC_DurDeb.HvBatt_tiMaiSwtOpngDebOk_C DDRC_DurDeb.HvBatt_tiMaiSwtOpngDebDef_C DDRC_DurDeb.HvBatt_tiMaiSwtWlddDebOk_C DDRC_DurDeb.HvBatt_tiMaiSwtWlddDebDef_C DDRC_DurDeb.HvBatt_tiOperModChrgPlausyDebOk_C DDRC_DurDeb.HvBatt_tiOperModChrgPlausyDebDef_C DFC_CtlMsk2.DFC_HvBattFltMod_C DFC_CtlMsk2.DFC_HvBattIninTout_C DFC_CtlMsk2.DFC_HvBattMaiSwtClsngFlt_C DFC_CtlMsk2.DFC_HvBattMaiSwtFlt_C DFC_CtlMsk2.DFC_HvBattMaiSwtOpen_C DFC_CtlMsk2.DFC_HvBattMaiSwtOpngFlt_C DFC_CtlMsk2.DFC_HvBattMaiSwtWldd_C DFC_CtlMsk2.DFC_HvBattOperModChrgPlausy_C DFC_DisblMsk2.DFC_HvBattFltMod_C DFC_DisblMsk2.DFC_HvBattIninTout_C DFC_DisblMsk2.DFC_HvBattMaiSwtClsngFlt_C DFC_DisblMsk2.DFC_HvBattMaiSwtFlt_C DFC_DisblMsk2.DFC_HvBattMaiSwtOpen_C DFC_DisblMsk2.DFC_HvBattMaiSwtOpngFlt_C DFC_DisblMsk2.DFC_HvBattMaiSwtWldd_C DFC_DisblMsk2.DFC_HvBattOperModChrgPlausy_C HvBatt_maskHvbCntctSq_C HvBatt_maskHvbFltSq_C HvBatt_maskHvbModSq_C HvBatt_stOperModChrgSeln_T HvBatt_stPlausySwtSeln_C /end DEF_CHARACTERISTIC
 /begin IN_MEASUREMENT ChrgMod_stMod Com_stHvbCntct Com_stHvbCntct_Sq Com_stHvbFlt Com_stHvbFlt_Sq Com_stHvbMod Com_stHvbMod_Sq Eem_flgSetMaiSwtHvBattClsd VehCoorn_st /end IN_MEASUREMENT
 /begin OUT_MEASUREMENT DDRC_St.DFC_HvBattFltMod DDRC_St.DFC_HvBattIninTout DDRC_St.DFC_HvBattMaiSwtClsngFlt DDRC_St.DFC_HvBattMaiSwtFlt DDRC_St.DFC_HvBattMaiSwtOpen DDRC_St.DFC_HvBattMaiSwtOpngFlt DDRC_St.DFC_HvBattMaiSwtWldd DDRC_St.DFC_HvBattOperModChrgPlausy DFC_st.DFC_HvBattFltMod DFC_st.DFC_HvBattIninTout DFC_st.DFC_HvBattMaiSwtClsngFlt DFC_st.DFC_HvBattMaiSwtFlt DFC_st.DFC_HvBattMaiSwtOpen DFC_st.DFC_HvBattMaiSwtOpngFlt DFC_st.DFC_HvBattMaiSwtWldd DFC_st.DFC_HvBattOperModChrgPlausy DINH_nrActvInhReas.FId_HvBattMaiSwtDiagEna DINH_stFId.FId_HvBattMaiSwtDiagEna HvBatt_flgHvActvnEnad HvBatt_stMaiSwtAct HvBatt_stOperModDes /end OUT_MEASUREMENT
 /begin LOC_MEASUREMENT HvBatt_stChrgMod /end LOC_MEASUREMENT
 FUNCTION_VERSION "1400.2.0" /end FUNCTION
/begin FUNCTION HvBatt_ThermVd "2.2.0     Virtual Driver of High Voltage Battery Thermal Functions" /begin IN_MEASUREMENT Com_tHvbAct Com_tHvbAct_Sq /end IN_MEASUREMENT /begin OUT_MEASUREMENT HvBatt_tActMeasd HvBatt_tActMeasd_Sq /end OUT_MEASUREMENT FUNCTION_VERSION "2.2.0" /end FUNCTION
/begin FUNCTION HvGrid_LimCalcn "1.1.1     Calculation of Electrical System Limits of High Voltage Grid"
 /begin DEF_CHARACTERISTIC DFC_CtlMsk2.DFC_HvGridSocMinLim_C DFC_DisblMsk2.DFC_HvGridSocMinLim_C HvGrid_ratSocLimDel_C HvGrid_ratSocLim_C HvGrid_uSysMax_C HvGrid_uSysMin_C /end DEF_CHARACTERISTIC
 /begin IN_MEASUREMENT HvBatt_ratSoc HvBatt_uMaxLim HvBatt_uMinLim /end IN_MEASUREMENT
 /begin OUT_MEASUREMENT DFC_st.DFC_HvGridSocMinLim HvGrid_uMaxElM HvGrid_uMinElM /end OUT_MEASUREMENT
 /begin LOC_MEASUREMENT HvGrid_stSocLimHLD HvGrid_stSocLimHLD_I /end LOC_MEASUREMENT
 FUNCTION_VERSION "1.1.1" /end FUNCTION
/begin FUNCTION HvGrid_LoadMngt "3.1.0     Calculation of Electrical Limit of High Voltage Loads" /begin DEF_CHARACTERISTIC HvGrid_pwrLoadMngMaxPred_T /end DEF_CHARACTERISTIC
 /begin IN_MEASUREMENT ACCmpr_pwrLoadMngtMaxPred CabAirHt_pwrLoadMngtMaxPred ChrgMod_pwrChrgnOut Dcdc_pwrLoadMngtMaxPred Eem_stHvLoc ElM_pwrElecPredTracMaxLo Emac_pwrAct01 HvBatt_pwrActMeasd HvBatt_pwrMaxChrgContns HvBatt_pwrMaxDchaContns HvGrid_pwrMaxLimOut VehCoorn_st /end IN_MEASUREMENT
 /begin OUT_MEASUREMENT HvGrid_pwrDesIn HvGrid_pwrMaxAc HvGrid_pwrMaxDcdc HvGrid_pwrMaxPtc HvGrid_pwrTotAvl /end OUT_MEASUREMENT
 FUNCTION_VERSION "3.1.0" /end FUNCTION
/begin FUNCTION HvGrid_LoadPrio "3.0.0     HV load priority" /begin DEF_CHARACTERISTIC HvGrid_idxChrg_T HvGrid_idxDrv_T HvGrid_idxHvReady_T /end DEF_CHARACTERISTIC /begin IN_MEASUREMENT HvGrid_pwrDesIn HvGrid_pwrTotAvl VehCoorn_st /end IN_MEASUREMENT /begin OUT_MEASUREMENT HvGrid_pwrMaxLimOut /end OUT_MEASUREMENT
 /begin LOC_MEASUREMENT HvGrid_idxList HvGrid_idxVehCoorn HvGrid_pwrAvl HvGrid_pwrDes HvGrid_pwrMaxLim /end LOC_MEASUREMENT
 FUNCTION_VERSION "3.0.0" /end FUNCTION
/begin FUNCTION HvGrid_Prdn "1400.0.0  Prediction of electrical (current, voltage or power) limits"
 /begin DEF_CHARACTERISTIC HvGrid_facPwrMaxGen_C HvGrid_maskpwrMaxChrgContnsSq_C HvGrid_maskpwrMaxChrgShoSq_C HvGrid_maskpwrMaxDchaContnsSq_C HvGrid_maskpwrMaxDchaShoSq_C HvGrid_pwrMaxGenNegBuf_C HvGrid_pwrMaxGenNegLim_C HvGrid_pwrMaxGenOffs_C HvGrid_pwrMaxMotPosLim_C /end DEF_CHARACTERISTIC
 /begin IN_MEASUREMENT HvBatt_pwrMaxChrgContns HvBatt_pwrMaxChrgContns_Sq HvBatt_pwrMaxChrgSho HvBatt_pwrMaxChrgSho_Sq HvBatt_pwrMaxDchaContns HvBatt_pwrMaxDchaContns_Sq HvBatt_pwrMaxDchaSho HvBatt_pwrMaxDchaSho_Sq HvGrid_pwrAcsyAct HvGrid_pwrAcsyCalc /end IN_MEASUREMENT
 /begin OUT_MEASUREMENT DINH_nrActvInhReas.FId_HvGridPwrMaxChrgContnsErr DINH_nrActvInhReas.FId_HvGridPwrMaxChrgShoErr DINH_nrActvInhReas.FId_HvGridPwrMaxDchaContnsErr DINH_nrActvInhReas.FId_HvGridPwrMaxDchaShoErr DINH_stFId.FId_HvGridPwrMaxChrgContnsErr DINH_stFId.FId_HvGridPwrMaxChrgShoErr DINH_stFId.FId_HvGridPwrMaxDchaContnsErr DINH_stFId.FId_HvGridPwrMaxDchaShoErr HVGrid_pwrMaxGenrTiLong HVGrid_pwrMaxGenrTiSho HVGrid_pwrMaxMotTiLong HVGrid_pwrMaxMotTiSho /end OUT_MEASUREMENT
 FUNCTION_VERSION "1400.0.0" /end FUNCTION
/begin FUNCTION HvGrid_PwrCalcn "1.7.0     Calculation of Power Consumption in High Voltage Grid"
 /begin DEF_CHARACTERISTIC HvGrid_flgAuxPwr01ActZr_C HvGrid_flgAuxPwr01Avl_C HvGrid_flgAuxPwr02ActZr_C HvGrid_flgAuxPwr02Avl_C HvGrid_flgAuxPwr03ActZr_C HvGrid_flgAuxPwr03Avl_C HvGrid_flgAuxPwr04ActZr_C HvGrid_flgAuxPwr04Avl_C HvGrid_flgDcdcPwrActZr_C HvGrid_flgDcdcPwrOk_C HvGrid_maskDcdcPwrHvActSq_C HvGrid_pwrAuxPwr01Nom_C HvGrid_pwrAuxPwr02Nom_C HvGrid_pwrAuxPwr03Nom_C HvGrid_pwrAuxPwr04Nom_C HvGrid_pwrDcdcPwrNom_C /end DEF_CHARACTERISTIC
 /begin IN_MEASUREMENT Dcdc_pwrHvAct Dcdc_pwrHvAct_Sq Eem_pwrHvAct01 Eem_pwrHvAct02 Eem_pwrHvAct03 Eem_pwrHvAct04 /end IN_MEASUREMENT
 /begin OUT_MEASUREMENT DINH_nrActvInhReas.FId_HvGridAuxPwr01 DINH_nrActvInhReas.FId_HvGridAuxPwr02 DINH_nrActvInhReas.FId_HvGridAuxPwr03 DINH_nrActvInhReas.FId_HvGridAuxPwr04 DINH_nrActvInhReas.FId_HvGridDcdcPwr DINH_stFId.FId_HvGridAuxPwr01 DINH_stFId.FId_HvGridAuxPwr02 DINH_stFId.FId_HvGridAuxPwr03 DINH_stFId.FId_HvGridAuxPwr04 DINH_stFId.FId_HvGridDcdcPwr HvGrid_pwrAcsyAct HvGrid_pwrAcsyCalc /end OUT_MEASUREMENT
 FUNCTION_VERSION "1.7.0" /end FUNCTION
/begin FUNCTION HvGrid_UPlausy "1.8.0_1.1.0Plausibility of Electric Values in High Voltage Grid"
 /begin DEF_CHARACTERISTIC DDRC_DurDeb.HvGrid_tiUMaxSdtyLimThdDebOk_C DDRC_DurDeb.HvGrid_tiUMaxSdtyLimThdDebDef_C DDRC_DurDeb.HvGrid_tiUMinSftyLimThdDebOk_C DDRC_DurDeb.HvGrid_tiUMinSftyLimThdDebDef_C DDRC_DurDeb.HvGrid_tiUPlausyThdDebOk_C DDRC_DurDeb.HvGrid_tiUPlausyThdDebDef_C DDRC_RatDeb.HvGrid_tiUMaxSdtyLimThdUDRat_C DDRC_RatDeb.HvGrid_tiUMinSftyLimThdUDRat_C DDRC_RatDeb.HvGrid_tiUPlausyThdUDRat_C DFC_CtlMsk2.DFC_HvGridUMaxSftyLim_C DFC_CtlMsk2.DFC_HvGridUMinSftyLim_C DFC_CtlMsk2.DFC_HvGridUPlausy_C DFC_DisblMsk2.DFC_HvGridUMaxSftyLim_C DFC_DisblMsk2.DFC_HvGridUMinSftyLim_C DFC_DisblMsk2.DFC_HvGridUPlausy_C HvGrid_maskComEmacUDcLink01Sq_C HvGrid_maskComStHvbCntctSq_C HvGrid_maskDcdcUHvActSq_C HvGrid_maskHvBattUActMeasdSq_C HvGrid_uPlausyThd_C /end DEF_CHARACTERISTIC
 /begin IN_MEASUREMENT ComEmac_uDcLnk01_Sq Com_stHvbCntct_Sq Dcdc_uHvAct Dcdc_uHvAct_Sq ElSS_uHvActMeasd01 ElSS_uHvActMeasd02 ElSS_uHvActMeasd03 ElSS_uHvActMeasd04 Emac_uDcLnk01 HvBatt_stMaiSwtAct HvBatt_uActMeasd HvBatt_uActMeasd_Sq HvGrid_uMaxElM HvGrid_uMinElM /end IN_MEASUREMENT
 /begin OUT_MEASUREMENT DDRC_St.DFC_HvGridUMaxSftyLim DDRC_St.DFC_HvGridUMinSftyLim DDRC_St.DFC_HvGridUPlausy DFC_st.DFC_HvGridUMaxSftyLim DFC_st.DFC_HvGridUMinSftyLim DFC_st.DFC_HvGridUPlausy DINH_nrActvInhReas.FId_HvGridDcdcUSftyErr DINH_nrActvInhReas.FId_HvGridElM01USftyErr DINH_nrActvInhReas.FId_HvGridHvBattSftyLimErr DINH_nrActvInhReas.FId_HvGridMaiSwtErr DINH_stFId.FId_HvGridDcdcUSftyErr DINH_stFId.FId_HvGridElM01USftyErr DINH_stFId.FId_HvGridHvBattSftyLimErr DINH_stFId.FId_HvGridMaiSwtErr /end OUT_MEASUREMENT
 FUNCTION_VERSION "1.8.0_1.1.0" /end FUNCTION
/begin FUNCTION HWSIG "15.0.0_VC1CP091_STLA_N_B010I1Hardware Signals" /begin OUT_MEASUREMENT B_rcdHW_msg B_rcd_msg /end OUT_MEASUREMENT /begin LOC_MEASUREMENT filteringCtr20ms_tmp /end LOC_MEASUREMENT FUNCTION_VERSION "15.0.0_VC1CP091_STLA_N_B010I1" /end FUNCTION
/begin FUNCTION I15031Extd_srv1 "30000.16.0Request current powertrain diagnostic data extended" FUNCTION_VERSION "30000.16.0" /end FUNCTION
/begin FUNCTION I15031Extd_srv2 "30000.12.0Request powertrain freeze frame data extended" FUNCTION_VERSION "30000.12.0" /end FUNCTION
/begin FUNCTION I15031Extd_srv37 "30000.7.0 Request of emission-relevant Diagnostic Trouble Codes from currentcompleted driving cycles extended" FUNCTION_VERSION "30000.7.0" /end FUNCTION
/begin FUNCTION I15031Extd_srv4 "30000.7.0 Clear and reset emission-related diagnostic information extended" /begin DEF_CHARACTERISTIC I15031_nMaxSrv4_C /end DEF_CHARACTERISTIC /begin IN_MEASUREMENT Epm_nEng /end IN_MEASUREMENT FUNCTION_VERSION "30000.7.0" /end FUNCTION
/begin FUNCTION I15031Extd_srv9 "30000.30.0Request vehicle informations extended"
 /begin DEF_CHARACTERISTIC I15031_srv9PIDTable.PID0_C I15031_srv9PIDTable.PID2_C I15031_srv9PIDTable.PID4_C I15031_srv9PIDTable.PID6_C I15031_srv9PIDTable.PIDA_C I15031_srv9PIDTable.PIDF_C /end DEF_CHARACTERISTIC
 /begin IN_MEASUREMENT T15_st /end IN_MEASUREMENT
 /begin OUT_MEASUREMENT I15031_ITIDSuppSrv9 I15031_srv9_stCVNRecalc I15031_srv9_ValidCVN /end OUT_MEASUREMENT
 /begin LOC_MEASUREMENT i15031_srv9_CVN_Calc_ui /end LOC_MEASUREMENT
 FUNCTION_VERSION "30000.30.0" /end FUNCTION
/begin FUNCTION I15031_srv1 "30000.44.0Request current powertrain diagnostic data"
 /begin DEF_CHARACTERISTIC I15031_PID13_C I15031_PID1C_C I15031_PID1D_C I15031_PID4FA_C I15031_PID4FB_C I15031_PID4FC_C I15031_PID4FD_C I15031_PID50A_C I15031_PID5F_C I15031_PID65A_C I15031_PID66A_C I15031_PID67A_C I15031_PID68A_C I15031_PID69A_C I15031_PID6AA_C I15031_PID6BA_C I15031_PID6CA_C I15031_PID6DA_C I15031_PID6EA_C I15031_PID6FA_C I15031_PID70A_C I15031_PID71A_C I15031_PID72A_C I15031_PID73A_C I15031_PID74A_C I15031_PID75A_C I15031_PID76A_C I15031_PID77A_C I15031_PID78A_C I15031_PID79A_C I15031_PID7AA_C I15031_PID7BA_C I15031_PID7CA_C I15031_PID7FA_C I15031_PID81A_C I15031_PID82A_C I15031_PID83A_C I15031_PID85A_C I15031_PID86A_C I15031_PID87A_C I15031_PID89A_C I15031_PID8AA_C I15031_PID8BA_C I15031_PID8CA_C I15031_PID8FA_C I15031_PID92A_C I15031_PID93A_C I15031_PID94A_C I15031_PID97A_C I15031_PID98A_C I15031_PID99A_C I15031_PID9AA_C I15031_PID9BA_C I15031_PID9CA_C I15031_PID9FA_C I15031_PIDA1A_C I15031_PIDA3A_C I15031_PIDA4A_C I15031_PIDA5A_C I15031_PIDA7A_C I15031_PIDA8A_C I15031_PIDA9A_C I15031_PIDACA_C I15031_stRfrshCal_C /end DEF_CHARACTERISTIC
 /begin OUT_MEASUREMENT I15031_FILLSIG1 I15031_FILLSIG2 I15031_FILLSIG4 I15031_PID13 I15031_PID1C I15031_PID1D I15031_PID4FA I15031_PID4FB I15031_PID4FC I15031_PID4FD I15031_PID50A I15031_PID50B I15031_PID50C I15031_PID50D I15031_PID5F I15031_PID65A I15031_PID66A I15031_PID67A I15031_PID68A I15031_PID69A I15031_PID6AA I15031_PID6BA I15031_PID6CA I15031_PID6DA I15031_PID6EA I15031_PID6FA I15031_PID70A I15031_PID71A I15031_PID72A I15031_PID73A I15031_PID74A I15031_PID75A I15031_PID76A I15031_PID77A I15031_PID78A I15031_PID79A I15031_PID7AA I15031_PID7BA I15031_PID7CA I15031_PID7FA I15031_PID81A I15031_PID82A I15031_PID83A I15031_PID85A I15031_PID86A I15031_PID87A I15031_PID89A I15031_PID8AA I15031_PID8BA I15031_PID8CA I15031_PID8FA I15031_PID92A I15031_PID93A I15031_PID94A I15031_PID97A I15031_PID98A I15031_PID99A I15031_PID9AA I15031_PID9BA I15031_PID9CA I15031_PID9FA I15031_PIDA1A I15031_PIDA3A I15031_PIDA4A I15031_PIDA5A I15031_PIDA7A I15031_PIDA8A I15031_PIDA9A I15031_PIDACA I15031_PIDSuppSrv1 I15031_Srv12_Ext_DisablPIDSupp /end OUT_MEASUREMENT
 /begin LOC_MEASUREMENT I15031_PIDSuppSrv2 /end LOC_MEASUREMENT
 FUNCTION_VERSION "30000.44.0" /end FUNCTION
/begin FUNCTION I15031_srv2 "30000.6.0 Request powertrain freeze frame data" FUNCTION_VERSION "30000.6.0" /end FUNCTION
/begin FUNCTION I15031_srv37 "30000.9.0 Request of emission-relevant DTC's from current/completed driving cycle(s)" FUNCTION_VERSION "30000.9.0" /end FUNCTION
/begin FUNCTION I15031_srv4 "30000.13.0Clear and reset emission-related diagnostic information" FUNCTION_VERSION "30000.13.0" /end FUNCTION
/begin FUNCTION I15031_srv6 "30000.10.0Request on-board monitoring test results for specific monitored systems" FUNCTION_VERSION "30000.10.0" /end FUNCTION
/begin FUNCTION I15031_Srv8 "3.0.0     Request control of on-board system, test or component" FUNCTION_VERSION "3.0.0" /end FUNCTION
/begin FUNCTION I15031_srv9 "30000.32.0Request vehicle informations" FUNCTION_VERSION "30000.32.0" /end FUNCTION
/begin FUNCTION I15031_Std "30000.28.0Base subservices for emission relevant diagnosis" /begin DEF_CHARACTERISTIC I15031_stSrvSuppMode_CA /end DEF_CHARACTERISTIC /begin IN_MEASUREMENT I15031_PIDSuppSrv1 SyC_stSub T15_flgOn T15_st /end IN_MEASUREMENT FUNCTION_VERSION "30000.28.0" /end FUNCTION
/begin FUNCTION Inm_CanCo "850.1.0   enables or disables CAN communication and the monitoring of the network"
 /begin DEF_CHARACTERISTIC Com_stCANxComReqByps_C Com_tiDlyNetOn_C Com_tiRstrtDlyDiagMuxCAN_C Com_tiStrtDlyDiagMuxCAN_C GMP_actif_C Inm_EngRestrtOn_C Inm_TmrSwtSel_C Nm_uBatMaxOff_C Nm_uBatMaxOn_C Nm_uBatMinOff_C Nm_uBatMinOn_C /end DEF_CHARACTERISTIC
 /begin IN_MEASUREMENT BattU_u Com_stCAN1ComReq Com_stCAN3ComReq CoPtFH_stPwt rba_SyC_bWkuMain /end IN_MEASUREMENT
 /begin OUT_MEASUREMENT ComM_stComModeCANHSN1 ComM_stComModeCANHSN3 ComM_stComModeCANHSN4 ComM_stComModeCANXCP ComM_stComModeLIN Com_bDiagCANHSN1 Com_bDiagCANHSN3 Com_bDiagMuxCAN Inm_bFullcomReqHSN1 Inm_bFullcomReqHSN3 Nm_bHSN1BusOn Nm_bHSN3BusOn Nm_bNetOn /end OUT_MEASUREMENT
 /begin LOC_MEASUREMENT Inm_stNm Nm_bStBatt /end LOC_MEASUREMENT
 FUNCTION_VERSION "850.1.0" /end FUNCTION
/begin FUNCTION Inm_CanNm "850.3.0   Handles the nodes and busoff monitoring"
 /begin DEF_CHARACTERISTIC DDRC_DurDeb.Inm_numHSN1MuteDebOk_C DDRC_DurDeb.Inm_numHSN1MuteDebDef_C DDRC_DurDeb.Inm_numHSN3MuteDebOk_C DDRC_DurDeb.Inm_numHSN3MuteDebDef_C DDRC_RatDeb.Inm_numHSN1MuteUDRat_C DDRC_RatDeb.Inm_numHSN3MuteUDRat_C DFC_CtlMsk2.DFC_ComHSN1CANMute_C DFC_CtlMsk2.DFC_ComHSN3CANMute_C DFC_CtlMsk2.DFC_ComHSN1BusOff_C DFC_CtlMsk2.DFC_ComHSN3BusOff_C DFC_DisblMsk2.DFC_ComHSN1CANMute_C DFC_DisblMsk2.DFC_ComHSN3CANMute_C DFC_DisblMsk2.DFC_ComHSN1BusOff_C DFC_DisblMsk2.DFC_ComHSN3BusOff_C Inm_XTransMax_C /end DEF_CHARACTERISTIC
 /begin IN_MEASUREMENT Com_bDiagCANHSN1 Com_bDiagCANHSN3 /end IN_MEASUREMENT
 /begin OUT_MEASUREMENT CanSM_HSN1BOffCntr CanSM_HSN3BOffCntr DDRC_St.DFC_ComHSN1CANMute DDRC_St.DFC_ComHSN3CANMute DFC_st.DFC_ComHSN1CANMute DFC_st.DFC_ComHSN3CANMute DFC_st.DFC_ComHSN1BusOff DFC_st.DFC_ComHSN3BusOff old_CanSM_HSN1BOffCntr old_CanSM_HSN3BOffCntr /end OUT_MEASUREMENT
 /begin LOC_MEASUREMENT debRepCheck Inm_221ToutMsgCntr Inm_241ToutMsgCntr /end LOC_MEASUREMENT
 FUNCTION_VERSION "850.3.0" /end FUNCTION
/begin FUNCTION Inm_LinNM "850.1.0   LIN Network Management"
 /begin DEF_CHARACTERISTIC DDRC_DurDeb.Com_tiLINBusBlkDebOk_C DDRC_DurDeb.Com_tiLINBusBlkDebDef_C DFC_CtlMsk2.DFC_InmLINBusBlk_C DFC_CtlMsk2.DFC_InmLINNodeHVACPanelAbsnt_C DFC_DisblMsk2.DFC_InmLINBusBlk_C DFC_DisblMsk2.DFC_InmLINNodeHVACPanelAbsnt_C Inm_ctHVACPanelAbsntThres_C /end DEF_CHARACTERISTIC
 /begin IN_MEASUREMENT Com_bDiagMuxCAN Inm_stLINStM /end IN_MEASUREMENT
 /begin OUT_MEASUREMENT Com_LinAllTxTO DDRC_St.DFC_InmLINBusBlk DFC_st.DFC_InmLINBusBlk DFC_st.DFC_InmLINNodeHVACPanelAbsnt Inm_ctHVACPanelAbsnt_mp Lin_bDgoLINBlock LIN_bDgoLostHVACPanel Lin_bMonRunLINBlock LIN_bMonRunLostHVACPanel /end OUT_MEASUREMENT
 /begin LOC_MEASUREMENT ctHVACPanelAbsnt Inm_25TxTout LinNm_debRepCheck /end LOC_MEASUREMENT
 FUNCTION_VERSION "850.1.0" /end FUNCTION
/begin COMPU_METHOD B_TRUE "" TAB_VERB "%6.3" "" COMPU_TAB_REF B_TRUE /end COMPU_METHOD
/begin COMPU_VTAB B_TRUE "" TAB_VERB 2 0 "FALSE" 1 "TRUE" /end COMPU_VTAB
/begin COMPU_METHOD C126_stEng_COMPU "" TAB_VERB "%6.3" "" COMPU_TAB_REF C126_stEng_COMPU /end COMPU_METHOD
/begin COMPU_VTAB C126_stEng_COMPU "" TAB_VERB 15 1 "Off or Stalled" 2 "Preparation" 3 "Driven Start" 4 "Autonomous Start" 5 "Engine Running" 6 "Stop" 7 "Driven Restart" 8 "Autonomous Restart" 9 "Reserved9" 10 "Reserved10" 11 "Reserved11" 12 "Reserved12" 13 "Reserved13" 14 "Reserved14" 15 "Reserved15" /end COMPU_VTAB
/begin COMPU_METHOD CoPtFH_stPwt_VERB "" TAB_VERB "%6.3" "" COMPU_TAB_REF CoPtFH_stPwt_VERB /end COMPU_METHOD
/begin COMPU_VTAB CoPtFH_stPwt_VERB "" TAB_VERB 16 0 "GMP inactif" 1 "Reserve" 2 "Reserve1" 3 "Reserve2" 4 "Activation GMP" 5 "Reserve3" 6 "Reserve4" 7 "Reserve5" 8 "GMP actif" 9 "Reserve6" 10 "Desactivation_GMP" 11 "Reserve7" 12 "Maintien_post_desactivation_GMP" 13 "Reserve8" 14 "GMP_au_repos" 15 "Reserve9" /end COMPU_VTAB
/begin COMPU_METHOD Curr_A_q0p03125_COMPU "" RAT_FUNC "%6.4" "A" COEFFS 0 32 0 0 0 1 /end COMPU_METHOD
/begin COMPU_METHOD DDRCTime_ms "" RAT_FUNC "%6.1" "ms" COEFFS 0 1 0 0 0 10 /end COMPU_METHOD
/begin COMPU_METHOD DDRC_Ratio "" TAB_VERB "%6.3" "-" COMPU_TAB_REF DDRC_Ratio /end COMPU_METHOD
/begin COMPU_VTAB DDRC_Ratio "" TAB_VERB 4 1 "Ratio1" 2 "Ratio2" 3 "Ratio3" 4 "Ratio4" /end COMPU_VTAB
/begin COMPU_METHOD dez "" RAT_FUNC "%6.2" "" COEFFS 0 1 0 0 0 1 /end COMPU_METHOD
/begin COMPU_METHOD DFC_OneToOne "" RAT_FUNC "%6.2" "-" COEFFS 0 1 0 0 0 1 /end COMPU_METHOD
/begin COMPU_METHOD DFES_OneToOne "" RAT_FUNC "%6.2" "-" COEFFS 0 1 0 0 0 1 /end COMPU_METHOD
/begin COMPU_METHOD DINH_ct_Compu "" RAT_FUNC "%6.0" "" COEFFS 0 -1 4096 0 0 1 /end COMPU_METHOD
/begin COMPU_METHOD EngN "" RAT_FUNC "%6.3" "rpm" COEFFS 0 2 0 0 0 1 /end COMPU_METHOD
/begin COMPU_METHOD Fact "" RAT_FUNC "%6.5" "-" COEFFS 0 8192 0 0 0 1 /end COMPU_METHOD
/begin COMPU_METHOD Fact100 "" RAT_FUNC "%6.4" "-" COEFFS 0 100 0 0 0 1 /end COMPU_METHOD
/begin COMPU_METHOD I15031_PID1CVerb "" TAB_VERB "%6.3" "-" COMPU_TAB_REF I15031_PID1CVerb /end COMPU_METHOD
/begin COMPU_VTAB I15031_PID1CVerb "" TAB_VERB 40 1 "OBD II" 2 "OBD" 3 "OBD and OBD II" 4 "OBD I" 5 "No OBD" 6 "EOBD" 7 "EOBD and OBD II" 8 "EOBD and OBD" 9 "EOBD, OBD and OBD II" 10 "JOBD" 11 "JOBD and OBD II" 12 "JOBD and EOBD" 13 "JOBD, EOBD and OBD II" 14 "OBD, EOBD and KOBD" 15 "OBD, OBD II, EOBD and KOBD" 17 "EMD" 18 "EMD+" 19 "HD OBD-C" 20 "HD OBD" 21 "WWH OBD" 23 "HD EOBD-I" 24 "HD EOBD-I N" 25 "HD EOBD-II" 26 "HD EOBD-II N" 28 "OBDBr-1" 29 "OBDBr-2" 30 "KOBD" 31 "IOBD I" 32 "IOBD II" 33 "HD EOBD-VI" 34 "OBD, OBD II and HD OBD" 35 "OBDBr-3" 36 "MC EOBD-I" 37 "MC EOBD-II" 38 "MC COBD-I" 39 "MC TOBD-I" 40 "MC JOBD-I" 41 "CN-OBD-6" 42 "OBDBr-D" 43 "CN-HDOBD-VI" /end COMPU_VTAB
/begin COMPU_METHOD I15031_PID5FVerb "" TAB_VERB "%6.3" "-" COMPU_TAB_REF I15031_PID5FVerb /end COMPU_METHOD
/begin COMPU_VTAB I15031_PID5FVerb "" TAB_VERB 4 14 "EURO IV B1" 15 "EURO V B2" 16 "EURO C" 17 "EURO VI" /end COMPU_VTAB
/begin COMPU_METHOD I15031_srv9_CVN_CalcVerb "" TAB_VERB "%2.1" "-" COMPU_TAB_REF I15031_srv9_CVN_CalcVerb /end COMPU_METHOD
/begin COMPU_VTAB I15031_srv9_CVN_CalcVerb "" TAB_VERB 7 0 "NOTAVAILABLE" 1 "CALC_START" 2 "CALC_BUSY" 3 "CALC_WRITE" 4 "CALC_READY" 5 "CALC_CLEAR" 6 "CALC_CLEARBUSY" /end COMPU_VTAB
/begin COMPU_METHOD Inm_SM_t_sm_VERB "" TAB_VERB "%6.3" "" COMPU_TAB_REF Inm_SM_t_sm_VERB /end COMPU_METHOD
/begin COMPU_VTAB Inm_SM_t_sm_VERB "" TAB_VERB 4 0 "Node_Off" 1 "Node_Init" 2 "Node_Waiting" 3 "Node_EngRun" /end COMPU_VTAB
/begin COMPU_METHOD Ki_pRail2Q_1 "" RAT_FUNC "%7.6" "mm^3/s^2/hPa" COEFFS 0 10737.41824 0 0 0 1 /end COMPU_METHOD
/begin COMPU_METHOD Ki_Temp2EGTFact "" RAT_FUNC "%8.7" "-" COEFFS 0 429496.7296 0 0 0 1 /end COMPU_METHOD
/begin COMPU_METHOD KLINE_SY_Compu "" TAB_VERB "%6.3" "" COMPU_TAB_REF KLINE_SY_Compu /end COMPU_METHOD
/begin COMPU_VTAB KLINE_SY_Compu "" TAB_VERB 2 0 "False" 1 "True" /end COMPU_VTAB
/begin COMPU_METHOD Kp "" RAT_FUNC "%7.6" "1/1" COEFFS 0 32768 0 0 0 1 /end COMPU_METHOD
/begin COMPU_METHOD Kp_1 "" RAT_FUNC "%6.4" "1/1" COEFFS 0 64 0 0 0 1 /end COMPU_METHOD
/begin COMPU_METHOD Kp_LmbdRec2InjMass_1 "" RAT_FUNC "%6.4" "mg/stroke" COEFFS 0 81.92 0 0 0 1 /end COMPU_METHOD
/begin COMPU_METHOD Kp_pRail2Q_1 "" RAT_FUNC "%7.6" "mm^3/s/hPa" COEFFS 0 81920 0 0 0 1 /end COMPU_METHOD
/begin COMPU_METHOD Kp_Temp2EGTFact "" RAT_FUNC "%7.6" "-" COEFFS 0 25600 0 0 0 1 /end COMPU_METHOD
/begin COMPU_METHOD L9779_SC_Compu "" TAB_VERB "%6.3" "" COMPU_TAB_REF L9779_SC_Compu /end COMPU_METHOD
/begin COMPU_VTAB L9779_SC_Compu "" TAB_VERB 2 0 "False" 1 "True" /end COMPU_VTAB
/begin COMPU_METHOD L9959_SC_Compu "" RAT_FUNC "%6.2" "" COEFFS 0 1 0 0 0 1 /end COMPU_METHOD
/begin COMPU_METHOD L9966_SC_Compu "" RAT_FUNC "%6.2" "" COEFFS 0 1 0 0 0 1 /end COMPU_METHOD
/begin COMPU_METHOD lambda "" RAT_FUNC "%6.5" "-" COEFFS 0 1000 0 0 0 1 /end COMPU_METHOD
/begin COMPU_METHOD lambdaRec "" RAT_FUNC "%7.6" "-" COEFFS 0 10000 0 0 0 1 /end COMPU_METHOD
/begin COMPU_METHOD lambdaRecVal "" RAT_FUNC "%6.5" "-" COEFFS 0 1000 0 0 0 1 /end COMPU_METHOD
/begin COMPU_METHOD Lambda_DiffQuot "" RAT_FUNC "%6.4" "1/s" COEFFS 0 20 0 0 0 1 /end COMPU_METHOD
/begin COMPU_METHOD LDCOM_SC_Compu "" TAB_VERB "%6.3" "" COMPU_TAB_REF LDCOM_SC_Compu /end COMPU_METHOD
/begin COMPU_VTAB LDCOM_SC_Compu "" TAB_VERB 2 0 "False" 1 "True" /end COMPU_VTAB
/begin COMPU_METHOD LengthCpp "" RAT_FUNC "%8.7" "m" COEFFS 0 100000 0 0 0 1 /end COMPU_METHOD
/begin COMPU_METHOD LengthKm "" RAT_FUNC "%6.1" "Km" COEFFS 0 0.05 0 0 0 1 /end COMPU_METHOD
/begin COMPU_METHOD LengthKm1 "" RAT_FUNC "%6.2" "Km" COEFFS 0 1 0 0 0 1 /end COMPU_METHOD
/begin COMPU_METHOD LengthMm "" RAT_FUNC "%6.2" "mm" COEFFS 0 1 0 0 0 1 /end COMPU_METHOD
/begin COMPU_METHOD Len_Km_q0p00001_COMPU "" RAT_FUNC "%8.7" "Km" COEFFS 0 100000 0 0 0 1 /end COMPU_METHOD
/begin COMPU_METHOD LINIPCORETYPE_SC_Compu "" TAB_VERB "%6.3" "" COMPU_TAB_REF LINIPCORETYPE_SC_Compu /end COMPU_METHOD
/begin COMPU_VTAB LINIPCORETYPE_SC_Compu "" TAB_VERB 2 0 "0" 1 "1" /end COMPU_VTAB
/begin COMPU_METHOD LIN_SY_Compu "" TAB_VERB "%6.3" "" COMPU_TAB_REF LIN_SY_Compu /end COMPU_METHOD
/begin COMPU_VTAB LIN_SY_Compu "" TAB_VERB 2 0 "False" 1 "True" /end COMPU_VTAB
/begin COMPU_METHOD LSM_SY_Compu "" TAB_VERB "%6.3" "" COMPU_TAB_REF LSM_SY_Compu /end COMPU_METHOD
/begin COMPU_VTAB LSM_SY_Compu "" TAB_VERB 2 0 "0" 1 "1" /end COMPU_VTAB
/begin COMPU_METHOD LSU_CT_SENSORS_SY_Compu "" TAB_VERB "%6.3" "" COMPU_TAB_REF LSU_CT_SENSORS_SY_Compu /end COMPU_METHOD
/begin COMPU_VTAB LSU_CT_SENSORS_SY_Compu "" TAB_VERB 5 0 "0" 1 "1" 2 "2" 3 "3" 4 "4" /end COMPU_VTAB
/begin COMPU_METHOD Mass2Temp_q0p000003 "" RAT_FUNC "%8.7" "Kg/K" COEFFS 0 333333.333333333 0 0 0 1 /end COMPU_METHOD
/begin COMPU_METHOD MassPerTimeq0p00001 "" RAT_FUNC "%8.7" "g/s" COEFFS 0 100000 0 0 0 1 /end COMPU_METHOD
/begin COMPU_METHOD MassPerTimeq0p001 "" RAT_FUNC "%6.5" "g/s" COEFFS 0 1000 0 0 0 1 /end COMPU_METHOD
/begin COMPU_METHOD Mass_q1 "" RAT_FUNC "%6.2" "g" COEFFS 0 1 0 0 0 1 /end COMPU_METHOD
/begin COMPU_METHOD MDG1CPUDEVICE_SC_Compu "" TAB_VERB "%6.3" "" COMPU_TAB_REF MDG1CPUDEVICE_SC_Compu /end COMPU_METHOD
/begin COMPU_VTAB MDG1CPUDEVICE_SC_Compu "" TAB_VERB 9 0 "None" 1 "Device1" 2 "Device2" 3 "Device3" 4 "Device4" 5 "Device5" 13 "Device3+" 14 "Device4+" 15 "Device5+" /end COMPU_VTAB
/begin COMPU_METHOD MDG1CPUSTEP_SC_Compu "" TAB_VERB "%6.3" "" COMPU_TAB_REF MDG1CPUSTEP_SC_Compu /end COMPU_METHOD
/begin COMPU_VTAB MDG1CPUSTEP_SC_Compu "" TAB_VERB 11 0 "None" 1 "1" 2 "2" 110 "110" 120 "120" 130 "130" 140 "140" 210 "210" 220 "220" 230 "230" 232 "232" /end COMPU_VTAB
/begin COMPU_METHOD MDG1CPUVENDOR_SC_Compu "" TAB_VERB "%6.3" "" COMPU_TAB_REF MDG1CPUVENDOR_SC_Compu /end COMPU_METHOD
/begin COMPU_VTAB MDG1CPUVENDOR_SC_Compu "" TAB_VERB 4 0 "None" 1 "IFX" 2 "JDP" 3 "ST" /end COMPU_VTAB
/begin COMPU_METHOD MDG1MSGCNCPT_SC_Compu "" TAB_VERB "%6.3" "" COMPU_TAB_REF MDG1MSGCNCPT_SC_Compu /end COMPU_METHOD
/begin COMPU_VTAB MDG1MSGCNCPT_SC_Compu "" TAB_VERB 2 0 "MSGCNCPT_DISABLED" 1 "MSGCNCPT_ENABLED" /end COMPU_VTAB
/begin COMPU_METHOD MEM_CENDIAGACTVD_SC_Compu "" TAB_VERB "%6.3" "" COMPU_TAB_REF MEM_CENDIAGACTVD_SC_Compu /end COMPU_METHOD
/begin COMPU_VTAB MEM_CENDIAGACTVD_SC_Compu "" TAB_VERB 2 0 "False" 1 "True" /end COMPU_VTAB
/begin COMPU_METHOD MEM_DIAGACTVDEXTD_SC_Compu "" TAB_VERB "%6.3" "" COMPU_TAB_REF MEM_DIAGACTVDEXTD_SC_Compu /end COMPU_METHOD
/begin COMPU_VTAB MEM_DIAGACTVDEXTD_SC_Compu "" TAB_VERB 2 0 "False" 1 "True" /end COMPU_VTAB
/begin COMPU_METHOD MgPerHubSec "" RAT_FUNC "%6.3" "mg/(Hub*sec)" COEFFS 0 10 0 0 0 1 /end COMPU_METHOD
/begin COMPU_METHOD MILLMP_ENGSTRTWITH2SECCDN_SC_Compu "" TAB_VERB "%6.3" "" COMPU_TAB_REF MILLMP_ENGSTRTWITH2SECCDN_SC_Compu /end COMPU_METHOD
/begin COMPU_VTAB MILLMP_ENGSTRTWITH2SECCDN_SC_Compu "" TAB_VERB 2 0 "False" 1 "True" /end COMPU_VTAB
/begin COMPU_METHOD MILLMP_PWRSTG_SY_Compu "" TAB_VERB "%6.3" "" COMPU_TAB_REF MILLMP_PWRSTG_SY_Compu /end COMPU_METHOD
/begin COMPU_VTAB MILLMP_PWRSTG_SY_Compu "" TAB_VERB 2 0 "False" 1 "True" /end COMPU_VTAB
/begin COMPU_METHOD MILLMP_SUPRT_ATS_SY_Compu "" TAB_VERB "%6.3" "" COMPU_TAB_REF MILLMP_SUPRT_ATS_SY_Compu /end COMPU_METHOD
/begin COMPU_VTAB MILLMP_SUPRT_ATS_SY_Compu "" TAB_VERB 2 0 "False" 1 "True" /end COMPU_VTAB
/begin COMPU_METHOD MOCCPU_IT_SY_Compu "" TAB_VERB "%6.3" "" COMPU_TAB_REF MOCCPU_IT_SY_Compu /end COMPU_METHOD
/begin COMPU_VTAB MOCCPU_IT_SY_Compu "" TAB_VERB 7 0 "CHISTE" 1 "FIT" 2 "OTCG" 3 "CHISTEundOTCG" 4 "FITundOTCG" 5 "Lock-Step" 6 "HW_CMPBL_SOLN" /end COMPU_VTAB
/begin COMPU_METHOD MOCFC_ADCTESTADDLBNK_SC_Compu "" TAB_VERB "%6.3" "" COMPU_TAB_REF MOCFC_ADCTESTADDLBNK_SC_Compu /end COMPU_METHOD
/begin COMPU_VTAB MOCFC_ADCTESTADDLBNK_SC_Compu "" TAB_VERB 2 0 "One_ADC_Bank" 1 "Two_ADC_Banks" /end COMPU_VTAB
/begin COMPU_METHOD MOCFC_GTMCLKMON_SC_Compu "" TAB_VERB "%6.3" "" COMPU_TAB_REF MOCFC_GTMCLKMON_SC_Compu /end COMPU_METHOD
/begin COMPU_VTAB MOCFC_GTMCLKMON_SC_Compu "" TAB_VERB 2 0 "False" 1 "True" /end COMPU_VTAB
/begin COMPU_METHOD MOCFC_GTMCONNTYP_SC_Compu "" TAB_VERB "%6.3" "" COMPU_TAB_REF MOCFC_GTMCONNTYP_SC_Compu /end COMPU_METHOD
/begin COMPU_VTAB MOCFC_GTMCONNTYP_SC_Compu "" TAB_VERB 2 0 "PORT" 1 "AUX_IN" /end COMPU_VTAB
/begin COMPU_METHOD MOCFC_NRCYCBLK_SC_Compu "" RAT_FUNC "%6.2" "" COEFFS 0 1 0 0 0 1 /end COMPU_METHOD
/begin COMPU_METHOD ModeType_VERB "" TAB_VERB "%6.3" "" COMPU_TAB_REF ModeType_VERB /end COMPU_METHOD
/begin COMPU_VTAB ModeType_VERB "" TAB_VERB 3 0 "No_COM" 1 "Silent" 2 "FULL_COM" /end COMPU_VTAB
/begin COMPU_METHOD OneToOne "" RAT_FUNC "%6.2" "-" COEFFS 0 1 0 0 0 1 /end COMPU_METHOD
/begin COMPU_METHOD OneToTenCarb "" RAT_FUNC "%6.1" "-" COEFFS 0 0.1 0 0 0 1 /end COMPU_METHOD
/begin COMPU_METHOD Prc "" RAT_FUNC "%6.4" "%" COEFFS 0 81.92 0 0 0 1 /end COMPU_METHOD
/begin COMPU_METHOD q0p001525_W_DIV_s "" RAT_FUNC "%6.4" "W/s" COEFFS 0 65536 0 0 0 100 /end COMPU_METHOD
/begin COMPU_METHOD q16 "" RAT_FUNC "%6.1" "-" COEFFS 0 1 0 0 0 16 /end COMPU_METHOD
/begin COMPU_METHOD q1_kOhm "" RAT_FUNC "%6.2" "kOhm" COEFFS 0 1 0 0 0 1 /end COMPU_METHOD
/begin COMPU_METHOD q64 "" RAT_FUNC "%6.1" "-" COEFFS 0 1 0 0 0 64 /end COMPU_METHOD
/begin COMPU_METHOD q8 "" RAT_FUNC "%6.2" "-" COEFFS 0 1 0 0 0 8 /end COMPU_METHOD
/begin COMPU_METHOD RBPtCel_fac_1p0_1 "" RAT_FUNC "%6.2" "-" COEFFS 0 1 0 0 0 1 /end COMPU_METHOD
/begin COMPU_METHOD RBPtCel_frq_1p0_1 "" RAT_FUNC "%6.2" "1/s" COEFFS 0 1 0 0 0 1 /end COMPU_METHOD
/begin COMPU_METHOD RBPtCel_Perc_1p0_1 "" RAT_FUNC "%6.2" "%" COEFFS 0 1 0 0 0 1 /end COMPU_METHOD
/begin COMPU_METHOD RBPtCel_pwr_1p0_4 "" RAT_FUNC "%6.2" "Ws" COEFFS 0 1 0 0 0 1 /end COMPU_METHOD
/begin COMPU_METHOD RBPtCel_pwr_25p0_1 "" RAT_FUNC "%6.1" "W" COEFFS 0 1 0 0 0 25 /end COMPU_METHOD
/begin COMPU_METHOD RBPtCel_ti_1p0_2 "" RAT_FUNC "%6.2" "s" COEFFS 0 1 0 0 0 1 /end COMPU_METHOD
/begin COMPU_METHOD RBPtCel_t_1p0_3 "" RAT_FUNC "%6.2" "Deg C" COEFFS 0 1 0 0 0 1 /end COMPU_METHOD
/begin COMPU_METHOD SigQly_COMPU_VERB "" TAB_VERB "%6.3" "" COMPU_TAB_REF SigQly_COMPU_VERB /end COMPU_METHOD
/begin COMPU_VTAB SigQly_COMPU_VERB "" TAB_VERB 16 0 "SIGQLY_NOTCALC" 1 "SIGQLY_INIT" 2 "SIGQLY_OK" 3 "SIGQLY_MODEL" 4 "SIGQLY_REPLACEMENT" 5 "SIGQLY_FROZEN" 6 "SIGQLY_INVALID" 7 "SIGQLY_RESERVED_7" 8 "SIGQLY_RESERVED_8" 9 "SIGQLY_RESERVED_9" 10 "SIGQLY_RESERVED_10" 11 "SIGQLY_RESERVED_11" 12 "SIGQLY_RESERVED_12" 13 "SIGQLY_RESERVED_13" 14 "SIGQLY_RESERVED_14" 15 "SIGQLY_RESERVED_15" /end COMPU_VTAB
/begin COMPU_METHOD Temp_Cels "" RAT_FUNC "%6.1" "deg C" COEFFS 0 10 2731.4 0 0 1 /end COMPU_METHOD
/begin COMPU_METHOD TimeDelay_s "" RAT_FUNC "%6.1" "s" COEFFS 0 0 1 0 0.00023283064365387 0 /end COMPU_METHOD
/begin COMPU_METHOD Time_s "" RAT_FUNC "%6.4" "s" COEFFS 0 100 0 0 0 1 /end COMPU_METHOD
/begin COMPU_METHOD t_q0p005 "" RAT_FUNC "%6.4" "s" COEFFS 0 1000 0 0 0 5 /end COMPU_METHOD
/begin COMPU_METHOD Vel "" RAT_FUNC "%6.4" "km/h" COEFFS 0 100 0 0 0 1 /end COMPU_METHOD
/begin COMPU_METHOD Volt_Batt "" RAT_FUNC "%6.1" "mV" COEFFS 0 0.05 0 0 0 1 /end COMPU_METHOD
/begin COMPU_METHOD Volt_V_q0p03125_COMPU "" RAT_FUNC "%6.4" "V" COEFFS 0 32 0 0 0 1 /end COMPU_METHOD
/begin RECORD_LAYOUT RB_Curve_R32_S16_sao NO_AXIS_PTS_X 1 ULONG AXIS_PTS_X 2 FLOAT32_IEEE INDEX_INCR DIRECT FNC_VALUES 3 SWORD COLUMN_DIR DIRECT STATIC_ADDRESS_OFFSETS /end RECORD_LAYOUT
/begin RECORD_LAYOUT RB_Curve_S16_R32_sao NO_AXIS_PTS_X 1 SWORD AXIS_PTS_X 2 SWORD INDEX_INCR DIRECT FNC_VALUES 3 FLOAT32_IEEE COLUMN_DIR DIRECT STATIC_ADDRESS_OFFSETS /end RECORD_LAYOUT
/begin RECORD_LAYOUT RB_Curve_S16_S16 NO_AXIS_PTS_X 1 SWORD AXIS_PTS_X 2 SWORD INDEX_INCR DIRECT FNC_VALUES 3 SWORD COLUMN_DIR DIRECT /end RECORD_LAYOUT
/begin RECORD_LAYOUT RB_Curve_S16_S32_sao NO_AXIS_PTS_X 1 SWORD AXIS_PTS_X 2 SWORD INDEX_INCR DIRECT FNC_VALUES 3 SLONG COLUMN_DIR DIRECT STATIC_ADDRESS_OFFSETS /end RECORD_LAYOUT
/begin RECORD_LAYOUT RB_Curve_U8_U8 NO_AXIS_PTS_X 1 UBYTE AXIS_PTS_X 2 UBYTE INDEX_INCR DIRECT FNC_VALUES 3 UBYTE COLUMN_DIR DIRECT /end RECORD_LAYOUT
/begin RECORD_LAYOUT RB_Map_S16S16_S16 NO_AXIS_PTS_X 1 SWORD NO_AXIS_PTS_Y 2 SWORD AXIS_PTS_X 3 SWORD INDEX_INCR DIRECT AXIS_PTS_Y 4 SWORD INDEX_INCR DIRECT FNC_VALUES 5 SWORD COLUMN_DIR DIRECT /end RECORD_LAYOUT
/begin RECORD_LAYOUT RB_Val_Wboolean FNC_VALUES 1 UBYTE COLUMN_DIR DIRECT /end RECORD_LAYOUT
/begin RECORD_LAYOUT RB_Val_Wr32 FNC_VALUES 1 FLOAT32_IEEE COLUMN_DIR DIRECT /end RECORD_LAYOUT
/begin RECORD_LAYOUT RB_Val_Ws16 FNC_VALUES 1 SWORD COLUMN_DIR DIRECT /end RECORD_LAYOUT
/begin RECORD_LAYOUT RB_Val_Ws32 FNC_VALUES 1 SLONG COLUMN_DIR DIRECT /end RECORD_LAYOUT
/begin RECORD_LAYOUT RB_Val_Wu16 FNC_VALUES 1 UWORD COLUMN_DIR DIRECT /end RECORD_LAYOUT
/begin RECORD_LAYOUT RB_Val_Wu32 FNC_VALUES 1 ULONG COLUMN_DIR DIRECT /end RECORD_LAYOUT
/begin RECORD_LAYOUT RB_Val_Wu8 FNC_VALUES 1 UBYTE COLUMN_DIR DIRECT /end RECORD_LAYOUT
/begin RECORD_LAYOUT ValA_Wu8 FNC_VALUES 1 UBYTE COLUMN_DIR DIRECT /end RECORD_LAYOUT
/begin RECORD_LAYOUT Val_Ws16 FNC_VALUES 1 SWORD COLUMN_DIR DIRECT /end RECORD_LAYOUT
/begin RECORD_LAYOUT Val_Wu16 FNC_VALUES 1 UWORD COLUMN_DIR DIRECT /end RECORD_LAYOUT
/begin RECORD_LAYOUT Val_Wu8 FNC_VALUES 1 UBYTE COLUMN_DIR DIRECT /end RECORD_LAYOUT
/end MODULE
/end PROJECT

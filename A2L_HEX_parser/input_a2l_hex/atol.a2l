ASAP2_VERSION 1 70
/begin PROJECT MDG1C "VC1CP091_STLA_N_D061I3"
/begin HEADER "" VERSION "VC1CP091_STLA_N_D061I3" PROJECT_NO MDG1C /end HEADER
/begin MODULE DIM ""
/begin MOD_COMMON "" BYTE_ORDER MSB_LAST ALIGNMENT_BYTE 1 ALIGNMENT_WORD 2 ALIGNMENT_LONG 4 ALIGNMENT_INT64 4 ALIGNMENT_FLOAT32_IEEE 4 ALIGNMENT_FLOAT64_IEEE 4 DATA_SIZE 32 /end MOD_COMMON
/begin CHARACTERISTIC DFC_CtlMsk2.DFC_MonEgyChrgnCoorr_AcChrgnWoMofRels_C "" VALUE 0x80241681 Val_Wu8 255.0 DFES_OneToOne 0.00 255.0 FORMAT "%5.1" /end CHARACTERISTIC
/begin CHARACTERISTIC DFC_CtlMsk2.DFC_MonEgyChrgnCoorr_ChrgnAbortIgr_C "" VALUE 0x80241682 Val_Wu8 255.0 DFES_OneToOne 0.00 255.0 FORMAT "%5.1" /end CHARACTERISTIC
/begin CHARACTERISTIC DFC_CtlMsk2.DFC_MonEgyChrgnCoorr_DcCntctFailr_C "" VALUE 0x80241683 Val_Wu8 255.0 DFES_OneToOne 0.00 255.0 FORMAT "%5.1" /end CHARACTERISTIC
/begin CHARACTERISTIC DFC_CtlMsk2.DFC_MonEgyChrgnCoorr_ExtChrgnShtOffReq_C "" VALUE 0x80241684 Val_Wu8 255.0 DFES_OneToOne 0.00 255.0 FORMAT "%5.1" /end CHARACTERISTIC
/begin CHARACTERISTIC DFC_CtlMsk2.DFC_MonEgyChrgnCoorr_ImpsChrgnMod_C "" VALUE 0x80241685 Val_Wu8 255.0 DFES_OneToOne 0.00 255.0 FORMAT "%5.1" /end CHARACTERISTIC
/begin CHARACTERISTIC DFC_CtlMsk2.DFC_MonEgyChrgnCoorr_ImpsChrgnPrms_C "" VALUE 0x80241686 Val_Wu8 255.0 DFES_OneToOne 0.00 255.0 FORMAT "%5.1" /end CHARACTERISTIC
/begin CHARACTERISTIC DFC_CtlMsk2.DFC_MonEgyChrgnCoorr_ImpsUDcIntk_C "" VALUE 0x80241687 Val_Wu8 255.0 DFES_OneToOne 0.00 255.0 FORMAT "%5.1" /end CHARACTERISTIC
/begin CHARACTERISTIC DFC_CtlMsk2.DFC_MonEgyChrgnCoorr_PlgLockMovmt_C "" VALUE 0x80241688 Val_Wu8 255.0 DFES_OneToOne 0.00 255.0 FORMAT "%5.1" /end CHARACTERISTIC
/begin CHARACTERISTIC DFC_CtlMsk2.DFC_MonEgyChrgnCoorr_VehCrashDetn_C "" VALUE 0x80241689 Val_Wu8 255.0 DFES_OneToOne 0.00 255.0 FORMAT "%5.1" /end CHARACTERISTIC
/begin CHARACTERISTIC DFC_CtlMsk2.DFC_MonEgyChrgnErrReactn_SftySwt_C "" VALUE 0x8024168A Val_Wu8 255.0 DFES_OneToOne 0.00 255.0 FORMAT "%5.1" /end CHARACTERISTIC
/begin CHARACTERISTIC DFC_CtlMsk2.DFC_MonEgyChrgnInlet_CcsPlgCtp_C "" VALUE 0x8024168B Val_Wu8 255.0 DFES_OneToOne 0.00 255.0 FORMAT "%5.1" /end CHARACTERISTIC
/begin CHARACTERISTIC DFC_CtlMsk2.DFC_MonEgyChrgnInlet_CcsPlgCtpPwm_C "" VALUE 0x8024168C Val_Wu8 255.0 DFES_OneToOne 0.00 255.0 FORMAT "%5.1" /end CHARACTERISTIC
/begin CHARACTERISTIC DFC_CtlMsk2.DFC_MonEgyChrgnInlet_CcsPlgLockCtrlImpsAtmpt_C "" VALUE 0x8024168D Val_Wu8 255.0 DFES_OneToOne 0.00 255.0 FORMAT "%5.1" /end CHARACTERISTIC
/begin CHARACTERISTIC DFC_CtlMsk2.DFC_MonEgyChrgnInlet_CcsPlgLockSnsrSigRngChk_C "" VALUE 0x8024168E Val_Wu8 255.0 DFES_OneToOne 0.00 255.0 FORMAT "%5.1" /end CHARACTERISTIC
/begin CHARACTERISTIC DFC_CtlMsk2.DFC_MonEgyChrgnInlet_CcsPlgLockStImps_C "" VALUE 0x8024168F Val_Wu8 255.0 DFES_OneToOne 0.00 255.0 FORMAT "%5.1" /end CHARACTERISTIC
/begin CHARACTERISTIC DFC_CtlMsk2.DFC_MonEgyChrgnInlet_CcsPlgPxp_C "" VALUE 0x80241690 Val_Wu8 255.0 DFES_OneToOne 0.00 255.0 FORMAT "%5.1" /end CHARACTERISTIC
/begin CHARACTERISTIC DFC_CtlMsk2.DFC_MonEgyChrgnT_Snsr1GrdtChk_C "" VALUE 0x80241691 Val_Wu8 255.0 DFES_OneToOne 0.00 255.0 FORMAT "%5.1" /end CHARACTERISTIC
/begin CHARACTERISTIC DFC_CtlMsk2.DFC_MonEgyChrgnT_Snsr1SigRngChk_C "" VALUE 0x80241692 Val_Wu8 255.0 DFES_OneToOne 0.00 255.0 FORMAT "%5.1" /end CHARACTERISTIC
/begin CHARACTERISTIC DFC_CtlMsk2.DFC_MonEgyChrgnT_Snsr2GrdtChk_C "" VALUE 0x80241693 Val_Wu8 255.0 DFES_OneToOne 0.00 255.0 FORMAT "%5.1" /end CHARACTERISTIC
/begin CHARACTERISTIC DFC_CtlMsk2.DFC_MonEgyChrgnT_Snsr2SigRngChk_C "" VALUE 0x80241694 Val_Wu8 255.0 DFES_OneToOne 0.00 255.0 FORMAT "%5.1" /end CHARACTERISTIC
/begin CHARACTERISTIC DFC_CtlMsk2.DFC_MonEgyChrgnT_SnsrDif_C "" VALUE 0x80241695 Val_Wu8 255.0 DFES_OneToOne 0.00 255.0 FORMAT "%5.1" /end CHARACTERISTIC
/begin CHARACTERISTIC DFC_DisblMsk2.DFC_MonEgyChrgnCoorr_AcChrgnWoMofRels_C "" VALUE 0x802491E8 Val_Wu16 65535.00 DFES_OneToOne 0.00 65535.00 FORMAT "%8.2" /end CHARACTERISTIC
/begin CHARACTERISTIC DFC_DisblMsk2.DFC_MonEgyChrgnCoorr_ChrgnAbortIgr_C "" VALUE 0x802491EA Val_Wu16 65535.00 DFES_OneToOne 0.00 65535.00 FORMAT "%8.2" /end CHARACTERISTIC
/begin CHARACTERISTIC DFC_DisblMsk2.DFC_MonEgyChrgnCoorr_DcCntctFailr_C "" VALUE 0x802491EC Val_Wu16 65535.00 DFES_OneToOne 0.00 65535.00 FORMAT "%8.2" /end CHARACTERISTIC
/begin CHARACTERISTIC DFC_DisblMsk2.DFC_MonEgyChrgnCoorr_ExtChrgnShtOffReq_C "" VALUE 0x802491EE Val_Wu16 65535.00 DFES_OneToOne 0.00 65535.00 FORMAT "%8.2" /end CHARACTERISTIC
/begin CHARACTERISTIC DFC_DisblMsk2.DFC_MonEgyChrgnCoorr_ImpsChrgnMod_C "" VALUE 0x802491F0 Val_Wu16 65535.00 DFES_OneToOne 0.00 65535.00 FORMAT "%8.2" /end CHARACTERISTIC
/begin CHARACTERISTIC DFC_DisblMsk2.DFC_MonEgyChrgnCoorr_ImpsChrgnPrms_C "" VALUE 0x802491F2 Val_Wu16 65535.00 DFES_OneToOne 0.00 65535.00 FORMAT "%8.2" /end CHARACTERISTIC
/begin CHARACTERISTIC DFC_DisblMsk2.DFC_MonEgyChrgnCoorr_ImpsUDcIntk_C "" VALUE 0x802491F4 Val_Wu16 65535.00 DFES_OneToOne 0.00 65535.00 FORMAT "%8.2" /end CHARACTERISTIC
/begin CHARACTERISTIC DFC_DisblMsk2.DFC_MonEgyChrgnCoorr_PlgLockMovmt_C "" VALUE 0x802491F6 Val_Wu16 65535.00 DFES_OneToOne 0.00 65535.00 FORMAT "%8.2" /end CHARACTERISTIC
/begin CHARACTERISTIC DFC_DisblMsk2.DFC_MonEgyChrgnCoorr_VehCrashDetn_C "" VALUE 0x802491F8 Val_Wu16 65535.00 DFES_OneToOne 0.00 65535.00 FORMAT "%8.2" /end CHARACTERISTIC
/begin CHARACTERISTIC DFC_DisblMsk2.DFC_MonEgyChrgnErrReactn_SftySwt_C "" VALUE 0x802491FA Val_Wu16 65535.00 DFES_OneToOne 0.00 65535.00 FORMAT "%8.2" /end CHARACTERISTIC
/begin CHARACTERISTIC DFC_DisblMsk2.DFC_MonEgyChrgnInlet_CcsPlgCtp_C "" VALUE 0x802491FC Val_Wu16 65535.00 DFES_OneToOne 0.00 65535.00 FORMAT "%8.2" /end CHARACTERISTIC
/begin CHARACTERISTIC DFC_DisblMsk2.DFC_MonEgyChrgnInlet_CcsPlgCtpPwm_C "" VALUE 0x802491FE Val_Wu16 65535.00 DFES_OneToOne 0.00 65535.00 FORMAT "%8.2" /end CHARACTERISTIC
/begin CHARACTERISTIC DFC_DisblMsk2.DFC_MonEgyChrgnInlet_CcsPlgLockCtrlImpsAtmpt_C "" VALUE 0x80249200 Val_Wu16 65535.00 DFES_OneToOne 0.00 65535.00 FORMAT "%8.2" /end CHARACTERISTIC
/begin CHARACTERISTIC DFC_DisblMsk2.DFC_MonEgyChrgnInlet_CcsPlgLockSnsrSigRngChk_C "" VALUE 0x80249202 Val_Wu16 65535.00 DFES_OneToOne 0.00 65535.00 FORMAT "%8.2" /end CHARACTERISTIC
/begin CHARACTERISTIC DFC_DisblMsk2.DFC_MonEgyChrgnInlet_CcsPlgLockStImps_C "" VALUE 0x80249204 Val_Wu16 65535.00 DFES_OneToOne 0.00 65535.00 FORMAT "%8.2" /end CHARACTERISTIC
/begin CHARACTERISTIC DFC_DisblMsk2.DFC_MonEgyChrgnInlet_CcsPlgPxp_C "" VALUE 0x80249206 Val_Wu16 65535.00 DFES_OneToOne 0.00 65535.00 FORMAT "%8.2" /end CHARACTERISTIC
/begin CHARACTERISTIC DFC_DisblMsk2.DFC_MonEgyChrgnT_Snsr1GrdtChk_C "" VALUE 0x80249208 Val_Wu16 65535.00 DFES_OneToOne 0.00 65535.00 FORMAT "%8.2" /end CHARACTERISTIC
/begin CHARACTERISTIC DFC_DisblMsk2.DFC_MonEgyChrgnT_Snsr1SigRngChk_C "" VALUE 0x8024920A Val_Wu16 65535.00 DFES_OneToOne 0.00 65535.00 FORMAT "%8.2" /end CHARACTERISTIC
/begin CHARACTERISTIC DFC_DisblMsk2.DFC_MonEgyChrgnT_Snsr2GrdtChk_C "" VALUE 0x8024920C Val_Wu16 65535.00 DFES_OneToOne 0.00 65535.00 FORMAT "%8.2" /end CHARACTERISTIC
/begin CHARACTERISTIC DFC_DisblMsk2.DFC_MonEgyChrgnT_Snsr2SigRngChk_C "" VALUE 0x8024920E Val_Wu16 65535.00 DFES_OneToOne 0.00 65535.00 FORMAT "%8.2" /end CHARACTERISTIC
/begin CHARACTERISTIC DFC_DisblMsk2.DFC_MonEgyChrgnT_SnsrDif_C "" VALUE 0x80249210 Val_Wu16 65535.00 DFES_OneToOne 0.00 65535.00 FORMAT "%8.2" /end CHARACTERISTIC
/begin CHARACTERISTIC MonEgyChrgnCoorr_cntrAcChrgnWoMofRelsErr_C "Debounce counter for AC charging without Level 2 permission error" VALUE 0x8026CF74 Val_Wu8 255.0 OneToOne 0.00 255.0 FORMAT "%5.1" /end CHARACTERISTIC
/begin CHARACTERISTIC MonEgyChrgnCoorr_cntrCcsPlgLockMovmtErr_C "Debounce counter for detection erroneous movement of the plug lock pin" VALUE 0x8026CF75 Val_Wu8 255.0 OneToOne 0.00 255.0 FORMAT "%5.1" /end CHARACTERISTIC
/begin CHARACTERISTIC MonEgyChrgnCoorr_cntrChrgnAbortErr_C "Debounce counter for charging abort violation error" VALUE 0x8026CF76 Val_Wu8 255.0 OneToOne 0.00 255.0 FORMAT "%5.1" /end CHARACTERISTIC
/begin CHARACTERISTIC MonEgyChrgnCoorr_cntrDcCntctErr_C "Debounce counter for DC contactor failure" VALUE 0x8026CF77 Val_Wu8 255.0 OneToOne 0.00 255.0 FORMAT "%5.1" /end CHARACTERISTIC
/begin CHARACTERISTIC MonEgyChrgnCoorr_cntrImpsChrgnModeErr_C "Debounce counter for implausible charging mode error" VALUE 0x8026CF78 Val_Wu8 255.0 OneToOne 0.00 255.0 FORMAT "%5.1" /end CHARACTERISTIC
/begin CHARACTERISTIC MonEgyChrgnCoorr_cntrImpsChrgnPrmsErr_C "Debounce counter for implausible charging permission error" VALUE 0x8026CF79 Val_Wu8 255.0 OneToOne 0.00 255.0 FORMAT "%5.1" /end CHARACTERISTIC
/begin CHARACTERISTIC MonEgyChrgnCoorr_cntrImpsUDcIntkErr_C "Debounce counter for implausible voltage on DC inlet error" VALUE 0x8026CF7A Val_Wu8 255.0 OneToOne 0.00 255.0 FORMAT "%5.1" /end CHARACTERISTIC
/begin CHARACTERISTIC MonEgyChrgnCoorr_cntrTurnOnDlyChrgMod_C "Debounce counter for charge mode detection" VALUE 0x8026CF7B Val_Wu8 255.0 OneToOne 0.00 255.0 FORMAT "%5.1" /end CHARACTERISTIC
/begin CHARACTERISTIC MonEgyChrgnCoorr_cntrTurnOnDlyChrgnPrms_C "Debounce counter for charging permission" VALUE 0x8026CF7C Val_Wu8 255.0 OneToOne 0.00 255.0 FORMAT "%5.1" /end CHARACTERISTIC
/begin CHARACTERISTIC MonEgyChrgnCoorr_stActChrgModSubVal_C "Substitue value for status actual charging mode" VALUE 0x8026CF7E Val_Wu8 6.00000000000 MonEgyChrgnCoorr_stActChrgMod_VERB 0.00 6.00000000000 FORMAT "%13.11" /end CHARACTERISTIC
/begin CHARACTERISTIC MonEgyChrgnCoorr_stCcsUnlckPlgLockPtdSubVal_C "Substitue value for status CCS unlock plug lock permitted" VALUE 0x8026CF7F Val_Wu8 1.00000000000 MonEgyChrgnCoorr_stUnlckPlgLockPtd_VERB 0.00 1.00000000000 FORMAT "%13.11" /end CHARACTERISTIC
/begin CHARACTERISTIC MonEgyChrgnCoorr_stChrgnSubVal_C "Substitute value for status charging" VALUE 0x8026CF80 Val_Wu8 2.00000000000 MonEgyChrgnCoorr_stChrgn_VERB 0.00 2.00000000000 FORMAT "%13.11" /end CHARACTERISTIC
/begin CHARACTERISTIC MonEgyChrgnCoorr_stDrvRdnSubVal_C "Substitute value for status driving readiness" VALUE 0x8026CF81 Val_Wu8 1.00000000000 MonEgyChrgnCoorr_stDrvRdn_VERB 0.00 1.00000000000 FORMAT "%13.11" /end CHARACTERISTIC
/begin CHARACTERISTIC MonEgyChrgnCoorr_stSftyErrSubVal_C "Substitue value for status safety error" VALUE 0x8026FEB6 Val_Wu16 255.0000 OneToOne 0.00 255.0000 FORMAT "%8.4" EXTENDED_LIMITS 0.00 65535.00 /end CHARACTERISTIC
/begin CHARACTERISTIC MonEgyChrgnCoorr_stSwtSubVal_C "Switch for substitute values monitoring charging coordinator" VALUE 0x8026CF82 Val_Wu8 255.0 OneToOne 0.00 255.0 FORMAT "%5.1" /end CHARACTERISTIC
/begin CHARACTERISTIC MonEgyChrgnCoorr_swtMplPlgDetd_C "Switch for charging stop request multiple charge plugs" VALUE 0x8026CF7D Val_Wu8 1.00000000000 B_TRUE 0.00 1.00000000000 FORMAT "%13.11" /end CHARACTERISTIC
/begin CHARACTERISTIC MonEgyChrgnCoorr_swtVehCdn_C "Switch for deactivation of vehicle conditions for charging release" VALUE 0x8026CF84 Val_Wu8 255.0 OneToOne 0.00 255.0 FORMAT "%5.1" /end CHARACTERISTIC
/begin CHARACTERISTIC MonEgyChrgnCoorr_uDcChrgnSubVal_C "Substitute value for DC charging voltage" VALUE 0x8026FEB8 Val_Ws16 6553.500 RBPtCel_u_0p1_1 -3276.800 3276.700 FORMAT "%8.3" /end CHARACTERISTIC
/begin CHARACTERISTIC MonEgyChrgnCoorr_uMaxDcChrgnNotAvl_C "Maximum voltage threshold in case of implausible or unavailable charging mode" VALUE 0x8026FEAE Val_Wu16 6553.500 RBPtCel_u_0p1_1 0.00 6553.500 FORMAT "%8.3" /end CHARACTERISTIC
/begin CHARACTERISTIC MonEgyChrgnCoorr_uMaxPlgLockCtrld_C "Maximum voltage threshold while controlling the plug lock" VALUE 0x8026FEB0 Val_Wu16 6553.500 RBPtCel_u_0p1_1 0.00 6553.500 FORMAT "%8.3" /end CHARACTERISTIC
/begin CHARACTERISTIC MonEgyChrgnCoorr_uMaxUnlockPlgLock_C "Maximum voltage threshold for unlocking the plug lock" VALUE 0x8026FEB2 Val_Wu16 6553.500 RBPtCel_u_0p1_1 0.00 6553.500 FORMAT "%8.3" /end CHARACTERISTIC
/begin CHARACTERISTIC MonEgyChrgnCoorr_uThdAcChrgn_C "Maximum voltage threshold for AC charging" VALUE 0x8026FEB4 Val_Ws16 6553.500 RBPtCel_u_0p1_1 -3276.800 3276.700 FORMAT "%8.3" /end CHARACTERISTIC
/begin CHARACTERISTIC MonEgyChrgnCoorr_vMaxVehMovg_C "Upper velocity threshold for vehicle not moving" VALUE 0x8026FEBA Val_Ws16 655.3500 Vel -327.6800 327.6700 FORMAT "%8.4" /end CHARACTERISTIC
/begin CHARACTERISTIC MonEgyChrgnErrReactn_cntrDebActvErrPin_C "Threshold for debouncing activation error pin" VALUE 0x8026FEBC Val_Wu16 65535.00 OneToOne 0.00 65535.00 FORMAT "%8.2" /end CHARACTERISTIC
/begin CHARACTERISTIC MonEgyChrgnErrReactn_cntrDebPersSftyErr_C "Threshold for debouncing persistent safety error" VALUE 0x8026FEBE Val_Wu16 65535.00 OneToOne 0.00 65535.00 FORMAT "%8.2" /end CHARACTERISTIC
/begin CHARACTERISTIC MonEgyChrgnErrReactn_cntrHealCtpSwtCtrl_C "Threshold for healing control pilot switch controlling" VALUE 0x8026FEC0 Val_Wu16 65535.00 OneToOne 0.00 65535.00 FORMAT "%8.2" /end CHARACTERISTIC
/begin CHARACTERISTIC MonEgyChrgnErrReactn_mskSftyErrActvnErrPin_C "Mask safety error activation error pin" VALUE 0x8026FEC2 Val_Wu16 65535.00 OneToOne 0.00 65535.00 FORMAT "%8.2" /end CHARACTERISTIC
/begin CHARACTERISTIC MonEgyChrgnErrReactn_mskStgErrReactnErrPinActv_C "Mask staged error reaction including error pin activation" VALUE 0x8026FEC4 Val_Wu16 65535.00 OneToOne 0.00 65535.00 FORMAT "%8.2" /end CHARACTERISTIC
/begin CHARACTERISTIC MonEgyChrgnErrReactn_mskStgErrReactn_C "Mask staged error reaction" VALUE 0x8026FEC6 Val_Wu16 65535.00 OneToOne 0.00 65535.00 FORMAT "%8.2" /end CHARACTERISTIC
/begin CHARACTERISTIC MonEgyChrgnIf_cntrTestAcChrgnWoMofRels_C "Test counter threshold fault memory entry AC charging without L2 permission." VALUE 0x8026CF86 Val_Wu8 255.0 OneToOne 0.00 255.0 FORMAT "%5.1" /end CHARACTERISTIC
/begin CHARACTERISTIC MonEgyChrgnIf_cntrTestCcsPlgCtpPwm_C "Test counter threshold fault memory entry CCS control pilot PWM error." VALUE 0x8026CF87 Val_Wu8 255.0 OneToOne 0.00 255.0 FORMAT "%5.1" /end CHARACTERISTIC
/begin CHARACTERISTIC MonEgyChrgnIf_cntrTestCcsPlgCtp_C "Test counter threshold fault memory entry CCS CTP plug." VALUE 0x8026CF88 Val_Wu8 255.0 OneToOne 0.00 255.0 FORMAT "%5.1" /end CHARACTERISTIC
/begin CHARACTERISTIC MonEgyChrgnIf_cntrTestCcsPlgLockCtrlImpsAtmpt_C "Test counter threshold fault memory entry CCS lockunlock failed after maximum lock actuation attempts." VALUE 0x8026CF89 Val_Wu8 255.0 OneToOne 0.00 255.0 FORMAT "%5.1" /end CHARACTERISTIC
/begin CHARACTERISTIC MonEgyChrgnIf_cntrTestCcsPlgLockSnsrSigRngChk_C "Test counter threshold fault memory entry CCS lock feedback sensor signal range check error." VALUE 0x8026CF8A Val_Wu8 255.0 OneToOne 0.00 255.0 FORMAT "%5.1" /end CHARACTERISTIC
/begin CHARACTERISTIC MonEgyChrgnIf_cntrTestCcsPlgLockStImps_C "Test counter threshold fault memory entry CCS lockunlock failed after maximum lock actuation attempts." VALUE 0x8026CF8B Val_Wu8 255.0 OneToOne 0.00 255.0 FORMAT "%5.1" /end CHARACTERISTIC
/begin CHARACTERISTIC MonEgyChrgnIf_cntrTestCcsPlgPxp_C "Test counter threshold fault memory entry CCS proximity pilot signal range check error." VALUE 0x8026CF8C Val_Wu8 255.0 OneToOne 0.00 255.0 FORMAT "%5.1" /end CHARACTERISTIC
/begin CHARACTERISTIC MonEgyChrgnIf_cntrTestChrgnAbortIgr_C "Test counter threshold fault memory entry charging abort ignored." VALUE 0x8026CF8D Val_Wu8 255.0 OneToOne 0.00 255.0 FORMAT "%5.1" /end CHARACTERISTIC
/begin CHARACTERISTIC MonEgyChrgnIf_cntrTestDcCntctFailr_C "Test counter threshold fault memory entry DC contactor failure." VALUE 0x8026CF8E Val_Wu8 255.0 OneToOne 0.00 255.0 FORMAT "%5.1" /end CHARACTERISTIC
/begin CHARACTERISTIC MonEgyChrgnIf_cntrTestExtChrgnShtOffReq_C "Test counter threshold fault memory entry customer specific request." VALUE 0x8026CF8F Val_Wu8 255.0 OneToOne 0.00 255.0 FORMAT "%5.1" /end CHARACTERISTIC
/begin CHARACTERISTIC MonEgyChrgnIf_cntrTestImpsChrgMod_C "Test counter threshold fault memory entry implausible charging mode." VALUE 0x8026CF90 Val_Wu8 255.0 OneToOne 0.00 255.0 FORMAT "%5.1" /end CHARACTERISTIC
/begin CHARACTERISTIC MonEgyChrgnIf_cntrTestImpsChrgPrms_C "Test counter threshold fault memory entry implausible charging permission." VALUE 0x8026CF91 Val_Wu8 255.0 OneToOne 0.00 255.0 FORMAT "%5.1" /end CHARACTERISTIC
/begin CHARACTERISTIC MonEgyChrgnIf_cntrTestImpsUDcIntk_C "Test counter threshold fault memory entry implausible votage on DC inlet." VALUE 0x8026CF92 Val_Wu8 255.0 OneToOne 0.00 255.0 FORMAT "%5.1" /end CHARACTERISTIC
/begin CHARACTERISTIC MonEgyChrgnIf_cntrTestPlgLockMovmt_C "Test counter threshold fault memory entry CCS plug lock pin movement." VALUE 0x8026CF93 Val_Wu8 255.0 OneToOne 0.00 255.0 FORMAT "%5.1" /end CHARACTERISTIC
/begin CHARACTERISTIC MonEgyChrgnIf_cntrTestSftySwt_C "Test counter threshold fault memory entry CCS S2 open." VALUE 0x8026CF94 Val_Wu8 255.0 OneToOne 0.00 255.0 FORMAT "%5.1" /end CHARACTERISTIC
/begin CHARACTERISTIC MonEgyChrgnIf_cntrTestSnsr1GrdtChk_C "Test counter threshold fault memory entry temperature sensor 1 gradient check error." VALUE 0x8026CF95 Val_Wu8 255.0 OneToOne 0.00 255.0 FORMAT "%5.1" /end CHARACTERISTIC
/begin CHARACTERISTIC MonEgyChrgnIf_cntrTestSnsr1SigRngChk_C "Test counter threshold fault memory entry temperature sensor 1 signal range check error." VALUE 0x8026CF96 Val_Wu8 255.0 OneToOne 0.00 255.0 FORMAT "%5.1" /end CHARACTERISTIC
/begin CHARACTERISTIC MonEgyChrgnIf_cntrTestSnsr2GrdtChk_C "Test counter threshold fault memory entry temperature sensor 2 gradient check error." VALUE 0x8026CF97 Val_Wu8 255.0 OneToOne 0.00 255.0 FORMAT "%5.1" /end CHARACTERISTIC
/begin CHARACTERISTIC MonEgyChrgnIf_cntrTestSnsr2SigRngChk_C "Test counter threshold fault memory entry temperature sensor 2 singnal range check error." VALUE 0x8026CF98 Val_Wu8 255.0 OneToOne 0.00 255.0 FORMAT "%5.1" /end CHARACTERISTIC
/begin CHARACTERISTIC MonEgyChrgnIf_cntrTestSnsrDif_C "Test counter threshold fault memory entry temperature difference sensor 1 versus sensor 2 error." VALUE 0x8026CF99 Val_Wu8 255.0 OneToOne 0.00 255.0 FORMAT "%5.1" /end CHARACTERISTIC
/begin CHARACTERISTIC MonEgyChrgnIf_cntrTestVehCrashDetn_C "Test counter threshold fault memory entry vehicle crash detected." VALUE 0x8026CF9A Val_Wu8 255.0 OneToOne 0.00 255.0 FORMAT "%5.1" /end CHARACTERISTIC
/begin CHARACTERISTIC MonEgyChrgnIf_stMskCcsCtpPwm_C "CCS control pilot pwm bit mask state." VALUE 0x8026D224 Val_Wu32 4294967295.00 OneToOne 0.00 4294967295.00 FORMAT "%13.2" /end CHARACTERISTIC
/begin CHARACTERISTIC MonEgyChrgnIf_stMskCcsCtp_C "CCS control pilot bit mask state." VALUE 0x8026D228 Val_Wu32 4294967295.00 OneToOne 0.00 4294967295.00 FORMAT "%13.2" /end CHARACTERISTIC
/begin CHARACTERISTIC MonEgyChrgnIf_stMskCcsPxp_C "CCS proximity pilot bit mask state." VALUE 0x8026D22C Val_Wu32 4294967295.00 OneToOne 0.00 4294967295.00 FORMAT "%13.2" /end CHARACTERISTIC
/begin CHARACTERISTIC MonEgyChrgnInlet_cntrDebConPwmCcsCtp_C "Threshold for debounce counter constanst duty cycle detection of CCS control pilot" VALUE 0x8026CFB0 Val_Wu8 255.0 OneToOne 0.00 255.0 FORMAT "%5.1" /end CHARACTERISTIC
/begin CHARACTERISTIC MonEgyChrgnInlet_cntrDebCtpDigComReq_C "Threshold for debounce counter digital communication required of CCS control pilot" VALUE 0x8026CFB1 Val_Wu8 255.0 OneToOne 0.00 255.0 FORMAT "%5.1" /end CHARACTERISTIC
/begin CHARACTERISTIC MonEgyChrgnInlet_cntrDebImpsSnsrPlgLock_C "Threshold for debounce counter implausible sensor plug lock" VALUE 0x8026CFA4 Val_Wu8 255.0 OneToOne 0.00 255.0 FORMAT "%5.1" /end CHARACTERISTIC
/begin CHARACTERISTIC MonEgyChrgnInlet_cntrDebMaxCtp_C "Threshold for debounce counter Control Pilot above max value" VALUE 0x8026CFB2 Val_Wu8 255.0 OneToOne 0.00 255.0 FORMAT "%5.1" /end CHARACTERISTIC
/begin CHARACTERISTIC MonEgyChrgnInlet_cntrDebMaxPxp_C "Threshold for debounce counter Proximity Pilot above max value" VALUE 0x8026CFB3 Val_Wu8 255.0 OneToOne 0.00 255.0 FORMAT "%5.1" /end CHARACTERISTIC
/begin CHARACTERISTIC MonEgyChrgnInlet_cntrDebMaxSnsrPlgLock_C "Threshold for debounce counter signal range check above maximum value for feedback sensor signal" VALUE 0x8026CFA5 Val_Wu8 255.0 OneToOne 0.00 255.0 FORMAT "%5.1" /end CHARACTERISTIC
/begin CHARACTERISTIC MonEgyChrgnInlet_cntrDebMinPxp_C "Threshold for debounce counter Proximity Pilot below min value" VALUE 0x8026CFB4 Val_Wu8 255.0 OneToOne 0.00 255.0 FORMAT "%5.1" /end CHARACTERISTIC
/begin CHARACTERISTIC MonEgyChrgnInlet_cntrDebMinSnsrPlgLock_C "Threshold for debounce counter signal range check below minimum value for feedback sensor signal" VALUE 0x8026CFA6 Val_Wu8 255.0 OneToOne 0.00 255.0 FORMAT "%5.1" /end CHARACTERISTIC
/begin CHARACTERISTIC MonEgyChrgnInlet_cntrDebPerdPwmCcsCtp_C "Threshold for debounce counter plausible periodic times CCS control pilot" VALUE 0x8026CFB5 Val_Wu8 255.0 OneToOne 0.00 255.0 FORMAT "%5.1" /end CHARACTERISTIC
/begin CHARACTERISTIC MonEgyChrgnInlet_cntrDebPlgLockStImps_C "Threshold for debounce counter plug lock status implausible" VALUE 0x8026CFA7 Val_Wu8 255.0 OneToOne 0.00 255.0 FORMAT "%5.1" /end CHARACTERISTIC
/begin CHARACTERISTIC MonEgyChrgnInlet_cntrDebPlgLockStUnlockdPlaus_C "Threshold for counter debounce plug lock status unlocked plausibilization" VALUE 0x8026CFA8 Val_Wu8 255.0 OneToOne 0.00 255.0 FORMAT "%5.1" /end CHARACTERISTIC
/begin CHARACTERISTIC MonEgyChrgnInlet_cntrDebPwmCcsCtpPlausAc_C "Threshold for debounce duty cycle of plausible AC charging current CCS control pilot" VALUE 0x8026CFB6 Val_Wu8 255.0 OneToOne 0.00 255.0 FORMAT "%5.1" /end CHARACTERISTIC
/begin CHARACTERISTIC MonEgyChrgnInlet_cntrHealConPwmCcsCtp_C "Threshold for healing counter constanst duty cycle detection of CCS control pilot" VALUE 0x8026CFB7 Val_Wu8 255.0 OneToOne 0.00 255.0 FORMAT "%5.1" /end CHARACTERISTIC
/begin CHARACTERISTIC MonEgyChrgnInlet_cntrHealCtpDigComReq_C "Threshold for healing counter digital communication required of CCS control pilot" VALUE 0x8026CFB8 Val_Wu8 255.0 OneToOne 0.00 255.0 FORMAT "%5.1" /end CHARACTERISTIC
/begin CHARACTERISTIC MonEgyChrgnInlet_cntrHealImpsSnsrPlgLock_C "Threshold for healing counter implausible sensor plug lock" VALUE 0x8026CFA9 Val_Wu8 255.0 OneToOne 0.00 255.0 FORMAT "%5.1" /end CHARACTERISTIC
/begin CHARACTERISTIC MonEgyChrgnInlet_cntrHealMaxPxp_C "Threshold for healing counter Proximity Pilot above max value" VALUE 0x8026CFB9 Val_Wu8 255.0 OneToOne 0.00 255.0 FORMAT "%5.1" /end CHARACTERISTIC
/begin CHARACTERISTIC MonEgyChrgnInlet_cntrHealMaxSnsrPlgLock_C "Threshold for healing counter signal range check above maximum value for feedback sensor signal" VALUE 0x8026CFAA Val_Wu8 255.0 OneToOne 0.00 255.0 FORMAT "%5.1" /end CHARACTERISTIC
/begin CHARACTERISTIC MonEgyChrgnInlet_cntrHealMinPxp_C "Threshold for healing counter Proximity Pilot below min value" VALUE 0x8026CFBA Val_Wu8 255.0 OneToOne 0.00 255.0 FORMAT "%5.1" /end CHARACTERISTIC
/begin CHARACTERISTIC MonEgyChrgnInlet_cntrHealMinSnsrPlgLock_C "Threshold for healing counter signal range check below minimum value for feedback sensor signal" VALUE 0x8026CFAB Val_Wu8 255.0 OneToOne 0.00 255.0 FORMAT "%5.1" /end CHARACTERISTIC
/begin CHARACTERISTIC MonEgyChrgnInlet_cntrHealPerdPwmCcsCtp_C "Threshold for healing counter plausible periodic times CCS control pilot" VALUE 0x8026CFBB Val_Wu8 255.0 OneToOne 0.00 255.0 FORMAT "%5.1" /end CHARACTERISTIC
/begin CHARACTERISTIC MonEgyChrgnInlet_cntrHealPwmCcsCtpPlausAc_C "Threshold for healing duty cycle of plausible AC charging current CCS control pilot" VALUE 0x8026CFBC Val_Wu8 255.0 OneToOne 0.00 255.0 FORMAT "%5.1" /end CHARACTERISTIC
/begin CHARACTERISTIC MonEgyChrgnInlet_cntrHeaMaxCtp_C "Threshold for healing counter Control Pilot above max value" VALUE 0x8026CFBD Val_Wu8 255.0 OneToOne 0.00 255.0 FORMAT "%5.1" /end CHARACTERISTIC
/begin CHARACTERISTIC MonEgyChrgnInlet_cntrIninPlausCcsCtp_C "Threshold for timing counter for the indication of ongoing initial CCS control pilot plausibility check" VALUE 0x8026CFBE Val_Wu8 255.0 OneToOne 0.00 255.0 FORMAT "%5.1" /end CHARACTERISTIC
/begin CHARACTERISTIC MonEgyChrgnInlet_cntrIninPlausCcsPlgLock_C "Threshold for initialization counter of CCS plug lock" VALUE 0x8026CFAC Val_Wu8 255.0 OneToOne 0.00 255.0 FORMAT "%5.1" /end CHARACTERISTIC
/begin CHARACTERISTIC MonEgyChrgnInlet_cntrIninPlausCcsPxp_C "Threshold for timing counter for the indication of ongoing initial CCS proximity pilot plausibility check" VALUE 0x8026CFBF Val_Wu8 255.0 OneToOne 0.00 255.0 FORMAT "%5.1" /end CHARACTERISTIC
/begin CHARACTERISTIC MonEgyChrgnInlet_cntrMaxPlgLockCtrlAtmpt_C "Maximum permitted plug lock control attempts" VALUE 0x8026CFAD Val_Wu8 255.0 OneToOne 0.00 255.0 FORMAT "%5.1" /end CHARACTERISTIC
/begin CHARACTERISTIC MonEgyChrgnInlet_cntrPlgLockClsng_C "Threshold for debounce counter plug lock locking detection" VALUE 0x8026CFC2 Val_Wu8 255.0 OneToOne 0.00 255.0 FORMAT "%5.1" /end CHARACTERISTIC
/begin CHARACTERISTIC MonEgyChrgnInlet_cntrPlgLockCtrlTi_C "Threshold for minimum required actuation time to detect a plug lock pin position change" VALUE 0x8026FECA Val_Wu16 65535.00 OneToOne 0.00 65535.00 FORMAT "%8.2" /end CHARACTERISTIC
/begin CHARACTERISTIC MonEgyChrgnInlet_cntrPlgLockOpng_C "Threshold for debounce counter plug lock unlocking detection" VALUE 0x8026CFC3 Val_Wu8 255.0 OneToOne 0.00 255.0 FORMAT "%5.1" /end CHARACTERISTIC
/begin CHARACTERISTIC MonEgyChrgnInlet_facAdcCnv_C "Multiplication factor for reading ADC voltage" VALUE 0x8026FEC8 Val_Ws16 79.99878 spg_q0p0012207_V -40.00000 39.99878 FORMAT "%8.5" /end CHARACTERISTIC
/begin CHARACTERISTIC MonEgyChrgnInlet_mskErrDiagCcsCtp_C "Mask for the error diagnosis of CCS control pilot" VALUE 0x8026FF06 Val_Wu16 65535.00 OneToOne 0.00 65535.00 FORMAT "%8.2" /end CHARACTERISTIC
/begin CHARACTERISTIC MonEgyChrgnInlet_mskErrDiagCcsPlgLock_C "Mask for diagnosis errors of CCS plug lock" VALUE 0x8026CFAE Val_Wu8 255.0 OneToOne 0.00 255.0 FORMAT "%5.1" /end CHARACTERISTIC
/begin CHARACTERISTIC MonEgyChrgnInlet_mskErrDiagCcsPxp_C "Mask for the error diagnosis of CCS proximity pilot" VALUE 0x8026CFC0 Val_Wu8 255.0 OneToOne 0.00 255.0 FORMAT "%5.1" /end CHARACTERISTIC
/begin CHARACTERISTIC MonEgyChrgnInlet_nrBitShift_C "Numbers of places for bitshift operation" VALUE 0x8026CFA2 Val_Wu8 255.0 OneToOne 0.00 255.0 FORMAT "%5.1" /end CHARACTERISTIC
/begin CHARACTERISTIC MonEgyChrgnInlet_ratConPwmCcsCtpMax_C "Upper threshold for constanst duty cycle detection of CCS control pilot" VALUE 0x8026FF08 Val_Wu16 655.3500 RBPtCel_Perc_0p01_1 0.00 655.3500 FORMAT "%8.4" /end CHARACTERISTIC
/begin CHARACTERISTIC MonEgyChrgnInlet_ratConPwmCcsCtpMin_C "Lower threshold for constanst duty cycle detection of CCS control pilot" VALUE 0x8026FF0A Val_Wu16 655.3500 RBPtCel_Perc_0p01_1 0.00 655.3500 FORMAT "%8.4" /end CHARACTERISTIC
/begin CHARACTERISTIC MonEgyChrgnInlet_ratPlgLockClsng_C "Ratio for CCS plug lock actuation request to detect locking" VALUE 0x8026FF56 Val_Ws16 799.9878 PRC -400.0000 399.9878 FORMAT "%8.4" /end CHARACTERISTIC
/begin CHARACTERISTIC MonEgyChrgnInlet_ratPlgLockOpng_C "Ratio for CCS plug lock actuation request to detect unlocking" VALUE 0x8026FF58 Val_Ws16 799.9878 PRC -400.0000 399.9878 FORMAT "%8.4" /end CHARACTERISTIC
/begin CHARACTERISTIC MonEgyChrgnInlet_ratPwmCcsCtpDigComReqMax_C "Upper threshold duty cycle for digital communication required of CCS control pilot" VALUE 0x8026FF0C Val_Wu16 655.3500 RBPtCel_Perc_0p01_1 0.00 655.3500 FORMAT "%8.4" /end CHARACTERISTIC
/begin CHARACTERISTIC MonEgyChrgnInlet_ratPwmCcsCtpDigComReqMin_C "Lower threshold duty cycle for digital communication required of CCS control pilot" VALUE 0x8026FF0E Val_Wu16 655.3500 RBPtCel_Perc_0p01_1 0.00 655.3500 FORMAT "%8.4" /end CHARACTERISTIC
/begin CHARACTERISTIC MonEgyChrgnInlet_ratPwmCcsCtpPlausAcMax_C "Upper threshold for duty cycle of plausible AC charging current CCS control pilot" VALUE 0x8026FF10 Val_Wu16 655.3500 RBPtCel_Perc_0p01_1 0.00 655.3500 FORMAT "%8.4" /end CHARACTERISTIC
/begin CHARACTERISTIC MonEgyChrgnInlet_ratPwmCcsCtpPlausAcMin_C "Lower threshold for duty cycle of plausible AC charging current CCS control pilot" VALUE 0x8026FF12 Val_Wu16 655.3500 RBPtCel_Perc_0p01_1 0.00 655.3500 FORMAT "%8.4" /end CHARACTERISTIC
/begin CHARACTERISTIC MonEgyChrgnInlet_stCcsChrgPlgSubVal_C "Substitue value for status CCS charge plug" VALUE 0x8026CF9C Val_Wu8 4.00000000000 MonEgyChrgnInlet_stCcsChrgPlg_VERB 0.00 4.00000000000 FORMAT "%13.11" /end CHARACTERISTIC
/begin CHARACTERISTIC MonEgyChrgnInlet_stCcsPlgLockSubVal_C "Substitute value for qualifier status CCS charging connector lock" VALUE 0x8026CF9D Val_Wu8 3.00000000000 MonEgyChrgnInlet_stCcsPlgLock_VERB 0.00 3.00000000000 FORMAT "%13.11" /end CHARACTERISTIC
/begin CHARACTERISTIC MonEgyChrgnInlet_stChrgPlgSubVal_C "Substitue value for status charge plug of all available installed plugs" VALUE 0x8026CF9E Val_Wu8 5.00000000000 MonEgyChrgnInlet_stChrgPlg_VERB 0.00 5.00000000000 FORMAT "%13.11" /end CHARACTERISTIC
/begin CHARACTERISTIC MonEgyChrgnInlet_stDiagCcsChrgPlgSubVal_C "Substitute value for status diagnosis CCS charge plug" VALUE 0x8026D230 Val_Wu32 4294967295.00 OneToOne 0.00 4294967295.00 FORMAT "%13.2" /end CHARACTERISTIC
/begin CHARACTERISTIC MonEgyChrgnInlet_stDiagCcsPlgLockSubVal_C "Substitute value for status diagnosis CCS charging connector lock" VALUE 0x8026CF9F Val_Wu8 255.0 OneToOne 0.00 255.0 FORMAT "%5.1" /end CHARACTERISTIC
/begin CHARACTERISTIC MonEgyChrgnInlet_stSwtCcs_C "Switch for substitute values CCS inlet plug and lock state" VALUE 0x8026CFA0 Val_Wu8 255.0 OneToOne 0.00 255.0 FORMAT "%5.1" /end CHARACTERISTIC
/begin CHARACTERISTIC MonEgyChrgnInlet_swtPxpPlausActv_C "Switch CCS proximity pilot plausibility active" VALUE 0x8026CFC1 Val_Wu8 1.00000000000 B_TRUE 0.00 1.00000000000 FORMAT "%13.11" /end CHARACTERISTIC
/begin CHARACTERISTIC MonEgyChrgnInlet_tiPerdPwmCcsCtpMax_C "Upper threshold for periodic times CCS control pilot" VALUE 0x8026D234 Val_Wu32 214.748364750 t_q5Em8_s 0.00 214.748364750 FORMAT "%13.9" /end CHARACTERISTIC
/begin CHARACTERISTIC MonEgyChrgnInlet_tiPerdPwmCcsCtpMin_C "Lower threshold for periodic times CCS control pilot" VALUE 0x8026D238 Val_Wu32 214.748364750 t_q5Em8_s 0.00 214.748364750 FORMAT "%13.9" /end CHARACTERISTIC
/begin CHARACTERISTIC MonEgyChrgnInlet_uCtpEvRdyMax_C "Upper voltage threshold for Electric Vehicle Ready plausible range in Control Pilot" VALUE 0x8026FF14 Val_Wu16 319.9951 spg_q0p00488 0.00 319.9951 FORMAT "%8.4" /end CHARACTERISTIC
/begin CHARACTERISTIC MonEgyChrgnInlet_uCtpEvRdyMin_C "Lower voltage threshold for Electric Vehicle Ready plausible range in Control Pilot" VALUE 0x8026FF16 Val_Wu16 319.9951 spg_q0p00488 0.00 319.9951 FORMAT "%8.4" /end CHARACTERISTIC
/begin CHARACTERISTIC MonEgyChrgnInlet_uCtpOlMax_C "Upper voltage threshold for Open Load plausible range in Control Pilot" VALUE 0x8026FF18 Val_Wu16 319.9951 spg_q0p00488 0.00 319.9951 FORMAT "%8.4" /end CHARACTERISTIC
/begin CHARACTERISTIC MonEgyChrgnInlet_uCtpOlMin_C "Lower voltage threshold for Open Load plausible range in Control Pilot" VALUE 0x8026FF1A Val_Wu16 319.9951 spg_q0p00488 0.00 319.9951 FORMAT "%8.4" /end CHARACTERISTIC
/begin CHARACTERISTIC MonEgyChrgnInlet_uCtpPlgCnctdMax_C "C Upper voltage threshold for Plug Connected plausible range in Control Pilot" VALUE 0x8026FF1C Val_Wu16 319.9951 spg_q0p00488 0.00 319.9951 FORMAT "%8.4" /end CHARACTERISTIC
/begin CHARACTERISTIC MonEgyChrgnInlet_uCtpPlgCnctdMin_C "C Lower voltage threshold for Plug Connected plausible range in Control Pilot" VALUE 0x8026FF1E Val_Wu16 319.9951 spg_q0p00488 0.00 319.9951 FORMAT "%8.4" /end CHARACTERISTIC
/begin CHARACTERISTIC MonEgyChrgnInlet_uCtpVentnRqrdMax_C "Upper voltage threshold for Ventilation Required plausible range in Control Pilot" VALUE 0x8026FF20 Val_Wu16 319.9951 spg_q0p00488 0.00 319.9951 FORMAT "%8.4" /end CHARACTERISTIC
/begin CHARACTERISTIC MonEgyChrgnInlet_uCtpVentnRqrdMin_C "Lower voltage threshold for Ventilation Required plausible range in Control Pilot" VALUE 0x8026FF22 Val_Wu16 319.9951 spg_q0p00488 0.00 319.9951 FORMAT "%8.4" /end CHARACTERISTIC
/begin CHARACTERISTIC MonEgyChrgnInlet_uMaxCtp_C "Upper voltage threshold for Control Pilot range check in debouncing" VALUE 0x8026FF24 Val_Wu16 319.9951 spg_q0p00488 0.00 319.9951 FORMAT "%8.4" /end CHARACTERISTIC
/begin CHARACTERISTIC MonEgyChrgnInlet_uMaxPxp_C "Upper voltage threshold for Proximity Pilot range check in debouncing" VALUE 0x8026FF26 Val_Wu16 319.9951 spg_q0p00488 0.00 319.9951 FORMAT "%8.4" /end CHARACTERISTIC
/begin CHARACTERISTIC MonEgyChrgnInlet_uMinPxp_C "Lower voltage threshold for Proximity Pilot range check in debouncing" VALUE 0x8026FF28 Val_Wu16 319.9951 spg_q0p00488 0.00 319.9951 FORMAT "%8.4" /end CHARACTERISTIC
/begin CHARACTERISTIC MonEgyChrgnInlet_uPosnClsdMax_C "Upper voltage threshold for CCS control pilot switch position closed" VALUE 0x8026FF2A Val_Ws16 79.99878 spg_q0p0012207_V -40.00000 39.99878 FORMAT "%8.5" /end CHARACTERISTIC
/begin CHARACTERISTIC MonEgyChrgnInlet_uPosnClsdMin_C "Lower voltage threshold for CCS control pilot switch switch position closed" VALUE 0x8026FF2C Val_Ws16 79.99878 spg_q0p0012207_V -40.00000 39.99878 FORMAT "%8.5" /end CHARACTERISTIC
/begin CHARACTERISTIC MonEgyChrgnInlet_uPxpTyp1FaildMax_C "Upper voltage threshold for proximity pilot type 1 failed" VALUE 0x8026FF2E Val_Wu16 319.9951 spg_q0p00488 0.00 319.9951 FORMAT "%8.4" /end CHARACTERISTIC
/begin CHARACTERISTIC MonEgyChrgnInlet_uPxpTyp1FaildMin_C "Lower voltage threshold for proximity pilot type 1 failed" VALUE 0x8026FF30 Val_Wu16 319.9951 spg_q0p00488 0.00 319.9951 FORMAT "%8.4" /end CHARACTERISTIC
/begin CHARACTERISTIC MonEgyChrgnInlet_uPxpTyp1OlMax_C "Upper voltage threshold for Open Load plausible range in Proximity Pilot Type1" VALUE 0x8026FF32 Val_Wu16 319.9951 spg_q0p00488 0.00 319.9951 FORMAT "%8.4" /end CHARACTERISTIC
/begin CHARACTERISTIC MonEgyChrgnInlet_uPxpTyp1OlMin_C "Lower voltage threshold for Open Load plausible range in Proximity Pilot Type1" VALUE 0x8026FF34 Val_Wu16 319.9951 spg_q0p00488 0.00 319.9951 FORMAT "%8.4" /end CHARACTERISTIC
/begin CHARACTERISTIC MonEgyChrgnInlet_uPxpTyp1Rng1Max_C "Upper voltage threshold for plausible Range1 in Proximity Pilot Type1" VALUE 0x8026FF36 Val_Wu16 319.9951 spg_q0p00488 0.00 319.9951 FORMAT "%8.4" /end CHARACTERISTIC
/begin CHARACTERISTIC MonEgyChrgnInlet_uPxpTyp1Rng1Min_C "Lower voltage threshold for plausible Range1 in Proximity Pilot Type1" VALUE 0x8026FF38 Val_Wu16 319.9951 spg_q0p00488 0.00 319.9951 FORMAT "%8.4" /end CHARACTERISTIC
/begin CHARACTERISTIC MonEgyChrgnInlet_uPxpTyp1Rng2Max_C "Upper voltage threshold for plausible Range2 in Proximity Pilot Type1" VALUE 0x8026FF3A Val_Wu16 319.9951 spg_q0p00488 0.00 319.9951 FORMAT "%8.4" /end CHARACTERISTIC
/begin CHARACTERISTIC MonEgyChrgnInlet_uPxpTyp1Rng2Min_C "Lower voltage threshold for plausible Range2 in Proximity Pilot Type1" VALUE 0x8026FF3C Val_Wu16 319.9951 spg_q0p00488 0.00 319.9951 FORMAT "%8.4" /end CHARACTERISTIC
/begin CHARACTERISTIC MonEgyChrgnInlet_uPxpTyp2FaildMax_C "Upper voltage threshold for proximity pilot type 2 failed" VALUE 0x8026FF3E Val_Wu16 319.9951 spg_q0p00488 0.00 319.9951 FORMAT "%8.4" /end CHARACTERISTIC
/begin CHARACTERISTIC MonEgyChrgnInlet_uPxpTyp2FaildMin_C "Lower voltage threshold for proximity pilot type 2 failed" VALUE 0x8026FF40 Val_Wu16 319.9951 spg_q0p00488 0.00 319.9951 FORMAT "%8.4" /end CHARACTERISTIC
/begin CHARACTERISTIC MonEgyChrgnInlet_uPxpTyp2OlMax_C "Upper voltage threshold for Open Load plausible range in Proximity Pilot Type2" VALUE 0x8026FF42 Val_Wu16 319.9951 spg_q0p00488 0.00 319.9951 FORMAT "%8.4" /end CHARACTERISTIC
/begin CHARACTERISTIC MonEgyChrgnInlet_uPxpTyp2OlMin_C "Lower voltage threshold for Open Load plausible range in Proximity Pilot Type2" VALUE 0x8026FF44 Val_Wu16 319.9951 spg_q0p00488 0.00 319.9951 FORMAT "%8.4" /end CHARACTERISTIC
/begin CHARACTERISTIC MonEgyChrgnInlet_uPxpTyp2Rng1Max_C "Upper voltage threshold for plausible Range1 in Proximity Pilot Type2" VALUE 0x8026FF46 Val_Wu16 319.9951 spg_q0p00488 0.00 319.9951 FORMAT "%8.4" /end CHARACTERISTIC
/begin CHARACTERISTIC MonEgyChrgnInlet_uPxpTyp2Rng1Min_C "Lower voltage threshold for plausible Range1 in Proximity Pilot Type2" VALUE 0x8026FF48 Val_Wu16 319.9951 spg_q0p00488 0.00 319.9951 FORMAT "%8.4" /end CHARACTERISTIC
/begin CHARACTERISTIC MonEgyChrgnInlet_uPxpTyp2Rng2Max_C "C Upper voltage threshold for plausible Range2 in Proximity Pilot Type2" VALUE 0x8026FF4A Val_Wu16 319.9951 spg_q0p00488 0.00 319.9951 FORMAT "%8.4" /end CHARACTERISTIC
/begin CHARACTERISTIC MonEgyChrgnInlet_uPxpTyp2Rng2Min_C "Lower voltage threshold for plausible Range2 in Proximity Pilot Type2" VALUE 0x8026FF4C Val_Wu16 319.9951 spg_q0p00488 0.00 319.9951 FORMAT "%8.4" /end CHARACTERISTIC
/begin CHARACTERISTIC MonEgyChrgnInlet_uPxpTyp2Rng3Max_C "Upper voltage threshold for plausible Range3 in Proximity Pilot Type2" VALUE 0x8026FF4E Val_Wu16 319.9951 spg_q0p00488 0.00 319.9951 FORMAT "%8.4" /end CHARACTERISTIC
/begin CHARACTERISTIC MonEgyChrgnInlet_uPxpTyp2Rng3Min_C "C Lower voltage threshold for plausible Range3 in Proximity Pilot Type2" VALUE 0x8026FF50 Val_Wu16 319.9951 spg_q0p00488 0.00 319.9951 FORMAT "%8.4" /end CHARACTERISTIC
/begin CHARACTERISTIC MonEgyChrgnInlet_uPxpTyp2Rng4Max_C "Upper voltage threshold for plausible Range4 in Proximity Pilot Type2" VALUE 0x8026FF52 Val_Wu16 319.9951 spg_q0p00488 0.00 319.9951 FORMAT "%8.4" /end CHARACTERISTIC
/begin CHARACTERISTIC MonEgyChrgnInlet_uPxpTyp2Rng4Min_C "Lower voltage threshold for plausible Range4 in Proximity Pilot Type2" VALUE 0x8026FF54 Val_Wu16 319.9951 spg_q0p00488 0.00 319.9951 FORMAT "%8.4" /end CHARACTERISTIC
/begin CHARACTERISTIC MonEgyChrgnInlet_uTrfCcsPlgLockPosn_T "Voltage transfer curve CCS plug lock position" CURVE 0x8026FECC Mo_DataCurveSstS16WS16 255.0000 OneToOne 0.00 255.0000 FORMAT "%8.4" EXTENDED_LIMITS -32768.00 32767.00
 /begin AXIS_DESCR STD_AXIS MonEgyChrgnInlet_uRawCcsPlgPosn spg_q0p0012207_V 14 -40.00000 39.99878 FORMAT "%8.5" DEPOSIT ABSOLUTE /end AXIS_DESCR
/end CHARACTERISTIC
/begin CHARACTERISTIC MonEgyChrgnT_cntrDebDifSnsr_C "Threshold for Debounce Counter Signal - plausibility error" VALUE 0x8026CFCA Val_Wu8 255.0 OneToOne 0.00 255.0 FORMAT "%5.1" /end CHARACTERISTIC
/begin CHARACTERISTIC MonEgyChrgnT_cntrDebGrdtTSnsr_C "Threshold for Debounce Counter Signal - gradient error" VALUE 0x8026FF60 Val_Wu16 65535.00 OneToOne 0.00 65535.00 FORMAT "%8.2" /end CHARACTERISTIC
/begin CHARACTERISTIC MonEgyChrgnT_cntrDebMaxTSnsr_C "Threshold for debounce counter signal-range-check below minimim value" VALUE 0x8026CFCB Val_Wu8 255.0 OneToOne 0.00 255.0 FORMAT "%5.1" /end CHARACTERISTIC
/begin CHARACTERISTIC MonEgyChrgnT_cntrHealDifSnsr_C "Threshold for Healing Counter Signal - plausibility error" VALUE 0x8026CFCC Val_Wu8 255.0 OneToOne 0.00 255.0 FORMAT "%5.1" /end CHARACTERISTIC
/begin CHARACTERISTIC MonEgyChrgnT_cntrHealGrdtTSnsr_C "Threshold for Healing Counter Signal - gradient error" VALUE 0x8026FF62 Val_Wu16 65535.00 OneToOne 0.00 65535.00 FORMAT "%8.2" /end CHARACTERISTIC
/begin CHARACTERISTIC MonEgyChrgnT_cntrHealMaxTSnsr_C "Threshold for healing counter signal-range-check above maximum value" VALUE 0x8026CFCD Val_Wu8 255.0 OneToOne 0.00 255.0 FORMAT "%5.1" /end CHARACTERISTIC
/begin CHARACTERISTIC MonEgyChrgnT_cntrIninPlausT_C "Threshold for timing counter for the indication of ongoing initial temperature plausibility and gradient check" VALUE 0x8026FF64 Val_Wu16 65535.00 OneToOne 0.00 65535.00 FORMAT "%8.2" /end CHARACTERISTIC
/begin CHARACTERISTIC MonEgyChrgnT_cntrlDebMinTSnsr_C "Threshold for Debounce Counter Signal-range-Check below minimum value" VALUE 0x8026CFCE Val_Wu8 255.0 OneToOne 0.00 255.0 FORMAT "%5.1" /end CHARACTERISTIC
/begin CHARACTERISTIC MonEgyChrgnT_cntrlHealMinTSnsr_C "Threshold for Healing Counter Signal-range-check below minimum value" VALUE 0x8026CFCF Val_Wu8 255.0 OneToOne 0.00 255.0 FORMAT "%5.1" /end CHARACTERISTIC
/begin CHARACTERISTIC MonEgyChrgnT_cntrTurnOffDlyNTP_C "Debounce counter threshold turn-off delay NTP" VALUE 0x8026CFD0 Val_Wu8 255.0 OneToOne 0.00 255.0 FORMAT "%5.1" /end CHARACTERISTIC
/begin CHARACTERISTIC MonEgyChrgnT_facAdcCnv_C "Multiplication factor for reading ADC voltage" VALUE 0x8026FF5E Val_Ws16 79.99878 spg_q0p0012207_V -40.00000 39.99878 FORMAT "%8.5" /end CHARACTERISTIC
/begin CHARACTERISTIC MonEgyChrgnT_nrBitShift_C "Numbers of places for bitshift operation" VALUE 0x8026CFC8 Val_Wu8 15.00 OneToOne 0.00 15.00 FORMAT "%5.2" EXTENDED_LIMITS 0.00 255.0 /end CHARACTERISTIC
/begin CHARACTERISTIC MonEgyChrgnT_stSnsr1SubVal_C "Substitute value for MonEgyChrgnT_stSnsr1" VALUE 0x8026CFC4 Val_Wu8 255.0 OneToOne 0.00 255.0 FORMAT "%5.1" /end CHARACTERISTIC
/begin CHARACTERISTIC MonEgyChrgnT_stSnsr2SubVal_C "Substitute value for MonEgyChrgnT_stSnsr2" VALUE 0x8026CFC5 Val_Wu8 255.0 OneToOne 0.00 255.0 FORMAT "%5.1" /end CHARACTERISTIC
/begin CHARACTERISTIC MonEgyChrgnT_stSwtDcChrgT_C "Switch for substitute values DC inlet temperature" VALUE 0x8026CFC6 Val_Wu8 255.0 OneToOne 0.00 255.0 FORMAT "%5.1" /end CHARACTERISTIC
/begin CHARACTERISTIC MonEgyChrgnT_tDifSnsr_C "Temperature threshold for synchronization check" VALUE 0x8026FF66 Val_Ws16 6553.500 RBPtCel_t_0p1_3 -3276.800 3276.700 FORMAT "%8.3" /end CHARACTERISTIC
/begin CHARACTERISTIC MonEgyChrgnT_tGrdtThd_C "Temperature threshold for the difference between two consecutive temperatures for gradient-check" VALUE 0x8026FF68 Val_Ws16 6553.500 RBPtCel_t_0p1_3 -3276.800 3276.700 FORMAT "%8.3" /end CHARACTERISTIC
/begin CHARACTERISTIC MonEgyChrgnT_tiFltGrdtTDwn_C "Threshold for filter gradient-check below minimum" VALUE 0x8026FF6A Val_Wu16 655.34999985 zk10msxs_uw_b655p36PT1 0.00000015 655.35000000 FORMAT "%12.8" EXTENDED_LIMITS 0.000000152590219 655.35000000 /end CHARACTERISTIC
/begin CHARACTERISTIC MonEgyChrgnT_tiFltGrdtTUp_C "Threshold for filter gradient check above maximum" VALUE 0x8026FF6C Val_Wu16 655.34999985 zk10msxs_uw_b655p36PT1 0.00000015 655.35000000 FORMAT "%12.8" EXTENDED_LIMITS 0.000000152590219 655.35000000 /end CHARACTERISTIC
/begin CHARACTERISTIC MonEgyChrgnT_tSnsr1ErrVal_C "Sensor1 error value" VALUE 0x8026FF6E Val_Ws16 6553.500 RBPtCel_t_0p1_3 -3276.800 3276.700 FORMAT "%8.3" /end CHARACTERISTIC
/begin CHARACTERISTIC MonEgyChrgnT_tSnsr1Max_C "Upper temperature threshold for Signal-range-check for Sensor1" VALUE 0x8026FF70 Val_Ws16 6553.500 RBPtCel_t_0p1_3 -3276.800 3276.700 FORMAT "%8.3" /end CHARACTERISTIC
/begin CHARACTERISTIC MonEgyChrgnT_tSnsr1Min_C "Lower temperature threshold for Signal-range-check for Sensor1" VALUE 0x8026FF72 Val_Ws16 6553.500 RBPtCel_t_0p1_3 -3276.800 3276.700 FORMAT "%8.3" /end CHARACTERISTIC
/begin CHARACTERISTIC MonEgyChrgnT_tSnsr1SubVal_C "Substitute value for MonEgyChrgnT_tSnsr1" VALUE 0x8026FF5A Val_Ws16 6553.500 RBPtCel_t_0p1_3 -3276.800 3276.700 FORMAT "%8.3" /end CHARACTERISTIC
/begin CHARACTERISTIC MonEgyChrgnT_tSnsr2ErrVal_C "Sensor2 error value" VALUE 0x8026FF74 Val_Ws16 6553.500 RBPtCel_t_0p1_3 -3276.800 3276.700 FORMAT "%8.3" /end CHARACTERISTIC
/begin CHARACTERISTIC MonEgyChrgnT_tSnsr2Max_C "Upper temperature threshold for Signal-range-check for Sensor2" VALUE 0x8026FF76 Val_Ws16 6553.500 RBPtCel_t_0p1_3 -3276.800 3276.700 FORMAT "%8.3" /end CHARACTERISTIC
/begin CHARACTERISTIC MonEgyChrgnT_tSnsr2Min_C "Lower temperature threshold for Signal-range-check for Sensor2" VALUE 0x8026FF78 Val_Ws16 6553.500 RBPtCel_t_0p1_3 -3276.800 3276.700 FORMAT "%8.3" /end CHARACTERISTIC
/begin CHARACTERISTIC MonEgyChrgnT_tSnsr2SubVal_C "Substitute value for MonEgyChrgnT_tSnsr2" VALUE 0x8026FF5C Val_Ws16 6553.500 RBPtCel_t_0p1_3 -3276.800 3276.700 FORMAT "%8.3" /end CHARACTERISTIC
/begin CHARACTERISTIC MonEgyChrgnT_tTrfSnsrDcChrgnIntk_T "Transfer curve for DC inlet temperature sensors" CURVE 0x8026FF7A Mo_DataCurveSstS16WS16 6553.500 RBPtCel_t_0p1_3 -3276.800 3276.700 FORMAT "%8.3"
 /begin AXIS_DESCR STD_AXIS MonEgyChrgnT_uRawDcChrgnIntkT1 spg_q0p0012207_V 10 -40.00000 39.99878 FORMAT "%8.5" DEPOSIT ABSOLUTE /end AXIS_DESCR
/end CHARACTERISTIC
/begin MEASUREMENT DFC_st.DFC_MonEgyChrgnCoorr_AcChrgnWoMofRels "" UBYTE DFC_OneToOne 1 100 0.00 255.0 FORMAT "%5.1" ECU_ADDRESS 0x60034D63 /end MEASUREMENT
/begin MEASUREMENT DFC_st.DFC_MonEgyChrgnCoorr_ChrgnAbortIgr "" UBYTE DFC_OneToOne 1 100 0.00 255.0 FORMAT "%5.1" ECU_ADDRESS 0x60034D64 /end MEASUREMENT
/begin MEASUREMENT DFC_st.DFC_MonEgyChrgnCoorr_DcCntctFailr "" UBYTE DFC_OneToOne 1 100 0.00 255.0 FORMAT "%5.1" ECU_ADDRESS 0x60034D65 /end MEASUREMENT
/begin MEASUREMENT DFC_st.DFC_MonEgyChrgnCoorr_ExtChrgnShtOffReq "" UBYTE DFC_OneToOne 1 100 0.00 255.0 FORMAT "%5.1" ECU_ADDRESS 0x60034D66 /end MEASUREMENT
/begin MEASUREMENT DFC_st.DFC_MonEgyChrgnCoorr_ImpsChrgnMod "" UBYTE DFC_OneToOne 1 100 0.00 255.0 FORMAT "%5.1" ECU_ADDRESS 0x60034D67 /end MEASUREMENT
/begin MEASUREMENT DFC_st.DFC_MonEgyChrgnCoorr_ImpsChrgnPrms "" UBYTE DFC_OneToOne 1 100 0.00 255.0 FORMAT "%5.1" ECU_ADDRESS 0x60034D68 /end MEASUREMENT
/begin MEASUREMENT DFC_st.DFC_MonEgyChrgnCoorr_ImpsUDcIntk "" UBYTE DFC_OneToOne 1 100 0.00 255.0 FORMAT "%5.1" ECU_ADDRESS 0x60034D69 /end MEASUREMENT
/begin MEASUREMENT DFC_st.DFC_MonEgyChrgnCoorr_PlgLockMovmt "" UBYTE DFC_OneToOne 1 100 0.00 255.0 FORMAT "%5.1" ECU_ADDRESS 0x60034D6A /end MEASUREMENT
/begin MEASUREMENT DFC_st.DFC_MonEgyChrgnCoorr_VehCrashDetn "" UBYTE DFC_OneToOne 1 100 0.00 255.0 FORMAT "%5.1" ECU_ADDRESS 0x60034D6B /end MEASUREMENT
/begin MEASUREMENT DFC_st.DFC_MonEgyChrgnErrReactn_SftySwt "" UBYTE DFC_OneToOne 1 100 0.00 255.0 FORMAT "%5.1" ECU_ADDRESS 0x60034D6C /end MEASUREMENT
/begin MEASUREMENT DFC_st.DFC_MonEgyChrgnInlet_CcsPlgCtp "" UBYTE DFC_OneToOne 1 100 0.00 255.0 FORMAT "%5.1" ECU_ADDRESS 0x60034D6D /end MEASUREMENT
/begin MEASUREMENT DFC_st.DFC_MonEgyChrgnInlet_CcsPlgCtpPwm "" UBYTE DFC_OneToOne 1 100 0.00 255.0 FORMAT "%5.1" ECU_ADDRESS 0x60034D6E /end MEASUREMENT
/begin MEASUREMENT DFC_st.DFC_MonEgyChrgnInlet_CcsPlgLockCtrlImpsAtmpt "" UBYTE DFC_OneToOne 1 100 0.00 255.0 FORMAT "%5.1" ECU_ADDRESS 0x60034D6F /end MEASUREMENT
/begin MEASUREMENT DFC_st.DFC_MonEgyChrgnInlet_CcsPlgLockSnsrSigRngChk "" UBYTE DFC_OneToOne 1 100 0.00 255.0 FORMAT "%5.1" ECU_ADDRESS 0x60034D70 /end MEASUREMENT
/begin MEASUREMENT DFC_st.DFC_MonEgyChrgnInlet_CcsPlgLockStImps "" UBYTE DFC_OneToOne 1 100 0.00 255.0 FORMAT "%5.1" ECU_ADDRESS 0x60034D71 /end MEASUREMENT
/begin MEASUREMENT DFC_st.DFC_MonEgyChrgnInlet_CcsPlgPxp "" UBYTE DFC_OneToOne 1 100 0.00 255.0 FORMAT "%5.1" ECU_ADDRESS 0x60034D72 /end MEASUREMENT
/begin MEASUREMENT DFC_st.DFC_MonEgyChrgnT_Snsr1GrdtChk "" UBYTE DFC_OneToOne 1 100 0.00 255.0 FORMAT "%5.1" ECU_ADDRESS 0x60034D73 /end MEASUREMENT
/begin MEASUREMENT DFC_st.DFC_MonEgyChrgnT_Snsr1SigRngChk "" UBYTE DFC_OneToOne 1 100 0.00 255.0 FORMAT "%5.1" ECU_ADDRESS 0x60034D74 /end MEASUREMENT
/begin MEASUREMENT DFC_st.DFC_MonEgyChrgnT_Snsr2GrdtChk "" UBYTE DFC_OneToOne 1 100 0.00 255.0 FORMAT "%5.1" ECU_ADDRESS 0x60034D75 /end MEASUREMENT
/begin MEASUREMENT DFC_st.DFC_MonEgyChrgnT_Snsr2SigRngChk "" UBYTE DFC_OneToOne 1 100 0.00 255.0 FORMAT "%5.1" ECU_ADDRESS 0x60034D76 /end MEASUREMENT
/begin MEASUREMENT DFC_st.DFC_MonEgyChrgnT_SnsrDif "" UBYTE DFC_OneToOne 1 100 0.00 255.0 FORMAT "%5.1" ECU_ADDRESS 0x60034D77 /end MEASUREMENT
/begin MEASUREMENT MonEgyChrgnCoorrCoorr_bbLoc1Cpl "Complement of MonEgyChrgnCoorrCoorr_bbLoc1" UBYTE OneToOne 1 100 0.00 255.0 FORMAT "%5.1" ECU_ADDRESS 0x6002B9B6
 /begin IF_DATA XCPplus 0x0102
  /begin DAQ_EVENT VARIABLE /end DAQ_EVENT
 /end IF_DATA
/end MEASUREMENT
/begin MEASUREMENT MonEgyChrgnCoorrCoorr_bbLoc2Cpl "Complement of MonEgyChrgnCoorrCoorr_bbLoc2" UBYTE OneToOne 1 100 0.00 255.0 FORMAT "%5.1" ECU_ADDRESS 0x6002B9B5
 /begin IF_DATA XCPplus 0x0102
  /begin DAQ_EVENT VARIABLE /end DAQ_EVENT
 /end IF_DATA
/end MEASUREMENT
/begin MEASUREMENT MonEgyChrgnCoorrPreProc_bbOut1Cpl "Complement of MonEgyChrgnCoorrPreProc_bbOut1" UBYTE OneToOne 1 100 0.00 255.0 FORMAT "%5.1" ECU_ADDRESS 0x6002B996
 /begin IF_DATA XCPplus 0x0102
  /begin DAQ_EVENT VARIABLE /end DAQ_EVENT
 /end IF_DATA
/end MEASUREMENT
/begin MEASUREMENT MonEgyChrgnCoorr_cntrAcChrgnWoMofRelsErr "Debounce counter for detection AC charging without Level 2 permission" UBYTE OneToOne 1 100 0.00 255.0 FORMAT "%5.1" ECU_ADDRESS 0x6002C3D0
 /begin IF_DATA XCPplus 0x0102
  /begin DAQ_EVENT VARIABLE /end DAQ_EVENT
 /end IF_DATA
/end MEASUREMENT
/begin MEASUREMENT MonEgyChrgnCoorr_cntrAcChrgnWoMofRelsErrCpl "Complement of MonEgyChrgnCoorr_cntrAcChrgnWoMofRelsErr" UBYTE OneToOne 1 100 0.00 255.0 FORMAT "%5.1" ECU_ADDRESS 0x6002B9B4
 /begin IF_DATA XCPplus 0x0102
  /begin DAQ_EVENT VARIABLE /end DAQ_EVENT
 /end IF_DATA
/end MEASUREMENT
/begin MEASUREMENT MonEgyChrgnCoorr_cntrCcsPlgLockMovmtErr "Debounce counter for detection erroneous movement of the plug lock pin" UBYTE OneToOne 1 100 0.00 255.0 FORMAT "%5.1" ECU_ADDRESS 0x6002C3CF
 /begin IF_DATA XCPplus 0x0102
  /begin DAQ_EVENT VARIABLE /end DAQ_EVENT
 /end IF_DATA
/end MEASUREMENT
/begin MEASUREMENT MonEgyChrgnCoorr_cntrCcsPlgLockMovmtErrCpl "Complement of MonEgyChrgnCoorr_cntrCcsPlgLockMovmtErr" UBYTE OneToOne 1 100 0.00 255.0 FORMAT "%5.1" ECU_ADDRESS 0x6002B9B3
 /begin IF_DATA XCPplus 0x0102
  /begin DAQ_EVENT VARIABLE /end DAQ_EVENT
 /end IF_DATA
/end MEASUREMENT
/begin MEASUREMENT MonEgyChrgnCoorr_cntrChrgnAbortErr "Debounce counter for charging abort violation error" UBYTE OneToOne 1 100 0.00 255.0 FORMAT "%5.1" ECU_ADDRESS 0x6002C3CE
 /begin IF_DATA XCPplus 0x0102
  /begin DAQ_EVENT VARIABLE /end DAQ_EVENT
 /end IF_DATA
/end MEASUREMENT
/begin MEASUREMENT MonEgyChrgnCoorr_cntrChrgnAbortErrCpl "Complement of MonEgyChrgnCoorr_cntrChrgnAbortErr" UBYTE OneToOne 1 100 0.00 255.0 FORMAT "%5.1" ECU_ADDRESS 0x6002B9B2
 /begin IF_DATA XCPplus 0x0102
  /begin DAQ_EVENT VARIABLE /end DAQ_EVENT
 /end IF_DATA
/end MEASUREMENT
/begin MEASUREMENT MonEgyChrgnCoorr_cntrDcCntctErr "Debounce counter for DC contactor failure" UBYTE OneToOne 1 100 0.00 255.0 FORMAT "%5.1" ECU_ADDRESS 0x6002C3CD
 /begin IF_DATA XCPplus 0x0102
  /begin DAQ_EVENT VARIABLE /end DAQ_EVENT
 /end IF_DATA
/end MEASUREMENT
/begin MEASUREMENT MonEgyChrgnCoorr_cntrDcCntctErrCpl "Complement of MonEgyChrgnCoorr_cntrDcCntctErr" UBYTE OneToOne 1 100 0.00 255.0 FORMAT "%5.1" ECU_ADDRESS 0x6002B9B1
 /begin IF_DATA XCPplus 0x0102
  /begin DAQ_EVENT VARIABLE /end DAQ_EVENT
 /end IF_DATA
/end MEASUREMENT
/begin MEASUREMENT MonEgyChrgnCoorr_cntrImpsChrgnModeErr "Debounce counter for implausible charging mode error" UBYTE OneToOne 1 100 0.00 255.0 FORMAT "%5.1" ECU_ADDRESS 0x6002C3CC
 /begin IF_DATA XCPplus 0x0102
  /begin DAQ_EVENT VARIABLE /end DAQ_EVENT
 /end IF_DATA
/end MEASUREMENT
/begin MEASUREMENT MonEgyChrgnCoorr_cntrImpsChrgnModeErrCpl "Complement of MonEgyChrgnCoorr_cntrImpsChrgModeErr" UBYTE OneToOne 1 100 0.00 255.0 FORMAT "%5.1" ECU_ADDRESS 0x6002B9B0
 /begin IF_DATA XCPplus 0x0102
  /begin DAQ_EVENT VARIABLE /end DAQ_EVENT
 /end IF_DATA
/end MEASUREMENT
/begin MEASUREMENT MonEgyChrgnCoorr_cntrImpsChrgnPrmsErr "Debounce counter for implausible charging permission error" UBYTE OneToOne 1 100 0.00 255.0 FORMAT "%5.1" ECU_ADDRESS 0x6002C3CB
 /begin IF_DATA XCPplus 0x0102
  /begin DAQ_EVENT VARIABLE /end DAQ_EVENT
 /end IF_DATA
/end MEASUREMENT
/begin MEASUREMENT MonEgyChrgnCoorr_cntrImpsChrgnPrmsErrCpl "Complement of MonEgyChrgnCoorr_cntrImpsChrgnPrmsErr" UBYTE OneToOne 1 100 0.00 255.0 FORMAT "%5.1" ECU_ADDRESS 0x6002B9AF
 /begin IF_DATA XCPplus 0x0102
  /begin DAQ_EVENT VARIABLE /end DAQ_EVENT
 /end IF_DATA
/end MEASUREMENT
/begin MEASUREMENT MonEgyChrgnCoorr_cntrImpsUDcIntkErr "Debounce counter for implausible voltage on DC inlet error" UBYTE OneToOne 1 100 0.00 255.0 FORMAT "%5.1" ECU_ADDRESS 0x6002C3CA
 /begin IF_DATA XCPplus 0x0102
  /begin DAQ_EVENT VARIABLE /end DAQ_EVENT
 /end IF_DATA
/end MEASUREMENT
/begin MEASUREMENT MonEgyChrgnCoorr_cntrImpsUDcIntkErrCpl "Complement of MonEgyChrgnCoorr_cntrUDcIntkErr" UBYTE OneToOne 1 100 0.00 255.0 FORMAT "%5.1" ECU_ADDRESS 0x6002B9AE
 /begin IF_DATA XCPplus 0x0102
  /begin DAQ_EVENT VARIABLE /end DAQ_EVENT
 /end IF_DATA
/end MEASUREMENT
/begin MEASUREMENT MonEgyChrgnCoorr_cntrTurnOnDlyAcChrgMod "Debounce counter for AC charge mode detection" UBYTE OneToOne 1 100 0.00 255.0 FORMAT "%5.1" ECU_ADDRESS 0x6002C3C9
 /begin IF_DATA XCPplus 0x0102
  /begin DAQ_EVENT VARIABLE /end DAQ_EVENT
 /end IF_DATA
/end MEASUREMENT
/begin MEASUREMENT MonEgyChrgnCoorr_cntrTurnOnDlyAcChrgModCpl "Complement of MonEgyChrgnCoorr_cntrTurnOnDlyChrgMod" UBYTE OneToOne 1 100 0.00 255.0 FORMAT "%5.1" ECU_ADDRESS 0x6002B9AD
 /begin IF_DATA XCPplus 0x0102
  /begin DAQ_EVENT VARIABLE /end DAQ_EVENT
 /end IF_DATA
/end MEASUREMENT
/begin MEASUREMENT MonEgyChrgnCoorr_cntrTurnOnDlyAcChrgnPrms "Debounce counter for AC charging permission" UBYTE OneToOne 1 100 0.00 255.0 FORMAT "%5.1" ECU_ADDRESS 0x6002C3C8
 /begin IF_DATA XCPplus 0x0102
  /begin DAQ_EVENT VARIABLE /end DAQ_EVENT
 /end IF_DATA
/end MEASUREMENT
/begin MEASUREMENT MonEgyChrgnCoorr_cntrTurnOnDlyAcChrgnPrmsCpl "Complement of MonEgyChrgnCoorr_cntrTurnOnDlyAcChrgnPrms" UBYTE OneToOne 1 100 0.00 255.0 FORMAT "%5.1" ECU_ADDRESS 0x6002B9AC
 /begin IF_DATA XCPplus 0x0102
  /begin DAQ_EVENT VARIABLE /end DAQ_EVENT
 /end IF_DATA
/end MEASUREMENT
/begin MEASUREMENT MonEgyChrgnCoorr_cntrTurnOnDlyDcChrgMod "Debounce counter for DC charge mode detection" UBYTE OneToOne 1 100 0.00 255.0 FORMAT "%5.1" ECU_ADDRESS 0x6002C3C7
 /begin IF_DATA XCPplus 0x0102
  /begin DAQ_EVENT VARIABLE /end DAQ_EVENT
 /end IF_DATA
/end MEASUREMENT
/begin MEASUREMENT MonEgyChrgnCoorr_cntrTurnOnDlyDcChrgModCpl "Complement of MonEgyChrgnCoorr_cntrTurnOnDlyDcChrgMod" UBYTE OneToOne 1 100 0.00 255.0 FORMAT "%5.1" ECU_ADDRESS 0x6002B9AB
 /begin IF_DATA XCPplus 0x0102
  /begin DAQ_EVENT VARIABLE /end DAQ_EVENT
 /end IF_DATA
/end MEASUREMENT
/begin MEASUREMENT MonEgyChrgnCoorr_cntrTurnOnDlyDcChrgnPrms "Debounce counter for DC charging permission" UBYTE OneToOne 1 100 0.00 255.0 FORMAT "%5.1" ECU_ADDRESS 0x6002C3C6
 /begin IF_DATA XCPplus 0x0102
  /begin DAQ_EVENT VARIABLE /end DAQ_EVENT
 /end IF_DATA
/end MEASUREMENT
/begin MEASUREMENT MonEgyChrgnCoorr_cntrTurnOnDlyDcChrgnPrmsCpl "Complement of MonEgyChrgnCoorr_cntrTurnOnDlyDcChrgnPrms" UBYTE OneToOne 1 100 0.00 255.0 FORMAT "%5.1" ECU_ADDRESS 0x6002B9AA
 /begin IF_DATA XCPplus 0x0102
  /begin DAQ_EVENT VARIABLE /end DAQ_EVENT
 /end IF_DATA
/end MEASUREMENT
/begin MEASUREMENT MonEgyChrgnCoorr_flgAcChrgnPtdPlgSt "Status flag AC charging permitted regarding plug status" UBYTE B_TRUE 1 100 0.00 1.00000000000 BIT_MASK 0x1 FORMAT "%13.11" ECU_ADDRESS 0x6002C3D2
 /begin IF_DATA XCPplus 0x0102
  /begin DAQ_EVENT VARIABLE /end DAQ_EVENT
 /end IF_DATA
/end MEASUREMENT
/begin MEASUREMENT MonEgyChrgnCoorr_flgAcChrgnWoMofRelsErr "Status flag AC charging without Level 2 permission error" UBYTE B_TRUE 1 100 0.00 1.00000000000 BIT_MASK 0x8 FORMAT "%13.11" ECU_ADDRESS 0x6002C3D2
 /begin IF_DATA XCPplus 0x0102
  /begin DAQ_EVENT VARIABLE /end DAQ_EVENT
 /end IF_DATA
/end MEASUREMENT
/begin MEASUREMENT MonEgyChrgnCoorr_flgChrgnAbortErr "Status flag error charging abort" UBYTE B_TRUE 1 100 0.00 1.00000000000 BIT_MASK 0x80 FORMAT "%13.11" ECU_ADDRESS 0x6002C3D2
 /begin IF_DATA XCPplus 0x0102
  /begin DAQ_EVENT VARIABLE /end DAQ_EVENT
 /end IF_DATA
/end MEASUREMENT
/begin MEASUREMENT MonEgyChrgnCoorr_flgChrgnStopReq "Status flag charging stop requested" UBYTE B_TRUE 1 100 0.00 1.00000000000 BIT_MASK 0x2 FORMAT "%13.11" ECU_ADDRESS 0x6002C3D2
 /begin IF_DATA XCPplus 0x0102
  /begin DAQ_EVENT VARIABLE /end DAQ_EVENT
 /end IF_DATA
/end MEASUREMENT
/begin MEASUREMENT MonEgyChrgnCoorr_flgDcChrgnPtdPlgSt "Status flag DC charging permitted regarding plug status" UBYTE B_TRUE 1 100 0.00 1.00000000000 BIT_MASK 0x4 FORMAT "%13.11" ECU_ADDRESS 0x6002C3D2
 /begin IF_DATA XCPplus 0x0102
  /begin DAQ_EVENT VARIABLE /end DAQ_EVENT
 /end IF_DATA
/end MEASUREMENT
/begin MEASUREMENT MonEgyChrgnCoorr_flgDcChrgnPtdT "Status flag DC charging permitted regarding DC inlet temperature" UBYTE B_TRUE 1 100 0.00 1.00000000000 BIT_MASK 0x1 FORMAT "%13.11" ECU_ADDRESS 0x6002C3B2
 /begin IF_DATA XCPplus 0x0102
  /begin DAQ_EVENT VARIABLE /end DAQ_EVENT
 /end IF_DATA
/end MEASUREMENT
/begin MEASUREMENT MonEgyChrgnCoorr_flgDcCntctErr "Status flag DC contactor failure" UBYTE B_TRUE 1 100 0.00 1.00000000000 BIT_MASK 0x20 FORMAT "%13.11" ECU_ADDRESS 0x6002C3D1
 /begin IF_DATA XCPplus 0x0102
  /begin DAQ_EVENT VARIABLE /end DAQ_EVENT
 /end IF_DATA
/end MEASUREMENT
/begin MEASUREMENT MonEgyChrgnCoorr_flgImpsChrgnModErr "Flag implausible charging mode error" UBYTE B_TRUE 1 100 0.00 1.00000000000 BIT_MASK 0x2 FORMAT "%13.11" ECU_ADDRESS 0x6002C3D1
 /begin IF_DATA XCPplus 0x0102
  /begin DAQ_EVENT VARIABLE /end DAQ_EVENT
 /end IF_DATA
/end MEASUREMENT
/begin MEASUREMENT MonEgyChrgnCoorr_flgImpsChrgnPrmsErr "Status flag error implausible charging permission" UBYTE B_TRUE 1 100 0.00 1.00000000000 BIT_MASK 0x4 FORMAT "%13.11" ECU_ADDRESS 0x6002C3D1
 /begin IF_DATA XCPplus 0x0102
  /begin DAQ_EVENT VARIABLE /end DAQ_EVENT
 /end IF_DATA
/end MEASUREMENT
/begin MEASUREMENT MonEgyChrgnCoorr_flgImpsUDcIntkErr "Status flag implausible voltage on DC inlet" UBYTE B_TRUE 1 100 0.00 1.00000000000 BIT_MASK 0x10 FORMAT "%13.11" ECU_ADDRESS 0x6002C3D1
 /begin IF_DATA XCPplus 0x0102
  /begin DAQ_EVENT VARIABLE /end DAQ_EVENT
 /end IF_DATA
/end MEASUREMENT
/begin MEASUREMENT MonEgyChrgnCoorr_flgNoChrgn "Flag no charging" UBYTE B_TRUE 1 100 0.00 1.00000000000 BIT_MASK 0x10 FORMAT "%13.11" ECU_ADDRESS 0x6002C3D2
 /begin IF_DATA XCPplus 0x0102
  /begin DAQ_EVENT VARIABLE /end DAQ_EVENT
 /end IF_DATA
/end MEASUREMENT
/begin MEASUREMENT MonEgyChrgnCoorr_flgPlgLockMovmtErr "Status flag erroneous movement of the plug lock pin" UBYTE B_TRUE 1 100 0.00 1.00000000000 BIT_MASK 0x8 FORMAT "%13.11" ECU_ADDRESS 0x6002C3D1
 /begin IF_DATA XCPplus 0x0102
  /begin DAQ_EVENT VARIABLE /end DAQ_EVENT
 /end IF_DATA
/end MEASUREMENT
/begin MEASUREMENT MonEgyChrgnCoorr_flgVehChrgnCdn "Status flag DC charging permitted regarding vehicle conditions" UBYTE B_TRUE 1 100 0.00 1.00000000000 BIT_MASK 0x2 FORMAT "%13.11" ECU_ADDRESS 0x6002C3B2
 /begin IF_DATA XCPplus 0x0102
  /begin DAQ_EVENT VARIABLE /end DAQ_EVENT
 /end IF_DATA
/end MEASUREMENT
/begin MEASUREMENT MonEgyChrgnCoorr_flgVehNotMovg "Flag vehicle not moving" UBYTE B_TRUE 1 100 0.00 1.00000000000 BIT_MASK 0x4 FORMAT "%13.11" ECU_ADDRESS 0x6002C3B2
 /begin IF_DATA XCPplus 0x0102
  /begin DAQ_EVENT VARIABLE /end DAQ_EVENT
 /end IF_DATA
/end MEASUREMENT
/begin MEASUREMENT MonEgyChrgnCoorr_stActChrgMod "Status actual charge mode" UBYTE MonEgyChrgnCoorr_stActChrgMod_VERB 1 100 0.00 6.00000000000 FORMAT "%13.11" ECU_ADDRESS 0x6002C3BF
 /begin IF_DATA XCPplus 0x0102
  /begin DAQ_EVENT VARIABLE /end DAQ_EVENT
 /end IF_DATA
/end MEASUREMENT
/begin MEASUREMENT MonEgyChrgnCoorr_stActChrgModCpl "Complement of MonEgyChrgnCoorr_stActChrgMod" UBYTE OneToOne 1 100 0.00 255.0 FORMAT "%5.1" ECU_ADDRESS 0x6002B9A9
 /begin IF_DATA XCPplus 0x0102
  /begin DAQ_EVENT VARIABLE /end DAQ_EVENT
 /end IF_DATA
/end MEASUREMENT
/begin MEASUREMENT MonEgyChrgnCoorr_stActChrgModIf "Status actual charging mode" UBYTE MonEgyChrgnCoorr_stActChrgMod_VERB 1 100 0.00 6.00000000000 FORMAT "%13.11" ECU_ADDRESS 0x6002C3B9
 /begin IF_DATA XCPplus 0x0102
  /begin DAQ_EVENT VARIABLE /end DAQ_EVENT
 /end IF_DATA
/end MEASUREMENT
/begin MEASUREMENT MonEgyChrgnCoorr_stActChrgModIfCpl "Complement of MonEgyChrgnCoorr_stActChrgModIf" UBYTE OneToOne 1 100 0.00 255.0 FORMAT "%5.1" ECU_ADDRESS 0x6002B99D
 /begin IF_DATA XCPplus 0x0102
  /begin DAQ_EVENT VARIABLE /end DAQ_EVENT
 /end IF_DATA
/end MEASUREMENT
/begin MEASUREMENT MonEgyChrgnCoorr_stCcsAc "Status CCS AC charging" UBYTE MonEgyChrgnCoorr_stChrgnCom_VERB 1 100 0.00 3.00000000000 FORMAT "%13.11" ECU_ADDRESS 0x6002C3C5
 /begin IF_DATA XCPplus 0x0102
  /begin DAQ_EVENT VARIABLE /end DAQ_EVENT
 /end IF_DATA
/end MEASUREMENT
/begin MEASUREMENT MonEgyChrgnCoorr_stCcsAcChrgn "Status CCS AC charging permission" UBYTE MonEgyChrgnCoorr_stChrgn_VERB 1 100 0.00 2.00000000000 FORMAT "%13.11" ECU_ADDRESS 0x6002C3C4
 /begin IF_DATA XCPplus 0x0102
  /begin DAQ_EVENT VARIABLE /end DAQ_EVENT
 /end IF_DATA
/end MEASUREMENT
/begin MEASUREMENT MonEgyChrgnCoorr_stCcsAcChrgnCpl "Complement of MonEgyChrgnCoorr_stCcsAcChrgn" UBYTE OneToOne 1 100 0.00 255.0 FORMAT "%5.1" ECU_ADDRESS 0x6002B9A8
 /begin IF_DATA XCPplus 0x0102
  /begin DAQ_EVENT VARIABLE /end DAQ_EVENT
 /end IF_DATA
/end MEASUREMENT
/begin MEASUREMENT MonEgyChrgnCoorr_stCcsAcCpl "Complement of MonEgyChrgnCoorr_stCcsAc" UBYTE OneToOne 1 100 0.00 255.0 FORMAT "%5.1" ECU_ADDRESS 0x6002B9A7
 /begin IF_DATA XCPplus 0x0102
  /begin DAQ_EVENT VARIABLE /end DAQ_EVENT
 /end IF_DATA
/end MEASUREMENT
/begin MEASUREMENT MonEgyChrgnCoorr_stCcsDc "Status CCS DC charging" UBYTE MonEgyChrgnCoorr_stChrgnCom_VERB 1 100 0.00 3.00000000000 FORMAT "%13.11" ECU_ADDRESS 0x6002C3C3
 /begin IF_DATA XCPplus 0x0102
  /begin DAQ_EVENT VARIABLE /end DAQ_EVENT
 /end IF_DATA
/end MEASUREMENT
/begin MEASUREMENT MonEgyChrgnCoorr_stCcsDcChrgn "Status CCS DC charging permission" UBYTE MonEgyChrgnCoorr_stChrgn_VERB 1 100 0.00 2.00000000000 FORMAT "%13.11" ECU_ADDRESS 0x6002C3C2
 /begin IF_DATA XCPplus 0x0102
  /begin DAQ_EVENT VARIABLE /end DAQ_EVENT
 /end IF_DATA
/end MEASUREMENT
/begin MEASUREMENT MonEgyChrgnCoorr_stCcsDcChrgnCpl "Complement of MonEgyChrgnCoorr_stCcsDcChrgn" UBYTE OneToOne 1 100 0.00 255.0 FORMAT "%5.1" ECU_ADDRESS 0x6002B9A6
 /begin IF_DATA XCPplus 0x0102
  /begin DAQ_EVENT VARIABLE /end DAQ_EVENT
 /end IF_DATA
/end MEASUREMENT
/begin MEASUREMENT MonEgyChrgnCoorr_stCcsDcCpl "Complement of MonEgyChrgnCoorr_stCcsDc" UBYTE OneToOne 1 100 0.00 255.0 FORMAT "%5.1" ECU_ADDRESS 0x6002B9A5
 /begin IF_DATA XCPplus 0x0102
  /begin DAQ_EVENT VARIABLE /end DAQ_EVENT
 /end IF_DATA
/end MEASUREMENT
/begin MEASUREMENT MonEgyChrgnCoorr_stCcsUnlckPlgLockPtd "Status CCS unlock plug lock permitted" UBYTE MonEgyChrgnCoorr_stUnlckPlgLockPtd_VERB 1 100 0.00 1.00000000000 FORMAT "%13.11" ECU_ADDRESS 0x6002C3BE
 /begin IF_DATA XCPplus 0x0102
  /begin DAQ_EVENT VARIABLE /end DAQ_EVENT
 /end IF_DATA
/end MEASUREMENT
/begin MEASUREMENT MonEgyChrgnCoorr_stCcsUnlckPlgLockPtdCpl "Complement of MonEgyChrgnCoorr_stCcsUnlckPlgLockPtd" UBYTE OneToOne 1 100 0.00 255.0 FORMAT "%5.1" ECU_ADDRESS 0x6002B9A4
 /begin IF_DATA XCPplus 0x0102
  /begin DAQ_EVENT VARIABLE /end DAQ_EVENT
 /end IF_DATA
/end MEASUREMENT
/begin MEASUREMENT MonEgyChrgnCoorr_stCcsUnlckPlgLockPtdIf "Status CCS unlock plug lock permitted" UBYTE MonEgyChrgnCoorr_stUnlckPlgLockPtd_VERB 1 100 0.00 1.00000000000 FORMAT "%13.11" ECU_ADDRESS 0x6002C3B8
 /begin IF_DATA XCPplus 0x0102
  /begin DAQ_EVENT VARIABLE /end DAQ_EVENT
 /end IF_DATA
/end MEASUREMENT
/begin MEASUREMENT MonEgyChrgnCoorr_stCcsUnlckPlgLockPtdIfCpl "Complement of MonEgyChrgnCoorr_stCcsUnlckPlgLockPtdIf" UBYTE OneToOne 1 100 0.00 255.0 FORMAT "%5.1" ECU_ADDRESS 0x6002B99C
 /begin IF_DATA XCPplus 0x0102
  /begin DAQ_EVENT VARIABLE /end DAQ_EVENT
 /end IF_DATA
/end MEASUREMENT
/begin MEASUREMENT MonEgyChrgnCoorr_stCcsUnlckPlgLockPtdMsg "Status CCS unlock plug lock permitted message" UBYTE MonEgyChrgnCoorr_stUnlckPlgLockPtd_VERB 1 100 0.00 1.00000000000 FORMAT "%13.11" ECU_ADDRESS 0x60023520
 /begin IF_DATA XCPplus 0x0102
  /begin DAQ_EVENT VARIABLE /end DAQ_EVENT
 /end IF_DATA
/end MEASUREMENT
/begin MEASUREMENT MonEgyChrgnCoorr_stChrgModSeld "Status charging mode selected" UBYTE MonEgyChrgnCoorr_stActChrgMod_VERB 1 100 0.00 6.00000000000 FORMAT "%13.11" ECU_ADDRESS 0x6002C3C1
 /begin IF_DATA XCPplus 0x0102
  /begin DAQ_EVENT VARIABLE /end DAQ_EVENT
 /end IF_DATA
/end MEASUREMENT
/begin MEASUREMENT MonEgyChrgnCoorr_stChrgModSeldCpl "Complement of MonEgyChrgnCoorr_stChrgModSeld" UBYTE OneToOne 1 100 0.00 255.0 FORMAT "%5.1" ECU_ADDRESS 0x6002B9A3
 /begin IF_DATA XCPplus 0x0102
  /begin DAQ_EVENT VARIABLE /end DAQ_EVENT
 /end IF_DATA
/end MEASUREMENT
/begin MEASUREMENT MonEgyChrgnCoorr_stChrgn "Status charging" UBYTE MonEgyChrgnCoorr_stChrgn_VERB 1 100 0.00 2.00000000000 FORMAT "%13.11" ECU_ADDRESS 0x6002C3BD
 /begin IF_DATA XCPplus 0x0102
  /begin DAQ_EVENT VARIABLE /end DAQ_EVENT
 /end IF_DATA
/end MEASUREMENT
/begin MEASUREMENT MonEgyChrgnCoorr_stChrgnCpl "Complement of MonEgyChrgnCoorr_stChrgn" UBYTE OneToOne 1 100 0.00 255.0 FORMAT "%5.1" ECU_ADDRESS 0x6002B9A2
 /begin IF_DATA XCPplus 0x0102
  /begin DAQ_EVENT VARIABLE /end DAQ_EVENT
 /end IF_DATA
/end MEASUREMENT
/begin MEASUREMENT MonEgyChrgnCoorr_stChrgnIf "Status charging" UBYTE MonEgyChrgnCoorr_stChrgn_VERB 1 100 0.00 2.00000000000 FORMAT "%13.11" ECU_ADDRESS 0x6002C3B7
 /begin IF_DATA XCPplus 0x0102
  /begin DAQ_EVENT VARIABLE /end DAQ_EVENT
 /end IF_DATA
/end MEASUREMENT
/begin MEASUREMENT MonEgyChrgnCoorr_stChrgnIfCpl "Complement of MonEgyChrgnCoorr_stChrgnIf" UBYTE OneToOne 1 100 0.00 255.0 FORMAT "%5.1" ECU_ADDRESS 0x6002B99B
 /begin IF_DATA XCPplus 0x0102
  /begin DAQ_EVENT VARIABLE /end DAQ_EVENT
 /end IF_DATA
/end MEASUREMENT
/begin MEASUREMENT MonEgyChrgnCoorr_stDrvRdn "Status driving readiness" UBYTE MonEgyChrgnCoorr_stDrvRdn_VERB 1 100 0.00 1.00000000000 FORMAT "%13.11" ECU_ADDRESS 0x6002C3BC
 /begin IF_DATA XCPplus 0x0102
  /begin DAQ_EVENT VARIABLE /end DAQ_EVENT
 /end IF_DATA
/end MEASUREMENT
/begin MEASUREMENT MonEgyChrgnCoorr_stDrvRdnCpl "Complement of MonEgyChrgnCoorr_stDrvRdn" UBYTE OneToOne 1 100 0.00 255.0 FORMAT "%5.1" ECU_ADDRESS 0x6002B9A1
 /begin IF_DATA XCPplus 0x0102
  /begin DAQ_EVENT VARIABLE /end DAQ_EVENT
 /end IF_DATA
/end MEASUREMENT
/begin MEASUREMENT MonEgyChrgnCoorr_stDrvRdnIf "Status driving readiness" UBYTE MonEgyChrgnCoorr_stDrvRdn_VERB 1 100 0.00 1.00000000000 FORMAT "%13.11" ECU_ADDRESS 0x6002C3B6
 /begin IF_DATA XCPplus 0x0102
  /begin DAQ_EVENT VARIABLE /end DAQ_EVENT
 /end IF_DATA
/end MEASUREMENT
/begin MEASUREMENT MonEgyChrgnCoorr_stDrvRdnIfCpl "Complement of MonEgyChrgnCoorr_stDrvRdnIf" UBYTE OneToOne 1 100 0.00 255.0 FORMAT "%5.1" ECU_ADDRESS 0x6002B99A
 /begin IF_DATA XCPplus 0x0102
  /begin DAQ_EVENT VARIABLE /end DAQ_EVENT
 /end IF_DATA
/end MEASUREMENT
/begin MEASUREMENT MonEgyChrgnCoorr_stSeldChrgnPrms "Status selected charging permission" UBYTE MonEgyChrgnCoorr_stChrgn_VERB 1 100 0.00 2.00000000000 FORMAT "%13.11" ECU_ADDRESS 0x6002C3C0
 /begin IF_DATA XCPplus 0x0102
  /begin DAQ_EVENT VARIABLE /end DAQ_EVENT
 /end IF_DATA
/end MEASUREMENT
/begin MEASUREMENT MonEgyChrgnCoorr_stSeldChrgnPrmsCpl "Complement of MonEgyChrgnCoorr_stSeldChrgnPrms" UBYTE OneToOne 1 100 0.00 255.0 FORMAT "%5.1" ECU_ADDRESS 0x6002B9A0
 /begin IF_DATA XCPplus 0x0102
  /begin DAQ_EVENT VARIABLE /end DAQ_EVENT
 /end IF_DATA
/end MEASUREMENT
/begin MEASUREMENT MonEgyChrgnCoorr_stSftyErr "Status information safety errors" UWORD OneToOne 1 100 0.00 65535.00 FORMAT "%8.2" ECU_ADDRESS 0x6002C3BA
 /begin IF_DATA XCPplus 0x0102
  /begin DAQ_EVENT VARIABLE /end DAQ_EVENT
 /end IF_DATA
/end MEASUREMENT
/begin MEASUREMENT MonEgyChrgnCoorr_stSftyErrCpl "Complement of MonEgyChrgnCoorr_stSftyErr" UWORD OneToOne 1 100 0.00 65535.00 FORMAT "%8.2" ECU_ADDRESS 0x6002B99E
 /begin IF_DATA XCPplus 0x0102
  /begin DAQ_EVENT VARIABLE /end DAQ_EVENT
 /end IF_DATA
/end MEASUREMENT
/begin MEASUREMENT MonEgyChrgnCoorr_stSftyErrIf "Status safety error" UWORD OneToOne 1 100 0.00 65535.00 FORMAT "%8.2" ECU_ADDRESS 0x6002C3B4
 /begin IF_DATA XCPplus 0x0102
  /begin DAQ_EVENT VARIABLE /end DAQ_EVENT
 /end IF_DATA
/end MEASUREMENT
/begin MEASUREMENT MonEgyChrgnCoorr_stSftyErrIfCpl "Complement of MonEgyChrgnCoorr_stSftyErrIf" UWORD OneToOne 1 100 0.00 65535.00 FORMAT "%8.2" ECU_ADDRESS 0x6002B998
 /begin IF_DATA XCPplus 0x0102
  /begin DAQ_EVENT VARIABLE /end DAQ_EVENT
 /end IF_DATA
/end MEASUREMENT
/begin MEASUREMENT MonEgyChrgnCoorr_uDcChrgn "DC charging voltage" SWORD RBPtCel_u_0p1_1 1 100 -3276.800 3276.700 FORMAT "%8.3" ECU_ADDRESS 0x6002C3B0
 /begin IF_DATA XCPplus 0x0102
  /begin DAQ_EVENT VARIABLE /end DAQ_EVENT
 /end IF_DATA
/end MEASUREMENT
/begin MEASUREMENT MonEgyChrgnCoorr_uDcChrgnCpl "Complement of MonEgyChrgnCoorr_uDcChrgn" UWORD OneToOne 1 100 0.00 65535.00 FORMAT "%8.2" ECU_ADDRESS 0x6002B994
 /begin IF_DATA XCPplus 0x0102
  /begin DAQ_EVENT VARIABLE /end DAQ_EVENT
 /end IF_DATA
/end MEASUREMENT
/begin MEASUREMENT MonEgyChrgnErrReactnCoorr_bbLoc1Cpl "Complement of MonEgyChrgnErrReactnCoorr_bbLoc1" UBYTE OneToOne 1 100 0.00 255.0 FORMAT "%5.1" ECU_ADDRESS 0x6002B993
 /begin IF_DATA XCPplus 0x0102
  /begin DAQ_EVENT VARIABLE /end DAQ_EVENT
 /end IF_DATA
/end MEASUREMENT
/begin MEASUREMENT MonEgyChrgnErrReactn_cntrDebActvErrPin "Counter debouncing activation error pin" UWORD OneToOne 1 100 0.00 65535.00 FORMAT "%8.2" ECU_ADDRESS 0x6002C3AC
 /begin IF_DATA XCPplus 0x0102
  /begin DAQ_EVENT VARIABLE /end DAQ_EVENT
 /end IF_DATA
/end MEASUREMENT
/begin MEASUREMENT MonEgyChrgnErrReactn_cntrDebActvErrPinCpl "Complement of MonEgyChrgnErrReactn_cntrDebActvErrPin" UWORD OneToOne 1 100 0.00 65535.00 FORMAT "%8.2" ECU_ADDRESS 0x6002B990
 /begin IF_DATA XCPplus 0x0102
  /begin DAQ_EVENT VARIABLE /end DAQ_EVENT
 /end IF_DATA
/end MEASUREMENT
/begin MEASUREMENT MonEgyChrgnErrReactn_cntrDebPersSftyErr "Counter debouncing persistent safety error" UWORD OneToOne 1 100 0.00 65535.00 FORMAT "%8.2" ECU_ADDRESS 0x6002C3AA
 /begin IF_DATA XCPplus 0x0102
  /begin DAQ_EVENT VARIABLE /end DAQ_EVENT
 /end IF_DATA
/end MEASUREMENT
/begin MEASUREMENT MonEgyChrgnErrReactn_cntrDebPersSftyErrCpl "Complement of MonEgyChrgnErrReactn_cntrDebPersSftyErr" UWORD OneToOne 1 100 0.00 65535.00 FORMAT "%8.2" ECU_ADDRESS 0x6002B98E
 /begin IF_DATA XCPplus 0x0102
  /begin DAQ_EVENT VARIABLE /end DAQ_EVENT
 /end IF_DATA
/end MEASUREMENT
/begin MEASUREMENT MonEgyChrgnErrReactn_cntrHealCtpSwtCtrl "Counter healing control pilot switch controlling" UWORD OneToOne 1 100 0.00 65535.00 FORMAT "%8.2" ECU_ADDRESS 0x6002C3A8
 /begin IF_DATA XCPplus 0x0102
  /begin DAQ_EVENT VARIABLE /end DAQ_EVENT
 /end IF_DATA
/end MEASUREMENT
/begin MEASUREMENT MonEgyChrgnErrReactn_cntrHealCtpSwtCtrlCpl "Complement of MonEgyChrgnErrReactn_cntrHealCtpSwtCtrl" UWORD OneToOne 1 100 0.00 65535.00 FORMAT "%8.2" ECU_ADDRESS 0x6002B98C
 /begin IF_DATA XCPplus 0x0102
  /begin DAQ_EVENT VARIABLE /end DAQ_EVENT
 /end IF_DATA
/end MEASUREMENT
/begin MEASUREMENT MonEgyChrgnErrReactn_flgCtpSwtClsCmd "Flag control pilot switch close command" UBYTE B_TRUE 1 100 0.00 1.00000000000 BIT_MASK 0x1 FORMAT "%13.11" ECU_ADDRESS 0x6002C3AF
 /begin IF_DATA XCPplus 0x0102
  /begin DAQ_EVENT VARIABLE /end DAQ_EVENT
 /end IF_DATA
/end MEASUREMENT
/begin MEASUREMENT MonEgyChrgnErrReactn_flgHealCtpSwtCtrl "Flag healing control pilot switch controlling" UBYTE B_TRUE 1 100 0.00 1.00000000000 BIT_MASK 0x4 FORMAT "%13.11" ECU_ADDRESS 0x6002C3AF
 /begin IF_DATA XCPplus 0x0102
  /begin DAQ_EVENT VARIABLE /end DAQ_EVENT
 /end IF_DATA
/end MEASUREMENT
/begin MEASUREMENT MonEgyChrgnErrReactn_flgPersSftyErr "Flag persistent safety error" UBYTE B_TRUE 1 100 0.00 1.00000000000 BIT_MASK 0x8 FORMAT "%13.11" ECU_ADDRESS 0x6002C3AF
 /begin IF_DATA XCPplus 0x0102
  /begin DAQ_EVENT VARIABLE /end DAQ_EVENT
 /end IF_DATA
/end MEASUREMENT
/begin MEASUREMENT MonEgyChrgnErrReactn_flgReqErrPinActv "Flag request error pin activation" UBYTE B_TRUE 1 100 0.00 1.00000000000 BIT_MASK 0x2 FORMAT "%13.11" ECU_ADDRESS 0x6002C3AF
 /begin IF_DATA XCPplus 0x0102
  /begin DAQ_EVENT VARIABLE /end DAQ_EVENT
 /end IF_DATA
/end MEASUREMENT
/begin MEASUREMENT MonEgyChrgnErrReactn_flgSftyErr "Flag safety error" UBYTE B_TRUE 1 100 0.00 1.00000000000 BIT_MASK 0x10 FORMAT "%13.11" ECU_ADDRESS 0x6002C3AF
 /begin IF_DATA XCPplus 0x0102
  /begin DAQ_EVENT VARIABLE /end DAQ_EVENT
 /end IF_DATA
/end MEASUREMENT
/begin MEASUREMENT MonEgyChrgnErrReactn_stSftyErrIf "Status safety error" UBYTE OneToOne 1 100 0.00 255.0 FORMAT "%5.1" ECU_ADDRESS 0x6002C3AE
 /begin IF_DATA XCPplus 0x0102
  /begin DAQ_EVENT VARIABLE /end DAQ_EVENT
 /end IF_DATA
/end MEASUREMENT
/begin MEASUREMENT MonEgyChrgnErrReactn_stSftyErrIfCpl "Complement of MonEgyChrgnErrReactn_stSftyErrIf" UBYTE OneToOne 1 100 0.00 255.0 FORMAT "%5.1" ECU_ADDRESS 0x6002B992
 /begin IF_DATA XCPplus 0x0102
  /begin DAQ_EVENT VARIABLE /end DAQ_EVENT
 /end IF_DATA
/end MEASUREMENT
/begin MEASUREMENT MonEgyChrgnIf_cntrTestAcChrgnWoMofRels "Test counter fault memory entry AC charging without L2 permission." UBYTE OneToOne 1 100 0.00 255.0 FORMAT "%5.1" ECU_ADDRESS 0x600230EE
 /begin IF_DATA XCPplus 0x0102
  /begin DAQ_EVENT VARIABLE /end DAQ_EVENT
 /end IF_DATA
/end MEASUREMENT
/begin MEASUREMENT MonEgyChrgnIf_cntrTestCcsPlgCtp "Test counter fault memory entry CCS CTP plug." UBYTE OneToOne 1 100 0.00 255.0 FORMAT "%5.1" ECU_ADDRESS 0x600230ED
 /begin IF_DATA XCPplus 0x0102
  /begin DAQ_EVENT VARIABLE /end DAQ_EVENT
 /end IF_DATA
/end MEASUREMENT
/begin MEASUREMENT MonEgyChrgnIf_cntrTestCcsPlgCtpPwm "Test counter fault memory entry CCS control pilot PWM error." UBYTE OneToOne 1 100 0.00 255.0 FORMAT "%5.1" ECU_ADDRESS 0x600230EC
 /begin IF_DATA XCPplus 0x0102
  /begin DAQ_EVENT VARIABLE /end DAQ_EVENT
 /end IF_DATA
/end MEASUREMENT
/begin MEASUREMENT MonEgyChrgnIf_cntrTestCcsPlgLockCtrlImpsAtmpt "Test counter fault memory entry CCS lockunlock failed after maximum lock actuation attempts." UBYTE OneToOne 1 100 0.00 255.0 FORMAT "%5.1" ECU_ADDRESS 0x600230EB
 /begin IF_DATA XCPplus 0x0102
  /begin DAQ_EVENT VARIABLE /end DAQ_EVENT
 /end IF_DATA
/end MEASUREMENT
/begin MEASUREMENT MonEgyChrgnIf_cntrTestCcsPlgLockSnsrSigRngChk "Test counter fault memory entry CCS lock feedback sensor signal range check error." UBYTE OneToOne 1 100 0.00 255.0 FORMAT "%5.1" ECU_ADDRESS 0x600230EA
 /begin IF_DATA XCPplus 0x0102
  /begin DAQ_EVENT VARIABLE /end DAQ_EVENT
 /end IF_DATA
/end MEASUREMENT
/begin MEASUREMENT MonEgyChrgnIf_cntrTestCcsPlgLockStImps "Test counter fault memory entry CCS lockunlock failed after maximum lock actuation attempts." UBYTE OneToOne 1 100 0.00 255.0 FORMAT "%5.1" ECU_ADDRESS 0x600230E9
 /begin IF_DATA XCPplus 0x0102
  /begin DAQ_EVENT VARIABLE /end DAQ_EVENT
 /end IF_DATA
/end MEASUREMENT
/begin MEASUREMENT MonEgyChrgnIf_cntrTestCcsPlgPxp "Test counter fault memory entry CCS proximity pilot signal range check error." UBYTE OneToOne 1 100 0.00 255.0 FORMAT "%5.1" ECU_ADDRESS 0x600230E8
 /begin IF_DATA XCPplus 0x0102
  /begin DAQ_EVENT VARIABLE /end DAQ_EVENT
 /end IF_DATA
/end MEASUREMENT
/begin MEASUREMENT MonEgyChrgnIf_cntrTestChrgnAbortIgr "Test counter fault memory entry charging abort ignored." UBYTE OneToOne 1 100 0.00 255.0 FORMAT "%5.1" ECU_ADDRESS 0x600230E7
 /begin IF_DATA XCPplus 0x0102
  /begin DAQ_EVENT VARIABLE /end DAQ_EVENT
 /end IF_DATA
/end MEASUREMENT
/begin MEASUREMENT MonEgyChrgnIf_cntrTestDcCntctFailr "Test counter fault memory entry DC contactor failure." UBYTE OneToOne 1 100 0.00 255.0 FORMAT "%5.1" ECU_ADDRESS 0x600230E6
 /begin IF_DATA XCPplus 0x0102
  /begin DAQ_EVENT VARIABLE /end DAQ_EVENT
 /end IF_DATA
/end MEASUREMENT
/begin MEASUREMENT MonEgyChrgnIf_cntrTestExtChrgnShtOffReq "Test counter fault memory entry customer specific request." UBYTE OneToOne 1 100 0.00 255.0 FORMAT "%5.1" ECU_ADDRESS 0x600230E5
 /begin IF_DATA XCPplus 0x0102
  /begin DAQ_EVENT VARIABLE /end DAQ_EVENT
 /end IF_DATA
/end MEASUREMENT
/begin MEASUREMENT MonEgyChrgnIf_cntrTestImpsChrgMod "Test counter fault memory entry implausible charging mode." UBYTE OneToOne 1 100 0.00 255.0 FORMAT "%5.1" ECU_ADDRESS 0x600230E4
 /begin IF_DATA XCPplus 0x0102
  /begin DAQ_EVENT VARIABLE /end DAQ_EVENT
 /end IF_DATA
/end MEASUREMENT
/begin MEASUREMENT MonEgyChrgnIf_cntrTestImpsChrgPrms "Test counter fault memory entry implausible charging permission." UBYTE OneToOne 1 100 0.00 255.0 FORMAT "%5.1" ECU_ADDRESS 0x600230E3
 /begin IF_DATA XCPplus 0x0102
  /begin DAQ_EVENT VARIABLE /end DAQ_EVENT
 /end IF_DATA
/end MEASUREMENT
/begin MEASUREMENT MonEgyChrgnIf_cntrTestImpsUDcIntk "Test counter fault memory entry implausible votage on DC inlet." UBYTE OneToOne 1 100 0.00 255.0 FORMAT "%5.1" ECU_ADDRESS 0x600230E2
 /begin IF_DATA XCPplus 0x0102
  /begin DAQ_EVENT VARIABLE /end DAQ_EVENT
 /end IF_DATA
/end MEASUREMENT
/begin MEASUREMENT MonEgyChrgnIf_cntrTestPlgLockMovmt "Test counter fault memory entry CCS plug lock pin movement." UBYTE OneToOne 1 100 0.00 255.0 FORMAT "%5.1" ECU_ADDRESS 0x600230E1
 /begin IF_DATA XCPplus 0x0102
  /begin DAQ_EVENT VARIABLE /end DAQ_EVENT
 /end IF_DATA
/end MEASUREMENT
/begin MEASUREMENT MonEgyChrgnIf_cntrTestSftySwt "Test counter fault memory entry CCS S2 open." UBYTE OneToOne 1 100 0.00 255.0 FORMAT "%5.1" ECU_ADDRESS 0x600230E0
 /begin IF_DATA XCPplus 0x0102
  /begin DAQ_EVENT VARIABLE /end DAQ_EVENT
 /end IF_DATA
/end MEASUREMENT
/begin MEASUREMENT MonEgyChrgnIf_cntrTestSnsr1GrdtChk "Test counter fault memory entry temperature sensor 1 gradient check error." UBYTE OneToOne 1 100 0.00 255.0 FORMAT "%5.1" ECU_ADDRESS 0x600230DF
 /begin IF_DATA XCPplus 0x0102
  /begin DAQ_EVENT VARIABLE /end DAQ_EVENT
 /end IF_DATA
/end MEASUREMENT
/begin MEASUREMENT MonEgyChrgnIf_cntrTestSnsr1SigRngChk "Test counter fault memory entry temperature sensor 1 signal range check error." UBYTE OneToOne 1 100 0.00 255.0 FORMAT "%5.1" ECU_ADDRESS 0x600230DE
 /begin IF_DATA XCPplus 0x0102
  /begin DAQ_EVENT VARIABLE /end DAQ_EVENT
 /end IF_DATA
/end MEASUREMENT
/begin MEASUREMENT MonEgyChrgnIf_cntrTestSnsr2GrdtChk "Test counter fault memory entry temperature sensor 2 gradient check error." UBYTE OneToOne 1 100 0.00 255.0 FORMAT "%5.1" ECU_ADDRESS 0x600230DD
 /begin IF_DATA XCPplus 0x0102
  /begin DAQ_EVENT VARIABLE /end DAQ_EVENT
 /end IF_DATA
/end MEASUREMENT
/begin MEASUREMENT MonEgyChrgnIf_cntrTestSnsr2SigRngChk "Test counter fault memory entry temperature sensor 2 singnal range check error." UBYTE OneToOne 1 100 0.00 255.0 FORMAT "%5.1" ECU_ADDRESS 0x600230DC
 /begin IF_DATA XCPplus 0x0102
  /begin DAQ_EVENT VARIABLE /end DAQ_EVENT
 /end IF_DATA
/end MEASUREMENT
/begin MEASUREMENT MonEgyChrgnIf_cntrTestSnsrDif "Test counter fault memory entry temperature difference sensor 1 versus sensor 2 error." UBYTE OneToOne 1 100 0.00 255.0 FORMAT "%5.1" ECU_ADDRESS 0x600230DB
 /begin IF_DATA XCPplus 0x0102
  /begin DAQ_EVENT VARIABLE /end DAQ_EVENT
 /end IF_DATA
/end MEASUREMENT
/begin MEASUREMENT MonEgyChrgnIf_cntrTestVehCrashDetn "Test counter fault memory entry vehicle crash detected." UBYTE OneToOne 1 100 0.00 255.0 FORMAT "%5.1" ECU_ADDRESS 0x600230DA
 /begin IF_DATA XCPplus 0x0102
  /begin DAQ_EVENT VARIABLE /end DAQ_EVENT
 /end IF_DATA
/end MEASUREMENT
/begin MEASUREMENT MonEgyChrgnIf_flgClrAcChrgnWoMofRels "DFC clear fault memory entry AC charging without L2 permission." UBYTE B_TRUE 1 100 0.00 1.00000000000 BIT_MASK 0x1 FORMAT "%13.11" ECU_ADDRESS 0x600230D9
 /begin IF_DATA XCPplus 0x0102
  /begin DAQ_EVENT VARIABLE /end DAQ_EVENT
 /end IF_DATA
/end MEASUREMENT
/begin MEASUREMENT MonEgyChrgnIf_flgClrCcsPlgCtp "DFC clear fault memory entry CCS CTP plug." UBYTE B_TRUE 1 100 0.00 1.00000000000 BIT_MASK 0x1 FORMAT "%13.11" ECU_ADDRESS 0x600230D8
 /begin IF_DATA XCPplus 0x0102
  /begin DAQ_EVENT VARIABLE /end DAQ_EVENT
 /end IF_DATA
/end MEASUREMENT
/begin MEASUREMENT MonEgyChrgnIf_flgClrCcsPlgCtpPwm "DFC clear fault memory entry CCS control pilot PWM error." UBYTE B_TRUE 1 100 0.00 1.00000000000 BIT_MASK 0x1 FORMAT "%13.11" ECU_ADDRESS 0x600230D7
 /begin IF_DATA XCPplus 0x0102
  /begin DAQ_EVENT VARIABLE /end DAQ_EVENT
 /end IF_DATA
/end MEASUREMENT
/begin MEASUREMENT MonEgyChrgnIf_flgClrCcsPlgLockCtrlImpsAtmpt "DFC clear fault memory entry CCS lockunlock failed after maximum lock actuation attempts." UBYTE B_TRUE 1 100 0.00 1.00000000000 BIT_MASK 0x1 FORMAT "%13.11" ECU_ADDRESS 0x600230D6
 /begin IF_DATA XCPplus 0x0102
  /begin DAQ_EVENT VARIABLE /end DAQ_EVENT
 /end IF_DATA
/end MEASUREMENT
/begin MEASUREMENT MonEgyChrgnIf_flgClrCcsPlgLockSnsrSigRngChk "DFC clear fault memory entry CCS lock feedback sensor signal range check error." UBYTE B_TRUE 1 100 0.00 1.00000000000 BIT_MASK 0x1 FORMAT "%13.11" ECU_ADDRESS 0x600230D5
 /begin IF_DATA XCPplus 0x0102
  /begin DAQ_EVENT VARIABLE /end DAQ_EVENT
 /end IF_DATA
/end MEASUREMENT
/begin MEASUREMENT MonEgyChrgnIf_flgClrCcsPlgLockStImps "DFC clear fault memory entry CCS lockunlock failed after maximum lock actuation attempts." UBYTE B_TRUE 1 100 0.00 1.00000000000 BIT_MASK 0x1 FORMAT "%13.11" ECU_ADDRESS 0x600230D4
 /begin IF_DATA XCPplus 0x0102
  /begin DAQ_EVENT VARIABLE /end DAQ_EVENT
 /end IF_DATA
/end MEASUREMENT
/begin MEASUREMENT MonEgyChrgnIf_flgClrCcsPlgPxp "DFC clear fault memory entry CCS proximity pilot signal range check error." UBYTE B_TRUE 1 100 0.00 1.00000000000 BIT_MASK 0x1 FORMAT "%13.11" ECU_ADDRESS 0x600230D3
 /begin IF_DATA XCPplus 0x0102
  /begin DAQ_EVENT VARIABLE /end DAQ_EVENT
 /end IF_DATA
/end MEASUREMENT
/begin MEASUREMENT MonEgyChrgnIf_flgClrChrgnAbortIgr "DFC clear fault memory entry charging abort ignored." UBYTE B_TRUE 1 100 0.00 1.00000000000 BIT_MASK 0x1 FORMAT "%13.11" ECU_ADDRESS 0x600230D2
 /begin IF_DATA XCPplus 0x0102
  /begin DAQ_EVENT VARIABLE /end DAQ_EVENT
 /end IF_DATA
/end MEASUREMENT
/begin MEASUREMENT MonEgyChrgnIf_flgClrDcCntctFailr "DFC clear fault memory entry DC contactor failure." UBYTE B_TRUE 1 100 0.00 1.00000000000 BIT_MASK 0x1 FORMAT "%13.11" ECU_ADDRESS 0x600230D1
 /begin IF_DATA XCPplus 0x0102
  /begin DAQ_EVENT VARIABLE /end DAQ_EVENT
 /end IF_DATA
/end MEASUREMENT
/begin MEASUREMENT MonEgyChrgnIf_flgClrExtChrgnShtOffReq "DFC clear fault memory entry customer specific request." UBYTE B_TRUE 1 100 0.00 1.00000000000 BIT_MASK 0x1 FORMAT "%13.11" ECU_ADDRESS 0x600230D0
 /begin IF_DATA XCPplus 0x0102
  /begin DAQ_EVENT VARIABLE /end DAQ_EVENT
 /end IF_DATA
/end MEASUREMENT
/begin MEASUREMENT MonEgyChrgnIf_flgClrImpsChrgMod "DFC clear fault memory entry implausible charging mode." UBYTE B_TRUE 1 100 0.00 1.00000000000 BIT_MASK 0x1 FORMAT "%13.11" ECU_ADDRESS 0x600230CF
 /begin IF_DATA XCPplus 0x0102
  /begin DAQ_EVENT VARIABLE /end DAQ_EVENT
 /end IF_DATA
/end MEASUREMENT
/begin MEASUREMENT MonEgyChrgnIf_flgClrImpsChrgPrms "DFC clear fault memory entry implausible charging permission." UBYTE B_TRUE 1 100 0.00 1.00000000000 BIT_MASK 0x1 FORMAT "%13.11" ECU_ADDRESS 0x600230CE
 /begin IF_DATA XCPplus 0x0102
  /begin DAQ_EVENT VARIABLE /end DAQ_EVENT
 /end IF_DATA
/end MEASUREMENT
/begin MEASUREMENT MonEgyChrgnIf_flgClrImpsUDcIntk "DFC clear fault memory entry implausible votage on DC inlet." UBYTE B_TRUE 1 100 0.00 1.00000000000 BIT_MASK 0x1 FORMAT "%13.11" ECU_ADDRESS 0x600230CD
 /begin IF_DATA XCPplus 0x0102
  /begin DAQ_EVENT VARIABLE /end DAQ_EVENT
 /end IF_DATA
/end MEASUREMENT
/begin MEASUREMENT MonEgyChrgnIf_flgClrPlgLockMovmt "DFC clear fault memory entry CCS plug lock pin movement." UBYTE B_TRUE 1 100 0.00 1.00000000000 BIT_MASK 0x1 FORMAT "%13.11" ECU_ADDRESS 0x600230CC
 /begin IF_DATA XCPplus 0x0102
  /begin DAQ_EVENT VARIABLE /end DAQ_EVENT
 /end IF_DATA
/end MEASUREMENT
/begin MEASUREMENT MonEgyChrgnIf_flgClrSftySwt "DFC clear fault memory entry CCS S2 open." UBYTE B_TRUE 1 100 0.00 1.00000000000 BIT_MASK 0x1 FORMAT "%13.11" ECU_ADDRESS 0x600230CB
 /begin IF_DATA XCPplus 0x0102
  /begin DAQ_EVENT VARIABLE /end DAQ_EVENT
 /end IF_DATA
/end MEASUREMENT
/begin MEASUREMENT MonEgyChrgnIf_flgClrSnsr1GrdtChk "DFC clear fault memory entry temperature sensor 1 gradient check error." UBYTE B_TRUE 1 100 0.00 1.00000000000 BIT_MASK 0x1 FORMAT "%13.11" ECU_ADDRESS 0x600230CA
 /begin IF_DATA XCPplus 0x0102
  /begin DAQ_EVENT VARIABLE /end DAQ_EVENT
 /end IF_DATA
/end MEASUREMENT
/begin MEASUREMENT MonEgyChrgnIf_flgClrSnsr1SigRngChk "DFC clear fault memory entry temperature sensor 1 signal range check error." UBYTE B_TRUE 1 100 0.00 1.00000000000 BIT_MASK 0x1 FORMAT "%13.11" ECU_ADDRESS 0x600230C9
 /begin IF_DATA XCPplus 0x0102
  /begin DAQ_EVENT VARIABLE /end DAQ_EVENT
 /end IF_DATA
/end MEASUREMENT
/begin MEASUREMENT MonEgyChrgnIf_flgClrSnsr2GrdtChk "DFC clear fault memory entry temperature sensor 2 gradient check error." UBYTE B_TRUE 1 100 0.00 1.00000000000 BIT_MASK 0x1 FORMAT "%13.11" ECU_ADDRESS 0x600230C8
 /begin IF_DATA XCPplus 0x0102
  /begin DAQ_EVENT VARIABLE /end DAQ_EVENT
 /end IF_DATA
/end MEASUREMENT
/begin MEASUREMENT MonEgyChrgnIf_flgClrSnsr2SigRngChk "DFC clear fault memory entry temperature sensor 2 singnal range check error." UBYTE B_TRUE 1 100 0.00 1.00000000000 BIT_MASK 0x1 FORMAT "%13.11" ECU_ADDRESS 0x600230C7
 /begin IF_DATA XCPplus 0x0102
  /begin DAQ_EVENT VARIABLE /end DAQ_EVENT
 /end IF_DATA
/end MEASUREMENT
/begin MEASUREMENT MonEgyChrgnIf_flgClrSnsrDif "DFC clear fault memory entry temperature difference sensor 1 versus sensor 2 error." UBYTE B_TRUE 1 100 0.00 1.00000000000 BIT_MASK 0x1 FORMAT "%13.11" ECU_ADDRESS 0x600230C6
 /begin IF_DATA XCPplus 0x0102
  /begin DAQ_EVENT VARIABLE /end DAQ_EVENT
 /end IF_DATA
/end MEASUREMENT
/begin MEASUREMENT MonEgyChrgnIf_flgClrVehCrashDetn "DFC clear fault memory entry vehicle crash detected." UBYTE B_TRUE 1 100 0.00 1.00000000000 BIT_MASK 0x1 FORMAT "%13.11" ECU_ADDRESS 0x600230C5
 /begin IF_DATA XCPplus 0x0102
  /begin DAQ_EVENT VARIABLE /end DAQ_EVENT
 /end IF_DATA
/end MEASUREMENT
/begin MEASUREMENT MonEgyChrgnIf_stChrgnMsg "Status charging" UBYTE MonEgyChrgnCoorr_stChrgn_VERB 1 100 0.00 2.00000000000 FORMAT "%13.11" ECU_ADDRESS 0x6002351F
 /begin IF_DATA XCPplus 0x0102
  /begin DAQ_EVENT VARIABLE /end DAQ_EVENT
 /end IF_DATA
/end MEASUREMENT
/begin MEASUREMENT MonEgyChrgnIf_stDrvRdnMsg "Status driving readiness" UBYTE MonEgyChrgnCoorr_stDrvRdn_VERB 1 100 0.00 1.00000000000 FORMAT "%13.11" ECU_ADDRESS 0x6002351E
 /begin IF_DATA XCPplus 0x0102
  /begin DAQ_EVENT VARIABLE /end DAQ_EVENT
 /end IF_DATA
/end MEASUREMENT
/begin MEASUREMENT MonEgyChrgnInletLock_bbLoc1Cpl "Complement of MonEgyChrgnInletLock_bbLoc1" UBYTE OneToOne 1 100 0.00 255.0 FORMAT "%5.1" ECU_ADDRESS 0x6002B967
 /begin IF_DATA XCPplus 0x0102
  /begin DAQ_EVENT VARIABLE /end DAQ_EVENT
 /end IF_DATA
/end MEASUREMENT
/begin MEASUREMENT MonEgyChrgnInletPlg_bbLoc1Cpl "Complement of MonEgyChrgnInletPlg_bbLoc1" UBYTE OneToOne 1 100 0.00 255.0 FORMAT "%5.1" ECU_ADDRESS 0x6002B956
 /begin IF_DATA XCPplus 0x0102
  /begin DAQ_EVENT VARIABLE /end DAQ_EVENT
 /end IF_DATA
/end MEASUREMENT
/begin MEASUREMENT MonEgyChrgnInletPlg_bbLoc2Cpl "Complement of MonEgyChrgnInletPlg_bbLoc2" UBYTE OneToOne 1 100 0.00 255.0 FORMAT "%5.1" ECU_ADDRESS 0x6002B955
 /begin IF_DATA XCPplus 0x0102
  /begin DAQ_EVENT VARIABLE /end DAQ_EVENT
 /end IF_DATA
/end MEASUREMENT
/begin MEASUREMENT MonEgyChrgnInletPlg_bbLoc3Cpl "Complement of MonEgyChrgnInletPlg_bbLoc3" UBYTE OneToOne 1 100 0.00 255.0 FORMAT "%5.1" ECU_ADDRESS 0x6002B954
 /begin IF_DATA XCPplus 0x0102
  /begin DAQ_EVENT VARIABLE /end DAQ_EVENT
 /end IF_DATA
/end MEASUREMENT
/begin MEASUREMENT MonEgyChrgnInletPreProc_bbOut1Cpl "Complement of MonEgyChrgnInletPreProc_bbOut1" UBYTE OneToOne 1 100 0.00 255.0 FORMAT "%5.1" ECU_ADDRESS 0x6002B932
 /begin IF_DATA XCPplus 0x0102
  /begin DAQ_EVENT VARIABLE /end DAQ_EVENT
 /end IF_DATA
/end MEASUREMENT
/begin MEASUREMENT MonEgyChrgnInlet_cntrDebConPwmCcsCtp "Debounce counter constanst duty cycle detection of CCS control pilot" UBYTE OneToOne 1 100 0.00 255.0 FORMAT "%5.1" ECU_ADDRESS 0x6002C36F
 /begin IF_DATA XCPplus 0x0102
  /begin DAQ_EVENT VARIABLE /end DAQ_EVENT
 /end IF_DATA
/end MEASUREMENT
/begin MEASUREMENT MonEgyChrgnInlet_cntrDebConPwmCcsCtpCpl "Complement of MonEgyChrgnInlet_cntrDebConPwmCcsCtp" UBYTE OneToOne 1 100 0.00 255.0 FORMAT "%5.1" ECU_ADDRESS 0x6002B953
 /begin IF_DATA XCPplus 0x0102
  /begin DAQ_EVENT VARIABLE /end DAQ_EVENT
 /end IF_DATA
/end MEASUREMENT
/begin MEASUREMENT MonEgyChrgnInlet_cntrDebCtpDigComReq "Debounce counter digital communication required of CCS control pilot" UBYTE OneToOne 1 100 0.00 255.0 FORMAT "%5.1" ECU_ADDRESS 0x6002C36E
 /begin IF_DATA XCPplus 0x0102
  /begin DAQ_EVENT VARIABLE /end DAQ_EVENT
 /end IF_DATA
/end MEASUREMENT
/begin MEASUREMENT MonEgyChrgnInlet_cntrDebCtpDigComReqCpl "Complement of MonEgyChrgnInlet_cntrDebCtpDigComReq" UBYTE OneToOne 1 100 0.00 255.0 FORMAT "%5.1" ECU_ADDRESS 0x6002B952
 /begin IF_DATA XCPplus 0x0102
  /begin DAQ_EVENT VARIABLE /end DAQ_EVENT
 /end IF_DATA
/end MEASUREMENT
/begin MEASUREMENT MonEgyChrgnInlet_cntrDebImpsSnsrPlgLock "Counter debounce implausible sensor plug lock" UBYTE OneToOne 1 100 0.00 255.0 FORMAT "%5.1" ECU_ADDRESS 0x6002C382
 /begin IF_DATA XCPplus 0x0102
  /begin DAQ_EVENT VARIABLE /end DAQ_EVENT
 /end IF_DATA
/end MEASUREMENT
/begin MEASUREMENT MonEgyChrgnInlet_cntrDebImpsSnsrPlgLockCpl "Complement of MonEgyChrgnInlet_cntrDebImpsSnsrPlgLock" UBYTE OneToOne 1 100 0.00 255.0 FORMAT "%5.1" ECU_ADDRESS 0x6002B966
 /begin IF_DATA XCPplus 0x0102
  /begin DAQ_EVENT VARIABLE /end DAQ_EVENT
 /end IF_DATA
/end MEASUREMENT
/begin MEASUREMENT MonEgyChrgnInlet_cntrDebMaxCtp "Debounce counter for Upper Limit in Control Pilot" UBYTE OneToOne 1 100 0.00 255.0 FORMAT "%5.1" ECU_ADDRESS 0x6002C36D
 /begin IF_DATA XCPplus 0x0102
  /begin DAQ_EVENT VARIABLE /end DAQ_EVENT
 /end IF_DATA
/end MEASUREMENT
/begin MEASUREMENT MonEgyChrgnInlet_cntrDebMaxCtpCpl "Complement of MonEgyChrgnInlet_cntrDebMaxCtp" UBYTE OneToOne 1 100 0.00 255.0 FORMAT "%5.1" ECU_ADDRESS 0x6002B951
 /begin IF_DATA XCPplus 0x0102
  /begin DAQ_EVENT VARIABLE /end DAQ_EVENT
 /end IF_DATA
/end MEASUREMENT
/begin MEASUREMENT MonEgyChrgnInlet_cntrDebMaxEvseErr "Debounce counter for Upper Limit for Evse Error" UBYTE OneToOne 1 100 0.00 255.0 FORMAT "%5.1" ECU_ADDRESS 0x6002C36C
 /begin IF_DATA XCPplus 0x0102
  /begin DAQ_EVENT VARIABLE /end DAQ_EVENT
 /end IF_DATA
/end MEASUREMENT
/begin MEASUREMENT MonEgyChrgnInlet_cntrDebMaxEvseErrCpl "Complement of MonEgyChrgnInlet_cntrDebMaxEvseErr" UBYTE OneToOne 1 100 0.00 255.0 FORMAT "%5.1" ECU_ADDRESS 0x6002B950
 /begin IF_DATA XCPplus 0x0102
  /begin DAQ_EVENT VARIABLE /end DAQ_EVENT
 /end IF_DATA
/end MEASUREMENT
/begin MEASUREMENT MonEgyChrgnInlet_cntrDebMaxPxp "Debounce counter for Upper Limit in Proximity Pilot" UBYTE OneToOne 1 100 0.00 255.0 FORMAT "%5.1" ECU_ADDRESS 0x6002C36B
 /begin IF_DATA XCPplus 0x0102
  /begin DAQ_EVENT VARIABLE /end DAQ_EVENT
 /end IF_DATA
/end MEASUREMENT
/begin MEASUREMENT MonEgyChrgnInlet_cntrDebMaxPxpCpl "Complement for MonEgyChrgnInlet_cntrDebMaxPxp" UBYTE OneToOne 1 100 0.00 255.0 FORMAT "%5.1" ECU_ADDRESS 0x6002B94F
 /begin IF_DATA XCPplus 0x0102
  /begin DAQ_EVENT VARIABLE /end DAQ_EVENT
 /end IF_DATA
/end MEASUREMENT
/begin MEASUREMENT MonEgyChrgnInlet_cntrDebMaxSnsrPlgLock "Debounce counter signal range check above maximum value for feedback sensor signal" UBYTE OneToOne 1 100 0.00 255.0 FORMAT "%5.1" ECU_ADDRESS 0x6002C381
 /begin IF_DATA XCPplus 0x0102
  /begin DAQ_EVENT VARIABLE /end DAQ_EVENT
 /end IF_DATA
/end MEASUREMENT
/begin MEASUREMENT MonEgyChrgnInlet_cntrDebMaxSnsrPlgLockCpl "Complement of MonEgyChrgnInlet_cntrDebMaxSnsrPlgLock" UBYTE OneToOne 1 100 0.00 255.0 FORMAT "%5.1" ECU_ADDRESS 0x6002B965
 /begin IF_DATA XCPplus 0x0102
  /begin DAQ_EVENT VARIABLE /end DAQ_EVENT
 /end IF_DATA
/end MEASUREMENT
/begin MEASUREMENT MonEgyChrgnInlet_cntrDebMinCtp "Debounce counter for Lower Limit in Control Pilot" UBYTE OneToOne 1 100 0.00 255.0 FORMAT "%5.1" ECU_ADDRESS 0x6002C36A
 /begin IF_DATA XCPplus 0x0102
  /begin DAQ_EVENT VARIABLE /end DAQ_EVENT
 /end IF_DATA
/end MEASUREMENT
/begin MEASUREMENT MonEgyChrgnInlet_cntrDebMinCtpCpl "Complement of MonEgyChrgnInlet_cntrDebMinCtp" UBYTE OneToOne 1 100 0.00 255.0 FORMAT "%5.1" ECU_ADDRESS 0x6002B94E
 /begin IF_DATA XCPplus 0x0102
  /begin DAQ_EVENT VARIABLE /end DAQ_EVENT
 /end IF_DATA
/end MEASUREMENT
/begin MEASUREMENT MonEgyChrgnInlet_cntrDebMinEvseErr "Debounce counter for Lower Limit for Evse Error" UBYTE OneToOne 1 100 0.00 255.0 FORMAT "%5.1" ECU_ADDRESS 0x6002C369
 /begin IF_DATA XCPplus 0x0102
  /begin DAQ_EVENT VARIABLE /end DAQ_EVENT
 /end IF_DATA
/end MEASUREMENT
/begin MEASUREMENT MonEgyChrgnInlet_cntrDebMinEvseErrCpl "Complement of MonEgyChrgnInlet_cntrDebMinEvseErr" UBYTE OneToOne 1 100 0.00 255.0 FORMAT "%5.1" ECU_ADDRESS 0x6002B94D
 /begin IF_DATA XCPplus 0x0102
  /begin DAQ_EVENT VARIABLE /end DAQ_EVENT
 /end IF_DATA
/end MEASUREMENT
/begin MEASUREMENT MonEgyChrgnInlet_cntrDebMinPxp "Debounce counter for Lower Limit in Proximity Pilot" UBYTE OneToOne 1 100 0.00 255.0 FORMAT "%5.1" ECU_ADDRESS 0x6002C368
 /begin IF_DATA XCPplus 0x0102
  /begin DAQ_EVENT VARIABLE /end DAQ_EVENT
 /end IF_DATA
/end MEASUREMENT
/begin MEASUREMENT MonEgyChrgnInlet_cntrDebMinPxpCpl "Complement of MonEgyChrgnInlet_cntrDebMinPxp" UBYTE OneToOne 1 100 0.00 255.0 FORMAT "%5.1" ECU_ADDRESS 0x6002B94C
 /begin IF_DATA XCPplus 0x0102
  /begin DAQ_EVENT VARIABLE /end DAQ_EVENT
 /end IF_DATA
/end MEASUREMENT
/begin MEASUREMENT MonEgyChrgnInlet_cntrDebMinSnsrPlgLock "Debounce counter signal range check below minimum value for feedback sensor signal" UBYTE OneToOne 1 100 0.00 255.0 FORMAT "%5.1" ECU_ADDRESS 0x6002C380
 /begin IF_DATA XCPplus 0x0102
  /begin DAQ_EVENT VARIABLE /end DAQ_EVENT
 /end IF_DATA
/end MEASUREMENT
/begin MEASUREMENT MonEgyChrgnInlet_cntrDebMinSnsrPlgLockCpl "Complement of MonEgyChrgnInlet_cntrDebMinSnsrPlgLock" UBYTE OneToOne 1 100 0.00 255.0 FORMAT "%5.1" ECU_ADDRESS 0x6002B964
 /begin IF_DATA XCPplus 0x0102
  /begin DAQ_EVENT VARIABLE /end DAQ_EVENT
 /end IF_DATA
/end MEASUREMENT
/begin MEASUREMENT MonEgyChrgnInlet_cntrDebPerdPwmCcsCtp "Debounce counter periodic times CCS control pilot" UBYTE OneToOne 1 100 0.00 255.0 FORMAT "%5.1" ECU_ADDRESS 0x6002C367
 /begin IF_DATA XCPplus 0x0102
  /begin DAQ_EVENT VARIABLE /end DAQ_EVENT
 /end IF_DATA
/end MEASUREMENT
/begin MEASUREMENT MonEgyChrgnInlet_cntrDebPerdPwmCcsCtpCpl "Complement of MonEgyChrgnInlet_cntrDebPerdPwmCcsCtp" UBYTE OneToOne 1 100 0.00 255.0 FORMAT "%5.1" ECU_ADDRESS 0x6002B94B
 /begin IF_DATA XCPplus 0x0102
  /begin DAQ_EVENT VARIABLE /end DAQ_EVENT
 /end IF_DATA
/end MEASUREMENT
/begin MEASUREMENT MonEgyChrgnInlet_cntrDebPlgLockStImps "Counter debounce plug lock status implausible" UBYTE OneToOne 1 100 0.00 255.0 FORMAT "%5.1" ECU_ADDRESS 0x6002C37F
 /begin IF_DATA XCPplus 0x0102
  /begin DAQ_EVENT VARIABLE /end DAQ_EVENT
 /end IF_DATA
/end MEASUREMENT
/begin MEASUREMENT MonEgyChrgnInlet_cntrDebPlgLockStImpsCpl "Complement of MonEgyChrgnInlet_cntrDebPlgLockStImps" UBYTE OneToOne 1 100 0.00 255.0 FORMAT "%5.1" ECU_ADDRESS 0x6002B963
 /begin IF_DATA XCPplus 0x0102
  /begin DAQ_EVENT VARIABLE /end DAQ_EVENT
 /end IF_DATA
/end MEASUREMENT
/begin MEASUREMENT MonEgyChrgnInlet_cntrDebPlgLockStUnlockdPlaus "Counter debounce plug lock status unlocked plausibilization" UBYTE OneToOne 1 100 0.00 255.0 FORMAT "%5.1" ECU_ADDRESS 0x6002C37E
 /begin IF_DATA XCPplus 0x0102
  /begin DAQ_EVENT VARIABLE /end DAQ_EVENT
 /end IF_DATA
/end MEASUREMENT
/begin MEASUREMENT MonEgyChrgnInlet_cntrDebPlgLockStUnlockdPlausCpl "Complement of MonEgyChrgnInlet_cntrDebPlgLockStUnlockdPlaus" UBYTE OneToOne 1 100 0.00 255.0 FORMAT "%5.1" ECU_ADDRESS 0x6002B962
 /begin IF_DATA XCPplus 0x0102
  /begin DAQ_EVENT VARIABLE /end DAQ_EVENT
 /end IF_DATA
/end MEASUREMENT
/begin MEASUREMENT MonEgyChrgnInlet_cntrDebPwmCcsCtpPlausAc "Debounce counter duty cycle of plausible AC charging current CCS control pilot" UBYTE OneToOne 1 100 0.00 255.0 FORMAT "%5.1" ECU_ADDRESS 0x6002C366
 /begin IF_DATA XCPplus 0x0102
  /begin DAQ_EVENT VARIABLE /end DAQ_EVENT
 /end IF_DATA
/end MEASUREMENT
/begin MEASUREMENT MonEgyChrgnInlet_cntrDebPwmCcsCtpPlausAcCpl "Complement of MonEgyChrgnInlet_cntrDebPwmCcsCtpPlausAc" UBYTE OneToOne 1 100 0.00 255.0 FORMAT "%5.1" ECU_ADDRESS 0x6002B94A
 /begin IF_DATA XCPplus 0x0102
  /begin DAQ_EVENT VARIABLE /end DAQ_EVENT
 /end IF_DATA
/end MEASUREMENT
/begin MEASUREMENT MonEgyChrgnInlet_cntrIninPlausCcsCtp "Counter for ongoing initial CCS control pilot plausibility check" UBYTE OneToOne 1 100 0.00 255.0 FORMAT "%5.1" ECU_ADDRESS 0x6002C365
 /begin IF_DATA XCPplus 0x0102
  /begin DAQ_EVENT VARIABLE /end DAQ_EVENT
 /end IF_DATA
/end MEASUREMENT
/begin MEASUREMENT MonEgyChrgnInlet_cntrIninPlausCcsCtpCpl "Complement of MonEgyChrgnInlet_cntrIninPlausCcsCtp" UBYTE OneToOne 1 100 0.00 255.0 FORMAT "%5.1" ECU_ADDRESS 0x6002B949
 /begin IF_DATA XCPplus 0x0102
  /begin DAQ_EVENT VARIABLE /end DAQ_EVENT
 /end IF_DATA
/end MEASUREMENT
/begin MEASUREMENT MonEgyChrgnInlet_cntrIninPlausCcsPlgLock "Counter for initial plausibilization of CCS plug lock" UBYTE OneToOne 1 100 0.00 255.0 FORMAT "%5.1" ECU_ADDRESS 0x6002C37D
 /begin IF_DATA XCPplus 0x0102
  /begin DAQ_EVENT VARIABLE /end DAQ_EVENT
 /end IF_DATA
/end MEASUREMENT
/begin MEASUREMENT MonEgyChrgnInlet_cntrIninPlausCcsPlgLockCpl "Complement of MonEgyChrgnInlet_cntrIninPlausCcsPlgLock" UBYTE OneToOne 1 100 0.00 255.0 FORMAT "%5.1" ECU_ADDRESS 0x6002B961
 /begin IF_DATA XCPplus 0x0102
  /begin DAQ_EVENT VARIABLE /end DAQ_EVENT
 /end IF_DATA
/end MEASUREMENT
/begin MEASUREMENT MonEgyChrgnInlet_cntrIninPlausCcsPxp "Counter for ongoing initial CCS proximity pilot plausibility check" UBYTE OneToOne 1 100 0.00 255.0 FORMAT "%5.1" ECU_ADDRESS 0x6002C364
 /begin IF_DATA XCPplus 0x0102
  /begin DAQ_EVENT VARIABLE /end DAQ_EVENT
 /end IF_DATA
/end MEASUREMENT
/begin MEASUREMENT MonEgyChrgnInlet_cntrIninPlausCcsPxpCpl "Complement of MonEgyChrgnInlet_cntrIninPlausCcsPxp" UBYTE OneToOne 1 100 0.00 255.0 FORMAT "%5.1" ECU_ADDRESS 0x6002B948
 /begin IF_DATA XCPplus 0x0102
  /begin DAQ_EVENT VARIABLE /end DAQ_EVENT
 /end IF_DATA
/end MEASUREMENT
/begin MEASUREMENT MonEgyChrgnInlet_cntrPlgLockClsng "Debounce counter plug lock locking detection" UBYTE OneToOne 1 100 0.00 255.0 FORMAT "%5.1" ECU_ADDRESS 0x6002C34E
 /begin IF_DATA XCPplus 0x0102
  /begin DAQ_EVENT VARIABLE /end DAQ_EVENT
 /end IF_DATA
/end MEASUREMENT
/begin MEASUREMENT MonEgyChrgnInlet_cntrPlgLockClsngCpl "Complement of MonEgyChrgnInlet_cntrPlgLockClsng" UBYTE OneToOne 1 100 0.00 255.0 FORMAT "%5.1" ECU_ADDRESS 0x6002B931
 /begin IF_DATA XCPplus 0x0102
  /begin DAQ_EVENT VARIABLE /end DAQ_EVENT
 /end IF_DATA
/end MEASUREMENT
/begin MEASUREMENT MonEgyChrgnInlet_cntrPlgLockCtrlAtmpt "Counter plug lock controlling attempts" UBYTE OneToOne 1 100 0.00 255.0 FORMAT "%5.1" ECU_ADDRESS 0x6002C37C
 /begin IF_DATA XCPplus 0x0102
  /begin DAQ_EVENT VARIABLE /end DAQ_EVENT
 /end IF_DATA
/end MEASUREMENT
/begin MEASUREMENT MonEgyChrgnInlet_cntrPlgLockCtrlAtmptCpl "Complement of MonEgyChrgnInlet_cntrPlgLockCtrlAtmpt" UBYTE OneToOne 1 100 0.00 255.0 FORMAT "%5.1" ECU_ADDRESS 0x6002B960
 /begin IF_DATA XCPplus 0x0102
  /begin DAQ_EVENT VARIABLE /end DAQ_EVENT
 /end IF_DATA
/end MEASUREMENT
/begin MEASUREMENT MonEgyChrgnInlet_cntrPlgLockCtrlTi "Duration of plug lock actuator controlling" UWORD OneToOne 1 100 0.00 65535.00 FORMAT "%8.2" ECU_ADDRESS 0x6002C374
 /begin IF_DATA XCPplus 0x0102
  /begin DAQ_EVENT VARIABLE /end DAQ_EVENT
 /end IF_DATA
/end MEASUREMENT
/begin MEASUREMENT MonEgyChrgnInlet_cntrPlgLockCtrlTiCpl "Complement of MonEgyChrgnInlet_cntrPlgLockCtrlTi" UWORD OneToOne 1 100 0.00 65535.00 FORMAT "%8.2" ECU_ADDRESS 0x6002B958
 /begin IF_DATA XCPplus 0x0102
  /begin DAQ_EVENT VARIABLE /end DAQ_EVENT
 /end IF_DATA
/end MEASUREMENT
/begin MEASUREMENT MonEgyChrgnInlet_cntrPlgLockOpng "Debounce counter plug lock unlocking detection" UBYTE OneToOne 1 100 0.00 255.0 FORMAT "%5.1" ECU_ADDRESS 0x6002C34D
 /begin IF_DATA XCPplus 0x0102
  /begin DAQ_EVENT VARIABLE /end DAQ_EVENT
 /end IF_DATA
/end MEASUREMENT
/begin MEASUREMENT MonEgyChrgnInlet_cntrPlgLockOpngCpl "Complement of MonEgyChrgnInlet_cntrPlgLockOpng" UBYTE OneToOne 1 100 0.00 255.0 FORMAT "%5.1" ECU_ADDRESS 0x6002B930
 /begin IF_DATA XCPplus 0x0102
  /begin DAQ_EVENT VARIABLE /end DAQ_EVENT
 /end IF_DATA
/end MEASUREMENT
/begin MEASUREMENT MonEgyChrgnInlet_flgCcsCtpDigComReq "Flag CCS control pilot digital communication required" UBYTE B_TRUE 1 100 0.00 1.00000000000 BIT_MASK 0x4 FORMAT "%13.11" ECU_ADDRESS 0x6002C371
 /begin IF_DATA XCPplus 0x0102
  /begin DAQ_EVENT VARIABLE /end DAQ_EVENT
 /end IF_DATA
/end MEASUREMENT
/begin MEASUREMENT MonEgyChrgnInlet_flgCcsTyp "Flag CCS Inlet Type" UBYTE B_TRUE 1 100 0.00 1.00000000000 BIT_MASK 0x1 FORMAT "%13.11" ECU_ADDRESS 0x6002C34C
 /begin IF_DATA XCPplus 0x0102
  /begin DAQ_EVENT VARIABLE /end DAQ_EVENT
 /end IF_DATA
/end MEASUREMENT
/begin MEASUREMENT MonEgyChrgnInlet_flgCtpEvRdy "Flag Control Pilot Electric Vehicle Ready" UBYTE B_TRUE 1 100 0.00 1.00000000000 BIT_MASK 0x10 FORMAT "%13.11" ECU_ADDRESS 0x6002C371
 /begin IF_DATA XCPplus 0x0102
  /begin DAQ_EVENT VARIABLE /end DAQ_EVENT
 /end IF_DATA
/end MEASUREMENT
/begin MEASUREMENT MonEgyChrgnInlet_flgCtpPlgd "Flag Control Pilot Plugged state" UBYTE B_TRUE 1 100 0.00 1.00000000000 BIT_MASK 0x1 FORMAT "%13.11" ECU_ADDRESS 0x6002C372
 /begin IF_DATA XCPplus 0x0102
  /begin DAQ_EVENT VARIABLE /end DAQ_EVENT
 /end IF_DATA
/end MEASUREMENT
/begin MEASUREMENT MonEgyChrgnInlet_flgCtpPlgDetd "Flag Control Pilot Plugged Detected" UBYTE B_TRUE 1 100 0.00 1.00000000000 BIT_MASK 0x80 FORMAT "%13.11" ECU_ADDRESS 0x6002C370
 /begin IF_DATA XCPplus 0x0102
  /begin DAQ_EVENT VARIABLE /end DAQ_EVENT
 /end IF_DATA
/end MEASUREMENT
/begin MEASUREMENT MonEgyChrgnInlet_flgCtpVentnRqrd "Flag Control Pilot Ventilation Required" UBYTE B_TRUE 1 100 0.00 1.00000000000 BIT_MASK 0x80 FORMAT "%13.11" ECU_ADDRESS 0x6002C371
 /begin IF_DATA XCPplus 0x0102
  /begin DAQ_EVENT VARIABLE /end DAQ_EVENT
 /end IF_DATA
/end MEASUREMENT
/begin MEASUREMENT MonEgyChrgnInlet_flgErrAdc "Flag error ADC" UBYTE B_TRUE 1 100 0.00 1.00000000000 BIT_MASK 0x2 FORMAT "%13.11" ECU_ADDRESS 0x6002C34C
 /begin IF_DATA XCPplus 0x0102
  /begin DAQ_EVENT VARIABLE /end DAQ_EVENT
 /end IF_DATA
/end MEASUREMENT
/begin MEASUREMENT MonEgyChrgnInlet_flgErrMaxCtp "Flag Debounced Error Upper Limit Control Pilot" UBYTE B_TRUE 1 100 0.00 1.00000000000 BIT_MASK 0x2 FORMAT "%13.11" ECU_ADDRESS 0x6002C371
 /begin IF_DATA XCPplus 0x0102
  /begin DAQ_EVENT VARIABLE /end DAQ_EVENT
 /end IF_DATA
/end MEASUREMENT
/begin MEASUREMENT MonEgyChrgnInlet_flgErrMaxPxp "Flag Debounced Error Upper Limit Proximity Pilot" UBYTE B_TRUE 1 100 0.00 1.00000000000 BIT_MASK 0x40 FORMAT "%13.11" ECU_ADDRESS 0x6002C372
 /begin IF_DATA XCPplus 0x0102
  /begin DAQ_EVENT VARIABLE /end DAQ_EVENT
 /end IF_DATA
/end MEASUREMENT
/begin MEASUREMENT MonEgyChrgnInlet_flgErrMinPxp "Flag Debounced Error Lower Limit Proximity Pilot" UBYTE B_TRUE 1 100 0.00 1.00000000000 BIT_MASK 0x80 FORMAT "%13.11" ECU_ADDRESS 0x6002C372
 /begin IF_DATA XCPplus 0x0102
  /begin DAQ_EVENT VARIABLE /end DAQ_EVENT
 /end IF_DATA
/end MEASUREMENT
/begin MEASUREMENT MonEgyChrgnInlet_flgLockCtrld "Flag actuator controlling finished" UBYTE B_TRUE 1 100 0.00 1.00000000000 BIT_MASK 0x8 FORMAT "%13.11" ECU_ADDRESS 0x6002C383
 /begin IF_DATA XCPplus 0x0102
  /begin DAQ_EVENT VARIABLE /end DAQ_EVENT
 /end IF_DATA
/end MEASUREMENT
/begin MEASUREMENT MonEgyChrgnInlet_flgLockCtrlMinExcdd "Flag minimum actuator controlling time reached" UBYTE B_TRUE 1 100 0.00 1.00000000000 BIT_MASK 0x1 FORMAT "%13.11" ECU_ADDRESS 0x6002C383
 /begin IF_DATA XCPplus 0x0102
  /begin DAQ_EVENT VARIABLE /end DAQ_EVENT
 /end IF_DATA
/end MEASUREMENT
/begin MEASUREMENT MonEgyChrgnInlet_flgLockNVRamChkErr "Flag NV RAM error" UBYTE B_TRUE 1 100 0.00 1.00000000000 BIT_MASK 0x2 FORMAT "%13.11" ECU_ADDRESS 0x6002C383
 /begin IF_DATA XCPplus 0x0102
  /begin DAQ_EVENT VARIABLE /end DAQ_EVENT
 /end IF_DATA
/end MEASUREMENT
/begin MEASUREMENT MonEgyChrgnInlet_flgPlausPwmCcsCtp "Flag detected plausible CCS control pilot PWM signal" UBYTE B_TRUE 1 100 0.00 1.00000000000 BIT_MASK 0x2 FORMAT "%13.11" ECU_ADDRESS 0x6002C372
 /begin IF_DATA XCPplus 0x0102
  /begin DAQ_EVENT VARIABLE /end DAQ_EVENT
 /end IF_DATA
/end MEASUREMENT
/begin MEASUREMENT MonEgyChrgnInlet_flgPlausRatPwmCcsCtp "Flag detected plausible CCS control pilot duty cycle" UBYTE B_TRUE 1 100 0.00 1.00000000000 BIT_MASK 0x4 FORMAT "%13.11" ECU_ADDRESS 0x6002C372
 /begin IF_DATA XCPplus 0x0102
  /begin DAQ_EVENT VARIABLE /end DAQ_EVENT
 /end IF_DATA
/end MEASUREMENT
/begin MEASUREMENT MonEgyChrgnInlet_flgPlgLockActrCtrl "Flag plug lock actuator is being controlled" UBYTE B_TRUE 1 100 0.00 1.00000000000 BIT_MASK 0x20 FORMAT "%13.11" ECU_ADDRESS 0x6002C383
 /begin IF_DATA XCPplus 0x0102
  /begin DAQ_EVENT VARIABLE /end DAQ_EVENT
 /end IF_DATA
/end MEASUREMENT
/begin MEASUREMENT MonEgyChrgnInlet_flgPlgLockActrCtrlOld "Flag one raster delayed status of plug lock actuator is being controlled" UBYTE B_TRUE 1 100 0.00 1.00000000000 BIT_MASK 0x10 FORMAT "%13.11" ECU_ADDRESS 0x6002C383
 /begin IF_DATA XCPplus 0x0102
  /begin DAQ_EVENT VARIABLE /end DAQ_EVENT
 /end IF_DATA
/end MEASUREMENT
/begin MEASUREMENT MonEgyChrgnInlet_flgPosPlgLockBfrCtrl "Flag plug lock connector pin position before actuator control" UBYTE B_TRUE 1 100 0.00 1.00000000000 BIT_MASK 0x40 FORMAT "%13.11" ECU_ADDRESS 0x6002C383
 /begin IF_DATA XCPplus 0x0102
  /begin DAQ_EVENT VARIABLE /end DAQ_EVENT
 /end IF_DATA
/end MEASUREMENT
/begin MEASUREMENT MonEgyChrgnInlet_flgPosPlgLockd "Flag plug lock locked" UBYTE B_TRUE 1 100 0.00 1.00000000000 BIT_MASK 0x4 FORMAT "%13.11" ECU_ADDRESS 0x6002C383
 /begin IF_DATA XCPplus 0x0102
  /begin DAQ_EVENT VARIABLE /end DAQ_EVENT
 /end IF_DATA
/end MEASUREMENT
/begin MEASUREMENT MonEgyChrgnInlet_flgPxpPlgd "Flag Proximity Pilot Plugged" UBYTE B_TRUE 1 100 0.00 1.00000000000 BIT_MASK 0x20 FORMAT "%13.11" ECU_ADDRESS 0x6002C372
 /begin IF_DATA XCPplus 0x0102
  /begin DAQ_EVENT VARIABLE /end DAQ_EVENT
 /end IF_DATA
/end MEASUREMENT
/begin MEASUREMENT MonEgyChrgnInlet_flgRatConPwmCcsCtp "Flag constanst duty cycle detected of CCS control pilot" UBYTE B_TRUE 1 100 0.00 1.00000000000 BIT_MASK 0x8 FORMAT "%13.11" ECU_ADDRESS 0x6002C372
 /begin IF_DATA XCPplus 0x0102
  /begin DAQ_EVENT VARIABLE /end DAQ_EVENT
 /end IF_DATA
/end MEASUREMENT
/begin MEASUREMENT MonEgyChrgnInlet_flgRng1 "Flag Proximity Pilot Range1 Type2" UBYTE B_TRUE 1 100 0.00 1.00000000000 BIT_MASK 0x2 FORMAT "%13.11" ECU_ADDRESS 0x6002C370
 /begin IF_DATA XCPplus 0x0102
  /begin DAQ_EVENT VARIABLE /end DAQ_EVENT
 /end IF_DATA
/end MEASUREMENT
/begin MEASUREMENT MonEgyChrgnInlet_flgRng2 "Flag Proximity Pilot Range2 Type2" UBYTE B_TRUE 1 100 0.00 1.00000000000 BIT_MASK 0x4 FORMAT "%13.11" ECU_ADDRESS 0x6002C370
 /begin IF_DATA XCPplus 0x0102
  /begin DAQ_EVENT VARIABLE /end DAQ_EVENT
 /end IF_DATA
/end MEASUREMENT
/begin MEASUREMENT MonEgyChrgnInlet_flgRng3 "Flag Proximity Pilot Range3 Type2" UBYTE B_TRUE 1 100 0.00 1.00000000000 BIT_MASK 0x8 FORMAT "%13.11" ECU_ADDRESS 0x6002C370
 /begin IF_DATA XCPplus 0x0102
  /begin DAQ_EVENT VARIABLE /end DAQ_EVENT
 /end IF_DATA
/end MEASUREMENT
/begin MEASUREMENT MonEgyChrgnInlet_flgRng4 "Flag Proximity Pilot Range4 Type2" UBYTE B_TRUE 1 100 0.00 1.00000000000 BIT_MASK 0x10 FORMAT "%13.11" ECU_ADDRESS 0x6002C370
 /begin IF_DATA XCPplus 0x0102
  /begin DAQ_EVENT VARIABLE /end DAQ_EVENT
 /end IF_DATA
/end MEASUREMENT
/begin MEASUREMENT MonEgyChrgnInlet_flgTmpErrMaxCtp "Flag Temporary Error above maximum value Control Pilot" UBYTE B_TRUE 1 100 0.00 1.00000000000 BIT_MASK 0x1 FORMAT "%13.11" ECU_ADDRESS 0x6002C371
 /begin IF_DATA XCPplus 0x0102
  /begin DAQ_EVENT VARIABLE /end DAQ_EVENT
 /end IF_DATA
/end MEASUREMENT
/begin MEASUREMENT MonEgyChrgnInlet_flgTmpErrMaxPxp "Flag Temporary Error above maximum value Proximity Pilot" UBYTE B_TRUE 1 100 0.00 1.00000000000 BIT_MASK 0x20 FORMAT "%13.11" ECU_ADDRESS 0x6002C370
 /begin IF_DATA XCPplus 0x0102
  /begin DAQ_EVENT VARIABLE /end DAQ_EVENT
 /end IF_DATA
/end MEASUREMENT
/begin MEASUREMENT MonEgyChrgnInlet_flgTmpErrMinPxp "Flag Temporary Error below minimum value Proximity Pilot" UBYTE B_TRUE 1 100 0.00 1.00000000000 BIT_MASK 0x40 FORMAT "%13.11" ECU_ADDRESS 0x6002C370
 /begin IF_DATA XCPplus 0x0102
  /begin DAQ_EVENT VARIABLE /end DAQ_EVENT
 /end IF_DATA
/end MEASUREMENT
/begin MEASUREMENT MonEgyChrgnInlet_flgVrntCcsInletTyp1 "Flag CCS Inlet Type 1 variant" UBYTE B_TRUE 1 100 0.00 1.00000000000 BIT_MASK 0x4 FORMAT "%13.11" ECU_ADDRESS 0x6002C34C
 /begin IF_DATA XCPplus 0x0102
  /begin DAQ_EVENT VARIABLE /end DAQ_EVENT
 /end IF_DATA
/end MEASUREMENT
/begin MEASUREMENT MonEgyChrgnInlet_flgVrntCcsInletTyp2 "Flag CCS Inlet Type 2 variant" UBYTE B_TRUE 1 100 0.00 1.00000000000 BIT_MASK 0x8 FORMAT "%13.11" ECU_ADDRESS 0x6002C34C
 /begin IF_DATA XCPplus 0x0102
  /begin DAQ_EVENT VARIABLE /end DAQ_EVENT
 /end IF_DATA
/end MEASUREMENT
/begin MEASUREMENT MonEgyChrgnInlet_ratPwmCcsCtp "Duty cycle of CCS control pilot" UWORD RBPtCel_Perc_0p01_1 1 100 0.00 655.3500 FORMAT "%8.4" ECU_ADDRESS 0x6002C38E
 /begin IF_DATA XCPplus 0x0102
  /begin DAQ_EVENT VARIABLE /end DAQ_EVENT
 /end IF_DATA
/end MEASUREMENT
/begin MEASUREMENT MonEgyChrgnInlet_ratPwmCcsCtpCpl "Complement of MonEgyChrgnInlet_ratPwmCcsCtp" UWORD OneToOne 1 100 0.00 65535.00 FORMAT "%8.2" ECU_ADDRESS 0x6002B976
 /begin IF_DATA XCPplus 0x0102
  /begin DAQ_EVENT VARIABLE /end DAQ_EVENT
 /end IF_DATA
/end MEASUREMENT
/begin MEASUREMENT MonEgyChrgnInlet_ratPwmCcsCtpLoc "Duty cycle of CCS control pilot" UWORD RBPtCel_Perc_0p01_1 1 100 0.00 655.3500 FORMAT "%8.4" ECU_ADDRESS 0x6002C392
 /begin IF_DATA XCPplus 0x0102
  /begin DAQ_EVENT VARIABLE /end DAQ_EVENT
 /end IF_DATA
/end MEASUREMENT
/begin MEASUREMENT MonEgyChrgnInlet_ratPwmCcsCtpLocCpl "Complement of MonEgyChrgnInlet_ratPwmCcsCtpLoc" UWORD OneToOne 1 100 0.00 65535.00 FORMAT "%8.2" ECU_ADDRESS 0x6002B974
 /begin IF_DATA XCPplus 0x0102
  /begin DAQ_EVENT VARIABLE /end DAQ_EVENT
 /end IF_DATA
/end MEASUREMENT
/begin MEASUREMENT MonEgyChrgnInlet_stCcsChrgPlg "Status CCS charge plug" UBYTE MonEgyChrgnInlet_stCcsChrgPlg_VERB 1 100 0.00 4.00000000000 FORMAT "%13.11" ECU_ADDRESS 0x6002C35C
 /begin IF_DATA XCPplus 0x0102
  /begin DAQ_EVENT VARIABLE /end DAQ_EVENT
 /end IF_DATA
/end MEASUREMENT
/begin MEASUREMENT MonEgyChrgnInlet_stCcsChrgPlgCpl "Complement of MonEgyChrgnInlet_stCcsChrgPlg" UBYTE OneToOne 1 100 0.00 255.0 FORMAT "%5.1" ECU_ADDRESS 0x6002B947
 /begin IF_DATA XCPplus 0x0102
  /begin DAQ_EVENT VARIABLE /end DAQ_EVENT
 /end IF_DATA
/end MEASUREMENT
/begin MEASUREMENT MonEgyChrgnInlet_stCcsChrgPlgIf "Status CCS charging plug" UBYTE MonEgyChrgnInlet_stCcsChrgPlg_VERB 1 100 0.00 4.00000000000 FORMAT "%13.11" ECU_ADDRESS 0x6002C3A7
 /begin IF_DATA XCPplus 0x0102
  /begin DAQ_EVENT VARIABLE /end DAQ_EVENT
 /end IF_DATA
/end MEASUREMENT
/begin MEASUREMENT MonEgyChrgnInlet_stCcsChrgPlgIfCpl "Complement of MonEgyChrgnInlet_stCcsChrgPlgIf" UBYTE OneToOne 1 100 0.00 255.0 FORMAT "%5.1" ECU_ADDRESS 0x6002B98B
 /begin IF_DATA XCPplus 0x0102
  /begin DAQ_EVENT VARIABLE /end DAQ_EVENT
 /end IF_DATA
/end MEASUREMENT
/begin MEASUREMENT MonEgyChrgnInlet_stCcsCtp "Status CCS control pilot" UBYTE MonEgyChrgnInlet_stPlgPlt_VERB 1 100 0.00 3.00000000000 FORMAT "%13.11" ECU_ADDRESS 0x6002C35B
 /begin IF_DATA XCPplus 0x0102
  /begin DAQ_EVENT VARIABLE /end DAQ_EVENT
 /end IF_DATA
/end MEASUREMENT
/begin MEASUREMENT MonEgyChrgnInlet_stCcsCtpCpl "Complement of MonEgyChrgnInlet_stCcsCtp" UBYTE OneToOne 1 100 0.00 255.0 FORMAT "%5.1" ECU_ADDRESS 0x6002B946
 /begin IF_DATA XCPplus 0x0102
  /begin DAQ_EVENT VARIABLE /end DAQ_EVENT
 /end IF_DATA
/end MEASUREMENT
/begin MEASUREMENT MonEgyChrgnInlet_stCcsPlgLock "Qualifier status CCS charging connector lock" UBYTE MonEgyChrgnInlet_stCcsPlgLock_VERB 1 100 0.00 3.00000000000 FORMAT "%13.11" ECU_ADDRESS 0x6002C377
 /begin IF_DATA XCPplus 0x0102
  /begin DAQ_EVENT VARIABLE /end DAQ_EVENT
 /end IF_DATA
/end MEASUREMENT
/begin MEASUREMENT MonEgyChrgnInlet_stCcsPlgLockCpl "Complement of MonEgyChrgnInlet_stCcsPlgLock" UBYTE OneToOne 1 100 0.00 255.0 FORMAT "%5.1" ECU_ADDRESS 0x6002B95F
 /begin IF_DATA XCPplus 0x0102
  /begin DAQ_EVENT VARIABLE /end DAQ_EVENT
 /end IF_DATA
/end MEASUREMENT
/begin MEASUREMENT MonEgyChrgnInlet_stCcsPlgLockIf "Status CCS charging plug lock" UBYTE MonEgyChrgnInlet_stCcsPlgLock_VERB 1 100 0.00 3.00000000000 FORMAT "%13.11" ECU_ADDRESS 0x6002C3A6
 /begin IF_DATA XCPplus 0x0102
  /begin DAQ_EVENT VARIABLE /end DAQ_EVENT
 /end IF_DATA
/end MEASUREMENT
/begin MEASUREMENT MonEgyChrgnInlet_stCcsPlgLockIfCpl "Complement of MonEgyChrgnInlet_stCcsPlgLockIf" UBYTE OneToOne 1 100 0.00 255.0 FORMAT "%5.1" ECU_ADDRESS 0x6002B98A
 /begin IF_DATA XCPplus 0x0102
  /begin DAQ_EVENT VARIABLE /end DAQ_EVENT
 /end IF_DATA
/end MEASUREMENT
/begin MEASUREMENT MonEgyChrgnInlet_stCcsPxp "Status CCS proximity pilot" UBYTE MonEgyChrgnInlet_stPlgPlt_VERB 1 100 0.00 3.00000000000 FORMAT "%13.11" ECU_ADDRESS 0x6002C35A
 /begin IF_DATA XCPplus 0x0102
  /begin DAQ_EVENT VARIABLE /end DAQ_EVENT
 /end IF_DATA
/end MEASUREMENT
/begin MEASUREMENT MonEgyChrgnInlet_stCcsPxpCpl "Complement of MonEgyChrgnInlet_stCcsPxp" UBYTE OneToOne 1 100 0.00 255.0 FORMAT "%5.1" ECU_ADDRESS 0x6002B945
 /begin IF_DATA XCPplus 0x0102
  /begin DAQ_EVENT VARIABLE /end DAQ_EVENT
 /end IF_DATA
/end MEASUREMENT
/begin MEASUREMENT MonEgyChrgnInlet_stChrgPlg "Status charge plug of all available plug(s)" UBYTE MonEgyChrgnInlet_stChrgPlg_VERB 1 100 0.00 5.00000000000 FORMAT "%13.11" ECU_ADDRESS 0x6002C359
 /begin IF_DATA XCPplus 0x0102
  /begin DAQ_EVENT VARIABLE /end DAQ_EVENT
 /end IF_DATA
/end MEASUREMENT
/begin MEASUREMENT MonEgyChrgnInlet_stChrgPlgCpl "Complement of MonEgyChrgnInlet_stChrgPlg" UBYTE OneToOne 1 100 0.00 255.0 FORMAT "%5.1" ECU_ADDRESS 0x6002B944
 /begin IF_DATA XCPplus 0x0102
  /begin DAQ_EVENT VARIABLE /end DAQ_EVENT
 /end IF_DATA
/end MEASUREMENT
/begin MEASUREMENT MonEgyChrgnInlet_stChrgPlgIf "Status charge plug of all available plug(s)" UBYTE MonEgyChrgnInlet_stChrgPlg_VERB 1 100 0.00 5.00000000000 FORMAT "%13.11" ECU_ADDRESS 0x6002C3A5
 /begin IF_DATA XCPplus 0x0102
  /begin DAQ_EVENT VARIABLE /end DAQ_EVENT
 /end IF_DATA
/end MEASUREMENT
/begin MEASUREMENT MonEgyChrgnInlet_stChrgPlgIfCpl "Complement of MonEgyChrgnInlet_stChrgPlgIf" UBYTE OneToOne 1 100 0.00 255.0 FORMAT "%5.1" ECU_ADDRESS 0x6002B989
 /begin IF_DATA XCPplus 0x0102
  /begin DAQ_EVENT VARIABLE /end DAQ_EVENT
 /end IF_DATA
/end MEASUREMENT
/begin MEASUREMENT MonEgyChrgnInlet_stDebConPwmCcsCtp "Status debouncing constanst duty cycle detection of CCS control pilot" UBYTE OneToOne 1 100 0.00 255.0 FORMAT "%5.1" ECU_ADDRESS 0x6002C363
 /begin IF_DATA XCPplus 0x0102
  /begin DAQ_EVENT VARIABLE /end DAQ_EVENT
 /end IF_DATA
/end MEASUREMENT
/begin MEASUREMENT MonEgyChrgnInlet_stDebConPwmCcsCtpCpl "Complement of MonEgyChrgnInlet_stDebConPwmCcsCtp" UBYTE OneToOne 1 100 0.00 255.0 FORMAT "%5.1" ECU_ADDRESS 0x6002B943
 /begin IF_DATA XCPplus 0x0102
  /begin DAQ_EVENT VARIABLE /end DAQ_EVENT
 /end IF_DATA
/end MEASUREMENT
/begin MEASUREMENT MonEgyChrgnInlet_stDebCtpDigComReq "Debounce counter status control pilot digital communication required" UBYTE OneToOne 1 100 0.00 255.0 FORMAT "%5.1" ECU_ADDRESS 0x6002C362
 /begin IF_DATA XCPplus 0x0102
  /begin DAQ_EVENT VARIABLE /end DAQ_EVENT
 /end IF_DATA
/end MEASUREMENT
/begin MEASUREMENT MonEgyChrgnInlet_stDebCtpDigComReqCpl "Complement of MonEgyChrgnInlet_stDebCtpDigComReq" UBYTE OneToOne 1 100 0.00 255.0 FORMAT "%5.1" ECU_ADDRESS 0x6002B942
 /begin IF_DATA XCPplus 0x0102
  /begin DAQ_EVENT VARIABLE /end DAQ_EVENT
 /end IF_DATA
/end MEASUREMENT
/begin MEASUREMENT MonEgyChrgnInlet_stDebImpsSnsrPlgLock "Status debounce implausible sensor plug lock" UBYTE OneToOne 1 100 0.00 255.0 FORMAT "%5.1" ECU_ADDRESS 0x6002C37B
 /begin IF_DATA XCPplus 0x0102
  /begin DAQ_EVENT VARIABLE /end DAQ_EVENT
 /end IF_DATA
/end MEASUREMENT
/begin MEASUREMENT MonEgyChrgnInlet_stDebImpsSnsrPlgLockCpl "Complement of MonEgyChrgnInlet_stDebImpsSnsrPlgLock" UBYTE OneToOne 1 100 0.00 255.0 FORMAT "%5.1" ECU_ADDRESS 0x6002B95E
 /begin IF_DATA XCPplus 0x0102
  /begin DAQ_EVENT VARIABLE /end DAQ_EVENT
 /end IF_DATA
/end MEASUREMENT
/begin MEASUREMENT MonEgyChrgnInlet_stDebMaxCtp "Debounce status Control Pilot Upper Limit" UBYTE OneToOne 1 100 0.00 255.0 FORMAT "%5.1" ECU_ADDRESS 0x6002C361
 /begin IF_DATA XCPplus 0x0102
  /begin DAQ_EVENT VARIABLE /end DAQ_EVENT
 /end IF_DATA
/end MEASUREMENT
/begin MEASUREMENT MonEgyChrgnInlet_stDebMaxCtpCpl "Complement of MonEgyChrgnInlet_stDebMaxCtp" UBYTE OneToOne 1 100 0.00 255.0 FORMAT "%5.1" ECU_ADDRESS 0x6002B941
 /begin IF_DATA XCPplus 0x0102
  /begin DAQ_EVENT VARIABLE /end DAQ_EVENT
 /end IF_DATA
/end MEASUREMENT
/begin MEASUREMENT MonEgyChrgnInlet_stDebMaxPxp "Debounce status Control Pilot Upper Limit" UBYTE OneToOne 1 100 0.00 255.0 FORMAT "%5.1" ECU_ADDRESS 0x6002C360
 /begin IF_DATA XCPplus 0x0102
  /begin DAQ_EVENT VARIABLE /end DAQ_EVENT
 /end IF_DATA
/end MEASUREMENT
/begin MEASUREMENT MonEgyChrgnInlet_stDebMaxPxpCpl "Complement of MonEgyChrgnInlet_stDebMaxPxp" UBYTE OneToOne 1 100 0.00 255.0 FORMAT "%5.1" ECU_ADDRESS 0x6002B940
 /begin IF_DATA XCPplus 0x0102
  /begin DAQ_EVENT VARIABLE /end DAQ_EVENT
 /end IF_DATA
/end MEASUREMENT
/begin MEASUREMENT MonEgyChrgnInlet_stDebMaxSnsrPlgLock "Status signal range check maximum for feedback sensor signal" UBYTE OneToOne 1 100 0.00 255.0 FORMAT "%5.1" ECU_ADDRESS 0x6002C37A
 /begin IF_DATA XCPplus 0x0102
  /begin DAQ_EVENT VARIABLE /end DAQ_EVENT
 /end IF_DATA
/end MEASUREMENT
/begin MEASUREMENT MonEgyChrgnInlet_stDebMaxSnsrPlgLockCpl "Complement of MonEgyChrgnInlet_stDebMaxSnsrPlgLock" UBYTE OneToOne 1 100 0.00 255.0 FORMAT "%5.1" ECU_ADDRESS 0x6002B95D
 /begin IF_DATA XCPplus 0x0102
  /begin DAQ_EVENT VARIABLE /end DAQ_EVENT
 /end IF_DATA
/end MEASUREMENT
/begin MEASUREMENT MonEgyChrgnInlet_stDebMinPxp "Debounce status Proximity Pilot Lower Limit" UBYTE OneToOne 1 100 0.00 255.0 FORMAT "%5.1" ECU_ADDRESS 0x6002C35F
 /begin IF_DATA XCPplus 0x0102
  /begin DAQ_EVENT VARIABLE /end DAQ_EVENT
 /end IF_DATA
/end MEASUREMENT
/begin MEASUREMENT MonEgyChrgnInlet_stDebMinPxpCpl "Complement of MonEgyChrgnInlet_stDebMinPxp" UBYTE OneToOne 1 100 0.00 255.0 FORMAT "%5.1" ECU_ADDRESS 0x6002B93F
 /begin IF_DATA XCPplus 0x0102
  /begin DAQ_EVENT VARIABLE /end DAQ_EVENT
 /end IF_DATA
/end MEASUREMENT
/begin MEASUREMENT MonEgyChrgnInlet_stDebMinSnsrPlgLock "Status signal range check minimum for feedback sensor signal" UBYTE OneToOne 1 100 0.00 255.0 FORMAT "%5.1" ECU_ADDRESS 0x6002C379
 /begin IF_DATA XCPplus 0x0102
  /begin DAQ_EVENT VARIABLE /end DAQ_EVENT
 /end IF_DATA
/end MEASUREMENT
/begin MEASUREMENT MonEgyChrgnInlet_stDebMinSnsrPlgLockCpl "Complement of MonEgyChrgnInlet_stDebMinSnsrPlgLock" UBYTE OneToOne 1 100 0.00 255.0 FORMAT "%5.1" ECU_ADDRESS 0x6002B95C
 /begin IF_DATA XCPplus 0x0102
  /begin DAQ_EVENT VARIABLE /end DAQ_EVENT
 /end IF_DATA
/end MEASUREMENT
/begin MEASUREMENT MonEgyChrgnInlet_stDebPerdPwmCcsCtp "Debounce counter status periodic times CCS control pilot" UBYTE OneToOne 1 100 0.00 255.0 FORMAT "%5.1" ECU_ADDRESS 0x6002C35E
 /begin IF_DATA XCPplus 0x0102
  /begin DAQ_EVENT VARIABLE /end DAQ_EVENT
 /end IF_DATA
/end MEASUREMENT
/begin MEASUREMENT MonEgyChrgnInlet_stDebPerdPwmCcsCtpCpl "Complement of MonEgyChrgnInlet_stDebPerdPwmCcsCtp" UBYTE OneToOne 1 100 0.00 255.0 FORMAT "%5.1" ECU_ADDRESS 0x6002B93E
 /begin IF_DATA XCPplus 0x0102
  /begin DAQ_EVENT VARIABLE /end DAQ_EVENT
 /end IF_DATA
/end MEASUREMENT
/begin MEASUREMENT MonEgyChrgnInlet_stDebPwmCcsCtpPlausAc "Status debouncing duty cycle of plausible AC charging current CCS control pilot" UBYTE OneToOne 1 100 0.00 255.0 FORMAT "%5.1" ECU_ADDRESS 0x6002C35D
 /begin IF_DATA XCPplus 0x0102
  /begin DAQ_EVENT VARIABLE /end DAQ_EVENT
 /end IF_DATA
/end MEASUREMENT
/begin MEASUREMENT MonEgyChrgnInlet_stDebPwmCcsCtpPlausAcCpl "Complement of MonEgyChrgnInlet_stDebPwmCcsCtpPlausAc" UBYTE OneToOne 1 100 0.00 255.0 FORMAT "%5.1" ECU_ADDRESS 0x6002B93D
 /begin IF_DATA XCPplus 0x0102
  /begin DAQ_EVENT VARIABLE /end DAQ_EVENT
 /end IF_DATA
/end MEASUREMENT
/begin MEASUREMENT MonEgyChrgnInlet_stDiagCcsChrgPlg "Status diagnosis CCS charging plug" ULONG OneToOne 1 100 0.00 4294967295.00 FORMAT "%13.2" ECU_ADDRESS 0x6002C354
 /begin IF_DATA XCPplus 0x0102
  /begin DAQ_EVENT VARIABLE /end DAQ_EVENT
 /end IF_DATA
/end MEASUREMENT
/begin MEASUREMENT MonEgyChrgnInlet_stDiagCcsChrgPlgCpl "Complement of MonEgyChrgnInlet_stDiagCcsChrgPlg" ULONG OneToOne 1 100 0.00 4294967295.00 FORMAT "%13.2" ECU_ADDRESS 0x6002B938
 /begin IF_DATA XCPplus 0x0102
  /begin DAQ_EVENT VARIABLE /end DAQ_EVENT
 /end IF_DATA
/end MEASUREMENT
/begin MEASUREMENT MonEgyChrgnInlet_stDiagCcsChrgPlgIf "Status diagnosis CCS charge plug" ULONG OneToOne 1 100 0.00 4294967295.00 FORMAT "%13.2" ECU_ADDRESS 0x6002C3A0
 /begin IF_DATA XCPplus 0x0102
  /begin DAQ_EVENT VARIABLE /end DAQ_EVENT
 /end IF_DATA
/end MEASUREMENT
/begin MEASUREMENT MonEgyChrgnInlet_stDiagCcsChrgPlgIfCpl "Complement of MonEgyChrgnInlet_stDiagCcsChrgPlgIf" ULONG OneToOne 1 100 0.00 4294967295.00 FORMAT "%13.2" ECU_ADDRESS 0x6002B984
 /begin IF_DATA XCPplus 0x0102
  /begin DAQ_EVENT VARIABLE /end DAQ_EVENT
 /end IF_DATA
/end MEASUREMENT
/begin MEASUREMENT MonEgyChrgnInlet_stDiagCcsCtp "Status diagnosis CCS control pilot" UWORD OneToOne 1 100 0.00 65535.00 FORMAT "%8.2" ECU_ADDRESS 0x6002C350
 /begin IF_DATA XCPplus 0x0102
  /begin DAQ_EVENT VARIABLE /end DAQ_EVENT
 /end IF_DATA
/end MEASUREMENT
/begin MEASUREMENT MonEgyChrgnInlet_stDiagCcsCtpCpl "Complement of MonEgyChrgnInlet_stDiagCcsCtp" UWORD OneToOne 1 100 0.00 65535.00 FORMAT "%8.2" ECU_ADDRESS 0x6002B934
 /begin IF_DATA XCPplus 0x0102
  /begin DAQ_EVENT VARIABLE /end DAQ_EVENT
 /end IF_DATA
/end MEASUREMENT
/begin MEASUREMENT MonEgyChrgnInlet_stDiagCcsPlgLock "Status diagnosis of CCS plug lock" UBYTE OneToOne 1 100 0.00 255.0 FORMAT "%5.1" ECU_ADDRESS 0x6002C376
 /begin IF_DATA XCPplus 0x0102
  /begin DAQ_EVENT VARIABLE /end DAQ_EVENT
 /end IF_DATA
/end MEASUREMENT
/begin MEASUREMENT MonEgyChrgnInlet_stDiagCcsPlgLockCpl "Complement of MonEgyChrgnInlet_stDiagCcsPlgLock" UBYTE OneToOne 1 100 0.00 255.0 FORMAT "%5.1" ECU_ADDRESS 0x6002B95B
 /begin IF_DATA XCPplus 0x0102
  /begin DAQ_EVENT VARIABLE /end DAQ_EVENT
 /end IF_DATA
/end MEASUREMENT
/begin MEASUREMENT MonEgyChrgnInlet_stDiagCcsPlgLockIf "Status diagnosis CCS charge plug lock" UBYTE OneToOne 1 100 0.00 255.0 FORMAT "%5.1" ECU_ADDRESS 0x6002C3A4
 /begin IF_DATA XCPplus 0x0102
  /begin DAQ_EVENT VARIABLE /end DAQ_EVENT
 /end IF_DATA
/end MEASUREMENT
/begin MEASUREMENT MonEgyChrgnInlet_stDiagCcsPlgLockIfCpl "Complement of MonEgyChrgnInlet_stDiagCcsPlgLockIf" UBYTE OneToOne 1 100 0.00 255.0 FORMAT "%5.1" ECU_ADDRESS 0x6002B988
 /begin IF_DATA XCPplus 0x0102
  /begin DAQ_EVENT VARIABLE /end DAQ_EVENT
 /end IF_DATA
/end MEASUREMENT
/begin MEASUREMENT MonEgyChrgnInlet_stDiagCcsPxp "Status diagnosis CCS proximity pilot" UBYTE OneToOne 1 100 0.00 255.0 FORMAT "%5.1" ECU_ADDRESS 0x6002C358
 /begin IF_DATA XCPplus 0x0102
  /begin DAQ_EVENT VARIABLE /end DAQ_EVENT
 /end IF_DATA
/end MEASUREMENT
/begin MEASUREMENT MonEgyChrgnInlet_stDiagCcsPxpCpl "Complement of MonEgyChrgnInlet_stDiagCcsPxp" UBYTE OneToOne 1 100 0.00 255.0 FORMAT "%5.1" ECU_ADDRESS 0x6002B93C
 /begin IF_DATA XCPplus 0x0102
  /begin DAQ_EVENT VARIABLE /end DAQ_EVENT
 /end IF_DATA
/end MEASUREMENT
/begin MEASUREMENT MonEgyChrgnInlet_stElecCcsPlgLockPosn "Status electrical CCS plug lock position" UBYTE OneToOne 1 100 0.00 255.0 FORMAT "%5.1" ECU_ADDRESS 0x6002C378
 /begin IF_DATA XCPplus 0x0102
  /begin DAQ_EVENT VARIABLE /end DAQ_EVENT
 /end IF_DATA
/end MEASUREMENT
/begin MEASUREMENT MonEgyChrgnInlet_stElecCcsPlgLockPosnCpl "Complement of MonEgyChrgnInlet_stElecCcsPlgLockPosn" UBYTE OneToOne 1 100 0.00 255.0 FORMAT "%5.1" ECU_ADDRESS 0x6002B95A
 /begin IF_DATA XCPplus 0x0102
  /begin DAQ_EVENT VARIABLE /end DAQ_EVENT
 /end IF_DATA
/end MEASUREMENT
/begin MEASUREMENT MonEgyChrgnInlet_stPlgLockCmdMsg "Control status of plug lock actuator" UBYTE OneToOne 1 100 0.00 255.0 FORMAT "%5.1" ECU_ADDRESS 0x6002351D
 /begin IF_DATA XCPplus 0x0102
  /begin DAQ_EVENT VARIABLE /end DAQ_EVENT
 /end IF_DATA
/end MEASUREMENT
/begin MEASUREMENT MonEgyChrgnInlet_stPosPlgLockOld "Old value of MonEgyChrgnInlet_stPosPlgLock" UBYTE OneToOne 1 100 0.00 255.0 FORMAT "%5.1" ECU_ADDRESS 0x60035F85
 /begin IF_DATA XCPplus 0x0102
  /begin DAQ_EVENT VARIABLE /end DAQ_EVENT
 /end IF_DATA
/end MEASUREMENT
/begin MEASUREMENT MonEgyChrgnInlet_stPosPlgLockOldCpl "Complement of MonEgyChrgnInlet_stPosPlgLock" UBYTE OneToOne 1 100 0.00 255.0 FORMAT "%5.1" ECU_ADDRESS 0x60035F84
 /begin IF_DATA XCPplus 0x0102
  /begin DAQ_EVENT VARIABLE /end DAQ_EVENT
 /end IF_DATA
/end MEASUREMENT
/begin MEASUREMENT MonEgyChrgnInlet_stSigCcsCtpLoc "Status PWM signal CCS control pilot" UBYTE OneToOne 1 100 0.00 255.0 FORMAT "%5.1" ECU_ADDRESS 0x6002C39C
 /begin IF_DATA XCPplus 0x0102
  /begin DAQ_EVENT VARIABLE /end DAQ_EVENT
 /end IF_DATA
/end MEASUREMENT
/begin MEASUREMENT MonEgyChrgnInlet_stSigCcsCtpLocCpl "Complement of MonEgyChrgnInlet_stSigCcsCtpLoc" UBYTE OneToOne 1 100 0.00 255.0 FORMAT "%5.1" ECU_ADDRESS 0x6002B980
 /begin IF_DATA XCPplus 0x0102
  /begin DAQ_EVENT VARIABLE /end DAQ_EVENT
 /end IF_DATA
/end MEASUREMENT
/begin MEASUREMENT MonEgyChrgnInlet_tiLoadCcsCtpLoc "Time high duration duty cycle of CCS control pilot" UWORD q1Em6_s 1 100 0.00 0.06553500 FORMAT "%10.8" ECU_ADDRESS 0x6002C390
 /begin IF_DATA XCPplus 0x0102
  /begin DAQ_EVENT VARIABLE /end DAQ_EVENT
 /end IF_DATA
/end MEASUREMENT
/begin MEASUREMENT MonEgyChrgnInlet_tiLoadCcsCtpLocCpl "Complement of MonEgyChrgnInlet_tiLoadCcsCtpLoc" UWORD OneToOne 1 100 0.00 65535.00 FORMAT "%8.2" ECU_ADDRESS 0x6002B972
 /begin IF_DATA XCPplus 0x0102
  /begin DAQ_EVENT VARIABLE /end DAQ_EVENT
 /end IF_DATA
/end MEASUREMENT
/begin MEASUREMENT MonEgyChrgnInlet_tiPerdCcsCtp "Periodic times CSS control pilot" ULONG t_q5Em8_s 1 100 0.00 214.748364750 FORMAT "%13.9" ECU_ADDRESS 0x6002C394
 /begin IF_DATA XCPplus 0x0102
  /begin DAQ_EVENT VARIABLE /end DAQ_EVENT
 /end IF_DATA
/end MEASUREMENT
/begin MEASUREMENT MonEgyChrgnInlet_tiPerdCcsCtpCpl "Complement of MonEgyChrgnInlet_tiPerdCcsCtp" ULONG OneToOne 1 100 0.00 4294967295.00 FORMAT "%13.2" ECU_ADDRESS 0x6002B97C
 /begin IF_DATA XCPplus 0x0102
  /begin DAQ_EVENT VARIABLE /end DAQ_EVENT
 /end IF_DATA
/end MEASUREMENT
/begin MEASUREMENT MonEgyChrgnInlet_tiPerdCcsCtpLoc "Periodic time CCS control pilot" ULONG t_q5Em8_s 1 100 0.00 214.748364750 FORMAT "%13.9" ECU_ADDRESS 0x6002C398
 /begin IF_DATA XCPplus 0x0102
  /begin DAQ_EVENT VARIABLE /end DAQ_EVENT
 /end IF_DATA
/end MEASUREMENT
/begin MEASUREMENT MonEgyChrgnInlet_tiPerdCcsCtpLocCpl "Complement of MonEgyChrgnInlet_tiPerdCcsCtpLoc" ULONG OneToOne 1 100 0.00 4294967295.00 FORMAT "%13.2" ECU_ADDRESS 0x6002B978
 /begin IF_DATA XCPplus 0x0102
  /begin DAQ_EVENT VARIABLE /end DAQ_EVENT
 /end IF_DATA
/end MEASUREMENT
/begin MEASUREMENT MonEgyChrgnInlet_uCtp "CCS Control Pilot voltage" UWORD spg_q0p00488 1 100 0.00 319.9951 FORMAT "%8.4" ECU_ADDRESS 0x6002C34A
 /begin IF_DATA XCPplus 0x0102
  /begin DAQ_EVENT VARIABLE /end DAQ_EVENT
 /end IF_DATA
/end MEASUREMENT
/begin MEASUREMENT MonEgyChrgnInlet_uCtpCpl "Complement of MonEgyChrgnInlet_uCtp" UWORD OneToOne 1 100 0.00 65535.00 FORMAT "%8.2" ECU_ADDRESS 0x6002B92E
 /begin IF_DATA XCPplus 0x0102
  /begin DAQ_EVENT VARIABLE /end DAQ_EVENT
 /end IF_DATA
/end MEASUREMENT
/begin MEASUREMENT MonEgyChrgnInlet_uCtpEvseErr "CCS Control Pilot voltage which indicates EVSE error" UWORD spg_q0p00488 1 100 0.00 319.9951 FORMAT "%8.4" ECU_ADDRESS 0x6002C348
 /begin IF_DATA XCPplus 0x0102
  /begin DAQ_EVENT VARIABLE /end DAQ_EVENT
 /end IF_DATA
/end MEASUREMENT
/begin MEASUREMENT MonEgyChrgnInlet_uCtpEvseErrCpl "Complement of MonEgyChrgnInlet_uCtpEvseErr" UWORD OneToOne 1 100 0.00 65535.00 FORMAT "%8.2" ECU_ADDRESS 0x6002B92C
 /begin IF_DATA XCPplus 0x0102
  /begin DAQ_EVENT VARIABLE /end DAQ_EVENT
 /end IF_DATA
/end MEASUREMENT
/begin MEASUREMENT MonEgyChrgnInlet_uPxp "CCS Proximity Pilot voltage" UWORD spg_q0p00488 1 100 0.00 319.9951 FORMAT "%8.4" ECU_ADDRESS 0x6002C346
 /begin IF_DATA XCPplus 0x0102
  /begin DAQ_EVENT VARIABLE /end DAQ_EVENT
 /end IF_DATA
/end MEASUREMENT
/begin MEASUREMENT MonEgyChrgnInlet_uPxpCpl "Complement of MonEgyChrgnInlet_uPxp" UWORD OneToOne 1 100 0.00 65535.00 FORMAT "%8.2" ECU_ADDRESS 0x6002B92A
 /begin IF_DATA XCPplus 0x0102
  /begin DAQ_EVENT VARIABLE /end DAQ_EVENT
 /end IF_DATA
/end MEASUREMENT
/begin MEASUREMENT MonEgyChrgnInlet_uRawCcsCtp "Raw value CCS Control Pilot voltage" SWORD spg_q0p0012207_V 1 100 -40.00000 39.99878 FORMAT "%8.5" ECU_ADDRESS 0x6002C38C
 /begin IF_DATA XCPplus 0x0102
  /begin DAQ_EVENT VARIABLE /end DAQ_EVENT
 /end IF_DATA
/end MEASUREMENT
/begin MEASUREMENT MonEgyChrgnInlet_uRawCcsCtpCpl "Complement of MonEgyChrgnInlet_uRawCcsCtp" UWORD OneToOne 1 100 0.00 65535.00 FORMAT "%8.2" ECU_ADDRESS 0x6002B970
 /begin IF_DATA XCPplus 0x0102
  /begin DAQ_EVENT VARIABLE /end DAQ_EVENT
 /end IF_DATA
/end MEASUREMENT
/begin MEASUREMENT MonEgyChrgnInlet_uRawCcsCtpStEvse "Raw value CCS Control Pilot EVSE status voltage" SWORD spg_q0p0012207_V 1 100 -40.00000 39.99878 FORMAT "%8.5" ECU_ADDRESS 0x6002C38A
 /begin IF_DATA XCPplus 0x0102
  /begin DAQ_EVENT VARIABLE /end DAQ_EVENT
 /end IF_DATA
/end MEASUREMENT
/begin MEASUREMENT MonEgyChrgnInlet_uRawCcsCtpStEvseCpl "Complement of MonEgyChrgnInlet_uRawCcsCtpStEvse" UWORD OneToOne 1 100 0.00 65535.00 FORMAT "%8.2" ECU_ADDRESS 0x6002B96E
 /begin IF_DATA XCPplus 0x0102
  /begin DAQ_EVENT VARIABLE /end DAQ_EVENT
 /end IF_DATA
/end MEASUREMENT
/begin MEASUREMENT MonEgyChrgnInlet_uRawCcsCtpSwtDiag "Raw voltage of CCS control pilot switch" SWORD spg_q0p0012207_V 1 100 -40.00000 39.99878 FORMAT "%8.5" ECU_ADDRESS 0x6002C388
 /begin IF_DATA XCPplus 0x0102
  /begin DAQ_EVENT VARIABLE /end DAQ_EVENT
 /end IF_DATA
/end MEASUREMENT
/begin MEASUREMENT MonEgyChrgnInlet_uRawCcsCtpSwtDiagCpl "Complement of MonEgyChrgnInlet_uRawCcsCtpSwtDiag" UWORD OneToOne 1 100 0.00 65535.00 FORMAT "%8.2" ECU_ADDRESS 0x6002B96C
 /begin IF_DATA XCPplus 0x0102
  /begin DAQ_EVENT VARIABLE /end DAQ_EVENT
 /end IF_DATA
/end MEASUREMENT
/begin MEASUREMENT MonEgyChrgnInlet_uRawCcsPlgPosn "Raw value CCS charging connector lock feedback sensor voltage" SWORD spg_q0p0012207_V 1 100 -40.00000 39.99878 FORMAT "%8.5" ECU_ADDRESS 0x6002C386
 /begin IF_DATA XCPplus 0x0102
  /begin DAQ_EVENT VARIABLE /end DAQ_EVENT
 /end IF_DATA
/end MEASUREMENT
/begin MEASUREMENT MonEgyChrgnInlet_uRawCcsPlgPosnCpl "Complement of MonEgyChrgnInlet_uRawCcsPlgPosn" UWORD OneToOne 1 100 0.00 65535.00 FORMAT "%8.2" ECU_ADDRESS 0x6002B96A
 /begin IF_DATA XCPplus 0x0102
  /begin DAQ_EVENT VARIABLE /end DAQ_EVENT
 /end IF_DATA
/end MEASUREMENT
/begin MEASUREMENT MonEgyChrgnInlet_uRawCcsPxp "Raw value CCS Proximity Pilot voltage" SWORD spg_q0p0012207_V 1 100 -40.00000 39.99878 FORMAT "%8.5" ECU_ADDRESS 0x6002C384
 /begin IF_DATA XCPplus 0x0102
  /begin DAQ_EVENT VARIABLE /end DAQ_EVENT
 /end IF_DATA
/end MEASUREMENT
/begin MEASUREMENT MonEgyChrgnInlet_uRawCcsPxpCpl "Complement of MonEgyChrgnInlet_uRawCcsPxp" UWORD OneToOne 1 100 0.00 65535.00 FORMAT "%8.2" ECU_ADDRESS 0x6002B968
 /begin IF_DATA XCPplus 0x0102
  /begin DAQ_EVENT VARIABLE /end DAQ_EVENT
 /end IF_DATA
/end MEASUREMENT
/begin MEASUREMENT MonEgyChrgnTPlausSig_bbLoc1Cpl "Complement of MonEgyChrgnTPlausSig_bbLoc1" UBYTE OneToOne 1 100 0.00 255.0 FORMAT "%5.1" ECU_ADDRESS 0x6002B91E
 /begin IF_DATA XCPplus 0x0102
  /begin DAQ_EVENT VARIABLE /end DAQ_EVENT
 /end IF_DATA
/end MEASUREMENT
/begin MEASUREMENT MonEgyChrgnTPlausSig_bbLoc2Cpl "Complement of MonEgyChrgnTPlausSig_bbLoc2" UBYTE OneToOne 1 100 0.00 255.0 FORMAT "%5.1" ECU_ADDRESS 0x6002B91D
 /begin IF_DATA XCPplus 0x0102
  /begin DAQ_EVENT VARIABLE /end DAQ_EVENT
 /end IF_DATA
/end MEASUREMENT
/begin MEASUREMENT MonEgyChrgnTPlausSig_bbLoc3Cpl "Complement of MonEgyChrgnTPlausSig_bbLoc3" UBYTE OneToOne 1 100 0.00 255.0 FORMAT "%5.1" ECU_ADDRESS 0x6002B91C
 /begin IF_DATA XCPplus 0x0102
  /begin DAQ_EVENT VARIABLE /end DAQ_EVENT
 /end IF_DATA
/end MEASUREMENT
/begin MEASUREMENT MonEgyChrgnTPreProc_bbOut1Cpl "Complement of MonEgyChrgnTPreProc_bbOut1" UBYTE OneToOne 1 100 0.00 255.0 FORMAT "%5.1" ECU_ADDRESS 0x6002B8F7
 /begin IF_DATA XCPplus 0x0102
  /begin DAQ_EVENT VARIABLE /end DAQ_EVENT
 /end IF_DATA
/end MEASUREMENT
/begin MEASUREMENT MonEgyChrgnT_cntrDebGrdtTSnsr1 "Debounce Counter for Gradient Sensor1" UWORD OneToOne 1 100 0.00 65535.00 FORMAT "%8.2" ECU_ADDRESS 0x6002C328
 /begin IF_DATA XCPplus 0x0102
  /begin DAQ_EVENT VARIABLE /end DAQ_EVENT
 /end IF_DATA
/end MEASUREMENT
/begin MEASUREMENT MonEgyChrgnT_cntrDebGrdtTSnsr1Cpl "Complement of MonEgyChrgnT_cntrDebGrdtTSnsr1" UWORD OneToOne 1 100 0.00 65535.00 FORMAT "%8.2" ECU_ADDRESS 0x6002B90C
 /begin IF_DATA XCPplus 0x0102
  /begin DAQ_EVENT VARIABLE /end DAQ_EVENT
 /end IF_DATA
/end MEASUREMENT
/begin MEASUREMENT MonEgyChrgnT_cntrDebGrdtTSnsr2 "Debounce Counter for Gradient Sensor2" UWORD OneToOne 1 100 0.00 65535.00 FORMAT "%8.2" ECU_ADDRESS 0x6002C326
 /begin IF_DATA XCPplus 0x0102
  /begin DAQ_EVENT VARIABLE /end DAQ_EVENT
 /end IF_DATA
/end MEASUREMENT
/begin MEASUREMENT MonEgyChrgnT_cntrDebGrdtTSnsr2Cpl "Complement of MonEgyChrgnT_cntrDebGrdtTSnsr2" UWORD OneToOne 1 100 0.00 65535.00 FORMAT "%8.2" ECU_ADDRESS 0x6002B90A
 /begin IF_DATA XCPplus 0x0102
  /begin DAQ_EVENT VARIABLE /end DAQ_EVENT
 /end IF_DATA
/end MEASUREMENT
/begin MEASUREMENT MonEgyChrgnT_cntrDebMaxTSnsr1 "Debounce Counter for Upper Limit Sensor1" UBYTE OneToOne 1 100 0.00 255.0 FORMAT "%5.1" ECU_ADDRESS 0x6002C337
 /begin IF_DATA XCPplus 0x0102
  /begin DAQ_EVENT VARIABLE /end DAQ_EVENT
 /end IF_DATA
/end MEASUREMENT
/begin MEASUREMENT MonEgyChrgnT_cntrDebMaxTSnsr1Cpl "Complement of MonEgyChrgnT_cntrDebMaxTSnsr1" UBYTE OneToOne 1 100 0.00 255.0 FORMAT "%5.1" ECU_ADDRESS 0x6002B91B
 /begin IF_DATA XCPplus 0x0102
  /begin DAQ_EVENT VARIABLE /end DAQ_EVENT
 /end IF_DATA
/end MEASUREMENT
/begin MEASUREMENT MonEgyChrgnT_cntrDebMaxTSnsr2 "Debounce Counter for Upper Limit Sensor2" UBYTE OneToOne 1 100 0.00 255.0 FORMAT "%5.1" ECU_ADDRESS 0x6002C336
 /begin IF_DATA XCPplus 0x0102
  /begin DAQ_EVENT VARIABLE /end DAQ_EVENT
 /end IF_DATA
/end MEASUREMENT
/begin MEASUREMENT MonEgyChrgnT_cntrDebMaxTSnsr2Cpl "Complement of MonEgyChrgnT_cntrDebMaxTSnsr2" UBYTE OneToOne 1 100 0.00 255.0 FORMAT "%5.1" ECU_ADDRESS 0x6002B91A
 /begin IF_DATA XCPplus 0x0102
  /begin DAQ_EVENT VARIABLE /end DAQ_EVENT
 /end IF_DATA
/end MEASUREMENT
/begin MEASUREMENT MonEgyChrgnT_cntrDebMinTSnsr1 "Debounce Counter for Lower Limit Sensor1" UBYTE OneToOne 1 100 0.00 255.0 FORMAT "%5.1" ECU_ADDRESS 0x6002C335
 /begin IF_DATA XCPplus 0x0102
  /begin DAQ_EVENT VARIABLE /end DAQ_EVENT
 /end IF_DATA
/end MEASUREMENT
/begin MEASUREMENT MonEgyChrgnT_cntrDebMinTSnsr1Cpl "Complement of MonEgyChrgnT_cntrDebMinTSnsr1" UBYTE OneToOne 1 100 0.00 255.0 FORMAT "%5.1" ECU_ADDRESS 0x6002B919
 /begin IF_DATA XCPplus 0x0102
  /begin DAQ_EVENT VARIABLE /end DAQ_EVENT
 /end IF_DATA
/end MEASUREMENT
/begin MEASUREMENT MonEgyChrgnT_cntrDebMinTSnsr2 "Debounce Counter for Lower Limit Sensor2" UBYTE OneToOne 1 100 0.00 255.0 FORMAT "%5.1" ECU_ADDRESS 0x6002C334
 /begin IF_DATA XCPplus 0x0102
  /begin DAQ_EVENT VARIABLE /end DAQ_EVENT
 /end IF_DATA
/end MEASUREMENT
/begin MEASUREMENT MonEgyChrgnT_cntrDebMinTSnsr2Cpl "Complement of MonEgyChrgnT_cntrDebMinTSnsr2" UBYTE OneToOne 1 100 0.00 255.0 FORMAT "%5.1" ECU_ADDRESS 0x6002B918
 /begin IF_DATA XCPplus 0x0102
  /begin DAQ_EVENT VARIABLE /end DAQ_EVENT
 /end IF_DATA
/end MEASUREMENT
/begin MEASUREMENT MonEgyChrgnT_cntrDifSnsr "Debounce Counter for Difference Between Sensor1 and Sensor2" UBYTE OneToOne 1 100 0.00 255.0 FORMAT "%5.1" ECU_ADDRESS 0x6002C333
 /begin IF_DATA XCPplus 0x0102
  /begin DAQ_EVENT VARIABLE /end DAQ_EVENT
 /end IF_DATA
/end MEASUREMENT
/begin MEASUREMENT MonEgyChrgnT_cntrDifSnsrCpl "Complement of MonEgyChrgnT_cntrDifSnsr" UBYTE OneToOne 1 100 0.00 255.0 FORMAT "%5.1" ECU_ADDRESS 0x6002B917
 /begin IF_DATA XCPplus 0x0102
  /begin DAQ_EVENT VARIABLE /end DAQ_EVENT
 /end IF_DATA
/end MEASUREMENT
/begin MEASUREMENT MonEgyChrgnT_cntrIninPlausT "Counter initial plausibility check" UWORD OneToOne 1 100 0.00 65535.00 FORMAT "%8.2" ECU_ADDRESS 0x6002C324
 /begin IF_DATA XCPplus 0x0102
  /begin DAQ_EVENT VARIABLE /end DAQ_EVENT
 /end IF_DATA
/end MEASUREMENT
/begin MEASUREMENT MonEgyChrgnT_cntrIninPlausTCpl "Complement of MonEgyChrgnT_cntrIninPlausT" UWORD OneToOne 1 100 0.00 65535.00 FORMAT "%8.2" ECU_ADDRESS 0x6002B908
 /begin IF_DATA XCPplus 0x0102
  /begin DAQ_EVENT VARIABLE /end DAQ_EVENT
 /end IF_DATA
/end MEASUREMENT
/begin MEASUREMENT MonEgyChrgnT_cntrTurnOffDlyNTP "Debounce counter turn-off delay NTP" UBYTE OneToOne 1 100 0.00 255.0 FORMAT "%5.1" ECU_ADDRESS 0x6002C313
 /begin IF_DATA XCPplus 0x0102
  /begin DAQ_EVENT VARIABLE /end DAQ_EVENT
 /end IF_DATA
/end MEASUREMENT
/begin MEASUREMENT MonEgyChrgnT_cntrTurnOffDlyNTPCpl "Complement of MonEgyChrgnT_cntrTurnOffDlyNTP" UBYTE OneToOne 1 100 0.00 255.0 FORMAT "%5.1" ECU_ADDRESS 0x6002B8F6
 /begin IF_DATA XCPplus 0x0102
  /begin DAQ_EVENT VARIABLE /end DAQ_EVENT
 /end IF_DATA
/end MEASUREMENT
/begin MEASUREMENT MonEgyChrgnT_flgErrAdc "Flag error ADC" UBYTE B_TRUE 1 100 0.00 1.00000000000 BIT_MASK 0x2 FORMAT "%13.11" ECU_ADDRESS 0x6002C312
 /begin IF_DATA XCPplus 0x0102
  /begin DAQ_EVENT VARIABLE /end DAQ_EVENT
 /end IF_DATA
/end MEASUREMENT
/begin MEASUREMENT MonEgyChrgnT_flgErrGrdtSnsr1 "Debounced Flag Error Gradient Sensor1" UBYTE B_TRUE 1 100 0.00 1.00000000000 BIT_MASK 0x1 FORMAT "%13.11" ECU_ADDRESS 0x6002C338
 /begin IF_DATA XCPplus 0x0102
  /begin DAQ_EVENT VARIABLE /end DAQ_EVENT
 /end IF_DATA
/end MEASUREMENT
/begin MEASUREMENT MonEgyChrgnT_flgErrGrdtSnsr2 "Debounced Flag Error Gradient Sensor2" UBYTE B_TRUE 1 100 0.00 1.00000000000 BIT_MASK 0x2 FORMAT "%13.11" ECU_ADDRESS 0x6002C338
 /begin IF_DATA XCPplus 0x0102
  /begin DAQ_EVENT VARIABLE /end DAQ_EVENT
 /end IF_DATA
/end MEASUREMENT
/begin MEASUREMENT MonEgyChrgnT_flgErrMaxSnsr1 "Debounce Flag Error Upper Limit Sensor1" UBYTE B_TRUE 1 100 0.00 1.00000000000 BIT_MASK 0x1 FORMAT "%13.11" ECU_ADDRESS 0x6002C33A
 /begin IF_DATA XCPplus 0x0102
  /begin DAQ_EVENT VARIABLE /end DAQ_EVENT
 /end IF_DATA
/end MEASUREMENT
/begin MEASUREMENT MonEgyChrgnT_flgErrMaxSnsr2 "Debounce Flag Error Upper Limit Sensor2" UBYTE B_TRUE 1 100 0.00 1.00000000000 BIT_MASK 0x2 FORMAT "%13.11" ECU_ADDRESS 0x6002C33A
 /begin IF_DATA XCPplus 0x0102
  /begin DAQ_EVENT VARIABLE /end DAQ_EVENT
 /end IF_DATA
/end MEASUREMENT
/begin MEASUREMENT MonEgyChrgnT_flgErrMinSnsr1 "Debounce Flag Error Lower Limit Sensor1" UBYTE B_TRUE 1 100 0.00 1.00000000000 BIT_MASK 0x8 FORMAT "%13.11" ECU_ADDRESS 0x6002C33A
 /begin IF_DATA XCPplus 0x0102
  /begin DAQ_EVENT VARIABLE /end DAQ_EVENT
 /end IF_DATA
/end MEASUREMENT
/begin MEASUREMENT MonEgyChrgnT_flgErrMinSnsr2 "Debounce Flag Error Lower Limit Sensor2" UBYTE B_TRUE 1 100 0.00 1.00000000000 BIT_MASK 0x10 FORMAT "%13.11" ECU_ADDRESS 0x6002C33A
 /begin IF_DATA XCPplus 0x0102
  /begin DAQ_EVENT VARIABLE /end DAQ_EVENT
 /end IF_DATA
/end MEASUREMENT
/begin MEASUREMENT MonEgyChrgnT_flgErrRngSnsr1 "Debounce Flag Error Range Sensor1" UBYTE B_TRUE 1 100 0.00 1.00000000000 BIT_MASK 0x40 FORMAT "%13.11" ECU_ADDRESS 0x6002C33A
 /begin IF_DATA XCPplus 0x0102
  /begin DAQ_EVENT VARIABLE /end DAQ_EVENT
 /end IF_DATA
/end MEASUREMENT
/begin MEASUREMENT MonEgyChrgnT_flgErrRngSnsr2 "Debounce Flag Error Range Sensor2" UBYTE B_TRUE 1 100 0.00 1.00000000000 BIT_MASK 0x8 FORMAT "%13.11" ECU_ADDRESS 0x6002C339
 /begin IF_DATA XCPplus 0x0102
  /begin DAQ_EVENT VARIABLE /end DAQ_EVENT
 /end IF_DATA
/end MEASUREMENT
/begin MEASUREMENT MonEgyChrgnT_flgErrSnsrDif "Debounced Flag Error of Difference Between Sensor1 and Sensor2" UBYTE B_TRUE 1 100 0.00 1.00000000000 BIT_MASK 0x10 FORMAT "%13.11" ECU_ADDRESS 0x6002C339
 /begin IF_DATA XCPplus 0x0102
  /begin DAQ_EVENT VARIABLE /end DAQ_EVENT
 /end IF_DATA
/end MEASUREMENT
/begin MEASUREMENT MonEgyChrgnT_flgErrSnsrRng "Debounce Flag Error Range Sensor1 or Sensor2" UBYTE B_TRUE 1 100 0.00 1.00000000000 BIT_MASK 0x20 FORMAT "%13.11" ECU_ADDRESS 0x6002C339
 /begin IF_DATA XCPplus 0x0102
  /begin DAQ_EVENT VARIABLE /end DAQ_EVENT
 /end IF_DATA
/end MEASUREMENT
/begin MEASUREMENT MonEgyChrgnT_flgNTPDlyd "Flag No-Load-Test-Pulse delayed" UBYTE B_TRUE 1 100 0.00 1.00000000000 BIT_MASK 0x1 FORMAT "%13.11" ECU_ADDRESS 0x6002C312
 /begin IF_DATA XCPplus 0x0102
  /begin DAQ_EVENT VARIABLE /end DAQ_EVENT
 /end IF_DATA
/end MEASUREMENT
/begin MEASUREMENT MonEgyChrgnT_flgTmpErrGrdtSnsr1 "Temporary Flag Error Gradient Sensor1" UBYTE B_TRUE 1 100 0.00 1.00000000000 BIT_MASK 0x40 FORMAT "%13.11" ECU_ADDRESS 0x6002C339
 /begin IF_DATA XCPplus 0x0102
  /begin DAQ_EVENT VARIABLE /end DAQ_EVENT
 /end IF_DATA
/end MEASUREMENT
/begin MEASUREMENT MonEgyChrgnT_flgTmpErrGrdtSnsr2 "Temporary Flag Error Gradient Sensor2" UBYTE B_TRUE 1 100 0.00 1.00000000000 BIT_MASK 0x80 FORMAT "%13.11" ECU_ADDRESS 0x6002C339
 /begin IF_DATA XCPplus 0x0102
  /begin DAQ_EVENT VARIABLE /end DAQ_EVENT
 /end IF_DATA
/end MEASUREMENT
/begin MEASUREMENT MonEgyChrgnT_flgTmpErrMaxSnsr1 "Temporary Flag Error Upper Limit Sensor1" UBYTE B_TRUE 1 100 0.00 1.00000000000 BIT_MASK 0x20 FORMAT "%13.11" ECU_ADDRESS 0x6002C33A
 /begin IF_DATA XCPplus 0x0102
  /begin DAQ_EVENT VARIABLE /end DAQ_EVENT
 /end IF_DATA
/end MEASUREMENT
/begin MEASUREMENT MonEgyChrgnT_flgTmpErrMaxSnsr2 "Temporary Flag Error Upper Limit Sensor2" UBYTE B_TRUE 1 100 0.00 1.00000000000 BIT_MASK 0x4 FORMAT "%13.11" ECU_ADDRESS 0x6002C33A
 /begin IF_DATA XCPplus 0x0102
  /begin DAQ_EVENT VARIABLE /end DAQ_EVENT
 /end IF_DATA
/end MEASUREMENT
/begin MEASUREMENT MonEgyChrgnT_flgTmpErrMinSnsr1 "Temporary Flag Error Lower Limit Sensor1" UBYTE B_TRUE 1 100 0.00 1.00000000000 BIT_MASK 0x1 FORMAT "%13.11" ECU_ADDRESS 0x6002C339
 /begin IF_DATA XCPplus 0x0102
  /begin DAQ_EVENT VARIABLE /end DAQ_EVENT
 /end IF_DATA
/end MEASUREMENT
/begin MEASUREMENT MonEgyChrgnT_flgTmpErrMinSnsr2 "Temporary Flag Error Lower Limit Sensor2" UBYTE B_TRUE 1 100 0.00 1.00000000000 BIT_MASK 0x4 FORMAT "%13.11" ECU_ADDRESS 0x6002C339
 /begin IF_DATA XCPplus 0x0102
  /begin DAQ_EVENT VARIABLE /end DAQ_EVENT
 /end IF_DATA
/end MEASUREMENT
/begin MEASUREMENT MonEgyChrgnT_flgTmpErrRngSnsr1 "Temporary Flag Error Range Sensor1" UBYTE B_TRUE 1 100 0.00 1.00000000000 BIT_MASK 0x4 FORMAT "%13.11" ECU_ADDRESS 0x6002C338
 /begin IF_DATA XCPplus 0x0102
  /begin DAQ_EVENT VARIABLE /end DAQ_EVENT
 /end IF_DATA
/end MEASUREMENT
/begin MEASUREMENT MonEgyChrgnT_flgTmpErrRngSnsr2 "Temporary Flag Error Range Sensor2" UBYTE B_TRUE 1 100 0.00 1.00000000000 BIT_MASK 0x2 FORMAT "%13.11" ECU_ADDRESS 0x6002C339
 /begin IF_DATA XCPplus 0x0102
  /begin DAQ_EVENT VARIABLE /end DAQ_EVENT
 /end IF_DATA
/end MEASUREMENT
/begin MEASUREMENT MonEgyChrgnT_flgTmpErrSnsrDif "Temporary Flag Error of Difference Between Sensor1 andSensor2" UBYTE B_TRUE 1 100 0.00 1.00000000000 BIT_MASK 0x80 FORMAT "%13.11" ECU_ADDRESS 0x6002C33A
 /begin IF_DATA XCPplus 0x0102
  /begin DAQ_EVENT VARIABLE /end DAQ_EVENT
 /end IF_DATA
/end MEASUREMENT
/begin MEASUREMENT MonEgyChrgnT_flgTmpErrSnsrRng "Temporary Flag Error Range Sensor1 or Sensor2" UBYTE B_TRUE 1 100 0.00 1.00000000000 BIT_MASK 0x8 FORMAT "%13.11" ECU_ADDRESS 0x6002C338
 /begin IF_DATA XCPplus 0x0102
  /begin DAQ_EVENT VARIABLE /end DAQ_EVENT
 /end IF_DATA
/end MEASUREMENT
/begin MEASUREMENT MonEgyChrgnT_stDcChrgT1 "Status DC inlet temperature sensor 1" UBYTE OneToOne 1 100 0.00 255.0 FORMAT "%5.1" ECU_ADDRESS 0x6002C345
 /begin IF_DATA XCPplus 0x0102
  /begin DAQ_EVENT VARIABLE /end DAQ_EVENT
 /end IF_DATA
/end MEASUREMENT
/begin MEASUREMENT MonEgyChrgnT_stDcChrgT1Cpl "Complement of MonEgyChrgnT_stDcChrgT1" UBYTE OneToOne 1 100 0.00 255.0 FORMAT "%5.1" ECU_ADDRESS 0x6002B929
 /begin IF_DATA XCPplus 0x0102
  /begin DAQ_EVENT VARIABLE /end DAQ_EVENT
 /end IF_DATA
/end MEASUREMENT
/begin MEASUREMENT MonEgyChrgnT_stDcChrgT2 "Status DC inlet temperature sensor 2" UBYTE OneToOne 1 100 0.00 255.0 FORMAT "%5.1" ECU_ADDRESS 0x6002C344
 /begin IF_DATA XCPplus 0x0102
  /begin DAQ_EVENT VARIABLE /end DAQ_EVENT
 /end IF_DATA
/end MEASUREMENT
/begin MEASUREMENT MonEgyChrgnT_stDcChrgT2Cpl "Complement of MonEgyChrgnT_stDcChrgT2" UBYTE OneToOne 1 100 0.00 255.0 FORMAT "%5.1" ECU_ADDRESS 0x6002B928
 /begin IF_DATA XCPplus 0x0102
  /begin DAQ_EVENT VARIABLE /end DAQ_EVENT
 /end IF_DATA
/end MEASUREMENT
/begin MEASUREMENT MonEgyChrgnT_stDebGrdtTSnsr1 "Debouncer Status of Gradient Sensor1" UBYTE OneToOne 1 100 0.00 255.0 FORMAT "%5.1" ECU_ADDRESS 0x6002C332
 /begin IF_DATA XCPplus 0x0102
  /begin DAQ_EVENT VARIABLE /end DAQ_EVENT
 /end IF_DATA
/end MEASUREMENT
/begin MEASUREMENT MonEgyChrgnT_stDebGrdtTSnsr1Cpl "Complement of MonEgyChrgnT_stDebGrdtTSnsr1" UBYTE OneToOne 1 100 0.00 255.0 FORMAT "%5.1" ECU_ADDRESS 0x6002B916
 /begin IF_DATA XCPplus 0x0102
  /begin DAQ_EVENT VARIABLE /end DAQ_EVENT
 /end IF_DATA
/end MEASUREMENT
/begin MEASUREMENT MonEgyChrgnT_stDebGrdtTSnsr2 "Debouncer Status of Gradient Sensor2" UBYTE OneToOne 1 100 0.00 255.0 FORMAT "%5.1" ECU_ADDRESS 0x6002C331
 /begin IF_DATA XCPplus 0x0102
  /begin DAQ_EVENT VARIABLE /end DAQ_EVENT
 /end IF_DATA
/end MEASUREMENT
/begin MEASUREMENT MonEgyChrgnT_stDebGrdtTSnsr2Cpl "Complement of MonEgyChrgnT_stDebGrdtTSnsr2" UBYTE OneToOne 1 100 0.00 255.0 FORMAT "%5.1" ECU_ADDRESS 0x6002B915
 /begin IF_DATA XCPplus 0x0102
  /begin DAQ_EVENT VARIABLE /end DAQ_EVENT
 /end IF_DATA
/end MEASUREMENT
/begin MEASUREMENT MonEgyChrgnT_stDebMaxTSnsr1 "Debouncer Status of Upper Limit Sensor1" UBYTE OneToOne 1 100 0.00 255.0 FORMAT "%5.1" ECU_ADDRESS 0x6002C330
 /begin IF_DATA XCPplus 0x0102
  /begin DAQ_EVENT VARIABLE /end DAQ_EVENT
 /end IF_DATA
/end MEASUREMENT
/begin MEASUREMENT MonEgyChrgnT_stDebMaxTSnsr1Cpl "Complement of MonEgyChrgnT_stDebMaxTSnsr1" UBYTE OneToOne 1 100 0.00 255.0 FORMAT "%5.1" ECU_ADDRESS 0x6002B914
 /begin IF_DATA XCPplus 0x0102
  /begin DAQ_EVENT VARIABLE /end DAQ_EVENT
 /end IF_DATA
/end MEASUREMENT
/begin MEASUREMENT MonEgyChrgnT_stDebMaxTSnsr2 "Debouncer Status of Upper Limit Sensor2" UBYTE OneToOne 1 100 0.00 255.0 FORMAT "%5.1" ECU_ADDRESS 0x6002C32F
 /begin IF_DATA XCPplus 0x0102
  /begin DAQ_EVENT VARIABLE /end DAQ_EVENT
 /end IF_DATA
/end MEASUREMENT
/begin MEASUREMENT MonEgyChrgnT_stDebMaxTSnsr2Cpl "Complement of MonEgyChrgnT_stDebMaxTSnsr2" UBYTE OneToOne 1 100 0.00 255.0 FORMAT "%5.1" ECU_ADDRESS 0x6002B913
 /begin IF_DATA XCPplus 0x0102
  /begin DAQ_EVENT VARIABLE /end DAQ_EVENT
 /end IF_DATA
/end MEASUREMENT
/begin MEASUREMENT MonEgyChrgnT_stDebMinTSnsr1 "Debouncer Status of Lower Limit Sensor1" UBYTE OneToOne 1 100 0.00 255.0 FORMAT "%5.1" ECU_ADDRESS 0x6002C32E
 /begin IF_DATA XCPplus 0x0102
  /begin DAQ_EVENT VARIABLE /end DAQ_EVENT
 /end IF_DATA
/end MEASUREMENT
/begin MEASUREMENT MonEgyChrgnT_stDebMinTSnsr1Cpl "Complement of MonEgyChrgnT_stDebMinTSnsr1" UBYTE OneToOne 1 100 0.00 255.0 FORMAT "%5.1" ECU_ADDRESS 0x6002B912
 /begin IF_DATA XCPplus 0x0102
  /begin DAQ_EVENT VARIABLE /end DAQ_EVENT
 /end IF_DATA
/end MEASUREMENT
/begin MEASUREMENT MonEgyChrgnT_stDebMinTSnsr2 "Debouncer Status of Lower Limit Sensor2" UBYTE OneToOne 1 100 0.00 255.0 FORMAT "%5.1" ECU_ADDRESS 0x6002C32D
 /begin IF_DATA XCPplus 0x0102
  /begin DAQ_EVENT VARIABLE /end DAQ_EVENT
 /end IF_DATA
/end MEASUREMENT
/begin MEASUREMENT MonEgyChrgnT_stDebMinTSnsr2Cpl "Complement of MonEgyChrgnT_stDebMinTSnsr2" UBYTE OneToOne 1 100 0.00 255.0 FORMAT "%5.1" ECU_ADDRESS 0x6002B911
 /begin IF_DATA XCPplus 0x0102
  /begin DAQ_EVENT VARIABLE /end DAQ_EVENT
 /end IF_DATA
/end MEASUREMENT
/begin MEASUREMENT MonEgyChrgnT_stDifSnsr "Debouncer Status of Difference Between Sensor1 and Sensor2" UBYTE OneToOne 1 100 0.00 255.0 FORMAT "%5.1" ECU_ADDRESS 0x6002C32C
 /begin IF_DATA XCPplus 0x0102
  /begin DAQ_EVENT VARIABLE /end DAQ_EVENT
 /end IF_DATA
/end MEASUREMENT
/begin MEASUREMENT MonEgyChrgnT_stDifSnsrCpl "Complement of MonEgyChrgnT_stDifSnsr" UBYTE OneToOne 1 100 0.00 255.0 FORMAT "%5.1" ECU_ADDRESS 0x6002B910
 /begin IF_DATA XCPplus 0x0102
  /begin DAQ_EVENT VARIABLE /end DAQ_EVENT
 /end IF_DATA
/end MEASUREMENT
/begin MEASUREMENT MonEgyChrgnT_stSnsr1 "Status DC inlet temperature sensor 1" UBYTE OneToOne 1 100 0.00 255.0 FORMAT "%5.1" ECU_ADDRESS 0x6002C32B
 /begin IF_DATA XCPplus 0x0102
  /begin DAQ_EVENT VARIABLE /end DAQ_EVENT
 /end IF_DATA
/end MEASUREMENT
/begin MEASUREMENT MonEgyChrgnT_stSnsr1Cpl "Complement of MonEgyChrgnT_stSnsr1" UBYTE OneToOne 1 100 0.00 255.0 FORMAT "%5.1" ECU_ADDRESS 0x6002B90F
 /begin IF_DATA XCPplus 0x0102
  /begin DAQ_EVENT VARIABLE /end DAQ_EVENT
 /end IF_DATA
/end MEASUREMENT
/begin MEASUREMENT MonEgyChrgnT_stSnsr2 "Status DC inlet temperature sensor 2" UBYTE OneToOne 1 100 0.00 255.0 FORMAT "%5.1" ECU_ADDRESS 0x6002C32A
 /begin IF_DATA XCPplus 0x0102
  /begin DAQ_EVENT VARIABLE /end DAQ_EVENT
 /end IF_DATA
/end MEASUREMENT
/begin MEASUREMENT MonEgyChrgnT_stSnsr2Cpl "Complement of MonEgyChrgnT_stSnsr2" UBYTE OneToOne 1 100 0.00 255.0 FORMAT "%5.1" ECU_ADDRESS 0x6002B90E
 /begin IF_DATA XCPplus 0x0102
  /begin DAQ_EVENT VARIABLE /end DAQ_EVENT
 /end IF_DATA
/end MEASUREMENT
/begin MEASUREMENT MonEgyChrgnT_tDcChrgnIntkT1 "DC inlet temperature sensor 1" SWORD RBPtCel_t_0p1_3 1 100 -3276.800 3276.700 FORMAT "%8.3" ECU_ADDRESS 0x6002C310
 /begin IF_DATA XCPplus 0x0102
  /begin DAQ_EVENT VARIABLE /end DAQ_EVENT
 /end IF_DATA
/end MEASUREMENT
/begin MEASUREMENT MonEgyChrgnT_tDcChrgnIntkT1Cpl "Complement of MonEgyChrgnT_tDcChrgnIntkT1" UWORD OneToOne 1 100 0.00 65535.00 FORMAT "%8.2" ECU_ADDRESS 0x6002B8F4
 /begin IF_DATA XCPplus 0x0102
  /begin DAQ_EVENT VARIABLE /end DAQ_EVENT
 /end IF_DATA
/end MEASUREMENT
/begin MEASUREMENT MonEgyChrgnT_tDcChrgnIntkT2 "DC inlet temperature sensor 2" SWORD RBPtCel_t_0p1_3 1 100 -3276.800 3276.700 FORMAT "%8.3" ECU_ADDRESS 0x6002C30E
 /begin IF_DATA XCPplus 0x0102
  /begin DAQ_EVENT VARIABLE /end DAQ_EVENT
 /end IF_DATA
/end MEASUREMENT
/begin MEASUREMENT MonEgyChrgnT_tDcChrgnIntkT2Cpl "Complement of MonEgyChrgnT_tDcChrgnIntkT2" UWORD OneToOne 1 100 0.00 65535.00 FORMAT "%8.2" ECU_ADDRESS 0x6002B8F2
 /begin IF_DATA XCPplus 0x0102
  /begin DAQ_EVENT VARIABLE /end DAQ_EVENT
 /end IF_DATA
/end MEASUREMENT
/begin MEASUREMENT MonEgyChrgnT_tDcChrgT1 "DC inlet temperature sensor 1" SWORD RBPtCel_t_0p1_3 1 100 -3276.800 3276.700 FORMAT "%8.3" ECU_ADDRESS 0x6002C342
 /begin IF_DATA XCPplus 0x0102
  /begin DAQ_EVENT VARIABLE /end DAQ_EVENT
 /end IF_DATA
/end MEASUREMENT
/begin MEASUREMENT MonEgyChrgnT_tDcChrgT1Cpl "Complement of MonEgyChrgnT_tDcChrgT1" UWORD OneToOne 1 100 0.00 65535.00 FORMAT "%8.2" ECU_ADDRESS 0x6002B926
 /begin IF_DATA XCPplus 0x0102
  /begin DAQ_EVENT VARIABLE /end DAQ_EVENT
 /end IF_DATA
/end MEASUREMENT
/begin MEASUREMENT MonEgyChrgnT_tDcChrgT2 "DC inlet temperature sensor 2" SWORD RBPtCel_t_0p1_3 1 100 -3276.800 3276.700 FORMAT "%8.3" ECU_ADDRESS 0x6002C340
 /begin IF_DATA XCPplus 0x0102
  /begin DAQ_EVENT VARIABLE /end DAQ_EVENT
 /end IF_DATA
/end MEASUREMENT
/begin MEASUREMENT MonEgyChrgnT_tDcChrgT2Cpl "Complement of MonEgyChrgnT_tDcChrgT2" UWORD OneToOne 1 100 0.00 65535.00 FORMAT "%8.2" ECU_ADDRESS 0x6002B924
 /begin IF_DATA XCPplus 0x0102
  /begin DAQ_EVENT VARIABLE /end DAQ_EVENT
 /end IF_DATA
/end MEASUREMENT
/begin MEASUREMENT MonEgyChrgnT_tGrdtFltLoSnsr1 "Pointer for UpDwnLowPassFilter Gradient Sensor1" UWORD OneToOne 1 100 0.00 65535.00 FORMAT "%8.2" ECU_ADDRESS 0x6002C322
 /begin IF_DATA XCPplus 0x0102
  /begin DAQ_EVENT VARIABLE /end DAQ_EVENT
 /end IF_DATA
/end MEASUREMENT
/begin MEASUREMENT MonEgyChrgnT_tGrdtFltLoSnsr1Cpl "Complement of MonEgyChrgnT_tGrdtFltLoSnsr1" UWORD OneToOne 1 100 0.00 65535.00 FORMAT "%8.2" ECU_ADDRESS 0x6002B906
 /begin IF_DATA XCPplus 0x0102
  /begin DAQ_EVENT VARIABLE /end DAQ_EVENT
 /end IF_DATA
/end MEASUREMENT
/begin MEASUREMENT MonEgyChrgnT_tGrdtFltLoSnsr2 "Pointer for UpDwnLowPassFilter Gradient Sensor2" UWORD OneToOne 1 100 0.00 65535.00 FORMAT "%8.2" ECU_ADDRESS 0x6002C320
 /begin IF_DATA XCPplus 0x0102
  /begin DAQ_EVENT VARIABLE /end DAQ_EVENT
 /end IF_DATA
/end MEASUREMENT
/begin MEASUREMENT MonEgyChrgnT_tGrdtFltLoSnsr2Cpl "Complement of MonEgyChrgnT_tGrdtFltLoSnsr2" UWORD OneToOne 1 100 0.00 65535.00 FORMAT "%8.2" ECU_ADDRESS 0x6002B904
 /begin IF_DATA XCPplus 0x0102
  /begin DAQ_EVENT VARIABLE /end DAQ_EVENT
 /end IF_DATA
/end MEASUREMENT
/begin MEASUREMENT MonEgyChrgnT_tGrdtFltSnsr1 "Output UpDwnLowPassFilter Gradient Sensor1" SWORD RBPtCel_t_0p1_3 1 100 -3276.800 3276.700 FORMAT "%8.3" ECU_ADDRESS 0x6002C31E
 /begin IF_DATA XCPplus 0x0102
  /begin DAQ_EVENT VARIABLE /end DAQ_EVENT
 /end IF_DATA
/end MEASUREMENT
/begin MEASUREMENT MonEgyChrgnT_tGrdtFltSnsr1Cpl "Complement of MonEgyChrgnT_tGrdtFltSnsr1" UWORD OneToOne 1 100 0.00 65535.00 FORMAT "%8.2" ECU_ADDRESS 0x6002B902
 /begin IF_DATA XCPplus 0x0102
  /begin DAQ_EVENT VARIABLE /end DAQ_EVENT
 /end IF_DATA
/end MEASUREMENT
/begin MEASUREMENT MonEgyChrgnT_tGrdtFltSnsr2 "Output UpDwnLowPassFilter Gradient Sensor2" SWORD RBPtCel_t_0p1_3 1 100 -3276.800 3276.700 FORMAT "%8.3" ECU_ADDRESS 0x6002C31C
 /begin IF_DATA XCPplus 0x0102
  /begin DAQ_EVENT VARIABLE /end DAQ_EVENT
 /end IF_DATA
/end MEASUREMENT
/begin MEASUREMENT MonEgyChrgnT_tGrdtFltSnsr2Cpl "Complement of MonEgyChrgnT_tGrdtFltSnsr2" UWORD OneToOne 1 100 0.00 65535.00 FORMAT "%8.2" ECU_ADDRESS 0x6002B900
 /begin IF_DATA XCPplus 0x0102
  /begin DAQ_EVENT VARIABLE /end DAQ_EVENT
 /end IF_DATA
/end MEASUREMENT
/begin MEASUREMENT MonEgyChrgnT_tSnsr1 "DC inlet temperature sensor 1" SWORD RBPtCel_t_0p1_3 1 100 -3276.800 3276.700 FORMAT "%8.3" ECU_ADDRESS 0x6002C316
 /begin IF_DATA XCPplus 0x0102
  /begin DAQ_EVENT VARIABLE /end DAQ_EVENT
 /end IF_DATA
/end MEASUREMENT
/begin MEASUREMENT MonEgyChrgnT_tSnsr1Cpl "Complement of MonEgyChrgnT_tSensor1" UWORD OneToOne 1 100 0.00 65535.00 FORMAT "%8.2" ECU_ADDRESS 0x6002B8FE
 /begin IF_DATA XCPplus 0x0102
  /begin DAQ_EVENT VARIABLE /end DAQ_EVENT
 /end IF_DATA
/end MEASUREMENT
/begin MEASUREMENT MonEgyChrgnT_tSnsr1Diff "Difference between Sensor1 and its filtered value" SWORD RBPtCel_t_0p1_3 1 100 -3276.800 3276.700 FORMAT "%8.3" ECU_ADDRESS 0x6002C31A
 /begin IF_DATA XCPplus 0x0102
  /begin DAQ_EVENT VARIABLE /end DAQ_EVENT
 /end IF_DATA
/end MEASUREMENT
/begin MEASUREMENT MonEgyChrgnT_tSnsr1DiffCpl "Complement of MonEgyChrgnT_tSnsr1Diff" UWORD OneToOne 1 100 0.00 65535.00 FORMAT "%8.2" ECU_ADDRESS 0x6002B8FC
 /begin IF_DATA XCPplus 0x0102
  /begin DAQ_EVENT VARIABLE /end DAQ_EVENT
 /end IF_DATA
/end MEASUREMENT
/begin MEASUREMENT MonEgyChrgnT_tSnsr2 "DC inlet temperature sensor 2" SWORD RBPtCel_t_0p1_3 1 100 -3276.800 3276.700 FORMAT "%8.3" ECU_ADDRESS 0x6002C314
 /begin IF_DATA XCPplus 0x0102
  /begin DAQ_EVENT VARIABLE /end DAQ_EVENT
 /end IF_DATA
/end MEASUREMENT
/begin MEASUREMENT MonEgyChrgnT_tSnsr2Cpl "Complement of MonEgyChrgnT_tSnsr2" UWORD OneToOne 1 100 0.00 65535.00 FORMAT "%8.2" ECU_ADDRESS 0x6002B8FA
 /begin IF_DATA XCPplus 0x0102
  /begin DAQ_EVENT VARIABLE /end DAQ_EVENT
 /end IF_DATA
/end MEASUREMENT
/begin MEASUREMENT MonEgyChrgnT_tSnsr2Diff "Difference between Sensor2 and its filtered value" SWORD RBPtCel_t_0p1_3 1 100 -3276.800 3276.700 FORMAT "%8.3" ECU_ADDRESS 0x6002C318
 /begin IF_DATA XCPplus 0x0102
  /begin DAQ_EVENT VARIABLE /end DAQ_EVENT
 /end IF_DATA
/end MEASUREMENT
/begin MEASUREMENT MonEgyChrgnT_tSnsr2DiffCpl "Complement of MonEgyChrgnT_tSnsr2Diff" UWORD OneToOne 1 100 0.00 65535.00 FORMAT "%8.2" ECU_ADDRESS 0x6002B8F8
 /begin IF_DATA XCPplus 0x0102
  /begin DAQ_EVENT VARIABLE /end DAQ_EVENT
 /end IF_DATA
/end MEASUREMENT
/begin MEASUREMENT MonEgyChrgnT_uRawDcChrgnIntkT1 "Raw value DC inlet temperature voltage sensor 1" SWORD spg_q0p0012207_V 1 100 -40.00000 39.99878 FORMAT "%8.5" ECU_ADDRESS 0x6002C33E
 /begin IF_DATA XCPplus 0x0102
  /begin DAQ_EVENT VARIABLE /end DAQ_EVENT
 /end IF_DATA
/end MEASUREMENT
/begin MEASUREMENT MonEgyChrgnT_uRawDcChrgnIntkT1Cpl "Complement of MonEgyChrgnT_uRawDcChrgnIntkT1" UWORD OneToOne 1 100 0.00 65535.00 FORMAT "%8.2" ECU_ADDRESS 0x6002B922
 /begin IF_DATA XCPplus 0x0102
  /begin DAQ_EVENT VARIABLE /end DAQ_EVENT
 /end IF_DATA
/end MEASUREMENT
/begin MEASUREMENT MonEgyChrgnT_uRawDcChrgnIntkT2 "Raw value DC inlet temperature voltage sensor 2" SWORD spg_q0p0012207_V 1 100 -40.00000 39.99878 FORMAT "%8.5" ECU_ADDRESS 0x6002C33C
 /begin IF_DATA XCPplus 0x0102
  /begin DAQ_EVENT VARIABLE /end DAQ_EVENT
 /end IF_DATA
/end MEASUREMENT
/begin MEASUREMENT MonEgyChrgnT_uRawDcChrgnIntkT2Cpl "Complement of MonEgyChrgnT_uRawDcChrgnIntkT2" UWORD OneToOne 1 100 0.00 65535.00 FORMAT "%8.2" ECU_ADDRESS 0x6002B920
 /begin IF_DATA XCPplus 0x0102
  /begin DAQ_EVENT VARIABLE /end DAQ_EVENT
 /end IF_DATA
/end MEASUREMENT
/begin FUNCTION MonEgyChrgnCoorr_Coorr "1.1.0_1.0.0Monitoring charging coordinator: Coordinator"
 /begin DEF_CHARACTERISTIC MonEgyChrgnCoorr_cntrAcChrgnWoMofRelsErr_C MonEgyChrgnCoorr_cntrCcsPlgLockMovmtErr_C MonEgyChrgnCoorr_cntrChrgnAbortErr_C MonEgyChrgnCoorr_cntrDcCntctErr_C MonEgyChrgnCoorr_cntrImpsChrgnModeErr_C MonEgyChrgnCoorr_cntrImpsChrgnPrmsErr_C MonEgyChrgnCoorr_cntrImpsUDcIntkErr_C MonEgyChrgnCoorr_cntrTurnOnDlyChrgMod_C MonEgyChrgnCoorr_cntrTurnOnDlyChrgnPrms_C MonEgyChrgnCoorr_swtMplPlgDetd_C MonEgyChrgnCoorr_uMaxDcChrgnNotAvl_C MonEgyChrgnCoorr_uMaxPlgLockCtrld_C MonEgyChrgnCoorr_uMaxUnlockPlgLock_C MonEgyChrgnCoorr_uThdAcChrgn_C /end DEF_CHARACTERISTIC
 /begin IN_MEASUREMENT CcsAcCtrl_stChrgn CcsCom_stEgyTrfModSeld CcsDcCtrl_stChrgn MonEgyChrgnCoorr_flgDcChrgnPtdT MonEgyChrgnCoorr_flgVehChrgnCdn MonEgyChrgnCoorr_flgVehNotMovg MonEgyChrgnCoorr_uDcChrgn MonEgyChrgnCrash_stCrashDetn MonEgyChrgnInlet_stCcsChrgPlgIf MonEgyChrgnInlet_stCcsPlgLockIf MonEgyChrgnInlet_stChrgPlgIf MonEgyChrgnInlet_stDiagCcsChrgPlgIf MonEgyChrgnInlet_stDiagCcsPlgLockIf MonEgyChrgn_stDcCntct MonEgyChrgn_stExtChrgnDiCmd Mo_stCplChk Mo_stMoC Mo_stMoCCpl /end IN_MEASUREMENT
 /begin OUT_MEASUREMENT MonEgyChrgnCoorr_stActChrgMod MonEgyChrgnCoorr_stCcsUnlckPlgLockPtd MonEgyChrgnCoorr_stChrgn MonEgyChrgnCoorr_stDrvRdn MonEgyChrgnCoorr_stSftyErr /end OUT_MEASUREMENT
 /begin LOC_MEASUREMENT MonEgyChrgnCoorrCoorr_bbLoc1Cpl MonEgyChrgnCoorrCoorr_bbLoc2Cpl MonEgyChrgnCoorr_cntrAcChrgnWoMofRelsErr MonEgyChrgnCoorr_cntrAcChrgnWoMofRelsErrCpl MonEgyChrgnCoorr_cntrCcsPlgLockMovmtErr MonEgyChrgnCoorr_cntrCcsPlgLockMovmtErrCpl MonEgyChrgnCoorr_cntrChrgnAbortErr MonEgyChrgnCoorr_cntrChrgnAbortErrCpl MonEgyChrgnCoorr_cntrDcCntctErr MonEgyChrgnCoorr_cntrDcCntctErrCpl MonEgyChrgnCoorr_cntrImpsChrgnModeErr MonEgyChrgnCoorr_cntrImpsChrgnModeErrCpl MonEgyChrgnCoorr_cntrImpsChrgnPrmsErr MonEgyChrgnCoorr_cntrImpsChrgnPrmsErrCpl MonEgyChrgnCoorr_cntrImpsUDcIntkErr MonEgyChrgnCoorr_cntrImpsUDcIntkErrCpl MonEgyChrgnCoorr_cntrTurnOnDlyAcChrgMod MonEgyChrgnCoorr_cntrTurnOnDlyAcChrgModCpl MonEgyChrgnCoorr_cntrTurnOnDlyAcChrgnPrms MonEgyChrgnCoorr_cntrTurnOnDlyAcChrgnPrmsCpl MonEgyChrgnCoorr_cntrTurnOnDlyDcChrgMod MonEgyChrgnCoorr_cntrTurnOnDlyDcChrgModCpl MonEgyChrgnCoorr_cntrTurnOnDlyDcChrgnPrms MonEgyChrgnCoorr_cntrTurnOnDlyDcChrgnPrmsCpl MonEgyChrgnCoorr_flgAcChrgnPtdPlgSt MonEgyChrgnCoorr_flgAcChrgnWoMofRelsErr MonEgyChrgnCoorr_flgChrgnAbortErr MonEgyChrgnCoorr_flgChrgnStopReq MonEgyChrgnCoorr_flgDcChrgnPtdPlgSt MonEgyChrgnCoorr_flgDcCntctErr MonEgyChrgnCoorr_flgImpsChrgnModErr MonEgyChrgnCoorr_flgImpsChrgnPrmsErr MonEgyChrgnCoorr_flgImpsUDcIntkErr MonEgyChrgnCoorr_flgNoChrgn MonEgyChrgnCoorr_flgPlgLockMovmtErr MonEgyChrgnCoorr_stActChrgModCpl MonEgyChrgnCoorr_stCcsAc MonEgyChrgnCoorr_stCcsAcChrgn MonEgyChrgnCoorr_stCcsAcChrgnCpl MonEgyChrgnCoorr_stCcsAcCpl MonEgyChrgnCoorr_stCcsDc MonEgyChrgnCoorr_stCcsDcChrgn MonEgyChrgnCoorr_stCcsDcChrgnCpl MonEgyChrgnCoorr_stCcsDcCpl MonEgyChrgnCoorr_stCcsUnlckPlgLockPtdCpl MonEgyChrgnCoorr_stChrgModSeld MonEgyChrgnCoorr_stChrgModSeldCpl MonEgyChrgnCoorr_stChrgnCpl MonEgyChrgnCoorr_stDrvRdnCpl MonEgyChrgnCoorr_stSeldChrgnPrms MonEgyChrgnCoorr_stSeldChrgnPrmsCpl MonEgyChrgnCoorr_stSftyErrCpl /end LOC_MEASUREMENT
 FUNCTION_VERSION "1.1.0_1.0.0" /end FUNCTION
/begin FUNCTION MonEgyChrgnCoorr_Info "1.1.0     Monitoring charging coordinator: Output information"
 /begin DEF_CHARACTERISTIC MonEgyChrgnCoorr_stActChrgModSubVal_C MonEgyChrgnCoorr_stCcsUnlckPlgLockPtdSubVal_C MonEgyChrgnCoorr_stChrgnSubVal_C MonEgyChrgnCoorr_stDrvRdnSubVal_C MonEgyChrgnCoorr_stSftyErrSubVal_C MonEgyChrgnCoorr_stSwtSubVal_C /end DEF_CHARACTERISTIC
 /begin IN_MEASUREMENT MonEgyChrgnCoorr_stActChrgMod MonEgyChrgnCoorr_stCcsUnlckPlgLockPtd MonEgyChrgnCoorr_stChrgn MonEgyChrgnCoorr_stDrvRdn MonEgyChrgnCoorr_stSftyErr Mo_stCplChk Mo_stMoC Mo_stMoCCpl /end IN_MEASUREMENT
 /begin OUT_MEASUREMENT MonEgyChrgnCoorr_stActChrgModIf MonEgyChrgnCoorr_stCcsUnlckPlgLockPtdIf MonEgyChrgnCoorr_stCcsUnlckPlgLockPtdMsg MonEgyChrgnCoorr_stChrgnIf MonEgyChrgnCoorr_stDrvRdnIf MonEgyChrgnCoorr_stSftyErrIf /end OUT_MEASUREMENT
 /begin LOC_MEASUREMENT MonEgyChrgnCoorr_stActChrgModIfCpl MonEgyChrgnCoorr_stCcsUnlckPlgLockPtdIfCpl MonEgyChrgnCoorr_stChrgnIfCpl MonEgyChrgnCoorr_stDrvRdnIfCpl MonEgyChrgnCoorr_stSftyErrIfCpl /end LOC_MEASUREMENT
 FUNCTION_VERSION "1.1.0" /end FUNCTION
/begin FUNCTION MonEgyChrgnCoorr_PreProc "1.1.0     Monitoring charging coordinator: Preprocessor"
 /begin DEF_CHARACTERISTIC MonEgyChrgnCoorr_swtVehCdn_C MonEgyChrgnCoorr_uDcChrgnSubVal_C MonEgyChrgnCoorr_vMaxVehMovg_C /end DEF_CHARACTERISTIC
 /begin IN_MEASUREMENT MonBrk_stPrkBrk MonBrk_stPrkBrkQlfr MonEgyChrgnT_stDcChrgT1 MonEgyChrgnT_stDcChrgT2 MonEgyChrgn_stDcChrgnQlfr MonEgyChrgn_uDcChrgn MonGbx_stGearLvr MonGbx_stGearLvrQlfr MonVehV_stSpdQlfr MonVehV_vSpd Mo_stCplChk Mo_stMoC Mo_stMoCCpl /end IN_MEASUREMENT
 /begin OUT_MEASUREMENT MonEgyChrgnCoorr_flgDcChrgnPtdT MonEgyChrgnCoorr_flgVehChrgnCdn MonEgyChrgnCoorr_flgVehNotMovg MonEgyChrgnCoorr_uDcChrgn /end OUT_MEASUREMENT
 /begin LOC_MEASUREMENT MonEgyChrgnCoorrPreProc_bbOut1Cpl MonEgyChrgnCoorr_uDcChrgnCpl /end LOC_MEASUREMENT
 FUNCTION_VERSION "1.1.0" /end FUNCTION
/begin FUNCTION MonEgyChrgnDefn_GlbDefn "1.3.0     Monitoring energy charging definition: global definitions" FUNCTION_VERSION "1.3.0" /end FUNCTION
/begin FUNCTION MonEgyChrgnErrReactn_Coorr "1.1.0     Monitoring chargining error handling: Coordinator"
 /begin DEF_CHARACTERISTIC MonEgyChrgnErrReactn_cntrDebActvErrPin_C MonEgyChrgnErrReactn_cntrDebPersSftyErr_C MonEgyChrgnErrReactn_cntrHealCtpSwtCtrl_C MonEgyChrgnErrReactn_mskSftyErrActvnErrPin_C MonEgyChrgnErrReactn_mskStgErrReactnErrPinActv_C MonEgyChrgnErrReactn_mskStgErrReactn_C /end DEF_CHARACTERISTIC
 /begin IN_MEASUREMENT MonEgyChrgnCoorr_stSftyErrIf Mo_stCplChk Mo_stMoC Mo_stMoCCpl /end IN_MEASUREMENT
 /begin OUT_MEASUREMENT MonEgyChrgnErrReactn_stSftyErrIf /end OUT_MEASUREMENT
 /begin LOC_MEASUREMENT MonEgyChrgnErrReactnCoorr_bbLoc1Cpl MonEgyChrgnErrReactn_cntrDebActvErrPin MonEgyChrgnErrReactn_cntrDebActvErrPinCpl MonEgyChrgnErrReactn_cntrDebPersSftyErr MonEgyChrgnErrReactn_cntrDebPersSftyErrCpl MonEgyChrgnErrReactn_cntrHealCtpSwtCtrl MonEgyChrgnErrReactn_cntrHealCtpSwtCtrlCpl MonEgyChrgnErrReactn_flgCtpSwtClsCmd MonEgyChrgnErrReactn_flgHealCtpSwtCtrl MonEgyChrgnErrReactn_flgPersSftyErr MonEgyChrgnErrReactn_flgReqErrPinActv MonEgyChrgnErrReactn_flgSftyErr MonEgyChrgnErrReactn_stSftyErrIfCpl /end LOC_MEASUREMENT
 FUNCTION_VERSION "1.1.0" /end FUNCTION
/begin FUNCTION MonEgyChrgnIf_Diag "1.0.0     Monitoring energy charging interfaces : Diagnosis"
 /begin DEF_CHARACTERISTIC DFC_CtlMsk2.DFC_MonEgyChrgnCoorr_AcChrgnWoMofRels_C DFC_CtlMsk2.DFC_MonEgyChrgnCoorr_ChrgnAbortIgr_C DFC_CtlMsk2.DFC_MonEgyChrgnCoorr_DcCntctFailr_C DFC_CtlMsk2.DFC_MonEgyChrgnCoorr_ExtChrgnShtOffReq_C DFC_CtlMsk2.DFC_MonEgyChrgnCoorr_ImpsChrgnMod_C DFC_CtlMsk2.DFC_MonEgyChrgnCoorr_ImpsChrgnPrms_C DFC_CtlMsk2.DFC_MonEgyChrgnCoorr_ImpsUDcIntk_C DFC_CtlMsk2.DFC_MonEgyChrgnCoorr_PlgLockMovmt_C DFC_CtlMsk2.DFC_MonEgyChrgnCoorr_VehCrashDetn_C DFC_CtlMsk2.DFC_MonEgyChrgnErrReactn_SftySwt_C DFC_CtlMsk2.DFC_MonEgyChrgnInlet_CcsPlgCtp_C DFC_CtlMsk2.DFC_MonEgyChrgnInlet_CcsPlgCtpPwm_C DFC_CtlMsk2.DFC_MonEgyChrgnInlet_CcsPlgLockCtrlImpsAtmpt_C DFC_CtlMsk2.DFC_MonEgyChrgnInlet_CcsPlgLockSnsrSigRngChk_C DFC_CtlMsk2.DFC_MonEgyChrgnInlet_CcsPlgLockStImps_C DFC_CtlMsk2.DFC_MonEgyChrgnInlet_CcsPlgPxp_C DFC_CtlMsk2.DFC_MonEgyChrgnT_Snsr1GrdtChk_C DFC_CtlMsk2.DFC_MonEgyChrgnT_Snsr1SigRngChk_C DFC_CtlMsk2.DFC_MonEgyChrgnT_Snsr2GrdtChk_C DFC_CtlMsk2.DFC_MonEgyChrgnT_Snsr2SigRngChk_C DFC_CtlMsk2.DFC_MonEgyChrgnT_SnsrDif_C DFC_DisblMsk2.DFC_MonEgyChrgnCoorr_AcChrgnWoMofRels_C DFC_DisblMsk2.DFC_MonEgyChrgnCoorr_ChrgnAbortIgr_C DFC_DisblMsk2.DFC_MonEgyChrgnCoorr_DcCntctFailr_C DFC_DisblMsk2.DFC_MonEgyChrgnCoorr_ExtChrgnShtOffReq_C DFC_DisblMsk2.DFC_MonEgyChrgnCoorr_ImpsChrgnMod_C DFC_DisblMsk2.DFC_MonEgyChrgnCoorr_ImpsChrgnPrms_C DFC_DisblMsk2.DFC_MonEgyChrgnCoorr_ImpsUDcIntk_C DFC_DisblMsk2.DFC_MonEgyChrgnCoorr_PlgLockMovmt_C DFC_DisblMsk2.DFC_MonEgyChrgnCoorr_VehCrashDetn_C DFC_DisblMsk2.DFC_MonEgyChrgnErrReactn_SftySwt_C DFC_DisblMsk2.DFC_MonEgyChrgnInlet_CcsPlgCtp_C DFC_DisblMsk2.DFC_MonEgyChrgnInlet_CcsPlgCtpPwm_C DFC_DisblMsk2.DFC_MonEgyChrgnInlet_CcsPlgLockCtrlImpsAtmpt_C DFC_DisblMsk2.DFC_MonEgyChrgnInlet_CcsPlgLockSnsrSigRngChk_C DFC_DisblMsk2.DFC_MonEgyChrgnInlet_CcsPlgLockStImps_C DFC_DisblMsk2.DFC_MonEgyChrgnInlet_CcsPlgPxp_C DFC_DisblMsk2.DFC_MonEgyChrgnT_Snsr1GrdtChk_C DFC_DisblMsk2.DFC_MonEgyChrgnT_Snsr1SigRngChk_C DFC_DisblMsk2.DFC_MonEgyChrgnT_Snsr2GrdtChk_C DFC_DisblMsk2.DFC_MonEgyChrgnT_Snsr2SigRngChk_C DFC_DisblMsk2.DFC_MonEgyChrgnT_SnsrDif_C MonEgyChrgnIf_cntrTestAcChrgnWoMofRels_C MonEgyChrgnIf_cntrTestCcsPlgCtpPwm_C MonEgyChrgnIf_cntrTestCcsPlgCtp_C MonEgyChrgnIf_cntrTestCcsPlgLockCtrlImpsAtmpt_C MonEgyChrgnIf_cntrTestCcsPlgLockSnsrSigRngChk_C MonEgyChrgnIf_cntrTestCcsPlgLockStImps_C MonEgyChrgnIf_cntrTestCcsPlgPxp_C MonEgyChrgnIf_cntrTestChrgnAbortIgr_C MonEgyChrgnIf_cntrTestDcCntctFailr_C MonEgyChrgnIf_cntrTestExtChrgnShtOffReq_C MonEgyChrgnIf_cntrTestImpsChrgMod_C MonEgyChrgnIf_cntrTestImpsChrgPrms_C MonEgyChrgnIf_cntrTestImpsUDcIntk_C MonEgyChrgnIf_cntrTestPlgLockMovmt_C MonEgyChrgnIf_cntrTestSftySwt_C MonEgyChrgnIf_cntrTestSnsr1GrdtChk_C MonEgyChrgnIf_cntrTestSnsr1SigRngChk_C MonEgyChrgnIf_cntrTestSnsr2GrdtChk_C MonEgyChrgnIf_cntrTestSnsr2SigRngChk_C MonEgyChrgnIf_cntrTestSnsrDif_C MonEgyChrgnIf_cntrTestVehCrashDetn_C MonEgyChrgnIf_stMskCcsCtpPwm_C MonEgyChrgnIf_stMskCcsCtp_C MonEgyChrgnIf_stMskCcsPxp_C /end DEF_CHARACTERISTIC
 /begin IN_MEASUREMENT MonEgyChrgnCoorr_stActChrgModIf MonEgyChrgnCoorr_stSftyErrIf MonEgyChrgnErrReactn_stSftyErrIf MonEgyChrgnInlet_stDiagCcsChrgPlgIf MonEgyChrgnInlet_stDiagCcsPlgLockIf MonEgyChrgnT_stDcChrgT1 MonEgyChrgnT_stDcChrgT2 /end IN_MEASUREMENT
 /begin OUT_MEASUREMENT DFC_st.DFC_MonEgyChrgnCoorr_AcChrgnWoMofRels DFC_st.DFC_MonEgyChrgnCoorr_ChrgnAbortIgr DFC_st.DFC_MonEgyChrgnCoorr_DcCntctFailr DFC_st.DFC_MonEgyChrgnCoorr_ExtChrgnShtOffReq DFC_st.DFC_MonEgyChrgnCoorr_ImpsChrgnMod DFC_st.DFC_MonEgyChrgnCoorr_ImpsChrgnPrms DFC_st.DFC_MonEgyChrgnCoorr_ImpsUDcIntk DFC_st.DFC_MonEgyChrgnCoorr_PlgLockMovmt DFC_st.DFC_MonEgyChrgnCoorr_VehCrashDetn DFC_st.DFC_MonEgyChrgnErrReactn_SftySwt DFC_st.DFC_MonEgyChrgnInlet_CcsPlgCtp DFC_st.DFC_MonEgyChrgnInlet_CcsPlgCtpPwm DFC_st.DFC_MonEgyChrgnInlet_CcsPlgLockCtrlImpsAtmpt DFC_st.DFC_MonEgyChrgnInlet_CcsPlgLockSnsrSigRngChk DFC_st.DFC_MonEgyChrgnInlet_CcsPlgLockStImps DFC_st.DFC_MonEgyChrgnInlet_CcsPlgPxp DFC_st.DFC_MonEgyChrgnT_Snsr1GrdtChk DFC_st.DFC_MonEgyChrgnT_Snsr1SigRngChk DFC_st.DFC_MonEgyChrgnT_Snsr2GrdtChk DFC_st.DFC_MonEgyChrgnT_Snsr2SigRngChk DFC_st.DFC_MonEgyChrgnT_SnsrDif MonEgyChrgnIf_flgClrAcChrgnWoMofRels MonEgyChrgnIf_flgClrCcsPlgCtp MonEgyChrgnIf_flgClrCcsPlgCtpPwm MonEgyChrgnIf_flgClrCcsPlgLockCtrlImpsAtmpt MonEgyChrgnIf_flgClrCcsPlgLockSnsrSigRngChk MonEgyChrgnIf_flgClrCcsPlgLockStImps MonEgyChrgnIf_flgClrCcsPlgPxp MonEgyChrgnIf_flgClrChrgnAbortIgr MonEgyChrgnIf_flgClrDcCntctFailr MonEgyChrgnIf_flgClrExtChrgnShtOffReq MonEgyChrgnIf_flgClrImpsChrgMod MonEgyChrgnIf_flgClrImpsChrgPrms MonEgyChrgnIf_flgClrImpsUDcIntk MonEgyChrgnIf_flgClrPlgLockMovmt MonEgyChrgnIf_flgClrSftySwt MonEgyChrgnIf_flgClrSnsr1GrdtChk MonEgyChrgnIf_flgClrSnsr1SigRngChk MonEgyChrgnIf_flgClrSnsr2GrdtChk MonEgyChrgnIf_flgClrSnsr2SigRngChk MonEgyChrgnIf_flgClrSnsrDif MonEgyChrgnIf_flgClrVehCrashDetn /end OUT_MEASUREMENT
 /begin LOC_MEASUREMENT MonEgyChrgnIf_cntrTestAcChrgnWoMofRels MonEgyChrgnIf_cntrTestCcsPlgCtp MonEgyChrgnIf_cntrTestCcsPlgCtpPwm MonEgyChrgnIf_cntrTestCcsPlgLockCtrlImpsAtmpt MonEgyChrgnIf_cntrTestCcsPlgLockSnsrSigRngChk MonEgyChrgnIf_cntrTestCcsPlgLockStImps MonEgyChrgnIf_cntrTestCcsPlgPxp MonEgyChrgnIf_cntrTestChrgnAbortIgr MonEgyChrgnIf_cntrTestDcCntctFailr MonEgyChrgnIf_cntrTestExtChrgnShtOffReq MonEgyChrgnIf_cntrTestImpsChrgMod MonEgyChrgnIf_cntrTestImpsChrgPrms MonEgyChrgnIf_cntrTestImpsUDcIntk MonEgyChrgnIf_cntrTestPlgLockMovmt MonEgyChrgnIf_cntrTestSftySwt MonEgyChrgnIf_cntrTestSnsr1GrdtChk MonEgyChrgnIf_cntrTestSnsr1SigRngChk MonEgyChrgnIf_cntrTestSnsr2GrdtChk MonEgyChrgnIf_cntrTestSnsr2SigRngChk MonEgyChrgnIf_cntrTestSnsrDif MonEgyChrgnIf_cntrTestVehCrashDetn /end LOC_MEASUREMENT
 FUNCTION_VERSION "1.0.0" /end FUNCTION
/begin FUNCTION MonEgyChrgnIf_Lvl1 "1.0.0     Monitoring energy charging interfaces : Level 1"
 /begin IN_MEASUREMENT MonEgyChrgnCoorr_stChrgnIf MonEgyChrgnCoorr_stDrvRdnIf Mo_stCplChk Mo_stMoC Mo_stMoCCpl /end IN_MEASUREMENT
 /begin OUT_MEASUREMENT MonEgyChrgnIf_stChrgnMsg MonEgyChrgnIf_stDrvRdnMsg /end OUT_MEASUREMENT
 FUNCTION_VERSION "1.0.0" /end FUNCTION
/begin FUNCTION MonEgyChrgnInlet_Info "1.1.0     Monitoring energy charging plug and lock state of the inlet: Output information"
 /begin DEF_CHARACTERISTIC MonEgyChrgnInlet_stCcsChrgPlgSubVal_C MonEgyChrgnInlet_stCcsPlgLockSubVal_C MonEgyChrgnInlet_stChrgPlgSubVal_C MonEgyChrgnInlet_stDiagCcsChrgPlgSubVal_C MonEgyChrgnInlet_stDiagCcsPlgLockSubVal_C MonEgyChrgnInlet_stSwtCcs_C /end DEF_CHARACTERISTIC
 /begin IN_MEASUREMENT MonEgyChrgnInlet_stCcsChrgPlg MonEgyChrgnInlet_stCcsPlgLock MonEgyChrgnInlet_stChrgPlg MonEgyChrgnInlet_stDiagCcsChrgPlg MonEgyChrgnInlet_stDiagCcsPlgLock Mo_stCplChk Mo_stMoC Mo_stMoCCpl /end IN_MEASUREMENT
 /begin OUT_MEASUREMENT MonEgyChrgnInlet_stCcsChrgPlgIf MonEgyChrgnInlet_stCcsPlgLockIf MonEgyChrgnInlet_stChrgPlgIf MonEgyChrgnInlet_stDiagCcsChrgPlgIf MonEgyChrgnInlet_stDiagCcsPlgLockIf /end OUT_MEASUREMENT
 /begin LOC_MEASUREMENT MonEgyChrgnInlet_stCcsChrgPlgIfCpl MonEgyChrgnInlet_stCcsPlgLockIfCpl MonEgyChrgnInlet_stChrgPlgIfCpl MonEgyChrgnInlet_stDiagCcsChrgPlgIfCpl MonEgyChrgnInlet_stDiagCcsPlgLockIfCpl /end LOC_MEASUREMENT
 FUNCTION_VERSION "1.1.0" /end FUNCTION
/begin FUNCTION MonEgyChrgnInlet_Inp "1.1.0     Monitoring energy charging plug and lock state of the inlet: input signals" /begin DEF_CHARACTERISTIC MonEgyChrgnInlet_facAdcCnv_C MonEgyChrgnInlet_nrBitShift_C /end DEF_CHARACTERISTIC /begin IN_MEASUREMENT Mo_stCplChk Mo_stMoC Mo_stMoCCpl /end IN_MEASUREMENT
 /begin OUT_MEASUREMENT MonEgyChrgnInlet_ratPwmCcsCtp MonEgyChrgnInlet_tiPerdCcsCtp MonEgyChrgnInlet_uRawCcsCtp MonEgyChrgnInlet_uRawCcsCtpStEvse MonEgyChrgnInlet_uRawCcsCtpSwtDiag MonEgyChrgnInlet_uRawCcsPlgPosn MonEgyChrgnInlet_uRawCcsPxp /end OUT_MEASUREMENT
 /begin LOC_MEASUREMENT MonEgyChrgnInlet_ratPwmCcsCtpCpl MonEgyChrgnInlet_ratPwmCcsCtpLoc MonEgyChrgnInlet_ratPwmCcsCtpLocCpl MonEgyChrgnInlet_stSigCcsCtpLoc MonEgyChrgnInlet_stSigCcsCtpLocCpl MonEgyChrgnInlet_tiLoadCcsCtpLoc MonEgyChrgnInlet_tiLoadCcsCtpLocCpl MonEgyChrgnInlet_tiPerdCcsCtpCpl MonEgyChrgnInlet_tiPerdCcsCtpLoc MonEgyChrgnInlet_tiPerdCcsCtpLocCpl MonEgyChrgnInlet_uRawCcsCtpCpl MonEgyChrgnInlet_uRawCcsCtpStEvseCpl MonEgyChrgnInlet_uRawCcsCtpSwtDiagCpl MonEgyChrgnInlet_uRawCcsPlgPosnCpl MonEgyChrgnInlet_uRawCcsPxpCpl /end LOC_MEASUREMENT
 FUNCTION_VERSION "1.1.0" /end FUNCTION
/begin FUNCTION MonEgyChrgnInlet_Lock "1.7.0     Monitoring energy charging plug and lock state of the inlet: Lock evaluation and plausibilization"
 /begin DEF_CHARACTERISTIC MonEgyChrgnInlet_cntrDebImpsSnsrPlgLock_C MonEgyChrgnInlet_cntrDebMaxSnsrPlgLock_C MonEgyChrgnInlet_cntrDebMinSnsrPlgLock_C MonEgyChrgnInlet_cntrDebPlgLockStImps_C MonEgyChrgnInlet_cntrDebPlgLockStUnlockdPlaus_C MonEgyChrgnInlet_cntrHealImpsSnsrPlgLock_C MonEgyChrgnInlet_cntrHealMaxSnsrPlgLock_C MonEgyChrgnInlet_cntrHealMinSnsrPlgLock_C MonEgyChrgnInlet_cntrIninPlausCcsPlgLock_C MonEgyChrgnInlet_cntrMaxPlgLockCtrlAtmpt_C MonEgyChrgnInlet_cntrPlgLockCtrlTi_C MonEgyChrgnInlet_mskErrDiagCcsPlgLock_C MonEgyChrgnInlet_uTrfCcsPlgLockPosn_T /end DEF_CHARACTERISTIC
 /begin IN_MEASUREMENT MonEgyChrgnDefn_flgVrntCcsPlgLock MonEgyChrgnInlet_flgErrAdc MonEgyChrgnInlet_stPlgLockCmdMsg MonEgyChrgnInlet_uRawCcsPlgPosn Mo_stCplChk Mo_stMoC Mo_stMoCCpl /end IN_MEASUREMENT
 /begin OUT_MEASUREMENT MonEgyChrgnInlet_stCcsPlgLock MonEgyChrgnInlet_stDiagCcsPlgLock /end OUT_MEASUREMENT
 /begin LOC_MEASUREMENT MonEgyChrgnInletLock_bbLoc1Cpl MonEgyChrgnInlet_cntrDebImpsSnsrPlgLock MonEgyChrgnInlet_cntrDebImpsSnsrPlgLockCpl MonEgyChrgnInlet_cntrDebMaxSnsrPlgLock MonEgyChrgnInlet_cntrDebMaxSnsrPlgLockCpl MonEgyChrgnInlet_cntrDebMinSnsrPlgLock MonEgyChrgnInlet_cntrDebMinSnsrPlgLockCpl MonEgyChrgnInlet_cntrDebPlgLockStImps MonEgyChrgnInlet_cntrDebPlgLockStImpsCpl MonEgyChrgnInlet_cntrDebPlgLockStUnlockdPlaus MonEgyChrgnInlet_cntrDebPlgLockStUnlockdPlausCpl MonEgyChrgnInlet_cntrIninPlausCcsPlgLock MonEgyChrgnInlet_cntrIninPlausCcsPlgLockCpl MonEgyChrgnInlet_cntrPlgLockCtrlAtmpt MonEgyChrgnInlet_cntrPlgLockCtrlAtmptCpl MonEgyChrgnInlet_cntrPlgLockCtrlTi MonEgyChrgnInlet_cntrPlgLockCtrlTiCpl MonEgyChrgnInlet_flgLockCtrld MonEgyChrgnInlet_flgLockCtrlMinExcdd MonEgyChrgnInlet_flgLockNVRamChkErr MonEgyChrgnInlet_flgPlgLockActrCtrl MonEgyChrgnInlet_flgPlgLockActrCtrlOld MonEgyChrgnInlet_flgPosPlgLockBfrCtrl MonEgyChrgnInlet_flgPosPlgLockd MonEgyChrgnInlet_stCcsPlgLockCpl MonEgyChrgnInlet_stDebImpsSnsrPlgLock MonEgyChrgnInlet_stDebImpsSnsrPlgLockCpl MonEgyChrgnInlet_stDebMaxSnsrPlgLock MonEgyChrgnInlet_stDebMaxSnsrPlgLockCpl MonEgyChrgnInlet_stDebMinSnsrPlgLock MonEgyChrgnInlet_stDebMinSnsrPlgLockCpl MonEgyChrgnInlet_stDiagCcsPlgLockCpl MonEgyChrgnInlet_stElecCcsPlgLockPosn MonEgyChrgnInlet_stElecCcsPlgLockPosnCpl MonEgyChrgnInlet_stPosPlgLockOld MonEgyChrgnInlet_stPosPlgLockOldCpl /end LOC_MEASUREMENT
 FUNCTION_VERSION "1.7.0" /end FUNCTION
/begin FUNCTION MonEgyChrgnInlet_Plg "1.1.0     Monitoring energy charging plug and lock state of the inlet: Plug evaluation and plausibilization"
 /begin DEF_CHARACTERISTIC MonEgyChrgnInlet_cntrDebConPwmCcsCtp_C MonEgyChrgnInlet_cntrDebCtpDigComReq_C MonEgyChrgnInlet_cntrDebMaxCtp_C MonEgyChrgnInlet_cntrDebMaxPxp_C MonEgyChrgnInlet_cntrDebMinPxp_C MonEgyChrgnInlet_cntrDebPerdPwmCcsCtp_C MonEgyChrgnInlet_cntrDebPwmCcsCtpPlausAc_C MonEgyChrgnInlet_cntrHealConPwmCcsCtp_C MonEgyChrgnInlet_cntrHealCtpDigComReq_C MonEgyChrgnInlet_cntrHealMaxPxp_C MonEgyChrgnInlet_cntrHealMinPxp_C MonEgyChrgnInlet_cntrHealPerdPwmCcsCtp_C MonEgyChrgnInlet_cntrHealPwmCcsCtpPlausAc_C MonEgyChrgnInlet_cntrHeaMaxCtp_C MonEgyChrgnInlet_cntrIninPlausCcsCtp_C MonEgyChrgnInlet_cntrIninPlausCcsPxp_C MonEgyChrgnInlet_mskErrDiagCcsCtp_C MonEgyChrgnInlet_mskErrDiagCcsPxp_C MonEgyChrgnInlet_ratConPwmCcsCtpMax_C MonEgyChrgnInlet_ratConPwmCcsCtpMin_C MonEgyChrgnInlet_ratPwmCcsCtpDigComReqMax_C MonEgyChrgnInlet_ratPwmCcsCtpDigComReqMin_C MonEgyChrgnInlet_ratPwmCcsCtpPlausAcMax_C MonEgyChrgnInlet_ratPwmCcsCtpPlausAcMin_C MonEgyChrgnInlet_swtPxpPlausActv_C MonEgyChrgnInlet_tiPerdPwmCcsCtpMax_C MonEgyChrgnInlet_tiPerdPwmCcsCtpMin_C MonEgyChrgnInlet_uCtpEvRdyMax_C MonEgyChrgnInlet_uCtpEvRdyMin_C MonEgyChrgnInlet_uCtpOlMax_C MonEgyChrgnInlet_uCtpOlMin_C MonEgyChrgnInlet_uCtpPlgCnctdMax_C MonEgyChrgnInlet_uCtpPlgCnctdMin_C MonEgyChrgnInlet_uCtpVentnRqrdMax_C MonEgyChrgnInlet_uCtpVentnRqrdMin_C MonEgyChrgnInlet_uMaxCtp_C MonEgyChrgnInlet_uMaxPxp_C MonEgyChrgnInlet_uMinPxp_C MonEgyChrgnInlet_uPosnClsdMax_C MonEgyChrgnInlet_uPosnClsdMin_C MonEgyChrgnInlet_uPxpTyp1FaildMax_C MonEgyChrgnInlet_uPxpTyp1FaildMin_C MonEgyChrgnInlet_uPxpTyp1OlMax_C MonEgyChrgnInlet_uPxpTyp1OlMin_C MonEgyChrgnInlet_uPxpTyp1Rng1Max_C MonEgyChrgnInlet_uPxpTyp1Rng1Min_C MonEgyChrgnInlet_uPxpTyp1Rng2Max_C MonEgyChrgnInlet_uPxpTyp1Rng2Min_C MonEgyChrgnInlet_uPxpTyp2FaildMax_C MonEgyChrgnInlet_uPxpTyp2FaildMin_C MonEgyChrgnInlet_uPxpTyp2OlMax_C MonEgyChrgnInlet_uPxpTyp2OlMin_C MonEgyChrgnInlet_uPxpTyp2Rng1Max_C MonEgyChrgnInlet_uPxpTyp2Rng1Min_C MonEgyChrgnInlet_uPxpTyp2Rng2Max_C MonEgyChrgnInlet_uPxpTyp2Rng2Min_C MonEgyChrgnInlet_uPxpTyp2Rng3Max_C MonEgyChrgnInlet_uPxpTyp2Rng3Min_C MonEgyChrgnInlet_uPxpTyp2Rng4Max_C MonEgyChrgnInlet_uPxpTyp2Rng4Min_C /end DEF_CHARACTERISTIC
 /begin IN_MEASUREMENT MonEgyChrgnInlet_flgCcsTyp MonEgyChrgnInlet_flgErrAdc MonEgyChrgnInlet_ratPwmCcsCtp MonEgyChrgnInlet_tiPerdCcsCtp MonEgyChrgnInlet_uCtp MonEgyChrgnInlet_uPxp MonEgyChrgnInlet_uRawCcsCtpSwtDiag Mo_stCplChk Mo_stMoC Mo_stMoCCpl /end IN_MEASUREMENT
 /begin OUT_MEASUREMENT MonEgyChrgnInlet_stCcsChrgPlg MonEgyChrgnInlet_stCcsCtp MonEgyChrgnInlet_stCcsPxp MonEgyChrgnInlet_stChrgPlg MonEgyChrgnInlet_stDiagCcsChrgPlg MonEgyChrgnInlet_stDiagCcsCtp MonEgyChrgnInlet_stDiagCcsPxp /end OUT_MEASUREMENT
 /begin LOC_MEASUREMENT MonEgyChrgnInletPlg_bbLoc1Cpl MonEgyChrgnInletPlg_bbLoc2Cpl MonEgyChrgnInletPlg_bbLoc3Cpl MonEgyChrgnInlet_cntrDebConPwmCcsCtp MonEgyChrgnInlet_cntrDebConPwmCcsCtpCpl MonEgyChrgnInlet_cntrDebCtpDigComReq MonEgyChrgnInlet_cntrDebCtpDigComReqCpl MonEgyChrgnInlet_cntrDebMaxCtp MonEgyChrgnInlet_cntrDebMaxCtpCpl MonEgyChrgnInlet_cntrDebMaxEvseErr MonEgyChrgnInlet_cntrDebMaxEvseErrCpl MonEgyChrgnInlet_cntrDebMaxPxp MonEgyChrgnInlet_cntrDebMaxPxpCpl MonEgyChrgnInlet_cntrDebMinCtp MonEgyChrgnInlet_cntrDebMinCtpCpl MonEgyChrgnInlet_cntrDebMinEvseErr MonEgyChrgnInlet_cntrDebMinEvseErrCpl MonEgyChrgnInlet_cntrDebMinPxp MonEgyChrgnInlet_cntrDebMinPxpCpl MonEgyChrgnInlet_cntrDebPerdPwmCcsCtp MonEgyChrgnInlet_cntrDebPerdPwmCcsCtpCpl MonEgyChrgnInlet_cntrDebPwmCcsCtpPlausAc MonEgyChrgnInlet_cntrDebPwmCcsCtpPlausAcCpl MonEgyChrgnInlet_cntrIninPlausCcsCtp MonEgyChrgnInlet_cntrIninPlausCcsCtpCpl MonEgyChrgnInlet_cntrIninPlausCcsPxp MonEgyChrgnInlet_cntrIninPlausCcsPxpCpl MonEgyChrgnInlet_flgCcsCtpDigComReq MonEgyChrgnInlet_flgCtpEvRdy MonEgyChrgnInlet_flgCtpPlgd MonEgyChrgnInlet_flgCtpPlgDetd MonEgyChrgnInlet_flgCtpVentnRqrd MonEgyChrgnInlet_flgErrMaxCtp MonEgyChrgnInlet_flgErrMaxPxp MonEgyChrgnInlet_flgErrMinPxp MonEgyChrgnInlet_flgPlausPwmCcsCtp MonEgyChrgnInlet_flgPlausRatPwmCcsCtp MonEgyChrgnInlet_flgPxpPlgd MonEgyChrgnInlet_flgRatConPwmCcsCtp MonEgyChrgnInlet_flgRng1 MonEgyChrgnInlet_flgRng2 MonEgyChrgnInlet_flgRng3 MonEgyChrgnInlet_flgRng4 MonEgyChrgnInlet_flgTmpErrMaxCtp MonEgyChrgnInlet_flgTmpErrMaxPxp MonEgyChrgnInlet_flgTmpErrMinPxp MonEgyChrgnInlet_stCcsChrgPlgCpl MonEgyChrgnInlet_stCcsCtpCpl MonEgyChrgnInlet_stCcsPxpCpl MonEgyChrgnInlet_stChrgPlgCpl MonEgyChrgnInlet_stDebConPwmCcsCtp MonEgyChrgnInlet_stDebConPwmCcsCtpCpl MonEgyChrgnInlet_stDebCtpDigComReq MonEgyChrgnInlet_stDebCtpDigComReqCpl MonEgyChrgnInlet_stDebMaxCtp MonEgyChrgnInlet_stDebMaxCtpCpl MonEgyChrgnInlet_stDebMaxPxp MonEgyChrgnInlet_stDebMaxPxpCpl MonEgyChrgnInlet_stDebMinPxp MonEgyChrgnInlet_stDebMinPxpCpl MonEgyChrgnInlet_stDebPerdPwmCcsCtp MonEgyChrgnInlet_stDebPerdPwmCcsCtpCpl MonEgyChrgnInlet_stDebPwmCcsCtpPlausAc MonEgyChrgnInlet_stDebPwmCcsCtpPlausAcCpl MonEgyChrgnInlet_stDiagCcsChrgPlgCpl MonEgyChrgnInlet_stDiagCcsCtpCpl MonEgyChrgnInlet_stDiagCcsPxpCpl /end LOC_MEASUREMENT
 FUNCTION_VERSION "1.1.0" /end FUNCTION
/begin FUNCTION MonEgyChrgnInlet_PreProc "1.1.0_STLAMonitoring energy charging plug and lock state of the inlet: Preprocessor"
 /begin DEF_CHARACTERISTIC MonEgyChrgnInlet_cntrPlgLockClsng_C MonEgyChrgnInlet_cntrPlgLockOpng_C MonEgyChrgnInlet_ratPlgLockClsng_C MonEgyChrgnInlet_ratPlgLockOpng_C /end DEF_CHARACTERISTIC
 /begin IN_MEASUREMENT IntlckChrgPlg_rActr MoCADC_bDef MonEgyChrgnInlet_uRawCcsCtp MonEgyChrgnInlet_uRawCcsCtpStEvse MonEgyChrgnInlet_uRawCcsPxp Mo_stCplChk Mo_stMoC Mo_stMoCCpl /end IN_MEASUREMENT
 /begin OUT_MEASUREMENT MonEgyChrgnInlet_flgCcsTyp MonEgyChrgnInlet_flgErrAdc MonEgyChrgnInlet_flgVrntCcsInletTyp1 MonEgyChrgnInlet_flgVrntCcsInletTyp2 MonEgyChrgnInlet_stPlgLockCmdMsg MonEgyChrgnInlet_uCtp MonEgyChrgnInlet_uCtpEvseErr MonEgyChrgnInlet_uPxp /end OUT_MEASUREMENT
 /begin LOC_MEASUREMENT MonEgyChrgnInletPreProc_bbOut1Cpl MonEgyChrgnInlet_cntrPlgLockClsng MonEgyChrgnInlet_cntrPlgLockClsngCpl MonEgyChrgnInlet_cntrPlgLockOpng MonEgyChrgnInlet_cntrPlgLockOpngCpl MonEgyChrgnInlet_uCtpCpl MonEgyChrgnInlet_uCtpEvseErrCpl MonEgyChrgnInlet_uPxpCpl /end LOC_MEASUREMENT
 FUNCTION_VERSION "1.1.0_STLA" /end FUNCTION
/begin FUNCTION MonEgyChrgnT_Info "1.1.0     Monitoring energy charging temperature sensors: Output information"
 /begin DEF_CHARACTERISTIC MonEgyChrgnT_stSnsr1SubVal_C MonEgyChrgnT_stSnsr2SubVal_C MonEgyChrgnT_stSwtDcChrgT_C MonEgyChrgnT_tSnsr1SubVal_C MonEgyChrgnT_tSnsr2SubVal_C /end DEF_CHARACTERISTIC
 /begin IN_MEASUREMENT MonEgyChrgnT_stSnsr1 MonEgyChrgnT_stSnsr2 MonEgyChrgnT_tSnsr1 MonEgyChrgnT_tSnsr2 Mo_stCplChk Mo_stMoC Mo_stMoCCpl /end IN_MEASUREMENT
 /begin OUT_MEASUREMENT MonEgyChrgnT_stDcChrgT1 MonEgyChrgnT_stDcChrgT2 MonEgyChrgnT_tDcChrgT1 MonEgyChrgnT_tDcChrgT2 /end OUT_MEASUREMENT
 /begin LOC_MEASUREMENT MonEgyChrgnT_stDcChrgT1Cpl MonEgyChrgnT_stDcChrgT2Cpl MonEgyChrgnT_tDcChrgT1Cpl MonEgyChrgnT_tDcChrgT2Cpl /end LOC_MEASUREMENT
 FUNCTION_VERSION "1.1.0" /end FUNCTION
/begin FUNCTION MonEgyChrgnT_Inp "1.1.0     Monitoring energy charging temperature sensors: Input signals" /begin DEF_CHARACTERISTIC MonEgyChrgnT_facAdcCnv_C MonEgyChrgnT_nrBitShift_C /end DEF_CHARACTERISTIC /begin IN_MEASUREMENT Mo_stCplChk Mo_stMoC Mo_stMoCCpl /end IN_MEASUREMENT
 /begin OUT_MEASUREMENT MonEgyChrgnT_uRawDcChrgnIntkT1 MonEgyChrgnT_uRawDcChrgnIntkT2 /end OUT_MEASUREMENT
 /begin LOC_MEASUREMENT MonEgyChrgnT_uRawDcChrgnIntkT1Cpl MonEgyChrgnT_uRawDcChrgnIntkT2Cpl /end LOC_MEASUREMENT
 FUNCTION_VERSION "1.1.0" /end FUNCTION
/begin FUNCTION MonEgyChrgnT_PlausSig "1.1.0     Monitoring energy charging temperature sensors: Signal plausible"
 /begin DEF_CHARACTERISTIC MonEgyChrgnT_cntrDebDifSnsr_C MonEgyChrgnT_cntrDebGrdtTSnsr_C MonEgyChrgnT_cntrDebMaxTSnsr_C MonEgyChrgnT_cntrHealDifSnsr_C MonEgyChrgnT_cntrHealGrdtTSnsr_C MonEgyChrgnT_cntrHealMaxTSnsr_C MonEgyChrgnT_cntrIninPlausT_C MonEgyChrgnT_cntrlDebMinTSnsr_C MonEgyChrgnT_cntrlHealMinTSnsr_C MonEgyChrgnT_tDifSnsr_C MonEgyChrgnT_tGrdtThd_C MonEgyChrgnT_tiFltGrdtTDwn_C MonEgyChrgnT_tiFltGrdtTUp_C MonEgyChrgnT_tSnsr1ErrVal_C MonEgyChrgnT_tSnsr1Max_C MonEgyChrgnT_tSnsr1Min_C MonEgyChrgnT_tSnsr2ErrVal_C MonEgyChrgnT_tSnsr2Max_C MonEgyChrgnT_tSnsr2Min_C /end DEF_CHARACTERISTIC
 /begin IN_MEASUREMENT MonEgyChrgnT_flgErrAdc MonEgyChrgnT_tDcChrgnIntkT1 MonEgyChrgnT_tDcChrgnIntkT2 Mo_stCplChk Mo_stMoC Mo_stMoCCpl /end IN_MEASUREMENT
 /begin OUT_MEASUREMENT MonEgyChrgnT_stSnsr1 MonEgyChrgnT_stSnsr2 MonEgyChrgnT_tSnsr1 MonEgyChrgnT_tSnsr2 /end OUT_MEASUREMENT
 /begin LOC_MEASUREMENT MonEgyChrgnTPlausSig_bbLoc1Cpl MonEgyChrgnTPlausSig_bbLoc2Cpl MonEgyChrgnTPlausSig_bbLoc3Cpl MonEgyChrgnT_cntrDebGrdtTSnsr1 MonEgyChrgnT_cntrDebGrdtTSnsr1Cpl MonEgyChrgnT_cntrDebGrdtTSnsr2 MonEgyChrgnT_cntrDebGrdtTSnsr2Cpl MonEgyChrgnT_cntrDebMaxTSnsr1 MonEgyChrgnT_cntrDebMaxTSnsr1Cpl MonEgyChrgnT_cntrDebMaxTSnsr2 MonEgyChrgnT_cntrDebMaxTSnsr2Cpl MonEgyChrgnT_cntrDebMinTSnsr1 MonEgyChrgnT_cntrDebMinTSnsr1Cpl MonEgyChrgnT_cntrDebMinTSnsr2 MonEgyChrgnT_cntrDebMinTSnsr2Cpl MonEgyChrgnT_cntrDifSnsr MonEgyChrgnT_cntrDifSnsrCpl MonEgyChrgnT_cntrIninPlausT MonEgyChrgnT_cntrIninPlausTCpl MonEgyChrgnT_flgErrGrdtSnsr1 MonEgyChrgnT_flgErrGrdtSnsr2 MonEgyChrgnT_flgErrMaxSnsr1 MonEgyChrgnT_flgErrMaxSnsr2 MonEgyChrgnT_flgErrMinSnsr1 MonEgyChrgnT_flgErrMinSnsr2 MonEgyChrgnT_flgErrRngSnsr1 MonEgyChrgnT_flgErrRngSnsr2 MonEgyChrgnT_flgErrSnsrDif MonEgyChrgnT_flgErrSnsrRng MonEgyChrgnT_flgTmpErrGrdtSnsr1 MonEgyChrgnT_flgTmpErrGrdtSnsr2 MonEgyChrgnT_flgTmpErrMaxSnsr1 MonEgyChrgnT_flgTmpErrMaxSnsr2 MonEgyChrgnT_flgTmpErrMinSnsr1 MonEgyChrgnT_flgTmpErrMinSnsr2 MonEgyChrgnT_flgTmpErrRngSnsr1 MonEgyChrgnT_flgTmpErrRngSnsr2 MonEgyChrgnT_flgTmpErrSnsrDif MonEgyChrgnT_flgTmpErrSnsrRng MonEgyChrgnT_stDebGrdtTSnsr1 MonEgyChrgnT_stDebGrdtTSnsr1Cpl MonEgyChrgnT_stDebGrdtTSnsr2 MonEgyChrgnT_stDebGrdtTSnsr2Cpl MonEgyChrgnT_stDebMaxTSnsr1 MonEgyChrgnT_stDebMaxTSnsr1Cpl MonEgyChrgnT_stDebMaxTSnsr2 MonEgyChrgnT_stDebMaxTSnsr2Cpl MonEgyChrgnT_stDebMinTSnsr1 MonEgyChrgnT_stDebMinTSnsr1Cpl MonEgyChrgnT_stDebMinTSnsr2 MonEgyChrgnT_stDebMinTSnsr2Cpl MonEgyChrgnT_stDifSnsr MonEgyChrgnT_stDifSnsrCpl MonEgyChrgnT_stSnsr1Cpl MonEgyChrgnT_stSnsr2Cpl MonEgyChrgnT_tGrdtFltLoSnsr1 MonEgyChrgnT_tGrdtFltLoSnsr1Cpl MonEgyChrgnT_tGrdtFltLoSnsr2 MonEgyChrgnT_tGrdtFltLoSnsr2Cpl MonEgyChrgnT_tGrdtFltSnsr1 MonEgyChrgnT_tGrdtFltSnsr1Cpl MonEgyChrgnT_tGrdtFltSnsr2 MonEgyChrgnT_tGrdtFltSnsr2Cpl MonEgyChrgnT_tSnsr1Cpl MonEgyChrgnT_tSnsr1Diff MonEgyChrgnT_tSnsr1DiffCpl MonEgyChrgnT_tSnsr2Cpl MonEgyChrgnT_tSnsr2Diff MonEgyChrgnT_tSnsr2DiffCpl /end LOC_MEASUREMENT
 FUNCTION_VERSION "1.1.0" /end FUNCTION
/begin FUNCTION MonEgyChrgnT_PreProc "1.1.0     Monitoring energy charging temperature sensors: Preprocessor"
 /begin DEF_CHARACTERISTIC MonEgyChrgnT_cntrTurnOffDlyNTP_C MonEgyChrgnT_tTrfSnsrDcChrgnIntk_T /end DEF_CHARACTERISTIC
 /begin IN_MEASUREMENT MoCADC_bDef MoCADC_bNTPActv MonEgyChrgnT_uRawDcChrgnIntkT1 MonEgyChrgnT_uRawDcChrgnIntkT2 Mo_stCplChk Mo_stMoC Mo_stMoCCpl /end IN_MEASUREMENT
 /begin OUT_MEASUREMENT MonEgyChrgnT_flgErrAdc MonEgyChrgnT_flgNTPDlyd MonEgyChrgnT_tDcChrgnIntkT1 MonEgyChrgnT_tDcChrgnIntkT2 /end OUT_MEASUREMENT
 /begin LOC_MEASUREMENT MonEgyChrgnTPreProc_bbOut1Cpl MonEgyChrgnT_cntrTurnOffDlyNTP MonEgyChrgnT_cntrTurnOffDlyNTPCpl MonEgyChrgnT_tDcChrgnIntkT1Cpl MonEgyChrgnT_tDcChrgnIntkT2Cpl /end LOC_MEASUREMENT
 FUNCTION_VERSION "1.1.0" /end FUNCTION
/begin COMPU_METHOD B_TRUE "" TAB_VERB "%6.3" "" COMPU_TAB_REF B_TRUE /end COMPU_METHOD
/begin COMPU_VTAB B_TRUE "" TAB_VERB 2 0 "FALSE" 1 "TRUE" /end COMPU_VTAB
/begin COMPU_METHOD DFC_OneToOne "" RAT_FUNC "%6.2" "-" COEFFS 0 1 0 0 0 1 /end COMPU_METHOD
/begin COMPU_METHOD DFES_OneToOne "" RAT_FUNC "%6.2" "-" COEFFS 0 1 0 0 0 1 /end COMPU_METHOD
/begin COMPU_METHOD MonEgyChrgnCoorr_stActChrgMod_VERB "" TAB_VERB "%6.3" "" COMPU_TAB_REF MonEgyChrgnCoorr_stActChrgMod_VERB /end COMPU_METHOD
/begin COMPU_VTAB MonEgyChrgnCoorr_stActChrgMod_VERB "" TAB_VERB 7 0 "CHRGNMOD_NO_CHRGN" 1 "CHRGNMOD_NOT_AVL" 2 "CHRGNMOD_CCS_AC" 3 "CHRGNMOD_CCS_DC" 4 "CHRGNMOD_CHADEMO" 5 "CHRGNMOD_CHINA_AC" 6 "CHRGNMOD_CHINA_DC" /end COMPU_VTAB
/begin COMPU_METHOD MonEgyChrgnCoorr_stChrgnCom_VERB "" TAB_VERB "%6.3" "" COMPU_TAB_REF MonEgyChrgnCoorr_stChrgnCom_VERB /end COMPU_METHOD
/begin COMPU_VTAB MonEgyChrgnCoorr_stChrgnCom_VERB "" TAB_VERB 4 0 "CHRGNCOM_ERR" 1 "CHRGNCOM_INI" 2 "CHRGNCOM_AVL" 3 "CHRGNCOM_NOT_AVL" /end COMPU_VTAB
/begin COMPU_METHOD MonEgyChrgnCoorr_stChrgn_VERB "" TAB_VERB "%6.3" "" COMPU_TAB_REF MonEgyChrgnCoorr_stChrgn_VERB /end COMPU_METHOD
/begin COMPU_VTAB MonEgyChrgnCoorr_stChrgn_VERB "" TAB_VERB 3 0 "CHRGN_PROHB" 1 "CHRGN_PTD" 2 "CHRGN_ABORT" /end COMPU_VTAB
/begin COMPU_METHOD MonEgyChrgnCoorr_stDrvRdn_VERB "" TAB_VERB "%6.3" "" COMPU_TAB_REF MonEgyChrgnCoorr_stDrvRdn_VERB /end COMPU_METHOD
/begin COMPU_VTAB MonEgyChrgnCoorr_stDrvRdn_VERB "" TAB_VERB 2 0 "DRVGRDN_PROHB" 1 "DRVGRDN_PTD" /end COMPU_VTAB
/begin COMPU_METHOD MonEgyChrgnCoorr_stUnlckPlgLockPtd_VERB "" TAB_VERB "%6.3" "" COMPU_TAB_REF MonEgyChrgnCoorr_stUnlckPlgLockPtd_VERB /end COMPU_METHOD
/begin COMPU_VTAB MonEgyChrgnCoorr_stUnlckPlgLockPtd_VERB "" TAB_VERB 2 0 "CHRGNPLGLOCK_RELS_PROHB" 1 "CHRGNPLGLOCK_RELS_PTD" /end COMPU_VTAB
/begin COMPU_METHOD MonEgyChrgnInlet_stCcsChrgPlg_VERB "" TAB_VERB "%6.3" "" COMPU_TAB_REF MonEgyChrgnInlet_stCcsChrgPlg_VERB /end COMPU_METHOD
/begin COMPU_VTAB MonEgyChrgnInlet_stCcsChrgPlg_VERB "" TAB_VERB 5 0 "CHRGNPLG_INI" 1 "CHRGNPLG_UNPLGD" 2 "CHRGNPLG_DETD" 3 "CHRGNPLG_PLGD" 4 "CHRGNPLG_ERR" /end COMPU_VTAB
/begin COMPU_METHOD MonEgyChrgnInlet_stCcsPlgLock_VERB "" TAB_VERB "%6.3" "" COMPU_TAB_REF MonEgyChrgnInlet_stCcsPlgLock_VERB /end COMPU_METHOD
/begin COMPU_VTAB MonEgyChrgnInlet_stCcsPlgLock_VERB "" TAB_VERB 4 0 "CHRGNPLGLOCK_INI" 1 "CHRGNPLGLOCK_UNLCKD" 2 "CHRGNPLGLOCK_LCKD" 3 "CHRGNPLGLOCK_ERR" /end COMPU_VTAB
/begin COMPU_METHOD MonEgyChrgnInlet_stChrgPlg_VERB "" TAB_VERB "%6.3" "" COMPU_TAB_REF MonEgyChrgnInlet_stChrgPlg_VERB /end COMPU_METHOD
/begin COMPU_VTAB MonEgyChrgnInlet_stChrgPlg_VERB "" TAB_VERB 6 0 "CHRGNPLG_INI" 1 "CHRGNPLG_UNPLGD" 2 "CHRGNPLG_DETD" 3 "CHRGNPLG_PLGD" 4 "CHRGNPLG_ERR" 5 "CHRGNPLG_MPL_PLGD" /end COMPU_VTAB
/begin COMPU_METHOD MonEgyChrgnInlet_stPlgPlt_VERB "" TAB_VERB "%6.3" "" COMPU_TAB_REF MonEgyChrgnInlet_stPlgPlt_VERB /end COMPU_METHOD
/begin COMPU_VTAB MonEgyChrgnInlet_stPlgPlt_VERB "" TAB_VERB 4 0 "PLGPLT_INI" 1 "PLGPLT_UNPLGD" 2 "PLGPLT_PLGD" 3 "PLGPLT_ERR" /end COMPU_VTAB
/begin COMPU_METHOD OneToOne "" RAT_FUNC "%6.2" "-" COEFFS 0 1 0 0 0 1 /end COMPU_METHOD
/begin COMPU_METHOD PRC "" RAT_FUNC "%6.4" "%" COEFFS 0 81.92 0 0 0 1 /end COMPU_METHOD
/begin COMPU_METHOD q1Em6_s "" RAT_FUNC "%9.8" "s" COEFFS 0 1000000 0 0 0 1 /end COMPU_METHOD
/begin COMPU_METHOD RBPtCel_i_1p0_1 "" RAT_FUNC "%6.2" "mA" COEFFS 0 1 0 0 0 1 /end COMPU_METHOD
/begin COMPU_METHOD RBPtCel_Perc_0p01_1 "" RAT_FUNC "%6.4" "%" COEFFS 0 100 0 0 0 1 /end COMPU_METHOD
/begin COMPU_METHOD RBPtCel_p_1p0_2 "" RAT_FUNC "%6.2" "Bar" COEFFS 0 1 0 0 0 1 /end COMPU_METHOD
/begin COMPU_METHOD RBPtCel_t_0p1_3 "" RAT_FUNC "%6.3" "Deg C" COEFFS 0 10 0 0 0 1 /end COMPU_METHOD
/begin COMPU_METHOD RBPtCel_u_0p1_1 "" RAT_FUNC "%6.3" "V" COEFFS 0 10 0 0 0 1 /end COMPU_METHOD
/begin COMPU_METHOD RBPtCel_vf_1p0_2 "" RAT_FUNC "%6.2" "l/min" COEFFS 0 1 0 0 0 1 /end COMPU_METHOD
/begin COMPU_METHOD RBPtCel_v_1p0_1 "" RAT_FUNC "%6.2" "km/h" COEFFS 0 1 0 0 0 1 /end COMPU_METHOD
/begin COMPU_METHOD Resist "" RAT_FUNC "%6.3" "Ohm" COEFFS 0 10 0 0 0 1 /end COMPU_METHOD
/begin COMPU_METHOD ResPerMass_hPaHrPerCM "" RAT_FUNC "%7.6" "(hPa(m^3/h))/g" COEFFS 0 10000 0 0 0 1 /end COMPU_METHOD
/begin COMPU_METHOD Res_hPaHrPerCM "" RAT_FUNC "%7.6" "hPa/(m^3/h)" COEFFS 0 10000 0 0 0 1 /end COMPU_METHOD
/begin COMPU_METHOD Res_hPaSPerCM "" RAT_FUNC "%6.5" "hPa/(m^3*s/h)" COEFFS 0 1000 0 0 0 1 /end COMPU_METHOD
/begin COMPU_METHOD ReynoldsNum "" RAT_FUNC "%6.0" "-" COEFFS 0 0.01 0 0 0 1 /end COMPU_METHOD
/begin COMPU_METHOD ReynoldsNum1 "" RAT_FUNC "%7.0" "-" COEFFS 0 0.001 0 0 0 1 /end COMPU_METHOD
/begin COMPU_METHOD RhoFuel "" RAT_FUNC "%6.3" "kg/m^3" COEFFS 0 10 0 0 0 1 /end COMPU_METHOD
/begin COMPU_METHOD rhoOilAsh_g_p_l "" RAT_FUNC "%6.3" "g/l" COEFFS 0 10 0 0 0 1 /end COMPU_METHOD
/begin COMPU_METHOD Rho_q0p001_COMPU "" RAT_FUNC "%6.5" "Kg/m^3" COEFFS 0 1000 0 0 0 1 /end COMPU_METHOD
/begin COMPU_METHOD RHUSTGYPRS_SY_Compu "" TAB_VERB "%6.3" "" COMPU_TAB_REF RHUSTGYPRS_SY_Compu /end COMPU_METHOD
/begin COMPU_VTAB RHUSTGYPRS_SY_Compu "" TAB_VERB 2 0 "False" 1 "True" /end COMPU_VTAB
/begin COMPU_METHOD Rmp "" RAT_FUNC "%6.4" "1/s" COEFFS 0 65.536 0 0 0 1 /end COMPU_METHOD
/begin COMPU_METHOD RmpDtyCyc "" RAT_FUNC "%6.5" "%/s" COEFFS 0 6553.6 0 0 0 1 /end COMPU_METHOD
/begin COMPU_METHOD Rmp_1 "" RAT_FUNC "%6.5" "1/s" COEFFS 0 1000 0 0 0 1 /end COMPU_METHOD
/begin COMPU_METHOD RMTAPP_ENBL_SY_Compu "" TAB_VERB "%6.3" "" COMPU_TAB_REF RMTAPP_ENBL_SY_Compu /end COMPU_METHOD
/begin COMPU_VTAB RMTAPP_ENBL_SY_Compu "" TAB_VERB 2 0 "False" 1 "True" /end COMPU_VTAB
/begin COMPU_METHOD SCRM_kg_q0p001_COMPU "" RAT_FUNC "%6.5" "kg" COEFFS 0 1000 0 0 0 1 /end COMPU_METHOD
/begin COMPU_METHOD SCR_DmStp0001 "" RAT_FUNC "%6.5" "mg/Step" COEFFS 0 1000 0 0 0 1 /end COMPU_METHOD
/begin COMPU_METHOD SCR_kPa_10 "" RAT_FUNC "%6.1" "kPa" COEFFS 0 0.1 0 0 0 1 /end COMPU_METHOD
/begin COMPU_METHOD SCR_kPa_100 "" RAT_FUNC "%6.0" "kPa" COEFFS 0 0.01 0 0 0 1 /end COMPU_METHOD
/begin COMPU_METHOD SCR_Volt_q0p0001227 "" RAT_FUNC "%6.5" "V" COEFFS 0 8192 0 0 0 1 /end COMPU_METHOD
/begin COMPU_METHOD SCTPMP1T_TYPAVL_SY_Compu "" TAB_VERB "%6.3" "" COMPU_TAB_REF SCTPMP1T_TYPAVL_SY_Compu /end COMPU_METHOD
/begin COMPU_VTAB SCTPMP1T_TYPAVL_SY_Compu "" TAB_VERB 2 0 "False" 1 "True" /end COMPU_VTAB
/begin COMPU_METHOD SCTPMP1_TYPAVL_SY_Compu "" TAB_VERB "%6.3" "" COMPU_TAB_REF SCTPMP1_TYPAVL_SY_Compu /end COMPU_METHOD
/begin COMPU_VTAB SCTPMP1_TYPAVL_SY_Compu "" TAB_VERB 2 0 "False" 1 "True" /end COMPU_VTAB
/begin COMPU_METHOD SCTPMPRLY_TYPAVL_SC_Compu "" TAB_VERB "%6.3" "" COMPU_TAB_REF SCTPMPRLY_TYPAVL_SC_Compu /end COMPU_METHOD
/begin COMPU_VTAB SCTPMPRLY_TYPAVL_SC_Compu "" TAB_VERB 2 0 "False" 1 "True" /end COMPU_VTAB
/begin COMPU_METHOD SD_SC_Compu "" TAB_VERB "%6.3" "" COMPU_TAB_REF SD_SC_Compu /end COMPU_METHOD
/begin COMPU_VTAB SD_SC_Compu "" TAB_VERB 2 0 "INACTIVE" 1 "ACTIVE" /end COMPU_VTAB
/begin COMPU_METHOD spg_q0p0012207_V "" RAT_FUNC "%6.4" "V" COEFFS 0 65536 0 0 0 80 /end COMPU_METHOD
/begin COMPU_METHOD spg_q0p00488 "" RAT_FUNC "%6.4" "V" COEFFS 0 1024 0 0 0 5 /end COMPU_METHOD
/begin COMPU_METHOD t_q5Em8_s "" RAT_FUNC "%10.9" "s" COEFFS 0 20000000 0 0 0 1 /end COMPU_METHOD
/begin COMPU_METHOD Vel "" RAT_FUNC "%6.4" "km/h" COEFFS 0 100 0 0 0 1 /end COMPU_METHOD
/begin COMPU_METHOD zk10msxs_uw_b655p36PT1 "" RAT_FUNC "%6.2" "s" COEFFS 0 0 65536 0 100 1 /end COMPU_METHOD
/begin RECORD_LAYOUT Mo_DataCurveSstS16WS16 NO_AXIS_PTS_X 1 SWORD AXIS_PTS_X 2 SWORD INDEX_INCR DIRECT FNC_VALUES 3 SWORD COLUMN_DIR DIRECT /end RECORD_LAYOUT
/begin RECORD_LAYOUT Val_Ws16 FNC_VALUES 1 SWORD COLUMN_DIR DIRECT /end RECORD_LAYOUT
/begin RECORD_LAYOUT Val_Wu16 FNC_VALUES 1 UWORD COLUMN_DIR DIRECT /end RECORD_LAYOUT
/begin RECORD_LAYOUT Val_Wu32 FNC_VALUES 1 ULONG COLUMN_DIR DIRECT /end RECORD_LAYOUT
/begin RECORD_LAYOUT Val_Wu8 FNC_VALUES 1 UBYTE COLUMN_DIR DIRECT /end RECORD_LAYOUT
/end MODULE
/end PROJECT

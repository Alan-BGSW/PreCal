ASAP2_VERSION 1 70
/begin PROJECT MDG1C "VC1CP091_STLA_N_D061I3"
/begin HEADER "" VERSION "VC1CP091_STLA_N_D061I3" PROJECT_NO MDG1C /end HEADER
/begin MODULE DIM ""
/begin MOD_COMMON "" BYTE_ORDER MSB_LAST ALIGNMENT_BYTE 1 ALIGNMENT_WORD 2 ALIGNMENT_LONG 4 ALIGNMENT_INT64 4 ALIGNMENT_FLOAT32_IEEE 4 ALIGNMENT_FLOAT64_IEEE 4 DATA_SIZE 32 /end MOD_COMMON
/begin CHARACTERISTIC ElM_stDesEem02_C "Calibration for ElM_stDesEem02 (Desired state of inverter and e-machine 02)" VALUE 0x8026CEFC Val_Wu8 255.0 OneToOne 0.00 255.0 FORMAT "%5.1" /end CHARACTERISTIC
/begin CHARACTERISTIC MoFDrvrAssc_flgAccActv_C "Calibration for MoFDrvrAssc_flgAccActv" VALUE 0x8026CEFD Val_Wu8 1.00000000000 B_TRUE 0.00 1.00000000000 FORMAT "%13.11" /end CHARACTERISTIC
/begin CHARACTERISTIC MoFDrvrAssc_flgDrvrAsscActv_C "Driver Assistance active" VALUE 0x8026CEFE Val_Wu8 1.00000000000 B_TRUE 0.00 1.00000000000 FORMAT "%13.11" /end CHARACTERISTIC
/begin CHARACTERISTIC MoFDrvrAssc_flgNeutRampActv_C "calibration label to indicate neutral gear ramp active" VALUE 0x8026CEFF Val_Wu8 1.00000000000 B_TRUE 0.00 1.00000000000 FORMAT "%13.11" /end CHARACTERISTIC
/begin CHARACTERISTIC MoFDrvrAssc_stAdasOvrd_C "Driver Assistance ADAS Overriden state" VALUE 0x8026CF00 Val_Wu8 255.0 OneToOne 0.00 255.0 FORMAT "%5.1" /end CHARACTERISTIC
/begin CHARACTERISTIC MoFDrvrAssc_tqDrvrAssc_C "Driver Assistence Torque" VALUE 0x8026D124 Val_Ws32 429496729.500 TrqPrpHigh -214748364.800 214748364.700 FORMAT "%13.3" /end CHARACTERISTIC
/begin CHARACTERISTIC MoFEvMngt_flgEmgyShtActvDft_C "MoFEvMngt_flgEmgyShtActvDft_C" VALUE 0x8026CEF4 Val_Wu8 255.0 OneToOne 0.00 255.0 FORMAT "%5.1" /end CHARACTERISTIC
/begin CHARACTERISTIC MoFEvMngt_stDcdcModReqDft_C "MoFEvMngt_stDcdcModReqDft_C" VALUE 0x8026CEF5 Val_Wu8 255.0 OneToOne 0.00 255.0 FORMAT "%5.1" /end CHARACTERISTIC
/begin CHARACTERISTIC MoFEvMngt_stDesEem01Dft_C "MoFEvMngt_stDesEem01Dft_C" VALUE 0x8026CEF6 Val_Wu8 255.0 OneToOne 0.00 255.0 FORMAT "%5.1" /end CHARACTERISTIC
/begin CHARACTERISTIC MoFEvMngt_stElMDesEemDft_C "MoFEvMngt_stElMDesEemDft_C" VALUE 0x8026CEF7 Val_Wu8 255.0 OneToOne 0.00 255.0 FORMAT "%5.1" /end CHARACTERISTIC
/begin CHARACTERISTIC MoFEvMngt_stOperModDesDft_C "MoFEvMngt_stOperModDesDft_C" VALUE 0x8026CEF8 Val_Wu8 255.0 OneToOne 0.00 255.0 FORMAT "%5.1" /end CHARACTERISTIC
/begin CHARACTERISTIC MoFExtCpt_stBrkBstPFltDft_C "MoFExtCpt_stBrkBstPFltDft_C" VALUE 0x8026CEF9 Val_Wu8 255.0 OneToOne 0.00 255.0 FORMAT "%5.1" /end CHARACTERISTIC
/begin CHARACTERISTIC MoFExtCpt_stMstWrnLmpDft_C "MoFExtCpt_stMstWrnLmpDft_C" VALUE 0x8026CEFA Val_Wu8 255.0 OneToOne 0.00 255.0 FORMAT "%5.1" /end CHARACTERISTIC
/begin CHARACTERISTIC MoFFrm_DataNetInfoSigRx_DCDC_FAULT_LEVEL.sigLen_C "Data PDu Structure for DCDC_FAULT_LEVEL / signal length (bits)" VALUE 0x80270234 Val_Wu8 31.00 OneToOne 1.00 32.00 FORMAT "%5.2" EXTENDED_LIMITS 0.00 255.0 /end CHARACTERISTIC
/begin CHARACTERISTIC MoFFrm_DataNetInfoSigRx_DCDC_IN_VOLTAGE.bytOrder_C " / Signal byte order" VALUE 0x80270236 Val_Wu8 1.000 OneToOne 0.00 1.000 FORMAT "%5.3" EXTENDED_LIMITS 0.00 255.0 /end CHARACTERISTIC
/begin CHARACTERISTIC MoFFrm_DataNetInfoSigRx_DCDC_IN_VOLTAGE.posnStrtBit_C " / signal start bit position" VALUE 0x80270238 Val_Wu16 65535.00 OneToOne 0.00 65535.00 FORMAT "%8.2" /end CHARACTERISTIC
/begin CHARACTERISTIC MoFFrm_DataNetInfoSigRx_DCDC_IN_VOLTAGE.sigLen_C " / signal length (bits)" VALUE 0x8027023A Val_Wu8 31.00 OneToOne 1.00 32.00 FORMAT "%5.2" EXTENDED_LIMITS 0.00 255.0 /end CHARACTERISTIC
/begin CHARACTERISTIC MoFFrm_DataNetInfoSigRx_DRIVER_DOOR_INFO.bytOrder_C "Data PDu Structure for DRIVER_DOOR_INFO / Signal byte order" VALUE 0x8027023C Val_Wu8 1.000 OneToOne 0.00 1.000 FORMAT "%5.3" EXTENDED_LIMITS 0.00 255.0 /end CHARACTERISTIC
/begin CHARACTERISTIC MoFFrm_DataNetInfoSigRx_DRIVER_DOOR_INFO.posnStrtBit_C "Data PDu Structure for DRIVER_DOOR_INFO / signal start bit position" VALUE 0x8027023E Val_Wu16 65535.00 OneToOne 0.00 65535.00 FORMAT "%8.2" /end CHARACTERISTIC
/begin CHARACTERISTIC MoFFrm_DataNetInfoSigRx_DRIVER_DOOR_INFO.sigLen_C "Data PDu Structure for DRIVER_DOOR_INFO / signal length (bits)" VALUE 0x80270240 Val_Wu8 31.00 OneToOne 1.00 32.00 FORMAT "%5.2" EXTENDED_LIMITS 0.00 255.0 /end CHARACTERISTIC
/begin CHARACTERISTIC MoFFrm_DataNetInfoSigRx_DRV_INFO_DRVR_SEAT_BELT.bytOrder_C "Data PDu Structure for DRV_INFO_DRVR_SEAT_BELT / Signal byte order" VALUE 0x80270242 Val_Wu8 1.000 OneToOne 0.00 1.000 FORMAT "%5.3" EXTENDED_LIMITS 0.00 255.0 /end CHARACTERISTIC
/begin CHARACTERISTIC MoFFrm_DataNetInfoSigRx_DRV_INFO_DRVR_SEAT_BELT.posnStrtBit_C "Data PDu Structure for DRV_INFO_DRVR_SEAT_BELT / signal start bit position" VALUE 0x80270244 Val_Wu16 65535.00 OneToOne 0.00 65535.00 FORMAT "%8.2" /end CHARACTERISTIC
/begin CHARACTERISTIC MoFFrm_DataNetInfoSigRx_DRV_INFO_DRVR_SEAT_BELT.sigLen_C "Data PDu Structure for DRV_INFO_DRVR_SEAT_BELT / signal length (bits)" VALUE 0x80270246 Val_Wu8 31.00 OneToOne 1.00 32.00 FORMAT "%5.2" EXTENDED_LIMITS 0.00 255.0 /end CHARACTERISTIC
/begin CHARACTERISTIC MoFFrm_DataNetInfoSigRx_HVBAT_CONNECT_STS.bytOrder_C "HVBAT_CONNECT_STS / Signal byte order" VALUE 0x80270248 Val_Wu8 1.000 OneToOne 0.00 1.000 FORMAT "%5.3" EXTENDED_LIMITS 0.00 255.0 /end CHARACTERISTIC
/begin CHARACTERISTIC MoFFrm_DataNetInfoSigRx_HVBAT_CONNECT_STS.posnStrtBit_C "HVBAT_CONNECT_STS / signal start bit position" VALUE 0x8027024A Val_Wu16 65535.00 OneToOne 0.00 65535.00 FORMAT "%8.2" /end CHARACTERISTIC
/begin CHARACTERISTIC MoFFrm_DataNetInfoSigRx_HVBAT_CONNECT_STS.sigLen_C "HVBAT_CONNECT_STS / signal length (bits)" VALUE 0x8027024C Val_Wu8 31.00 OneToOne 1.00 32.00 FORMAT "%5.2" EXTENDED_LIMITS 0.00 255.0 /end CHARACTERISTIC
/begin CHARACTERISTIC MoFFrm_DataNetInfoSigRx_HVBAT_FAULT.bytOrder_C "HVBAT_FAULT / Signal byte order" VALUE 0x8027024E Val_Wu8 1.000 OneToOne 0.00 1.000 FORMAT "%5.3" EXTENDED_LIMITS 0.00 255.0 /end CHARACTERISTIC
/begin CHARACTERISTIC MoFFrm_DataNetInfoSigRx_HVBAT_FAULT.posnStrtBit_C "HVBAT_FAULT / signal start bit position" VALUE 0x80270250 Val_Wu16 65535.00 OneToOne 0.00 65535.00 FORMAT "%8.2" /end CHARACTERISTIC
/begin CHARACTERISTIC MoFFrm_DataNetInfoSigRx_HVBAT_FAULT.sigLen_C "HVBAT_FAULT / signal length (bits)" VALUE 0x80270252 Val_Wu8 31.00 OneToOne 1.00 32.00 FORMAT "%5.2" EXTENDED_LIMITS 0.00 255.0 /end CHARACTERISTIC
/begin CHARACTERISTIC MoFFrm_DataNetInfoSigRx_HVBAT_HVIL_STS.bytOrder_C "Data PDu Structure for HVBAT_HVIL_STS / Signal byte order" VALUE 0x80270254 Val_Wu8 1.000 OneToOne 0.00 1.000 FORMAT "%5.3" EXTENDED_LIMITS 0.00 255.0 /end CHARACTERISTIC
/begin CHARACTERISTIC MoFFrm_DataNetInfoSigRx_HVBAT_HVIL_STS.posnStrtBit_C "Data PDu Structure for HVBAT_HVIL_STS / signal start bit position" VALUE 0x80270256 Val_Wu16 65535.00 OneToOne 0.00 65535.00 FORMAT "%8.2" /end CHARACTERISTIC
/begin CHARACTERISTIC MoFFrm_DataNetInfoSigRx_HVBAT_HVIL_STS.sigLen_C "Data PDu Structure for HVBAT_HVIL_STS / signal length (bits)" VALUE 0x80270258 Val_Wu8 31.00 OneToOne 1.00 32.00 FORMAT "%5.2" EXTENDED_LIMITS 0.00 255.0 /end CHARACTERISTIC
/begin CHARACTERISTIC MoFFrm_DataNetInfoSigRx_INV_DC_BUS_VOLTAGE.bytOrder_C " / Signal byte order" VALUE 0x8027025A Val_Wu8 1.000 OneToOne 0.00 1.000 FORMAT "%5.3" EXTENDED_LIMITS 0.00 255.0 /end CHARACTERISTIC
/begin CHARACTERISTIC MoFFrm_DataNetInfoSigRx_INV_DC_BUS_VOLTAGE.posnStrtBit_C " / signal start bit position" VALUE 0x8027025C Val_Wu16 65535.00 OneToOne 0.00 65535.00 FORMAT "%8.2" /end CHARACTERISTIC
/begin CHARACTERISTIC MoFFrm_DataNetInfoSigRx_INV_DC_BUS_VOLTAGE.sigLen_C " / signal length (bits)" VALUE 0x8027025E Val_Wu8 31.00 OneToOne 1.00 32.00 FORMAT "%5.2" EXTENDED_LIMITS 0.00 255.0 /end CHARACTERISTIC
/begin CHARACTERISTIC MoFFrm_DataNetInfoSigRx_INV_FAULT_LEVEL.bytOrder_C "Structure instance of signal INV_FAULT_LEVEL;MoFFrm_Lib_DataNetInfoSig / Signal byte order" VALUE 0x80270260 Val_Wu8 1.000 OneToOne 0.00 1.000 FORMAT "%5.3" EXTENDED_LIMITS 0.00 255.0 /end CHARACTERISTIC
/begin CHARACTERISTIC MoFFrm_DataNetInfoSigRx_INV_FAULT_LEVEL.posnStrtBit_C "Structure instance of signal INV_FAULT_LEVEL;MoFFrm_Lib_DataNetInfoSig / signal start bit position" VALUE 0x80270262 Val_Wu16 65535.00 OneToOne 0.00 65535.00 FORMAT "%8.2" /end CHARACTERISTIC
/begin CHARACTERISTIC MoFFrm_DataNetInfoSigRx_INV_FAULT_LEVEL.sigLen_C "Structure instance of signal INV_FAULT_LEVEL;MoFFrm_Lib_DataNetInfoSig / signal length (bits)" VALUE 0x80270264 Val_Wu8 31.00 OneToOne 1.00 32.00 FORMAT "%5.2" EXTENDED_LIMITS 0.00 255.0 /end CHARACTERISTIC
/begin CHARACTERISTIC MoFFrm_DataNetInfoSigRx_INV_HILLHOLD_STATUS.bytOrder_C "Data PDu Structure for INV_HILLHOLD_STATUS / Signal byte order" VALUE 0x80270266 Val_Wu8 1.000 OneToOne 0.00 1.000 FORMAT "%5.3" EXTENDED_LIMITS 0.00 255.0 /end CHARACTERISTIC
/begin CHARACTERISTIC MoFFrm_DataNetInfoSigRx_INV_HILLHOLD_STATUS.posnStrtBit_C "Data PDu Structure for INV_HILLHOLD_STATUS / signal start bit position" VALUE 0x80270268 Val_Wu16 65535.00 OneToOne 0.00 65535.00 FORMAT "%8.2" /end CHARACTERISTIC
/begin CHARACTERISTIC MoFFrm_DataNetInfoSigRx_INV_HILLHOLD_STATUS.sigLen_C "Data PDu Structure for INV_HILLHOLD_STATUS / signal length (bits)" VALUE 0x8027026A Val_Wu8 31.00 OneToOne 1.00 32.00 FORMAT "%5.2" EXTENDED_LIMITS 0.00 255.0 /end CHARACTERISTIC
/begin CHARACTERISTIC MoFFrm_DataNetInfoSigRx_INV_MTR_ACTUAL_TRQ.bytOrder_C "Data PDu Structure for INV_MTR_ACTUAL_TRQ / Signal byte order" VALUE 0x8027026C Val_Wu8 1.000 OneToOne 0.00 1.000 FORMAT "%5.3" EXTENDED_LIMITS 0.00 255.0 /end CHARACTERISTIC
/begin CHARACTERISTIC MoFFrm_DataNetInfoSigRx_INV_MTR_ACTUAL_TRQ.posnStrtBit_C "Data PDu Structure for INV_MTR_ACTUAL_TRQ / signal start bit position" VALUE 0x8027026E Val_Wu16 65535.00 OneToOne 0.00 65535.00 FORMAT "%8.2" /end CHARACTERISTIC
/begin CHARACTERISTIC MoFFrm_DataNetInfoSigRx_INV_MTR_ACTUAL_TRQ.sigLen_C "Data PDu Structure for INV_MTR_ACTUAL_TRQ / signal length (bits)" VALUE 0x80270270 Val_Wu8 31.00 OneToOne 1.00 32.00 FORMAT "%5.2" EXTENDED_LIMITS 0.00 255.0 /end CHARACTERISTIC
/begin CHARACTERISTIC MoFFrm_DataNetInfoSigRx_INV_MTR_SPEED.bytOrder_C "Data PDu Structure for INV_MTR_SPEED / Signal byte order" VALUE 0x80270272 Val_Wu8 1.000 OneToOne 0.00 1.000 FORMAT "%5.3" EXTENDED_LIMITS 0.00 255.0 /end CHARACTERISTIC
/begin CHARACTERISTIC MoFFrm_DataNetInfoSigRx_INV_MTR_SPEED.posnStrtBit_C "Data PDu Structure for INV_MTR_SPEED / signal start bit position" VALUE 0x80270274 Val_Wu16 65535.00 OneToOne 0.00 65535.00 FORMAT "%8.2" /end CHARACTERISTIC
/begin CHARACTERISTIC MoFFrm_DataNetInfoSigRx_INV_MTR_SPEED.sigLen_C "Data PDu Structure for INV_MTR_SPEED / signal length (bits)" VALUE 0x80270276 Val_Wu8 31.00 OneToOne 1.00 32.00 FORMAT "%5.2" EXTENDED_LIMITS 0.00 255.0 /end CHARACTERISTIC
/begin CHARACTERISTIC MoFFrm_DataNetInfoSigRx_INV_OP_MODE.bytOrder_C "Data PDu Structure for INV_OP_MODE / Signal byte order" VALUE 0x80270278 Val_Wu8 1.000 OneToOne 0.00 1.000 FORMAT "%5.3" EXTENDED_LIMITS 0.00 255.0 /end CHARACTERISTIC
/begin CHARACTERISTIC MoFFrm_DataNetInfoSigRx_INV_OP_MODE.posnStrtBit_C "Data PDu Structure for INV_OP_MODE / signal start bit position" VALUE 0x8027027A Val_Wu16 65535.00 OneToOne 0.00 65535.00 FORMAT "%8.2" /end CHARACTERISTIC
/begin CHARACTERISTIC MoFFrm_DataNetInfoSigRx_INV_OP_MODE.sigLen_C "Data PDu Structure for INV_OP_MODE / signal length (bits)" VALUE 0x8027027C Val_Wu8 31.00 OneToOne 1.00 32.00 FORMAT "%5.2" EXTENDED_LIMITS 0.00 255.0 /end CHARACTERISTIC
/begin CHARACTERISTIC MoFFrm_DataNetInfoSigRx_PDU_FlgUBus_ActErr.bytOrder_C "CRASH_AIRBAG_COMPLI data / Signal byte order" VALUE 0x8027027E Val_Wu8 1.000 OneToOne 0.00 1.000 FORMAT "%5.3" EXTENDED_LIMITS 0.00 255.0 /end CHARACTERISTIC
/begin CHARACTERISTIC MoFFrm_DataNetInfoSigRx_PDU_FlgUBus_ActErr.posnStrtBit_C "CRASH_AIRBAG_COMPLI data / signal start bit position" VALUE 0x80270280 Val_Wu16 65535.00 OneToOne 0.00 65535.00 FORMAT "%8.2" /end CHARACTERISTIC
/begin CHARACTERISTIC MoFFrm_DataNetInfoSigRx_PDU_FlgUBus_ActErr.sigLen_C "CRASH_AIRBAG_COMPLI data / signal length (bits)" VALUE 0x80270282 Val_Wu8 31.00 OneToOne 1.00 32.00 FORMAT "%5.2" EXTENDED_LIMITS 0.00 255.0 /end CHARACTERISTIC
/begin CHARACTERISTIC MoFFrm_DataNetInfoSigRx_PDU_FlgUBus_OnceErr.bytOrder_C "DU_FlgUBus_OnceErr data / Signal byte order" VALUE 0x80270284 Val_Wu8 1.000 OneToOne 0.00 1.000 FORMAT "%5.3" EXTENDED_LIMITS 0.00 255.0 /end CHARACTERISTIC
/begin CHARACTERISTIC MoFFrm_DataNetInfoSigRx_PDU_FlgUBus_OnceErr.posnStrtBit_C "DU_FlgUBus_OnceErr data / signal start bit position" VALUE 0x80270286 Val_Wu16 65535.00 OneToOne 0.00 65535.00 FORMAT "%8.2" /end CHARACTERISTIC
/begin CHARACTERISTIC MoFFrm_DataNetInfoSigRx_PDU_FlgUBus_OnceErr.sigLen_C "DU_FlgUBus_OnceErr data / signal length (bits)" VALUE 0x80270288 Val_Wu8 31.00 OneToOne 1.00 32.00 FORMAT "%5.2" EXTENDED_LIMITS 0.00 255.0 /end CHARACTERISTIC
/begin CHARACTERISTIC MoFFrm_DataNetInfoSigRx_PDU_FlgUBus_Reliable.bytOrder_C "PDU_FlgUBus_Reliable data / Signal byte order" VALUE 0x8027028A Val_Wu8 1.000 OneToOne 0.00 1.000 FORMAT "%5.3" EXTENDED_LIMITS 0.00 255.0 /end CHARACTERISTIC
/begin CHARACTERISTIC MoFFrm_DataNetInfoSigRx_PDU_FlgUBus_Reliable.posnStrtBit_C "PDU_FlgUBus_Reliable data / signal start bit position" VALUE 0x8027028C Val_Wu16 65535.00 OneToOne 0.00 65535.00 FORMAT "%8.2" /end CHARACTERISTIC
/begin CHARACTERISTIC MoFFrm_DataNetInfoSigRx_PDU_FlgUBus_Reliable.sigLen_C "PDU_FlgUBus_Reliable data / signal length (bits)" VALUE 0x8027028E Val_Wu8 31.00 OneToOne 1.00 32.00 FORMAT "%5.2" EXTENDED_LIMITS 0.00 255.0 /end CHARACTERISTIC
/begin CHARACTERISTIC MoFFrm_DataNetInfoSigRx_PDU_FlgUBus_SysErr.bytOrder_C "DU_FlgUBus_SysErr data / Signal byte order" VALUE 0x80270290 Val_Wu8 1.000 OneToOne 0.00 1.000 FORMAT "%5.3" EXTENDED_LIMITS 0.00 255.0 /end CHARACTERISTIC
/begin CHARACTERISTIC MoFFrm_DataNetInfoSigRx_PDU_FlgUBus_SysErr.posnStrtBit_C "DU_FlgUBus_SysErr data / signal start bit position" VALUE 0x80270292 Val_Wu16 65535.00 OneToOne 0.00 65535.00 FORMAT "%8.2" /end CHARACTERISTIC
/begin CHARACTERISTIC MoFFrm_DataNetInfoSigRx_PDU_FlgUBus_SysErr.sigLen_C "DU_FlgUBus_SysErr data / signal length (bits)" VALUE 0x80270294 Val_Wu8 31.00 OneToOne 1.00 32.00 FORMAT "%5.2" EXTENDED_LIMITS 0.00 255.0 /end CHARACTERISTIC
/begin CHARACTERISTIC MoFFrm_DataNetInfoSigRx_PDU_UBus_V.bytOrder_C "Data PDu Structure for PDU_UBus_V / Signal byte order" VALUE 0x80270296 Val_Wu8 1.000 OneToOne 0.00 1.000 FORMAT "%5.3" EXTENDED_LIMITS 0.00 255.0 /end CHARACTERISTIC
/begin CHARACTERISTIC MoFFrm_DataNetInfoSigRx_PDU_UBus_V.posnStrtBit_C "Data PDu Structure for PDU_UBus_V / signal start bit position" VALUE 0x80270298 Val_Wu16 65535.00 OneToOne 0.00 65535.00 FORMAT "%8.2" /end CHARACTERISTIC
/begin CHARACTERISTIC MoFFrm_DataNetInfoSigRx_PDU_UBus_V.sigLen_C "Data PDu Structure for PDU_UBus_V / signal length (bits)" VALUE 0x8027029A Val_Wu8 31.00 OneToOne 1.00 32.00 FORMAT "%5.2" EXTENDED_LIMITS 0.00 255.0 /end CHARACTERISTIC
/begin CHARACTERISTIC MoFFrm_DataNetInfoSigRx_PRECOND_ELEC_WAKEUP.bytOrder_C "MoFFrm_Rx / Signal byte order" VALUE 0x8027029C Val_Wu8 1.000 OneToOne 0.00 1.000 FORMAT "%5.3" EXTENDED_LIMITS 0.00 255.0 /end CHARACTERISTIC
/begin CHARACTERISTIC MoFFrm_DataNetInfoSigRx_PRECOND_ELEC_WAKEUP.posnStrtBit_C "MoFFrm_Rx / signal start bit position" VALUE 0x8027029E Val_Wu16 65535.00 OneToOne 0.00 65535.00 FORMAT "%8.2" /end CHARACTERISTIC
/begin CHARACTERISTIC MoFFrm_DataNetInfoSigRx_PRECOND_ELEC_WAKEUP.sigLen_C "MoFFrm_Rx / signal length (bits)" VALUE 0x802702A0 Val_Wu8 31.00 OneToOne 1.00 32.00 FORMAT "%5.2" EXTENDED_LIMITS 0.00 255.0 /end CHARACTERISTIC
/begin CHARACTERISTIC MoFFrm_DataNetInfoSigRx_REGUL_ABR.bytOrder_C "Data PDu Structure for REGUL_ABR / Signal byte order" VALUE 0x802702A2 Val_Wu8 1.000 OneToOne 0.00 1.000 FORMAT "%5.3" EXTENDED_LIMITS 0.00 255.0 /end CHARACTERISTIC
/begin CHARACTERISTIC MoFFrm_DataNetInfoSigRx_REGUL_ABR.posnStrtBit_C "Data PDu Structure for REGUL_ABR / signal start bit position" VALUE 0x802702A4 Val_Wu16 65535.00 OneToOne 0.00 65535.00 FORMAT "%8.2" /end CHARACTERISTIC
/begin CHARACTERISTIC MoFFrm_DataNetInfoSigRx_REGUL_ABR.sigLen_C "Data PDu Structure for REGUL_ABR / signal length (bits)" VALUE 0x802702A6 Val_Wu8 31.00 OneToOne 1.00 32.00 FORMAT "%5.2" EXTENDED_LIMITS 0.00 255.0 /end CHARACTERISTIC
/begin CHARACTERISTIC MoFFrm_DataNetInfoSigRx_TGLM_FAILURE_STATE.bytOrder_C "Data PDu Structure for TGLM_FAILURE_STATE / Signal byte order" VALUE 0x802702A8 Val_Wu8 1.000 OneToOne 0.00 1.000 FORMAT "%5.3" EXTENDED_LIMITS 0.00 255.0 /end CHARACTERISTIC
/begin CHARACTERISTIC MoFFrm_DataNetInfoSigRx_TGLM_FAILURE_STATE.posnStrtBit_C "Data PDu Structure for TGLM_FAILURE_STATE / signal start bit position" VALUE 0x802702AA Val_Wu16 65535.00 OneToOne 0.00 65535.00 FORMAT "%8.2" /end CHARACTERISTIC
/begin CHARACTERISTIC MoFFrm_DataNetInfoSigRx_TGLM_FAILURE_STATE.sigLen_C "Data PDu Structure for TGLM_FAILURE_STATE / signal length (bits)" VALUE 0x802702AC Val_Wu8 31.00 OneToOne 1.00 32.00 FORMAT "%5.2" EXTENDED_LIMITS 0.00 255.0 /end CHARACTERISTIC
/begin CHARACTERISTIC MoFFrm_DataNetInfoSigRx_TOGGLE_MONOSTABLE_POS.bytOrder_C "Data PDu Structure for TOGGLE_MONOSTABLE_POS / Signal byte order" VALUE 0x802702AE Val_Wu8 1.000 OneToOne 0.00 1.000 FORMAT "%5.3" EXTENDED_LIMITS 0.00 255.0 /end CHARACTERISTIC
/begin CHARACTERISTIC MoFFrm_DataNetInfoSigRx_TOGGLE_MONOSTABLE_POS.posnStrtBit_C "Data PDu Structure for TOGGLE_MONOSTABLE_POS / signal start bit position" VALUE 0x802702B0 Val_Wu16 65535.00 OneToOne 0.00 65535.00 FORMAT "%8.2" /end CHARACTERISTIC
/begin CHARACTERISTIC MoFFrm_DataNetInfoSigRx_TOGGLE_MONOSTABLE_POS.sigLen_C "Data PDu Structure for TOGGLE_MONOSTABLE_POS / signal length (bits)" VALUE 0x802702B2 Val_Wu8 31.00 OneToOne 1.00 32.00 FORMAT "%5.2" EXTENDED_LIMITS 0.00 255.0 /end CHARACTERISTIC
/begin CHARACTERISTIC MoFFrm_DataNetInfoSigRx_VITESSE_VEHICULE_ROUES.bytOrder_C "Network signal configuration for VITESSE_VEHICULE_ROUES / Signal byte order" VALUE 0x802702B4 Val_Wu8 1.000 OneToOne 0.00 1.000 FORMAT "%5.3" EXTENDED_LIMITS 0.00 255.0 /end CHARACTERISTIC
/begin CHARACTERISTIC MoFFrm_DataNetInfoSigRx_VITESSE_VEHICULE_ROUES.posnStrtBit_C "Network signal configuration for VITESSE_VEHICULE_ROUES / signal start bit position" VALUE 0x802702B6 Val_Wu16 65535.00 OneToOne 0.00 65535.00 FORMAT "%8.2" /end CHARACTERISTIC
/begin CHARACTERISTIC MoFFrm_DataNetInfoSigRx_VITESSE_VEHICULE_ROUES.sigLen_C "Network signal configuration for VITESSE_VEHICULE_ROUES / signal length (bits)" VALUE 0x802702B8 Val_Wu8 31.00 OneToOne 1.00 32.00 FORMAT "%5.2" EXTENDED_LIMITS 0.00 255.0 /end CHARACTERISTIC
/begin CHARACTERISTIC MoFFrm_DataNetInfoSigTx_VCU_DCDC_State_Command.bytOrder_C "MoFFrm_DataNetInfoSigTx_VCU_DCDC_State_Command / Signal byte order" VALUE 0x80270524 Val_Wu8 1.000 OneToOne 0.00 1.000 FORMAT "%5.3" EXTENDED_LIMITS 0.00 255.0 /end CHARACTERISTIC
/begin CHARACTERISTIC MoFFrm_DataNetInfoSigTx_VCU_DCDC_State_Command.posnStrtBit_C "MoFFrm_DataNetInfoSigTx_VCU_DCDC_State_Command / signal start bit position" VALUE 0x80270526 Val_Wu16 65535.00 OneToOne 0.00 65535.00 FORMAT "%8.2" /end CHARACTERISTIC
/begin CHARACTERISTIC MoFFrm_DataNetInfoSigTx_VCU_DCDC_State_Command.sigLen_C "MoFFrm_DataNetInfoSigTx_VCU_DCDC_State_Command / signal length (bits)" VALUE 0x80270528 Val_Wu8 31.00 OneToOne 1.00 32.00 FORMAT "%5.2" EXTENDED_LIMITS 0.00 255.0 /end CHARACTERISTIC
/begin CHARACTERISTIC MoFFrm_DataNetInfoSigTx_VCU_EMERGENCY_SHUTDOWN.bytOrder_C "Structure instance of signal VCU_EMERGENCY_SHUTDOWN / Signal byte order" VALUE 0x8027052A Val_Wu8 1.000 OneToOne 0.00 1.000 FORMAT "%5.3" EXTENDED_LIMITS 0.00 255.0 /end CHARACTERISTIC
/begin CHARACTERISTIC MoFFrm_DataNetInfoSigTx_VCU_EMERGENCY_SHUTDOWN.posnStrtBit_C "Structure instance of signal VCU_EMERGENCY_SHUTDOWN / signal start bit position" VALUE 0x8027052C Val_Wu16 65535.00 OneToOne 0.00 65535.00 FORMAT "%8.2" /end CHARACTERISTIC
/begin CHARACTERISTIC MoFFrm_DataNetInfoSigTx_VCU_EMERGENCY_SHUTDOWN.sigLen_C "Structure instance of signal VCU_EMERGENCY_SHUTDOWN / signal length (bits)" VALUE 0x8027052E Val_Wu8 31.00 OneToOne 1.00 32.00 FORMAT "%5.2" EXTENDED_LIMITS 0.00 255.0 /end CHARACTERISTIC
/begin CHARACTERISTIC MoFFrm_DataNetInfoSigTx_VCU_INV_ACTIVE_DISCHARGE_REQ.bytOrder_C "MoFFrm_DataNetInfoSigTx_VCU_INV_ACTIVE_DISCHARGE_REQ / Signal byte order" VALUE 0x80270530 Val_Wu8 1.000 OneToOne 0.00 1.000 FORMAT "%5.3" EXTENDED_LIMITS 0.00 255.0 /end CHARACTERISTIC
/begin CHARACTERISTIC MoFFrm_DataNetInfoSigTx_VCU_INV_ACTIVE_DISCHARGE_REQ.posnStrtBit_C "MoFFrm_DataNetInfoSigTx_VCU_INV_ACTIVE_DISCHARGE_REQ / signal start bit position" VALUE 0x80270532 Val_Wu16 65535.00 OneToOne 0.00 65535.00 FORMAT "%8.2" /end CHARACTERISTIC
/begin CHARACTERISTIC MoFFrm_DataNetInfoSigTx_VCU_INV_ACTIVE_DISCHARGE_REQ.sigLen_C "MoFFrm_DataNetInfoSigTx_VCU_INV_ACTIVE_DISCHARGE_REQ / signal length (bits)" VALUE 0x80270534 Val_Wu8 31.00 OneToOne 1.00 32.00 FORMAT "%5.2" EXTENDED_LIMITS 0.00 255.0 /end CHARACTERISTIC
/begin CHARACTERISTIC MoFFrm_DataNetInfoSigTx_VCU_INV_CTRL_MODE_REQ.bytOrder_C "MoFFrm_DataNetInfoSigTx_VCU_INV_CTRL_MODE_REQ / Signal byte order" VALUE 0x80270536 Val_Wu8 1.000 OneToOne 0.00 1.000 FORMAT "%5.3" EXTENDED_LIMITS 0.00 255.0 /end CHARACTERISTIC
/begin CHARACTERISTIC MoFFrm_DataNetInfoSigTx_VCU_INV_CTRL_MODE_REQ.posnStrtBit_C "MoFFrm_DataNetInfoSigTx_VCU_INV_CTRL_MODE_REQ / signal start bit position" VALUE 0x80270538 Val_Wu16 65535.00 OneToOne 0.00 65535.00 FORMAT "%8.2" /end CHARACTERISTIC
/begin CHARACTERISTIC MoFFrm_DataNetInfoSigTx_VCU_INV_CTRL_MODE_REQ.sigLen_C "MoFFrm_DataNetInfoSigTx_VCU_INV_CTRL_MODE_REQ / signal length (bits)" VALUE 0x8027053A Val_Wu8 31.00 OneToOne 1.00 32.00 FORMAT "%5.2" EXTENDED_LIMITS 0.00 255.0 /end CHARACTERISTIC
/begin CHARACTERISTIC MoFFrm_DataNetInfoSigTx_VCU_INV_TRQ_REQ.bytOrder_C "MoFFrm_DataNetInfoSigTx_VCU_INV_TRQ_REQ / Signal byte order" VALUE 0x8027053C Val_Wu8 1.000 OneToOne 0.00 1.000 FORMAT "%5.3" EXTENDED_LIMITS 0.00 255.0 /end CHARACTERISTIC
/begin CHARACTERISTIC MoFFrm_DataNetInfoSigTx_VCU_INV_TRQ_REQ.posnStrtBit_C "MoFFrm_DataNetInfoSigTx_VCU_INV_TRQ_REQ / signal start bit position" VALUE 0x8027053E Val_Wu16 65535.00 OneToOne 0.00 65535.00 FORMAT "%8.2" /end CHARACTERISTIC
/begin CHARACTERISTIC MoFFrm_DataNetInfoSigTx_VCU_INV_TRQ_REQ.sigLen_C "MoFFrm_DataNetInfoSigTx_VCU_INV_TRQ_REQ / signal length (bits)" VALUE 0x80270540 Val_Wu8 31.00 OneToOne 1.00 32.00 FORMAT "%5.2" EXTENDED_LIMITS 0.00 255.0 /end CHARACTERISTIC
/begin CHARACTERISTIC MoFFrm_DataNetInfoSigTx_VCU_MASTER_WARNING_LIGHT.bytOrder_C "MoFFrm_DataNetInfoSigTx_VCU_MASTER_WARNING_LIGHT / Signal byte order" VALUE 0x80270542 Val_Wu8 1.000 OneToOne 0.00 1.000 FORMAT "%5.3" EXTENDED_LIMITS 0.00 255.0 /end CHARACTERISTIC
/begin CHARACTERISTIC MoFFrm_DataNetInfoSigTx_VCU_MASTER_WARNING_LIGHT.posnStrtBit_C "MoFFrm_DataNetInfoSigTx_VCU_MASTER_WARNING_LIGHT / signal start bit position" VALUE 0x80270544 Val_Wu16 65535.00 OneToOne 0.00 65535.00 FORMAT "%8.2" /end CHARACTERISTIC
/begin CHARACTERISTIC MoFFrm_DataNetInfoSigTx_VCU_MASTER_WARNING_LIGHT.sigLen_C "MoFFrm_DataNetInfoSigTx_VCU_MASTER_WARNING_LIGHT / signal length (bits)" VALUE 0x80270546 Val_Wu8 31.00 OneToOne 1.00 32.00 FORMAT "%5.2" EXTENDED_LIMITS 0.00 255.0 /end CHARACTERISTIC
/begin CHARACTERISTIC MoFFrm_DataNetInfoSigTx_VCU_STATE_COMMAND.bytOrder_C "MoFFrm_DataNetInfoSigTx_VCU_STATE_COMMAND / Signal byte order" VALUE 0x80270548 Val_Wu8 1.000 OneToOne 0.00 1.000 FORMAT "%5.3" EXTENDED_LIMITS 0.00 255.0 /end CHARACTERISTIC
/begin CHARACTERISTIC MoFFrm_DataNetInfoSigTx_VCU_STATE_COMMAND.posnStrtBit_C "MoFFrm_DataNetInfoSigTx_VCU_STATE_COMMAND / signal start bit position" VALUE 0x8027054A Val_Wu16 65535.00 OneToOne 0.00 65535.00 FORMAT "%8.2" /end CHARACTERISTIC
/begin CHARACTERISTIC MoFFrm_DataNetInfoSigTx_VCU_STATE_COMMAND.sigLen_C "MoFFrm_DataNetInfoSigTx_VCU_STATE_COMMAND / signal length (bits)" VALUE 0x8027054C Val_Wu8 31.00 OneToOne 1.00 32.00 FORMAT "%5.2" EXTENDED_LIMITS 0.00 255.0 /end CHARACTERISTIC
/begin CHARACTERISTIC MoFFrm_DataNetInfoSigTx_VCU_VACCUM_FAULT.bytOrder_C "MoFFrm_DataNetInfoSigTx_VCU_VACCUM_FAULT / Signal byte order" VALUE 0x8027054E Val_Wu8 1.000 OneToOne 0.00 1.000 FORMAT "%5.3" EXTENDED_LIMITS 0.00 255.0 /end CHARACTERISTIC
/begin CHARACTERISTIC MoFFrm_DataNetInfoSigTx_VCU_VACCUM_FAULT.posnStrtBit_C "MoFFrm_DataNetInfoSigTx_VCU_VACCUM_FAULT / signal start bit position" VALUE 0x80270550 Val_Wu16 65535.00 OneToOne 0.00 65535.00 FORMAT "%8.2" /end CHARACTERISTIC
/begin CHARACTERISTIC MoFFrm_DataNetInfoSigTx_VCU_VACCUM_FAULT.sigLen_C "MoFFrm_DataNetInfoSigTx_VCU_VACCUM_FAULT / signal length (bits)" VALUE 0x80270552 Val_Wu8 31.00 OneToOne 1.00 32.00 FORMAT "%5.2" EXTENDED_LIMITS 0.00 255.0 /end CHARACTERISTIC
/begin CHARACTERISTIC MoFFrm_flgBrkRawDft_C "Calibration for Brake pedal switch" VALUE 0x8026CEE2 Val_Wu8 255.0 OneToOne 0.00 255.0 FORMAT "%5.1" /end CHARACTERISTIC
/begin CHARACTERISTIC MoFFrm_flgDrvrDoorOpenDft_C "CAlibration for Driver door status" VALUE 0x8026CEE3 Val_Wu8 255.0 OneToOne 0.00 255.0 FORMAT "%5.1" /end CHARACTERISTIC
/begin CHARACTERISTIC MoFFrm_flgHMICrpDi_C "Calibration for MoFFrm_flgHMICrpDi_C" VALUE 0x8026CF01 Val_Wu8 1.00000000000 B_TRUE 0.00 1.00000000000 FORMAT "%13.11" /end CHARACTERISTIC
/begin CHARACTERISTIC MoFFrm_flgPreCdngWakeupDft_C "MoFFrm_Rx" VALUE 0x8026CEE4 Val_Wu8 255.0 OneToOne 0.00 255.0 FORMAT "%5.1" /end CHARACTERISTIC
/begin CHARACTERISTIC MoFFrm_flgPrpInhb01_C "Calibration variable for MoFFrm_flgPrpInhb01" VALUE 0x8026CF02 Val_Wu8 1.00000000000 B_TRUE 0.00 1.00000000000 FORMAT "%13.11" /end CHARACTERISTIC
/begin CHARACTERISTIC MoFFrm_flgRgnInhbnDft_C "Calibration for ABS in regulation" VALUE 0x8026CEE5 Val_Wu8 255.0 OneToOne 0.00 255.0 FORMAT "%5.1" /end CHARACTERISTIC
/begin CHARACTERISTIC MoFFrm_flgVehHldActvDft_C "CAlibration for Hill Hold Status" VALUE 0x8026CEE6 Val_Wu8 255.0 OneToOne 0.00 255.0 FORMAT "%5.1" /end CHARACTERISTIC
/begin CHARACTERISTIC MoFFrm_nEm01CANRawDft_C "Defect value for raw e-machine speed received via CAN" VALUE 0x8026D754 Val_Ws16 65535.00 RBPtCel_n_1p0_1 -32768.00 32767.00 FORMAT "%8.2" /end CHARACTERISTIC
/begin CHARACTERISTIC MoFFrm_Rx_DataPdu_DCDC_283h.bufLen_C " / parameter to indicate the buffer length of the receiving PDU" VALUE 0x802702C4 Val_Wu8 255.0 OneToOne 0.00 255.0 FORMAT "%5.1" /end CHARACTERISTIC
/begin CHARACTERISTIC MoFFrm_Rx_DataPdu_DCDC_283h.bytOrderAlvCntr_C " / Alive counter calibration of RX Data Pdu" VALUE 0x802702C5 Val_Wu8 1.000 OneToOne 0.00 1.000 FORMAT "%5.3" EXTENDED_LIMITS 0.00 255.0 /end CHARACTERISTIC
/begin CHARACTERISTIC MoFFrm_Rx_DataPdu_DCDC_283h.bytOrderCrc_C " / CRC calibration of RX Data Pdu" VALUE 0x802702C6 Val_Wu8 1.000 OneToOne 0.00 1.000 FORMAT "%5.3" EXTENDED_LIMITS 0.00 255.0 /end CHARACTERISTIC
/begin CHARACTERISTIC MoFFrm_Rx_DataPdu_DCDC_283h.chksEndVal_C " / Calibration to indicate the XOR value in a checksum logic." VALUE 0x802702C8 Val_Wu16 65535.00 OneToOne 0.00 65535.00 FORMAT "%8.2" /end CHARACTERISTIC
/begin CHARACTERISTIC MoFFrm_Rx_DataPdu_DCDC_283h.chksStrtVal_C " / Calibration to indicate the initial value in a checksum logic." VALUE 0x802702CA Val_Wu16 65535.00 OneToOne 0.00 65535.00 FORMAT "%8.2" /end CHARACTERISTIC
/begin CHARACTERISTIC MoFFrm_Rx_DataPdu_DCDC_283h.cntrAlvErrDeb_C " / Alive counter debounce error calibration of RX Data Pdu" VALUE 0x802702CC Val_Wu16 65535.00 OneToOne 0.00 65535.00 FORMAT "%8.2" /end CHARACTERISTIC
/begin CHARACTERISTIC MoFFrm_Rx_DataPdu_DCDC_283h.cntrCrcErrDeb_C " / Alive counter debounce error calibration of RX Data Pdu" VALUE 0x802702CE Val_Wu16 65535.00 OneToOne 0.00 65535.00 FORMAT "%8.2" /end CHARACTERISTIC
/begin CHARACTERISTIC MoFFrm_Rx_DataPdu_DCDC_283h.cntrMaxAlvDif_C " / Complement of Counter cyclic calibration of RX Data Pdu" VALUE 0x802702D0 Val_Wu8 255.0 OneToOne 0.00 255.0 FORMAT "%5.1" /end CHARACTERISTIC
/begin CHARACTERISTIC MoFFrm_Rx_DataPdu_DCDC_283h.cntrTiOutDeb_C " / Counter time out debounce calibration of Rx data PDU" VALUE 0x802702D2 Val_Wu16 65535.00 OneToOne 0.00 65535.00 FORMAT "%8.2" /end CHARACTERISTIC
/begin CHARACTERISTIC MoFFrm_Rx_DataPdu_DCDC_283h.crcId_C " / CRC ID of Rx data PDU" VALUE 0x802702D4 Val_Wu32 4294967295.00 OneToOne 0.00 4294967295.00 FORMAT "%13.2" /end CHARACTERISTIC
/begin CHARACTERISTIC MoFFrm_Rx_DataPdu_DCDC_283h.cycTi_C " / cycle time from bus matrix" VALUE 0x802702D8 Val_Wu16 65535.00 OneToOne 0.00 65535.00 FORMAT "%8.2" /end CHARACTERISTIC
/begin CHARACTERISTIC MoFFrm_Rx_DataPdu_DCDC_283h.diChks_C " / parameter to enable or disable manipulation of various checks" VALUE 0x802702DA Val_Wu8 255.0 OneToOne 0.00 255.0 FORMAT "%5.1" /end CHARACTERISTIC
/begin CHARACTERISTIC MoFFrm_Rx_DataPdu_DCDC_283h.evalType_C " / evaluation type" VALUE 0x802702DB Val_Wu8 255.0 OneToOne 0.00 255.0 FORMAT "%5.1" /end CHARACTERISTIC
/begin CHARACTERISTIC MoFFrm_Rx_DataPdu_DCDC_283h.maskAlvCntr_C " / Alive counter start bit position of Rx data PDU" VALUE 0x802702DC Val_Wu8 255.0 OneToOne 0.00 255.0 FORMAT "%5.1" /end CHARACTERISTIC
/begin CHARACTERISTIC MoFFrm_Rx_DataPdu_DCDC_283h.posnAlvCntrStrtBit_C " / Alive counter start bit calibration of of Data PDU Rx" VALUE 0x802702DE Val_Wu16 65535.00 OneToOne 0.00 65535.00 FORMAT "%8.2" /end CHARACTERISTIC
/begin CHARACTERISTIC MoFFrm_Rx_DataPdu_DCDC_283h.posnCrcCalcEndByte_C " / End byte of CRC calculation position of Data PDU Rx" VALUE 0x802702E0 Val_Wu8 255.0 OneToOne 0.00 255.0 FORMAT "%5.1" /end CHARACTERISTIC
/begin CHARACTERISTIC MoFFrm_Rx_DataPdu_DCDC_283h.posnCrcCalcStrtByte_C " / Start byte of CRC calculation position of Data PDU Rx" VALUE 0x802702E1 Val_Wu8 255.0 OneToOne 0.00 255.0 FORMAT "%5.1" /end CHARACTERISTIC
/begin CHARACTERISTIC MoFFrm_Rx_DataPdu_DCDC_283h.posnCrcStrtBit_C " / CRC start bit position of Rx data PDU" VALUE 0x802702E2 Val_Wu16 65535.00 OneToOne 0.00 65535.00 FORMAT "%8.2" /end CHARACTERISTIC
/begin CHARACTERISTIC MoFFrm_Rx_DataPdu_DCDC_283h.sigLenAlvCntr_C " / Alive counter signal length of Rx data PDU" VALUE 0x802702E4 Val_Wu8 31.00 OneToOne 1.00 32.00 FORMAT "%5.2" EXTENDED_LIMITS 0.00 255.0 /end CHARACTERISTIC
/begin CHARACTERISTIC MoFFrm_Rx_DataPdu_DCDC_283h.sigLenCrc_C " / CRC calibration signal length of Rx data PDU" VALUE 0x802702E5 Val_Wu8 31.00 OneToOne 1.00 32.00 FORMAT "%5.2" EXTENDED_LIMITS 0.00 255.0 /end CHARACTERISTIC
/begin CHARACTERISTIC MoFFrm_Rx_DataPdu_DCDC_293h.bufLen_C "Data PDu Structure for DCDC_293h / parameter to indicate the buffer length of the receiving PDU" VALUE 0x802702F0 Val_Wu8 255.0 OneToOne 0.00 255.0 FORMAT "%5.1" /end CHARACTERISTIC
/begin CHARACTERISTIC MoFFrm_Rx_DataPdu_DCDC_293h.bytOrderAlvCntr_C "Data PDu Structure for DCDC_293h / Alive counter calibration of RX Data Pdu" VALUE 0x802702F1 Val_Wu8 1.000 OneToOne 0.00 1.000 FORMAT "%5.3" EXTENDED_LIMITS 0.00 255.0 /end CHARACTERISTIC
/begin CHARACTERISTIC MoFFrm_Rx_DataPdu_DCDC_293h.bytOrderCrc_C "Data PDu Structure for DCDC_293h / CRC calibration of RX Data Pdu" VALUE 0x802702F2 Val_Wu8 1.000 OneToOne 0.00 1.000 FORMAT "%5.3" EXTENDED_LIMITS 0.00 255.0 /end CHARACTERISTIC
/begin CHARACTERISTIC MoFFrm_Rx_DataPdu_DCDC_293h.chksEndVal_C "Data PDu Structure for DCDC_293h / Calibration to indicate the XOR value in a checksum logic." VALUE 0x802702F4 Val_Wu16 65535.00 OneToOne 0.00 65535.00 FORMAT "%8.2" /end CHARACTERISTIC
/begin CHARACTERISTIC MoFFrm_Rx_DataPdu_DCDC_293h.chksStrtVal_C "Data PDu Structure for DCDC_293h / Calibration to indicate the initial value in a checksum logic." VALUE 0x802702F6 Val_Wu16 65535.00 OneToOne 0.00 65535.00 FORMAT "%8.2" /end CHARACTERISTIC
/begin CHARACTERISTIC MoFFrm_Rx_DataPdu_DCDC_293h.cntrAlvErrDeb_C "Data PDu Structure for DCDC_293h / Alive counter debounce error calibration of RX Data Pdu" VALUE 0x802702F8 Val_Wu16 65535.00 OneToOne 0.00 65535.00 FORMAT "%8.2" /end CHARACTERISTIC
/begin CHARACTERISTIC MoFFrm_Rx_DataPdu_DCDC_293h.cntrCrcErrDeb_C "Data PDu Structure for DCDC_293h / Alive counter debounce error calibration of RX Data Pdu" VALUE 0x802702FA Val_Wu16 65535.00 OneToOne 0.00 65535.00 FORMAT "%8.2" /end CHARACTERISTIC
/begin CHARACTERISTIC MoFFrm_Rx_DataPdu_DCDC_293h.cntrMaxAlvDif_C "Data PDu Structure for DCDC_293h / Complement of Counter cyclic calibration of RX Data Pdu" VALUE 0x802702FC Val_Wu8 255.0 OneToOne 0.00 255.0 FORMAT "%5.1" /end CHARACTERISTIC
/begin CHARACTERISTIC MoFFrm_Rx_DataPdu_DCDC_293h.cntrTiOutDeb_C "Data PDu Structure for DCDC_293h / Counter time out debounce calibration of Rx data PDU" VALUE 0x802702FE Val_Wu16 65535.00 OneToOne 0.00 65535.00 FORMAT "%8.2" /end CHARACTERISTIC
/begin CHARACTERISTIC MoFFrm_Rx_DataPdu_DCDC_293h.crcId_C "Data PDu Structure for DCDC_293h / CRC ID of Rx data PDU" VALUE 0x80270300 Val_Wu32 4294967295.00 OneToOne 0.00 4294967295.00 FORMAT "%13.2" /end CHARACTERISTIC
/begin CHARACTERISTIC MoFFrm_Rx_DataPdu_DCDC_293h.cycTi_C "Data PDu Structure for DCDC_293h / cycle time from bus matrix" VALUE 0x80270304 Val_Wu16 65535.00 OneToOne 0.00 65535.00 FORMAT "%8.2" /end CHARACTERISTIC
/begin CHARACTERISTIC MoFFrm_Rx_DataPdu_DCDC_293h.diChks_C "Data PDu Structure for DCDC_293h / parameter to enable or disable manipulation of various checks" VALUE 0x80270306 Val_Wu8 255.0 OneToOne 0.00 255.0 FORMAT "%5.1" /end CHARACTERISTIC
/begin CHARACTERISTIC MoFFrm_Rx_DataPdu_DCDC_293h.evalType_C "Data PDu Structure for DCDC_293h / evaluation type" VALUE 0x80270307 Val_Wu8 255.0 OneToOne 0.00 255.0 FORMAT "%5.1" /end CHARACTERISTIC
/begin CHARACTERISTIC MoFFrm_Rx_DataPdu_DCDC_293h.maskAlvCntr_C "Data PDu Structure for DCDC_293h / Alive counter start bit position of Rx data PDU" VALUE 0x80270308 Val_Wu8 255.0 OneToOne 0.00 255.0 FORMAT "%5.1" /end CHARACTERISTIC
/begin CHARACTERISTIC MoFFrm_Rx_DataPdu_DCDC_293h.posnAlvCntrStrtBit_C "Data PDu Structure for DCDC_293h / Alive counter start bit calibration of of Data PDU Rx" VALUE 0x8027030A Val_Wu16 65535.00 OneToOne 0.00 65535.00 FORMAT "%8.2" /end CHARACTERISTIC
/begin CHARACTERISTIC MoFFrm_Rx_DataPdu_DCDC_293h.posnCrcCalcEndByte_C "Data PDu Structure for DCDC_293h / End byte of CRC calculation position of Data PDU Rx" VALUE 0x8027030C Val_Wu8 255.0 OneToOne 0.00 255.0 FORMAT "%5.1" /end CHARACTERISTIC
/begin CHARACTERISTIC MoFFrm_Rx_DataPdu_DCDC_293h.posnCrcCalcStrtByte_C "Data PDu Structure for DCDC_293h / Start byte of CRC calculation position of Data PDU Rx" VALUE 0x8027030D Val_Wu8 255.0 OneToOne 0.00 255.0 FORMAT "%5.1" /end CHARACTERISTIC
/begin CHARACTERISTIC MoFFrm_Rx_DataPdu_DCDC_293h.posnCrcStrtBit_C "Data PDu Structure for DCDC_293h / CRC start bit position of Rx data PDU" VALUE 0x8027030E Val_Wu16 65535.00 OneToOne 0.00 65535.00 FORMAT "%8.2" /end CHARACTERISTIC
/begin CHARACTERISTIC MoFFrm_Rx_DataPdu_DCDC_293h.sigLenAlvCntr_C "Data PDu Structure for DCDC_293h / Alive counter signal length of Rx data PDU" VALUE 0x80270310 Val_Wu8 31.00 OneToOne 1.00 32.00 FORMAT "%5.2" EXTENDED_LIMITS 0.00 255.0 /end CHARACTERISTIC
/begin CHARACTERISTIC MoFFrm_Rx_DataPdu_DCDC_293h.sigLenCrc_C "Data PDu Structure for DCDC_293h / CRC calibration signal length of Rx data PDU" VALUE 0x80270311 Val_Wu8 31.00 OneToOne 1.00 32.00 FORMAT "%5.2" EXTENDED_LIMITS 0.00 255.0 /end CHARACTERISTIC
/begin CHARACTERISTIC MoFFrm_Rx_DataPdu_HS3_AUTO_GEARBOX_SWITCH_STATUS.bufLen_C "Data PDu Structure for HS3_AUTO_GEARBOX_SWITCH_STATUS / parameter to indicate the buffer length of the receiving PDU" VALUE 0x8027031C Val_Wu8 255.0 OneToOne 0.00 255.0 FORMAT "%5.1" /end CHARACTERISTIC
/begin CHARACTERISTIC MoFFrm_Rx_DataPdu_HS3_AUTO_GEARBOX_SWITCH_STATUS.bytOrderAlvCntr_C "Data PDu Structure for HS3_AUTO_GEARBOX_SWITCH_STATUS / Alive counter calibration of RX Data Pdu" VALUE 0x8027031D Val_Wu8 1.000 OneToOne 0.00 1.000 FORMAT "%5.3" EXTENDED_LIMITS 0.00 255.0 /end CHARACTERISTIC
/begin CHARACTERISTIC MoFFrm_Rx_DataPdu_HS3_AUTO_GEARBOX_SWITCH_STATUS.bytOrderCrc_C "Data PDu Structure for HS3_AUTO_GEARBOX_SWITCH_STATUS / CRC calibration of RX Data Pdu" VALUE 0x8027031E Val_Wu8 1.000 OneToOne 0.00 1.000 FORMAT "%5.3" EXTENDED_LIMITS 0.00 255.0 /end CHARACTERISTIC
/begin CHARACTERISTIC MoFFrm_Rx_DataPdu_HS3_AUTO_GEARBOX_SWITCH_STATUS.chksEndVal_C "Data PDu Structure for HS3_AUTO_GEARBOX_SWITCH_STATUS / Calibration to indicate the XOR value in a checksum logic." VALUE 0x80270320 Val_Wu16 65535.00 OneToOne 0.00 65535.00 FORMAT "%8.2" /end CHARACTERISTIC
/begin CHARACTERISTIC MoFFrm_Rx_DataPdu_HS3_AUTO_GEARBOX_SWITCH_STATUS.chksStrtVal_C "Data PDu Structure for HS3_AUTO_GEARBOX_SWITCH_STATUS / Calibration to indicate the initial value in a checksum logic." VALUE 0x80270322 Val_Wu16 65535.00 OneToOne 0.00 65535.00 FORMAT "%8.2" /end CHARACTERISTIC
/begin CHARACTERISTIC MoFFrm_Rx_DataPdu_HS3_AUTO_GEARBOX_SWITCH_STATUS.cntrAlvErrDeb_C "Data PDu Structure for HS3_AUTO_GEARBOX_SWITCH_STATUS / Alive counter debounce error calibration of RX Data Pdu" VALUE 0x80270324 Val_Wu16 65535.00 OneToOne 0.00 65535.00 FORMAT "%8.2" /end CHARACTERISTIC
/begin CHARACTERISTIC MoFFrm_Rx_DataPdu_HS3_AUTO_GEARBOX_SWITCH_STATUS.cntrCrcErrDeb_C "Data PDu Structure for HS3_AUTO_GEARBOX_SWITCH_STATUS / Alive counter debounce error calibration of RX Data Pdu" VALUE 0x80270326 Val_Wu16 65535.00 OneToOne 0.00 65535.00 FORMAT "%8.2" /end CHARACTERISTIC
/begin CHARACTERISTIC MoFFrm_Rx_DataPdu_HS3_AUTO_GEARBOX_SWITCH_STATUS.cntrMaxAlvDif_C "Data PDu Structure for HS3_AUTO_GEARBOX_SWITCH_STATUS / Complement of Counter cyclic calibration of RX Data Pdu" VALUE 0x80270328 Val_Wu8 255.0 OneToOne 0.00 255.0 FORMAT "%5.1" /end CHARACTERISTIC
/begin CHARACTERISTIC MoFFrm_Rx_DataPdu_HS3_AUTO_GEARBOX_SWITCH_STATUS.cntrTiOutDeb_C "Data PDu Structure for HS3_AUTO_GEARBOX_SWITCH_STATUS / Counter time out debounce calibration of Rx data PDU" VALUE 0x8027032A Val_Wu16 65535.00 OneToOne 0.00 65535.00 FORMAT "%8.2" /end CHARACTERISTIC
/begin CHARACTERISTIC MoFFrm_Rx_DataPdu_HS3_AUTO_GEARBOX_SWITCH_STATUS.crcId_C "Data PDu Structure for HS3_AUTO_GEARBOX_SWITCH_STATUS / CRC ID of Rx data PDU" VALUE 0x8027032C Val_Wu32 4294967295.00 OneToOne 0.00 4294967295.00 FORMAT "%13.2" /end CHARACTERISTIC
/begin CHARACTERISTIC MoFFrm_Rx_DataPdu_HS3_AUTO_GEARBOX_SWITCH_STATUS.cycTi_C "Data PDu Structure for HS3_AUTO_GEARBOX_SWITCH_STATUS / cycle time from bus matrix" VALUE 0x80270330 Val_Wu16 65535.00 OneToOne 0.00 65535.00 FORMAT "%8.2" /end CHARACTERISTIC
/begin CHARACTERISTIC MoFFrm_Rx_DataPdu_HS3_AUTO_GEARBOX_SWITCH_STATUS.diChks_C "Data PDu Structure for HS3_AUTO_GEARBOX_SWITCH_STATUS / parameter to enable or disable manipulation of various checks" VALUE 0x80270332 Val_Wu8 255.0 OneToOne 0.00 255.0 FORMAT "%5.1" /end CHARACTERISTIC
/begin CHARACTERISTIC MoFFrm_Rx_DataPdu_HS3_AUTO_GEARBOX_SWITCH_STATUS.evalType_C "Data PDu Structure for HS3_AUTO_GEARBOX_SWITCH_STATUS / evaluation type" VALUE 0x80270333 Val_Wu8 255.0 OneToOne 0.00 255.0 FORMAT "%5.1" /end CHARACTERISTIC
/begin CHARACTERISTIC MoFFrm_Rx_DataPdu_HS3_AUTO_GEARBOX_SWITCH_STATUS.maskAlvCntr_C "Data PDu Structure for HS3_AUTO_GEARBOX_SWITCH_STATUS / Alive counter start bit position of Rx data PDU" VALUE 0x80270334 Val_Wu8 255.0 OneToOne 0.00 255.0 FORMAT "%5.1" /end CHARACTERISTIC
/begin CHARACTERISTIC MoFFrm_Rx_DataPdu_HS3_AUTO_GEARBOX_SWITCH_STATUS.posnAlvCntrStrtBit_C "Data PDu Structure for HS3_AUTO_GEARBOX_SWITCH_STATUS / Alive counter start bit calibration of of Data PDU Rx" VALUE 0x80270336 Val_Wu16 65535.00 OneToOne 0.00 65535.00 FORMAT "%8.2" /end CHARACTERISTIC
/begin CHARACTERISTIC MoFFrm_Rx_DataPdu_HS3_AUTO_GEARBOX_SWITCH_STATUS.posnCrcCalcEndByte_C "Data PDu Structure for HS3_AUTO_GEARBOX_SWITCH_STATUS / End byte of CRC calculation position of Data PDU Rx" VALUE 0x80270338 Val_Wu8 255.0 OneToOne 0.00 255.0 FORMAT "%5.1" /end CHARACTERISTIC
/begin CHARACTERISTIC MoFFrm_Rx_DataPdu_HS3_AUTO_GEARBOX_SWITCH_STATUS.posnCrcCalcStrtByte_C "Data PDu Structure for HS3_AUTO_GEARBOX_SWITCH_STATUS / Start byte of CRC calculation position of Data PDU Rx" VALUE 0x80270339 Val_Wu8 255.0 OneToOne 0.00 255.0 FORMAT "%5.1" /end CHARACTERISTIC
/begin CHARACTERISTIC MoFFrm_Rx_DataPdu_HS3_AUTO_GEARBOX_SWITCH_STATUS.posnCrcStrtBit_C "Data PDu Structure for HS3_AUTO_GEARBOX_SWITCH_STATUS / CRC start bit position of Rx data PDU" VALUE 0x8027033A Val_Wu16 65535.00 OneToOne 0.00 65535.00 FORMAT "%8.2" /end CHARACTERISTIC
/begin CHARACTERISTIC MoFFrm_Rx_DataPdu_HS3_AUTO_GEARBOX_SWITCH_STATUS.sigLenAlvCntr_C "Data PDu Structure for HS3_AUTO_GEARBOX_SWITCH_STATUS / Alive counter signal length of Rx data PDU" VALUE 0x8027033C Val_Wu8 31.00 OneToOne 1.00 32.00 FORMAT "%5.2" EXTENDED_LIMITS 0.00 255.0 /end CHARACTERISTIC
/begin CHARACTERISTIC MoFFrm_Rx_DataPdu_HS3_AUTO_GEARBOX_SWITCH_STATUS.sigLenCrc_C "Data PDu Structure for HS3_AUTO_GEARBOX_SWITCH_STATUS / CRC calibration signal length of Rx data PDU" VALUE 0x8027033D Val_Wu8 31.00 OneToOne 1.00 32.00 FORMAT "%5.2" EXTENDED_LIMITS 0.00 255.0 /end CHARACTERISTIC
/begin CHARACTERISTIC MoFFrm_Rx_DataPdu_HVBAT_205h.bufLen_C "MoFFrm_Rx_DataPdu_HVBAT_205h / parameter to indicate the buffer length of the receiving PDU" VALUE 0x80270348 Val_Wu8 255.0 OneToOne 0.00 255.0 FORMAT "%5.1" /end CHARACTERISTIC
/begin CHARACTERISTIC MoFFrm_Rx_DataPdu_HVBAT_205h.bytOrderAlvCntr_C "MoFFrm_Rx_DataPdu_HVBAT_205h / Alive counter calibration of RX Data Pdu" VALUE 0x80270349 Val_Wu8 1.000 OneToOne 0.00 1.000 FORMAT "%5.3" EXTENDED_LIMITS 0.00 255.0 /end CHARACTERISTIC
/begin CHARACTERISTIC MoFFrm_Rx_DataPdu_HVBAT_205h.bytOrderCrc_C "MoFFrm_Rx_DataPdu_HVBAT_205h / CRC calibration of RX Data Pdu" VALUE 0x8027034A Val_Wu8 1.000 OneToOne 0.00 1.000 FORMAT "%5.3" EXTENDED_LIMITS 0.00 255.0 /end CHARACTERISTIC
/begin CHARACTERISTIC MoFFrm_Rx_DataPdu_HVBAT_205h.chksEndVal_C "MoFFrm_Rx_DataPdu_HVBAT_205h / Calibration to indicate the XOR value in a checksum logic." VALUE 0x8027034C Val_Wu16 65535.00 OneToOne 0.00 65535.00 FORMAT "%8.2" /end CHARACTERISTIC
/begin CHARACTERISTIC MoFFrm_Rx_DataPdu_HVBAT_205h.chksStrtVal_C "MoFFrm_Rx_DataPdu_HVBAT_205h / Calibration to indicate the initial value in a checksum logic." VALUE 0x8027034E Val_Wu16 65535.00 OneToOne 0.00 65535.00 FORMAT "%8.2" /end CHARACTERISTIC
/begin CHARACTERISTIC MoFFrm_Rx_DataPdu_HVBAT_205h.cntrAlvErrDeb_C "MoFFrm_Rx_DataPdu_HVBAT_205h / Alive counter debounce error calibration of RX Data Pdu" VALUE 0x80270350 Val_Wu16 65535.00 OneToOne 0.00 65535.00 FORMAT "%8.2" /end CHARACTERISTIC
/begin CHARACTERISTIC MoFFrm_Rx_DataPdu_HVBAT_205h.cntrCrcErrDeb_C "MoFFrm_Rx_DataPdu_HVBAT_205h / Alive counter debounce error calibration of RX Data Pdu" VALUE 0x80270352 Val_Wu16 65535.00 OneToOne 0.00 65535.00 FORMAT "%8.2" /end CHARACTERISTIC
/begin CHARACTERISTIC MoFFrm_Rx_DataPdu_HVBAT_205h.cntrMaxAlvDif_C "MoFFrm_Rx_DataPdu_HVBAT_205h / Complement of Counter cyclic calibration of RX Data Pdu" VALUE 0x80270354 Val_Wu8 255.0 OneToOne 0.00 255.0 FORMAT "%5.1" /end CHARACTERISTIC
/begin CHARACTERISTIC MoFFrm_Rx_DataPdu_HVBAT_205h.cntrTiOutDeb_C "MoFFrm_Rx_DataPdu_HVBAT_205h / Counter time out debounce calibration of Rx data PDU" VALUE 0x80270356 Val_Wu16 65535.00 OneToOne 0.00 65535.00 FORMAT "%8.2" /end CHARACTERISTIC
/begin CHARACTERISTIC MoFFrm_Rx_DataPdu_HVBAT_205h.crcId_C "MoFFrm_Rx_DataPdu_HVBAT_205h / CRC ID of Rx data PDU" VALUE 0x80270358 Val_Wu32 4294967295.00 OneToOne 0.00 4294967295.00 FORMAT "%13.2" /end CHARACTERISTIC
/begin CHARACTERISTIC MoFFrm_Rx_DataPdu_HVBAT_205h.cycTi_C "MoFFrm_Rx_DataPdu_HVBAT_205h / cycle time from bus matrix" VALUE 0x8027035C Val_Wu16 65535.00 OneToOne 0.00 65535.00 FORMAT "%8.2" /end CHARACTERISTIC
/begin CHARACTERISTIC MoFFrm_Rx_DataPdu_HVBAT_205h.diChks_C "MoFFrm_Rx_DataPdu_HVBAT_205h / parameter to enable or disable manipulation of various checks" VALUE 0x8027035E Val_Wu8 255.0 OneToOne 0.00 255.0 FORMAT "%5.1" /end CHARACTERISTIC
/begin CHARACTERISTIC MoFFrm_Rx_DataPdu_HVBAT_205h.evalType_C "MoFFrm_Rx_DataPdu_HVBAT_205h / evaluation type" VALUE 0x8027035F Val_Wu8 255.0 OneToOne 0.00 255.0 FORMAT "%5.1" /end CHARACTERISTIC
/begin CHARACTERISTIC MoFFrm_Rx_DataPdu_HVBAT_205h.maskAlvCntr_C "MoFFrm_Rx_DataPdu_HVBAT_205h / Alive counter start bit position of Rx data PDU" VALUE 0x80270360 Val_Wu8 255.0 OneToOne 0.00 255.0 FORMAT "%5.1" /end CHARACTERISTIC
/begin CHARACTERISTIC MoFFrm_Rx_DataPdu_HVBAT_205h.posnAlvCntrStrtBit_C "MoFFrm_Rx_DataPdu_HVBAT_205h / Alive counter start bit calibration of of Data PDU Rx" VALUE 0x80270362 Val_Wu16 65535.00 OneToOne 0.00 65535.00 FORMAT "%8.2" /end CHARACTERISTIC
/begin CHARACTERISTIC MoFFrm_Rx_DataPdu_HVBAT_205h.posnCrcCalcEndByte_C "MoFFrm_Rx_DataPdu_HVBAT_205h / End byte of CRC calculation position of Data PDU Rx" VALUE 0x80270364 Val_Wu8 255.0 OneToOne 0.00 255.0 FORMAT "%5.1" /end CHARACTERISTIC
/begin CHARACTERISTIC MoFFrm_Rx_DataPdu_HVBAT_205h.posnCrcCalcStrtByte_C "MoFFrm_Rx_DataPdu_HVBAT_205h / Start byte of CRC calculation position of Data PDU Rx" VALUE 0x80270365 Val_Wu8 255.0 OneToOne 0.00 255.0 FORMAT "%5.1" /end CHARACTERISTIC
/begin CHARACTERISTIC MoFFrm_Rx_DataPdu_HVBAT_205h.posnCrcStrtBit_C "MoFFrm_Rx_DataPdu_HVBAT_205h / CRC start bit position of Rx data PDU" VALUE 0x80270366 Val_Wu16 65535.00 OneToOne 0.00 65535.00 FORMAT "%8.2" /end CHARACTERISTIC
/begin CHARACTERISTIC MoFFrm_Rx_DataPdu_HVBAT_205h.sigLenAlvCntr_C "MoFFrm_Rx_DataPdu_HVBAT_205h / Alive counter signal length of Rx data PDU" VALUE 0x80270368 Val_Wu8 31.00 OneToOne 1.00 32.00 FORMAT "%5.2" EXTENDED_LIMITS 0.00 255.0 /end CHARACTERISTIC
/begin CHARACTERISTIC MoFFrm_Rx_DataPdu_HVBAT_205h.sigLenCrc_C "MoFFrm_Rx_DataPdu_HVBAT_205h / CRC calibration signal length of Rx data PDU" VALUE 0x80270369 Val_Wu8 31.00 OneToOne 1.00 32.00 FORMAT "%5.2" EXTENDED_LIMITS 0.00 255.0 /end CHARACTERISTIC
/begin CHARACTERISTIC MoFFrm_Rx_DataPdu_HVBAT_325h.bufLen_C "Data PDu Structure for HVBAT_325h / parameter to indicate the buffer length of the receiving PDU" VALUE 0x80270374 Val_Wu8 255.0 OneToOne 0.00 255.0 FORMAT "%5.1" /end CHARACTERISTIC
/begin CHARACTERISTIC MoFFrm_Rx_DataPdu_HVBAT_325h.bytOrderAlvCntr_C "Data PDu Structure for HVBAT_325h / Alive counter calibration of RX Data Pdu" VALUE 0x80270375 Val_Wu8 1.000 OneToOne 0.00 1.000 FORMAT "%5.3" EXTENDED_LIMITS 0.00 255.0 /end CHARACTERISTIC
/begin CHARACTERISTIC MoFFrm_Rx_DataPdu_HVBAT_325h.bytOrderCrc_C "Data PDu Structure for HVBAT_325h / CRC calibration of RX Data Pdu" VALUE 0x80270376 Val_Wu8 1.000 OneToOne 0.00 1.000 FORMAT "%5.3" EXTENDED_LIMITS 0.00 255.0 /end CHARACTERISTIC
/begin CHARACTERISTIC MoFFrm_Rx_DataPdu_HVBAT_325h.chksEndVal_C "Data PDu Structure for HVBAT_325h / Calibration to indicate the XOR value in a checksum logic." VALUE 0x80270378 Val_Wu16 65535.00 OneToOne 0.00 65535.00 FORMAT "%8.2" /end CHARACTERISTIC
/begin CHARACTERISTIC MoFFrm_Rx_DataPdu_HVBAT_325h.chksStrtVal_C "Data PDu Structure for HVBAT_325h / Calibration to indicate the initial value in a checksum logic." VALUE 0x8027037A Val_Wu16 65535.00 OneToOne 0.00 65535.00 FORMAT "%8.2" /end CHARACTERISTIC
/begin CHARACTERISTIC MoFFrm_Rx_DataPdu_HVBAT_325h.cntrAlvErrDeb_C "Data PDu Structure for HVBAT_325h / Alive counter debounce error calibration of RX Data Pdu" VALUE 0x8027037C Val_Wu16 65535.00 OneToOne 0.00 65535.00 FORMAT "%8.2" /end CHARACTERISTIC
/begin CHARACTERISTIC MoFFrm_Rx_DataPdu_HVBAT_325h.cntrCrcErrDeb_C "Data PDu Structure for HVBAT_325h / Alive counter debounce error calibration of RX Data Pdu" VALUE 0x8027037E Val_Wu16 65535.00 OneToOne 0.00 65535.00 FORMAT "%8.2" /end CHARACTERISTIC
/begin CHARACTERISTIC MoFFrm_Rx_DataPdu_HVBAT_325h.cntrMaxAlvDif_C "Data PDu Structure for HVBAT_325h / Complement of Counter cyclic calibration of RX Data Pdu" VALUE 0x80270380 Val_Wu8 255.0 OneToOne 0.00 255.0 FORMAT "%5.1" /end CHARACTERISTIC
/begin CHARACTERISTIC MoFFrm_Rx_DataPdu_HVBAT_325h.cntrTiOutDeb_C "Data PDu Structure for HVBAT_325h / Counter time out debounce calibration of Rx data PDU" VALUE 0x80270382 Val_Wu16 65535.00 OneToOne 0.00 65535.00 FORMAT "%8.2" /end CHARACTERISTIC
/begin CHARACTERISTIC MoFFrm_Rx_DataPdu_HVBAT_325h.crcId_C "Data PDu Structure for HVBAT_325h / CRC ID of Rx data PDU" VALUE 0x80270384 Val_Wu32 4294967295.00 OneToOne 0.00 4294967295.00 FORMAT "%13.2" /end CHARACTERISTIC
/begin CHARACTERISTIC MoFFrm_Rx_DataPdu_HVBAT_325h.cycTi_C "Data PDu Structure for HVBAT_325h / cycle time from bus matrix" VALUE 0x80270388 Val_Wu16 65535.00 OneToOne 0.00 65535.00 FORMAT "%8.2" /end CHARACTERISTIC
/begin CHARACTERISTIC MoFFrm_Rx_DataPdu_HVBAT_325h.diChks_C "Data PDu Structure for HVBAT_325h / parameter to enable or disable manipulation of various checks" VALUE 0x8027038A Val_Wu8 255.0 OneToOne 0.00 255.0 FORMAT "%5.1" /end CHARACTERISTIC
/begin CHARACTERISTIC MoFFrm_Rx_DataPdu_HVBAT_325h.evalType_C "Data PDu Structure for HVBAT_325h / evaluation type" VALUE 0x8027038B Val_Wu8 255.0 OneToOne 0.00 255.0 FORMAT "%5.1" /end CHARACTERISTIC
/begin CHARACTERISTIC MoFFrm_Rx_DataPdu_HVBAT_325h.maskAlvCntr_C "Data PDu Structure for HVBAT_325h / Alive counter start bit position of Rx data PDU" VALUE 0x8027038C Val_Wu8 255.0 OneToOne 0.00 255.0 FORMAT "%5.1" /end CHARACTERISTIC
/begin CHARACTERISTIC MoFFrm_Rx_DataPdu_HVBAT_325h.posnAlvCntrStrtBit_C "Data PDu Structure for HVBAT_325h / Alive counter start bit calibration of of Data PDU Rx" VALUE 0x8027038E Val_Wu16 65535.00 OneToOne 0.00 65535.00 FORMAT "%8.2" /end CHARACTERISTIC
/begin CHARACTERISTIC MoFFrm_Rx_DataPdu_HVBAT_325h.posnCrcCalcEndByte_C "Data PDu Structure for HVBAT_325h / End byte of CRC calculation position of Data PDU Rx" VALUE 0x80270390 Val_Wu8 255.0 OneToOne 0.00 255.0 FORMAT "%5.1" /end CHARACTERISTIC
/begin CHARACTERISTIC MoFFrm_Rx_DataPdu_HVBAT_325h.posnCrcCalcStrtByte_C "Data PDu Structure for HVBAT_325h / Start byte of CRC calculation position of Data PDU Rx" VALUE 0x80270391 Val_Wu8 255.0 OneToOne 0.00 255.0 FORMAT "%5.1" /end CHARACTERISTIC
/begin CHARACTERISTIC MoFFrm_Rx_DataPdu_HVBAT_325h.posnCrcStrtBit_C "Data PDu Structure for HVBAT_325h / CRC start bit position of Rx data PDU" VALUE 0x80270392 Val_Wu16 65535.00 OneToOne 0.00 65535.00 FORMAT "%8.2" /end CHARACTERISTIC
/begin CHARACTERISTIC MoFFrm_Rx_DataPdu_HVBAT_325h.sigLenAlvCntr_C "Data PDu Structure for HVBAT_325h / Alive counter signal length of Rx data PDU" VALUE 0x80270394 Val_Wu8 31.00 OneToOne 1.00 32.00 FORMAT "%5.2" EXTENDED_LIMITS 0.00 255.0 /end CHARACTERISTIC
/begin CHARACTERISTIC MoFFrm_Rx_DataPdu_HVBAT_325h.sigLenCrc_C "Data PDu Structure for HVBAT_325h / CRC calibration signal length of Rx data PDU" VALUE 0x80270395 Val_Wu8 31.00 OneToOne 1.00 32.00 FORMAT "%5.2" EXTENDED_LIMITS 0.00 255.0 /end CHARACTERISTIC
/begin CHARACTERISTIC MoFFrm_Rx_DataPdu_INV_217h.bufLen_C "Data PDu Structure for INV_217h / parameter to indicate the buffer length of the receiving PDU" VALUE 0x802703A0 Val_Wu8 255.0 OneToOne 0.00 255.0 FORMAT "%5.1" /end CHARACTERISTIC
/begin CHARACTERISTIC MoFFrm_Rx_DataPdu_INV_217h.bytOrderAlvCntr_C "Data PDu Structure for INV_217h / Alive counter calibration of RX Data Pdu" VALUE 0x802703A1 Val_Wu8 1.000 OneToOne 0.00 1.000 FORMAT "%5.3" EXTENDED_LIMITS 0.00 255.0 /end CHARACTERISTIC
/begin CHARACTERISTIC MoFFrm_Rx_DataPdu_INV_217h.bytOrderCrc_C "Data PDu Structure for INV_217h / CRC calibration of RX Data Pdu" VALUE 0x802703A2 Val_Wu8 1.000 OneToOne 0.00 1.000 FORMAT "%5.3" EXTENDED_LIMITS 0.00 255.0 /end CHARACTERISTIC
/begin CHARACTERISTIC MoFFrm_Rx_DataPdu_INV_217h.chksEndVal_C "Data PDu Structure for INV_217h / Calibration to indicate the XOR value in a checksum logic." VALUE 0x802703A4 Val_Wu16 65535.00 OneToOne 0.00 65535.00 FORMAT "%8.2" /end CHARACTERISTIC
/begin CHARACTERISTIC MoFFrm_Rx_DataPdu_INV_217h.chksStrtVal_C "Data PDu Structure for INV_217h / Calibration to indicate the initial value in a checksum logic." VALUE 0x802703A6 Val_Wu16 65535.00 OneToOne 0.00 65535.00 FORMAT "%8.2" /end CHARACTERISTIC
/begin CHARACTERISTIC MoFFrm_Rx_DataPdu_INV_217h.cntrAlvErrDeb_C "Data PDu Structure for INV_217h / Alive counter debounce error calibration of RX Data Pdu" VALUE 0x802703A8 Val_Wu16 65535.00 OneToOne 0.00 65535.00 FORMAT "%8.2" /end CHARACTERISTIC
/begin CHARACTERISTIC MoFFrm_Rx_DataPdu_INV_217h.cntrCrcErrDeb_C "Data PDu Structure for INV_217h / Alive counter debounce error calibration of RX Data Pdu" VALUE 0x802703AA Val_Wu16 65535.00 OneToOne 0.00 65535.00 FORMAT "%8.2" /end CHARACTERISTIC
/begin CHARACTERISTIC MoFFrm_Rx_DataPdu_INV_217h.cntrMaxAlvDif_C "Data PDu Structure for INV_217h / Complement of Counter cyclic calibration of RX Data Pdu" VALUE 0x802703AC Val_Wu8 255.0 OneToOne 0.00 255.0 FORMAT "%5.1" /end CHARACTERISTIC
/begin CHARACTERISTIC MoFFrm_Rx_DataPdu_INV_217h.cntrTiOutDeb_C "Data PDu Structure for INV_217h / Counter time out debounce calibration of Rx data PDU" VALUE 0x802703AE Val_Wu16 65535.00 OneToOne 0.00 65535.00 FORMAT "%8.2" /end CHARACTERISTIC
/begin CHARACTERISTIC MoFFrm_Rx_DataPdu_INV_217h.crcId_C "Data PDu Structure for INV_217h / CRC ID of Rx data PDU" VALUE 0x802703B0 Val_Wu32 4294967295.00 OneToOne 0.00 4294967295.00 FORMAT "%13.2" /end CHARACTERISTIC
/begin CHARACTERISTIC MoFFrm_Rx_DataPdu_INV_217h.cycTi_C "Data PDu Structure for INV_217h / cycle time from bus matrix" VALUE 0x802703B4 Val_Wu16 65535.00 OneToOne 0.00 65535.00 FORMAT "%8.2" /end CHARACTERISTIC
/begin CHARACTERISTIC MoFFrm_Rx_DataPdu_INV_217h.diChks_C "Data PDu Structure for INV_217h / parameter to enable or disable manipulation of various checks" VALUE 0x802703B6 Val_Wu8 255.0 OneToOne 0.00 255.0 FORMAT "%5.1" /end CHARACTERISTIC
/begin CHARACTERISTIC MoFFrm_Rx_DataPdu_INV_217h.evalType_C "Data PDu Structure for INV_217h / evaluation type" VALUE 0x802703B7 Val_Wu8 255.0 OneToOne 0.00 255.0 FORMAT "%5.1" /end CHARACTERISTIC
/begin CHARACTERISTIC MoFFrm_Rx_DataPdu_INV_217h.maskAlvCntr_C "Data PDu Structure for INV_217h / Alive counter start bit position of Rx data PDU" VALUE 0x802703B8 Val_Wu8 255.0 OneToOne 0.00 255.0 FORMAT "%5.1" /end CHARACTERISTIC
/begin CHARACTERISTIC MoFFrm_Rx_DataPdu_INV_217h.posnAlvCntrStrtBit_C "Data PDu Structure for INV_217h / Alive counter start bit calibration of of Data PDU Rx" VALUE 0x802703BA Val_Wu16 65535.00 OneToOne 0.00 65535.00 FORMAT "%8.2" /end CHARACTERISTIC
/begin CHARACTERISTIC MoFFrm_Rx_DataPdu_INV_217h.posnCrcCalcEndByte_C "Data PDu Structure for INV_217h / End byte of CRC calculation position of Data PDU Rx" VALUE 0x802703BC Val_Wu8 255.0 OneToOne 0.00 255.0 FORMAT "%5.1" /end CHARACTERISTIC
/begin CHARACTERISTIC MoFFrm_Rx_DataPdu_INV_217h.posnCrcCalcStrtByte_C "Data PDu Structure for INV_217h / Start byte of CRC calculation position of Data PDU Rx" VALUE 0x802703BD Val_Wu8 255.0 OneToOne 0.00 255.0 FORMAT "%5.1" /end CHARACTERISTIC
/begin CHARACTERISTIC MoFFrm_Rx_DataPdu_INV_217h.posnCrcStrtBit_C "Data PDu Structure for INV_217h / CRC start bit position of Rx data PDU" VALUE 0x802703BE Val_Wu16 65535.00 OneToOne 0.00 65535.00 FORMAT "%8.2" /end CHARACTERISTIC
/begin CHARACTERISTIC MoFFrm_Rx_DataPdu_INV_217h.sigLenAlvCntr_C "Data PDu Structure for INV_217h / Alive counter signal length of Rx data PDU" VALUE 0x802703C0 Val_Wu8 31.00 OneToOne 1.00 32.00 FORMAT "%5.2" EXTENDED_LIMITS 0.00 255.0 /end CHARACTERISTIC
/begin CHARACTERISTIC MoFFrm_Rx_DataPdu_INV_217h.sigLenCrc_C "Data PDu Structure for INV_217h / CRC calibration signal length of Rx data PDU" VALUE 0x802703C1 Val_Wu8 31.00 OneToOne 1.00 32.00 FORMAT "%5.2" EXTENDED_LIMITS 0.00 255.0 /end CHARACTERISTIC
/begin CHARACTERISTIC MoFFrm_Rx_DataPdu_INV_237.bufLen_C "Data PDu Structure for INV_237 / parameter to indicate the buffer length of the receiving PDU" VALUE 0x802703CC Val_Wu8 255.0 OneToOne 0.00 255.0 FORMAT "%5.1" /end CHARACTERISTIC
/begin CHARACTERISTIC MoFFrm_Rx_DataPdu_INV_237.bytOrderAlvCntr_C "Data PDu Structure for INV_237 / Alive counter calibration of RX Data Pdu" VALUE 0x802703CD Val_Wu8 1.000 OneToOne 0.00 1.000 FORMAT "%5.3" EXTENDED_LIMITS 0.00 255.0 /end CHARACTERISTIC
/begin CHARACTERISTIC MoFFrm_Rx_DataPdu_INV_237.bytOrderCrc_C "Data PDu Structure for INV_237 / CRC calibration of RX Data Pdu" VALUE 0x802703CE Val_Wu8 1.000 OneToOne 0.00 1.000 FORMAT "%5.3" EXTENDED_LIMITS 0.00 255.0 /end CHARACTERISTIC
/begin CHARACTERISTIC MoFFrm_Rx_DataPdu_INV_237.chksEndVal_C "Data PDu Structure for INV_237 / Calibration to indicate the XOR value in a checksum logic." VALUE 0x802703D0 Val_Wu16 65535.00 OneToOne 0.00 65535.00 FORMAT "%8.2" /end CHARACTERISTIC
/begin CHARACTERISTIC MoFFrm_Rx_DataPdu_INV_237.chksStrtVal_C "Data PDu Structure for INV_237 / Calibration to indicate the initial value in a checksum logic." VALUE 0x802703D2 Val_Wu16 65535.00 OneToOne 0.00 65535.00 FORMAT "%8.2" /end CHARACTERISTIC
/begin CHARACTERISTIC MoFFrm_Rx_DataPdu_INV_237.cntrAlvErrDeb_C "Data PDu Structure for INV_237 / Alive counter debounce error calibration of RX Data Pdu" VALUE 0x802703D4 Val_Wu16 65535.00 OneToOne 0.00 65535.00 FORMAT "%8.2" /end CHARACTERISTIC
/begin CHARACTERISTIC MoFFrm_Rx_DataPdu_INV_237.cntrCrcErrDeb_C "Data PDu Structure for INV_237 / Alive counter debounce error calibration of RX Data Pdu" VALUE 0x802703D6 Val_Wu16 65535.00 OneToOne 0.00 65535.00 FORMAT "%8.2" /end CHARACTERISTIC
/begin CHARACTERISTIC MoFFrm_Rx_DataPdu_INV_237.cntrMaxAlvDif_C "Data PDu Structure for INV_237 / Complement of Counter cyclic calibration of RX Data Pdu" VALUE 0x802703D8 Val_Wu8 255.0 OneToOne 0.00 255.0 FORMAT "%5.1" /end CHARACTERISTIC
/begin CHARACTERISTIC MoFFrm_Rx_DataPdu_INV_237.cntrTiOutDeb_C "Data PDu Structure for INV_237 / Counter time out debounce calibration of Rx data PDU" VALUE 0x802703DA Val_Wu16 65535.00 OneToOne 0.00 65535.00 FORMAT "%8.2" /end CHARACTERISTIC
/begin CHARACTERISTIC MoFFrm_Rx_DataPdu_INV_237.crcId_C "Data PDu Structure for INV_237 / CRC ID of Rx data PDU" VALUE 0x802703DC Val_Wu32 4294967295.00 OneToOne 0.00 4294967295.00 FORMAT "%13.2" /end CHARACTERISTIC
/begin CHARACTERISTIC MoFFrm_Rx_DataPdu_INV_237.cycTi_C "Data PDu Structure for INV_237 / cycle time from bus matrix" VALUE 0x802703E0 Val_Wu16 65535.00 OneToOne 0.00 65535.00 FORMAT "%8.2" /end CHARACTERISTIC
/begin CHARACTERISTIC MoFFrm_Rx_DataPdu_INV_237.diChks_C "Data PDu Structure for INV_237 / parameter to enable or disable manipulation of various checks" VALUE 0x802703E2 Val_Wu8 255.0 OneToOne 0.00 255.0 FORMAT "%5.1" /end CHARACTERISTIC
/begin CHARACTERISTIC MoFFrm_Rx_DataPdu_INV_237.evalType_C "Data PDu Structure for INV_237 / evaluation type" VALUE 0x802703E3 Val_Wu8 255.0 OneToOne 0.00 255.0 FORMAT "%5.1" /end CHARACTERISTIC
/begin CHARACTERISTIC MoFFrm_Rx_DataPdu_INV_237.maskAlvCntr_C "Data PDu Structure for INV_237 / Alive counter start bit position of Rx data PDU" VALUE 0x802703E4 Val_Wu8 255.0 OneToOne 0.00 255.0 FORMAT "%5.1" /end CHARACTERISTIC
/begin CHARACTERISTIC MoFFrm_Rx_DataPdu_INV_237.posnAlvCntrStrtBit_C "Data PDu Structure for INV_237 / Alive counter start bit calibration of of Data PDU Rx" VALUE 0x802703E6 Val_Wu16 65535.00 OneToOne 0.00 65535.00 FORMAT "%8.2" /end CHARACTERISTIC
/begin CHARACTERISTIC MoFFrm_Rx_DataPdu_INV_237.posnCrcCalcEndByte_C "Data PDu Structure for INV_237 / End byte of CRC calculation position of Data PDU Rx" VALUE 0x802703E8 Val_Wu8 255.0 OneToOne 0.00 255.0 FORMAT "%5.1" /end CHARACTERISTIC
/begin CHARACTERISTIC MoFFrm_Rx_DataPdu_INV_237.posnCrcCalcStrtByte_C "Data PDu Structure for INV_237 / Start byte of CRC calculation position of Data PDU Rx" VALUE 0x802703E9 Val_Wu8 255.0 OneToOne 0.00 255.0 FORMAT "%5.1" /end CHARACTERISTIC
/begin CHARACTERISTIC MoFFrm_Rx_DataPdu_INV_237.posnCrcStrtBit_C "Data PDu Structure for INV_237 / CRC start bit position of Rx data PDU" VALUE 0x802703EA Val_Wu16 65535.00 OneToOne 0.00 65535.00 FORMAT "%8.2" /end CHARACTERISTIC
/begin CHARACTERISTIC MoFFrm_Rx_DataPdu_INV_237.sigLenAlvCntr_C "Data PDu Structure for INV_237 / Alive counter signal length of Rx data PDU" VALUE 0x802703EC Val_Wu8 31.00 OneToOne 1.00 32.00 FORMAT "%5.2" EXTENDED_LIMITS 0.00 255.0 /end CHARACTERISTIC
/begin CHARACTERISTIC MoFFrm_Rx_DataPdu_INV_237.sigLenCrc_C "Data PDu Structure for INV_237 / CRC calibration signal length of Rx data PDU" VALUE 0x802703ED Val_Wu8 31.00 OneToOne 1.00 32.00 FORMAT "%5.2" EXTENDED_LIMITS 0.00 255.0 /end CHARACTERISTIC
/begin CHARACTERISTIC MoFFrm_Rx_DataPdu_INV_427h.bufLen_C "Data PDu Structure for INV_427h / parameter to indicate the buffer length of the receiving PDU" VALUE 0x802703F8 Val_Wu8 255.0 OneToOne 0.00 255.0 FORMAT "%5.1" /end CHARACTERISTIC
/begin CHARACTERISTIC MoFFrm_Rx_DataPdu_INV_427h.bytOrderAlvCntr_C "Data PDu Structure for INV_427h / Alive counter calibration of RX Data Pdu" VALUE 0x802703F9 Val_Wu8 1.000 OneToOne 0.00 1.000 FORMAT "%5.3" EXTENDED_LIMITS 0.00 255.0 /end CHARACTERISTIC
/begin CHARACTERISTIC MoFFrm_Rx_DataPdu_INV_427h.bytOrderCrc_C "Data PDu Structure for INV_427h / CRC calibration of RX Data Pdu" VALUE 0x802703FA Val_Wu8 1.000 OneToOne 0.00 1.000 FORMAT "%5.3" EXTENDED_LIMITS 0.00 255.0 /end CHARACTERISTIC
/begin CHARACTERISTIC MoFFrm_Rx_DataPdu_INV_427h.chksEndVal_C "Data PDu Structure for INV_427h / Calibration to indicate the XOR value in a checksum logic." VALUE 0x802703FC Val_Wu16 65535.00 OneToOne 0.00 65535.00 FORMAT "%8.2" /end CHARACTERISTIC
/begin CHARACTERISTIC MoFFrm_Rx_DataPdu_INV_427h.chksStrtVal_C "Data PDu Structure for INV_427h / Calibration to indicate the initial value in a checksum logic." VALUE 0x802703FE Val_Wu16 65535.00 OneToOne 0.00 65535.00 FORMAT "%8.2" /end CHARACTERISTIC
/begin CHARACTERISTIC MoFFrm_Rx_DataPdu_INV_427h.cntrAlvErrDeb_C "Data PDu Structure for INV_427h / Alive counter debounce error calibration of RX Data Pdu" VALUE 0x80270400 Val_Wu16 65535.00 OneToOne 0.00 65535.00 FORMAT "%8.2" /end CHARACTERISTIC
/begin CHARACTERISTIC MoFFrm_Rx_DataPdu_INV_427h.cntrCrcErrDeb_C "Data PDu Structure for INV_427h / Alive counter debounce error calibration of RX Data Pdu" VALUE 0x80270402 Val_Wu16 65535.00 OneToOne 0.00 65535.00 FORMAT "%8.2" /end CHARACTERISTIC
/begin CHARACTERISTIC MoFFrm_Rx_DataPdu_INV_427h.cntrMaxAlvDif_C "Data PDu Structure for INV_427h / Complement of Counter cyclic calibration of RX Data Pdu" VALUE 0x80270404 Val_Wu8 255.0 OneToOne 0.00 255.0 FORMAT "%5.1" /end CHARACTERISTIC
/begin CHARACTERISTIC MoFFrm_Rx_DataPdu_INV_427h.cntrTiOutDeb_C "Data PDu Structure for INV_427h / Counter time out debounce calibration of Rx data PDU" VALUE 0x80270406 Val_Wu16 65535.00 OneToOne 0.00 65535.00 FORMAT "%8.2" /end CHARACTERISTIC
/begin CHARACTERISTIC MoFFrm_Rx_DataPdu_INV_427h.crcId_C "Data PDu Structure for INV_427h / CRC ID of Rx data PDU" VALUE 0x80270408 Val_Wu32 4294967295.00 OneToOne 0.00 4294967295.00 FORMAT "%13.2" /end CHARACTERISTIC
/begin CHARACTERISTIC MoFFrm_Rx_DataPdu_INV_427h.cycTi_C "Data PDu Structure for INV_427h / cycle time from bus matrix" VALUE 0x8027040C Val_Wu16 65535.00 OneToOne 0.00 65535.00 FORMAT "%8.2" /end CHARACTERISTIC
/begin CHARACTERISTIC MoFFrm_Rx_DataPdu_INV_427h.diChks_C "Data PDu Structure for INV_427h / parameter to enable or disable manipulation of various checks" VALUE 0x8027040E Val_Wu8 255.0 OneToOne 0.00 255.0 FORMAT "%5.1" /end CHARACTERISTIC
/begin CHARACTERISTIC MoFFrm_Rx_DataPdu_INV_427h.evalType_C "Data PDu Structure for INV_427h / evaluation type" VALUE 0x8027040F Val_Wu8 255.0 OneToOne 0.00 255.0 FORMAT "%5.1" /end CHARACTERISTIC
/begin CHARACTERISTIC MoFFrm_Rx_DataPdu_INV_427h.maskAlvCntr_C "Data PDu Structure for INV_427h / Alive counter start bit position of Rx data PDU" VALUE 0x80270410 Val_Wu8 255.0 OneToOne 0.00 255.0 FORMAT "%5.1" /end CHARACTERISTIC
/begin CHARACTERISTIC MoFFrm_Rx_DataPdu_INV_427h.posnAlvCntrStrtBit_C "Data PDu Structure for INV_427h / Alive counter start bit calibration of of Data PDU Rx" VALUE 0x80270412 Val_Wu16 65535.00 OneToOne 0.00 65535.00 FORMAT "%8.2" /end CHARACTERISTIC
/begin CHARACTERISTIC MoFFrm_Rx_DataPdu_INV_427h.posnCrcCalcEndByte_C "Data PDu Structure for INV_427h / End byte of CRC calculation position of Data PDU Rx" VALUE 0x80270414 Val_Wu8 255.0 OneToOne 0.00 255.0 FORMAT "%5.1" /end CHARACTERISTIC
/begin CHARACTERISTIC MoFFrm_Rx_DataPdu_INV_427h.posnCrcCalcStrtByte_C "Data PDu Structure for INV_427h / Start byte of CRC calculation position of Data PDU Rx" VALUE 0x80270415 Val_Wu8 255.0 OneToOne 0.00 255.0 FORMAT "%5.1" /end CHARACTERISTIC
/begin CHARACTERISTIC MoFFrm_Rx_DataPdu_INV_427h.posnCrcStrtBit_C "Data PDu Structure for INV_427h / CRC start bit position of Rx data PDU" VALUE 0x80270416 Val_Wu16 65535.00 OneToOne 0.00 65535.00 FORMAT "%8.2" /end CHARACTERISTIC
/begin CHARACTERISTIC MoFFrm_Rx_DataPdu_INV_427h.sigLenAlvCntr_C "Data PDu Structure for INV_427h / Alive counter signal length of Rx data PDU" VALUE 0x80270418 Val_Wu8 31.00 OneToOne 1.00 32.00 FORMAT "%5.2" EXTENDED_LIMITS 0.00 255.0 /end CHARACTERISTIC
/begin CHARACTERISTIC MoFFrm_Rx_DataPdu_INV_427h.sigLenCrc_C "Data PDu Structure for INV_427h / CRC calibration signal length of Rx data PDU" VALUE 0x80270419 Val_Wu8 31.00 OneToOne 1.00 32.00 FORMAT "%5.2" EXTENDED_LIMITS 0.00 255.0 /end CHARACTERISTIC
/begin CHARACTERISTIC MoFFrm_Rx_DataPdu_IS_DAT_ABR_50Dh.bufLen_C "Data PDu Structure for IS_DAT_ABR_50Dh / parameter to indicate the buffer length of the receiving PDU" VALUE 0x80270424 Val_Wu8 255.0 OneToOne 0.00 255.0 FORMAT "%5.1" /end CHARACTERISTIC
/begin CHARACTERISTIC MoFFrm_Rx_DataPdu_IS_DAT_ABR_50Dh.bytOrderAlvCntr_C "Data PDu Structure for IS_DAT_ABR_50Dh / Alive counter calibration of RX Data Pdu" VALUE 0x80270425 Val_Wu8 1.000 OneToOne 0.00 1.000 FORMAT "%5.3" EXTENDED_LIMITS 0.00 255.0 /end CHARACTERISTIC
/begin CHARACTERISTIC MoFFrm_Rx_DataPdu_IS_DAT_ABR_50Dh.bytOrderCrc_C "Data PDu Structure for IS_DAT_ABR_50Dh / CRC calibration of RX Data Pdu" VALUE 0x80270426 Val_Wu8 1.000 OneToOne 0.00 1.000 FORMAT "%5.3" EXTENDED_LIMITS 0.00 255.0 /end CHARACTERISTIC
/begin CHARACTERISTIC MoFFrm_Rx_DataPdu_IS_DAT_ABR_50Dh.chksEndVal_C "Data PDu Structure for IS_DAT_ABR_50Dh / Calibration to indicate the XOR value in a checksum logic." VALUE 0x80270428 Val_Wu16 65535.00 OneToOne 0.00 65535.00 FORMAT "%8.2" /end CHARACTERISTIC
/begin CHARACTERISTIC MoFFrm_Rx_DataPdu_IS_DAT_ABR_50Dh.chksStrtVal_C "Data PDu Structure for IS_DAT_ABR_50Dh / Calibration to indicate the initial value in a checksum logic." VALUE 0x8027042A Val_Wu16 65535.00 OneToOne 0.00 65535.00 FORMAT "%8.2" /end CHARACTERISTIC
/begin CHARACTERISTIC MoFFrm_Rx_DataPdu_IS_DAT_ABR_50Dh.cntrAlvErrDeb_C "Data PDu Structure for IS_DAT_ABR_50Dh / Alive counter debounce error calibration of RX Data Pdu" VALUE 0x8027042C Val_Wu16 65535.00 OneToOne 0.00 65535.00 FORMAT "%8.2" /end CHARACTERISTIC
/begin CHARACTERISTIC MoFFrm_Rx_DataPdu_IS_DAT_ABR_50Dh.cntrCrcErrDeb_C "Data PDu Structure for IS_DAT_ABR_50Dh / Alive counter debounce error calibration of RX Data Pdu" VALUE 0x8027042E Val_Wu16 65535.00 OneToOne 0.00 65535.00 FORMAT "%8.2" /end CHARACTERISTIC
/begin CHARACTERISTIC MoFFrm_Rx_DataPdu_IS_DAT_ABR_50Dh.cntrMaxAlvDif_C "Data PDu Structure for IS_DAT_ABR_50Dh / Complement of Counter cyclic calibration of RX Data Pdu" VALUE 0x80270430 Val_Wu8 255.0 OneToOne 0.00 255.0 FORMAT "%5.1" /end CHARACTERISTIC
/begin CHARACTERISTIC MoFFrm_Rx_DataPdu_IS_DAT_ABR_50Dh.cntrTiOutDeb_C "Data PDu Structure for IS_DAT_ABR_50Dh / Counter time out debounce calibration of Rx data PDU" VALUE 0x80270432 Val_Wu16 65535.00 OneToOne 0.00 65535.00 FORMAT "%8.2" /end CHARACTERISTIC
/begin CHARACTERISTIC MoFFrm_Rx_DataPdu_IS_DAT_ABR_50Dh.crcId_C "Data PDu Structure for IS_DAT_ABR_50Dh / CRC ID of Rx data PDU" VALUE 0x80270434 Val_Wu32 4294967295.00 OneToOne 0.00 4294967295.00 FORMAT "%13.2" /end CHARACTERISTIC
/begin CHARACTERISTIC MoFFrm_Rx_DataPdu_IS_DAT_ABR_50Dh.cycTi_C "Data PDu Structure for IS_DAT_ABR_50Dh / cycle time from bus matrix" VALUE 0x80270438 Val_Wu16 65535.00 OneToOne 0.00 65535.00 FORMAT "%8.2" /end CHARACTERISTIC
/begin CHARACTERISTIC MoFFrm_Rx_DataPdu_IS_DAT_ABR_50Dh.diChks_C "Data PDu Structure for IS_DAT_ABR_50Dh / parameter to enable or disable manipulation of various checks" VALUE 0x8027043A Val_Wu8 255.0 OneToOne 0.00 255.0 FORMAT "%5.1" /end CHARACTERISTIC
/begin CHARACTERISTIC MoFFrm_Rx_DataPdu_IS_DAT_ABR_50Dh.evalType_C "Data PDu Structure for IS_DAT_ABR_50Dh / evaluation type" VALUE 0x8027043B Val_Wu8 255.0 OneToOne 0.00 255.0 FORMAT "%5.1" /end CHARACTERISTIC
/begin CHARACTERISTIC MoFFrm_Rx_DataPdu_IS_DAT_ABR_50Dh.maskAlvCntr_C "Data PDu Structure for IS_DAT_ABR_50Dh / Alive counter start bit position of Rx data PDU" VALUE 0x8027043C Val_Wu8 255.0 OneToOne 0.00 255.0 FORMAT "%5.1" /end CHARACTERISTIC
/begin CHARACTERISTIC MoFFrm_Rx_DataPdu_IS_DAT_ABR_50Dh.posnAlvCntrStrtBit_C "Data PDu Structure for IS_DAT_ABR_50Dh / Alive counter start bit calibration of of Data PDU Rx" VALUE 0x8027043E Val_Wu16 65535.00 OneToOne 0.00 65535.00 FORMAT "%8.2" /end CHARACTERISTIC
/begin CHARACTERISTIC MoFFrm_Rx_DataPdu_IS_DAT_ABR_50Dh.posnCrcCalcEndByte_C "Data PDu Structure for IS_DAT_ABR_50Dh / End byte of CRC calculation position of Data PDU Rx" VALUE 0x80270440 Val_Wu8 255.0 OneToOne 0.00 255.0 FORMAT "%5.1" /end CHARACTERISTIC
/begin CHARACTERISTIC MoFFrm_Rx_DataPdu_IS_DAT_ABR_50Dh.posnCrcCalcStrtByte_C "Data PDu Structure for IS_DAT_ABR_50Dh / Start byte of CRC calculation position of Data PDU Rx" VALUE 0x80270441 Val_Wu8 255.0 OneToOne 0.00 255.0 FORMAT "%5.1" /end CHARACTERISTIC
/begin CHARACTERISTIC MoFFrm_Rx_DataPdu_IS_DAT_ABR_50Dh.posnCrcStrtBit_C "Data PDu Structure for IS_DAT_ABR_50Dh / CRC start bit position of Rx data PDU" VALUE 0x80270442 Val_Wu16 65535.00 OneToOne 0.00 65535.00 FORMAT "%8.2" /end CHARACTERISTIC
/begin CHARACTERISTIC MoFFrm_Rx_DataPdu_IS_DAT_ABR_50Dh.sigLenAlvCntr_C "Data PDu Structure for IS_DAT_ABR_50Dh / Alive counter signal length of Rx data PDU" VALUE 0x80270444 Val_Wu8 31.00 OneToOne 1.00 32.00 FORMAT "%5.2" EXTENDED_LIMITS 0.00 255.0 /end CHARACTERISTIC
/begin CHARACTERISTIC MoFFrm_Rx_DataPdu_IS_DAT_ABR_50Dh.sigLenCrc_C "Data PDu Structure for IS_DAT_ABR_50Dh / CRC calibration signal length of Rx data PDU" VALUE 0x80270445 Val_Wu8 31.00 OneToOne 1.00 32.00 FORMAT "%5.2" EXTENDED_LIMITS 0.00 255.0 /end CHARACTERISTIC
/begin CHARACTERISTIC MoFFrm_Rx_DataPdu_IS_DAT_BSI_412h.bufLen_C "Data PDu Structure forIS_DAT_BSI_412h / parameter to indicate the buffer length of the receiving PDU" VALUE 0x80270450 Val_Wu8 255.0 OneToOne 0.00 255.0 FORMAT "%5.1" /end CHARACTERISTIC
/begin CHARACTERISTIC MoFFrm_Rx_DataPdu_IS_DAT_BSI_412h.bytOrderAlvCntr_C "Data PDu Structure forIS_DAT_BSI_412h / Alive counter calibration of RX Data Pdu" VALUE 0x80270451 Val_Wu8 1.000 OneToOne 0.00 1.000 FORMAT "%5.3" EXTENDED_LIMITS 0.00 255.0 /end CHARACTERISTIC
/begin CHARACTERISTIC MoFFrm_Rx_DataPdu_IS_DAT_BSI_412h.bytOrderCrc_C "Data PDu Structure forIS_DAT_BSI_412h / CRC calibration of RX Data Pdu" VALUE 0x80270452 Val_Wu8 1.000 OneToOne 0.00 1.000 FORMAT "%5.3" EXTENDED_LIMITS 0.00 255.0 /end CHARACTERISTIC
/begin CHARACTERISTIC MoFFrm_Rx_DataPdu_IS_DAT_BSI_412h.chksEndVal_C "Data PDu Structure forIS_DAT_BSI_412h / Calibration to indicate the XOR value in a checksum logic." VALUE 0x80270454 Val_Wu16 65535.00 OneToOne 0.00 65535.00 FORMAT "%8.2" /end CHARACTERISTIC
/begin CHARACTERISTIC MoFFrm_Rx_DataPdu_IS_DAT_BSI_412h.chksStrtVal_C "Data PDu Structure forIS_DAT_BSI_412h / Calibration to indicate the initial value in a checksum logic." VALUE 0x80270456 Val_Wu16 65535.00 OneToOne 0.00 65535.00 FORMAT "%8.2" /end CHARACTERISTIC
/begin CHARACTERISTIC MoFFrm_Rx_DataPdu_IS_DAT_BSI_412h.cntrAlvErrDeb_C "Data PDu Structure forIS_DAT_BSI_412h / Alive counter debounce error calibration of RX Data Pdu" VALUE 0x80270458 Val_Wu16 65535.00 OneToOne 0.00 65535.00 FORMAT "%8.2" /end CHARACTERISTIC
/begin CHARACTERISTIC MoFFrm_Rx_DataPdu_IS_DAT_BSI_412h.cntrCrcErrDeb_C "Data PDu Structure forIS_DAT_BSI_412h / Alive counter debounce error calibration of RX Data Pdu" VALUE 0x8027045A Val_Wu16 65535.00 OneToOne 0.00 65535.00 FORMAT "%8.2" /end CHARACTERISTIC
/begin CHARACTERISTIC MoFFrm_Rx_DataPdu_IS_DAT_BSI_412h.cntrMaxAlvDif_C "Data PDu Structure forIS_DAT_BSI_412h / Complement of Counter cyclic calibration of RX Data Pdu" VALUE 0x8027045C Val_Wu8 255.0 OneToOne 0.00 255.0 FORMAT "%5.1" /end CHARACTERISTIC
/begin CHARACTERISTIC MoFFrm_Rx_DataPdu_IS_DAT_BSI_412h.cntrTiOutDeb_C "Data PDu Structure forIS_DAT_BSI_412h / Counter time out debounce calibration of Rx data PDU" VALUE 0x8027045E Val_Wu16 65535.00 OneToOne 0.00 65535.00 FORMAT "%8.2" /end CHARACTERISTIC
/begin CHARACTERISTIC MoFFrm_Rx_DataPdu_IS_DAT_BSI_412h.crcId_C "Data PDu Structure forIS_DAT_BSI_412h / CRC ID of Rx data PDU" VALUE 0x80270460 Val_Wu32 4294967295.00 OneToOne 0.00 4294967295.00 FORMAT "%13.2" /end CHARACTERISTIC
/begin CHARACTERISTIC MoFFrm_Rx_DataPdu_IS_DAT_BSI_412h.cycTi_C "Data PDu Structure forIS_DAT_BSI_412h / cycle time from bus matrix" VALUE 0x80270464 Val_Wu16 65535.00 OneToOne 0.00 65535.00 FORMAT "%8.2" /end CHARACTERISTIC
/begin CHARACTERISTIC MoFFrm_Rx_DataPdu_IS_DAT_BSI_412h.diChks_C "Data PDu Structure forIS_DAT_BSI_412h / parameter to enable or disable manipulation of various checks" VALUE 0x80270466 Val_Wu8 255.0 OneToOne 0.00 255.0 FORMAT "%5.1" /end CHARACTERISTIC
/begin CHARACTERISTIC MoFFrm_Rx_DataPdu_IS_DAT_BSI_412h.evalType_C "Data PDu Structure forIS_DAT_BSI_412h / evaluation type" VALUE 0x80270467 Val_Wu8 255.0 OneToOne 0.00 255.0 FORMAT "%5.1" /end CHARACTERISTIC
/begin CHARACTERISTIC MoFFrm_Rx_DataPdu_IS_DAT_BSI_412h.maskAlvCntr_C "Data PDu Structure forIS_DAT_BSI_412h / Alive counter start bit position of Rx data PDU" VALUE 0x80270468 Val_Wu8 255.0 OneToOne 0.00 255.0 FORMAT "%5.1" /end CHARACTERISTIC
/begin CHARACTERISTIC MoFFrm_Rx_DataPdu_IS_DAT_BSI_412h.posnAlvCntrStrtBit_C "Data PDu Structure forIS_DAT_BSI_412h / Alive counter start bit calibration of of Data PDU Rx" VALUE 0x8027046A Val_Wu16 65535.00 OneToOne 0.00 65535.00 FORMAT "%8.2" /end CHARACTERISTIC
/begin CHARACTERISTIC MoFFrm_Rx_DataPdu_IS_DAT_BSI_412h.posnCrcCalcEndByte_C "Data PDu Structure forIS_DAT_BSI_412h / End byte of CRC calculation position of Data PDU Rx" VALUE 0x8027046C Val_Wu8 255.0 OneToOne 0.00 255.0 FORMAT "%5.1" /end CHARACTERISTIC
/begin CHARACTERISTIC MoFFrm_Rx_DataPdu_IS_DAT_BSI_412h.posnCrcCalcStrtByte_C "Data PDu Structure forIS_DAT_BSI_412h / Start byte of CRC calculation position of Data PDU Rx" VALUE 0x8027046D Val_Wu8 255.0 OneToOne 0.00 255.0 FORMAT "%5.1" /end CHARACTERISTIC
/begin CHARACTERISTIC MoFFrm_Rx_DataPdu_IS_DAT_BSI_412h.posnCrcStrtBit_C "Data PDu Structure forIS_DAT_BSI_412h / CRC start bit position of Rx data PDU" VALUE 0x8027046E Val_Wu16 65535.00 OneToOne 0.00 65535.00 FORMAT "%8.2" /end CHARACTERISTIC
/begin CHARACTERISTIC MoFFrm_Rx_DataPdu_IS_DAT_BSI_412h.sigLenAlvCntr_C "Data PDu Structure forIS_DAT_BSI_412h / Alive counter signal length of Rx data PDU" VALUE 0x80270470 Val_Wu8 31.00 OneToOne 1.00 32.00 FORMAT "%5.2" EXTENDED_LIMITS 0.00 255.0 /end CHARACTERISTIC
/begin CHARACTERISTIC MoFFrm_Rx_DataPdu_IS_DAT_BSI_412h.sigLenCrc_C "Data PDu Structure forIS_DAT_BSI_412h / CRC calibration signal length of Rx data PDU" VALUE 0x80270471 Val_Wu8 31.00 OneToOne 1.00 32.00 FORMAT "%5.2" EXTENDED_LIMITS 0.00 255.0 /end CHARACTERISTIC
/begin CHARACTERISTIC MoFFrm_Rx_DataPdu_IS_DYN_ABR_38Dh.bufLen_C "Data PDu Structure for IS_DYN_ABR_38Dh / parameter to indicate the buffer length of the receiving PDU" VALUE 0x8027047C Val_Wu8 255.0 OneToOne 0.00 255.0 FORMAT "%5.1" /end CHARACTERISTIC
/begin CHARACTERISTIC MoFFrm_Rx_DataPdu_IS_DYN_ABR_38Dh.bytOrderAlvCntr_C "Data PDu Structure for IS_DYN_ABR_38Dh / Alive counter calibration of RX Data Pdu" VALUE 0x8027047D Val_Wu8 1.000 OneToOne 0.00 1.000 FORMAT "%5.3" EXTENDED_LIMITS 0.00 255.0 /end CHARACTERISTIC
/begin CHARACTERISTIC MoFFrm_Rx_DataPdu_IS_DYN_ABR_38Dh.bytOrderCrc_C "Data PDu Structure for IS_DYN_ABR_38Dh / CRC calibration of RX Data Pdu" VALUE 0x8027047E Val_Wu8 1.000 OneToOne 0.00 1.000 FORMAT "%5.3" EXTENDED_LIMITS 0.00 255.0 /end CHARACTERISTIC
/begin CHARACTERISTIC MoFFrm_Rx_DataPdu_IS_DYN_ABR_38Dh.chksEndVal_C "Data PDu Structure for IS_DYN_ABR_38Dh / Calibration to indicate the XOR value in a checksum logic." VALUE 0x80270480 Val_Wu16 65535.00 OneToOne 0.00 65535.00 FORMAT "%8.2" /end CHARACTERISTIC
/begin CHARACTERISTIC MoFFrm_Rx_DataPdu_IS_DYN_ABR_38Dh.chksStrtVal_C "Data PDu Structure for IS_DYN_ABR_38Dh / Calibration to indicate the initial value in a checksum logic." VALUE 0x80270482 Val_Wu16 65535.00 OneToOne 0.00 65535.00 FORMAT "%8.2" /end CHARACTERISTIC
/begin CHARACTERISTIC MoFFrm_Rx_DataPdu_IS_DYN_ABR_38Dh.cntrAlvErrDeb_C "Data PDu Structure for IS_DYN_ABR_38Dh / Alive counter debounce error calibration of RX Data Pdu" VALUE 0x80270484 Val_Wu16 65535.00 OneToOne 0.00 65535.00 FORMAT "%8.2" /end CHARACTERISTIC
/begin CHARACTERISTIC MoFFrm_Rx_DataPdu_IS_DYN_ABR_38Dh.cntrCrcErrDeb_C "Data PDu Structure for IS_DYN_ABR_38Dh / Alive counter debounce error calibration of RX Data Pdu" VALUE 0x80270486 Val_Wu16 65535.00 OneToOne 0.00 65535.00 FORMAT "%8.2" /end CHARACTERISTIC
/begin CHARACTERISTIC MoFFrm_Rx_DataPdu_IS_DYN_ABR_38Dh.cntrMaxAlvDif_C "Data PDu Structure for IS_DYN_ABR_38Dh / Complement of Counter cyclic calibration of RX Data Pdu" VALUE 0x80270488 Val_Wu8 255.0 OneToOne 0.00 255.0 FORMAT "%5.1" /end CHARACTERISTIC
/begin CHARACTERISTIC MoFFrm_Rx_DataPdu_IS_DYN_ABR_38Dh.cntrTiOutDeb_C "Data PDu Structure for IS_DYN_ABR_38Dh / Counter time out debounce calibration of Rx data PDU" VALUE 0x8027048A Val_Wu16 65535.00 OneToOne 0.00 65535.00 FORMAT "%8.2" /end CHARACTERISTIC
/begin CHARACTERISTIC MoFFrm_Rx_DataPdu_IS_DYN_ABR_38Dh.crcId_C "Data PDu Structure for IS_DYN_ABR_38Dh / CRC ID of Rx data PDU" VALUE 0x8027048C Val_Wu32 4294967295.00 OneToOne 0.00 4294967295.00 FORMAT "%13.2" /end CHARACTERISTIC
/begin CHARACTERISTIC MoFFrm_Rx_DataPdu_IS_DYN_ABR_38Dh.cycTi_C "Data PDu Structure for IS_DYN_ABR_38Dh / cycle time from bus matrix" VALUE 0x80270490 Val_Wu16 65535.00 OneToOne 0.00 65535.00 FORMAT "%8.2" /end CHARACTERISTIC
/begin CHARACTERISTIC MoFFrm_Rx_DataPdu_IS_DYN_ABR_38Dh.diChks_C "Data PDu Structure for IS_DYN_ABR_38Dh / parameter to enable or disable manipulation of various checks" VALUE 0x80270492 Val_Wu8 255.0 OneToOne 0.00 255.0 FORMAT "%5.1" /end CHARACTERISTIC
/begin CHARACTERISTIC MoFFrm_Rx_DataPdu_IS_DYN_ABR_38Dh.evalType_C "Data PDu Structure for IS_DYN_ABR_38Dh / evaluation type" VALUE 0x80270493 Val_Wu8 255.0 OneToOne 0.00 255.0 FORMAT "%5.1" /end CHARACTERISTIC
/begin CHARACTERISTIC MoFFrm_Rx_DataPdu_IS_DYN_ABR_38Dh.maskAlvCntr_C "Data PDu Structure for IS_DYN_ABR_38Dh / Alive counter start bit position of Rx data PDU" VALUE 0x80270494 Val_Wu8 255.0 OneToOne 0.00 255.0 FORMAT "%5.1" /end CHARACTERISTIC
/begin CHARACTERISTIC MoFFrm_Rx_DataPdu_IS_DYN_ABR_38Dh.posnAlvCntrStrtBit_C "Data PDu Structure for IS_DYN_ABR_38Dh / Alive counter start bit calibration of of Data PDU Rx" VALUE 0x80270496 Val_Wu16 65535.00 OneToOne 0.00 65535.00 FORMAT "%8.2" /end CHARACTERISTIC
/begin CHARACTERISTIC MoFFrm_Rx_DataPdu_IS_DYN_ABR_38Dh.posnCrcCalcEndByte_C "Data PDu Structure for IS_DYN_ABR_38Dh / End byte of CRC calculation position of Data PDU Rx" VALUE 0x80270498 Val_Wu8 255.0 OneToOne 0.00 255.0 FORMAT "%5.1" /end CHARACTERISTIC
/begin CHARACTERISTIC MoFFrm_Rx_DataPdu_IS_DYN_ABR_38Dh.posnCrcCalcStrtByte_C "Data PDu Structure for IS_DYN_ABR_38Dh / Start byte of CRC calculation position of Data PDU Rx" VALUE 0x80270499 Val_Wu8 255.0 OneToOne 0.00 255.0 FORMAT "%5.1" /end CHARACTERISTIC
/begin CHARACTERISTIC MoFFrm_Rx_DataPdu_IS_DYN_ABR_38Dh.posnCrcStrtBit_C "Data PDu Structure for IS_DYN_ABR_38Dh / CRC start bit position of Rx data PDU" VALUE 0x8027049A Val_Wu16 65535.00 OneToOne 0.00 65535.00 FORMAT "%8.2" /end CHARACTERISTIC
/begin CHARACTERISTIC MoFFrm_Rx_DataPdu_IS_DYN_ABR_38Dh.sigLenAlvCntr_C "Data PDu Structure for IS_DYN_ABR_38Dh / Alive counter signal length of Rx data PDU" VALUE 0x8027049C Val_Wu8 31.00 OneToOne 1.00 32.00 FORMAT "%5.2" EXTENDED_LIMITS 0.00 255.0 /end CHARACTERISTIC
/begin CHARACTERISTIC MoFFrm_Rx_DataPdu_IS_DYN_ABR_38Dh.sigLenCrc_C "Data PDu Structure for IS_DYN_ABR_38Dh / CRC calibration signal length of Rx data PDU" VALUE 0x8027049D Val_Wu8 31.00 OneToOne 1.00 32.00 FORMAT "%5.2" EXTENDED_LIMITS 0.00 255.0 /end CHARACTERISTIC
/begin CHARACTERISTIC MoFFrm_Rx_DataPdu_PDU_BusVoltages_308.bufLen_C "Data PDu Structure for PDU_BusVoltages_308 / parameter to indicate the buffer length of the receiving PDU" VALUE 0x802704A8 Val_Wu8 255.0 OneToOne 0.00 255.0 FORMAT "%5.1" /end CHARACTERISTIC
/begin CHARACTERISTIC MoFFrm_Rx_DataPdu_PDU_BusVoltages_308.bytOrderAlvCntr_C "Data PDu Structure for PDU_BusVoltages_308 / Alive counter calibration of RX Data Pdu" VALUE 0x802704A9 Val_Wu8 1.000 OneToOne 0.00 1.000 FORMAT "%5.3" EXTENDED_LIMITS 0.00 255.0 /end CHARACTERISTIC
/begin CHARACTERISTIC MoFFrm_Rx_DataPdu_PDU_BusVoltages_308.bytOrderCrc_C "Data PDu Structure for PDU_BusVoltages_308 / CRC calibration of RX Data Pdu" VALUE 0x802704AA Val_Wu8 1.000 OneToOne 0.00 1.000 FORMAT "%5.3" EXTENDED_LIMITS 0.00 255.0 /end CHARACTERISTIC
/begin CHARACTERISTIC MoFFrm_Rx_DataPdu_PDU_BusVoltages_308.chksEndVal_C "Data PDu Structure for PDU_BusVoltages_308 / Calibration to indicate the XOR value in a checksum logic." VALUE 0x802704AC Val_Wu16 65535.00 OneToOne 0.00 65535.00 FORMAT "%8.2" /end CHARACTERISTIC
/begin CHARACTERISTIC MoFFrm_Rx_DataPdu_PDU_BusVoltages_308.chksStrtVal_C "Data PDu Structure for PDU_BusVoltages_308 / Calibration to indicate the initial value in a checksum logic." VALUE 0x802704AE Val_Wu16 65535.00 OneToOne 0.00 65535.00 FORMAT "%8.2" /end CHARACTERISTIC
/begin CHARACTERISTIC MoFFrm_Rx_DataPdu_PDU_BusVoltages_308.cntrAlvErrDeb_C "Data PDu Structure for PDU_BusVoltages_308 / Alive counter debounce error calibration of RX Data Pdu" VALUE 0x802704B0 Val_Wu16 65535.00 OneToOne 0.00 65535.00 FORMAT "%8.2" /end CHARACTERISTIC
/begin CHARACTERISTIC MoFFrm_Rx_DataPdu_PDU_BusVoltages_308.cntrCrcErrDeb_C "Data PDu Structure for PDU_BusVoltages_308 / Alive counter debounce error calibration of RX Data Pdu" VALUE 0x802704B2 Val_Wu16 65535.00 OneToOne 0.00 65535.00 FORMAT "%8.2" /end CHARACTERISTIC
/begin CHARACTERISTIC MoFFrm_Rx_DataPdu_PDU_BusVoltages_308.cntrMaxAlvDif_C "Data PDu Structure for PDU_BusVoltages_308 / Complement of Counter cyclic calibration of RX Data Pdu" VALUE 0x802704B4 Val_Wu8 255.0 OneToOne 0.00 255.0 FORMAT "%5.1" /end CHARACTERISTIC
/begin CHARACTERISTIC MoFFrm_Rx_DataPdu_PDU_BusVoltages_308.cntrTiOutDeb_C "Data PDu Structure for PDU_BusVoltages_308 / Counter time out debounce calibration of Rx data PDU" VALUE 0x802704B6 Val_Wu16 65535.00 OneToOne 0.00 65535.00 FORMAT "%8.2" /end CHARACTERISTIC
/begin CHARACTERISTIC MoFFrm_Rx_DataPdu_PDU_BusVoltages_308.crcId_C "Data PDu Structure for PDU_BusVoltages_308 / CRC ID of Rx data PDU" VALUE 0x802704B8 Val_Wu32 4294967295.00 OneToOne 0.00 4294967295.00 FORMAT "%13.2" /end CHARACTERISTIC
/begin CHARACTERISTIC MoFFrm_Rx_DataPdu_PDU_BusVoltages_308.cycTi_C "Data PDu Structure for PDU_BusVoltages_308 / cycle time from bus matrix" VALUE 0x802704BC Val_Wu16 65535.00 OneToOne 0.00 65535.00 FORMAT "%8.2" /end CHARACTERISTIC
/begin CHARACTERISTIC MoFFrm_Rx_DataPdu_PDU_BusVoltages_308.diChks_C "Data PDu Structure for PDU_BusVoltages_308 / parameter to enable or disable manipulation of various checks" VALUE 0x802704BE Val_Wu8 255.0 OneToOne 0.00 255.0 FORMAT "%5.1" /end CHARACTERISTIC
/begin CHARACTERISTIC MoFFrm_Rx_DataPdu_PDU_BusVoltages_308.evalType_C "Data PDu Structure for PDU_BusVoltages_308 / evaluation type" VALUE 0x802704BF Val_Wu8 255.0 OneToOne 0.00 255.0 FORMAT "%5.1" /end CHARACTERISTIC
/begin CHARACTERISTIC MoFFrm_Rx_DataPdu_PDU_BusVoltages_308.maskAlvCntr_C "Data PDu Structure for PDU_BusVoltages_308 / Alive counter start bit position of Rx data PDU" VALUE 0x802704C0 Val_Wu8 255.0 OneToOne 0.00 255.0 FORMAT "%5.1" /end CHARACTERISTIC
/begin CHARACTERISTIC MoFFrm_Rx_DataPdu_PDU_BusVoltages_308.posnAlvCntrStrtBit_C "Data PDu Structure for PDU_BusVoltages_308 / Alive counter start bit calibration of of Data PDU Rx" VALUE 0x802704C2 Val_Wu16 65535.00 OneToOne 0.00 65535.00 FORMAT "%8.2" /end CHARACTERISTIC
/begin CHARACTERISTIC MoFFrm_Rx_DataPdu_PDU_BusVoltages_308.posnCrcCalcEndByte_C "Data PDu Structure for PDU_BusVoltages_308 / End byte of CRC calculation position of Data PDU Rx" VALUE 0x802704C4 Val_Wu8 255.0 OneToOne 0.00 255.0 FORMAT "%5.1" /end CHARACTERISTIC
/begin CHARACTERISTIC MoFFrm_Rx_DataPdu_PDU_BusVoltages_308.posnCrcCalcStrtByte_C "Data PDu Structure for PDU_BusVoltages_308 / Start byte of CRC calculation position of Data PDU Rx" VALUE 0x802704C5 Val_Wu8 255.0 OneToOne 0.00 255.0 FORMAT "%5.1" /end CHARACTERISTIC
/begin CHARACTERISTIC MoFFrm_Rx_DataPdu_PDU_BusVoltages_308.posnCrcStrtBit_C "Data PDu Structure for PDU_BusVoltages_308 / CRC start bit position of Rx data PDU" VALUE 0x802704C6 Val_Wu16 65535.00 OneToOne 0.00 65535.00 FORMAT "%8.2" /end CHARACTERISTIC
/begin CHARACTERISTIC MoFFrm_Rx_DataPdu_PDU_BusVoltages_308.sigLenAlvCntr_C "Data PDu Structure for PDU_BusVoltages_308 / Alive counter signal length of Rx data PDU" VALUE 0x802704C8 Val_Wu8 31.00 OneToOne 1.00 32.00 FORMAT "%5.2" EXTENDED_LIMITS 0.00 255.0 /end CHARACTERISTIC
/begin CHARACTERISTIC MoFFrm_Rx_DataPdu_PDU_BusVoltages_308.sigLenCrc_C "Data PDu Structure for PDU_BusVoltages_308 / CRC calibration signal length of Rx data PDU" VALUE 0x802704C9 Val_Wu8 31.00 OneToOne 1.00 32.00 FORMAT "%5.2" EXTENDED_LIMITS 0.00 255.0 /end CHARACTERISTIC
/begin CHARACTERISTIC MoFFrm_Rx_DataPdu_VCU_AIRBAG_351h.bufLen_C "Data PDu Structure for VCU_AIRBAG_351h / parameter to indicate the buffer length of the receiving PDU" VALUE 0x802704D4 Val_Wu8 255.0 OneToOne 0.00 255.0 FORMAT "%5.1" /end CHARACTERISTIC
/begin CHARACTERISTIC MoFFrm_Rx_DataPdu_VCU_AIRBAG_351h.bytOrderAlvCntr_C "Data PDu Structure for VCU_AIRBAG_351h / Alive counter calibration of RX Data Pdu" VALUE 0x802704D5 Val_Wu8 1.000 OneToOne 0.00 1.000 FORMAT "%5.3" EXTENDED_LIMITS 0.00 255.0 /end CHARACTERISTIC
/begin CHARACTERISTIC MoFFrm_Rx_DataPdu_VCU_AIRBAG_351h.bytOrderCrc_C "Data PDu Structure for VCU_AIRBAG_351h / CRC calibration of RX Data Pdu" VALUE 0x802704D6 Val_Wu8 1.000 OneToOne 0.00 1.000 FORMAT "%5.3" EXTENDED_LIMITS 0.00 255.0 /end CHARACTERISTIC
/begin CHARACTERISTIC MoFFrm_Rx_DataPdu_VCU_AIRBAG_351h.chksEndVal_C "Data PDu Structure for VCU_AIRBAG_351h / Calibration to indicate the XOR value in a checksum logic." VALUE 0x802704D8 Val_Wu16 65535.00 OneToOne 0.00 65535.00 FORMAT "%8.2" /end CHARACTERISTIC
/begin CHARACTERISTIC MoFFrm_Rx_DataPdu_VCU_AIRBAG_351h.chksStrtVal_C "Data PDu Structure for VCU_AIRBAG_351h / Calibration to indicate the initial value in a checksum logic." VALUE 0x802704DA Val_Wu16 65535.00 OneToOne 0.00 65535.00 FORMAT "%8.2" /end CHARACTERISTIC
/begin CHARACTERISTIC MoFFrm_Rx_DataPdu_VCU_AIRBAG_351h.cntrAlvErrDeb_C "Data PDu Structure for VCU_AIRBAG_351h / Alive counter debounce error calibration of RX Data Pdu" VALUE 0x802704DC Val_Wu16 65535.00 OneToOne 0.00 65535.00 FORMAT "%8.2" /end CHARACTERISTIC
/begin CHARACTERISTIC MoFFrm_Rx_DataPdu_VCU_AIRBAG_351h.cntrCrcErrDeb_C "Data PDu Structure for VCU_AIRBAG_351h / Alive counter debounce error calibration of RX Data Pdu" VALUE 0x802704DE Val_Wu16 65535.00 OneToOne 0.00 65535.00 FORMAT "%8.2" /end CHARACTERISTIC
/begin CHARACTERISTIC MoFFrm_Rx_DataPdu_VCU_AIRBAG_351h.cntrMaxAlvDif_C "Data PDu Structure for VCU_AIRBAG_351h / Complement of Counter cyclic calibration of RX Data Pdu" VALUE 0x802704E0 Val_Wu8 255.0 OneToOne 0.00 255.0 FORMAT "%5.1" /end CHARACTERISTIC
/begin CHARACTERISTIC MoFFrm_Rx_DataPdu_VCU_AIRBAG_351h.cntrTiOutDeb_C "Data PDu Structure for VCU_AIRBAG_351h / Counter time out debounce calibration of Rx data PDU" VALUE 0x802704E2 Val_Wu16 65535.00 OneToOne 0.00 65535.00 FORMAT "%8.2" /end CHARACTERISTIC
/begin CHARACTERISTIC MoFFrm_Rx_DataPdu_VCU_AIRBAG_351h.crcId_C "Data PDu Structure for VCU_AIRBAG_351h / CRC ID of Rx data PDU" VALUE 0x802704E4 Val_Wu32 4294967295.00 OneToOne 0.00 4294967295.00 FORMAT "%13.2" /end CHARACTERISTIC
/begin CHARACTERISTIC MoFFrm_Rx_DataPdu_VCU_AIRBAG_351h.cycTi_C "Data PDu Structure for VCU_AIRBAG_351h / cycle time from bus matrix" VALUE 0x802704E8 Val_Wu16 65535.00 OneToOne 0.00 65535.00 FORMAT "%8.2" /end CHARACTERISTIC
/begin CHARACTERISTIC MoFFrm_Rx_DataPdu_VCU_AIRBAG_351h.diChks_C "Data PDu Structure for VCU_AIRBAG_351h / parameter to enable or disable manipulation of various checks" VALUE 0x802704EA Val_Wu8 255.0 OneToOne 0.00 255.0 FORMAT "%5.1" /end CHARACTERISTIC
/begin CHARACTERISTIC MoFFrm_Rx_DataPdu_VCU_AIRBAG_351h.evalType_C "Data PDu Structure for VCU_AIRBAG_351h / evaluation type" VALUE 0x802704EB Val_Wu8 255.0 OneToOne 0.00 255.0 FORMAT "%5.1" /end CHARACTERISTIC
/begin CHARACTERISTIC MoFFrm_Rx_DataPdu_VCU_AIRBAG_351h.maskAlvCntr_C "Data PDu Structure for VCU_AIRBAG_351h / Alive counter start bit position of Rx data PDU" VALUE 0x802704EC Val_Wu8 255.0 OneToOne 0.00 255.0 FORMAT "%5.1" /end CHARACTERISTIC
/begin CHARACTERISTIC MoFFrm_Rx_DataPdu_VCU_AIRBAG_351h.posnAlvCntrStrtBit_C "Data PDu Structure for VCU_AIRBAG_351h / Alive counter start bit calibration of of Data PDU Rx" VALUE 0x802704EE Val_Wu16 65535.00 OneToOne 0.00 65535.00 FORMAT "%8.2" /end CHARACTERISTIC
/begin CHARACTERISTIC MoFFrm_Rx_DataPdu_VCU_AIRBAG_351h.posnCrcCalcEndByte_C "Data PDu Structure for VCU_AIRBAG_351h / End byte of CRC calculation position of Data PDU Rx" VALUE 0x802704F0 Val_Wu8 255.0 OneToOne 0.00 255.0 FORMAT "%5.1" /end CHARACTERISTIC
/begin CHARACTERISTIC MoFFrm_Rx_DataPdu_VCU_AIRBAG_351h.posnCrcCalcStrtByte_C "Data PDu Structure for VCU_AIRBAG_351h / Start byte of CRC calculation position of Data PDU Rx" VALUE 0x802704F1 Val_Wu8 255.0 OneToOne 0.00 255.0 FORMAT "%5.1" /end CHARACTERISTIC
/begin CHARACTERISTIC MoFFrm_Rx_DataPdu_VCU_AIRBAG_351h.posnCrcStrtBit_C "Data PDu Structure for VCU_AIRBAG_351h / CRC start bit position of Rx data PDU" VALUE 0x802704F2 Val_Wu16 65535.00 OneToOne 0.00 65535.00 FORMAT "%8.2" /end CHARACTERISTIC
/begin CHARACTERISTIC MoFFrm_Rx_DataPdu_VCU_AIRBAG_351h.sigLenAlvCntr_C "Data PDu Structure for VCU_AIRBAG_351h / Alive counter signal length of Rx data PDU" VALUE 0x802704F4 Val_Wu8 31.00 OneToOne 1.00 32.00 FORMAT "%5.2" EXTENDED_LIMITS 0.00 255.0 /end CHARACTERISTIC
/begin CHARACTERISTIC MoFFrm_Rx_DataPdu_VCU_AIRBAG_351h.sigLenCrc_C "Data PDu Structure for VCU_AIRBAG_351h / CRC calibration signal length of Rx data PDU" VALUE 0x802704F5 Val_Wu8 31.00 OneToOne 1.00 32.00 FORMAT "%5.2" EXTENDED_LIMITS 0.00 255.0 /end CHARACTERISTIC
/begin CHARACTERISTIC MoFFrm_Rx_DataPdu_VCU_eBCCM_432h.bufLen_C "MoFFrm_Rx / parameter to indicate the buffer length of the receiving PDU" VALUE 0x80270500 Val_Wu8 255.0 OneToOne 0.00 255.0 FORMAT "%5.1" /end CHARACTERISTIC
/begin CHARACTERISTIC MoFFrm_Rx_DataPdu_VCU_eBCCM_432h.bytOrderAlvCntr_C "MoFFrm_Rx / Alive counter calibration of RX Data Pdu" VALUE 0x80270501 Val_Wu8 1.000 OneToOne 0.00 1.000 FORMAT "%5.3" EXTENDED_LIMITS 0.00 255.0 /end CHARACTERISTIC
/begin CHARACTERISTIC MoFFrm_Rx_DataPdu_VCU_eBCCM_432h.bytOrderCrc_C "MoFFrm_Rx / CRC calibration of RX Data Pdu" VALUE 0x80270502 Val_Wu8 1.000 OneToOne 0.00 1.000 FORMAT "%5.3" EXTENDED_LIMITS 0.00 255.0 /end CHARACTERISTIC
/begin CHARACTERISTIC MoFFrm_Rx_DataPdu_VCU_eBCCM_432h.chksEndVal_C "MoFFrm_Rx / Calibration to indicate the XOR value in a checksum logic." VALUE 0x80270504 Val_Wu16 65535.00 OneToOne 0.00 65535.00 FORMAT "%8.2" /end CHARACTERISTIC
/begin CHARACTERISTIC MoFFrm_Rx_DataPdu_VCU_eBCCM_432h.chksStrtVal_C "MoFFrm_Rx / Calibration to indicate the initial value in a checksum logic." VALUE 0x80270506 Val_Wu16 65535.00 OneToOne 0.00 65535.00 FORMAT "%8.2" /end CHARACTERISTIC
/begin CHARACTERISTIC MoFFrm_Rx_DataPdu_VCU_eBCCM_432h.cntrAlvErrDeb_C "MoFFrm_Rx / Alive counter debounce error calibration of RX Data Pdu" VALUE 0x80270508 Val_Wu16 65535.00 OneToOne 0.00 65535.00 FORMAT "%8.2" /end CHARACTERISTIC
/begin CHARACTERISTIC MoFFrm_Rx_DataPdu_VCU_eBCCM_432h.cntrCrcErrDeb_C "MoFFrm_Rx / Alive counter debounce error calibration of RX Data Pdu" VALUE 0x8027050A Val_Wu16 65535.00 OneToOne 0.00 65535.00 FORMAT "%8.2" /end CHARACTERISTIC
/begin CHARACTERISTIC MoFFrm_Rx_DataPdu_VCU_eBCCM_432h.cntrMaxAlvDif_C "MoFFrm_Rx / Complement of Counter cyclic calibration of RX Data Pdu" VALUE 0x8027050C Val_Wu8 255.0 OneToOne 0.00 255.0 FORMAT "%5.1" /end CHARACTERISTIC
/begin CHARACTERISTIC MoFFrm_Rx_DataPdu_VCU_eBCCM_432h.cntrTiOutDeb_C "MoFFrm_Rx / Counter time out debounce calibration of Rx data PDU" VALUE 0x8027050E Val_Wu16 65535.00 OneToOne 0.00 65535.00 FORMAT "%8.2" /end CHARACTERISTIC
/begin CHARACTERISTIC MoFFrm_Rx_DataPdu_VCU_eBCCM_432h.crcId_C "MoFFrm_Rx / CRC ID of Rx data PDU" VALUE 0x80270510 Val_Wu32 4294967295.00 OneToOne 0.00 4294967295.00 FORMAT "%13.2" /end CHARACTERISTIC
/begin CHARACTERISTIC MoFFrm_Rx_DataPdu_VCU_eBCCM_432h.cycTi_C "MoFFrm_Rx / cycle time from bus matrix" VALUE 0x80270514 Val_Wu16 65535.00 OneToOne 0.00 65535.00 FORMAT "%8.2" /end CHARACTERISTIC
/begin CHARACTERISTIC MoFFrm_Rx_DataPdu_VCU_eBCCM_432h.diChks_C "MoFFrm_Rx / parameter to enable or disable manipulation of various checks" VALUE 0x80270516 Val_Wu8 255.0 OneToOne 0.00 255.0 FORMAT "%5.1" /end CHARACTERISTIC
/begin CHARACTERISTIC MoFFrm_Rx_DataPdu_VCU_eBCCM_432h.evalType_C "MoFFrm_Rx / evaluation type" VALUE 0x80270517 Val_Wu8 255.0 OneToOne 0.00 255.0 FORMAT "%5.1" /end CHARACTERISTIC
/begin CHARACTERISTIC MoFFrm_Rx_DataPdu_VCU_eBCCM_432h.maskAlvCntr_C "MoFFrm_Rx / Alive counter start bit position of Rx data PDU" VALUE 0x80270518 Val_Wu8 255.0 OneToOne 0.00 255.0 FORMAT "%5.1" /end CHARACTERISTIC
/begin CHARACTERISTIC MoFFrm_Rx_DataPdu_VCU_eBCCM_432h.posnAlvCntrStrtBit_C "MoFFrm_Rx / Alive counter start bit calibration of of Data PDU Rx" VALUE 0x8027051A Val_Wu16 65535.00 OneToOne 0.00 65535.00 FORMAT "%8.2" /end CHARACTERISTIC
/begin CHARACTERISTIC MoFFrm_Rx_DataPdu_VCU_eBCCM_432h.posnCrcCalcEndByte_C "MoFFrm_Rx / End byte of CRC calculation position of Data PDU Rx" VALUE 0x8027051C Val_Wu8 255.0 OneToOne 0.00 255.0 FORMAT "%5.1" /end CHARACTERISTIC
/begin CHARACTERISTIC MoFFrm_Rx_DataPdu_VCU_eBCCM_432h.posnCrcCalcStrtByte_C "MoFFrm_Rx / Start byte of CRC calculation position of Data PDU Rx" VALUE 0x8027051D Val_Wu8 255.0 OneToOne 0.00 255.0 FORMAT "%5.1" /end CHARACTERISTIC
/begin CHARACTERISTIC MoFFrm_Rx_DataPdu_VCU_eBCCM_432h.posnCrcStrtBit_C "MoFFrm_Rx / CRC start bit position of Rx data PDU" VALUE 0x8027051E Val_Wu16 65535.00 OneToOne 0.00 65535.00 FORMAT "%8.2" /end CHARACTERISTIC
/begin CHARACTERISTIC MoFFrm_Rx_DataPdu_VCU_eBCCM_432h.sigLenAlvCntr_C "MoFFrm_Rx / Alive counter signal length of Rx data PDU" VALUE 0x80270520 Val_Wu8 31.00 OneToOne 1.00 32.00 FORMAT "%5.2" EXTENDED_LIMITS 0.00 255.0 /end CHARACTERISTIC
/begin CHARACTERISTIC MoFFrm_Rx_DataPdu_VCU_eBCCM_432h.sigLenCrc_C "MoFFrm_Rx / CRC calibration signal length of Rx data PDU" VALUE 0x80270521 Val_Wu8 31.00 OneToOne 1.00 32.00 FORMAT "%5.2" EXTENDED_LIMITS 0.00 255.0 /end CHARACTERISTIC
/begin CHARACTERISTIC MoFFrm_stATCEngMode_C "Calibration for MoFFrm_stATCEngMode_C" VALUE 0x8026CF03 Val_Wu8 255.0 OneToOne 0.00 255.0 FORMAT "%5.1" /end CHARACTERISTIC
/begin CHARACTERISTIC MoFFrm_stATCRtdrMode_C "Calibration for MoFFrm_stATCRtdrMode_C" VALUE 0x8026CF04 Val_Wu8 255.0 OneToOne 0.00 255.0 FORMAT "%5.1" /end CHARACTERISTIC
/begin CHARACTERISTIC MoFFrm_stBrkQlyFacRaw_C "Calibration for MoFFrm_stBrkQlyFacRaw_C" VALUE 0x8026CF05 Val_Wu8 255.0 OneToOne 0.00 255.0 FORMAT "%5.1" /end CHARACTERISTIC
/begin CHARACTERISTIC MoFFrm_stCplCrashDft_C "MoFFrm_stCplCrash cal" VALUE 0x8026CEE7 Val_Wu8 255.0 OneToOne 0.00 255.0 FORMAT "%5.1" /end CHARACTERISTIC
/begin CHARACTERISTIC MoFFrm_stCrashDft_C "Defect value for crash signal received via CAN in function monitoring" VALUE 0x8026CEE8 Val_Wu8 255.0 OneToOne 0.00 255.0 FORMAT "%5.1" /end CHARACTERISTIC
/begin CHARACTERISTIC MoFFrm_stDcChrgnVoltErr_C "MoFFrm_stDcChrgnVoltErr cal" VALUE 0x8026CEE9 Val_Wu8 255.0 OneToOne 0.00 255.0 FORMAT "%5.1" /end CHARACTERISTIC
/begin CHARACTERISTIC MoFFrm_stDcdcErrDft_C "Default value for Dcdc error in CAN in function monitoring" VALUE 0x8026D120 Val_Wu32 4294967295.00 OneToOne 0.00 4294967295.00 FORMAT "%13.2" /end CHARACTERISTIC
/begin CHARACTERISTIC MoFFrm_stDrvrSeatBltDft_C "Calibration for Driver seat belt status" VALUE 0x8026CEEA Val_Wu8 255.0 OneToOne 0.00 255.0 FORMAT "%5.1" /end CHARACTERISTIC
/begin CHARACTERISTIC MoFFrm_stESMFailrDft_C "CAlibration for ESM failure" VALUE 0x8026CEEB Val_Wu8 255.0 OneToOne 0.00 255.0 FORMAT "%5.1" /end CHARACTERISTIC
/begin CHARACTERISTIC MoFFrm_stGearNumDft_C "Caibration for Positions physique du joystick module Toggle" VALUE 0x8026CEEC Val_Wu8 255.0 OneToOne 0.00 255.0 FORMAT "%5.1" /end CHARACTERISTIC
/begin CHARACTERISTIC MoFFrm_stHvbCnctnDft_C "MoFFrm_stHvbCnctnDft_C" VALUE 0x8026CEED Val_Wu8 255.0 OneToOne 0.00 255.0 FORMAT "%5.1" /end CHARACTERISTIC
/begin CHARACTERISTIC MoFFrm_stHvbFltLvlDft_C "MoFFrm_stHvbFltLvlDft_C" VALUE 0x8026CEEE Val_Wu8 255.0 OneToOne 0.00 255.0 FORMAT "%5.1" /end CHARACTERISTIC
/begin CHARACTERISTIC MoFFrm_stHvIntlckDft_C "Default value for HV interlock status via CAN in function monitoring" VALUE 0x8026CEEF Val_Wu8 255.0 OneToOne 0.00 255.0 FORMAT "%5.1" /end CHARACTERISTIC
/begin CHARACTERISTIC MoFFrm_stIIvtrFltLvl01Dft_C "Calibration for inverter fault level" VALUE 0x8026CEF0 Val_Wu8 255.0 OneToOne 0.00 255.0 FORMAT "%5.1" /end CHARACTERISTIC
/begin CHARACTERISTIC MoFFrm_stIvtr1Intlck_C "Default value of interlock signal through inverter 1 in function monitoring" VALUE 0x8026CF06 Val_Wu8 255.0 OneToOne 0.00 255.0 FORMAT "%5.1" /end CHARACTERISTIC
/begin CHARACTERISTIC MoFFrm_stIvtr2Intlck_C "Default value of interlock signal through inverter 2 in function monitoring" VALUE 0x8026CF07 Val_Wu8 255.0 OneToOne 0.00 255.0 FORMAT "%5.1" /end CHARACTERISTIC
/begin CHARACTERISTIC MoFFrm_stIvtrOpMod01Dft_C "Calibration for INV Internal Operating Mode" VALUE 0x8026CEF1 Val_Wu8 255.0 OneToOne 0.00 255.0 FORMAT "%5.1" /end CHARACTERISTIC
/begin CHARACTERISTIC MoFFrm_stPrkgBrkSwtDft_C "Calibration for Parking brake switch" VALUE 0x8026CEF2 Val_Wu8 255.0 OneToOne 0.00 255.0 FORMAT "%5.1" /end CHARACTERISTIC
/begin CHARACTERISTIC MoFFrm_stPrpInhb01Qlfr_C "Calibration variable for MoFFrm_stPrpInhb01Qlfr" VALUE 0x8026CF08 Val_Wu8 255.0 OneToOne 0.00 255.0 FORMAT "%5.1" /end CHARACTERISTIC
/begin CHARACTERISTIC MoFFrm_stSofErr_C "Default value for battery sensor error in monitoring" VALUE 0x8026CF09 Val_Wu8 255.0 OneToOne 0.00 255.0 FORMAT "%5.1" /end CHARACTERISTIC
/begin CHARACTERISTIC MoFFrm_stT30c_C "Calibration for MoFFrm_stT30c at adapter" VALUE 0x8026CF0A Val_Wu8 255.0 OneToOne 0.00 255.0 FORMAT "%5.1" /end CHARACTERISTIC
/begin CHARACTERISTIC MoFFrm_tqAct01Dft_C "Calibration for Actual Torque at Motor" VALUE 0x8026D756 Val_Ws16 6553.500 RBPtCel_tq_0p1_1 -3276.800 3276.700 FORMAT "%8.3" /end CHARACTERISTIC
/begin CHARACTERISTIC MoFFrm_tqBrkDesPrimAxleQlfr_C "primary axle qualifier calibration" VALUE 0x8026CF0B Val_Wu8 255.0 OneToOne 0.00 255.0 FORMAT "%5.1" /end CHARACTERISTIC
/begin CHARACTERISTIC MoFFrm_tqBrkDesPrimAxle_C "primary axle brake calibration" VALUE 0x8026D128 Val_Ws32 429496729.500 TrqPrpHigh -214748364.800 214748364.700 FORMAT "%13.3" /end CHARACTERISTIC
/begin CHARACTERISTIC MoFFrm_tqBrkDesSecAxleQlfr_C "qualifier of secondary axle qualifier calibration" VALUE 0x8026CF0C Val_Wu8 255.0 OneToOne 0.00 255.0 FORMAT "%5.1" /end CHARACTERISTIC
/begin CHARACTERISTIC MoFFrm_tqBrkDesSecAxle_C "secondary axle brake desired calibration" VALUE 0x8026D12C Val_Ws32 429496729.500 TrqPrpHigh -214748364.800 214748364.700 FORMAT "%13.3" /end CHARACTERISTIC
/begin CHARACTERISTIC MoFFrm_Tx_DataPdu_IS_DYN_VCU_208h.bufLen_C "MoFFrm_Tx_DataPdu_IS_DYN_VCU_208h / Buffer length of the transmission PDU" VALUE 0x8027055C Val_Wu8 255.0 OneToOne 0.00 255.0 FORMAT "%5.1" /end CHARACTERISTIC
/begin CHARACTERISTIC MoFFrm_Tx_DataPdu_IS_DYN_VCU_208h.bytOrderAlvCntr_C "MoFFrm_Tx_DataPdu_IS_DYN_VCU_208h / Alive counter byte order" VALUE 0x8027055D Val_Wu8 1.000 OneToOne 0.00 1.000 FORMAT "%5.3" EXTENDED_LIMITS 0.00 255.0 /end CHARACTERISTIC
/begin CHARACTERISTIC MoFFrm_Tx_DataPdu_IS_DYN_VCU_208h.bytOrderCrc_C "MoFFrm_Tx_DataPdu_IS_DYN_VCU_208h / CRC byte order" VALUE 0x8027055E Val_Wu8 1.000 OneToOne 0.00 1.000 FORMAT "%5.3" EXTENDED_LIMITS 0.00 255.0 /end CHARACTERISTIC
/begin CHARACTERISTIC MoFFrm_Tx_DataPdu_IS_DYN_VCU_208h.chksEndVal_C "MoFFrm_Tx_DataPdu_IS_DYN_VCU_208h / Calibration to indicate the XOR value in a checksum logic." VALUE 0x80270560 Val_Wu16 65535.00 OneToOne 0.00 65535.00 FORMAT "%8.2" /end CHARACTERISTIC
/begin CHARACTERISTIC MoFFrm_Tx_DataPdu_IS_DYN_VCU_208h.chksStrtVal_C "MoFFrm_Tx_DataPdu_IS_DYN_VCU_208h / Calibration to indicate the initial value in a checksum logic." VALUE 0x80270562 Val_Wu16 65535.00 OneToOne 0.00 65535.00 FORMAT "%8.2" /end CHARACTERISTIC
/begin CHARACTERISTIC MoFFrm_Tx_DataPdu_IS_DYN_VCU_208h.crcId_C "MoFFrm_Tx_DataPdu_IS_DYN_VCU_208h / CRC iD calibration of Tx data PDU" VALUE 0x80270564 Val_Wu32 4294967295.00 OneToOne 0.00 4294967295.00 FORMAT "%13.2" /end CHARACTERISTIC
/begin CHARACTERISTIC MoFFrm_Tx_DataPdu_IS_DYN_VCU_208h.evalType_C "MoFFrm_Tx_DataPdu_IS_DYN_VCU_208h / evaluation type of the Tx message" VALUE 0x80270568 Val_Wu8 255.0 OneToOne 0.00 255.0 FORMAT "%5.1" /end CHARACTERISTIC
/begin CHARACTERISTIC MoFFrm_Tx_DataPdu_IS_DYN_VCU_208h.posnAlvCntrStrtBit_C "MoFFrm_Tx_DataPdu_IS_DYN_VCU_208h / alive counter start bit position" VALUE 0x8027056A Val_Wu16 65535.00 OneToOne 0.00 65535.00 FORMAT "%8.2" /end CHARACTERISTIC
/begin CHARACTERISTIC MoFFrm_Tx_DataPdu_IS_DYN_VCU_208h.posnCrcCalcEndByte_C "MoFFrm_Tx_DataPdu_IS_DYN_VCU_208h / Start byte of CRC calculation position of Data PDU Tx" VALUE 0x8027056C Val_Wu8 255.0 OneToOne 0.00 255.0 FORMAT "%5.1" /end CHARACTERISTIC
/begin CHARACTERISTIC MoFFrm_Tx_DataPdu_IS_DYN_VCU_208h.posnCrcCalcStrtByte_C "MoFFrm_Tx_DataPdu_IS_DYN_VCU_208h / Start byte of CRC calculation position of Data PDU Tx" VALUE 0x8027056D Val_Wu8 255.0 OneToOne 0.00 255.0 FORMAT "%5.1" /end CHARACTERISTIC
/begin CHARACTERISTIC MoFFrm_Tx_DataPdu_IS_DYN_VCU_208h.posnCrcStrtBit_C "MoFFrm_Tx_DataPdu_IS_DYN_VCU_208h / CRC start bit position" VALUE 0x8027056E Val_Wu16 65535.00 OneToOne 0.00 65535.00 FORMAT "%8.2" /end CHARACTERISTIC
/begin CHARACTERISTIC MoFFrm_Tx_DataPdu_IS_DYN_VCU_208h.sigLenAlvCntr_C "MoFFrm_Tx_DataPdu_IS_DYN_VCU_208h / alive counter signal length" VALUE 0x80270570 Val_Wu8 31.00 OneToOne 1.00 32.00 FORMAT "%5.2" EXTENDED_LIMITS 0.00 255.0 /end CHARACTERISTIC
/begin CHARACTERISTIC MoFFrm_Tx_DataPdu_IS_DYN_VCU_208h.sigLenCrc_C "MoFFrm_Tx_DataPdu_IS_DYN_VCU_208h / CRC signal length" VALUE 0x80270571 Val_Wu8 31.00 OneToOne 1.00 32.00 FORMAT "%5.2" EXTENDED_LIMITS 0.00 255.0 /end CHARACTERISTIC
/begin CHARACTERISTIC MoFFrm_Tx_DataPdu_VCU_211h.bufLen_C "MoFFrm_Tx_DataPdu_VCU_211h / Buffer length of the transmission PDU" VALUE 0x8027057C Val_Wu8 255.0 OneToOne 0.00 255.0 FORMAT "%5.1" /end CHARACTERISTIC
/begin CHARACTERISTIC MoFFrm_Tx_DataPdu_VCU_211h.bytOrderAlvCntr_C "MoFFrm_Tx_DataPdu_VCU_211h / Alive counter byte order" VALUE 0x8027057D Val_Wu8 1.000 OneToOne 0.00 1.000 FORMAT "%5.3" EXTENDED_LIMITS 0.00 255.0 /end CHARACTERISTIC
/begin CHARACTERISTIC MoFFrm_Tx_DataPdu_VCU_211h.bytOrderCrc_C "MoFFrm_Tx_DataPdu_VCU_211h / CRC byte order" VALUE 0x8027057E Val_Wu8 1.000 OneToOne 0.00 1.000 FORMAT "%5.3" EXTENDED_LIMITS 0.00 255.0 /end CHARACTERISTIC
/begin CHARACTERISTIC MoFFrm_Tx_DataPdu_VCU_211h.chksEndVal_C "MoFFrm_Tx_DataPdu_VCU_211h / Calibration to indicate the XOR value in a checksum logic." VALUE 0x80270580 Val_Wu16 65535.00 OneToOne 0.00 65535.00 FORMAT "%8.2" /end CHARACTERISTIC
/begin CHARACTERISTIC MoFFrm_Tx_DataPdu_VCU_211h.chksStrtVal_C "MoFFrm_Tx_DataPdu_VCU_211h / Calibration to indicate the initial value in a checksum logic." VALUE 0x80270582 Val_Wu16 65535.00 OneToOne 0.00 65535.00 FORMAT "%8.2" /end CHARACTERISTIC
/begin CHARACTERISTIC MoFFrm_Tx_DataPdu_VCU_211h.crcId_C "MoFFrm_Tx_DataPdu_VCU_211h / CRC iD calibration of Tx data PDU" VALUE 0x80270584 Val_Wu32 4294967295.00 OneToOne 0.00 4294967295.00 FORMAT "%13.2" /end CHARACTERISTIC
/begin CHARACTERISTIC MoFFrm_Tx_DataPdu_VCU_211h.evalType_C "MoFFrm_Tx_DataPdu_VCU_211h / evaluation type of the Tx message" VALUE 0x80270588 Val_Wu8 255.0 OneToOne 0.00 255.0 FORMAT "%5.1" /end CHARACTERISTIC
/begin CHARACTERISTIC MoFFrm_Tx_DataPdu_VCU_211h.posnAlvCntrStrtBit_C "MoFFrm_Tx_DataPdu_VCU_211h / alive counter start bit position" VALUE 0x8027058A Val_Wu16 65535.00 OneToOne 0.00 65535.00 FORMAT "%8.2" /end CHARACTERISTIC
/begin CHARACTERISTIC MoFFrm_Tx_DataPdu_VCU_211h.posnCrcCalcEndByte_C "MoFFrm_Tx_DataPdu_VCU_211h / Start byte of CRC calculation position of Data PDU Tx" VALUE 0x8027058C Val_Wu8 255.0 OneToOne 0.00 255.0 FORMAT "%5.1" /end CHARACTERISTIC
/begin CHARACTERISTIC MoFFrm_Tx_DataPdu_VCU_211h.posnCrcCalcStrtByte_C "MoFFrm_Tx_DataPdu_VCU_211h / Start byte of CRC calculation position of Data PDU Tx" VALUE 0x8027058D Val_Wu8 255.0 OneToOne 0.00 255.0 FORMAT "%5.1" /end CHARACTERISTIC
/begin CHARACTERISTIC MoFFrm_Tx_DataPdu_VCU_211h.posnCrcStrtBit_C "MoFFrm_Tx_DataPdu_VCU_211h / CRC start bit position" VALUE 0x8027058E Val_Wu16 65535.00 OneToOne 0.00 65535.00 FORMAT "%8.2" /end CHARACTERISTIC
/begin CHARACTERISTIC MoFFrm_Tx_DataPdu_VCU_211h.sigLenAlvCntr_C "MoFFrm_Tx_DataPdu_VCU_211h / alive counter signal length" VALUE 0x80270590 Val_Wu8 31.00 OneToOne 1.00 32.00 FORMAT "%5.2" EXTENDED_LIMITS 0.00 255.0 /end CHARACTERISTIC
/begin CHARACTERISTIC MoFFrm_Tx_DataPdu_VCU_211h.sigLenCrc_C "MoFFrm_Tx_DataPdu_VCU_211h / CRC signal length" VALUE 0x80270591 Val_Wu8 31.00 OneToOne 1.00 32.00 FORMAT "%5.2" EXTENDED_LIMITS 0.00 255.0 /end CHARACTERISTIC
/begin CHARACTERISTIC MoFFrm_Tx_DataPdu_VCU_221h.bufLen_C "MoFFrm_Tx_DataPdu_VCU_221h / Buffer length of the transmission PDU" VALUE 0x8027059C Val_Wu8 255.0 OneToOne 0.00 255.0 FORMAT "%5.1" /end CHARACTERISTIC
/begin CHARACTERISTIC MoFFrm_Tx_DataPdu_VCU_221h.bytOrderAlvCntr_C "MoFFrm_Tx_DataPdu_VCU_221h / Alive counter byte order" VALUE 0x8027059D Val_Wu8 1.000 OneToOne 0.00 1.000 FORMAT "%5.3" EXTENDED_LIMITS 0.00 255.0 /end CHARACTERISTIC
/begin CHARACTERISTIC MoFFrm_Tx_DataPdu_VCU_221h.bytOrderCrc_C "MoFFrm_Tx_DataPdu_VCU_221h / CRC byte order" VALUE 0x8027059E Val_Wu8 1.000 OneToOne 0.00 1.000 FORMAT "%5.3" EXTENDED_LIMITS 0.00 255.0 /end CHARACTERISTIC
/begin CHARACTERISTIC MoFFrm_Tx_DataPdu_VCU_221h.chksEndVal_C "MoFFrm_Tx_DataPdu_VCU_221h / Calibration to indicate the XOR value in a checksum logic." VALUE 0x802705A0 Val_Wu16 65535.00 OneToOne 0.00 65535.00 FORMAT "%8.2" /end CHARACTERISTIC
/begin CHARACTERISTIC MoFFrm_Tx_DataPdu_VCU_221h.chksStrtVal_C "MoFFrm_Tx_DataPdu_VCU_221h / Calibration to indicate the initial value in a checksum logic." VALUE 0x802705A2 Val_Wu16 65535.00 OneToOne 0.00 65535.00 FORMAT "%8.2" /end CHARACTERISTIC
/begin CHARACTERISTIC MoFFrm_Tx_DataPdu_VCU_221h.crcId_C "MoFFrm_Tx_DataPdu_VCU_221h / CRC iD calibration of Tx data PDU" VALUE 0x802705A4 Val_Wu32 4294967295.00 OneToOne 0.00 4294967295.00 FORMAT "%13.2" /end CHARACTERISTIC
/begin CHARACTERISTIC MoFFrm_Tx_DataPdu_VCU_221h.evalType_C "MoFFrm_Tx_DataPdu_VCU_221h / evaluation type of the Tx message" VALUE 0x802705A8 Val_Wu8 255.0 OneToOne 0.00 255.0 FORMAT "%5.1" /end CHARACTERISTIC
/begin CHARACTERISTIC MoFFrm_Tx_DataPdu_VCU_221h.posnAlvCntrStrtBit_C "MoFFrm_Tx_DataPdu_VCU_221h / alive counter start bit position" VALUE 0x802705AA Val_Wu16 65535.00 OneToOne 0.00 65535.00 FORMAT "%8.2" /end CHARACTERISTIC
/begin CHARACTERISTIC MoFFrm_Tx_DataPdu_VCU_221h.posnCrcCalcEndByte_C "MoFFrm_Tx_DataPdu_VCU_221h / Start byte of CRC calculation position of Data PDU Tx" VALUE 0x802705AC Val_Wu8 255.0 OneToOne 0.00 255.0 FORMAT "%5.1" /end CHARACTERISTIC
/begin CHARACTERISTIC MoFFrm_Tx_DataPdu_VCU_221h.posnCrcCalcStrtByte_C "MoFFrm_Tx_DataPdu_VCU_221h / Start byte of CRC calculation position of Data PDU Tx" VALUE 0x802705AD Val_Wu8 255.0 OneToOne 0.00 255.0 FORMAT "%5.1" /end CHARACTERISTIC
/begin CHARACTERISTIC MoFFrm_Tx_DataPdu_VCU_221h.posnCrcStrtBit_C "MoFFrm_Tx_DataPdu_VCU_221h / CRC start bit position" VALUE 0x802705AE Val_Wu16 65535.00 OneToOne 0.00 65535.00 FORMAT "%8.2" /end CHARACTERISTIC
/begin CHARACTERISTIC MoFFrm_Tx_DataPdu_VCU_221h.sigLenAlvCntr_C "MoFFrm_Tx_DataPdu_VCU_221h / alive counter signal length" VALUE 0x802705B0 Val_Wu8 31.00 OneToOne 1.00 32.00 FORMAT "%5.2" EXTENDED_LIMITS 0.00 255.0 /end CHARACTERISTIC
/begin CHARACTERISTIC MoFFrm_Tx_DataPdu_VCU_221h.sigLenCrc_C "MoFFrm_Tx_DataPdu_VCU_221h / CRC signal length" VALUE 0x802705B1 Val_Wu8 31.00 OneToOne 1.00 32.00 FORMAT "%5.2" EXTENDED_LIMITS 0.00 255.0 /end CHARACTERISTIC
/begin CHARACTERISTIC MoFFrm_Tx_DataPdu_VCU_241h.bufLen_C "Structure instance of PDU VCU_241h / Buffer length of the transmission PDU" VALUE 0x802705BC Val_Wu8 255.0 OneToOne 0.00 255.0 FORMAT "%5.1" /end CHARACTERISTIC
/begin CHARACTERISTIC MoFFrm_Tx_DataPdu_VCU_241h.bytOrderAlvCntr_C "Structure instance of PDU VCU_241h / Alive counter byte order" VALUE 0x802705BD Val_Wu8 1.000 OneToOne 0.00 1.000 FORMAT "%5.3" EXTENDED_LIMITS 0.00 255.0 /end CHARACTERISTIC
/begin CHARACTERISTIC MoFFrm_Tx_DataPdu_VCU_241h.bytOrderCrc_C "Structure instance of PDU VCU_241h / CRC byte order" VALUE 0x802705BE Val_Wu8 1.000 OneToOne 0.00 1.000 FORMAT "%5.3" EXTENDED_LIMITS 0.00 255.0 /end CHARACTERISTIC
/begin CHARACTERISTIC MoFFrm_Tx_DataPdu_VCU_241h.chksEndVal_C "Structure instance of PDU VCU_241h / Calibration to indicate the XOR value in a checksum logic." VALUE 0x802705C0 Val_Wu16 65535.00 OneToOne 0.00 65535.00 FORMAT "%8.2" /end CHARACTERISTIC
/begin CHARACTERISTIC MoFFrm_Tx_DataPdu_VCU_241h.chksStrtVal_C "Structure instance of PDU VCU_241h / Calibration to indicate the initial value in a checksum logic." VALUE 0x802705C2 Val_Wu16 65535.00 OneToOne 0.00 65535.00 FORMAT "%8.2" /end CHARACTERISTIC
/begin CHARACTERISTIC MoFFrm_Tx_DataPdu_VCU_241h.crcId_C "Structure instance of PDU VCU_241h / CRC iD calibration of Tx data PDU" VALUE 0x802705C4 Val_Wu32 4294967295.00 OneToOne 0.00 4294967295.00 FORMAT "%13.2" /end CHARACTERISTIC
/begin CHARACTERISTIC MoFFrm_Tx_DataPdu_VCU_241h.evalType_C "Structure instance of PDU VCU_241h / evaluation type of the Tx message" VALUE 0x802705C8 Val_Wu8 255.0 OneToOne 0.00 255.0 FORMAT "%5.1" /end CHARACTERISTIC
/begin CHARACTERISTIC MoFFrm_Tx_DataPdu_VCU_241h.posnAlvCntrStrtBit_C "Structure instance of PDU VCU_241h / alive counter start bit position" VALUE 0x802705CA Val_Wu16 65535.00 OneToOne 0.00 65535.00 FORMAT "%8.2" /end CHARACTERISTIC
/begin CHARACTERISTIC MoFFrm_Tx_DataPdu_VCU_241h.posnCrcCalcEndByte_C "Structure instance of PDU VCU_241h / Start byte of CRC calculation position of Data PDU Tx" VALUE 0x802705CC Val_Wu8 255.0 OneToOne 0.00 255.0 FORMAT "%5.1" /end CHARACTERISTIC
/begin CHARACTERISTIC MoFFrm_Tx_DataPdu_VCU_241h.posnCrcCalcStrtByte_C "Structure instance of PDU VCU_241h / Start byte of CRC calculation position of Data PDU Tx" VALUE 0x802705CD Val_Wu8 255.0 OneToOne 0.00 255.0 FORMAT "%5.1" /end CHARACTERISTIC
/begin CHARACTERISTIC MoFFrm_Tx_DataPdu_VCU_241h.posnCrcStrtBit_C "Structure instance of PDU VCU_241h / CRC start bit position" VALUE 0x802705CE Val_Wu16 65535.00 OneToOne 0.00 65535.00 FORMAT "%8.2" /end CHARACTERISTIC
/begin CHARACTERISTIC MoFFrm_Tx_DataPdu_VCU_241h.sigLenAlvCntr_C "Structure instance of PDU VCU_241h / alive counter signal length" VALUE 0x802705D0 Val_Wu8 31.00 OneToOne 1.00 32.00 FORMAT "%5.2" EXTENDED_LIMITS 0.00 255.0 /end CHARACTERISTIC
/begin CHARACTERISTIC MoFFrm_Tx_DataPdu_VCU_241h.sigLenCrc_C "Structure instance of PDU VCU_241h / CRC signal length" VALUE 0x802705D1 Val_Wu8 31.00 OneToOne 1.00 32.00 FORMAT "%5.2" EXTENDED_LIMITS 0.00 255.0 /end CHARACTERISTIC
/begin CHARACTERISTIC MoFFrm_Tx_DataPdu_VCU_281h.bufLen_C "MoFFrm_Tx_DataPdu_VCU_281h / Buffer length of the transmission PDU" VALUE 0x802705DC Val_Wu8 255.0 OneToOne 0.00 255.0 FORMAT "%5.1" /end CHARACTERISTIC
/begin CHARACTERISTIC MoFFrm_Tx_DataPdu_VCU_281h.bytOrderAlvCntr_C "MoFFrm_Tx_DataPdu_VCU_281h / Alive counter byte order" VALUE 0x802705DD Val_Wu8 1.000 OneToOne 0.00 1.000 FORMAT "%5.3" EXTENDED_LIMITS 0.00 255.0 /end CHARACTERISTIC
/begin CHARACTERISTIC MoFFrm_Tx_DataPdu_VCU_281h.bytOrderCrc_C "MoFFrm_Tx_DataPdu_VCU_281h / CRC byte order" VALUE 0x802705DE Val_Wu8 1.000 OneToOne 0.00 1.000 FORMAT "%5.3" EXTENDED_LIMITS 0.00 255.0 /end CHARACTERISTIC
/begin CHARACTERISTIC MoFFrm_Tx_DataPdu_VCU_281h.chksEndVal_C "MoFFrm_Tx_DataPdu_VCU_281h / Calibration to indicate the XOR value in a checksum logic." VALUE 0x802705E0 Val_Wu16 65535.00 OneToOne 0.00 65535.00 FORMAT "%8.2" /end CHARACTERISTIC
/begin CHARACTERISTIC MoFFrm_Tx_DataPdu_VCU_281h.chksStrtVal_C "MoFFrm_Tx_DataPdu_VCU_281h / Calibration to indicate the initial value in a checksum logic." VALUE 0x802705E2 Val_Wu16 65535.00 OneToOne 0.00 65535.00 FORMAT "%8.2" /end CHARACTERISTIC
/begin CHARACTERISTIC MoFFrm_Tx_DataPdu_VCU_281h.crcId_C "MoFFrm_Tx_DataPdu_VCU_281h / CRC iD calibration of Tx data PDU" VALUE 0x802705E4 Val_Wu32 4294967295.00 OneToOne 0.00 4294967295.00 FORMAT "%13.2" /end CHARACTERISTIC
/begin CHARACTERISTIC MoFFrm_Tx_DataPdu_VCU_281h.evalType_C "MoFFrm_Tx_DataPdu_VCU_281h / evaluation type of the Tx message" VALUE 0x802705E8 Val_Wu8 255.0 OneToOne 0.00 255.0 FORMAT "%5.1" /end CHARACTERISTIC
/begin CHARACTERISTIC MoFFrm_Tx_DataPdu_VCU_281h.posnAlvCntrStrtBit_C "MoFFrm_Tx_DataPdu_VCU_281h / alive counter start bit position" VALUE 0x802705EA Val_Wu16 65535.00 OneToOne 0.00 65535.00 FORMAT "%8.2" /end CHARACTERISTIC
/begin CHARACTERISTIC MoFFrm_Tx_DataPdu_VCU_281h.posnCrcCalcEndByte_C "MoFFrm_Tx_DataPdu_VCU_281h / Start byte of CRC calculation position of Data PDU Tx" VALUE 0x802705EC Val_Wu8 255.0 OneToOne 0.00 255.0 FORMAT "%5.1" /end CHARACTERISTIC
/begin CHARACTERISTIC MoFFrm_Tx_DataPdu_VCU_281h.posnCrcCalcStrtByte_C "MoFFrm_Tx_DataPdu_VCU_281h / Start byte of CRC calculation position of Data PDU Tx" VALUE 0x802705ED Val_Wu8 255.0 OneToOne 0.00 255.0 FORMAT "%5.1" /end CHARACTERISTIC
/begin CHARACTERISTIC MoFFrm_Tx_DataPdu_VCU_281h.posnCrcStrtBit_C "MoFFrm_Tx_DataPdu_VCU_281h / CRC start bit position" VALUE 0x802705EE Val_Wu16 65535.00 OneToOne 0.00 65535.00 FORMAT "%8.2" /end CHARACTERISTIC
/begin CHARACTERISTIC MoFFrm_Tx_DataPdu_VCU_281h.sigLenAlvCntr_C "MoFFrm_Tx_DataPdu_VCU_281h / alive counter signal length" VALUE 0x802705F0 Val_Wu8 31.00 OneToOne 1.00 32.00 FORMAT "%5.2" EXTENDED_LIMITS 0.00 255.0 /end CHARACTERISTIC
/begin CHARACTERISTIC MoFFrm_Tx_DataPdu_VCU_281h.sigLenCrc_C "MoFFrm_Tx_DataPdu_VCU_281h / CRC signal length" VALUE 0x802705F1 Val_Wu8 31.00 OneToOne 1.00 32.00 FORMAT "%5.2" EXTENDED_LIMITS 0.00 255.0 /end CHARACTERISTIC
/begin CHARACTERISTIC MoFFrm_uDcChrgnDft_C "Calibration for bus positive voltage" VALUE 0x8026D758 Val_Ws16 6553.500 RBPtCel_u_0p1_1 -3276.800 3276.700 FORMAT "%8.3" /end CHARACTERISTIC
/begin CHARACTERISTIC MoFFrm_uDcdcHvActDft_C "" VALUE 0x8026D75A Val_Wu16 65535.00 RBPtCel_u_1p0_1 0.00 65535.00 FORMAT "%8.2" /end CHARACTERISTIC
/begin CHARACTERISTIC MoFFrm_uDcLnk01Dft_C "" VALUE 0x8026D75C Val_Wu16 65535.00 RBPtCel_u_1p0_1 0.00 65535.00 FORMAT "%8.2" /end CHARACTERISTIC
/begin CHARACTERISTIC MoFFrm_uSofAsilRaw_C "Default value for battery voltage read in monitoring" VALUE 0x8026D762 Val_Wu16 4095.938 spg_q0p0625_V 0.00 4095.938 FORMAT "%8.3" /end CHARACTERISTIC
/begin CHARACTERISTIC MoFFrm_vVehDft_C "Replacement value for signal VITESSE_VEHICULE_ROUES" VALUE 0x8026D75E Val_Wu16 655.3500 RBPtCel_v_0p01_1 0.00 655.3500 FORMAT "%8.4" /end CHARACTERISTIC
/begin CHARACTERISTIC MoFInCo_errReactnSelnMask_C "Calibration:mask selection for error reaction" VALUE 0x8026CF0D Val_Wu8 255.0 OneToOne 0.00 255.0 FORMAT "%5.1" /end CHARACTERISTIC
/begin CHARACTERISTIC MoFIn_flgDrvrDoorOpenEna_C "Calibration for MoFIn_flgDrvrDoorOpen" VALUE 0x8026CF0E Val_Wu8 1.00000000000 B_TRUE 0.00 1.00000000000 FORMAT "%13.11" /end CHARACTERISTIC
/begin CHARACTERISTIC MoFIn_flgShtOffPahReqd_C "Calibration for Shut Off Path Requested" VALUE 0x8026CF0F Val_Wu8 1.00000000000 B_TRUE 0.00 1.00000000000 FORMAT "%13.11" READ_ONLY /end CHARACTERISTIC
/begin CHARACTERISTIC MoFIn_stAdap_C "adapter status in function monitoring" VALUE 0x8026CF10 Val_Wu8 255.0 OneToOne 0.00 255.0 FORMAT "%5.1" /end CHARACTERISTIC
/begin CHARACTERISTIC MoFIn_stErrLvPwrSply_C "Default value for power supply error in monitoring" VALUE 0x8026CF11 Val_Wu8 255.0 OneToOne 0.00 255.0 FORMAT "%5.1" /end CHARACTERISTIC
/begin CHARACTERISTIC MoFIn_stErrReactn_C "Calibration:status of error reaction" VALUE 0x8026CF12 Val_Wu8 255.0 OneToOne 0.00 255.0 FORMAT "%5.1" /end CHARACTERISTIC
/begin CHARACTERISTIC MoFPtSt_ratPT_C "Default calibrated value for the torque ratio in function monitoring" VALUE 0x8026D764 Val_Ws16 655.3500 TransR -327.6800 327.6700 FORMAT "%8.4" /end CHARACTERISTIC
/begin CHARACTERISTIC MoFPtSt_ratSecPT_C "Default value for Powertrain torque ratio for secondary axle." VALUE 0x8026D766 Val_Ws16 655.3500 TransR -327.6800 327.6700 FORMAT "%8.4" /end CHARACTERISTIC
/begin CHARACTERISTIC MoFTqPtdOut_tqLimnEm01Dft_C "Deault calibration for signal MoFTqPtdOut_tqLimnEm01" VALUE 0x8026D760 Val_Ws16 6553.500 Trq -3276.800 3276.700 FORMAT "%8.3" /end CHARACTERISTIC
/begin CHARACTERISTIC MoFTrsmAssc_flgGearNrErr_C "Gear Request Error" VALUE 0x8026CF13 Val_Wu8 1.00000000000 B_TRUE 0.00 1.00000000000 FORMAT "%13.11" /end CHARACTERISTIC
/begin CHARACTERISTIC MonEgyChrgnCrash_stCrashDetn_C "Calibration for Crash Determination" VALUE 0x8026CF14 Val_Wu8 255.0 OneToOne 0.00 255.0 FORMAT "%5.1" /end CHARACTERISTIC
/begin CHARACTERISTIC MonEgyChrgn_stExtChrgnDiCmd_C "Exit charging Di Cmd" VALUE 0x8026CF15 Val_Wu8 255.0 OneToOne 0.00 255.0 FORMAT "%5.1" /end CHARACTERISTIC
/begin MEASUREMENT ElM_stDesEem02 "Desired state of inverter and e-machine 02" UBYTE OneToOne 1 100 0.00 255.0 FORMAT "%5.1" ECU_ADDRESS 0x600235A4
 /begin IF_DATA XCPplus 0x0102
  /begin DAQ_EVENT VARIABLE /end DAQ_EVENT
 /end IF_DATA
/end MEASUREMENT
/begin MEASUREMENT MoFDrvrAssc_flgAccActv "flag to Indicate the ACC active status" UBYTE B_TRUE 1 100 0.00 1.00000000000 BIT_MASK 0x10 FORMAT "%13.11" ECU_ADDRESS 0x6002C706
 /begin IF_DATA XCPplus 0x0102
  /begin DAQ_EVENT VARIABLE /end DAQ_EVENT
 /end IF_DATA
/end MEASUREMENT
/begin MEASUREMENT MoFDrvrAssc_flgAtnmsDrvActv "Autonomus driving status active" UBYTE B_TRUE 1 100 0.00 1.00000000000 BIT_MASK 0x2 FORMAT "%13.11" ECU_ADDRESS 0x6002C706
 /begin IF_DATA XCPplus 0x0102
  /begin DAQ_EVENT VARIABLE /end DAQ_EVENT
 /end IF_DATA
/end MEASUREMENT
/begin MEASUREMENT MoFDrvrAssc_flgDrvrAsscActv "a driver assistance function (cruise) is active and valid" UBYTE B_TRUE 1 100 0.00 1.00000000000 BIT_MASK 0x4 FORMAT "%13.11" ECU_ADDRESS 0x6002C705
 /begin IF_DATA XCPplus 0x0102
  /begin DAQ_EVENT VARIABLE /end DAQ_EVENT
 /end IF_DATA
/end MEASUREMENT
/begin MEASUREMENT MoFDrvrAssc_flgNeutRampActv "Flag to indicate neutral gear ramp active" UBYTE B_TRUE 1 100 0.00 1.00000000000 BIT_MASK 0x20 FORMAT "%13.11" ECU_ADDRESS 0x6002C706
 /begin IF_DATA XCPplus 0x0102
  /begin DAQ_EVENT VARIABLE /end DAQ_EVENT
 /end IF_DATA
/end MEASUREMENT
/begin MEASUREMENT MoFDrvrAssc_stAdasOvrd "Advanced Driver Assistance override status" UBYTE OneToOne 1 100 0.00 255.0 FORMAT "%5.1" ECU_ADDRESS 0x6002C715
 /begin IF_DATA XCPplus 0x0102
  /begin DAQ_EVENT VARIABLE /end DAQ_EVENT
 /end IF_DATA
/end MEASUREMENT
/begin MEASUREMENT MoFDrvrAssc_stAdasOvrdCpl "Complement of Advanced driver assistance System override status" UBYTE OneToOne 1 100 0.00 255.0 FORMAT "%5.1" ECU_ADDRESS 0x6002BCF9
 /begin IF_DATA XCPplus 0x0102
  /begin DAQ_EVENT VARIABLE /end DAQ_EVENT
 /end IF_DATA
/end MEASUREMENT
/begin MEASUREMENT MoFDrvrAssc_tqDrvrAssc "Driver Assistance torque in functional safety" SLONG TrqPrpHigh 1 100 -214748364.800 214748364.700 FORMAT "%13.3" ECU_ADDRESS 0x6002C6FC
 /begin IF_DATA XCPplus 0x0102
  /begin DAQ_EVENT VARIABLE /end DAQ_EVENT
 /end IF_DATA
/end MEASUREMENT
/begin MEASUREMENT MoFDrvrAssc_tqDrvrAsscCpl "Complement of Driver assistance torque" ULONG OneToOne 1 100 0.00 4294967295.00 FORMAT "%13.2" ECU_ADDRESS 0x6002BCE0
 /begin IF_DATA XCPplus 0x0102
  /begin DAQ_EVENT VARIABLE /end DAQ_EVENT
 /end IF_DATA
/end MEASUREMENT
/begin MEASUREMENT MoFDrvrAssc_tqSpdLimr "Speed Limiter torque" SLONG TrqPrpHigh 1 100 -214748364.800 214748364.700 FORMAT "%13.3" ECU_ADDRESS 0x6002C6F8
 /begin IF_DATA XCPplus 0x0102
  /begin DAQ_EVENT VARIABLE /end DAQ_EVENT
 /end IF_DATA
/end MEASUREMENT
/begin MEASUREMENT MoFDrvrAssc_tqSpdLimrCpl "RAM data redundancy of MoFDrvrAssc_tqSpdLimr" ULONG OneToOne 1 100 0.00 4294967295.00 FORMAT "%13.2" ECU_ADDRESS 0x6002BCDC
 /begin IF_DATA XCPplus 0x0102
  /begin DAQ_EVENT VARIABLE /end DAQ_EVENT
 /end IF_DATA
/end MEASUREMENT
/begin MEASUREMENT MoFFrm_aRecupDrvOnePedlDrvg "Deceleration rate in Drive for recupertion" SWORD acc_q0p001 1 100 -32.76800 32.76700 FORMAT "%8.5" ECU_ADDRESS 0x6002C6EE
 /begin IF_DATA XCPplus 0x0102
  /begin DAQ_EVENT VARIABLE /end DAQ_EVENT
 /end IF_DATA
/end MEASUREMENT
/begin MEASUREMENT MoFFrm_aRecupDrvOnePedlDrvgCpl "Complement for MoFFrm_aRecupDrvOnePedlDrvg" UWORD OneToOne 1 100 0.00 65535.00 FORMAT "%8.2" ECU_ADDRESS 0x6002BCD2
 /begin IF_DATA XCPplus 0x0102
  /begin DAQ_EVENT VARIABLE /end DAQ_EVENT
 /end IF_DATA
/end MEASUREMENT
/begin MEASUREMENT MoFFrm_aRecupRvsOnePedlDrvg "Deceleration rate in Reverse for recupertion" SWORD acc_q0p001 1 100 -32.76800 32.76700 FORMAT "%8.5" ECU_ADDRESS 0x6002C6EC
 /begin IF_DATA XCPplus 0x0102
  /begin DAQ_EVENT VARIABLE /end DAQ_EVENT
 /end IF_DATA
/end MEASUREMENT
/begin MEASUREMENT MoFFrm_aRecupRvsOnePedlDrvgCpl "Complement for MoFFrm_aRecupRvsOnePedlDrvg" UWORD OneToOne 1 100 0.00 65535.00 FORMAT "%8.2" ECU_ADDRESS 0x6002BCD0
 /begin IF_DATA XCPplus 0x0102
  /begin DAQ_EVENT VARIABLE /end DAQ_EVENT
 /end IF_DATA
/end MEASUREMENT
/begin MEASUREMENT MoFFrm_flgHMICrpDi "Human-Machine interface creep disable." UBYTE B_TRUE 1 100 0.00 1.00000000000 BIT_MASK 0x4 FORMAT "%13.11" ECU_ADDRESS 0x6002C706
 /begin IF_DATA XCPplus 0x0102
  /begin DAQ_EVENT VARIABLE /end DAQ_EVENT
 /end IF_DATA
/end MEASUREMENT
/begin MEASUREMENT MoFFrm_flgPrpInhb01 "Propulsion inhibit flag from CAN" UBYTE B_TRUE 1 100 0.00 1.00000000000 BIT_MASK 0x80 FORMAT "%13.11" ECU_ADDRESS 0x6002C706
 /begin IF_DATA XCPplus 0x0102
  /begin DAQ_EVENT VARIABLE /end DAQ_EVENT
 /end IF_DATA
/end MEASUREMENT
/begin MEASUREMENT MoFFrm_flgRecupInhb01 "Recuperation inhibit flag from CAN" UBYTE B_TRUE 1 100 0.00 1.00000000000 BIT_MASK 0x1 FORMAT "%13.11" ECU_ADDRESS 0x6002C705
 /begin IF_DATA XCPplus 0x0102
  /begin DAQ_EVENT VARIABLE /end DAQ_EVENT
 /end IF_DATA
/end MEASUREMENT
/begin MEASUREMENT MoFFrm_nrGear "Current gear" SBYTE OneToOne 1 100 -128.0 127.0 FORMAT "%5.1" ECU_ADDRESS 0x6002C714
 /begin IF_DATA XCPplus 0x0102
  /begin DAQ_EVENT VARIABLE /end DAQ_EVENT
 /end IF_DATA
/end MEASUREMENT
/begin MEASUREMENT MoFFrm_nrGearCpl "complement of current gear" UBYTE OneToOne 1 100 0.00 255.0 FORMAT "%5.1" ECU_ADDRESS 0x6002BCF8
 /begin IF_DATA XCPplus 0x0102
  /begin DAQ_EVENT VARIABLE /end DAQ_EVENT
 /end IF_DATA
/end MEASUREMENT
/begin MEASUREMENT MoFFrm_ratVirtZrPnt "Virtual zero point ratio from external source" SWORD Prc 1 100 -400.0000 399.9878 FORMAT "%8.4" ECU_ADDRESS 0x6002C6EA
 /begin IF_DATA XCPplus 0x0102
  /begin DAQ_EVENT VARIABLE /end DAQ_EVENT
 /end IF_DATA
/end MEASUREMENT
/begin MEASUREMENT MoFFrm_ratVirtZrPntCpl "Complement for MoFFrm_ratVirtZrPnt" UWORD OneToOne 1 100 0.00 65535.00 FORMAT "%8.2" ECU_ADDRESS 0x6002BCCE
 /begin IF_DATA XCPplus 0x0102
  /begin DAQ_EVENT VARIABLE /end DAQ_EVENT
 /end IF_DATA
/end MEASUREMENT
/begin MEASUREMENT MoFFrm_stAcPlgIns "AC charger plugged in" UBYTE OneToOne 1 100 0.00 255.0 FORMAT "%5.1" ECU_ADDRESS 0x6002C713
 /begin IF_DATA XCPplus 0x0102
  /begin DAQ_EVENT VARIABLE /end DAQ_EVENT
 /end IF_DATA
/end MEASUREMENT
/begin MEASUREMENT MoFFrm_stAcPlgInsCpl "RAM data redundancy for MoFFrm_stAcPlgIns" UBYTE OneToOne 1 100 0.00 255.0 FORMAT "%5.1" ECU_ADDRESS 0x6002BCF7
 /begin IF_DATA XCPplus 0x0102
  /begin DAQ_EVENT VARIABLE /end DAQ_EVENT
 /end IF_DATA
/end MEASUREMENT
/begin MEASUREMENT MoFFrm_stATCEngMode "Increasing Torque Control-Limit mode" UBYTE OneToOne 1 100 0.00 255.0 FORMAT "%5.1" ECU_ADDRESS 0x6002C712
 /begin IF_DATA XCPplus 0x0102
  /begin DAQ_EVENT VARIABLE /end DAQ_EVENT
 /end IF_DATA
/end MEASUREMENT
/begin MEASUREMENT MoFFrm_stATCEngModeCpl "Complement for MoFFrm_stATCEngMode" UBYTE OneToOne 1 100 0.00 255.0 FORMAT "%5.1" ECU_ADDRESS 0x6002BCF6
 /begin IF_DATA XCPplus 0x0102
  /begin DAQ_EVENT VARIABLE /end DAQ_EVENT
 /end IF_DATA
/end MEASUREMENT
/begin MEASUREMENT MoFFrm_stATCRtdrMode "Retarding Torque Control-Limit mode" UBYTE OneToOne 1 100 0.00 255.0 FORMAT "%5.1" ECU_ADDRESS 0x6002C711
 /begin IF_DATA XCPplus 0x0102
  /begin DAQ_EVENT VARIABLE /end DAQ_EVENT
 /end IF_DATA
/end MEASUREMENT
/begin MEASUREMENT MoFFrm_stATCRtdrModeCpl "Complement for MoFFrm_stATCRtdrMode" UBYTE OneToOne 1 100 0.00 255.0 FORMAT "%5.1" ECU_ADDRESS 0x6002BCF5
 /begin IF_DATA XCPplus 0x0102
  /begin DAQ_EVENT VARIABLE /end DAQ_EVENT
 /end IF_DATA
/end MEASUREMENT
/begin MEASUREMENT MoFFrm_stBrkQlyFacRaw "Quality factor of Brake pressed status received from i-Booster vial CAN" UBYTE OneToOne 1 100 0.00 255.0 FORMAT "%5.1" ECU_ADDRESS 0x6002C710
 /begin IF_DATA XCPplus 0x0102
  /begin DAQ_EVENT VARIABLE /end DAQ_EVENT
 /end IF_DATA
/end MEASUREMENT
/begin MEASUREMENT MoFFrm_stBrkQlyFacRawCpl "Complement variable of MoFFrm_stBrkQlyFacRaw" UBYTE OneToOne 1 100 0.00 255.0 FORMAT "%5.1" ECU_ADDRESS 0x6002BCF4
 /begin IF_DATA XCPplus 0x0102
  /begin DAQ_EVENT VARIABLE /end DAQ_EVENT
 /end IF_DATA
/end MEASUREMENT
/begin MEASUREMENT MoFFrm_stDcPlgIns "DC charger plugged in" UBYTE OneToOne 1 100 0.00 255.0 FORMAT "%5.1" ECU_ADDRESS 0x6002C70F
 /begin IF_DATA XCPplus 0x0102
  /begin DAQ_EVENT VARIABLE /end DAQ_EVENT
 /end IF_DATA
/end MEASUREMENT
/begin MEASUREMENT MoFFrm_stDcPlgInsCpl "RAM data redundancy for MoFFrm_stDcPlgIns" UBYTE OneToOne 1 100 0.00 255.0 FORMAT "%5.1" ECU_ADDRESS 0x6002BCF3
 /begin IF_DATA XCPplus 0x0102
  /begin DAQ_EVENT VARIABLE /end DAQ_EVENT
 /end IF_DATA
/end MEASUREMENT
/begin MEASUREMENT MoFFrm_stIvtr1Intlck "Decentralized interlock state of inverter 1" UBYTE OneToOne 1 100 0.00 255.0 FORMAT "%5.1" ECU_ADDRESS 0x6002C70E
 /begin IF_DATA XCPplus 0x0102
  /begin DAQ_EVENT VARIABLE /end DAQ_EVENT
 /end IF_DATA
/end MEASUREMENT
/begin MEASUREMENT MoFFrm_stIvtr1IntlckCpl "Complement of MoFFrm_stIvtr1Intlck" UBYTE OneToOne 1 100 0.00 255.0 FORMAT "%5.1" ECU_ADDRESS 0x6002BCF2
 /begin IF_DATA XCPplus 0x0102
  /begin DAQ_EVENT VARIABLE /end DAQ_EVENT
 /end IF_DATA
/end MEASUREMENT
/begin MEASUREMENT MoFFrm_stIvtr2Intlck "Decentralized interlock state of inverter 2" UBYTE OneToOne 1 100 0.00 255.0 FORMAT "%5.1" ECU_ADDRESS 0x6002C70D
 /begin IF_DATA XCPplus 0x0102
  /begin DAQ_EVENT VARIABLE /end DAQ_EVENT
 /end IF_DATA
/end MEASUREMENT
/begin MEASUREMENT MoFFrm_stIvtr2IntlckCpl "Complement of MoFFrm_stIvtr2Intlck" UBYTE OneToOne 1 100 0.00 255.0 FORMAT "%5.1" ECU_ADDRESS 0x6002BCF1
 /begin IF_DATA XCPplus 0x0102
  /begin DAQ_EVENT VARIABLE /end DAQ_EVENT
 /end IF_DATA
/end MEASUREMENT
/begin MEASUREMENT MoFFrm_stPrpInhb01Qlfr "CAN qualifier for propulsion inhibit flag" UBYTE OneToOne 1 100 0.00 255.0 FORMAT "%5.1" ECU_ADDRESS 0x6002C70C
 /begin IF_DATA XCPplus 0x0102
  /begin DAQ_EVENT VARIABLE /end DAQ_EVENT
 /end IF_DATA
/end MEASUREMENT
/begin MEASUREMENT MoFFrm_stPrpInhb01QlfrCpl "Complement of propulsion inhibit EM01 CAN qualifier status" UBYTE OneToOne 1 100 0.00 255.0 FORMAT "%5.1" ECU_ADDRESS 0x6002BCF0
 /begin IF_DATA XCPplus 0x0102
  /begin DAQ_EVENT VARIABLE /end DAQ_EVENT
 /end IF_DATA
/end MEASUREMENT
/begin MEASUREMENT MoFFrm_stRecupInhb01Qlfr "CAN qualifier for recuperation inhibit flag" UBYTE OneToOne 1 100 0.00 255.0 FORMAT "%5.1" ECU_ADDRESS 0x6002C70B
 /begin IF_DATA XCPplus 0x0102
  /begin DAQ_EVENT VARIABLE /end DAQ_EVENT
 /end IF_DATA
/end MEASUREMENT
/begin MEASUREMENT MoFFrm_stRecupInhb01QlfrCpl "Complement of recuperation inhibit EM01 CAN qualifier status" UBYTE OneToOne 1 100 0.00 255.0 FORMAT "%5.1" ECU_ADDRESS 0x6002BCEF
 /begin IF_DATA XCPplus 0x0102
  /begin DAQ_EVENT VARIABLE /end DAQ_EVENT
 /end IF_DATA
/end MEASUREMENT
/begin MEASUREMENT MoFFrm_stSofErr "Battery sensor error information" UBYTE OneToOne 1 100 0.00 255.0 FORMAT "%5.1" ECU_ADDRESS 0x6002C70A
 /begin IF_DATA XCPplus 0x0102
  /begin DAQ_EVENT VARIABLE /end DAQ_EVENT
 /end IF_DATA
/end MEASUREMENT
/begin MEASUREMENT MoFFrm_stSofErrCpl "Comlement of MoFFrm_stSofErr" UBYTE OneToOne 1 100 0.00 255.0 FORMAT "%5.1" ECU_ADDRESS 0x6002BCEE
 /begin IF_DATA XCPplus 0x0102
  /begin DAQ_EVENT VARIABLE /end DAQ_EVENT
 /end IF_DATA
/end MEASUREMENT
/begin MEASUREMENT MoFFrm_stT30c "Terminal 30c state" UBYTE OneToOne 1 100 0.00 255.0 FORMAT "%5.1" ECU_ADDRESS 0x6002C709
 /begin IF_DATA XCPplus 0x0102
  /begin DAQ_EVENT VARIABLE /end DAQ_EVENT
 /end IF_DATA
/end MEASUREMENT
/begin MEASUREMENT MoFFrm_stT30cCpl "Complement of MoFFrm_stT30c variable" UBYTE OneToOne 1 100 0.00 255.0 FORMAT "%5.1" ECU_ADDRESS 0x6002BCED
 /begin IF_DATA XCPplus 0x0102
  /begin DAQ_EVENT VARIABLE /end DAQ_EVENT
 /end IF_DATA
/end MEASUREMENT
/begin MEASUREMENT MoFFrm_tqBrkDesPrimAxle "Desired brake torque for primary axle" SLONG TrqPrpHigh 1 100 -214748364.800 214748364.700 FORMAT "%13.3" ECU_ADDRESS 0x6002C6F4
 /begin IF_DATA XCPplus 0x0102
  /begin DAQ_EVENT VARIABLE /end DAQ_EVENT
 /end IF_DATA
/end MEASUREMENT
/begin MEASUREMENT MoFFrm_tqBrkDesPrimAxleCpl "Complement variable of MoFFrm_tqBrkDesPrimAxle" ULONG OneToOne 1 100 0.00 4294967295.00 FORMAT "%13.2" ECU_ADDRESS 0x6002BCD8
 /begin IF_DATA XCPplus 0x0102
  /begin DAQ_EVENT VARIABLE /end DAQ_EVENT
 /end IF_DATA
/end MEASUREMENT
/begin MEASUREMENT MoFFrm_tqBrkDesPrimAxleQlfr "Qualifier for signal Desired brake torque for primary axle" UBYTE OneToOne 1 100 0.00 255.0 FORMAT "%5.1" ECU_ADDRESS 0x6002C708
 /begin IF_DATA XCPplus 0x0102
  /begin DAQ_EVENT VARIABLE /end DAQ_EVENT
 /end IF_DATA
/end MEASUREMENT
/begin MEASUREMENT MoFFrm_tqBrkDesPrimAxleQlfrCpl "Complement variable of MoFFrm_tqBrkDesPrimAxleQlfr" UBYTE OneToOne 1 100 0.00 255.0 FORMAT "%5.1" ECU_ADDRESS 0x6002BCEC
 /begin IF_DATA XCPplus 0x0102
  /begin DAQ_EVENT VARIABLE /end DAQ_EVENT
 /end IF_DATA
/end MEASUREMENT
/begin MEASUREMENT MoFFrm_tqBrkDesSecAxle "Desired brake torque for secondary axle" SLONG TrqPrpHigh 1 100 -214748364.800 214748364.700 FORMAT "%13.3" ECU_ADDRESS 0x6002C6F0
 /begin IF_DATA XCPplus 0x0102
  /begin DAQ_EVENT VARIABLE /end DAQ_EVENT
 /end IF_DATA
/end MEASUREMENT
/begin MEASUREMENT MoFFrm_tqBrkDesSecAxleCpl "Complement variable of MoFFrm_tqBrkDesSecAxle" ULONG OneToOne 1 100 0.00 4294967295.00 FORMAT "%13.2" ECU_ADDRESS 0x6002BCD4
 /begin IF_DATA XCPplus 0x0102
  /begin DAQ_EVENT VARIABLE /end DAQ_EVENT
 /end IF_DATA
/end MEASUREMENT
/begin MEASUREMENT MoFFrm_tqBrkDesSecAxleQlfr "Qualifier for signal Desired brake torque for secondary axle" UBYTE OneToOne 1 100 0.00 255.0 FORMAT "%5.1" ECU_ADDRESS 0x6002C707
 /begin IF_DATA XCPplus 0x0102
  /begin DAQ_EVENT VARIABLE /end DAQ_EVENT
 /end IF_DATA
/end MEASUREMENT
/begin MEASUREMENT MoFFrm_tqBrkDesSecAxleQlfrCpl "Complement variable of MoFFrm_tqBrkDesSecAxleQlfr" UBYTE OneToOne 1 100 0.00 255.0 FORMAT "%5.1" ECU_ADDRESS 0x6002BCEB
 /begin IF_DATA XCPplus 0x0102
  /begin DAQ_EVENT VARIABLE /end DAQ_EVENT
 /end IF_DATA
/end MEASUREMENT
/begin MEASUREMENT MoFFrm_Tx_bbOutIS_DYN_VCU_208hCpl "Complement variable of MoFFrm_Tx_bbOutIS_DYN_VCU_208h" UBYTE OneToOne 1 100 0.00 255.0 FORMAT "%5.1" ECU_ADDRESS 0x6002BD25 /end MEASUREMENT
/begin MEASUREMENT MoFFrm_Tx_bbOutVCU_211hCpl "Complement variable of MoFFrm_Tx_bbOutVCU_211h" UBYTE OneToOne 1 100 0.00 255.0 FORMAT "%5.1" ECU_ADDRESS 0x6002BD24 /end MEASUREMENT
/begin MEASUREMENT MoFFrm_Tx_bbOutVCU_221hCpl "Complement variable of MoFFrm_Tx_bbOutVCU_221h" UBYTE OneToOne 1 100 0.00 255.0 FORMAT "%5.1" ECU_ADDRESS 0x6002BD23 /end MEASUREMENT
/begin MEASUREMENT MoFFrm_Tx_bbOutVCU_241hCpl "Complement of MoFFrm_Tx_bbOutVCU_241h" UBYTE OneToOne 1 100 0.00 255.0 FORMAT "%5.1" ECU_ADDRESS 0x6002BD22 /end MEASUREMENT
/begin MEASUREMENT MoFFrm_Tx_bbOutVCU_281hCpl "Complement variable of MoFFrm_Tx_bbOutVCU_281h" UBYTE OneToOne 1 100 0.00 255.0 FORMAT "%5.1" ECU_ADDRESS 0x6002BD21 /end MEASUREMENT
/begin MEASUREMENT MoFFrm_Tx_Buf_IS_DYN_VCU_208h "Transmit buffer of PDU IS_DYN_VCU_208h" UBYTE OneToOne 1 100 0.00 255.0 FORMAT "%5.1" MATRIX_DIM 8 ECU_ADDRESS 0x60023119
 /begin IF_DATA XCPplus 0x0102
  /begin DAQ_EVENT VARIABLE /end DAQ_EVENT
 /end IF_DATA
/end MEASUREMENT
/begin MEASUREMENT MoFFrm_Tx_Buf_VCU_211h "Transmit buffer of PDU VCU_211h" UBYTE OneToOne 1 100 0.00 255.0 FORMAT "%5.1" MATRIX_DIM 8 ECU_ADDRESS 0x60023111
 /begin IF_DATA XCPplus 0x0102
  /begin DAQ_EVENT VARIABLE /end DAQ_EVENT
 /end IF_DATA
/end MEASUREMENT
/begin MEASUREMENT MoFFrm_Tx_Buf_VCU_221h "Transmit buffer of PDU VCU_221h" UBYTE OneToOne 1 100 0.00 255.0 FORMAT "%5.1" MATRIX_DIM 8 ECU_ADDRESS 0x60023109
 /begin IF_DATA XCPplus 0x0102
  /begin DAQ_EVENT VARIABLE /end DAQ_EVENT
 /end IF_DATA
/end MEASUREMENT
/begin MEASUREMENT MoFFrm_Tx_Buf_VCU_241h "Transmit buffer of PDU VCU_241h" UBYTE OneToOne 1 100 0.00 255.0 FORMAT "%5.1" MATRIX_DIM 8 ECU_ADDRESS 0x60023101
 /begin IF_DATA XCPplus 0x0102
  /begin DAQ_EVENT VARIABLE /end DAQ_EVENT
 /end IF_DATA
/end MEASUREMENT
/begin MEASUREMENT MoFFrm_Tx_Buf_VCU_281h "Transmit buffer of PDU VCU_281h" UBYTE OneToOne 1 100 0.00 255.0 FORMAT "%5.1" MATRIX_DIM 8 ECU_ADDRESS 0x600230F9
 /begin IF_DATA XCPplus 0x0102
  /begin DAQ_EVENT VARIABLE /end DAQ_EVENT
 /end IF_DATA
/end MEASUREMENT
/begin MEASUREMENT MoFFrm_Tx_DataPdu_IS_DYN_VCU_208h.cntrAlvOld "MoFFrm_Tx_DataPdu_IS_DYN_VCU_208h / old alive counter" UBYTE OneToOne 1 100 0.00 255.0 FORMAT "%5.1" ECU_ADDRESS 0x6002C72E /end MEASUREMENT
/begin MEASUREMENT MoFFrm_Tx_DataPdu_IS_DYN_VCU_208h.cntrAlvOldCpl "MoFFrm_Tx_DataPdu_IS_DYN_VCU_208h / complement of oold alive counter" UBYTE OneToOne 1 100 0.00 255.0 FORMAT "%5.1" ECU_ADDRESS 0x6002BD12 /end MEASUREMENT
/begin MEASUREMENT MoFFrm_Tx_DataPdu_IS_DYN_VCU_208h.crcData "MoFFrm_Tx_DataPdu_IS_DYN_VCU_208h / crc data" UWORD OneToOne 1 100 0.00 65535.00 FORMAT "%8.2" ECU_ADDRESS 0x6002C730 /end MEASUREMENT
/begin MEASUREMENT MoFFrm_Tx_DataPdu_IS_DYN_VCU_208h.crcDataCpl "MoFFrm_Tx_DataPdu_IS_DYN_VCU_208h / complement of crc data" UWORD OneToOne 1 100 0.00 65535.00 FORMAT "%8.2" ECU_ADDRESS 0x6002BD14 /end MEASUREMENT
/begin MEASUREMENT MoFFrm_Tx_DataPdu_IS_DYN_VCU_208h.flgAswTrigTx "MoFFrm_Tx_DataPdu_IS_DYN_VCU_208h / ASW Tx trigger flag" UBYTE B_TRUE 1 100 0.00 1.00000000000 BIT_MASK 0x1 FORMAT "%13.11" ECU_ADDRESS 0x6002C732 /end MEASUREMENT
/begin MEASUREMENT MoFFrm_Tx_DataPdu_IS_DYN_VCU_208h.flgAswTrigTxCpl "MoFFrm_Tx_DataPdu_IS_DYN_VCU_208h / complement of ASW Tx trigger flag" UBYTE B_TRUE 1 100 0.00 1.00000000000 BIT_MASK 0x1 FORMAT "%13.11" ECU_ADDRESS 0x6002BD16 /end MEASUREMENT
/begin MEASUREMENT MoFFrm_Tx_DataPdu_VCU_211h.cntrAlvOld "MoFFrm_Tx_DataPdu_VCU_211h / old alive counter" UBYTE OneToOne 1 100 0.00 255.0 FORMAT "%5.1" ECU_ADDRESS 0x6002C728 /end MEASUREMENT
/begin MEASUREMENT MoFFrm_Tx_DataPdu_VCU_211h.cntrAlvOldCpl "MoFFrm_Tx_DataPdu_VCU_211h / complement of oold alive counter" UBYTE OneToOne 1 100 0.00 255.0 FORMAT "%5.1" ECU_ADDRESS 0x6002BD0C /end MEASUREMENT
/begin MEASUREMENT MoFFrm_Tx_DataPdu_VCU_211h.crcData "MoFFrm_Tx_DataPdu_VCU_211h / crc data" UWORD OneToOne 1 100 0.00 65535.00 FORMAT "%8.2" ECU_ADDRESS 0x6002C72A /end MEASUREMENT
/begin MEASUREMENT MoFFrm_Tx_DataPdu_VCU_211h.crcDataCpl "MoFFrm_Tx_DataPdu_VCU_211h / complement of crc data" UWORD OneToOne 1 100 0.00 65535.00 FORMAT "%8.2" ECU_ADDRESS 0x6002BD0E /end MEASUREMENT
/begin MEASUREMENT MoFFrm_Tx_DataPdu_VCU_211h.flgAswTrigTx "MoFFrm_Tx_DataPdu_VCU_211h / ASW Tx trigger flag" UBYTE B_TRUE 1 100 0.00 1.00000000000 BIT_MASK 0x1 FORMAT "%13.11" ECU_ADDRESS 0x6002C72C /end MEASUREMENT
/begin MEASUREMENT MoFFrm_Tx_DataPdu_VCU_211h.flgAswTrigTxCpl "MoFFrm_Tx_DataPdu_VCU_211h / complement of ASW Tx trigger flag" UBYTE B_TRUE 1 100 0.00 1.00000000000 BIT_MASK 0x1 FORMAT "%13.11" ECU_ADDRESS 0x6002BD10 /end MEASUREMENT
/begin MEASUREMENT MoFFrm_Tx_DataPdu_VCU_221h.cntrAlvOld "MoFFrm_Tx_DataPdu_VCU_221h / old alive counter" UBYTE OneToOne 1 100 0.00 255.0 FORMAT "%5.1" ECU_ADDRESS 0x6002C722 /end MEASUREMENT
/begin MEASUREMENT MoFFrm_Tx_DataPdu_VCU_221h.cntrAlvOldCpl "MoFFrm_Tx_DataPdu_VCU_221h / complement of oold alive counter" UBYTE OneToOne 1 100 0.00 255.0 FORMAT "%5.1" ECU_ADDRESS 0x6002BD06 /end MEASUREMENT
/begin MEASUREMENT MoFFrm_Tx_DataPdu_VCU_221h.crcData "MoFFrm_Tx_DataPdu_VCU_221h / crc data" UWORD OneToOne 1 100 0.00 65535.00 FORMAT "%8.2" ECU_ADDRESS 0x6002C724 /end MEASUREMENT
/begin MEASUREMENT MoFFrm_Tx_DataPdu_VCU_221h.crcDataCpl "MoFFrm_Tx_DataPdu_VCU_221h / complement of crc data" UWORD OneToOne 1 100 0.00 65535.00 FORMAT "%8.2" ECU_ADDRESS 0x6002BD08 /end MEASUREMENT
/begin MEASUREMENT MoFFrm_Tx_DataPdu_VCU_221h.flgAswTrigTx "MoFFrm_Tx_DataPdu_VCU_221h / ASW Tx trigger flag" UBYTE B_TRUE 1 100 0.00 1.00000000000 BIT_MASK 0x1 FORMAT "%13.11" ECU_ADDRESS 0x6002C726 /end MEASUREMENT
/begin MEASUREMENT MoFFrm_Tx_DataPdu_VCU_221h.flgAswTrigTxCpl "MoFFrm_Tx_DataPdu_VCU_221h / complement of ASW Tx trigger flag" UBYTE B_TRUE 1 100 0.00 1.00000000000 BIT_MASK 0x1 FORMAT "%13.11" ECU_ADDRESS 0x6002BD0A /end MEASUREMENT
/begin MEASUREMENT MoFFrm_Tx_DataPdu_VCU_241h.cntrAlvOld "Structure instance of PDU VCU_241h / old alive counter" UBYTE OneToOne 1 100 0.00 255.0 FORMAT "%5.1" ECU_ADDRESS 0x6002C71C /end MEASUREMENT
/begin MEASUREMENT MoFFrm_Tx_DataPdu_VCU_241h.cntrAlvOldCpl "Structure instance of PDU VCU_241h / complement of oold alive counter" UBYTE OneToOne 1 100 0.00 255.0 FORMAT "%5.1" ECU_ADDRESS 0x6002BD00 /end MEASUREMENT
/begin MEASUREMENT MoFFrm_Tx_DataPdu_VCU_241h.crcData "Structure instance of PDU VCU_241h / crc data" UWORD OneToOne 1 100 0.00 65535.00 FORMAT "%8.2" ECU_ADDRESS 0x6002C71E /end MEASUREMENT
/begin MEASUREMENT MoFFrm_Tx_DataPdu_VCU_241h.crcDataCpl "Structure instance of PDU VCU_241h / complement of crc data" UWORD OneToOne 1 100 0.00 65535.00 FORMAT "%8.2" ECU_ADDRESS 0x6002BD02 /end MEASUREMENT
/begin MEASUREMENT MoFFrm_Tx_DataPdu_VCU_241h.flgAswTrigTx "Structure instance of PDU VCU_241h / ASW Tx trigger flag" UBYTE B_TRUE 1 100 0.00 1.00000000000 BIT_MASK 0x1 FORMAT "%13.11" ECU_ADDRESS 0x6002C720 /end MEASUREMENT
/begin MEASUREMENT MoFFrm_Tx_DataPdu_VCU_241h.flgAswTrigTxCpl "Structure instance of PDU VCU_241h / complement of ASW Tx trigger flag" UBYTE B_TRUE 1 100 0.00 1.00000000000 BIT_MASK 0x1 FORMAT "%13.11" ECU_ADDRESS 0x6002BD04 /end MEASUREMENT
/begin MEASUREMENT MoFFrm_Tx_DataPdu_VCU_281h.cntrAlvOld "MoFFrm_Tx_DataPdu_VCU_281h / old alive counter" UBYTE OneToOne 1 100 0.00 255.0 FORMAT "%5.1" ECU_ADDRESS 0x6002C716 /end MEASUREMENT
/begin MEASUREMENT MoFFrm_Tx_DataPdu_VCU_281h.cntrAlvOldCpl "MoFFrm_Tx_DataPdu_VCU_281h / complement of oold alive counter" UBYTE OneToOne 1 100 0.00 255.0 FORMAT "%5.1" ECU_ADDRESS 0x6002BCFA /end MEASUREMENT
/begin MEASUREMENT MoFFrm_Tx_DataPdu_VCU_281h.crcData "MoFFrm_Tx_DataPdu_VCU_281h / crc data" UWORD OneToOne 1 100 0.00 65535.00 FORMAT "%8.2" ECU_ADDRESS 0x6002C718 /end MEASUREMENT
/begin MEASUREMENT MoFFrm_Tx_DataPdu_VCU_281h.crcDataCpl "MoFFrm_Tx_DataPdu_VCU_281h / complement of crc data" UWORD OneToOne 1 100 0.00 65535.00 FORMAT "%8.2" ECU_ADDRESS 0x6002BCFC /end MEASUREMENT
/begin MEASUREMENT MoFFrm_Tx_DataPdu_VCU_281h.flgAswTrigTx "MoFFrm_Tx_DataPdu_VCU_281h / ASW Tx trigger flag" UBYTE B_TRUE 1 100 0.00 1.00000000000 BIT_MASK 0x1 FORMAT "%13.11" ECU_ADDRESS 0x6002C71A /end MEASUREMENT
/begin MEASUREMENT MoFFrm_Tx_DataPdu_VCU_281h.flgAswTrigTxCpl "MoFFrm_Tx_DataPdu_VCU_281h / complement of ASW Tx trigger flag" UBYTE B_TRUE 1 100 0.00 1.00000000000 BIT_MASK 0x1 FORMAT "%13.11" ECU_ADDRESS 0x6002BCFE /end MEASUREMENT
/begin MEASUREMENT MoFFrm_Tx_dataVCU_DCDC_State_Command "Safety information to be transmitted in network signal VCU_DCDC_State_Command" UBYTE OneToOne 1 100 0.00 255.0 FORMAT "%5.1" ECU_ADDRESS 0x6002C744
 /begin IF_DATA XCPplus 0x0102
  /begin DAQ_EVENT VARIABLE /end DAQ_EVENT
 /end IF_DATA
/end MEASUREMENT
/begin MEASUREMENT MoFFrm_Tx_dataVCU_DCDC_State_CommandCpl "Complement variable of MoFFrm_Tx_dataVCU_DCDC_State_Command" UBYTE OneToOne 1 100 0.00 255.0 FORMAT "%5.1" ECU_ADDRESS 0x6002BD20
 /begin IF_DATA XCPplus 0x0102
  /begin DAQ_EVENT VARIABLE /end DAQ_EVENT
 /end IF_DATA
/end MEASUREMENT
/begin MEASUREMENT MoFFrm_Tx_dataVCU_EMERGENCY_SHUTDOWN "Safety information to be transmitted in network signal VCU_EMERGENCY_SHUTDOWN" UBYTE OneToOne 1 100 0.00 255.0 FORMAT "%5.1" ECU_ADDRESS 0x6002C743
 /begin IF_DATA XCPplus 0x0102
  /begin DAQ_EVENT VARIABLE /end DAQ_EVENT
 /end IF_DATA
/end MEASUREMENT
/begin MEASUREMENT MoFFrm_Tx_dataVCU_EMERGENCY_SHUTDOWNCpl "Complement of MoFFrm_Tx_dataVCU_EMERGENCY_SHUTDOWN" UBYTE OneToOne 1 100 0.00 255.0 FORMAT "%5.1" ECU_ADDRESS 0x6002BD1F
 /begin IF_DATA XCPplus 0x0102
  /begin DAQ_EVENT VARIABLE /end DAQ_EVENT
 /end IF_DATA
/end MEASUREMENT
/begin MEASUREMENT MoFFrm_Tx_dataVCU_INV_ACTIVE_DISCHARGE_REQ "Safety information to be transmitted in network signal VCU_INV_ACTIVE_DISCHARGE_REQ" UBYTE OneToOne 1 100 0.00 255.0 FORMAT "%5.1" ECU_ADDRESS 0x6002C742
 /begin IF_DATA XCPplus 0x0102
  /begin DAQ_EVENT VARIABLE /end DAQ_EVENT
 /end IF_DATA
/end MEASUREMENT
/begin MEASUREMENT MoFFrm_Tx_dataVCU_INV_ACTIVE_DISCHARGE_REQCpl "Complement variable of MoFFrm_Tx_dataVCU_INV_ACTIVE_DISCHARGE_REQ" UBYTE OneToOne 1 100 0.00 255.0 FORMAT "%5.1" ECU_ADDRESS 0x6002BD1E
 /begin IF_DATA XCPplus 0x0102
  /begin DAQ_EVENT VARIABLE /end DAQ_EVENT
 /end IF_DATA
/end MEASUREMENT
/begin MEASUREMENT MoFFrm_Tx_dataVCU_INV_CTRL_MODE_REQ "Safety information to be transmitted in network signal VCU_INV_CTRL_MODE_REQ" UBYTE OneToOne 1 100 0.00 255.0 FORMAT "%5.1" ECU_ADDRESS 0x6002C741
 /begin IF_DATA XCPplus 0x0102
  /begin DAQ_EVENT VARIABLE /end DAQ_EVENT
 /end IF_DATA
/end MEASUREMENT
/begin MEASUREMENT MoFFrm_Tx_dataVCU_INV_CTRL_MODE_REQCpl "Complement variable of MoFFrm_Tx_dataVCU_INV_CTRL_MODE_REQ" UBYTE OneToOne 1 100 0.00 255.0 FORMAT "%5.1" ECU_ADDRESS 0x6002BD1D
 /begin IF_DATA XCPplus 0x0102
  /begin DAQ_EVENT VARIABLE /end DAQ_EVENT
 /end IF_DATA
/end MEASUREMENT
/begin MEASUREMENT MoFFrm_Tx_dataVCU_INV_TRQ_REQ "Safety information to be transmitted in network signal VCU_INV_TRQ_REQ" SWORD OneToOne 1 100 -32768.00 32767.00 FORMAT "%8.2" ECU_ADDRESS 0x6002C734
 /begin IF_DATA XCPplus 0x0102
  /begin DAQ_EVENT VARIABLE /end DAQ_EVENT
 /end IF_DATA
/end MEASUREMENT
/begin MEASUREMENT MoFFrm_Tx_dataVCU_INV_TRQ_REQCpl "Complement variable of MoFFrm_Tx_dataVCU_INV_TRQ_REQ" UWORD OneToOne 1 100 0.00 65535.00 FORMAT "%8.2" ECU_ADDRESS 0x6002BD18
 /begin IF_DATA XCPplus 0x0102
  /begin DAQ_EVENT VARIABLE /end DAQ_EVENT
 /end IF_DATA
/end MEASUREMENT
/begin MEASUREMENT MoFFrm_Tx_dataVCU_MASTER_WARNING_LIGHT "Safety information to be transmitted in network signal VCU_MASTER_WARNING_LIGHT" UBYTE OneToOne 1 100 0.00 255.0 FORMAT "%5.1" ECU_ADDRESS 0x6002C740
 /begin IF_DATA XCPplus 0x0102
  /begin DAQ_EVENT VARIABLE /end DAQ_EVENT
 /end IF_DATA
/end MEASUREMENT
/begin MEASUREMENT MoFFrm_Tx_dataVCU_MASTER_WARNING_LIGHTCpl "Complement variable of MoFFrm_Tx_dataVCU_MASTER_WARNING_LIGHT" UBYTE OneToOne 1 100 0.00 255.0 FORMAT "%5.1" ECU_ADDRESS 0x6002BD1C
 /begin IF_DATA XCPplus 0x0102
  /begin DAQ_EVENT VARIABLE /end DAQ_EVENT
 /end IF_DATA
/end MEASUREMENT
/begin MEASUREMENT MoFFrm_Tx_dataVCU_STATE_COMMAND "Safety information to be transmitted in network signal VCU_STATE_COMMAND" UBYTE OneToOne 1 100 0.00 255.0 FORMAT "%5.1" ECU_ADDRESS 0x6002C73F
 /begin IF_DATA XCPplus 0x0102
  /begin DAQ_EVENT VARIABLE /end DAQ_EVENT
 /end IF_DATA
/end MEASUREMENT
/begin MEASUREMENT MoFFrm_Tx_dataVCU_STATE_COMMANDCpl "Complement variable of MoFFrm_Tx_dataVCU_STATE_COMMAND" UBYTE OneToOne 1 100 0.00 255.0 FORMAT "%5.1" ECU_ADDRESS 0x6002BD1B
 /begin IF_DATA XCPplus 0x0102
  /begin DAQ_EVENT VARIABLE /end DAQ_EVENT
 /end IF_DATA
/end MEASUREMENT
/begin MEASUREMENT MoFFrm_Tx_dataVCU_VACCUM_FAULT "Safety information to be transmitted in network signal VCU_VACCUM_FAULT" UBYTE OneToOne 1 100 0.00 255.0 FORMAT "%5.1" ECU_ADDRESS 0x6002C73E
 /begin IF_DATA XCPplus 0x0102
  /begin DAQ_EVENT VARIABLE /end DAQ_EVENT
 /end IF_DATA
/end MEASUREMENT
/begin MEASUREMENT MoFFrm_Tx_dataVCU_VACCUM_FAULTCpl "Complement variable of MoFFrm_Tx_dataVCU_VACCUM_FAULT" UBYTE OneToOne 1 100 0.00 255.0 FORMAT "%5.1" ECU_ADDRESS 0x6002BD1A
 /begin IF_DATA XCPplus 0x0102
  /begin DAQ_EVENT VARIABLE /end DAQ_EVENT
 /end IF_DATA
/end MEASUREMENT
/begin MEASUREMENT MoFFrm_Tx_flgPduStIS_DYN_VCU_208h "State flag of PDU IS_DYN_VCU_208h" UBYTE B_TRUE 1 100 0.00 1.00000000000 BIT_MASK 0x1 FORMAT "%13.11" ECU_ADDRESS 0x6002C749
 /begin IF_DATA XCPplus 0x0102
  /begin DAQ_EVENT VARIABLE /end DAQ_EVENT
 /end IF_DATA
/end MEASUREMENT
/begin MEASUREMENT MoFFrm_Tx_flgPduStVCU_211h "State flag of PDU VCU_211h" UBYTE B_TRUE 1 100 0.00 1.00000000000 BIT_MASK 0x1 FORMAT "%13.11" ECU_ADDRESS 0x6002C748
 /begin IF_DATA XCPplus 0x0102
  /begin DAQ_EVENT VARIABLE /end DAQ_EVENT
 /end IF_DATA
/end MEASUREMENT
/begin MEASUREMENT MoFFrm_Tx_flgPduStVCU_221h "State flag of PDU VCU_221h" UBYTE B_TRUE 1 100 0.00 1.00000000000 BIT_MASK 0x1 FORMAT "%13.11" ECU_ADDRESS 0x6002C747
 /begin IF_DATA XCPplus 0x0102
  /begin DAQ_EVENT VARIABLE /end DAQ_EVENT
 /end IF_DATA
/end MEASUREMENT
/begin MEASUREMENT MoFFrm_Tx_flgPduStVCU_241h "State flag of PDU VCU_241h" UBYTE B_TRUE 1 100 0.00 1.00000000000 BIT_MASK 0x1 FORMAT "%13.11" ECU_ADDRESS 0x6002C746
 /begin IF_DATA XCPplus 0x0102
  /begin DAQ_EVENT VARIABLE /end DAQ_EVENT
 /end IF_DATA
/end MEASUREMENT
/begin MEASUREMENT MoFFrm_Tx_flgPduStVCU_281h "State flag of PDU VCU_281h" UBYTE B_TRUE 1 100 0.00 1.00000000000 BIT_MASK 0x1 FORMAT "%13.11" ECU_ADDRESS 0x6002C745
 /begin IF_DATA XCPplus 0x0102
  /begin DAQ_EVENT VARIABLE /end DAQ_EVENT
 /end IF_DATA
/end MEASUREMENT
/begin MEASUREMENT MoFFrm_Tx_mirrBuf "Transmit mirror buffer" UBYTE OneToOne 1 100 0.00 255.0 FORMAT "%5.1" MATRIX_DIM 8 ECU_ADDRESS 0x6002C736
 /begin IF_DATA XCPplus 0x0102
  /begin DAQ_EVENT VARIABLE /end DAQ_EVENT
 /end IF_DATA
/end MEASUREMENT
/begin MEASUREMENT MoFFrm_uSofAsilRaw "Battery sensor: Battery voltage value" UWORD spg_q0p0625_V 1 100 0.00 4095.938 FORMAT "%8.3" ECU_ADDRESS 0x6002C6E8
 /begin IF_DATA XCPplus 0x0102
  /begin DAQ_EVENT VARIABLE /end DAQ_EVENT
 /end IF_DATA
/end MEASUREMENT
/begin MEASUREMENT MoFFrm_uSofAsilRawCpl "Comlement of MoFFrm_stSofErr" UWORD OneToOne 1 100 0.00 65535.00 FORMAT "%8.2" ECU_ADDRESS 0x6002BCCC
 /begin IF_DATA XCPplus 0x0102
  /begin DAQ_EVENT VARIABLE /end DAQ_EVENT
 /end IF_DATA
/end MEASUREMENT
/begin MEASUREMENT MoFIn_Co_bbOut0Cpl "Compliment:byte for gathering local bits in MoFIn_Co" UBYTE OneToOne 1 100 0.00 255.0 FORMAT "%5.1" ECU_ADDRESS 0x6002BCEA
 /begin IF_DATA XCPplus 0x0102
  /begin DAQ_EVENT VARIABLE /end DAQ_EVENT
 /end IF_DATA
/end MEASUREMENT
/begin MEASUREMENT MoFIn_Co_bbOut1Cpl "Compliment:byte for gathering local bits in MoFIn_Co" UBYTE OneToOne 1 100 0.00 255.0 FORMAT "%5.1" ECU_ADDRESS 0x6002BCE9
 /begin IF_DATA XCPplus 0x0102
  /begin DAQ_EVENT VARIABLE /end DAQ_EVENT
 /end IF_DATA
/end MEASUREMENT
/begin MEASUREMENT MoFIn_flgDrvrDoorOpen "driver door open in function monitoring" UBYTE B_TRUE 1 100 0.00 1.00000000000 BIT_MASK 0x1 FORMAT "%13.11" ECU_ADDRESS 0x6002C706
 /begin IF_DATA XCPplus 0x0102
  /begin DAQ_EVENT VARIABLE /end DAQ_EVENT
 /end IF_DATA
/end MEASUREMENT
/begin MEASUREMENT MoFIn_flgShtOffPahReqd "Flag for Shut Off Path Requested" UBYTE B_TRUE 1 100 0.00 1.00000000000 BIT_MASK 0x2 FORMAT "%13.11" ECU_ADDRESS 0x6002C705
 /begin IF_DATA XCPplus 0x0102
  /begin DAQ_EVENT VARIABLE /end DAQ_EVENT
 /end IF_DATA
/end MEASUREMENT
/begin MEASUREMENT MoFIn_stErrLvPwrSply "Power Supply Error from function level" UBYTE OneToOne 1 100 0.00 1.000 FORMAT "%5.3" ECU_ADDRESS 0x6002C704
 /begin IF_DATA XCPplus 0x0102
  /begin DAQ_EVENT VARIABLE /end DAQ_EVENT
 /end IF_DATA
/end MEASUREMENT
/begin MEASUREMENT MoFIn_stErrLvPwrSplyCpl "Comlement of MoFFrm_stSofErr" UBYTE OneToOne 1 100 0.00 255.0 FORMAT "%5.1" ECU_ADDRESS 0x6002BCE8
 /begin IF_DATA XCPplus 0x0102
  /begin DAQ_EVENT VARIABLE /end DAQ_EVENT
 /end IF_DATA
/end MEASUREMENT
/begin MEASUREMENT MoFPtSt_ratPT "Powertrain torque ratio in function monitoring" SWORD TransR 1 100 -327.6800 327.6700 FORMAT "%8.4" ECU_ADDRESS 0x6002C6E0
 /begin IF_DATA XCPplus 0x0102
  /begin DAQ_EVENT VARIABLE /end DAQ_EVENT
 /end IF_DATA
/end MEASUREMENT
/begin MEASUREMENT MoFPtSt_ratPTCpl "RAM data redundancy of MoFPtSt_ratPT" UWORD OneToOne 1 100 0.00 65535.00 FORMAT "%8.2" ECU_ADDRESS 0x6002BCC4
 /begin IF_DATA XCPplus 0x0102
  /begin DAQ_EVENT VARIABLE /end DAQ_EVENT
 /end IF_DATA
/end MEASUREMENT
/begin MEASUREMENT MoFPtSt_ratSecPT "Powertrain ratio for secondary axle." SWORD TransR 1 100 -327.6800 327.6700 FORMAT "%8.4" ECU_ADDRESS 0x6002C6DE
 /begin IF_DATA XCPplus 0x0102
  /begin DAQ_EVENT VARIABLE /end DAQ_EVENT
 /end IF_DATA
/end MEASUREMENT
/begin MEASUREMENT MoFPtSt_ratSecPTCpl "Ram data redundancy of MoFPtSt_ratSecPTC." UWORD OneToOne 1 100 0.00 65535.00 FORMAT "%8.2" ECU_ADDRESS 0x6002BCC2
 /begin IF_DATA XCPplus 0x0102
  /begin DAQ_EVENT VARIABLE /end DAQ_EVENT
 /end IF_DATA
/end MEASUREMENT
/begin MEASUREMENT MoFTrsmAssc_flgGearNrErr "Gear lever error in function monitoring" UBYTE B_TRUE 1 100 0.00 1.00000000000 BIT_MASK 0x8 FORMAT "%13.11" ECU_ADDRESS 0x6002C705
 /begin IF_DATA XCPplus 0x0102
  /begin DAQ_EVENT VARIABLE /end DAQ_EVENT
 /end IF_DATA
/end MEASUREMENT
/begin MEASUREMENT MonBrk_stPrkBrk "Status Park Brake" UBYTE MonBrk_stPrkBrk_VERB 1 100 0.00 255.000000000 FORMAT "%13.9" ECU_ADDRESS 0x6002C703
 /begin IF_DATA XCPplus 0x0102
  /begin DAQ_EVENT VARIABLE /end DAQ_EVENT
 /end IF_DATA
/end MEASUREMENT
/begin MEASUREMENT MonBrk_stPrkBrkCpl "Complement for MonBrk_stPrkBrk" UBYTE OneToOne 1 100 0.00 255.0 FORMAT "%5.1" ECU_ADDRESS 0x6002BCE7
 /begin IF_DATA XCPplus 0x0102
  /begin DAQ_EVENT VARIABLE /end DAQ_EVENT
 /end IF_DATA
/end MEASUREMENT
/begin MEASUREMENT MonBrk_stPrkBrkQlfr "Status Park Brake Qualifier" UWORD OneToOne 1 100 0.00 65535.00 FORMAT "%8.2" ECU_ADDRESS 0x6002C6E6
 /begin IF_DATA XCPplus 0x0102
  /begin DAQ_EVENT VARIABLE /end DAQ_EVENT
 /end IF_DATA
/end MEASUREMENT
/begin MEASUREMENT MonBrk_stPrkBrkQlfrCpl "Complement for MonBrk_stPrkBrkQlfr" UWORD OneToOne 1 100 0.00 65535.00 FORMAT "%8.2" ECU_ADDRESS 0x6002BCCA
 /begin IF_DATA XCPplus 0x0102
  /begin DAQ_EVENT VARIABLE /end DAQ_EVENT
 /end IF_DATA
/end MEASUREMENT
/begin MEASUREMENT MonEgyChrgnCrash_stCrashDetn "Crash Determination status" UBYTE OneToOne 1 100 0.00 255.0 FORMAT "%5.1" ECU_ADDRESS 0x6002C702
 /begin IF_DATA XCPplus 0x0102
  /begin DAQ_EVENT VARIABLE /end DAQ_EVENT
 /end IF_DATA
/end MEASUREMENT
/begin MEASUREMENT MonEgyChrgnCrash_stCrashDetnCpl "Complement of MonEgyChrgnCrash_stCrashDetn" UBYTE OneToOne 1 100 0.00 255.0 FORMAT "%5.1" ECU_ADDRESS 0x6002BCE6
 /begin IF_DATA XCPplus 0x0102
  /begin DAQ_EVENT VARIABLE /end DAQ_EVENT
 /end IF_DATA
/end MEASUREMENT
/begin MEASUREMENT MonEgyChrgn_stDcChrgnQlfr "Signal qualifier of MonEgyChrgn_uDcChrgn" UWORD OneToOne 1 100 0.00 65535.00 FORMAT "%8.2" ECU_ADDRESS 0x6002C6E4
 /begin IF_DATA XCPplus 0x0102
  /begin DAQ_EVENT VARIABLE /end DAQ_EVENT
 /end IF_DATA
/end MEASUREMENT
/begin MEASUREMENT MonEgyChrgn_stDcChrgnQlfrCpl "Complement of MonEgyChrgn_stDcChrgnQlfr" UWORD OneToOne 1 100 0.00 65535.00 FORMAT "%8.2" ECU_ADDRESS 0x6002BCC8
 /begin IF_DATA XCPplus 0x0102
  /begin DAQ_EVENT VARIABLE /end DAQ_EVENT
 /end IF_DATA
/end MEASUREMENT
/begin MEASUREMENT MonEgyChrgn_stDcCntct "Status DC contactors" UBYTE MonEgyChrgn_stDcCntct_VERB 1 100 0.00 2.00000000000 FORMAT "%13.11" ECU_ADDRESS 0x6002C701
 /begin IF_DATA XCPplus 0x0102
  /begin DAQ_EVENT VARIABLE /end DAQ_EVENT
 /end IF_DATA
/end MEASUREMENT
/begin MEASUREMENT MonEgyChrgn_stDcCntctCpl "Cpl check for MonEgyChrgn_stDcCntct" UBYTE OneToOne 1 100 0.00 255.0 FORMAT "%5.1" ECU_ADDRESS 0x6002BCE5
 /begin IF_DATA XCPplus 0x0102
  /begin DAQ_EVENT VARIABLE /end DAQ_EVENT
 /end IF_DATA
/end MEASUREMENT
/begin MEASUREMENT MonEgyChrgn_stDcCntctNeg "Macro defined in DIO.h" UBYTE B_TRUE 1 100 0.00 1.00000000000 BIT_MASK 0x8 FORMAT "%13.11" ECU_ADDRESS 0x6002C706
 /begin IF_DATA XCPplus 0x0102
  /begin DAQ_EVENT VARIABLE /end DAQ_EVENT
 /end IF_DATA
/end MEASUREMENT
/begin MEASUREMENT MonEgyChrgn_stDcCntctPos "Macro defined in DIO.h" UBYTE B_TRUE 1 100 0.00 1.00000000000 BIT_MASK 0x40 FORMAT "%13.11" ECU_ADDRESS 0x6002C706
 /begin IF_DATA XCPplus 0x0102
  /begin DAQ_EVENT VARIABLE /end DAQ_EVENT
 /end IF_DATA
/end MEASUREMENT
/begin MEASUREMENT MonEgyChrgn_stExtChrgnDiCmd "Status external charging disable command" UBYTE MonEgyChrgn_stExtChrgnDiCmd_VERB 1 100 0.00 1.00000000000 FORMAT "%13.11" ECU_ADDRESS 0x6002C700
 /begin IF_DATA XCPplus 0x0102
  /begin DAQ_EVENT VARIABLE /end DAQ_EVENT
 /end IF_DATA
/end MEASUREMENT
/begin MEASUREMENT MonEgyChrgn_stExtChrgnDiCmdCpl "Compelment of MonEgyChrgn_stExtChrgnDiCmd" UBYTE OneToOne 1 100 0.00 255.0 FORMAT "%5.1" ECU_ADDRESS 0x6002BCE4
 /begin IF_DATA XCPplus 0x0102
  /begin DAQ_EVENT VARIABLE /end DAQ_EVENT
 /end IF_DATA
/end MEASUREMENT
/begin MEASUREMENT MonEgyChrgn_uDcChrgn "Voltage at DC vehicle inlet" SWORD RBPtCel_u_0p1_1 1 100 -3276.800 3276.700 FORMAT "%8.3" ECU_ADDRESS 0x6002C6E2
 /begin IF_DATA XCPplus 0x0102
  /begin DAQ_EVENT VARIABLE /end DAQ_EVENT
 /end IF_DATA
/end MEASUREMENT
/begin MEASUREMENT MonEgyChrgn_uDcChrgnCpl "Complement for MonEgyChrgn_uDcChrgn" UWORD OneToOne 1 100 0.00 65535.00 FORMAT "%8.2" ECU_ADDRESS 0x6002BCC6
 /begin IF_DATA XCPplus 0x0102
  /begin DAQ_EVENT VARIABLE /end DAQ_EVENT
 /end IF_DATA
/end MEASUREMENT
/begin MEASUREMENT Mo_stErrReacMsg "Error Reaction Status message" UBYTE OneToOne 1 100 0.00 255.0 FORMAT "%5.1" ECU_ADDRESS 0x60023526
 /begin IF_DATA XCPplus 0x0102
  /begin DAQ_EVENT VARIABLE /end DAQ_EVENT
 /end IF_DATA
/end MEASUREMENT
/begin FUNCTION MoFFrm_Rx "1000.4.0  Function Monitoring: Frame Manager - Received Messages"
 /begin DEF_CHARACTERISTIC MoFFrm_DataNetInfoSigRx_DCDC_FAULT_LEVEL.sigLen_C MoFFrm_DataNetInfoSigRx_DCDC_IN_VOLTAGE.bytOrder_C MoFFrm_DataNetInfoSigRx_DCDC_IN_VOLTAGE.posnStrtBit_C MoFFrm_DataNetInfoSigRx_DCDC_IN_VOLTAGE.sigLen_C MoFFrm_DataNetInfoSigRx_DRIVER_DOOR_INFO.bytOrder_C MoFFrm_DataNetInfoSigRx_DRIVER_DOOR_INFO.posnStrtBit_C MoFFrm_DataNetInfoSigRx_DRIVER_DOOR_INFO.sigLen_C MoFFrm_DataNetInfoSigRx_DRV_INFO_DRVR_SEAT_BELT.bytOrder_C MoFFrm_DataNetInfoSigRx_DRV_INFO_DRVR_SEAT_BELT.posnStrtBit_C MoFFrm_DataNetInfoSigRx_DRV_INFO_DRVR_SEAT_BELT.sigLen_C MoFFrm_DataNetInfoSigRx_HVBAT_CONNECT_STS.bytOrder_C MoFFrm_DataNetInfoSigRx_HVBAT_CONNECT_STS.posnStrtBit_C MoFFrm_DataNetInfoSigRx_HVBAT_CONNECT_STS.sigLen_C MoFFrm_DataNetInfoSigRx_HVBAT_FAULT.bytOrder_C MoFFrm_DataNetInfoSigRx_HVBAT_FAULT.posnStrtBit_C MoFFrm_DataNetInfoSigRx_HVBAT_FAULT.sigLen_C MoFFrm_DataNetInfoSigRx_HVBAT_HVIL_STS.bytOrder_C MoFFrm_DataNetInfoSigRx_HVBAT_HVIL_STS.posnStrtBit_C MoFFrm_DataNetInfoSigRx_HVBAT_HVIL_STS.sigLen_C MoFFrm_DataNetInfoSigRx_INV_DC_BUS_VOLTAGE.bytOrder_C MoFFrm_DataNetInfoSigRx_INV_DC_BUS_VOLTAGE.posnStrtBit_C MoFFrm_DataNetInfoSigRx_INV_DC_BUS_VOLTAGE.sigLen_C MoFFrm_DataNetInfoSigRx_INV_FAULT_LEVEL.bytOrder_C MoFFrm_DataNetInfoSigRx_INV_FAULT_LEVEL.posnStrtBit_C MoFFrm_DataNetInfoSigRx_INV_FAULT_LEVEL.sigLen_C MoFFrm_DataNetInfoSigRx_INV_HILLHOLD_STATUS.bytOrder_C MoFFrm_DataNetInfoSigRx_INV_HILLHOLD_STATUS.posnStrtBit_C MoFFrm_DataNetInfoSigRx_INV_HILLHOLD_STATUS.sigLen_C MoFFrm_DataNetInfoSigRx_INV_MTR_ACTUAL_TRQ.bytOrder_C MoFFrm_DataNetInfoSigRx_INV_MTR_ACTUAL_TRQ.posnStrtBit_C MoFFrm_DataNetInfoSigRx_INV_MTR_ACTUAL_TRQ.sigLen_C MoFFrm_DataNetInfoSigRx_INV_MTR_SPEED.bytOrder_C MoFFrm_DataNetInfoSigRx_INV_MTR_SPEED.posnStrtBit_C MoFFrm_DataNetInfoSigRx_INV_MTR_SPEED.sigLen_C MoFFrm_DataNetInfoSigRx_INV_OP_MODE.bytOrder_C MoFFrm_DataNetInfoSigRx_INV_OP_MODE.posnStrtBit_C MoFFrm_DataNetInfoSigRx_INV_OP_MODE.sigLen_C MoFFrm_DataNetInfoSigRx_PDU_FlgUBus_ActErr.bytOrder_C MoFFrm_DataNetInfoSigRx_PDU_FlgUBus_ActErr.posnStrtBit_C MoFFrm_DataNetInfoSigRx_PDU_FlgUBus_ActErr.sigLen_C MoFFrm_DataNetInfoSigRx_PDU_FlgUBus_OnceErr.bytOrder_C MoFFrm_DataNetInfoSigRx_PDU_FlgUBus_OnceErr.posnStrtBit_C MoFFrm_DataNetInfoSigRx_PDU_FlgUBus_OnceErr.sigLen_C MoFFrm_DataNetInfoSigRx_PDU_FlgUBus_Reliable.bytOrder_C MoFFrm_DataNetInfoSigRx_PDU_FlgUBus_Reliable.posnStrtBit_C MoFFrm_DataNetInfoSigRx_PDU_FlgUBus_Reliable.sigLen_C MoFFrm_DataNetInfoSigRx_PDU_FlgUBus_SysErr.bytOrder_C MoFFrm_DataNetInfoSigRx_PDU_FlgUBus_SysErr.posnStrtBit_C MoFFrm_DataNetInfoSigRx_PDU_FlgUBus_SysErr.sigLen_C MoFFrm_DataNetInfoSigRx_PDU_UBus_V.bytOrder_C MoFFrm_DataNetInfoSigRx_PDU_UBus_V.posnStrtBit_C MoFFrm_DataNetInfoSigRx_PDU_UBus_V.sigLen_C MoFFrm_DataNetInfoSigRx_PRECOND_ELEC_WAKEUP.bytOrder_C MoFFrm_DataNetInfoSigRx_PRECOND_ELEC_WAKEUP.posnStrtBit_C MoFFrm_DataNetInfoSigRx_PRECOND_ELEC_WAKEUP.sigLen_C MoFFrm_DataNetInfoSigRx_REGUL_ABR.bytOrder_C MoFFrm_DataNetInfoSigRx_REGUL_ABR.posnStrtBit_C MoFFrm_DataNetInfoSigRx_REGUL_ABR.sigLen_C MoFFrm_DataNetInfoSigRx_TGLM_FAILURE_STATE.bytOrder_C MoFFrm_DataNetInfoSigRx_TGLM_FAILURE_STATE.posnStrtBit_C MoFFrm_DataNetInfoSigRx_TGLM_FAILURE_STATE.sigLen_C MoFFrm_DataNetInfoSigRx_TOGGLE_MONOSTABLE_POS.bytOrder_C MoFFrm_DataNetInfoSigRx_TOGGLE_MONOSTABLE_POS.posnStrtBit_C MoFFrm_DataNetInfoSigRx_TOGGLE_MONOSTABLE_POS.sigLen_C MoFFrm_DataNetInfoSigRx_VITESSE_VEHICULE_ROUES.bytOrder_C MoFFrm_DataNetInfoSigRx_VITESSE_VEHICULE_ROUES.posnStrtBit_C MoFFrm_DataNetInfoSigRx_VITESSE_VEHICULE_ROUES.sigLen_C MoFFrm_flgBrkRawDft_C MoFFrm_flgDrvrDoorOpenDft_C MoFFrm_flgPreCdngWakeupDft_C MoFFrm_flgRgnInhbnDft_C MoFFrm_flgVehHldActvDft_C MoFFrm_nEm01CANRawDft_C MoFFrm_Rx_DataPdu_DCDC_283h.bufLen_C MoFFrm_Rx_DataPdu_DCDC_283h.bytOrderAlvCntr_C MoFFrm_Rx_DataPdu_DCDC_283h.bytOrderCrc_C MoFFrm_Rx_DataPdu_DCDC_283h.chksEndVal_C MoFFrm_Rx_DataPdu_DCDC_283h.chksStrtVal_C MoFFrm_Rx_DataPdu_DCDC_283h.cntrAlvErrDeb_C MoFFrm_Rx_DataPdu_DCDC_283h.cntrCrcErrDeb_C MoFFrm_Rx_DataPdu_DCDC_283h.cntrMaxAlvDif_C MoFFrm_Rx_DataPdu_DCDC_283h.cntrTiOutDeb_C MoFFrm_Rx_DataPdu_DCDC_283h.crcId_C MoFFrm_Rx_DataPdu_DCDC_283h.cycTi_C MoFFrm_Rx_DataPdu_DCDC_283h.diChks_C MoFFrm_Rx_DataPdu_DCDC_283h.evalType_C MoFFrm_Rx_DataPdu_DCDC_283h.maskAlvCntr_C MoFFrm_Rx_DataPdu_DCDC_283h.posnAlvCntrStrtBit_C MoFFrm_Rx_DataPdu_DCDC_283h.posnCrcCalcEndByte_C MoFFrm_Rx_DataPdu_DCDC_283h.posnCrcCalcStrtByte_C MoFFrm_Rx_DataPdu_DCDC_283h.posnCrcStrtBit_C MoFFrm_Rx_DataPdu_DCDC_283h.sigLenAlvCntr_C MoFFrm_Rx_DataPdu_DCDC_283h.sigLenCrc_C MoFFrm_Rx_DataPdu_DCDC_293h.bufLen_C MoFFrm_Rx_DataPdu_DCDC_293h.bytOrderAlvCntr_C MoFFrm_Rx_DataPdu_DCDC_293h.bytOrderCrc_C MoFFrm_Rx_DataPdu_DCDC_293h.chksEndVal_C MoFFrm_Rx_DataPdu_DCDC_293h.chksStrtVal_C MoFFrm_Rx_DataPdu_DCDC_293h.cntrAlvErrDeb_C MoFFrm_Rx_DataPdu_DCDC_293h.cntrCrcErrDeb_C MoFFrm_Rx_DataPdu_DCDC_293h.cntrMaxAlvDif_C MoFFrm_Rx_DataPdu_DCDC_293h.cntrTiOutDeb_C MoFFrm_Rx_DataPdu_DCDC_293h.crcId_C MoFFrm_Rx_DataPdu_DCDC_293h.cycTi_C MoFFrm_Rx_DataPdu_DCDC_293h.diChks_C MoFFrm_Rx_DataPdu_DCDC_293h.evalType_C MoFFrm_Rx_DataPdu_DCDC_293h.maskAlvCntr_C MoFFrm_Rx_DataPdu_DCDC_293h.posnAlvCntrStrtBit_C MoFFrm_Rx_DataPdu_DCDC_293h.posnCrcCalcEndByte_C MoFFrm_Rx_DataPdu_DCDC_293h.posnCrcCalcStrtByte_C MoFFrm_Rx_DataPdu_DCDC_293h.posnCrcStrtBit_C MoFFrm_Rx_DataPdu_DCDC_293h.sigLenAlvCntr_C MoFFrm_Rx_DataPdu_DCDC_293h.sigLenCrc_C MoFFrm_Rx_DataPdu_HS3_AUTO_GEARBOX_SWITCH_STATUS.bufLen_C MoFFrm_Rx_DataPdu_HS3_AUTO_GEARBOX_SWITCH_STATUS.bytOrderAlvCntr_C MoFFrm_Rx_DataPdu_HS3_AUTO_GEARBOX_SWITCH_STATUS.bytOrderCrc_C MoFFrm_Rx_DataPdu_HS3_AUTO_GEARBOX_SWITCH_STATUS.chksEndVal_C MoFFrm_Rx_DataPdu_HS3_AUTO_GEARBOX_SWITCH_STATUS.chksStrtVal_C MoFFrm_Rx_DataPdu_HS3_AUTO_GEARBOX_SWITCH_STATUS.cntrAlvErrDeb_C MoFFrm_Rx_DataPdu_HS3_AUTO_GEARBOX_SWITCH_STATUS.cntrCrcErrDeb_C MoFFrm_Rx_DataPdu_HS3_AUTO_GEARBOX_SWITCH_STATUS.cntrMaxAlvDif_C MoFFrm_Rx_DataPdu_HS3_AUTO_GEARBOX_SWITCH_STATUS.cntrTiOutDeb_C MoFFrm_Rx_DataPdu_HS3_AUTO_GEARBOX_SWITCH_STATUS.crcId_C MoFFrm_Rx_DataPdu_HS3_AUTO_GEARBOX_SWITCH_STATUS.cycTi_C MoFFrm_Rx_DataPdu_HS3_AUTO_GEARBOX_SWITCH_STATUS.diChks_C MoFFrm_Rx_DataPdu_HS3_AUTO_GEARBOX_SWITCH_STATUS.evalType_C MoFFrm_Rx_DataPdu_HS3_AUTO_GEARBOX_SWITCH_STATUS.maskAlvCntr_C MoFFrm_Rx_DataPdu_HS3_AUTO_GEARBOX_SWITCH_STATUS.posnAlvCntrStrtBit_C MoFFrm_Rx_DataPdu_HS3_AUTO_GEARBOX_SWITCH_STATUS.posnCrcCalcEndByte_C MoFFrm_Rx_DataPdu_HS3_AUTO_GEARBOX_SWITCH_STATUS.posnCrcCalcStrtByte_C MoFFrm_Rx_DataPdu_HS3_AUTO_GEARBOX_SWITCH_STATUS.posnCrcStrtBit_C MoFFrm_Rx_DataPdu_HS3_AUTO_GEARBOX_SWITCH_STATUS.sigLenAlvCntr_C MoFFrm_Rx_DataPdu_HS3_AUTO_GEARBOX_SWITCH_STATUS.sigLenCrc_C MoFFrm_Rx_DataPdu_HVBAT_205h.bufLen_C MoFFrm_Rx_DataPdu_HVBAT_205h.bytOrderAlvCntr_C MoFFrm_Rx_DataPdu_HVBAT_205h.bytOrderCrc_C MoFFrm_Rx_DataPdu_HVBAT_205h.chksEndVal_C MoFFrm_Rx_DataPdu_HVBAT_205h.chksStrtVal_C MoFFrm_Rx_DataPdu_HVBAT_205h.cntrAlvErrDeb_C MoFFrm_Rx_DataPdu_HVBAT_205h.cntrCrcErrDeb_C MoFFrm_Rx_DataPdu_HVBAT_205h.cntrMaxAlvDif_C MoFFrm_Rx_DataPdu_HVBAT_205h.cntrTiOutDeb_C MoFFrm_Rx_DataPdu_HVBAT_205h.crcId_C MoFFrm_Rx_DataPdu_HVBAT_205h.cycTi_C MoFFrm_Rx_DataPdu_HVBAT_205h.diChks_C MoFFrm_Rx_DataPdu_HVBAT_205h.evalType_C MoFFrm_Rx_DataPdu_HVBAT_205h.maskAlvCntr_C MoFFrm_Rx_DataPdu_HVBAT_205h.posnAlvCntrStrtBit_C MoFFrm_Rx_DataPdu_HVBAT_205h.posnCrcCalcEndByte_C MoFFrm_Rx_DataPdu_HVBAT_205h.posnCrcCalcStrtByte_C MoFFrm_Rx_DataPdu_HVBAT_205h.posnCrcStrtBit_C MoFFrm_Rx_DataPdu_HVBAT_205h.sigLenAlvCntr_C MoFFrm_Rx_DataPdu_HVBAT_205h.sigLenCrc_C MoFFrm_Rx_DataPdu_HVBAT_325h.bufLen_C MoFFrm_Rx_DataPdu_HVBAT_325h.bytOrderAlvCntr_C MoFFrm_Rx_DataPdu_HVBAT_325h.bytOrderCrc_C MoFFrm_Rx_DataPdu_HVBAT_325h.chksEndVal_C MoFFrm_Rx_DataPdu_HVBAT_325h.chksStrtVal_C MoFFrm_Rx_DataPdu_HVBAT_325h.cntrAlvErrDeb_C MoFFrm_Rx_DataPdu_HVBAT_325h.cntrCrcErrDeb_C MoFFrm_Rx_DataPdu_HVBAT_325h.cntrMaxAlvDif_C MoFFrm_Rx_DataPdu_HVBAT_325h.cntrTiOutDeb_C MoFFrm_Rx_DataPdu_HVBAT_325h.crcId_C MoFFrm_Rx_DataPdu_HVBAT_325h.cycTi_C MoFFrm_Rx_DataPdu_HVBAT_325h.diChks_C MoFFrm_Rx_DataPdu_HVBAT_325h.evalType_C MoFFrm_Rx_DataPdu_HVBAT_325h.maskAlvCntr_C MoFFrm_Rx_DataPdu_HVBAT_325h.posnAlvCntrStrtBit_C MoFFrm_Rx_DataPdu_HVBAT_325h.posnCrcCalcEndByte_C MoFFrm_Rx_DataPdu_HVBAT_325h.posnCrcCalcStrtByte_C MoFFrm_Rx_DataPdu_HVBAT_325h.posnCrcStrtBit_C MoFFrm_Rx_DataPdu_HVBAT_325h.sigLenAlvCntr_C MoFFrm_Rx_DataPdu_HVBAT_325h.sigLenCrc_C MoFFrm_Rx_DataPdu_INV_217h.bufLen_C MoFFrm_Rx_DataPdu_INV_217h.bytOrderAlvCntr_C MoFFrm_Rx_DataPdu_INV_217h.bytOrderCrc_C MoFFrm_Rx_DataPdu_INV_217h.chksEndVal_C MoFFrm_Rx_DataPdu_INV_217h.chksStrtVal_C MoFFrm_Rx_DataPdu_INV_217h.cntrAlvErrDeb_C MoFFrm_Rx_DataPdu_INV_217h.cntrCrcErrDeb_C MoFFrm_Rx_DataPdu_INV_217h.cntrMaxAlvDif_C MoFFrm_Rx_DataPdu_INV_217h.cntrTiOutDeb_C MoFFrm_Rx_DataPdu_INV_217h.crcId_C MoFFrm_Rx_DataPdu_INV_217h.cycTi_C MoFFrm_Rx_DataPdu_INV_217h.diChks_C MoFFrm_Rx_DataPdu_INV_217h.evalType_C MoFFrm_Rx_DataPdu_INV_217h.maskAlvCntr_C MoFFrm_Rx_DataPdu_INV_217h.posnAlvCntrStrtBit_C MoFFrm_Rx_DataPdu_INV_217h.posnCrcCalcEndByte_C MoFFrm_Rx_DataPdu_INV_217h.posnCrcCalcStrtByte_C MoFFrm_Rx_DataPdu_INV_217h.posnCrcStrtBit_C MoFFrm_Rx_DataPdu_INV_217h.sigLenAlvCntr_C MoFFrm_Rx_DataPdu_INV_217h.sigLenCrc_C MoFFrm_Rx_DataPdu_INV_237.bufLen_C MoFFrm_Rx_DataPdu_INV_237.bytOrderAlvCntr_C MoFFrm_Rx_DataPdu_INV_237.bytOrderCrc_C MoFFrm_Rx_DataPdu_INV_237.chksEndVal_C MoFFrm_Rx_DataPdu_INV_237.chksStrtVal_C MoFFrm_Rx_DataPdu_INV_237.cntrAlvErrDeb_C MoFFrm_Rx_DataPdu_INV_237.cntrCrcErrDeb_C MoFFrm_Rx_DataPdu_INV_237.cntrMaxAlvDif_C MoFFrm_Rx_DataPdu_INV_237.cntrTiOutDeb_C MoFFrm_Rx_DataPdu_INV_237.crcId_C MoFFrm_Rx_DataPdu_INV_237.cycTi_C MoFFrm_Rx_DataPdu_INV_237.diChks_C MoFFrm_Rx_DataPdu_INV_237.evalType_C MoFFrm_Rx_DataPdu_INV_237.maskAlvCntr_C MoFFrm_Rx_DataPdu_INV_237.posnAlvCntrStrtBit_C MoFFrm_Rx_DataPdu_INV_237.posnCrcCalcEndByte_C MoFFrm_Rx_DataPdu_INV_237.posnCrcCalcStrtByte_C MoFFrm_Rx_DataPdu_INV_237.posnCrcStrtBit_C MoFFrm_Rx_DataPdu_INV_237.sigLenAlvCntr_C MoFFrm_Rx_DataPdu_INV_237.sigLenCrc_C MoFFrm_Rx_DataPdu_INV_427h.bufLen_C MoFFrm_Rx_DataPdu_INV_427h.bytOrderAlvCntr_C MoFFrm_Rx_DataPdu_INV_427h.bytOrderCrc_C MoFFrm_Rx_DataPdu_INV_427h.chksEndVal_C MoFFrm_Rx_DataPdu_INV_427h.chksStrtVal_C MoFFrm_Rx_DataPdu_INV_427h.cntrAlvErrDeb_C MoFFrm_Rx_DataPdu_INV_427h.cntrCrcErrDeb_C MoFFrm_Rx_DataPdu_INV_427h.cntrMaxAlvDif_C MoFFrm_Rx_DataPdu_INV_427h.cntrTiOutDeb_C MoFFrm_Rx_DataPdu_INV_427h.crcId_C MoFFrm_Rx_DataPdu_INV_427h.cycTi_C MoFFrm_Rx_DataPdu_INV_427h.diChks_C MoFFrm_Rx_DataPdu_INV_427h.evalType_C MoFFrm_Rx_DataPdu_INV_427h.maskAlvCntr_C MoFFrm_Rx_DataPdu_INV_427h.posnAlvCntrStrtBit_C MoFFrm_Rx_DataPdu_INV_427h.posnCrcCalcEndByte_C MoFFrm_Rx_DataPdu_INV_427h.posnCrcCalcStrtByte_C MoFFrm_Rx_DataPdu_INV_427h.posnCrcStrtBit_C MoFFrm_Rx_DataPdu_INV_427h.sigLenAlvCntr_C MoFFrm_Rx_DataPdu_INV_427h.sigLenCrc_C MoFFrm_Rx_DataPdu_IS_DAT_ABR_50Dh.bufLen_C MoFFrm_Rx_DataPdu_IS_DAT_ABR_50Dh.bytOrderAlvCntr_C MoFFrm_Rx_DataPdu_IS_DAT_ABR_50Dh.bytOrderCrc_C MoFFrm_Rx_DataPdu_IS_DAT_ABR_50Dh.chksEndVal_C MoFFrm_Rx_DataPdu_IS_DAT_ABR_50Dh.chksStrtVal_C MoFFrm_Rx_DataPdu_IS_DAT_ABR_50Dh.cntrAlvErrDeb_C MoFFrm_Rx_DataPdu_IS_DAT_ABR_50Dh.cntrCrcErrDeb_C MoFFrm_Rx_DataPdu_IS_DAT_ABR_50Dh.cntrMaxAlvDif_C MoFFrm_Rx_DataPdu_IS_DAT_ABR_50Dh.cntrTiOutDeb_C MoFFrm_Rx_DataPdu_IS_DAT_ABR_50Dh.crcId_C MoFFrm_Rx_DataPdu_IS_DAT_ABR_50Dh.cycTi_C MoFFrm_Rx_DataPdu_IS_DAT_ABR_50Dh.diChks_C MoFFrm_Rx_DataPdu_IS_DAT_ABR_50Dh.evalType_C MoFFrm_Rx_DataPdu_IS_DAT_ABR_50Dh.maskAlvCntr_C MoFFrm_Rx_DataPdu_IS_DAT_ABR_50Dh.posnAlvCntrStrtBit_C MoFFrm_Rx_DataPdu_IS_DAT_ABR_50Dh.posnCrcCalcEndByte_C MoFFrm_Rx_DataPdu_IS_DAT_ABR_50Dh.posnCrcCalcStrtByte_C MoFFrm_Rx_DataPdu_IS_DAT_ABR_50Dh.posnCrcStrtBit_C MoFFrm_Rx_DataPdu_IS_DAT_ABR_50Dh.sigLenAlvCntr_C MoFFrm_Rx_DataPdu_IS_DAT_ABR_50Dh.sigLenCrc_C MoFFrm_Rx_DataPdu_IS_DAT_BSI_412h.bufLen_C MoFFrm_Rx_DataPdu_IS_DAT_BSI_412h.bytOrderAlvCntr_C MoFFrm_Rx_DataPdu_IS_DAT_BSI_412h.bytOrderCrc_C MoFFrm_Rx_DataPdu_IS_DAT_BSI_412h.chksEndVal_C MoFFrm_Rx_DataPdu_IS_DAT_BSI_412h.chksStrtVal_C MoFFrm_Rx_DataPdu_IS_DAT_BSI_412h.cntrAlvErrDeb_C MoFFrm_Rx_DataPdu_IS_DAT_BSI_412h.cntrCrcErrDeb_C MoFFrm_Rx_DataPdu_IS_DAT_BSI_412h.cntrMaxAlvDif_C MoFFrm_Rx_DataPdu_IS_DAT_BSI_412h.cntrTiOutDeb_C MoFFrm_Rx_DataPdu_IS_DAT_BSI_412h.crcId_C MoFFrm_Rx_DataPdu_IS_DAT_BSI_412h.cycTi_C MoFFrm_Rx_DataPdu_IS_DAT_BSI_412h.diChks_C MoFFrm_Rx_DataPdu_IS_DAT_BSI_412h.evalType_C MoFFrm_Rx_DataPdu_IS_DAT_BSI_412h.maskAlvCntr_C MoFFrm_Rx_DataPdu_IS_DAT_BSI_412h.posnAlvCntrStrtBit_C MoFFrm_Rx_DataPdu_IS_DAT_BSI_412h.posnCrcCalcEndByte_C MoFFrm_Rx_DataPdu_IS_DAT_BSI_412h.posnCrcCalcStrtByte_C MoFFrm_Rx_DataPdu_IS_DAT_BSI_412h.posnCrcStrtBit_C MoFFrm_Rx_DataPdu_IS_DAT_BSI_412h.sigLenAlvCntr_C MoFFrm_Rx_DataPdu_IS_DAT_BSI_412h.sigLenCrc_C MoFFrm_Rx_DataPdu_IS_DYN_ABR_38Dh.bufLen_C MoFFrm_Rx_DataPdu_IS_DYN_ABR_38Dh.bytOrderAlvCntr_C MoFFrm_Rx_DataPdu_IS_DYN_ABR_38Dh.bytOrderCrc_C MoFFrm_Rx_DataPdu_IS_DYN_ABR_38Dh.chksEndVal_C MoFFrm_Rx_DataPdu_IS_DYN_ABR_38Dh.chksStrtVal_C MoFFrm_Rx_DataPdu_IS_DYN_ABR_38Dh.cntrAlvErrDeb_C MoFFrm_Rx_DataPdu_IS_DYN_ABR_38Dh.cntrCrcErrDeb_C MoFFrm_Rx_DataPdu_IS_DYN_ABR_38Dh.cntrMaxAlvDif_C MoFFrm_Rx_DataPdu_IS_DYN_ABR_38Dh.cntrTiOutDeb_C MoFFrm_Rx_DataPdu_IS_DYN_ABR_38Dh.crcId_C MoFFrm_Rx_DataPdu_IS_DYN_ABR_38Dh.cycTi_C MoFFrm_Rx_DataPdu_IS_DYN_ABR_38Dh.diChks_C MoFFrm_Rx_DataPdu_IS_DYN_ABR_38Dh.evalType_C MoFFrm_Rx_DataPdu_IS_DYN_ABR_38Dh.maskAlvCntr_C MoFFrm_Rx_DataPdu_IS_DYN_ABR_38Dh.posnAlvCntrStrtBit_C MoFFrm_Rx_DataPdu_IS_DYN_ABR_38Dh.posnCrcCalcEndByte_C MoFFrm_Rx_DataPdu_IS_DYN_ABR_38Dh.posnCrcCalcStrtByte_C MoFFrm_Rx_DataPdu_IS_DYN_ABR_38Dh.posnCrcStrtBit_C MoFFrm_Rx_DataPdu_IS_DYN_ABR_38Dh.sigLenAlvCntr_C MoFFrm_Rx_DataPdu_IS_DYN_ABR_38Dh.sigLenCrc_C MoFFrm_Rx_DataPdu_PDU_BusVoltages_308.bufLen_C MoFFrm_Rx_DataPdu_PDU_BusVoltages_308.bytOrderAlvCntr_C MoFFrm_Rx_DataPdu_PDU_BusVoltages_308.bytOrderCrc_C MoFFrm_Rx_DataPdu_PDU_BusVoltages_308.chksEndVal_C MoFFrm_Rx_DataPdu_PDU_BusVoltages_308.chksStrtVal_C MoFFrm_Rx_DataPdu_PDU_BusVoltages_308.cntrAlvErrDeb_C MoFFrm_Rx_DataPdu_PDU_BusVoltages_308.cntrCrcErrDeb_C MoFFrm_Rx_DataPdu_PDU_BusVoltages_308.cntrMaxAlvDif_C MoFFrm_Rx_DataPdu_PDU_BusVoltages_308.cntrTiOutDeb_C MoFFrm_Rx_DataPdu_PDU_BusVoltages_308.crcId_C MoFFrm_Rx_DataPdu_PDU_BusVoltages_308.cycTi_C MoFFrm_Rx_DataPdu_PDU_BusVoltages_308.diChks_C MoFFrm_Rx_DataPdu_PDU_BusVoltages_308.evalType_C MoFFrm_Rx_DataPdu_PDU_BusVoltages_308.maskAlvCntr_C MoFFrm_Rx_DataPdu_PDU_BusVoltages_308.posnAlvCntrStrtBit_C MoFFrm_Rx_DataPdu_PDU_BusVoltages_308.posnCrcCalcEndByte_C MoFFrm_Rx_DataPdu_PDU_BusVoltages_308.posnCrcCalcStrtByte_C MoFFrm_Rx_DataPdu_PDU_BusVoltages_308.posnCrcStrtBit_C MoFFrm_Rx_DataPdu_PDU_BusVoltages_308.sigLenAlvCntr_C MoFFrm_Rx_DataPdu_PDU_BusVoltages_308.sigLenCrc_C MoFFrm_Rx_DataPdu_VCU_AIRBAG_351h.bufLen_C MoFFrm_Rx_DataPdu_VCU_AIRBAG_351h.bytOrderAlvCntr_C MoFFrm_Rx_DataPdu_VCU_AIRBAG_351h.bytOrderCrc_C MoFFrm_Rx_DataPdu_VCU_AIRBAG_351h.chksEndVal_C MoFFrm_Rx_DataPdu_VCU_AIRBAG_351h.chksStrtVal_C MoFFrm_Rx_DataPdu_VCU_AIRBAG_351h.cntrAlvErrDeb_C MoFFrm_Rx_DataPdu_VCU_AIRBAG_351h.cntrCrcErrDeb_C MoFFrm_Rx_DataPdu_VCU_AIRBAG_351h.cntrMaxAlvDif_C MoFFrm_Rx_DataPdu_VCU_AIRBAG_351h.cntrTiOutDeb_C MoFFrm_Rx_DataPdu_VCU_AIRBAG_351h.crcId_C MoFFrm_Rx_DataPdu_VCU_AIRBAG_351h.cycTi_C MoFFrm_Rx_DataPdu_VCU_AIRBAG_351h.diChks_C MoFFrm_Rx_DataPdu_VCU_AIRBAG_351h.evalType_C MoFFrm_Rx_DataPdu_VCU_AIRBAG_351h.maskAlvCntr_C MoFFrm_Rx_DataPdu_VCU_AIRBAG_351h.posnAlvCntrStrtBit_C MoFFrm_Rx_DataPdu_VCU_AIRBAG_351h.posnCrcCalcEndByte_C MoFFrm_Rx_DataPdu_VCU_AIRBAG_351h.posnCrcCalcStrtByte_C MoFFrm_Rx_DataPdu_VCU_AIRBAG_351h.posnCrcStrtBit_C MoFFrm_Rx_DataPdu_VCU_AIRBAG_351h.sigLenAlvCntr_C MoFFrm_Rx_DataPdu_VCU_AIRBAG_351h.sigLenCrc_C MoFFrm_Rx_DataPdu_VCU_eBCCM_432h.bufLen_C MoFFrm_Rx_DataPdu_VCU_eBCCM_432h.bytOrderAlvCntr_C MoFFrm_Rx_DataPdu_VCU_eBCCM_432h.bytOrderCrc_C MoFFrm_Rx_DataPdu_VCU_eBCCM_432h.chksEndVal_C MoFFrm_Rx_DataPdu_VCU_eBCCM_432h.chksStrtVal_C MoFFrm_Rx_DataPdu_VCU_eBCCM_432h.cntrAlvErrDeb_C MoFFrm_Rx_DataPdu_VCU_eBCCM_432h.cntrCrcErrDeb_C MoFFrm_Rx_DataPdu_VCU_eBCCM_432h.cntrMaxAlvDif_C MoFFrm_Rx_DataPdu_VCU_eBCCM_432h.cntrTiOutDeb_C MoFFrm_Rx_DataPdu_VCU_eBCCM_432h.crcId_C MoFFrm_Rx_DataPdu_VCU_eBCCM_432h.cycTi_C MoFFrm_Rx_DataPdu_VCU_eBCCM_432h.diChks_C MoFFrm_Rx_DataPdu_VCU_eBCCM_432h.evalType_C MoFFrm_Rx_DataPdu_VCU_eBCCM_432h.maskAlvCntr_C MoFFrm_Rx_DataPdu_VCU_eBCCM_432h.posnAlvCntrStrtBit_C MoFFrm_Rx_DataPdu_VCU_eBCCM_432h.posnCrcCalcEndByte_C MoFFrm_Rx_DataPdu_VCU_eBCCM_432h.posnCrcCalcStrtByte_C MoFFrm_Rx_DataPdu_VCU_eBCCM_432h.posnCrcStrtBit_C MoFFrm_Rx_DataPdu_VCU_eBCCM_432h.sigLenAlvCntr_C MoFFrm_Rx_DataPdu_VCU_eBCCM_432h.sigLenCrc_C MoFFrm_stCplCrashDft_C MoFFrm_stCrashDft_C MoFFrm_stDcChrgnVoltErr_C MoFFrm_stDcdcErrDft_C MoFFrm_stDrvrSeatBltDft_C MoFFrm_stESMFailrDft_C MoFFrm_stGearNumDft_C MoFFrm_stHvbCnctnDft_C MoFFrm_stHvbFltLvlDft_C MoFFrm_stHvIntlckDft_C MoFFrm_stIIvtrFltLvl01Dft_C MoFFrm_stIvtrOpMod01Dft_C MoFFrm_stPrkgBrkSwtDft_C MoFFrm_tqAct01Dft_C MoFFrm_uDcChrgnDft_C MoFFrm_uDcdcHvActDft_C MoFFrm_uDcLnk01Dft_C MoFFrm_vVehDft_C /end DEF_CHARACTERISTIC
 FUNCTION_VERSION "1000.4.0" /end FUNCTION
/begin FUNCTION MoFFrm_Tx "1000.0.0  Function Monitoring: Frame Manager - Sent Messages"
 /begin DEF_CHARACTERISTIC MoFEvMngt_flgEmgyShtActvDft_C MoFEvMngt_stDcdcModReqDft_C MoFEvMngt_stDesEem01Dft_C MoFEvMngt_stElMDesEemDft_C MoFEvMngt_stOperModDesDft_C MoFExtCpt_stBrkBstPFltDft_C MoFExtCpt_stMstWrnLmpDft_C MoFFrm_DataNetInfoSigTx_VCU_DCDC_State_Command.bytOrder_C MoFFrm_DataNetInfoSigTx_VCU_DCDC_State_Command.posnStrtBit_C MoFFrm_DataNetInfoSigTx_VCU_DCDC_State_Command.sigLen_C MoFFrm_DataNetInfoSigTx_VCU_EMERGENCY_SHUTDOWN.bytOrder_C MoFFrm_DataNetInfoSigTx_VCU_EMERGENCY_SHUTDOWN.posnStrtBit_C MoFFrm_DataNetInfoSigTx_VCU_EMERGENCY_SHUTDOWN.sigLen_C MoFFrm_DataNetInfoSigTx_VCU_INV_ACTIVE_DISCHARGE_REQ.bytOrder_C MoFFrm_DataNetInfoSigTx_VCU_INV_ACTIVE_DISCHARGE_REQ.posnStrtBit_C MoFFrm_DataNetInfoSigTx_VCU_INV_ACTIVE_DISCHARGE_REQ.sigLen_C MoFFrm_DataNetInfoSigTx_VCU_INV_CTRL_MODE_REQ.bytOrder_C MoFFrm_DataNetInfoSigTx_VCU_INV_CTRL_MODE_REQ.posnStrtBit_C MoFFrm_DataNetInfoSigTx_VCU_INV_CTRL_MODE_REQ.sigLen_C MoFFrm_DataNetInfoSigTx_VCU_INV_TRQ_REQ.bytOrder_C MoFFrm_DataNetInfoSigTx_VCU_INV_TRQ_REQ.posnStrtBit_C MoFFrm_DataNetInfoSigTx_VCU_INV_TRQ_REQ.sigLen_C MoFFrm_DataNetInfoSigTx_VCU_MASTER_WARNING_LIGHT.bytOrder_C MoFFrm_DataNetInfoSigTx_VCU_MASTER_WARNING_LIGHT.posnStrtBit_C MoFFrm_DataNetInfoSigTx_VCU_MASTER_WARNING_LIGHT.sigLen_C MoFFrm_DataNetInfoSigTx_VCU_STATE_COMMAND.bytOrder_C MoFFrm_DataNetInfoSigTx_VCU_STATE_COMMAND.posnStrtBit_C MoFFrm_DataNetInfoSigTx_VCU_STATE_COMMAND.sigLen_C MoFFrm_DataNetInfoSigTx_VCU_VACCUM_FAULT.bytOrder_C MoFFrm_DataNetInfoSigTx_VCU_VACCUM_FAULT.posnStrtBit_C MoFFrm_DataNetInfoSigTx_VCU_VACCUM_FAULT.sigLen_C MoFFrm_Tx_DataPdu_IS_DYN_VCU_208h.bufLen_C MoFFrm_Tx_DataPdu_IS_DYN_VCU_208h.bytOrderAlvCntr_C MoFFrm_Tx_DataPdu_IS_DYN_VCU_208h.bytOrderCrc_C MoFFrm_Tx_DataPdu_IS_DYN_VCU_208h.chksEndVal_C MoFFrm_Tx_DataPdu_IS_DYN_VCU_208h.chksStrtVal_C MoFFrm_Tx_DataPdu_IS_DYN_VCU_208h.crcId_C MoFFrm_Tx_DataPdu_IS_DYN_VCU_208h.evalType_C MoFFrm_Tx_DataPdu_IS_DYN_VCU_208h.posnAlvCntrStrtBit_C MoFFrm_Tx_DataPdu_IS_DYN_VCU_208h.posnCrcCalcEndByte_C MoFFrm_Tx_DataPdu_IS_DYN_VCU_208h.posnCrcCalcStrtByte_C MoFFrm_Tx_DataPdu_IS_DYN_VCU_208h.posnCrcStrtBit_C MoFFrm_Tx_DataPdu_IS_DYN_VCU_208h.sigLenAlvCntr_C MoFFrm_Tx_DataPdu_IS_DYN_VCU_208h.sigLenCrc_C MoFFrm_Tx_DataPdu_VCU_211h.bufLen_C MoFFrm_Tx_DataPdu_VCU_211h.bytOrderAlvCntr_C MoFFrm_Tx_DataPdu_VCU_211h.bytOrderCrc_C MoFFrm_Tx_DataPdu_VCU_211h.chksEndVal_C MoFFrm_Tx_DataPdu_VCU_211h.chksStrtVal_C MoFFrm_Tx_DataPdu_VCU_211h.crcId_C MoFFrm_Tx_DataPdu_VCU_211h.evalType_C MoFFrm_Tx_DataPdu_VCU_211h.posnAlvCntrStrtBit_C MoFFrm_Tx_DataPdu_VCU_211h.posnCrcCalcEndByte_C MoFFrm_Tx_DataPdu_VCU_211h.posnCrcCalcStrtByte_C MoFFrm_Tx_DataPdu_VCU_211h.posnCrcStrtBit_C MoFFrm_Tx_DataPdu_VCU_211h.sigLenAlvCntr_C MoFFrm_Tx_DataPdu_VCU_211h.sigLenCrc_C MoFFrm_Tx_DataPdu_VCU_221h.bufLen_C MoFFrm_Tx_DataPdu_VCU_221h.bytOrderAlvCntr_C MoFFrm_Tx_DataPdu_VCU_221h.bytOrderCrc_C MoFFrm_Tx_DataPdu_VCU_221h.chksEndVal_C MoFFrm_Tx_DataPdu_VCU_221h.chksStrtVal_C MoFFrm_Tx_DataPdu_VCU_221h.crcId_C MoFFrm_Tx_DataPdu_VCU_221h.evalType_C MoFFrm_Tx_DataPdu_VCU_221h.posnAlvCntrStrtBit_C MoFFrm_Tx_DataPdu_VCU_221h.posnCrcCalcEndByte_C MoFFrm_Tx_DataPdu_VCU_221h.posnCrcCalcStrtByte_C MoFFrm_Tx_DataPdu_VCU_221h.posnCrcStrtBit_C MoFFrm_Tx_DataPdu_VCU_221h.sigLenAlvCntr_C MoFFrm_Tx_DataPdu_VCU_221h.sigLenCrc_C MoFFrm_Tx_DataPdu_VCU_241h.bufLen_C MoFFrm_Tx_DataPdu_VCU_241h.bytOrderAlvCntr_C MoFFrm_Tx_DataPdu_VCU_241h.bytOrderCrc_C MoFFrm_Tx_DataPdu_VCU_241h.chksEndVal_C MoFFrm_Tx_DataPdu_VCU_241h.chksStrtVal_C MoFFrm_Tx_DataPdu_VCU_241h.crcId_C MoFFrm_Tx_DataPdu_VCU_241h.evalType_C MoFFrm_Tx_DataPdu_VCU_241h.posnAlvCntrStrtBit_C MoFFrm_Tx_DataPdu_VCU_241h.posnCrcCalcEndByte_C MoFFrm_Tx_DataPdu_VCU_241h.posnCrcCalcStrtByte_C MoFFrm_Tx_DataPdu_VCU_241h.posnCrcStrtBit_C MoFFrm_Tx_DataPdu_VCU_241h.sigLenAlvCntr_C MoFFrm_Tx_DataPdu_VCU_241h.sigLenCrc_C MoFFrm_Tx_DataPdu_VCU_281h.bufLen_C MoFFrm_Tx_DataPdu_VCU_281h.bytOrderAlvCntr_C MoFFrm_Tx_DataPdu_VCU_281h.bytOrderCrc_C MoFFrm_Tx_DataPdu_VCU_281h.chksEndVal_C MoFFrm_Tx_DataPdu_VCU_281h.chksStrtVal_C MoFFrm_Tx_DataPdu_VCU_281h.crcId_C MoFFrm_Tx_DataPdu_VCU_281h.evalType_C MoFFrm_Tx_DataPdu_VCU_281h.posnAlvCntrStrtBit_C MoFFrm_Tx_DataPdu_VCU_281h.posnCrcCalcEndByte_C MoFFrm_Tx_DataPdu_VCU_281h.posnCrcCalcStrtByte_C MoFFrm_Tx_DataPdu_VCU_281h.posnCrcStrtBit_C MoFFrm_Tx_DataPdu_VCU_281h.sigLenAlvCntr_C MoFFrm_Tx_DataPdu_VCU_281h.sigLenCrc_C MoFTqPtdOut_tqLimnEm01Dft_C /end DEF_CHARACTERISTIC
 /begin IN_MEASUREMENT MoFEvMngt_flgEmgyShtActv MoFEvMngt_stDcdcModReq MoFEvMngt_stDesEem01 MoFEvMngt_stElMDesEem MoFEvMngt_stOperModDes MoFExtCpt_stBrkBstPFlt MoFExtCpt_stMstWrnLmp MoFTqPtdOut_tqLimnEm01 MoXFrm_Buf_IS_DYN_VCU_208h MoXFrm_Buf_VCU_211h MoXFrm_Buf_VCU_221h MoXFrm_Buf_VCU_241h MoXFrm_Buf_VCU_281h MoXFrm_flgUpdIS_DYN_VCU_208h MoXFrm_flgUpdVCU_211h MoXFrm_flgUpdVCU_221h MoXFrm_flgUpdVCU_241h MoXFrm_flgUpdVCU_281h Mo_stCplChk Mo_stMoC Mo_stMoCCpl /end IN_MEASUREMENT
 /begin LOC_MEASUREMENT MoFFrm_Tx_bbOutIS_DYN_VCU_208hCpl MoFFrm_Tx_bbOutVCU_211hCpl MoFFrm_Tx_bbOutVCU_221hCpl MoFFrm_Tx_bbOutVCU_241hCpl MoFFrm_Tx_bbOutVCU_281hCpl MoFFrm_Tx_Buf_IS_DYN_VCU_208h MoFFrm_Tx_Buf_VCU_211h MoFFrm_Tx_Buf_VCU_221h MoFFrm_Tx_Buf_VCU_241h MoFFrm_Tx_Buf_VCU_281h MoFFrm_Tx_DataPdu_IS_DYN_VCU_208h.cntrAlvOld MoFFrm_Tx_DataPdu_IS_DYN_VCU_208h.cntrAlvOldCpl MoFFrm_Tx_DataPdu_IS_DYN_VCU_208h.crcData MoFFrm_Tx_DataPdu_IS_DYN_VCU_208h.crcDataCpl MoFFrm_Tx_DataPdu_IS_DYN_VCU_208h.flgAswTrigTx MoFFrm_Tx_DataPdu_IS_DYN_VCU_208h.flgAswTrigTxCpl MoFFrm_Tx_DataPdu_VCU_211h.cntrAlvOld MoFFrm_Tx_DataPdu_VCU_211h.cntrAlvOldCpl MoFFrm_Tx_DataPdu_VCU_211h.crcData MoFFrm_Tx_DataPdu_VCU_211h.crcDataCpl MoFFrm_Tx_DataPdu_VCU_211h.flgAswTrigTx MoFFrm_Tx_DataPdu_VCU_211h.flgAswTrigTxCpl MoFFrm_Tx_DataPdu_VCU_221h.cntrAlvOld MoFFrm_Tx_DataPdu_VCU_221h.cntrAlvOldCpl MoFFrm_Tx_DataPdu_VCU_221h.crcData MoFFrm_Tx_DataPdu_VCU_221h.crcDataCpl MoFFrm_Tx_DataPdu_VCU_221h.flgAswTrigTx MoFFrm_Tx_DataPdu_VCU_221h.flgAswTrigTxCpl MoFFrm_Tx_DataPdu_VCU_241h.cntrAlvOld MoFFrm_Tx_DataPdu_VCU_241h.cntrAlvOldCpl MoFFrm_Tx_DataPdu_VCU_241h.crcData MoFFrm_Tx_DataPdu_VCU_241h.crcDataCpl MoFFrm_Tx_DataPdu_VCU_241h.flgAswTrigTx MoFFrm_Tx_DataPdu_VCU_241h.flgAswTrigTxCpl MoFFrm_Tx_DataPdu_VCU_281h.cntrAlvOld MoFFrm_Tx_DataPdu_VCU_281h.cntrAlvOldCpl MoFFrm_Tx_DataPdu_VCU_281h.crcData MoFFrm_Tx_DataPdu_VCU_281h.crcDataCpl MoFFrm_Tx_DataPdu_VCU_281h.flgAswTrigTx MoFFrm_Tx_DataPdu_VCU_281h.flgAswTrigTxCpl MoFFrm_Tx_dataVCU_DCDC_State_Command MoFFrm_Tx_dataVCU_DCDC_State_CommandCpl MoFFrm_Tx_dataVCU_EMERGENCY_SHUTDOWN MoFFrm_Tx_dataVCU_EMERGENCY_SHUTDOWNCpl MoFFrm_Tx_dataVCU_INV_ACTIVE_DISCHARGE_REQ MoFFrm_Tx_dataVCU_INV_ACTIVE_DISCHARGE_REQCpl MoFFrm_Tx_dataVCU_INV_CTRL_MODE_REQ MoFFrm_Tx_dataVCU_INV_CTRL_MODE_REQCpl MoFFrm_Tx_dataVCU_INV_TRQ_REQ MoFFrm_Tx_dataVCU_INV_TRQ_REQCpl MoFFrm_Tx_dataVCU_MASTER_WARNING_LIGHT MoFFrm_Tx_dataVCU_MASTER_WARNING_LIGHTCpl MoFFrm_Tx_dataVCU_STATE_COMMAND MoFFrm_Tx_dataVCU_STATE_COMMANDCpl MoFFrm_Tx_dataVCU_VACCUM_FAULT MoFFrm_Tx_dataVCU_VACCUM_FAULTCpl MoFFrm_Tx_flgPduStIS_DYN_VCU_208h MoFFrm_Tx_flgPduStVCU_211h MoFFrm_Tx_flgPduStVCU_221h MoFFrm_Tx_flgPduStVCU_241h MoFFrm_Tx_flgPduStVCU_281h MoFFrm_Tx_mirrBuf /end LOC_MEASUREMENT
 FUNCTION_VERSION "1000.0.0" /end FUNCTION
/begin FUNCTION MoFIn_Co "118.3.0   Function Monitoring: Input signals"
 /begin DEF_CHARACTERISTIC ElM_stDesEem02_C MoFDrvrAssc_flgAccActv_C MoFDrvrAssc_flgDrvrAsscActv_C MoFDrvrAssc_flgNeutRampActv_C MoFDrvrAssc_stAdasOvrd_C MoFDrvrAssc_tqDrvrAssc_C MoFFrm_flgHMICrpDi_C MoFFrm_flgPrpInhb01_C MoFFrm_stATCEngMode_C MoFFrm_stATCRtdrMode_C MoFFrm_stBrkQlyFacRaw_C MoFFrm_stIvtr1Intlck_C MoFFrm_stIvtr2Intlck_C MoFFrm_stPrpInhb01Qlfr_C MoFFrm_stSofErr_C MoFFrm_stT30c_C MoFFrm_tqBrkDesPrimAxleQlfr_C MoFFrm_tqBrkDesPrimAxle_C MoFFrm_tqBrkDesSecAxleQlfr_C MoFFrm_tqBrkDesSecAxle_C MoFFrm_uSofAsilRaw_C MoFInCo_errReactnSelnMask_C MoFIn_flgDrvrDoorOpenEna_C MoFIn_flgShtOffPahReqd_C MoFIn_stAdap_C MoFIn_stErrLvPwrSply_C MoFIn_stErrReactn_C MoFTrsmAssc_flgGearNrErr_C MonEgyChrgnCrash_stCrashDetn_C MonEgyChrgn_stExtChrgnDiCmd_C /end DEF_CHARACTERISTIC
 /begin IN_MEASUREMENT Com_aRecupOnePedlDrvg Com_aRecupRvsOnePedlDrvg Com_rVirtZrPntExt CoVMD_trqLLim DrvMod_stPosn MoCSOP_stRdy MoFBas_flgT15 MoFErrHndlg_stErrReactn MoFFrm_flgDrvrDoorOpen MoFFrm_flgDrvrDoorOpenQlfr MoFFrm_flgRgnInhbn MoFFrm_flgRgnInhbnQlfr MoFFrm_stPrkgBrkSwt MoFFrm_stPrkgBrkSwtQlfr MoFFrm_uDcChrgn MoFFrm_uDcChrgnQlfr MonEgyChrgnInlet_stChrgPlgIf Mo_stCplChk Mo_stMoC Mo_stMoCCpl SyC_stSub /end IN_MEASUREMENT
 /begin OUT_MEASUREMENT ElM_stDesEem02 MoFDrvrAssc_flgAccActv MoFDrvrAssc_flgAtnmsDrvActv MoFDrvrAssc_flgDrvrAsscActv MoFDrvrAssc_flgNeutRampActv MoFDrvrAssc_stAdasOvrd MoFDrvrAssc_tqDrvrAssc MoFDrvrAssc_tqSpdLimr MoFFrm_aRecupDrvOnePedlDrvg MoFFrm_aRecupRvsOnePedlDrvg MoFFrm_flgHMICrpDi MoFFrm_flgPrpInhb01 MoFFrm_flgRecupInhb01 MoFFrm_nrGear MoFFrm_ratVirtZrPnt MoFFrm_stAcPlgIns MoFFrm_stATCEngMode MoFFrm_stATCRtdrMode MoFFrm_stBrkQlyFacRaw MoFFrm_stDcPlgIns MoFFrm_stIvtr1Intlck MoFFrm_stIvtr2Intlck MoFFrm_stPrpInhb01Qlfr MoFFrm_stRecupInhb01Qlfr MoFFrm_stSofErr MoFFrm_stT30c MoFFrm_tqBrkDesPrimAxle MoFFrm_tqBrkDesPrimAxleQlfr MoFFrm_tqBrkDesSecAxle MoFFrm_tqBrkDesSecAxleQlfr MoFFrm_uSofAsilRaw MoFIn_flgDrvrDoorOpen MoFIn_flgShtOffPahReqd MoFIn_stErrLvPwrSply MoFTrsmAssc_flgGearNrErr MonBrk_stPrkBrk MonBrk_stPrkBrkQlfr MonEgyChrgnCrash_stCrashDetn MonEgyChrgn_stDcChrgnQlfr MonEgyChrgn_stDcCntct MonEgyChrgn_stExtChrgnDiCmd MonEgyChrgn_uDcChrgn Mo_stErrReacMsg /end OUT_MEASUREMENT
 /begin LOC_MEASUREMENT MoFDrvrAssc_stAdasOvrdCpl MoFDrvrAssc_tqDrvrAsscCpl MoFDrvrAssc_tqSpdLimrCpl MoFFrm_aRecupDrvOnePedlDrvgCpl MoFFrm_aRecupRvsOnePedlDrvgCpl MoFFrm_nrGearCpl MoFFrm_ratVirtZrPntCpl MoFFrm_stAcPlgInsCpl MoFFrm_stATCEngModeCpl MoFFrm_stATCRtdrModeCpl MoFFrm_stBrkQlyFacRawCpl MoFFrm_stDcPlgInsCpl MoFFrm_stIvtr1IntlckCpl MoFFrm_stIvtr2IntlckCpl MoFFrm_stPrpInhb01QlfrCpl MoFFrm_stRecupInhb01QlfrCpl MoFFrm_stSofErrCpl MoFFrm_stT30cCpl MoFFrm_tqBrkDesPrimAxleCpl MoFFrm_tqBrkDesPrimAxleQlfrCpl MoFFrm_tqBrkDesSecAxleCpl MoFFrm_tqBrkDesSecAxleQlfrCpl MoFFrm_uSofAsilRawCpl MoFIn_Co_bbOut0Cpl MoFIn_Co_bbOut1Cpl MoFIn_stErrLvPwrSplyCpl MonBrk_stPrkBrkCpl MonBrk_stPrkBrkQlfrCpl MonEgyChrgnCrash_stCrashDetnCpl MonEgyChrgn_stDcChrgnQlfrCpl MonEgyChrgn_stDcCntctCpl MonEgyChrgn_stDcCntctNeg MonEgyChrgn_stDcCntctPos MonEgyChrgn_stExtChrgnDiCmdCpl MonEgyChrgn_uDcChrgnCpl /end LOC_MEASUREMENT
 FUNCTION_VERSION "118.3.0" /end FUNCTION
/begin FUNCTION MoFPtSt_Rat "3.1.0     Function monitoring Powertrain ratio" /begin DEF_CHARACTERISTIC MoFPtSt_ratPT_C MoFPtSt_ratSecPT_C /end DEF_CHARACTERISTIC /begin IN_MEASUREMENT Mo_stCplChk Mo_stMoC Mo_stMoCCpl /end IN_MEASUREMENT /begin OUT_MEASUREMENT MoFPtSt_ratPT MoFPtSt_ratSecPT /end OUT_MEASUREMENT /begin LOC_MEASUREMENT MoFPtSt_ratPTCpl MoFPtSt_ratSecPTCpl /end LOC_MEASUREMENT FUNCTION_VERSION "3.1.0" /end FUNCTION
/begin COMPU_METHOD acc_q0p001 "" RAT_FUNC "%6.5" "m/(s^2)" COEFFS 0 1000 0 0 0 1 /end COMPU_METHOD
/begin COMPU_METHOD B_TRUE "" TAB_VERB "%6.3" "" COMPU_TAB_REF B_TRUE /end COMPU_METHOD
/begin COMPU_VTAB B_TRUE "" TAB_VERB 2 0 "FALSE" 1 "TRUE" /end COMPU_VTAB
/begin COMPU_METHOD MonBrk_stPrkBrk_VERB "" TAB_VERB "%6.3" "" COMPU_TAB_REF MonBrk_stPrkBrk_VERB /end COMPU_METHOD
/begin COMPU_VTAB MonBrk_stPrkBrk_VERB "" TAB_VERB 4 0 "PRKBRK_UNDEF" 1 "PRKBRK_NOT_APPLD" 2 "PRKBRK_APPLD" 255 "PRKBRK_ERR" /end COMPU_VTAB
/begin COMPU_METHOD MonEgyChrgn_stDcCntct_VERB "" TAB_VERB "%6.3" "" COMPU_TAB_REF MonEgyChrgn_stDcCntct_VERB /end COMPU_METHOD
/begin COMPU_VTAB MonEgyChrgn_stDcCntct_VERB "" TAB_VERB 3 0 "DCCNTCT_INVLD" 1 "DCCNTCT_OPEN" 2 "DCCNTCT_CLSD" /end COMPU_VTAB
/begin COMPU_METHOD MonEgyChrgn_stExtChrgnDiCmd_VERB "" TAB_VERB "%6.3" "" COMPU_TAB_REF MonEgyChrgn_stExtChrgnDiCmd_VERB /end COMPU_METHOD
/begin COMPU_VTAB MonEgyChrgn_stExtChrgnDiCmd_VERB "" TAB_VERB 2 0 "EXTCHRGNREQ_DINOTACTV" 1 "EXTCHRGNREQ_DIACTV" /end COMPU_VTAB
/begin COMPU_METHOD OneToOne "" RAT_FUNC "%6.2" "-" COEFFS 0 1 0 0 0 1 /end COMPU_METHOD
/begin COMPU_METHOD Prc "" RAT_FUNC "%6.4" "%" COEFFS 0 81.92 0 0 0 1 /end COMPU_METHOD
/begin COMPU_METHOD Prc2EffGrad "" RAT_FUNC "%7.6" "1/(%*s)" COEFFS 0 10000 0 0 0 1 /end COMPU_METHOD
/begin COMPU_METHOD PrcSlp "" RAT_FUNC "%6.4" "%/s" COEFFS 0 819.2 0 0 0 1 /end COMPU_METHOD
/begin COMPU_METHOD Prc_Fact100 "" RAT_FUNC "%6.4" "%" COEFFS 0 100 0 0 0 1 /end COMPU_METHOD
/begin COMPU_METHOD Prc_q0p1_COMPU "" RAT_FUNC "%6.3" "%" COEFFS 0 10 0 0 0 1 /end COMPU_METHOD
/begin COMPU_METHOD PRECOPT_SC_Compu "" TAB_VERB "%6.3" "" COMPU_TAB_REF PRECOPT_SC_Compu /end COMPU_METHOD
/begin COMPU_VTAB PRECOPT_SC_Compu "" TAB_VERB 2 0 "PREC_DCDC" 1 "PREC_TRACBATT" /end COMPU_VTAB
/begin COMPU_METHOD Pres "" RAT_FUNC "%6.3" "kPa" COEFFS 0 10 0 0 0 1 /end COMPU_METHOD
/begin COMPU_METHOD RBPtCel_n_1p0_1 "" RAT_FUNC "%6.2" "rpm" COEFFS 0 1 0 0 0 1 /end COMPU_METHOD
/begin COMPU_METHOD RBPtCel_tq_0p1_1 "" RAT_FUNC "%6.3" "Nm" COEFFS 0 10 0 0 0 1 /end COMPU_METHOD
/begin COMPU_METHOD RBPtCel_u_0p1_1 "" RAT_FUNC "%6.3" "V" COEFFS 0 10 0 0 0 1 /end COMPU_METHOD
/begin COMPU_METHOD RBPtCel_u_1p0_1 "" RAT_FUNC "%6.2" "V" COEFFS 0 1 0 0 0 1 /end COMPU_METHOD
/begin COMPU_METHOD RBPtCel_v_0p01_1 "" RAT_FUNC "%6.4" "km/h" COEFFS 0 100 0 0 0 1 /end COMPU_METHOD
/begin COMPU_METHOD spg_q0p0625_V "" RAT_FUNC "%6.4" "V" COEFFS 0 16 0 0 0 1 /end COMPU_METHOD
/begin COMPU_METHOD TransR "" RAT_FUNC "%6.4" "-" COEFFS 0 100 0 0 0 1 /end COMPU_METHOD
/begin COMPU_METHOD Trq "" RAT_FUNC "%6.3" "Nm" COEFFS 0 10 0 0 0 1 /end COMPU_METHOD
/begin COMPU_METHOD TrqPrpHigh "" RAT_FUNC "%6.3" "Nm" COEFFS 0 10 0 0 0 1 /end COMPU_METHOD
/begin RECORD_LAYOUT Val_Ws16 FNC_VALUES 1 SWORD COLUMN_DIR DIRECT /end RECORD_LAYOUT
/begin RECORD_LAYOUT Val_Ws32 FNC_VALUES 1 SLONG COLUMN_DIR DIRECT /end RECORD_LAYOUT
/begin RECORD_LAYOUT Val_Wu16 FNC_VALUES 1 UWORD COLUMN_DIR DIRECT /end RECORD_LAYOUT
/begin RECORD_LAYOUT Val_Wu32 FNC_VALUES 1 ULONG COLUMN_DIR DIRECT /end RECORD_LAYOUT
/begin RECORD_LAYOUT Val_Wu8 FNC_VALUES 1 UBYTE COLUMN_DIR DIRECT /end RECORD_LAYOUT
/end MODULE
/end PROJECT

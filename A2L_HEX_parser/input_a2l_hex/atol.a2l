ASAP2_VERSION 1 70
/begin PROJECT MDG1C "VC1CP091_STLA_N_D061I3"
/begin HEADER "" VERSION "VC1CP091_STLA_N_D061I3" PROJECT_NO MDG1C /end HEADER
/begin MODULE DIM ""
/begin MOD_COMMON "" BYTE_ORDER MSB_LAST ALIGNMENT_BYTE 1 ALIGNMENT_WORD 2 ALIGNMENT_LONG 4 ALIGNMENT_INT64 4 ALIGNMENT_FLOAT32_IEEE 4 ALIGNMENT_FLOAT64_IEEE 4 DATA_SIZE 32 /end MOD_COMMON
/begin CHARACTERISTIC AcChrgrIntkT_ATS_ATS.LimitTypeMsk_C "" VALUE 0x80252E74 Val_Wu8 255.0 OneToOne 0.00 255.0 FORMAT "%5.1" /end CHARACTERISTIC
/begin CHARACTERISTIC AcChrgrIntkT_ATS_ATS.CnvNorm_C "" VALUE 0x80252E75 Val_Wu8 255.0 OneToOne 0.00 255.0 FORMAT "%5.1" /end CHARACTERISTIC
/begin CHARACTERISTIC AcChrgrIntkT_ATS_ATS.LowLim_C "" VALUE 0x80252E76 Val_Ws16 65535.00 RBPtCel_t_1p0_3 -32768.00 32767.00 FORMAT "%8.2" /end CHARACTERISTIC
/begin CHARACTERISTIC AcChrgrIntkT_ATS_ATS.UpLim_C "" VALUE 0x80252E78 Val_Ws16 65535.00 RBPtCel_t_1p0_3 -32768.00 32767.00 FORMAT "%8.2" /end CHARACTERISTIC
/begin CHARACTERISTIC AcChrgrIntkT_ATS_ATS.CnvFac_C "" VALUE 0x80252E7C Val_Ws32 4294967295.00 OneToOne -2147483648.00 2147483647.00 FORMAT "%13.2" /end CHARACTERISTIC
/begin CHARACTERISTIC AcChrgrIntkT_ATS_ATS.CnvOfs_C "" VALUE 0x80252E80 Val_Ws16 65535.00 OneToOne -32768.00 32767.00 FORMAT "%8.2" /end CHARACTERISTIC
/begin CHARACTERISTIC AcChrgrIntkT_ATS_ATS.DfltVal_C "" VALUE 0x80252E82 Val_Ws16 65535.00 OneToOne -32768.00 32767.00 FORMAT "%8.2" /end CHARACTERISTIC
/begin CHARACTERISTIC ATS_Standby_Disabled_C "" VALUE 0x80252E94 Val_Wu8 255.0 OneToOne 0.00 255.0 FORMAT "%5.1" /end CHARACTERISTIC
/begin CHARACTERISTIC ATS_tiTstDemHeal_C "" VALUE 0x80252E96 Val_Wu16 655.3500 Time_s 0.00 655.3500 FORMAT "%8.4" /end CHARACTERISTIC
/begin CHARACTERISTIC ATS_tiTstDemMax_C "" VALUE 0x80252E98 Val_Wu16 655.3500 Time_s 0.00 655.3500 FORMAT "%8.4" /end CHARACTERISTIC
/begin CHARACTERISTIC ATS_TmrBehaviour_C "" VALUE 0x80252E9A Val_Wu8 255.0 OneToOne 0.00 255.0 FORMAT "%5.1" /end CHARACTERISTIC
/begin CHARACTERISTIC ATS_TstDemMaxEngN_C "" VALUE 0x80252E9B Val_Wu8 10200. EngN_LRes 0.00 10200. FORMAT "%5.0" /end CHARACTERISTIC
/begin CHARACTERISTIC ATS_TstDemMaxVSSCDV_C "" VALUE 0x80252E9C Val_Ws16 655.3500 Vel -327.6800 327.6700 FORMAT "%8.4" /end CHARACTERISTIC
/begin CHARACTERISTIC BattU_cfgUBChkRelsCdn_C "configuration of enable conditions for operating range check" VALUE 0x8024F636 RB_Val_Wu8 255.0 OneToOne 0.00 255.0 FORMAT "%5.1" /end CHARACTERISTIC
/begin CHARACTERISTIC BattU_ctPwrFailDebErr_C "Debounce count for Battery power failures" VALUE 0x8024F632 RB_Val_Wu8 255.0 OneToOne 0.00 255.0 FORMAT "%5.1" /end CHARACTERISTIC
/begin CHARACTERISTIC BattU_iMinThdDcdc "current threshold under which the dcdc is considered to be currentless" VALUE 0x8024F638 RB_Val_Ws16 2047.969 Curr_A_q0p03125_COMPU -1024.000 1023.969 FORMAT "%8.3" /end CHARACTERISTIC
/begin CHARACTERISTIC BattU_maskVehVVldSq_C "Masking calibration for Vehicle speed signal qualifier VehV_v_Sq corresponding to validity of vehicle speed signal" VALUE 0x8024F63A RB_Val_Wu16 65535.00 OneToOne 0.00 65535.00 FORMAT "%8.2" /end CHARACTERISTIC
/begin CHARACTERISTIC BattU_swtCorFacActv_C "Switch for enabling battery factor correction calculation" VALUE 0x8024F63C RB_Val_Wu8 1.00000000000 B_TRUE 0.00 1.00000000000 FORMAT "%13.11" /end CHARACTERISTIC
/begin CHARACTERISTIC BattU_swtLvDcdcSplyPosSignI_C "switch to change between positive and negative sign for DCDC current" VALUE 0x8024F63D RB_Val_Wu8 1.00000000000 B_TRUE 0.00 1.00000000000 FORMAT "%13.11" /end CHARACTERISTIC
/begin CHARACTERISTIC BattU_swtRated_C "Switch for rated voltage selection" VALUE 0x8024F63E RB_Val_Wu8 1.00000000000 B_TRUE 0.00 1.00000000000 FORMAT "%13.11" /end CHARACTERISTIC
/begin CHARACTERISTIC BattU_swtReplcmtVal_C "switch to allow replacement values for battery voltage" VALUE 0x8024F63F RB_Val_Wu8 1.00000000000 B_TRUE 0.00 1.00000000000 FORMAT "%13.11" /end CHARACTERISTIC
/begin CHARACTERISTIC BattU_tiDebDcdcSply_C "debounce time for detection of DCDC supply" VALUE 0x8024F640 RB_Val_Ws16 655.3500 Time_s -327.6800 327.6700 FORMAT "%8.4" /end CHARACTERISTIC
/begin CHARACTERISTIC BattU_tiEcuOn_C "Calibration time for BattU diagnosis" VALUE 0x8024F634 RB_Val_Ws16 655.3500 Time_s -327.6800 327.6700 FORMAT "%8.4" /end CHARACTERISTIC
/begin CHARACTERISTIC BattU_uDfl_C "Default value for battery voltage" VALUE 0x8024F642 RB_Val_Ws16 1310700. Volt_Batt -655360.0 655340.0 FORMAT "%8.1" /end CHARACTERISTIC
/begin CHARACTERISTIC BattU_uMaxThdBatt_C "threshold for overvoltage check when supplied by battery" VALUE 0x8024F644 RB_Val_Ws16 1310700. Volt_Batt -655360.0 655340.0 FORMAT "%8.1" /end CHARACTERISTIC
/begin CHARACTERISTIC BattU_uMaxThdNoBatt_C "threshold for overvoltage check when supplied by alternator or dcdc converter" VALUE 0x8024F646 RB_Val_Ws16 1310700. Volt_Batt -655360.0 655340.0 FORMAT "%8.1" /end CHARACTERISTIC
/begin CHARACTERISTIC BattU_uMinThdBatt_C "threshold for undervoltage check when supplied by battery" VALUE 0x8024F648 RB_Val_Ws16 1310700. Volt_Batt -655360.0 655340.0 FORMAT "%8.1" /end CHARACTERISTIC
/begin CHARACTERISTIC BattU_uMinThdNoBatt_C "threshold for undervoltage check when supplied by alternator or dcdc converter" VALUE 0x8024F64A RB_Val_Ws16 1310700. Volt_Batt -655360.0 655340.0 FORMAT "%8.1" /end CHARACTERISTIC
/begin CHARACTERISTIC BattU_uNrm_C "Normal battery voltage to calculate the correction factor" VALUE 0x8024F64C RB_Val_Ws16 1310700. Volt_Batt -655360.0 655340.0 FORMAT "%8.1" /end CHARACTERISTIC
/begin CHARACTERISTIC BattU_uSrcMaxThd_C "Signal range check maximum threshold" VALUE 0x8024F5EC RB_Val_Ws16 13107.00 Volt -6553.600 6553.400 FORMAT "%8.3" /end CHARACTERISTIC
/begin CHARACTERISTIC BattU_uSrcMinThd_C "Signal range check mimumum threshold" VALUE 0x8024F5EE RB_Val_Ws16 13107.00 Volt -6553.600 6553.400 FORMAT "%8.3" /end CHARACTERISTIC
/begin CHARACTERISTIC BattU_uTransf_CUR "Transformation curve for battery voltage" CURVE 0x8024F5F0 RB_Curve_S16_S16 1310700. Volt_Batt -655360.0 655340.0 FORMAT "%8.1"
 /begin AXIS_DESCR STD_AXIS BattU_uRaw Volt 16 -6553.600 6553.400 FORMAT "%8.3" DEPOSIT ABSOLUTE /end AXIS_DESCR
/end CHARACTERISTIC
/begin CHARACTERISTIC BattU_VD_maskBattU_u_Sq_C "Masking calibration for Battery voltage qualifier" VALUE 0x8024F64E RB_Val_Wu16 65535.00 OneToOne 0.00 65535.00 FORMAT "%8.2" /end CHARACTERISTIC
/begin CHARACTERISTIC BattU_vUBChkLim_C "velocity threshold for diagnosis release" VALUE 0x8024F650 RB_Val_Ws16 655.3500 Vel -327.6800 327.6700 FORMAT "%8.4" /end CHARACTERISTIC
/begin CHARACTERISTIC Blwr_flgComActvRepl_C "Replacement value in case of communication error" VALUE 0x8024E66C Val_Wu8 1.000 OneToOne 0.00 1.000 FORMAT "%5.3" EXTENDED_LIMITS 0.00 255.0 /end CHARACTERISTIC
/begin CHARACTERISTIC Blwr_tiActvDly_C "Blower active signal delayed" VALUE 0x8024E66E Val_Ws16 655.3500 Time_s -327.6800 327.6700 FORMAT "%8.4" /end CHARACTERISTIC
/begin CHARACTERISTIC Blwr_tiOffDly_C "Blower off signal delayed" VALUE 0x8024E670 Val_Ws16 655.3500 Time_s -327.6800 327.6700 FORMAT "%8.4" /end CHARACTERISTIC
/begin CHARACTERISTIC BrkBstPmp_facSlopDec_C "factor to reduce slope of decrement" VALUE 0x8024F774 RB_Val_Wu8 1.000 Fact100 0.00 1.000 FORMAT "%5.3" EXTENDED_LIMITS 0.00 2.550 /end CHARACTERISTIC
/begin CHARACTERISTIC BrkBstPmp_flgEnaEnvPSnsr_C "Calibration to enable the environment pressure sensor in project" VALUE 0x8024F775 RB_Val_Wu8 1.00000000000 B_TRUE 0.00 1.00000000000 FORMAT "%13.11" /end CHARACTERISTIC
/begin CHARACTERISTIC BrkBstPmp_flgLeakDiagWaitForNxtPmpOn_C "Calibration flag to determine the leakage diagnosis behaviour" VALUE 0x8024F776 RB_Val_Wu8 1.00000000000 B_TRUE 0.00 1.00000000000 FORMAT "%13.11" /end CHARACTERISTIC
/begin CHARACTERISTIC BrkBstPmp_maskBrkBoostPSq_C "Calibration mask to detect the brake booster pressure signal quality" VALUE 0x8024F778 RB_Val_Wu16 65535.00 OneToOne 0.00 65535.00 FORMAT "%8.2" /end CHARACTERISTIC
/begin CHARACTERISTIC BrkBstPmp_maskBrkBoostPVldyLeakDiagSq_C "Mask to calculate validity of brake booster pressure" VALUE 0x8024F77A RB_Val_Wu16 65535.00 OneToOne 0.00 65535.00 FORMAT "%8.2" /end CHARACTERISTIC
/begin CHARACTERISTIC BrkBstPmp_maskBrkStSq_C "Calibration mask to detect the signal quality of brake" VALUE 0x8024F77C RB_Val_Wu16 65535.00 OneToOne 0.00 65535.00 FORMAT "%8.2" /end CHARACTERISTIC
/begin CHARACTERISTIC BrkBstPmp_maskBrkStVldyLeakDiagSq_C "Mask to calculate the validity of brake status" VALUE 0x8024F77E RB_Val_Wu16 65535.00 OneToOne 0.00 65535.00 FORMAT "%8.2" /end CHARACTERISTIC
/begin CHARACTERISTIC BrkBstPmp_maskEnvPVldySq_C "Calibration to detemine the validity of environment pressure" VALUE 0x8024F780 RB_Val_Wu16 65535.00 OneToOne 0.00 65535.00 FORMAT "%8.2" /end CHARACTERISTIC
/begin CHARACTERISTIC BrkBstPmp_maskOvldBrkBoostPSq_C "Mask to calculate validity of brake booster pressure" VALUE 0x8024F782 RB_Val_Wu16 65535.00 OneToOne 0.00 65535.00 FORMAT "%8.2" /end CHARACTERISTIC
/begin CHARACTERISTIC BrkBstPmp_nrMaxManTestImp_C "Maximum number of test impulses possible during active diagnosis." VALUE 0x8024F754 RB_Val_Wu8 255.0 OneToOne 0.00 255.0 FORMAT "%5.1" /end CHARACTERISTIC
/begin CHARACTERISTIC BrkBstPmp_nrTestMaxHs_C "Absolute number of test impulses for high side switch within driving cycle. Max value leads to infinite number of test impulses." VALUE 0x8024F756 RB_Val_Wu16 65535.00 OneToOne 0.00 65535.00 FORMAT "%8.2" /end CHARACTERISTIC
/begin CHARACTERISTIC BrkBstPmp_nrTestMaxLs_C "Absolute number of test impulses for low side switch within driving cycle. Max value leads to infinite number of test impulses." VALUE 0x8024F758 RB_Val_Wu16 65535.00 OneToOne 0.00 65535.00 FORMAT "%8.2" /end CHARACTERISTIC
/begin CHARACTERISTIC BrkBstPmp_pEnvPDfl_C "Default environment pressure" VALUE 0x8024F784 RB_Val_Wu16 2559.961 p_q0p039 0.00 2559.961 FORMAT "%8.3" /end CHARACTERISTIC
/begin CHARACTERISTIC BrkBstPmp_pLeakDetnThd_C "The leakage pressure difference threshold" VALUE 0x8024F786 RB_Val_Ws16 65535.00 Pres_hPa -32768.00 32767.00 FORMAT "%8.2" /end CHARACTERISTIC
/begin CHARACTERISTIC BrkBstPmp_pThdVacChkEna_C "pressure threshold to start vacuum check" VALUE 0x8024F788 RB_Val_Ws16 65535.00 Pres_hPa -32768.00 32767.00 FORMAT "%8.2" /end CHARACTERISTIC
/begin CHARACTERISTIC BrkBstPmp_pVacChkMinDif_M "Calibratable map to determine the threshold for vacuum generation plausibility check diagnosis" MAP 0x8024F78A RB_Map_S16U16_S16_sao 65535.00 Pres_hPa -32768.00 32767.00 FORMAT "%8.2"
 /begin AXIS_DESCR STD_AXIS BrkBstPmp_pVacChkStrtd Pres_hPa 6 -32768.00 32767.00 FORMAT "%8.2" DEPOSIT ABSOLUTE /end AXIS_DESCR
 /begin AXIS_DESCR STD_AXIS PEnv_p p_q0p039 6 0.00 2559.961 FORMAT "%8.3" DEPOSIT ABSOLUTE /end AXIS_DESCR
/end CHARACTERISTIC
/begin CHARACTERISTIC BrkBstPmp_stPsDiagDi_C "application to disable the diagnosis of the power stage" VALUE 0x8024F75A RB_Val_Wu16 65535.00 OneToOne 0.00 65535.00 FORMAT "%8.2" /end CHARACTERISTIC
/begin CHARACTERISTIC BrkBstPmp_stPsDi_C "application to disable the power stage" VALUE 0x8024F75C RB_Val_Wu16 65535.00 OneToOne 0.00 65535.00 FORMAT "%8.2" /end CHARACTERISTIC
/begin CHARACTERISTIC BrkBstPmp_swtEnaFct_C "switch to activate whole functionality" VALUE 0x8024F7EE RB_Val_Wu8 1.00000000000 B_TRUE 0.00 1.00000000000 FORMAT "%13.11" /end CHARACTERISTIC
/begin CHARACTERISTIC BrkBstPmp_swtEnaOvldProtn_C "switch to enable overload protection" VALUE 0x8024F7EF RB_Val_Wu8 1.00000000000 B_TRUE 0.00 1.00000000000 FORMAT "%13.11" /end CHARACTERISTIC
/begin CHARACTERISTIC BrkBstPmp_swtVacChkEna_C "switch to enable vacuum generation check" VALUE 0x8024F7F0 RB_Val_Wu8 1.00000000000 B_TRUE 0.00 1.00000000000 FORMAT "%13.11" /end CHARACTERISTIC
/begin CHARACTERISTIC BrkBstPmp_tiBtwTestImp_C "Minimum time between test impulses when high side switch and low side switch are open" VALUE 0x8024F75E RB_Val_Wu8 5.100 RBPtCel_ti_0p02_1 0.00 5.100 FORMAT "%5.3" /end CHARACTERISTIC
/begin CHARACTERISTIC BrkBstPmp_tiBtwTestOtHs_C "Time between test impulses in case of short circuit battery on low side." VALUE 0x8024F760 RB_Val_Ws16 655350.0 Time_ms -327680.0 327670.0 FORMAT "%8.1" /end CHARACTERISTIC
/begin CHARACTERISTIC BrkBstPmp_tiBtwTestOtLs_C "Time between test impulses in case of short circuit battery on low side." VALUE 0x8024F762 RB_Val_Ws16 655350.0 Time_ms -327680.0 327670.0 FORMAT "%8.1" /end CHARACTERISTIC
/begin CHARACTERISTIC BrkBstPmp_tiBtwTestScbHs_C "Time between test impulses in case of short circuit battery on high side." VALUE 0x8024F764 RB_Val_Ws16 655350.0 Time_ms -327680.0 327670.0 FORMAT "%8.1" /end CHARACTERISTIC
/begin CHARACTERISTIC BrkBstPmp_tiBtwTestScbLs_C "Time between test impulses in case of short circuit battery on low side." VALUE 0x8024F766 RB_Val_Ws16 655350.0 Time_ms -327680.0 327670.0 FORMAT "%8.1" /end CHARACTERISTIC
/begin CHARACTERISTIC BrkBstPmp_tiIniDlyAftBoostIdle_C "Time to settle the brake booster after a brake release or pump deactivation." VALUE 0x8024F7F2 RB_Val_Ws16 655.3500 RBPtCel_ti_0p01_1 -327.6800 327.6700 FORMAT "%8.4" /end CHARACTERISTIC
/begin CHARACTERISTIC BrkBstPmp_tiIniDly_C "Delay time shall be calibrated in a way that short circuit battery on high and low side switch and short circuit ground on high side switch can be detected if active." VALUE 0x8024F768 RB_Val_Wu16 655.3500 RBPtCel_ti_0p01_1 0.00 655.3500 FORMAT "%8.4" /end CHARACTERISTIC
/begin CHARACTERISTIC BrkBstPmp_tiLeakDetnDlyThd_C "Time between leakage check" VALUE 0x8024F7F4 RB_Val_Ws16 655.3500 RBPtCel_ti_0p01_1 -327.6800 327.6700 FORMAT "%8.4" /end CHARACTERISTIC
/begin CHARACTERISTIC BrkBstPmp_tiOff_C "Delay time shall be calibrated in a way, that short circuit ground and open load error on low side switch can be detected within the delay time." VALUE 0x8024F76A RB_Val_Wu16 655.3500 RBPtCel_ti_0p01_1 0.00 655.3500 FORMAT "%8.4" /end CHARACTERISTIC
/begin CHARACTERISTIC BrkBstPmp_tiOn_C "Delay time to delay activation of the low side switch while high side switch is activated in order to heal errors" VALUE 0x8024F76C RB_Val_Wu16 655.3500 RBPtCel_ti_0p01_1 0.00 655.3500 FORMAT "%8.4" /end CHARACTERISTIC
/begin CHARACTERISTIC BrkBstPmp_tiOvldCntrMaxThd_C "Maximum runtime of the overload counter" VALUE 0x8024F7F8 RB_Val_Wu32 429496.729500 t_q0p0001_s 0.00 429496.729500 FORMAT "%13.6" /end CHARACTERISTIC
/begin CHARACTERISTIC BrkBstPmp_tiOvldMaxThd_C "Maximum run time for over load" VALUE 0x8024F7FC RB_Val_Wu32 429496.729500 t_q0p0001_s 0.00 429496.729500 FORMAT "%13.6" /end CHARACTERISTIC
/begin CHARACTERISTIC BrkBstPmp_tiPmpRlyPosnDebHiLo_C "High to low debounce for relay feedback" VALUE 0x8024F76E RB_Val_Ws16 655.3500 q0p01_s -327.6800 327.6700 FORMAT "%8.4" /end CHARACTERISTIC
/begin CHARACTERISTIC BrkBstPmp_tiPmpRlyPosnDebLoHi_C "Low to High debounce for relay feedback." VALUE 0x8024F770 RB_Val_Ws16 655.3500 q0p01_s -327.6800 327.6700 FORMAT "%8.4" /end CHARACTERISTIC
/begin CHARACTERISTIC BrkBstPmp_tiStActv_C "Activation timing" VALUE 0x8024F772 RB_Val_Wu16 655.3500 RBPtCel_ti_0p01_1 0.00 655.3500 FORMAT "%8.4" /end CHARACTERISTIC
/begin CHARACTERISTIC BrkBstPmp_tiVacChkDlyStrt_C "Duration for the vacuum check plausibilisation" VALUE 0x8024F800 RB_Val_Ws16 655.3500 RBPtCel_ti_0p01_1 -327.6800 327.6700 FORMAT "%8.4" /end CHARACTERISTIC
/begin CHARACTERISTIC BrkBstP_flgPhyRngChkEnad_C "Calibration to determine the enabling condition of physical range check calculation" VALUE 0x8024F6A0 RB_Val_Wu8 1.00000000000 B_TRUE 0.00 1.00000000000 FORMAT "%13.11" /end CHARACTERISTIC
/begin CHARACTERISTIC BrkBstP_flgSnsrTypDp_C "Flag which is et if a differential pressure sensor is used in the brake booster" VALUE 0x8024F6A1 RB_Val_Wu8 1.00000000000 B_TRUE 0.00 1.00000000000 FORMAT "%13.11" /end CHARACTERISTIC
/begin CHARACTERISTIC BrkBstP_maskPEnvPVldSq_C "Calibration to detect the signal quality of environment pressure signal" VALUE 0x8024F6A2 RB_Val_Wu16 65535.00 OneToOne 0.00 65535.00 FORMAT "%8.2" /end CHARACTERISTIC
/begin CHARACTERISTIC BrkBstP_maskPSnsrFrznVldySq_C "Calibration mask to detect the frozen validity of pressure" VALUE 0x8024F6A4 RB_Val_Wu16 65535.00 OneToOne 0.00 65535.00 FORMAT "%8.2" /end CHARACTERISTIC
/begin CHARACTERISTIC BrkBstP_maskPSnsrReplcmtVldySq_C "Calibration mask to detect the invalid pressure signal" VALUE 0x8024F6A6 RB_Val_Wu16 65535.00 OneToOne 0.00 65535.00 FORMAT "%8.2" /end CHARACTERISTIC
/begin CHARACTERISTIC BrkBstP_maskRngChkEnvPVldySq_C "Calibration to determine the validity of environment pressure signal quality" VALUE 0x8024F6A8 RB_Val_Wu16 65535.00 OneToOne 0.00 65535.00 FORMAT "%8.2" /end CHARACTERISTIC
/begin CHARACTERISTIC BrkBstP_maskRngChkSnsrPVldySq_C "Calibration to determine the validity of brake boost pressure raw value signal quality" VALUE 0x8024F6AA RB_Val_Wu16 65535.00 OneToOne 0.00 65535.00 FORMAT "%8.2" /end CHARACTERISTIC
/begin CHARACTERISTIC BrkBstP_maskVehVVldySq_C "Calibration mask to detect the validity of vehicle speed" VALUE 0x8024F6AC RB_Val_Wu16 65535.00 OneToOne 0.00 65535.00 FORMAT "%8.2" /end CHARACTERISTIC
/begin CHARACTERISTIC BrkBstP_pAbsltPhyRngChkMaxThd_C "Calibration to determine the threshold for physical range check with maximum error" VALUE 0x8024F6AE RB_Val_Ws16 65535.00 RBPtCel_p_1p0_1 -32768.00 32767.00 FORMAT "%8.2" /end CHARACTERISTIC
/begin CHARACTERISTIC BrkBstP_pAbsltPhyRngChkMinThd_C "Calibration to determine the threshold for physical range check with minimum error" VALUE 0x8024F6B0 RB_Val_Ws16 65535.00 RBPtCel_p_1p0_1 -32768.00 32767.00 FORMAT "%8.2" /end CHARACTERISTIC
/begin CHARACTERISTIC BrkBstP_pDfl_C "Default value for sensed Brake Boost Vacuum Pressure" VALUE 0x8024F6B2 RB_Val_Ws16 65535.00 RBPtCel_p_1p0_1 -32768.00 32767.00 FORMAT "%8.2" /end CHARACTERISTIC
/begin CHARACTERISTIC BrkBstP_pSnsrHiVCautionDfctThd_C "Caution defect pressure threshold at higher vehicle speed. (Absolute pressure)" VALUE 0x8024F6B4 RB_Val_Ws16 65535.00 RBPtCel_p_1p0_1 -32768.00 32767.00 FORMAT "%8.2" /end CHARACTERISTIC
/begin CHARACTERISTIC BrkBstP_pSnsrHiVWarnDfctThd_C "Warning defect pressure threshold at higher vehicle speed. (Absolute pressure)" VALUE 0x8024F6B6 RB_Val_Ws16 65535.00 RBPtCel_p_1p0_1 -32768.00 32767.00 FORMAT "%8.2" /end CHARACTERISTIC
/begin CHARACTERISTIC BrkBstP_pSnsrLoVCautionDfctThd_C "Caution defect pressure threshold at lower vehicle speed. (Absolute pressure)" VALUE 0x8024F6B8 RB_Val_Ws16 65535.00 RBPtCel_p_1p0_1 -32768.00 32767.00 FORMAT "%8.2" /end CHARACTERISTIC
/begin CHARACTERISTIC BrkBstP_pSnsrLoVWarnDfctThd_C "Warning defect pressure threshold at lower vehicle speed. (Absolute pressure)" VALUE 0x8024F6BA RB_Val_Ws16 65535.00 RBPtCel_p_1p0_1 -32768.00 32767.00 FORMAT "%8.2" /end CHARACTERISTIC
/begin CHARACTERISTIC BrkBstP_pSnsrPlaus12Thd_C "Minimum deviation allowed between sensor 1 and sensor 2 pressure." VALUE 0x8024F654 RB_Val_Ws16 65535.00 RBPtCel_p_1p0_1 -32768.00 32767.00 FORMAT "%8.2" /end CHARACTERISTIC
/begin CHARACTERISTIC BrkBstP_pSnsrPmpOffThdForDiag_M "Curve to determine the sensor pump off threshold" MAP 0x8024F6BC RB_Map_U16S16_S16_sao 65535.00 RBPtCel_p_1p0_1 -32768.00 32767.00 FORMAT "%8.2"
 /begin AXIS_DESCR STD_AXIS PEnv_p p_q0p039 5 0.00 2559.961 FORMAT "%8.3" DEPOSIT ABSOLUTE /end AXIS_DESCR
 /begin AXIS_DESCR STD_AXIS VehV_v Vel 8 -327.6800 327.6700 FORMAT "%8.4" DEPOSIT ABSOLUTE /end AXIS_DESCR
/end CHARACTERISTIC
/begin CHARACTERISTIC BrkBstP_pSnsrPmpOffThdForDiag_T "Map to determine the sensor pump off threshold" CURVE 0x8024F72A RB_Curve_U16_S16_sao 65535.00 RBPtCel_p_1p0_1 -32768.00 32767.00 FORMAT "%8.2"
 /begin AXIS_DESCR STD_AXIS PEnv_p p_q0p039 5 0.00 2559.961 FORMAT "%8.3" DEPOSIT ABSOLUTE /end AXIS_DESCR
/end CHARACTERISTIC
/begin CHARACTERISTIC BrkBstP_pSnsrThdPMax_C "Maximum measurable pressure by the Brake Booster sensor" VALUE 0x8024F740 RB_Val_Ws16 65535.00 Pres_hPa -32768.00 32767.00 FORMAT "%8.2" /end CHARACTERISTIC
/begin CHARACTERISTIC BrkBstP_pSnsrThdPMin_C "Minimum measurable pressure by the Brake Booster sensor" VALUE 0x8024F742 RB_Val_Ws16 65535.00 Pres_hPa -32768.00 32767.00 FORMAT "%8.2" /end CHARACTERISTIC
/begin CHARACTERISTIC BrkBstP_Snsr1_I.pVoltConv_T "class of brake booster pressure sensor 1 / Parameter to convert voltage to pressure" CURVE 0x8024F65C RB_Curve_S16_S16 65535.00 RBPtCel_p_1p0_1 -32768.00 32767.00 FORMAT "%8.2"
 /begin AXIS_DESCR STD_AXIS NO_INPUT_QUANTITY RBPtCel_u_0p2_1 6 -6553.600 6553.400 FORMAT "%8.3" DEPOSIT ABSOLUTE /end AXIS_DESCR
/end CHARACTERISTIC
/begin CHARACTERISTIC BrkBstP_Snsr1_I.uScbThd_C "class of brake booster pressure sensor 1 / Short circuit to battery calibratable threshold" VALUE 0x8024F676 RB_Val_Ws16 13107.00 RBPtCel_u_0p2_1 -6553.600 6553.400 FORMAT "%8.3" /end CHARACTERISTIC
/begin CHARACTERISTIC BrkBstP_Snsr1_I.uScgThd_C "class of brake booster pressure sensor 1 / Short circuit to ground calibratable threshold" VALUE 0x8024F678 RB_Val_Ws16 13107.00 RBPtCel_u_0p2_1 -6553.600 6553.400 FORMAT "%8.3" /end CHARACTERISTIC
/begin CHARACTERISTIC BrkBstP_Snsr2_I.pVoltConv_T "class of brake booster pressure sensor 2 / Parameter to convert voltage to pressure" CURVE 0x8024F680 RB_Curve_S16_S16 65535.00 RBPtCel_p_1p0_1 -32768.00 32767.00 FORMAT "%8.2"
 /begin AXIS_DESCR STD_AXIS NO_INPUT_QUANTITY RBPtCel_u_0p2_1 6 -6553.600 6553.400 FORMAT "%8.3" DEPOSIT ABSOLUTE /end AXIS_DESCR
/end CHARACTERISTIC
/begin CHARACTERISTIC BrkBstP_Snsr2_I.uScbThd_C "class of brake booster pressure sensor 2 / Short circuit to battery calibratable threshold" VALUE 0x8024F69A RB_Val_Ws16 13107.00 RBPtCel_u_0p2_1 -6553.600 6553.400 FORMAT "%8.3" /end CHARACTERISTIC
/begin CHARACTERISTIC BrkBstP_Snsr2_I.uScgThd_C "class of brake booster pressure sensor 2 / Short circuit to ground calibratable threshold" VALUE 0x8024F69C RB_Val_Ws16 13107.00 RBPtCel_u_0p2_1 -6553.600 6553.400 FORMAT "%8.3" /end CHARACTERISTIC
/begin CHARACTERISTIC BrkBstP_stActvPt_C "Calibration to determine the status of powertrain" VALUE 0x8024F744 RB_Val_Wu8 15.0000000000 CoPtFH_stPwt_VERB 0.00 15.0000000000 FORMAT "%13.10" /end CHARACTERISTIC
/begin CHARACTERISTIC BrkBstP_swtSnsrSeln_C "When sensor 1 and sensor 2 have same quality this calibration can be used select the final signal" VALUE 0x8024F656 RB_Val_Wu8 255.0 q1 0.00 255.0 FORMAT "%5.1" /end CHARACTERISTIC
/begin CHARACTERISTIC BrkBstP_tiPSnsrPT1_C "Calibration for PT1 filter time constant" VALUE 0x8024F748 RB_Val_Ws32 4294.9672940000000 TimeDelay_s 0.0000020000000 4294.9672959999998 FORMAT "%19.14" EXTENDED_LIMITS 0.000002000000001 4294.9672959999998 /end CHARACTERISTIC
/begin CHARACTERISTIC BrkBstP_tiPtActvDiagEnaDly_C "Delay, which is necessary for the brake booster system to ensure the status of powertrain" VALUE 0x8024F74C RB_Val_Ws16 655.3500 RBPtCel_ti_0p01_1 -327.6800 327.6700 FORMAT "%8.4" /end CHARACTERISTIC
/begin CHARACTERISTIC BrkBstP_vDeltaHiPDiagThd_C "Hysteresis delta vehicle speed to select diagnosis pressure thresholds" VALUE 0x8024F74E RB_Val_Ws16 655.3500 Vel -327.6800 327.6700 FORMAT "%8.4" /end CHARACTERISTIC
/begin CHARACTERISTIC BrkBstP_vHiPDiagThd_C "Vehicle speed threshold to select pressure thresholds for diagnosis" VALUE 0x8024F750 RB_Val_Ws16 655.3500 Vel -327.6800 327.6700 FORMAT "%8.4" /end CHARACTERISTIC
/begin CHARACTERISTIC BrkBst_flgBkupModSeln_C "Calibration to enable back up mode based on Brk_st" VALUE 0x8024F804 RB_Val_Wu8 255.0 OneToOne 0.00 255.0 FORMAT "%5.1" /end CHARACTERISTIC
/begin CHARACTERISTIC BrkBst_flgEnaEnvPSnsr_C "Calibration to enable the environment pressure sensor in project" VALUE 0x8024F805 RB_Val_Wboolean 1.00000000000 B_TRUE 0.00 1.00000000000 FORMAT "%13.11" /end CHARACTERISTIC
/begin CHARACTERISTIC BrkBst_flgIniBasdDcdc_C "flag to activate the Ini pump request activation based on DCDC state" VALUE 0x8024F806 RB_Val_Wboolean 1.00000000000 B_TRUE 0.00 1.00000000000 FORMAT "%13.11" /end CHARACTERISTIC
/begin CHARACTERISTIC BrkBst_flgVBasdPmpCtrl_C "calibratable flag to activate the vehicle speed based pump request control in backup mode" VALUE 0x8024F807 RB_Val_Wboolean 1.00000000000 B_TRUE 0.00 1.00000000000 FORMAT "%13.11" /end CHARACTERISTIC
/begin CHARACTERISTIC BrkBst_maskBrkPVldSq_C "Bitmask to detect valid signal quality at BrkBstP_p_Sq" VALUE 0x8024F808 RB_Val_Wu16 65535.00 OneToOne 0.00 65535.00 FORMAT "%8.2" /end CHARACTERISTIC
/begin CHARACTERISTIC BrkBst_maskBrkStVldSq_C "Bitmask to detect valid signal quality at Brk_st_Sq" VALUE 0x8024F80A RB_Val_Wu16 65535.00 OneToOne 0.00 65535.00 FORMAT "%8.2" /end CHARACTERISTIC
/begin CHARACTERISTIC BrkBst_maskVehVVldSq_C "Bitmask to detect valid signal quality at VehV_v_Sq" VALUE 0x8024F80C RB_Val_Wu16 65535.00 OneToOne 0.00 65535.00 FORMAT "%8.2" /end CHARACTERISTIC
/begin CHARACTERISTIC BrkBst_pEnvPDfl_C "Default pressure in case of errors in environmental pressure sensor" VALUE 0x8024F80E RB_Val_Wu16 2559.961 p_q0p039 0.00 2559.961 FORMAT "%8.3" /end CHARACTERISTIC
/begin CHARACTERISTIC BrkBst_pThdEnvPBasdPmpReqOff_T "Calibratable curve to set the pump off pressure threshold based on the environment pressure sensor values" CURVE 0x8024F810 RB_Curve_S16_S16 65535.00 Pres_hPa -32768.00 32767.00 FORMAT "%8.2"
 /begin AXIS_DESCR STD_AXIS BrkBst_pEnv Pres_hPa 5 -32768.00 32767.00 FORMAT "%8.2" DEPOSIT ABSOLUTE /end AXIS_DESCR
/end CHARACTERISTIC
/begin CHARACTERISTIC BrkBst_pThdEnvPBasdPmpReqOn_T "Calibratable curve to set the pump on pressure threshold based on the environment pressure sensor values" CURVE 0x8024F826 RB_Curve_S16_S16 65535.00 Pres_hPa -32768.00 32767.00 FORMAT "%8.2"
 /begin AXIS_DESCR STD_AXIS BrkBst_pEnv Pres_hPa 5 -32768.00 32767.00 FORMAT "%8.2" DEPOSIT ABSOLUTE /end AXIS_DESCR
/end CHARACTERISTIC
/begin CHARACTERISTIC BrkBst_pThdPmpReqOff_M "Calibratable map to set the pump off pressure threshold based on the environment pressure sensor values and vehicle speed" MAP 0x8024F83C RB_Map_S16S16_S16 65535.00 Pres_hPa -32768.00 32767.00 FORMAT "%8.2"
 /begin AXIS_DESCR STD_AXIS BrkBst_pEnv Pres_hPa 5 -32768.00 32767.00 FORMAT "%8.2" DEPOSIT ABSOLUTE /end AXIS_DESCR
 /begin AXIS_DESCR STD_AXIS VehV_v Vel 8 -327.6800 327.6700 FORMAT "%8.4" DEPOSIT ABSOLUTE /end AXIS_DESCR
/end CHARACTERISTIC
/begin CHARACTERISTIC BrkBst_pThdPmpReqOn_M "Calibratable map to set the pump on pressure threshold based on the environment pressure sensor values and vehicle speed" MAP 0x8024F8AA RB_Map_S16S16_S16 65535.00 Pres_hPa -32768.00 32767.00 FORMAT "%8.2"
 /begin AXIS_DESCR STD_AXIS BrkBst_pEnv Pres_hPa 5 -32768.00 32767.00 FORMAT "%8.2" DEPOSIT ABSOLUTE /end AXIS_DESCR
 /begin AXIS_DESCR STD_AXIS VehV_v Vel 8 -327.6800 327.6700 FORMAT "%8.4" DEPOSIT ABSOLUTE /end AXIS_DESCR
/end CHARACTERISTIC
/begin CHARACTERISTIC BrkBst_pTstStopThd_C "Presure threshold which has to be reached to finishe the test routine successfully" VALUE 0x8024F918 RB_Val_Ws16 65535.00 Pres_hPa -32768.00 32767.00 FORMAT "%8.2" /end CHARACTERISTIC
/begin CHARACTERISTIC BrkBst_pTstStrtMax_C "Maximum pressure to start the test routine" VALUE 0x8024F91A RB_Val_Ws16 65535.00 Pres_hPa -32768.00 32767.00 FORMAT "%8.2" /end CHARACTERISTIC
/begin CHARACTERISTIC BrkBst_pTstStrtMin_C "Minimum pressure to start the test routine" VALUE 0x8024F91C RB_Val_Ws16 65535.00 Pres_hPa -32768.00 32767.00 FORMAT "%8.2" /end CHARACTERISTIC
/begin CHARACTERISTIC BrkBst_stPwtActv_C "Parameter to check the state of the power train status" VALUE 0x8024F91E RB_Val_Wu8 15.0000000000 CoPtFH_stPwt_VERB 0.00 15.0000000000 FORMAT "%13.10" /end CHARACTERISTIC
/begin CHARACTERISTIC BrkBst_tiBkUpModPmpReq_C "Duration to keep EVP activation request ON due to Inactivity of the EVP" VALUE 0x8024F920 RB_Val_Wu16 655.3500 Time_s 0.00 655.3500 FORMAT "%8.4" /end CHARACTERISTIC
/begin CHARACTERISTIC BrkBst_tiBkupPerdPmpOff_C "Duration to keep EVP activation request OFF in periodic mode" VALUE 0x8024F922 RB_Val_Wu16 655.3500 Time_s 0.00 655.3500 FORMAT "%8.4" /end CHARACTERISTIC
/begin CHARACTERISTIC BrkBst_tiBkupPerdPmpOn_C "Duration to keep EVP activation request ON in periodic mode" VALUE 0x8024F924 RB_Val_Wu16 655.3500 Time_s 0.00 655.3500 FORMAT "%8.4" /end CHARACTERISTIC
/begin CHARACTERISTIC BrkBst_tiBkupPmpOff_C "Duration to keep EVP activation request OFF in brake press based backup mode" VALUE 0x8024F926 RB_Val_Ws16 655.3500 Time_s -327.6800 327.6700 FORMAT "%8.4" /end CHARACTERISTIC
/begin CHARACTERISTIC BrkBst_tiBkupPmpOnDurn_C "Duration to check EVP activation request in brake press based backup mode" VALUE 0x8024F928 RB_Val_Wu16 655.3500 Time_s 0.00 655.3500 FORMAT "%8.4" /end CHARACTERISTIC
/begin CHARACTERISTIC BrkBst_tiBkupPmpOn_C "Duration to keep EVP activation request ON in brake press based backup mode" VALUE 0x8024F92A RB_Val_Ws16 655.3500 Time_s -327.6800 327.6700 FORMAT "%8.4" /end CHARACTERISTIC
/begin CHARACTERISTIC BrkBst_tiInActvPmpReq_C "Calibration time for inactive pump request" VALUE 0x8024F92C RB_Val_Wu16 655.3500 Time_s 0.00 655.3500 FORMAT "%8.4" /end CHARACTERISTIC
/begin CHARACTERISTIC BrkBst_tiIniPmpReq_C "EVP runtime on ECU initialization" VALUE 0x8024F92E RB_Val_Wu16 655.3500 Time_s 0.00 655.3500 FORMAT "%8.4" /end CHARACTERISTIC
/begin CHARACTERISTIC BrkBst_tiMaxTstRun_C "Maximum run time of the test routine" VALUE 0x8024F930 RB_Val_Wu16 655.3500 Time_s 0.00 655.3500 FORMAT "%8.4" /end CHARACTERISTIC
/begin CHARACTERISTIC BrkBst_tiOvrnDfcHeal_C "Duration to heal the over run diagnosis" VALUE 0x8024F932 RB_Val_Wu16 655.3500 Time_s 0.00 655.3500 FORMAT "%8.4" /end CHARACTERISTIC
/begin CHARACTERISTIC BrkBst_tiPmpShtOff_C "Time duration by which the deactivation of the EVP is delayed" VALUE 0x8024F934 RB_Val_Wu16 655.3500 Time_s 0.00 655.3500 FORMAT "%8.4" /end CHARACTERISTIC
/begin CHARACTERISTIC BrkBst_vTstStrtMax_C "Maximum vehicle velocity to execute test routine" VALUE 0x8024F936 RB_Val_Ws16 655.3500 Vel -327.6800 327.6700 FORMAT "%8.4" /end CHARACTERISTIC
/begin CHARACTERISTIC BrkBst_vVehMaxThdBkup_C "Vehicle speed maximum threshold to control the pump request in backup mode" VALUE 0x8024F938 RB_Val_Ws16 655.3500 Vel -327.6800 327.6700 FORMAT "%8.4" /end CHARACTERISTIC
/begin CHARACTERISTIC BrkBst_vVehMinThdBkup_C "Vehicle speed minimum threshold to deactive the pump request in backup mode" VALUE 0x8024F93A RB_Val_Ws16 655.3500 Vel -327.6800 327.6700 FORMAT "%8.4" /end CHARACTERISTIC
/begin CHARACTERISTIC Brk_cntrErrThd_C "Number of errors when the diagnosis reports defect" VALUE 0x8024F970 RB_Val_Wu8 255.0 OneToOne 0.00 255.0 FORMAT "%5.1" /end CHARACTERISTIC
/begin CHARACTERISTIC Brk_flgRdntSensPrs_C "Switch redundant brake switch present" VALUE 0x8024F97A RB_Val_Wu8 1.00000000000 B_TRUE 0.00 1.00000000000 FORMAT "%13.11" /end CHARACTERISTIC
/begin CHARACTERISTIC Brk_flgT15DpdtMaiSwt_C "T15 dependent Brake main switch" VALUE 0x8024F93C RB_Val_Wu8 1.00000000000 B_TRUE 0.00 1.00000000000 FORMAT "%13.11" /end CHARACTERISTIC
/begin CHARACTERISTIC Brk_flgT15DpdtRedSwt_C "T15 dependent Brake redundant switch" VALUE 0x8024F93D RB_Val_Wu8 1.00000000000 B_TRUE 0.00 1.00000000000 FORMAT "%13.11" /end CHARACTERISTIC
/begin CHARACTERISTIC Brk_maskPlaus1EnaStMaiVldSq_C "Calibratable mask to check if main brake status is valid and then enable the diagnosis." VALUE 0x8024F972 RB_Val_Wu16 65535.00 OneToOne 0.00 65535.00 FORMAT "%8.2" /end CHARACTERISTIC
/begin CHARACTERISTIC Brk_maskPlaus1EnaStRdntVldSq_C "Calibratable mask to check if Redundant brake status is valid and then enable the diagnosis." VALUE 0x8024F974 RB_Val_Wu16 65535.00 OneToOne 0.00 65535.00 FORMAT "%8.2" /end CHARACTERISTIC
/begin CHARACTERISTIC Brk_maskStMnFinalDfctSq_C "Calibratable mask for detecting final defect of main brake status." VALUE 0x8024F97E RB_Val_Wu16 65535.00 OneToOne 0.00 65535.00 FORMAT "%8.2" /end CHARACTERISTIC
/begin CHARACTERISTIC Brk_maskStMnPrelDfctSq_C "Calibratable mask for detecting preliminary defect of main brake status." VALUE 0x8024F980 RB_Val_Wu16 65535.00 OneToOne 0.00 65535.00 FORMAT "%8.2" /end CHARACTERISTIC
/begin CHARACTERISTIC Brk_maskStRedFinalDfctSq_C "Calibratable mask for detecting final defect of redundant brake status." VALUE 0x8024F982 RB_Val_Wu16 65535.00 OneToOne 0.00 65535.00 FORMAT "%8.2" /end CHARACTERISTIC
/begin CHARACTERISTIC Brk_maskStRedPrelDfctSq_C "Calibratable mask for detecting preliminary defect of redundant brake status." VALUE 0x8024F984 RB_Val_Wu16 65535.00 OneToOne 0.00 65535.00 FORMAT "%8.2" /end CHARACTERISTIC
/begin CHARACTERISTIC Brk_Mn_GDD_I.flgIvt_C "Class for DIO evaluation of Main Brake Status / flag for inverting the status" VALUE 0x8024F944 RB_Val_Wu8 255.0 boolean 0.00 255.0 FORMAT "%5.1" /end CHARACTERISTIC
/begin CHARACTERISTIC Brk_Mn_GDD_I.tiDebHiLo_C "Class for DIO evaluation of Main Brake Status / debounce time for high to low transitions" VALUE 0x8024F946 RB_Val_Ws16 655350.0 RBPtCel_ti_10p0_1 -327680.0 327670.0 FORMAT "%8.1" /end CHARACTERISTIC
/begin CHARACTERISTIC Brk_Mn_GDD_I.tiDebLoHi_C "Class for DIO evaluation of Main Brake Status / debounce time for low to high transitions" VALUE 0x8024F948 RB_Val_Ws16 655350.0 RBPtCel_ti_10p0_1 -327680.0 327670.0 FORMAT "%8.1" /end CHARACTERISTIC
/begin CHARACTERISTIC Brk_Red_GDD_I.flgIvt_C "Class for DIO evaluation of Redundant Brake Status / flag for inverting the status" VALUE 0x8024F950 RB_Val_Wu8 255.0 boolean 0.00 255.0 FORMAT "%5.1" /end CHARACTERISTIC
/begin CHARACTERISTIC Brk_Red_GDD_I.tiDebHiLo_C "Class for DIO evaluation of Redundant Brake Status / debounce time for high to low transitions" VALUE 0x8024F952 RB_Val_Ws16 655350.0 RBPtCel_ti_10p0_1 -327680.0 327670.0 FORMAT "%8.1" /end CHARACTERISTIC
/begin CHARACTERISTIC Brk_Red_GDD_I.tiDebLoHi_C "Class for DIO evaluation of Redundant Brake Status / debounce time for low to high transitions" VALUE 0x8024F954 RB_Val_Ws16 655350.0 RBPtCel_ti_10p0_1 -327680.0 327670.0 FORMAT "%8.1" /end CHARACTERISTIC
/begin CHARACTERISTIC Brk_r_GASWT_I.flgIvt_C "Class for the calculation of the brake pedal position and the brake pedal status via ADC / flag for inverting DIO Status" VALUE 0x8024F95C RB_Val_Wu8 255.0 boolean 0.00 255.0 FORMAT "%5.1" /end CHARACTERISTIC
/begin CHARACTERISTIC Brk_r_GASWT_I.tiDebHiLo_C "Class for the calculation of the brake pedal position and the brake pedal status via ADC / debounce time for high to low transitions" VALUE 0x8024F95E RB_Val_Ws16 655350.0 RBPtCel_ti_10p0_1 -327680.0 327670.0 FORMAT "%8.1" /end CHARACTERISTIC
/begin CHARACTERISTIC Brk_r_GASWT_I.tiDebLoHi_C "Class for the calculation of the brake pedal position and the brake pedal status via ADC / debounce time for low to high transitions" VALUE 0x8024F960 RB_Val_Ws16 655350.0 RBPtCel_ti_10p0_1 -327680.0 327670.0 FORMAT "%8.1" /end CHARACTERISTIC
/begin CHARACTERISTIC Brk_r_GASWT_I.uAdcHysLe_C "Class for the calculation of the brake pedal position and the brake pedal status via ADC / Lower hysteresis threshold for converting Adc to Dio signal" VALUE 0x8024F962 RB_Val_Ws16 13107.00 RBPtCel_u_0p2_1 -6553.600 6553.400 FORMAT "%8.3" /end CHARACTERISTIC
/begin CHARACTERISTIC Brk_r_GASWT_I.uAdcHysRi_C "Class for the calculation of the brake pedal position and the brake pedal status via ADC / Upper hysteresis threshold for converting Adc to Dio signal" VALUE 0x8024F964 RB_Val_Ws16 13107.00 RBPtCel_u_0p2_1 -6553.600 6553.400 FORMAT "%8.3" /end CHARACTERISTIC
/begin CHARACTERISTIC Brk_r_GASWT_I.uSrcMax_C "Class for the calculation of the brake pedal position and the brake pedal status via ADC / voltage threshold for SRC Max error" VALUE 0x8024F966 RB_Val_Ws16 13107.00 RBPtCel_u_0p2_1 -6553.600 6553.400 FORMAT "%8.3" /end CHARACTERISTIC
/begin CHARACTERISTIC Brk_r_GASWT_I.uSrcMin_C "Class for the calculation of the brake pedal position and the brake pedal status via ADC / voltage threshold for SRC min error" VALUE 0x8024F968 RB_Val_Ws16 13107.00 RBPtCel_u_0p2_1 -6553.600 6553.400 FORMAT "%8.3" /end CHARACTERISTIC
/begin CHARACTERISTIC Brk_r_GAS_I.uSrcMax_C "Class for the calculation of the brake pedal position via ADC / voltage threshold for SRC max error" VALUE 0x8024F96C RB_Val_Ws16 13107.00 RBPtCel_u_0p2_1 -6553.600 6553.400 FORMAT "%8.3" /end CHARACTERISTIC
/begin CHARACTERISTIC Brk_r_GAS_I.uSrcMin_C "Class for the calculation of the brake pedal position via ADC / voltage threshold for SRC min error" VALUE 0x8024F96E RB_Val_Ws16 13107.00 RBPtCel_u_0p2_1 -6553.600 6553.400 FORMAT "%8.3" /end CHARACTERISTIC
/begin CHARACTERISTIC Brk_stSwtFltSt_C "Switch which of the unequal states of main and redundant brake signal are evaluated as faulty" VALUE 0x8024F976 RB_Val_Wu8 255.0 OneToOne 0.00 255.0 FORMAT "%5.1" /end CHARACTERISTIC
/begin CHARACTERISTIC Brk_swtMaiSig_C "main brake source signal switch" VALUE 0x8024F97B RB_Val_Wu8 255.0 OneToOne 0.00 255.0 FORMAT "%5.1" /end CHARACTERISTIC
/begin CHARACTERISTIC Brk_swtRdntSig_C "redundant brake source signal switch" VALUE 0x8024F97C RB_Val_Wu8 255.0 OneToOne 0.00 255.0 FORMAT "%5.1" /end CHARACTERISTIC
/begin CHARACTERISTIC Brk_tiDebImpyErr_C "Debouncing time for the detection of implausibility error between main brake and redundant brake signals" VALUE 0x8024F978 RB_Val_Ws16 655.3500 RBPtCel_ti_0p01_1 -327.6800 327.6700 FORMAT "%8.4" /end CHARACTERISTIC
/begin CHARACTERISTIC CanEif_vVeh_C "Calibration value limit for Vehicle speed check for CanEif" VALUE 0x8025499C Val_Ws16 655.3500 Vel -327.6800 327.6700 FORMAT "%8.4" /end CHARACTERISTIC
/begin CHARACTERISTIC CbnHeatgSwt_ATS_ATS.LimitTypeMsk_C "" VALUE 0x80252EB0 Val_Wu8 255.0 OneToOne 0.00 255.0 FORMAT "%5.1" /end CHARACTERISTIC
/begin CHARACTERISTIC CbnHeatgSwt_ATS_ATS.CnvNorm_C "" VALUE 0x80252EB1 Val_Wu8 255.0 OneToOne 0.00 255.0 FORMAT "%5.1" /end CHARACTERISTIC
/begin CHARACTERISTIC CbnHeatgSwt_ATS_ATS.LowLim_C "" VALUE 0x80252EB2 Val_Ws16 65535.00 OneToOne -32768.00 32767.00 FORMAT "%8.2" /end CHARACTERISTIC
/begin CHARACTERISTIC CbnHeatgSwt_ATS_ATS.UpLim_C "" VALUE 0x80252EB4 Val_Ws16 65535.00 OneToOne -32768.00 32767.00 FORMAT "%8.2" /end CHARACTERISTIC
/begin CHARACTERISTIC CbnHeatgSwt_ATS_ATS.CnvFac_C "" VALUE 0x80252EB8 Val_Ws32 4294967295.00 OneToOne -2147483648.00 2147483647.00 FORMAT "%13.2" /end CHARACTERISTIC
/begin CHARACTERISTIC CbnHeatgSwt_ATS_ATS.CnvOfs_C "" VALUE 0x80252EBC Val_Ws16 65535.00 OneToOne -32768.00 32767.00 FORMAT "%8.2" /end CHARACTERISTIC
/begin CHARACTERISTIC CbnHeatgSwt_ATS_ATS.DfltVal_C "" VALUE 0x80252EBE Val_Ws16 65535.00 OneToOne -32768.00 32767.00 FORMAT "%8.2" /end CHARACTERISTIC
/begin CHARACTERISTIC CcsPwrLineChpRst_O_S_ATS_ATS.LimitTypeMsk_C "" VALUE 0x80252EC0 Val_Wu8 255.0 OneToOne 0.00 255.0 FORMAT "%5.1" /end CHARACTERISTIC
/begin CHARACTERISTIC CcsPwrLineChpRst_O_S_ATS_ATS.CnvNorm_C "" VALUE 0x80252EC1 Val_Wu8 255.0 OneToOne 0.00 255.0 FORMAT "%5.1" /end CHARACTERISTIC
/begin CHARACTERISTIC CcsPwrLineChpRst_O_S_ATS_ATS.LowLim_C "" VALUE 0x80252EC2 Val_Ws16 799.9878 Prc -400.0000 399.9878 FORMAT "%8.4" /end CHARACTERISTIC
/begin CHARACTERISTIC CcsPwrLineChpRst_O_S_ATS_ATS.UpLim_C "" VALUE 0x80252EC4 Val_Ws16 799.9878 Prc -400.0000 399.9878 FORMAT "%8.4" /end CHARACTERISTIC
/begin CHARACTERISTIC CcsPwrLineChpRst_O_S_ATS_ATS.CnvFac_C "" VALUE 0x80252EC8 Val_Ws32 4294967295.00 OneToOne -2147483648.00 2147483647.00 FORMAT "%13.2" /end CHARACTERISTIC
/begin CHARACTERISTIC CcsPwrLineChpRst_O_S_ATS_ATS.CnvOfs_C "" VALUE 0x80252ECC Val_Ws16 65535.00 OneToOne -32768.00 32767.00 FORMAT "%8.2" /end CHARACTERISTIC
/begin CHARACTERISTIC CcsPwrLineChpRst_O_S_ATS_ATS.DfltVal_C "" VALUE 0x80252ECE Val_Ws16 65535.00 OneToOne -32768.00 32767.00 FORMAT "%8.2" /end CHARACTERISTIC
/begin CHARACTERISTIC CcsPwrLineChpVccEna_O_S_ATS_ATS.LimitTypeMsk_C "" VALUE 0x80252ED0 Val_Wu8 255.0 OneToOne 0.00 255.0 FORMAT "%5.1" /end CHARACTERISTIC
/begin CHARACTERISTIC CcsPwrLineChpVccEna_O_S_ATS_ATS.CnvNorm_C "" VALUE 0x80252ED1 Val_Wu8 255.0 OneToOne 0.00 255.0 FORMAT "%5.1" /end CHARACTERISTIC
/begin CHARACTERISTIC CcsPwrLineChpVccEna_O_S_ATS_ATS.LowLim_C "" VALUE 0x80252ED2 Val_Ws16 799.9878 Prc -400.0000 399.9878 FORMAT "%8.4" /end CHARACTERISTIC
/begin CHARACTERISTIC CcsPwrLineChpVccEna_O_S_ATS_ATS.UpLim_C "" VALUE 0x80252ED4 Val_Ws16 799.9878 Prc -400.0000 399.9878 FORMAT "%8.4" /end CHARACTERISTIC
/begin CHARACTERISTIC CcsPwrLineChpVccEna_O_S_ATS_ATS.CnvFac_C "" VALUE 0x80252ED8 Val_Ws32 4294967295.00 OneToOne -2147483648.00 2147483647.00 FORMAT "%13.2" /end CHARACTERISTIC
/begin CHARACTERISTIC CcsPwrLineChpVccEna_O_S_ATS_ATS.CnvOfs_C "" VALUE 0x80252EDC Val_Ws16 65535.00 OneToOne -32768.00 32767.00 FORMAT "%8.2" /end CHARACTERISTIC
/begin CHARACTERISTIC CcsPwrLineChpVccEna_O_S_ATS_ATS.DfltVal_C "" VALUE 0x80252EDE Val_Ws16 65535.00 OneToOne -32768.00 32767.00 FORMAT "%8.2" /end CHARACTERISTIC
/begin CHARACTERISTIC CcsPwrLineChpVcc_ATS_ATS.LimitTypeMsk_C "" VALUE 0x80252EE0 Val_Wu8 255.0 OneToOne 0.00 255.0 FORMAT "%5.1" /end CHARACTERISTIC
/begin CHARACTERISTIC CcsPwrLineChpVcc_ATS_ATS.CnvNorm_C "" VALUE 0x80252EE1 Val_Wu8 255.0 OneToOne 0.00 255.0 FORMAT "%5.1" /end CHARACTERISTIC
/begin CHARACTERISTIC CcsPwrLineChpVcc_ATS_ATS.LowLim_C "" VALUE 0x80252EE2 Val_Ws16 65535.00 RBPtCel_u_1p0_1 -32768.00 32767.00 FORMAT "%8.2" /end CHARACTERISTIC
/begin CHARACTERISTIC CcsPwrLineChpVcc_ATS_ATS.UpLim_C "" VALUE 0x80252EE4 Val_Ws16 65535.00 RBPtCel_u_1p0_1 -32768.00 32767.00 FORMAT "%8.2" /end CHARACTERISTIC
/begin CHARACTERISTIC CcsPwrLineChpVcc_ATS_ATS.CnvFac_C "" VALUE 0x80252EE8 Val_Ws32 4294967295.00 OneToOne -2147483648.00 2147483647.00 FORMAT "%13.2" /end CHARACTERISTIC
/begin CHARACTERISTIC CcsPwrLineChpVcc_ATS_ATS.CnvOfs_C "" VALUE 0x80252EEC Val_Ws16 65535.00 OneToOne -32768.00 32767.00 FORMAT "%8.2" /end CHARACTERISTIC
/begin CHARACTERISTIC CcsPwrLineChpVcc_ATS_ATS.DfltVal_C "" VALUE 0x80252EEE Val_Ws16 65535.00 OneToOne -32768.00 32767.00 FORMAT "%8.2" /end CHARACTERISTIC
/begin CHARACTERISTIC CcsPwrLineComChpT_ATS_ATS.LimitTypeMsk_C "" VALUE 0x80252EF0 Val_Wu8 255.0 OneToOne 0.00 255.0 FORMAT "%5.1" /end CHARACTERISTIC
/begin CHARACTERISTIC CcsPwrLineComChpT_ATS_ATS.CnvNorm_C "" VALUE 0x80252EF1 Val_Wu8 255.0 OneToOne 0.00 255.0 FORMAT "%5.1" /end CHARACTERISTIC
/begin CHARACTERISTIC CcsPwrLineComChpT_ATS_ATS.LowLim_C "" VALUE 0x80252EF2 Val_Ws16 65535.00 RBPtCel_t_1p0_3 -32768.00 32767.00 FORMAT "%8.2" /end CHARACTERISTIC
/begin CHARACTERISTIC CcsPwrLineComChpT_ATS_ATS.UpLim_C "" VALUE 0x80252EF4 Val_Ws16 65535.00 RBPtCel_t_1p0_3 -32768.00 32767.00 FORMAT "%8.2" /end CHARACTERISTIC
/begin CHARACTERISTIC CcsPwrLineComChpT_ATS_ATS.CnvFac_C "" VALUE 0x80252EF8 Val_Ws32 4294967295.00 OneToOne -2147483648.00 2147483647.00 FORMAT "%13.2" /end CHARACTERISTIC
/begin CHARACTERISTIC CcsPwrLineComChpT_ATS_ATS.CnvOfs_C "" VALUE 0x80252EFC Val_Ws16 65535.00 OneToOne -32768.00 32767.00 FORMAT "%8.2" /end CHARACTERISTIC
/begin CHARACTERISTIC CcsPwrLineComChpT_ATS_ATS.DfltVal_C "" VALUE 0x80252EFE Val_Ws16 65535.00 OneToOne -32768.00 32767.00 FORMAT "%8.2" /end CHARACTERISTIC
/begin CHARACTERISTIC CtpCarrFrq_ATS_ATS.LimitTypeMsk_C "" VALUE 0x80252F00 Val_Wu8 255.0 OneToOne 0.00 255.0 FORMAT "%5.1" /end CHARACTERISTIC
/begin CHARACTERISTIC CtpCarrFrq_ATS_ATS.CnvNorm_C "" VALUE 0x80252F01 Val_Wu8 255.0 OneToOne 0.00 255.0 FORMAT "%5.1" /end CHARACTERISTIC
/begin CHARACTERISTIC CtpCarrFrq_ATS_ATS.LowLim_C "" VALUE 0x80252F02 Val_Ws16 65535.00 RBPtCel_Perc_1p0_1 -32768.00 32767.00 FORMAT "%8.2" /end CHARACTERISTIC
/begin CHARACTERISTIC CtpCarrFrq_ATS_ATS.UpLim_C "" VALUE 0x80252F04 Val_Ws16 65535.00 RBPtCel_Perc_1p0_1 -32768.00 32767.00 FORMAT "%8.2" /end CHARACTERISTIC
/begin CHARACTERISTIC CtpCarrFrq_ATS_ATS.CnvFac_C "" VALUE 0x80252F08 Val_Ws32 4294967295.00 OneToOne -2147483648.00 2147483647.00 FORMAT "%13.2" /end CHARACTERISTIC
/begin CHARACTERISTIC CtpCarrFrq_ATS_ATS.CnvOfs_C "" VALUE 0x80252F0C Val_Ws16 65535.00 OneToOne -32768.00 32767.00 FORMAT "%8.2" /end CHARACTERISTIC
/begin CHARACTERISTIC CtpCarrFrq_ATS_ATS.DfltVal_C "" VALUE 0x80252F0E Val_Ws16 65535.00 OneToOne -32768.00 32767.00 FORMAT "%8.2" /end CHARACTERISTIC
/begin CHARACTERISTIC CtPSwtActr_O_S_ATS_ATS.LimitTypeMsk_C "" VALUE 0x80252F10 Val_Wu8 255.0 OneToOne 0.00 255.0 FORMAT "%5.1" /end CHARACTERISTIC
/begin CHARACTERISTIC CtPSwtActr_O_S_ATS_ATS.CnvNorm_C "" VALUE 0x80252F11 Val_Wu8 255.0 OneToOne 0.00 255.0 FORMAT "%5.1" /end CHARACTERISTIC
/begin CHARACTERISTIC CtPSwtActr_O_S_ATS_ATS.LowLim_C "" VALUE 0x80252F12 Val_Ws16 799.9878 Prc -400.0000 399.9878 FORMAT "%8.4" /end CHARACTERISTIC
/begin CHARACTERISTIC CtPSwtActr_O_S_ATS_ATS.UpLim_C "" VALUE 0x80252F14 Val_Ws16 799.9878 Prc -400.0000 399.9878 FORMAT "%8.4" /end CHARACTERISTIC
/begin CHARACTERISTIC CtPSwtActr_O_S_ATS_ATS.CnvFac_C "" VALUE 0x80252F18 Val_Ws32 4294967295.00 OneToOne -2147483648.00 2147483647.00 FORMAT "%13.2" /end CHARACTERISTIC
/begin CHARACTERISTIC CtPSwtActr_O_S_ATS_ATS.CnvOfs_C "" VALUE 0x80252F1C Val_Ws16 65535.00 OneToOne -32768.00 32767.00 FORMAT "%8.2" /end CHARACTERISTIC
/begin CHARACTERISTIC CtPSwtActr_O_S_ATS_ATS.DfltVal_C "" VALUE 0x80252F1E Val_Ws16 65535.00 OneToOne -32768.00 32767.00 FORMAT "%8.2" /end CHARACTERISTIC
/begin CHARACTERISTIC CtPSwtDiag_ATS_ATS.LimitTypeMsk_C "" VALUE 0x80252F20 Val_Wu8 255.0 OneToOne 0.00 255.0 FORMAT "%5.1" /end CHARACTERISTIC
/begin CHARACTERISTIC CtPSwtDiag_ATS_ATS.CnvNorm_C "" VALUE 0x80252F21 Val_Wu8 255.0 OneToOne 0.00 255.0 FORMAT "%5.1" /end CHARACTERISTIC
/begin CHARACTERISTIC CtPSwtDiag_ATS_ATS.LowLim_C "" VALUE 0x80252F22 Val_Ws16 65535.00 RBPtCel_u_1p0_1 -32768.00 32767.00 FORMAT "%8.2" /end CHARACTERISTIC
/begin CHARACTERISTIC CtPSwtDiag_ATS_ATS.UpLim_C "" VALUE 0x80252F24 Val_Ws16 65535.00 RBPtCel_u_1p0_1 -32768.00 32767.00 FORMAT "%8.2" /end CHARACTERISTIC
/begin CHARACTERISTIC CtPSwtDiag_ATS_ATS.CnvFac_C "" VALUE 0x80252F28 Val_Ws32 4294967295.00 OneToOne -2147483648.00 2147483647.00 FORMAT "%13.2" /end CHARACTERISTIC
/begin CHARACTERISTIC CtPSwtDiag_ATS_ATS.CnvOfs_C "" VALUE 0x80252F2C Val_Ws16 65535.00 OneToOne -32768.00 32767.00 FORMAT "%8.2" /end CHARACTERISTIC
/begin CHARACTERISTIC CtPSwtDiag_ATS_ATS.DfltVal_C "" VALUE 0x80252F2E Val_Ws16 65535.00 OneToOne -32768.00 32767.00 FORMAT "%8.2" /end CHARACTERISTIC
/begin CHARACTERISTIC DcChrgrIntkT2_ATS_ATS.LimitTypeMsk_C "" VALUE 0x80252F50 Val_Wu8 255.0 OneToOne 0.00 255.0 FORMAT "%5.1" /end CHARACTERISTIC
/begin CHARACTERISTIC DcChrgrIntkT2_ATS_ATS.CnvNorm_C "" VALUE 0x80252F51 Val_Wu8 255.0 OneToOne 0.00 255.0 FORMAT "%5.1" /end CHARACTERISTIC
/begin CHARACTERISTIC DcChrgrIntkT2_ATS_ATS.LowLim_C "" VALUE 0x80252F52 Val_Ws16 65535.00 RBPtCel_t_1p0_3 -32768.00 32767.00 FORMAT "%8.2" /end CHARACTERISTIC
/begin CHARACTERISTIC DcChrgrIntkT2_ATS_ATS.UpLim_C "" VALUE 0x80252F54 Val_Ws16 65535.00 RBPtCel_t_1p0_3 -32768.00 32767.00 FORMAT "%8.2" /end CHARACTERISTIC
/begin CHARACTERISTIC DcChrgrIntkT2_ATS_ATS.CnvFac_C "" VALUE 0x80252F58 Val_Ws32 4294967295.00 OneToOne -2147483648.00 2147483647.00 FORMAT "%13.2" /end CHARACTERISTIC
/begin CHARACTERISTIC DcChrgrIntkT2_ATS_ATS.CnvOfs_C "" VALUE 0x80252F5C Val_Ws16 65535.00 OneToOne -32768.00 32767.00 FORMAT "%8.2" /end CHARACTERISTIC
/begin CHARACTERISTIC DcChrgrIntkT2_ATS_ATS.DfltVal_C "" VALUE 0x80252F5E Val_Ws16 65535.00 OneToOne -32768.00 32767.00 FORMAT "%8.2" /end CHARACTERISTIC
/begin CHARACTERISTIC DcChrgrIntkT_ATS_ATS.LimitTypeMsk_C "" VALUE 0x80252F60 Val_Wu8 255.0 OneToOne 0.00 255.0 FORMAT "%5.1" /end CHARACTERISTIC
/begin CHARACTERISTIC DcChrgrIntkT_ATS_ATS.CnvNorm_C "" VALUE 0x80252F61 Val_Wu8 255.0 OneToOne 0.00 255.0 FORMAT "%5.1" /end CHARACTERISTIC
/begin CHARACTERISTIC DcChrgrIntkT_ATS_ATS.LowLim_C "" VALUE 0x80252F62 Val_Ws16 65535.00 RBPtCel_t_1p0_3 -32768.00 32767.00 FORMAT "%8.2" /end CHARACTERISTIC
/begin CHARACTERISTIC DcChrgrIntkT_ATS_ATS.UpLim_C "" VALUE 0x80252F64 Val_Ws16 65535.00 RBPtCel_t_1p0_3 -32768.00 32767.00 FORMAT "%8.2" /end CHARACTERISTIC
/begin CHARACTERISTIC DcChrgrIntkT_ATS_ATS.CnvFac_C "" VALUE 0x80252F68 Val_Ws32 4294967295.00 OneToOne -2147483648.00 2147483647.00 FORMAT "%13.2" /end CHARACTERISTIC
/begin CHARACTERISTIC DcChrgrIntkT_ATS_ATS.CnvOfs_C "" VALUE 0x80252F6C Val_Ws16 65535.00 OneToOne -32768.00 32767.00 FORMAT "%8.2" /end CHARACTERISTIC
/begin CHARACTERISTIC DcChrgrIntkT_ATS_ATS.DfltVal_C "" VALUE 0x80252F6E Val_Ws16 65535.00 OneToOne -32768.00 32767.00 FORMAT "%8.2" /end CHARACTERISTIC
/begin CHARACTERISTIC DDRC_DurDeb.BattU_tiMaxDebOk_C "" VALUE 0x802408C4 Val_Wu16 655350.0 DDRCTime_ms 0.00 655350.0 FORMAT "%8.1" /end CHARACTERISTIC
/begin CHARACTERISTIC DDRC_DurDeb.BattU_tiMaxDebDef_C "" VALUE 0x802408C6 Val_Wu16 655350.0 DDRCTime_ms 0.00 655350.0 FORMAT "%8.1" /end CHARACTERISTIC
/begin CHARACTERISTIC DDRC_DurDeb.BattU_tiMaxBattDebOk_C "" VALUE 0x802408C8 Val_Wu16 655350.0 DDRCTime_ms 0.00 655350.0 FORMAT "%8.1" /end CHARACTERISTIC
/begin CHARACTERISTIC DDRC_DurDeb.BattU_tiMaxBattDebDef_C "" VALUE 0x802408CA Val_Wu16 655350.0 DDRCTime_ms 0.00 655350.0 FORMAT "%8.1" /end CHARACTERISTIC
/begin CHARACTERISTIC DDRC_DurDeb.BattU_tiMaxNoBattDebOk_C "" VALUE 0x802408CC Val_Wu16 655350.0 DDRCTime_ms 0.00 655350.0 FORMAT "%8.1" /end CHARACTERISTIC
/begin CHARACTERISTIC DDRC_DurDeb.BattU_tiMaxNoBattDebDef_C "" VALUE 0x802408CE Val_Wu16 655350.0 DDRCTime_ms 0.00 655350.0 FORMAT "%8.1" /end CHARACTERISTIC
/begin CHARACTERISTIC DDRC_DurDeb.BattU_tiMinDebOk_C "" VALUE 0x802408D0 Val_Wu16 655350.0 DDRCTime_ms 0.00 655350.0 FORMAT "%8.1" /end CHARACTERISTIC
/begin CHARACTERISTIC DDRC_DurDeb.BattU_tiMinDebDef_C "" VALUE 0x802408D2 Val_Wu16 655350.0 DDRCTime_ms 0.00 655350.0 FORMAT "%8.1" /end CHARACTERISTIC
/begin CHARACTERISTIC DDRC_DurDeb.BattU_tiMinBattDebOk_C "" VALUE 0x802408D4 Val_Wu16 655350.0 DDRCTime_ms 0.00 655350.0 FORMAT "%8.1" /end CHARACTERISTIC
/begin CHARACTERISTIC DDRC_DurDeb.BattU_tiMinBattDebDef_C "" VALUE 0x802408D6 Val_Wu16 655350.0 DDRCTime_ms 0.00 655350.0 FORMAT "%8.1" /end CHARACTERISTIC
/begin CHARACTERISTIC DDRC_DurDeb.BattU_tiMinNoBattDebOk_C "" VALUE 0x802408D8 Val_Wu16 655350.0 DDRCTime_ms 0.00 655350.0 FORMAT "%8.1" /end CHARACTERISTIC
/begin CHARACTERISTIC DDRC_DurDeb.BattU_tiMinNoBattDebDef_C "" VALUE 0x802408DA Val_Wu16 655350.0 DDRCTime_ms 0.00 655350.0 FORMAT "%8.1" /end CHARACTERISTIC
/begin CHARACTERISTIC DDRC_DurDeb.BrkBstP_tiHiCautionDfctDebOk_C "" VALUE 0x802408DC Val_Wu16 655350.0 DDRCTime_ms 0.00 655350.0 FORMAT "%8.1" /end CHARACTERISTIC
/begin CHARACTERISTIC DDRC_DurDeb.BrkBstP_tiHiCautionDfctDebDef_C "" VALUE 0x802408DE Val_Wu16 655350.0 DDRCTime_ms 0.00 655350.0 FORMAT "%8.1" /end CHARACTERISTIC
/begin CHARACTERISTIC DDRC_DurDeb.BrkBstP_tiHiWarnDfctDebOk_C "" VALUE 0x802408E0 Val_Wu16 655350.0 DDRCTime_ms 0.00 655350.0 FORMAT "%8.1" /end CHARACTERISTIC
/begin CHARACTERISTIC DDRC_DurDeb.BrkBstP_tiHiWarnDfctDebDef_C "" VALUE 0x802408E2 Val_Wu16 655350.0 DDRCTime_ms 0.00 655350.0 FORMAT "%8.1" /end CHARACTERISTIC
/begin CHARACTERISTIC DDRC_DurDeb.BrkBstP_tiPhyRngChkMaxDebOk_C "" VALUE 0x802408E4 Val_Wu16 655350.0 DDRCTime_ms 0.00 655350.0 FORMAT "%8.1" /end CHARACTERISTIC
/begin CHARACTERISTIC DDRC_DurDeb.BrkBstP_tiPhyRngChkMaxDebDef_C "" VALUE 0x802408E6 Val_Wu16 655350.0 DDRCTime_ms 0.00 655350.0 FORMAT "%8.1" /end CHARACTERISTIC
/begin CHARACTERISTIC DDRC_DurDeb.BrkBstP_tiPhyRngChkMinDebOk_C "" VALUE 0x802408E8 Val_Wu16 655350.0 DDRCTime_ms 0.00 655350.0 FORMAT "%8.1" /end CHARACTERISTIC
/begin CHARACTERISTIC DDRC_DurDeb.BrkBstP_tiPhyRngChkMinDebDef_C "" VALUE 0x802408EA Val_Wu16 655350.0 DDRCTime_ms 0.00 655350.0 FORMAT "%8.1" /end CHARACTERISTIC
/begin CHARACTERISTIC DDRC_DurDeb.BrkBstP_tiSnsr12PlausDebOk_C "" VALUE 0x802408EC Val_Wu16 655350.0 DDRCTime_ms 0.00 655350.0 FORMAT "%8.1" /end CHARACTERISTIC
/begin CHARACTERISTIC DDRC_DurDeb.BrkBstP_tiSnsr12PlausDebDef_C "" VALUE 0x802408EE Val_Wu16 655350.0 DDRCTime_ms 0.00 655350.0 FORMAT "%8.1" /end CHARACTERISTIC
/begin CHARACTERISTIC DDRC_DurDeb.BrkBstP_tiSnsr1ScbDebOk_C "" VALUE 0x802408F0 Val_Wu16 655350.0 DDRCTime_ms 0.00 655350.0 FORMAT "%8.1" /end CHARACTERISTIC
/begin CHARACTERISTIC DDRC_DurDeb.BrkBstP_tiSnsr1ScbDebDef_C "" VALUE 0x802408F2 Val_Wu16 655350.0 DDRCTime_ms 0.00 655350.0 FORMAT "%8.1" /end CHARACTERISTIC
/begin CHARACTERISTIC DDRC_DurDeb.BrkBstP_tiSnsr1ScgDebOk_C "" VALUE 0x802408F4 Val_Wu16 655350.0 DDRCTime_ms 0.00 655350.0 FORMAT "%8.1" /end CHARACTERISTIC
/begin CHARACTERISTIC DDRC_DurDeb.BrkBstP_tiSnsr1ScgDebDef_C "" VALUE 0x802408F6 Val_Wu16 655350.0 DDRCTime_ms 0.00 655350.0 FORMAT "%8.1" /end CHARACTERISTIC
/begin CHARACTERISTIC DDRC_DurDeb.BrkBstP_tiSnsr2ScbDebOk_C "" VALUE 0x802408F8 Val_Wu16 655350.0 DDRCTime_ms 0.00 655350.0 FORMAT "%8.1" /end CHARACTERISTIC
/begin CHARACTERISTIC DDRC_DurDeb.BrkBstP_tiSnsr2ScbDebDef_C "" VALUE 0x802408FA Val_Wu16 655350.0 DDRCTime_ms 0.00 655350.0 FORMAT "%8.1" /end CHARACTERISTIC
/begin CHARACTERISTIC DDRC_DurDeb.BrkBstP_tiSnsr2ScgDebOk_C "" VALUE 0x802408FC Val_Wu16 655350.0 DDRCTime_ms 0.00 655350.0 FORMAT "%8.1" /end CHARACTERISTIC
/begin CHARACTERISTIC DDRC_DurDeb.BrkBstP_tiSnsr2ScgDebDef_C "" VALUE 0x802408FE Val_Wu16 655350.0 DDRCTime_ms 0.00 655350.0 FORMAT "%8.1" /end CHARACTERISTIC
/begin CHARACTERISTIC DDRC_DurDeb.BrkBstP_tiSnsrPMaxDebOk_C "" VALUE 0x80240900 Val_Wu16 655350.0 DDRCTime_ms 0.00 655350.0 FORMAT "%8.1" /end CHARACTERISTIC
/begin CHARACTERISTIC DDRC_DurDeb.BrkBstP_tiSnsrPMaxDebDef_C "" VALUE 0x80240902 Val_Wu16 655350.0 DDRCTime_ms 0.00 655350.0 FORMAT "%8.1" /end CHARACTERISTIC
/begin CHARACTERISTIC DDRC_DurDeb.BrkBstP_tiSnsrPMinDebOk_C "" VALUE 0x80240904 Val_Wu16 655350.0 DDRCTime_ms 0.00 655350.0 FORMAT "%8.1" /end CHARACTERISTIC
/begin CHARACTERISTIC DDRC_DurDeb.BrkBstP_tiSnsrPMinDebDef_C "" VALUE 0x80240906 Val_Wu16 655350.0 DDRCTime_ms 0.00 655350.0 FORMAT "%8.1" /end CHARACTERISTIC
/begin CHARACTERISTIC DDRC_DurDeb.BrkBstPmp_tiHsScbDebOk_C "" VALUE 0x80240908 Val_Wu16 655350.0 DDRCTime_ms 0.00 655350.0 FORMAT "%8.1" /end CHARACTERISTIC
/begin CHARACTERISTIC DDRC_DurDeb.BrkBstPmp_tiHsScbDebDef_C "" VALUE 0x8024090A Val_Wu16 655350.0 DDRCTime_ms 0.00 655350.0 FORMAT "%8.1" /end CHARACTERISTIC
/begin CHARACTERISTIC DDRC_DurDeb.BrkBstPmp_tiHsScgDebOk_C "" VALUE 0x8024090C Val_Wu16 655350.0 DDRCTime_ms 0.00 655350.0 FORMAT "%8.1" /end CHARACTERISTIC
/begin CHARACTERISTIC DDRC_DurDeb.BrkBstPmp_tiHsScgDebDef_C "" VALUE 0x8024090E Val_Wu16 655350.0 DDRCTime_ms 0.00 655350.0 FORMAT "%8.1" /end CHARACTERISTIC
/begin CHARACTERISTIC DDRC_DurDeb.BrkBstPmp_tiLsOlDebOk_C "" VALUE 0x80240910 Val_Wu16 655350.0 DDRCTime_ms 0.00 655350.0 FORMAT "%8.1" /end CHARACTERISTIC
/begin CHARACTERISTIC DDRC_DurDeb.BrkBstPmp_tiLsOlDebDef_C "" VALUE 0x80240912 Val_Wu16 655350.0 DDRCTime_ms 0.00 655350.0 FORMAT "%8.1" /end CHARACTERISTIC
/begin CHARACTERISTIC DDRC_DurDeb.BrkBstPmp_tiLsScbDebOk_C "" VALUE 0x80240914 Val_Wu16 655350.0 DDRCTime_ms 0.00 655350.0 FORMAT "%8.1" /end CHARACTERISTIC
/begin CHARACTERISTIC DDRC_DurDeb.BrkBstPmp_tiLsScbDebDef_C "" VALUE 0x80240916 Val_Wu16 655350.0 DDRCTime_ms 0.00 655350.0 FORMAT "%8.1" /end CHARACTERISTIC
/begin CHARACTERISTIC DDRC_DurDeb.BrkBstPmp_tiLsScgDebOk_C "" VALUE 0x80240918 Val_Wu16 655350.0 DDRCTime_ms 0.00 655350.0 FORMAT "%8.1" /end CHARACTERISTIC
/begin CHARACTERISTIC DDRC_DurDeb.BrkBstPmp_tiLsScgDebDef_C "" VALUE 0x8024091A Val_Wu16 655350.0 DDRCTime_ms 0.00 655350.0 FORMAT "%8.1" /end CHARACTERISTIC
/begin CHARACTERISTIC DDRC_DurDeb.BrkBstPmp_tiActtnDfctDebOk_C "" VALUE 0x80240B24 Val_Wu16 655350.0 DDRCTime_ms 0.00 655350.0 FORMAT "%8.1" /end CHARACTERISTIC
/begin CHARACTERISTIC DDRC_DurDeb.BrkBstPmp_tiActtnDfctDebDef_C "" VALUE 0x80240B26 Val_Wu16 655350.0 DDRCTime_ms 0.00 655350.0 FORMAT "%8.1" /end CHARACTERISTIC
/begin CHARACTERISTIC DDRC_DurDeb.BrkBstPmp_tiDeactvnDfctDebOk_C "" VALUE 0x80240B28 Val_Wu16 655350.0 DDRCTime_ms 0.00 655350.0 FORMAT "%8.1" /end CHARACTERISTIC
/begin CHARACTERISTIC DDRC_DurDeb.BrkBstPmp_tiDeactvnDfctDebDef_C "" VALUE 0x80240B2A Val_Wu16 655350.0 DDRCTime_ms 0.00 655350.0 FORMAT "%8.1" /end CHARACTERISTIC
/begin CHARACTERISTIC DDRC_DurDeb.BrkBstPmp_numPLeakDfctDebOk_C "" VALUE 0x80240DB0 Val_Wu16 65535.00 OneToOne 0.00 65535.00 FORMAT "%8.2" /end CHARACTERISTIC
/begin CHARACTERISTIC DDRC_DurDeb.BrkBstPmp_numPLeakDfctDebDef_C "" VALUE 0x80240DB2 Val_Wu16 65535.00 OneToOne 0.00 65535.00 FORMAT "%8.2" /end CHARACTERISTIC
/begin CHARACTERISTIC DDRC_DurDeb.BrkBstPmp_numPlausGennDebOk_C "" VALUE 0x802412E8 Val_Wu16 65535.00 OneToOne 0.00 65535.00 FORMAT "%8.2" /end CHARACTERISTIC
/begin CHARACTERISTIC DDRC_DurDeb.BrkBstPmp_numPlausGennDebDef_C "" VALUE 0x802412EA Val_Wu16 65535.00 OneToOne 0.00 65535.00 FORMAT "%8.2" /end CHARACTERISTIC
/begin CHARACTERISTIC DDRC_RatDeb.BattU_tiMaxUDRat_C "" VALUE 0x80248A35 Val_Wu8 3.00000000000 DDRC_Ratio 1.00000000000 4.00000000000 FORMAT "%13.11" /end CHARACTERISTIC
/begin CHARACTERISTIC DDRC_RatDeb.BattU_tiMaxBattUDRat_C "" VALUE 0x80248A36 Val_Wu8 3.00000000000 DDRC_Ratio 1.00000000000 4.00000000000 FORMAT "%13.11" /end CHARACTERISTIC
/begin CHARACTERISTIC DDRC_RatDeb.BattU_tiMaxNoBattUDRat_C "" VALUE 0x80248A37 Val_Wu8 3.00000000000 DDRC_Ratio 1.00000000000 4.00000000000 FORMAT "%13.11" /end CHARACTERISTIC
/begin CHARACTERISTIC DDRC_RatDeb.BattU_tiMinUDRat_C "" VALUE 0x80248A38 Val_Wu8 3.00000000000 DDRC_Ratio 1.00000000000 4.00000000000 FORMAT "%13.11" /end CHARACTERISTIC
/begin CHARACTERISTIC DDRC_RatDeb.BattU_tiMinBattUDRat_C "" VALUE 0x80248A39 Val_Wu8 3.00000000000 DDRC_Ratio 1.00000000000 4.00000000000 FORMAT "%13.11" /end CHARACTERISTIC
/begin CHARACTERISTIC DDRC_RatDeb.BattU_tiMinNoBattUDRat_C "" VALUE 0x80248A3A Val_Wu8 3.00000000000 DDRC_Ratio 1.00000000000 4.00000000000 FORMAT "%13.11" /end CHARACTERISTIC
/begin CHARACTERISTIC DDRC_RatDeb.BrkBstP_tiHiCautionDfctUDRat_C "" VALUE 0x80248A3B Val_Wu8 3.00000000000 DDRC_Ratio 1.00000000000 4.00000000000 FORMAT "%13.11" /end CHARACTERISTIC
/begin CHARACTERISTIC DDRC_RatDeb.BrkBstP_tiHiWarnDfctUDRat_C "" VALUE 0x80248A3C Val_Wu8 3.00000000000 DDRC_Ratio 1.00000000000 4.00000000000 FORMAT "%13.11" /end CHARACTERISTIC
/begin CHARACTERISTIC DDRC_RatDeb.BrkBstP_tiPhyRngChkMaxUDRat_C "" VALUE 0x80248A3D Val_Wu8 3.00000000000 DDRC_Ratio 1.00000000000 4.00000000000 FORMAT "%13.11" /end CHARACTERISTIC
/begin CHARACTERISTIC DDRC_RatDeb.BrkBstP_tiPhyRngChkMinUDRat_C "" VALUE 0x80248A3E Val_Wu8 3.00000000000 DDRC_Ratio 1.00000000000 4.00000000000 FORMAT "%13.11" /end CHARACTERISTIC
/begin CHARACTERISTIC DDRC_RatDeb.BrkBstP_tiSnsr12PlausUDRat_C "" VALUE 0x80248A3F Val_Wu8 3.00000000000 DDRC_Ratio 1.00000000000 4.00000000000 FORMAT "%13.11" /end CHARACTERISTIC
/begin CHARACTERISTIC DDRC_RatDeb.BrkBstP_tiSnsr1ScbUDRat_C "" VALUE 0x80248A40 Val_Wu8 3.00000000000 DDRC_Ratio 1.00000000000 4.00000000000 FORMAT "%13.11" /end CHARACTERISTIC
/begin CHARACTERISTIC DDRC_RatDeb.BrkBstP_tiSnsr1ScgUDRat_C "" VALUE 0x80248A41 Val_Wu8 3.00000000000 DDRC_Ratio 1.00000000000 4.00000000000 FORMAT "%13.11" /end CHARACTERISTIC
/begin CHARACTERISTIC DDRC_RatDeb.BrkBstP_tiSnsr2ScbUDRat_C "" VALUE 0x80248A42 Val_Wu8 3.00000000000 DDRC_Ratio 1.00000000000 4.00000000000 FORMAT "%13.11" /end CHARACTERISTIC
/begin CHARACTERISTIC DDRC_RatDeb.BrkBstP_tiSnsr2ScgUDRat_C "" VALUE 0x80248A43 Val_Wu8 3.00000000000 DDRC_Ratio 1.00000000000 4.00000000000 FORMAT "%13.11" /end CHARACTERISTIC
/begin CHARACTERISTIC DDRC_RatDeb.BrkBstP_tiSnsrPMaxUDRat_C "" VALUE 0x80248A44 Val_Wu8 3.00000000000 DDRC_Ratio 1.00000000000 4.00000000000 FORMAT "%13.11" /end CHARACTERISTIC
/begin CHARACTERISTIC DDRC_RatDeb.BrkBstP_tiSnsrPMinUDRat_C "" VALUE 0x80248A45 Val_Wu8 3.00000000000 DDRC_Ratio 1.00000000000 4.00000000000 FORMAT "%13.11" /end CHARACTERISTIC
/begin CHARACTERISTIC DDRC_RatDeb.BrkBstPmp_tiHsScbUDRat_C "" VALUE 0x80248A46 Val_Wu8 3.00000000000 DDRC_Ratio 1.00000000000 4.00000000000 FORMAT "%13.11" /end CHARACTERISTIC
/begin CHARACTERISTIC DDRC_RatDeb.BrkBstPmp_tiHsScgUDRat_C "" VALUE 0x80248A47 Val_Wu8 3.00000000000 DDRC_Ratio 1.00000000000 4.00000000000 FORMAT "%13.11" /end CHARACTERISTIC
/begin CHARACTERISTIC DDRC_RatDeb.BrkBstPmp_tiLsOlUDRat_C "" VALUE 0x80248A48 Val_Wu8 3.00000000000 DDRC_Ratio 1.00000000000 4.00000000000 FORMAT "%13.11" /end CHARACTERISTIC
/begin CHARACTERISTIC DDRC_RatDeb.BrkBstPmp_tiLsScbUDRat_C "" VALUE 0x80248A49 Val_Wu8 3.00000000000 DDRC_Ratio 1.00000000000 4.00000000000 FORMAT "%13.11" /end CHARACTERISTIC
/begin CHARACTERISTIC DDRC_RatDeb.BrkBstPmp_tiLsScgUDRat_C "" VALUE 0x80248A4A Val_Wu8 3.00000000000 DDRC_Ratio 1.00000000000 4.00000000000 FORMAT "%13.11" /end CHARACTERISTIC
/begin CHARACTERISTIC DFC_CtlMsk2.DFC_BrkBstPmpActtnDfct_C "" VALUE 0x80241301 Val_Wu8 255.0 DFES_OneToOne 0.00 255.0 FORMAT "%5.1" /end CHARACTERISTIC
/begin CHARACTERISTIC DFC_CtlMsk2.DFC_BrkBstPmpDeactvnDfct_C "" VALUE 0x80241302 Val_Wu8 255.0 DFES_OneToOne 0.00 255.0 FORMAT "%5.1" /end CHARACTERISTIC
/begin CHARACTERISTIC DFC_CtlMsk2.DFC_BrkBstPmpPLeakDfct_C "" VALUE 0x802413A1 Val_Wu8 255.0 DFES_OneToOne 0.00 255.0 FORMAT "%5.1" /end CHARACTERISTIC
/begin CHARACTERISTIC DFC_CtlMsk2.DFC_BattUBMaxBatt_C "" VALUE 0x802414E2 Val_Wu8 255.0 DFES_OneToOne 0.00 255.0 FORMAT "%5.1" /end CHARACTERISTIC
/begin CHARACTERISTIC DFC_CtlMsk2.DFC_BattUBMaxNoBatt_C "" VALUE 0x802414E3 Val_Wu8 255.0 DFES_OneToOne 0.00 255.0 FORMAT "%5.1" /end CHARACTERISTIC
/begin CHARACTERISTIC DFC_CtlMsk2.DFC_BattUBMinBatt_C "" VALUE 0x802414E4 Val_Wu8 255.0 DFES_OneToOne 0.00 255.0 FORMAT "%5.1" /end CHARACTERISTIC
/begin CHARACTERISTIC DFC_CtlMsk2.DFC_BattUBMinNoBatt_C "" VALUE 0x802414E5 Val_Wu8 255.0 DFES_OneToOne 0.00 255.0 FORMAT "%5.1" /end CHARACTERISTIC
/begin CHARACTERISTIC DFC_CtlMsk2.DFC_BattUSRCMax_C "" VALUE 0x802414E6 Val_Wu8 255.0 DFES_OneToOne 0.00 255.0 FORMAT "%5.1" /end CHARACTERISTIC
/begin CHARACTERISTIC DFC_CtlMsk2.DFC_BattUSRCMin_C "" VALUE 0x802414E7 Val_Wu8 255.0 DFES_OneToOne 0.00 255.0 FORMAT "%5.1" /end CHARACTERISTIC
/begin CHARACTERISTIC DFC_CtlMsk2.DFC_BrkBstPHiCautionDfct_C "" VALUE 0x802414E8 Val_Wu8 255.0 DFES_OneToOne 0.00 255.0 FORMAT "%5.1" /end CHARACTERISTIC
/begin CHARACTERISTIC DFC_CtlMsk2.DFC_BrkBstPHiWarnDfct_C "" VALUE 0x802414E9 Val_Wu8 255.0 DFES_OneToOne 0.00 255.0 FORMAT "%5.1" /end CHARACTERISTIC
/begin CHARACTERISTIC DFC_CtlMsk2.DFC_BrkBstPSnsr12PlausDfct_C "" VALUE 0x802414EA Val_Wu8 255.0 DFES_OneToOne 0.00 255.0 FORMAT "%5.1" /end CHARACTERISTIC
/begin CHARACTERISTIC DFC_CtlMsk2.DFC_BrkBstPSnsr1Scb_C "" VALUE 0x802414EB Val_Wu8 255.0 DFES_OneToOne 0.00 255.0 FORMAT "%5.1" /end CHARACTERISTIC
/begin CHARACTERISTIC DFC_CtlMsk2.DFC_BrkBstPSnsr1Scg_C "" VALUE 0x802414EC Val_Wu8 255.0 DFES_OneToOne 0.00 255.0 FORMAT "%5.1" /end CHARACTERISTIC
/begin CHARACTERISTIC DFC_CtlMsk2.DFC_BrkBstPSnsr2Scb_C "" VALUE 0x802414ED Val_Wu8 255.0 DFES_OneToOne 0.00 255.0 FORMAT "%5.1" /end CHARACTERISTIC
/begin CHARACTERISTIC DFC_CtlMsk2.DFC_BrkBstPSnsr2Scg_C "" VALUE 0x802414EE Val_Wu8 255.0 DFES_OneToOne 0.00 255.0 FORMAT "%5.1" /end CHARACTERISTIC
/begin CHARACTERISTIC DFC_CtlMsk2.DFC_BrkBstPSnsrMax_C "" VALUE 0x802414EF Val_Wu8 255.0 DFES_OneToOne 0.00 255.0 FORMAT "%5.1" /end CHARACTERISTIC
/begin CHARACTERISTIC DFC_CtlMsk2.DFC_BrkBstPSnsrMin_C "" VALUE 0x802414F0 Val_Wu8 255.0 DFES_OneToOne 0.00 255.0 FORMAT "%5.1" /end CHARACTERISTIC
/begin CHARACTERISTIC DFC_CtlMsk2.DFC_BrkBstPhyRngChkMax_C "" VALUE 0x802414F1 Val_Wu8 255.0 DFES_OneToOne 0.00 255.0 FORMAT "%5.1" /end CHARACTERISTIC
/begin CHARACTERISTIC DFC_CtlMsk2.DFC_BrkBstPhyRngChkMin_C "" VALUE 0x802414F2 Val_Wu8 255.0 DFES_OneToOne 0.00 255.0 FORMAT "%5.1" /end CHARACTERISTIC
/begin CHARACTERISTIC DFC_CtlMsk2.DFC_BrkBstPmpHsScb_C "" VALUE 0x802414F3 Val_Wu8 255.0 DFES_OneToOne 0.00 255.0 FORMAT "%5.1" /end CHARACTERISTIC
/begin CHARACTERISTIC DFC_CtlMsk2.DFC_BrkBstPmpHsScg_C "" VALUE 0x802414F4 Val_Wu8 255.0 DFES_OneToOne 0.00 255.0 FORMAT "%5.1" /end CHARACTERISTIC
/begin CHARACTERISTIC DFC_CtlMsk2.DFC_BrkBstPmpLsOl_C "" VALUE 0x802414F5 Val_Wu8 255.0 DFES_OneToOne 0.00 255.0 FORMAT "%5.1" /end CHARACTERISTIC
/begin CHARACTERISTIC DFC_CtlMsk2.DFC_BrkBstPmpLsScb_C "" VALUE 0x802414F6 Val_Wu8 255.0 DFES_OneToOne 0.00 255.0 FORMAT "%5.1" /end CHARACTERISTIC
/begin CHARACTERISTIC DFC_CtlMsk2.DFC_BrkBstPmpLsScg_C "" VALUE 0x802414F7 Val_Wu8 255.0 DFES_OneToOne 0.00 255.0 FORMAT "%5.1" /end CHARACTERISTIC
/begin CHARACTERISTIC DFC_CtlMsk2.DFC_BrkBstPmpPlausGenn_C "" VALUE 0x80241590 Val_Wu8 255.0 DFES_OneToOne 0.00 255.0 FORMAT "%5.1" /end CHARACTERISTIC
/begin CHARACTERISTIC DFC_CtlMsk2.DFC_CANTRCV_E_NO_TRCV_CONTROL_0_C "" VALUE 0x802415B4 Val_Wu8 255.0 DFES_OneToOne 0.00 255.0 FORMAT "%5.1" /end CHARACTERISTIC
/begin CHARACTERISTIC DFC_CtlMsk2.DFC_CAN_E_TIMEOUT_C "" VALUE 0x802415B5 Val_Wu8 255.0 DFES_OneToOne 0.00 255.0 FORMAT "%5.1" /end CHARACTERISTIC
/begin CHARACTERISTIC DFC_CtlMsk2.DFC_BattUPwrFail_C "" VALUE 0x802415CE Val_Wu8 255.0 DFES_OneToOne 0.00 255.0 FORMAT "%5.1" /end CHARACTERISTIC
/begin CHARACTERISTIC DFC_CtlMsk2.DFC_BrkBstBkupOvrn_C "" VALUE 0x802415CF Val_Wu8 255.0 DFES_OneToOne 0.00 255.0 FORMAT "%5.1" /end CHARACTERISTIC
/begin CHARACTERISTIC DFC_CtlMsk2.DFC_BrkBstPmpOvld_C "" VALUE 0x802415D0 Val_Wu8 255.0 DFES_OneToOne 0.00 255.0 FORMAT "%5.1" /end CHARACTERISTIC
/begin CHARACTERISTIC DFC_CtlMsk2.DFC_BrkPlausChk_C "" VALUE 0x802415D1 Val_Wu8 255.0 DFES_OneToOne 0.00 255.0 FORMAT "%5.1" /end CHARACTERISTIC
/begin CHARACTERISTIC DFC_DisblMsk2.DFC_BrkBstPmpActtnDfct_C "" VALUE 0x80248AE8 Val_Wu16 65535.00 DFES_OneToOne 0.00 65535.00 FORMAT "%8.2" /end CHARACTERISTIC
/begin CHARACTERISTIC DFC_DisblMsk2.DFC_BrkBstPmpDeactvnDfct_C "" VALUE 0x80248AEA Val_Wu16 65535.00 DFES_OneToOne 0.00 65535.00 FORMAT "%8.2" /end CHARACTERISTIC
/begin CHARACTERISTIC DFC_DisblMsk2.DFC_BrkBstPmpPLeakDfct_C "" VALUE 0x80248C28 Val_Wu16 65535.00 DFES_OneToOne 0.00 65535.00 FORMAT "%8.2" /end CHARACTERISTIC
/begin CHARACTERISTIC DFC_DisblMsk2.DFC_BattUBMaxBatt_C "" VALUE 0x80248EAA Val_Wu16 65535.00 DFES_OneToOne 0.00 65535.00 FORMAT "%8.2" /end CHARACTERISTIC
/begin CHARACTERISTIC DFC_DisblMsk2.DFC_BattUBMaxNoBatt_C "" VALUE 0x80248EAC Val_Wu16 65535.00 DFES_OneToOne 0.00 65535.00 FORMAT "%8.2" /end CHARACTERISTIC
/begin CHARACTERISTIC DFC_DisblMsk2.DFC_BattUBMinBatt_C "" VALUE 0x80248EAE Val_Wu16 65535.00 DFES_OneToOne 0.00 65535.00 FORMAT "%8.2" /end CHARACTERISTIC
/begin CHARACTERISTIC DFC_DisblMsk2.DFC_BattUBMinNoBatt_C "" VALUE 0x80248EB0 Val_Wu16 65535.00 DFES_OneToOne 0.00 65535.00 FORMAT "%8.2" /end CHARACTERISTIC
/begin CHARACTERISTIC DFC_DisblMsk2.DFC_BattUSRCMax_C "" VALUE 0x80248EB2 Val_Wu16 65535.00 DFES_OneToOne 0.00 65535.00 FORMAT "%8.2" /end CHARACTERISTIC
/begin CHARACTERISTIC DFC_DisblMsk2.DFC_BattUSRCMin_C "" VALUE 0x80248EB4 Val_Wu16 65535.00 DFES_OneToOne 0.00 65535.00 FORMAT "%8.2" /end CHARACTERISTIC
/begin CHARACTERISTIC DFC_DisblMsk2.DFC_BrkBstPHiCautionDfct_C "" VALUE 0x80248EB6 Val_Wu16 65535.00 DFES_OneToOne 0.00 65535.00 FORMAT "%8.2" /end CHARACTERISTIC
/begin CHARACTERISTIC DFC_DisblMsk2.DFC_BrkBstPHiWarnDfct_C "" VALUE 0x80248EB8 Val_Wu16 65535.00 DFES_OneToOne 0.00 65535.00 FORMAT "%8.2" /end CHARACTERISTIC
/begin CHARACTERISTIC DFC_DisblMsk2.DFC_BrkBstPSnsr12PlausDfct_C "" VALUE 0x80248EBA Val_Wu16 65535.00 DFES_OneToOne 0.00 65535.00 FORMAT "%8.2" /end CHARACTERISTIC
/begin CHARACTERISTIC DFC_DisblMsk2.DFC_BrkBstPSnsr1Scb_C "" VALUE 0x80248EBC Val_Wu16 65535.00 DFES_OneToOne 0.00 65535.00 FORMAT "%8.2" /end CHARACTERISTIC
/begin CHARACTERISTIC DFC_DisblMsk2.DFC_BrkBstPSnsr1Scg_C "" VALUE 0x80248EBE Val_Wu16 65535.00 DFES_OneToOne 0.00 65535.00 FORMAT "%8.2" /end CHARACTERISTIC
/begin CHARACTERISTIC DFC_DisblMsk2.DFC_BrkBstPSnsr2Scb_C "" VALUE 0x80248EC0 Val_Wu16 65535.00 DFES_OneToOne 0.00 65535.00 FORMAT "%8.2" /end CHARACTERISTIC
/begin CHARACTERISTIC DFC_DisblMsk2.DFC_BrkBstPSnsr2Scg_C "" VALUE 0x80248EC2 Val_Wu16 65535.00 DFES_OneToOne 0.00 65535.00 FORMAT "%8.2" /end CHARACTERISTIC
/begin CHARACTERISTIC DFC_DisblMsk2.DFC_BrkBstPSnsrMax_C "" VALUE 0x80248EC4 Val_Wu16 65535.00 DFES_OneToOne 0.00 65535.00 FORMAT "%8.2" /end CHARACTERISTIC
/begin CHARACTERISTIC DFC_DisblMsk2.DFC_BrkBstPSnsrMin_C "" VALUE 0x80248EC6 Val_Wu16 65535.00 DFES_OneToOne 0.00 65535.00 FORMAT "%8.2" /end CHARACTERISTIC
/begin CHARACTERISTIC DFC_DisblMsk2.DFC_BrkBstPhyRngChkMax_C "" VALUE 0x80248EC8 Val_Wu16 65535.00 DFES_OneToOne 0.00 65535.00 FORMAT "%8.2" /end CHARACTERISTIC
/begin CHARACTERISTIC DFC_DisblMsk2.DFC_BrkBstPhyRngChkMin_C "" VALUE 0x80248ECA Val_Wu16 65535.00 DFES_OneToOne 0.00 65535.00 FORMAT "%8.2" /end CHARACTERISTIC
/begin CHARACTERISTIC DFC_DisblMsk2.DFC_BrkBstPmpHsScb_C "" VALUE 0x80248ECC Val_Wu16 65535.00 DFES_OneToOne 0.00 65535.00 FORMAT "%8.2" /end CHARACTERISTIC
/begin CHARACTERISTIC DFC_DisblMsk2.DFC_BrkBstPmpHsScg_C "" VALUE 0x80248ECE Val_Wu16 65535.00 DFES_OneToOne 0.00 65535.00 FORMAT "%8.2" /end CHARACTERISTIC
/begin CHARACTERISTIC DFC_DisblMsk2.DFC_BrkBstPmpLsOl_C "" VALUE 0x80248ED0 Val_Wu16 65535.00 DFES_OneToOne 0.00 65535.00 FORMAT "%8.2" /end CHARACTERISTIC
/begin CHARACTERISTIC DFC_DisblMsk2.DFC_BrkBstPmpLsScb_C "" VALUE 0x80248ED2 Val_Wu16 65535.00 DFES_OneToOne 0.00 65535.00 FORMAT "%8.2" /end CHARACTERISTIC
/begin CHARACTERISTIC DFC_DisblMsk2.DFC_BrkBstPmpLsScg_C "" VALUE 0x80248ED4 Val_Wu16 65535.00 DFES_OneToOne 0.00 65535.00 FORMAT "%8.2" /end CHARACTERISTIC
/begin CHARACTERISTIC DFC_DisblMsk2.DFC_BrkBstPmpPlausGenn_C "" VALUE 0x80249006 Val_Wu16 65535.00 DFES_OneToOne 0.00 65535.00 FORMAT "%8.2" /end CHARACTERISTIC
/begin CHARACTERISTIC DFC_DisblMsk2.DFC_CANTRCV_E_NO_TRCV_CONTROL_0_C "" VALUE 0x8024904E Val_Wu16 65535.00 DFES_OneToOne 0.00 65535.00 FORMAT "%8.2" /end CHARACTERISTIC
/begin CHARACTERISTIC DFC_DisblMsk2.DFC_CAN_E_TIMEOUT_C "" VALUE 0x80249050 Val_Wu16 65535.00 DFES_OneToOne 0.00 65535.00 FORMAT "%8.2" /end CHARACTERISTIC
/begin CHARACTERISTIC DFC_DisblMsk2.DFC_BattUPwrFail_C "" VALUE 0x80249082 Val_Wu16 65535.00 DFES_OneToOne 0.00 65535.00 FORMAT "%8.2" /end CHARACTERISTIC
/begin CHARACTERISTIC DFC_DisblMsk2.DFC_BrkBstBkupOvrn_C "" VALUE 0x80249084 Val_Wu16 65535.00 DFES_OneToOne 0.00 65535.00 FORMAT "%8.2" /end CHARACTERISTIC
/begin CHARACTERISTIC DFC_DisblMsk2.DFC_BrkBstPmpOvld_C "" VALUE 0x80249086 Val_Wu16 65535.00 DFES_OneToOne 0.00 65535.00 FORMAT "%8.2" /end CHARACTERISTIC
/begin CHARACTERISTIC DFC_DisblMsk2.DFC_BrkPlausChk_C "" VALUE 0x80249088 Val_Wu16 65535.00 DFES_OneToOne 0.00 65535.00 FORMAT "%8.2" /end CHARACTERISTIC
/begin CHARACTERISTIC EmWakeupSig_O_S_ATS_ATS.LimitTypeMsk_C "" VALUE 0x80252F70 Val_Wu8 255.0 OneToOne 0.00 255.0 FORMAT "%5.1" /end CHARACTERISTIC
/begin CHARACTERISTIC EmWakeupSig_O_S_ATS_ATS.CnvNorm_C "" VALUE 0x80252F71 Val_Wu8 255.0 OneToOne 0.00 255.0 FORMAT "%5.1" /end CHARACTERISTIC
/begin CHARACTERISTIC EmWakeupSig_O_S_ATS_ATS.LowLim_C "" VALUE 0x80252F72 Val_Ws16 799.9878 Prc -400.0000 399.9878 FORMAT "%8.4" /end CHARACTERISTIC
/begin CHARACTERISTIC EmWakeupSig_O_S_ATS_ATS.UpLim_C "" VALUE 0x80252F74 Val_Ws16 799.9878 Prc -400.0000 399.9878 FORMAT "%8.4" /end CHARACTERISTIC
/begin CHARACTERISTIC EmWakeupSig_O_S_ATS_ATS.CnvFac_C "" VALUE 0x80252F78 Val_Ws32 4294967295.00 OneToOne -2147483648.00 2147483647.00 FORMAT "%13.2" /end CHARACTERISTIC
/begin CHARACTERISTIC EmWakeupSig_O_S_ATS_ATS.CnvOfs_C "" VALUE 0x80252F7C Val_Ws16 65535.00 OneToOne -32768.00 32767.00 FORMAT "%8.2" /end CHARACTERISTIC
/begin CHARACTERISTIC EmWakeupSig_O_S_ATS_ATS.DfltVal_C "" VALUE 0x80252F7E Val_Ws16 65535.00 OneToOne -32768.00 32767.00 FORMAT "%8.2" /end CHARACTERISTIC
/begin CHARACTERISTIC Ext_tiHldIntModeExitMainWku_C "Delay after which EI mode is exited if CMM is not in Main wakeup" VALUE 0x8024E672 Val_Wu16 327.6750 t_q0p005 0.00 327.6750 FORMAT "%8.4" /end CHARACTERISTIC
/begin CHARACTERISTIC FanSpd_ATS_ATS.LimitTypeMsk_C "" VALUE 0x80252F80 Val_Wu8 255.0 OneToOne 0.00 255.0 FORMAT "%5.1" /end CHARACTERISTIC
/begin CHARACTERISTIC FanSpd_ATS_ATS.CnvNorm_C "" VALUE 0x80252F81 Val_Wu8 255.0 OneToOne 0.00 255.0 FORMAT "%5.1" /end CHARACTERISTIC
/begin CHARACTERISTIC FanSpd_ATS_ATS.LowLim_C "" VALUE 0x80252F82 Val_Ws16 655350.0 TurboN -327680.0 327670.0 FORMAT "%8.1" /end CHARACTERISTIC
/begin CHARACTERISTIC FanSpd_ATS_ATS.UpLim_C "" VALUE 0x80252F84 Val_Ws16 655350.0 TurboN -327680.0 327670.0 FORMAT "%8.1" /end CHARACTERISTIC
/begin CHARACTERISTIC FanSpd_ATS_ATS.CnvFac_C "" VALUE 0x80252F88 Val_Ws32 4294967295.00 OneToOne -2147483648.00 2147483647.00 FORMAT "%13.2" /end CHARACTERISTIC
/begin CHARACTERISTIC FanSpd_ATS_ATS.CnvOfs_C "" VALUE 0x80252F8C Val_Ws16 65535.00 OneToOne -32768.00 32767.00 FORMAT "%8.2" /end CHARACTERISTIC
/begin CHARACTERISTIC FanSpd_ATS_ATS.DfltVal_C "" VALUE 0x80252F8E Val_Ws16 65535.00 OneToOne -32768.00 32767.00 FORMAT "%8.2" /end CHARACTERISTIC
/begin CHARACTERISTIC FreonP_ATS_ATS.LimitTypeMsk_C "" VALUE 0x80252F90 Val_Wu8 255.0 OneToOne 0.00 255.0 FORMAT "%5.1" /end CHARACTERISTIC
/begin CHARACTERISTIC FreonP_ATS_ATS.CnvNorm_C "" VALUE 0x80252F91 Val_Wu8 255.0 OneToOne 0.00 255.0 FORMAT "%5.1" /end CHARACTERISTIC
/begin CHARACTERISTIC FreonP_ATS_ATS.LowLim_C "" VALUE 0x80252F92 Val_Ws16 6553.500 p_q0p1_bar -3276.800 3276.700 FORMAT "%8.3" /end CHARACTERISTIC
/begin CHARACTERISTIC FreonP_ATS_ATS.UpLim_C "" VALUE 0x80252F94 Val_Ws16 6553.500 p_q0p1_bar -3276.800 3276.700 FORMAT "%8.3" /end CHARACTERISTIC
/begin CHARACTERISTIC FreonP_ATS_ATS.CnvFac_C "" VALUE 0x80252F98 Val_Ws32 4294967295.00 OneToOne -2147483648.00 2147483647.00 FORMAT "%13.2" /end CHARACTERISTIC
/begin CHARACTERISTIC FreonP_ATS_ATS.CnvOfs_C "" VALUE 0x80252F9C Val_Ws16 65535.00 OneToOne -32768.00 32767.00 FORMAT "%8.2" /end CHARACTERISTIC
/begin CHARACTERISTIC FreonP_ATS_ATS.DfltVal_C "" VALUE 0x80252F9E Val_Ws16 65535.00 OneToOne -32768.00 32767.00 FORMAT "%8.2" /end CHARACTERISTIC
/begin CHARACTERISTIC HeatrCoreT_ATS_ATS.LimitTypeMsk_C "" VALUE 0x80252FA0 Val_Wu8 255.0 OneToOne 0.00 255.0 FORMAT "%5.1" /end CHARACTERISTIC
/begin CHARACTERISTIC HeatrCoreT_ATS_ATS.CnvNorm_C "" VALUE 0x80252FA1 Val_Wu8 255.0 OneToOne 0.00 255.0 FORMAT "%5.1" /end CHARACTERISTIC
/begin CHARACTERISTIC HeatrCoreT_ATS_ATS.LowLim_C "" VALUE 0x80252FA2 Val_Ws16 65535.00 RBPtCel_t_1p0_3 -32768.00 32767.00 FORMAT "%8.2" /end CHARACTERISTIC
/begin CHARACTERISTIC HeatrCoreT_ATS_ATS.UpLim_C "" VALUE 0x80252FA4 Val_Ws16 65535.00 RBPtCel_t_1p0_3 -32768.00 32767.00 FORMAT "%8.2" /end CHARACTERISTIC
/begin CHARACTERISTIC HeatrCoreT_ATS_ATS.CnvFac_C "" VALUE 0x80252FA8 Val_Ws32 4294967295.00 OneToOne -2147483648.00 2147483647.00 FORMAT "%13.2" /end CHARACTERISTIC
/begin CHARACTERISTIC HeatrCoreT_ATS_ATS.CnvOfs_C "" VALUE 0x80252FAC Val_Ws16 65535.00 OneToOne -32768.00 32767.00 FORMAT "%8.2" /end CHARACTERISTIC
/begin CHARACTERISTIC HeatrCoreT_ATS_ATS.DfltVal_C "" VALUE 0x80252FAE Val_Ws16 65535.00 OneToOne -32768.00 32767.00 FORMAT "%8.2" /end CHARACTERISTIC
/begin CHARACTERISTIC IntlckChrgPlg_DTYCYC_O_S_ATS_ATS.LimitTypeMsk_C "" VALUE 0x80252FB0 Val_Wu8 255.0 OneToOne 0.00 255.0 FORMAT "%5.1" /end CHARACTERISTIC
/begin CHARACTERISTIC IntlckChrgPlg_DTYCYC_O_S_ATS_ATS.CnvNorm_C "" VALUE 0x80252FB1 Val_Wu8 255.0 OneToOne 0.00 255.0 FORMAT "%5.1" /end CHARACTERISTIC
/begin CHARACTERISTIC IntlckChrgPlg_DTYCYC_O_S_ATS_ATS.LowLim_C "" VALUE 0x80252FB2 Val_Ws16 655.3500 DtyCyc -327.6800 327.6700 FORMAT "%8.4" /end CHARACTERISTIC
/begin CHARACTERISTIC IntlckChrgPlg_DTYCYC_O_S_ATS_ATS.UpLim_C "" VALUE 0x80252FB4 Val_Ws16 655.3500 DtyCyc -327.6800 327.6700 FORMAT "%8.4" /end CHARACTERISTIC
/begin CHARACTERISTIC IntlckChrgPlg_DTYCYC_O_S_ATS_ATS.CnvFac_C "" VALUE 0x80252FB8 Val_Ws32 4294967295.00 OneToOne -2147483648.00 2147483647.00 FORMAT "%13.2" /end CHARACTERISTIC
/begin CHARACTERISTIC IntlckChrgPlg_DTYCYC_O_S_ATS_ATS.CnvOfs_C "" VALUE 0x80252FBC Val_Ws16 65535.00 OneToOne -32768.00 32767.00 FORMAT "%8.2" /end CHARACTERISTIC
/begin CHARACTERISTIC IntlckChrgPlg_DTYCYC_O_S_ATS_ATS.DfltVal_C "" VALUE 0x80252FBE Val_Ws16 65535.00 OneToOne -32768.00 32767.00 FORMAT "%8.2" /end CHARACTERISTIC
/begin CHARACTERISTIC PwmCtP_ATS_ATS.LimitTypeMsk_C "" VALUE 0x80252FC0 Val_Wu8 255.0 OneToOne 0.00 255.0 FORMAT "%5.1" /end CHARACTERISTIC
/begin CHARACTERISTIC PwmCtP_ATS_ATS.CnvNorm_C "" VALUE 0x80252FC1 Val_Wu8 255.0 OneToOne 0.00 255.0 FORMAT "%5.1" /end CHARACTERISTIC
/begin CHARACTERISTIC PwmCtP_ATS_ATS.LowLim_C "" VALUE 0x80252FC2 Val_Ws16 65535.00 RBPtCel_i_1p0_2 -32768.00 32767.00 FORMAT "%8.2" /end CHARACTERISTIC
/begin CHARACTERISTIC PwmCtP_ATS_ATS.UpLim_C "" VALUE 0x80252FC4 Val_Ws16 65535.00 RBPtCel_i_1p0_2 -32768.00 32767.00 FORMAT "%8.2" /end CHARACTERISTIC
/begin CHARACTERISTIC PwmCtP_ATS_ATS.CnvFac_C "" VALUE 0x80252FC8 Val_Ws32 4294967295.00 OneToOne -2147483648.00 2147483647.00 FORMAT "%13.2" /end CHARACTERISTIC
/begin CHARACTERISTIC PwmCtP_ATS_ATS.CnvOfs_C "" VALUE 0x80252FCC Val_Ws16 65535.00 OneToOne -32768.00 32767.00 FORMAT "%8.2" /end CHARACTERISTIC
/begin CHARACTERISTIC PwmCtP_ATS_ATS.DfltVal_C "" VALUE 0x80252FCE Val_Ws16 65535.00 OneToOne -32768.00 32767.00 FORMAT "%8.2" /end CHARACTERISTIC
/begin CHARACTERISTIC PwrDistbnUnitT_ATS_ATS.LimitTypeMsk_C "" VALUE 0x80252FD0 Val_Wu8 255.0 OneToOne 0.00 255.0 FORMAT "%5.1" /end CHARACTERISTIC
/begin CHARACTERISTIC PwrDistbnUnitT_ATS_ATS.CnvNorm_C "" VALUE 0x80252FD1 Val_Wu8 255.0 OneToOne 0.00 255.0 FORMAT "%5.1" /end CHARACTERISTIC
/begin CHARACTERISTIC PwrDistbnUnitT_ATS_ATS.LowLim_C "" VALUE 0x80252FD2 Val_Ws16 65535.00 RBPtCel_t_1p0_3 -32768.00 32767.00 FORMAT "%8.2" /end CHARACTERISTIC
/begin CHARACTERISTIC PwrDistbnUnitT_ATS_ATS.UpLim_C "" VALUE 0x80252FD4 Val_Ws16 65535.00 RBPtCel_t_1p0_3 -32768.00 32767.00 FORMAT "%8.2" /end CHARACTERISTIC
/begin CHARACTERISTIC PwrDistbnUnitT_ATS_ATS.CnvFac_C "" VALUE 0x80252FD8 Val_Ws32 4294967295.00 OneToOne -2147483648.00 2147483647.00 FORMAT "%13.2" /end CHARACTERISTIC
/begin CHARACTERISTIC PwrDistbnUnitT_ATS_ATS.CnvOfs_C "" VALUE 0x80252FDC Val_Ws16 65535.00 OneToOne -32768.00 32767.00 FORMAT "%8.2" /end CHARACTERISTIC
/begin CHARACTERISTIC PwrDistbnUnitT_ATS_ATS.DfltVal_C "" VALUE 0x80252FDE Val_Ws16 65535.00 OneToOne -32768.00 32767.00 FORMAT "%8.2" /end CHARACTERISTIC
/begin CHARACTERISTIC SCtPmp1_DTYCYC_O_S_ATS_ATS.LimitTypeMsk_C "" VALUE 0x80252FE0 Val_Wu8 255.0 OneToOne 0.00 255.0 FORMAT "%5.1" /end CHARACTERISTIC
/begin CHARACTERISTIC SCtPmp1_DTYCYC_O_S_ATS_ATS.CnvNorm_C "" VALUE 0x80252FE1 Val_Wu8 255.0 OneToOne 0.00 255.0 FORMAT "%5.1" /end CHARACTERISTIC
/begin CHARACTERISTIC SCtPmp1_DTYCYC_O_S_ATS_ATS.LowLim_C "" VALUE 0x80252FE2 Val_Ws16 655.3500 DtyCyc -327.6800 327.6700 FORMAT "%8.4" /end CHARACTERISTIC
/begin CHARACTERISTIC SCtPmp1_DTYCYC_O_S_ATS_ATS.UpLim_C "" VALUE 0x80252FE4 Val_Ws16 655.3500 DtyCyc -327.6800 327.6700 FORMAT "%8.4" /end CHARACTERISTIC
/begin CHARACTERISTIC SCtPmp1_DTYCYC_O_S_ATS_ATS.CnvFac_C "" VALUE 0x80252FE8 Val_Ws32 4294967295.00 OneToOne -2147483648.00 2147483647.00 FORMAT "%13.2" /end CHARACTERISTIC
/begin CHARACTERISTIC SCtPmp1_DTYCYC_O_S_ATS_ATS.CnvOfs_C "" VALUE 0x80252FEC Val_Ws16 65535.00 OneToOne -32768.00 32767.00 FORMAT "%8.2" /end CHARACTERISTIC
/begin CHARACTERISTIC SCtPmp1_DTYCYC_O_S_ATS_ATS.DfltVal_C "" VALUE 0x80252FEE Val_Ws16 65535.00 OneToOne -32768.00 32767.00 FORMAT "%8.2" /end CHARACTERISTIC
/begin CHARACTERISTIC SCtPmp1_O_S_ATS_ATS.LimitTypeMsk_C "" VALUE 0x80252FF0 Val_Wu8 255.0 OneToOne 0.00 255.0 FORMAT "%5.1" /end CHARACTERISTIC
/begin CHARACTERISTIC SCtPmp1_O_S_ATS_ATS.CnvNorm_C "" VALUE 0x80252FF1 Val_Wu8 255.0 OneToOne 0.00 255.0 FORMAT "%5.1" /end CHARACTERISTIC
/begin CHARACTERISTIC SCtPmp1_O_S_ATS_ATS.LowLim_C "" VALUE 0x80252FF2 Val_Ws16 799.9878 Prc -400.0000 399.9878 FORMAT "%8.4" /end CHARACTERISTIC
/begin CHARACTERISTIC SCtPmp1_O_S_ATS_ATS.UpLim_C "" VALUE 0x80252FF4 Val_Ws16 799.9878 Prc -400.0000 399.9878 FORMAT "%8.4" /end CHARACTERISTIC
/begin CHARACTERISTIC SCtPmp1_O_S_ATS_ATS.CnvFac_C "" VALUE 0x80252FF8 Val_Ws32 4294967295.00 OneToOne -2147483648.00 2147483647.00 FORMAT "%13.2" /end CHARACTERISTIC
/begin CHARACTERISTIC SCtPmp1_O_S_ATS_ATS.CnvOfs_C "" VALUE 0x80252FFC Val_Ws16 65535.00 OneToOne -32768.00 32767.00 FORMAT "%8.2" /end CHARACTERISTIC
/begin CHARACTERISTIC SCtPmp1_O_S_ATS_ATS.DfltVal_C "" VALUE 0x80252FFE Val_Ws16 65535.00 OneToOne -32768.00 32767.00 FORMAT "%8.2" /end CHARACTERISTIC
/begin CHARACTERISTIC SpplCooltPmpRly_DTYCYC_O_S_ATS_ATS.LimitTypeMsk_C "" VALUE 0x80253000 Val_Wu8 255.0 OneToOne 0.00 255.0 FORMAT "%5.1" /end CHARACTERISTIC
/begin CHARACTERISTIC SpplCooltPmpRly_DTYCYC_O_S_ATS_ATS.CnvNorm_C "" VALUE 0x80253001 Val_Wu8 255.0 OneToOne 0.00 255.0 FORMAT "%5.1" /end CHARACTERISTIC
/begin CHARACTERISTIC SpplCooltPmpRly_DTYCYC_O_S_ATS_ATS.LowLim_C "" VALUE 0x80253002 Val_Ws16 655.3500 DtyCyc -327.6800 327.6700 FORMAT "%8.4" /end CHARACTERISTIC
/begin CHARACTERISTIC SpplCooltPmpRly_DTYCYC_O_S_ATS_ATS.UpLim_C "" VALUE 0x80253004 Val_Ws16 655.3500 DtyCyc -327.6800 327.6700 FORMAT "%8.4" /end CHARACTERISTIC
/begin CHARACTERISTIC SpplCooltPmpRly_DTYCYC_O_S_ATS_ATS.CnvFac_C "" VALUE 0x80253008 Val_Ws32 4294967295.00 OneToOne -2147483648.00 2147483647.00 FORMAT "%13.2" /end CHARACTERISTIC
/begin CHARACTERISTIC SpplCooltPmpRly_DTYCYC_O_S_ATS_ATS.CnvOfs_C "" VALUE 0x8025300C Val_Ws16 65535.00 OneToOne -32768.00 32767.00 FORMAT "%8.2" /end CHARACTERISTIC
/begin CHARACTERISTIC SpplCooltPmpRly_DTYCYC_O_S_ATS_ATS.DfltVal_C "" VALUE 0x8025300E Val_Ws16 65535.00 OneToOne -32768.00 32767.00 FORMAT "%8.2" /end CHARACTERISTIC
/begin CHARACTERISTIC SpplCooltPmpRly_O_S_ATS_ATS.LimitTypeMsk_C "" VALUE 0x80253010 Val_Wu8 255.0 OneToOne 0.00 255.0 FORMAT "%5.1" /end CHARACTERISTIC
/begin CHARACTERISTIC SpplCooltPmpRly_O_S_ATS_ATS.CnvNorm_C "" VALUE 0x80253011 Val_Wu8 255.0 OneToOne 0.00 255.0 FORMAT "%5.1" /end CHARACTERISTIC
/begin CHARACTERISTIC SpplCooltPmpRly_O_S_ATS_ATS.LowLim_C "" VALUE 0x80253012 Val_Ws16 799.9878 Prc -400.0000 399.9878 FORMAT "%8.4" /end CHARACTERISTIC
/begin CHARACTERISTIC SpplCooltPmpRly_O_S_ATS_ATS.UpLim_C "" VALUE 0x80253014 Val_Ws16 799.9878 Prc -400.0000 399.9878 FORMAT "%8.4" /end CHARACTERISTIC
/begin CHARACTERISTIC SpplCooltPmpRly_O_S_ATS_ATS.CnvFac_C "" VALUE 0x80253018 Val_Ws32 4294967295.00 OneToOne -2147483648.00 2147483647.00 FORMAT "%13.2" /end CHARACTERISTIC
/begin CHARACTERISTIC SpplCooltPmpRly_O_S_ATS_ATS.CnvOfs_C "" VALUE 0x8025301C Val_Ws16 65535.00 OneToOne -32768.00 32767.00 FORMAT "%8.2" /end CHARACTERISTIC
/begin CHARACTERISTIC SpplCooltPmpRly_O_S_ATS_ATS.DfltVal_C "" VALUE 0x8025301E Val_Ws16 65535.00 OneToOne -32768.00 32767.00 FORMAT "%8.2" /end CHARACTERISTIC
/begin CHARACTERISTIC UCtP_ATS_ATS.LimitTypeMsk_C "" VALUE 0x80253020 Val_Wu8 255.0 OneToOne 0.00 255.0 FORMAT "%5.1" /end CHARACTERISTIC
/begin CHARACTERISTIC UCtP_ATS_ATS.CnvNorm_C "" VALUE 0x80253021 Val_Wu8 255.0 OneToOne 0.00 255.0 FORMAT "%5.1" /end CHARACTERISTIC
/begin CHARACTERISTIC UCtP_ATS_ATS.LowLim_C "" VALUE 0x80253022 Val_Ws16 65535.00 RBPtCel_u_1p0_1 -32768.00 32767.00 FORMAT "%8.2" /end CHARACTERISTIC
/begin CHARACTERISTIC UCtP_ATS_ATS.UpLim_C "" VALUE 0x80253024 Val_Ws16 65535.00 RBPtCel_u_1p0_1 -32768.00 32767.00 FORMAT "%8.2" /end CHARACTERISTIC
/begin CHARACTERISTIC UCtP_ATS_ATS.CnvFac_C "" VALUE 0x80253028 Val_Ws32 4294967295.00 OneToOne -2147483648.00 2147483647.00 FORMAT "%13.2" /end CHARACTERISTIC
/begin CHARACTERISTIC UCtP_ATS_ATS.CnvOfs_C "" VALUE 0x8025302C Val_Ws16 65535.00 OneToOne -32768.00 32767.00 FORMAT "%8.2" /end CHARACTERISTIC
/begin CHARACTERISTIC UCtP_ATS_ATS.DfltVal_C "" VALUE 0x8025302E Val_Ws16 65535.00 OneToOne -32768.00 32767.00 FORMAT "%8.2" /end CHARACTERISTIC
/begin CHARACTERISTIC UPxP1_ATS_ATS.LimitTypeMsk_C "" VALUE 0x80253030 Val_Wu8 255.0 OneToOne 0.00 255.0 FORMAT "%5.1" /end CHARACTERISTIC
/begin CHARACTERISTIC UPxP1_ATS_ATS.CnvNorm_C "" VALUE 0x80253031 Val_Wu8 255.0 OneToOne 0.00 255.0 FORMAT "%5.1" /end CHARACTERISTIC
/begin CHARACTERISTIC UPxP1_ATS_ATS.LowLim_C "" VALUE 0x80253032 Val_Ws16 65535.00 RBPtCel_u_1p0_1 -32768.00 32767.00 FORMAT "%8.2" /end CHARACTERISTIC
/begin CHARACTERISTIC UPxP1_ATS_ATS.UpLim_C "" VALUE 0x80253034 Val_Ws16 65535.00 RBPtCel_u_1p0_1 -32768.00 32767.00 FORMAT "%8.2" /end CHARACTERISTIC
/begin CHARACTERISTIC UPxP1_ATS_ATS.CnvFac_C "" VALUE 0x80253038 Val_Ws32 4294967295.00 OneToOne -2147483648.00 2147483647.00 FORMAT "%13.2" /end CHARACTERISTIC
/begin CHARACTERISTIC UPxP1_ATS_ATS.CnvOfs_C "" VALUE 0x8025303C Val_Ws16 65535.00 OneToOne -32768.00 32767.00 FORMAT "%8.2" /end CHARACTERISTIC
/begin CHARACTERISTIC UPxP1_ATS_ATS.DfltVal_C "" VALUE 0x8025303E Val_Ws16 65535.00 OneToOne -32768.00 32767.00 FORMAT "%8.2" /end CHARACTERISTIC
/begin MEASUREMENT ATS_ctCurRunTst "" UBYTE OneToOne 1 100 0.00 255.0 FORMAT "%5.1" ECU_ADDRESS 0x6002387F
 /begin IF_DATA XCPplus 0x0102
  /begin DAQ_EVENT VARIABLE /end DAQ_EVENT
 /end IF_DATA
/end MEASUREMENT
/begin MEASUREMENT ATS_IntvVal_mp "Intervention value" SWORD OneToOne 1 100 -32768.00 32767.00 FORMAT "%8.2" ECU_ADDRESS 0x70006B4E /end MEASUREMENT
/begin MEASUREMENT ATS_stMon "status of ATS internal monitoring" UBYTE OneToOne 1 100 0.00 255.0 FORMAT "%5.1" ECU_ADDRESS 0x6002389C
 /begin IF_DATA XCPplus 0x0102
  /begin DAQ_EVENT VARIABLE /end DAQ_EVENT
 /end IF_DATA
/end MEASUREMENT
/begin MEASUREMENT ATS_stMonTimeLimit "Behaviour time limit response for new tester demands" UBYTE OneToOne 1 100 0.00 255.0 FORMAT "%5.1" ECU_ADDRESS 0x6002387E
 /begin IF_DATA XCPplus 0x0102
  /begin DAQ_EVENT VARIABLE /end DAQ_EVENT
 /end IF_DATA
/end MEASUREMENT
/begin MEASUREMENT ATS_TstStatus_mp "Status of actuatorintervention" UBYTE OneToOne 1 100 0.00 255.0 FORMAT "%5.1" ECU_ADDRESS 0x70006C29 /end MEASUREMENT
/begin MEASUREMENT BattU_ctPwrFailErr_mp "Count of Battery power failures" UBYTE OneToOne 1 100 0.00 255.0 FORMAT "%5.1" ECU_ADDRESS 0x70006C30
 /begin IF_DATA XCPplus 0x0102
  /begin DAQ_EVENT VARIABLE /end DAQ_EVENT
 /end IF_DATA
/end MEASUREMENT
/begin MEASUREMENT BattU_facCor "Correction factor for battery voltage" SWORD Fact 1 100 -4.000000 3.999878 FORMAT "%8.6" ECU_ADDRESS 0x6001FC3C
 /begin IF_DATA XCPplus 0x0102
  /begin DAQ_EVENT VARIABLE /end DAQ_EVENT
 /end IF_DATA
/end MEASUREMENT
/begin MEASUREMENT BattU_flgBattSply "flag for battery supply" UBYTE B_TRUE 1 100 0.00 1.00000000000 BIT_MASK 0x1 FORMAT "%13.11" ECU_ADDRESS 0x700001DC
 /begin IF_DATA XCPplus 0x0102
  /begin DAQ_EVENT VARIABLE /end DAQ_EVENT
 /end IF_DATA
/end MEASUREMENT
/begin MEASUREMENT BattU_flgDiagInvld "Flag for not reporting heal if Syc is invalid" UBYTE B_TRUE 1 100 0.00 1.00000000000 BIT_MASK 0x1 FORMAT "%13.11" ECU_ADDRESS 0x60023200 /end MEASUREMENT
/begin MEASUREMENT BattU_flgECUOn "Flag which stores status of ECU on time delay" UBYTE B_TRUE 1 100 0.00 1.00000000000 BIT_MASK 0x1 FORMAT "%13.11" ECU_ADDRESS 0x600231FF
 /begin IF_DATA XCPplus 0x0102
  /begin DAQ_EVENT VARIABLE /end DAQ_EVENT
 /end IF_DATA
/end MEASUREMENT
/begin MEASUREMENT BattU_flgOverUChkEna "flag for release of overvoltage detection" UBYTE B_TRUE 1 100 0.00 1.00000000000 BIT_MASK 0x1 FORMAT "%13.11" ECU_ADDRESS 0x700001DB
 /begin IF_DATA XCPplus 0x0102
  /begin DAQ_EVENT VARIABLE /end DAQ_EVENT
 /end IF_DATA
/end MEASUREMENT
/begin MEASUREMENT BattU_flgRprtOnce "Flag to report error and heal once in driving cycle" UBYTE B_TRUE 1 100 0.00 1.00000000000 BIT_MASK 0x1 FORMAT "%13.11" ECU_ADDRESS 0x600231FE
 /begin IF_DATA XCPplus 0x0102
  /begin DAQ_EVENT VARIABLE /end DAQ_EVENT
 /end IF_DATA
/end MEASUREMENT
/begin MEASUREMENT BattU_flgRstDebCntr "flag to reset debounce counter after DSM clear" UBYTE B_TRUE 1 100 0.00 1.00000000000 BIT_MASK 0x1 FORMAT "%13.11" ECU_ADDRESS 0x600231FD
 /begin IF_DATA XCPplus 0x0102
  /begin DAQ_EVENT VARIABLE /end DAQ_EVENT
 /end IF_DATA
/end MEASUREMENT
/begin MEASUREMENT BattU_flgUnderUChkEna "flag for release of undervoltage detection" UBYTE B_TRUE 1 100 0.00 1.00000000000 BIT_MASK 0x1 FORMAT "%13.11" ECU_ADDRESS 0x700001DA
 /begin IF_DATA XCPplus 0x0102
  /begin DAQ_EVENT VARIABLE /end DAQ_EVENT
 /end IF_DATA
/end MEASUREMENT
/begin MEASUREMENT BattU_stPwrFail "State interruption of power supply" UBYTE B_TRUE 1 100 0.00 1.00000000000 BIT_MASK 0x1 FORMAT "%13.11" ECU_ADDRESS 0x6002342C /end MEASUREMENT
/begin MEASUREMENT BattU_u "Battery voltage" SWORD Volt_Batt 1 100 -655360.0 655340.0 FORMAT "%8.1" ECU_ADDRESS 0x6001FC3A
 /begin IF_DATA XCPplus 0x0102
  /begin DAQ_EVENT VARIABLE /end DAQ_EVENT
 /end IF_DATA
/end MEASUREMENT
/begin MEASUREMENT BattU_uPID42 "Supply voltage for tester interface (SIGNAL)" SWORD Volt_Batt 1 100 -655360.0 655340.0 FORMAT "%8.1" ECU_ADDRESS 0x6001FC38
 /begin IF_DATA XCPplus 0x0102
  /begin DAQ_EVENT VARIABLE /end DAQ_EVENT
 /end IF_DATA
/end MEASUREMENT
/begin MEASUREMENT BattU_uRated "Rated battery voltage" SWORD Volt_Batt 1 100 -655360.0 655340.0 FORMAT "%8.1" ECU_ADDRESS 0x6001FC36 /end MEASUREMENT
/begin MEASUREMENT BattU_uRaw "Battery voltage before defect detection and handling" SWORD Volt 1 100 -6553.600 6553.400 FORMAT "%8.3" ECU_ADDRESS 0x6001FC34
 /begin IF_DATA XCPplus 0x0102
  /begin DAQ_EVENT VARIABLE /end DAQ_EVENT
 /end IF_DATA
/end MEASUREMENT
/begin MEASUREMENT BattU_uRawBuf "raw batteryvoltage array" SWORD Volt 1 100 -6553.600 6553.400 FORMAT "%8.3" MATRIX_DIM 11 ECU_ADDRESS 0x70001358 /end MEASUREMENT
/begin MEASUREMENT BattU_uSens "Sensed battery voltage" SWORD Volt_Batt 1 100 -655360.0 655340.0 FORMAT "%8.1" ECU_ADDRESS 0x6001FC30
 /begin IF_DATA XCPplus 0x0102
  /begin DAQ_EVENT VARIABLE /end DAQ_EVENT
 /end IF_DATA
/end MEASUREMENT
/begin MEASUREMENT BattU_uSens1 "sensed supply voltage" SWORD Volt_Batt 1 100 -655360.0 655340.0 FORMAT "%8.1" ECU_ADDRESS 0x6001FC32
 /begin IF_DATA XCPplus 0x0102
  /begin DAQ_EVENT VARIABLE /end DAQ_EVENT
 /end IF_DATA
/end MEASUREMENT
/begin MEASUREMENT BattU_uThdOverUChk "actual voltage threshold for overvoltage check" SWORD Volt_Batt 1 100 -655360.0 655340.0 FORMAT "%8.1" ECU_ADDRESS 0x6001F612
 /begin IF_DATA XCPplus 0x0102
  /begin DAQ_EVENT VARIABLE /end DAQ_EVENT
 /end IF_DATA
/end MEASUREMENT
/begin MEASUREMENT BattU_uThdUnderUChk "actual voltage threshold for undervoltage check" SWORD Volt_Batt 1 100 -655360.0 655340.0 FORMAT "%8.1" ECU_ADDRESS 0x6001F610
 /begin IF_DATA XCPplus 0x0102
  /begin DAQ_EVENT VARIABLE /end DAQ_EVENT
 /end IF_DATA
/end MEASUREMENT
/begin MEASUREMENT BattU_u_Sq "Signal qualifier of Batterie voltage BattU_u" UBYTE SigQly_COMPU_VERB 1 100 0.00 15.0000000000 FORMAT "%13.10" ECU_ADDRESS 0x6002367C
 /begin IF_DATA XCPplus 0x0102
  /begin DAQ_EVENT VARIABLE /end DAQ_EVENT
 /end IF_DATA
/end MEASUREMENT
/begin MEASUREMENT Blwr_flgActv "AC-blower active" UBYTE OneToOne 1 100 0.00 1.000 BIT_MASK 0x1 FORMAT "%5.3" ECU_ADDRESS 0x6002374B
 /begin IF_DATA XCPplus 0x0102
  /begin DAQ_EVENT VARIABLE /end DAQ_EVENT
 /end IF_DATA
/end MEASUREMENT
/begin MEASUREMENT Blwr_flgComActv "Debounced Com-signal AC-blower active" UBYTE OneToOne 1 100 0.00 1.000 BIT_MASK 0x1 FORMAT "%5.3" ECU_ADDRESS 0x6002374A
 /begin IF_DATA XCPplus 0x0102
  /begin DAQ_EVENT VARIABLE /end DAQ_EVENT
 /end IF_DATA
/end MEASUREMENT
/begin MEASUREMENT BrkBstPmp_bPmpReq "Brake Booster vacuum pump request from virtual device" UBYTE B_TRUE 1 100 0.00 1.00000000000 BIT_MASK 0x1 FORMAT "%13.11" ECU_ADDRESS 0x70000297
 /begin IF_DATA XCPplus 0x0102
  /begin DAQ_EVENT VARIABLE /end DAQ_EVENT
 /end IF_DATA
/end MEASUREMENT
/begin MEASUREMENT BrkBstPmp_bPmpStrt "Pump start request from Brake Booster pump virtual device" UBYTE B_TRUE 1 100 0.00 1.00000000000 BIT_MASK 0x1 FORMAT "%13.11" ECU_ADDRESS 0x70000296
 /begin IF_DATA XCPplus 0x0102
  /begin DAQ_EVENT VARIABLE /end DAQ_EVENT
 /end IF_DATA
/end MEASUREMENT
/begin MEASUREMENT BrkBstPmp_DigOutPrmStructHs.tiBtwTstSCB_C "high side digital output parameter structure / Structure containing parameters for Digital output power stage error handling" SWORD OneToOne 1 100 -32768.00 32767.00 FORMAT "%8.2" ECU_ADDRESS 0x6001F606 /end MEASUREMENT
/begin MEASUREMENT BrkBstPmp_DigOutPrmStructHs.tiBtwTstOT_C "high side digital output parameter structure / Time between tests for OT error" SWORD OneToOne 1 100 -32768.00 32767.00 FORMAT "%8.2" ECU_ADDRESS 0x6001F608 /end MEASUREMENT
/begin MEASUREMENT BrkBstPmp_DigOutPrmStructHs.numTstMax_C "high side digital output parameter structure / Maximum number of tests allowed on permanent defect" UWORD OneToOne 1 100 0.00 65535.00 FORMAT "%8.2" ECU_ADDRESS 0x6001F60A /end MEASUREMENT
/begin MEASUREMENT BrkBstPmp_DigOutPrmStructLs.tiBtwTstSCB_C "low side digital output parameter structure / Structure containing parameters for Digital output power stage error handling" SWORD OneToOne 1 100 -32768.00 32767.00 FORMAT "%8.2" ECU_ADDRESS 0x6001F600 /end MEASUREMENT
/begin MEASUREMENT BrkBstPmp_DigOutPrmStructLs.tiBtwTstOT_C "low side digital output parameter structure / Time between tests for OT error" SWORD OneToOne 1 100 -32768.00 32767.00 FORMAT "%8.2" ECU_ADDRESS 0x6001F602 /end MEASUREMENT
/begin MEASUREMENT BrkBstPmp_DigOutPrmStructLs.numTstMax_C "low side digital output parameter structure / Maximum number of tests allowed on permanent defect" UWORD OneToOne 1 100 0.00 65535.00 FORMAT "%8.2" ECU_ADDRESS 0x6001F604 /end MEASUREMENT
/begin MEASUREMENT BrkBstPmp_DigOutStatStructHs.tmrTBtwTst "high side digital output static structure / Timer to save the time between tests" SWORD SrvB_SWTmrS16 1 100 -32768.00 32767.00 FORMAT "%8.2" ECU_ADDRESS 0x6001F5FA /end MEASUREMENT
/begin MEASUREMENT BrkBstPmp_DigOutStatStructHs.ctTstDne "high side digital output static structure / Static counter to save the test impulse in permanent error" UWORD OneToOne 1 100 0.00 65535.00 FORMAT "%8.2" ECU_ADDRESS 0x6001F5FC /end MEASUREMENT
/begin MEASUREMENT BrkBstPmp_DigOutStatStructHs.stPrevTstRslt "high side digital output static structure / Test Status of Power Stage Diagnosis" UWORD OneToOne 1 100 0.00 65535.00 FORMAT "%8.2" ECU_ADDRESS 0x6001F5FE /end MEASUREMENT
/begin MEASUREMENT BrkBstPmp_DigOutStatStructLs.tmrTBtwTst "low side digital output static structure / Timer to save the time between tests" SWORD SrvB_SWTmrS16 1 100 -32768.00 32767.00 FORMAT "%8.2" ECU_ADDRESS 0x6001F5F4 /end MEASUREMENT
/begin MEASUREMENT BrkBstPmp_DigOutStatStructLs.ctTstDne "low side digital output static structure / Static counter to save the test impulse in permanent error" UWORD OneToOne 1 100 0.00 65535.00 FORMAT "%8.2" ECU_ADDRESS 0x6001F5F6 /end MEASUREMENT
/begin MEASUREMENT BrkBstPmp_DigOutStatStructLs.stPrevTstRslt "low side digital output static structure / Test Status of Power Stage Diagnosis" UWORD OneToOne 1 100 0.00 65535.00 FORMAT "%8.2" ECU_ADDRESS 0x6001F5F8 /end MEASUREMENT
/begin MEASUREMENT BrkBstPmp_flgDiagEnad "flag of enabled diagnosis" UBYTE B_TRUE 1 100 0.00 1.00000000000 BIT_MASK 0x1 FORMAT "%13.11" ECU_ADDRESS 0x700001D6
 /begin IF_DATA XCPplus 0x0102
  /begin DAQ_EVENT VARIABLE /end DAQ_EVENT
 /end IF_DATA
/end MEASUREMENT
/begin MEASUREMENT BrkBstPmp_flgHsActr "flag of high side actuator" UBYTE B_TRUE 1 100 0.00 1.00000000000 BIT_MASK 0x1 FORMAT "%13.11" ECU_ADDRESS 0x70000295
 /begin IF_DATA XCPplus 0x0102
  /begin DAQ_EVENT VARIABLE /end DAQ_EVENT
 /end IF_DATA
/end MEASUREMENT
/begin MEASUREMENT BrkBstPmp_flgLeakDiagEnad "flag leakage diagnosis enabled" UBYTE B_TRUE 1 100 0.00 1.00000000000 BIT_MASK 0x1 FORMAT "%13.11" ECU_ADDRESS 0x700001D1
 /begin IF_DATA XCPplus 0x0102
  /begin DAQ_EVENT VARIABLE /end DAQ_EVENT
 /end IF_DATA
/end MEASUREMENT
/begin MEASUREMENT BrkBstPmp_flgLsActr "flag of low side actuator" UBYTE B_TRUE 1 100 0.00 1.00000000000 BIT_MASK 0x1 FORMAT "%13.11" ECU_ADDRESS 0x70000294
 /begin IF_DATA XCPplus 0x0102
  /begin DAQ_EVENT VARIABLE /end DAQ_EVENT
 /end IF_DATA
/end MEASUREMENT
/begin MEASUREMENT BrkBstPmp_flgPmpStrtRaw "relay raw feedback signal" UBYTE B_TRUE 1 100 0.00 1.00000000000 BIT_MASK 0x1 FORMAT "%13.11" ECU_ADDRESS 0x700001D5
 /begin IF_DATA XCPplus 0x0102
  /begin DAQ_EVENT VARIABLE /end DAQ_EVENT
 /end IF_DATA
/end MEASUREMENT
/begin MEASUREMENT BrkBstPmp_flgRstPLeakDiag "reset flag leakage diagnosis" UBYTE B_TRUE 1 100 0.00 1.00000000000 BIT_MASK 0x1 FORMAT "%13.11" ECU_ADDRESS 0x700001D0
 /begin IF_DATA XCPplus 0x0102
  /begin DAQ_EVENT VARIABLE /end DAQ_EVENT
 /end IF_DATA
/end MEASUREMENT
/begin MEASUREMENT BrkBstPmp_flgVacChkStrtd "flag vacuum check started" UBYTE B_TRUE 1 100 0.00 1.00000000000 BIT_MASK 0x1 FORMAT "%13.11" ECU_ADDRESS 0x700001CF
 /begin IF_DATA XCPplus 0x0102
  /begin DAQ_EVENT VARIABLE /end DAQ_EVENT
 /end IF_DATA
/end MEASUREMENT
/begin MEASUREMENT BrkBstPmp_pEnv "Atmospheric pressure" UWORD p_q0p039 1 100 0.00 2559.961 FORMAT "%8.3" ECU_ADDRESS 0x6001F5F2
 /begin IF_DATA XCPplus 0x0102
  /begin DAQ_EVENT VARIABLE /end DAQ_EVENT
 /end IF_DATA
/end MEASUREMENT
/begin MEASUREMENT BrkBstPmp_pRel "Relative Brake Booster pressure" SWORD Pres_hPa 1 100 -32768.00 32767.00 FORMAT "%8.2" ECU_ADDRESS 0x6001F5F0
 /begin IF_DATA XCPplus 0x0102
  /begin DAQ_EVENT VARIABLE /end DAQ_EVENT
 /end IF_DATA
/end MEASUREMENT
/begin MEASUREMENT BrkBstPmp_pStrtg "starting pressure after brake release" SWORD Pres_hPa 1 100 -32768.00 32767.00 FORMAT "%8.2" ECU_ADDRESS 0x6001F5EE
 /begin IF_DATA XCPplus 0x0102
  /begin DAQ_EVENT VARIABLE /end DAQ_EVENT
 /end IF_DATA
/end MEASUREMENT
/begin MEASUREMENT BrkBstPmp_pVacChkMinDif "the threshold for vacuum generation plausibility check diagnosis" SWORD Pres_hPa 1 100 -32768.00 32767.00 FORMAT "%8.2" ECU_ADDRESS 0x6001F5EC
 /begin IF_DATA XCPplus 0x0102
  /begin DAQ_EVENT VARIABLE /end DAQ_EVENT
 /end IF_DATA
/end MEASUREMENT
/begin MEASUREMENT BrkBstPmp_pVacChkStrtd "pressure at the beginning of the vacuum check" SWORD Pres_hPa 1 100 -32768.00 32767.00 FORMAT "%8.2" ECU_ADDRESS 0x6001F5EA
 /begin IF_DATA XCPplus 0x0102
  /begin DAQ_EVENT VARIABLE /end DAQ_EVENT
 /end IF_DATA
/end MEASUREMENT
/begin MEASUREMENT BrkBstPmp_stErr "Status of Brake vacuum pump power stage error" UWORD OneToOne 1 100 0.00 65535.00 FORMAT "%8.2" ECU_ADDRESS 0x6001F60E
 /begin IF_DATA XCPplus 0x0102
  /begin DAQ_EVENT VARIABLE /end DAQ_EVENT
 /end IF_DATA
/end MEASUREMENT
/begin MEASUREMENT BrkBstPmp_stErrHsOpen "Status of high side open switch error" ULONG OneToOne 1 100 0.00 4294967295.00 FORMAT "%13.2" ECU_ADDRESS 0x60000C04
 /begin IF_DATA XCPplus 0x0102
  /begin DAQ_EVENT VARIABLE /end DAQ_EVENT
 /end IF_DATA
/end MEASUREMENT
/begin MEASUREMENT BrkBstPmp_stErrLsOpen "Status of low side open switch error" ULONG OneToOne 1 100 0.00 4294967295.00 FORMAT "%13.2" ECU_ADDRESS 0x60000C00
 /begin IF_DATA XCPplus 0x0102
  /begin DAQ_EVENT VARIABLE /end DAQ_EVENT
 /end IF_DATA
/end MEASUREMENT
/begin MEASUREMENT BrkBstPmp_stHsClsd "Status of high side closed switch" ULONG OneToOne 1 100 0.00 4294967295.00 FORMAT "%13.2" ECU_ADDRESS 0x60000BFC
 /begin IF_DATA XCPplus 0x0102
  /begin DAQ_EVENT VARIABLE /end DAQ_EVENT
 /end IF_DATA
/end MEASUREMENT
/begin MEASUREMENT BrkBstPmp_stLsClsd "Status of low side closed switch" ULONG OneToOne 1 100 0.00 4294967295.00 FORMAT "%13.2" ECU_ADDRESS 0x60000BF8
 /begin IF_DATA XCPplus 0x0102
  /begin DAQ_EVENT VARIABLE /end DAQ_EVENT
 /end IF_DATA
/end MEASUREMENT
/begin MEASUREMENT BrkBstPmp_stStMac "Status in state machine" UBYTE OneToOne 1 100 0.00 255.0 FORMAT "%5.1" ECU_ADDRESS 0x600231FC
 /begin IF_DATA XCPplus 0x0102
  /begin DAQ_EVENT VARIABLE /end DAQ_EVENT
 /end IF_DATA
/end MEASUREMENT
/begin MEASUREMENT BrkBstPmp_tiLeakDiag "counter in leakage diagnosis" SWORD RBPtCel_ti_0p01_1 1 100 -327.6800 327.6700 FORMAT "%8.4" ECU_ADDRESS 0x6001F5E8
 /begin IF_DATA XCPplus 0x0102
  /begin DAQ_EVENT VARIABLE /end DAQ_EVENT
 /end IF_DATA
/end MEASUREMENT
/begin MEASUREMENT BrkBstPmp_tiOvldTmr "Overload timer" ULONG t_q0p0001_s 1 100 0.00 429496.729500 FORMAT "%13.6" ECU_ADDRESS 0x60000BEC
 /begin IF_DATA XCPplus 0x0102
  /begin DAQ_EVENT VARIABLE /end DAQ_EVENT
 /end IF_DATA
/end MEASUREMENT
/begin MEASUREMENT BrkBstPmp_tiOvrnTmr "Old value of overload timer" ULONG t_q0p0001_s 1 100 0.00 429496.729500 FORMAT "%13.6" ECU_ADDRESS 0x60000BE8
 /begin IF_DATA XCPplus 0x0102
  /begin DAQ_EVENT VARIABLE /end DAQ_EVENT
 /end IF_DATA
/end MEASUREMENT
/begin MEASUREMENT BrkBstPmp_tiStMac "Timing in state machine" UWORD RBPtCel_ti_0p01_1 1 100 0.00 655.3500 FORMAT "%8.4" ECU_ADDRESS 0x6001F60C
 /begin IF_DATA XCPplus 0x0102
  /begin DAQ_EVENT VARIABLE /end DAQ_EVENT
 /end IF_DATA
/end MEASUREMENT
/begin MEASUREMENT BrkBstPmp_VacChkCompER_I "edge rising detection execute comparison" UBYTE B_TRUE 1 100 0.00 1.00000000000 BIT_MASK 0x1 FORMAT "%13.11" ECU_ADDRESS 0x700001CD
 /begin IF_DATA XCPplus 0x0102
  /begin DAQ_EVENT VARIABLE /end DAQ_EVENT
 /end IF_DATA
/end MEASUREMENT
/begin MEASUREMENT BrkBstPmp_VacChkStrtdER_I "edge rising detection plausibility check started" UBYTE B_TRUE 1 100 0.00 1.00000000000 BIT_MASK 0x1 FORMAT "%13.11" ECU_ADDRESS 0x700001CC
 /begin IF_DATA XCPplus 0x0102
  /begin DAQ_EVENT VARIABLE /end DAQ_EVENT
 /end IF_DATA
/end MEASUREMENT
/begin MEASUREMENT BrkBstP_p "Sensed Pressure of Brake Booster pressure sensor" SWORD Pres_hPa 1 100 -32768.00 32767.00 FORMAT "%8.2" ECU_ADDRESS 0x6001FC2E
 /begin IF_DATA XCPplus 0x0102
  /begin DAQ_EVENT VARIABLE /end DAQ_EVENT
 /end IF_DATA
/end MEASUREMENT
/begin MEASUREMENT BrkBstP_pAbslt "absolute brake booster pressure" SWORD RBPtCel_p_1p0_1 1 100 -32768.00 32767.00 FORMAT "%8.2" ECU_ADDRESS 0x6001F5DC
 /begin IF_DATA XCPplus 0x0102
  /begin DAQ_EVENT VARIABLE /end DAQ_EVENT
 /end IF_DATA
/end MEASUREMENT
/begin MEASUREMENT BrkBstP_pDifSnsr12 "Pressure difference between sensor 1 and sensor 2" SWORD RBPtCel_p_1p0_1 1 100 -32768.00 32767.00 FORMAT "%8.2" ECU_ADDRESS 0x6001F5E6
 /begin IF_DATA XCPplus 0x0102
  /begin DAQ_EVENT VARIABLE /end DAQ_EVENT
 /end IF_DATA
/end MEASUREMENT
/begin MEASUREMENT BrkBstP_pSnsr "Vacuum raw value" SWORD RBPtCel_p_1p0_1 1 100 -32768.00 32767.00 FORMAT "%8.2" ECU_ADDRESS 0x6001FC28
 /begin IF_DATA XCPplus 0x0102
  /begin DAQ_EVENT VARIABLE /end DAQ_EVENT
 /end IF_DATA
/end MEASUREMENT
/begin MEASUREMENT BrkBstP_pSnsr1 "Brake booster raw pressure of pressure sesnor 1" SWORD RBPtCel_p_1p0_1 1 100 -32768.00 32767.00 FORMAT "%8.2" ECU_ADDRESS 0x6001FC2C
 /begin IF_DATA XCPplus 0x0102
  /begin DAQ_EVENT VARIABLE /end DAQ_EVENT
 /end IF_DATA
/end MEASUREMENT
/begin MEASUREMENT BrkBstP_pSnsr2 "Brake booster raw pressure of pressure sesnor 2" SWORD RBPtCel_p_1p0_1 1 100 -32768.00 32767.00 FORMAT "%8.2" ECU_ADDRESS 0x6001FC2A
 /begin IF_DATA XCPplus 0x0102
  /begin DAQ_EVENT VARIABLE /end DAQ_EVENT
 /end IF_DATA
/end MEASUREMENT
/begin MEASUREMENT BrkBstP_pSnsr_Sq "signal quality of brake booster raw pressure" UBYTE SigQly_COMPU_VERB 1 100 0.00 15.0000000000 FORMAT "%13.10" ECU_ADDRESS 0x6002367B
 /begin IF_DATA XCPplus 0x0102
  /begin DAQ_EVENT VARIABLE /end DAQ_EVENT
 /end IF_DATA
/end MEASUREMENT
/begin MEASUREMENT BrkBstP_p_Sq "Brake booster pressure signal qualifier" UBYTE SigQly_COMPU_VERB 1 100 0.00 15.0000000000 FORMAT "%13.10" ECU_ADDRESS 0x6002367A
 /begin IF_DATA XCPplus 0x0102
  /begin DAQ_EVENT VARIABLE /end DAQ_EVENT
 /end IF_DATA
/end MEASUREMENT
/begin MEASUREMENT BrkBstP_Snsr1_I.pSnsr "class of brake booster pressure sensor 1 / raw pressure" SWORD RBPtCel_p_1p0_1 1 100 -32768.00 32767.00 FORMAT "%8.2" ECU_ADDRESS 0x6001F5E2 /end MEASUREMENT
/begin MEASUREMENT BrkBstP_Snsr1_I.stQly "class of brake booster pressure sensor 1 / signal quality" UBYTE q1 1 100 0.00 255.0 FORMAT "%5.1" ECU_ADDRESS 0x6001F5E4 /end MEASUREMENT
/begin MEASUREMENT BrkBstP_Snsr2_I.pSnsr "class of brake booster pressure sensor 2 / raw pressure" SWORD RBPtCel_p_1p0_1 1 100 -32768.00 32767.00 FORMAT "%8.2" ECU_ADDRESS 0x6001F5DE /end MEASUREMENT
/begin MEASUREMENT BrkBstP_Snsr2_I.stQly "class of brake booster pressure sensor 2 / signal quality" UBYTE q1 1 100 0.00 255.0 FORMAT "%5.1" ECU_ADDRESS 0x6001F5E0 /end MEASUREMENT
/begin MEASUREMENT BrkBstP_stQly "signal quality of brake booster pressure" UBYTE q1 1 100 0.00 255.0 FORMAT "%5.1" ECU_ADDRESS 0x600231FB
 /begin IF_DATA XCPplus 0x0102
  /begin DAQ_EVENT VARIABLE /end DAQ_EVENT
 /end IF_DATA
/end MEASUREMENT
/begin MEASUREMENT BrkBstP_stQlyPAbslt "signal quality of absolute pressure" UBYTE OneToOne 1 100 0.00 255.0 FORMAT "%5.1" ECU_ADDRESS 0x600231FA
 /begin IF_DATA XCPplus 0x0102
  /begin DAQ_EVENT VARIABLE /end DAQ_EVENT
 /end IF_DATA
/end MEASUREMENT
/begin MEASUREMENT BrkBstP_uRaw1 "Raw voltage from ADC for brake Boost Vacuum pressure sensor (Sensor 1)" SWORD RBPtCel_u_0p2_1 1 100 -6553.600 6553.400 FORMAT "%8.3" ECU_ADDRESS 0x6001FC26
 /begin IF_DATA XCPplus 0x0102
  /begin DAQ_EVENT VARIABLE /end DAQ_EVENT
 /end IF_DATA
/end MEASUREMENT
/begin MEASUREMENT BrkBstP_uRaw2 "Raw voltage from ADC for brake Boost Vacuum pressure sensor (Sensor 2)" SWORD RBPtCel_u_0p2_1 1 100 -6553.600 6553.400 FORMAT "%8.3" ECU_ADDRESS 0x6001FC24
 /begin IF_DATA XCPplus 0x0102
  /begin DAQ_EVENT VARIABLE /end DAQ_EVENT
 /end IF_DATA
/end MEASUREMENT
/begin MEASUREMENT BrkBst_bBkupModBrkPedReq "State of EVP activation request from brake pedal backup mode" UBYTE B_TRUE 1 100 0.00 1.00000000000 BIT_MASK 0x1 FORMAT "%13.11" ECU_ADDRESS 0x600231F9
 /begin IF_DATA XCPplus 0x0102
  /begin DAQ_EVENT VARIABLE /end DAQ_EVENT
 /end IF_DATA
/end MEASUREMENT
/begin MEASUREMENT BrkBst_bBkupModPerdReq "Periodic backup mode pump request" UBYTE B_TRUE 1 100 0.00 1.00000000000 BIT_MASK 0x1 FORMAT "%13.11" ECU_ADDRESS 0x600231F8
 /begin IF_DATA XCPplus 0x0102
  /begin DAQ_EVENT VARIABLE /end DAQ_EVENT
 /end IF_DATA
/end MEASUREMENT
/begin MEASUREMENT BrkBst_bBkupOvrnDetd "Overrun detected in backup mode" UBYTE B_TRUE 1 100 0.00 1.00000000000 BIT_MASK 0x1 FORMAT "%13.11" ECU_ADDRESS 0x600231F7
 /begin IF_DATA XCPplus 0x0102
  /begin DAQ_EVENT VARIABLE /end DAQ_EVENT
 /end IF_DATA
/end MEASUREMENT
/begin MEASUREMENT BrkBst_bIniPmpReq "State of EVP activation request from initial pump request mode" UBYTE B_TRUE 1 100 0.00 1.00000000000 BIT_MASK 0x1 FORMAT "%13.11" ECU_ADDRESS 0x600231F6
 /begin IF_DATA XCPplus 0x0102
  /begin DAQ_EVENT VARIABLE /end DAQ_EVENT
 /end IF_DATA
/end MEASUREMENT
/begin MEASUREMENT BrkBst_bIniReq "Ini request" UBYTE B_TRUE 1 100 0.00 1.00000000000 BIT_MASK 0x1 FORMAT "%13.11" ECU_ADDRESS 0x600231F5
 /begin IF_DATA XCPplus 0x0102
  /begin DAQ_EVENT VARIABLE /end DAQ_EVENT
 /end IF_DATA
/end MEASUREMENT
/begin MEASUREMENT BrkBst_bNormPmpReq "Brake Booster vacuum pump normal mode pump request" UBYTE B_TRUE 1 100 0.00 1.00000000000 BIT_MASK 0x1 FORMAT "%13.11" ECU_ADDRESS 0x600231F4
 /begin IF_DATA XCPplus 0x0102
  /begin DAQ_EVENT VARIABLE /end DAQ_EVENT
 /end IF_DATA
/end MEASUREMENT
/begin MEASUREMENT BrkBst_bPmpActvnCondEn "State of Pre-Condition to enable Pump Activation" UBYTE B_TRUE 1 100 0.00 1.00000000000 BIT_MASK 0x1 FORMAT "%13.11" ECU_ADDRESS 0x600231F3
 /begin IF_DATA XCPplus 0x0102
  /begin DAQ_EVENT VARIABLE /end DAQ_EVENT
 /end IF_DATA
/end MEASUREMENT
/begin MEASUREMENT BrkBst_bPmpReq "Pump ON or OFF request from pump control logic" UBYTE B_TRUE 1 100 0.00 1.00000000000 BIT_MASK 0x1 FORMAT "%13.11" ECU_ADDRESS 0x600234E6
 /begin IF_DATA XCPplus 0x0102
  /begin DAQ_EVENT VARIABLE /end DAQ_EVENT
 /end IF_DATA
/end MEASUREMENT
/begin MEASUREMENT BrkBst_bPmpReqBrkPed "State of EVP activation request triggered by brake pedal action(pressed or released)" UBYTE B_TRUE 1 100 0.00 1.00000000000 BIT_MASK 0x1 FORMAT "%13.11" ECU_ADDRESS 0x600231F2
 /begin IF_DATA XCPplus 0x0102
  /begin DAQ_EVENT VARIABLE /end DAQ_EVENT
 /end IF_DATA
/end MEASUREMENT
/begin MEASUREMENT BrkBst_bPmpReqInActvPmp "State of EVP activation request triggered by EVP inactivity for a calibratable time." UBYTE B_TRUE 1 100 0.00 1.00000000000 BIT_MASK 0x1 FORMAT "%13.11" ECU_ADDRESS 0x600231F1
 /begin IF_DATA XCPplus 0x0102
  /begin DAQ_EVENT VARIABLE /end DAQ_EVENT
 /end IF_DATA
/end MEASUREMENT
/begin MEASUREMENT BrkBst_bStdPmpReq "Brake booster pump activation request fom standard pump operation" UBYTE B_TRUE 1 100 0.00 1.00000000000 BIT_MASK 0x1 FORMAT "%13.11" ECU_ADDRESS 0x600231F0
 /begin IF_DATA XCPplus 0x0102
  /begin DAQ_EVENT VARIABLE /end DAQ_EVENT
 /end IF_DATA
/end MEASUREMENT
/begin MEASUREMENT BrkBst_bTstModReq "Pump activation request because of test routine" UBYTE B_TRUE 1 100 0.00 1.00000000000 BIT_MASK 0x1 FORMAT "%13.11" ECU_ADDRESS 0x600231EF
 /begin IF_DATA XCPplus 0x0102
  /begin DAQ_EVENT VARIABLE /end DAQ_EVENT
 /end IF_DATA
/end MEASUREMENT
/begin MEASUREMENT BrkBst_flgBkupModActv "Status of back up mode" UBYTE B_TRUE 1 100 0.00 1.00000000000 BIT_MASK 0x1 FORMAT "%13.11" ECU_ADDRESS 0x600234E5
 /begin IF_DATA XCPplus 0x0102
  /begin DAQ_EVENT VARIABLE /end DAQ_EVENT
 /end IF_DATA
/end MEASUREMENT
/begin MEASUREMENT BrkBst_flgPBasdReq "flag of pump request based on pressure inputs" UBYTE B_TRUE 1 100 0.00 1.00000000000 BIT_MASK 0x1 FORMAT "%13.11" ECU_ADDRESS 0x600231EE
 /begin IF_DATA XCPplus 0x0102
  /begin DAQ_EVENT VARIABLE /end DAQ_EVENT
 /end IF_DATA
/end MEASUREMENT
/begin MEASUREMENT BrkBst_flgPmpActvn "flag of pump activation status based on pressure inputs" UBYTE B_TRUE 1 100 0.00 1.00000000000 BIT_MASK 0x1 FORMAT "%13.11" ECU_ADDRESS 0x600231ED
 /begin IF_DATA XCPplus 0x0102
  /begin DAQ_EVENT VARIABLE /end DAQ_EVENT
 /end IF_DATA
/end MEASUREMENT
/begin MEASUREMENT BrkBst_flgTstAbort "Abort condition of test routine fulfilled" UBYTE B_TRUE 1 100 0.00 1.00000000000 BIT_MASK 0x1 FORMAT "%13.11" ECU_ADDRESS 0x600231EC
 /begin IF_DATA XCPplus 0x0102
  /begin DAQ_EVENT VARIABLE /end DAQ_EVENT
 /end IF_DATA
/end MEASUREMENT
/begin MEASUREMENT BrkBst_flgTstStrtCdn "Start conditions of the test routine fulfilled" UBYTE B_TRUE 1 100 0.00 1.00000000000 BIT_MASK 0x1 FORMAT "%13.11" ECU_ADDRESS 0x600231EB
 /begin IF_DATA XCPplus 0x0102
  /begin DAQ_EVENT VARIABLE /end DAQ_EVENT
 /end IF_DATA
/end MEASUREMENT
/begin MEASUREMENT BrkBst_flgVehStat "flag of vehicle static condition" UBYTE B_TRUE 1 100 0.00 1.00000000000 BIT_MASK 0x1 FORMAT "%13.11" ECU_ADDRESS 0x600231EA
 /begin IF_DATA XCPplus 0x0102
  /begin DAQ_EVENT VARIABLE /end DAQ_EVENT
 /end IF_DATA
/end MEASUREMENT
/begin MEASUREMENT BrkBst_pEnv "Atmospheric pressure" SWORD Pres_hPa 1 100 -32768.00 32767.00 FORMAT "%8.2" ECU_ADDRESS 0x6001F5D8
 /begin IF_DATA XCPplus 0x0102
  /begin DAQ_EVENT VARIABLE /end DAQ_EVENT
 /end IF_DATA
/end MEASUREMENT
/begin MEASUREMENT BrkBst_pPmpOffThd "Pump off threshold" SWORD Pres_hPa 1 100 -32768.00 32767.00 FORMAT "%8.2" ECU_ADDRESS 0x6001FC22
 /begin IF_DATA XCPplus 0x0102
  /begin DAQ_EVENT VARIABLE /end DAQ_EVENT
 /end IF_DATA
/end MEASUREMENT
/begin MEASUREMENT BrkBst_pRel "Relative Brake Booster pressure" SWORD Pres_hPa 1 100 -32768.00 32767.00 FORMAT "%8.2" ECU_ADDRESS 0x6001F5D6
 /begin IF_DATA XCPplus 0x0102
  /begin DAQ_EVENT VARIABLE /end DAQ_EVENT
 /end IF_DATA
/end MEASUREMENT
/begin MEASUREMENT BrkBst_pThdPmpReqOff "Pump off pressure threshold" SWORD Pres_hPa 1 100 -32768.00 32767.00 FORMAT "%8.2" ECU_ADDRESS 0x6001F5D4
 /begin IF_DATA XCPplus 0x0102
  /begin DAQ_EVENT VARIABLE /end DAQ_EVENT
 /end IF_DATA
/end MEASUREMENT
/begin MEASUREMENT BrkBst_pThdPmpReqOn "Pump on pressure threshold" SWORD Pres_hPa 1 100 -32768.00 32767.00 FORMAT "%8.2" ECU_ADDRESS 0x6001F5D2
 /begin IF_DATA XCPplus 0x0102
  /begin DAQ_EVENT VARIABLE /end DAQ_EVENT
 /end IF_DATA
/end MEASUREMENT
/begin MEASUREMENT BrkBst_pTstStop "Pressure at the moment the test routine finish successfully" SWORD Pres_hPa 1 100 -32768.00 32767.00 FORMAT "%8.2" ECU_ADDRESS 0x6001F5D0
 /begin IF_DATA XCPplus 0x0102
  /begin DAQ_EVENT VARIABLE /end DAQ_EVENT
 /end IF_DATA
/end MEASUREMENT
/begin MEASUREMENT BrkBst_pTstStrt "Pressure at the moment the test routine starts successfully" SWORD Pres_hPa 1 100 -32768.00 32767.00 FORMAT "%8.2" ECU_ADDRESS 0x6001F5CE
 /begin IF_DATA XCPplus 0x0102
  /begin DAQ_EVENT VARIABLE /end DAQ_EVENT
 /end IF_DATA
/end MEASUREMENT
/begin MEASUREMENT BrkBst_stActvModeOld "Last Active mode to request EVP activation" UBYTE OneToOne 1 100 0.00 255.0 FORMAT "%5.1" ECU_ADDRESS 0x600231E9
 /begin IF_DATA XCPplus 0x0102
  /begin DAQ_EVENT VARIABLE /end DAQ_EVENT
 /end IF_DATA
/end MEASUREMENT
/begin MEASUREMENT BrkBst_stBkupPmpReq "Pump request status in backup mode" UBYTE B_TRUE 1 100 0.00 1.00000000000 BIT_MASK 0x1 FORMAT "%13.11" ECU_ADDRESS 0x600231E8
 /begin IF_DATA XCPplus 0x0102
  /begin DAQ_EVENT VARIABLE /end DAQ_EVENT
 /end IF_DATA
/end MEASUREMENT
/begin MEASUREMENT BrkBst_stDfcHeal "Overrun diagnosis heal status" UBYTE B_TRUE 1 100 0.00 1.00000000000 BIT_MASK 0x1 FORMAT "%13.11" ECU_ADDRESS 0x600231E7
 /begin IF_DATA XCPplus 0x0102
  /begin DAQ_EVENT VARIABLE /end DAQ_EVENT
 /end IF_DATA
/end MEASUREMENT
/begin MEASUREMENT BrkBst_stTst "Current status of the test routine" UBYTE OneToOne 1 100 0.00 255.0 FORMAT "%5.1" ECU_ADDRESS 0x600231E6
 /begin IF_DATA XCPplus 0x0102
  /begin DAQ_EVENT VARIABLE /end DAQ_EVENT
 /end IF_DATA
/end MEASUREMENT
/begin MEASUREMENT BrkBst_stTstCbk "Current status of the test routine according callback function" UBYTE OneToOne 1 100 0.00 255.0 FORMAT "%5.1" ECU_ADDRESS 0x600231E5
 /begin IF_DATA XCPplus 0x0102
  /begin DAQ_EVENT VARIABLE /end DAQ_EVENT
 /end IF_DATA
/end MEASUREMENT
/begin MEASUREMENT BrkBst_stTstrReq "Status of test request" UWORD OneToOne 1 100 0.00 65535.00 FORMAT "%8.2" ECU_ADDRESS 0x6001F5CC
 /begin IF_DATA XCPplus 0x0102
  /begin DAQ_EVENT VARIABLE /end DAQ_EVENT
 /end IF_DATA
/end MEASUREMENT
/begin MEASUREMENT BrkBst_tiTstRun "Total run time if test routine is finished successfully" UWORD Time_s 1 100 0.00 655.3500 FORMAT "%8.4" ECU_ADDRESS 0x6001F5CA
 /begin IF_DATA XCPplus 0x0102
  /begin DAQ_EVENT VARIABLE /end DAQ_EVENT
 /end IF_DATA
/end MEASUREMENT
/begin MEASUREMENT BrkTqEv_tqBrkDesPrimAxle "limited brake torque of the primary axle" SLONG TrqPrpHigh 1 100 -214748364.800 214748364.700 FORMAT "%13.3" ECU_ADDRESS 0x60000FBC
 /begin IF_DATA XCPplus 0x0102
  /begin DAQ_EVENT VARIABLE /end DAQ_EVENT
 /end IF_DATA
/end MEASUREMENT
/begin MEASUREMENT BrkTqEv_tqRcptPrimAxle "requested brake torque of the primary axle" SLONG TrqPrpHigh 1 100 -214748364.800 214748364.700 FORMAT "%13.3" ECU_ADDRESS 0x60000FB8
 /begin IF_DATA XCPplus 0x0102
  /begin DAQ_EVENT VARIABLE /end DAQ_EVENT
 /end IF_DATA
/end MEASUREMENT
/begin MEASUREMENT Brk_cntrErrPlaus "Counter of the Error Counter Diagnosis" UBYTE OneToOne 1 100 0.00 255.0 FORMAT "%5.1" ECU_ADDRESS 0x60036000
 /begin IF_DATA XCPplus 0x0102
  /begin DAQ_EVENT VARIABLE /end DAQ_EVENT
 /end IF_DATA
/end MEASUREMENT
/begin MEASUREMENT Brk_flgDiagPlausEna "Flag to enable the Brake plausible error check diagnosis" UBYTE B_TRUE 1 100 0.00 1.00000000000 BIT_MASK 0x1 FORMAT "%13.11" ECU_ADDRESS 0x70000293
 /begin IF_DATA XCPplus 0x0102
  /begin DAQ_EVENT VARIABLE /end DAQ_EVENT
 /end IF_DATA
/end MEASUREMENT
/begin MEASUREMENT Brk_flgMaiSnsrDetd "main brake switch auto detection successful" UBYTE B_TRUE 1 100 0.00 1.00000000000 BIT_MASK 0x1 FORMAT "%13.11" ECU_ADDRESS 0x60034952
 /begin IF_DATA XCPplus 0x0102
  /begin DAQ_EVENT VARIABLE /end DAQ_EVENT
 /end IF_DATA
/end MEASUREMENT
/begin MEASUREMENT Brk_flgPlaus1ChkErr "Flag to indicate the plausible error of brake switch information" UBYTE B_TRUE 1 100 0.00 1.00000000000 BIT_MASK 0x1 FORMAT "%13.11" ECU_ADDRESS 0x700001C7
 /begin IF_DATA XCPplus 0x0102
  /begin DAQ_EVENT VARIABLE /end DAQ_EVENT
 /end IF_DATA
/end MEASUREMENT
/begin MEASUREMENT Brk_flgPlaus1ChkOk "Flag to indicate the healing condition of brake plausible check" UBYTE B_TRUE 1 100 0.00 1.00000000000 BIT_MASK 0x1 FORMAT "%13.11" ECU_ADDRESS 0x700001C6
 /begin IF_DATA XCPplus 0x0102
  /begin DAQ_EVENT VARIABLE /end DAQ_EVENT
 /end IF_DATA
/end MEASUREMENT
/begin MEASUREMENT Brk_flgPlaus1RstDiag "Flag to indicate the reset of brake plausible error by DSM clear" UBYTE B_TRUE 1 100 0.00 1.00000000000 BIT_MASK 0x1 FORMAT "%13.11" ECU_ADDRESS 0x700001C5
 /begin IF_DATA XCPplus 0x0102
  /begin DAQ_EVENT VARIABLE /end DAQ_EVENT
 /end IF_DATA
/end MEASUREMENT
/begin MEASUREMENT Brk_flgRdntSnsr "redundant brake switch status from DIO" UBYTE B_TRUE 1 100 0.00 1.00000000000 BIT_MASK 0x1 FORMAT "%13.11" ECU_ADDRESS 0x70000292
 /begin IF_DATA XCPplus 0x0102
  /begin DAQ_EVENT VARIABLE /end DAQ_EVENT
 /end IF_DATA
/end MEASUREMENT
/begin MEASUREMENT Brk_flgRdntSnsrDetd "redundant brake switch auto detection successful" UBYTE B_TRUE 1 100 0.00 1.00000000000 BIT_MASK 0x1 FORMAT "%13.11" ECU_ADDRESS 0x60034951
 /begin IF_DATA XCPplus 0x0102
  /begin DAQ_EVENT VARIABLE /end DAQ_EVENT
 /end IF_DATA
/end MEASUREMENT
/begin MEASUREMENT Brk_flgRdntSnsrRaw "raw redundant brake switch status from DIO" UBYTE B_TRUE 1 100 0.00 1.00000000000 BIT_MASK 0x1 FORMAT "%13.11" ECU_ADDRESS 0x70000291
 /begin IF_DATA XCPplus 0x0102
  /begin DAQ_EVENT VARIABLE /end DAQ_EVENT
 /end IF_DATA
/end MEASUREMENT
/begin MEASUREMENT Brk_r_GASWT_I.stHLR_I "Class for the calculation of the brake pedal position and the brake pedal status via ADC / Hysteresis for conversion of Adc to Dio Signal" UBYTE B_TRUE 1 100 0.00 1.00000000000 BIT_MASK 0x1 FORMAT "%13.11" ECU_ADDRESS 0x70001338 /end MEASUREMENT
/begin MEASUREMENT Brk_st "Brake switch state" UBYTE OneToOne 1 100 0.00 255.0 FORMAT "%5.1" ECU_ADDRESS 0x60023679
 /begin IF_DATA XCPplus 0x0102
  /begin DAQ_EVENT VARIABLE /end DAQ_EVENT
 /end IF_DATA
/end MEASUREMENT
/begin MEASUREMENT Brk_stMn "State main brake switch" UBYTE B_TRUE 1 100 0.00 1.00000000000 BIT_MASK 0x1 FORMAT "%13.11" ECU_ADDRESS 0x600234E3
 /begin IF_DATA XCPplus 0x0102
  /begin DAQ_EVENT VARIABLE /end DAQ_EVENT
 /end IF_DATA
/end MEASUREMENT
/begin MEASUREMENT Brk_stMnRaw "State main brake switch, raw value" UBYTE B_TRUE 1 100 0.00 1.00000000000 BIT_MASK 0x1 FORMAT "%13.11" ECU_ADDRESS 0x600234E2
 /begin IF_DATA XCPplus 0x0102
  /begin DAQ_EVENT VARIABLE /end DAQ_EVENT
 /end IF_DATA
/end MEASUREMENT
/begin MEASUREMENT Brk_stMn_Sq "State main brake switch signal qualifier" UBYTE SigQly_COMPU_VERB 1 100 0.00 15.0000000000 FORMAT "%13.10" ECU_ADDRESS 0x60023678
 /begin IF_DATA XCPplus 0x0102
  /begin DAQ_EVENT VARIABLE /end DAQ_EVENT
 /end IF_DATA
/end MEASUREMENT
/begin MEASUREMENT Brk_stQly "Signal quality of Brk_st" UBYTE OneToOne 1 100 0.00 255.0 FORMAT "%5.1" ECU_ADDRESS 0x600231E4
 /begin IF_DATA XCPplus 0x0102
  /begin DAQ_EVENT VARIABLE /end DAQ_EVENT
 /end IF_DATA
/end MEASUREMENT
/begin MEASUREMENT Brk_stRed "State redundant brake switch" UBYTE B_TRUE 1 100 0.00 1.00000000000 BIT_MASK 0x1 FORMAT "%13.11" ECU_ADDRESS 0x600234E1
 /begin IF_DATA XCPplus 0x0102
  /begin DAQ_EVENT VARIABLE /end DAQ_EVENT
 /end IF_DATA
/end MEASUREMENT
/begin MEASUREMENT Brk_stRedRaw "State redundant brake switch, raw value" UBYTE B_TRUE 1 100 0.00 1.00000000000 BIT_MASK 0x1 FORMAT "%13.11" ECU_ADDRESS 0x600234E0
 /begin IF_DATA XCPplus 0x0102
  /begin DAQ_EVENT VARIABLE /end DAQ_EVENT
 /end IF_DATA
/end MEASUREMENT
/begin MEASUREMENT Brk_stRed_Sq "State redundant brake switch signal qualifier" UBYTE SigQly_COMPU_VERB 1 100 0.00 15.0000000000 FORMAT "%13.10" ECU_ADDRESS 0x60023677
 /begin IF_DATA XCPplus 0x0102
  /begin DAQ_EVENT VARIABLE /end DAQ_EVENT
 /end IF_DATA
/end MEASUREMENT
/begin MEASUREMENT Brk_st_Sq "Signal quality for brake status" UBYTE SigQly_COMPU_VERB 1 100 0.00 15.0000000000 FORMAT "%13.10" ECU_ADDRESS 0x60023676
 /begin IF_DATA XCPplus 0x0102
  /begin DAQ_EVENT VARIABLE /end DAQ_EVENT
 /end IF_DATA
/end MEASUREMENT
/begin MEASUREMENT CanEif_bCleanend "End of electronic integration frame (nominal mode)" UBYTE OneToOne 1 100 0.00 1.000 BIT_MASK 0x1 FORMAT "%5.3" ECU_ADDRESS 0x60023899
 /begin IF_DATA XCPplus 0x0102
  /begin DAQ_EVENT VARIABLE /end DAQ_EVENT
 /end IF_DATA
/end MEASUREMENT
/begin MEASUREMENT CanEif_bDiag "Disturbing diagnosis during mode electronic integration frame must be inhibited" UBYTE B_TRUE 1 100 0.00 1.00000000000 BIT_MASK 0x1 FORMAT "%13.11" ECU_ADDRESS 0x700014AA
 /begin IF_DATA XCPplus 0x0102
  /begin DAQ_EVENT VARIABLE /end DAQ_EVENT
 /end IF_DATA
/end MEASUREMENT
/begin MEASUREMENT CanEif_bMainWkupExit "Main Wake-Up condition for CanEif" UBYTE OneToOne 1 100 0.00 255.0 BIT_MASK 0x1 FORMAT "%5.1" ECU_ADDRESS 0x60023749
 /begin IF_DATA XCPplus 0x0102
  /begin DAQ_EVENT VARIABLE /end DAQ_EVENT
 /end IF_DATA
/end MEASUREMENT
/begin MEASUREMENT CanEif_bMode "Request of mode electronic integration frame required" UBYTE B_TRUE 1 100 0.00 1.00000000000 BIT_MASK 0x1 FORMAT "%13.11" ECU_ADDRESS 0x700014A9
 /begin IF_DATA XCPplus 0x0102
  /begin DAQ_EVENT VARIABLE /end DAQ_EVENT
 /end IF_DATA
/end MEASUREMENT
/begin MEASUREMENT CanEif_bProcessNewFrame "Process new frame" UBYTE OneToOne 1 100 0.00 1.000 BIT_MASK 0x1 FORMAT "%5.3" ECU_ADDRESS 0x60023898
 /begin IF_DATA XCPplus 0x0102
  /begin DAQ_EVENT VARIABLE /end DAQ_EVENT
 /end IF_DATA
/end MEASUREMENT
/begin MEASUREMENT CanEif_bProg "Condition ECU downloaded" UBYTE OneToOne 1 100 0.00 1.000 BIT_MASK 0x1 FORMAT "%5.3" ECU_ADDRESS 0x60023897
 /begin IF_DATA XCPplus 0x0102
  /begin DAQ_EVENT VARIABLE /end DAQ_EVENT
 /end IF_DATA
/end MEASUREMENT
/begin MEASUREMENT CanEif_bRcwLow "Condition : leave without delay the main wake-up and elec. integration frame on B_rcd trouble" UBYTE OneToOne 1 100 0.00 1.000 BIT_MASK 0x1 FORMAT "%5.3" ECU_ADDRESS 0x60023896
 /begin IF_DATA XCPplus 0x0102
  /begin DAQ_EVENT VARIABLE /end DAQ_EVENT
 /end IF_DATA
/end MEASUREMENT
/begin MEASUREMENT CanEif_bVehSpdVld "Vehicle Speed validity check for CanEif" UBYTE OneToOne 1 100 0.00 255.0 BIT_MASK 0x1 FORMAT "%5.1" ECU_ADDRESS 0x60023748
 /begin IF_DATA XCPplus 0x0102
  /begin DAQ_EVENT VARIABLE /end DAQ_EVENT
 /end IF_DATA
/end MEASUREMENT
/begin MEASUREMENT CanEif_ctDelay "Delay counter used to handle the 1sec delay within which three consecutive identical electronic integration frames must be received before processing a new electronic integration request" UBYTE OneToOne 1 100 0.00 255.0 FORMAT "%5.1" ECU_ADDRESS 0x600231E3
 /begin IF_DATA XCPplus 0x0102
  /begin DAQ_EVENT VARIABLE /end DAQ_EVENT
 /end IF_DATA
/end MEASUREMENT
/begin MEASUREMENT CanEif_ctIdentFr "Counter of consecutive identical electronic integration frames received since the 1sec timer was started" UBYTE OneToOne 1 100 0.00 255.0 FORMAT "%5.1" ECU_ADDRESS 0x600231E2
 /begin IF_DATA XCPplus 0x0102
  /begin DAQ_EVENT VARIABLE /end DAQ_EVENT
 /end IF_DATA
/end MEASUREMENT
/begin MEASUREMENT CanEif_flgDiagon "EI operating mode left on loss of security conditions (DiagMuxOn == TRUE)" UBYTE OneToOne 1 100 0.00 1.000 BIT_MASK 0x1 FORMAT "%5.3" ECU_ADDRESS 0x60023895
 /begin IF_DATA XCPplus 0x0102
  /begin DAQ_EVENT VARIABLE /end DAQ_EVENT
 /end IF_DATA
/end MEASUREMENT
/begin MEASUREMENT CanEif_stCmdByte "Variable holding the value of the pending electronic integration request that still need to be confirmed" UBYTE OneToOne 1 100 0.00 255.0 FORMAT "%5.1" ECU_ADDRESS 0x600231E1
 /begin IF_DATA XCPplus 0x0102
  /begin DAQ_EVENT VARIABLE /end DAQ_EVENT
 /end IF_DATA
/end MEASUREMENT
/begin MEASUREMENT CanEif_stReqHSN1_CANTx "Variable used to stop transmission of frames in EI mode" UBYTE OneToOne 1 100 0.00 255.0 FORMAT "%5.1" ECU_ADDRESS 0x6002387A
 /begin IF_DATA XCPplus 0x0102
  /begin DAQ_EVENT VARIABLE /end DAQ_EVENT
 /end IF_DATA
/end MEASUREMENT
/begin MEASUREMENT CanEif_stReqHSN3_CANTx "Variable used to stop transmission of frames in EI mode" UBYTE OneToOne 1 100 0.00 255.0 FORMAT "%5.1" ECU_ADDRESS 0x60023879
 /begin IF_DATA XCPplus 0x0102
  /begin DAQ_EVENT VARIABLE /end DAQ_EVENT
 /end IF_DATA
/end MEASUREMENT
/begin MEASUREMENT Com_092RxFlg "Flag to indicate if 0x92 frame is received" UBYTE OneToOne 1 100 0.00 255.0 FORMAT "%5.1" ECU_ADDRESS 0x600231E0
 /begin IF_DATA XCPplus 0x0102
  /begin DAQ_EVENT VARIABLE /end DAQ_EVENT
 /end IF_DATA
/end MEASUREMENT
/begin MEASUREMENT Com_EIModeEntryCond "Variable used to indicate if entry conditions are satisfied" UWORD OneToOne 1 100 0.00 65535.00 FORMAT "%8.2" ECU_ADDRESS 0x6001FD20
 /begin IF_DATA XCPplus 0x0102
  /begin DAQ_EVENT VARIABLE /end DAQ_EVENT
 /end IF_DATA
/end MEASUREMENT
/begin MEASUREMENT Com_EIModeExitCond "Variable used to indicate if exit conditions are satisfied" UWORD OneToOne 1 100 0.00 65535.00 FORMAT "%8.2" ECU_ADDRESS 0x6001FD1E
 /begin IF_DATA XCPplus 0x0102
  /begin DAQ_EVENT VARIABLE /end DAQ_EVENT
 /end IF_DATA
/end MEASUREMENT
/begin MEASUREMENT Com_stCANEif "Command byte received within last electronic integration frame 092h, or 0xFF if no frame has been received within the last 100ms" UBYTE OneToOne 1 100 0.00 255.0 FORMAT "%5.1" ECU_ADDRESS 0x60023832
 /begin IF_DATA XCPplus 0x0102
  /begin DAQ_EVENT VARIABLE /end DAQ_EVENT
 /end IF_DATA
/end MEASUREMENT
/begin MEASUREMENT DDRC_ctArDebLvl.DFC_CANTRCV_E_NO_TRCV_CONTROL_0 "" SWORD DFC_OneToOne 1 100 -32768.00 32767.00 FORMAT "%8.2" ECU_ADDRESS 0x60021F58 /end MEASUREMENT
/begin MEASUREMENT DDRC_ctArDebLvl.DFC_CAN_E_TIMEOUT "" SWORD DFC_OneToOne 1 100 -32768.00 32767.00 FORMAT "%8.2" ECU_ADDRESS 0x60021F5A /end MEASUREMENT
/begin MEASUREMENT DDRC_St.DFC_BrkBstPmpActtnDfct "" ULONG DFC_OneToOne 1 100 0.00 536870911.000 BIT_MASK 0x1fffffff FORMAT "%13.3" ECU_ADDRESS 0x6001C200 /end MEASUREMENT
/begin MEASUREMENT DDRC_St.DFC_BrkBstPmpDeactvnDfct "" ULONG DFC_OneToOne 1 100 0.00 536870911.000 BIT_MASK 0x1fffffff FORMAT "%13.3" ECU_ADDRESS 0x6001C204 /end MEASUREMENT
/begin MEASUREMENT DDRC_St.DFC_BrkBstPmpPLeakDfct "" ULONG DFC_OneToOne 1 100 0.00 536870911.000 BIT_MASK 0x1fffffff FORMAT "%13.3" ECU_ADDRESS 0x6001C480 /end MEASUREMENT
/begin MEASUREMENT DDRC_St.DFC_BattUBMaxBatt "" ULONG DFC_OneToOne 1 100 0.00 536870911.000 BIT_MASK 0x1fffffff FORMAT "%13.3" ECU_ADDRESS 0x6001C984 /end MEASUREMENT
/begin MEASUREMENT DDRC_St.DFC_BattUBMaxNoBatt "" ULONG DFC_OneToOne 1 100 0.00 536870911.000 BIT_MASK 0x1fffffff FORMAT "%13.3" ECU_ADDRESS 0x6001C988 /end MEASUREMENT
/begin MEASUREMENT DDRC_St.DFC_BattUBMinBatt "" ULONG DFC_OneToOne 1 100 0.00 536870911.000 BIT_MASK 0x1fffffff FORMAT "%13.3" ECU_ADDRESS 0x6001C98C /end MEASUREMENT
/begin MEASUREMENT DDRC_St.DFC_BattUBMinNoBatt "" ULONG DFC_OneToOne 1 100 0.00 536870911.000 BIT_MASK 0x1fffffff FORMAT "%13.3" ECU_ADDRESS 0x6001C990 /end MEASUREMENT
/begin MEASUREMENT DDRC_St.DFC_BattUSRCMax "" ULONG DFC_OneToOne 1 100 0.00 536870911.000 BIT_MASK 0x1fffffff FORMAT "%13.3" ECU_ADDRESS 0x6001C994 /end MEASUREMENT
/begin MEASUREMENT DDRC_St.DFC_BattUSRCMin "" ULONG DFC_OneToOne 1 100 0.00 536870911.000 BIT_MASK 0x1fffffff FORMAT "%13.3" ECU_ADDRESS 0x6001C998 /end MEASUREMENT
/begin MEASUREMENT DDRC_St.DFC_BrkBstPHiCautionDfct "" ULONG DFC_OneToOne 1 100 0.00 536870911.000 BIT_MASK 0x1fffffff FORMAT "%13.3" ECU_ADDRESS 0x6001C99C /end MEASUREMENT
/begin MEASUREMENT DDRC_St.DFC_BrkBstPHiWarnDfct "" ULONG DFC_OneToOne 1 100 0.00 536870911.000 BIT_MASK 0x1fffffff FORMAT "%13.3" ECU_ADDRESS 0x6001C9A0 /end MEASUREMENT
/begin MEASUREMENT DDRC_St.DFC_BrkBstPSnsr12PlausDfct "" ULONG DFC_OneToOne 1 100 0.00 536870911.000 BIT_MASK 0x1fffffff FORMAT "%13.3" ECU_ADDRESS 0x6001C9A4 /end MEASUREMENT
/begin MEASUREMENT DDRC_St.DFC_BrkBstPSnsr1Scb "" ULONG DFC_OneToOne 1 100 0.00 536870911.000 BIT_MASK 0x1fffffff FORMAT "%13.3" ECU_ADDRESS 0x6001C9A8 /end MEASUREMENT
/begin MEASUREMENT DDRC_St.DFC_BrkBstPSnsr1Scg "" ULONG DFC_OneToOne 1 100 0.00 536870911.000 BIT_MASK 0x1fffffff FORMAT "%13.3" ECU_ADDRESS 0x6001C9AC /end MEASUREMENT
/begin MEASUREMENT DDRC_St.DFC_BrkBstPSnsr2Scb "" ULONG DFC_OneToOne 1 100 0.00 536870911.000 BIT_MASK 0x1fffffff FORMAT "%13.3" ECU_ADDRESS 0x6001C9B0 /end MEASUREMENT
/begin MEASUREMENT DDRC_St.DFC_BrkBstPSnsr2Scg "" ULONG DFC_OneToOne 1 100 0.00 536870911.000 BIT_MASK 0x1fffffff FORMAT "%13.3" ECU_ADDRESS 0x6001C9B4 /end MEASUREMENT
/begin MEASUREMENT DDRC_St.DFC_BrkBstPSnsrMax "" ULONG DFC_OneToOne 1 100 0.00 536870911.000 BIT_MASK 0x1fffffff FORMAT "%13.3" ECU_ADDRESS 0x6001C9B8 /end MEASUREMENT
/begin MEASUREMENT DDRC_St.DFC_BrkBstPSnsrMin "" ULONG DFC_OneToOne 1 100 0.00 536870911.000 BIT_MASK 0x1fffffff FORMAT "%13.3" ECU_ADDRESS 0x6001C9BC /end MEASUREMENT
/begin MEASUREMENT DDRC_St.DFC_BrkBstPhyRngChkMax "" ULONG DFC_OneToOne 1 100 0.00 536870911.000 BIT_MASK 0x1fffffff FORMAT "%13.3" ECU_ADDRESS 0x6001C9C0 /end MEASUREMENT
/begin MEASUREMENT DDRC_St.DFC_BrkBstPhyRngChkMin "" ULONG DFC_OneToOne 1 100 0.00 536870911.000 BIT_MASK 0x1fffffff FORMAT "%13.3" ECU_ADDRESS 0x6001C9C4 /end MEASUREMENT
/begin MEASUREMENT DDRC_St.DFC_BrkBstPmpHsScb "" ULONG DFC_OneToOne 1 100 0.00 536870911.000 BIT_MASK 0x1fffffff FORMAT "%13.3" ECU_ADDRESS 0x6001C9C8 /end MEASUREMENT
/begin MEASUREMENT DDRC_St.DFC_BrkBstPmpHsScg "" ULONG DFC_OneToOne 1 100 0.00 536870911.000 BIT_MASK 0x1fffffff FORMAT "%13.3" ECU_ADDRESS 0x6001C9CC /end MEASUREMENT
/begin MEASUREMENT DDRC_St.DFC_BrkBstPmpLsOl "" ULONG DFC_OneToOne 1 100 0.00 536870911.000 BIT_MASK 0x1fffffff FORMAT "%13.3" ECU_ADDRESS 0x6001C9D0 /end MEASUREMENT
/begin MEASUREMENT DDRC_St.DFC_BrkBstPmpLsScb "" ULONG DFC_OneToOne 1 100 0.00 536870911.000 BIT_MASK 0x1fffffff FORMAT "%13.3" ECU_ADDRESS 0x6001C9D4 /end MEASUREMENT
/begin MEASUREMENT DDRC_St.DFC_BrkBstPmpLsScg "" ULONG DFC_OneToOne 1 100 0.00 536870911.000 BIT_MASK 0x1fffffff FORMAT "%13.3" ECU_ADDRESS 0x6001C9D8 /end MEASUREMENT
/begin MEASUREMENT DDRC_St.DFC_BrkBstPmpPlausGenn "" UWORD DFC_OneToOne 1 100 0.00 8191.000 BIT_MASK 0x1fff FORMAT "%8.3" ECU_ADDRESS 0x60022036 /end MEASUREMENT
/begin MEASUREMENT DDRC_stLstRprtEve.DFC_CANTRCV_E_NO_TRCV_CONTROL_0 "" UBYTE DDRC_LstRprtEve_VERB 1 100 0.00 255.000000000 FORMAT "%13.9" ECU_ADDRESS 0x6002496A /end MEASUREMENT
/begin MEASUREMENT DDRC_stLstRprtEve.DFC_CAN_E_TIMEOUT "" UBYTE DDRC_LstRprtEve_VERB 1 100 0.00 255.000000000 FORMAT "%13.9" ECU_ADDRESS 0x6002496B /end MEASUREMENT
/begin MEASUREMENT DFC_st.DFC_BrkBstPmpActtnDfct "" UBYTE DFC_OneToOne 1 100 0.00 255.0 FORMAT "%5.1" ECU_ADDRESS 0x600349E3 /end MEASUREMENT
/begin MEASUREMENT DFC_st.DFC_BrkBstPmpDeactvnDfct "" UBYTE DFC_OneToOne 1 100 0.00 255.0 FORMAT "%5.1" ECU_ADDRESS 0x600349E4 /end MEASUREMENT
/begin MEASUREMENT DFC_st.DFC_BrkBstPmpPLeakDfct "" UBYTE DFC_OneToOne 1 100 0.00 255.0 FORMAT "%5.1" ECU_ADDRESS 0x60034A83 /end MEASUREMENT
/begin MEASUREMENT DFC_st.DFC_BattUBMaxBatt "" UBYTE DFC_OneToOne 1 100 0.00 255.0 FORMAT "%5.1" ECU_ADDRESS 0x60034BC4 /end MEASUREMENT
/begin MEASUREMENT DFC_st.DFC_BattUBMaxNoBatt "" UBYTE DFC_OneToOne 1 100 0.00 255.0 FORMAT "%5.1" ECU_ADDRESS 0x60034BC5 /end MEASUREMENT
/begin MEASUREMENT DFC_st.DFC_BattUBMinBatt "" UBYTE DFC_OneToOne 1 100 0.00 255.0 FORMAT "%5.1" ECU_ADDRESS 0x60034BC6 /end MEASUREMENT
/begin MEASUREMENT DFC_st.DFC_BattUBMinNoBatt "" UBYTE DFC_OneToOne 1 100 0.00 255.0 FORMAT "%5.1" ECU_ADDRESS 0x60034BC7 /end MEASUREMENT
/begin MEASUREMENT DFC_st.DFC_BattUSRCMax "" UBYTE DFC_OneToOne 1 100 0.00 255.0 FORMAT "%5.1" ECU_ADDRESS 0x60034BC8 /end MEASUREMENT
/begin MEASUREMENT DFC_st.DFC_BattUSRCMin "" UBYTE DFC_OneToOne 1 100 0.00 255.0 FORMAT "%5.1" ECU_ADDRESS 0x60034BC9 /end MEASUREMENT
/begin MEASUREMENT DFC_st.DFC_BrkBstPHiCautionDfct "" UBYTE DFC_OneToOne 1 100 0.00 255.0 FORMAT "%5.1" ECU_ADDRESS 0x60034BCA /end MEASUREMENT
/begin MEASUREMENT DFC_st.DFC_BrkBstPHiWarnDfct "" UBYTE DFC_OneToOne 1 100 0.00 255.0 FORMAT "%5.1" ECU_ADDRESS 0x60034BCB /end MEASUREMENT
/begin MEASUREMENT DFC_st.DFC_BrkBstPSnsr12PlausDfct "" UBYTE DFC_OneToOne 1 100 0.00 255.0 FORMAT "%5.1" ECU_ADDRESS 0x60034BCC /end MEASUREMENT
/begin MEASUREMENT DFC_st.DFC_BrkBstPSnsr1Scb "" UBYTE DFC_OneToOne 1 100 0.00 255.0 FORMAT "%5.1" ECU_ADDRESS 0x60034BCD /end MEASUREMENT
/begin MEASUREMENT DFC_st.DFC_BrkBstPSnsr1Scg "" UBYTE DFC_OneToOne 1 100 0.00 255.0 FORMAT "%5.1" ECU_ADDRESS 0x60034BCE /end MEASUREMENT
/begin MEASUREMENT DFC_st.DFC_BrkBstPSnsr2Scb "" UBYTE DFC_OneToOne 1 100 0.00 255.0 FORMAT "%5.1" ECU_ADDRESS 0x60034BCF /end MEASUREMENT
/begin MEASUREMENT DFC_st.DFC_BrkBstPSnsr2Scg "" UBYTE DFC_OneToOne 1 100 0.00 255.0 FORMAT "%5.1" ECU_ADDRESS 0x60034BD0 /end MEASUREMENT
/begin MEASUREMENT DFC_st.DFC_BrkBstPSnsrMax "" UBYTE DFC_OneToOne 1 100 0.00 255.0 FORMAT "%5.1" ECU_ADDRESS 0x60034BD1 /end MEASUREMENT
/begin MEASUREMENT DFC_st.DFC_BrkBstPSnsrMin "" UBYTE DFC_OneToOne 1 100 0.00 255.0 FORMAT "%5.1" ECU_ADDRESS 0x60034BD2 /end MEASUREMENT
/begin MEASUREMENT DFC_st.DFC_BrkBstPhyRngChkMax "" UBYTE DFC_OneToOne 1 100 0.00 255.0 FORMAT "%5.1" ECU_ADDRESS 0x60034BD3 /end MEASUREMENT
/begin MEASUREMENT DFC_st.DFC_BrkBstPhyRngChkMin "" UBYTE DFC_OneToOne 1 100 0.00 255.0 FORMAT "%5.1" ECU_ADDRESS 0x60034BD4 /end MEASUREMENT
/begin MEASUREMENT DFC_st.DFC_BrkBstPmpHsScb "" UBYTE DFC_OneToOne 1 100 0.00 255.0 FORMAT "%5.1" ECU_ADDRESS 0x60034BD5 /end MEASUREMENT
/begin MEASUREMENT DFC_st.DFC_BrkBstPmpHsScg "" UBYTE DFC_OneToOne 1 100 0.00 255.0 FORMAT "%5.1" ECU_ADDRESS 0x60034BD6 /end MEASUREMENT
/begin MEASUREMENT DFC_st.DFC_BrkBstPmpLsOl "" UBYTE DFC_OneToOne 1 100 0.00 255.0 FORMAT "%5.1" ECU_ADDRESS 0x60034BD7 /end MEASUREMENT
/begin MEASUREMENT DFC_st.DFC_BrkBstPmpLsScb "" UBYTE DFC_OneToOne 1 100 0.00 255.0 FORMAT "%5.1" ECU_ADDRESS 0x60034BD8 /end MEASUREMENT
/begin MEASUREMENT DFC_st.DFC_BrkBstPmpLsScg "" UBYTE DFC_OneToOne 1 100 0.00 255.0 FORMAT "%5.1" ECU_ADDRESS 0x60034BD9 /end MEASUREMENT
/begin MEASUREMENT DFC_st.DFC_BrkBstPmpPlausGenn "" UBYTE DFC_OneToOne 1 100 0.00 255.0 FORMAT "%5.1" ECU_ADDRESS 0x60034C72 /end MEASUREMENT
/begin MEASUREMENT DFC_st.DFC_CANTRCV_E_NO_TRCV_CONTROL_0 "" UBYTE DFC_OneToOne 1 100 0.00 255.0 FORMAT "%5.1" ECU_ADDRESS 0x60034C96 /end MEASUREMENT
/begin MEASUREMENT DFC_st.DFC_CAN_E_TIMEOUT "" UBYTE DFC_OneToOne 1 100 0.00 255.0 FORMAT "%5.1" ECU_ADDRESS 0x60034C97 /end MEASUREMENT
/begin MEASUREMENT DFC_st.DFC_BattUPwrFail "" UBYTE DFC_OneToOne 1 100 0.00 255.0 FORMAT "%5.1" ECU_ADDRESS 0x60034CB0 /end MEASUREMENT
/begin MEASUREMENT DFC_st.DFC_BrkBstBkupOvrn "" UBYTE DFC_OneToOne 1 100 0.00 255.0 FORMAT "%5.1" ECU_ADDRESS 0x60034CB1 /end MEASUREMENT
/begin MEASUREMENT DFC_st.DFC_BrkBstPmpOvld "" UBYTE DFC_OneToOne 1 100 0.00 255.0 FORMAT "%5.1" ECU_ADDRESS 0x60034CB2 /end MEASUREMENT
/begin MEASUREMENT DFC_st.DFC_BrkPlausChk "" UBYTE DFC_OneToOne 1 100 0.00 255.0 FORMAT "%5.1" ECU_ADDRESS 0x60034CB3 /end MEASUREMENT
/begin MEASUREMENT DINH_nrActvInhReas.FId_BattUDiagEna "" UWORD DINH_ct_Compu 1 100 -4095.000 4096.000 BIT_MASK 0x1fff FORMAT "%8.3" ECU_ADDRESS 0x60021322 /end MEASUREMENT
/begin MEASUREMENT DINH_nrActvInhReas.FId_BattUReplcmt "" UWORD DINH_ct_Compu 1 100 -4095.000 4096.000 BIT_MASK 0x1fff FORMAT "%8.3" ECU_ADDRESS 0x60021326 /end MEASUREMENT
/begin MEASUREMENT DINH_nrActvInhReas.FId_BattUVehVVld "" UWORD DINH_ct_Compu 1 100 -4095.000 4096.000 BIT_MASK 0x1fff FORMAT "%8.3" ECU_ADDRESS 0x60021328 /end MEASUREMENT
/begin MEASUREMENT DINH_nrActvInhReas.FId_BlwrComErr "" UWORD DINH_ct_Compu 1 100 -4095.000 4096.000 BIT_MASK 0x1fff FORMAT "%8.3" ECU_ADDRESS 0x6002132A /end MEASUREMENT
/begin MEASUREMENT DINH_nrActvInhReas.FId_BrkBstBrkSt "" UWORD DINH_ct_Compu 1 100 -4095.000 4096.000 BIT_MASK 0x1fff FORMAT "%8.3" ECU_ADDRESS 0x6002132C /end MEASUREMENT
/begin MEASUREMENT DINH_nrActvInhReas.FId_BrkBstP "" UWORD DINH_ct_Compu 1 100 -4095.000 4096.000 BIT_MASK 0x1fff FORMAT "%8.3" ECU_ADDRESS 0x6002132E /end MEASUREMENT
/begin MEASUREMENT DINH_nrActvInhReas.FId_BrkBstPEnaPrc "" UWORD DINH_ct_Compu 1 100 -4095.000 4096.000 BIT_MASK 0x1fff FORMAT "%8.3" ECU_ADDRESS 0x60021330 /end MEASUREMENT
/begin MEASUREMENT DINH_nrActvInhReas.FId_BrkBstPFrzVal "" UWORD DINH_ct_Compu 1 100 -4095.000 4096.000 BIT_MASK 0x1fff FORMAT "%8.3" ECU_ADDRESS 0x60021332 /end MEASUREMENT
/begin MEASUREMENT DINH_nrActvInhReas.FId_BrkBstPPlaus12FrznDfct "" UWORD DINH_ct_Compu 1 100 -4095.000 4096.000 BIT_MASK 0x1fff FORMAT "%8.3" ECU_ADDRESS 0x60021334 /end MEASUREMENT
/begin MEASUREMENT DINH_nrActvInhReas.FId_BrkBstPPlaus12ReplcmtDfct "" UWORD DINH_ct_Compu 1 100 -4095.000 4096.000 BIT_MASK 0x1fff FORMAT "%8.3" ECU_ADDRESS 0x60021336 /end MEASUREMENT
/begin MEASUREMENT DINH_nrActvInhReas.FId_BrkBstPReplVal "" UWORD DINH_ct_Compu 1 100 -4095.000 4096.000 BIT_MASK 0x1fff FORMAT "%8.3" ECU_ADDRESS 0x60021338 /end MEASUREMENT
/begin MEASUREMENT DINH_nrActvInhReas.FId_BrkBstPSnsr1FrzDfct "" UWORD DINH_ct_Compu 1 100 -4095.000 4096.000 BIT_MASK 0x1fff FORMAT "%8.3" ECU_ADDRESS 0x6002133A /end MEASUREMENT
/begin MEASUREMENT DINH_nrActvInhReas.FId_BrkBstPSnsr1ReplcmtDfct "" UWORD DINH_ct_Compu 1 100 -4095.000 4096.000 BIT_MASK 0x1fff FORMAT "%8.3" ECU_ADDRESS 0x6002133C /end MEASUREMENT
/begin MEASUREMENT DINH_nrActvInhReas.FId_BrkBstPSnsr1SplyDfct "" UWORD DINH_ct_Compu 1 100 -4095.000 4096.000 BIT_MASK 0x1fff FORMAT "%8.3" ECU_ADDRESS 0x6002133E /end MEASUREMENT
/begin MEASUREMENT DINH_nrActvInhReas.FId_BrkBstPSnsr2FrzDfct "" UWORD DINH_ct_Compu 1 100 -4095.000 4096.000 BIT_MASK 0x1fff FORMAT "%8.3" ECU_ADDRESS 0x60021340 /end MEASUREMENT
/begin MEASUREMENT DINH_nrActvInhReas.FId_BrkBstPSnsr2ReplcmtDfct "" UWORD DINH_ct_Compu 1 100 -4095.000 4096.000 BIT_MASK 0x1fff FORMAT "%8.3" ECU_ADDRESS 0x60021342 /end MEASUREMENT
/begin MEASUREMENT DINH_nrActvInhReas.FId_BrkBstPSnsr2SplyDfct "" UWORD DINH_ct_Compu 1 100 -4095.000 4096.000 BIT_MASK 0x1fff FORMAT "%8.3" ECU_ADDRESS 0x60021344 /end MEASUREMENT
/begin MEASUREMENT DINH_nrActvInhReas.FId_BrkBstPmpActtnDiagEnad "" UWORD DINH_ct_Compu 1 100 -4095.000 4096.000 BIT_MASK 0x1fff FORMAT "%8.3" ECU_ADDRESS 0x60021346 /end MEASUREMENT
/begin MEASUREMENT DINH_nrActvInhReas.FId_BrkBstPmpDeactvnDiagEnad "" UWORD DINH_ct_Compu 1 100 -4095.000 4096.000 BIT_MASK 0x1fff FORMAT "%8.3" ECU_ADDRESS 0x60021348 /end MEASUREMENT
/begin MEASUREMENT DINH_nrActvInhReas.FId_BrkBstPmpLeakDiagEnad "" UWORD DINH_ct_Compu 1 100 -4095.000 4096.000 BIT_MASK 0x1fff FORMAT "%8.3" ECU_ADDRESS 0x6002134A /end MEASUREMENT
/begin MEASUREMENT DINH_nrActvInhReas.FId_BrkBstPmpM1Err "" UWORD DINH_ct_Compu 1 100 -4095.000 4096.000 BIT_MASK 0x1fff FORMAT "%8.3" ECU_ADDRESS 0x6002134C /end MEASUREMENT
/begin MEASUREMENT DINH_nrActvInhReas.FId_BrkBstPmpM2Err "" UWORD DINH_ct_Compu 1 100 -4095.000 4096.000 BIT_MASK 0x1fff FORMAT "%8.3" ECU_ADDRESS 0x6002134E /end MEASUREMENT
/begin MEASUREMENT DINH_nrActvInhReas.FId_BrkBstPmpScgLsErr "" UWORD DINH_ct_Compu 1 100 -4095.000 4096.000 BIT_MASK 0x1fff FORMAT "%8.3" ECU_ADDRESS 0x60021350 /end MEASUREMENT
/begin MEASUREMENT DINH_nrActvInhReas.FId_BrkBstPmpVacChkEna "" UWORD DINH_ct_Compu 1 100 -4095.000 4096.000 BIT_MASK 0x1fff FORMAT "%8.3" ECU_ADDRESS 0x60021352 /end MEASUREMENT
/begin MEASUREMENT DINH_nrActvInhReas.FId_BrkBstTst "" UWORD DINH_ct_Compu 1 100 -4095.000 4096.000 BIT_MASK 0x1fff FORMAT "%8.3" ECU_ADDRESS 0x60021354 /end MEASUREMENT
/begin MEASUREMENT DINH_nrActvInhReas.FId_BrkPlaus1Ena "" UWORD DINH_ct_Compu 1 100 -4095.000 4096.000 BIT_MASK 0x1fff FORMAT "%8.3" ECU_ADDRESS 0x60021356 /end MEASUREMENT
/begin MEASUREMENT DINH_nrActvInhReas.FId_BrkSigMaiCanFrzVal "" UWORD DINH_ct_Compu 1 100 -4095.000 4096.000 BIT_MASK 0x1fff FORMAT "%8.3" ECU_ADDRESS 0x6002135A /end MEASUREMENT
/begin MEASUREMENT DINH_nrActvInhReas.FId_BrkSigMaiCanReplVal "" UWORD DINH_ct_Compu 1 100 -4095.000 4096.000 BIT_MASK 0x1fff FORMAT "%8.3" ECU_ADDRESS 0x6002135C /end MEASUREMENT
/begin MEASUREMENT DINH_nrActvInhReas.FId_BrkStMnFinalDfct "" UWORD DINH_ct_Compu 1 100 -4095.000 4096.000 BIT_MASK 0x1fff FORMAT "%8.3" ECU_ADDRESS 0x6002135E /end MEASUREMENT
/begin MEASUREMENT DINH_nrActvInhReas.FId_BrkStMnPrelDfct "" UWORD DINH_ct_Compu 1 100 -4095.000 4096.000 BIT_MASK 0x1fff FORMAT "%8.3" ECU_ADDRESS 0x60021360 /end MEASUREMENT
/begin MEASUREMENT DINH_nrActvInhReas.FId_BrkStRdntFinalDfct "" UWORD DINH_ct_Compu 1 100 -4095.000 4096.000 BIT_MASK 0x1fff FORMAT "%8.3" ECU_ADDRESS 0x60021362 /end MEASUREMENT
/begin MEASUREMENT DINH_nrActvInhReas.FId_BrkStRdntPrelDfct "" UWORD DINH_ct_Compu 1 100 -4095.000 4096.000 BIT_MASK 0x1fff FORMAT "%8.3" ECU_ADDRESS 0x60021364 /end MEASUREMENT
/begin MEASUREMENT DINH_nrActvInhReas.FId_CanEifVehSpdVld "" UWORD DINH_ct_Compu 1 100 -4095.000 4096.000 BIT_MASK 0x1fff FORMAT "%8.3" ECU_ADDRESS 0x60021366 /end MEASUREMENT
/begin MEASUREMENT DINH_nrActvInhReas.FId_FiMFID_test "" UWORD DINH_ct_Compu 1 100 -4095.000 4096.000 BIT_MASK 0x1fff FORMAT "%8.3" ECU_ADDRESS 0x6002148A /end MEASUREMENT
/begin MEASUREMENT DINH_nrActvInhReas.FId_bInhCanEif_HVBAT_NGTV_CONTACTOR_STS "" UWORD DINH_ct_Compu 1 100 -4095.000 4096.000 BIT_MASK 0x1fff FORMAT "%8.3" ECU_ADDRESS 0x600215C4 /end MEASUREMENT
/begin MEASUREMENT DINH_nrActvInhReas.FId_bInhCanEif_HVBAT_PRECHRG_CONTACTOR_STS "" UWORD DINH_ct_Compu 1 100 -4095.000 4096.000 BIT_MASK 0x1fff FORMAT "%8.3" ECU_ADDRESS 0x600215C6 /end MEASUREMENT
/begin MEASUREMENT DINH_nrActvInhReas.FId_bInhCanEif_HVBAT_PSTV_CONTACTOR_STS "" UWORD DINH_ct_Compu 1 100 -4095.000 4096.000 BIT_MASK 0x1fff FORMAT "%8.3" ECU_ADDRESS 0x600215C8 /end MEASUREMENT
/begin MEASUREMENT DINH_nrActvInhReas.FId_bInhCanEif_VCU_eBCCM_432h "" UWORD DINH_ct_Compu 1 100 -4095.000 4096.000 BIT_MASK 0x1fff FORMAT "%8.3" ECU_ADDRESS 0x600215CA /end MEASUREMENT
/begin MEASUREMENT DINH_stFId.FId_BattUDiagEna "" UWORD DFC_OneToOne 1 100 0.00 65535.00 FORMAT "%8.2" ECU_ADDRESS 0x60021322 /end MEASUREMENT
/begin MEASUREMENT DINH_stFId.FId_BattUReplcmt "" UWORD DFC_OneToOne 1 100 0.00 65535.00 FORMAT "%8.2" ECU_ADDRESS 0x60021326 /end MEASUREMENT
/begin MEASUREMENT DINH_stFId.FId_BattUVehVVld "" UWORD DFC_OneToOne 1 100 0.00 65535.00 FORMAT "%8.2" ECU_ADDRESS 0x60021328 /end MEASUREMENT
/begin MEASUREMENT DINH_stFId.FId_BlwrComErr "" UWORD DFC_OneToOne 1 100 0.00 65535.00 FORMAT "%8.2" ECU_ADDRESS 0x6002132A /end MEASUREMENT
/begin MEASUREMENT DINH_stFId.FId_BrkBstBrkSt "" UWORD DFC_OneToOne 1 100 0.00 65535.00 FORMAT "%8.2" ECU_ADDRESS 0x6002132C /end MEASUREMENT
/begin MEASUREMENT DINH_stFId.FId_BrkBstP "" UWORD DFC_OneToOne 1 100 0.00 65535.00 FORMAT "%8.2" ECU_ADDRESS 0x6002132E /end MEASUREMENT
/begin MEASUREMENT DINH_stFId.FId_BrkBstPEnaPrc "" UWORD DFC_OneToOne 1 100 0.00 65535.00 FORMAT "%8.2" ECU_ADDRESS 0x60021330 /end MEASUREMENT
/begin MEASUREMENT DINH_stFId.FId_BrkBstPFrzVal "" UWORD DFC_OneToOne 1 100 0.00 65535.00 FORMAT "%8.2" ECU_ADDRESS 0x60021332 /end MEASUREMENT
/begin MEASUREMENT DINH_stFId.FId_BrkBstPPlaus12FrznDfct "" UWORD DFC_OneToOne 1 100 0.00 65535.00 FORMAT "%8.2" ECU_ADDRESS 0x60021334 /end MEASUREMENT
/begin MEASUREMENT DINH_stFId.FId_BrkBstPPlaus12ReplcmtDfct "" UWORD DFC_OneToOne 1 100 0.00 65535.00 FORMAT "%8.2" ECU_ADDRESS 0x60021336 /end MEASUREMENT
/begin MEASUREMENT DINH_stFId.FId_BrkBstPReplVal "" UWORD DFC_OneToOne 1 100 0.00 65535.00 FORMAT "%8.2" ECU_ADDRESS 0x60021338 /end MEASUREMENT
/begin MEASUREMENT DINH_stFId.FId_BrkBstPSnsr1FrzDfct "" UWORD DFC_OneToOne 1 100 0.00 65535.00 FORMAT "%8.2" ECU_ADDRESS 0x6002133A /end MEASUREMENT
/begin MEASUREMENT DINH_stFId.FId_BrkBstPSnsr1ReplcmtDfct "" UWORD DFC_OneToOne 1 100 0.00 65535.00 FORMAT "%8.2" ECU_ADDRESS 0x6002133C /end MEASUREMENT
/begin MEASUREMENT DINH_stFId.FId_BrkBstPSnsr1SplyDfct "" UWORD DFC_OneToOne 1 100 0.00 65535.00 FORMAT "%8.2" ECU_ADDRESS 0x6002133E /end MEASUREMENT
/begin MEASUREMENT DINH_stFId.FId_BrkBstPSnsr2FrzDfct "" UWORD DFC_OneToOne 1 100 0.00 65535.00 FORMAT "%8.2" ECU_ADDRESS 0x60021340 /end MEASUREMENT
/begin MEASUREMENT DINH_stFId.FId_BrkBstPSnsr2ReplcmtDfct "" UWORD DFC_OneToOne 1 100 0.00 65535.00 FORMAT "%8.2" ECU_ADDRESS 0x60021342 /end MEASUREMENT
/begin MEASUREMENT DINH_stFId.FId_BrkBstPSnsr2SplyDfct "" UWORD DFC_OneToOne 1 100 0.00 65535.00 FORMAT "%8.2" ECU_ADDRESS 0x60021344 /end MEASUREMENT
/begin MEASUREMENT DINH_stFId.FId_BrkBstPmpActtnDiagEnad "" UWORD DFC_OneToOne 1 100 0.00 65535.00 FORMAT "%8.2" ECU_ADDRESS 0x60021346 /end MEASUREMENT
/begin MEASUREMENT DINH_stFId.FId_BrkBstPmpDeactvnDiagEnad "" UWORD DFC_OneToOne 1 100 0.00 65535.00 FORMAT "%8.2" ECU_ADDRESS 0x60021348 /end MEASUREMENT
/begin MEASUREMENT DINH_stFId.FId_BrkBstPmpLeakDiagEnad "" UWORD DFC_OneToOne 1 100 0.00 65535.00 FORMAT "%8.2" ECU_ADDRESS 0x6002134A /end MEASUREMENT
/begin MEASUREMENT DINH_stFId.FId_BrkBstPmpM1Err "" UWORD DFC_OneToOne 1 100 0.00 65535.00 FORMAT "%8.2" ECU_ADDRESS 0x6002134C /end MEASUREMENT
/begin MEASUREMENT DINH_stFId.FId_BrkBstPmpM2Err "" UWORD DFC_OneToOne 1 100 0.00 65535.00 FORMAT "%8.2" ECU_ADDRESS 0x6002134E /end MEASUREMENT
/begin MEASUREMENT DINH_stFId.FId_BrkBstPmpScgLsErr "" UWORD DFC_OneToOne 1 100 0.00 65535.00 FORMAT "%8.2" ECU_ADDRESS 0x60021350 /end MEASUREMENT
/begin MEASUREMENT DINH_stFId.FId_BrkBstPmpVacChkEna "" UWORD DFC_OneToOne 1 100 0.00 65535.00 FORMAT "%8.2" ECU_ADDRESS 0x60021352 /end MEASUREMENT
/begin MEASUREMENT DINH_stFId.FId_BrkBstTst "" UWORD DFC_OneToOne 1 100 0.00 65535.00 FORMAT "%8.2" ECU_ADDRESS 0x60021354 /end MEASUREMENT
/begin MEASUREMENT DINH_stFId.FId_BrkPlaus1Ena "" UWORD DFC_OneToOne 1 100 0.00 65535.00 FORMAT "%8.2" ECU_ADDRESS 0x60021356 /end MEASUREMENT
/begin MEASUREMENT DINH_stFId.FId_BrkSigMaiCanFrzVal "" UWORD DFC_OneToOne 1 100 0.00 65535.00 FORMAT "%8.2" ECU_ADDRESS 0x6002135A /end MEASUREMENT
/begin MEASUREMENT DINH_stFId.FId_BrkSigMaiCanReplVal "" UWORD DFC_OneToOne 1 100 0.00 65535.00 FORMAT "%8.2" ECU_ADDRESS 0x6002135C /end MEASUREMENT
/begin MEASUREMENT DINH_stFId.FId_BrkStMnFinalDfct "" UWORD DFC_OneToOne 1 100 0.00 65535.00 FORMAT "%8.2" ECU_ADDRESS 0x6002135E /end MEASUREMENT
/begin MEASUREMENT DINH_stFId.FId_BrkStMnPrelDfct "" UWORD DFC_OneToOne 1 100 0.00 65535.00 FORMAT "%8.2" ECU_ADDRESS 0x60021360 /end MEASUREMENT
/begin MEASUREMENT DINH_stFId.FId_BrkStRdntFinalDfct "" UWORD DFC_OneToOne 1 100 0.00 65535.00 FORMAT "%8.2" ECU_ADDRESS 0x60021362 /end MEASUREMENT
/begin MEASUREMENT DINH_stFId.FId_BrkStRdntPrelDfct "" UWORD DFC_OneToOne 1 100 0.00 65535.00 FORMAT "%8.2" ECU_ADDRESS 0x60021364 /end MEASUREMENT
/begin MEASUREMENT DINH_stFId.FId_CanEifVehSpdVld "" UWORD DFC_OneToOne 1 100 0.00 65535.00 FORMAT "%8.2" ECU_ADDRESS 0x60021366 /end MEASUREMENT
/begin MEASUREMENT DINH_stFId.FId_FiMFID_test "" UWORD DFC_OneToOne 1 100 0.00 65535.00 FORMAT "%8.2" ECU_ADDRESS 0x6002148A /end MEASUREMENT
/begin MEASUREMENT DINH_stFId.FId_bInhCanEif_HVBAT_NGTV_CONTACTOR_STS "" UWORD DFC_OneToOne 1 100 0.00 65535.00 FORMAT "%8.2" ECU_ADDRESS 0x600215C4 /end MEASUREMENT
/begin MEASUREMENT DINH_stFId.FId_bInhCanEif_HVBAT_PRECHRG_CONTACTOR_STS "" UWORD DFC_OneToOne 1 100 0.00 65535.00 FORMAT "%8.2" ECU_ADDRESS 0x600215C6 /end MEASUREMENT
/begin MEASUREMENT DINH_stFId.FId_bInhCanEif_HVBAT_PSTV_CONTACTOR_STS "" UWORD DFC_OneToOne 1 100 0.00 65535.00 FORMAT "%8.2" ECU_ADDRESS 0x600215C8 /end MEASUREMENT
/begin MEASUREMENT DINH_stFId.FId_bInhCanEif_VCU_eBCCM_432h "" UWORD DFC_OneToOne 1 100 0.00 65535.00 FORMAT "%8.2" ECU_ADDRESS 0x600215CA /end MEASUREMENT
/begin MEASUREMENT DSQ_st.DSQ_BattU "" UBYTE DFC_OneToOne 1 100 0.00 255.0 FORMAT "%5.1" ECU_ADDRESS 0x60024663 /end MEASUREMENT
/begin MEASUREMENT VehDrvEv_tqPrimAxleDes "desired primary axle torque" SLONG TrqPrpHigh 1 100 -214748364.800 214748364.700 FORMAT "%13.3" ECU_ADDRESS 0x60000F28
 /begin IF_DATA XCPplus 0x0102
  /begin DAQ_EVENT VARIABLE /end DAQ_EVENT
 /end IF_DATA
/end MEASUREMENT
/begin FUNCTION ATS_Std "30000.35.0Handling of actuator test demands with diagnostics"
 /begin DEF_CHARACTERISTIC AcChrgrIntkT_ATS_ATS.LimitTypeMsk_C AcChrgrIntkT_ATS_ATS.CnvNorm_C AcChrgrIntkT_ATS_ATS.LowLim_C AcChrgrIntkT_ATS_ATS.UpLim_C AcChrgrIntkT_ATS_ATS.CnvFac_C AcChrgrIntkT_ATS_ATS.CnvOfs_C AcChrgrIntkT_ATS_ATS.DfltVal_C ATS_Standby_Disabled_C ATS_tiTstDemHeal_C ATS_tiTstDemMax_C ATS_TmrBehaviour_C ATS_TstDemMaxEngN_C ATS_TstDemMaxVSSCDV_C CbnHeatgSwt_ATS_ATS.LimitTypeMsk_C CbnHeatgSwt_ATS_ATS.CnvNorm_C CbnHeatgSwt_ATS_ATS.LowLim_C CbnHeatgSwt_ATS_ATS.UpLim_C CbnHeatgSwt_ATS_ATS.CnvFac_C CbnHeatgSwt_ATS_ATS.CnvOfs_C CbnHeatgSwt_ATS_ATS.DfltVal_C CcsPwrLineChpRst_O_S_ATS_ATS.LimitTypeMsk_C CcsPwrLineChpRst_O_S_ATS_ATS.CnvNorm_C CcsPwrLineChpRst_O_S_ATS_ATS.LowLim_C CcsPwrLineChpRst_O_S_ATS_ATS.UpLim_C CcsPwrLineChpRst_O_S_ATS_ATS.CnvFac_C CcsPwrLineChpRst_O_S_ATS_ATS.CnvOfs_C CcsPwrLineChpRst_O_S_ATS_ATS.DfltVal_C CcsPwrLineChpVccEna_O_S_ATS_ATS.LimitTypeMsk_C CcsPwrLineChpVccEna_O_S_ATS_ATS.CnvNorm_C CcsPwrLineChpVccEna_O_S_ATS_ATS.LowLim_C CcsPwrLineChpVccEna_O_S_ATS_ATS.UpLim_C CcsPwrLineChpVccEna_O_S_ATS_ATS.CnvFac_C CcsPwrLineChpVccEna_O_S_ATS_ATS.CnvOfs_C CcsPwrLineChpVccEna_O_S_ATS_ATS.DfltVal_C CcsPwrLineChpVcc_ATS_ATS.LimitTypeMsk_C CcsPwrLineChpVcc_ATS_ATS.CnvNorm_C CcsPwrLineChpVcc_ATS_ATS.LowLim_C CcsPwrLineChpVcc_ATS_ATS.UpLim_C CcsPwrLineChpVcc_ATS_ATS.CnvFac_C CcsPwrLineChpVcc_ATS_ATS.CnvOfs_C CcsPwrLineChpVcc_ATS_ATS.DfltVal_C CcsPwrLineComChpT_ATS_ATS.LimitTypeMsk_C CcsPwrLineComChpT_ATS_ATS.CnvNorm_C CcsPwrLineComChpT_ATS_ATS.LowLim_C CcsPwrLineComChpT_ATS_ATS.UpLim_C CcsPwrLineComChpT_ATS_ATS.CnvFac_C CcsPwrLineComChpT_ATS_ATS.CnvOfs_C CcsPwrLineComChpT_ATS_ATS.DfltVal_C CtpCarrFrq_ATS_ATS.LimitTypeMsk_C CtpCarrFrq_ATS_ATS.CnvNorm_C CtpCarrFrq_ATS_ATS.LowLim_C CtpCarrFrq_ATS_ATS.UpLim_C CtpCarrFrq_ATS_ATS.CnvFac_C CtpCarrFrq_ATS_ATS.CnvOfs_C CtpCarrFrq_ATS_ATS.DfltVal_C CtPSwtActr_O_S_ATS_ATS.LimitTypeMsk_C CtPSwtActr_O_S_ATS_ATS.CnvNorm_C CtPSwtActr_O_S_ATS_ATS.LowLim_C CtPSwtActr_O_S_ATS_ATS.UpLim_C CtPSwtActr_O_S_ATS_ATS.CnvFac_C CtPSwtActr_O_S_ATS_ATS.CnvOfs_C CtPSwtActr_O_S_ATS_ATS.DfltVal_C CtPSwtDiag_ATS_ATS.LimitTypeMsk_C CtPSwtDiag_ATS_ATS.CnvNorm_C CtPSwtDiag_ATS_ATS.LowLim_C CtPSwtDiag_ATS_ATS.UpLim_C CtPSwtDiag_ATS_ATS.CnvFac_C CtPSwtDiag_ATS_ATS.CnvOfs_C CtPSwtDiag_ATS_ATS.DfltVal_C DcChrgrIntkT2_ATS_ATS.LimitTypeMsk_C DcChrgrIntkT2_ATS_ATS.CnvNorm_C DcChrgrIntkT2_ATS_ATS.LowLim_C DcChrgrIntkT2_ATS_ATS.UpLim_C DcChrgrIntkT2_ATS_ATS.CnvFac_C DcChrgrIntkT2_ATS_ATS.CnvOfs_C DcChrgrIntkT2_ATS_ATS.DfltVal_C DcChrgrIntkT_ATS_ATS.LimitTypeMsk_C DcChrgrIntkT_ATS_ATS.CnvNorm_C DcChrgrIntkT_ATS_ATS.LowLim_C DcChrgrIntkT_ATS_ATS.UpLim_C DcChrgrIntkT_ATS_ATS.CnvFac_C DcChrgrIntkT_ATS_ATS.CnvOfs_C DcChrgrIntkT_ATS_ATS.DfltVal_C EmWakeupSig_O_S_ATS_ATS.LimitTypeMsk_C EmWakeupSig_O_S_ATS_ATS.CnvNorm_C EmWakeupSig_O_S_ATS_ATS.LowLim_C EmWakeupSig_O_S_ATS_ATS.UpLim_C EmWakeupSig_O_S_ATS_ATS.CnvFac_C EmWakeupSig_O_S_ATS_ATS.CnvOfs_C EmWakeupSig_O_S_ATS_ATS.DfltVal_C FanSpd_ATS_ATS.LimitTypeMsk_C FanSpd_ATS_ATS.CnvNorm_C FanSpd_ATS_ATS.LowLim_C FanSpd_ATS_ATS.UpLim_C FanSpd_ATS_ATS.CnvFac_C FanSpd_ATS_ATS.CnvOfs_C FanSpd_ATS_ATS.DfltVal_C FreonP_ATS_ATS.LimitTypeMsk_C FreonP_ATS_ATS.CnvNorm_C FreonP_ATS_ATS.LowLim_C FreonP_ATS_ATS.UpLim_C FreonP_ATS_ATS.CnvFac_C FreonP_ATS_ATS.CnvOfs_C FreonP_ATS_ATS.DfltVal_C HeatrCoreT_ATS_ATS.LimitTypeMsk_C HeatrCoreT_ATS_ATS.CnvNorm_C HeatrCoreT_ATS_ATS.LowLim_C HeatrCoreT_ATS_ATS.UpLim_C HeatrCoreT_ATS_ATS.CnvFac_C HeatrCoreT_ATS_ATS.CnvOfs_C HeatrCoreT_ATS_ATS.DfltVal_C IntlckChrgPlg_DTYCYC_O_S_ATS_ATS.LimitTypeMsk_C IntlckChrgPlg_DTYCYC_O_S_ATS_ATS.CnvNorm_C IntlckChrgPlg_DTYCYC_O_S_ATS_ATS.LowLim_C IntlckChrgPlg_DTYCYC_O_S_ATS_ATS.UpLim_C IntlckChrgPlg_DTYCYC_O_S_ATS_ATS.CnvFac_C IntlckChrgPlg_DTYCYC_O_S_ATS_ATS.CnvOfs_C IntlckChrgPlg_DTYCYC_O_S_ATS_ATS.DfltVal_C PwmCtP_ATS_ATS.LimitTypeMsk_C PwmCtP_ATS_ATS.CnvNorm_C PwmCtP_ATS_ATS.LowLim_C PwmCtP_ATS_ATS.UpLim_C PwmCtP_ATS_ATS.CnvFac_C PwmCtP_ATS_ATS.CnvOfs_C PwmCtP_ATS_ATS.DfltVal_C PwrDistbnUnitT_ATS_ATS.LimitTypeMsk_C PwrDistbnUnitT_ATS_ATS.CnvNorm_C PwrDistbnUnitT_ATS_ATS.LowLim_C PwrDistbnUnitT_ATS_ATS.UpLim_C PwrDistbnUnitT_ATS_ATS.CnvFac_C PwrDistbnUnitT_ATS_ATS.CnvOfs_C PwrDistbnUnitT_ATS_ATS.DfltVal_C SCtPmp1_DTYCYC_O_S_ATS_ATS.LimitTypeMsk_C SCtPmp1_DTYCYC_O_S_ATS_ATS.CnvNorm_C SCtPmp1_DTYCYC_O_S_ATS_ATS.LowLim_C SCtPmp1_DTYCYC_O_S_ATS_ATS.UpLim_C SCtPmp1_DTYCYC_O_S_ATS_ATS.CnvFac_C SCtPmp1_DTYCYC_O_S_ATS_ATS.CnvOfs_C SCtPmp1_DTYCYC_O_S_ATS_ATS.DfltVal_C SCtPmp1_O_S_ATS_ATS.LimitTypeMsk_C SCtPmp1_O_S_ATS_ATS.CnvNorm_C SCtPmp1_O_S_ATS_ATS.LowLim_C SCtPmp1_O_S_ATS_ATS.UpLim_C SCtPmp1_O_S_ATS_ATS.CnvFac_C SCtPmp1_O_S_ATS_ATS.CnvOfs_C SCtPmp1_O_S_ATS_ATS.DfltVal_C SpplCooltPmpRly_DTYCYC_O_S_ATS_ATS.LimitTypeMsk_C SpplCooltPmpRly_DTYCYC_O_S_ATS_ATS.CnvNorm_C SpplCooltPmpRly_DTYCYC_O_S_ATS_ATS.LowLim_C SpplCooltPmpRly_DTYCYC_O_S_ATS_ATS.UpLim_C SpplCooltPmpRly_DTYCYC_O_S_ATS_ATS.CnvFac_C SpplCooltPmpRly_DTYCYC_O_S_ATS_ATS.CnvOfs_C SpplCooltPmpRly_DTYCYC_O_S_ATS_ATS.DfltVal_C SpplCooltPmpRly_O_S_ATS_ATS.LimitTypeMsk_C SpplCooltPmpRly_O_S_ATS_ATS.CnvNorm_C SpplCooltPmpRly_O_S_ATS_ATS.LowLim_C SpplCooltPmpRly_O_S_ATS_ATS.UpLim_C SpplCooltPmpRly_O_S_ATS_ATS.CnvFac_C SpplCooltPmpRly_O_S_ATS_ATS.CnvOfs_C SpplCooltPmpRly_O_S_ATS_ATS.DfltVal_C UCtP_ATS_ATS.LimitTypeMsk_C UCtP_ATS_ATS.CnvNorm_C UCtP_ATS_ATS.LowLim_C UCtP_ATS_ATS.UpLim_C UCtP_ATS_ATS.CnvFac_C UCtP_ATS_ATS.CnvOfs_C UCtP_ATS_ATS.DfltVal_C UPxP1_ATS_ATS.LimitTypeMsk_C UPxP1_ATS_ATS.CnvNorm_C UPxP1_ATS_ATS.LowLim_C UPxP1_ATS_ATS.UpLim_C UPxP1_ATS_ATS.CnvFac_C UPxP1_ATS_ATS.CnvOfs_C UPxP1_ATS_ATS.DfltVal_C /end DEF_CHARACTERISTIC
 /begin REF_CHARACTERISTIC Airbg_CrashDeploy_ATS_ATS.LimitTypeMsk_C Airbg_CrashDeploy_ATS_ATS.CnvNorm_C Airbg_CrashDeploy_ATS_ATS.LowLim_C Airbg_CrashDeploy_ATS_ATS.UpLim_C Airbg_CrashDeploy_ATS_ATS.CnvFac_C Airbg_CrashDeploy_ATS_ATS.CnvOfs_C Airbg_CrashDeploy_ATS_ATS.DfltVal_C CbnHeatgHeatr_ATS_ATS.LimitTypeMsk_C CbnHeatgHeatr_ATS_ATS.CnvNorm_C CbnHeatgHeatr_ATS_ATS.LowLim_C CbnHeatgHeatr_ATS_ATS.UpLim_C CbnHeatgHeatr_ATS_ATS.CnvFac_C CbnHeatgHeatr_ATS_ATS.CnvOfs_C CbnHeatgHeatr_ATS_ATS.DfltVal_C DcChrgnRlyNeg_O_S_ATS_ATS.LimitTypeMsk_C DcChrgnRlyNeg_O_S_ATS_ATS.CnvNorm_C DcChrgnRlyNeg_O_S_ATS_ATS.LowLim_C DcChrgnRlyNeg_O_S_ATS_ATS.UpLim_C DcChrgnRlyNeg_O_S_ATS_ATS.CnvFac_C DcChrgnRlyNeg_O_S_ATS_ATS.CnvOfs_C DcChrgnRlyNeg_O_S_ATS_ATS.DfltVal_C DcChrgnRlyPos_O_S_ATS_ATS.LimitTypeMsk_C DcChrgnRlyPos_O_S_ATS_ATS.CnvNorm_C DcChrgnRlyPos_O_S_ATS_ATS.LowLim_C DcChrgnRlyPos_O_S_ATS_ATS.UpLim_C DcChrgnRlyPos_O_S_ATS_ATS.CnvFac_C DcChrgnRlyPos_O_S_ATS_ATS.CnvOfs_C DcChrgnRlyPos_O_S_ATS_ATS.DfltVal_C /end REF_CHARACTERISTIC
 /begin IN_MEASUREMENT Epm_nEngLRes T15_st VehV_v /end IN_MEASUREMENT
 /begin OUT_MEASUREMENT ATS_ctCurRunTst ATS_stMon ATS_stMonTimeLimit /end OUT_MEASUREMENT
 /begin LOC_MEASUREMENT ATS_IntvVal_mp ATS_TstStatus_mp /end LOC_MEASUREMENT
 FUNCTION_VERSION "30000.35.0" /end FUNCTION
/begin FUNCTION AVSExtd_Std "30000.0.0 Adjustment Value Service extended" FUNCTION_VERSION "30000.0.0" /end FUNCTION
/begin FUNCTION AVS_Std "30000.16.0Adjustment Value Service" FUNCTION_VERSION "30000.16.0" /end FUNCTION
/begin FUNCTION BattU_DD "2.17.0    Battery Voltage Acquisition Device Driver"
 /begin DEF_CHARACTERISTIC BattU_uSrcMaxThd_C BattU_uSrcMinThd_C BattU_uTransf_CUR DDRC_DurDeb.BattU_tiMaxDebOk_C DDRC_DurDeb.BattU_tiMaxDebDef_C DDRC_DurDeb.BattU_tiMinDebOk_C DDRC_DurDeb.BattU_tiMinDebDef_C DDRC_RatDeb.BattU_tiMaxUDRat_C DDRC_RatDeb.BattU_tiMinUDRat_C DFC_CtlMsk2.DFC_BattUSRCMax_C DFC_CtlMsk2.DFC_BattUSRCMin_C DFC_DisblMsk2.DFC_BattUSRCMax_C DFC_DisblMsk2.DFC_BattUSRCMin_C /end DEF_CHARACTERISTIC
 /begin IN_MEASUREMENT MRly_stAct /end IN_MEASUREMENT
 /begin OUT_MEASUREMENT BattU_uRaw BattU_uSens1 DDRC_St.DFC_BattUSRCMax DDRC_St.DFC_BattUSRCMin DFC_st.DFC_BattUSRCMax DFC_st.DFC_BattUSRCMin /end OUT_MEASUREMENT
 /begin LOC_MEASUREMENT BattU_uRawBuf /end LOC_MEASUREMENT
 FUNCTION_VERSION "2.17.0" /end FUNCTION
/begin FUNCTION BattU_PwrFail "2.6.0     Battery Voltage Powerfail Detection" /begin OUT_MEASUREMENT BattU_stPwrFail /end OUT_MEASUREMENT FUNCTION_VERSION "2.6.0" /end FUNCTION
/begin FUNCTION BattU_UStbyDia "2.2.0     Diagnosis of stand-by power supply line"
 /begin DEF_CHARACTERISTIC BattU_ctPwrFailDebErr_C BattU_tiEcuOn_C DFC_CtlMsk2.DFC_BattUPwrFail_C DFC_DisblMsk2.DFC_BattUPwrFail_C /end DEF_CHARACTERISTIC
 /begin IN_MEASUREMENT BattU_stPwrFail /end IN_MEASUREMENT
 /begin OUT_MEASUREMENT DFC_st.DFC_BattUPwrFail /end OUT_MEASUREMENT
 /begin LOC_MEASUREMENT BattU_ctPwrFailErr_mp BattU_flgDiagInvld BattU_flgECUOn BattU_flgRprtOnce BattU_flgRstDebCntr /end LOC_MEASUREMENT
 FUNCTION_VERSION "2.2.0" /end FUNCTION
/begin FUNCTION BattU_VD "2.17.0    Battery Voltage Acquisition Virtual Device"
 /begin DEF_CHARACTERISTIC BattU_cfgUBChkRelsCdn_C BattU_iMinThdDcdc BattU_maskVehVVldSq_C BattU_swtCorFacActv_C BattU_swtLvDcdcSplyPosSignI_C BattU_swtRated_C BattU_swtReplcmtVal_C BattU_tiDebDcdcSply_C BattU_uDfl_C BattU_uMaxThdBatt_C BattU_uMaxThdNoBatt_C BattU_uMinThdBatt_C BattU_uMinThdNoBatt_C BattU_uNrm_C BattU_VD_maskBattU_u_Sq_C BattU_vUBChkLim_C DDRC_DurDeb.BattU_tiMaxBattDebOk_C DDRC_DurDeb.BattU_tiMaxBattDebDef_C DDRC_DurDeb.BattU_tiMaxNoBattDebOk_C DDRC_DurDeb.BattU_tiMaxNoBattDebDef_C DDRC_DurDeb.BattU_tiMinBattDebOk_C DDRC_DurDeb.BattU_tiMinBattDebDef_C DDRC_DurDeb.BattU_tiMinNoBattDebOk_C DDRC_DurDeb.BattU_tiMinNoBattDebDef_C DDRC_RatDeb.BattU_tiMaxBattUDRat_C DDRC_RatDeb.BattU_tiMaxNoBattUDRat_C DDRC_RatDeb.BattU_tiMinBattUDRat_C DDRC_RatDeb.BattU_tiMinNoBattUDRat_C DFC_CtlMsk2.DFC_BattUBMaxBatt_C DFC_CtlMsk2.DFC_BattUBMaxNoBatt_C DFC_CtlMsk2.DFC_BattUBMinBatt_C DFC_CtlMsk2.DFC_BattUBMinNoBatt_C DFC_DisblMsk2.DFC_BattUBMaxBatt_C DFC_DisblMsk2.DFC_BattUBMaxNoBatt_C DFC_DisblMsk2.DFC_BattUBMinBatt_C DFC_DisblMsk2.DFC_BattUBMinNoBatt_C /end DEF_CHARACTERISTIC
 /begin IN_MEASUREMENT BattU_uSens1 Dcdc_iLvAct MRly_stAct SyC_stSub VehV_v VehV_v_Sq /end IN_MEASUREMENT
 /begin OUT_MEASUREMENT BattU_facCor BattU_u BattU_uPID42 BattU_uRated BattU_uSens BattU_u_Sq DDRC_St.DFC_BattUBMaxBatt DDRC_St.DFC_BattUBMaxNoBatt DDRC_St.DFC_BattUBMinBatt DDRC_St.DFC_BattUBMinNoBatt DFC_st.DFC_BattUBMaxBatt DFC_st.DFC_BattUBMaxNoBatt DFC_st.DFC_BattUBMinBatt DFC_st.DFC_BattUBMinNoBatt DINH_nrActvInhReas.FId_BattUDiagEna DINH_nrActvInhReas.FId_BattUReplcmt DINH_nrActvInhReas.FId_BattUVehVVld DINH_stFId.FId_BattUDiagEna DINH_stFId.FId_BattUReplcmt DINH_stFId.FId_BattUVehVVld DSQ_st.DSQ_BattU /end OUT_MEASUREMENT
 /begin LOC_MEASUREMENT BattU_flgBattSply BattU_flgOverUChkEna BattU_flgUnderUChkEna BattU_uThdOverUChk BattU_uThdUnderUChk /end LOC_MEASUREMENT
 FUNCTION_VERSION "2.17.0" /end FUNCTION
/begin FUNCTION Blabla ""
 /begin OUT_MEASUREMENT DINH_nrActvInhReas.FId_FiMFID_test DINH_stFId.FId_FiMFID_test /end OUT_MEASUREMENT
/end FUNCTION
/begin FUNCTION Blwr_DD "3.3.0     HW-depending device driver for cabine blower" /begin DEF_CHARACTERISTIC Blwr_flgComActvRepl_C /end DEF_CHARACTERISTIC /begin IN_MEASUREMENT Com_flgBlwrActv /end IN_MEASUREMENT
 /begin OUT_MEASUREMENT Blwr_flgComActv DINH_nrActvInhReas.FId_BlwrComErr DINH_stFId.FId_BlwrComErr /end OUT_MEASUREMENT
 FUNCTION_VERSION "3.3.0" /end FUNCTION
/begin FUNCTION Blwr_VD "2.2.0     Virtual device driver for cabine blower" /begin DEF_CHARACTERISTIC Blwr_tiActvDly_C Blwr_tiOffDly_C /end DEF_CHARACTERISTIC /begin IN_MEASUREMENT Blwr_flgComActv /end IN_MEASUREMENT /begin OUT_MEASUREMENT Blwr_flgActv /end OUT_MEASUREMENT FUNCTION_VERSION "2.2.0" /end FUNCTION
/begin FUNCTION BrkBstPmp_DD "1400.2.0  Brake Booster Vacuum Pump Device Driver"
 /begin DEF_CHARACTERISTIC BrkBstPmp_nrMaxManTestImp_C BrkBstPmp_nrTestMaxHs_C BrkBstPmp_nrTestMaxLs_C BrkBstPmp_stPsDiagDi_C BrkBstPmp_stPsDi_C BrkBstPmp_tiBtwTestImp_C BrkBstPmp_tiBtwTestOtHs_C BrkBstPmp_tiBtwTestOtLs_C BrkBstPmp_tiBtwTestScbHs_C BrkBstPmp_tiBtwTestScbLs_C BrkBstPmp_tiIniDly_C BrkBstPmp_tiOff_C BrkBstPmp_tiOn_C BrkBstPmp_tiPmpRlyPosnDebHiLo_C BrkBstPmp_tiPmpRlyPosnDebLoHi_C BrkBstPmp_tiStActv_C DDRC_DurDeb.BrkBstPmp_tiHsScbDebOk_C DDRC_DurDeb.BrkBstPmp_tiHsScbDebDef_C DDRC_DurDeb.BrkBstPmp_tiHsScgDebOk_C DDRC_DurDeb.BrkBstPmp_tiHsScgDebDef_C DDRC_DurDeb.BrkBstPmp_tiLsOlDebOk_C DDRC_DurDeb.BrkBstPmp_tiLsOlDebDef_C DDRC_DurDeb.BrkBstPmp_tiLsScbDebOk_C DDRC_DurDeb.BrkBstPmp_tiLsScbDebDef_C DDRC_DurDeb.BrkBstPmp_tiLsScgDebOk_C DDRC_DurDeb.BrkBstPmp_tiLsScgDebDef_C DDRC_DurDeb.BrkBstPmp_tiActtnDfctDebOk_C DDRC_DurDeb.BrkBstPmp_tiActtnDfctDebDef_C DDRC_DurDeb.BrkBstPmp_tiDeactvnDfctDebOk_C DDRC_DurDeb.BrkBstPmp_tiDeactvnDfctDebDef_C DDRC_RatDeb.BrkBstPmp_tiHsScbUDRat_C DDRC_RatDeb.BrkBstPmp_tiHsScgUDRat_C DDRC_RatDeb.BrkBstPmp_tiLsOlUDRat_C DDRC_RatDeb.BrkBstPmp_tiLsScbUDRat_C DDRC_RatDeb.BrkBstPmp_tiLsScgUDRat_C DFC_CtlMsk2.DFC_BrkBstPmpActtnDfct_C DFC_CtlMsk2.DFC_BrkBstPmpDeactvnDfct_C DFC_CtlMsk2.DFC_BrkBstPmpHsScb_C DFC_CtlMsk2.DFC_BrkBstPmpHsScg_C DFC_CtlMsk2.DFC_BrkBstPmpLsOl_C DFC_CtlMsk2.DFC_BrkBstPmpLsScb_C DFC_CtlMsk2.DFC_BrkBstPmpLsScg_C DFC_DisblMsk2.DFC_BrkBstPmpActtnDfct_C DFC_DisblMsk2.DFC_BrkBstPmpDeactvnDfct_C DFC_DisblMsk2.DFC_BrkBstPmpHsScb_C DFC_DisblMsk2.DFC_BrkBstPmpHsScg_C DFC_DisblMsk2.DFC_BrkBstPmpLsOl_C DFC_DisblMsk2.DFC_BrkBstPmpLsScb_C DFC_DisblMsk2.DFC_BrkBstPmpLsScg_C /end DEF_CHARACTERISTIC
 /begin REF_CHARACTERISTIC BrkBstPmp_swtEnaFct_C /end REF_CHARACTERISTIC
 /begin IN_MEASUREMENT BrkBstPmp_bPmpReq DevLib_stPwrStgEnaCond /end IN_MEASUREMENT
 /begin OUT_MEASUREMENT BrkBstPmp_bPmpStrt BrkBstPmp_flgHsActr BrkBstPmp_flgLsActr DDRC_St.DFC_BrkBstPmpActtnDfct DDRC_St.DFC_BrkBstPmpDeactvnDfct DDRC_St.DFC_BrkBstPmpHsScb DDRC_St.DFC_BrkBstPmpHsScg DDRC_St.DFC_BrkBstPmpLsOl DDRC_St.DFC_BrkBstPmpLsScb DDRC_St.DFC_BrkBstPmpLsScg DFC_st.DFC_BrkBstPmpActtnDfct DFC_st.DFC_BrkBstPmpDeactvnDfct DFC_st.DFC_BrkBstPmpHsScb DFC_st.DFC_BrkBstPmpHsScg DFC_st.DFC_BrkBstPmpLsOl DFC_st.DFC_BrkBstPmpLsScb DFC_st.DFC_BrkBstPmpLsScg DINH_nrActvInhReas.FId_BrkBstPmpActtnDiagEnad DINH_nrActvInhReas.FId_BrkBstPmpDeactvnDiagEnad DINH_nrActvInhReas.FId_BrkBstPmpM1Err DINH_nrActvInhReas.FId_BrkBstPmpM2Err DINH_nrActvInhReas.FId_BrkBstPmpScgLsErr DINH_stFId.FId_BrkBstPmpActtnDiagEnad DINH_stFId.FId_BrkBstPmpDeactvnDiagEnad DINH_stFId.FId_BrkBstPmpM1Err DINH_stFId.FId_BrkBstPmpM2Err DINH_stFId.FId_BrkBstPmpScgLsErr /end OUT_MEASUREMENT
 /begin LOC_MEASUREMENT BrkBstPmp_DigOutPrmStructHs.tiBtwTstSCB_C BrkBstPmp_DigOutPrmStructHs.tiBtwTstOT_C BrkBstPmp_DigOutPrmStructHs.numTstMax_C BrkBstPmp_DigOutPrmStructLs.tiBtwTstSCB_C BrkBstPmp_DigOutPrmStructLs.tiBtwTstOT_C BrkBstPmp_DigOutPrmStructLs.numTstMax_C BrkBstPmp_DigOutStatStructHs.tmrTBtwTst BrkBstPmp_DigOutStatStructHs.ctTstDne BrkBstPmp_DigOutStatStructHs.stPrevTstRslt BrkBstPmp_DigOutStatStructLs.tmrTBtwTst BrkBstPmp_DigOutStatStructLs.ctTstDne BrkBstPmp_DigOutStatStructLs.stPrevTstRslt BrkBstPmp_flgDiagEnad BrkBstPmp_flgPmpStrtRaw BrkBstPmp_stErr BrkBstPmp_stErrHsOpen BrkBstPmp_stErrLsOpen BrkBstPmp_stHsClsd BrkBstPmp_stLsClsd BrkBstPmp_stStMac BrkBstPmp_tiStMac /end LOC_MEASUREMENT
 FUNCTION_VERSION "1400.2.0" /end FUNCTION
/begin FUNCTION BrkBstPmp_VD "1400.6.0  Brake Booster Vacuum Pump Virtual Device"
 /begin DEF_CHARACTERISTIC BrkBstPmp_facSlopDec_C BrkBstPmp_flgEnaEnvPSnsr_C BrkBstPmp_flgLeakDiagWaitForNxtPmpOn_C BrkBstPmp_maskBrkBoostPSq_C BrkBstPmp_maskBrkBoostPVldyLeakDiagSq_C BrkBstPmp_maskBrkStSq_C BrkBstPmp_maskBrkStVldyLeakDiagSq_C BrkBstPmp_maskEnvPVldySq_C BrkBstPmp_maskOvldBrkBoostPSq_C BrkBstPmp_pEnvPDfl_C BrkBstPmp_pLeakDetnThd_C BrkBstPmp_pThdVacChkEna_C BrkBstPmp_pVacChkMinDif_M BrkBstPmp_swtEnaFct_C BrkBstPmp_swtEnaOvldProtn_C BrkBstPmp_swtVacChkEna_C BrkBstPmp_tiIniDlyAftBoostIdle_C BrkBstPmp_tiLeakDetnDlyThd_C BrkBstPmp_tiOvldCntrMaxThd_C BrkBstPmp_tiOvldMaxThd_C BrkBstPmp_tiVacChkDlyStrt_C DDRC_DurDeb.BrkBstPmp_numPLeakDfctDebOk_C DDRC_DurDeb.BrkBstPmp_numPLeakDfctDebDef_C DDRC_DurDeb.BrkBstPmp_numPlausGennDebOk_C DDRC_DurDeb.BrkBstPmp_numPlausGennDebDef_C DFC_CtlMsk2.DFC_BrkBstPmpPLeakDfct_C DFC_CtlMsk2.DFC_BrkBstPmpPlausGenn_C DFC_CtlMsk2.DFC_BrkBstPmpOvld_C DFC_DisblMsk2.DFC_BrkBstPmpPLeakDfct_C DFC_DisblMsk2.DFC_BrkBstPmpPlausGenn_C DFC_DisblMsk2.DFC_BrkBstPmpOvld_C /end DEF_CHARACTERISTIC
 /begin IN_MEASUREMENT BrkBstPmp_bPmpStrt BrkBstP_p BrkBstP_p_Sq BrkBst_bPmpReq BrkBst_pPmpOffThd Brk_st Brk_st_Sq PEnv_p PEnv_p_Sq /end IN_MEASUREMENT
 /begin OUT_MEASUREMENT BrkBstPmp_bPmpReq DDRC_St.DFC_BrkBstPmpPLeakDfct DDRC_St.DFC_BrkBstPmpPlausGenn DFC_st.DFC_BrkBstPmpPLeakDfct DFC_st.DFC_BrkBstPmpPlausGenn DFC_st.DFC_BrkBstPmpOvld DINH_nrActvInhReas.FId_BrkBstPmpLeakDiagEnad DINH_nrActvInhReas.FId_BrkBstPmpVacChkEna DINH_stFId.FId_BrkBstPmpLeakDiagEnad DINH_stFId.FId_BrkBstPmpVacChkEna /end OUT_MEASUREMENT
 /begin LOC_MEASUREMENT BrkBstPmp_flgLeakDiagEnad BrkBstPmp_flgRstPLeakDiag BrkBstPmp_flgVacChkStrtd BrkBstPmp_pEnv BrkBstPmp_pRel BrkBstPmp_pStrtg BrkBstPmp_pVacChkMinDif BrkBstPmp_pVacChkStrtd BrkBstPmp_tiLeakDiag BrkBstPmp_tiOvldTmr BrkBstPmp_tiOvrnTmr BrkBstPmp_VacChkCompER_I BrkBstPmp_VacChkStrtdER_I /end LOC_MEASUREMENT
 FUNCTION_VERSION "1400.6.0" /end FUNCTION
/begin FUNCTION BrkBstP_DD "1400.5.0  Pressure sensor for brakebooster device driver"
 /begin DEF_CHARACTERISTIC BrkBstP_pSnsrPlaus12Thd_C BrkBstP_Snsr1_I.pVoltConv_T BrkBstP_Snsr1_I.uScbThd_C BrkBstP_Snsr1_I.uScgThd_C BrkBstP_Snsr2_I.pVoltConv_T BrkBstP_Snsr2_I.uScbThd_C BrkBstP_Snsr2_I.uScgThd_C BrkBstP_swtSnsrSeln_C DDRC_DurDeb.BrkBstP_tiSnsr12PlausDebOk_C DDRC_DurDeb.BrkBstP_tiSnsr12PlausDebDef_C DDRC_DurDeb.BrkBstP_tiSnsr1ScbDebOk_C DDRC_DurDeb.BrkBstP_tiSnsr1ScbDebDef_C DDRC_DurDeb.BrkBstP_tiSnsr1ScgDebOk_C DDRC_DurDeb.BrkBstP_tiSnsr1ScgDebDef_C DDRC_DurDeb.BrkBstP_tiSnsr2ScbDebOk_C DDRC_DurDeb.BrkBstP_tiSnsr2ScbDebDef_C DDRC_DurDeb.BrkBstP_tiSnsr2ScgDebOk_C DDRC_DurDeb.BrkBstP_tiSnsr2ScgDebDef_C DDRC_RatDeb.BrkBstP_tiSnsr12PlausUDRat_C DDRC_RatDeb.BrkBstP_tiSnsr1ScbUDRat_C DDRC_RatDeb.BrkBstP_tiSnsr1ScgUDRat_C DDRC_RatDeb.BrkBstP_tiSnsr2ScbUDRat_C DDRC_RatDeb.BrkBstP_tiSnsr2ScgUDRat_C DFC_CtlMsk2.DFC_BrkBstPSnsr12PlausDfct_C DFC_CtlMsk2.DFC_BrkBstPSnsr1Scb_C DFC_CtlMsk2.DFC_BrkBstPSnsr1Scg_C DFC_CtlMsk2.DFC_BrkBstPSnsr2Scb_C DFC_CtlMsk2.DFC_BrkBstPSnsr2Scg_C DFC_DisblMsk2.DFC_BrkBstPSnsr12PlausDfct_C DFC_DisblMsk2.DFC_BrkBstPSnsr1Scb_C DFC_DisblMsk2.DFC_BrkBstPSnsr1Scg_C DFC_DisblMsk2.DFC_BrkBstPSnsr2Scb_C DFC_DisblMsk2.DFC_BrkBstPSnsr2Scg_C /end DEF_CHARACTERISTIC
 /begin OUT_MEASUREMENT BrkBstP_pSnsr BrkBstP_pSnsr1 BrkBstP_pSnsr2 BrkBstP_pSnsr_Sq BrkBstP_uRaw1 BrkBstP_uRaw2 DDRC_St.DFC_BrkBstPSnsr12PlausDfct DDRC_St.DFC_BrkBstPSnsr1Scb DDRC_St.DFC_BrkBstPSnsr1Scg DDRC_St.DFC_BrkBstPSnsr2Scb DDRC_St.DFC_BrkBstPSnsr2Scg DFC_st.DFC_BrkBstPSnsr12PlausDfct DFC_st.DFC_BrkBstPSnsr1Scb DFC_st.DFC_BrkBstPSnsr1Scg DFC_st.DFC_BrkBstPSnsr2Scb DFC_st.DFC_BrkBstPSnsr2Scg DINH_nrActvInhReas.FId_BrkBstPPlaus12FrznDfct DINH_nrActvInhReas.FId_BrkBstPPlaus12ReplcmtDfct DINH_nrActvInhReas.FId_BrkBstPSnsr1FrzDfct DINH_nrActvInhReas.FId_BrkBstPSnsr1ReplcmtDfct DINH_nrActvInhReas.FId_BrkBstPSnsr1SplyDfct DINH_nrActvInhReas.FId_BrkBstPSnsr2FrzDfct DINH_nrActvInhReas.FId_BrkBstPSnsr2ReplcmtDfct DINH_nrActvInhReas.FId_BrkBstPSnsr2SplyDfct DINH_stFId.FId_BrkBstPPlaus12FrznDfct DINH_stFId.FId_BrkBstPPlaus12ReplcmtDfct DINH_stFId.FId_BrkBstPSnsr1FrzDfct DINH_stFId.FId_BrkBstPSnsr1ReplcmtDfct DINH_stFId.FId_BrkBstPSnsr1SplyDfct DINH_stFId.FId_BrkBstPSnsr2FrzDfct DINH_stFId.FId_BrkBstPSnsr2ReplcmtDfct DINH_stFId.FId_BrkBstPSnsr2SplyDfct /end OUT_MEASUREMENT
 /begin LOC_MEASUREMENT BrkBstP_pDifSnsr12 BrkBstP_Snsr1_I.pSnsr BrkBstP_Snsr1_I.stQly BrkBstP_Snsr2_I.pSnsr BrkBstP_Snsr2_I.stQly BrkBstP_stQly /end LOC_MEASUREMENT
 FUNCTION_VERSION "1400.5.0" /end FUNCTION
/begin FUNCTION BrkBstP_VD "1400.4.0  Pressure sensor for brakebooster virtual device"
 /begin DEF_CHARACTERISTIC BrkBstP_flgPhyRngChkEnad_C BrkBstP_flgSnsrTypDp_C BrkBstP_maskPEnvPVldSq_C BrkBstP_maskPSnsrFrznVldySq_C BrkBstP_maskPSnsrReplcmtVldySq_C BrkBstP_maskRngChkEnvPVldySq_C BrkBstP_maskRngChkSnsrPVldySq_C BrkBstP_maskVehVVldySq_C BrkBstP_pAbsltPhyRngChkMaxThd_C BrkBstP_pAbsltPhyRngChkMinThd_C BrkBstP_pDfl_C BrkBstP_pSnsrHiVCautionDfctThd_C BrkBstP_pSnsrHiVWarnDfctThd_C BrkBstP_pSnsrLoVCautionDfctThd_C BrkBstP_pSnsrLoVWarnDfctThd_C BrkBstP_pSnsrPmpOffThdForDiag_M BrkBstP_pSnsrPmpOffThdForDiag_T BrkBstP_pSnsrThdPMax_C BrkBstP_pSnsrThdPMin_C BrkBstP_stActvPt_C BrkBstP_tiPSnsrPT1_C BrkBstP_tiPtActvDiagEnaDly_C BrkBstP_vDeltaHiPDiagThd_C BrkBstP_vHiPDiagThd_C DDRC_DurDeb.BrkBstP_tiHiCautionDfctDebOk_C DDRC_DurDeb.BrkBstP_tiHiCautionDfctDebDef_C DDRC_DurDeb.BrkBstP_tiHiWarnDfctDebOk_C DDRC_DurDeb.BrkBstP_tiHiWarnDfctDebDef_C DDRC_DurDeb.BrkBstP_tiPhyRngChkMaxDebOk_C DDRC_DurDeb.BrkBstP_tiPhyRngChkMaxDebDef_C DDRC_DurDeb.BrkBstP_tiPhyRngChkMinDebOk_C DDRC_DurDeb.BrkBstP_tiPhyRngChkMinDebDef_C DDRC_DurDeb.BrkBstP_tiSnsrPMaxDebOk_C DDRC_DurDeb.BrkBstP_tiSnsrPMaxDebDef_C DDRC_DurDeb.BrkBstP_tiSnsrPMinDebOk_C DDRC_DurDeb.BrkBstP_tiSnsrPMinDebDef_C DDRC_RatDeb.BrkBstP_tiHiCautionDfctUDRat_C DDRC_RatDeb.BrkBstP_tiHiWarnDfctUDRat_C DDRC_RatDeb.BrkBstP_tiPhyRngChkMaxUDRat_C DDRC_RatDeb.BrkBstP_tiPhyRngChkMinUDRat_C DDRC_RatDeb.BrkBstP_tiSnsrPMaxUDRat_C DDRC_RatDeb.BrkBstP_tiSnsrPMinUDRat_C DFC_CtlMsk2.DFC_BrkBstPHiCautionDfct_C DFC_CtlMsk2.DFC_BrkBstPHiWarnDfct_C DFC_CtlMsk2.DFC_BrkBstPSnsrMax_C DFC_CtlMsk2.DFC_BrkBstPSnsrMin_C DFC_CtlMsk2.DFC_BrkBstPhyRngChkMax_C DFC_CtlMsk2.DFC_BrkBstPhyRngChkMin_C DFC_DisblMsk2.DFC_BrkBstPHiCautionDfct_C DFC_DisblMsk2.DFC_BrkBstPHiWarnDfct_C DFC_DisblMsk2.DFC_BrkBstPSnsrMax_C DFC_DisblMsk2.DFC_BrkBstPSnsrMin_C DFC_DisblMsk2.DFC_BrkBstPhyRngChkMax_C DFC_DisblMsk2.DFC_BrkBstPhyRngChkMin_C /end DEF_CHARACTERISTIC
 /begin IN_MEASUREMENT BrkBstP_pSnsr BrkBstP_pSnsr_Sq CoPtFH_stPwt PEnv_p PEnv_p_Sq VehV_v VehV_v_Sq /end IN_MEASUREMENT
 /begin OUT_MEASUREMENT BrkBstP_p BrkBstP_p_Sq DDRC_St.DFC_BrkBstPHiCautionDfct DDRC_St.DFC_BrkBstPHiWarnDfct DDRC_St.DFC_BrkBstPSnsrMax DDRC_St.DFC_BrkBstPSnsrMin DDRC_St.DFC_BrkBstPhyRngChkMax DDRC_St.DFC_BrkBstPhyRngChkMin DFC_st.DFC_BrkBstPHiCautionDfct DFC_st.DFC_BrkBstPHiWarnDfct DFC_st.DFC_BrkBstPSnsrMax DFC_st.DFC_BrkBstPSnsrMin DFC_st.DFC_BrkBstPhyRngChkMax DFC_st.DFC_BrkBstPhyRngChkMin DINH_nrActvInhReas.FId_BrkBstPEnaPrc DINH_nrActvInhReas.FId_BrkBstPFrzVal DINH_nrActvInhReas.FId_BrkBstPReplVal DINH_stFId.FId_BrkBstPEnaPrc DINH_stFId.FId_BrkBstPFrzVal DINH_stFId.FId_BrkBstPReplVal /end OUT_MEASUREMENT
 /begin LOC_MEASUREMENT BrkBstP_pAbslt BrkBstP_stQlyPAbslt /end LOC_MEASUREMENT
 FUNCTION_VERSION "1400.4.0" /end FUNCTION
/begin FUNCTION BrkBst_PresCtl "1400.5.0  Pressure control for brake booster"
 /begin DEF_CHARACTERISTIC BrkBst_flgBkupModSeln_C BrkBst_flgEnaEnvPSnsr_C BrkBst_flgIniBasdDcdc_C BrkBst_flgVBasdPmpCtrl_C BrkBst_maskBrkPVldSq_C BrkBst_maskBrkStVldSq_C BrkBst_maskVehVVldSq_C BrkBst_pEnvPDfl_C BrkBst_pThdEnvPBasdPmpReqOff_T BrkBst_pThdEnvPBasdPmpReqOn_T BrkBst_pThdPmpReqOff_M BrkBst_pThdPmpReqOn_M BrkBst_pTstStopThd_C BrkBst_pTstStrtMax_C BrkBst_pTstStrtMin_C BrkBst_stPwtActv_C BrkBst_tiBkUpModPmpReq_C BrkBst_tiBkupPerdPmpOff_C BrkBst_tiBkupPerdPmpOn_C BrkBst_tiBkupPmpOff_C BrkBst_tiBkupPmpOnDurn_C BrkBst_tiBkupPmpOn_C BrkBst_tiInActvPmpReq_C BrkBst_tiIniPmpReq_C BrkBst_tiMaxTstRun_C BrkBst_tiOvrnDfcHeal_C BrkBst_tiPmpShtOff_C BrkBst_vTstStrtMax_C BrkBst_vVehMaxThdBkup_C BrkBst_vVehMinThdBkup_C DFC_CtlMsk2.DFC_BrkBstBkupOvrn_C DFC_DisblMsk2.DFC_BrkBstBkupOvrn_C /end DEF_CHARACTERISTIC
 /begin IN_MEASUREMENT BrkBstP_p BrkBstP_p_Sq Brk_st Brk_st_Sq CoPtFH_stPwt Dcdc_stOperModAct HndBrk_stDebVal PEnv_p VehV_v VehV_v_Sq /end IN_MEASUREMENT
 /begin OUT_MEASUREMENT BrkBst_bPmpReq BrkBst_flgBkupModActv BrkBst_pPmpOffThd DFC_st.DFC_BrkBstBkupOvrn DINH_nrActvInhReas.FId_BrkBstBrkSt DINH_nrActvInhReas.FId_BrkBstP DINH_nrActvInhReas.FId_BrkBstTst DINH_stFId.FId_BrkBstBrkSt DINH_stFId.FId_BrkBstP DINH_stFId.FId_BrkBstTst /end OUT_MEASUREMENT
 /begin LOC_MEASUREMENT BrkBst_bBkupModBrkPedReq BrkBst_bBkupModPerdReq BrkBst_bBkupOvrnDetd BrkBst_bIniPmpReq BrkBst_bIniReq BrkBst_bNormPmpReq BrkBst_bPmpActvnCondEn BrkBst_bPmpReqBrkPed BrkBst_bPmpReqInActvPmp BrkBst_bStdPmpReq BrkBst_bTstModReq BrkBst_flgPBasdReq BrkBst_flgPmpActvn BrkBst_flgTstAbort BrkBst_flgTstStrtCdn BrkBst_flgVehStat BrkBst_pEnv BrkBst_pRel BrkBst_pThdPmpReqOff BrkBst_pThdPmpReqOn BrkBst_pTstStop BrkBst_pTstStrt BrkBst_stActvModeOld BrkBst_stBkupPmpReq BrkBst_stDfcHeal BrkBst_stTst BrkBst_stTstCbk BrkBst_stTstrReq BrkBst_tiTstRun /end LOC_MEASUREMENT
 FUNCTION_VERSION "1400.5.0" /end FUNCTION
/begin FUNCTION BrkTqEv_TqCoorr "160.5.1   Coordinator electrical brake torque" /begin IN_MEASUREMENT VehMotEv_tqPrimAxleFild /end IN_MEASUREMENT
 /begin OUT_MEASUREMENT BrkTqEv_tqBrkDesPrimAxle BrkTqEv_tqRcptPrimAxle VehDrvEv_tqPrimAxleDes /end OUT_MEASUREMENT
 FUNCTION_VERSION "160.5.1" /end FUNCTION
/begin FUNCTION Brk_AutDetn "1.0.0     auto detection of brake switch availability" /begin DEF_CHARACTERISTIC Brk_flgT15DpdtMaiSwt_C Brk_flgT15DpdtRedSwt_C /end DEF_CHARACTERISTIC /begin REF_CHARACTERISTIC Brk_flgRdntSensPrs_C /end REF_CHARACTERISTIC /begin IN_MEASUREMENT T15_st /end IN_MEASUREMENT /begin OUT_MEASUREMENT Brk_flgDiagPlausEna Brk_flgMaiSnsrDetd Brk_flgRdntSnsrDetd /end OUT_MEASUREMENT FUNCTION_VERSION "1.0.0" /end FUNCTION
/begin FUNCTION Brk_DD "3.11.0    Brake Device Driver"
 /begin DEF_CHARACTERISTIC Brk_Mn_GDD_I.flgIvt_C Brk_Mn_GDD_I.tiDebHiLo_C Brk_Mn_GDD_I.tiDebLoHi_C Brk_Red_GDD_I.flgIvt_C Brk_Red_GDD_I.tiDebHiLo_C Brk_Red_GDD_I.tiDebLoHi_C Brk_r_GASWT_I.flgIvt_C Brk_r_GASWT_I.tiDebHiLo_C Brk_r_GASWT_I.tiDebLoHi_C Brk_r_GASWT_I.uAdcHysLe_C Brk_r_GASWT_I.uAdcHysRi_C Brk_r_GASWT_I.uSrcMax_C Brk_r_GASWT_I.uSrcMin_C Brk_r_GAS_I.uSrcMax_C Brk_r_GAS_I.uSrcMin_C /end DEF_CHARACTERISTIC
 /begin OUT_MEASUREMENT Brk_flgRdntSnsr Brk_flgRdntSnsrRaw /end OUT_MEASUREMENT
 /begin LOC_MEASUREMENT Brk_r_GASWT_I.stHLR_I /end LOC_MEASUREMENT
 FUNCTION_VERSION "3.11.0" /end FUNCTION
/begin FUNCTION Brk_Plaus1 "1.1.0     Brake status plausibility diagnosis"
 /begin DEF_CHARACTERISTIC Brk_cntrErrThd_C Brk_maskPlaus1EnaStMaiVldSq_C Brk_maskPlaus1EnaStRdntVldSq_C Brk_stSwtFltSt_C Brk_tiDebImpyErr_C DFC_CtlMsk2.DFC_BrkPlausChk_C DFC_DisblMsk2.DFC_BrkPlausChk_C /end DEF_CHARACTERISTIC
 /begin IN_MEASUREMENT Brk_flgDiagPlausEna Brk_flgMaiSnsrDetd Brk_flgRdntSnsrDetd Brk_stMn Brk_stMn_Sq Brk_stRed Brk_stRed_Sq /end IN_MEASUREMENT
 /begin OUT_MEASUREMENT Brk_cntrErrPlaus DFC_st.DFC_BrkPlausChk DINH_nrActvInhReas.FId_BrkPlaus1Ena DINH_stFId.FId_BrkPlaus1Ena /end OUT_MEASUREMENT
 /begin LOC_MEASUREMENT Brk_flgPlaus1ChkErr Brk_flgPlaus1ChkOk Brk_flgPlaus1RstDiag /end LOC_MEASUREMENT
 FUNCTION_VERSION "1.1.0" /end FUNCTION
/begin FUNCTION Brk_SelSig "1.1.0     Selection of signal source for main and redundant brake status" /begin DEF_CHARACTERISTIC Brk_flgRdntSensPrs_C Brk_swtMaiSig_C Brk_swtRdntSig_C /end DEF_CHARACTERISTIC /begin IN_MEASUREMENT Brk_flgRdntSnsr Brk_flgRdntSnsrRaw Com_flgBrkMai /end IN_MEASUREMENT
 /begin OUT_MEASUREMENT Brk_stMn Brk_stMnRaw Brk_stMn_Sq Brk_stRed Brk_stRedRaw Brk_stRed_Sq DINH_nrActvInhReas.FId_BrkSigMaiCanFrzVal DINH_nrActvInhReas.FId_BrkSigMaiCanReplVal DINH_stFId.FId_BrkSigMaiCanFrzVal DINH_stFId.FId_BrkSigMaiCanReplVal /end OUT_MEASUREMENT
 FUNCTION_VERSION "1.1.0" /end FUNCTION
/begin FUNCTION Brk_VdSt "4.1.0     Acquisition status brake pedal by brake switch"
 /begin DEF_CHARACTERISTIC Brk_maskStMnFinalDfctSq_C Brk_maskStMnPrelDfctSq_C Brk_maskStRedFinalDfctSq_C Brk_maskStRedPrelDfctSq_C /end DEF_CHARACTERISTIC
 /begin REF_CHARACTERISTIC Brk_flgT15DpdtMaiSwt_C Brk_flgT15DpdtRedSwt_C /end REF_CHARACTERISTIC
 /begin IN_MEASUREMENT Brk_flgMaiSnsrDetd Brk_flgRdntSnsrDetd Brk_stMn Brk_stMn_Sq Brk_stRed Brk_stRed_Sq T15_st /end IN_MEASUREMENT
 /begin OUT_MEASUREMENT Brk_st Brk_st_Sq DINH_nrActvInhReas.FId_BrkStMnFinalDfct DINH_nrActvInhReas.FId_BrkStMnPrelDfct DINH_nrActvInhReas.FId_BrkStRdntFinalDfct DINH_nrActvInhReas.FId_BrkStRdntPrelDfct DINH_stFId.FId_BrkStMnFinalDfct DINH_stFId.FId_BrkStMnPrelDfct DINH_stFId.FId_BrkStRdntFinalDfct DINH_stFId.FId_BrkStRdntPrelDfct /end OUT_MEASUREMENT
 /begin LOC_MEASUREMENT Brk_stQly /end LOC_MEASUREMENT
 FUNCTION_VERSION "4.1.0" /end FUNCTION
/begin FUNCTION CanDrv ""
 /begin DEF_CHARACTERISTIC DFC_CtlMsk2.DFC_CAN_E_TIMEOUT_C DFC_DisblMsk2.DFC_CAN_E_TIMEOUT_C /end DEF_CHARACTERISTIC
 /begin OUT_MEASUREMENT DDRC_ctArDebLvl.DFC_CAN_E_TIMEOUT DDRC_stLstRprtEve.DFC_CAN_E_TIMEOUT DFC_st.DFC_CAN_E_TIMEOUT /end OUT_MEASUREMENT
/end FUNCTION
/begin FUNCTION CanEif "850.2.0   Electronic Integration Frame" /begin DEF_CHARACTERISTIC CanEif_vVeh_C Ext_tiHldIntModeExitMainWku_C /end DEF_CHARACTERISTIC
 /begin IN_MEASUREMENT Com_bDelDftReq Com_bDiagMuxCAN Com_bElIntgDiag Com_bElIntgDiagMod Com_stChrgPlg Com_stHvbNegCntct Com_stHvbPosCntct Com_stHvbPrecCntct Com_stMainWkuReq Com_vVeh CoPtFH_stPwt rba_SyC_bWkuMain SyC_stSub SyC_stSubOld T15_bRCDLine /end IN_MEASUREMENT
 /begin OUT_MEASUREMENT CanEif_bCleanend CanEif_bDiag CanEif_bMainWkupExit CanEif_bMode CanEif_bProcessNewFrame CanEif_bProg CanEif_bRcwLow CanEif_bVehSpdVld CanEif_flgDiagon CanEif_stCmdByte CanEif_stReqHSN1_CANTx CanEif_stReqHSN3_CANTx Com_092RxFlg Com_EIModeEntryCond Com_EIModeExitCond Com_stCANEif DINH_nrActvInhReas.FId_CanEifVehSpdVld DINH_nrActvInhReas.FId_bInhCanEif_HVBAT_NGTV_CONTACTOR_STS DINH_nrActvInhReas.FId_bInhCanEif_HVBAT_PRECHRG_CONTACTOR_STS DINH_nrActvInhReas.FId_bInhCanEif_HVBAT_PSTV_CONTACTOR_STS DINH_nrActvInhReas.FId_bInhCanEif_VCU_eBCCM_432h DINH_stFId.FId_CanEifVehSpdVld DINH_stFId.FId_bInhCanEif_HVBAT_NGTV_CONTACTOR_STS DINH_stFId.FId_bInhCanEif_HVBAT_PRECHRG_CONTACTOR_STS DINH_stFId.FId_bInhCanEif_HVBAT_PSTV_CONTACTOR_STS DINH_stFId.FId_bInhCanEif_VCU_eBCCM_432h /end OUT_MEASUREMENT
 /begin LOC_MEASUREMENT CanEif_ctDelay CanEif_ctIdentFr /end LOC_MEASUREMENT
 FUNCTION_VERSION "850.2.0" /end FUNCTION
/begin FUNCTION CanTrcv "6.16.2    CAN Tranceiver Driver"
 /begin DEF_CHARACTERISTIC DFC_CtlMsk2.DFC_CANTRCV_E_NO_TRCV_CONTROL_0_C DFC_DisblMsk2.DFC_CANTRCV_E_NO_TRCV_CONTROL_0_C /end DEF_CHARACTERISTIC
 /begin OUT_MEASUREMENT DDRC_ctArDebLvl.DFC_CANTRCV_E_NO_TRCV_CONTROL_0 DDRC_stLstRprtEve.DFC_CANTRCV_E_NO_TRCV_CONTROL_0 DFC_st.DFC_CANTRCV_E_NO_TRCV_CONTROL_0 /end OUT_MEASUREMENT
 FUNCTION_VERSION "6.16.2" /end FUNCTION
/begin COMPU_METHOD boolean "" RAT_FUNC "%6.2" "-" COEFFS 0 1 0 0 0 1 /end COMPU_METHOD
/begin COMPU_METHOD BRKBSTPMP_SC_Compu "" TAB_VERB "%6.3" "" COMPU_TAB_REF BRKBSTPMP_SC_Compu /end COMPU_METHOD
/begin COMPU_VTAB BRKBSTPMP_SC_Compu "" TAB_VERB 2 0 "False" 1 "True" /end COMPU_VTAB
/begin COMPU_METHOD BRKBSTPMP_SWTPLAUSGENN_SC_Compu "" TAB_VERB "%6.3" "" COMPU_TAB_REF BRKBSTPMP_SWTPLAUSGENN_SC_Compu /end COMPU_METHOD
/begin COMPU_VTAB BRKBSTPMP_SWTPLAUSGENN_SC_Compu "" TAB_VERB 2 0 "False" 1 "True" /end COMPU_VTAB
/begin COMPU_METHOD BRKBSTP_SWTADC_SC_Compu "" TAB_VERB "%6.3" "" COMPU_TAB_REF BRKBSTP_SWTADC_SC_Compu /end COMPU_METHOD
/begin COMPU_VTAB BRKBSTP_SWTADC_SC_Compu "" TAB_VERB 2 0 "False" 1 "True" /end COMPU_VTAB
/begin COMPU_METHOD BRKBSTP_SWTPLAUSCNS_SC_Compu "" TAB_VERB "%6.3" "" COMPU_TAB_REF BRKBSTP_SWTPLAUSCNS_SC_Compu /end COMPU_METHOD
/begin COMPU_VTAB BRKBSTP_SWTPLAUSCNS_SC_Compu "" TAB_VERB 2 0 "False" 1 "True" /end COMPU_VTAB
/begin COMPU_METHOD BRKBSTP_TYPAVL_SC_Compu "" TAB_VERB "%6.3" "" COMPU_TAB_REF BRKBSTP_TYPAVL_SC_Compu /end COMPU_METHOD
/begin COMPU_VTAB BRKBSTP_TYPAVL_SC_Compu "" TAB_VERB 2 0 "False" 1 "True" /end COMPU_VTAB
/begin COMPU_METHOD BRKBST_MDLAIRMF_SC_Compu "" TAB_VERB "%6.3" "" COMPU_TAB_REF BRKBST_MDLAIRMF_SC_Compu /end COMPU_METHOD
/begin COMPU_VTAB BRKBST_MDLAIRMF_SC_Compu "" TAB_VERB 2 0 "Disable" 1 "Enable" /end COMPU_VTAB
/begin COMPU_METHOD BRKGTOZR_SC_Compu "" TAB_VERB "%6.3" "" COMPU_TAB_REF BRKGTOZR_SC_Compu /end COMPU_METHOD
/begin COMPU_VTAB BRKGTOZR_SC_Compu "" TAB_VERB 2 0 "False" 1 "True" /end COMPU_VTAB
/begin COMPU_METHOD BRKPEDLEVLN_SC_Compu "" RAT_FUNC "%6.2" "" COEFFS 0 1 0 0 0 1 /end COMPU_METHOD
/begin COMPU_METHOD BRKP_ACQHWENA_SC_Compu "" TAB_VERB "%6.3" "" COMPU_TAB_REF BRKP_ACQHWENA_SC_Compu /end COMPU_METHOD
/begin COMPU_VTAB BRKP_ACQHWENA_SC_Compu "" TAB_VERB 2 0 "Disable" 1 "Enable" /end COMPU_VTAB
/begin COMPU_METHOD BRKP_SC_Compu "" TAB_VERB "%6.3" "" COMPU_TAB_REF BRKP_SC_Compu /end COMPU_METHOD
/begin COMPU_VTAB BRKP_SC_Compu "" TAB_VERB 2 0 "False" 1 "True" /end COMPU_VTAB
/begin COMPU_METHOD BRKVEHSPDPLAUS_SY_Compu "" TAB_VERB "%6.3" "" COMPU_TAB_REF BRKVEHSPDPLAUS_SY_Compu /end COMPU_METHOD
/begin COMPU_VTAB BRKVEHSPDPLAUS_SY_Compu "" TAB_VERB 2 0 "False" 1 "True" /end COMPU_VTAB
/begin COMPU_METHOD BRK_EXTBRKINTVBRKP_SC_Compu "" TAB_VERB "%6.3" "" COMPU_TAB_REF BRK_EXTBRKINTVBRKP_SC_Compu /end COMPU_METHOD
/begin COMPU_VTAB BRK_EXTBRKINTVBRKP_SC_Compu "" TAB_VERB 2 0 "False" 1 "True" /end COMPU_VTAB
/begin COMPU_METHOD BRK_FLGSWTSTUCKDIAG_SC_Compu "" TAB_VERB "%6.3" "" COMPU_TAB_REF BRK_FLGSWTSTUCKDIAG_SC_Compu /end COMPU_METHOD
/begin COMPU_VTAB BRK_FLGSWTSTUCKDIAG_SC_Compu "" TAB_VERB 2 0 "OFF" 1 "ON" /end COMPU_VTAB
/begin COMPU_METHOD BRK_MAISNSRAUTDETNENA_SC_Compu "" TAB_VERB "%6.3" "" COMPU_TAB_REF BRK_MAISNSRAUTDETNENA_SC_Compu /end COMPU_METHOD
/begin COMPU_VTAB BRK_MAISNSRAUTDETNENA_SC_Compu "" TAB_VERB 2 0 "False" 1 "True" /end COMPU_VTAB
/begin COMPU_METHOD BRK_PLAUSBRKSTBRKP_SC_Compu "" TAB_VERB "%6.3" "" COMPU_TAB_REF BRK_PLAUSBRKSTBRKP_SC_Compu /end COMPU_METHOD
/begin COMPU_VTAB BRK_PLAUSBRKSTBRKP_SC_Compu "" TAB_VERB 2 0 "Check_disabled" 1 "Check_enabled" /end COMPU_VTAB
/begin COMPU_METHOD BRK_RATSRCADC_SC_Compu "" TAB_VERB "%6.3" "" COMPU_TAB_REF BRK_RATSRCADC_SC_Compu /end COMPU_METHOD
/begin COMPU_VTAB BRK_RATSRCADC_SC_Compu "" TAB_VERB 2 0 "False" 1 "True" /end COMPU_VTAB
/begin COMPU_METHOD BRK_RAT_SC_Compu "" TAB_VERB "%6.3" "" COMPU_TAB_REF BRK_RAT_SC_Compu /end COMPU_METHOD
/begin COMPU_VTAB BRK_RAT_SC_Compu "" TAB_VERB 2 0 "False" 1 "True" /end COMPU_VTAB
/begin COMPU_METHOD BRK_RDNTSNSRAUTDETNENA_SC_Compu "" TAB_VERB "%6.3" "" COMPU_TAB_REF BRK_RDNTSNSRAUTDETNENA_SC_Compu /end COMPU_METHOD
/begin COMPU_VTAB BRK_RDNTSNSRAUTDETNENA_SC_Compu "" TAB_VERB 2 0 "False" 1 "True" /end COMPU_VTAB
/begin COMPU_METHOD BRK_SWTADC_SC_Compu "" TAB_VERB "%6.3" "" COMPU_TAB_REF BRK_SWTADC_SC_Compu /end COMPU_METHOD
/begin COMPU_VTAB BRK_SWTADC_SC_Compu "" TAB_VERB 2 0 "False" 1 "True" /end COMPU_VTAB
/begin COMPU_METHOD BRK_SWTBRKP_SC_Compu "" TAB_VERB "%6.3" "" COMPU_TAB_REF BRK_SWTBRKP_SC_Compu /end COMPU_METHOD
/begin COMPU_VTAB BRK_SWTBRKP_SC_Compu "" TAB_VERB 2 0 "False" 1 "True" /end COMPU_VTAB
/begin COMPU_METHOD BRK_SWTMAICAN_SC_Compu "" TAB_VERB "%6.3" "" COMPU_TAB_REF BRK_SWTMAICAN_SC_Compu /end COMPU_METHOD
/begin COMPU_VTAB BRK_SWTMAICAN_SC_Compu "" TAB_VERB 2 0 "False" 1 "True" /end COMPU_VTAB
/begin COMPU_METHOD BRK_SWTMAIDIO_SC_Compu "" TAB_VERB "%6.3" "" COMPU_TAB_REF BRK_SWTMAIDIO_SC_Compu /end COMPU_METHOD
/begin COMPU_VTAB BRK_SWTMAIDIO_SC_Compu "" TAB_VERB 2 0 "False" 1 "True" /end COMPU_VTAB
/begin COMPU_METHOD BRK_SWTPLAUS_SC_Compu "" TAB_VERB "%6.3" "" COMPU_TAB_REF BRK_SWTPLAUS_SC_Compu /end COMPU_METHOD
/begin COMPU_VTAB BRK_SWTPLAUS_SC_Compu "" TAB_VERB 4 0 "0" 1 "1" 2 "2" 3 "3" /end COMPU_VTAB
/begin COMPU_METHOD BRK_SWTPWM_SC_Compu "" TAB_VERB "%6.3" "" COMPU_TAB_REF BRK_SWTPWM_SC_Compu /end COMPU_METHOD
/begin COMPU_VTAB BRK_SWTPWM_SC_Compu "" TAB_VERB 2 0 "False" 1 "True" /end COMPU_VTAB
/begin COMPU_METHOD BRK_SWTRDNTCAN_SC_Compu "" TAB_VERB "%6.3" "" COMPU_TAB_REF BRK_SWTRDNTCAN_SC_Compu /end COMPU_METHOD
/begin COMPU_VTAB BRK_SWTRDNTCAN_SC_Compu "" TAB_VERB 2 0 "False" 1 "True" /end COMPU_VTAB
/begin COMPU_METHOD BRK_SWTRDNTDIO_SC_Compu "" TAB_VERB "%6.3" "" COMPU_TAB_REF BRK_SWTRDNTDIO_SC_Compu /end COMPU_METHOD
/begin COMPU_VTAB BRK_SWTRDNTDIO_SC_Compu "" TAB_VERB 2 0 "False" 1 "True" /end COMPU_VTAB
/begin COMPU_METHOD BSWCPTEXCLSN_SC_Compu "" TAB_VERB "%6.3" "" COMPU_TAB_REF BSWCPTEXCLSN_SC_Compu /end COMPU_METHOD
/begin COMPU_VTAB BSWCPTEXCLSN_SC_Compu "" TAB_VERB 1 0 "EXCLUDED" /end COMPU_VTAB
/begin COMPU_METHOD BSWDEVLERRDETNACTVN_SC_Compu "" TAB_VERB "%6.3" "" COMPU_TAB_REF BSWDEVLERRDETNACTVN_SC_Compu /end COMPU_METHOD
/begin COMPU_VTAB BSWDEVLERRDETNACTVN_SC_Compu "" TAB_VERB 2 0 "False" 1 "True" /end COMPU_VTAB
/begin COMPU_METHOD BSWLIB_TRAPLOG_SC_Compu "" TAB_VERB "%6.3" "" COMPU_TAB_REF BSWLIB_TRAPLOG_SC_Compu /end COMPU_METHOD
/begin COMPU_VTAB BSWLIB_TRAPLOG_SC_Compu "" TAB_VERB 2 0 "False" 1 "True" /end COMPU_VTAB
/begin COMPU_METHOD BYPASS_SY_Compu "" TAB_VERB "%6.3" "" COMPU_TAB_REF BYPASS_SY_Compu /end COMPU_METHOD
/begin COMPU_VTAB BYPASS_SY_Compu "" TAB_VERB 2 0 "No Bypass" 1 "Bypass" /end COMPU_VTAB
/begin COMPU_METHOD B_TRUE "" TAB_VERB "%6.3" "" COMPU_TAB_REF B_TRUE /end COMPU_METHOD
/begin COMPU_VTAB B_TRUE "" TAB_VERB 2 0 "FALSE" 1 "TRUE" /end COMPU_VTAB
/begin COMPU_METHOD CACDSPLP_TYPAVL_SC_Compu "" TAB_VERB "%6.3" "" COMPU_TAB_REF CACDSPLP_TYPAVL_SC_Compu /end COMPU_METHOD
/begin COMPU_VTAB CACDSPLP_TYPAVL_SC_Compu "" TAB_VERB 2 0 "False" 1 "True" /end COMPU_VTAB
/begin COMPU_METHOD CACDSP_TYPAVL_SY_Compu "" TAB_VERB "%6.3" "" COMPU_TAB_REF CACDSP_TYPAVL_SY_Compu /end COMPU_METHOD
/begin COMPU_VTAB CACDSP_TYPAVL_SY_Compu "" TAB_VERB 2 0 "False" 1 "True" /end COMPU_VTAB
/begin COMPU_METHOD CACDSTLP_TYPAVL_SC_Compu "" TAB_VERB "%6.3" "" COMPU_TAB_REF CACDSTLP_TYPAVL_SC_Compu /end COMPU_METHOD
/begin COMPU_VTAB CACDSTLP_TYPAVL_SC_Compu "" TAB_VERB 2 0 "False" 1 "True" /end COMPU_VTAB
/begin COMPU_METHOD CACDST_TYPAVL_SY_Compu "" TAB_VERB "%6.3" "" COMPU_TAB_REF CACDST_TYPAVL_SY_Compu /end COMPU_METHOD
/begin COMPU_VTAB CACDST_TYPAVL_SY_Compu "" TAB_VERB 2 0 "False" 1 "True" /end COMPU_VTAB
/begin COMPU_METHOD CACUSP_TYPAVL_SY_Compu "" TAB_VERB "%6.3" "" COMPU_TAB_REF CACUSP_TYPAVL_SY_Compu /end COMPU_METHOD
/begin COMPU_VTAB CACUSP_TYPAVL_SY_Compu "" TAB_VERB 2 0 "False" 1 "True" /end COMPU_VTAB
/begin COMPU_METHOD CACUST_TYPAVL_SY_Compu "" TAB_VERB "%6.3" "" COMPU_TAB_REF CACUST_TYPAVL_SY_Compu /end COMPU_METHOD
/begin COMPU_VTAB CACUST_TYPAVL_SY_Compu "" TAB_VERB 2 0 "False" 1 "True" /end COMPU_VTAB
/begin COMPU_METHOD CAIRHT_SY_Compu "" TAB_VERB "%6.3" "" COMPU_TAB_REF CAIRHT_SY_Compu /end COMPU_METHOD
/begin COMPU_VTAB CAIRHT_SY_Compu "" TAB_VERB 2 0 "False" 1 "True" /end COMPU_VTAB
/begin COMPU_METHOD Calory "" RAT_FUNC "%6.2" "J/g" COEFFS 0 1 0 0 0 1 /end COMPU_METHOD
/begin COMPU_METHOD CalVal_q0p01 "" RAT_FUNC "%6.4" "MJ/Kg" COEFFS 0 100 0 0 0 1 /end COMPU_METHOD
/begin COMPU_METHOD CoPtFH_stPwt_VERB "" TAB_VERB "%6.3" "" COMPU_TAB_REF CoPtFH_stPwt_VERB /end COMPU_METHOD
/begin COMPU_VTAB CoPtFH_stPwt_VERB "" TAB_VERB 16 0 "GMP inactif" 1 "Reserve" 2 "Reserve1" 3 "Reserve2" 4 "Activation GMP" 5 "Reserve3" 6 "Reserve4" 7 "Reserve5" 8 "GMP actif" 9 "Reserve6" 10 "Desactivation_GMP" 11 "Reserve7" 12 "Maintien_post_desactivation_GMP" 13 "Reserve8" 14 "GMP_au_repos" 15 "Reserve9" /end COMPU_VTAB
/begin COMPU_METHOD Curr_A_q0p03125_COMPU "" RAT_FUNC "%6.4" "A" COEFFS 0 32 0 0 0 1 /end COMPU_METHOD
/begin COMPU_METHOD DDRCTime_ms "" RAT_FUNC "%6.1" "ms" COEFFS 0 1 0 0 0 10 /end COMPU_METHOD
/begin COMPU_METHOD DDRC_LstRprtEve_VERB "" TAB_VERB "%6.3" "" COMPU_TAB_REF DDRC_LstRprtEve_VERB /end COMPU_METHOD
/begin COMPU_VTAB DDRC_LstRprtEve_VERB "" TAB_VERB 5 0 "PASSED" 1 "FAILED" 2 "PREPASSED" 3 "PREFAILED" 255 "INVALID" /end COMPU_VTAB
/begin COMPU_METHOD DDRC_Ratio "" TAB_VERB "%6.3" "-" COMPU_TAB_REF DDRC_Ratio /end COMPU_METHOD
/begin COMPU_VTAB DDRC_Ratio "" TAB_VERB 4 1 "Ratio1" 2 "Ratio2" 3 "Ratio3" 4 "Ratio4" /end COMPU_VTAB
/begin COMPU_METHOD DFC_OneToOne "" RAT_FUNC "%6.2" "-" COEFFS 0 1 0 0 0 1 /end COMPU_METHOD
/begin COMPU_METHOD DFES_OneToOne "" RAT_FUNC "%6.2" "-" COEFFS 0 1 0 0 0 1 /end COMPU_METHOD
/begin COMPU_METHOD DINH_ct_Compu "" RAT_FUNC "%6.0" "" COEFFS 0 -1 4096 0 0 1 /end COMPU_METHOD
/begin COMPU_METHOD DtyCyc "" RAT_FUNC "%6.4" "%" COEFFS 0 100 0 0 0 1 /end COMPU_METHOD
/begin COMPU_METHOD EngN_LRes "" RAT_FUNC "%6.1" "rpm" COEFFS 0 0.025 0 0 0 1 /end COMPU_METHOD
/begin COMPU_METHOD Fact "" RAT_FUNC "%6.5" "-" COEFFS 0 8192 0 0 0 1 /end COMPU_METHOD
/begin COMPU_METHOD Fact100 "" RAT_FUNC "%6.4" "-" COEFFS 0 100 0 0 0 1 /end COMPU_METHOD
/begin COMPU_METHOD OneToOne "" RAT_FUNC "%6.2" "-" COEFFS 0 1 0 0 0 1 /end COMPU_METHOD
/begin COMPU_METHOD Prc "" RAT_FUNC "%6.4" "%" COEFFS 0 81.92 0 0 0 1 /end COMPU_METHOD
/begin COMPU_METHOD Pres_hPa "" RAT_FUNC "%6.2" "hPa" COEFFS 0 1 0 0 0 1 /end COMPU_METHOD
/begin COMPU_METHOD p_q0p039 "" RAT_FUNC "%6.4" "hPa" COEFFS 0 256 0 0 0 10 /end COMPU_METHOD
/begin COMPU_METHOD p_q0p1_bar "" RAT_FUNC "%6.3" "bar" COEFFS 0 10 0 0 0 1 /end COMPU_METHOD
/begin COMPU_METHOD q0p01_s "" RAT_FUNC "%6.4" "s" COEFFS 0 100 0 0 0 1 /end COMPU_METHOD
/begin COMPU_METHOD q1 "" RAT_FUNC "%6.2" "-" COEFFS 0 1 0 0 0 1 /end COMPU_METHOD
/begin COMPU_METHOD RBPtCel_i_1p0_2 "" RAT_FUNC "%6.2" "A" COEFFS 0 1 0 0 0 1 /end COMPU_METHOD
/begin COMPU_METHOD RBPtCel_Perc_1p0_1 "" RAT_FUNC "%6.2" "%" COEFFS 0 1 0 0 0 1 /end COMPU_METHOD
/begin COMPU_METHOD RBPtCel_p_1p0_1 "" RAT_FUNC "%6.2" "hPa" COEFFS 0 1 0 0 0 1 /end COMPU_METHOD
/begin COMPU_METHOD RBPtCel_ti_0p01_1 "" RAT_FUNC "%6.4" "s" COEFFS 0 100 0 0 0 1 /end COMPU_METHOD
/begin COMPU_METHOD RBPtCel_ti_0p02_1 "" RAT_FUNC "%6.4" "s" COEFFS 0 100 0 0 0 2 /end COMPU_METHOD
/begin COMPU_METHOD RBPtCel_ti_10p0_1 "" RAT_FUNC "%6.1" "ms" COEFFS 0 1 0 0 0 10 /end COMPU_METHOD
/begin COMPU_METHOD RBPtCel_t_1p0_3 "" RAT_FUNC "%6.2" "Deg C" COEFFS 0 1 0 0 0 1 /end COMPU_METHOD
/begin COMPU_METHOD RBPtCel_u_0p2_1 "" RAT_FUNC "%6.3" "mV" COEFFS 0 5 0 0 0 1 /end COMPU_METHOD
/begin COMPU_METHOD RBPtCel_u_1p0_1 "" RAT_FUNC "%6.2" "V" COEFFS 0 1 0 0 0 1 /end COMPU_METHOD
/begin COMPU_METHOD SigQly_COMPU_VERB "" TAB_VERB "%6.3" "" COMPU_TAB_REF SigQly_COMPU_VERB /end COMPU_METHOD
/begin COMPU_VTAB SigQly_COMPU_VERB "" TAB_VERB 16 0 "SIGQLY_NOTCALC" 1 "SIGQLY_INIT" 2 "SIGQLY_OK" 3 "SIGQLY_MODEL" 4 "SIGQLY_REPLACEMENT" 5 "SIGQLY_FROZEN" 6 "SIGQLY_INVALID" 7 "SIGQLY_RESERVED_7" 8 "SIGQLY_RESERVED_8" 9 "SIGQLY_RESERVED_9" 10 "SIGQLY_RESERVED_10" 11 "SIGQLY_RESERVED_11" 12 "SIGQLY_RESERVED_12" 13 "SIGQLY_RESERVED_13" 14 "SIGQLY_RESERVED_14" 15 "SIGQLY_RESERVED_15" /end COMPU_VTAB
/begin COMPU_METHOD SrvB_SWTmrS16 "" RAT_FUNC "%6.2" "-" COEFFS 0 1 0 0 0 1 /end COMPU_METHOD
/begin COMPU_METHOD TimeDelay_s "" RAT_FUNC "%6.1" "s" COEFFS 0 0 1 0 0.00023283064365387 0 /end COMPU_METHOD
/begin COMPU_METHOD Time_ms "" RAT_FUNC "%6.1" "ms" COEFFS 0 0.1 0 0 0 1 /end COMPU_METHOD
/begin COMPU_METHOD Time_s "" RAT_FUNC "%6.4" "s" COEFFS 0 100 0 0 0 1 /end COMPU_METHOD
/begin COMPU_METHOD TrqPrpHigh "" RAT_FUNC "%6.3" "Nm" COEFFS 0 10 0 0 0 1 /end COMPU_METHOD
/begin COMPU_METHOD TurboN "" RAT_FUNC "%6.1" "rpm" COEFFS 0 0.1 0 0 0 1 /end COMPU_METHOD
/begin COMPU_METHOD t_q0p0001_s "" RAT_FUNC "%7.6" "s" COEFFS 0 10000 0 0 0 1 /end COMPU_METHOD
/begin COMPU_METHOD t_q0p005 "" RAT_FUNC "%6.4" "s" COEFFS 0 1000 0 0 0 5 /end COMPU_METHOD
/begin COMPU_METHOD Vel "" RAT_FUNC "%6.4" "km/h" COEFFS 0 100 0 0 0 1 /end COMPU_METHOD
/begin COMPU_METHOD Volt "" RAT_FUNC "%6.3" "mV" COEFFS 0 5 0 0 0 1 /end COMPU_METHOD
/begin COMPU_METHOD Volt_Batt "" RAT_FUNC "%6.1" "mV" COEFFS 0 0.05 0 0 0 1 /end COMPU_METHOD
/begin RECORD_LAYOUT RB_Curve_S16_S16 NO_AXIS_PTS_X 1 SWORD AXIS_PTS_X 2 SWORD INDEX_INCR DIRECT FNC_VALUES 3 SWORD COLUMN_DIR DIRECT /end RECORD_LAYOUT
/begin RECORD_LAYOUT RB_Curve_U16_S16_sao NO_AXIS_PTS_X 1 UWORD AXIS_PTS_X 2 UWORD INDEX_INCR DIRECT FNC_VALUES 3 SWORD COLUMN_DIR DIRECT STATIC_ADDRESS_OFFSETS /end RECORD_LAYOUT
/begin RECORD_LAYOUT RB_Map_S16S16_S16 NO_AXIS_PTS_X 1 SWORD NO_AXIS_PTS_Y 2 SWORD AXIS_PTS_X 3 SWORD INDEX_INCR DIRECT AXIS_PTS_Y 4 SWORD INDEX_INCR DIRECT FNC_VALUES 5 SWORD COLUMN_DIR DIRECT /end RECORD_LAYOUT
/begin RECORD_LAYOUT RB_Map_S16U16_S16_sao NO_AXIS_PTS_X 1 SWORD NO_AXIS_PTS_Y 2 SWORD AXIS_PTS_X 3 SWORD INDEX_INCR DIRECT AXIS_PTS_Y 4 UWORD INDEX_INCR DIRECT FNC_VALUES 5 SWORD ROW_DIR DIRECT STATIC_ADDRESS_OFFSETS /end RECORD_LAYOUT
/begin RECORD_LAYOUT RB_Map_U16S16_S16_sao NO_AXIS_PTS_X 1 UWORD NO_AXIS_PTS_Y 2 UWORD AXIS_PTS_X 3 UWORD INDEX_INCR DIRECT AXIS_PTS_Y 4 SWORD INDEX_INCR DIRECT FNC_VALUES 5 SWORD COLUMN_DIR DIRECT STATIC_ADDRESS_OFFSETS /end RECORD_LAYOUT
/begin RECORD_LAYOUT RB_Val_Wboolean FNC_VALUES 1 UBYTE COLUMN_DIR DIRECT /end RECORD_LAYOUT
/begin RECORD_LAYOUT RB_Val_Ws16 FNC_VALUES 1 SWORD COLUMN_DIR DIRECT /end RECORD_LAYOUT
/begin RECORD_LAYOUT RB_Val_Ws32 FNC_VALUES 1 SLONG COLUMN_DIR DIRECT /end RECORD_LAYOUT
/begin RECORD_LAYOUT RB_Val_Wu16 FNC_VALUES 1 UWORD COLUMN_DIR DIRECT /end RECORD_LAYOUT
/begin RECORD_LAYOUT RB_Val_Wu32 FNC_VALUES 1 ULONG COLUMN_DIR DIRECT /end RECORD_LAYOUT
/begin RECORD_LAYOUT RB_Val_Wu8 FNC_VALUES 1 UBYTE COLUMN_DIR DIRECT /end RECORD_LAYOUT
/begin RECORD_LAYOUT Val_Ws16 FNC_VALUES 1 SWORD COLUMN_DIR DIRECT /end RECORD_LAYOUT
/begin RECORD_LAYOUT Val_Ws32 FNC_VALUES 1 SLONG COLUMN_DIR DIRECT /end RECORD_LAYOUT
/begin RECORD_LAYOUT Val_Wu16 FNC_VALUES 1 UWORD COLUMN_DIR DIRECT /end RECORD_LAYOUT
/begin RECORD_LAYOUT Val_Wu8 FNC_VALUES 1 UBYTE COLUMN_DIR DIRECT /end RECORD_LAYOUT
/end MODULE
/end PROJECT

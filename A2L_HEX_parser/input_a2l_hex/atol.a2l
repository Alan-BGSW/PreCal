ASAP2_VERSION 1 70
/begin PROJECT MDG1C "VC1CP091_STLA_N_D061I3"
/begin HEADER "" VERSION "VC1CP091_STLA_N_D061I3" PROJECT_NO MDG1C /end HEADER
/begin MODULE DIM ""
/begin MOD_COMMON "" BYTE_ORDER MSB_LAST ALIGNMENT_BYTE 1 ALIGNMENT_WORD 2 ALIGNMENT_LONG 4 ALIGNMENT_INT64 4 ALIGNMENT_FLOAT32_IEEE 4 ALIGNMENT_FLOAT64_IEEE 4 DATA_SIZE 32 /end MOD_COMMON
/begin CHARACTERISTIC DFES_Cls.DFC_HvBattMaiSwtWldd_C "" VALUE 0x80241748 Val_Wu8 3.000 DFES_OneToOne 0.00 3.000 FORMAT "%5.3" EXTENDED_LIMITS 0.00 255.0 /end CHARACTERISTIC
/begin CHARACTERISTIC DFES_Cls.DFC_HvBattNegCntctrCntErr_C "" VALUE 0x80241749 Val_Wu8 3.000 DFES_OneToOne 0.00 3.000 FORMAT "%5.3" EXTENDED_LIMITS 0.00 255.0 /end CHARACTERISTIC
/begin CHARACTERISTIC DFES_Cls.DFC_HvBattOperModChrgPlausy_C "" VALUE 0x8024174A Val_Wu8 3.000 DFES_OneToOne 0.00 3.000 FORMAT "%5.3" EXTENDED_LIMITS 0.00 255.0 /end CHARACTERISTIC
/begin CHARACTERISTIC DFES_Cls.DFC_HvBattOverTDern_C "" VALUE 0x8024174B Val_Wu8 3.000 DFES_OneToOne 0.00 3.000 FORMAT "%5.3" EXTENDED_LIMITS 0.00 255.0 /end CHARACTERISTIC
/begin CHARACTERISTIC DFES_Cls.DFC_HvBattPosCntctrCntErr_C "" VALUE 0x8024174C Val_Wu8 3.000 DFES_OneToOne 0.00 3.000 FORMAT "%5.3" EXTENDED_LIMITS 0.00 255.0 /end CHARACTERISTIC
/begin CHARACTERISTIC DFES_Cls.DFC_HvBattPrecCntctrCntErr_C "" VALUE 0x8024174D Val_Wu8 3.000 DFES_OneToOne 0.00 3.000 FORMAT "%5.3" EXTENDED_LIMITS 0.00 255.0 /end CHARACTERISTIC
/begin CHARACTERISTIC DFES_Cls.DFC_HvBattPwrDistbnTDern_C "" VALUE 0x8024174E Val_Wu8 3.000 DFES_OneToOne 0.00 3.000 FORMAT "%5.3" EXTENDED_LIMITS 0.00 255.0 /end CHARACTERISTIC
/begin CHARACTERISTIC DFES_Cls.DFC_HvBattPwrDistbnTInhbn_C "" VALUE 0x8024174F Val_Wu8 3.000 DFES_OneToOne 0.00 3.000 FORMAT "%5.3" EXTENDED_LIMITS 0.00 255.0 /end CHARACTERISTIC
/begin CHARACTERISTIC DFES_Cls.DFC_HvBattRatRSohErr_C "" VALUE 0x80241750 Val_Wu8 3.000 DFES_OneToOne 0.00 3.000 FORMAT "%5.3" EXTENDED_LIMITS 0.00 255.0 /end CHARACTERISTIC
/begin CHARACTERISTIC DFES_Cls.DFC_HvBattRatSohErr_C "" VALUE 0x80241751 Val_Wu8 3.000 DFES_OneToOne 0.00 3.000 FORMAT "%5.3" EXTENDED_LIMITS 0.00 255.0 /end CHARACTERISTIC
/begin CHARACTERISTIC DFES_Cls.DFC_HvBattSngIsoWarn_C "" VALUE 0x80241752 Val_Wu8 3.000 DFES_OneToOne 0.00 3.000 FORMAT "%5.3" EXTENDED_LIMITS 0.00 255.0 /end CHARACTERISTIC
/begin CHARACTERISTIC DFES_Cls.DFC_HvBattSrvPlgDiscnct_C "" VALUE 0x80241753 Val_Wu8 3.000 DFES_OneToOne 0.00 3.000 FORMAT "%5.3" EXTENDED_LIMITS 0.00 255.0 /end CHARACTERISTIC
/begin CHARACTERISTIC DFES_Cls.DFC_HvBattUNomChrgnErr_C "" VALUE 0x80241754 Val_Wu8 3.000 DFES_OneToOne 0.00 3.000 FORMAT "%5.3" EXTENDED_LIMITS 0.00 255.0 /end CHARACTERISTIC
/begin CHARACTERISTIC DFES_Cls.DFC_HvBattUNomChrgnIni_C "" VALUE 0x80241755 Val_Wu8 3.000 DFES_OneToOne 0.00 3.000 FORMAT "%5.3" EXTENDED_LIMITS 0.00 255.0 /end CHARACTERISTIC
/begin CHARACTERISTIC DFES_Cls.DFC_HvBattUnderTDern_C "" VALUE 0x80241756 Val_Wu8 3.000 DFES_OneToOne 0.00 3.000 FORMAT "%5.3" EXTENDED_LIMITS 0.00 255.0 /end CHARACTERISTIC
/begin CHARACTERISTIC DFES_Cls.DFC_HvbEVLmpBlink_C "" VALUE 0x80241757 Val_Wu8 3.000 DFES_OneToOne 0.00 3.000 FORMAT "%5.3" EXTENDED_LIMITS 0.00 255.0 /end CHARACTERISTIC
/begin CHARACTERISTIC DFES_Cls.DFC_HvbEVLmpCont_C "" VALUE 0x80241758 Val_Wu8 3.000 DFES_OneToOne 0.00 3.000 FORMAT "%5.3" EXTENDED_LIMITS 0.00 255.0 /end CHARACTERISTIC
/begin CHARACTERISTIC DFES_Cls.DFC_HvbSVSBlink_C "" VALUE 0x80241759 Val_Wu8 3.000 DFES_OneToOne 0.00 3.000 FORMAT "%5.3" EXTENDED_LIMITS 0.00 255.0 /end CHARACTERISTIC
/begin CHARACTERISTIC DFES_Cls.DFC_HvbSVSCont_C "" VALUE 0x8024175A Val_Wu8 3.000 DFES_OneToOne 0.00 3.000 FORMAT "%5.3" EXTENDED_LIMITS 0.00 255.0 /end CHARACTERISTIC
/begin CHARACTERISTIC DFES_Cls.DFC_InmLINBusBlk_C "" VALUE 0x8024175B Val_Wu8 3.000 DFES_OneToOne 0.00 3.000 FORMAT "%5.3" EXTENDED_LIMITS 0.00 255.0 /end CHARACTERISTIC
/begin CHARACTERISTIC DFES_Cls.DFC_PDUProgmFailr_C "" VALUE 0x8024175C Val_Wu8 3.000 DFES_OneToOne 0.00 3.000 FORMAT "%5.3" EXTENDED_LIMITS 0.00 255.0 /end CHARACTERISTIC
/begin CHARACTERISTIC DFES_Cls.DFC_PEnvSigRngMax_C "" VALUE 0x8024175D Val_Wu8 3.000 DFES_OneToOne 0.00 3.000 FORMAT "%5.3" EXTENDED_LIMITS 0.00 255.0 /end CHARACTERISTIC
/begin CHARACTERISTIC DFES_Cls.DFC_PEnvSigRngMin_C "" VALUE 0x8024175E Val_Wu8 3.000 DFES_OneToOne 0.00 3.000 FORMAT "%5.3" EXTENDED_LIMITS 0.00 255.0 /end CHARACTERISTIC
/begin CHARACTERISTIC DFES_Cls.DFC_PLnCChpDeactvnFaild_C "" VALUE 0x8024175F Val_Wu8 3.000 DFES_OneToOne 0.00 3.000 FORMAT "%5.3" EXTENDED_LIMITS 0.00 255.0 /end CHARACTERISTIC
/begin CHARACTERISTIC DFES_Cls.DFC_PrkgBrkFailr_C "" VALUE 0x80241760 Val_Wu8 3.000 DFES_OneToOne 0.00 3.000 FORMAT "%5.3" EXTENDED_LIMITS 0.00 255.0 /end CHARACTERISTIC
/begin CHARACTERISTIC DFES_Cls.DFC_PtSysLimErr_C "" VALUE 0x80241761 Val_Wu8 3.000 DFES_OneToOne 0.00 3.000 FORMAT "%5.3" EXTENDED_LIMITS 0.00 255.0 /end CHARACTERISTIC
/begin CHARACTERISTIC DFES_Cls.DFC_PwrMaxDchaShoLo_C "" VALUE 0x80241762 Val_Wu8 3.000 DFES_OneToOne 0.00 3.000 FORMAT "%5.3" EXTENDED_LIMITS 0.00 255.0 /end CHARACTERISTIC
/begin CHARACTERISTIC DFES_Cls.DFC_SCtPmp1FailSafeNotSuc_C "" VALUE 0x80241763 Val_Wu8 3.000 DFES_OneToOne 0.00 3.000 FORMAT "%5.3" EXTENDED_LIMITS 0.00 255.0 /end CHARACTERISTIC
/begin CHARACTERISTIC DFES_Cls.DFC_SCtPmp1SCG_C "" VALUE 0x80241764 Val_Wu8 3.000 DFES_OneToOne 0.00 3.000 FORMAT "%5.3" EXTENDED_LIMITS 0.00 255.0 /end CHARACTERISTIC
/begin CHARACTERISTIC DFES_Cls.DFC_VehCoornDrvrNotPrsnt_C "" VALUE 0x80241765 Val_Wu8 3.000 DFES_OneToOne 0.00 3.000 FORMAT "%5.3" EXTENDED_LIMITS 0.00 255.0 /end CHARACTERISTIC
/begin CHARACTERISTIC DFES_Cls.DFC_VehVCanAvl_C "" VALUE 0x80241766 Val_Wu8 3.000 DFES_OneToOne 0.00 3.000 FORMAT "%5.3" EXTENDED_LIMITS 0.00 255.0 /end CHARACTERISTIC
/begin CHARACTERISTIC DFES_Cls.DFC_VehVCanErr_C "" VALUE 0x80241767 Val_Wu8 3.000 DFES_OneToOne 0.00 3.000 FORMAT "%5.3" EXTENDED_LIMITS 0.00 255.0 /end CHARACTERISTIC
/begin CHARACTERISTIC DFES_Cls.DFC_eTogFailrLvlRes_C "" VALUE 0x80241768 Val_Wu8 3.000 DFES_OneToOne 0.00 3.000 FORMAT "%5.3" EXTENDED_LIMITS 0.00 255.0 /end CHARACTERISTIC
/begin CHARACTERISTIC DFES_Cls.DFC_flgBrkMaiDiag_C "" VALUE 0x80241769 Val_Wu8 3.000 DFES_OneToOne 0.00 3.000 FORMAT "%5.3" EXTENDED_LIMITS 0.00 255.0 /end CHARACTERISTIC
/begin CHARACTERISTIC DFES_Cls.DFC_stHvbIsoMeasmtRes_C "" VALUE 0x8024176A Val_Wu8 3.000 DFES_OneToOne 0.00 3.000 FORMAT "%5.3" EXTENDED_LIMITS 0.00 255.0 /end CHARACTERISTIC
/begin CHARACTERISTIC DFES_Cls.DFC_BrkBstPmpPLeakDfct_C "" VALUE 0x8024176B Val_Wu8 3.000 DFES_OneToOne 0.00 3.000 FORMAT "%5.3" EXTENDED_LIMITS 0.00 255.0 /end CHARACTERISTIC
/begin CHARACTERISTIC DFES_Cls.DFC_Com082hTooShort_C "" VALUE 0x8024176C Val_Wu8 3.000 DFES_OneToOne 0.00 3.000 FORMAT "%5.3" EXTENDED_LIMITS 0.00 255.0 /end CHARACTERISTIC
/begin CHARACTERISTIC DFES_Cls.DFC_Com092hTooShort_C "" VALUE 0x8024176D Val_Wu8 3.000 DFES_OneToOne 0.00 3.000 FORMAT "%5.3" EXTENDED_LIMITS 0.00 255.0 /end CHARACTERISTIC
/begin CHARACTERISTIC DFES_Cls.DFC_Com205hAbsent_C "" VALUE 0x8024176E Val_Wu8 3.000 DFES_OneToOne 0.00 3.000 FORMAT "%5.3" EXTENDED_LIMITS 0.00 255.0 /end CHARACTERISTIC
/begin CHARACTERISTIC DFES_Cls.DFC_Com205hChecksum_C "" VALUE 0x8024176F Val_Wu8 3.000 DFES_OneToOne 0.00 3.000 FORMAT "%5.3" EXTENDED_LIMITS 0.00 255.0 /end CHARACTERISTIC
/begin CHARACTERISTIC DFES_Cls.DFC_Com205hCounter_C "" VALUE 0x80241770 Val_Wu8 3.000 DFES_OneToOne 0.00 3.000 FORMAT "%5.3" EXTENDED_LIMITS 0.00 255.0 /end CHARACTERISTIC
/begin CHARACTERISTIC DFES_Cls.DFC_Com205hTooShort_C "" VALUE 0x80241771 Val_Wu8 3.000 DFES_OneToOne 0.00 3.000 FORMAT "%5.3" EXTENDED_LIMITS 0.00 255.0 /end CHARACTERISTIC
/begin CHARACTERISTIC DFES_Cls.DFC_Com217hAbsent_C "" VALUE 0x80241772 Val_Wu8 3.000 DFES_OneToOne 0.00 3.000 FORMAT "%5.3" EXTENDED_LIMITS 0.00 255.0 /end CHARACTERISTIC
/begin CHARACTERISTIC DFES_Cls.DFC_Com217hChecksum_C "" VALUE 0x80241773 Val_Wu8 3.000 DFES_OneToOne 0.00 3.000 FORMAT "%5.3" EXTENDED_LIMITS 0.00 255.0 /end CHARACTERISTIC
/begin CHARACTERISTIC DFES_Cls.DFC_Com217hCounter_C "" VALUE 0x80241774 Val_Wu8 3.000 DFES_OneToOne 0.00 3.000 FORMAT "%5.3" EXTENDED_LIMITS 0.00 255.0 /end CHARACTERISTIC
/begin CHARACTERISTIC DFES_Cls.DFC_Com217hTooShort_C "" VALUE 0x80241775 Val_Wu8 3.000 DFES_OneToOne 0.00 3.000 FORMAT "%5.3" EXTENDED_LIMITS 0.00 255.0 /end CHARACTERISTIC
/begin CHARACTERISTIC DFES_Cls.DFC_Com227hAbsent_C "" VALUE 0x80241776 Val_Wu8 3.000 DFES_OneToOne 0.00 3.000 FORMAT "%5.3" EXTENDED_LIMITS 0.00 255.0 /end CHARACTERISTIC
/begin CHARACTERISTIC DFES_Cls.DFC_Com227hTooShort_C "" VALUE 0x80241777 Val_Wu8 3.000 DFES_OneToOne 0.00 3.000 FORMAT "%5.3" EXTENDED_LIMITS 0.00 255.0 /end CHARACTERISTIC
/begin CHARACTERISTIC DFES_Cls.DFC_Com237hAbsent_C "" VALUE 0x80241778 Val_Wu8 3.000 DFES_OneToOne 0.00 3.000 FORMAT "%5.3" EXTENDED_LIMITS 0.00 255.0 /end CHARACTERISTIC
/begin CHARACTERISTIC DFES_Cls.DFC_Com237hChecksum_C "" VALUE 0x80241779 Val_Wu8 3.000 DFES_OneToOne 0.00 3.000 FORMAT "%5.3" EXTENDED_LIMITS 0.00 255.0 /end CHARACTERISTIC
/begin CHARACTERISTIC DFES_Cls.DFC_Com237hCounter_C "" VALUE 0x8024177A Val_Wu8 3.000 DFES_OneToOne 0.00 3.000 FORMAT "%5.3" EXTENDED_LIMITS 0.00 255.0 /end CHARACTERISTIC
/begin CHARACTERISTIC DFES_Cls.DFC_Com237hTooShort_C "" VALUE 0x8024177B Val_Wu8 3.000 DFES_OneToOne 0.00 3.000 FORMAT "%5.3" EXTENDED_LIMITS 0.00 255.0 /end CHARACTERISTIC
/begin CHARACTERISTIC DFES_Cls.DFC_Com259hAbsent_C "" VALUE 0x8024177C Val_Wu8 3.000 DFES_OneToOne 0.00 3.000 FORMAT "%5.3" EXTENDED_LIMITS 0.00 255.0 /end CHARACTERISTIC
/begin CHARACTERISTIC DFES_Cls.DFC_Com259hChecksum_C "" VALUE 0x8024177D Val_Wu8 3.000 DFES_OneToOne 0.00 3.000 FORMAT "%5.3" EXTENDED_LIMITS 0.00 255.0 /end CHARACTERISTIC
/begin CHARACTERISTIC DFES_Cls.DFC_Com259hCounter_C "" VALUE 0x8024177E Val_Wu8 3.000 DFES_OneToOne 0.00 3.000 FORMAT "%5.3" EXTENDED_LIMITS 0.00 255.0 /end CHARACTERISTIC
/begin CHARACTERISTIC DFES_Cls.DFC_Com259hTooShort_C "" VALUE 0x8024177F Val_Wu8 3.000 DFES_OneToOne 0.00 3.000 FORMAT "%5.3" EXTENDED_LIMITS 0.00 255.0 /end CHARACTERISTIC
/begin CHARACTERISTIC DFES_Cls.DFC_Com26hAbsent_C "" VALUE 0x80241780 Val_Wu8 3.000 DFES_OneToOne 0.00 3.000 FORMAT "%5.3" EXTENDED_LIMITS 0.00 255.0 /end CHARACTERISTIC
/begin CHARACTERISTIC DFES_Cls.DFC_Com26hTooShort_C "" VALUE 0x80241781 Val_Wu8 3.000 DFES_OneToOne 0.00 3.000 FORMAT "%5.3" EXTENDED_LIMITS 0.00 255.0 /end CHARACTERISTIC
/begin CHARACTERISTIC DFES_Cls.DFC_Com273hAbsent_C "" VALUE 0x80241782 Val_Wu8 3.000 DFES_OneToOne 0.00 3.000 FORMAT "%5.3" EXTENDED_LIMITS 0.00 255.0 /end CHARACTERISTIC
/begin CHARACTERISTIC DFES_Cls.DFC_Com273hChecksum_C "" VALUE 0x80241783 Val_Wu8 3.000 DFES_OneToOne 0.00 3.000 FORMAT "%5.3" EXTENDED_LIMITS 0.00 255.0 /end CHARACTERISTIC
/begin CHARACTERISTIC DFES_Cls.DFC_Com273hCounter_C "" VALUE 0x80241784 Val_Wu8 3.000 DFES_OneToOne 0.00 3.000 FORMAT "%5.3" EXTENDED_LIMITS 0.00 255.0 /end CHARACTERISTIC
/begin CHARACTERISTIC DFES_Cls.DFC_Com273hTooShort_C "" VALUE 0x80241785 Val_Wu8 3.000 DFES_OneToOne 0.00 3.000 FORMAT "%5.3" EXTENDED_LIMITS 0.00 255.0 /end CHARACTERISTIC
/begin CHARACTERISTIC DFES_Cls.DFC_Com275hAbsent_C "" VALUE 0x80241786 Val_Wu8 3.000 DFES_OneToOne 0.00 3.000 FORMAT "%5.3" EXTENDED_LIMITS 0.00 255.0 /end CHARACTERISTIC
/begin CHARACTERISTIC DFES_Cls.DFC_Com275hChecksum_C "" VALUE 0x80241787 Val_Wu8 3.000 DFES_OneToOne 0.00 3.000 FORMAT "%5.3" EXTENDED_LIMITS 0.00 255.0 /end CHARACTERISTIC
/begin CHARACTERISTIC DFES_Cls.DFC_Com275hCounter_C "" VALUE 0x80241788 Val_Wu8 3.000 DFES_OneToOne 0.00 3.000 FORMAT "%5.3" EXTENDED_LIMITS 0.00 255.0 /end CHARACTERISTIC
/begin CHARACTERISTIC DFES_Cls.DFC_Com275hTooShort_C "" VALUE 0x80241789 Val_Wu8 3.000 DFES_OneToOne 0.00 3.000 FORMAT "%5.3" EXTENDED_LIMITS 0.00 255.0 /end CHARACTERISTIC
/begin CHARACTERISTIC DFES_Cls.DFC_Com283hAbsent_C "" VALUE 0x8024178A Val_Wu8 3.000 DFES_OneToOne 0.00 3.000 FORMAT "%5.3" EXTENDED_LIMITS 0.00 255.0 /end CHARACTERISTIC
/begin CHARACTERISTIC DFES_Cls.DFC_Com283hTooShort_C "" VALUE 0x8024178B Val_Wu8 3.000 DFES_OneToOne 0.00 3.000 FORMAT "%5.3" EXTENDED_LIMITS 0.00 255.0 /end CHARACTERISTIC
/begin CHARACTERISTIC DFES_Cls.DFC_Com285hAbsent_C "" VALUE 0x8024178C Val_Wu8 3.000 DFES_OneToOne 0.00 3.000 FORMAT "%5.3" EXTENDED_LIMITS 0.00 255.0 /end CHARACTERISTIC
/begin CHARACTERISTIC DFES_Cls.DFC_Com285hChecksum_C "" VALUE 0x8024178D Val_Wu8 3.000 DFES_OneToOne 0.00 3.000 FORMAT "%5.3" EXTENDED_LIMITS 0.00 255.0 /end CHARACTERISTIC
/begin CHARACTERISTIC DFES_Cls.DFC_Com285hCounter_C "" VALUE 0x8024178E Val_Wu8 3.000 DFES_OneToOne 0.00 3.000 FORMAT "%5.3" EXTENDED_LIMITS 0.00 255.0 /end CHARACTERISTIC
/begin CHARACTERISTIC DFES_Cls.DFC_Com285hTooShort_C "" VALUE 0x8024178F Val_Wu8 3.000 DFES_OneToOne 0.00 3.000 FORMAT "%5.3" EXTENDED_LIMITS 0.00 255.0 /end CHARACTERISTIC
/begin CHARACTERISTIC DFES_Cls.DFC_Com293hAbsent_C "" VALUE 0x80241790 Val_Wu8 3.000 DFES_OneToOne 0.00 3.000 FORMAT "%5.3" EXTENDED_LIMITS 0.00 255.0 /end CHARACTERISTIC
/begin CHARACTERISTIC DFES_Cls.DFC_Com293hChecksum_C "" VALUE 0x80241791 Val_Wu8 3.000 DFES_OneToOne 0.00 3.000 FORMAT "%5.3" EXTENDED_LIMITS 0.00 255.0 /end CHARACTERISTIC
/begin CHARACTERISTIC DFES_Cls.DFC_Com293hCounter_C "" VALUE 0x80241792 Val_Wu8 3.000 DFES_OneToOne 0.00 3.000 FORMAT "%5.3" EXTENDED_LIMITS 0.00 255.0 /end CHARACTERISTIC
/begin CHARACTERISTIC DFES_Cls.DFC_Com293hTooShort_C "" VALUE 0x80241793 Val_Wu8 3.000 DFES_OneToOne 0.00 3.000 FORMAT "%5.3" EXTENDED_LIMITS 0.00 255.0 /end CHARACTERISTIC
/begin CHARACTERISTIC DFES_Cls.DFC_Com308hAbsent_C "" VALUE 0x80241794 Val_Wu8 3.000 DFES_OneToOne 0.00 3.000 FORMAT "%5.3" EXTENDED_LIMITS 0.00 255.0 /end CHARACTERISTIC
/begin CHARACTERISTIC DFES_Cls.DFC_Com308hChecksum_C "" VALUE 0x80241795 Val_Wu8 3.000 DFES_OneToOne 0.00 3.000 FORMAT "%5.3" EXTENDED_LIMITS 0.00 255.0 /end CHARACTERISTIC
/begin CHARACTERISTIC DFES_Cls.DFC_Com308hCounter_C "" VALUE 0x80241796 Val_Wu8 3.000 DFES_OneToOne 0.00 3.000 FORMAT "%5.3" EXTENDED_LIMITS 0.00 255.0 /end CHARACTERISTIC
/begin CHARACTERISTIC DFES_Cls.DFC_Com308hTooShort_C "" VALUE 0x80241797 Val_Wu8 3.000 DFES_OneToOne 0.00 3.000 FORMAT "%5.3" EXTENDED_LIMITS 0.00 255.0 /end CHARACTERISTIC
/begin CHARACTERISTIC DFES_Cls.DFC_Com318hAbsent_C "" VALUE 0x80241798 Val_Wu8 3.000 DFES_OneToOne 0.00 3.000 FORMAT "%5.3" EXTENDED_LIMITS 0.00 255.0 /end CHARACTERISTIC
/begin CHARACTERISTIC DFES_Cls.DFC_Com318hChecksum_C "" VALUE 0x80241799 Val_Wu8 3.000 DFES_OneToOne 0.00 3.000 FORMAT "%5.3" EXTENDED_LIMITS 0.00 255.0 /end CHARACTERISTIC
/begin CHARACTERISTIC DFES_Cls.DFC_Com318hCounter_C "" VALUE 0x8024179A Val_Wu8 3.000 DFES_OneToOne 0.00 3.000 FORMAT "%5.3" EXTENDED_LIMITS 0.00 255.0 /end CHARACTERISTIC
/begin CHARACTERISTIC DFES_Cls.DFC_Com318hTooShort_C "" VALUE 0x8024179B Val_Wu8 3.000 DFES_OneToOne 0.00 3.000 FORMAT "%5.3" EXTENDED_LIMITS 0.00 255.0 /end CHARACTERISTIC
/begin CHARACTERISTIC DFES_Cls.DFC_Com325hAbsent_C "" VALUE 0x8024179C Val_Wu8 3.000 DFES_OneToOne 0.00 3.000 FORMAT "%5.3" EXTENDED_LIMITS 0.00 255.0 /end CHARACTERISTIC
/begin CHARACTERISTIC DFES_Cls.DFC_Com325hChecksum_C "" VALUE 0x8024179D Val_Wu8 3.000 DFES_OneToOne 0.00 3.000 FORMAT "%5.3" EXTENDED_LIMITS 0.00 255.0 /end CHARACTERISTIC
/begin CHARACTERISTIC DFES_Cls.DFC_Com325hCounter_C "" VALUE 0x8024179E Val_Wu8 3.000 DFES_OneToOne 0.00 3.000 FORMAT "%5.3" EXTENDED_LIMITS 0.00 255.0 /end CHARACTERISTIC
/begin CHARACTERISTIC DFES_Cls.DFC_Com325hTooShort_C "" VALUE 0x8024179F Val_Wu8 3.000 DFES_OneToOne 0.00 3.000 FORMAT "%5.3" EXTENDED_LIMITS 0.00 255.0 /end CHARACTERISTIC
/begin CHARACTERISTIC DFES_Cls.DFC_Com335hAbsent_C "" VALUE 0x802417A0 Val_Wu8 3.000 DFES_OneToOne 0.00 3.000 FORMAT "%5.3" EXTENDED_LIMITS 0.00 255.0 /end CHARACTERISTIC
/begin CHARACTERISTIC DFES_Cls.DFC_Com335hChecksum_C "" VALUE 0x802417A1 Val_Wu8 3.000 DFES_OneToOne 0.00 3.000 FORMAT "%5.3" EXTENDED_LIMITS 0.00 255.0 /end CHARACTERISTIC
/begin CHARACTERISTIC DFES_Cls.DFC_Com335hCounter_C "" VALUE 0x802417A2 Val_Wu8 3.000 DFES_OneToOne 0.00 3.000 FORMAT "%5.3" EXTENDED_LIMITS 0.00 255.0 /end CHARACTERISTIC
/begin CHARACTERISTIC DFES_Cls.DFC_Com335hTooShort_C "" VALUE 0x802417A3 Val_Wu8 3.000 DFES_OneToOne 0.00 3.000 FORMAT "%5.3" EXTENDED_LIMITS 0.00 255.0 /end CHARACTERISTIC
/begin CHARACTERISTIC DFES_Cls.DFC_Com351hAbsent_C "" VALUE 0x802417A4 Val_Wu8 3.000 DFES_OneToOne 0.00 3.000 FORMAT "%5.3" EXTENDED_LIMITS 0.00 255.0 /end CHARACTERISTIC
/begin CHARACTERISTIC DFES_Cls.DFC_Com351hTooShort_C "" VALUE 0x802417A5 Val_Wu8 3.000 DFES_OneToOne 0.00 3.000 FORMAT "%5.3" EXTENDED_LIMITS 0.00 255.0 /end CHARACTERISTIC
/begin CHARACTERISTIC DFES_Cls.DFC_Com38DhAbsent_C "" VALUE 0x802417A6 Val_Wu8 3.000 DFES_OneToOne 0.00 3.000 FORMAT "%5.3" EXTENDED_LIMITS 0.00 255.0 /end CHARACTERISTIC
/begin CHARACTERISTIC DFES_Cls.DFC_Com38DhChecksum_C "" VALUE 0x802417A7 Val_Wu8 3.000 DFES_OneToOne 0.00 3.000 FORMAT "%5.3" EXTENDED_LIMITS 0.00 255.0 /end CHARACTERISTIC
/begin CHARACTERISTIC DFES_Cls.DFC_Com38DhCounter_C "" VALUE 0x802417A8 Val_Wu8 3.000 DFES_OneToOne 0.00 3.000 FORMAT "%5.3" EXTENDED_LIMITS 0.00 255.0 /end CHARACTERISTIC
/begin CHARACTERISTIC DFES_Cls.DFC_Com38DhTooShort_C "" VALUE 0x802417A9 Val_Wu8 3.000 DFES_OneToOne 0.00 3.000 FORMAT "%5.3" EXTENDED_LIMITS 0.00 255.0 /end CHARACTERISTIC
/begin CHARACTERISTIC DFES_Cls.DFC_Com412hAbsent_C "" VALUE 0x802417AA Val_Wu8 3.000 DFES_OneToOne 0.00 3.000 FORMAT "%5.3" EXTENDED_LIMITS 0.00 255.0 /end CHARACTERISTIC
/begin CHARACTERISTIC DFES_Cls.DFC_Com412hChecksum_C "" VALUE 0x802417AB Val_Wu8 3.000 DFES_OneToOne 0.00 3.000 FORMAT "%5.3" EXTENDED_LIMITS 0.00 255.0 /end CHARACTERISTIC
/begin CHARACTERISTIC DFES_Cls.DFC_Com412hCounter_C "" VALUE 0x802417AC Val_Wu8 3.000 DFES_OneToOne 0.00 3.000 FORMAT "%5.3" EXTENDED_LIMITS 0.00 255.0 /end CHARACTERISTIC
/begin CHARACTERISTIC DFES_Cls.DFC_Com412hTooShort_C "" VALUE 0x802417AD Val_Wu8 3.000 DFES_OneToOne 0.00 3.000 FORMAT "%5.3" EXTENDED_LIMITS 0.00 255.0 /end CHARACTERISTIC
/begin CHARACTERISTIC DFES_Cls.DFC_Com427hAbsent_C "" VALUE 0x802417AE Val_Wu8 3.000 DFES_OneToOne 0.00 3.000 FORMAT "%5.3" EXTENDED_LIMITS 0.00 255.0 /end CHARACTERISTIC
/begin CHARACTERISTIC DFES_Cls.DFC_Com427hTooShort_C "" VALUE 0x802417AF Val_Wu8 3.000 DFES_OneToOne 0.00 3.000 FORMAT "%5.3" EXTENDED_LIMITS 0.00 255.0 /end CHARACTERISTIC
/begin CHARACTERISTIC DFES_Cls.DFC_Com432hAbsent_C "" VALUE 0x802417B0 Val_Wu8 3.000 DFES_OneToOne 0.00 3.000 FORMAT "%5.3" EXTENDED_LIMITS 0.00 255.0 /end CHARACTERISTIC
/begin CHARACTERISTIC DFES_Cls.DFC_Com432hChecksum_C "" VALUE 0x802417B1 Val_Wu8 3.000 DFES_OneToOne 0.00 3.000 FORMAT "%5.3" EXTENDED_LIMITS 0.00 255.0 /end CHARACTERISTIC
/begin CHARACTERISTIC DFES_Cls.DFC_Com432hCounter_C "" VALUE 0x802417B2 Val_Wu8 3.000 DFES_OneToOne 0.00 3.000 FORMAT "%5.3" EXTENDED_LIMITS 0.00 255.0 /end CHARACTERISTIC
/begin CHARACTERISTIC DFES_Cls.DFC_Com432hTooShort_C "" VALUE 0x802417B3 Val_Wu8 3.000 DFES_OneToOne 0.00 3.000 FORMAT "%5.3" EXTENDED_LIMITS 0.00 255.0 /end CHARACTERISTIC
/begin CHARACTERISTIC DFES_Cls.DFC_Com435hAbsent_C "" VALUE 0x802417B4 Val_Wu8 3.000 DFES_OneToOne 0.00 3.000 FORMAT "%5.3" EXTENDED_LIMITS 0.00 255.0 /end CHARACTERISTIC
/begin CHARACTERISTIC DFES_Cls.DFC_Com435hTooShort_C "" VALUE 0x802417B5 Val_Wu8 3.000 DFES_OneToOne 0.00 3.000 FORMAT "%5.3" EXTENDED_LIMITS 0.00 255.0 /end CHARACTERISTIC
/begin CHARACTERISTIC DFES_Cls.DFC_Com442hAbsent_C "" VALUE 0x802417B6 Val_Wu8 3.000 DFES_OneToOne 0.00 3.000 FORMAT "%5.3" EXTENDED_LIMITS 0.00 255.0 /end CHARACTERISTIC
/begin CHARACTERISTIC DFES_Cls.DFC_Com442hTooShort_C "" VALUE 0x802417B7 Val_Wu8 3.000 DFES_OneToOne 0.00 3.000 FORMAT "%5.3" EXTENDED_LIMITS 0.00 255.0 /end CHARACTERISTIC
/begin CHARACTERISTIC DFES_Cls.DFC_Com453hAbsent_C "" VALUE 0x802417B8 Val_Wu8 3.000 DFES_OneToOne 0.00 3.000 FORMAT "%5.3" EXTENDED_LIMITS 0.00 255.0 /end CHARACTERISTIC
/begin CHARACTERISTIC DFES_Cls.DFC_Com453hTooShort_C "" VALUE 0x802417B9 Val_Wu8 3.000 DFES_OneToOne 0.00 3.000 FORMAT "%5.3" EXTENDED_LIMITS 0.00 255.0 /end CHARACTERISTIC
/begin CHARACTERISTIC DFES_Cls.DFC_Com455hAbsent_C "" VALUE 0x802417BA Val_Wu8 3.000 DFES_OneToOne 0.00 3.000 FORMAT "%5.3" EXTENDED_LIMITS 0.00 255.0 /end CHARACTERISTIC
/begin CHARACTERISTIC DFES_Cls.DFC_Com455hTooShort_C "" VALUE 0x802417BB Val_Wu8 3.000 DFES_OneToOne 0.00 3.000 FORMAT "%5.3" EXTENDED_LIMITS 0.00 255.0 /end CHARACTERISTIC
/begin CHARACTERISTIC DFES_Cls.DFC_Com463hAbsent_C "" VALUE 0x802417BC Val_Wu8 3.000 DFES_OneToOne 0.00 3.000 FORMAT "%5.3" EXTENDED_LIMITS 0.00 255.0 /end CHARACTERISTIC
/begin CHARACTERISTIC DFES_Cls.DFC_Com463hTooShort_C "" VALUE 0x802417BD Val_Wu8 3.000 DFES_OneToOne 0.00 3.000 FORMAT "%5.3" EXTENDED_LIMITS 0.00 255.0 /end CHARACTERISTIC
/begin CHARACTERISTIC DFES_Cls.DFC_Com473hAbsent_C "" VALUE 0x802417BE Val_Wu8 3.000 DFES_OneToOne 0.00 3.000 FORMAT "%5.3" EXTENDED_LIMITS 0.00 255.0 /end CHARACTERISTIC
/begin CHARACTERISTIC DFES_Cls.DFC_Com473hTooShort_C "" VALUE 0x802417BF Val_Wu8 3.000 DFES_OneToOne 0.00 3.000 FORMAT "%5.3" EXTENDED_LIMITS 0.00 255.0 /end CHARACTERISTIC
/begin CHARACTERISTIC DFES_Cls.DFC_Com47BhAbsent_C "" VALUE 0x802417C0 Val_Wu8 3.000 DFES_OneToOne 0.00 3.000 FORMAT "%5.3" EXTENDED_LIMITS 0.00 255.0 /end CHARACTERISTIC
/begin CHARACTERISTIC DFES_Cls.DFC_Com47BhTooShort_C "" VALUE 0x802417C1 Val_Wu8 3.000 DFES_OneToOne 0.00 3.000 FORMAT "%5.3" EXTENDED_LIMITS 0.00 255.0 /end CHARACTERISTIC
/begin CHARACTERISTIC DFES_Cls.DFC_Com48BhAbsent_C "" VALUE 0x802417C2 Val_Wu8 3.000 DFES_OneToOne 0.00 3.000 FORMAT "%5.3" EXTENDED_LIMITS 0.00 255.0 /end CHARACTERISTIC
/begin CHARACTERISTIC DFES_Cls.DFC_Com48BhTooShort_C "" VALUE 0x802417C3 Val_Wu8 3.000 DFES_OneToOne 0.00 3.000 FORMAT "%5.3" EXTENDED_LIMITS 0.00 255.0 /end CHARACTERISTIC
/begin CHARACTERISTIC DFES_Cls.DFC_Com497hTooShort_C "" VALUE 0x802417C4 Val_Wu8 3.000 DFES_OneToOne 0.00 3.000 FORMAT "%5.3" EXTENDED_LIMITS 0.00 255.0 /end CHARACTERISTIC
/begin CHARACTERISTIC DFES_Cls.DFC_Com4F2hAbsent_C "" VALUE 0x802417C5 Val_Wu8 3.000 DFES_OneToOne 0.00 3.000 FORMAT "%5.3" EXTENDED_LIMITS 0.00 255.0 /end CHARACTERISTIC
/begin CHARACTERISTIC DFES_Cls.DFC_Com4F2hChecksum_C "" VALUE 0x802417C6 Val_Wu8 3.000 DFES_OneToOne 0.00 3.000 FORMAT "%5.3" EXTENDED_LIMITS 0.00 255.0 /end CHARACTERISTIC
/begin CHARACTERISTIC DFES_Cls.DFC_Com4F2hCounter_C "" VALUE 0x802417C7 Val_Wu8 3.000 DFES_OneToOne 0.00 3.000 FORMAT "%5.3" EXTENDED_LIMITS 0.00 255.0 /end CHARACTERISTIC
/begin CHARACTERISTIC DFES_Cls.DFC_Com4F2hTooShort_C "" VALUE 0x802417C8 Val_Wu8 3.000 DFES_OneToOne 0.00 3.000 FORMAT "%5.3" EXTENDED_LIMITS 0.00 255.0 /end CHARACTERISTIC
/begin CHARACTERISTIC DFES_Cls.DFC_Com50DhAbsent_C "" VALUE 0x802417C9 Val_Wu8 3.000 DFES_OneToOne 0.00 3.000 FORMAT "%5.3" EXTENDED_LIMITS 0.00 255.0 /end CHARACTERISTIC
/begin CHARACTERISTIC DFES_Cls.DFC_Com50DhTooShort_C "" VALUE 0x802417CA Val_Wu8 3.000 DFES_OneToOne 0.00 3.000 FORMAT "%5.3" EXTENDED_LIMITS 0.00 255.0 /end CHARACTERISTIC
/begin CHARACTERISTIC DFES_Cls.DFC_Com535hAbsent_C "" VALUE 0x802417CB Val_Wu8 3.000 DFES_OneToOne 0.00 3.000 FORMAT "%5.3" EXTENDED_LIMITS 0.00 255.0 /end CHARACTERISTIC
/begin CHARACTERISTIC DFES_Cls.DFC_Com535hTooShort_C "" VALUE 0x802417CC Val_Wu8 3.000 DFES_OneToOne 0.00 3.000 FORMAT "%5.3" EXTENDED_LIMITS 0.00 255.0 /end CHARACTERISTIC
/begin CHARACTERISTIC DFES_Cls.DFC_Com543hAbsent_C "" VALUE 0x802417CD Val_Wu8 3.000 DFES_OneToOne 0.00 3.000 FORMAT "%5.3" EXTENDED_LIMITS 0.00 255.0 /end CHARACTERISTIC
/begin CHARACTERISTIC DFES_Cls.DFC_Com543hTooShort_C "" VALUE 0x802417CE Val_Wu8 3.000 DFES_OneToOne 0.00 3.000 FORMAT "%5.3" EXTENDED_LIMITS 0.00 255.0 /end CHARACTERISTIC
/begin CHARACTERISTIC DFES_Cls.DFC_Com552hAbsent_C "" VALUE 0x802417CF Val_Wu8 3.000 DFES_OneToOne 0.00 3.000 FORMAT "%5.3" EXTENDED_LIMITS 0.00 255.0 /end CHARACTERISTIC
/begin CHARACTERISTIC DFES_Cls.DFC_Com552hTooShort_C "" VALUE 0x802417D0 Val_Wu8 3.000 DFES_OneToOne 0.00 3.000 FORMAT "%5.3" EXTENDED_LIMITS 0.00 255.0 /end CHARACTERISTIC
/begin CHARACTERISTIC DFES_Cls.DFC_Com583hAbsent_C "" VALUE 0x802417D1 Val_Wu8 3.000 DFES_OneToOne 0.00 3.000 FORMAT "%5.3" EXTENDED_LIMITS 0.00 255.0 /end CHARACTERISTIC
/begin CHARACTERISTIC DFES_Cls.DFC_Com583hTooShort_C "" VALUE 0x802417D2 Val_Wu8 3.000 DFES_OneToOne 0.00 3.000 FORMAT "%5.3" EXTENDED_LIMITS 0.00 255.0 /end CHARACTERISTIC
/begin CHARACTERISTIC DFES_Cls.DFC_Com592hAbsent_C "" VALUE 0x802417D3 Val_Wu8 3.000 DFES_OneToOne 0.00 3.000 FORMAT "%5.3" EXTENDED_LIMITS 0.00 255.0 /end CHARACTERISTIC
/begin CHARACTERISTIC DFES_Cls.DFC_Com592hChecksum_C "" VALUE 0x802417D4 Val_Wu8 3.000 DFES_OneToOne 0.00 3.000 FORMAT "%5.3" EXTENDED_LIMITS 0.00 255.0 /end CHARACTERISTIC
/begin CHARACTERISTIC DFES_Cls.DFC_Com592hCounter_C "" VALUE 0x802417D5 Val_Wu8 3.000 DFES_OneToOne 0.00 3.000 FORMAT "%5.3" EXTENDED_LIMITS 0.00 255.0 /end CHARACTERISTIC
/begin CHARACTERISTIC DFES_Cls.DFC_Com592hTooShort_C "" VALUE 0x802417D6 Val_Wu8 3.000 DFES_OneToOne 0.00 3.000 FORMAT "%5.3" EXTENDED_LIMITS 0.00 255.0 /end CHARACTERISTIC
/begin CHARACTERISTIC DFES_Cls.DFC_Com595hAbsent_C "" VALUE 0x802417D7 Val_Wu8 3.000 DFES_OneToOne 0.00 3.000 FORMAT "%5.3" EXTENDED_LIMITS 0.00 255.0 /end CHARACTERISTIC
/begin CHARACTERISTIC DFES_Cls.DFC_Com595hChecksum_C "" VALUE 0x802417D8 Val_Wu8 3.000 DFES_OneToOne 0.00 3.000 FORMAT "%5.3" EXTENDED_LIMITS 0.00 255.0 /end CHARACTERISTIC
/begin CHARACTERISTIC DFES_Cls.DFC_Com595hCounter_C "" VALUE 0x802417D9 Val_Wu8 3.000 DFES_OneToOne 0.00 3.000 FORMAT "%5.3" EXTENDED_LIMITS 0.00 255.0 /end CHARACTERISTIC
/begin CHARACTERISTIC DFES_Cls.DFC_Com595hTooShort_C "" VALUE 0x802417DA Val_Wu8 3.000 DFES_OneToOne 0.00 3.000 FORMAT "%5.3" EXTENDED_LIMITS 0.00 255.0 /end CHARACTERISTIC
/begin CHARACTERISTIC DFES_Cls.DFC_Com5B2hAbsent_C "" VALUE 0x802417DB Val_Wu8 3.000 DFES_OneToOne 0.00 3.000 FORMAT "%5.3" EXTENDED_LIMITS 0.00 255.0 /end CHARACTERISTIC
/begin CHARACTERISTIC DFES_Cls.DFC_Com5B2hTooShort_C "" VALUE 0x802417DC Val_Wu8 3.000 DFES_OneToOne 0.00 3.000 FORMAT "%5.3" EXTENDED_LIMITS 0.00 255.0 /end CHARACTERISTIC
/begin CHARACTERISTIC DFES_Cls.DFC_Com5B5hAbsent_C "" VALUE 0x802417DD Val_Wu8 3.000 DFES_OneToOne 0.00 3.000 FORMAT "%5.3" EXTENDED_LIMITS 0.00 255.0 /end CHARACTERISTIC
/begin CHARACTERISTIC DFES_Cls.DFC_Com5B5hChecksum_C "" VALUE 0x802417DE Val_Wu8 3.000 DFES_OneToOne 0.00 3.000 FORMAT "%5.3" EXTENDED_LIMITS 0.00 255.0 /end CHARACTERISTIC
/begin CHARACTERISTIC DFES_Cls.DFC_Com5B5hCounter_C "" VALUE 0x802417DF Val_Wu8 3.000 DFES_OneToOne 0.00 3.000 FORMAT "%5.3" EXTENDED_LIMITS 0.00 255.0 /end CHARACTERISTIC
/begin CHARACTERISTIC DFES_Cls.DFC_Com5B5hTooShort_C "" VALUE 0x802417E0 Val_Wu8 3.000 DFES_OneToOne 0.00 3.000 FORMAT "%5.3" EXTENDED_LIMITS 0.00 255.0 /end CHARACTERISTIC
/begin CHARACTERISTIC DFES_Cls.DFC_Com5C7hTooShort_C "" VALUE 0x802417E1 Val_Wu8 3.000 DFES_OneToOne 0.00 3.000 FORMAT "%5.3" EXTENDED_LIMITS 0.00 255.0 /end CHARACTERISTIC
/begin CHARACTERISTIC DFES_Cls.DFC_Com5E7hAbsent_C "" VALUE 0x802417E2 Val_Wu8 3.000 DFES_OneToOne 0.00 3.000 FORMAT "%5.3" EXTENDED_LIMITS 0.00 255.0 /end CHARACTERISTIC
/begin CHARACTERISTIC DFES_Cls.DFC_Com5E7hTooShort_C "" VALUE 0x802417E3 Val_Wu8 3.000 DFES_OneToOne 0.00 3.000 FORMAT "%5.3" EXTENDED_LIMITS 0.00 255.0 /end CHARACTERISTIC
/begin CHARACTERISTIC DFES_Cls.DFC_Com635hTooShort_C "" VALUE 0x802417E4 Val_Wu8 3.000 DFES_OneToOne 0.00 3.000 FORMAT "%5.3" EXTENDED_LIMITS 0.00 255.0 /end CHARACTERISTIC
/begin CHARACTERISTIC DFES_Cls.DFC_Com645hTooShort_C "" VALUE 0x802417E5 Val_Wu8 3.000 DFES_OneToOne 0.00 3.000 FORMAT "%5.3" EXTENDED_LIMITS 0.00 255.0 /end CHARACTERISTIC
/begin CHARACTERISTIC DFES_Cls.DFC_Com663hAbsent_C "" VALUE 0x802417E6 Val_Wu8 3.000 DFES_OneToOne 0.00 3.000 FORMAT "%5.3" EXTENDED_LIMITS 0.00 255.0 /end CHARACTERISTIC
/begin CHARACTERISTIC DFES_Cls.DFC_Com663hTooShort_C "" VALUE 0x802417E7 Val_Wu8 3.000 DFES_OneToOne 0.00 3.000 FORMAT "%5.3" EXTENDED_LIMITS 0.00 255.0 /end CHARACTERISTIC
/begin CHARACTERISTIC DFES_Cls.DFC_Com665hAbsent_C "" VALUE 0x802417E8 Val_Wu8 3.000 DFES_OneToOne 0.00 3.000 FORMAT "%5.3" EXTENDED_LIMITS 0.00 255.0 /end CHARACTERISTIC
/begin CHARACTERISTIC DFES_Cls.DFC_Com665hTooShort_C "" VALUE 0x802417E9 Val_Wu8 3.000 DFES_OneToOne 0.00 3.000 FORMAT "%5.3" EXTENDED_LIMITS 0.00 255.0 /end CHARACTERISTIC
/begin CHARACTERISTIC DFES_Cls.DFC_Com675hAbsent_C "" VALUE 0x802417EA Val_Wu8 3.000 DFES_OneToOne 0.00 3.000 FORMAT "%5.3" EXTENDED_LIMITS 0.00 255.0 /end CHARACTERISTIC
/begin CHARACTERISTIC DFES_Cls.DFC_Com675hTooShort_C "" VALUE 0x802417EB Val_Wu8 3.000 DFES_OneToOne 0.00 3.000 FORMAT "%5.3" EXTENDED_LIMITS 0.00 255.0 /end CHARACTERISTIC
/begin CHARACTERISTIC DFES_Cls.DFC_ComFrbd_205h_HVBAT_PACK_CURRENT_C "" VALUE 0x802417EC Val_Wu8 3.000 DFES_OneToOne 0.00 3.000 FORMAT "%5.3" EXTENDED_LIMITS 0.00 255.0 /end CHARACTERISTIC
/begin CHARACTERISTIC DFES_Cls.DFC_ComFrbd_205h_HVBAT_SOC_DISPLAY_C "" VALUE 0x802417ED Val_Wu8 3.000 DFES_OneToOne 0.00 3.000 FORMAT "%5.3" EXTENDED_LIMITS 0.00 255.0 /end CHARACTERISTIC
/begin CHARACTERISTIC DFES_Cls.DFC_ComFrbd_205h_HVBAT_VOLTAGE_C "" VALUE 0x802417EE Val_Wu8 3.000 DFES_OneToOne 0.00 3.000 FORMAT "%5.3" EXTENDED_LIMITS 0.00 255.0 /end CHARACTERISTIC
/begin CHARACTERISTIC DFES_Cls.DFC_ComFrbd_217h_INV_DC_BUS_VOLTAGE_C "" VALUE 0x802417EF Val_Wu8 3.000 DFES_OneToOne 0.00 3.000 FORMAT "%5.3" EXTENDED_LIMITS 0.00 255.0 /end CHARACTERISTIC
/begin CHARACTERISTIC DFES_Cls.DFC_ComFrbd_217h_INV_MTR_ACTUAL_TRQ_C "" VALUE 0x802417F0 Val_Wu8 3.000 DFES_OneToOne 0.00 3.000 FORMAT "%5.3" EXTENDED_LIMITS 0.00 255.0 /end CHARACTERISTIC
/begin CHARACTERISTIC DFES_Cls.DFC_ComFrbd_217h_INV_MTR_SPEED_C "" VALUE 0x802417F1 Val_Wu8 3.000 DFES_OneToOne 0.00 3.000 FORMAT "%5.3" EXTENDED_LIMITS 0.00 255.0 /end CHARACTERISTIC
/begin CHARACTERISTIC DFES_Cls.DFC_ComFrbd_217h_INV_MTR_TRQ_C "" VALUE 0x802417F2 Val_Wu8 3.000 DFES_OneToOne 0.00 3.000 FORMAT "%5.3" EXTENDED_LIMITS 0.00 255.0 /end CHARACTERISTIC
/begin CHARACTERISTIC DFES_Cls.DFC_ComFrbd_227h_INV_DC_CURRENT_C "" VALUE 0x802417F3 Val_Wu8 3.000 DFES_OneToOne 0.00 3.000 FORMAT "%5.3" EXTENDED_LIMITS 0.00 255.0 /end CHARACTERISTIC
/begin CHARACTERISTIC DFES_Cls.DFC_ComFrbd_227h_INV_MOTORING_PEAK_TRQ_C "" VALUE 0x802417F4 Val_Wu8 3.000 DFES_OneToOne 0.00 3.000 FORMAT "%5.3" EXTENDED_LIMITS 0.00 255.0 /end CHARACTERISTIC
/begin CHARACTERISTIC DFES_Cls.DFC_ComFrbd_227h_INV_MTR_INST_INPUT_POWER_C "" VALUE 0x802417F5 Val_Wu8 3.000 DFES_OneToOne 0.00 3.000 FORMAT "%5.3" EXTENDED_LIMITS 0.00 255.0 /end CHARACTERISTIC
/begin CHARACTERISTIC DFES_Cls.DFC_ComFrbd_227h_INV_REGEN_PEAK_TRQ_C "" VALUE 0x802417F6 Val_Wu8 3.000 DFES_OneToOne 0.00 3.000 FORMAT "%5.3" EXTENDED_LIMITS 0.00 255.0 /end CHARACTERISTIC
/begin CHARACTERISTIC DFES_Cls.DFC_ComFrbd_237h_INV_ACTIVE_DISCHARGE_STATUS_C "" VALUE 0x802417F7 Val_Wu8 3.000 DFES_OneToOne 0.00 3.000 FORMAT "%5.3" EXTENDED_LIMITS 0.00 255.0 /end CHARACTERISTIC
/begin CHARACTERISTIC DFES_Cls.DFC_ComFrbd_237h_INV_CTRL_MODE_ACK_C "" VALUE 0x802417F8 Val_Wu8 3.000 DFES_OneToOne 0.00 3.000 FORMAT "%5.3" EXTENDED_LIMITS 0.00 255.0 /end CHARACTERISTIC
/begin CHARACTERISTIC DFES_Cls.DFC_ComFrbd_237h_INV_EV_WARNING_C "" VALUE 0x802417F9 Val_Wu8 3.000 DFES_OneToOne 0.00 3.000 FORMAT "%5.3" EXTENDED_LIMITS 0.00 255.0 /end CHARACTERISTIC
/begin CHARACTERISTIC DFES_Cls.DFC_ComFrbd_237h_INV_FAULT_LEVEL_C "" VALUE 0x802417FA Val_Wu8 3.000 DFES_OneToOne 0.00 3.000 FORMAT "%5.3" EXTENDED_LIMITS 0.00 255.0 /end CHARACTERISTIC
/begin CHARACTERISTIC DFES_Cls.DFC_ComFrbd_237h_INV_MASTER_STOP_C "" VALUE 0x802417FB Val_Wu8 3.000 DFES_OneToOne 0.00 3.000 FORMAT "%5.3" EXTENDED_LIMITS 0.00 255.0 /end CHARACTERISTIC
/begin CHARACTERISTIC DFES_Cls.DFC_ComFrbd_237h_INV_SERVICE_DUE_C "" VALUE 0x802417FC Val_Wu8 3.000 DFES_OneToOne 0.00 3.000 FORMAT "%5.3" EXTENDED_LIMITS 0.00 255.0 /end CHARACTERISTIC
/begin CHARACTERISTIC DFES_Cls.DFC_ComFrbd_237h_INV_STAB_MIN_TRQ_C "" VALUE 0x802417FD Val_Wu8 3.000 DFES_OneToOne 0.00 3.000 FORMAT "%5.3" EXTENDED_LIMITS 0.00 255.0 /end CHARACTERISTIC
/begin CHARACTERISTIC DFES_Cls.DFC_ComFrbd_259h_TGLM_FAILURE_STATE_C "" VALUE 0x802417FE Val_Wu8 3.000 DFES_OneToOne 0.00 3.000 FORMAT "%5.3" EXTENDED_LIMITS 0.00 255.0 /end CHARACTERISTIC
/begin CHARACTERISTIC DFES_Cls.DFC_ComFrbd_259h_TGLM_MODE_PUSH_C "" VALUE 0x802417FF Val_Wu8 3.000 DFES_OneToOne 0.00 3.000 FORMAT "%5.3" EXTENDED_LIMITS 0.00 255.0 /end CHARACTERISTIC
/begin CHARACTERISTIC DFES_Cls.DFC_ComFrbd_259h_TOGGLE_MONOSTABLE_POS_C "" VALUE 0x80241800 Val_Wu8 3.000 DFES_OneToOne 0.00 3.000 FORMAT "%5.3" EXTENDED_LIMITS 0.00 255.0 /end CHARACTERISTIC
/begin CHARACTERISTIC DFES_Cls.DFC_ComFrbd_273h_OBC_outputpower_capability_C "" VALUE 0x80241801 Val_Wu8 3.000 DFES_OneToOne 0.00 3.000 FORMAT "%5.3" EXTENDED_LIMITS 0.00 255.0 /end CHARACTERISTIC
/begin CHARACTERISTIC DFES_Cls.DFC_ComFrbd_275h_HVBAT_DISCHARGE_30S_AVAILABLE_CURRENT_C "" VALUE 0x80241802 Val_Wu8 3.000 DFES_OneToOne 0.00 3.000 FORMAT "%5.3" EXTENDED_LIMITS 0.00 255.0 /end CHARACTERISTIC
/begin CHARACTERISTIC DFES_Cls.DFC_ComFrbd_275h_HVBAT_DISCHARGE_30S_AVAILABLE_POWER_C "" VALUE 0x80241803 Val_Wu8 3.000 DFES_OneToOne 0.00 3.000 FORMAT "%5.3" EXTENDED_LIMITS 0.00 255.0 /end CHARACTERISTIC
/begin CHARACTERISTIC DFES_Cls.DFC_ComFrbd_283h_DCDC_IN_CURRENT_C "" VALUE 0x80241804 Val_Wu8 3.000 DFES_OneToOne 0.00 3.000 FORMAT "%5.3" EXTENDED_LIMITS 0.00 255.0 /end CHARACTERISTIC
/begin CHARACTERISTIC DFES_Cls.DFC_ComFrbd_283h_DCDC_IN_VOLTAGE_C "" VALUE 0x80241805 Val_Wu8 3.000 DFES_OneToOne 0.00 3.000 FORMAT "%5.3" EXTENDED_LIMITS 0.00 255.0 /end CHARACTERISTIC
/begin CHARACTERISTIC DFES_Cls.DFC_ComFrbd_283h_DCDC_OUT_CURRENT_C "" VALUE 0x80241806 Val_Wu8 3.000 DFES_OneToOne 0.00 3.000 FORMAT "%5.3" EXTENDED_LIMITS 0.00 255.0 /end CHARACTERISTIC
/begin CHARACTERISTIC DFES_Cls.DFC_ComFrbd_283h_DCDC_OUT_VOLTAGE_C "" VALUE 0x80241807 Val_Wu8 3.000 DFES_OneToOne 0.00 3.000 FORMAT "%5.3" EXTENDED_LIMITS 0.00 255.0 /end CHARACTERISTIC
/begin CHARACTERISTIC DFES_Cls.DFC_ComFrbd_285h_HVBAT_REGEN_CHG_30S_CURRENT_LIMIT_C "" VALUE 0x80241808 Val_Wu8 3.000 DFES_OneToOne 0.00 3.000 FORMAT "%5.3" EXTENDED_LIMITS 0.00 255.0 /end CHARACTERISTIC
/begin CHARACTERISTIC DFES_Cls.DFC_ComFrbd_285h_HVBAT_REGEN_CHRG_30S_POWER_LIMIT_C "" VALUE 0x80241809 Val_Wu8 3.000 DFES_OneToOne 0.00 3.000 FORMAT "%5.3" EXTENDED_LIMITS 0.00 255.0 /end CHARACTERISTIC
/begin CHARACTERISTIC DFES_Cls.DFC_ComFrbd_293h_DCDC_outputpower_capability_C "" VALUE 0x8024180A Val_Wu8 3.000 DFES_OneToOne 0.00 3.000 FORMAT "%5.3" EXTENDED_LIMITS 0.00 255.0 /end CHARACTERISTIC
/begin CHARACTERISTIC DFES_Cls.DFC_ComFrbd_325h_HVBAT_INSULATION_RESISTANCE_C "" VALUE 0x8024180B Val_Wu8 3.000 DFES_OneToOne 0.00 3.000 FORMAT "%5.3" EXTENDED_LIMITS 0.00 255.0 /end CHARACTERISTIC
/begin CHARACTERISTIC DFES_Cls.DFC_ComFrbd_325h_HVBAT_TEMPERATURE_C "" VALUE 0x8024180C Val_Wu8 3.000 DFES_OneToOne 0.00 3.000 FORMAT "%5.3" EXTENDED_LIMITS 0.00 255.0 /end CHARACTERISTIC
/begin CHARACTERISTIC DFES_Cls.DFC_ComFrbd_335h_HVBAT_CHRG_CONTINUOUS_CURR_MAX_C "" VALUE 0x8024180D Val_Wu8 3.000 DFES_OneToOne 0.00 3.000 FORMAT "%5.3" EXTENDED_LIMITS 0.00 255.0 /end CHARACTERISTIC
/begin CHARACTERISTIC DFES_Cls.DFC_ComFrbd_335h_HVBAT_CHRG_COTINUOUS_CURR_REQ_C "" VALUE 0x8024180E Val_Wu8 3.000 DFES_OneToOne 0.00 3.000 FORMAT "%5.3" EXTENDED_LIMITS 0.00 255.0 /end CHARACTERISTIC
/begin CHARACTERISTIC DFES_Cls.DFC_ComFrbd_335h_HVBAT_CHRG_MAX_VOLT_C "" VALUE 0x8024180F Val_Wu8 3.000 DFES_OneToOne 0.00 3.000 FORMAT "%5.3" EXTENDED_LIMITS 0.00 255.0 /end CHARACTERISTIC
/begin CHARACTERISTIC DFES_Cls.DFC_ComFrbd_335h_HVBAT_DC_BUS_VOLTAGE_C "" VALUE 0x80241810 Val_Wu8 3.000 DFES_OneToOne 0.00 3.000 FORMAT "%5.3" EXTENDED_LIMITS 0.00 255.0 /end CHARACTERISTIC
/begin CHARACTERISTIC DFES_Cls.DFC_ComFrbd_427h_INV_OP_MODE_C "" VALUE 0x80241811 Val_Wu8 3.000 DFES_OneToOne 0.00 3.000 FORMAT "%5.3" EXTENDED_LIMITS 0.00 255.0 /end CHARACTERISTIC
/begin CHARACTERISTIC DFES_Cls.DFC_ComFrbd_427h_INV_PERMISIBLE_TORQUE_C "" VALUE 0x80241812 Val_Wu8 3.000 DFES_OneToOne 0.00 3.000 FORMAT "%5.3" EXTENDED_LIMITS 0.00 255.0 /end CHARACTERISTIC
/begin CHARACTERISTIC DFES_Cls.DFC_ComFrbd_435h_HVBAT_MAX_CELL_VOLT_C "" VALUE 0x80241813 Val_Wu8 3.000 DFES_OneToOne 0.00 3.000 FORMAT "%5.3" EXTENDED_LIMITS 0.00 255.0 /end CHARACTERISTIC
/begin CHARACTERISTIC DFES_Cls.DFC_ComFrbd_435h_HVBAT_MAX_CELL_VOLT_NUM_C "" VALUE 0x80241814 Val_Wu8 3.000 DFES_OneToOne 0.00 3.000 FORMAT "%5.3" EXTENDED_LIMITS 0.00 255.0 /end CHARACTERISTIC
/begin CHARACTERISTIC DFES_Cls.DFC_ComFrbd_435h_HVBAT_MAX_SENSOR_TEMP_C "" VALUE 0x80241815 Val_Wu8 3.000 DFES_OneToOne 0.00 3.000 FORMAT "%5.3" EXTENDED_LIMITS 0.00 255.0 /end CHARACTERISTIC
/begin CHARACTERISTIC DFES_Cls.DFC_ComFrbd_435h_HVBAT_MIN_CELL_VOLT_C "" VALUE 0x80241816 Val_Wu8 3.000 DFES_OneToOne 0.00 3.000 FORMAT "%5.3" EXTENDED_LIMITS 0.00 255.0 /end CHARACTERISTIC
/begin CHARACTERISTIC DFES_Cls.DFC_ComFrbd_435h_HVBAT_MIN_CELL_VOLT_NUM_C "" VALUE 0x80241817 Val_Wu8 3.000 DFES_OneToOne 0.00 3.000 FORMAT "%5.3" EXTENDED_LIMITS 0.00 255.0 /end CHARACTERISTIC
/begin CHARACTERISTIC DFES_Cls.DFC_ComFrbd_453h_OBC_IN_CURRENT_C "" VALUE 0x80241818 Val_Wu8 3.000 DFES_OneToOne 0.00 3.000 FORMAT "%5.3" EXTENDED_LIMITS 0.00 255.0 /end CHARACTERISTIC
/begin CHARACTERISTIC DFES_Cls.DFC_ComFrbd_453h_OBC_IN_VOLTAGE_C "" VALUE 0x80241819 Val_Wu8 3.000 DFES_OneToOne 0.00 3.000 FORMAT "%5.3" EXTENDED_LIMITS 0.00 255.0 /end CHARACTERISTIC
/begin CHARACTERISTIC DFES_Cls.DFC_ComFrbd_453h_OBC_IP_POWER_C "" VALUE 0x8024181A Val_Wu8 3.000 DFES_OneToOne 0.00 3.000 FORMAT "%5.3" EXTENDED_LIMITS 0.00 255.0 /end CHARACTERISTIC
/begin CHARACTERISTIC DFES_Cls.DFC_ComFrbd_455h_HVBAT_NOMINAL_VOLTAGE_C "" VALUE 0x8024181B Val_Wu8 3.000 DFES_OneToOne 0.00 3.000 FORMAT "%5.3" EXTENDED_LIMITS 0.00 255.0 /end CHARACTERISTIC
/begin CHARACTERISTIC DFES_Cls.DFC_ComFrbd_463h_OBC_OUT_CURRENT_C "" VALUE 0x8024181C Val_Wu8 3.000 DFES_OneToOne 0.00 3.000 FORMAT "%5.3" EXTENDED_LIMITS 0.00 255.0 /end CHARACTERISTIC
/begin CHARACTERISTIC DFES_Cls.DFC_ComFrbd_463h_OBC_OUT_VOLTAGE_C "" VALUE 0x8024181D Val_Wu8 3.000 DFES_OneToOne 0.00 3.000 FORMAT "%5.3" EXTENDED_LIMITS 0.00 255.0 /end CHARACTERISTIC
/begin CHARACTERISTIC DFES_Cls.DFC_ComFrbd_463h_OBC_TEMPERATURE_C "" VALUE 0x8024181E Val_Wu8 3.000 DFES_OneToOne 0.00 3.000 FORMAT "%5.3" EXTENDED_LIMITS 0.00 255.0 /end CHARACTERISTIC
/begin CHARACTERISTIC DFES_Cls.DFC_ComFrbd_473h_DCDC_Coolant_Temperature_C "" VALUE 0x8024181F Val_Wu8 3.000 DFES_OneToOne 0.00 3.000 FORMAT "%5.3" EXTENDED_LIMITS 0.00 255.0 /end CHARACTERISTIC
/begin CHARACTERISTIC DFES_Cls.DFC_ComFrbd_473h_DCDC_TEMPERATURE_C "" VALUE 0x80241820 Val_Wu8 3.000 DFES_OneToOne 0.00 3.000 FORMAT "%5.3" EXTENDED_LIMITS 0.00 255.0 /end CHARACTERISTIC
/begin CHARACTERISTIC DFES_Cls.DFC_ComFrbd_47Bh_eCOMP_BusBarCurrent_C "" VALUE 0x80241821 Val_Wu8 3.000 DFES_OneToOne 0.00 3.000 FORMAT "%5.3" EXTENDED_LIMITS 0.00 255.0 /end CHARACTERISTIC
/begin CHARACTERISTIC DFES_Cls.DFC_ComFrbd_47Bh_eCOMP_BusBarVoltage_C "" VALUE 0x80241822 Val_Wu8 3.000 DFES_OneToOne 0.00 3.000 FORMAT "%5.3" EXTENDED_LIMITS 0.00 255.0 /end CHARACTERISTIC
/begin CHARACTERISTIC DFES_Cls.DFC_ComFrbd_47Bh_eCOMP_CompressorSpeed_C "" VALUE 0x80241823 Val_Wu8 3.000 DFES_OneToOne 0.00 3.000 FORMAT "%5.3" EXTENDED_LIMITS 0.00 255.0 /end CHARACTERISTIC
/begin CHARACTERISTIC DFES_Cls.DFC_ComFrbd_47Bh_eCOMP_IGBT_Temp_C "" VALUE 0x80241824 Val_Wu8 3.000 DFES_OneToOne 0.00 3.000 FORMAT "%5.3" EXTENDED_LIMITS 0.00 255.0 /end CHARACTERISTIC
/begin CHARACTERISTIC DFES_Cls.DFC_ComFrbd_47Bh_eCOMP_PeakPhaCurrent_C "" VALUE 0x80241825 Val_Wu8 3.000 DFES_OneToOne 0.00 3.000 FORMAT "%5.3" EXTENDED_LIMITS 0.00 255.0 /end CHARACTERISTIC
/begin CHARACTERISTIC DFES_Cls.DFC_ComFrbd_47Bh_eCOMP_Power_consumption_C "" VALUE 0x80241826 Val_Wu8 3.000 DFES_OneToOne 0.00 3.000 FORMAT "%5.3" EXTENDED_LIMITS 0.00 255.0 /end CHARACTERISTIC
/begin CHARACTERISTIC DFES_Cls.DFC_ComFrbd_48Bh_eCOMP_Fault_Level_C "" VALUE 0x80241827 Val_Wu8 3.000 DFES_OneToOne 0.00 3.000 FORMAT "%5.3" EXTENDED_LIMITS 0.00 255.0 /end CHARACTERISTIC
/begin CHARACTERISTIC DFES_Cls.DFC_ComFrbd_4F2h_VALEUR_SOC_ETENDUE_C "" VALUE 0x80241828 Val_Wu8 3.000 DFES_OneToOne 0.00 3.000 FORMAT "%5.3" EXTENDED_LIMITS 0.00 255.0 /end CHARACTERISTIC
/begin CHARACTERISTIC DFES_Cls.DFC_ComFrbd_535h_HV_BATT_TEMP_AVG_C "" VALUE 0x80241829 Val_Wu8 3.000 DFES_OneToOne 0.00 3.000 FORMAT "%5.3" EXTENDED_LIMITS 0.00 255.0 /end CHARACTERISTIC
/begin CHARACTERISTIC DFES_Cls.DFC_ComFrbd_543h_HVBAT_RESTBATTENERGY_C "" VALUE 0x8024182A Val_Wu8 3.000 DFES_OneToOne 0.00 3.000 FORMAT "%5.3" EXTENDED_LIMITS 0.00 255.0 /end CHARACTERISTIC
/begin CHARACTERISTIC DFES_Cls.DFC_ComFrbd_543h_HVBAT_SOH_C "" VALUE 0x8024182B Val_Wu8 3.000 DFES_OneToOne 0.00 3.000 FORMAT "%5.3" EXTENDED_LIMITS 0.00 255.0 /end CHARACTERISTIC
/begin CHARACTERISTIC DFES_Cls.DFC_ComFrbd_543h_HV_BATT_SOH_RES_C "" VALUE 0x8024182C Val_Wu8 3.000 DFES_OneToOne 0.00 3.000 FORMAT "%5.3" EXTENDED_LIMITS 0.00 255.0 /end CHARACTERISTIC
/begin CHARACTERISTIC DFES_Cls.DFC_ComFrbd_592h_IBATT_1_C "" VALUE 0x8024182D Val_Wu8 3.000 DFES_OneToOne 0.00 3.000 FORMAT "%5.3" EXTENDED_LIMITS 0.00 255.0 /end CHARACTERISTIC
/begin CHARACTERISTIC DFES_Cls.DFC_ComFrbd_592h_IBATT_2_C "" VALUE 0x8024182E Val_Wu8 3.000 DFES_OneToOne 0.00 3.000 FORMAT "%5.3" EXTENDED_LIMITS 0.00 255.0 /end CHARACTERISTIC
/begin CHARACTERISTIC DFES_Cls.DFC_ComFrbd_592h_IBATT_3_C "" VALUE 0x8024182F Val_Wu8 3.000 DFES_OneToOne 0.00 3.000 FORMAT "%5.3" EXTENDED_LIMITS 0.00 255.0 /end CHARACTERISTIC
/begin CHARACTERISTIC DFES_Cls.DFC_ComFrbd_592h_TEMP_BATT_C "" VALUE 0x80241830 Val_Wu8 3.000 DFES_OneToOne 0.00 3.000 FORMAT "%5.3" EXTENDED_LIMITS 0.00 255.0 /end CHARACTERISTIC
/begin CHARACTERISTIC DFES_Cls.DFC_ComFrbd_592h_U_BATT_BECB_C "" VALUE 0x80241831 Val_Wu8 3.000 DFES_OneToOne 0.00 3.000 FORMAT "%5.3" EXTENDED_LIMITS 0.00 255.0 /end CHARACTERISTIC
/begin CHARACTERISTIC DFES_Cls.DFC_ComFrbd_595h_HVBAT_TIME_TO_CHRG_80_C "" VALUE 0x80241832 Val_Wu8 3.000 DFES_OneToOne 0.00 3.000 FORMAT "%5.3" EXTENDED_LIMITS 0.00 255.0 /end CHARACTERISTIC
/begin CHARACTERISTIC DFES_Cls.DFC_ComFrbd_5B2h_TEMP_AIR_EXT_C "" VALUE 0x80241833 Val_Wu8 3.000 DFES_OneToOne 0.00 3.000 FORMAT "%5.3" EXTENDED_LIMITS 0.00 255.0 /end CHARACTERISTIC
/begin CHARACTERISTIC DFES_Cls.DFC_ComFrbd_635h_HVBAT_NEG_CONT_COUNT_SEG1_C "" VALUE 0x80241834 Val_Wu8 3.000 DFES_OneToOne 0.00 3.000 FORMAT "%5.3" EXTENDED_LIMITS 0.00 255.0 /end CHARACTERISTIC
/begin CHARACTERISTIC DFES_Cls.DFC_ComFrbd_635h_HVBAT_NEG_CONT_COUNT_SEG3_C "" VALUE 0x80241835 Val_Wu8 3.000 DFES_OneToOne 0.00 3.000 FORMAT "%5.3" EXTENDED_LIMITS 0.00 255.0 /end CHARACTERISTIC
/begin CHARACTERISTIC DFES_Cls.DFC_ComFrbd_635h_HVBAT_NEG_CONT_COUNT_SEG4_C "" VALUE 0x80241836 Val_Wu8 3.000 DFES_OneToOne 0.00 3.000 FORMAT "%5.3" EXTENDED_LIMITS 0.00 255.0 /end CHARACTERISTIC
/begin CHARACTERISTIC DFES_Cls.DFC_ComFrbd_635h_HVBAT_PST_CONT_COUNT_SEG1_C "" VALUE 0x80241837 Val_Wu8 3.000 DFES_OneToOne 0.00 3.000 FORMAT "%5.3" EXTENDED_LIMITS 0.00 255.0 /end CHARACTERISTIC
/begin CHARACTERISTIC DFES_Cls.DFC_ComFrbd_635h_HVBAT_PST_CONT_COUNT_SEG3_C "" VALUE 0x80241838 Val_Wu8 3.000 DFES_OneToOne 0.00 3.000 FORMAT "%5.3" EXTENDED_LIMITS 0.00 255.0 /end CHARACTERISTIC
/begin CHARACTERISTIC DFES_Cls.DFC_ComFrbd_635h_HVBAT_PST_CONT_COUNT_SEG4_C "" VALUE 0x80241839 Val_Wu8 3.000 DFES_OneToOne 0.00 3.000 FORMAT "%5.3" EXTENDED_LIMITS 0.00 255.0 /end CHARACTERISTIC
/begin CHARACTERISTIC DFES_Cls.DFC_ComFrbd_645h_HVBAT_PRECHRGE_CONT_COUNT_SEG1_C "" VALUE 0x8024183A Val_Wu8 3.000 DFES_OneToOne 0.00 3.000 FORMAT "%5.3" EXTENDED_LIMITS 0.00 255.0 /end CHARACTERISTIC
/begin CHARACTERISTIC DFES_Cls.DFC_ComFrbd_645h_HVBAT_PRECHRGE_CONT_COUNT_SEG2_C "" VALUE 0x8024183B Val_Wu8 3.000 DFES_OneToOne 0.00 3.000 FORMAT "%5.3" EXTENDED_LIMITS 0.00 255.0 /end CHARACTERISTIC
/begin CHARACTERISTIC DFES_Cls.DFC_ComFrbd_675h_HVBAT_REMAININGBATTCAPACITY_C "" VALUE 0x8024183C Val_Wu8 3.000 DFES_OneToOne 0.00 3.000 FORMAT "%5.3" EXTENDED_LIMITS 0.00 255.0 /end CHARACTERISTIC
/begin CHARACTERISTIC DFES_Cls.DFC_ComInvld_205h_HVBAT_CHARGING_STATUS_C "" VALUE 0x8024183D Val_Wu8 3.000 DFES_OneToOne 0.00 3.000 FORMAT "%5.3" EXTENDED_LIMITS 0.00 255.0 /end CHARACTERISTIC
/begin CHARACTERISTIC DFES_Cls.DFC_ComInvld_205h_HVBAT_PACK_CURRENT_C "" VALUE 0x8024183E Val_Wu8 3.000 DFES_OneToOne 0.00 3.000 FORMAT "%5.3" EXTENDED_LIMITS 0.00 255.0 /end CHARACTERISTIC
/begin CHARACTERISTIC DFES_Cls.DFC_ComInvld_205h_HVBAT_SOC_DISPLAY_C "" VALUE 0x8024183F Val_Wu8 3.000 DFES_OneToOne 0.00 3.000 FORMAT "%5.3" EXTENDED_LIMITS 0.00 255.0 /end CHARACTERISTIC
/begin CHARACTERISTIC DFES_Cls.DFC_ComInvld_205h_HVBAT_VOLTAGE_C "" VALUE 0x80241840 Val_Wu8 3.000 DFES_OneToOne 0.00 3.000 FORMAT "%5.3" EXTENDED_LIMITS 0.00 255.0 /end CHARACTERISTIC
/begin CHARACTERISTIC DFES_Cls.DFC_ComInvld_217h_INV_DC_BUS_VOLTAGE_C "" VALUE 0x80241841 Val_Wu8 3.000 DFES_OneToOne 0.00 3.000 FORMAT "%5.3" EXTENDED_LIMITS 0.00 255.0 /end CHARACTERISTIC
/begin CHARACTERISTIC DFES_Cls.DFC_ComInvld_217h_INV_MTR_ACTUAL_TRQ_C "" VALUE 0x80241842 Val_Wu8 3.000 DFES_OneToOne 0.00 3.000 FORMAT "%5.3" EXTENDED_LIMITS 0.00 255.0 /end CHARACTERISTIC
/begin CHARACTERISTIC DFES_Cls.DFC_ComInvld_217h_INV_MTR_SPEED_C "" VALUE 0x80241843 Val_Wu8 3.000 DFES_OneToOne 0.00 3.000 FORMAT "%5.3" EXTENDED_LIMITS 0.00 255.0 /end CHARACTERISTIC
/begin CHARACTERISTIC DFES_Cls.DFC_ComInvld_217h_INV_MTR_TRQ_C "" VALUE 0x80241844 Val_Wu8 3.000 DFES_OneToOne 0.00 3.000 FORMAT "%5.3" EXTENDED_LIMITS 0.00 255.0 /end CHARACTERISTIC
/begin CHARACTERISTIC DFES_Cls.DFC_ComInvld_227h_INV_DC_CURRENT_C "" VALUE 0x80241845 Val_Wu8 3.000 DFES_OneToOne 0.00 3.000 FORMAT "%5.3" EXTENDED_LIMITS 0.00 255.0 /end CHARACTERISTIC
/begin CHARACTERISTIC DFES_Cls.DFC_ComInvld_227h_INV_MOTORING_PEAK_TRQ_C "" VALUE 0x80241846 Val_Wu8 3.000 DFES_OneToOne 0.00 3.000 FORMAT "%5.3" EXTENDED_LIMITS 0.00 255.0 /end CHARACTERISTIC
/begin CHARACTERISTIC DFES_Cls.DFC_ComInvld_227h_INV_MTR_INST_INPUT_POWER_C "" VALUE 0x80241847 Val_Wu8 3.000 DFES_OneToOne 0.00 3.000 FORMAT "%5.3" EXTENDED_LIMITS 0.00 255.0 /end CHARACTERISTIC
/begin CHARACTERISTIC DFES_Cls.DFC_ComInvld_227h_INV_REGEN_PEAK_TRQ_C "" VALUE 0x80241848 Val_Wu8 3.000 DFES_OneToOne 0.00 3.000 FORMAT "%5.3" EXTENDED_LIMITS 0.00 255.0 /end CHARACTERISTIC
/begin CHARACTERISTIC DFES_Cls.DFC_ComInvld_237h_INV_ACTIVE_DISCHARGE_STATUS_C "" VALUE 0x80241849 Val_Wu8 3.000 DFES_OneToOne 0.00 3.000 FORMAT "%5.3" EXTENDED_LIMITS 0.00 255.0 /end CHARACTERISTIC
/begin CHARACTERISTIC DFES_Cls.DFC_ComInvld_237h_INV_FAULT_LEVEL_C "" VALUE 0x8024184A Val_Wu8 3.000 DFES_OneToOne 0.00 3.000 FORMAT "%5.3" EXTENDED_LIMITS 0.00 255.0 /end CHARACTERISTIC
/begin CHARACTERISTIC DFES_Cls.DFC_ComInvld_237h_INV_STAB_MIN_TRQ_C "" VALUE 0x8024184B Val_Wu8 3.000 DFES_OneToOne 0.00 3.000 FORMAT "%5.3" EXTENDED_LIMITS 0.00 255.0 /end CHARACTERISTIC
/begin CHARACTERISTIC DFES_Cls.DFC_ComInvld_259h_TGLM_MODE_PUSH_C "" VALUE 0x8024184C Val_Wu8 3.000 DFES_OneToOne 0.00 3.000 FORMAT "%5.3" EXTENDED_LIMITS 0.00 255.0 /end CHARACTERISTIC
/begin CHARACTERISTIC DFES_Cls.DFC_ComInvld_259h_TOGGLE_MONOSTABLE_POS_C "" VALUE 0x8024184D Val_Wu8 3.000 DFES_OneToOne 0.00 3.000 FORMAT "%5.3" EXTENDED_LIMITS 0.00 255.0 /end CHARACTERISTIC
/begin CHARACTERISTIC DFES_Cls.DFC_ComInvld_26h_AC_SWITCH_REQ_C "" VALUE 0x8024184E Val_Wu8 3.000 DFES_OneToOne 0.00 3.000 FORMAT "%5.3" EXTENDED_LIMITS 0.00 255.0 /end CHARACTERISTIC
/begin CHARACTERISTIC DFES_Cls.DFC_ComInvld_26h_BLOWER_POSITION_C "" VALUE 0x8024184F Val_Wu8 3.000 DFES_OneToOne 0.00 3.000 FORMAT "%5.3" EXTENDED_LIMITS 0.00 255.0 /end CHARACTERISTIC
/begin CHARACTERISTIC DFES_Cls.DFC_ComInvld_26h_EVAP_SENSOR_FAULT_C "" VALUE 0x80241850 Val_Wu8 3.000 DFES_OneToOne 0.00 3.000 FORMAT "%5.3" EXTENDED_LIMITS 0.00 255.0 /end CHARACTERISTIC
/begin CHARACTERISTIC DFES_Cls.DFC_ComInvld_26h_EVAP_SENSOR_VALUE_C "" VALUE 0x80241851 Val_Wu8 3.000 DFES_OneToOne 0.00 3.000 FORMAT "%5.3" EXTENDED_LIMITS 0.00 255.0 /end CHARACTERISTIC
/begin CHARACTERISTIC DFES_Cls.DFC_ComInvld_26h_POTENTIOMETER_FAULT_C "" VALUE 0x80241852 Val_Wu8 3.000 DFES_OneToOne 0.00 3.000 FORMAT "%5.3" EXTENDED_LIMITS 0.00 255.0 /end CHARACTERISTIC
/begin CHARACTERISTIC DFES_Cls.DFC_ComInvld_26h_REAR_DEFOG_REQ_C "" VALUE 0x80241853 Val_Wu8 3.000 DFES_OneToOne 0.00 3.000 FORMAT "%5.3" EXTENDED_LIMITS 0.00 255.0 /end CHARACTERISTIC
/begin CHARACTERISTIC DFES_Cls.DFC_ComInvld_26h_TEMP_POSITION_C "" VALUE 0x80241854 Val_Wu8 3.000 DFES_OneToOne 0.00 3.000 FORMAT "%5.3" EXTENDED_LIMITS 0.00 255.0 /end CHARACTERISTIC
/begin CHARACTERISTIC DFES_Cls.DFC_ComInvld_273h_OBC_FAULT_LEVEL_C "" VALUE 0x80241855 Val_Wu8 3.000 DFES_OneToOne 0.00 3.000 FORMAT "%5.3" EXTENDED_LIMITS 0.00 255.0 /end CHARACTERISTIC
/begin CHARACTERISTIC DFES_Cls.DFC_ComInvld_273h_OBC_outputpower_capability_C "" VALUE 0x80241856 Val_Wu8 3.000 DFES_OneToOne 0.00 3.000 FORMAT "%5.3" EXTENDED_LIMITS 0.00 255.0 /end CHARACTERISTIC
/begin CHARACTERISTIC DFES_Cls.DFC_ComInvld_275h_HVBAT_DISCHARGE_30S_AVAILABLE_CURRENT_C "" VALUE 0x80241857 Val_Wu8 3.000 DFES_OneToOne 0.00 3.000 FORMAT "%5.3" EXTENDED_LIMITS 0.00 255.0 /end CHARACTERISTIC
/begin CHARACTERISTIC DFES_Cls.DFC_ComInvld_275h_HVBAT_DISCHARGE_30S_AVAILABLE_POWER_C "" VALUE 0x80241858 Val_Wu8 3.000 DFES_OneToOne 0.00 3.000 FORMAT "%5.3" EXTENDED_LIMITS 0.00 255.0 /end CHARACTERISTIC
/begin CHARACTERISTIC DFES_Cls.DFC_ComInvld_283h_DCDC_IN_CURRENT_C "" VALUE 0x80241859 Val_Wu8 3.000 DFES_OneToOne 0.00 3.000 FORMAT "%5.3" EXTENDED_LIMITS 0.00 255.0 /end CHARACTERISTIC
/begin CHARACTERISTIC DFES_Cls.DFC_ComInvld_283h_DCDC_IN_VOLTAGE_C "" VALUE 0x8024185A Val_Wu8 3.000 DFES_OneToOne 0.00 3.000 FORMAT "%5.3" EXTENDED_LIMITS 0.00 255.0 /end CHARACTERISTIC
/begin CHARACTERISTIC DFES_Cls.DFC_ComInvld_283h_DCDC_OUT_CURRENT_C "" VALUE 0x8024185B Val_Wu8 3.000 DFES_OneToOne 0.00 3.000 FORMAT "%5.3" EXTENDED_LIMITS 0.00 255.0 /end CHARACTERISTIC
/begin CHARACTERISTIC DFES_Cls.DFC_ComInvld_283h_DCDC_OUT_VOLTAGE_C "" VALUE 0x8024185C Val_Wu8 3.000 DFES_OneToOne 0.00 3.000 FORMAT "%5.3" EXTENDED_LIMITS 0.00 255.0 /end CHARACTERISTIC
/begin CHARACTERISTIC DFES_Cls.DFC_ComInvld_285h_HVBAT_REGEN_CHG_30S_CURRENT_LIMIT_C "" VALUE 0x8024185D Val_Wu8 3.000 DFES_OneToOne 0.00 3.000 FORMAT "%5.3" EXTENDED_LIMITS 0.00 255.0 /end CHARACTERISTIC
/begin CHARACTERISTIC DFES_Cls.DFC_ComInvld_285h_HVBAT_REGEN_CHRG_30S_POWER_LIMIT_C "" VALUE 0x8024185E Val_Wu8 3.000 DFES_OneToOne 0.00 3.000 FORMAT "%5.3" EXTENDED_LIMITS 0.00 255.0 /end CHARACTERISTIC
/begin CHARACTERISTIC DFES_Cls.DFC_ComInvld_293h_DCDC_FAULT_LEVEL_C "" VALUE 0x8024185F Val_Wu8 3.000 DFES_OneToOne 0.00 3.000 FORMAT "%5.3" EXTENDED_LIMITS 0.00 255.0 /end CHARACTERISTIC
/begin CHARACTERISTIC DFES_Cls.DFC_ComInvld_293h_DCDC_outputpower_capability_C "" VALUE 0x80241860 Val_Wu8 3.000 DFES_OneToOne 0.00 3.000 FORMAT "%5.3" EXTENDED_LIMITS 0.00 255.0 /end CHARACTERISTIC
/begin CHARACTERISTIC DFES_Cls.DFC_ComInvld_325h_HVBAT_EPLUG_STATUS_C "" VALUE 0x80241861 Val_Wu8 3.000 DFES_OneToOne 0.00 3.000 FORMAT "%5.3" EXTENDED_LIMITS 0.00 255.0 /end CHARACTERISTIC
/begin CHARACTERISTIC DFES_Cls.DFC_ComInvld_325h_HVBAT_HVIL_STS_C "" VALUE 0x80241862 Val_Wu8 3.000 DFES_OneToOne 0.00 3.000 FORMAT "%5.3" EXTENDED_LIMITS 0.00 255.0 /end CHARACTERISTIC
/begin CHARACTERISTIC DFES_Cls.DFC_ComInvld_325h_HVBAT_INSULATION_FAULT_C "" VALUE 0x80241863 Val_Wu8 3.000 DFES_OneToOne 0.00 3.000 FORMAT "%5.3" EXTENDED_LIMITS 0.00 255.0 /end CHARACTERISTIC
/begin CHARACTERISTIC DFES_Cls.DFC_ComInvld_325h_HVBAT_INSULATION_RESISTANCE_C "" VALUE 0x80241864 Val_Wu8 3.000 DFES_OneToOne 0.00 3.000 FORMAT "%5.3" EXTENDED_LIMITS 0.00 255.0 /end CHARACTERISTIC
/begin CHARACTERISTIC DFES_Cls.DFC_ComInvld_325h_HVBAT_TEMPERATURE_C "" VALUE 0x80241865 Val_Wu8 3.000 DFES_OneToOne 0.00 3.000 FORMAT "%5.3" EXTENDED_LIMITS 0.00 255.0 /end CHARACTERISTIC
/begin CHARACTERISTIC DFES_Cls.DFC_ComInvld_335h_HVBAT_CHRG_CONTINUOUS_CURR_MAX_C "" VALUE 0x80241866 Val_Wu8 3.000 DFES_OneToOne 0.00 3.000 FORMAT "%5.3" EXTENDED_LIMITS 0.00 255.0 /end CHARACTERISTIC
/begin CHARACTERISTIC DFES_Cls.DFC_ComInvld_335h_HVBAT_CHRG_COTINUOUS_CURR_REQ_C "" VALUE 0x80241867 Val_Wu8 3.000 DFES_OneToOne 0.00 3.000 FORMAT "%5.3" EXTENDED_LIMITS 0.00 255.0 /end CHARACTERISTIC
/begin CHARACTERISTIC DFES_Cls.DFC_ComInvld_335h_HVBAT_CHRG_MAX_VOLT_C "" VALUE 0x80241868 Val_Wu8 3.000 DFES_OneToOne 0.00 3.000 FORMAT "%5.3" EXTENDED_LIMITS 0.00 255.0 /end CHARACTERISTIC
/begin CHARACTERISTIC DFES_Cls.DFC_ComInvld_335h_HVBAT_DC_BUS_VOLTAGE_C "" VALUE 0x80241869 Val_Wu8 3.000 DFES_OneToOne 0.00 3.000 FORMAT "%5.3" EXTENDED_LIMITS 0.00 255.0 /end CHARACTERISTIC
/begin CHARACTERISTIC DFES_Cls.DFC_ComInvld_38Dh_VITESSE_VEHICULE_ROUES_C "" VALUE 0x8024186A Val_Wu8 3.000 DFES_OneToOne 0.00 3.000 FORMAT "%5.3" EXTENDED_LIMITS 0.00 255.0 /end CHARACTERISTIC
/begin CHARACTERISTIC DFES_Cls.DFC_ComInvld_38Dh_VVH_INDISP_C "" VALUE 0x8024186B Val_Wu8 3.000 DFES_OneToOne 0.00 3.000 FORMAT "%5.3" EXTENDED_LIMITS 0.00 255.0 /end CHARACTERISTIC
/begin CHARACTERISTIC DFES_Cls.DFC_ComInvld_427h_INV_COOLANT_TEMP_C "" VALUE 0x8024186C Val_Wu8 3.000 DFES_OneToOne 0.00 3.000 FORMAT "%5.3" EXTENDED_LIMITS 0.00 255.0 /end CHARACTERISTIC
/begin CHARACTERISTIC DFES_Cls.DFC_ComInvld_427h_INV_MOTOR_TEMP_C "" VALUE 0x8024186D Val_Wu8 3.000 DFES_OneToOne 0.00 3.000 FORMAT "%5.3" EXTENDED_LIMITS 0.00 255.0 /end CHARACTERISTIC
/begin CHARACTERISTIC DFES_Cls.DFC_ComInvld_427h_INV_OP_MODE_C "" VALUE 0x8024186E Val_Wu8 3.000 DFES_OneToOne 0.00 3.000 FORMAT "%5.3" EXTENDED_LIMITS 0.00 255.0 /end CHARACTERISTIC
/begin CHARACTERISTIC DFES_Cls.DFC_ComInvld_427h_INV_PERMISIBLE_TORQUE_C "" VALUE 0x8024186F Val_Wu8 3.000 DFES_OneToOne 0.00 3.000 FORMAT "%5.3" EXTENDED_LIMITS 0.00 255.0 /end CHARACTERISTIC
/begin CHARACTERISTIC DFES_Cls.DFC_ComInvld_427h_INV_TEMP_C "" VALUE 0x80241870 Val_Wu8 3.000 DFES_OneToOne 0.00 3.000 FORMAT "%5.3" EXTENDED_LIMITS 0.00 255.0 /end CHARACTERISTIC
/begin CHARACTERISTIC DFES_Cls.DFC_ComInvld_432h_REVEIL_PRINCIPAL_C "" VALUE 0x80241871 Val_Wu8 3.000 DFES_OneToOne 0.00 3.000 FORMAT "%5.3" EXTENDED_LIMITS 0.00 255.0 /end CHARACTERISTIC
/begin CHARACTERISTIC DFES_Cls.DFC_ComInvld_435h_HVBAT_MAX_CELL_VOLT_C "" VALUE 0x80241872 Val_Wu8 3.000 DFES_OneToOne 0.00 3.000 FORMAT "%5.3" EXTENDED_LIMITS 0.00 255.0 /end CHARACTERISTIC
/begin CHARACTERISTIC DFES_Cls.DFC_ComInvld_435h_HVBAT_MAX_CELL_VOLT_NUM_C "" VALUE 0x80241873 Val_Wu8 3.000 DFES_OneToOne 0.00 3.000 FORMAT "%5.3" EXTENDED_LIMITS 0.00 255.0 /end CHARACTERISTIC
/begin CHARACTERISTIC DFES_Cls.DFC_ComInvld_435h_HVBAT_MAX_SENSOR_TEMP_C "" VALUE 0x80241874 Val_Wu8 3.000 DFES_OneToOne 0.00 3.000 FORMAT "%5.3" EXTENDED_LIMITS 0.00 255.0 /end CHARACTERISTIC
/begin CHARACTERISTIC DFES_Cls.DFC_ComInvld_435h_HVBAT_MIN_CELL_VOLT_C "" VALUE 0x80241875 Val_Wu8 3.000 DFES_OneToOne 0.00 3.000 FORMAT "%5.3" EXTENDED_LIMITS 0.00 255.0 /end CHARACTERISTIC
/begin CHARACTERISTIC DFES_Cls.DFC_ComInvld_435h_HVBAT_MIN_CELL_VOLT_NUM_C "" VALUE 0x80241876 Val_Wu8 3.000 DFES_OneToOne 0.00 3.000 FORMAT "%5.3" EXTENDED_LIMITS 0.00 255.0 /end CHARACTERISTIC
/begin CHARACTERISTIC DFES_Cls.DFC_ComInvld_442h_BCCM_BLOWER_RELAY_STS_C "" VALUE 0x80241877 Val_Wu8 3.000 DFES_OneToOne 0.00 3.000 FORMAT "%5.3" EXTENDED_LIMITS 0.00 255.0 /end CHARACTERISTIC
/begin CHARACTERISTIC DFES_Cls.DFC_ComInvld_453h_OBC_IN_CURRENT_C "" VALUE 0x80241878 Val_Wu8 3.000 DFES_OneToOne 0.00 3.000 FORMAT "%5.3" EXTENDED_LIMITS 0.00 255.0 /end CHARACTERISTIC
/begin CHARACTERISTIC DFES_Cls.DFC_ComInvld_453h_OBC_IN_VOLTAGE_C "" VALUE 0x80241879 Val_Wu8 3.000 DFES_OneToOne 0.00 3.000 FORMAT "%5.3" EXTENDED_LIMITS 0.00 255.0 /end CHARACTERISTIC
/begin CHARACTERISTIC DFES_Cls.DFC_ComInvld_453h_OBC_IP_POWER_C "" VALUE 0x8024187A Val_Wu8 3.000 DFES_OneToOne 0.00 3.000 FORMAT "%5.3" EXTENDED_LIMITS 0.00 255.0 /end CHARACTERISTIC
/begin CHARACTERISTIC DFES_Cls.DFC_ComInvld_455h_HVBAT_NOMINAL_VOLTAGE_C "" VALUE 0x8024187B Val_Wu8 3.000 DFES_OneToOne 0.00 3.000 FORMAT "%5.3" EXTENDED_LIMITS 0.00 255.0 /end CHARACTERISTIC
/begin CHARACTERISTIC DFES_Cls.DFC_ComInvld_463h_OBC_OUT_CURRENT_C "" VALUE 0x8024187C Val_Wu8 3.000 DFES_OneToOne 0.00 3.000 FORMAT "%5.3" EXTENDED_LIMITS 0.00 255.0 /end CHARACTERISTIC
/begin CHARACTERISTIC DFES_Cls.DFC_ComInvld_463h_OBC_OUT_VOLTAGE_C "" VALUE 0x8024187D Val_Wu8 3.000 DFES_OneToOne 0.00 3.000 FORMAT "%5.3" EXTENDED_LIMITS 0.00 255.0 /end CHARACTERISTIC
/begin CHARACTERISTIC DFES_Cls.DFC_ComInvld_463h_OBC_TEMPERATURE_C "" VALUE 0x8024187E Val_Wu8 3.000 DFES_OneToOne 0.00 3.000 FORMAT "%5.3" EXTENDED_LIMITS 0.00 255.0 /end CHARACTERISTIC
/begin CHARACTERISTIC DFES_Cls.DFC_ComInvld_473h_DCDC_Coolant_Temperature_C "" VALUE 0x8024187F Val_Wu8 3.000 DFES_OneToOne 0.00 3.000 FORMAT "%5.3" EXTENDED_LIMITS 0.00 255.0 /end CHARACTERISTIC
/begin CHARACTERISTIC DFES_Cls.DFC_ComInvld_473h_DCDC_TEMPERATURE_C "" VALUE 0x80241880 Val_Wu8 3.000 DFES_OneToOne 0.00 3.000 FORMAT "%5.3" EXTENDED_LIMITS 0.00 255.0 /end CHARACTERISTIC
/begin CHARACTERISTIC DFES_Cls.DFC_ComInvld_47Bh_eCOMP_BusBarCurrent_C "" VALUE 0x80241881 Val_Wu8 3.000 DFES_OneToOne 0.00 3.000 FORMAT "%5.3" EXTENDED_LIMITS 0.00 255.0 /end CHARACTERISTIC
/begin CHARACTERISTIC DFES_Cls.DFC_ComInvld_47Bh_eCOMP_BusBarVoltage_C "" VALUE 0x80241882 Val_Wu8 3.000 DFES_OneToOne 0.00 3.000 FORMAT "%5.3" EXTENDED_LIMITS 0.00 255.0 /end CHARACTERISTIC
/begin CHARACTERISTIC DFES_Cls.DFC_ComInvld_47Bh_eCOMP_CompressorSpeed_C "" VALUE 0x80241883 Val_Wu8 3.000 DFES_OneToOne 0.00 3.000 FORMAT "%5.3" EXTENDED_LIMITS 0.00 255.0 /end CHARACTERISTIC
/begin CHARACTERISTIC DFES_Cls.DFC_ComInvld_47Bh_eCOMP_IGBT_Temp_C "" VALUE 0x80241884 Val_Wu8 3.000 DFES_OneToOne 0.00 3.000 FORMAT "%5.3" EXTENDED_LIMITS 0.00 255.0 /end CHARACTERISTIC
/begin CHARACTERISTIC DFES_Cls.DFC_ComInvld_47Bh_eCOMP_PeakPhaCurrent_C "" VALUE 0x80241885 Val_Wu8 3.000 DFES_OneToOne 0.00 3.000 FORMAT "%5.3" EXTENDED_LIMITS 0.00 255.0 /end CHARACTERISTIC
/begin CHARACTERISTIC DFES_Cls.DFC_ComInvld_47Bh_eCOMP_Power_consumption_C "" VALUE 0x80241886 Val_Wu8 3.000 DFES_OneToOne 0.00 3.000 FORMAT "%5.3" EXTENDED_LIMITS 0.00 255.0 /end CHARACTERISTIC
/begin CHARACTERISTIC DFES_Cls.DFC_ComInvld_4F2h_STATUS_SOC_C "" VALUE 0x80241887 Val_Wu8 3.000 DFES_OneToOne 0.00 3.000 FORMAT "%5.3" EXTENDED_LIMITS 0.00 255.0 /end CHARACTERISTIC
/begin CHARACTERISTIC DFES_Cls.DFC_ComInvld_4F2h_TEMP_BATT_STATUS_C "" VALUE 0x80241888 Val_Wu8 3.000 DFES_OneToOne 0.00 3.000 FORMAT "%5.3" EXTENDED_LIMITS 0.00 255.0 /end CHARACTERISTIC
/begin CHARACTERISTIC DFES_Cls.DFC_ComInvld_4F2h_VALEUR_SOC_ETENDUE_C "" VALUE 0x80241889 Val_Wu8 3.000 DFES_OneToOne 0.00 3.000 FORMAT "%5.3" EXTENDED_LIMITS 0.00 255.0 /end CHARACTERISTIC
/begin CHARACTERISTIC DFES_Cls.DFC_ComInvld_535h_HV_BATT_TEMP_AVG_C "" VALUE 0x8024188A Val_Wu8 3.000 DFES_OneToOne 0.00 3.000 FORMAT "%5.3" EXTENDED_LIMITS 0.00 255.0 /end CHARACTERISTIC
/begin CHARACTERISTIC DFES_Cls.DFC_ComInvld_543h_HVBAT_RESTBATTENERGY_C "" VALUE 0x8024188B Val_Wu8 3.000 DFES_OneToOne 0.00 3.000 FORMAT "%5.3" EXTENDED_LIMITS 0.00 255.0 /end CHARACTERISTIC
/begin CHARACTERISTIC DFES_Cls.DFC_ComInvld_543h_HVBAT_SOH_C "" VALUE 0x8024188C Val_Wu8 3.000 DFES_OneToOne 0.00 3.000 FORMAT "%5.3" EXTENDED_LIMITS 0.00 255.0 /end CHARACTERISTIC
/begin CHARACTERISTIC DFES_Cls.DFC_ComInvld_543h_HV_BATT_SOH_RES_C "" VALUE 0x8024188D Val_Wu8 3.000 DFES_OneToOne 0.00 3.000 FORMAT "%5.3" EXTENDED_LIMITS 0.00 255.0 /end CHARACTERISTIC
/begin CHARACTERISTIC DFES_Cls.DFC_ComInvld_552h_CPT_TEMPOREL_C "" VALUE 0x8024188E Val_Wu8 3.000 DFES_OneToOne 0.00 3.000 FORMAT "%5.3" EXTENDED_LIMITS 0.00 255.0 /end CHARACTERISTIC
/begin CHARACTERISTIC DFES_Cls.DFC_ComInvld_552h_KILOMETRAGE_C "" VALUE 0x8024188F Val_Wu8 3.000 DFES_OneToOne 0.00 3.000 FORMAT "%5.3" EXTENDED_LIMITS 0.00 255.0 /end CHARACTERISTIC
/begin CHARACTERISTIC DFES_Cls.DFC_ComInvld_583h_HV_BATT_DISCONT_CSE_OPEN_C "" VALUE 0x80241890 Val_Wu8 3.000 DFES_OneToOne 0.00 3.000 FORMAT "%5.3" EXTENDED_LIMITS 0.00 255.0 /end CHARACTERISTIC
/begin CHARACTERISTIC DFES_Cls.DFC_ComInvld_592h_CALIBRE_IBATT_C "" VALUE 0x80241891 Val_Wu8 3.000 DFES_OneToOne 0.00 3.000 FORMAT "%5.3" EXTENDED_LIMITS 0.00 255.0 /end CHARACTERISTIC
/begin CHARACTERISTIC DFES_Cls.DFC_ComInvld_592h_IBATT_1_C "" VALUE 0x80241892 Val_Wu8 3.000 DFES_OneToOne 0.00 3.000 FORMAT "%5.3" EXTENDED_LIMITS 0.00 255.0 /end CHARACTERISTIC
/begin CHARACTERISTIC DFES_Cls.DFC_ComInvld_592h_IBATT_2_C "" VALUE 0x80241893 Val_Wu8 3.000 DFES_OneToOne 0.00 3.000 FORMAT "%5.3" EXTENDED_LIMITS 0.00 255.0 /end CHARACTERISTIC
/begin CHARACTERISTIC DFES_Cls.DFC_ComInvld_592h_IBATT_3_C "" VALUE 0x80241894 Val_Wu8 3.000 DFES_OneToOne 0.00 3.000 FORMAT "%5.3" EXTENDED_LIMITS 0.00 255.0 /end CHARACTERISTIC
/begin CHARACTERISTIC DFES_Cls.DFC_ComInvld_592h_TEMP_BATT_C "" VALUE 0x80241895 Val_Wu8 3.000 DFES_OneToOne 0.00 3.000 FORMAT "%5.3" EXTENDED_LIMITS 0.00 255.0 /end CHARACTERISTIC
/begin CHARACTERISTIC DFES_Cls.DFC_ComInvld_592h_U_BATT_BECB_C "" VALUE 0x80241896 Val_Wu8 3.000 DFES_OneToOne 0.00 3.000 FORMAT "%5.3" EXTENDED_LIMITS 0.00 255.0 /end CHARACTERISTIC
/begin CHARACTERISTIC DFES_Cls.DFC_ComInvld_595h_HVBAT_TIME_TO_CHRG_80_C "" VALUE 0x80241897 Val_Wu8 3.000 DFES_OneToOne 0.00 3.000 FORMAT "%5.3" EXTENDED_LIMITS 0.00 255.0 /end CHARACTERISTIC
/begin CHARACTERISTIC DFES_Cls.DFC_ComInvld_5B2h_TEMP_AIR_EXT_C "" VALUE 0x80241898 Val_Wu8 3.000 DFES_OneToOne 0.00 3.000 FORMAT "%5.3" EXTENDED_LIMITS 0.00 255.0 /end CHARACTERISTIC
/begin CHARACTERISTIC DFES_Cls.DFC_ComInvld_5B5h_HVBAT_THERMAL_RUNAWAY_C "" VALUE 0x80241899 Val_Wu8 3.000 DFES_OneToOne 0.00 3.000 FORMAT "%5.3" EXTENDED_LIMITS 0.00 255.0 /end CHARACTERISTIC
/begin CHARACTERISTIC DFES_Cls.DFC_ComInvld_635h_HVBAT_NEG_CONT_COUNT_SEG1_C "" VALUE 0x8024189A Val_Wu8 3.000 DFES_OneToOne 0.00 3.000 FORMAT "%5.3" EXTENDED_LIMITS 0.00 255.0 /end CHARACTERISTIC
/begin CHARACTERISTIC DFES_Cls.DFC_ComInvld_635h_HVBAT_NEG_CONT_COUNT_SEG3_C "" VALUE 0x8024189B Val_Wu8 3.000 DFES_OneToOne 0.00 3.000 FORMAT "%5.3" EXTENDED_LIMITS 0.00 255.0 /end CHARACTERISTIC
/begin CHARACTERISTIC DFES_Cls.DFC_ComInvld_635h_HVBAT_NEG_CONT_COUNT_SEG4_C "" VALUE 0x8024189C Val_Wu8 3.000 DFES_OneToOne 0.00 3.000 FORMAT "%5.3" EXTENDED_LIMITS 0.00 255.0 /end CHARACTERISTIC
/begin CHARACTERISTIC DFES_Cls.DFC_ComInvld_635h_HVBAT_PST_CONT_COUNT_SEG1_C "" VALUE 0x8024189D Val_Wu8 3.000 DFES_OneToOne 0.00 3.000 FORMAT "%5.3" EXTENDED_LIMITS 0.00 255.0 /end CHARACTERISTIC
/begin CHARACTERISTIC DFES_Cls.DFC_ComInvld_635h_HVBAT_PST_CONT_COUNT_SEG3_C "" VALUE 0x8024189E Val_Wu8 3.000 DFES_OneToOne 0.00 3.000 FORMAT "%5.3" EXTENDED_LIMITS 0.00 255.0 /end CHARACTERISTIC
/begin CHARACTERISTIC DFES_Cls.DFC_ComInvld_635h_HVBAT_PST_CONT_COUNT_SEG4_C "" VALUE 0x8024189F Val_Wu8 3.000 DFES_OneToOne 0.00 3.000 FORMAT "%5.3" EXTENDED_LIMITS 0.00 255.0 /end CHARACTERISTIC
/begin CHARACTERISTIC DFES_Cls.DFC_ComInvld_645h_HVBAT_PRECHRGE_CONT_COUNT_SEG1_C "" VALUE 0x802418A0 Val_Wu8 3.000 DFES_OneToOne 0.00 3.000 FORMAT "%5.3" EXTENDED_LIMITS 0.00 255.0 /end CHARACTERISTIC
/begin CHARACTERISTIC DFES_Cls.DFC_ComInvld_645h_HVBAT_PRECHRGE_CONT_COUNT_SEG2_C "" VALUE 0x802418A1 Val_Wu8 3.000 DFES_OneToOne 0.00 3.000 FORMAT "%5.3" EXTENDED_LIMITS 0.00 255.0 /end CHARACTERISTIC
/begin CHARACTERISTIC DFES_Cls.DFC_ComInvld_675h_HVBAT_REMAININGBATTCAPACITY_C "" VALUE 0x802418A2 Val_Wu8 3.000 DFES_OneToOne 0.00 3.000 FORMAT "%5.3" EXTENDED_LIMITS 0.00 255.0 /end CHARACTERISTIC
/begin CHARACTERISTIC DFES_Cls.DFC_ACCmprFltLvl1_C "" VALUE 0x802418A3 Val_Wu8 3.000 DFES_OneToOne 0.00 3.000 FORMAT "%5.3" EXTENDED_LIMITS 0.00 255.0 /end CHARACTERISTIC
/begin CHARACTERISTIC DFES_Cls.DFC_ACCmprFltLvl2_C "" VALUE 0x802418A4 Val_Wu8 3.000 DFES_OneToOne 0.00 3.000 FORMAT "%5.3" EXTENDED_LIMITS 0.00 255.0 /end CHARACTERISTIC
/begin CHARACTERISTIC DFES_Cls.DFC_ACCmprFltLvl3_C "" VALUE 0x802418A5 Val_Wu8 3.000 DFES_OneToOne 0.00 3.000 FORMAT "%5.3" EXTENDED_LIMITS 0.00 255.0 /end CHARACTERISTIC
/begin CHARACTERISTIC DFES_Cls.DFC_ACCmprFltLvl4_C "" VALUE 0x802418A6 Val_Wu8 3.000 DFES_OneToOne 0.00 3.000 FORMAT "%5.3" EXTENDED_LIMITS 0.00 255.0 /end CHARACTERISTIC
/begin CHARACTERISTIC DFES_Cls.DFC_ACCmprHiPFlt_C "" VALUE 0x802418A7 Val_Wu8 3.000 DFES_OneToOne 0.00 3.000 FORMAT "%5.3" EXTENDED_LIMITS 0.00 255.0 /end CHARACTERISTIC
/begin CHARACTERISTIC DFES_Cls.DFC_ACCmprInvldCmprSt_C "" VALUE 0x802418A8 Val_Wu8 3.000 DFES_OneToOne 0.00 3.000 FORMAT "%5.3" EXTENDED_LIMITS 0.00 255.0 /end CHARACTERISTIC
/begin CHARACTERISTIC DFES_Cls.DFC_ACCmprInvldElecActPwr_C "" VALUE 0x802418A9 Val_Wu8 3.000 DFES_OneToOne 0.00 3.000 FORMAT "%5.3" EXTENDED_LIMITS 0.00 255.0 /end CHARACTERISTIC
/begin CHARACTERISTIC DFES_Cls.DFC_ACCmprLoPFlt_C "" VALUE 0x802418AA Val_Wu8 3.000 DFES_OneToOne 0.00 3.000 FORMAT "%5.3" EXTENDED_LIMITS 0.00 255.0 /end CHARACTERISTIC
/begin CHARACTERISTIC DFES_Cls.DFC_AcChrgrIntkTSRCMin_C "" VALUE 0x802418AB Val_Wu8 3.000 DFES_OneToOne 0.00 3.000 FORMAT "%5.3" EXTENDED_LIMITS 0.00 255.0 /end CHARACTERISTIC
/begin CHARACTERISTIC DFES_Cls.DFC_BattUBMaxBatt_C "" VALUE 0x802418AC Val_Wu8 3.000 DFES_OneToOne 0.00 3.000 FORMAT "%5.3" EXTENDED_LIMITS 0.00 255.0 /end CHARACTERISTIC
/begin CHARACTERISTIC DFES_Cls.DFC_BattUBMaxNoBatt_C "" VALUE 0x802418AD Val_Wu8 3.000 DFES_OneToOne 0.00 3.000 FORMAT "%5.3" EXTENDED_LIMITS 0.00 255.0 /end CHARACTERISTIC
/begin CHARACTERISTIC DFES_Cls.DFC_BattUBMinBatt_C "" VALUE 0x802418AE Val_Wu8 3.000 DFES_OneToOne 0.00 3.000 FORMAT "%5.3" EXTENDED_LIMITS 0.00 255.0 /end CHARACTERISTIC
/begin CHARACTERISTIC DFES_Cls.DFC_BattUBMinNoBatt_C "" VALUE 0x802418AF Val_Wu8 3.000 DFES_OneToOne 0.00 3.000 FORMAT "%5.3" EXTENDED_LIMITS 0.00 255.0 /end CHARACTERISTIC
/begin CHARACTERISTIC DFES_Cls.DFC_BattUSRCMax_C "" VALUE 0x802418B0 Val_Wu8 3.000 DFES_OneToOne 0.00 3.000 FORMAT "%5.3" EXTENDED_LIMITS 0.00 255.0 /end CHARACTERISTIC
/begin CHARACTERISTIC DFES_Cls.DFC_BattUSRCMin_C "" VALUE 0x802418B1 Val_Wu8 3.000 DFES_OneToOne 0.00 3.000 FORMAT "%5.3" EXTENDED_LIMITS 0.00 255.0 /end CHARACTERISTIC
/begin CHARACTERISTIC DFES_Cls.DFC_BrkBstPHiCautionDfct_C "" VALUE 0x802418B2 Val_Wu8 3.000 DFES_OneToOne 0.00 3.000 FORMAT "%5.3" EXTENDED_LIMITS 0.00 255.0 /end CHARACTERISTIC
/begin CHARACTERISTIC DFES_Cls.DFC_BrkBstPHiWarnDfct_C "" VALUE 0x802418B3 Val_Wu8 3.000 DFES_OneToOne 0.00 3.000 FORMAT "%5.3" EXTENDED_LIMITS 0.00 255.0 /end CHARACTERISTIC
/begin CHARACTERISTIC DFES_Cls.DFC_BrkBstPSnsr12PlausDfct_C "" VALUE 0x802418B4 Val_Wu8 3.000 DFES_OneToOne 0.00 3.000 FORMAT "%5.3" EXTENDED_LIMITS 0.00 255.0 /end CHARACTERISTIC
/begin CHARACTERISTIC DFES_Cls.DFC_BrkBstPSnsr1Scb_C "" VALUE 0x802418B5 Val_Wu8 3.000 DFES_OneToOne 0.00 3.000 FORMAT "%5.3" EXTENDED_LIMITS 0.00 255.0 /end CHARACTERISTIC
/begin CHARACTERISTIC DFES_Cls.DFC_BrkBstPSnsr1Scg_C "" VALUE 0x802418B6 Val_Wu8 3.000 DFES_OneToOne 0.00 3.000 FORMAT "%5.3" EXTENDED_LIMITS 0.00 255.0 /end CHARACTERISTIC
/begin CHARACTERISTIC DFES_Cls.DFC_BrkBstPSnsr2Scb_C "" VALUE 0x802418B7 Val_Wu8 3.000 DFES_OneToOne 0.00 3.000 FORMAT "%5.3" EXTENDED_LIMITS 0.00 255.0 /end CHARACTERISTIC
/begin CHARACTERISTIC DFES_Cls.DFC_BrkBstPSnsr2Scg_C "" VALUE 0x802418B8 Val_Wu8 3.000 DFES_OneToOne 0.00 3.000 FORMAT "%5.3" EXTENDED_LIMITS 0.00 255.0 /end CHARACTERISTIC
/begin CHARACTERISTIC DFES_Cls.DFC_BrkBstPSnsrMax_C "" VALUE 0x802418B9 Val_Wu8 3.000 DFES_OneToOne 0.00 3.000 FORMAT "%5.3" EXTENDED_LIMITS 0.00 255.0 /end CHARACTERISTIC
/begin CHARACTERISTIC DFES_Cls.DFC_BrkBstPSnsrMin_C "" VALUE 0x802418BA Val_Wu8 3.000 DFES_OneToOne 0.00 3.000 FORMAT "%5.3" EXTENDED_LIMITS 0.00 255.0 /end CHARACTERISTIC
/begin CHARACTERISTIC DFES_Cls.DFC_BrkBstPhyRngChkMax_C "" VALUE 0x802418BB Val_Wu8 3.000 DFES_OneToOne 0.00 3.000 FORMAT "%5.3" EXTENDED_LIMITS 0.00 255.0 /end CHARACTERISTIC
/begin CHARACTERISTIC DFES_Cls.DFC_BrkBstPhyRngChkMin_C "" VALUE 0x802418BC Val_Wu8 3.000 DFES_OneToOne 0.00 3.000 FORMAT "%5.3" EXTENDED_LIMITS 0.00 255.0 /end CHARACTERISTIC
/begin CHARACTERISTIC DFES_Cls.DFC_BrkBstPmpHsScb_C "" VALUE 0x802418BD Val_Wu8 3.000 DFES_OneToOne 0.00 3.000 FORMAT "%5.3" EXTENDED_LIMITS 0.00 255.0 /end CHARACTERISTIC
/begin CHARACTERISTIC DFES_Cls.DFC_BrkBstPmpHsScg_C "" VALUE 0x802418BE Val_Wu8 3.000 DFES_OneToOne 0.00 3.000 FORMAT "%5.3" EXTENDED_LIMITS 0.00 255.0 /end CHARACTERISTIC
/begin CHARACTERISTIC DFES_Cls.DFC_BrkBstPmpLsOl_C "" VALUE 0x802418BF Val_Wu8 3.000 DFES_OneToOne 0.00 3.000 FORMAT "%5.3" EXTENDED_LIMITS 0.00 255.0 /end CHARACTERISTIC
/begin CHARACTERISTIC DFES_Cls.DFC_BrkBstPmpLsScb_C "" VALUE 0x802418C0 Val_Wu8 3.000 DFES_OneToOne 0.00 3.000 FORMAT "%5.3" EXTENDED_LIMITS 0.00 255.0 /end CHARACTERISTIC
/begin CHARACTERISTIC DFES_Cls.DFC_BrkBstPmpLsScg_C "" VALUE 0x802418C1 Val_Wu8 3.000 DFES_OneToOne 0.00 3.000 FORMAT "%5.3" EXTENDED_LIMITS 0.00 255.0 /end CHARACTERISTIC
/begin CHARACTERISTIC DFES_Cls.DFC_CbnHeatgHeatrRlyOpend_C "" VALUE 0x802418C2 Val_Wu8 3.000 DFES_OneToOne 0.00 3.000 FORMAT "%5.3" EXTENDED_LIMITS 0.00 255.0 /end CHARACTERISTIC
/begin CHARACTERISTIC DFES_Cls.DFC_CbnHeatgHeatrRlyWldd_C "" VALUE 0x802418C3 Val_Wu8 3.000 DFES_OneToOne 0.00 3.000 FORMAT "%5.3" EXTENDED_LIMITS 0.00 255.0 /end CHARACTERISTIC
/begin CHARACTERISTIC DFES_Cls.DFC_CcsDcIBattExcdd_C "" VALUE 0x802418C4 Val_Wu8 3.000 DFES_OneToOne 0.00 3.000 FORMAT "%5.3" EXTENDED_LIMITS 0.00 255.0 /end CHARACTERISTIC
/begin CHARACTERISTIC DFES_Cls.DFC_CcsDcIEvseOutDe_C "" VALUE 0x802418C5 Val_Wu8 3.000 DFES_OneToOne 0.00 3.000 FORMAT "%5.3" EXTENDED_LIMITS 0.00 255.0 /end CHARACTERISTIC
/begin CHARACTERISTIC DFES_Cls.DFC_CcsDcIOutDe_C "" VALUE 0x802418C6 Val_Wu8 3.000 DFES_OneToOne 0.00 3.000 FORMAT "%5.3" EXTENDED_LIMITS 0.00 255.0 /end CHARACTERISTIC
/begin CHARACTERISTIC DFES_Cls.DFC_CcsDcIOutExcdd_C "" VALUE 0x802418C7 Val_Wu8 3.000 DFES_OneToOne 0.00 3.000 FORMAT "%5.3" EXTENDED_LIMITS 0.00 255.0 /end CHARACTERISTIC
/begin CHARACTERISTIC DFES_Cls.DFC_CcsDcUOutDe_C "" VALUE 0x802418C8 Val_Wu8 3.000 DFES_OneToOne 0.00 3.000 FORMAT "%5.3" EXTENDED_LIMITS 0.00 255.0 /end CHARACTERISTIC
/begin CHARACTERISTIC DFES_Cls.DFC_CcsDcUOutExcdd_C "" VALUE 0x802418C9 Val_Wu8 3.000 DFES_OneToOne 0.00 3.000 FORMAT "%5.3" EXTENDED_LIMITS 0.00 255.0 /end CHARACTERISTIC
/begin CHARACTERISTIC DFES_Cls.DFC_CcsPwrLineChpRstOL_C "" VALUE 0x802418CA Val_Wu8 3.000 DFES_OneToOne 0.00 3.000 FORMAT "%5.3" EXTENDED_LIMITS 0.00 255.0 /end CHARACTERISTIC
/begin CHARACTERISTIC DFES_Cls.DFC_CcsPwrLineChpRstOvrTemp_C "" VALUE 0x802418CB Val_Wu8 3.000 DFES_OneToOne 0.00 3.000 FORMAT "%5.3" EXTENDED_LIMITS 0.00 255.0 /end CHARACTERISTIC
/begin CHARACTERISTIC DFES_Cls.DFC_CcsPwrLineChpRstSCB_C "" VALUE 0x802418CC Val_Wu8 3.000 DFES_OneToOne 0.00 3.000 FORMAT "%5.3" EXTENDED_LIMITS 0.00 255.0 /end CHARACTERISTIC
/begin CHARACTERISTIC DFES_Cls.DFC_CcsPwrLineChpRstSCG_C "" VALUE 0x802418CD Val_Wu8 3.000 DFES_OneToOne 0.00 3.000 FORMAT "%5.3" EXTENDED_LIMITS 0.00 255.0 /end CHARACTERISTIC
/begin CHARACTERISTIC DFES_Cls.DFC_CcsPwrLineChpVccEnaOL_C "" VALUE 0x802418CE Val_Wu8 3.000 DFES_OneToOne 0.00 3.000 FORMAT "%5.3" EXTENDED_LIMITS 0.00 255.0 /end CHARACTERISTIC
/begin CHARACTERISTIC DFES_Cls.DFC_CcsPwrLineChpVccEnaOvrTemp_C "" VALUE 0x802418CF Val_Wu8 3.000 DFES_OneToOne 0.00 3.000 FORMAT "%5.3" EXTENDED_LIMITS 0.00 255.0 /end CHARACTERISTIC
/begin CHARACTERISTIC DFES_Cls.DFC_CcsPwrLineChpVccEnaSCB_C "" VALUE 0x802418D0 Val_Wu8 3.000 DFES_OneToOne 0.00 3.000 FORMAT "%5.3" EXTENDED_LIMITS 0.00 255.0 /end CHARACTERISTIC
/begin CHARACTERISTIC DFES_Cls.DFC_CcsPwrLineChpVccEnaSCG_C "" VALUE 0x802418D1 Val_Wu8 3.000 DFES_OneToOne 0.00 3.000 FORMAT "%5.3" EXTENDED_LIMITS 0.00 255.0 /end CHARACTERISTIC
/begin CHARACTERISTIC DFES_Cls.DFC_CcsPwrLineChpVccSRCMin_C "" VALUE 0x802418D2 Val_Wu8 3.000 DFES_OneToOne 0.00 3.000 FORMAT "%5.3" EXTENDED_LIMITS 0.00 255.0 /end CHARACTERISTIC
/begin CHARACTERISTIC DFES_Cls.DFC_CcsPwrLineComChpTSRCMin_C "" VALUE 0x802418D3 Val_Wu8 3.000 DFES_OneToOne 0.00 3.000 FORMAT "%5.3" EXTENDED_LIMITS 0.00 255.0 /end CHARACTERISTIC
/begin CHARACTERISTIC DFES_Cls.DFC_CtPSwtActrOL_C "" VALUE 0x802418D4 Val_Wu8 3.000 DFES_OneToOne 0.00 3.000 FORMAT "%5.3" EXTENDED_LIMITS 0.00 255.0 /end CHARACTERISTIC
/begin CHARACTERISTIC DFES_Cls.DFC_CtPSwtActrOvrTemp_C "" VALUE 0x802418D5 Val_Wu8 3.000 DFES_OneToOne 0.00 3.000 FORMAT "%5.3" EXTENDED_LIMITS 0.00 255.0 /end CHARACTERISTIC
/begin CHARACTERISTIC DFES_Cls.DFC_CtPSwtActrSCB_C "" VALUE 0x802418D6 Val_Wu8 3.000 DFES_OneToOne 0.00 3.000 FORMAT "%5.3" EXTENDED_LIMITS 0.00 255.0 /end CHARACTERISTIC
/begin CHARACTERISTIC DFES_Cls.DFC_CtPSwtActrSCG_C "" VALUE 0x802418D7 Val_Wu8 3.000 DFES_OneToOne 0.00 3.000 FORMAT "%5.3" EXTENDED_LIMITS 0.00 255.0 /end CHARACTERISTIC
/begin CHARACTERISTIC DFES_Cls.DFC_CtPSwtDiagSRCMin_C "" VALUE 0x802418D8 Val_Wu8 3.000 DFES_OneToOne 0.00 3.000 FORMAT "%5.3" EXTENDED_LIMITS 0.00 255.0 /end CHARACTERISTIC
/begin CHARACTERISTIC DFES_Cls.DFC_CtpCarrFrqSRCMin_C "" VALUE 0x802418D9 Val_Wu8 3.000 DFES_OneToOne 0.00 3.000 FORMAT "%5.3" EXTENDED_LIMITS 0.00 255.0 /end CHARACTERISTIC
/begin CHARACTERISTIC DFES_Cls.DFC_DcChrgrIntkT2SRCMin_C "" VALUE 0x802418DA Val_Wu8 3.000 DFES_OneToOne 0.00 3.000 FORMAT "%5.3" EXTENDED_LIMITS 0.00 255.0 /end CHARACTERISTIC
/begin CHARACTERISTIC DFES_Cls.DFC_DcChrgrIntkTSRCMin_C "" VALUE 0x802418DB Val_Wu8 3.000 DFES_OneToOne 0.00 3.000 FORMAT "%5.3" EXTENDED_LIMITS 0.00 255.0 /end CHARACTERISTIC
/begin CHARACTERISTIC DFES_Cls.DFC_DevLibBattUHi_C "" VALUE 0x802418DC Val_Wu8 3.000 DFES_OneToOne 0.00 3.000 FORMAT "%5.3" EXTENDED_LIMITS 0.00 255.0 /end CHARACTERISTIC
/begin CHARACTERISTIC DFES_Cls.DFC_DevLibBattULo_C "" VALUE 0x802418DD Val_Wu8 3.000 DFES_OneToOne 0.00 3.000 FORMAT "%5.3" EXTENDED_LIMITS 0.00 255.0 /end CHARACTERISTIC
/begin CHARACTERISTIC DFES_Cls.DFC_EmWakeupSigOL_C "" VALUE 0x802418DE Val_Wu8 3.000 DFES_OneToOne 0.00 3.000 FORMAT "%5.3" EXTENDED_LIMITS 0.00 255.0 /end CHARACTERISTIC
/begin CHARACTERISTIC DFES_Cls.DFC_EmWakeupSigOvrTemp_C "" VALUE 0x802418DF Val_Wu8 3.000 DFES_OneToOne 0.00 3.000 FORMAT "%5.3" EXTENDED_LIMITS 0.00 255.0 /end CHARACTERISTIC
/begin CHARACTERISTIC DFES_Cls.DFC_EmWakeupSigSCB_C "" VALUE 0x802418E0 Val_Wu8 3.000 DFES_OneToOne 0.00 3.000 FORMAT "%5.3" EXTENDED_LIMITS 0.00 255.0 /end CHARACTERISTIC
/begin CHARACTERISTIC DFES_Cls.DFC_EmWakeupSigSCG_C "" VALUE 0x802418E1 Val_Wu8 3.000 DFES_OneToOne 0.00 3.000 FORMAT "%5.3" EXTENDED_LIMITS 0.00 255.0 /end CHARACTERISTIC
/begin CHARACTERISTIC DFES_Cls.DFC_Fan1OL_C "" VALUE 0x802418E2 Val_Wu8 3.000 DFES_OneToOne 0.00 3.000 FORMAT "%5.3" EXTENDED_LIMITS 0.00 255.0 /end CHARACTERISTIC
/begin CHARACTERISTIC DFES_Cls.DFC_Fan1OvrTemp_C "" VALUE 0x802418E3 Val_Wu8 3.000 DFES_OneToOne 0.00 3.000 FORMAT "%5.3" EXTENDED_LIMITS 0.00 255.0 /end CHARACTERISTIC
/begin CHARACTERISTIC DFES_Cls.DFC_Fan1SCB_C "" VALUE 0x802418E4 Val_Wu8 3.000 DFES_OneToOne 0.00 3.000 FORMAT "%5.3" EXTENDED_LIMITS 0.00 255.0 /end CHARACTERISTIC
/begin CHARACTERISTIC DFES_Cls.DFC_FanRlySCB_C "" VALUE 0x802418E5 Val_Wu8 3.000 DFES_OneToOne 0.00 3.000 FORMAT "%5.3" EXTENDED_LIMITS 0.00 255.0 /end CHARACTERISTIC
/begin CHARACTERISTIC DFES_Cls.DFC_FanRlySCG_C "" VALUE 0x802418E6 Val_Wu8 3.000 DFES_OneToOne 0.00 3.000 FORMAT "%5.3" EXTENDED_LIMITS 0.00 255.0 /end CHARACTERISTIC
/begin CHARACTERISTIC DFES_Cls.DFC_FanSpdSRCMin_C "" VALUE 0x802418E7 Val_Wu8 3.000 DFES_OneToOne 0.00 3.000 FORMAT "%5.3" EXTENDED_LIMITS 0.00 255.0 /end CHARACTERISTIC
/begin CHARACTERISTIC DFES_Cls.DFC_FreonPSRCMin_C "" VALUE 0x802418E8 Val_Wu8 3.000 DFES_OneToOne 0.00 3.000 FORMAT "%5.3" EXTENDED_LIMITS 0.00 255.0 /end CHARACTERISTIC
/begin CHARACTERISTIC DFES_Cls.DFC_HLCCcsPLnCChipTHi_C "" VALUE 0x802418E9 Val_Wu8 3.000 DFES_OneToOne 0.00 3.000 FORMAT "%5.3" EXTENDED_LIMITS 0.00 255.0 /end CHARACTERISTIC
/begin CHARACTERISTIC DFES_Cls.DFC_HeatrCoreTSRCMin_C "" VALUE 0x802418EA Val_Wu8 3.000 DFES_OneToOne 0.00 3.000 FORMAT "%5.3" EXTENDED_LIMITS 0.00 255.0 /end CHARACTERISTIC
/begin CHARACTERISTIC DFES_Cls.DFC_PwmCtPSRCMin_C "" VALUE 0x802418EB Val_Wu8 3.000 DFES_OneToOne 0.00 3.000 FORMAT "%5.3" EXTENDED_LIMITS 0.00 255.0 /end CHARACTERISTIC
/begin CHARACTERISTIC DFES_Cls.DFC_PwrDistbnUnitTSRCMin_C "" VALUE 0x802418EC Val_Wu8 3.000 DFES_OneToOne 0.00 3.000 FORMAT "%5.3" EXTENDED_LIMITS 0.00 255.0 /end CHARACTERISTIC
/begin CHARACTERISTIC DFES_Cls.DFC_SCtPmp1OL_C "" VALUE 0x802418ED Val_Wu8 3.000 DFES_OneToOne 0.00 3.000 FORMAT "%5.3" EXTENDED_LIMITS 0.00 255.0 /end CHARACTERISTIC
/begin CHARACTERISTIC DFES_Cls.DFC_SCtPmp1OvrTemp_C "" VALUE 0x802418EE Val_Wu8 3.000 DFES_OneToOne 0.00 3.000 FORMAT "%5.3" EXTENDED_LIMITS 0.00 255.0 /end CHARACTERISTIC
/begin CHARACTERISTIC DFES_Cls.DFC_SCtPmp1SCB_C "" VALUE 0x802418EF Val_Wu8 3.000 DFES_OneToOne 0.00 3.000 FORMAT "%5.3" EXTENDED_LIMITS 0.00 255.0 /end CHARACTERISTIC
/begin CHARACTERISTIC DFES_Cls.DFC_SCtPmpRlyOL_C "" VALUE 0x802418F0 Val_Wu8 3.000 DFES_OneToOne 0.00 3.000 FORMAT "%5.3" EXTENDED_LIMITS 0.00 255.0 /end CHARACTERISTIC
/begin CHARACTERISTIC DFES_Cls.DFC_SCtPmpRlyOvrTemp_C "" VALUE 0x802418F1 Val_Wu8 3.000 DFES_OneToOne 0.00 3.000 FORMAT "%5.3" EXTENDED_LIMITS 0.00 255.0 /end CHARACTERISTIC
/begin CHARACTERISTIC DFES_Cls.DFC_SCtPmpRlySCB_C "" VALUE 0x802418F2 Val_Wu8 3.000 DFES_OneToOne 0.00 3.000 FORMAT "%5.3" EXTENDED_LIMITS 0.00 255.0 /end CHARACTERISTIC
/begin CHARACTERISTIC DFES_Cls.DFC_SpplCooltPmpRlyOL_C "" VALUE 0x802418F3 Val_Wu8 3.000 DFES_OneToOne 0.00 3.000 FORMAT "%5.3" EXTENDED_LIMITS 0.00 255.0 /end CHARACTERISTIC
/begin CHARACTERISTIC DFES_Cls.DFC_SpplCooltPmpRlyOvrTemp_C "" VALUE 0x802418F4 Val_Wu8 3.000 DFES_OneToOne 0.00 3.000 FORMAT "%5.3" EXTENDED_LIMITS 0.00 255.0 /end CHARACTERISTIC
/begin CHARACTERISTIC DFES_Cls.DFC_SpplCooltPmpRlySCB_C "" VALUE 0x802418F5 Val_Wu8 3.000 DFES_OneToOne 0.00 3.000 FORMAT "%5.3" EXTENDED_LIMITS 0.00 255.0 /end CHARACTERISTIC
/begin CHARACTERISTIC DFES_Cls.DFC_UCtPSRCMin_C "" VALUE 0x802418F6 Val_Wu8 3.000 DFES_OneToOne 0.00 3.000 FORMAT "%5.3" EXTENDED_LIMITS 0.00 255.0 /end CHARACTERISTIC
/begin CHARACTERISTIC DFES_Cls.DFC_UPxP1SRCMin_C "" VALUE 0x802418F7 Val_Wu8 3.000 DFES_OneToOne 0.00 3.000 FORMAT "%5.3" EXTENDED_LIMITS 0.00 255.0 /end CHARACTERISTIC
/begin CHARACTERISTIC DFES_Cls.DFC_ComHSN1CANMute_C "" VALUE 0x802418F8 Val_Wu8 3.000 DFES_OneToOne 0.00 3.000 FORMAT "%5.3" EXTENDED_LIMITS 0.00 255.0 /end CHARACTERISTIC
/begin CHARACTERISTIC DFES_Cls.DFC_ComHSN3CANMute_C "" VALUE 0x802418F9 Val_Wu8 3.000 DFES_OneToOne 0.00 3.000 FORMAT "%5.3" EXTENDED_LIMITS 0.00 255.0 /end CHARACTERISTIC
/begin CHARACTERISTIC DFES_Cls.DFC_AcChrgrIntkTPhysRngHi_C "" VALUE 0x802418FA Val_Wu8 3.000 DFES_OneToOne 0.00 3.000 FORMAT "%5.3" EXTENDED_LIMITS 0.00 255.0 /end CHARACTERISTIC
/begin CHARACTERISTIC DFES_Cls.DFC_AcChrgrIntkTPhysRngLo_C "" VALUE 0x802418FB Val_Wu8 3.000 DFES_OneToOne 0.00 3.000 FORMAT "%5.3" EXTENDED_LIMITS 0.00 255.0 /end CHARACTERISTIC
/begin CHARACTERISTIC DFES_Cls.DFC_AcChrgrIntkTSRCOpn_C "" VALUE 0x802418FC Val_Wu8 3.000 DFES_OneToOne 0.00 3.000 FORMAT "%5.3" EXTENDED_LIMITS 0.00 255.0 /end CHARACTERISTIC
/begin CHARACTERISTIC DFES_Cls.DFC_CcsPwrLineChpVccPhysRngHi_C "" VALUE 0x802418FD Val_Wu8 3.000 DFES_OneToOne 0.00 3.000 FORMAT "%5.3" EXTENDED_LIMITS 0.00 255.0 /end CHARACTERISTIC
/begin CHARACTERISTIC DFES_Cls.DFC_CcsPwrLineChpVccPhysRngLo_C "" VALUE 0x802418FE Val_Wu8 3.000 DFES_OneToOne 0.00 3.000 FORMAT "%5.3" EXTENDED_LIMITS 0.00 255.0 /end CHARACTERISTIC
/begin CHARACTERISTIC DFES_Cls.DFC_CcsPwrLineChpVccSRCOpn_C "" VALUE 0x802418FF Val_Wu8 3.000 DFES_OneToOne 0.00 3.000 FORMAT "%5.3" EXTENDED_LIMITS 0.00 255.0 /end CHARACTERISTIC
/begin CHARACTERISTIC DFES_Cls.DFC_CcsPwrLineComChpTPhysRngHi_C "" VALUE 0x80241900 Val_Wu8 3.000 DFES_OneToOne 0.00 3.000 FORMAT "%5.3" EXTENDED_LIMITS 0.00 255.0 /end CHARACTERISTIC
/begin CHARACTERISTIC DFES_Cls.DFC_CcsPwrLineComChpTPhysRngLo_C "" VALUE 0x80241901 Val_Wu8 3.000 DFES_OneToOne 0.00 3.000 FORMAT "%5.3" EXTENDED_LIMITS 0.00 255.0 /end CHARACTERISTIC
/begin CHARACTERISTIC DFES_Cls.DFC_CcsPwrLineComChpTSRCOpn_C "" VALUE 0x80241902 Val_Wu8 3.000 DFES_OneToOne 0.00 3.000 FORMAT "%5.3" EXTENDED_LIMITS 0.00 255.0 /end CHARACTERISTIC
/begin CHARACTERISTIC DFES_Cls.DFC_CtPSwtDiagPhysRngHi_C "" VALUE 0x80241903 Val_Wu8 3.000 DFES_OneToOne 0.00 3.000 FORMAT "%5.3" EXTENDED_LIMITS 0.00 255.0 /end CHARACTERISTIC
/begin CHARACTERISTIC DFES_Cls.DFC_CtPSwtDiagPhysRngLo_C "" VALUE 0x80241904 Val_Wu8 3.000 DFES_OneToOne 0.00 3.000 FORMAT "%5.3" EXTENDED_LIMITS 0.00 255.0 /end CHARACTERISTIC
/begin CHARACTERISTIC DFES_Cls.DFC_CtPSwtDiagSRCOpn_C "" VALUE 0x80241905 Val_Wu8 3.000 DFES_OneToOne 0.00 3.000 FORMAT "%5.3" EXTENDED_LIMITS 0.00 255.0 /end CHARACTERISTIC
/begin CHARACTERISTIC DFES_Cls.DFC_CtpCarrFrqPhysRngHi_C "" VALUE 0x80241906 Val_Wu8 3.000 DFES_OneToOne 0.00 3.000 FORMAT "%5.3" EXTENDED_LIMITS 0.00 255.0 /end CHARACTERISTIC
/begin CHARACTERISTIC DFES_Cls.DFC_CtpCarrFrqPhysRngLo_C "" VALUE 0x80241907 Val_Wu8 3.000 DFES_OneToOne 0.00 3.000 FORMAT "%5.3" EXTENDED_LIMITS 0.00 255.0 /end CHARACTERISTIC
/begin CHARACTERISTIC DFES_Cls.DFC_CtpCarrFrqSRCMax_C "" VALUE 0x80241908 Val_Wu8 3.000 DFES_OneToOne 0.00 3.000 FORMAT "%5.3" EXTENDED_LIMITS 0.00 255.0 /end CHARACTERISTIC
/begin CHARACTERISTIC DFES_Cls.DFC_DcChrgrIntkT2PhysRngHi_C "" VALUE 0x80241909 Val_Wu8 3.000 DFES_OneToOne 0.00 3.000 FORMAT "%5.3" EXTENDED_LIMITS 0.00 255.0 /end CHARACTERISTIC
/begin CHARACTERISTIC DFES_Cls.DFC_DcChrgrIntkT2PhysRngLo_C "" VALUE 0x8024190A Val_Wu8 3.000 DFES_OneToOne 0.00 3.000 FORMAT "%5.3" EXTENDED_LIMITS 0.00 255.0 /end CHARACTERISTIC
/begin CHARACTERISTIC DFES_Cls.DFC_DcChrgrIntkT2SRCOpn_C "" VALUE 0x8024190B Val_Wu8 3.000 DFES_OneToOne 0.00 3.000 FORMAT "%5.3" EXTENDED_LIMITS 0.00 255.0 /end CHARACTERISTIC
/begin CHARACTERISTIC DFES_Cls.DFC_DcChrgrIntkTPhysRngHi_C "" VALUE 0x8024190C Val_Wu8 3.000 DFES_OneToOne 0.00 3.000 FORMAT "%5.3" EXTENDED_LIMITS 0.00 255.0 /end CHARACTERISTIC
/begin CHARACTERISTIC DFES_Cls.DFC_DcChrgrIntkTPhysRngLo_C "" VALUE 0x8024190D Val_Wu8 3.000 DFES_OneToOne 0.00 3.000 FORMAT "%5.3" EXTENDED_LIMITS 0.00 255.0 /end CHARACTERISTIC
/begin CHARACTERISTIC DFES_Cls.DFC_DcChrgrIntkTSRCOpn_C "" VALUE 0x8024190E Val_Wu8 3.000 DFES_OneToOne 0.00 3.000 FORMAT "%5.3" EXTENDED_LIMITS 0.00 255.0 /end CHARACTERISTIC
/begin CHARACTERISTIC DFES_Cls.DFC_Fan1SCG_C "" VALUE 0x8024190F Val_Wu8 3.000 DFES_OneToOne 0.00 3.000 FORMAT "%5.3" EXTENDED_LIMITS 0.00 255.0 /end CHARACTERISTIC
/begin CHARACTERISTIC DFES_Cls.DFC_FanSpdPhysRngHi_C "" VALUE 0x80241910 Val_Wu8 3.000 DFES_OneToOne 0.00 3.000 FORMAT "%5.3" EXTENDED_LIMITS 0.00 255.0 /end CHARACTERISTIC
/begin CHARACTERISTIC DFES_Cls.DFC_FanSpdPhysRngLo_C "" VALUE 0x80241911 Val_Wu8 3.000 DFES_OneToOne 0.00 3.000 FORMAT "%5.3" EXTENDED_LIMITS 0.00 255.0 /end CHARACTERISTIC
/begin CHARACTERISTIC DFES_Cls.DFC_FanSpdSRCOpn_C "" VALUE 0x80241912 Val_Wu8 3.000 DFES_OneToOne 0.00 3.000 FORMAT "%5.3" EXTENDED_LIMITS 0.00 255.0 /end CHARACTERISTIC
/begin CHARACTERISTIC DFES_Cls.DFC_FreonPPhysRngHi_C "" VALUE 0x80241913 Val_Wu8 3.000 DFES_OneToOne 0.00 3.000 FORMAT "%5.3" EXTENDED_LIMITS 0.00 255.0 /end CHARACTERISTIC
/begin CHARACTERISTIC DFES_Cls.DFC_FreonPPhysRngLo_C "" VALUE 0x80241914 Val_Wu8 3.000 DFES_OneToOne 0.00 3.000 FORMAT "%5.3" EXTENDED_LIMITS 0.00 255.0 /end CHARACTERISTIC
/begin CHARACTERISTIC DFES_Cls.DFC_FreonPSRCOpn_C "" VALUE 0x80241915 Val_Wu8 3.000 DFES_OneToOne 0.00 3.000 FORMAT "%5.3" EXTENDED_LIMITS 0.00 255.0 /end CHARACTERISTIC
/begin CHARACTERISTIC DFES_Cls.DFC_HeatrCoreTPhysRngHi_C "" VALUE 0x80241916 Val_Wu8 3.000 DFES_OneToOne 0.00 3.000 FORMAT "%5.3" EXTENDED_LIMITS 0.00 255.0 /end CHARACTERISTIC
/begin CHARACTERISTIC DFES_Cls.DFC_HeatrCoreTPhysRngLo_C "" VALUE 0x80241917 Val_Wu8 3.000 DFES_OneToOne 0.00 3.000 FORMAT "%5.3" EXTENDED_LIMITS 0.00 255.0 /end CHARACTERISTIC
/begin CHARACTERISTIC DFES_Cls.DFC_HeatrCoreTSRCOpn_C "" VALUE 0x80241918 Val_Wu8 3.000 DFES_OneToOne 0.00 3.000 FORMAT "%5.3" EXTENDED_LIMITS 0.00 255.0 /end CHARACTERISTIC
/begin CHARACTERISTIC DFES_Cls.DFC_HvGridUMaxSftyLim_C "" VALUE 0x80241919 Val_Wu8 3.000 DFES_OneToOne 0.00 3.000 FORMAT "%5.3" EXTENDED_LIMITS 0.00 255.0 /end CHARACTERISTIC
/begin CHARACTERISTIC DFES_Cls.DFC_HvGridUMinSftyLim_C "" VALUE 0x8024191A Val_Wu8 3.000 DFES_OneToOne 0.00 3.000 FORMAT "%5.3" EXTENDED_LIMITS 0.00 255.0 /end CHARACTERISTIC
/begin CHARACTERISTIC DFES_Cls.DFC_HvGridUPlausy_C "" VALUE 0x8024191B Val_Wu8 3.000 DFES_OneToOne 0.00 3.000 FORMAT "%5.3" EXTENDED_LIMITS 0.00 255.0 /end CHARACTERISTIC
/begin CHARACTERISTIC DFES_Cls.DFC_IntlckChrgPlgHBrgOpnLd_C "" VALUE 0x8024191C Val_Wu8 3.000 DFES_OneToOne 0.00 3.000 FORMAT "%5.3" EXTENDED_LIMITS 0.00 255.0 /end CHARACTERISTIC
/begin CHARACTERISTIC DFES_Cls.DFC_IntlckChrgPlgHBrgOvrCurr_C "" VALUE 0x8024191D Val_Wu8 3.000 DFES_OneToOne 0.00 3.000 FORMAT "%5.3" EXTENDED_LIMITS 0.00 255.0 /end CHARACTERISTIC
/begin CHARACTERISTIC DFES_Cls.DFC_IntlckChrgPlgHBrgOvrTemp_C "" VALUE 0x8024191E Val_Wu8 3.000 DFES_OneToOne 0.00 3.000 FORMAT "%5.3" EXTENDED_LIMITS 0.00 255.0 /end CHARACTERISTIC
/begin CHARACTERISTIC DFES_Cls.DFC_IntlckChrgPlgHBrgShCirBatt1_C "" VALUE 0x8024191F Val_Wu8 3.000 DFES_OneToOne 0.00 3.000 FORMAT "%5.3" EXTENDED_LIMITS 0.00 255.0 /end CHARACTERISTIC
/begin CHARACTERISTIC DFES_Cls.DFC_IntlckChrgPlgHBrgShCirBatt2_C "" VALUE 0x80241920 Val_Wu8 3.000 DFES_OneToOne 0.00 3.000 FORMAT "%5.3" EXTENDED_LIMITS 0.00 255.0 /end CHARACTERISTIC
/begin CHARACTERISTIC DFES_Cls.DFC_IntlckChrgPlgHBrgShCirGnd1_C "" VALUE 0x80241921 Val_Wu8 3.000 DFES_OneToOne 0.00 3.000 FORMAT "%5.3" EXTENDED_LIMITS 0.00 255.0 /end CHARACTERISTIC
/begin CHARACTERISTIC DFES_Cls.DFC_IntlckChrgPlgHBrgShCirGnd2_C "" VALUE 0x80241922 Val_Wu8 3.000 DFES_OneToOne 0.00 3.000 FORMAT "%5.3" EXTENDED_LIMITS 0.00 255.0 /end CHARACTERISTIC
/begin CHARACTERISTIC DFES_Cls.DFC_IntlckChrgPlgHBrgShCirOvrLd_C "" VALUE 0x80241923 Val_Wu8 3.000 DFES_OneToOne 0.00 3.000 FORMAT "%5.3" EXTENDED_LIMITS 0.00 255.0 /end CHARACTERISTIC
/begin CHARACTERISTIC DFES_Cls.DFC_IntlckChrgPlgHBrgTempOvrCurr_C "" VALUE 0x80241924 Val_Wu8 3.000 DFES_OneToOne 0.00 3.000 FORMAT "%5.3" EXTENDED_LIMITS 0.00 255.0 /end CHARACTERISTIC
/begin CHARACTERISTIC DFES_Cls.DFC_IntlckChrgPlgHBrgUndrVltg_C "" VALUE 0x80241925 Val_Wu8 3.000 DFES_OneToOne 0.00 3.000 FORMAT "%5.3" EXTENDED_LIMITS 0.00 255.0 /end CHARACTERISTIC
/begin CHARACTERISTIC DFES_Cls.DFC_IntlckChrgPlgPosnRngFlt_C "" VALUE 0x80241926 Val_Wu8 3.000 DFES_OneToOne 0.00 3.000 FORMAT "%5.3" EXTENDED_LIMITS 0.00 255.0 /end CHARACTERISTIC
/begin CHARACTERISTIC DFES_Cls.DFC_IntlckChrgPlgPosnSrcMax_C "" VALUE 0x80241927 Val_Wu8 3.000 DFES_OneToOne 0.00 3.000 FORMAT "%5.3" EXTENDED_LIMITS 0.00 255.0 /end CHARACTERISTIC
/begin CHARACTERISTIC DFES_Cls.DFC_IntlckChrgPlgPosnSrcMin_C "" VALUE 0x80241928 Val_Wu8 3.000 DFES_OneToOne 0.00 3.000 FORMAT "%5.3" EXTENDED_LIMITS 0.00 255.0 /end CHARACTERISTIC
/begin CHARACTERISTIC DFES_Cls.DFC_PwmCtPPhysRngHi_C "" VALUE 0x80241929 Val_Wu8 3.000 DFES_OneToOne 0.00 3.000 FORMAT "%5.3" EXTENDED_LIMITS 0.00 255.0 /end CHARACTERISTIC
/begin CHARACTERISTIC DFES_Cls.DFC_PwmCtPPhysRngLo_C "" VALUE 0x8024192A Val_Wu8 3.000 DFES_OneToOne 0.00 3.000 FORMAT "%5.3" EXTENDED_LIMITS 0.00 255.0 /end CHARACTERISTIC
/begin CHARACTERISTIC DFES_Cls.DFC_PwmCtPSRCMax_C "" VALUE 0x8024192B Val_Wu8 3.000 DFES_OneToOne 0.00 3.000 FORMAT "%5.3" EXTENDED_LIMITS 0.00 255.0 /end CHARACTERISTIC
/begin CHARACTERISTIC DFES_Cls.DFC_PwrDistbnUnitTPhysRngHi_C "" VALUE 0x8024192C Val_Wu8 3.000 DFES_OneToOne 0.00 3.000 FORMAT "%5.3" EXTENDED_LIMITS 0.00 255.0 /end CHARACTERISTIC
/begin CHARACTERISTIC DFES_Cls.DFC_PwrDistbnUnitTPhysRngLo_C "" VALUE 0x8024192D Val_Wu8 3.000 DFES_OneToOne 0.00 3.000 FORMAT "%5.3" EXTENDED_LIMITS 0.00 255.0 /end CHARACTERISTIC
/begin CHARACTERISTIC DFES_Cls.DFC_PwrDistbnUnitTSRCOpn_C "" VALUE 0x8024192E Val_Wu8 3.000 DFES_OneToOne 0.00 3.000 FORMAT "%5.3" EXTENDED_LIMITS 0.00 255.0 /end CHARACTERISTIC
/begin CHARACTERISTIC DFES_Cls.DFC_SCtPmpRlySCG_C "" VALUE 0x8024192F Val_Wu8 3.000 DFES_OneToOne 0.00 3.000 FORMAT "%5.3" EXTENDED_LIMITS 0.00 255.0 /end CHARACTERISTIC
/begin CHARACTERISTIC DFES_Cls.DFC_SpplCooltPmpRlySCG_C "" VALUE 0x80241930 Val_Wu8 3.000 DFES_OneToOne 0.00 3.000 FORMAT "%5.3" EXTENDED_LIMITS 0.00 255.0 /end CHARACTERISTIC
/begin CHARACTERISTIC DFES_Cls.DFC_UCtPPhysRngHi_C "" VALUE 0x80241931 Val_Wu8 3.000 DFES_OneToOne 0.00 3.000 FORMAT "%5.3" EXTENDED_LIMITS 0.00 255.0 /end CHARACTERISTIC
/begin CHARACTERISTIC DFES_Cls.DFC_UCtPPhysRngLo_C "" VALUE 0x80241932 Val_Wu8 3.000 DFES_OneToOne 0.00 3.000 FORMAT "%5.3" EXTENDED_LIMITS 0.00 255.0 /end CHARACTERISTIC
/begin CHARACTERISTIC DFES_Cls.DFC_UCtPSRCOpn_C "" VALUE 0x80241933 Val_Wu8 3.000 DFES_OneToOne 0.00 3.000 FORMAT "%5.3" EXTENDED_LIMITS 0.00 255.0 /end CHARACTERISTIC
/begin CHARACTERISTIC DFES_Cls.DFC_UPxP1PhysRngHi_C "" VALUE 0x80241934 Val_Wu8 3.000 DFES_OneToOne 0.00 3.000 FORMAT "%5.3" EXTENDED_LIMITS 0.00 255.0 /end CHARACTERISTIC
/begin CHARACTERISTIC DFES_Cls.DFC_UPxP1PhysRngLo_C "" VALUE 0x80241935 Val_Wu8 3.000 DFES_OneToOne 0.00 3.000 FORMAT "%5.3" EXTENDED_LIMITS 0.00 255.0 /end CHARACTERISTIC
/begin CHARACTERISTIC DFES_Cls.DFC_UPxP1SRCOpn_C "" VALUE 0x80241936 Val_Wu8 3.000 DFES_OneToOne 0.00 3.000 FORMAT "%5.3" EXTENDED_LIMITS 0.00 255.0 /end CHARACTERISTIC
/begin CHARACTERISTIC DFES_Cls.DFC_VehVPhysRngHi_C "" VALUE 0x80241937 Val_Wu8 3.000 DFES_OneToOne 0.00 3.000 FORMAT "%5.3" EXTENDED_LIMITS 0.00 255.0 /end CHARACTERISTIC
/begin CHARACTERISTIC DFES_Cls.DFC_VehVPhysRngLo_C "" VALUE 0x80241938 Val_Wu8 3.000 DFES_OneToOne 0.00 3.000 FORMAT "%5.3" EXTENDED_LIMITS 0.00 255.0 /end CHARACTERISTIC
/begin CHARACTERISTIC DFES_Cls.DFC_VehVSigCan_C "" VALUE 0x80241939 Val_Wu8 3.000 DFES_OneToOne 0.00 3.000 FORMAT "%5.3" EXTENDED_LIMITS 0.00 255.0 /end CHARACTERISTIC
/begin CHARACTERISTIC DFES_Cls.DFC_VehVSigCanSafe_C "" VALUE 0x8024193A Val_Wu8 3.000 DFES_OneToOne 0.00 3.000 FORMAT "%5.3" EXTENDED_LIMITS 0.00 255.0 /end CHARACTERISTIC
/begin CHARACTERISTIC DFES_Cls.DFC_SCtPmp1DiagGrdKey1_C "" VALUE 0x8024193B Val_Wu8 3.000 DFES_OneToOne 0.00 3.000 FORMAT "%5.3" EXTENDED_LIMITS 0.00 255.0 /end CHARACTERISTIC
/begin CHARACTERISTIC DFES_Cls.DFC_SCtPmp1DiagGrdKey2_C "" VALUE 0x8024193C Val_Wu8 3.000 DFES_OneToOne 0.00 3.000 FORMAT "%5.3" EXTENDED_LIMITS 0.00 255.0 /end CHARACTERISTIC
/begin CHARACTERISTIC DFES_Cls.DFC_SCtPmp1DiagGrdKey3_C "" VALUE 0x8024193D Val_Wu8 3.000 DFES_OneToOne 0.00 3.000 FORMAT "%5.3" EXTENDED_LIMITS 0.00 255.0 /end CHARACTERISTIC
/begin CHARACTERISTIC DFES_Cls.DFC_SCtPmp1DiagGrdKey4_C "" VALUE 0x8024193E Val_Wu8 3.000 DFES_OneToOne 0.00 3.000 FORMAT "%5.3" EXTENDED_LIMITS 0.00 255.0 /end CHARACTERISTIC
/begin CHARACTERISTIC DFES_Cls.DFC_SCtPmp1DiagGrdKey5_C "" VALUE 0x8024193F Val_Wu8 3.000 DFES_OneToOne 0.00 3.000 FORMAT "%5.3" EXTENDED_LIMITS 0.00 255.0 /end CHARACTERISTIC
/begin CHARACTERISTIC DFES_Cls.DFC_ChrgPlgLiveCntctHzrdCcs_C "" VALUE 0x80241940 Val_Wu8 3.000 DFES_OneToOne 0.00 3.000 FORMAT "%5.3" EXTENDED_LIMITS 0.00 255.0 /end CHARACTERISTIC
/begin CHARACTERISTIC DFES_Cls.DFC_ChrgPlgProxPltImps_C "" VALUE 0x80241941 Val_Wu8 3.000 DFES_OneToOne 0.00 3.000 FORMAT "%5.3" EXTENDED_LIMITS 0.00 255.0 /end CHARACTERISTIC
/begin CHARACTERISTIC DFES_Cls.DFC_ChrgPlgTHiCcsDc_C "" VALUE 0x80241942 Val_Wu8 3.000 DFES_OneToOne 0.00 3.000 FORMAT "%5.3" EXTENDED_LIMITS 0.00 255.0 /end CHARACTERISTIC
/begin CHARACTERISTIC DFES_Cls.DFC_ElMActvDchaFailr_C "" VALUE 0x80241943 Val_Wu8 3.000 DFES_OneToOne 0.00 3.000 FORMAT "%5.3" EXTENDED_LIMITS 0.00 255.0 /end CHARACTERISTIC
/begin CHARACTERISTIC DFES_Cls.DFC_ElMActvDchaFlt_C "" VALUE 0x80241944 Val_Wu8 3.000 DFES_OneToOne 0.00 3.000 FORMAT "%5.3" EXTENDED_LIMITS 0.00 255.0 /end CHARACTERISTIC
/begin CHARACTERISTIC DFES_Cls.DFC_ElMFbdnIvtrModDrv01_C "" VALUE 0x80241945 Val_Wu8 3.000 DFES_OneToOne 0.00 3.000 FORMAT "%5.3" EXTENDED_LIMITS 0.00 255.0 /end CHARACTERISTIC
/begin CHARACTERISTIC DFES_Cls.DFC_ElMImobAuthent_C "" VALUE 0x80241946 Val_Wu8 3.000 DFES_OneToOne 0.00 3.000 FORMAT "%5.3" EXTENDED_LIMITS 0.00 255.0 /end CHARACTERISTIC
/begin CHARACTERISTIC DFES_Cls.DFC_ElMIsoMonFlt_C "" VALUE 0x80241947 Val_Wu8 3.000 DFES_OneToOne 0.00 3.000 FORMAT "%5.3" EXTENDED_LIMITS 0.00 255.0 /end CHARACTERISTIC
/begin CHARACTERISTIC DFES_Cls.DFC_ElMIsoMonPlausyFlt_C "" VALUE 0x80241948 Val_Wu8 3.000 DFES_OneToOne 0.00 3.000 FORMAT "%5.3" EXTENDED_LIMITS 0.00 255.0 /end CHARACTERISTIC
/begin CHARACTERISTIC DFES_Cls.DFC_ElMIvtrCooltT01_C "" VALUE 0x80241949 Val_Wu8 3.000 DFES_OneToOne 0.00 3.000 FORMAT "%5.3" EXTENDED_LIMITS 0.00 255.0 /end CHARACTERISTIC
/begin CHARACTERISTIC DFES_Cls.DFC_ElMIvtrEmgyShtDwn01_C "" VALUE 0x8024194A Val_Wu8 3.000 DFES_OneToOne 0.00 3.000 FORMAT "%5.3" EXTENDED_LIMITS 0.00 255.0 /end CHARACTERISTIC
/begin CHARACTERISTIC DFES_Cls.DFC_ElMIvtrFailr01_C "" VALUE 0x8024194B Val_Wu8 3.000 DFES_OneToOne 0.00 3.000 FORMAT "%5.3" EXTENDED_LIMITS 0.00 255.0 /end CHARACTERISTIC
/begin CHARACTERISTIC DFES_Cls.DFC_ElMIvtrIntlck01_C "" VALUE 0x8024194C Val_Wu8 3.000 DFES_OneToOne 0.00 3.000 FORMAT "%5.3" EXTENDED_LIMITS 0.00 255.0 /end CHARACTERISTIC
/begin CHARACTERISTIC DFES_Cls.DFC_ElMIvtrTErr01_C "" VALUE 0x8024194D Val_Wu8 3.000 DFES_OneToOne 0.00 3.000 FORMAT "%5.3" EXTENDED_LIMITS 0.00 255.0 /end CHARACTERISTIC
/begin CHARACTERISTIC DFES_Cls.DFC_ElMOverSpdNeg01_C "" VALUE 0x8024194E Val_Wu8 3.000 DFES_OneToOne 0.00 3.000 FORMAT "%5.3" EXTENDED_LIMITS 0.00 255.0 /end CHARACTERISTIC
/begin CHARACTERISTIC DFES_Cls.DFC_ElMOverSpdPos01_C "" VALUE 0x8024194F Val_Wu8 3.000 DFES_OneToOne 0.00 3.000 FORMAT "%5.3" EXTENDED_LIMITS 0.00 255.0 /end CHARACTERISTIC
/begin CHARACTERISTIC DFES_Cls.DFC_ElMOverTqNeg01_C "" VALUE 0x80241950 Val_Wu8 3.000 DFES_OneToOne 0.00 3.000 FORMAT "%5.3" EXTENDED_LIMITS 0.00 255.0 /end CHARACTERISTIC
/begin CHARACTERISTIC DFES_Cls.DFC_ElMOverTqPos01_C "" VALUE 0x80241951 Val_Wu8 3.000 DFES_OneToOne 0.00 3.000 FORMAT "%5.3" EXTENDED_LIMITS 0.00 255.0 /end CHARACTERISTIC
/begin CHARACTERISTIC DFES_Cls.DFC_ElMPwrAuthn_C "" VALUE 0x80241952 Val_Wu8 3.000 DFES_OneToOne 0.00 3.000 FORMAT "%5.3" EXTENDED_LIMITS 0.00 255.0 /end CHARACTERISTIC
/begin CHARACTERISTIC DFES_Cls.DFC_ElMSpdErr01_C "" VALUE 0x80241953 Val_Wu8 3.000 DFES_OneToOne 0.00 3.000 FORMAT "%5.3" EXTENDED_LIMITS 0.00 255.0 /end CHARACTERISTIC
/begin CHARACTERISTIC DFES_Cls.DFC_ElMSvs01_C "" VALUE 0x80241954 Val_Wu8 3.000 DFES_OneToOne 0.00 3.000 FORMAT "%5.3" EXTENDED_LIMITS 0.00 255.0 /end CHARACTERISTIC
/begin CHARACTERISTIC DFES_Cls.DFC_PEnvCcMax_C "" VALUE 0x80241955 Val_Wu8 3.000 DFES_OneToOne 0.00 3.000 FORMAT "%5.3" EXTENDED_LIMITS 0.00 255.0 /end CHARACTERISTIC
/begin CHARACTERISTIC DFES_Cls.DFC_PEnvCcMin_C "" VALUE 0x80241956 Val_Wu8 3.000 DFES_OneToOne 0.00 3.000 FORMAT "%5.3" EXTENDED_LIMITS 0.00 255.0 /end CHARACTERISTIC
/begin CHARACTERISTIC DFES_Cls.DFC_PEnvRngChkMax_C "" VALUE 0x80241957 Val_Wu8 3.000 DFES_OneToOne 0.00 3.000 FORMAT "%5.3" EXTENDED_LIMITS 0.00 255.0 /end CHARACTERISTIC
/begin CHARACTERISTIC DFES_Cls.DFC_PEnvRngChkMin_C "" VALUE 0x80241958 Val_Wu8 3.000 DFES_OneToOne 0.00 3.000 FORMAT "%5.3" EXTENDED_LIMITS 0.00 255.0 /end CHARACTERISTIC
/begin CHARACTERISTIC DFES_Cls.DFC_PEnvSnsrPlaus_C "" VALUE 0x80241959 Val_Wu8 3.000 DFES_OneToOne 0.00 3.000 FORMAT "%5.3" EXTENDED_LIMITS 0.00 255.0 /end CHARACTERISTIC
/begin CHARACTERISTIC DFES_Cls.DFC_BrkBstPmpPlausGenn_C "" VALUE 0x8024195A Val_Wu8 3.000 DFES_OneToOne 0.00 3.000 FORMAT "%5.3" EXTENDED_LIMITS 0.00 255.0 /end CHARACTERISTIC
/begin CHARACTERISTIC DFES_Cls.DFC_CbnHeatrRlyLfLoWarn_C "" VALUE 0x8024195B Val_Wu8 3.000 DFES_OneToOne 0.00 3.000 FORMAT "%5.3" EXTENDED_LIMITS 0.00 255.0 /end CHARACTERISTIC
/begin CHARACTERISTIC DFES_Cls.DFC_ChgrPlugLockPinByndClsd_C "" VALUE 0x8024195C Val_Wu8 3.000 DFES_OneToOne 0.00 3.000 FORMAT "%5.3" EXTENDED_LIMITS 0.00 255.0 /end CHARACTERISTIC
/begin CHARACTERISTIC DFES_Cls.DFC_ChgrPlugLockPinMoveWoCmd_C "" VALUE 0x8024195D Val_Wu8 3.000 DFES_OneToOne 0.00 3.000 FORMAT "%5.3" EXTENDED_LIMITS 0.00 255.0 /end CHARACTERISTIC
/begin CHARACTERISTIC DFES_Cls.DFC_ChgrPlugLockPinStuckInClsd_C "" VALUE 0x8024195E Val_Wu8 3.000 DFES_OneToOne 0.00 3.000 FORMAT "%5.3" EXTENDED_LIMITS 0.00 255.0 /end CHARACTERISTIC
/begin CHARACTERISTIC DFES_Cls.DFC_ChgrPlugLockPinStuckInOpen_C "" VALUE 0x8024195F Val_Wu8 3.000 DFES_OneToOne 0.00 3.000 FORMAT "%5.3" EXTENDED_LIMITS 0.00 255.0 /end CHARACTERISTIC
/begin CHARACTERISTIC DFES_Cls.DFC_ChrgrStErr_C "" VALUE 0x80241960 Val_Wu8 3.000 DFES_OneToOne 0.00 3.000 FORMAT "%5.3" EXTENDED_LIMITS 0.00 255.0 /end CHARACTERISTIC
/begin CHARACTERISTIC DFES_Cls.DFC_ComHSN1BusOff_C "" VALUE 0x80241961 Val_Wu8 3.000 DFES_OneToOne 0.00 3.000 FORMAT "%5.3" EXTENDED_LIMITS 0.00 255.0 /end CHARACTERISTIC
/begin CHARACTERISTIC DFES_Cls.DFC_ComHSN3BusOff_C "" VALUE 0x80241962 Val_Wu8 3.000 DFES_OneToOne 0.00 3.000 FORMAT "%5.3" EXTENDED_LIMITS 0.00 255.0 /end CHARACTERISTIC
/begin CHARACTERISTIC DFES_Cls.DFC_ComVCInval_C "" VALUE 0x80241963 Val_Wu8 3.000 DFES_OneToOne 0.00 3.000 FORMAT "%5.3" EXTENDED_LIMITS 0.00 255.0 /end CHARACTERISTIC
/begin CHARACTERISTIC DFES_Cls.DFC_EemDcdcPrecSpdInhb_C "" VALUE 0x80241964 Val_Wu8 3.000 DFES_OneToOne 0.00 3.000 FORMAT "%5.3" EXTENDED_LIMITS 0.00 255.0 /end CHARACTERISTIC
/begin CHARACTERISTIC DFES_Cls.DFC_ExpPwrLatch_C "" VALUE 0x80241965 Val_Wu8 3.000 DFES_OneToOne 0.00 3.000 FORMAT "%5.3" EXTENDED_LIMITS 0.00 255.0 /end CHARACTERISTIC
/begin CHARACTERISTIC DFES_Cls.DFC_FanMaxOvrd_C "" VALUE 0x80241966 Val_Wu8 3.000 DFES_OneToOne 0.00 3.000 FORMAT "%5.3" EXTENDED_LIMITS 0.00 255.0 /end CHARACTERISTIC
/begin CHARACTERISTIC DFES_Cls.DFC_HLCCcsGnrlComErr_C "" VALUE 0x80241967 Val_Wu8 3.000 DFES_OneToOne 0.00 3.000 FORMAT "%5.3" EXTENDED_LIMITS 0.00 255.0 /end CHARACTERISTIC
/begin CHARACTERISTIC DFES_Cls.DFC_InmLINNodeHVACPanelAbsnt_C "" VALUE 0x80241968 Val_Wu8 3.000 DFES_OneToOne 0.00 3.000 FORMAT "%5.3" EXTENDED_LIMITS 0.00 255.0 /end CHARACTERISTIC
/begin CHARACTERISTIC DFES_Cls.DFC_ResetRcvNotAllwd_C "" VALUE 0x80241969 Val_Wu8 3.000 DFES_OneToOne 0.00 3.000 FORMAT "%5.3" EXTENDED_LIMITS 0.00 255.0 /end CHARACTERISTIC
/begin CHARACTERISTIC DFES_Cls.DFC_TelltlCooltPlaus_C "" VALUE 0x8024196A Val_Wu8 3.000 DFES_OneToOne 0.00 3.000 FORMAT "%5.3" EXTENDED_LIMITS 0.00 255.0 /end CHARACTERISTIC
/begin CHARACTERISTIC DFES_Cls.DFC_MRlyOL_C "" VALUE 0x8024196B Val_Wu8 3.000 DFES_OneToOne 0.00 3.000 FORMAT "%5.3" EXTENDED_LIMITS 0.00 255.0 /end CHARACTERISTIC
/begin CHARACTERISTIC DFES_Cls.DFC_MRlySCB_C "" VALUE 0x8024196C Val_Wu8 3.000 DFES_OneToOne 0.00 3.000 FORMAT "%5.3" EXTENDED_LIMITS 0.00 255.0 /end CHARACTERISTIC
/begin CHARACTERISTIC DFES_Cls.DFC_MRlySCG_C "" VALUE 0x8024196D Val_Wu8 3.000 DFES_OneToOne 0.00 3.000 FORMAT "%5.3" EXTENDED_LIMITS 0.00 255.0 /end CHARACTERISTIC
/begin CHARACTERISTIC DFES_Cls.DFC_SSpMon1_C "" VALUE 0x8024196E Val_Wu8 3.000 DFES_OneToOne 0.00 3.000 FORMAT "%5.3" EXTENDED_LIMITS 0.00 255.0 /end CHARACTERISTIC
/begin CHARACTERISTIC DFES_Cls.DFC_SSpMon1OV_C "" VALUE 0x8024196F Val_Wu8 3.000 DFES_OneToOne 0.00 3.000 FORMAT "%5.3" EXTENDED_LIMITS 0.00 255.0 /end CHARACTERISTIC
/begin CHARACTERISTIC DFES_Cls.DFC_SSpMon1SCG_C "" VALUE 0x80241970 Val_Wu8 3.000 DFES_OneToOne 0.00 3.000 FORMAT "%5.3" EXTENDED_LIMITS 0.00 255.0 /end CHARACTERISTIC
/begin CHARACTERISTIC DFES_Cls.DFC_SSpMon1UV_C "" VALUE 0x80241971 Val_Wu8 3.000 DFES_OneToOne 0.00 3.000 FORMAT "%5.3" EXTENDED_LIMITS 0.00 255.0 /end CHARACTERISTIC
/begin CHARACTERISTIC DFES_Cls.DFC_SSpMon2_C "" VALUE 0x80241972 Val_Wu8 3.000 DFES_OneToOne 0.00 3.000 FORMAT "%5.3" EXTENDED_LIMITS 0.00 255.0 /end CHARACTERISTIC
/begin CHARACTERISTIC DFES_Cls.DFC_SSpMon2OV_C "" VALUE 0x80241973 Val_Wu8 3.000 DFES_OneToOne 0.00 3.000 FORMAT "%5.3" EXTENDED_LIMITS 0.00 255.0 /end CHARACTERISTIC
/begin CHARACTERISTIC DFES_Cls.DFC_SSpMon2SCG_C "" VALUE 0x80241974 Val_Wu8 3.000 DFES_OneToOne 0.00 3.000 FORMAT "%5.3" EXTENDED_LIMITS 0.00 255.0 /end CHARACTERISTIC
/begin CHARACTERISTIC DFES_Cls.DFC_SSpMon2UV_C "" VALUE 0x80241975 Val_Wu8 3.000 DFES_OneToOne 0.00 3.000 FORMAT "%5.3" EXTENDED_LIMITS 0.00 255.0 /end CHARACTERISTIC
/begin CHARACTERISTIC DFES_Cls.DFC_SSpMon3_C "" VALUE 0x80241976 Val_Wu8 3.000 DFES_OneToOne 0.00 3.000 FORMAT "%5.3" EXTENDED_LIMITS 0.00 255.0 /end CHARACTERISTIC
/begin CHARACTERISTIC DFES_Cls.DFC_SSpMon3OV_C "" VALUE 0x80241977 Val_Wu8 3.000 DFES_OneToOne 0.00 3.000 FORMAT "%5.3" EXTENDED_LIMITS 0.00 255.0 /end CHARACTERISTIC
/begin CHARACTERISTIC DFES_Cls.DFC_SSpMon3SCG_C "" VALUE 0x80241978 Val_Wu8 3.000 DFES_OneToOne 0.00 3.000 FORMAT "%5.3" EXTENDED_LIMITS 0.00 255.0 /end CHARACTERISTIC
/begin CHARACTERISTIC DFES_Cls.DFC_SSpMon3UV_C "" VALUE 0x80241979 Val_Wu8 3.000 DFES_OneToOne 0.00 3.000 FORMAT "%5.3" EXTENDED_LIMITS 0.00 255.0 /end CHARACTERISTIC
/begin CHARACTERISTIC DFES_Cls.DFC_CANSM_E_BUS_OFF_NETWORK_HSN1_CAN_C "" VALUE 0x8024197A Val_Wu8 3.000 DFES_OneToOne 0.00 3.000 FORMAT "%5.3" EXTENDED_LIMITS 0.00 255.0 /end CHARACTERISTIC
/begin CHARACTERISTIC DFES_Cls.DFC_CANSM_E_BUS_OFF_NETWORK_HSN3_CAN_C "" VALUE 0x8024197B Val_Wu8 3.000 DFES_OneToOne 0.00 3.000 FORMAT "%5.3" EXTENDED_LIMITS 0.00 255.0 /end CHARACTERISTIC
/begin CHARACTERISTIC DFES_Cls.DFC_CANSM_E_BUS_OFF_NETWORK_HSN4_CAN_C "" VALUE 0x8024197C Val_Wu8 3.000 DFES_OneToOne 0.00 3.000 FORMAT "%5.3" EXTENDED_LIMITS 0.00 255.0 /end CHARACTERISTIC
/begin CHARACTERISTIC DFES_Cls.DFC_CANSM_E_BUS_OFF_NETWORK_XCP_CAN_C "" VALUE 0x8024197D Val_Wu8 3.000 DFES_OneToOne 0.00 3.000 FORMAT "%5.3" EXTENDED_LIMITS 0.00 255.0 /end CHARACTERISTIC
/begin CHARACTERISTIC DFES_Cls.DFC_CANTRCV_E_NO_TRCV_CONTROL_0_C "" VALUE 0x8024197E Val_Wu8 3.000 DFES_OneToOne 0.00 3.000 FORMAT "%5.3" EXTENDED_LIMITS 0.00 255.0 /end CHARACTERISTIC
/begin CHARACTERISTIC DFES_Cls.DFC_CAN_E_TIMEOUT_C "" VALUE 0x8024197F Val_Wu8 3.000 DFES_OneToOne 0.00 3.000 FORMAT "%5.3" EXTENDED_LIMITS 0.00 255.0 /end CHARACTERISTIC
/begin CHARACTERISTIC DFES_Cls.DFC_COMM_E_NET_START_IND_CHANNEL_0_C "" VALUE 0x80241980 Val_Wu8 3.000 DFES_OneToOne 0.00 3.000 FORMAT "%5.3" EXTENDED_LIMITS 0.00 255.0 /end CHARACTERISTIC
/begin CHARACTERISTIC DFES_Cls.DFC_COMM_E_NET_START_IND_CHANNEL_1_C "" VALUE 0x80241981 Val_Wu8 3.000 DFES_OneToOne 0.00 3.000 FORMAT "%5.3" EXTENDED_LIMITS 0.00 255.0 /end CHARACTERISTIC
/begin CHARACTERISTIC DFES_Cls.DFC_COMM_E_NET_START_IND_CHANNEL_2_C "" VALUE 0x80241982 Val_Wu8 3.000 DFES_OneToOne 0.00 3.000 FORMAT "%5.3" EXTENDED_LIMITS 0.00 255.0 /end CHARACTERISTIC
/begin CHARACTERISTIC DFES_Cls.DFC_COMM_E_NET_START_IND_CHANNEL_3_C "" VALUE 0x80241983 Val_Wu8 3.000 DFES_OneToOne 0.00 3.000 FORMAT "%5.3" EXTENDED_LIMITS 0.00 255.0 /end CHARACTERISTIC
/begin CHARACTERISTIC DFES_Cls.DFC_COMM_E_NET_START_IND_CHANNEL_4_C "" VALUE 0x80241984 Val_Wu8 3.000 DFES_OneToOne 0.00 3.000 FORMAT "%5.3" EXTENDED_LIMITS 0.00 255.0 /end CHARACTERISTIC
/begin CHARACTERISTIC DFES_Cls.DFC_COMM_E_NET_START_IND_CHANNEL_5_C "" VALUE 0x80241985 Val_Wu8 3.000 DFES_OneToOne 0.00 3.000 FORMAT "%5.3" EXTENDED_LIMITS 0.00 255.0 /end CHARACTERISTIC
/begin CHARACTERISTIC DFES_Cls.DFC_LIN_E_TIMEOUT_C "" VALUE 0x80241986 Val_Wu8 3.000 DFES_OneToOne 0.00 3.000 FORMAT "%5.3" EXTENDED_LIMITS 0.00 255.0 /end CHARACTERISTIC
/begin CHARACTERISTIC DFES_Cls.DFC_rba_EcuCtrl_TOMaxProlg_C "" VALUE 0x80241987 Val_Wu8 3.000 DFES_OneToOne 0.00 3.000 FORMAT "%5.3" EXTENDED_LIMITS 0.00 255.0 /end CHARACTERISTIC
/begin CHARACTERISTIC DFES_Cls.DFC_rba_EcuCtrl_TOMaxShutDwn_C "" VALUE 0x80241988 Val_Wu8 3.000 DFES_OneToOne 0.00 3.000 FORMAT "%5.3" EXTENDED_LIMITS 0.00 255.0 /end CHARACTERISTIC
/begin CHARACTERISTIC DFES_Cls.DFC_rba_MultiStackTrace_Threshold_C "" VALUE 0x80241989 Val_Wu8 3.000 DFES_OneToOne 0.00 3.000 FORMAT "%5.3" EXTENDED_LIMITS 0.00 255.0 /end CHARACTERISTIC
/begin CHARACTERISTIC DFES_Cls.DFC_rba_SyC_CustStates_Degraded_disord_Event_C "" VALUE 0x8024198A Val_Wu8 3.000 DFES_OneToOne 0.00 3.000 FORMAT "%5.3" EXTENDED_LIMITS 0.00 255.0 /end CHARACTERISTIC
/begin CHARACTERISTIC DFES_Cls.DFC_rba_SyC_CustStates_Degraded_incst_Event_C "" VALUE 0x8024198B Val_Wu8 3.000 DFES_OneToOne 0.00 3.000 FORMAT "%5.3" EXTENDED_LIMITS 0.00 255.0 /end CHARACTERISTIC
/begin CHARACTERISTIC DFES_Cls.DFC_rba_SyC_CustStates_TransNoWakReq_Event_C "" VALUE 0x8024198C Val_Wu8 3.000 DFES_OneToOne 0.00 3.000 FORMAT "%5.3" EXTENDED_LIMITS 0.00 255.0 /end CHARACTERISTIC
/begin CHARACTERISTIC DFES_Cls.DFC_RBA_IOEXTLIB_KEEPALIVE_DRV_C "" VALUE 0x8024198D Val_Wu8 3.000 DFES_OneToOne 0.00 3.000 FORMAT "%5.3" EXTENDED_LIMITS 0.00 255.0 /end CHARACTERISTIC
/begin CHARACTERISTIC DFES_Cls.DFC_RBA_IOEXTLIB_KEEPALIVE_INI_C "" VALUE 0x8024198E Val_Wu8 3.000 DFES_OneToOne 0.00 3.000 FORMAT "%5.3" EXTENDED_LIMITS 0.00 255.0 /end CHARACTERISTIC
/begin CHARACTERISTIC DFES_Cls.DFC_rba_IoSigRtc_StopCounter_C "" VALUE 0x8024198F Val_Wu8 3.000 DFES_OneToOne 0.00 3.000 FORMAT "%5.3" EXTENDED_LIMITS 0.00 255.0 /end CHARACTERISTIC
/begin CHARACTERISTIC DFES_Cls.DFC_rba_MRly_Diag_Stk_Event_C "" VALUE 0x80241990 Val_Wu8 3.000 DFES_OneToOne 0.00 3.000 FORMAT "%5.3" EXTENDED_LIMITS 0.00 255.0 /end CHARACTERISTIC
/begin CHARACTERISTIC DFES_Cls.DFC_rba_MemDiag_MemReadErr_C "" VALUE 0x80241991 Val_Wu8 3.000 DFES_OneToOne 0.00 3.000 FORMAT "%5.3" EXTENDED_LIMITS 0.00 255.0 /end CHARACTERISTIC
/begin CHARACTERISTIC DFES_Cls.DFC_rba_MemDiag_MemWrErr_C "" VALUE 0x80241992 Val_Wu8 3.000 DFES_OneToOne 0.00 3.000 FORMAT "%5.3" EXTENDED_LIMITS 0.00 255.0 /end CHARACTERISTIC
/begin CHARACTERISTIC DFES_Cls.DFC_rba_SyC_IrrSwOffTrigEngRun_Event_C "" VALUE 0x80241993 Val_Wu8 3.000 DFES_OneToOne 0.00 3.000 FORMAT "%5.3" EXTENDED_LIMITS 0.00 255.0 /end CHARACTERISTIC
/begin CHARACTERISTIC DFES_Cls.DFC_AcChrgrIntkTSRCMax_C "" VALUE 0x80241994 Val_Wu8 3.000 DFES_OneToOne 0.00 3.000 FORMAT "%5.3" EXTENDED_LIMITS 0.00 255.0 /end CHARACTERISTIC
/begin CHARACTERISTIC DFES_Cls.DFC_AcChrgrIntkTTmpErr_C "" VALUE 0x80241995 Val_Wu8 3.000 DFES_OneToOne 0.00 3.000 FORMAT "%5.3" EXTENDED_LIMITS 0.00 255.0 /end CHARACTERISTIC
/begin CHARACTERISTIC DFES_Cls.DFC_AcFlt_C "" VALUE 0x80241996 Val_Wu8 3.000 DFES_OneToOne 0.00 3.000 FORMAT "%5.3" EXTENDED_LIMITS 0.00 255.0 /end CHARACTERISTIC
/begin CHARACTERISTIC DFES_Cls.DFC_AppAllSnsrDfct_C "" VALUE 0x80241997 Val_Wu8 3.000 DFES_OneToOne 0.00 3.000 FORMAT "%5.3" EXTENDED_LIMITS 0.00 255.0 /end CHARACTERISTIC
/begin CHARACTERISTIC DFES_Cls.DFC_BattUPwrFail_C "" VALUE 0x80241998 Val_Wu8 3.000 DFES_OneToOne 0.00 3.000 FORMAT "%5.3" EXTENDED_LIMITS 0.00 255.0 /end CHARACTERISTIC
/begin CHARACTERISTIC DFES_Cls.DFC_BrkBstBkupOvrn_C "" VALUE 0x80241999 Val_Wu8 3.000 DFES_OneToOne 0.00 3.000 FORMAT "%5.3" EXTENDED_LIMITS 0.00 255.0 /end CHARACTERISTIC
/begin CHARACTERISTIC DFES_Cls.DFC_BrkBstPmpOvld_C "" VALUE 0x8024199A Val_Wu8 3.000 DFES_OneToOne 0.00 3.000 FORMAT "%5.3" EXTENDED_LIMITS 0.00 255.0 /end CHARACTERISTIC
/begin CHARACTERISTIC DFES_Cls.DFC_BrkPlausChk_C "" VALUE 0x8024199B Val_Wu8 3.000 DFES_OneToOne 0.00 3.000 FORMAT "%5.3" EXTENDED_LIMITS 0.00 255.0 /end CHARACTERISTIC
/begin CHARACTERISTIC DFES_Cls.DFC_CbnHeatgSwtTmpErr_C "" VALUE 0x8024199C Val_Wu8 3.000 DFES_OneToOne 0.00 3.000 FORMAT "%5.3" EXTENDED_LIMITS 0.00 255.0 /end CHARACTERISTIC
/begin CHARACTERISTIC DFES_Cls.DFC_CcsPwrLineChpVccSRCMax_C "" VALUE 0x8024199D Val_Wu8 3.000 DFES_OneToOne 0.00 3.000 FORMAT "%5.3" EXTENDED_LIMITS 0.00 255.0 /end CHARACTERISTIC
/begin CHARACTERISTIC DFES_Cls.DFC_CcsPwrLineChpVccTmpErr_C "" VALUE 0x8024199E Val_Wu8 3.000 DFES_OneToOne 0.00 3.000 FORMAT "%5.3" EXTENDED_LIMITS 0.00 255.0 /end CHARACTERISTIC
/begin CHARACTERISTIC DFES_Cls.DFC_CcsPwrLineComChpTSRCMax_C "" VALUE 0x8024199F Val_Wu8 3.000 DFES_OneToOne 0.00 3.000 FORMAT "%5.3" EXTENDED_LIMITS 0.00 255.0 /end CHARACTERISTIC
/begin CHARACTERISTIC DFES_Cls.DFC_CcsPwrLineComChpTTmpErr_C "" VALUE 0x802419A0 Val_Wu8 3.000 DFES_OneToOne 0.00 3.000 FORMAT "%5.3" EXTENDED_LIMITS 0.00 255.0 /end CHARACTERISTIC
/begin CHARACTERISTIC DFES_Cls.DFC_ChgrPlugCtpCarrFrqErr_C "" VALUE 0x802419A1 Val_Wu8 3.000 DFES_OneToOne 0.00 3.000 FORMAT "%5.3" EXTENDED_LIMITS 0.00 255.0 /end CHARACTERISTIC
/begin CHARACTERISTIC DFES_Cls.DFC_ChgrPlugCtpSwtStuckClsd_C "" VALUE 0x802419A2 Val_Wu8 3.000 DFES_OneToOne 0.00 3.000 FORMAT "%5.3" EXTENDED_LIMITS 0.00 255.0 /end CHARACTERISTIC
/begin CHARACTERISTIC DFES_Cls.DFC_ChgrPlugCtpSwtStuckOpen_C "" VALUE 0x802419A3 Val_Wu8 3.000 DFES_OneToOne 0.00 3.000 FORMAT "%5.3" EXTENDED_LIMITS 0.00 255.0 /end CHARACTERISTIC
/begin CHARACTERISTIC DFES_Cls.DFC_ChgrPlugCtpUErrHi_C "" VALUE 0x802419A4 Val_Wu8 3.000 DFES_OneToOne 0.00 3.000 FORMAT "%5.3" EXTENDED_LIMITS 0.00 255.0 /end CHARACTERISTIC
/begin CHARACTERISTIC DFES_Cls.DFC_ChgrPlugPxp1SrcErr_C "" VALUE 0x802419A5 Val_Wu8 3.000 DFES_OneToOne 0.00 3.000 FORMAT "%5.3" EXTENDED_LIMITS 0.00 255.0 /end CHARACTERISTIC
/begin CHARACTERISTIC DFES_Cls.DFC_ChrgCntctAllWldd_C "" VALUE 0x802419A6 Val_Wu8 3.000 DFES_OneToOne 0.00 3.000 FORMAT "%5.3" EXTENDED_LIMITS 0.00 255.0 /end CHARACTERISTIC
/begin CHARACTERISTIC DFES_Cls.DFC_ChrgCntctNegOperErr_C "" VALUE 0x802419A7 Val_Wu8 3.000 DFES_OneToOne 0.00 3.000 FORMAT "%5.3" EXTENDED_LIMITS 0.00 255.0 /end CHARACTERISTIC
/begin CHARACTERISTIC DFES_Cls.DFC_ChrgCntctNegOperWarn_C "" VALUE 0x802419A8 Val_Wu8 3.000 DFES_OneToOne 0.00 3.000 FORMAT "%5.3" EXTENDED_LIMITS 0.00 255.0 /end CHARACTERISTIC
/begin CHARACTERISTIC DFES_Cls.DFC_ChrgCntctNegWldd_C "" VALUE 0x802419A9 Val_Wu8 3.000 DFES_OneToOne 0.00 3.000 FORMAT "%5.3" EXTENDED_LIMITS 0.00 255.0 /end CHARACTERISTIC
/begin CHARACTERISTIC DFES_Cls.DFC_ChrgCntctPosOperErr_C "" VALUE 0x802419AA Val_Wu8 3.000 DFES_OneToOne 0.00 3.000 FORMAT "%5.3" EXTENDED_LIMITS 0.00 255.0 /end CHARACTERISTIC
/begin CHARACTERISTIC DFES_Cls.DFC_ChrgCntctPosOperWarn_C "" VALUE 0x802419AB Val_Wu8 3.000 DFES_OneToOne 0.00 3.000 FORMAT "%5.3" EXTENDED_LIMITS 0.00 255.0 /end CHARACTERISTIC
/begin CHARACTERISTIC DFES_Cls.DFC_ChrgCntctPosWldd_C "" VALUE 0x802419AC Val_Wu8 3.000 DFES_OneToOne 0.00 3.000 FORMAT "%5.3" EXTENDED_LIMITS 0.00 255.0 /end CHARACTERISTIC
/begin CHARACTERISTIC DFES_Cls.DFC_ChrgCntctStuckOpen_C "" VALUE 0x802419AD Val_Wu8 3.000 DFES_OneToOne 0.00 3.000 FORMAT "%5.3" EXTENDED_LIMITS 0.00 255.0 /end CHARACTERISTIC
/begin CHARACTERISTIC DFES_Cls.DFC_ChrgPlgIntlckFaild_C "" VALUE 0x802419AE Val_Wu8 3.000 DFES_OneToOne 0.00 3.000 FORMAT "%5.3" EXTENDED_LIMITS 0.00 255.0 /end CHARACTERISTIC
/begin CHARACTERISTIC DFES_Cls.DFC_ChrgnUnplRqrd_C "" VALUE 0x802419AF Val_Wu8 3.000 DFES_OneToOne 0.00 3.000 FORMAT "%5.3" EXTENDED_LIMITS 0.00 255.0 /end CHARACTERISTIC
/begin CHARACTERISTIC DFES_Cls.DFC_CoElMOffsCalibActv01_C "" VALUE 0x802419B0 Val_Wu8 3.000 DFES_OneToOne 0.00 3.000 FORMAT "%5.3" EXTENDED_LIMITS 0.00 255.0 /end CHARACTERISTIC
/begin CHARACTERISTIC DFES_Cls.DFC_CtPSwtDiagSRCMax_C "" VALUE 0x802419B1 Val_Wu8 3.000 DFES_OneToOne 0.00 3.000 FORMAT "%5.3" EXTENDED_LIMITS 0.00 255.0 /end CHARACTERISTIC
/begin CHARACTERISTIC DFES_Cls.DFC_CtPSwtDiagTmpErr_C "" VALUE 0x802419B2 Val_Wu8 3.000 DFES_OneToOne 0.00 3.000 FORMAT "%5.3" EXTENDED_LIMITS 0.00 255.0 /end CHARACTERISTIC
/begin CHARACTERISTIC DFES_Cls.DFC_CtpCarrFrqTmpErr_C "" VALUE 0x802419B3 Val_Wu8 3.000 DFES_OneToOne 0.00 3.000 FORMAT "%5.3" EXTENDED_LIMITS 0.00 255.0 /end CHARACTERISTIC
/begin CHARACTERISTIC DFES_Cls.DFC_DcChrgrIntkT2SRCMax_C "" VALUE 0x802419B4 Val_Wu8 3.000 DFES_OneToOne 0.00 3.000 FORMAT "%5.3" EXTENDED_LIMITS 0.00 255.0 /end CHARACTERISTIC
/begin CHARACTERISTIC DFES_Cls.DFC_DcChrgrIntkT2TmpErr_C "" VALUE 0x802419B5 Val_Wu8 3.000 DFES_OneToOne 0.00 3.000 FORMAT "%5.3" EXTENDED_LIMITS 0.00 255.0 /end CHARACTERISTIC
/begin CHARACTERISTIC DFES_Cls.DFC_DcChrgrIntkTSRCMax_C "" VALUE 0x802419B6 Val_Wu8 3.000 DFES_OneToOne 0.00 3.000 FORMAT "%5.3" EXTENDED_LIMITS 0.00 255.0 /end CHARACTERISTIC
/begin CHARACTERISTIC DFES_Cls.DFC_DcChrgrIntkTTmpErr_C "" VALUE 0x802419B7 Val_Wu8 3.000 DFES_OneToOne 0.00 3.000 FORMAT "%5.3" EXTENDED_LIMITS 0.00 255.0 /end CHARACTERISTIC
/begin CHARACTERISTIC DFES_Cls.DFC_EChrDvPlinCntrThdExcdd_C "" VALUE 0x802419B8 Val_Wu8 3.000 DFES_OneToOne 0.00 3.000 FORMAT "%5.3" EXTENDED_LIMITS 0.00 255.0 /end CHARACTERISTIC
/begin CHARACTERISTIC DFES_Cls.DFC_EemDiagCtctrClsTout_C "" VALUE 0x802419B9 Val_Wu8 3.000 DFES_OneToOne 0.00 3.000 FORMAT "%5.3" EXTENDED_LIMITS 0.00 255.0 /end CHARACTERISTIC
/begin CHARACTERISTIC DFES_Cls.DFC_EemDiagDcdcOffTOut_C "" VALUE 0x802419BA Val_Wu8 3.000 DFES_OneToOne 0.00 3.000 FORMAT "%5.3" EXTENDED_LIMITS 0.00 255.0 /end CHARACTERISTIC
/begin CHARACTERISTIC DFES_Cls.DFC_EemDiagHvCnsrOffTOut_C "" VALUE 0x802419BB Val_Wu8 3.000 DFES_OneToOne 0.00 3.000 FORMAT "%5.3" EXTENDED_LIMITS 0.00 255.0 /end CHARACTERISTIC
/begin CHARACTERISTIC DFES_Cls.DFC_EemDiagHvbOffTOut_C "" VALUE 0x802419BC Val_Wu8 3.000 DFES_OneToOne 0.00 3.000 FORMAT "%5.3" EXTENDED_LIMITS 0.00 255.0 /end CHARACTERISTIC
/begin CHARACTERISTIC DFES_Cls.DFC_FanSpdSRCMax_C "" VALUE 0x802419BD Val_Wu8 3.000 DFES_OneToOne 0.00 3.000 FORMAT "%5.3" EXTENDED_LIMITS 0.00 255.0 /end CHARACTERISTIC
/begin CHARACTERISTIC DFES_Cls.DFC_FanSpdTmpErr_C "" VALUE 0x802419BE Val_Wu8 3.000 DFES_OneToOne 0.00 3.000 FORMAT "%5.3" EXTENDED_LIMITS 0.00 255.0 /end CHARACTERISTIC
/begin CHARACTERISTIC DFES_Cls.DFC_FreonPSRCMax_C "" VALUE 0x802419BF Val_Wu8 3.000 DFES_OneToOne 0.00 3.000 FORMAT "%5.3" EXTENDED_LIMITS 0.00 255.0 /end CHARACTERISTIC
/begin CHARACTERISTIC DFES_Cls.DFC_FreonPTmpErr_C "" VALUE 0x802419C0 Val_Wu8 3.000 DFES_OneToOne 0.00 3.000 FORMAT "%5.3" EXTENDED_LIMITS 0.00 255.0 /end CHARACTERISTIC
/begin CHARACTERISTIC DFES_Cls.DFC_HeatrCoreTSRCMax_C "" VALUE 0x802419C1 Val_Wu8 3.000 DFES_OneToOne 0.00 3.000 FORMAT "%5.3" EXTENDED_LIMITS 0.00 255.0 /end CHARACTERISTIC
/begin CHARACTERISTIC DFES_Cls.DFC_HeatrCoreTTmpErr_C "" VALUE 0x802419C2 Val_Wu8 3.000 DFES_OneToOne 0.00 3.000 FORMAT "%5.3" EXTENDED_LIMITS 0.00 255.0 /end CHARACTERISTIC
/begin CHARACTERISTIC DFES_Cls.DFC_HvGridSocMinLim_C "" VALUE 0x802419C3 Val_Wu8 3.000 DFES_OneToOne 0.00 3.000 FORMAT "%5.3" EXTENDED_LIMITS 0.00 255.0 /end CHARACTERISTIC
/begin CHARACTERISTIC DFES_Cls.DFC_HvacBlwrFrntFlt_C "" VALUE 0x802419C4 Val_Wu8 3.000 DFES_OneToOne 0.00 3.000 FORMAT "%5.3" EXTENDED_LIMITS 0.00 255.0 /end CHARACTERISTIC
/begin CHARACTERISTIC DFES_Cls.DFC_HvacEvapElecFlt_C "" VALUE 0x802419C5 Val_Wu8 3.000 DFES_OneToOne 0.00 3.000 FORMAT "%5.3" EXTENDED_LIMITS 0.00 255.0 /end CHARACTERISTIC
/begin CHARACTERISTIC DFES_Cls.DFC_HvacEvapElecFltGnd_C "" VALUE 0x802419C6 Val_Wu8 3.000 DFES_OneToOne 0.00 3.000 FORMAT "%5.3" EXTENDED_LIMITS 0.00 255.0 /end CHARACTERISTIC
/begin CHARACTERISTIC DFES_Cls.DFC_HvacKnobPosnFlt_C "" VALUE 0x802419C7 Val_Wu8 3.000 DFES_OneToOne 0.00 3.000 FORMAT "%5.3" EXTENDED_LIMITS 0.00 255.0 /end CHARACTERISTIC
/begin CHARACTERISTIC DFES_Cls.DFC_InvBinID_C "" VALUE 0x802419C8 Val_Wu8 3.000 DFES_OneToOne 0.00 3.000 FORMAT "%5.3" EXTENDED_LIMITS 0.00 255.0 /end CHARACTERISTIC
/begin CHARACTERISTIC DFES_Cls.DFC_InvCalID_C "" VALUE 0x802419C9 Val_Wu8 3.000 DFES_OneToOne 0.00 3.000 FORMAT "%5.3" EXTENDED_LIMITS 0.00 255.0 /end CHARACTERISTIC
/begin CHARACTERISTIC DFES_Cls.DFC_InvErotan_C "" VALUE 0x802419CA Val_Wu8 3.000 DFES_OneToOne 0.00 3.000 FORMAT "%5.3" EXTENDED_LIMITS 0.00 255.0 /end CHARACTERISTIC
/begin CHARACTERISTIC DFES_Cls.DFC_InvVinID_C "" VALUE 0x802419CB Val_Wu8 3.000 DFES_OneToOne 0.00 3.000 FORMAT "%5.3" EXTENDED_LIMITS 0.00 255.0 /end CHARACTERISTIC
/begin CHARACTERISTIC DFES_Cls.DFC_MOXEMM_SMU_ALM0_0_C "" VALUE 0x802419CC Val_Wu8 3.000 DFES_OneToOne 0.00 3.000 FORMAT "%5.3" EXTENDED_LIMITS 0.00 255.0 /end CHARACTERISTIC
/begin CHARACTERISTIC DFES_Cls.DFC_MOXEMM_SMU_ALM0_1_C "" VALUE 0x802419CD Val_Wu8 3.000 DFES_OneToOne 0.00 3.000 FORMAT "%5.3" EXTENDED_LIMITS 0.00 255.0 /end CHARACTERISTIC
/begin CHARACTERISTIC DFES_Cls.DFC_MOXEMM_SMU_ALM0_10_C "" VALUE 0x802419CE Val_Wu8 3.000 DFES_OneToOne 0.00 3.000 FORMAT "%5.3" EXTENDED_LIMITS 0.00 255.0 /end CHARACTERISTIC
/begin CHARACTERISTIC DFES_Cls.DFC_MOXEMM_SMU_ALM0_11_C "" VALUE 0x802419CF Val_Wu8 3.000 DFES_OneToOne 0.00 3.000 FORMAT "%5.3" EXTENDED_LIMITS 0.00 255.0 /end CHARACTERISTIC
/begin CHARACTERISTIC DFES_Cls.DFC_MOXEMM_SMU_ALM0_13_C "" VALUE 0x802419D0 Val_Wu8 3.000 DFES_OneToOne 0.00 3.000 FORMAT "%5.3" EXTENDED_LIMITS 0.00 255.0 /end CHARACTERISTIC
/begin CHARACTERISTIC DFES_Cls.DFC_MOXEMM_SMU_ALM0_14_C "" VALUE 0x802419D1 Val_Wu8 3.000 DFES_OneToOne 0.00 3.000 FORMAT "%5.3" EXTENDED_LIMITS 0.00 255.0 /end CHARACTERISTIC
/begin CHARACTERISTIC DFES_Cls.DFC_MOXEMM_SMU_ALM0_2_C "" VALUE 0x802419D2 Val_Wu8 3.000 DFES_OneToOne 0.00 3.000 FORMAT "%5.3" EXTENDED_LIMITS 0.00 255.0 /end CHARACTERISTIC
/begin CHARACTERISTIC DFES_Cls.DFC_MOXEMM_SMU_ALM0_22_C "" VALUE 0x802419D3 Val_Wu8 3.000 DFES_OneToOne 0.00 3.000 FORMAT "%5.3" EXTENDED_LIMITS 0.00 255.0 /end CHARACTERISTIC
/begin CHARACTERISTIC DFES_Cls.DFC_MOXEMM_SMU_ALM0_23_C "" VALUE 0x802419D4 Val_Wu8 3.000 DFES_OneToOne 0.00 3.000 FORMAT "%5.3" EXTENDED_LIMITS 0.00 255.0 /end CHARACTERISTIC
/begin CHARACTERISTIC DFES_Cls.DFC_MOXEMM_SMU_ALM0_4_C "" VALUE 0x802419D5 Val_Wu8 3.000 DFES_OneToOne 0.00 3.000 FORMAT "%5.3" EXTENDED_LIMITS 0.00 255.0 /end CHARACTERISTIC
/begin CHARACTERISTIC DFES_Cls.DFC_MOXEMM_SMU_ALM0_5_C "" VALUE 0x802419D6 Val_Wu8 3.000 DFES_OneToOne 0.00 3.000 FORMAT "%5.3" EXTENDED_LIMITS 0.00 255.0 /end CHARACTERISTIC
/begin CHARACTERISTIC DFES_Cls.DFC_MOXEMM_SMU_ALM0_7_C "" VALUE 0x802419D7 Val_Wu8 3.000 DFES_OneToOne 0.00 3.000 FORMAT "%5.3" EXTENDED_LIMITS 0.00 255.0 /end CHARACTERISTIC
/begin CHARACTERISTIC DFES_Cls.DFC_MOXEMM_SMU_ALM0_8_C "" VALUE 0x802419D8 Val_Wu8 3.000 DFES_OneToOne 0.00 3.000 FORMAT "%5.3" EXTENDED_LIMITS 0.00 255.0 /end CHARACTERISTIC
/begin CHARACTERISTIC DFES_Cls.DFC_MOXEMM_SMU_ALM10_16_C "" VALUE 0x802419D9 Val_Wu8 3.000 DFES_OneToOne 0.00 3.000 FORMAT "%5.3" EXTENDED_LIMITS 0.00 255.0 /end CHARACTERISTIC
/begin CHARACTERISTIC DFES_Cls.DFC_MOXEMM_SMU_ALM10_17_C "" VALUE 0x802419DA Val_Wu8 3.000 DFES_OneToOne 0.00 3.000 FORMAT "%5.3" EXTENDED_LIMITS 0.00 255.0 /end CHARACTERISTIC
/begin CHARACTERISTIC DFES_Cls.DFC_MOXEMM_SMU_ALM10_21_C "" VALUE 0x802419DB Val_Wu8 3.000 DFES_OneToOne 0.00 3.000 FORMAT "%5.3" EXTENDED_LIMITS 0.00 255.0 /end CHARACTERISTIC
/begin CHARACTERISTIC DFES_Cls.DFC_MOXEMM_SMU_ALM11_0_C "" VALUE 0x802419DC Val_Wu8 3.000 DFES_OneToOne 0.00 3.000 FORMAT "%5.3" EXTENDED_LIMITS 0.00 255.0 /end CHARACTERISTIC
/begin CHARACTERISTIC DFES_Cls.DFC_MOXEMM_SMU_ALM11_1_C "" VALUE 0x802419DD Val_Wu8 3.000 DFES_OneToOne 0.00 3.000 FORMAT "%5.3" EXTENDED_LIMITS 0.00 255.0 /end CHARACTERISTIC
/begin CHARACTERISTIC DFES_Cls.DFC_MOXEMM_SMU_ALM11_2_C "" VALUE 0x802419DE Val_Wu8 3.000 DFES_OneToOne 0.00 3.000 FORMAT "%5.3" EXTENDED_LIMITS 0.00 255.0 /end CHARACTERISTIC
/begin CHARACTERISTIC DFES_Cls.DFC_MOXEMM_SMU_ALM11_3_C "" VALUE 0x802419DF Val_Wu8 3.000 DFES_OneToOne 0.00 3.000 FORMAT "%5.3" EXTENDED_LIMITS 0.00 255.0 /end CHARACTERISTIC
/begin CHARACTERISTIC DFES_Cls.DFC_MOXEMM_SMU_ALM11_4_C "" VALUE 0x802419E0 Val_Wu8 3.000 DFES_OneToOne 0.00 3.000 FORMAT "%5.3" EXTENDED_LIMITS 0.00 255.0 /end CHARACTERISTIC
/begin CHARACTERISTIC DFES_Cls.DFC_MOXEMM_SMU_ALM11_5_C "" VALUE 0x802419E1 Val_Wu8 3.000 DFES_OneToOne 0.00 3.000 FORMAT "%5.3" EXTENDED_LIMITS 0.00 255.0 /end CHARACTERISTIC
/begin CHARACTERISTIC DFES_Cls.DFC_MOXEMM_SMU_ALM11_8_C "" VALUE 0x802419E2 Val_Wu8 3.000 DFES_OneToOne 0.00 3.000 FORMAT "%5.3" EXTENDED_LIMITS 0.00 255.0 /end CHARACTERISTIC
/begin CHARACTERISTIC DFES_Cls.DFC_MOXEMM_SMU_ALM11_9_C "" VALUE 0x802419E3 Val_Wu8 3.000 DFES_OneToOne 0.00 3.000 FORMAT "%5.3" EXTENDED_LIMITS 0.00 255.0 /end CHARACTERISTIC
/begin CHARACTERISTIC DFES_Cls.DFC_MOXEMM_SMU_ALM1_0_C "" VALUE 0x802419E4 Val_Wu8 3.000 DFES_OneToOne 0.00 3.000 FORMAT "%5.3" EXTENDED_LIMITS 0.00 255.0 /end CHARACTERISTIC
/begin CHARACTERISTIC DFES_Cls.DFC_MOXEMM_SMU_ALM1_1_C "" VALUE 0x802419E5 Val_Wu8 3.000 DFES_OneToOne 0.00 3.000 FORMAT "%5.3" EXTENDED_LIMITS 0.00 255.0 /end CHARACTERISTIC
/begin CHARACTERISTIC DFES_Cls.DFC_MOXEMM_SMU_ALM1_10_C "" VALUE 0x802419E6 Val_Wu8 3.000 DFES_OneToOne 0.00 3.000 FORMAT "%5.3" EXTENDED_LIMITS 0.00 255.0 /end CHARACTERISTIC
/begin CHARACTERISTIC DFES_Cls.DFC_MOXEMM_SMU_ALM1_11_C "" VALUE 0x802419E7 Val_Wu8 3.000 DFES_OneToOne 0.00 3.000 FORMAT "%5.3" EXTENDED_LIMITS 0.00 255.0 /end CHARACTERISTIC
/begin CHARACTERISTIC DFES_Cls.DFC_MOXEMM_SMU_ALM1_13_C "" VALUE 0x802419E8 Val_Wu8 3.000 DFES_OneToOne 0.00 3.000 FORMAT "%5.3" EXTENDED_LIMITS 0.00 255.0 /end CHARACTERISTIC
/begin CHARACTERISTIC DFES_Cls.DFC_MOXEMM_SMU_ALM1_14_C "" VALUE 0x802419E9 Val_Wu8 3.000 DFES_OneToOne 0.00 3.000 FORMAT "%5.3" EXTENDED_LIMITS 0.00 255.0 /end CHARACTERISTIC
/begin CHARACTERISTIC DFES_Cls.DFC_MOXEMM_SMU_ALM1_2_C "" VALUE 0x802419EA Val_Wu8 3.000 DFES_OneToOne 0.00 3.000 FORMAT "%5.3" EXTENDED_LIMITS 0.00 255.0 /end CHARACTERISTIC
/begin CHARACTERISTIC DFES_Cls.DFC_MOXEMM_SMU_ALM1_22_C "" VALUE 0x802419EB Val_Wu8 3.000 DFES_OneToOne 0.00 3.000 FORMAT "%5.3" EXTENDED_LIMITS 0.00 255.0 /end CHARACTERISTIC
/begin CHARACTERISTIC DFES_Cls.DFC_MOXEMM_SMU_ALM1_23_C "" VALUE 0x802419EC Val_Wu8 3.000 DFES_OneToOne 0.00 3.000 FORMAT "%5.3" EXTENDED_LIMITS 0.00 255.0 /end CHARACTERISTIC
/begin CHARACTERISTIC DFES_Cls.DFC_MOXEMM_SMU_ALM1_4_C "" VALUE 0x802419ED Val_Wu8 3.000 DFES_OneToOne 0.00 3.000 FORMAT "%5.3" EXTENDED_LIMITS 0.00 255.0 /end CHARACTERISTIC
/begin CHARACTERISTIC DFES_Cls.DFC_MOXEMM_SMU_ALM1_5_C "" VALUE 0x802419EE Val_Wu8 3.000 DFES_OneToOne 0.00 3.000 FORMAT "%5.3" EXTENDED_LIMITS 0.00 255.0 /end CHARACTERISTIC
/begin CHARACTERISTIC DFES_Cls.DFC_MOXEMM_SMU_ALM1_7_C "" VALUE 0x802419EF Val_Wu8 3.000 DFES_OneToOne 0.00 3.000 FORMAT "%5.3" EXTENDED_LIMITS 0.00 255.0 /end CHARACTERISTIC
/begin CHARACTERISTIC DFES_Cls.DFC_MOXEMM_SMU_ALM1_8_C "" VALUE 0x802419F0 Val_Wu8 3.000 DFES_OneToOne 0.00 3.000 FORMAT "%5.3" EXTENDED_LIMITS 0.00 255.0 /end CHARACTERISTIC
/begin CHARACTERISTIC DFES_Cls.DFC_MOXEMM_SMU_ALM21_0_C "" VALUE 0x802419F1 Val_Wu8 3.000 DFES_OneToOne 0.00 3.000 FORMAT "%5.3" EXTENDED_LIMITS 0.00 255.0 /end CHARACTERISTIC
/begin CHARACTERISTIC DFES_Cls.DFC_MOXEMM_SMU_ALM21_16_C "" VALUE 0x802419F2 Val_Wu8 3.000 DFES_OneToOne 0.00 3.000 FORMAT "%5.3" EXTENDED_LIMITS 0.00 255.0 /end CHARACTERISTIC
/begin CHARACTERISTIC DFES_Cls.DFC_MOXEMM_SMU_ALM21_3_C "" VALUE 0x802419F3 Val_Wu8 3.000 DFES_OneToOne 0.00 3.000 FORMAT "%5.3" EXTENDED_LIMITS 0.00 255.0 /end CHARACTERISTIC
/begin CHARACTERISTIC DFES_Cls.DFC_MOXEMM_SMU_ALM2_1_C "" VALUE 0x802419F4 Val_Wu8 3.000 DFES_OneToOne 0.00 3.000 FORMAT "%5.3" EXTENDED_LIMITS 0.00 255.0 /end CHARACTERISTIC
/begin CHARACTERISTIC DFES_Cls.DFC_MOXEMM_SMU_ALM2_10_C "" VALUE 0x802419F5 Val_Wu8 3.000 DFES_OneToOne 0.00 3.000 FORMAT "%5.3" EXTENDED_LIMITS 0.00 255.0 /end CHARACTERISTIC
/begin CHARACTERISTIC DFES_Cls.DFC_MOXEMM_SMU_ALM2_11_C "" VALUE 0x802419F6 Val_Wu8 3.000 DFES_OneToOne 0.00 3.000 FORMAT "%5.3" EXTENDED_LIMITS 0.00 255.0 /end CHARACTERISTIC
/begin CHARACTERISTIC DFES_Cls.DFC_MOXEMM_SMU_ALM2_13_C "" VALUE 0x802419F7 Val_Wu8 3.000 DFES_OneToOne 0.00 3.000 FORMAT "%5.3" EXTENDED_LIMITS 0.00 255.0 /end CHARACTERISTIC
/begin CHARACTERISTIC DFES_Cls.DFC_MOXEMM_SMU_ALM2_14_C "" VALUE 0x802419F8 Val_Wu8 3.000 DFES_OneToOne 0.00 3.000 FORMAT "%5.3" EXTENDED_LIMITS 0.00 255.0 /end CHARACTERISTIC
/begin CHARACTERISTIC DFES_Cls.DFC_MOXEMM_SMU_ALM2_22_C "" VALUE 0x802419F9 Val_Wu8 3.000 DFES_OneToOne 0.00 3.000 FORMAT "%5.3" EXTENDED_LIMITS 0.00 255.0 /end CHARACTERISTIC
/begin CHARACTERISTIC DFES_Cls.DFC_MOXEMM_SMU_ALM2_23_C "" VALUE 0x802419FA Val_Wu8 3.000 DFES_OneToOne 0.00 3.000 FORMAT "%5.3" EXTENDED_LIMITS 0.00 255.0 /end CHARACTERISTIC
/begin CHARACTERISTIC DFES_Cls.DFC_MOXEMM_SMU_ALM2_4_C "" VALUE 0x802419FB Val_Wu8 3.000 DFES_OneToOne 0.00 3.000 FORMAT "%5.3" EXTENDED_LIMITS 0.00 255.0 /end CHARACTERISTIC
/begin CHARACTERISTIC DFES_Cls.DFC_MOXEMM_SMU_ALM2_5_C "" VALUE 0x802419FC Val_Wu8 3.000 DFES_OneToOne 0.00 3.000 FORMAT "%5.3" EXTENDED_LIMITS 0.00 255.0 /end CHARACTERISTIC
/begin CHARACTERISTIC DFES_Cls.DFC_MOXEMM_SMU_ALM2_7_C "" VALUE 0x802419FD Val_Wu8 3.000 DFES_OneToOne 0.00 3.000 FORMAT "%5.3" EXTENDED_LIMITS 0.00 255.0 /end CHARACTERISTIC
/begin CHARACTERISTIC DFES_Cls.DFC_MOXEMM_SMU_ALM2_8_C "" VALUE 0x802419FE Val_Wu8 3.000 DFES_OneToOne 0.00 3.000 FORMAT "%5.3" EXTENDED_LIMITS 0.00 255.0 /end CHARACTERISTIC
/begin CHARACTERISTIC DFES_Cls.DFC_MOXEMM_SMU_ALM6_0_C "" VALUE 0x802419FF Val_Wu8 3.000 DFES_OneToOne 0.00 3.000 FORMAT "%5.3" EXTENDED_LIMITS 0.00 255.0 /end CHARACTERISTIC
/begin CHARACTERISTIC DFES_Cls.DFC_MOXEMM_SMU_ALM6_11_C "" VALUE 0x80241A00 Val_Wu8 3.000 DFES_OneToOne 0.00 3.000 FORMAT "%5.3" EXTENDED_LIMITS 0.00 255.0 /end CHARACTERISTIC
/begin CHARACTERISTIC DFES_Cls.DFC_MOXEMM_SMU_ALM6_12_C "" VALUE 0x80241A01 Val_Wu8 3.000 DFES_OneToOne 0.00 3.000 FORMAT "%5.3" EXTENDED_LIMITS 0.00 255.0 /end CHARACTERISTIC
/begin CHARACTERISTIC DFES_Cls.DFC_MOXEMM_SMU_ALM6_14_C "" VALUE 0x80241A02 Val_Wu8 3.000 DFES_OneToOne 0.00 3.000 FORMAT "%5.3" EXTENDED_LIMITS 0.00 255.0 /end CHARACTERISTIC
/begin CHARACTERISTIC DFES_Cls.DFC_MOXEMM_SMU_ALM6_15_C "" VALUE 0x80241A03 Val_Wu8 3.000 DFES_OneToOne 0.00 3.000 FORMAT "%5.3" EXTENDED_LIMITS 0.00 255.0 /end CHARACTERISTIC
/begin CHARACTERISTIC DFES_Cls.DFC_MOXEMM_SMU_ALM6_17_C "" VALUE 0x80241A04 Val_Wu8 3.000 DFES_OneToOne 0.00 3.000 FORMAT "%5.3" EXTENDED_LIMITS 0.00 255.0 /end CHARACTERISTIC
/begin CHARACTERISTIC DFES_Cls.DFC_MOXEMM_SMU_ALM6_18_C "" VALUE 0x80241A05 Val_Wu8 3.000 DFES_OneToOne 0.00 3.000 FORMAT "%5.3" EXTENDED_LIMITS 0.00 255.0 /end CHARACTERISTIC
/begin CHARACTERISTIC DFES_Cls.DFC_MOXEMM_SMU_ALM6_20_C "" VALUE 0x80241A06 Val_Wu8 3.000 DFES_OneToOne 0.00 3.000 FORMAT "%5.3" EXTENDED_LIMITS 0.00 255.0 /end CHARACTERISTIC
/begin CHARACTERISTIC DFES_Cls.DFC_MOXEMM_SMU_ALM6_21_C "" VALUE 0x80241A07 Val_Wu8 3.000 DFES_OneToOne 0.00 3.000 FORMAT "%5.3" EXTENDED_LIMITS 0.00 255.0 /end CHARACTERISTIC
/begin CHARACTERISTIC DFES_Cls.DFC_MOXEMM_SMU_ALM6_25_C "" VALUE 0x80241A08 Val_Wu8 3.000 DFES_OneToOne 0.00 3.000 FORMAT "%5.3" EXTENDED_LIMITS 0.00 255.0 /end CHARACTERISTIC
/begin CHARACTERISTIC DFES_Cls.DFC_MOXEMM_SMU_ALM6_4_C "" VALUE 0x80241A09 Val_Wu8 3.000 DFES_OneToOne 0.00 3.000 FORMAT "%5.3" EXTENDED_LIMITS 0.00 255.0 /end CHARACTERISTIC
/begin CHARACTERISTIC DFES_Cls.DFC_MOXEMM_SMU_ALM6_5_C "" VALUE 0x80241A0A Val_Wu8 3.000 DFES_OneToOne 0.00 3.000 FORMAT "%5.3" EXTENDED_LIMITS 0.00 255.0 /end CHARACTERISTIC
/begin CHARACTERISTIC DFES_Cls.DFC_MOXEMM_SMU_ALM6_7_C "" VALUE 0x80241A0B Val_Wu8 3.000 DFES_OneToOne 0.00 3.000 FORMAT "%5.3" EXTENDED_LIMITS 0.00 255.0 /end CHARACTERISTIC
/begin CHARACTERISTIC DFES_Cls.DFC_MOXEMM_SMU_ALM6_8_C "" VALUE 0x80241A0C Val_Wu8 3.000 DFES_OneToOne 0.00 3.000 FORMAT "%5.3" EXTENDED_LIMITS 0.00 255.0 /end CHARACTERISTIC
/begin CHARACTERISTIC DFES_Cls.DFC_MOXEMM_SMU_ALM7_1_C "" VALUE 0x80241A0D Val_Wu8 3.000 DFES_OneToOne 0.00 3.000 FORMAT "%5.3" EXTENDED_LIMITS 0.00 255.0 /end CHARACTERISTIC
/begin CHARACTERISTIC DFES_Cls.DFC_MOXEMM_SMU_ALM7_12_C "" VALUE 0x80241A0E Val_Wu8 3.000 DFES_OneToOne 0.00 3.000 FORMAT "%5.3" EXTENDED_LIMITS 0.00 255.0 /end CHARACTERISTIC
/begin CHARACTERISTIC DFES_Cls.DFC_MOXEMM_SMU_ALM7_13_C "" VALUE 0x80241A0F Val_Wu8 3.000 DFES_OneToOne 0.00 3.000 FORMAT "%5.3" EXTENDED_LIMITS 0.00 255.0 /end CHARACTERISTIC
/begin CHARACTERISTIC DFES_Cls.DFC_MOXEMM_SMU_ALM7_14_C "" VALUE 0x80241A10 Val_Wu8 3.000 DFES_OneToOne 0.00 3.000 FORMAT "%5.3" EXTENDED_LIMITS 0.00 255.0 /end CHARACTERISTIC
/begin CHARACTERISTIC DFES_Cls.DFC_MOXEMM_SMU_ALM7_15_C "" VALUE 0x80241A11 Val_Wu8 3.000 DFES_OneToOne 0.00 3.000 FORMAT "%5.3" EXTENDED_LIMITS 0.00 255.0 /end CHARACTERISTIC
/begin CHARACTERISTIC DFES_Cls.DFC_MOXEMM_SMU_ALM7_16_C "" VALUE 0x80241A12 Val_Wu8 3.000 DFES_OneToOne 0.00 3.000 FORMAT "%5.3" EXTENDED_LIMITS 0.00 255.0 /end CHARACTERISTIC
/begin CHARACTERISTIC DFES_Cls.DFC_MOXEMM_SMU_ALM7_17_C "" VALUE 0x80241A13 Val_Wu8 3.000 DFES_OneToOne 0.00 3.000 FORMAT "%5.3" EXTENDED_LIMITS 0.00 255.0 /end CHARACTERISTIC
/begin CHARACTERISTIC DFES_Cls.DFC_MOXEMM_SMU_ALM7_2_C "" VALUE 0x80241A14 Val_Wu8 3.000 DFES_OneToOne 0.00 3.000 FORMAT "%5.3" EXTENDED_LIMITS 0.00 255.0 /end CHARACTERISTIC
/begin CHARACTERISTIC DFES_Cls.DFC_MOXEMM_SMU_ALM7_20_C "" VALUE 0x80241A15 Val_Wu8 3.000 DFES_OneToOne 0.00 3.000 FORMAT "%5.3" EXTENDED_LIMITS 0.00 255.0 /end CHARACTERISTIC
/begin CHARACTERISTIC DFES_Cls.DFC_MOXEMM_SMU_ALM7_25_C "" VALUE 0x80241A16 Val_Wu8 3.000 DFES_OneToOne 0.00 3.000 FORMAT "%5.3" EXTENDED_LIMITS 0.00 255.0 /end CHARACTERISTIC
/begin CHARACTERISTIC DFES_Cls.DFC_MOXEMM_SMU_ALM7_26_C "" VALUE 0x80241A17 Val_Wu8 3.000 DFES_OneToOne 0.00 3.000 FORMAT "%5.3" EXTENDED_LIMITS 0.00 255.0 /end CHARACTERISTIC
/begin CHARACTERISTIC DFES_Cls.DFC_MOXEMM_SMU_ALM7_28_C "" VALUE 0x80241A18 Val_Wu8 3.000 DFES_OneToOne 0.00 3.000 FORMAT "%5.3" EXTENDED_LIMITS 0.00 255.0 /end CHARACTERISTIC
/begin CHARACTERISTIC DFES_Cls.DFC_MOXEMM_SMU_ALM7_29_C "" VALUE 0x80241A19 Val_Wu8 3.000 DFES_OneToOne 0.00 3.000 FORMAT "%5.3" EXTENDED_LIMITS 0.00 255.0 /end CHARACTERISTIC
/begin CHARACTERISTIC DFES_Cls.DFC_MOXEMM_SMU_ALM7_30_C "" VALUE 0x80241A1A Val_Wu8 3.000 DFES_OneToOne 0.00 3.000 FORMAT "%5.3" EXTENDED_LIMITS 0.00 255.0 /end CHARACTERISTIC
/begin CHARACTERISTIC DFES_Cls.DFC_MOXEMM_SMU_ALM7_31_C "" VALUE 0x80241A1B Val_Wu8 3.000 DFES_OneToOne 0.00 3.000 FORMAT "%5.3" EXTENDED_LIMITS 0.00 255.0 /end CHARACTERISTIC
/begin CHARACTERISTIC DFES_Cls.DFC_MOXEMM_SMU_ALM8_0_C "" VALUE 0x80241A1C Val_Wu8 3.000 DFES_OneToOne 0.00 3.000 FORMAT "%5.3" EXTENDED_LIMITS 0.00 255.0 /end CHARACTERISTIC
/begin CHARACTERISTIC DFES_Cls.DFC_MOXEMM_SMU_ALM8_1_C "" VALUE 0x80241A1D Val_Wu8 3.000 DFES_OneToOne 0.00 3.000 FORMAT "%5.3" EXTENDED_LIMITS 0.00 255.0 /end CHARACTERISTIC
/begin CHARACTERISTIC DFES_Cls.DFC_MOXEMM_SMU_ALM8_10_C "" VALUE 0x80241A1E Val_Wu8 3.000 DFES_OneToOne 0.00 3.000 FORMAT "%5.3" EXTENDED_LIMITS 0.00 255.0 /end CHARACTERISTIC
/begin CHARACTERISTIC DFES_Cls.DFC_MOXEMM_SMU_ALM8_11_C "" VALUE 0x80241A1F Val_Wu8 3.000 DFES_OneToOne 0.00 3.000 FORMAT "%5.3" EXTENDED_LIMITS 0.00 255.0 /end CHARACTERISTIC
/begin CHARACTERISTIC DFES_Cls.DFC_MOXEMM_SMU_ALM8_12_C "" VALUE 0x80241A20 Val_Wu8 3.000 DFES_OneToOne 0.00 3.000 FORMAT "%5.3" EXTENDED_LIMITS 0.00 255.0 /end CHARACTERISTIC
/begin CHARACTERISTIC DFES_Cls.DFC_MOXEMM_SMU_ALM8_16_C "" VALUE 0x80241A21 Val_Wu8 3.000 DFES_OneToOne 0.00 3.000 FORMAT "%5.3" EXTENDED_LIMITS 0.00 255.0 /end CHARACTERISTIC
/begin CHARACTERISTIC DFES_Cls.DFC_MOXEMM_SMU_ALM8_18_C "" VALUE 0x80241A22 Val_Wu8 3.000 DFES_OneToOne 0.00 3.000 FORMAT "%5.3" EXTENDED_LIMITS 0.00 255.0 /end CHARACTERISTIC
/begin CHARACTERISTIC DFES_Cls.DFC_MOXEMM_SMU_ALM8_2_C "" VALUE 0x80241A23 Val_Wu8 3.000 DFES_OneToOne 0.00 3.000 FORMAT "%5.3" EXTENDED_LIMITS 0.00 255.0 /end CHARACTERISTIC
/begin CHARACTERISTIC DFES_Cls.DFC_MOXEMM_SMU_ALM8_3_C "" VALUE 0x80241A24 Val_Wu8 3.000 DFES_OneToOne 0.00 3.000 FORMAT "%5.3" EXTENDED_LIMITS 0.00 255.0 /end CHARACTERISTIC
/begin CHARACTERISTIC DFES_Cls.DFC_MOXEMM_SMU_ALM8_31_C "" VALUE 0x80241A25 Val_Wu8 3.000 DFES_OneToOne 0.00 3.000 FORMAT "%5.3" EXTENDED_LIMITS 0.00 255.0 /end CHARACTERISTIC
/begin CHARACTERISTIC DFES_Cls.DFC_MOXEMM_SMU_ALM8_4_C "" VALUE 0x80241A26 Val_Wu8 3.000 DFES_OneToOne 0.00 3.000 FORMAT "%5.3" EXTENDED_LIMITS 0.00 255.0 /end CHARACTERISTIC
/begin CHARACTERISTIC DFES_Cls.DFC_MOXEMM_SMU_ALM9_0_C "" VALUE 0x80241A27 Val_Wu8 3.000 DFES_OneToOne 0.00 3.000 FORMAT "%5.3" EXTENDED_LIMITS 0.00 255.0 /end CHARACTERISTIC
/begin CHARACTERISTIC DFES_Cls.DFC_MOXEMM_SMU_ALM9_15_C "" VALUE 0x80241A28 Val_Wu8 3.000 DFES_OneToOne 0.00 3.000 FORMAT "%5.3" EXTENDED_LIMITS 0.00 255.0 /end CHARACTERISTIC
/begin CHARACTERISTIC DFES_Cls.DFC_MOXEMM_SMU_ALM9_3_C "" VALUE 0x80241A29 Val_Wu8 3.000 DFES_OneToOne 0.00 3.000 FORMAT "%5.3" EXTENDED_LIMITS 0.00 255.0 /end CHARACTERISTIC
/begin CHARACTERISTIC DFES_Cls.DFC_MoCADCNTPBnk1_C "" VALUE 0x80241A2A Val_Wu8 3.000 DFES_OneToOne 0.00 3.000 FORMAT "%5.3" EXTENDED_LIMITS 0.00 255.0 /end CHARACTERISTIC
/begin CHARACTERISTIC DFES_Cls.DFC_MoCADCTestVoltBnk1_C "" VALUE 0x80241A2B Val_Wu8 3.000 DFES_OneToOne 0.00 3.000 FORMAT "%5.3" EXTENDED_LIMITS 0.00 255.0 /end CHARACTERISTIC
/begin CHARACTERISTIC DFES_Cls.DFC_MoCSOPICO_C "" VALUE 0x80241A2C Val_Wu8 3.000 DFES_OneToOne 0.00 3.000 FORMAT "%5.3" EXTENDED_LIMITS 0.00 255.0 /end CHARACTERISTIC
/begin CHARACTERISTIC DFES_Cls.DFC_MoFAccr_C "" VALUE 0x80241A2D Val_Wu8 3.000 DFES_OneToOne 0.00 3.000 FORMAT "%5.3" EXTENDED_LIMITS 0.00 255.0 /end CHARACTERISTIC
/begin CHARACTERISTIC DFES_Cls.DFC_MoFCbnPreCdngOvrheat_C "" VALUE 0x80241A2E Val_Wu8 3.000 DFES_OneToOne 0.00 3.000 FORMAT "%5.3" EXTENDED_LIMITS 0.00 255.0 /end CHARACTERISTIC
/begin CHARACTERISTIC DFES_Cls.DFC_MoFCbnPreCdngTmrExpi_C "" VALUE 0x80241A2F Val_Wu8 3.000 DFES_OneToOne 0.00 3.000 FORMAT "%5.3" EXTENDED_LIMITS 0.00 255.0 /end CHARACTERISTIC
/begin CHARACTERISTIC DFES_Cls.DFC_MoFEvMngtBms_C "" VALUE 0x80241A30 Val_Wu8 3.000 DFES_OneToOne 0.00 3.000 FORMAT "%5.3" EXTENDED_LIMITS 0.00 255.0 /end CHARACTERISTIC
/begin CHARACTERISTIC DFES_Cls.DFC_MoFEvMngtDcdc_C "" VALUE 0x80241A31 Val_Wu8 3.000 DFES_OneToOne 0.00 3.000 FORMAT "%5.3" EXTENDED_LIMITS 0.00 255.0 /end CHARACTERISTIC
/begin CHARACTERISTIC DFES_Cls.DFC_MoFEvMngtEm01_C "" VALUE 0x80241A32 Val_Wu8 3.000 DFES_OneToOne 0.00 3.000 FORMAT "%5.3" EXTENDED_LIMITS 0.00 255.0 /end CHARACTERISTIC
/begin CHARACTERISTIC DFES_Cls.DFC_MoFEvMngtEm01BrkgToZr_C "" VALUE 0x80241A33 Val_Wu8 3.000 DFES_OneToOne 0.00 3.000 FORMAT "%5.3" EXTENDED_LIMITS 0.00 255.0 /end CHARACTERISTIC
/begin CHARACTERISTIC DFES_Cls.DFC_MoFEvMngtEm01EngSpd_C "" VALUE 0x80241A34 Val_Wu8 3.000 DFES_OneToOne 0.00 3.000 FORMAT "%5.3" EXTENDED_LIMITS 0.00 255.0 /end CHARACTERISTIC
/begin CHARACTERISTIC DFES_Cls.DFC_MoFEvMngtEm02EngSpd_C "" VALUE 0x80241A35 Val_Wu8 3.000 DFES_OneToOne 0.00 3.000 FORMAT "%5.3" EXTENDED_LIMITS 0.00 255.0 /end CHARACTERISTIC
/begin CHARACTERISTIC DFES_Cls.DFC_MoFEvMngtEm02Lvl1_C "" VALUE 0x80241A36 Val_Wu8 3.000 DFES_OneToOne 0.00 3.000 FORMAT "%5.3" EXTENDED_LIMITS 0.00 255.0 /end CHARACTERISTIC
/begin CHARACTERISTIC DFES_Cls.DFC_MoFEvMngtEm02Lvl2_C "" VALUE 0x80241A37 Val_Wu8 3.000 DFES_OneToOne 0.00 3.000 FORMAT "%5.3" EXTENDED_LIMITS 0.00 255.0 /end CHARACTERISTIC
/begin CHARACTERISTIC DFES_Cls.DFC_MoFExtCptAuxCpt_C "" VALUE 0x80241A38 Val_Wu8 3.000 DFES_OneToOne 0.00 3.000 FORMAT "%5.3" EXTENDED_LIMITS 0.00 255.0 /end CHARACTERISTIC
/begin CHARACTERISTIC DFES_Cls.DFC_MoFExtCptVacPmpErr_C "" VALUE 0x80241A39 Val_Wu8 3.000 DFES_OneToOne 0.00 3.000 FORMAT "%5.3" EXTENDED_LIMITS 0.00 255.0 /end CHARACTERISTIC
/begin CHARACTERISTIC DFES_Cls.DFC_MoFTqPtdAxle_C "" VALUE 0x80241A3A Val_Wu8 3.000 DFES_OneToOne 0.00 3.000 FORMAT "%5.3" EXTENDED_LIMITS 0.00 255.0 /end CHARACTERISTIC
/begin CHARACTERISTIC DFES_Cls.DFC_MoFTqPtdAxleSec_C "" VALUE 0x80241A3B Val_Wu8 3.000 DFES_OneToOne 0.00 3.000 FORMAT "%5.3" EXTENDED_LIMITS 0.00 255.0 /end CHARACTERISTIC
/begin CHARACTERISTIC DFES_Cls.DFC_MoFTqPtdEmPtRels_C "" VALUE 0x80241A3C Val_Wu8 3.000 DFES_OneToOne 0.00 3.000 FORMAT "%5.3" EXTENDED_LIMITS 0.00 255.0 /end CHARACTERISTIC
/begin CHARACTERISTIC DFES_Cls.DFC_MoFTqPtdEmPtRelsSec_C "" VALUE 0x80241A3D Val_Wu8 3.000 DFES_OneToOne 0.00 3.000 FORMAT "%5.3" EXTENDED_LIMITS 0.00 255.0 /end CHARACTERISTIC
/begin CHARACTERISTIC DFES_Cls.DFC_MoFTqPtdEmSign_C "" VALUE 0x80241A3E Val_Wu8 3.000 DFES_OneToOne 0.00 3.000 FORMAT "%5.3" EXTENDED_LIMITS 0.00 255.0 /end CHARACTERISTIC
/begin CHARACTERISTIC DFES_Cls.DFC_MoFTqPtdEmSignSec_C "" VALUE 0x80241A3F Val_Wu8 3.000 DFES_OneToOne 0.00 3.000 FORMAT "%5.3" EXTENDED_LIMITS 0.00 255.0 /end CHARACTERISTIC
/begin CHARACTERISTIC DFES_Cls.DFC_MoFTqPtdEmTq_C "" VALUE 0x80241A40 Val_Wu8 3.000 DFES_OneToOne 0.00 3.000 FORMAT "%5.3" EXTENDED_LIMITS 0.00 255.0 /end CHARACTERISTIC
/begin CHARACTERISTIC DFES_Cls.DFC_MoFTqPtdEmTqSec_C "" VALUE 0x80241A41 Val_Wu8 3.000 DFES_OneToOne 0.00 3.000 FORMAT "%5.3" EXTENDED_LIMITS 0.00 255.0 /end CHARACTERISTIC
/begin CHARACTERISTIC DFES_Cls.DFC_MoFTqPtdVeh_C "" VALUE 0x80241A42 Val_Wu8 3.000 DFES_OneToOne 0.00 3.000 FORMAT "%5.3" EXTENDED_LIMITS 0.00 255.0 /end CHARACTERISTIC
/begin CHARACTERISTIC DFES_Cls.DFC_MoFVarPostBldSel_C "" VALUE 0x80241A43 Val_Wu8 3.000 DFES_OneToOne 0.00 3.000 FORMAT "%5.3" EXTENDED_LIMITS 0.00 255.0 /end CHARACTERISTIC
/begin CHARACTERISTIC DFES_Cls.DFC_MoSysCtrlReIni_C "" VALUE 0x80241A44 Val_Wu8 3.000 DFES_OneToOne 0.00 3.000 FORMAT "%5.3" EXTENDED_LIMITS 0.00 255.0 /end CHARACTERISTIC
/begin CHARACTERISTIC DFES_Cls.DFC_MoXEMMHwLTMCUFW_C "" VALUE 0x80241A45 Val_Wu8 3.000 DFES_OneToOne 0.00 3.000 FORMAT "%5.3" EXTENDED_LIMITS 0.00 255.0 /end CHARACTERISTIC
/begin CHARACTERISTIC DFES_Cls.DFC_MoXEMMHwLTMonBIST_C "" VALUE 0x80241A46 Val_Wu8 3.000 DFES_OneToOne 0.00 3.000 FORMAT "%5.3" EXTENDED_LIMITS 0.00 255.0 /end CHARACTERISTIC
/begin CHARACTERISTIC DFES_Cls.DFC_MoXEMMHwLTRegMonTest_C "" VALUE 0x80241A47 Val_Wu8 3.000 DFES_OneToOne 0.00 3.000 FORMAT "%5.3" EXTENDED_LIMITS 0.00 255.0 /end CHARACTERISTIC
/begin CHARACTERISTIC DFES_Cls.DFC_MoXEMMHwLTStbySMUAlvTest_C "" VALUE 0x80241A48 Val_Wu8 3.000 DFES_OneToOne 0.00 3.000 FORMAT "%5.3" EXTENDED_LIMITS 0.00 255.0 /end CHARACTERISTIC
/begin CHARACTERISTIC DFES_Cls.DFC_MoXEMMHwLTTempSens_C "" VALUE 0x80241A49 Val_Wu8 3.000 DFES_OneToOne 0.00 3.000 FORMAT "%5.3" EXTENDED_LIMITS 0.00 255.0 /end CHARACTERISTIC
/begin CHARACTERISTIC DFES_Cls.DFC_MoXEMMHwLTUCBCfg_C "" VALUE 0x80241A4A Val_Wu8 3.000 DFES_OneToOne 0.00 3.000 FORMAT "%5.3" EXTENDED_LIMITS 0.00 255.0 /end CHARACTERISTIC
/begin CHARACTERISTIC DFES_Cls.DFC_MonEgyChrgnCoorr_AcChrgnWoMofRels_C "" VALUE 0x80241A4B Val_Wu8 3.000 DFES_OneToOne 0.00 3.000 FORMAT "%5.3" EXTENDED_LIMITS 0.00 255.0 /end CHARACTERISTIC
/begin CHARACTERISTIC DFES_Cls.DFC_MonEgyChrgnCoorr_ChrgnAbortIgr_C "" VALUE 0x80241A4C Val_Wu8 3.000 DFES_OneToOne 0.00 3.000 FORMAT "%5.3" EXTENDED_LIMITS 0.00 255.0 /end CHARACTERISTIC
/begin CHARACTERISTIC DFES_Cls.DFC_MonEgyChrgnCoorr_DcCntctFailr_C "" VALUE 0x80241A4D Val_Wu8 3.000 DFES_OneToOne 0.00 3.000 FORMAT "%5.3" EXTENDED_LIMITS 0.00 255.0 /end CHARACTERISTIC
/begin CHARACTERISTIC DFES_Cls.DFC_MonEgyChrgnCoorr_ExtChrgnShtOffReq_C "" VALUE 0x80241A4E Val_Wu8 3.000 DFES_OneToOne 0.00 3.000 FORMAT "%5.3" EXTENDED_LIMITS 0.00 255.0 /end CHARACTERISTIC
/begin CHARACTERISTIC DFES_Cls.DFC_MonEgyChrgnCoorr_ImpsChrgnMod_C "" VALUE 0x80241A4F Val_Wu8 3.000 DFES_OneToOne 0.00 3.000 FORMAT "%5.3" EXTENDED_LIMITS 0.00 255.0 /end CHARACTERISTIC
/begin CHARACTERISTIC DFES_Cls.DFC_MonEgyChrgnCoorr_ImpsChrgnPrms_C "" VALUE 0x80241A50 Val_Wu8 3.000 DFES_OneToOne 0.00 3.000 FORMAT "%5.3" EXTENDED_LIMITS 0.00 255.0 /end CHARACTERISTIC
/begin CHARACTERISTIC DFES_Cls.DFC_MonEgyChrgnCoorr_ImpsUDcIntk_C "" VALUE 0x80241A51 Val_Wu8 3.000 DFES_OneToOne 0.00 3.000 FORMAT "%5.3" EXTENDED_LIMITS 0.00 255.0 /end CHARACTERISTIC
/begin CHARACTERISTIC DFES_Cls.DFC_MonEgyChrgnCoorr_PlgLockMovmt_C "" VALUE 0x80241A52 Val_Wu8 3.000 DFES_OneToOne 0.00 3.000 FORMAT "%5.3" EXTENDED_LIMITS 0.00 255.0 /end CHARACTERISTIC
/begin CHARACTERISTIC DFES_Cls.DFC_MonEgyChrgnCoorr_VehCrashDetn_C "" VALUE 0x80241A53 Val_Wu8 3.000 DFES_OneToOne 0.00 3.000 FORMAT "%5.3" EXTENDED_LIMITS 0.00 255.0 /end CHARACTERISTIC
/begin CHARACTERISTIC DFES_Cls.DFC_MonEgyChrgnErrReactn_SftySwt_C "" VALUE 0x80241A54 Val_Wu8 3.000 DFES_OneToOne 0.00 3.000 FORMAT "%5.3" EXTENDED_LIMITS 0.00 255.0 /end CHARACTERISTIC
/begin CHARACTERISTIC DFES_Cls.DFC_MonEgyChrgnInlet_CcsPlgCtp_C "" VALUE 0x80241A55 Val_Wu8 3.000 DFES_OneToOne 0.00 3.000 FORMAT "%5.3" EXTENDED_LIMITS 0.00 255.0 /end CHARACTERISTIC
/begin CHARACTERISTIC DFES_Cls.DFC_MonEgyChrgnInlet_CcsPlgCtpPwm_C "" VALUE 0x80241A56 Val_Wu8 3.000 DFES_OneToOne 0.00 3.000 FORMAT "%5.3" EXTENDED_LIMITS 0.00 255.0 /end CHARACTERISTIC
/begin CHARACTERISTIC DFES_Cls.DFC_MonEgyChrgnInlet_CcsPlgLockCtrlImpsAtmpt_C "" VALUE 0x80241A57 Val_Wu8 3.000 DFES_OneToOne 0.00 3.000 FORMAT "%5.3" EXTENDED_LIMITS 0.00 255.0 /end CHARACTERISTIC
/begin CHARACTERISTIC DFES_Cls.DFC_MonEgyChrgnInlet_CcsPlgLockSnsrSigRngChk_C "" VALUE 0x80241A58 Val_Wu8 3.000 DFES_OneToOne 0.00 3.000 FORMAT "%5.3" EXTENDED_LIMITS 0.00 255.0 /end CHARACTERISTIC
/begin CHARACTERISTIC DFES_Cls.DFC_MonEgyChrgnInlet_CcsPlgLockStImps_C "" VALUE 0x80241A59 Val_Wu8 3.000 DFES_OneToOne 0.00 3.000 FORMAT "%5.3" EXTENDED_LIMITS 0.00 255.0 /end CHARACTERISTIC
/begin CHARACTERISTIC DFES_Cls.DFC_MonEgyChrgnInlet_CcsPlgPxp_C "" VALUE 0x80241A5A Val_Wu8 3.000 DFES_OneToOne 0.00 3.000 FORMAT "%5.3" EXTENDED_LIMITS 0.00 255.0 /end CHARACTERISTIC
/begin CHARACTERISTIC DFES_Cls.DFC_MonEgyChrgnT_Snsr1GrdtChk_C "" VALUE 0x80241A5B Val_Wu8 3.000 DFES_OneToOne 0.00 3.000 FORMAT "%5.3" EXTENDED_LIMITS 0.00 255.0 /end CHARACTERISTIC
/begin CHARACTERISTIC DFES_Cls.DFC_MonEgyChrgnT_Snsr1SigRngChk_C "" VALUE 0x80241A5C Val_Wu8 3.000 DFES_OneToOne 0.00 3.000 FORMAT "%5.3" EXTENDED_LIMITS 0.00 255.0 /end CHARACTERISTIC
/begin CHARACTERISTIC DFES_Cls.DFC_MonEgyChrgnT_Snsr2GrdtChk_C "" VALUE 0x80241A5D Val_Wu8 3.000 DFES_OneToOne 0.00 3.000 FORMAT "%5.3" EXTENDED_LIMITS 0.00 255.0 /end CHARACTERISTIC
/begin CHARACTERISTIC DFES_Cls.DFC_MonEgyChrgnT_Snsr2SigRngChk_C "" VALUE 0x80241A5E Val_Wu8 3.000 DFES_OneToOne 0.00 3.000 FORMAT "%5.3" EXTENDED_LIMITS 0.00 255.0 /end CHARACTERISTIC
/begin CHARACTERISTIC DFES_Cls.DFC_MonEgyChrgnT_SnsrDif_C "" VALUE 0x80241A5F Val_Wu8 3.000 DFES_OneToOne 0.00 3.000 FORMAT "%5.3" EXTENDED_LIMITS 0.00 255.0 /end CHARACTERISTIC
/begin CHARACTERISTIC DFES_Cls.DFC_OCWDAABEActv_C "" VALUE 0x80241A60 Val_Wu8 3.000 DFES_OneToOne 0.00 3.000 FORMAT "%5.3" EXTENDED_LIMITS 0.00 255.0 /end CHARACTERISTIC
/begin CHARACTERISTIC DFES_Cls.DFC_OCWDACom_C "" VALUE 0x80241A61 Val_Wu8 3.000 DFES_OneToOne 0.00 3.000 FORMAT "%5.3" EXTENDED_LIMITS 0.00 255.0 /end CHARACTERISTIC
/begin CHARACTERISTIC DFES_Cls.DFC_OCWDAErrPin_C "" VALUE 0x80241A62 Val_Wu8 3.000 DFES_OneToOne 0.00 3.000 FORMAT "%5.3" EXTENDED_LIMITS 0.00 255.0 /end CHARACTERISTIC
/begin CHARACTERISTIC DFES_Cls.DFC_OCWDAOvrVltg_C "" VALUE 0x80241A63 Val_Wu8 3.000 DFES_OneToOne 0.00 3.000 FORMAT "%5.3" EXTENDED_LIMITS 0.00 255.0 /end CHARACTERISTIC
/begin CHARACTERISTIC DFES_Cls.DFC_PUmax_C "" VALUE 0x80241A64 Val_Wu8 3.000 DFES_OneToOne 0.00 3.000 FORMAT "%5.3" EXTENDED_LIMITS 0.00 255.0 /end CHARACTERISTIC
/begin CHARACTERISTIC DFES_Cls.DFC_PwmCtPTmpErr_C "" VALUE 0x80241A65 Val_Wu8 3.000 DFES_OneToOne 0.00 3.000 FORMAT "%5.3" EXTENDED_LIMITS 0.00 255.0 /end CHARACTERISTIC
/begin CHARACTERISTIC DFES_Cls.DFC_PwrDistbnUnitTSRCMax_C "" VALUE 0x80241A66 Val_Wu8 3.000 DFES_OneToOne 0.00 3.000 FORMAT "%5.3" EXTENDED_LIMITS 0.00 255.0 /end CHARACTERISTIC
/begin CHARACTERISTIC DFES_Cls.DFC_PwrDistbnUnitTTmpErr_C "" VALUE 0x80241A67 Val_Wu8 3.000 DFES_OneToOne 0.00 3.000 FORMAT "%5.3" EXTENDED_LIMITS 0.00 255.0 /end CHARACTERISTIC
/begin CHARACTERISTIC DFES_Cls.DFC_SCtPmp1DiagGrdKeyErr_C "" VALUE 0x80241A68 Val_Wu8 3.000 DFES_OneToOne 0.00 3.000 FORMAT "%5.3" EXTENDED_LIMITS 0.00 255.0 /end CHARACTERISTIC
/begin CHARACTERISTIC DFES_Cls.DFC_SRCHighAPP1_C "" VALUE 0x80241A69 Val_Wu8 3.000 DFES_OneToOne 0.00 3.000 FORMAT "%5.3" EXTENDED_LIMITS 0.00 255.0 /end CHARACTERISTIC
/begin CHARACTERISTIC DFES_Cls.DFC_SRCHighAPP2_C "" VALUE 0x80241A6A Val_Wu8 3.000 DFES_OneToOne 0.00 3.000 FORMAT "%5.3" EXTENDED_LIMITS 0.00 255.0 /end CHARACTERISTIC
/begin CHARACTERISTIC DFES_Cls.DFC_SRCLowAPP1_C "" VALUE 0x80241A6B Val_Wu8 3.000 DFES_OneToOne 0.00 3.000 FORMAT "%5.3" EXTENDED_LIMITS 0.00 255.0 /end CHARACTERISTIC
/begin CHARACTERISTIC DFES_Cls.DFC_SRCLowAPP2_C "" VALUE 0x80241A6C Val_Wu8 3.000 DFES_OneToOne 0.00 3.000 FORMAT "%5.3" EXTENDED_LIMITS 0.00 255.0 /end CHARACTERISTIC
/begin CHARACTERISTIC DFES_Cls.DFC_SWReset_0_C "" VALUE 0x80241A6D Val_Wu8 3.000 DFES_OneToOne 0.00 3.000 FORMAT "%5.3" EXTENDED_LIMITS 0.00 255.0 /end CHARACTERISTIC
/begin CHARACTERISTIC DFES_Cls.DFC_SWReset_1_C "" VALUE 0x80241A6E Val_Wu8 3.000 DFES_OneToOne 0.00 3.000 FORMAT "%5.3" EXTENDED_LIMITS 0.00 255.0 /end CHARACTERISTIC
/begin CHARACTERISTIC DFES_Cls.DFC_SWReset_2_C "" VALUE 0x80241A6F Val_Wu8 3.000 DFES_OneToOne 0.00 3.000 FORMAT "%5.3" EXTENDED_LIMITS 0.00 255.0 /end CHARACTERISTIC
/begin CHARACTERISTIC DFES_Cls.DFC_Sia_InvldCode_C "" VALUE 0x80241A70 Val_Wu8 3.000 DFES_OneToOne 0.00 3.000 FORMAT "%5.3" EXTENDED_LIMITS 0.00 255.0 /end CHARACTERISTIC
/begin CHARACTERISTIC DFES_Cls.DFC_Sia_InvldKey_C "" VALUE 0x80241A71 Val_Wu8 3.000 DFES_OneToOne 0.00 3.000 FORMAT "%5.3" EXTENDED_LIMITS 0.00 255.0 /end CHARACTERISTIC
/begin CHARACTERISTIC DFES_Cls.DFC_Sia_NoRespUCx_C "" VALUE 0x80241A72 Val_Wu8 3.000 DFES_OneToOne 0.00 3.000 FORMAT "%5.3" EXTENDED_LIMITS 0.00 255.0 /end CHARACTERISTIC
/begin CHARACTERISTIC DFES_Cls.DFC_Sia_TprotRttp_C "" VALUE 0x80241A73 Val_Wu8 3.000 DFES_OneToOne 0.00 3.000 FORMAT "%5.3" EXTENDED_LIMITS 0.00 255.0 /end CHARACTERISTIC
/begin CHARACTERISTIC DFES_Cls.DFC_StrtUpEvStandStillDeactvn_C "" VALUE 0x80241A74 Val_Wu8 3.000 DFES_OneToOne 0.00 3.000 FORMAT "%5.3" EXTENDED_LIMITS 0.00 255.0 /end CHARACTERISTIC
/begin CHARACTERISTIC DFES_Cls.DFC_SyncAPP_C "" VALUE 0x80241A75 Val_Wu8 3.000 DFES_OneToOne 0.00 3.000 FORMAT "%5.3" EXTENDED_LIMITS 0.00 255.0 /end CHARACTERISTIC
/begin CHARACTERISTIC DFES_Cls.DFC_UCtPSRCMax_C "" VALUE 0x80241A76 Val_Wu8 3.000 DFES_OneToOne 0.00 3.000 FORMAT "%5.3" EXTENDED_LIMITS 0.00 255.0 /end CHARACTERISTIC
/begin CHARACTERISTIC DFES_Cls.DFC_UCtPTmpErr_C "" VALUE 0x80241A77 Val_Wu8 3.000 DFES_OneToOne 0.00 3.000 FORMAT "%5.3" EXTENDED_LIMITS 0.00 255.0 /end CHARACTERISTIC
/begin CHARACTERISTIC DFES_Cls.DFC_UPxP1SRCMax_C "" VALUE 0x80241A78 Val_Wu8 3.000 DFES_OneToOne 0.00 3.000 FORMAT "%5.3" EXTENDED_LIMITS 0.00 255.0 /end CHARACTERISTIC
/begin CHARACTERISTIC DFES_Cls.DFC_UPxP1TmpErr_C "" VALUE 0x80241A79 Val_Wu8 3.000 DFES_OneToOne 0.00 3.000 FORMAT "%5.3" EXTENDED_LIMITS 0.00 255.0 /end CHARACTERISTIC
/begin CHARACTERISTIC DFES_Cls.DFC_VehVObd_C "" VALUE 0x80241A7A Val_Wu8 3.000 DFES_OneToOne 0.00 3.000 FORMAT "%5.3" EXTENDED_LIMITS 0.00 255.0 /end CHARACTERISTIC
/begin CHARACTERISTIC DFES_DbLv_C "" VALUE 0x80241A7C Val_Wu8 15.00 DFES_OneToOne 0.00 15.00 FORMAT "%5.2" EXTENDED_LIMITS 0.00 255.0 /end CHARACTERISTIC
/begin CHARACTERISTIC DFES_DTCM.DFC_Unused_C "" VALUE 0x80249248 Val_Wu16 65535.00 DFES_OneToOne 0.00 65535.00 FORMAT "%8.2" READ_ONLY /end CHARACTERISTIC
/begin CHARACTERISTIC DFES_DTCM.DFC_ACCmprFltLvlRes_C "" VALUE 0x8024924A Val_Wu16 65535.00 DFES_OneToOne 0.00 65535.00 FORMAT "%8.2" /end CHARACTERISTIC
/begin CHARACTERISTIC DFES_DTCM.DFC_AbgHiSigFlt_C "" VALUE 0x8024924C Val_Wu16 65535.00 DFES_OneToOne 0.00 65535.00 FORMAT "%8.2" /end CHARACTERISTIC
/begin CHARACTERISTIC DFES_DTCM.DFC_AbgIntPatFlt_C "" VALUE 0x8024924E Val_Wu16 65535.00 DFES_OneToOne 0.00 65535.00 FORMAT "%8.2" /end CHARACTERISTIC
/begin CHARACTERISTIC DFES_DTCM.DFC_AbgLoSigFlt_C "" VALUE 0x80249250 Val_Wu16 65535.00 DFES_OneToOne 0.00 65535.00 FORMAT "%8.2" /end CHARACTERISTIC
/begin CHARACTERISTIC DFES_DTCM.DFC_AbgUnkwnErrSigFlt_C "" VALUE 0x80249252 Val_Wu16 65535.00 DFES_OneToOne 0.00 65535.00 FORMAT "%8.2" /end CHARACTERISTIC
/begin CHARACTERISTIC DFES_DTCM.DFC_AcExtChrgrIBattExcdd_C "" VALUE 0x80249254 Val_Wu16 65535.00 DFES_OneToOne 0.00 65535.00 FORMAT "%8.2" /end CHARACTERISTIC
/begin CHARACTERISTIC DFES_DTCM.DFC_AcExtChrgrIInExcdd_C "" VALUE 0x80249256 Val_Wu16 65535.00 DFES_OneToOne 0.00 65535.00 FORMAT "%8.2" /end CHARACTERISTIC
/begin CHARACTERISTIC DFES_DTCM.DFC_AcExtChrgrIOutDe_C "" VALUE 0x80249258 Val_Wu16 65535.00 DFES_OneToOne 0.00 65535.00 FORMAT "%8.2" /end CHARACTERISTIC
/begin CHARACTERISTIC DFES_DTCM.DFC_AcExtChrgrIOutExcdd_C "" VALUE 0x8024925A Val_Wu16 65535.00 DFES_OneToOne 0.00 65535.00 FORMAT "%8.2" /end CHARACTERISTIC
/begin CHARACTERISTIC DFES_DTCM.DFC_AcExtChrgrUOutDe_C "" VALUE 0x8024925C Val_Wu16 65535.00 DFES_OneToOne 0.00 65535.00 FORMAT "%8.2" /end CHARACTERISTIC
/begin CHARACTERISTIC DFES_DTCM.DFC_AdpActvDChaFailr_C "" VALUE 0x8024925E Val_Wu16 65535.00 DFES_OneToOne 0.00 65535.00 FORMAT "%8.2" /end CHARACTERISTIC
/begin CHARACTERISTIC DFES_DTCM.DFC_AirbcuFlt_C "" VALUE 0x80249260 Val_Wu16 65535.00 DFES_OneToOne 0.00 65535.00 FORMAT "%8.2" /end CHARACTERISTIC
/begin CHARACTERISTIC DFES_DTCM.DFC_Airbg_C "" VALUE 0x80249262 Val_Wu16 65535.00 DFES_OneToOne 0.00 65535.00 FORMAT "%8.2" /end CHARACTERISTIC
/begin CHARACTERISTIC DFES_DTCM.DFC_AirbgCan_C "" VALUE 0x80249264 Val_Wu16 65535.00 DFES_OneToOne 0.00 65535.00 FORMAT "%8.2" /end CHARACTERISTIC
/begin CHARACTERISTIC DFES_DTCM.DFC_AirbgCanHWPlaus_C "" VALUE 0x80249266 Val_Wu16 65535.00 DFES_OneToOne 0.00 65535.00 FORMAT "%8.2" /end CHARACTERISTIC
/begin CHARACTERISTIC DFES_DTCM.DFC_AirbgHWCanPlaus_C "" VALUE 0x80249268 Val_Wu16 65535.00 DFES_OneToOne 0.00 65535.00 FORMAT "%8.2" /end CHARACTERISTIC
/begin CHARACTERISTIC DFES_DTCM.DFC_AirbgMnr_C "" VALUE 0x8024926A Val_Wu16 65535.00 DFES_OneToOne 0.00 65535.00 FORMAT "%8.2" /end CHARACTERISTIC
/begin CHARACTERISTIC DFES_DTCM.DFC_AirbgPerHi_C "" VALUE 0x8024926C Val_Wu16 65535.00 DFES_OneToOne 0.00 65535.00 FORMAT "%8.2" /end CHARACTERISTIC
/begin CHARACTERISTIC DFES_DTCM.DFC_AirbgPerdRngFlt_C "" VALUE 0x8024926E Val_Wu16 65535.00 DFES_OneToOne 0.00 65535.00 FORMAT "%8.2" /end CHARACTERISTIC
/begin CHARACTERISTIC DFES_DTCM.DFC_BlowrRlyErr_C "" VALUE 0x80249270 Val_Wu16 65535.00 DFES_OneToOne 0.00 65535.00 FORMAT "%8.2" /end CHARACTERISTIC
/begin CHARACTERISTIC DFES_DTCM.DFC_BrkBstPmpActtnDfct_C "" VALUE 0x80249272 Val_Wu16 65535.00 DFES_OneToOne 0.00 65535.00 FORMAT "%8.2" /end CHARACTERISTIC
/begin CHARACTERISTIC DFES_DTCM.DFC_BrkBstPmpDeactvnDfct_C "" VALUE 0x80249274 Val_Wu16 65535.00 DFES_OneToOne 0.00 65535.00 FORMAT "%8.2" /end CHARACTERISTIC
/begin CHARACTERISTIC DFES_DTCM.DFC_BrkSwtFlt_C "" VALUE 0x80249276 Val_Wu16 65535.00 DFES_OneToOne 0.00 65535.00 FORMAT "%8.2" /end CHARACTERISTIC
/begin CHARACTERISTIC DFES_DTCM.DFC_CbnHeatgHeatrHsScb_C "" VALUE 0x80249278 Val_Wu16 65535.00 DFES_OneToOne 0.00 65535.00 FORMAT "%8.2" /end CHARACTERISTIC
/begin CHARACTERISTIC DFES_DTCM.DFC_CbnHeatgHeatrHsScg_C "" VALUE 0x8024927A Val_Wu16 65535.00 DFES_OneToOne 0.00 65535.00 FORMAT "%8.2" /end CHARACTERISTIC
/begin CHARACTERISTIC DFES_DTCM.DFC_CbnHeatgHeatrLsOl_C "" VALUE 0x8024927C Val_Wu16 65535.00 DFES_OneToOne 0.00 65535.00 FORMAT "%8.2" /end CHARACTERISTIC
/begin CHARACTERISTIC DFES_DTCM.DFC_CbnHeatgHeatrLsScb_C "" VALUE 0x8024927E Val_Wu16 65535.00 DFES_OneToOne 0.00 65535.00 FORMAT "%8.2" /end CHARACTERISTIC
/begin CHARACTERISTIC DFES_DTCM.DFC_CbnHeatgHeatrLsScg_C "" VALUE 0x80249280 Val_Wu16 65535.00 DFES_OneToOne 0.00 65535.00 FORMAT "%8.2" /end CHARACTERISTIC
/begin CHARACTERISTIC DFES_DTCM.DFC_CbnHeatgHeatrUnUsed_C "" VALUE 0x80249282 Val_Wu16 65535.00 DFES_OneToOne 0.00 65535.00 FORMAT "%8.2" /end CHARACTERISTIC
/begin CHARACTERISTIC DFES_DTCM.DFC_ChrgnCntctHsOt_C "" VALUE 0x80249284 Val_Wu16 65535.00 DFES_OneToOne 0.00 65535.00 FORMAT "%8.2" /end CHARACTERISTIC
/begin CHARACTERISTIC DFES_DTCM.DFC_ChrgnCntctHsScb_C "" VALUE 0x80249286 Val_Wu16 65535.00 DFES_OneToOne 0.00 65535.00 FORMAT "%8.2" /end CHARACTERISTIC
/begin CHARACTERISTIC DFES_DTCM.DFC_ChrgnCntctHsScg_C "" VALUE 0x80249288 Val_Wu16 65535.00 DFES_OneToOne 0.00 65535.00 FORMAT "%8.2" /end CHARACTERISTIC
/begin CHARACTERISTIC DFES_DTCM.DFC_ChrgnCntctLsNegOl_C "" VALUE 0x8024928A Val_Wu16 65535.00 DFES_OneToOne 0.00 65535.00 FORMAT "%8.2" /end CHARACTERISTIC
/begin CHARACTERISTIC DFES_DTCM.DFC_ChrgnCntctLsNegOt_C "" VALUE 0x8024928C Val_Wu16 65535.00 DFES_OneToOne 0.00 65535.00 FORMAT "%8.2" /end CHARACTERISTIC
/begin CHARACTERISTIC DFES_DTCM.DFC_ChrgnCntctLsNegScb_C "" VALUE 0x8024928E Val_Wu16 65535.00 DFES_OneToOne 0.00 65535.00 FORMAT "%8.2" /end CHARACTERISTIC
/begin CHARACTERISTIC DFES_DTCM.DFC_ChrgnCntctLsNegScg_C "" VALUE 0x80249290 Val_Wu16 65535.00 DFES_OneToOne 0.00 65535.00 FORMAT "%8.2" /end CHARACTERISTIC
/begin CHARACTERISTIC DFES_DTCM.DFC_ChrgnCntctLsPosOl_C "" VALUE 0x80249292 Val_Wu16 65535.00 DFES_OneToOne 0.00 65535.00 FORMAT "%8.2" /end CHARACTERISTIC
/begin CHARACTERISTIC DFES_DTCM.DFC_ChrgnCntctLsPosOt_C "" VALUE 0x80249294 Val_Wu16 65535.00 DFES_OneToOne 0.00 65535.00 FORMAT "%8.2" /end CHARACTERISTIC
/begin CHARACTERISTIC DFES_DTCM.DFC_ChrgnCntctLsPosScb_C "" VALUE 0x80249296 Val_Wu16 65535.00 DFES_OneToOne 0.00 65535.00 FORMAT "%8.2" /end CHARACTERISTIC
/begin CHARACTERISTIC DFES_DTCM.DFC_ChrgnCntctLsPosScg_C "" VALUE 0x80249298 Val_Wu16 65535.00 DFES_OneToOne 0.00 65535.00 FORMAT "%8.2" /end CHARACTERISTIC
/begin CHARACTERISTIC DFES_DTCM.DFC_ChrgnCntctUnUsed_C "" VALUE 0x8024929A Val_Wu16 65535.00 DFES_OneToOne 0.00 65535.00 FORMAT "%8.2" /end CHARACTERISTIC
/begin CHARACTERISTIC DFES_DTCM.DFC_ComBrkMai_C "" VALUE 0x8024929C Val_Wu16 65535.00 DFES_OneToOne 0.00 65535.00 FORMAT "%8.2" /end CHARACTERISTIC
/begin CHARACTERISTIC DFES_DTCM.DFC_ComChrgrEVCont_C "" VALUE 0x8024929E Val_Wu16 65535.00 DFES_OneToOne 0.00 65535.00 FORMAT "%8.2" /end CHARACTERISTIC
/begin CHARACTERISTIC DFES_DTCM.DFC_ComChrgrEVtBlink_C "" VALUE 0x802492A0 Val_Wu16 65535.00 DFES_OneToOne 0.00 65535.00 FORMAT "%8.2" /end CHARACTERISTIC
/begin CHARACTERISTIC DFES_DTCM.DFC_ComChrgrMstBlink_C "" VALUE 0x802492A2 Val_Wu16 65535.00 DFES_OneToOne 0.00 65535.00 FORMAT "%8.2" /end CHARACTERISTIC
/begin CHARACTERISTIC DFES_DTCM.DFC_ComChrgrMstCont_C "" VALUE 0x802492A4 Val_Wu16 65535.00 DFES_OneToOne 0.00 65535.00 FORMAT "%8.2" /end CHARACTERISTIC
/begin CHARACTERISTIC DFES_DTCM.DFC_ComChrgrSVSBlink_C "" VALUE 0x802492A6 Val_Wu16 65535.00 DFES_OneToOne 0.00 65535.00 FORMAT "%8.2" /end CHARACTERISTIC
/begin CHARACTERISTIC DFES_DTCM.DFC_ComChrgrSVSCont_C "" VALUE 0x802492A8 Val_Wu16 65535.00 DFES_OneToOne 0.00 65535.00 FORMAT "%8.2" /end CHARACTERISTIC
/begin CHARACTERISTIC DFES_DTCM.DFC_ComDcdcEVBlink_C "" VALUE 0x802492AA Val_Wu16 65535.00 DFES_OneToOne 0.00 65535.00 FORMAT "%8.2" /end CHARACTERISTIC
/begin CHARACTERISTIC DFES_DTCM.DFC_ComDcdcEVCont_C "" VALUE 0x802492AC Val_Wu16 65535.00 DFES_OneToOne 0.00 65535.00 FORMAT "%8.2" /end CHARACTERISTIC
/begin CHARACTERISTIC DFES_DTCM.DFC_ComDcdcFltLvl2_C "" VALUE 0x802492AE Val_Wu16 65535.00 DFES_OneToOne 0.00 65535.00 FORMAT "%8.2" /end CHARACTERISTIC
/begin CHARACTERISTIC DFES_DTCM.DFC_ComDcdcFltLvl3_C "" VALUE 0x802492B0 Val_Wu16 65535.00 DFES_OneToOne 0.00 65535.00 FORMAT "%8.2" /end CHARACTERISTIC
/begin CHARACTERISTIC DFES_DTCM.DFC_ComDcdcFltLvl4_C "" VALUE 0x802492B2 Val_Wu16 65535.00 DFES_OneToOne 0.00 65535.00 FORMAT "%8.2" /end CHARACTERISTIC
/begin CHARACTERISTIC DFES_DTCM.DFC_ComDcdcFltLvl5_C "" VALUE 0x802492B4 Val_Wu16 65535.00 DFES_OneToOne 0.00 65535.00 FORMAT "%8.2" /end CHARACTERISTIC
/begin CHARACTERISTIC DFES_DTCM.DFC_ComDcdcFltLvlRes_C "" VALUE 0x802492B6 Val_Wu16 65535.00 DFES_OneToOne 0.00 65535.00 FORMAT "%8.2" /end CHARACTERISTIC
/begin CHARACTERISTIC DFES_DTCM.DFC_ComDcdcMstBlink_C "" VALUE 0x802492B8 Val_Wu16 65535.00 DFES_OneToOne 0.00 65535.00 FORMAT "%8.2" /end CHARACTERISTIC
/begin CHARACTERISTIC DFES_DTCM.DFC_ComDcdcMstCont_C "" VALUE 0x802492BA Val_Wu16 65535.00 DFES_OneToOne 0.00 65535.00 FORMAT "%8.2" /end CHARACTERISTIC
/begin CHARACTERISTIC DFES_DTCM.DFC_ComDcdcSVSBlink_C "" VALUE 0x802492BC Val_Wu16 65535.00 DFES_OneToOne 0.00 65535.00 FORMAT "%8.2" /end CHARACTERISTIC
/begin CHARACTERISTIC DFES_DTCM.DFC_ComDcdcSVSCont_C "" VALUE 0x802492BE Val_Wu16 65535.00 DFES_OneToOne 0.00 65535.00 FORMAT "%8.2" /end CHARACTERISTIC
/begin CHARACTERISTIC DFES_DTCM.DFC_ComElMIIvtrFltLvl2_C "" VALUE 0x802492C0 Val_Wu16 65535.00 DFES_OneToOne 0.00 65535.00 FORMAT "%8.2" /end CHARACTERISTIC
/begin CHARACTERISTIC DFES_DTCM.DFC_ComElMIIvtrFltLvl3_C "" VALUE 0x802492C2 Val_Wu16 65535.00 DFES_OneToOne 0.00 65535.00 FORMAT "%8.2" /end CHARACTERISTIC
/begin CHARACTERISTIC DFES_DTCM.DFC_ComElMIIvtrFltLvl4_C "" VALUE 0x802492C4 Val_Wu16 65535.00 DFES_OneToOne 0.00 65535.00 FORMAT "%8.2" /end CHARACTERISTIC
/begin CHARACTERISTIC DFES_DTCM.DFC_ComElMIIvtrFltLvl5_C "" VALUE 0x802492C6 Val_Wu16 65535.00 DFES_OneToOne 0.00 65535.00 FORMAT "%8.2" /end CHARACTERISTIC
/begin CHARACTERISTIC DFES_DTCM.DFC_ComElMIIvtrFltLvlRes_C "" VALUE 0x802492C8 Val_Wu16 65535.00 DFES_OneToOne 0.00 65535.00 FORMAT "%8.2" /end CHARACTERISTIC
/begin CHARACTERISTIC DFES_DTCM.DFC_ComEmacEVBlink_C "" VALUE 0x802492CA Val_Wu16 65535.00 DFES_OneToOne 0.00 65535.00 FORMAT "%8.2" /end CHARACTERISTIC
/begin CHARACTERISTIC DFES_DTCM.DFC_ComEmacEVCont_C "" VALUE 0x802492CC Val_Wu16 65535.00 DFES_OneToOne 0.00 65535.00 FORMAT "%8.2" /end CHARACTERISTIC
/begin CHARACTERISTIC DFES_DTCM.DFC_ComEmacMstCont_C "" VALUE 0x802492CE Val_Wu16 65535.00 DFES_OneToOne 0.00 65535.00 FORMAT "%8.2" /end CHARACTERISTIC
/begin CHARACTERISTIC DFES_DTCM.DFC_ComEmacMsttBlink_C "" VALUE 0x802492D0 Val_Wu16 65535.00 DFES_OneToOne 0.00 65535.00 FORMAT "%8.2" /end CHARACTERISTIC
/begin CHARACTERISTIC DFES_DTCM.DFC_ComEmacSVSBlink_C "" VALUE 0x802492D2 Val_Wu16 65535.00 DFES_OneToOne 0.00 65535.00 FORMAT "%8.2" /end CHARACTERISTIC
/begin CHARACTERISTIC DFES_DTCM.DFC_ComEmacSVSCont_C "" VALUE 0x802492D4 Val_Wu16 65535.00 DFES_OneToOne 0.00 65535.00 FORMAT "%8.2" /end CHARACTERISTIC
/begin CHARACTERISTIC DFES_DTCM.DFC_ComGunCntInfoWkuReq_C "" VALUE 0x802492D6 Val_Wu16 65535.00 DFES_OneToOne 0.00 65535.00 FORMAT "%8.2" /end CHARACTERISTIC
/begin CHARACTERISTIC DFES_DTCM.DFC_ComHillHldFlt_C "" VALUE 0x802492D8 Val_Wu16 65535.00 DFES_OneToOne 0.00 65535.00 FORMAT "%8.2" /end CHARACTERISTIC
/begin CHARACTERISTIC DFES_DTCM.DFC_ComHvBattRchrgWkuReq_C "" VALUE 0x802492DA Val_Wu16 65535.00 DFES_OneToOne 0.00 65535.00 FORMAT "%8.2" /end CHARACTERISTIC
/begin CHARACTERISTIC DFES_DTCM.DFC_ComHvbFltLvl2_C "" VALUE 0x802492DC Val_Wu16 65535.00 DFES_OneToOne 0.00 65535.00 FORMAT "%8.2" /end CHARACTERISTIC
/begin CHARACTERISTIC DFES_DTCM.DFC_ComHvbFltLvl3_C "" VALUE 0x802492DE Val_Wu16 65535.00 DFES_OneToOne 0.00 65535.00 FORMAT "%8.2" /end CHARACTERISTIC
/begin CHARACTERISTIC DFES_DTCM.DFC_ComHvbFltLvl4_C "" VALUE 0x802492E0 Val_Wu16 65535.00 DFES_OneToOne 0.00 65535.00 FORMAT "%8.2" /end CHARACTERISTIC
/begin CHARACTERISTIC DFES_DTCM.DFC_ComHvbFltLvl5_C "" VALUE 0x802492E2 Val_Wu16 65535.00 DFES_OneToOne 0.00 65535.00 FORMAT "%8.2" /end CHARACTERISTIC
/begin CHARACTERISTIC DFES_DTCM.DFC_ComHvbFltLvlRes_C "" VALUE 0x802492E4 Val_Wu16 65535.00 DFES_OneToOne 0.00 65535.00 FORMAT "%8.2" /end CHARACTERISTIC
/begin CHARACTERISTIC DFES_DTCM.DFC_ComHvbMstBlink_C "" VALUE 0x802492E6 Val_Wu16 65535.00 DFES_OneToOne 0.00 65535.00 FORMAT "%8.2" /end CHARACTERISTIC
/begin CHARACTERISTIC DFES_DTCM.DFC_ComHvbMstCont_C "" VALUE 0x802492E8 Val_Wu16 65535.00 DFES_OneToOne 0.00 65535.00 FORMAT "%8.2" /end CHARACTERISTIC
/begin CHARACTERISTIC DFES_DTCM.DFC_ComImmoUnlockWkuReq_C "" VALUE 0x802492EA Val_Wu16 65535.00 DFES_OneToOne 0.00 65535.00 FORMAT "%8.2" /end CHARACTERISTIC
/begin CHARACTERISTIC DFES_DTCM.DFC_ComInfoReqPtlWkuReq_C "" VALUE 0x802492EC Val_Wu16 65535.00 DFES_OneToOne 0.00 65535.00 FORMAT "%8.2" /end CHARACTERISTIC
/begin CHARACTERISTIC DFES_DTCM.DFC_ComOBCFltLvl2_C "" VALUE 0x802492EE Val_Wu16 65535.00 DFES_OneToOne 0.00 65535.00 FORMAT "%8.2" /end CHARACTERISTIC
/begin CHARACTERISTIC DFES_DTCM.DFC_ComOBCFltLvl3_C "" VALUE 0x802492F0 Val_Wu16 65535.00 DFES_OneToOne 0.00 65535.00 FORMAT "%8.2" /end CHARACTERISTIC
/begin CHARACTERISTIC DFES_DTCM.DFC_ComOBCFltLvl4_C "" VALUE 0x802492F2 Val_Wu16 65535.00 DFES_OneToOne 0.00 65535.00 FORMAT "%8.2" /end CHARACTERISTIC
/begin CHARACTERISTIC DFES_DTCM.DFC_ComOBCFltLvl5_C "" VALUE 0x802492F4 Val_Wu16 65535.00 DFES_OneToOne 0.00 65535.00 FORMAT "%8.2" /end CHARACTERISTIC
/begin CHARACTERISTIC DFES_DTCM.DFC_ComOBCFltLvlRes_C "" VALUE 0x802492F6 Val_Wu16 65535.00 DFES_OneToOne 0.00 65535.00 FORMAT "%8.2" /end CHARACTERISTIC
/begin CHARACTERISTIC DFES_DTCM.DFC_ComPostOperationWkuReq_C "" VALUE 0x802492F8 Val_Wu16 65535.00 DFES_OneToOne 0.00 65535.00 FORMAT "%8.2" /end CHARACTERISTIC
/begin CHARACTERISTIC DFES_DTCM.DFC_ComPreCondElecWkuReq_C "" VALUE 0x802492FA Val_Wu16 65535.00 DFES_OneToOne 0.00 65535.00 FORMAT "%8.2" /end CHARACTERISTIC
/begin CHARACTERISTIC DFES_DTCM.DFC_ComRemUnlckWkuReq_C "" VALUE 0x802492FC Val_Wu16 65535.00 DFES_OneToOne 0.00 65535.00 FORMAT "%8.2" /end CHARACTERISTIC
/begin CHARACTERISTIC DFES_DTCM.DFC_ComStpDlyHMIWkuReq_C "" VALUE 0x802492FE Val_Wu16 65535.00 DFES_OneToOne 0.00 65535.00 FORMAT "%8.2" /end CHARACTERISTIC
/begin CHARACTERISTIC DFES_DTCM.DFC_ComflgCurMeasmtErr_C "" VALUE 0x80249300 Val_Wu16 65535.00 DFES_OneToOne 0.00 65535.00 FORMAT "%8.2" /end CHARACTERISTIC
/begin CHARACTERISTIC DFES_DTCM.DFC_ComflgCurMeasmtSysErr_C "" VALUE 0x80249302 Val_Wu16 65535.00 DFES_OneToOne 0.00 65535.00 FORMAT "%8.2" /end CHARACTERISTIC
/begin CHARACTERISTIC DFES_DTCM.DFC_ComflgCurMeasmtVld_C "" VALUE 0x80249304 Val_Wu16 65535.00 DFES_OneToOne 0.00 65535.00 FORMAT "%8.2" /end CHARACTERISTIC
/begin CHARACTERISTIC DFES_DTCM.DFC_ComflgCurRngErr_C "" VALUE 0x80249306 Val_Wu16 65535.00 DFES_OneToOne 0.00 65535.00 FORMAT "%8.2" /end CHARACTERISTIC
/begin CHARACTERISTIC DFES_DTCM.DFC_ComflgTPcbMeasmtErr_C "" VALUE 0x80249308 Val_Wu16 65535.00 DFES_OneToOne 0.00 65535.00 FORMAT "%8.2" /end CHARACTERISTIC
/begin CHARACTERISTIC DFES_DTCM.DFC_ComflgTPcbMeasmtVld_C "" VALUE 0x8024930A Val_Wu16 65535.00 DFES_OneToOne 0.00 65535.00 FORMAT "%8.2" /end CHARACTERISTIC
/begin CHARACTERISTIC DFES_DTCM.DFC_ComflgTPcbRngErr_C "" VALUE 0x8024930C Val_Wu16 65535.00 DFES_OneToOne 0.00 65535.00 FORMAT "%8.2" /end CHARACTERISTIC
/begin CHARACTERISTIC DFES_DTCM.DFC_ComflgTPcbSysErr_C "" VALUE 0x8024930E Val_Wu16 65535.00 DFES_OneToOne 0.00 65535.00 FORMAT "%8.2" /end CHARACTERISTIC
/begin CHARACTERISTIC DFES_DTCM.DFC_ComflgTShntMeasmtErr_C "" VALUE 0x80249310 Val_Wu16 65535.00 DFES_OneToOne 0.00 65535.00 FORMAT "%8.2" /end CHARACTERISTIC
/begin CHARACTERISTIC DFES_DTCM.DFC_ComflgTShntMeasmtVld_C "" VALUE 0x80249312 Val_Wu16 65535.00 DFES_OneToOne 0.00 65535.00 FORMAT "%8.2" /end CHARACTERISTIC
/begin CHARACTERISTIC DFES_DTCM.DFC_ComflgTShntRngErr_C "" VALUE 0x80249314 Val_Wu16 65535.00 DFES_OneToOne 0.00 65535.00 FORMAT "%8.2" /end CHARACTERISTIC
/begin CHARACTERISTIC DFES_DTCM.DFC_ComflgTShntSysErr_C "" VALUE 0x80249316 Val_Wu16 65535.00 DFES_OneToOne 0.00 65535.00 FORMAT "%8.2" /end CHARACTERISTIC
/begin CHARACTERISTIC DFES_DTCM.DFC_ComflgVoltMeasmtErr_C "" VALUE 0x80249318 Val_Wu16 65535.00 DFES_OneToOne 0.00 65535.00 FORMAT "%8.2" /end CHARACTERISTIC
/begin CHARACTERISTIC DFES_DTCM.DFC_ComflgVoltMeasmtSysErr_C "" VALUE 0x8024931A Val_Wu16 65535.00 DFES_OneToOne 0.00 65535.00 FORMAT "%8.2" /end CHARACTERISTIC
/begin CHARACTERISTIC DFES_DTCM.DFC_ComflgVoltMeasmtVld_C "" VALUE 0x8024931C Val_Wu16 65535.00 DFES_OneToOne 0.00 65535.00 FORMAT "%8.2" /end CHARACTERISTIC
/begin CHARACTERISTIC DFES_DTCM.DFC_ComflgVoltRngErr_C "" VALUE 0x8024931E Val_Wu16 65535.00 DFES_OneToOne 0.00 65535.00 FORMAT "%8.2" /end CHARACTERISTIC
/begin CHARACTERISTIC DFES_DTCM.DFC_CrashEveOcc_C "" VALUE 0x80249320 Val_Wu16 65535.00 DFES_OneToOne 0.00 65535.00 FORMAT "%8.2" /end CHARACTERISTIC
/begin CHARACTERISTIC DFES_DTCM.DFC_DcdcFwdModStuck_C "" VALUE 0x80249322 Val_Wu16 65535.00 DFES_OneToOne 0.00 65535.00 FORMAT "%8.2" /end CHARACTERISTIC
/begin CHARACTERISTIC DFES_DTCM.DFC_DcdcLvUDifMaxFlt_C "" VALUE 0x80249324 Val_Wu16 65535.00 DFES_OneToOne 0.00 65535.00 FORMAT "%8.2" /end CHARACTERISTIC
/begin CHARACTERISTIC DFES_DTCM.DFC_DcdcOffModStuck_C "" VALUE 0x80249326 Val_Wu16 65535.00 DFES_OneToOne 0.00 65535.00 FORMAT "%8.2" /end CHARACTERISTIC
/begin CHARACTERISTIC DFES_DTCM.DFC_DcdcOperModFailr_C "" VALUE 0x80249328 Val_Wu16 65535.00 DFES_OneToOne 0.00 65535.00 FORMAT "%8.2" /end CHARACTERISTIC
/begin CHARACTERISTIC DFES_DTCM.DFC_DcdcPrecModStuck_C "" VALUE 0x8024932A Val_Wu16 65535.00 DFES_OneToOne 0.00 65535.00 FORMAT "%8.2" /end CHARACTERISTIC
/begin CHARACTERISTIC DFES_DTCM.DFC_DrvDoorOpn_C "" VALUE 0x8024932C Val_Wu16 65535.00 DFES_OneToOne 0.00 65535.00 FORMAT "%8.2" /end CHARACTERISTIC
/begin CHARACTERISTIC DFES_DTCM.DFC_DrvModPosnDfct_C "" VALUE 0x8024932E Val_Wu16 65535.00 DFES_OneToOne 0.00 65535.00 FORMAT "%8.2" /end CHARACTERISTIC
/begin CHARACTERISTIC DFES_DTCM.DFC_DrvStbltOpn_C "" VALUE 0x80249330 Val_Wu16 65535.00 DFES_OneToOne 0.00 65535.00 FORMAT "%8.2" /end CHARACTERISTIC
/begin CHARACTERISTIC DFES_DTCM.DFC_ETogFailrLvl3_C "" VALUE 0x80249332 Val_Wu16 65535.00 DFES_OneToOne 0.00 65535.00 FORMAT "%8.2" /end CHARACTERISTIC
/begin CHARACTERISTIC DFES_DTCM.DFC_ETogFailrLvl4_C "" VALUE 0x80249334 Val_Wu16 65535.00 DFES_OneToOne 0.00 65535.00 FORMAT "%8.2" /end CHARACTERISTIC
/begin CHARACTERISTIC DFES_DTCM.DFC_EbsLvBattSocDiagLo_C "" VALUE 0x80249336 Val_Wu16 65535.00 DFES_OneToOne 0.00 65535.00 FORMAT "%8.2" /end CHARACTERISTIC
/begin CHARACTERISTIC DFES_DTCM.DFC_EbsLvBattUDiagDiOper_C "" VALUE 0x80249338 Val_Wu16 65535.00 DFES_OneToOne 0.00 65535.00 FORMAT "%8.2" /end CHARACTERISTIC
/begin FUNCTION DFES "30000.70.0Diagnostic Fault Event Storage"
 /begin DEF_CHARACTERISTIC DFES_Cls.DFC_HvBattMaiSwtWldd_C DFES_Cls.DFC_HvBattNegCntctrCntErr_C DFES_Cls.DFC_HvBattOperModChrgPlausy_C DFES_Cls.DFC_HvBattOverTDern_C DFES_Cls.DFC_HvBattPosCntctrCntErr_C DFES_Cls.DFC_HvBattPrecCntctrCntErr_C DFES_Cls.DFC_HvBattPwrDistbnTDern_C DFES_Cls.DFC_HvBattPwrDistbnTInhbn_C DFES_Cls.DFC_HvBattRatRSohErr_C DFES_Cls.DFC_HvBattRatSohErr_C DFES_Cls.DFC_HvBattSngIsoWarn_C DFES_Cls.DFC_HvBattSrvPlgDiscnct_C DFES_Cls.DFC_HvBattUNomChrgnErr_C DFES_Cls.DFC_HvBattUNomChrgnIni_C DFES_Cls.DFC_HvBattUnderTDern_C DFES_Cls.DFC_HvbEVLmpBlink_C DFES_Cls.DFC_HvbEVLmpCont_C DFES_Cls.DFC_HvbSVSBlink_C DFES_Cls.DFC_HvbSVSCont_C DFES_Cls.DFC_InmLINBusBlk_C DFES_Cls.DFC_PDUProgmFailr_C DFES_Cls.DFC_PEnvSigRngMax_C DFES_Cls.DFC_PEnvSigRngMin_C DFES_Cls.DFC_PLnCChpDeactvnFaild_C DFES_Cls.DFC_PrkgBrkFailr_C DFES_Cls.DFC_PtSysLimErr_C DFES_Cls.DFC_PwrMaxDchaShoLo_C DFES_Cls.DFC_SCtPmp1FailSafeNotSuc_C DFES_Cls.DFC_SCtPmp1SCG_C DFES_Cls.DFC_VehCoornDrvrNotPrsnt_C DFES_Cls.DFC_VehVCanAvl_C DFES_Cls.DFC_VehVCanErr_C DFES_Cls.DFC_eTogFailrLvlRes_C DFES_Cls.DFC_flgBrkMaiDiag_C DFES_Cls.DFC_stHvbIsoMeasmtRes_C DFES_Cls.DFC_BrkBstPmpPLeakDfct_C DFES_Cls.DFC_Com082hTooShort_C DFES_Cls.DFC_Com092hTooShort_C DFES_Cls.DFC_Com205hAbsent_C DFES_Cls.DFC_Com205hChecksum_C DFES_Cls.DFC_Com205hCounter_C DFES_Cls.DFC_Com205hTooShort_C DFES_Cls.DFC_Com217hAbsent_C DFES_Cls.DFC_Com217hChecksum_C DFES_Cls.DFC_Com217hCounter_C DFES_Cls.DFC_Com217hTooShort_C DFES_Cls.DFC_Com227hAbsent_C DFES_Cls.DFC_Com227hTooShort_C DFES_Cls.DFC_Com237hAbsent_C DFES_Cls.DFC_Com237hChecksum_C DFES_Cls.DFC_Com237hCounter_C DFES_Cls.DFC_Com237hTooShort_C DFES_Cls.DFC_Com259hAbsent_C DFES_Cls.DFC_Com259hChecksum_C DFES_Cls.DFC_Com259hCounter_C DFES_Cls.DFC_Com259hTooShort_C DFES_Cls.DFC_Com26hAbsent_C DFES_Cls.DFC_Com26hTooShort_C DFES_Cls.DFC_Com273hAbsent_C DFES_Cls.DFC_Com273hChecksum_C DFES_Cls.DFC_Com273hCounter_C DFES_Cls.DFC_Com273hTooShort_C DFES_Cls.DFC_Com275hAbsent_C DFES_Cls.DFC_Com275hChecksum_C DFES_Cls.DFC_Com275hCounter_C DFES_Cls.DFC_Com275hTooShort_C DFES_Cls.DFC_Com283hAbsent_C DFES_Cls.DFC_Com283hTooShort_C DFES_Cls.DFC_Com285hAbsent_C DFES_Cls.DFC_Com285hChecksum_C DFES_Cls.DFC_Com285hCounter_C DFES_Cls.DFC_Com285hTooShort_C DFES_Cls.DFC_Com293hAbsent_C DFES_Cls.DFC_Com293hChecksum_C DFES_Cls.DFC_Com293hCounter_C DFES_Cls.DFC_Com293hTooShort_C DFES_Cls.DFC_Com308hAbsent_C DFES_Cls.DFC_Com308hChecksum_C DFES_Cls.DFC_Com308hCounter_C DFES_Cls.DFC_Com308hTooShort_C DFES_Cls.DFC_Com318hAbsent_C DFES_Cls.DFC_Com318hChecksum_C DFES_Cls.DFC_Com318hCounter_C DFES_Cls.DFC_Com318hTooShort_C DFES_Cls.DFC_Com325hAbsent_C DFES_Cls.DFC_Com325hChecksum_C DFES_Cls.DFC_Com325hCounter_C DFES_Cls.DFC_Com325hTooShort_C DFES_Cls.DFC_Com335hAbsent_C DFES_Cls.DFC_Com335hChecksum_C DFES_Cls.DFC_Com335hCounter_C DFES_Cls.DFC_Com335hTooShort_C DFES_Cls.DFC_Com351hAbsent_C DFES_Cls.DFC_Com351hTooShort_C DFES_Cls.DFC_Com38DhAbsent_C DFES_Cls.DFC_Com38DhChecksum_C DFES_Cls.DFC_Com38DhCounter_C DFES_Cls.DFC_Com38DhTooShort_C DFES_Cls.DFC_Com412hAbsent_C DFES_Cls.DFC_Com412hChecksum_C DFES_Cls.DFC_Com412hCounter_C DFES_Cls.DFC_Com412hTooShort_C DFES_Cls.DFC_Com427hAbsent_C DFES_Cls.DFC_Com427hTooShort_C DFES_Cls.DFC_Com432hAbsent_C DFES_Cls.DFC_Com432hChecksum_C DFES_Cls.DFC_Com432hCounter_C DFES_Cls.DFC_Com432hTooShort_C DFES_Cls.DFC_Com435hAbsent_C DFES_Cls.DFC_Com435hTooShort_C DFES_Cls.DFC_Com442hAbsent_C DFES_Cls.DFC_Com442hTooShort_C DFES_Cls.DFC_Com453hAbsent_C DFES_Cls.DFC_Com453hTooShort_C DFES_Cls.DFC_Com455hAbsent_C DFES_Cls.DFC_Com455hTooShort_C DFES_Cls.DFC_Com463hAbsent_C DFES_Cls.DFC_Com463hTooShort_C DFES_Cls.DFC_Com473hAbsent_C DFES_Cls.DFC_Com473hTooShort_C DFES_Cls.DFC_Com47BhAbsent_C DFES_Cls.DFC_Com47BhTooShort_C DFES_Cls.DFC_Com48BhAbsent_C DFES_Cls.DFC_Com48BhTooShort_C DFES_Cls.DFC_Com497hTooShort_C DFES_Cls.DFC_Com4F2hAbsent_C DFES_Cls.DFC_Com4F2hChecksum_C DFES_Cls.DFC_Com4F2hCounter_C DFES_Cls.DFC_Com4F2hTooShort_C DFES_Cls.DFC_Com50DhAbsent_C DFES_Cls.DFC_Com50DhTooShort_C DFES_Cls.DFC_Com535hAbsent_C DFES_Cls.DFC_Com535hTooShort_C DFES_Cls.DFC_Com543hAbsent_C DFES_Cls.DFC_Com543hTooShort_C DFES_Cls.DFC_Com552hAbsent_C DFES_Cls.DFC_Com552hTooShort_C DFES_Cls.DFC_Com583hAbsent_C DFES_Cls.DFC_Com583hTooShort_C DFES_Cls.DFC_Com592hAbsent_C DFES_Cls.DFC_Com592hChecksum_C DFES_Cls.DFC_Com592hCounter_C DFES_Cls.DFC_Com592hTooShort_C DFES_Cls.DFC_Com595hAbsent_C DFES_Cls.DFC_Com595hChecksum_C DFES_Cls.DFC_Com595hCounter_C DFES_Cls.DFC_Com595hTooShort_C DFES_Cls.DFC_Com5B2hAbsent_C DFES_Cls.DFC_Com5B2hTooShort_C DFES_Cls.DFC_Com5B5hAbsent_C DFES_Cls.DFC_Com5B5hChecksum_C DFES_Cls.DFC_Com5B5hCounter_C DFES_Cls.DFC_Com5B5hTooShort_C DFES_Cls.DFC_Com5C7hTooShort_C DFES_Cls.DFC_Com5E7hAbsent_C DFES_Cls.DFC_Com5E7hTooShort_C DFES_Cls.DFC_Com635hTooShort_C DFES_Cls.DFC_Com645hTooShort_C DFES_Cls.DFC_Com663hAbsent_C DFES_Cls.DFC_Com663hTooShort_C DFES_Cls.DFC_Com665hAbsent_C DFES_Cls.DFC_Com665hTooShort_C DFES_Cls.DFC_Com675hAbsent_C DFES_Cls.DFC_Com675hTooShort_C DFES_Cls.DFC_ComFrbd_205h_HVBAT_PACK_CURRENT_C DFES_Cls.DFC_ComFrbd_205h_HVBAT_SOC_DISPLAY_C DFES_Cls.DFC_ComFrbd_205h_HVBAT_VOLTAGE_C DFES_Cls.DFC_ComFrbd_217h_INV_DC_BUS_VOLTAGE_C DFES_Cls.DFC_ComFrbd_217h_INV_MTR_ACTUAL_TRQ_C DFES_Cls.DFC_ComFrbd_217h_INV_MTR_SPEED_C DFES_Cls.DFC_ComFrbd_217h_INV_MTR_TRQ_C DFES_Cls.DFC_ComFrbd_227h_INV_DC_CURRENT_C DFES_Cls.DFC_ComFrbd_227h_INV_MOTORING_PEAK_TRQ_C DFES_Cls.DFC_ComFrbd_227h_INV_MTR_INST_INPUT_POWER_C DFES_Cls.DFC_ComFrbd_227h_INV_REGEN_PEAK_TRQ_C DFES_Cls.DFC_ComFrbd_237h_INV_ACTIVE_DISCHARGE_STATUS_C DFES_Cls.DFC_ComFrbd_237h_INV_CTRL_MODE_ACK_C DFES_Cls.DFC_ComFrbd_237h_INV_EV_WARNING_C DFES_Cls.DFC_ComFrbd_237h_INV_FAULT_LEVEL_C DFES_Cls.DFC_ComFrbd_237h_INV_MASTER_STOP_C DFES_Cls.DFC_ComFrbd_237h_INV_SERVICE_DUE_C DFES_Cls.DFC_ComFrbd_237h_INV_STAB_MIN_TRQ_C DFES_Cls.DFC_ComFrbd_259h_TGLM_FAILURE_STATE_C DFES_Cls.DFC_ComFrbd_259h_TGLM_MODE_PUSH_C DFES_Cls.DFC_ComFrbd_259h_TOGGLE_MONOSTABLE_POS_C DFES_Cls.DFC_ComFrbd_273h_OBC_outputpower_capability_C DFES_Cls.DFC_ComFrbd_275h_HVBAT_DISCHARGE_30S_AVAILABLE_CURRENT_C DFES_Cls.DFC_ComFrbd_275h_HVBAT_DISCHARGE_30S_AVAILABLE_POWER_C DFES_Cls.DFC_ComFrbd_283h_DCDC_IN_CURRENT_C DFES_Cls.DFC_ComFrbd_283h_DCDC_IN_VOLTAGE_C DFES_Cls.DFC_ComFrbd_283h_DCDC_OUT_CURRENT_C DFES_Cls.DFC_ComFrbd_283h_DCDC_OUT_VOLTAGE_C DFES_Cls.DFC_ComFrbd_285h_HVBAT_REGEN_CHG_30S_CURRENT_LIMIT_C DFES_Cls.DFC_ComFrbd_285h_HVBAT_REGEN_CHRG_30S_POWER_LIMIT_C DFES_Cls.DFC_ComFrbd_293h_DCDC_outputpower_capability_C DFES_Cls.DFC_ComFrbd_325h_HVBAT_INSULATION_RESISTANCE_C DFES_Cls.DFC_ComFrbd_325h_HVBAT_TEMPERATURE_C DFES_Cls.DFC_ComFrbd_335h_HVBAT_CHRG_CONTINUOUS_CURR_MAX_C DFES_Cls.DFC_ComFrbd_335h_HVBAT_CHRG_COTINUOUS_CURR_REQ_C DFES_Cls.DFC_ComFrbd_335h_HVBAT_CHRG_MAX_VOLT_C DFES_Cls.DFC_ComFrbd_335h_HVBAT_DC_BUS_VOLTAGE_C DFES_Cls.DFC_ComFrbd_427h_INV_OP_MODE_C DFES_Cls.DFC_ComFrbd_427h_INV_PERMISIBLE_TORQUE_C DFES_Cls.DFC_ComFrbd_435h_HVBAT_MAX_CELL_VOLT_C DFES_Cls.DFC_ComFrbd_435h_HVBAT_MAX_CELL_VOLT_NUM_C DFES_Cls.DFC_ComFrbd_435h_HVBAT_MAX_SENSOR_TEMP_C DFES_Cls.DFC_ComFrbd_435h_HVBAT_MIN_CELL_VOLT_C DFES_Cls.DFC_ComFrbd_435h_HVBAT_MIN_CELL_VOLT_NUM_C DFES_Cls.DFC_ComFrbd_453h_OBC_IN_CURRENT_C DFES_Cls.DFC_ComFrbd_453h_OBC_IN_VOLTAGE_C DFES_Cls.DFC_ComFrbd_453h_OBC_IP_POWER_C DFES_Cls.DFC_ComFrbd_455h_HVBAT_NOMINAL_VOLTAGE_C DFES_Cls.DFC_ComFrbd_463h_OBC_OUT_CURRENT_C DFES_Cls.DFC_ComFrbd_463h_OBC_OUT_VOLTAGE_C DFES_Cls.DFC_ComFrbd_463h_OBC_TEMPERATURE_C DFES_Cls.DFC_ComFrbd_473h_DCDC_Coolant_Temperature_C DFES_Cls.DFC_ComFrbd_473h_DCDC_TEMPERATURE_C DFES_Cls.DFC_ComFrbd_47Bh_eCOMP_BusBarCurrent_C DFES_Cls.DFC_ComFrbd_47Bh_eCOMP_BusBarVoltage_C DFES_Cls.DFC_ComFrbd_47Bh_eCOMP_CompressorSpeed_C DFES_Cls.DFC_ComFrbd_47Bh_eCOMP_IGBT_Temp_C DFES_Cls.DFC_ComFrbd_47Bh_eCOMP_PeakPhaCurrent_C DFES_Cls.DFC_ComFrbd_47Bh_eCOMP_Power_consumption_C DFES_Cls.DFC_ComFrbd_48Bh_eCOMP_Fault_Level_C DFES_Cls.DFC_ComFrbd_4F2h_VALEUR_SOC_ETENDUE_C DFES_Cls.DFC_ComFrbd_535h_HV_BATT_TEMP_AVG_C DFES_Cls.DFC_ComFrbd_543h_HVBAT_RESTBATTENERGY_C DFES_Cls.DFC_ComFrbd_543h_HVBAT_SOH_C DFES_Cls.DFC_ComFrbd_543h_HV_BATT_SOH_RES_C DFES_Cls.DFC_ComFrbd_592h_IBATT_1_C DFES_Cls.DFC_ComFrbd_592h_IBATT_2_C DFES_Cls.DFC_ComFrbd_592h_IBATT_3_C DFES_Cls.DFC_ComFrbd_592h_TEMP_BATT_C DFES_Cls.DFC_ComFrbd_592h_U_BATT_BECB_C DFES_Cls.DFC_ComFrbd_595h_HVBAT_TIME_TO_CHRG_80_C DFES_Cls.DFC_ComFrbd_5B2h_TEMP_AIR_EXT_C DFES_Cls.DFC_ComFrbd_635h_HVBAT_NEG_CONT_COUNT_SEG1_C DFES_Cls.DFC_ComFrbd_635h_HVBAT_NEG_CONT_COUNT_SEG3_C DFES_Cls.DFC_ComFrbd_635h_HVBAT_NEG_CONT_COUNT_SEG4_C DFES_Cls.DFC_ComFrbd_635h_HVBAT_PST_CONT_COUNT_SEG1_C DFES_Cls.DFC_ComFrbd_635h_HVBAT_PST_CONT_COUNT_SEG3_C DFES_Cls.DFC_ComFrbd_635h_HVBAT_PST_CONT_COUNT_SEG4_C DFES_Cls.DFC_ComFrbd_645h_HVBAT_PRECHRGE_CONT_COUNT_SEG1_C DFES_Cls.DFC_ComFrbd_645h_HVBAT_PRECHRGE_CONT_COUNT_SEG2_C DFES_Cls.DFC_ComFrbd_675h_HVBAT_REMAININGBATTCAPACITY_C DFES_Cls.DFC_ComInvld_205h_HVBAT_CHARGING_STATUS_C DFES_Cls.DFC_ComInvld_205h_HVBAT_PACK_CURRENT_C DFES_Cls.DFC_ComInvld_205h_HVBAT_SOC_DISPLAY_C DFES_Cls.DFC_ComInvld_205h_HVBAT_VOLTAGE_C DFES_Cls.DFC_ComInvld_217h_INV_DC_BUS_VOLTAGE_C DFES_Cls.DFC_ComInvld_217h_INV_MTR_ACTUAL_TRQ_C DFES_Cls.DFC_ComInvld_217h_INV_MTR_SPEED_C DFES_Cls.DFC_ComInvld_217h_INV_MTR_TRQ_C DFES_Cls.DFC_ComInvld_227h_INV_DC_CURRENT_C DFES_Cls.DFC_ComInvld_227h_INV_MOTORING_PEAK_TRQ_C DFES_Cls.DFC_ComInvld_227h_INV_MTR_INST_INPUT_POWER_C DFES_Cls.DFC_ComInvld_227h_INV_REGEN_PEAK_TRQ_C DFES_Cls.DFC_ComInvld_237h_INV_ACTIVE_DISCHARGE_STATUS_C DFES_Cls.DFC_ComInvld_237h_INV_FAULT_LEVEL_C DFES_Cls.DFC_ComInvld_237h_INV_STAB_MIN_TRQ_C DFES_Cls.DFC_ComInvld_259h_TGLM_MODE_PUSH_C DFES_Cls.DFC_ComInvld_259h_TOGGLE_MONOSTABLE_POS_C DFES_Cls.DFC_ComInvld_26h_AC_SWITCH_REQ_C DFES_Cls.DFC_ComInvld_26h_BLOWER_POSITION_C DFES_Cls.DFC_ComInvld_26h_EVAP_SENSOR_FAULT_C DFES_Cls.DFC_ComInvld_26h_EVAP_SENSOR_VALUE_C DFES_Cls.DFC_ComInvld_26h_POTENTIOMETER_FAULT_C DFES_Cls.DFC_ComInvld_26h_REAR_DEFOG_REQ_C DFES_Cls.DFC_ComInvld_26h_TEMP_POSITION_C DFES_Cls.DFC_ComInvld_273h_OBC_FAULT_LEVEL_C DFES_Cls.DFC_ComInvld_273h_OBC_outputpower_capability_C DFES_Cls.DFC_ComInvld_275h_HVBAT_DISCHARGE_30S_AVAILABLE_CURRENT_C DFES_Cls.DFC_ComInvld_275h_HVBAT_DISCHARGE_30S_AVAILABLE_POWER_C DFES_Cls.DFC_ComInvld_283h_DCDC_IN_CURRENT_C DFES_Cls.DFC_ComInvld_283h_DCDC_IN_VOLTAGE_C DFES_Cls.DFC_ComInvld_283h_DCDC_OUT_CURRENT_C DFES_Cls.DFC_ComInvld_283h_DCDC_OUT_VOLTAGE_C DFES_Cls.DFC_ComInvld_285h_HVBAT_REGEN_CHG_30S_CURRENT_LIMIT_C DFES_Cls.DFC_ComInvld_285h_HVBAT_REGEN_CHRG_30S_POWER_LIMIT_C DFES_Cls.DFC_ComInvld_293h_DCDC_FAULT_LEVEL_C DFES_Cls.DFC_ComInvld_293h_DCDC_outputpower_capability_C DFES_Cls.DFC_ComInvld_325h_HVBAT_EPLUG_STATUS_C DFES_Cls.DFC_ComInvld_325h_HVBAT_HVIL_STS_C DFES_Cls.DFC_ComInvld_325h_HVBAT_INSULATION_FAULT_C DFES_Cls.DFC_ComInvld_325h_HVBAT_INSULATION_RESISTANCE_C DFES_Cls.DFC_ComInvld_325h_HVBAT_TEMPERATURE_C DFES_Cls.DFC_ComInvld_335h_HVBAT_CHRG_CONTINUOUS_CURR_MAX_C DFES_Cls.DFC_ComInvld_335h_HVBAT_CHRG_COTINUOUS_CURR_REQ_C DFES_Cls.DFC_ComInvld_335h_HVBAT_CHRG_MAX_VOLT_C DFES_Cls.DFC_ComInvld_335h_HVBAT_DC_BUS_VOLTAGE_C DFES_Cls.DFC_ComInvld_38Dh_VITESSE_VEHICULE_ROUES_C DFES_Cls.DFC_ComInvld_38Dh_VVH_INDISP_C DFES_Cls.DFC_ComInvld_427h_INV_COOLANT_TEMP_C DFES_Cls.DFC_ComInvld_427h_INV_MOTOR_TEMP_C DFES_Cls.DFC_ComInvld_427h_INV_OP_MODE_C DFES_Cls.DFC_ComInvld_427h_INV_PERMISIBLE_TORQUE_C DFES_Cls.DFC_ComInvld_427h_INV_TEMP_C DFES_Cls.DFC_ComInvld_432h_REVEIL_PRINCIPAL_C DFES_Cls.DFC_ComInvld_435h_HVBAT_MAX_CELL_VOLT_C DFES_Cls.DFC_ComInvld_435h_HVBAT_MAX_CELL_VOLT_NUM_C DFES_Cls.DFC_ComInvld_435h_HVBAT_MAX_SENSOR_TEMP_C DFES_Cls.DFC_ComInvld_435h_HVBAT_MIN_CELL_VOLT_C DFES_Cls.DFC_ComInvld_435h_HVBAT_MIN_CELL_VOLT_NUM_C DFES_Cls.DFC_ComInvld_442h_BCCM_BLOWER_RELAY_STS_C DFES_Cls.DFC_ComInvld_453h_OBC_IN_CURRENT_C DFES_Cls.DFC_ComInvld_453h_OBC_IN_VOLTAGE_C DFES_Cls.DFC_ComInvld_453h_OBC_IP_POWER_C DFES_Cls.DFC_ComInvld_455h_HVBAT_NOMINAL_VOLTAGE_C DFES_Cls.DFC_ComInvld_463h_OBC_OUT_CURRENT_C DFES_Cls.DFC_ComInvld_463h_OBC_OUT_VOLTAGE_C DFES_Cls.DFC_ComInvld_463h_OBC_TEMPERATURE_C DFES_Cls.DFC_ComInvld_473h_DCDC_Coolant_Temperature_C DFES_Cls.DFC_ComInvld_473h_DCDC_TEMPERATURE_C DFES_Cls.DFC_ComInvld_47Bh_eCOMP_BusBarCurrent_C DFES_Cls.DFC_ComInvld_47Bh_eCOMP_BusBarVoltage_C DFES_Cls.DFC_ComInvld_47Bh_eCOMP_CompressorSpeed_C DFES_Cls.DFC_ComInvld_47Bh_eCOMP_IGBT_Temp_C DFES_Cls.DFC_ComInvld_47Bh_eCOMP_PeakPhaCurrent_C DFES_Cls.DFC_ComInvld_47Bh_eCOMP_Power_consumption_C DFES_Cls.DFC_ComInvld_4F2h_STATUS_SOC_C DFES_Cls.DFC_ComInvld_4F2h_TEMP_BATT_STATUS_C DFES_Cls.DFC_ComInvld_4F2h_VALEUR_SOC_ETENDUE_C DFES_Cls.DFC_ComInvld_535h_HV_BATT_TEMP_AVG_C DFES_Cls.DFC_ComInvld_543h_HVBAT_RESTBATTENERGY_C DFES_Cls.DFC_ComInvld_543h_HVBAT_SOH_C DFES_Cls.DFC_ComInvld_543h_HV_BATT_SOH_RES_C DFES_Cls.DFC_ComInvld_552h_CPT_TEMPOREL_C DFES_Cls.DFC_ComInvld_552h_KILOMETRAGE_C DFES_Cls.DFC_ComInvld_583h_HV_BATT_DISCONT_CSE_OPEN_C DFES_Cls.DFC_ComInvld_592h_CALIBRE_IBATT_C DFES_Cls.DFC_ComInvld_592h_IBATT_1_C DFES_Cls.DFC_ComInvld_592h_IBATT_2_C DFES_Cls.DFC_ComInvld_592h_IBATT_3_C DFES_Cls.DFC_ComInvld_592h_TEMP_BATT_C DFES_Cls.DFC_ComInvld_592h_U_BATT_BECB_C DFES_Cls.DFC_ComInvld_595h_HVBAT_TIME_TO_CHRG_80_C DFES_Cls.DFC_ComInvld_5B2h_TEMP_AIR_EXT_C DFES_Cls.DFC_ComInvld_5B5h_HVBAT_THERMAL_RUNAWAY_C DFES_Cls.DFC_ComInvld_635h_HVBAT_NEG_CONT_COUNT_SEG1_C DFES_Cls.DFC_ComInvld_635h_HVBAT_NEG_CONT_COUNT_SEG3_C DFES_Cls.DFC_ComInvld_635h_HVBAT_NEG_CONT_COUNT_SEG4_C DFES_Cls.DFC_ComInvld_635h_HVBAT_PST_CONT_COUNT_SEG1_C DFES_Cls.DFC_ComInvld_635h_HVBAT_PST_CONT_COUNT_SEG3_C DFES_Cls.DFC_ComInvld_635h_HVBAT_PST_CONT_COUNT_SEG4_C DFES_Cls.DFC_ComInvld_645h_HVBAT_PRECHRGE_CONT_COUNT_SEG1_C DFES_Cls.DFC_ComInvld_645h_HVBAT_PRECHRGE_CONT_COUNT_SEG2_C DFES_Cls.DFC_ComInvld_675h_HVBAT_REMAININGBATTCAPACITY_C DFES_Cls.DFC_ACCmprFltLvl1_C DFES_Cls.DFC_ACCmprFltLvl2_C DFES_Cls.DFC_ACCmprFltLvl3_C DFES_Cls.DFC_ACCmprFltLvl4_C DFES_Cls.DFC_ACCmprHiPFlt_C DFES_Cls.DFC_ACCmprInvldCmprSt_C DFES_Cls.DFC_ACCmprInvldElecActPwr_C DFES_Cls.DFC_ACCmprLoPFlt_C DFES_Cls.DFC_AcChrgrIntkTSRCMin_C DFES_Cls.DFC_BattUBMaxBatt_C DFES_Cls.DFC_BattUBMaxNoBatt_C DFES_Cls.DFC_BattUBMinBatt_C DFES_Cls.DFC_BattUBMinNoBatt_C DFES_Cls.DFC_BattUSRCMax_C DFES_Cls.DFC_BattUSRCMin_C DFES_Cls.DFC_BrkBstPHiCautionDfct_C DFES_Cls.DFC_BrkBstPHiWarnDfct_C DFES_Cls.DFC_BrkBstPSnsr12PlausDfct_C DFES_Cls.DFC_BrkBstPSnsr1Scb_C DFES_Cls.DFC_BrkBstPSnsr1Scg_C DFES_Cls.DFC_BrkBstPSnsr2Scb_C DFES_Cls.DFC_BrkBstPSnsr2Scg_C DFES_Cls.DFC_BrkBstPSnsrMax_C DFES_Cls.DFC_BrkBstPSnsrMin_C DFES_Cls.DFC_BrkBstPhyRngChkMax_C DFES_Cls.DFC_BrkBstPhyRngChkMin_C DFES_Cls.DFC_BrkBstPmpHsScb_C DFES_Cls.DFC_BrkBstPmpHsScg_C DFES_Cls.DFC_BrkBstPmpLsOl_C DFES_Cls.DFC_BrkBstPmpLsScb_C DFES_Cls.DFC_BrkBstPmpLsScg_C DFES_Cls.DFC_CbnHeatgHeatrRlyOpend_C DFES_Cls.DFC_CbnHeatgHeatrRlyWldd_C DFES_Cls.DFC_CcsDcIBattExcdd_C DFES_Cls.DFC_CcsDcIEvseOutDe_C DFES_Cls.DFC_CcsDcIOutDe_C DFES_Cls.DFC_CcsDcIOutExcdd_C DFES_Cls.DFC_CcsDcUOutDe_C DFES_Cls.DFC_CcsDcUOutExcdd_C DFES_Cls.DFC_CcsPwrLineChpRstOL_C DFES_Cls.DFC_CcsPwrLineChpRstOvrTemp_C DFES_Cls.DFC_CcsPwrLineChpRstSCB_C DFES_Cls.DFC_CcsPwrLineChpRstSCG_C DFES_Cls.DFC_CcsPwrLineChpVccEnaOL_C DFES_Cls.DFC_CcsPwrLineChpVccEnaOvrTemp_C DFES_Cls.DFC_CcsPwrLineChpVccEnaSCB_C DFES_Cls.DFC_CcsPwrLineChpVccEnaSCG_C DFES_Cls.DFC_CcsPwrLineChpVccSRCMin_C DFES_Cls.DFC_CcsPwrLineComChpTSRCMin_C DFES_Cls.DFC_CtPSwtActrOL_C DFES_Cls.DFC_CtPSwtActrOvrTemp_C DFES_Cls.DFC_CtPSwtActrSCB_C DFES_Cls.DFC_CtPSwtActrSCG_C DFES_Cls.DFC_CtPSwtDiagSRCMin_C DFES_Cls.DFC_CtpCarrFrqSRCMin_C DFES_Cls.DFC_DcChrgrIntkT2SRCMin_C DFES_Cls.DFC_DcChrgrIntkTSRCMin_C DFES_Cls.DFC_DevLibBattUHi_C DFES_Cls.DFC_DevLibBattULo_C DFES_Cls.DFC_EmWakeupSigOL_C DFES_Cls.DFC_EmWakeupSigOvrTemp_C DFES_Cls.DFC_EmWakeupSigSCB_C DFES_Cls.DFC_EmWakeupSigSCG_C DFES_Cls.DFC_Fan1OL_C DFES_Cls.DFC_Fan1OvrTemp_C DFES_Cls.DFC_Fan1SCB_C DFES_Cls.DFC_FanRlySCB_C DFES_Cls.DFC_FanRlySCG_C DFES_Cls.DFC_FanSpdSRCMin_C DFES_Cls.DFC_FreonPSRCMin_C DFES_Cls.DFC_HLCCcsPLnCChipTHi_C DFES_Cls.DFC_HeatrCoreTSRCMin_C DFES_Cls.DFC_PwmCtPSRCMin_C DFES_Cls.DFC_PwrDistbnUnitTSRCMin_C DFES_Cls.DFC_SCtPmp1OL_C DFES_Cls.DFC_SCtPmp1OvrTemp_C DFES_Cls.DFC_SCtPmp1SCB_C DFES_Cls.DFC_SCtPmpRlyOL_C DFES_Cls.DFC_SCtPmpRlyOvrTemp_C DFES_Cls.DFC_SCtPmpRlySCB_C DFES_Cls.DFC_SpplCooltPmpRlyOL_C DFES_Cls.DFC_SpplCooltPmpRlyOvrTemp_C DFES_Cls.DFC_SpplCooltPmpRlySCB_C DFES_Cls.DFC_UCtPSRCMin_C DFES_Cls.DFC_UPxP1SRCMin_C DFES_Cls.DFC_ComHSN1CANMute_C DFES_Cls.DFC_ComHSN3CANMute_C DFES_Cls.DFC_AcChrgrIntkTPhysRngHi_C DFES_Cls.DFC_AcChrgrIntkTPhysRngLo_C DFES_Cls.DFC_AcChrgrIntkTSRCOpn_C DFES_Cls.DFC_CcsPwrLineChpVccPhysRngHi_C DFES_Cls.DFC_CcsPwrLineChpVccPhysRngLo_C DFES_Cls.DFC_CcsPwrLineChpVccSRCOpn_C DFES_Cls.DFC_CcsPwrLineComChpTPhysRngHi_C DFES_Cls.DFC_CcsPwrLineComChpTPhysRngLo_C DFES_Cls.DFC_CcsPwrLineComChpTSRCOpn_C DFES_Cls.DFC_CtPSwtDiagPhysRngHi_C DFES_Cls.DFC_CtPSwtDiagPhysRngLo_C DFES_Cls.DFC_CtPSwtDiagSRCOpn_C DFES_Cls.DFC_CtpCarrFrqPhysRngHi_C DFES_Cls.DFC_CtpCarrFrqPhysRngLo_C DFES_Cls.DFC_CtpCarrFrqSRCMax_C DFES_Cls.DFC_DcChrgrIntkT2PhysRngHi_C DFES_Cls.DFC_DcChrgrIntkT2PhysRngLo_C DFES_Cls.DFC_DcChrgrIntkT2SRCOpn_C DFES_Cls.DFC_DcChrgrIntkTPhysRngHi_C DFES_Cls.DFC_DcChrgrIntkTPhysRngLo_C DFES_Cls.DFC_DcChrgrIntkTSRCOpn_C DFES_Cls.DFC_Fan1SCG_C DFES_Cls.DFC_FanSpdPhysRngHi_C DFES_Cls.DFC_FanSpdPhysRngLo_C DFES_Cls.DFC_FanSpdSRCOpn_C DFES_Cls.DFC_FreonPPhysRngHi_C DFES_Cls.DFC_FreonPPhysRngLo_C DFES_Cls.DFC_FreonPSRCOpn_C DFES_Cls.DFC_HeatrCoreTPhysRngHi_C DFES_Cls.DFC_HeatrCoreTPhysRngLo_C DFES_Cls.DFC_HeatrCoreTSRCOpn_C DFES_Cls.DFC_HvGridUMaxSftyLim_C DFES_Cls.DFC_HvGridUMinSftyLim_C DFES_Cls.DFC_HvGridUPlausy_C DFES_Cls.DFC_IntlckChrgPlgHBrgOpnLd_C DFES_Cls.DFC_IntlckChrgPlgHBrgOvrCurr_C DFES_Cls.DFC_IntlckChrgPlgHBrgOvrTemp_C DFES_Cls.DFC_IntlckChrgPlgHBrgShCirBatt1_C DFES_Cls.DFC_IntlckChrgPlgHBrgShCirBatt2_C DFES_Cls.DFC_IntlckChrgPlgHBrgShCirGnd1_C DFES_Cls.DFC_IntlckChrgPlgHBrgShCirGnd2_C DFES_Cls.DFC_IntlckChrgPlgHBrgShCirOvrLd_C DFES_Cls.DFC_IntlckChrgPlgHBrgTempOvrCurr_C DFES_Cls.DFC_IntlckChrgPlgHBrgUndrVltg_C DFES_Cls.DFC_IntlckChrgPlgPosnRngFlt_C DFES_Cls.DFC_IntlckChrgPlgPosnSrcMax_C DFES_Cls.DFC_IntlckChrgPlgPosnSrcMin_C DFES_Cls.DFC_PwmCtPPhysRngHi_C DFES_Cls.DFC_PwmCtPPhysRngLo_C DFES_Cls.DFC_PwmCtPSRCMax_C DFES_Cls.DFC_PwrDistbnUnitTPhysRngHi_C DFES_Cls.DFC_PwrDistbnUnitTPhysRngLo_C DFES_Cls.DFC_PwrDistbnUnitTSRCOpn_C DFES_Cls.DFC_SCtPmpRlySCG_C DFES_Cls.DFC_SpplCooltPmpRlySCG_C DFES_Cls.DFC_UCtPPhysRngHi_C DFES_Cls.DFC_UCtPPhysRngLo_C DFES_Cls.DFC_UCtPSRCOpn_C DFES_Cls.DFC_UPxP1PhysRngHi_C DFES_Cls.DFC_UPxP1PhysRngLo_C DFES_Cls.DFC_UPxP1SRCOpn_C DFES_Cls.DFC_VehVPhysRngHi_C DFES_Cls.DFC_VehVPhysRngLo_C DFES_Cls.DFC_VehVSigCan_C DFES_Cls.DFC_VehVSigCanSafe_C DFES_Cls.DFC_SCtPmp1DiagGrdKey1_C DFES_Cls.DFC_SCtPmp1DiagGrdKey2_C DFES_Cls.DFC_SCtPmp1DiagGrdKey3_C DFES_Cls.DFC_SCtPmp1DiagGrdKey4_C DFES_Cls.DFC_SCtPmp1DiagGrdKey5_C DFES_Cls.DFC_ChrgPlgLiveCntctHzrdCcs_C DFES_Cls.DFC_ChrgPlgProxPltImps_C DFES_Cls.DFC_ChrgPlgTHiCcsDc_C DFES_Cls.DFC_ElMActvDchaFailr_C DFES_Cls.DFC_ElMActvDchaFlt_C DFES_Cls.DFC_ElMFbdnIvtrModDrv01_C DFES_Cls.DFC_ElMImobAuthent_C DFES_Cls.DFC_ElMIsoMonFlt_C DFES_Cls.DFC_ElMIsoMonPlausyFlt_C DFES_Cls.DFC_ElMIvtrCooltT01_C DFES_Cls.DFC_ElMIvtrEmgyShtDwn01_C DFES_Cls.DFC_ElMIvtrFailr01_C DFES_Cls.DFC_ElMIvtrIntlck01_C DFES_Cls.DFC_ElMIvtrTErr01_C DFES_Cls.DFC_ElMOverSpdNeg01_C DFES_Cls.DFC_ElMOverSpdPos01_C DFES_Cls.DFC_ElMOverTqNeg01_C DFES_Cls.DFC_ElMOverTqPos01_C DFES_Cls.DFC_ElMPwrAuthn_C DFES_Cls.DFC_ElMSpdErr01_C DFES_Cls.DFC_ElMSvs01_C DFES_Cls.DFC_PEnvCcMax_C DFES_Cls.DFC_PEnvCcMin_C DFES_Cls.DFC_PEnvRngChkMax_C DFES_Cls.DFC_PEnvRngChkMin_C DFES_Cls.DFC_PEnvSnsrPlaus_C DFES_Cls.DFC_BrkBstPmpPlausGenn_C DFES_Cls.DFC_CbnHeatrRlyLfLoWarn_C DFES_Cls.DFC_ChgrPlugLockPinByndClsd_C DFES_Cls.DFC_ChgrPlugLockPinMoveWoCmd_C DFES_Cls.DFC_ChgrPlugLockPinStuckInClsd_C DFES_Cls.DFC_ChgrPlugLockPinStuckInOpen_C DFES_Cls.DFC_ChrgrStErr_C DFES_Cls.DFC_ComHSN1BusOff_C DFES_Cls.DFC_ComHSN3BusOff_C DFES_Cls.DFC_ComVCInval_C DFES_Cls.DFC_EemDcdcPrecSpdInhb_C DFES_Cls.DFC_ExpPwrLatch_C DFES_Cls.DFC_FanMaxOvrd_C DFES_Cls.DFC_HLCCcsGnrlComErr_C DFES_Cls.DFC_InmLINNodeHVACPanelAbsnt_C DFES_Cls.DFC_ResetRcvNotAllwd_C DFES_Cls.DFC_TelltlCooltPlaus_C DFES_Cls.DFC_MRlyOL_C DFES_Cls.DFC_MRlySCB_C DFES_Cls.DFC_MRlySCG_C DFES_Cls.DFC_SSpMon1_C DFES_Cls.DFC_SSpMon1OV_C DFES_Cls.DFC_SSpMon1SCG_C DFES_Cls.DFC_SSpMon1UV_C DFES_Cls.DFC_SSpMon2_C DFES_Cls.DFC_SSpMon2OV_C DFES_Cls.DFC_SSpMon2SCG_C DFES_Cls.DFC_SSpMon2UV_C DFES_Cls.DFC_SSpMon3_C DFES_Cls.DFC_SSpMon3OV_C DFES_Cls.DFC_SSpMon3SCG_C DFES_Cls.DFC_SSpMon3UV_C DFES_Cls.DFC_CANSM_E_BUS_OFF_NETWORK_HSN1_CAN_C DFES_Cls.DFC_CANSM_E_BUS_OFF_NETWORK_HSN3_CAN_C DFES_Cls.DFC_CANSM_E_BUS_OFF_NETWORK_HSN4_CAN_C DFES_Cls.DFC_CANSM_E_BUS_OFF_NETWORK_XCP_CAN_C DFES_Cls.DFC_CANTRCV_E_NO_TRCV_CONTROL_0_C DFES_Cls.DFC_CAN_E_TIMEOUT_C DFES_Cls.DFC_COMM_E_NET_START_IND_CHANNEL_0_C DFES_Cls.DFC_COMM_E_NET_START_IND_CHANNEL_1_C DFES_Cls.DFC_COMM_E_NET_START_IND_CHANNEL_2_C DFES_Cls.DFC_COMM_E_NET_START_IND_CHANNEL_3_C DFES_Cls.DFC_COMM_E_NET_START_IND_CHANNEL_4_C DFES_Cls.DFC_COMM_E_NET_START_IND_CHANNEL_5_C DFES_Cls.DFC_LIN_E_TIMEOUT_C DFES_Cls.DFC_rba_EcuCtrl_TOMaxProlg_C DFES_Cls.DFC_rba_EcuCtrl_TOMaxShutDwn_C DFES_Cls.DFC_rba_MultiStackTrace_Threshold_C DFES_Cls.DFC_rba_SyC_CustStates_Degraded_disord_Event_C DFES_Cls.DFC_rba_SyC_CustStates_Degraded_incst_Event_C DFES_Cls.DFC_rba_SyC_CustStates_TransNoWakReq_Event_C DFES_Cls.DFC_RBA_IOEXTLIB_KEEPALIVE_DRV_C DFES_Cls.DFC_RBA_IOEXTLIB_KEEPALIVE_INI_C DFES_Cls.DFC_rba_IoSigRtc_StopCounter_C DFES_Cls.DFC_rba_MRly_Diag_Stk_Event_C DFES_Cls.DFC_rba_MemDiag_MemReadErr_C DFES_Cls.DFC_rba_MemDiag_MemWrErr_C DFES_Cls.DFC_rba_SyC_IrrSwOffTrigEngRun_Event_C DFES_Cls.DFC_AcChrgrIntkTSRCMax_C DFES_Cls.DFC_AcChrgrIntkTTmpErr_C DFES_Cls.DFC_AcFlt_C DFES_Cls.DFC_AppAllSnsrDfct_C DFES_Cls.DFC_BattUPwrFail_C DFES_Cls.DFC_BrkBstBkupOvrn_C DFES_Cls.DFC_BrkBstPmpOvld_C DFES_Cls.DFC_BrkPlausChk_C DFES_Cls.DFC_CbnHeatgSwtTmpErr_C DFES_Cls.DFC_CcsPwrLineChpVccSRCMax_C DFES_Cls.DFC_CcsPwrLineChpVccTmpErr_C DFES_Cls.DFC_CcsPwrLineComChpTSRCMax_C DFES_Cls.DFC_CcsPwrLineComChpTTmpErr_C DFES_Cls.DFC_ChgrPlugCtpCarrFrqErr_C DFES_Cls.DFC_ChgrPlugCtpSwtStuckClsd_C DFES_Cls.DFC_ChgrPlugCtpSwtStuckOpen_C DFES_Cls.DFC_ChgrPlugCtpUErrHi_C DFES_Cls.DFC_ChgrPlugPxp1SrcErr_C DFES_Cls.DFC_ChrgCntctAllWldd_C DFES_Cls.DFC_ChrgCntctNegOperErr_C DFES_Cls.DFC_ChrgCntctNegOperWarn_C DFES_Cls.DFC_ChrgCntctNegWldd_C DFES_Cls.DFC_ChrgCntctPosOperErr_C DFES_Cls.DFC_ChrgCntctPosOperWarn_C DFES_Cls.DFC_ChrgCntctPosWldd_C DFES_Cls.DFC_ChrgCntctStuckOpen_C DFES_Cls.DFC_ChrgPlgIntlckFaild_C DFES_Cls.DFC_ChrgnUnplRqrd_C DFES_Cls.DFC_CoElMOffsCalibActv01_C DFES_Cls.DFC_CtPSwtDiagSRCMax_C DFES_Cls.DFC_CtPSwtDiagTmpErr_C DFES_Cls.DFC_CtpCarrFrqTmpErr_C DFES_Cls.DFC_DcChrgrIntkT2SRCMax_C DFES_Cls.DFC_DcChrgrIntkT2TmpErr_C DFES_Cls.DFC_DcChrgrIntkTSRCMax_C DFES_Cls.DFC_DcChrgrIntkTTmpErr_C DFES_Cls.DFC_EChrDvPlinCntrThdExcdd_C DFES_Cls.DFC_EemDiagCtctrClsTout_C DFES_Cls.DFC_EemDiagDcdcOffTOut_C DFES_Cls.DFC_EemDiagHvCnsrOffTOut_C DFES_Cls.DFC_EemDiagHvbOffTOut_C DFES_Cls.DFC_FanSpdSRCMax_C DFES_Cls.DFC_FanSpdTmpErr_C DFES_Cls.DFC_FreonPSRCMax_C DFES_Cls.DFC_FreonPTmpErr_C DFES_Cls.DFC_HeatrCoreTSRCMax_C DFES_Cls.DFC_HeatrCoreTTmpErr_C DFES_Cls.DFC_HvGridSocMinLim_C DFES_Cls.DFC_HvacBlwrFrntFlt_C DFES_Cls.DFC_HvacEvapElecFlt_C DFES_Cls.DFC_HvacEvapElecFltGnd_C DFES_Cls.DFC_HvacKnobPosnFlt_C DFES_Cls.DFC_InvBinID_C DFES_Cls.DFC_InvCalID_C DFES_Cls.DFC_InvErotan_C DFES_Cls.DFC_InvVinID_C DFES_Cls.DFC_MOXEMM_SMU_ALM0_0_C DFES_Cls.DFC_MOXEMM_SMU_ALM0_1_C DFES_Cls.DFC_MOXEMM_SMU_ALM0_10_C DFES_Cls.DFC_MOXEMM_SMU_ALM0_11_C DFES_Cls.DFC_MOXEMM_SMU_ALM0_13_C DFES_Cls.DFC_MOXEMM_SMU_ALM0_14_C DFES_Cls.DFC_MOXEMM_SMU_ALM0_2_C DFES_Cls.DFC_MOXEMM_SMU_ALM0_22_C DFES_Cls.DFC_MOXEMM_SMU_ALM0_23_C DFES_Cls.DFC_MOXEMM_SMU_ALM0_4_C DFES_Cls.DFC_MOXEMM_SMU_ALM0_5_C DFES_Cls.DFC_MOXEMM_SMU_ALM0_7_C DFES_Cls.DFC_MOXEMM_SMU_ALM0_8_C DFES_Cls.DFC_MOXEMM_SMU_ALM10_16_C DFES_Cls.DFC_MOXEMM_SMU_ALM10_17_C DFES_Cls.DFC_MOXEMM_SMU_ALM10_21_C DFES_Cls.DFC_MOXEMM_SMU_ALM11_0_C DFES_Cls.DFC_MOXEMM_SMU_ALM11_1_C DFES_Cls.DFC_MOXEMM_SMU_ALM11_2_C DFES_Cls.DFC_MOXEMM_SMU_ALM11_3_C DFES_Cls.DFC_MOXEMM_SMU_ALM11_4_C DFES_Cls.DFC_MOXEMM_SMU_ALM11_5_C DFES_Cls.DFC_MOXEMM_SMU_ALM11_8_C DFES_Cls.DFC_MOXEMM_SMU_ALM11_9_C DFES_Cls.DFC_MOXEMM_SMU_ALM1_0_C DFES_Cls.DFC_MOXEMM_SMU_ALM1_1_C DFES_Cls.DFC_MOXEMM_SMU_ALM1_10_C DFES_Cls.DFC_MOXEMM_SMU_ALM1_11_C DFES_Cls.DFC_MOXEMM_SMU_ALM1_13_C DFES_Cls.DFC_MOXEMM_SMU_ALM1_14_C DFES_Cls.DFC_MOXEMM_SMU_ALM1_2_C DFES_Cls.DFC_MOXEMM_SMU_ALM1_22_C DFES_Cls.DFC_MOXEMM_SMU_ALM1_23_C DFES_Cls.DFC_MOXEMM_SMU_ALM1_4_C DFES_Cls.DFC_MOXEMM_SMU_ALM1_5_C DFES_Cls.DFC_MOXEMM_SMU_ALM1_7_C DFES_Cls.DFC_MOXEMM_SMU_ALM1_8_C DFES_Cls.DFC_MOXEMM_SMU_ALM21_0_C DFES_Cls.DFC_MOXEMM_SMU_ALM21_16_C DFES_Cls.DFC_MOXEMM_SMU_ALM21_3_C DFES_Cls.DFC_MOXEMM_SMU_ALM2_1_C DFES_Cls.DFC_MOXEMM_SMU_ALM2_10_C DFES_Cls.DFC_MOXEMM_SMU_ALM2_11_C DFES_Cls.DFC_MOXEMM_SMU_ALM2_13_C DFES_Cls.DFC_MOXEMM_SMU_ALM2_14_C DFES_Cls.DFC_MOXEMM_SMU_ALM2_22_C DFES_Cls.DFC_MOXEMM_SMU_ALM2_23_C DFES_Cls.DFC_MOXEMM_SMU_ALM2_4_C DFES_Cls.DFC_MOXEMM_SMU_ALM2_5_C DFES_Cls.DFC_MOXEMM_SMU_ALM2_7_C DFES_Cls.DFC_MOXEMM_SMU_ALM2_8_C DFES_Cls.DFC_MOXEMM_SMU_ALM6_0_C DFES_Cls.DFC_MOXEMM_SMU_ALM6_11_C DFES_Cls.DFC_MOXEMM_SMU_ALM6_12_C DFES_Cls.DFC_MOXEMM_SMU_ALM6_14_C DFES_Cls.DFC_MOXEMM_SMU_ALM6_15_C DFES_Cls.DFC_MOXEMM_SMU_ALM6_17_C DFES_Cls.DFC_MOXEMM_SMU_ALM6_18_C DFES_Cls.DFC_MOXEMM_SMU_ALM6_20_C DFES_Cls.DFC_MOXEMM_SMU_ALM6_21_C DFES_Cls.DFC_MOXEMM_SMU_ALM6_25_C DFES_Cls.DFC_MOXEMM_SMU_ALM6_4_C DFES_Cls.DFC_MOXEMM_SMU_ALM6_5_C DFES_Cls.DFC_MOXEMM_SMU_ALM6_7_C DFES_Cls.DFC_MOXEMM_SMU_ALM6_8_C DFES_Cls.DFC_MOXEMM_SMU_ALM7_1_C DFES_Cls.DFC_MOXEMM_SMU_ALM7_12_C DFES_Cls.DFC_MOXEMM_SMU_ALM7_13_C DFES_Cls.DFC_MOXEMM_SMU_ALM7_14_C DFES_Cls.DFC_MOXEMM_SMU_ALM7_15_C DFES_Cls.DFC_MOXEMM_SMU_ALM7_16_C DFES_Cls.DFC_MOXEMM_SMU_ALM7_17_C DFES_Cls.DFC_MOXEMM_SMU_ALM7_2_C DFES_Cls.DFC_MOXEMM_SMU_ALM7_20_C DFES_Cls.DFC_MOXEMM_SMU_ALM7_25_C DFES_Cls.DFC_MOXEMM_SMU_ALM7_26_C DFES_Cls.DFC_MOXEMM_SMU_ALM7_28_C DFES_Cls.DFC_MOXEMM_SMU_ALM7_29_C DFES_Cls.DFC_MOXEMM_SMU_ALM7_30_C DFES_Cls.DFC_MOXEMM_SMU_ALM7_31_C DFES_Cls.DFC_MOXEMM_SMU_ALM8_0_C DFES_Cls.DFC_MOXEMM_SMU_ALM8_1_C DFES_Cls.DFC_MOXEMM_SMU_ALM8_10_C DFES_Cls.DFC_MOXEMM_SMU_ALM8_11_C DFES_Cls.DFC_MOXEMM_SMU_ALM8_12_C DFES_Cls.DFC_MOXEMM_SMU_ALM8_16_C DFES_Cls.DFC_MOXEMM_SMU_ALM8_18_C DFES_Cls.DFC_MOXEMM_SMU_ALM8_2_C DFES_Cls.DFC_MOXEMM_SMU_ALM8_3_C DFES_Cls.DFC_MOXEMM_SMU_ALM8_31_C DFES_Cls.DFC_MOXEMM_SMU_ALM8_4_C DFES_Cls.DFC_MOXEMM_SMU_ALM9_0_C DFES_Cls.DFC_MOXEMM_SMU_ALM9_15_C DFES_Cls.DFC_MOXEMM_SMU_ALM9_3_C DFES_Cls.DFC_MoCADCNTPBnk1_C DFES_Cls.DFC_MoCADCTestVoltBnk1_C DFES_Cls.DFC_MoCSOPICO_C DFES_Cls.DFC_MoFAccr_C DFES_Cls.DFC_MoFCbnPreCdngOvrheat_C DFES_Cls.DFC_MoFCbnPreCdngTmrExpi_C DFES_Cls.DFC_MoFEvMngtBms_C DFES_Cls.DFC_MoFEvMngtDcdc_C DFES_Cls.DFC_MoFEvMngtEm01_C DFES_Cls.DFC_MoFEvMngtEm01BrkgToZr_C DFES_Cls.DFC_MoFEvMngtEm01EngSpd_C DFES_Cls.DFC_MoFEvMngtEm02EngSpd_C DFES_Cls.DFC_MoFEvMngtEm02Lvl1_C DFES_Cls.DFC_MoFEvMngtEm02Lvl2_C DFES_Cls.DFC_MoFExtCptAuxCpt_C DFES_Cls.DFC_MoFExtCptVacPmpErr_C DFES_Cls.DFC_MoFTqPtdAxle_C DFES_Cls.DFC_MoFTqPtdAxleSec_C DFES_Cls.DFC_MoFTqPtdEmPtRels_C DFES_Cls.DFC_MoFTqPtdEmPtRelsSec_C DFES_Cls.DFC_MoFTqPtdEmSign_C DFES_Cls.DFC_MoFTqPtdEmSignSec_C DFES_Cls.DFC_MoFTqPtdEmTq_C DFES_Cls.DFC_MoFTqPtdEmTqSec_C DFES_Cls.DFC_MoFTqPtdVeh_C DFES_Cls.DFC_MoFVarPostBldSel_C DFES_Cls.DFC_MoSysCtrlReIni_C DFES_Cls.DFC_MoXEMMHwLTMCUFW_C DFES_Cls.DFC_MoXEMMHwLTMonBIST_C DFES_Cls.DFC_MoXEMMHwLTRegMonTest_C DFES_Cls.DFC_MoXEMMHwLTStbySMUAlvTest_C DFES_Cls.DFC_MoXEMMHwLTTempSens_C DFES_Cls.DFC_MoXEMMHwLTUCBCfg_C DFES_Cls.DFC_MonEgyChrgnCoorr_AcChrgnWoMofRels_C DFES_Cls.DFC_MonEgyChrgnCoorr_ChrgnAbortIgr_C DFES_Cls.DFC_MonEgyChrgnCoorr_DcCntctFailr_C DFES_Cls.DFC_MonEgyChrgnCoorr_ExtChrgnShtOffReq_C DFES_Cls.DFC_MonEgyChrgnCoorr_ImpsChrgnMod_C DFES_Cls.DFC_MonEgyChrgnCoorr_ImpsChrgnPrms_C DFES_Cls.DFC_MonEgyChrgnCoorr_ImpsUDcIntk_C DFES_Cls.DFC_MonEgyChrgnCoorr_PlgLockMovmt_C DFES_Cls.DFC_MonEgyChrgnCoorr_VehCrashDetn_C DFES_Cls.DFC_MonEgyChrgnErrReactn_SftySwt_C DFES_Cls.DFC_MonEgyChrgnInlet_CcsPlgCtp_C DFES_Cls.DFC_MonEgyChrgnInlet_CcsPlgCtpPwm_C DFES_Cls.DFC_MonEgyChrgnInlet_CcsPlgLockCtrlImpsAtmpt_C DFES_Cls.DFC_MonEgyChrgnInlet_CcsPlgLockSnsrSigRngChk_C DFES_Cls.DFC_MonEgyChrgnInlet_CcsPlgLockStImps_C DFES_Cls.DFC_MonEgyChrgnInlet_CcsPlgPxp_C DFES_Cls.DFC_MonEgyChrgnT_Snsr1GrdtChk_C DFES_Cls.DFC_MonEgyChrgnT_Snsr1SigRngChk_C DFES_Cls.DFC_MonEgyChrgnT_Snsr2GrdtChk_C DFES_Cls.DFC_MonEgyChrgnT_Snsr2SigRngChk_C DFES_Cls.DFC_MonEgyChrgnT_SnsrDif_C DFES_Cls.DFC_OCWDAABEActv_C DFES_Cls.DFC_OCWDACom_C DFES_Cls.DFC_OCWDAErrPin_C DFES_Cls.DFC_OCWDAOvrVltg_C DFES_Cls.DFC_PUmax_C DFES_Cls.DFC_PwmCtPTmpErr_C DFES_Cls.DFC_PwrDistbnUnitTSRCMax_C DFES_Cls.DFC_PwrDistbnUnitTTmpErr_C DFES_Cls.DFC_SCtPmp1DiagGrdKeyErr_C DFES_Cls.DFC_SRCHighAPP1_C DFES_Cls.DFC_SRCHighAPP2_C DFES_Cls.DFC_SRCLowAPP1_C DFES_Cls.DFC_SRCLowAPP2_C DFES_Cls.DFC_SWReset_0_C DFES_Cls.DFC_SWReset_1_C DFES_Cls.DFC_SWReset_2_C DFES_Cls.DFC_Sia_InvldCode_C DFES_Cls.DFC_Sia_InvldKey_C DFES_Cls.DFC_Sia_NoRespUCx_C DFES_Cls.DFC_Sia_TprotRttp_C DFES_Cls.DFC_StrtUpEvStandStillDeactvn_C DFES_Cls.DFC_SyncAPP_C DFES_Cls.DFC_UCtPSRCMax_C DFES_Cls.DFC_UCtPTmpErr_C DFES_Cls.DFC_UPxP1SRCMax_C DFES_Cls.DFC_UPxP1TmpErr_C DFES_Cls.DFC_VehVObd_C DFES_DbLv_C DFES_DTCM.DFC_Unused_C DFES_DTCM.DFC_ACCmprFltLvlRes_C DFES_DTCM.DFC_AbgHiSigFlt_C DFES_DTCM.DFC_AbgIntPatFlt_C DFES_DTCM.DFC_AbgLoSigFlt_C DFES_DTCM.DFC_AbgUnkwnErrSigFlt_C DFES_DTCM.DFC_AcExtChrgrIBattExcdd_C DFES_DTCM.DFC_AcExtChrgrIInExcdd_C DFES_DTCM.DFC_AcExtChrgrIOutDe_C DFES_DTCM.DFC_AcExtChrgrIOutExcdd_C DFES_DTCM.DFC_AcExtChrgrUOutDe_C DFES_DTCM.DFC_AdpActvDChaFailr_C DFES_DTCM.DFC_AirbcuFlt_C DFES_DTCM.DFC_Airbg_C DFES_DTCM.DFC_AirbgCan_C DFES_DTCM.DFC_AirbgCanHWPlaus_C DFES_DTCM.DFC_AirbgHWCanPlaus_C DFES_DTCM.DFC_AirbgMnr_C DFES_DTCM.DFC_AirbgPerHi_C DFES_DTCM.DFC_AirbgPerdRngFlt_C DFES_DTCM.DFC_BlowrRlyErr_C DFES_DTCM.DFC_BrkBstPmpActtnDfct_C DFES_DTCM.DFC_BrkBstPmpDeactvnDfct_C DFES_DTCM.DFC_BrkSwtFlt_C DFES_DTCM.DFC_CbnHeatgHeatrHsScb_C DFES_DTCM.DFC_CbnHeatgHeatrHsScg_C DFES_DTCM.DFC_CbnHeatgHeatrLsOl_C DFES_DTCM.DFC_CbnHeatgHeatrLsScb_C DFES_DTCM.DFC_CbnHeatgHeatrLsScg_C DFES_DTCM.DFC_CbnHeatgHeatrUnUsed_C DFES_DTCM.DFC_ChrgnCntctHsOt_C DFES_DTCM.DFC_ChrgnCntctHsScb_C DFES_DTCM.DFC_ChrgnCntctHsScg_C DFES_DTCM.DFC_ChrgnCntctLsNegOl_C DFES_DTCM.DFC_ChrgnCntctLsNegOt_C DFES_DTCM.DFC_ChrgnCntctLsNegScb_C DFES_DTCM.DFC_ChrgnCntctLsNegScg_C DFES_DTCM.DFC_ChrgnCntctLsPosOl_C DFES_DTCM.DFC_ChrgnCntctLsPosOt_C DFES_DTCM.DFC_ChrgnCntctLsPosScb_C DFES_DTCM.DFC_ChrgnCntctLsPosScg_C DFES_DTCM.DFC_ChrgnCntctUnUsed_C DFES_DTCM.DFC_ComBrkMai_C DFES_DTCM.DFC_ComChrgrEVCont_C DFES_DTCM.DFC_ComChrgrEVtBlink_C DFES_DTCM.DFC_ComChrgrMstBlink_C DFES_DTCM.DFC_ComChrgrMstCont_C DFES_DTCM.DFC_ComChrgrSVSBlink_C DFES_DTCM.DFC_ComChrgrSVSCont_C DFES_DTCM.DFC_ComDcdcEVBlink_C DFES_DTCM.DFC_ComDcdcEVCont_C DFES_DTCM.DFC_ComDcdcFltLvl2_C DFES_DTCM.DFC_ComDcdcFltLvl3_C DFES_DTCM.DFC_ComDcdcFltLvl4_C DFES_DTCM.DFC_ComDcdcFltLvl5_C DFES_DTCM.DFC_ComDcdcFltLvlRes_C DFES_DTCM.DFC_ComDcdcMstBlink_C DFES_DTCM.DFC_ComDcdcMstCont_C DFES_DTCM.DFC_ComDcdcSVSBlink_C DFES_DTCM.DFC_ComDcdcSVSCont_C DFES_DTCM.DFC_ComElMIIvtrFltLvl2_C DFES_DTCM.DFC_ComElMIIvtrFltLvl3_C DFES_DTCM.DFC_ComElMIIvtrFltLvl4_C DFES_DTCM.DFC_ComElMIIvtrFltLvl5_C DFES_DTCM.DFC_ComElMIIvtrFltLvlRes_C DFES_DTCM.DFC_ComEmacEVBlink_C DFES_DTCM.DFC_ComEmacEVCont_C DFES_DTCM.DFC_ComEmacMstCont_C DFES_DTCM.DFC_ComEmacMsttBlink_C DFES_DTCM.DFC_ComEmacSVSBlink_C DFES_DTCM.DFC_ComEmacSVSCont_C DFES_DTCM.DFC_ComGunCntInfoWkuReq_C DFES_DTCM.DFC_ComHillHldFlt_C DFES_DTCM.DFC_ComHvBattRchrgWkuReq_C DFES_DTCM.DFC_ComHvbFltLvl2_C DFES_DTCM.DFC_ComHvbFltLvl3_C DFES_DTCM.DFC_ComHvbFltLvl4_C DFES_DTCM.DFC_ComHvbFltLvl5_C DFES_DTCM.DFC_ComHvbFltLvlRes_C DFES_DTCM.DFC_ComHvbMstBlink_C DFES_DTCM.DFC_ComHvbMstCont_C DFES_DTCM.DFC_ComImmoUnlockWkuReq_C DFES_DTCM.DFC_ComInfoReqPtlWkuReq_C DFES_DTCM.DFC_ComOBCFltLvl2_C DFES_DTCM.DFC_ComOBCFltLvl3_C DFES_DTCM.DFC_ComOBCFltLvl4_C DFES_DTCM.DFC_ComOBCFltLvl5_C DFES_DTCM.DFC_ComOBCFltLvlRes_C DFES_DTCM.DFC_ComPostOperationWkuReq_C DFES_DTCM.DFC_ComPreCondElecWkuReq_C DFES_DTCM.DFC_ComRemUnlckWkuReq_C DFES_DTCM.DFC_ComStpDlyHMIWkuReq_C DFES_DTCM.DFC_ComflgCurMeasmtErr_C DFES_DTCM.DFC_ComflgCurMeasmtSysErr_C DFES_DTCM.DFC_ComflgCurMeasmtVld_C DFES_DTCM.DFC_ComflgCurRngErr_C DFES_DTCM.DFC_ComflgTPcbMeasmtErr_C DFES_DTCM.DFC_ComflgTPcbMeasmtVld_C DFES_DTCM.DFC_ComflgTPcbRngErr_C DFES_DTCM.DFC_ComflgTPcbSysErr_C DFES_DTCM.DFC_ComflgTShntMeasmtErr_C DFES_DTCM.DFC_ComflgTShntMeasmtVld_C DFES_DTCM.DFC_ComflgTShntRngErr_C DFES_DTCM.DFC_ComflgTShntSysErr_C DFES_DTCM.DFC_ComflgVoltMeasmtErr_C DFES_DTCM.DFC_ComflgVoltMeasmtSysErr_C DFES_DTCM.DFC_ComflgVoltMeasmtVld_C DFES_DTCM.DFC_ComflgVoltRngErr_C DFES_DTCM.DFC_CrashEveOcc_C DFES_DTCM.DFC_DcdcFwdModStuck_C DFES_DTCM.DFC_DcdcLvUDifMaxFlt_C DFES_DTCM.DFC_DcdcOffModStuck_C DFES_DTCM.DFC_DcdcOperModFailr_C DFES_DTCM.DFC_DcdcPrecModStuck_C DFES_DTCM.DFC_DrvDoorOpn_C DFES_DTCM.DFC_DrvModPosnDfct_C DFES_DTCM.DFC_DrvStbltOpn_C DFES_DTCM.DFC_ETogFailrLvl3_C DFES_DTCM.DFC_ETogFailrLvl4_C DFES_DTCM.DFC_EbsLvBattSocDiagLo_C DFES_DTCM.DFC_EbsLvBattUDiagDiOper_C /end DEF_CHARACTERISTIC
 FUNCTION_VERSION "30000.70.0" /end FUNCTION
/begin COMPU_METHOD DFES_OneToOne "" RAT_FUNC "%6.2" "-" COEFFS 0 1 0 0 0 1 /end COMPU_METHOD
/begin RECORD_LAYOUT Val_Wu16 FNC_VALUES 1 UWORD COLUMN_DIR DIRECT /end RECORD_LAYOUT
/begin RECORD_LAYOUT Val_Wu8 FNC_VALUES 1 UBYTE COLUMN_DIR DIRECT /end RECORD_LAYOUT
/end MODULE
/end PROJECT

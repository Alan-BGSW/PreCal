ASAP2_VERSION 1 70
/begin PROJECT MDG1C "VC1CP091_STLA_N_D061I3"
/begin HEADER "" VERSION "VC1CP091_STLA_N_D061I3" PROJECT_NO MDG1C /end HEADER
/begin MODULE DIM ""
/begin MOD_COMMON "" BYTE_ORDER MSB_LAST ALIGNMENT_BYTE 1 ALIGNMENT_WORD 2 ALIGNMENT_LONG 4 ALIGNMENT_INT64 4 ALIGNMENT_FLOAT32_IEEE 4 ALIGNMENT_FLOAT64_IEEE 4 DATA_SIZE 32 /end MOD_COMMON
/begin CHARACTERISTIC DDRC_DurDeb.IntlckChrgPlgPosn_tiRngFltDebOk_C "" VALUE 0x80240A54 Val_Wu16 655350.0 DDRCTime_ms 0.00 655350.0 FORMAT "%8.1" /end CHARACTERISTIC
/begin CHARACTERISTIC DDRC_DurDeb.IntlckChrgPlgPosn_tiRngFltDebDef_C "" VALUE 0x80240A56 Val_Wu16 655350.0 DDRCTime_ms 0.00 655350.0 FORMAT "%8.1" /end CHARACTERISTIC
/begin CHARACTERISTIC DDRC_DurDeb.IntlckChrgPlgPosn_tiSrcMaxDebOk_C "" VALUE 0x80240A58 Val_Wu16 655350.0 DDRCTime_ms 0.00 655350.0 FORMAT "%8.1" /end CHARACTERISTIC
/begin CHARACTERISTIC DDRC_DurDeb.IntlckChrgPlgPosn_tiSrcMaxDebDef_C "" VALUE 0x80240A5A Val_Wu16 655350.0 DDRCTime_ms 0.00 655350.0 FORMAT "%8.1" /end CHARACTERISTIC
/begin CHARACTERISTIC DDRC_DurDeb.IntlckChrgPlgPosn_tiSrcMinDebOk_C "" VALUE 0x80240A5C Val_Wu16 655350.0 DDRCTime_ms 0.00 655350.0 FORMAT "%8.1" /end CHARACTERISTIC
/begin CHARACTERISTIC DDRC_DurDeb.IntlckChrgPlgPosn_tiSrcMinDebDef_C "" VALUE 0x80240A5E Val_Wu16 655350.0 DDRCTime_ms 0.00 655350.0 FORMAT "%8.1" /end CHARACTERISTIC
/begin CHARACTERISTIC DDRC_DurDeb.IntlckChrgPlg_tiHBrgOpnLdDebOk_C "" VALUE 0x80240A60 Val_Wu16 655350.0 DDRCTime_ms 0.00 655350.0 FORMAT "%8.1" /end CHARACTERISTIC
/begin CHARACTERISTIC DDRC_DurDeb.IntlckChrgPlg_tiHBrgOpnLdDebDef_C "" VALUE 0x80240A62 Val_Wu16 655350.0 DDRCTime_ms 0.00 655350.0 FORMAT "%8.1" /end CHARACTERISTIC
/begin CHARACTERISTIC DDRC_DurDeb.IntlckChrgPlg_tiHBrgOvrCurrDebOk_C "" VALUE 0x80240A64 Val_Wu16 655350.0 DDRCTime_ms 0.00 655350.0 FORMAT "%8.1" /end CHARACTERISTIC
/begin CHARACTERISTIC DDRC_DurDeb.IntlckChrgPlg_tiHBrgOvrCurrDebDef_C "" VALUE 0x80240A66 Val_Wu16 655350.0 DDRCTime_ms 0.00 655350.0 FORMAT "%8.1" /end CHARACTERISTIC
/begin CHARACTERISTIC DDRC_DurDeb.IntlckChrgPlg_tiHBrgOvrTempDebOk_C "" VALUE 0x80240A68 Val_Wu16 655350.0 DDRCTime_ms 0.00 655350.0 FORMAT "%8.1" /end CHARACTERISTIC
/begin CHARACTERISTIC DDRC_DurDeb.IntlckChrgPlg_tiHBrgOvrTempDebDef_C "" VALUE 0x80240A6A Val_Wu16 655350.0 DDRCTime_ms 0.00 655350.0 FORMAT "%8.1" /end CHARACTERISTIC
/begin CHARACTERISTIC DDRC_DurDeb.IntlckChrgPlg_tiHBrgShCirBatt1DebOk_C "" VALUE 0x80240A6C Val_Wu16 655350.0 DDRCTime_ms 0.00 655350.0 FORMAT "%8.1" /end CHARACTERISTIC
/begin CHARACTERISTIC DDRC_DurDeb.IntlckChrgPlg_tiHBrgShCirBatt1DebDef_C "" VALUE 0x80240A6E Val_Wu16 655350.0 DDRCTime_ms 0.00 655350.0 FORMAT "%8.1" /end CHARACTERISTIC
/begin CHARACTERISTIC DDRC_DurDeb.IntlckChrgPlg_tiHBrgShCirBatt2DebOk_C "" VALUE 0x80240A70 Val_Wu16 655350.0 DDRCTime_ms 0.00 655350.0 FORMAT "%8.1" /end CHARACTERISTIC
/begin CHARACTERISTIC DDRC_DurDeb.IntlckChrgPlg_tiHBrgShCirBatt2DebDef_C "" VALUE 0x80240A72 Val_Wu16 655350.0 DDRCTime_ms 0.00 655350.0 FORMAT "%8.1" /end CHARACTERISTIC
/begin CHARACTERISTIC DDRC_DurDeb.IntlckChrgPlg_tiHBrgShCirGnd1DebOk_C "" VALUE 0x80240A74 Val_Wu16 655350.0 DDRCTime_ms 0.00 655350.0 FORMAT "%8.1" /end CHARACTERISTIC
/begin CHARACTERISTIC DDRC_DurDeb.IntlckChrgPlg_tiHBrgShCirGnd1DebDef_C "" VALUE 0x80240A76 Val_Wu16 655350.0 DDRCTime_ms 0.00 655350.0 FORMAT "%8.1" /end CHARACTERISTIC
/begin CHARACTERISTIC DDRC_DurDeb.IntlckChrgPlg_tiHBrgShCirGnd2DebOk_C "" VALUE 0x80240A78 Val_Wu16 655350.0 DDRCTime_ms 0.00 655350.0 FORMAT "%8.1" /end CHARACTERISTIC
/begin CHARACTERISTIC DDRC_DurDeb.IntlckChrgPlg_tiHBrgShCirGnd2DebDef_C "" VALUE 0x80240A7A Val_Wu16 655350.0 DDRCTime_ms 0.00 655350.0 FORMAT "%8.1" /end CHARACTERISTIC
/begin CHARACTERISTIC DDRC_DurDeb.IntlckChrgPlg_tiHBrgShCirOvrLdDebOk_C "" VALUE 0x80240A7C Val_Wu16 655350.0 DDRCTime_ms 0.00 655350.0 FORMAT "%8.1" /end CHARACTERISTIC
/begin CHARACTERISTIC DDRC_DurDeb.IntlckChrgPlg_tiHBrgShCirOvrLdDebDef_C "" VALUE 0x80240A7E Val_Wu16 655350.0 DDRCTime_ms 0.00 655350.0 FORMAT "%8.1" /end CHARACTERISTIC
/begin CHARACTERISTIC DDRC_DurDeb.IntlckChrgPlg_tiHBrgTempOvrCurrDebOk_C "" VALUE 0x80240A80 Val_Wu16 655350.0 DDRCTime_ms 0.00 655350.0 FORMAT "%8.1" /end CHARACTERISTIC
/begin CHARACTERISTIC DDRC_DurDeb.IntlckChrgPlg_tiHBrgTempOvrCurrDebDef_C "" VALUE 0x80240A82 Val_Wu16 655350.0 DDRCTime_ms 0.00 655350.0 FORMAT "%8.1" /end CHARACTERISTIC
/begin CHARACTERISTIC DDRC_DurDeb.IntlckChrgPlg_tiHBrgUndrVltgDebOk_C "" VALUE 0x80240A84 Val_Wu16 655350.0 DDRCTime_ms 0.00 655350.0 FORMAT "%8.1" /end CHARACTERISTIC
/begin CHARACTERISTIC DDRC_DurDeb.IntlckChrgPlg_tiHBrgUndrVltgDebDef_C "" VALUE 0x80240A86 Val_Wu16 655350.0 DDRCTime_ms 0.00 655350.0 FORMAT "%8.1" /end CHARACTERISTIC
/begin CHARACTERISTIC DDRC_RatDeb.IntlckChrgPlgPosn_tiRngFltUDRat_C "" VALUE 0x80248A99 Val_Wu8 3.00000000000 DDRC_Ratio 1.00000000000 4.00000000000 FORMAT "%13.11" /end CHARACTERISTIC
/begin CHARACTERISTIC DDRC_RatDeb.IntlckChrgPlgPosn_tiSrcMaxUDRat_C "" VALUE 0x80248A9A Val_Wu8 3.00000000000 DDRC_Ratio 1.00000000000 4.00000000000 FORMAT "%13.11" /end CHARACTERISTIC
/begin CHARACTERISTIC DDRC_RatDeb.IntlckChrgPlgPosn_tiSrcMinUDRat_C "" VALUE 0x80248A9B Val_Wu8 3.00000000000 DDRC_Ratio 1.00000000000 4.00000000000 FORMAT "%13.11" /end CHARACTERISTIC
/begin CHARACTERISTIC DDRC_RatDeb.IntlckChrgPlg_tiHBrgOpnLdUDRat_C "" VALUE 0x80248A9C Val_Wu8 3.00000000000 DDRC_Ratio 1.00000000000 4.00000000000 FORMAT "%13.11" /end CHARACTERISTIC
/begin CHARACTERISTIC DDRC_RatDeb.IntlckChrgPlg_tiHBrgOvrCurrUDRat_C "" VALUE 0x80248A9D Val_Wu8 3.00000000000 DDRC_Ratio 1.00000000000 4.00000000000 FORMAT "%13.11" /end CHARACTERISTIC
/begin CHARACTERISTIC DDRC_RatDeb.IntlckChrgPlg_tiHBrgOvrTempUDRat_C "" VALUE 0x80248A9E Val_Wu8 3.00000000000 DDRC_Ratio 1.00000000000 4.00000000000 FORMAT "%13.11" /end CHARACTERISTIC
/begin CHARACTERISTIC DDRC_RatDeb.IntlckChrgPlg_tiHBrgShCirBatt1UDRat_C "" VALUE 0x80248A9F Val_Wu8 3.00000000000 DDRC_Ratio 1.00000000000 4.00000000000 FORMAT "%13.11" /end CHARACTERISTIC
/begin CHARACTERISTIC DDRC_RatDeb.IntlckChrgPlg_tiHBrgShCirBatt2UDRat_C "" VALUE 0x80248AA0 Val_Wu8 3.00000000000 DDRC_Ratio 1.00000000000 4.00000000000 FORMAT "%13.11" /end CHARACTERISTIC
/begin CHARACTERISTIC DDRC_RatDeb.IntlckChrgPlg_tiHBrgShCirGnd1UDRat_C "" VALUE 0x80248AA1 Val_Wu8 3.00000000000 DDRC_Ratio 1.00000000000 4.00000000000 FORMAT "%13.11" /end CHARACTERISTIC
/begin CHARACTERISTIC DDRC_RatDeb.IntlckChrgPlg_tiHBrgShCirGnd2UDRat_C "" VALUE 0x80248AA2 Val_Wu8 3.00000000000 DDRC_Ratio 1.00000000000 4.00000000000 FORMAT "%13.11" /end CHARACTERISTIC
/begin CHARACTERISTIC DDRC_RatDeb.IntlckChrgPlg_tiHBrgShCirOvrLdUDRat_C "" VALUE 0x80248AA3 Val_Wu8 3.00000000000 DDRC_Ratio 1.00000000000 4.00000000000 FORMAT "%13.11" /end CHARACTERISTIC
/begin CHARACTERISTIC DDRC_RatDeb.IntlckChrgPlg_tiHBrgTempOvrCurrUDRat_C "" VALUE 0x80248AA4 Val_Wu8 3.00000000000 DDRC_Ratio 1.00000000000 4.00000000000 FORMAT "%13.11" /end CHARACTERISTIC
/begin CHARACTERISTIC DDRC_RatDeb.IntlckChrgPlg_tiHBrgUndrVltgUDRat_C "" VALUE 0x80248AA5 Val_Wu8 3.00000000000 DDRC_Ratio 1.00000000000 4.00000000000 FORMAT "%13.11" /end CHARACTERISTIC
/begin CHARACTERISTIC DFC_CtlMsk2.DFC_IntlckChrgPlgHBrgOpnLd_C "" VALUE 0x80241552 Val_Wu8 255.0 DFES_OneToOne 0.00 255.0 FORMAT "%5.1" /end CHARACTERISTIC
/begin CHARACTERISTIC DFC_CtlMsk2.DFC_IntlckChrgPlgHBrgOvrCurr_C "" VALUE 0x80241553 Val_Wu8 255.0 DFES_OneToOne 0.00 255.0 FORMAT "%5.1" /end CHARACTERISTIC
/begin CHARACTERISTIC DFC_CtlMsk2.DFC_IntlckChrgPlgHBrgOvrTemp_C "" VALUE 0x80241554 Val_Wu8 255.0 DFES_OneToOne 0.00 255.0 FORMAT "%5.1" /end CHARACTERISTIC
/begin CHARACTERISTIC DFC_CtlMsk2.DFC_IntlckChrgPlgHBrgShCirBatt1_C "" VALUE 0x80241555 Val_Wu8 255.0 DFES_OneToOne 0.00 255.0 FORMAT "%5.1" /end CHARACTERISTIC
/begin CHARACTERISTIC DFC_CtlMsk2.DFC_IntlckChrgPlgHBrgShCirBatt2_C "" VALUE 0x80241556 Val_Wu8 255.0 DFES_OneToOne 0.00 255.0 FORMAT "%5.1" /end CHARACTERISTIC
/begin CHARACTERISTIC DFC_CtlMsk2.DFC_IntlckChrgPlgHBrgShCirGnd1_C "" VALUE 0x80241557 Val_Wu8 255.0 DFES_OneToOne 0.00 255.0 FORMAT "%5.1" /end CHARACTERISTIC
/begin CHARACTERISTIC DFC_CtlMsk2.DFC_IntlckChrgPlgHBrgShCirGnd2_C "" VALUE 0x80241558 Val_Wu8 255.0 DFES_OneToOne 0.00 255.0 FORMAT "%5.1" /end CHARACTERISTIC
/begin CHARACTERISTIC DFC_CtlMsk2.DFC_IntlckChrgPlgHBrgShCirOvrLd_C "" VALUE 0x80241559 Val_Wu8 255.0 DFES_OneToOne 0.00 255.0 FORMAT "%5.1" /end CHARACTERISTIC
/begin CHARACTERISTIC DFC_CtlMsk2.DFC_IntlckChrgPlgHBrgTempOvrCurr_C "" VALUE 0x8024155A Val_Wu8 255.0 DFES_OneToOne 0.00 255.0 FORMAT "%5.1" /end CHARACTERISTIC
/begin CHARACTERISTIC DFC_CtlMsk2.DFC_IntlckChrgPlgHBrgUndrVltg_C "" VALUE 0x8024155B Val_Wu8 255.0 DFES_OneToOne 0.00 255.0 FORMAT "%5.1" /end CHARACTERISTIC
/begin CHARACTERISTIC DFC_CtlMsk2.DFC_IntlckChrgPlgPosnRngFlt_C "" VALUE 0x8024155C Val_Wu8 255.0 DFES_OneToOne 0.00 255.0 FORMAT "%5.1" /end CHARACTERISTIC
/begin CHARACTERISTIC DFC_CtlMsk2.DFC_IntlckChrgPlgPosnSrcMax_C "" VALUE 0x8024155D Val_Wu8 255.0 DFES_OneToOne 0.00 255.0 FORMAT "%5.1" /end CHARACTERISTIC
/begin CHARACTERISTIC DFC_CtlMsk2.DFC_IntlckChrgPlgPosnSrcMin_C "" VALUE 0x8024155E Val_Wu8 255.0 DFES_OneToOne 0.00 255.0 FORMAT "%5.1" /end CHARACTERISTIC
/begin CHARACTERISTIC DFC_CtlMsk2.DFC_MoCADCNTPBnk1_C "" VALUE 0x80241660 Val_Wu8 255.0 DFES_OneToOne 0.00 255.0 FORMAT "%5.1" /end CHARACTERISTIC
/begin CHARACTERISTIC DFC_CtlMsk2.DFC_MoCADCTestVoltBnk1_C "" VALUE 0x80241661 Val_Wu8 255.0 DFES_OneToOne 0.00 255.0 FORMAT "%5.1" /end CHARACTERISTIC
/begin CHARACTERISTIC DFC_DisblMsk2.DFC_IntlckChrgPlgHBrgOpnLd_C "" VALUE 0x80248F8A Val_Wu16 65535.00 DFES_OneToOne 0.00 65535.00 FORMAT "%8.2" /end CHARACTERISTIC
/begin CHARACTERISTIC DFC_DisblMsk2.DFC_IntlckChrgPlgHBrgOvrCurr_C "" VALUE 0x80248F8C Val_Wu16 65535.00 DFES_OneToOne 0.00 65535.00 FORMAT "%8.2" /end CHARACTERISTIC
/begin CHARACTERISTIC DFC_DisblMsk2.DFC_IntlckChrgPlgHBrgOvrTemp_C "" VALUE 0x80248F8E Val_Wu16 65535.00 DFES_OneToOne 0.00 65535.00 FORMAT "%8.2" /end CHARACTERISTIC
/begin CHARACTERISTIC DFC_DisblMsk2.DFC_IntlckChrgPlgHBrgShCirBatt1_C "" VALUE 0x80248F90 Val_Wu16 65535.00 DFES_OneToOne 0.00 65535.00 FORMAT "%8.2" /end CHARACTERISTIC
/begin CHARACTERISTIC DFC_DisblMsk2.DFC_IntlckChrgPlgHBrgShCirBatt2_C "" VALUE 0x80248F92 Val_Wu16 65535.00 DFES_OneToOne 0.00 65535.00 FORMAT "%8.2" /end CHARACTERISTIC
/begin CHARACTERISTIC DFC_DisblMsk2.DFC_IntlckChrgPlgHBrgShCirGnd1_C "" VALUE 0x80248F94 Val_Wu16 65535.00 DFES_OneToOne 0.00 65535.00 FORMAT "%8.2" /end CHARACTERISTIC
/begin CHARACTERISTIC DFC_DisblMsk2.DFC_IntlckChrgPlgHBrgShCirGnd2_C "" VALUE 0x80248F96 Val_Wu16 65535.00 DFES_OneToOne 0.00 65535.00 FORMAT "%8.2" /end CHARACTERISTIC
/begin CHARACTERISTIC DFC_DisblMsk2.DFC_IntlckChrgPlgHBrgShCirOvrLd_C "" VALUE 0x80248F98 Val_Wu16 65535.00 DFES_OneToOne 0.00 65535.00 FORMAT "%8.2" /end CHARACTERISTIC
/begin CHARACTERISTIC DFC_DisblMsk2.DFC_IntlckChrgPlgHBrgTempOvrCurr_C "" VALUE 0x80248F9A Val_Wu16 65535.00 DFES_OneToOne 0.00 65535.00 FORMAT "%8.2" /end CHARACTERISTIC
/begin CHARACTERISTIC DFC_DisblMsk2.DFC_IntlckChrgPlgHBrgUndrVltg_C "" VALUE 0x80248F9C Val_Wu16 65535.00 DFES_OneToOne 0.00 65535.00 FORMAT "%8.2" /end CHARACTERISTIC
/begin CHARACTERISTIC DFC_DisblMsk2.DFC_IntlckChrgPlgPosnRngFlt_C "" VALUE 0x80248F9E Val_Wu16 65535.00 DFES_OneToOne 0.00 65535.00 FORMAT "%8.2" /end CHARACTERISTIC
/begin CHARACTERISTIC DFC_DisblMsk2.DFC_IntlckChrgPlgPosnSrcMax_C "" VALUE 0x80248FA0 Val_Wu16 65535.00 DFES_OneToOne 0.00 65535.00 FORMAT "%8.2" /end CHARACTERISTIC
/begin CHARACTERISTIC DFC_DisblMsk2.DFC_IntlckChrgPlgPosnSrcMin_C "" VALUE 0x80248FA2 Val_Wu16 65535.00 DFES_OneToOne 0.00 65535.00 FORMAT "%8.2" /end CHARACTERISTIC
/begin CHARACTERISTIC DFC_DisblMsk2.DFC_MoCADCNTPBnk1_C "" VALUE 0x802491A6 Val_Wu16 65535.00 DFES_OneToOne 0.00 65535.00 FORMAT "%8.2" /end CHARACTERISTIC
/begin CHARACTERISTIC DFC_DisblMsk2.DFC_MoCADCTestVoltBnk1_C "" VALUE 0x802491A8 Val_Wu16 65535.00 DFES_OneToOne 0.00 65535.00 FORMAT "%8.2" /end CHARACTERISTIC
/begin CHARACTERISTIC Inm_ctWkUpPttTx_C "Number of times the wakeup pattern is to be transmitted in case of wakeup failure." VALUE 0x80264020 Val_Wu8 255.0 OneToOne 0.00 255.0 FORMAT "%5.1" /end CHARACTERISTIC
/begin CHARACTERISTIC Inm_swtLIN_C "Switch to declare whether LIN is present in the vehicle" VALUE 0x80264021 Val_Wu8 1.000 OneToOne 0.00 1.000 FORMAT "%5.3" EXTENDED_LIMITS 0.00 255.0 /end CHARACTERISTIC
/begin CHARACTERISTIC Inm_tiLINStBy_C "Time since emitting sleep frame before entering sleep mode" VALUE 0x80264022 Val_Wu8 63.00 Time_sec_q1_COMPU 0.00 63.00 FORMAT "%5.2" EXTENDED_LIMITS 0.00 255.0 /end CHARACTERISTIC
/begin CHARACTERISTIC IntlckChrgPlgPosn_stReplcmtVal_C "" VALUE 0x80251294 RB_Val_Wu8 1.00000000000 B_TRUE 0.00 1.00000000000 FORMAT "%13.11" /end CHARACTERISTIC
/begin CHARACTERISTIC IntlckChrgPlgPosn_SwtGASD_I.flgIvt_C " / Flag to invert the binary switch status derived from ADC input" VALUE 0x8025129C RB_Val_Wu8 255.0 boolean 0.00 255.0 FORMAT "%5.1" /end CHARACTERISTIC
/begin CHARACTERISTIC IntlckChrgPlgPosn_SwtGASD_I.tiDebHiLo_C " / Debounce time for high to low transitions" VALUE 0x8025129E RB_Val_Ws16 655350.0 RBPtCel_ti_10p0_1 -327680.0 327670.0 FORMAT "%8.1" /end CHARACTERISTIC
/begin CHARACTERISTIC IntlckChrgPlgPosn_SwtGASD_I.tiDebLoHi_C " / Debounce time for low to high transitions" VALUE 0x802512A0 RB_Val_Ws16 655350.0 RBPtCel_ti_10p0_1 -327680.0 327670.0 FORMAT "%8.1" /end CHARACTERISTIC
/begin CHARACTERISTIC IntlckChrgPlgPosn_SwtGASD_I.uAdcHysLe_C " / Low hysteresis threshold for conversion from voltage to binary signal" VALUE 0x802512A2 RB_Val_Ws16 13107.00 RBPtCel_u_0p2_1 -6553.600 6553.400 FORMAT "%8.3" /end CHARACTERISTIC
/begin CHARACTERISTIC IntlckChrgPlgPosn_SwtGASD_I.uAdcHysRi_C " / High hysteresis threshold for conversion from voltage to binary signal" VALUE 0x802512A4 RB_Val_Ws16 13107.00 RBPtCel_u_0p2_1 -6553.600 6553.400 FORMAT "%8.3" /end CHARACTERISTIC
/begin CHARACTERISTIC IntlckChrgPlgPosn_SwtGASD_I.uSrcMax_C " / Voltage threshold for SRC max error" VALUE 0x802512A6 RB_Val_Ws16 13107.00 RBPtCel_u_0p2_1 -6553.600 6553.400 FORMAT "%8.3" /end CHARACTERISTIC
/begin CHARACTERISTIC IntlckChrgPlgPosn_SwtGASD_I.uSrcMin_C " / Voltage threshold for SRC min error" VALUE 0x802512A8 RB_Val_Ws16 13107.00 RBPtCel_u_0p2_1 -6553.600 6553.400 FORMAT "%8.3" /end CHARACTERISTIC
/begin CHARACTERISTIC IntlckChrgPlg_ActrPwrStgDrvr_Cal.swtConf_C "e_:Calibration Parameter Structure for Linear Governor limitation Feature:_e;d_:Applikationsstruktur für das lineare Reglerbegrenzungsfeature:_d / e_:Minimum allowable motor torque/ motor torque threshold in downward direction to activate ramping:_e;d_:Minimales erlaubtes Motormoment in Richtung unten um Rampe zu aktivieren:_d" VALUE 0x802512AC Val_Wu8 255.0 OneToOne 0.00 255.0 FORMAT "%5.1" /end CHARACTERISTIC
/begin CHARACTERISTIC IntlckChrgPlg_ActrPwrStgDrvr_Cal.stMOCSOPChk_C "e_:Calibration Parameter Structure for Linear Governor limitation Feature:_e;d_:Applikationsstruktur für das lineare Reglerbegrenzungsfeature:_d / e_:Minimum upper motor torque:_e;d_:Minimum des oberen Motordrehmoments:_d" VALUE 0x802512AD Val_Wu8 255.0 OneToOne 0.00 255.0 FORMAT "%5.1" /end CHARACTERISTIC
/begin CHARACTERISTIC IntlckChrgPlg_ActrPwrStgDrvr_Cal.swtPSDis_C "e_:Calibration Parameter Structure for Linear Governor limitation Feature:_e;d_:Applikationsstruktur für das lineare Reglerbegrenzungsfeature:_d / e_:Minimum motor initial torque:_e;d_:Minimum des initialen Motormoments:_d" VALUE 0x802512AE Val_Wu16 65535.00 OneToOne 0.00 65535.00 FORMAT "%8.2" /end CHARACTERISTIC
/begin CHARACTERISTIC IntlckChrgPlg_HalfBrdgCal.tiBtwOpnLd_C "e_:Hlfbr Hbridge calibration structure for StdActr:_e;d_:H Brückenkalibrationsstruktur für StdActr:_d / e_:Time between recurring OpenLoad tests:_e;d_:Zeit zwischen den OpenLoad-Tests:_d" VALUE 0x802512B0 Val_Ws16 655350.0 Time_ms -327680.0 327670.0 FORMAT "%8.1" /end CHARACTERISTIC
/begin CHARACTERISTIC IntlckChrgPlg_HalfBrdgCal.tiPwmPerHbrNotTstd_C "e_:Hlfbr Hbridge calibration structure for StdActr:_e;d_:H Brückenkalibrationsstruktur für StdActr:_d / e_:Time period for PWM signal when FId_PrfXXXHbrdgNotTstdBXXX is inhibited:_e;d_:Zeitdauer für das PWM Signal wenn FId_PrfXXXHbrdgNotTstdBXXX verriegelt:_d" VALUE 0x802512B4 Val_Wu32 4294967295.00 Time_usec_q1_COMPU 0.00 4294967295.00 FORMAT "%13.2" /end CHARACTERISTIC
/begin CHARACTERISTIC IntlckChrgPlg_numStdActr_C "" VALUE 0x80264630 Val_Wu32 4294967295.00 OneToOne 0.00 4294967295.00 FORMAT "%13.2" /end CHARACTERISTIC
/begin CHARACTERISTIC IntlckChrgPlg_PwmOutCal.rMin_C " / Lower threshold to limit the duty cycle output" VALUE 0x80264634 Val_Ws16 655.3500 DtyCyc -327.6800 327.6700 FORMAT "%8.4" /end CHARACTERISTIC
/begin CHARACTERISTIC IntlckChrgPlg_PwmOutCal.rMax_C " / Upper threshold to limit the duty cycle output" VALUE 0x80264636 Val_Ws16 655.3500 DtyCyc -327.6800 327.6700 FORMAT "%8.4" /end CHARACTERISTIC
/begin CHARACTERISTIC IntlckChrgPlg_PwmOutCal.swtBattCor_C " / Battery voltage correction for the output duty cycle active" VALUE 0x80264638 Val_Wu8 255.0 OneToOne 0.00 255.0 FORMAT "%5.1" /end CHARACTERISTIC
/begin CHARACTERISTIC IntlckChrgPlg_ratActLin_CUR "" CURVE 0x802645C8 RB_Curve_S16_S16 511.9922 rel_q0p0078125 -256.0000 255.9922 FORMAT "%8.4"
 /begin AXIS_DESCR STD_AXIS IntlckChrgPlg_rAct Prc 25 -400.0000 399.9878 FORMAT "%8.4" DEPOSIT ABSOLUTE /end AXIS_DESCR
/end CHARACTERISTIC
/begin CHARACTERISTIC IntlckChrgPlg_rCnv_MAP "" MAP 0x80264070 RB_Map_S16S16_S16 655.3500 DtyCyc -327.6800 327.6700 FORMAT "%8.4"
 /begin AXIS_DESCR STD_AXIS IntlckChrgPlg_rActr Prc 25 -400.0000 399.9878 FORMAT "%8.4" DEPOSIT ABSOLUTE /end AXIS_DESCR
 /begin AXIS_DESCR STD_AXIS EnvP_p Pres_hPa 25 -32768.00 32767.00 FORMAT "%8.2" DEPOSIT ABSOLUTE /end AXIS_DESCR
/end CHARACTERISTIC
/begin CHARACTERISTIC IntlckChrgPlg_StdCal.tiDesValFlt_C " / PT1 Filter time constant for setpoint to calculate simulated feedback" VALUE 0x80264024 Val_Ws32 4294.9672940000000 TimeDelay_s 0.0000020000000 4294.9672959999998 FORMAT "%19.14" EXTENDED_LIMITS 0.000002000000001 4294.9672959999998 /end CHARACTERISTIC
/begin CHARACTERISTIC IntlckChrgPlg_StdCal.rPsOff_C " / Dutycycle value for actuator switch off" VALUE 0x80264028 Val_Ws16 655.3500 DtyCyc -327.6800 327.6700 FORMAT "%8.4" /end CHARACTERISTIC
/begin CHARACTERISTIC IntlckChrgPlg_StdCal.rActrStop_C " / Actuator shut off PWM duty cycle" VALUE 0x8026402A Val_Ws16 655.3500 DtyCyc -327.6800 327.6700 FORMAT "%8.4" /end CHARACTERISTIC
/begin CHARACTERISTIC IntlckChrgPlg_StdCal.rHysHigh_C " / e_:upper hysteresis threshold:_e;d_:Obere Hystereseschwelle:_d" VALUE 0x8026402C Val_Ws16 655.3500 DtyCyc -327.6800 327.6700 FORMAT "%8.4" /end CHARACTERISTIC
/begin CHARACTERISTIC IntlckChrgPlg_StdCal.rHysLow_C " / e_:lower hysteresis threshold:_e;d_:Untere Hystereseschwelle:_d" VALUE 0x8026402E Val_Ws16 655.3500 DtyCyc -327.6800 327.6700 FORMAT "%8.4" /end CHARACTERISTIC
/begin CHARACTERISTIC IntlckChrgPlg_StdCal.stPwrStgDiaDis_C " / Mask to disable powerstage diagnosis" VALUE 0x80264030 Val_Wu16 65535.00 OneToOne 0.00 65535.00 FORMAT "%8.2" /end CHARACTERISTIC
/begin CHARACTERISTIC IntlckChrgPlg_StdCal.stPlausDiaDis_C " / e_:Mask to disable plausibility diagnosis:_e;d_:Maske zur Deaktivierung der Plausibilitätsdiagnose:_d" VALUE 0x80264032 Val_Wu16 65535.00 OneToOne 0.00 65535.00 FORMAT "%8.2" /end CHARACTERISTIC
/begin CHARACTERISTIC IntlckChrgPlg_StdCal.stPwrStgDis_C " / Mask to disable powerstage actuation under different conditions" VALUE 0x80264034 Val_Wu16 65535.00 OneToOne 0.00 65535.00 FORMAT "%8.2" /end CHARACTERISTIC
/begin CHARACTERISTIC IntlckChrgPlg_StdCal.stActrStop_C " / Bitcoded value of the states where actuator switchoff signal should be sent" VALUE 0x80264036 Val_Wu16 65535.00 OneToOne 0.00 65535.00 FORMAT "%8.2" /end CHARACTERISTIC
/begin CHARACTERISTIC IntlckChrgPlg_StdCal.stAllPwrStgDiaEna_C " / Switch configuration for power stage diagnosis for digital actuators" VALUE 0x80264038 Val_Wu8 255.0 OneToOne 0.00 255.0 FORMAT "%5.1" /end CHARACTERISTIC
/begin CHARACTERISTIC IntlckChrgPlg_StdCal.swtDesVal_C " / Switch to select default setpoint" VALUE 0x80264039 Val_Wu8 255.0 OneToOne 0.00 255.0 FORMAT "%5.1" /end CHARACTERISTIC
/begin CHARACTERISTIC IntlckChrgPlg_StdCal.numDiagTry_C " / Counter to limit the number of active diagnosis" VALUE 0x8026403A Val_Wu8 255.0 OneToOne 0.00 255.0 FORMAT "%5.1" /end CHARACTERISTIC
/begin CHARACTERISTIC IntlckChrgPlg_StdCal.rDesValOff_C " / Default desired value in case of power stage errors" VALUE 0x8026403C Val_Ws16 799.9878 Prc -400.0000 399.9878 FORMAT "%8.4" /end CHARACTERISTIC
/begin CHARACTERISTIC IntlckChrgPlg_StdCal.rDesValOn_C " / Default desired value for On position" VALUE 0x8026403E Val_Ws16 799.9878 Prc -400.0000 399.9878 FORMAT "%8.4" /end CHARACTERISTIC
/begin CHARACTERISTIC IntlckChrgPlg_StdCal.numEngDaFrqPs_C " / variable frequency option in PWM signals" VALUE 0x80264040 Val_Wu16 255.000000000 DELIB_ALLTEMP_VERB_COMPU 0.00 255.000000000 FORMAT "%13.9" /end CHARACTERISTIC
/begin CHARACTERISTIC IntlckChrgPlg_StdCal.tiSlwRespSimPT1_C " / PT1 Filter time constant for slow response simulation" VALUE 0x80264044 Val_Ws32 4294.9672940000000 TimeDelay_s 0.0000020000000 4294.9672959999998 FORMAT "%19.14" EXTENDED_LIMITS 0.000002000000001 4294.9672959999998 /end CHARACTERISTIC
/begin CHARACTERISTIC IntlckChrgPlg_StdCal.uHiBattThd_C " / Upper hysteresis threshold for BattU_u" VALUE 0x80264048 Val_Ws16 1310700. Volt_Batt -655360.0 655340.0 FORMAT "%8.1" /end CHARACTERISTIC
/begin CHARACTERISTIC IntlckChrgPlg_StdCal.uLoBattThd_C " / Lower hysteresis threshold for BattU_u" VALUE 0x8026404A Val_Ws16 1310700. Volt_Batt -655360.0 655340.0 FORMAT "%8.1" /end CHARACTERISTIC
/begin CHARACTERISTIC IntlckChrgPlg_StdCal.tiDebBattVoltOk_C " / Healing time of defected battery voltage" VALUE 0x8026404C Val_Ws16 655350.0 Time_ms -327680.0 327670.0 FORMAT "%8.1" /end CHARACTERISTIC
/begin CHARACTERISTIC IntlckChrgPlg_StdCal.tiDebBattVoltDfct_C " / Debounce time to sense Battery voltage Defect" VALUE 0x8026404E Val_Ws16 655350.0 Time_ms -327680.0 327670.0 FORMAT "%8.1" /end CHARACTERISTIC
/begin CHARACTERISTIC IntlckChrgPlg_StdCal.mskActrActv_C " / Bitmask to choose in which engine states the actuator is activated" VALUE 0x80264050 Val_Wu8 255.0 OneToOne 0.00 255.0 FORMAT "%5.1" /end CHARACTERISTIC
/begin CHARACTERISTIC IntlckChrgPlg_StdCal.tiDlyActrActvn_C " / Delay for actuator activation" VALUE 0x80264052 Val_Wu16 6553.500 TiSec_q0p1_COMPU 0.00 6553.500 FORMAT "%8.3" /end CHARACTERISTIC
/begin CHARACTERISTIC IntlckChrgPlg_StdCal.rPsActrOff_C " / Replacement value for powerstage dutycycle when actuator is not activated" VALUE 0x80264054 Val_Ws16 655.3500 DtyCyc -327.6800 327.6700 FORMAT "%8.4" /end CHARACTERISTIC
/begin CHARACTERISTIC IntlckChrgPlg_StdCal.uBattMin_C " / Minimum value of battery voltage to enable Clean and Verify" VALUE 0x80264056 Val_Ws16 1310700. Volt_Batt -655360.0 655340.0 FORMAT "%8.1" /end CHARACTERISTIC
/begin CHARACTERISTIC IntlckChrgPlg_StdCal.uBattMax_C " / Maximum value of battery voltage to enable zero point adaption" VALUE 0x80264058 Val_Ws16 1310700. Volt_Batt -655360.0 655340.0 FORMAT "%8.1" /end CHARACTERISTIC
/begin CHARACTERISTIC IntlckChrgPlg_StdCal.tiShOffCtrlDne_C " / Delay for deactivation of the actuator when shut off is done" VALUE 0x8026405A Val_Ws16 655350.0 Time_ms -327680.0 327670.0 FORMAT "%8.1" /end CHARACTERISTIC
/begin CHARACTERISTIC IntlckChrgPlg_StdCal.swtDeactvn_C " / bitmask to deactivate the actuator by calibration" VALUE 0x8026405C Val_Wu8 255.0 OneToOne 0.00 255.0 FORMAT "%5.1" /end CHARACTERISTIC
/begin CHARACTERISTIC IntlckChrgPlg_StdCal.tiSelfDiagStrt_C " / Delay time to start the self diagnosis of the powertstage once the engine state has reached the required state." VALUE 0x8026405E Val_Ws16 655350.0 Time_ms -327680.0 327670.0 FORMAT "%8.1" /end CHARACTERISTIC
/begin CHARACTERISTIC IntlckChrgPlg_StdCal.flgReacvnPostDrv_C " / e_:Reactivation of actuator at transition into POSTDRIVE.:_e;d_:Reaktivierung des Stellers beim Ã?bergang in den POSTDRIVE.:_d" VALUE 0x80264060 Val_Wu8 255.0 OneToOne 0.00 255.0 FORMAT "%5.1" /end CHARACTERISTIC
/begin CHARACTERISTIC IntlckChrgPlg_StdCal.rPsRlyOff_C " / e_:Calibration to indicate the switch-off dutycycle:_e;d_:Kalibrierung zur Anzeige des Ausschaltzyklus:_d" VALUE 0x80264062 Val_Ws16 655.3500 DtyCyc -327.6800 327.6700 FORMAT "%8.4" /end CHARACTERISTIC
/begin CHARACTERISTIC IntlckChrgPlg_StdCal.tiRlyOnDly_C " / e_:Calibration to delay the enabling of powerstage:_e;d_:Kalibrierung, um die Aktivierung der Endstufe zu verzögern:_d" VALUE 0x80264064 Val_Ws16 33.55392 RBPtCel_ti_5p12em4_1 -16.77722 16.77670 FORMAT "%8.5" /end CHARACTERISTIC
/begin CHARACTERISTIC IntlckChrgPlg_StdCal.nFMInWinMsk_C " / e_:Calibration mask to select the proper window representing the actuator jammed error:_e;d_:Maske für die Auswahl des Frequenzfensters für das blockierte Ventil:_d" VALUE 0x80264068 Val_Wu32 4294967295.00 OneToOne 0.00 4294967295.00 FORMAT "%13.2" /end CHARACTERISTIC
/begin CHARACTERISTIC IntlckChrgPlg_StdCal.tiFMInDeb_C " / e_:Time for debouncing the frequency window::_e;d_:Zeit zum Entprellen des Frequenzfensters:_d" VALUE 0x8026406C Val_Wu8 2550. Time_ms 0.00 2550. FORMAT "%5.0" /end CHARACTERISTIC
/begin CHARACTERISTIC IntlckChrgPlg_StdCal.tiJamActrWait_C " / e_:Time to start the jammed actuator debouncing after the preliminary error:_e;d_:Zeit zum Starten der Entprellung des blockierten Stellers nach dem vorläufigen Fehler:_d" VALUE 0x8026406E Val_Ws16 6553.500 t_q0p1 -3276.800 3276.700 FORMAT "%8.3" /end CHARACTERISTIC
/begin CHARACTERISTIC IntlckChrgPlg_StdHbrDiaCal.tiBtwTestPrel_C " / Time between test during preliminary error in short circuit, over temperature, or open load" VALUE 0x8026463A Val_Ws16 655350.0 Time_ms -327680.0 327670.0 FORMAT "%8.1" /end CHARACTERISTIC
/begin CHARACTERISTIC IntlckChrgPlg_StdHbrDiaCal.tiBtwTestPrmnt_C " / Time between test during permanent short circuit or over temperature error" VALUE 0x8026463C Val_Ws16 655350.0 Time_ms -327680.0 327670.0 FORMAT "%8.1" /end CHARACTERISTIC
/begin CHARACTERISTIC IntlckChrgPlg_StdHbrDiaCal.tiBtwTestPrmntOl_C " / Time between test during permanent open load error in active mode" VALUE 0x8026463E Val_Ws16 655350.0 Time_ms -327680.0 327670.0 FORMAT "%8.1" /end CHARACTERISTIC
/begin CHARACTERISTIC IntlckChrgPlg_StdHbrDiaCal.tiOpenLoadDiagDurn_C " / Extended open load diagnosis duration" VALUE 0x80264640 Val_Ws16 655350.0 Time_ms -327680.0 327670.0 FORMAT "%8.1" /end CHARACTERISTIC
/begin CHARACTERISTIC IntlckChrgPlg_StdHbrDiaCal.tiExtdOpenLoadDiagDurn_C " / Open load diagnosis duration" VALUE 0x80264642 Val_Ws16 655350.0 Time_ms -327680.0 327670.0 FORMAT "%8.1" /end CHARACTERISTIC
/begin CHARACTERISTIC IntlckChrgPlg_swtBattCorSqd_C "" VALUE 0x802645BA Val_Wu8 255.0 OneToOne 0.00 255.0 FORMAT "%5.1" /end CHARACTERISTIC
/begin CHARACTERISTIC IntlckChrgPlg_swtConf2_C "" VALUE 0x802645BC Val_Wu32 4294967295.00 OneToOne 0.00 4294967295.00 FORMAT "%13.2" /end CHARACTERISTIC
/begin CHARACTERISTIC IntlckChrgPlg_swtConfStdActrSwVers162_C "" VALUE 0x802645C0 Val_Wu32 4294967295.00 OneToOne 0.00 4294967295.00 FORMAT "%13.2" /end CHARACTERISTIC
/begin CHARACTERISTIC IntlckChrgPlg_swtConf_C "" VALUE 0x802645C4 Val_Wu32 4294967295.00 OneToOne 0.00 4294967295.00 FORMAT "%13.2" /end CHARACTERISTIC
/begin CHARACTERISTIC IntlckChrgPlg_tiPwmPer_C "" VALUE 0x80240898 RB_Val_Wu32 65535.0000000 Time_usec_q1_COMPU 0.00 65535.0000000 FORMAT "%13.7" EXTENDED_LIMITS 0.00 4294967295.00 /end CHARACTERISTIC
/begin CHARACTERISTIC IntlckChrgPlg_tiPwmPer_MAP "" MAP 0x8024034C RB_Map_S16S16_U16_sao 65535.00 Time_usec_q1_COMPU 0.00 65535.00 FORMAT "%8.2"
 /begin AXIS_DESCR STD_AXIS Epm_nEng EngN 25 -16384.00 16383.50 FORMAT "%8.2" DEPOSIT ABSOLUTE /end AXIS_DESCR
 /begin AXIS_DESCR STD_AXIS VehV_v Vel 25 -327.6800 327.6700 FORMAT "%8.4" DEPOSIT ABSOLUTE /end AXIS_DESCR
/end CHARACTERISTIC
/begin CHARACTERISTIC LLim_aDifNeg_C "Maximum negative change of Acceleration Request per cycle" VALUE 0x802512B8 RB_Val_Ws16 65.53500 Acc -32.76800 32.76700 FORMAT "%8.5" /end CHARACTERISTIC
/begin CHARACTERISTIC LLim_aDifPos_C "Maximum Positive change of Acceleration Request per cycle" VALUE 0x802512BA RB_Val_Ws16 65.53500 Acc -32.76800 32.76700 FORMAT "%8.5" /end CHARACTERISTIC
/begin CHARACTERISTIC LLim_aMSL_T "Curve for Speed limiter acceleration limit" CURVE 0x802512BC RB_Curve_S16_S16 65.53500 Acc -32.76800 32.76700 FORMAT "%8.5"
 /begin AXIS_DESCR STD_AXIS NO_INPUT_QUANTITY Vel 9 -327.6800 327.6700 FORMAT "%8.4" DEPOSIT ABSOLUTE /end AXIS_DESCR
/end CHARACTERISTIC
/begin CHARACTERISTIC LLim_axMax_C "Upper Bound for acceleration request" VALUE 0x802512E2 RB_Val_Ws16 65.53500 Acc -32.76800 32.76700 FORMAT "%8.5" /end CHARACTERISTIC
/begin CHARACTERISTIC LLim_vMaxFixdNorm_C "Highest velocity in normal mode" VALUE 0x802512E4 RB_Val_Ws16 655.3500 Vel -327.6800 327.6700 FORMAT "%8.4" /end CHARACTERISTIC
/begin CHARACTERISTIC LLim_vMaxFixdRvs_C "The vehicle velocity is limited in Reverse Gear to this maximum value" VALUE 0x802512E6 RB_Val_Ws16 655.3500 Vel -327.6800 327.6700 FORMAT "%8.4" /end CHARACTERISTIC
/begin CHARACTERISTIC LLim_vThd_C "Velocity Threshold for activating Speed Limiter" VALUE 0x802512E8 RB_Val_Ws16 655.3500 Vel -327.6800 327.6700 FORMAT "%8.4" /end CHARACTERISTIC
/begin CHARACTERISTIC LvGrid_duDcdcLimRampStepNeg_C "slope during fall of set point voltage DCDC converter on LV side in reduced mode" VALUE 0x802512EC RB_Val_Wu32 255999.999960 q5p96046Em5_V_DIV_s 0.00 255999.999960 FORMAT "%13.6" /end CHARACTERISTIC
/begin CHARACTERISTIC LvGrid_duDcdcLimRampStepPos_C "slope during rise of set point voltage DCDC converter on LV side in reduced mode" VALUE 0x802512F0 RB_Val_Wu32 255999.999960 q5p96046Em5_V_DIV_s 0.00 255999.999960 FORMAT "%13.6" /end CHARACTERISTIC
/begin CHARACTERISTIC LvGrid_duRampStepNeg_C "Slope during fall of setpoint voltage of DCDC converter on LV side" VALUE 0x802512F4 RB_Val_Wu32 255999.999960 q5p96046Em5_V_DIV_s 0.00 255999.999960 FORMAT "%13.6" /end CHARACTERISTIC
/begin CHARACTERISTIC LvGrid_duRampStepPos_C "Slope during rise of setpoint voltage of DCDC converter on LV side" VALUE 0x802512F8 RB_Val_Wu32 255999.999960 q5p96046Em5_V_DIV_s 0.00 255999.999960 FORMAT "%13.6" /end CHARACTERISTIC
/begin CHARACTERISTIC LvGrid_maskDcdcULimReqSq_C "Calibration mask to determine the LV limit request validity" VALUE 0x802512FC RB_Val_Wu16 65535.00 OneToOne 0.00 65535.00 FORMAT "%8.2" /end CHARACTERISTIC
/begin CHARACTERISTIC LvGrid_maskEbsSocLvBattSq_C "Calibration mask to determine the state of LV battery validity" VALUE 0x802512FE RB_Val_Wu16 65535.00 OneToOne 0.00 65535.00 FORMAT "%8.2" /end CHARACTERISTIC
/begin CHARACTERISTIC LvGrid_maskEbsTLvBattSq_C "Calibration mask to determine the LV battery temperature validity" VALUE 0x80251300 RB_Val_Wu16 65535.00 OneToOne 0.00 65535.00 FORMAT "%8.2" /end CHARACTERISTIC
/begin CHARACTERISTIC LvGrid_maskEbsUBattFildSq_C "Calibration mask to determine the Sensor value battery voltage validity" VALUE 0x80251302 RB_Val_Wu16 65535.00 OneToOne 0.00 65535.00 FORMAT "%8.2" /end CHARACTERISTIC
/begin CHARACTERISTIC LvGrid_tAmbInit_C "Init value for ambient temperature ramp" VALUE 0x80251304 RB_Val_Ws16 6553.500 Temp_Cels -3549.940 3003.560 FORMAT "%8.3" /end CHARACTERISTIC
/begin CHARACTERISTIC LvGrid_tiDcdcRedUReqTOut_C "Calibratable time to request for a lower DCDC setpoint voltage and this would be allowed for a short period of time" VALUE 0x80251306 RB_Val_Wu16 655.3500 RBPtCel_ti_0p01_1 0.00 655.3500 FORMAT "%8.4" /end CHARACTERISTIC
/begin CHARACTERISTIC LvGrid_tiOnDlyFrwdMod_C "Delay activation of temperature curve values" VALUE 0x80251308 RB_Val_Wu16 655350.0 RBPtCel_ti_10p0_3 0.00 655350.0 FORMAT "%8.1" /end CHARACTERISTIC
/begin CHARACTERISTIC LvGrid_tRampStepNeg_C "Ramp limit" VALUE 0x8025130C RB_Val_Wu32 6553599.99740 q1p52588Em3_DegCgrd_DIV_s 0.00 6553599.99740 FORMAT "%13.5" /end CHARACTERISTIC
/begin CHARACTERISTIC LvGrid_tRampStepPos_C "Ramp limit" VALUE 0x80251310 RB_Val_Wu32 6553599.99740 q1p52588Em3_DegCgrd_DIV_s 0.00 6553599.99740 FORMAT "%13.5" /end CHARACTERISTIC
/begin CHARACTERISTIC LvGrid_uDcdcFrwd_C "Calibrated FORWARD setpoint" VALUE 0x80251314 RB_Val_Ws16 255.9961 spg_q0p0039 -128.0000 127.9961 FORMAT "%8.4" /end CHARACTERISTIC
/begin CHARACTERISTIC LvGrid_uDcdcLvRedReq_C "Calibration value for reduced set point voltage of DCDC converter" VALUE 0x80251316 RB_Val_Ws16 255.9961 spg_q0p0039 -128.0000 127.9961 FORMAT "%8.4" /end CHARACTERISTIC
/begin CHARACTERISTIC LvGrid_uDesDcdcAllwbl_C "Calibration value for allowable set point voltage of DCDC converter" VALUE 0x80251318 RB_Val_Ws16 255.9961 spg_q0p0039 -128.0000 127.9961 FORMAT "%8.4" /end CHARACTERISTIC
/begin CHARACTERISTIC LvGrid_uDesDcdcInit_C "Init setpoint" VALUE 0x8025131A RB_Val_Ws16 255.9961 spg_q0p0039 -128.0000 127.9961 FORMAT "%8.4" /end CHARACTERISTIC
/begin CHARACTERISTIC LvGrid_uDesDcdcRMPInit_C "Voltage setpoint ramp" VALUE 0x8025131C RB_Val_Ws16 255.9961 spg_q0p0039 -128.0000 127.9961 FORMAT "%8.4" /end CHARACTERISTIC
/begin CHARACTERISTIC LvGrid_uDesDcdcSocErrSub_C "Calibration value for SOC error substitutional set point voltage for Dcdc converter" VALUE 0x8025131E RB_Val_Ws16 255.9961 spg_q0p0039 -128.0000 127.9961 FORMAT "%8.4" /end CHARACTERISTIC
/begin CHARACTERISTIC LvGrid_uDesDcdcTErrSub_C "Calibration value for tempertature error substitutional set point voltage for Dcdc converter" VALUE 0x80251320 RB_Val_Ws16 255.9961 spg_q0p0039 -128.0000 127.9961 FORMAT "%8.4" /end CHARACTERISTIC
/begin CHARACTERISTIC LvGrid_uNrmSocBatt_T "Curve value for state of battery based set point voltage for DCDC converter" CURVE 0x80251322 RB_Curve_U8_S16_sao 255.9961 spg_q0p0039 -128.0000 127.9961 FORMAT "%8.4"
 /begin AXIS_DESCR STD_AXIS Ebs_ratSocFild rel_q1 8 0.00 255.0 FORMAT "%5.1" DEPOSIT ABSOLUTE /end AXIS_DESCR
/end CHARACTERISTIC
/begin CHARACTERISTIC LvGrid_uNrmTBatt_T "Chrging Voltage based on battery temperature" CURVE 0x8025133C RB_Curve_S16_S16 255.9961 spg_q0p0039 -128.0000 127.9961 FORMAT "%8.4"
 /begin AXIS_DESCR STD_AXIS LvGrid_tFild Temp_Cels 8 -3549.940 3003.560 FORMAT "%8.3" DEPOSIT ABSOLUTE /end AXIS_DESCR
/end CHARACTERISTIC
/begin CHARACTERISTIC MedTPmp_dratNegSlop_C "Negative slope for desired pump ratio ramp" VALUE 0x80251360 RB_Val_Wu32 799999.999814 RmpPrc 0.00 799999.999814 FORMAT "%13.6" /end CHARACTERISTIC
/begin CHARACTERISTIC MedTPmp_dratPosSlop_C "Positive slope for desired pump ratio ramp" VALUE 0x80251364 RB_Val_Wu32 799999.999814 RmpPrc 0.00 799999.999814 FORMAT "%13.6" /end CHARACTERISTIC
/begin CHARACTERISTIC MedTPmp_ratDes_M "Calibration map to convert cooling request to MT pump ratio" MAP 0x80251368 RB_Map_S16S16_S16 799.9878 RBPtCel_Perc_0p012207_1 -400.0000 399.9878 FORMAT "%8.4"
 /begin AXIS_DESCR STD_AXIS WtrPmp1_pLossMedT RBPtCel_p_0p1_4 5 -3276.800 3276.700 FORMAT "%8.3" DEPOSIT ABSOLUTE /end AXIS_DESCR
 /begin AXIS_DESCR STD_AXIS WtrPmp1_mfDesMedT q1p220703Em4_kg_DIV_s 5 -4.000000 3.999878 FORMAT "%8.6" DEPOSIT ABSOLUTE /end AXIS_DESCR
/end CHARACTERISTIC
/begin CHARACTERISTIC MedTPmp_ratSCtPmp1Delta_C "calibrateable delta thershold ratio of control value provided by governor" VALUE 0x802513B2 RB_Val_Ws16 799.9878 RBPtCel_Perc_0p012207_1 -400.0000 399.9878 FORMAT "%8.4" /end CHARACTERISTIC
/begin CHARACTERISTIC MedTPmp_ratSCtPmp1Lo_C "calibrateable lower thershold ratio of control value provided by governor" VALUE 0x802513B4 RB_Val_Ws16 799.9878 RBPtCel_Perc_0p012207_1 -400.0000 399.9878 FORMAT "%8.4" /end CHARACTERISTIC
/begin CHARACTERISTIC MedTPmp_tiSpplCooltPmpRly_C "calibrateable time for turn on the the e-water pump relay" VALUE 0x802513B6 RB_Val_Ws16 655.3500 Time_s -327.6800 327.6700 FORMAT "%8.4" /end CHARACTERISTIC
/begin CHARACTERISTIC MILLmp_cwReqActv_C "Controlword for special functions of the Mil module" VALUE 0x80264644 Val_Wu8 255.0 OneToOne 0.00 255.0 FORMAT "%5.1" /end CHARACTERISTIC
/begin CHARACTERISTIC MILLmp_tiAftStrt_C "time for MIL_ON after engine start" VALUE 0x80264645 Val_Wu8 50.00 t200msxs_ub_b51 0.00 50.00 FORMAT "%5.2" EXTENDED_LIMITS 0.00 51.00 /end CHARACTERISTIC
/begin CHARACTERISTIC MILLmp_tiVisTst_C "time for function test of the MIL" VALUE 0x80264646 Val_Wu8 51.00 t200msxs_ub_b51 0.00 51.00 FORMAT "%5.2" /end CHARACTERISTIC
/begin CHARACTERISTIC MoCADC_cntrDebNTP_C "Final value of Error counter for verifying of Null-- Load-Test-Pulse" VALUE 0x8026CBE0 Val_Wu8 5100.00 t20ms_ub_b5100 0.00 5100.00 /end CHARACTERISTIC
/begin CHARACTERISTIC MoCADC_cntrDebTest_C "Error counter end value of test voltage verification" VALUE 0x8026CBE1 Val_Wu8 255.0 dez 0.00 255.0 FORMAT "%5.1" /end CHARACTERISTIC
/begin CHARACTERISTIC MoCADC_cntrRstNTP_C "Number of permitted resets for verifying of Null-- Load-Test-Pulse" VALUE 0x8026CBE2 Val_Wu8 255.0 dez 0.00 255.0 FORMAT "%5.1" /end CHARACTERISTIC
/begin CHARACTERISTIC MoCADC_cntrRstTest_C "Number of permissible resets in case of an error in test voltage verification" VALUE 0x8026CBE3 Val_Wu8 255.0 dez 0.00 255.0 FORMAT "%5.1" /end CHARACTERISTIC
/begin CHARACTERISTIC MoCADC_uNTPBnk1Max_C "Maximum ADC value in case of ADC channel moved to low during the ADC verification in bank1" VALUE 0x8026CBE4 Val_Wu8 2.490 spg_q0p00977 0.00 2.490 FORMAT "%5.3" /end CHARACTERISTIC
/begin CHARACTERISTIC MoCADC_uTestMax_C "Maximum test voltage in ADC test" VALUE 0x8026D23C Val_Ws16 319995.1 spg_q4p88_mV -160000.0 159995.1 FORMAT "%8.1" /end CHARACTERISTIC
/begin CHARACTERISTIC MoCADC_uTestMin_C "Minimum test voltage in ADC test" VALUE 0x8026D23E Val_Ws16 319995.1 spg_q4p88_mV -160000.0 159995.1 FORMAT "%8.1" /end CHARACTERISTIC
/begin CHARACTERISTIC MoCCPU_stLockStepTstActv_CW "Codeword to create lockstep core error for test purpose" VALUE 0x80270600 Val_Wu8 1.000 dez 0.00 1.000 FORMAT "%5.3" EXTENDED_LIMITS 0.00 255.0 /end CHARACTERISTIC
/begin CHARACTERISTIC MoCGTM_cntrCMPErrbitHealMax_C "Number of times CMP patter match should occur to initiate healing of MoCGTM_cntrCMPErrbit" VALUE 0x8026CBE6 Val_Wu8 255.0 dez 0.00 255.0 FORMAT "%5.1" /end CHARACTERISTIC
/begin CHARACTERISTIC MoCGTM_cntrDebErrMax_C "Max. allowed deviation between badcase created and detected occured" VALUE 0x8026CBE7 Val_Wu8 255.0 dez 0.00 255.0 FORMAT "%5.1" /end CHARACTERISTIC
/begin CHARACTERISTIC MoCGTM_cntrErrClkMonMax_C "Maximum allowed debounce time for error in clock monitoring in GTM" VALUE 0x8026CBE8 Val_Wu8 255.0 dez 0.00 255.0 FORMAT "%5.1" /end CHARACTERISTIC
/begin CHARACTERISTIC MoCGTM_stChksTstActv_CW "Calibration for ECU-MST test of MCS ROM check" VALUE 0x80270602 Val_Wu8 1.000 dez 0.00 1.000 FORMAT "%5.3" EXTENDED_LIMITS 0.00 255.0 /end CHARACTERISTIC
/begin CHARACTERISTIC MoCGTM_stClkMonTestActv_CW "Codeword to activate MFT (Monitoring Function Test) for clock monitoring in MoCGTM" VALUE 0x80270603 Val_Wu8 255.0 dez 0.00 255.0 FORMAT "%5.1" /end CHARACTERISTIC
/begin CHARACTERISTIC MoCGTM_stSWResetDem_CW "Codeword for enabling reset and Error pin as error reaction in case of failure of MoCGTM tests" VALUE 0x8026CBED Val_Wu8 255.0 dez 0.00 255.0 FORMAT "%5.1" /end CHARACTERISTIC
/begin CHARACTERISTIC MoCGTM_stTestActv_CW "Codeword to activate MFT (Monitoring Function Test) and check the error reaction from MoCGTM_Co" VALUE 0x80270604 Val_Wu8 1.000 dez 0.00 1.000 FORMAT "%5.3" EXTENDED_LIMITS 0.00 255.0 /end CHARACTERISTIC
/begin CHARACTERISTIC MoCGTM_tiEClkPerdMax_C "Maximum allowed value of Period transferred from TIM for the ECLK signal." VALUE 0x8026CBEE Val_Wu8 255.0 dez 0.00 255.0 FORMAT "%5.1" /end CHARACTERISTIC
/begin CHARACTERISTIC MoCGTM_tiEClkPerdMin_C "Minimum allowed value of Period transferred from TIM for the ECLK signal." VALUE 0x8026CBEF Val_Wu8 255.0 dez 0.00 255.0 FORMAT "%5.1" /end CHARACTERISTIC
/begin CHARACTERISTIC MoCGTM_tiEClkTOnMax_C "Maximum allowed value of duty cycle transferred from TIM for the ECLK signal." VALUE 0x8026CBF0 Val_Wu8 255.0 dez 0.00 255.0 FORMAT "%5.1" /end CHARACTERISTIC
/begin CHARACTERISTIC MoCGTM_tiEClkTOnMin_C "Minimum allowed value of duty cycle transferred from TIM for the ECLK signal." VALUE 0x8026CBF1 Val_Wu8 255.0 dez 0.00 255.0 FORMAT "%5.1" /end CHARACTERISTIC
/begin CHARACTERISTIC MoCHwLogicTest_stTestActv_CW "Codeword to activate MFT (Monitoring Function Test) and check the error reaction from MoCHwLogicTest_Co" VALUE 0x80270606 Val_Wu8 255.0 dez 0.00 255.0 FORMAT "%5.1" /end CHARACTERISTIC
/begin CHARACTERISTIC MoCHwLogicTest_swtDisblErrReactn_CW "Calibration to disable error reaction from checks in hardware logic test module" VALUE 0x8026CBF2 Val_Wu8 255.0 dez 0.00 255.0 FORMAT "%5.1" /end CHARACTERISTIC
/begin CHARACTERISTIC MoCHwLogicTest_swtDisblFwChk_CA "Calibration to disable error reaction from Firmware checks" VAL_BLK 0x8026CFD4 ValA_Wu32 4294967295.00 OneToOne 0.00 4294967295.00 FORMAT "%13.2" MATRIX_DIM 5 /end CHARACTERISTIC
/begin CHARACTERISTIC MoCIWDH_stPtlRespTstActv_CW "Codeword to destroy the partial response from MoCIWDH if enabled" VALUE 0x80270607 Val_Wu8 1.000 dez 0.00 1.000 FORMAT "%5.3" EXTENDED_LIMITS 0.00 255.0 /end CHARACTERISTIC
/begin CHARACTERISTIC MoCMemStrtUp_chkRamTest_C "Parameter to request corruption of RAM test during complete memory test" VALUE 0x80270608 Val_Wu8 255.0 dez 0.00 255.0 FORMAT "%5.1" /end CHARACTERISTIC
/begin CHARACTERISTIC MoCMemStrtUp_chkRomTest_C "Parameter to request corruption of ROM test during complete memory test" VALUE 0x80270609 Val_Wu8 255.0 dez 0.00 255.0 FORMAT "%5.1" /end CHARACTERISTIC
/begin CHARACTERISTIC MoCMem_ctDebErrChkRAM_C "Error tolerance threshold for double storage and cyclic RAM-Test" VALUE 0x8026CBF4 Val_Wu8 255.0 dez 0.00 255.0 FORMAT "%5.1" /end CHARACTERISTIC
/begin CHARACTERISTIC MoCMem_ctDebErrChkROM_C "Error tolerance threshold for cyclic ROM-Test" VALUE 0x8026CBF5 Val_Wu8 255.0 dez 0.00 255.0 FORMAT "%5.1" /end CHARACTERISTIC
/begin CHARACTERISTIC MoCMem_ctDebHealChkRAMCpl_C "Complement of the tolerance threshold of the healing counter for the double storage and the cyclical RAM-tests" VALUE 0x8027060A Val_Wu8 255.0 dez 0.00 255.0 FORMAT "%5.1" /end CHARACTERISTIC
/begin CHARACTERISTIC MoCMem_ctDebHealChkRAM_C "Tolerance threshold of the healing counter for the double storage and the cyclical RAM-tests" VALUE 0x8026CBF6 Val_Wu8 255.0 dez 0.00 255.0 FORMAT "%5.1" /end CHARACTERISTIC
/begin CHARACTERISTIC MoCMem_ctDebHealChkROMCpl_C "Complement of the tolerance threshold of the healing counter for the cyclical ROM-tests" VALUE 0x8027060B Val_Wu8 255.0 dez 0.00 255.0 FORMAT "%5.1" /end CHARACTERISTIC
/begin CHARACTERISTIC MoCMem_ctDebHealChkROM_C "Tolerance threshold of the healing counter for the cyclical ROM-tests" VALUE 0x8026CBF7 Val_Wu8 255.0 dez 0.00 255.0 FORMAT "%5.1" /end CHARACTERISTIC
/begin CHARACTERISTIC MoCMem_noMEMChkRstCpl_CW "Double storage for MoCMem_noMEMChkRst_CW" VALUE 0x8027060C Val_Wu8 255.0 dez 0.00 255.0 FORMAT "%5.1" /end CHARACTERISTIC
/begin CHARACTERISTIC MoCMem_noMEMChkRst_CW "Disables the error reaction found during the cyclical memory check (Depends on MOCMEM_CONF_SERIES_TOOLCHAIN and MO_ROM_SY)" VALUE 0x8026CBF8 Val_Wu8 255.0 dez 0.00 255.0 FORMAT "%5.1" /end CHARACTERISTIC
/begin CHARACTERISTIC MoCMem_numRamChk_C "Number of 32-bit memory cells to be tested in cyclical RAM-check" VALUE 0x8026D240 Val_Wu16 65535.00 dez 0.00 65535.00 FORMAT "%8.2" /end CHARACTERISTIC
/begin CHARACTERISTIC MoCMem_numRomChk_CA "Number of 32-bit memory cells to be tested in cyclical ROM-check." VAL_BLK 0x8026D242 ValA_Wu16 65535.00 dez 0.00 65535.00 FORMAT "%8.2" MATRIX_DIM 4 /end CHARACTERISTIC
/begin CHARACTERISTIC MoCMem_RamTst_CW "Code word for simulating error in cyclic RAM, Stack and CSA test" VALUE 0x8027060D Val_Wu8 255.0 dez 0.00 255.0 FORMAT "%5.1" /end CHARACTERISTIC
/begin CHARACTERISTIC MoCMem_RomTst_CW "code word for requiring the reaction test of the cyclic ROM test" VALUE 0x8027060E Val_Wu8 255.0 dez 0.00 255.0 FORMAT "%5.1" /end CHARACTERISTIC
/begin CHARACTERISTIC MoCMem_stSwtAutRamChkConf_C "Switch to select automatic configuration of block size for the cyclic RAM check" VALUE 0x8026CBF9 Val_Wu8 255.0 dez 0.00 255.0 FORMAT "%5.1" /end CHARACTERISTIC
/begin CHARACTERISTIC MoCMem_stSwtAutRomChkConf_C "Switch to select automatic configuration of block size for the cyclic ROM check" VALUE 0x8026CBFA Val_Wu8 255.0 dez 0.00 255.0 FORMAT "%5.1" /end CHARACTERISTIC
/begin CHARACTERISTIC MoCPFC_stPtlRespTestActv_CW "codeword to simulate wrong PFC response error" VALUE 0x80270610 Val_Wu8 255.0 dez 0.00 255.0 FORMAT "%5.1" /end CHARACTERISTIC
/begin CHARACTERISTIC MoCSCC_cntrDebMax_C "Debounce counter for configuration check error" VALUE 0x8026CBFC Val_Wu8 255.0 dez 0.00 255.0 FORMAT "%5.1" /end CHARACTERISTIC
/begin CHARACTERISTIC MoCSCC_stSCCTstActv_CW "status bits to simulate the safety feature configuration check fault" VALUE 0x8027062E Val_Wu16 65535.00 dez 0.00 65535.00 FORMAT "%8.2" /end CHARACTERISTIC
/begin CHARACTERISTIC MoCSCC_swtDisblEmmChk_CA "Disable activation check of EMM events, each bit corresponds to a specific EMM event" VAL_BLK 0x8026CFE8 ValA_Wu32 4294967295.00 OneToOne 0.00 4294967295.00 FORMAT "%13.2" MATRIX_DIM 12 /end CHARACTERISTIC
/begin CHARACTERISTIC MoCSCC_swtLfastWrkarndActv_CW "Deactivation of crossbar MPU check for activation of LFAST interface" VALUE 0x8026CBFD Val_Wu8 255.0 dez 0.00 255.0 FORMAT "%5.1" /end CHARACTERISTIC
/begin MEASUREMENT Com_cntrRxFrm0x497 "Counter to be monitiored for the reception" UBYTE OneToOne 1 100 0.00 255.0 FORMAT "%5.1" ECU_ADDRESS 0x700014DA
 /begin IF_DATA XCPplus 0x0102
  /begin DAQ_EVENT VARIABLE /end DAQ_EVENT
 /end IF_DATA
/end MEASUREMENT
/begin MEASUREMENT Com_EvecntrDF0ASrv "Counter for event frame transmission" UBYTE OneToOne 1 100 0.00 255.0 FORMAT "%5.1" ECU_ADDRESS 0x700014EA
 /begin IF_DATA XCPplus 0x0102
  /begin DAQ_EVENT VARIABLE /end DAQ_EVENT
 /end IF_DATA
/end MEASUREMENT
/begin MEASUREMENT Com_EveDetnDF0ASrv "Event has been detected" UBYTE OneToOne 1 100 0.00 255.0 FORMAT "%5.1" ECU_ADDRESS 0x700014EB
 /begin IF_DATA XCPplus 0x0102
  /begin DAQ_EVENT VARIABLE /end DAQ_EVENT
 /end IF_DATA
/end MEASUREMENT
/begin MEASUREMENT Com_St1StsDF0ASrv "Sate1 Status for DF0A Routine Excution" UBYTE St1StsDF0ASrv_VERB 1 100 0.00 3.00000000000 FORMAT "%13.11" ECU_ADDRESS 0x700014E1
 /begin IF_DATA XCPplus 0x0102
  /begin DAQ_EVENT VARIABLE /end DAQ_EVENT
 /end IF_DATA
/end MEASUREMENT
/begin MEASUREMENT Com_St2StsDF0ASrv "Sate2 Status for DF0A Routine Excution" UBYTE St2StsDF0ASrv_VERB 1 100 0.00 8.00000000000 FORMAT "%13.11" ECU_ADDRESS 0x700014E0
 /begin IF_DATA XCPplus 0x0102
  /begin DAQ_EVENT VARIABLE /end DAQ_EVENT
 /end IF_DATA
/end MEASUREMENT
/begin MEASUREMENT Com_stCmdOffsEM01 "ASW interface for VCU_MOTOR_OFFSET_REQ_DATA signal of 0x491 Frame" UBYTE B_TRUE 1 100 0.00 1.00000000000 BIT_MASK 0x1 FORMAT "%13.11" ECU_ADDRESS 0x70001497
 /begin IF_DATA XCPplus 0x0102
  /begin DAQ_EVENT VARIABLE /end DAQ_EVENT
 /end IF_DATA
/end MEASUREMENT
/begin MEASUREMENT Com_stIvtrOffsRd "Order status information for the EEP read for invertor offset data" UBYTE OneToOne 1 100 0.00 255.0 FORMAT "%5.1" ECU_ADDRESS 0x700014CC
 /begin IF_DATA XCPplus 0x0102
  /begin DAQ_EVENT VARIABLE /end DAQ_EVENT
 /end IF_DATA
/end MEASUREMENT
/begin MEASUREMENT Com_stNwCmdLIN "Network Command interface for LIN" UBYTE Ext_stNwCmdLIN_VERB 1 100 0.00 255.000000000 FORMAT "%13.9" ECU_ADDRESS 0x700014CA
 /begin IF_DATA XCPplus 0x0102
  /begin DAQ_EVENT VARIABLE /end DAQ_EVENT
 /end IF_DATA
/end MEASUREMENT
/begin MEASUREMENT Com_stsEepRetVal "EeP Read action to read the stored INV Offset value" UBYTE OneToOne 1 100 0.00 255.0 FORMAT "%5.1" ECU_ADDRESS 0x700014C4
 /begin IF_DATA XCPplus 0x0102
  /begin DAQ_EVENT VARIABLE /end DAQ_EVENT
 /end IF_DATA
/end MEASUREMENT
/begin MEASUREMENT Com_valEepOffsEM01 "ASW interface for VCU_MOTOR_OFFSET_VAL signal of 0x491 Frame" UWORD OneToOne 1 100 0.00 65535.00 FORMAT "%8.2" ECU_ADDRESS 0x7000150E
 /begin IF_DATA XCPplus 0x0102
  /begin DAQ_EVENT VARIABLE /end DAQ_EVENT
 /end IF_DATA
/end MEASUREMENT
/begin MEASUREMENT DDRC_St.DFC_IntlckChrgPlgHBrgOpnLd "" UWORD DFC_OneToOne 1 100 0.00 8191.000 BIT_MASK 0x1fff FORMAT "%8.3" ECU_ADDRESS 0x60021FBA /end MEASUREMENT
/begin MEASUREMENT DDRC_St.DFC_IntlckChrgPlgHBrgOvrCurr "" UWORD DFC_OneToOne 1 100 0.00 8191.000 BIT_MASK 0x1fff FORMAT "%8.3" ECU_ADDRESS 0x60021FBC /end MEASUREMENT
/begin MEASUREMENT DDRC_St.DFC_IntlckChrgPlgHBrgOvrTemp "" UWORD DFC_OneToOne 1 100 0.00 8191.000 BIT_MASK 0x1fff FORMAT "%8.3" ECU_ADDRESS 0x60021FBE /end MEASUREMENT
/begin MEASUREMENT DDRC_St.DFC_IntlckChrgPlgHBrgShCirBatt1 "" UWORD DFC_OneToOne 1 100 0.00 8191.000 BIT_MASK 0x1fff FORMAT "%8.3" ECU_ADDRESS 0x60021FC0 /end MEASUREMENT
/begin MEASUREMENT DDRC_St.DFC_IntlckChrgPlgHBrgShCirBatt2 "" UWORD DFC_OneToOne 1 100 0.00 8191.000 BIT_MASK 0x1fff FORMAT "%8.3" ECU_ADDRESS 0x60021FC2 /end MEASUREMENT
/begin MEASUREMENT DDRC_St.DFC_IntlckChrgPlgHBrgShCirGnd1 "" UWORD DFC_OneToOne 1 100 0.00 8191.000 BIT_MASK 0x1fff FORMAT "%8.3" ECU_ADDRESS 0x60021FC4 /end MEASUREMENT
/begin MEASUREMENT DDRC_St.DFC_IntlckChrgPlgHBrgShCirGnd2 "" UWORD DFC_OneToOne 1 100 0.00 8191.000 BIT_MASK 0x1fff FORMAT "%8.3" ECU_ADDRESS 0x60021FC6 /end MEASUREMENT
/begin MEASUREMENT DDRC_St.DFC_IntlckChrgPlgHBrgShCirOvrLd "" UWORD DFC_OneToOne 1 100 0.00 8191.000 BIT_MASK 0x1fff FORMAT "%8.3" ECU_ADDRESS 0x60021FC8 /end MEASUREMENT
/begin MEASUREMENT DDRC_St.DFC_IntlckChrgPlgHBrgTempOvrCurr "" UWORD DFC_OneToOne 1 100 0.00 8191.000 BIT_MASK 0x1fff FORMAT "%8.3" ECU_ADDRESS 0x60021FCA /end MEASUREMENT
/begin MEASUREMENT DDRC_St.DFC_IntlckChrgPlgHBrgUndrVltg "" UWORD DFC_OneToOne 1 100 0.00 8191.000 BIT_MASK 0x1fff FORMAT "%8.3" ECU_ADDRESS 0x60021FCC /end MEASUREMENT
/begin MEASUREMENT DDRC_St.DFC_IntlckChrgPlgPosnRngFlt "" UWORD DFC_OneToOne 1 100 0.00 8191.000 BIT_MASK 0x1fff FORMAT "%8.3" ECU_ADDRESS 0x60021FCE /end MEASUREMENT
/begin MEASUREMENT DDRC_St.DFC_IntlckChrgPlgPosnSrcMax "" UWORD DFC_OneToOne 1 100 0.00 8191.000 BIT_MASK 0x1fff FORMAT "%8.3" ECU_ADDRESS 0x60021FD0 /end MEASUREMENT
/begin MEASUREMENT DDRC_St.DFC_IntlckChrgPlgPosnSrcMin "" UWORD DFC_OneToOne 1 100 0.00 8191.000 BIT_MASK 0x1fff FORMAT "%8.3" ECU_ADDRESS 0x60021FD2 /end MEASUREMENT
/begin MEASUREMENT DFC_st.DFC_IntlckChrgPlgHBrgOpnLd "" UBYTE DFC_OneToOne 1 100 0.00 255.0 FORMAT "%5.1" ECU_ADDRESS 0x60034C34 /end MEASUREMENT
/begin MEASUREMENT DFC_st.DFC_IntlckChrgPlgHBrgOvrCurr "" UBYTE DFC_OneToOne 1 100 0.00 255.0 FORMAT "%5.1" ECU_ADDRESS 0x60034C35 /end MEASUREMENT
/begin MEASUREMENT DFC_st.DFC_IntlckChrgPlgHBrgOvrTemp "" UBYTE DFC_OneToOne 1 100 0.00 255.0 FORMAT "%5.1" ECU_ADDRESS 0x60034C36 /end MEASUREMENT
/begin MEASUREMENT DFC_st.DFC_IntlckChrgPlgHBrgShCirBatt1 "" UBYTE DFC_OneToOne 1 100 0.00 255.0 FORMAT "%5.1" ECU_ADDRESS 0x60034C37 /end MEASUREMENT
/begin MEASUREMENT DFC_st.DFC_IntlckChrgPlgHBrgShCirBatt2 "" UBYTE DFC_OneToOne 1 100 0.00 255.0 FORMAT "%5.1" ECU_ADDRESS 0x60034C38 /end MEASUREMENT
/begin MEASUREMENT DFC_st.DFC_IntlckChrgPlgHBrgShCirGnd1 "" UBYTE DFC_OneToOne 1 100 0.00 255.0 FORMAT "%5.1" ECU_ADDRESS 0x60034C39 /end MEASUREMENT
/begin MEASUREMENT DFC_st.DFC_IntlckChrgPlgHBrgShCirGnd2 "" UBYTE DFC_OneToOne 1 100 0.00 255.0 FORMAT "%5.1" ECU_ADDRESS 0x60034C3A /end MEASUREMENT
/begin MEASUREMENT DFC_st.DFC_IntlckChrgPlgHBrgShCirOvrLd "" UBYTE DFC_OneToOne 1 100 0.00 255.0 FORMAT "%5.1" ECU_ADDRESS 0x60034C3B /end MEASUREMENT
/begin MEASUREMENT DFC_st.DFC_IntlckChrgPlgHBrgTempOvrCurr "" UBYTE DFC_OneToOne 1 100 0.00 255.0 FORMAT "%5.1" ECU_ADDRESS 0x60034C3C /end MEASUREMENT
/begin MEASUREMENT DFC_st.DFC_IntlckChrgPlgHBrgUndrVltg "" UBYTE DFC_OneToOne 1 100 0.00 255.0 FORMAT "%5.1" ECU_ADDRESS 0x60034C3D /end MEASUREMENT
/begin MEASUREMENT DFC_st.DFC_IntlckChrgPlgPosnRngFlt "" UBYTE DFC_OneToOne 1 100 0.00 255.0 FORMAT "%5.1" ECU_ADDRESS 0x60034C3E /end MEASUREMENT
/begin MEASUREMENT DFC_st.DFC_IntlckChrgPlgPosnSrcMax "" UBYTE DFC_OneToOne 1 100 0.00 255.0 FORMAT "%5.1" ECU_ADDRESS 0x60034C3F /end MEASUREMENT
/begin MEASUREMENT DFC_st.DFC_IntlckChrgPlgPosnSrcMin "" UBYTE DFC_OneToOne 1 100 0.00 255.0 FORMAT "%5.1" ECU_ADDRESS 0x60034C40 /end MEASUREMENT
/begin MEASUREMENT DFC_st.DFC_MoCADCNTPBnk1 "" UBYTE DFC_OneToOne 1 100 0.00 255.0 FORMAT "%5.1" ECU_ADDRESS 0x60034D42 /end MEASUREMENT
/begin MEASUREMENT DFC_st.DFC_MoCADCTestVoltBnk1 "" UBYTE DFC_OneToOne 1 100 0.00 255.0 FORMAT "%5.1" ECU_ADDRESS 0x60034D43 /end MEASUREMENT
/begin MEASUREMENT DINH_nrActvInhReas.FId_IntlckChrgPlgActrOff "" UWORD DINH_ct_Compu 1 100 -4095.000 4096.000 BIT_MASK 0x1fff FORMAT "%8.3" ECU_ADDRESS 0x600214E8 /end MEASUREMENT
/begin MEASUREMENT DINH_nrActvInhReas.FId_IntlckChrgPlgHbrdgNotTstd "" UWORD DINH_ct_Compu 1 100 -4095.000 4096.000 BIT_MASK 0x1fff FORMAT "%8.3" ECU_ADDRESS 0x600214EA /end MEASUREMENT
/begin MEASUREMENT DINH_nrActvInhReas.FId_IntlckChrgPlgMon "" UWORD DINH_ct_Compu 1 100 -4095.000 4096.000 BIT_MASK 0x1fff FORMAT "%8.3" ECU_ADDRESS 0x600214EE /end MEASUREMENT
/begin MEASUREMENT DINH_nrActvInhReas.FId_IntlckChrgPlgPosnAdcInvld "" UWORD DINH_ct_Compu 1 100 -4095.000 4096.000 BIT_MASK 0x1fff FORMAT "%8.3" ECU_ADDRESS 0x600214F0 /end MEASUREMENT
/begin MEASUREMENT DINH_nrActvInhReas.FId_IntlckChrgPlgPwrStg "" UWORD DINH_ct_Compu 1 100 -4095.000 4096.000 BIT_MASK 0x1fff FORMAT "%8.3" ECU_ADDRESS 0x600214F4 /end MEASUREMENT
/begin MEASUREMENT DINH_nrActvInhReas.FId_LvGridSocErr "" UWORD DINH_ct_Compu 1 100 -4095.000 4096.000 BIT_MASK 0x1fff FORMAT "%8.3" ECU_ADDRESS 0x600214F8 /end MEASUREMENT
/begin MEASUREMENT DINH_nrActvInhReas.FId_LvGridTErr "" UWORD DINH_ct_Compu 1 100 -4095.000 4096.000 BIT_MASK 0x1fff FORMAT "%8.3" ECU_ADDRESS 0x600214FA /end MEASUREMENT
/begin MEASUREMENT DINH_nrActvInhReas.FId_LvGridTestPlsReq "" UWORD DINH_ct_Compu 1 100 -4095.000 4096.000 BIT_MASK 0x1fff FORMAT "%8.3" ECU_ADDRESS 0x600214FC /end MEASUREMENT
/begin MEASUREMENT DINH_nrActvInhReas.FId_LvGridUErr "" UWORD DINH_ct_Compu 1 100 -4095.000 4096.000 BIT_MASK 0x1fff FORMAT "%8.3" ECU_ADDRESS 0x600214FE /end MEASUREMENT
/begin MEASUREMENT DINH_nrActvInhReas.FId_MedTPmpFlt "" UWORD DINH_ct_Compu 1 100 -4095.000 4096.000 BIT_MASK 0x1fff FORMAT "%8.3" ECU_ADDRESS 0x60021500 /end MEASUREMENT
/begin MEASUREMENT DINH_nrActvInhReas.FId_MedTPmpPwrCtrlRly "" UWORD DINH_ct_Compu 1 100 -4095.000 4096.000 BIT_MASK 0x1fff FORMAT "%8.3" ECU_ADDRESS 0x60021502 /end MEASUREMENT
/begin MEASUREMENT DINH_stFId.FId_IntlckChrgPlgActrOff "" UWORD DFC_OneToOne 1 100 0.00 65535.00 FORMAT "%8.2" ECU_ADDRESS 0x600214E8 /end MEASUREMENT
/begin MEASUREMENT DINH_stFId.FId_IntlckChrgPlgHbrdgNotTstd "" UWORD DFC_OneToOne 1 100 0.00 65535.00 FORMAT "%8.2" ECU_ADDRESS 0x600214EA /end MEASUREMENT
/begin MEASUREMENT DINH_stFId.FId_IntlckChrgPlgMon "" UWORD DFC_OneToOne 1 100 0.00 65535.00 FORMAT "%8.2" ECU_ADDRESS 0x600214EE /end MEASUREMENT
/begin MEASUREMENT DINH_stFId.FId_IntlckChrgPlgPosnAdcInvld "" UWORD DFC_OneToOne 1 100 0.00 65535.00 FORMAT "%8.2" ECU_ADDRESS 0x600214F0 /end MEASUREMENT
/begin MEASUREMENT DINH_stFId.FId_IntlckChrgPlgPwrStg "" UWORD DFC_OneToOne 1 100 0.00 65535.00 FORMAT "%8.2" ECU_ADDRESS 0x600214F4 /end MEASUREMENT
/begin MEASUREMENT DINH_stFId.FId_LvGridSocErr "" UWORD DFC_OneToOne 1 100 0.00 65535.00 FORMAT "%8.2" ECU_ADDRESS 0x600214F8 /end MEASUREMENT
/begin MEASUREMENT DINH_stFId.FId_LvGridTErr "" UWORD DFC_OneToOne 1 100 0.00 65535.00 FORMAT "%8.2" ECU_ADDRESS 0x600214FA /end MEASUREMENT
/begin MEASUREMENT DINH_stFId.FId_LvGridTestPlsReq "" UWORD DFC_OneToOne 1 100 0.00 65535.00 FORMAT "%8.2" ECU_ADDRESS 0x600214FC /end MEASUREMENT
/begin MEASUREMENT DINH_stFId.FId_LvGridUErr "" UWORD DFC_OneToOne 1 100 0.00 65535.00 FORMAT "%8.2" ECU_ADDRESS 0x600214FE /end MEASUREMENT
/begin MEASUREMENT DINH_stFId.FId_MedTPmpFlt "" UWORD DFC_OneToOne 1 100 0.00 65535.00 FORMAT "%8.2" ECU_ADDRESS 0x60021500 /end MEASUREMENT
/begin MEASUREMENT DINH_stFId.FId_MedTPmpPwrCtrlRly "" UWORD DFC_OneToOne 1 100 0.00 65535.00 FORMAT "%8.2" ECU_ADDRESS 0x60021502 /end MEASUREMENT
/begin MEASUREMENT ErrLmp_stMIL "MIL status indicator" UBYTE OneToOne 1 100 0.00 255.0 FORMAT "%5.1" ECU_ADDRESS 0x60023886
 /begin IF_DATA XCPplus 0x0102
  /begin DAQ_EVENT VARIABLE /end DAQ_EVENT
 /end IF_DATA
/end MEASUREMENT
/begin MEASUREMENT Inm_bLinRunNetCmdReq "lin net command request" UBYTE B_TRUE 1 100 0.00 1.00000000000 FORMAT "%13.11" ECU_ADDRESS 0x6002312F
 /begin IF_DATA XCPplus 0x0102
  /begin DAQ_EVENT VARIABLE /end DAQ_EVENT
 /end IF_DATA
/end MEASUREMENT
/begin MEASUREMENT Inm_bLinRunSched "Functional Schedule table" UBYTE B_TRUE 1 100 0.00 1.00000000000 FORMAT "%13.11" ECU_ADDRESS 0x6002312E
 /begin IF_DATA XCPplus 0x0102
  /begin DAQ_EVENT VARIABLE /end DAQ_EVENT
 /end IF_DATA
/end MEASUREMENT
/begin MEASUREMENT Inm_bLINWkUpSuc_mp "Status of the LIN wakeup pattern transmission" UBYTE OneToOne 1 100 0.00 255.0 FORMAT "%5.1" ECU_ADDRESS 0x70006C05 /end MEASUREMENT
/begin MEASUREMENT Inm_bMnWkUp_mp "Main wake up status for LIN state machine" UBYTE OneToOne 1 100 0.00 255.0 FORMAT "%5.1" ECU_ADDRESS 0x70006C04 /end MEASUREMENT
/begin MEASUREMENT Inm_flgSchedEndNetCmd "Lin schedule notification" UBYTE B_TRUE 1 100 0.00 1.00000000000 FORMAT "%13.11" ECU_ADDRESS 0x6002312D
 /begin IF_DATA XCPplus 0x0102
  /begin DAQ_EVENT VARIABLE /end DAQ_EVENT
 /end IF_DATA
/end MEASUREMENT
/begin MEASUREMENT Inm_stLINStM "State of the LIN communication" UBYTE OneToOne 1 100 0.00 255.0 FORMAT "%5.1" ECU_ADDRESS 0x60023797
 /begin IF_DATA XCPplus 0x0102
  /begin DAQ_EVENT VARIABLE /end DAQ_EVENT
 /end IF_DATA
/end MEASUREMENT
/begin MEASUREMENT Inm_stLINStMTrans_mp "Bit coded status of the transition conditions for the LIN state machine" UBYTE OneToOne 1 100 0.00 255.0 FORMAT "%5.1" ECU_ADDRESS 0x70006C03 /end MEASUREMENT
/begin MEASUREMENT Inm_stLINSubStM "lin sub state" UBYTE OneToOne 1 100 0.00 255.0 FORMAT "%5.1" ECU_ADDRESS 0x60023796
 /begin IF_DATA XCPplus 0x0102
  /begin DAQ_EVENT VARIABLE /end DAQ_EVENT
 /end IF_DATA
/end MEASUREMENT
/begin MEASUREMENT Inm_swtLIN "LIN present in the vehicle flag" UBYTE OneToOne 1 100 0.00 255.0 FORMAT "%5.1" ECU_ADDRESS 0x60023795 /end MEASUREMENT
/begin MEASUREMENT IntlckChrgPlgPosn_st "Debounced switch status" UBYTE B_TRUE 1 100 0.00 1.00000000000 BIT_MASK 0x1 FORMAT "%13.11" ECU_ADDRESS 0x70000250
 /begin IF_DATA XCPplus 0x0102
  /begin DAQ_EVENT VARIABLE /end DAQ_EVENT
 /end IF_DATA
/end MEASUREMENT
/begin MEASUREMENT IntlckChrgPlgPosn_stRaw "" UBYTE B_TRUE 1 100 0.00 1.00000000000 BIT_MASK 0x1 FORMAT "%13.11" ECU_ADDRESS 0x7000024F
 /begin IF_DATA XCPplus 0x0102
  /begin DAQ_EVENT VARIABLE /end DAQ_EVENT
 /end IF_DATA
/end MEASUREMENT
/begin MEASUREMENT IntlckChrgPlgPosn_st_Sq "" UBYTE SigQly_COMPU_VERB 1 100 0.00 15.0000000000 FORMAT "%13.10" ECU_ADDRESS 0x700014B6
 /begin IF_DATA XCPplus 0x0102
  /begin DAQ_EVENT VARIABLE /end DAQ_EVENT
 /end IF_DATA
/end MEASUREMENT
/begin MEASUREMENT IntlckChrgPlgPosn_SwtGASD_I.stHLR_I " / Status of Hysteresis" UBYTE B_TRUE 1 100 0.00 1.00000000000 BIT_MASK 0x1 FORMAT "%13.11" ECU_ADDRESS 0x700012C0 /end MEASUREMENT
/begin MEASUREMENT IntlckChrgPlgPosn_uRaw "" SWORD RBPtCel_u_0p2_1 1 100 -6553.600 6553.400 FORMAT "%8.3" ECU_ADDRESS 0x700012CC
 /begin IF_DATA XCPplus 0x0102
  /begin DAQ_EVENT VARIABLE /end DAQ_EVENT
 /end IF_DATA
/end MEASUREMENT
/begin MEASUREMENT IntlckChrgPlg_flgActrReq "power stage required by ASW for controlling" UBYTE OneToOne 1 100 0.00 255.0 BIT_MASK 0x1 FORMAT "%5.1" ECU_ADDRESS 0x60023492
 /begin IF_DATA XCPplus 0x0102
  /begin DAQ_EVENT VARIABLE /end DAQ_EVENT
 /end IF_DATA
/end MEASUREMENT
/begin MEASUREMENT IntlckChrgPlg_flgActrSwtOffReq "" UBYTE OneToOne 1 100 0.00 255.0 FORMAT "%5.1" ECU_ADDRESS 0x60023539
 /begin IF_DATA XCPplus 0x0102
  /begin DAQ_EVENT VARIABLE /end DAQ_EVENT
 /end IF_DATA
/end MEASUREMENT
/begin MEASUREMENT IntlckChrgPlg_flgElecDiagSwtOffReq "" UBYTE OneToOne 1 100 0.00 255.0 FORMAT "%5.1" ECU_ADDRESS 0x60023538
 /begin IF_DATA XCPplus 0x0102
  /begin DAQ_EVENT VARIABLE /end DAQ_EVENT
 /end IF_DATA
/end MEASUREMENT
/begin MEASUREMENT IntlckChrgPlg_flgPwrStgReq "" UBYTE OneToOne 1 100 0.00 1.000 FORMAT "%5.3" ECU_ADDRESS 0x60023537
 /begin IF_DATA XCPplus 0x0102
  /begin DAQ_EVENT VARIABLE /end DAQ_EVENT
 /end IF_DATA
/end MEASUREMENT
/begin MEASUREMENT IntlckChrgPlg_numSigID "" UWORD OneToOne 1 100 0.00 65535.00 FORMAT "%8.2" ECU_ADDRESS 0x6001F418 /end MEASUREMENT
/begin MEASUREMENT IntlckChrgPlg_rAct "" SWORD Prc 1 100 -400.0000 399.9878 FORMAT "%8.4" ECU_ADDRESS 0x6001FDB0
 /begin IF_DATA XCPplus 0x0102
  /begin DAQ_EVENT VARIABLE /end DAQ_EVENT
 /end IF_DATA
/end MEASUREMENT
/begin MEASUREMENT IntlckChrgPlg_rActr "Governor output + Release function output" SWORD Prc 1 100 -400.0000 399.9878 FORMAT "%8.4" ECU_ADDRESS 0x6001FDAE
 /begin IF_DATA XCPplus 0x0102
  /begin DAQ_EVENT VARIABLE /end DAQ_EVENT
 /end IF_DATA
/end MEASUREMENT
/begin MEASUREMENT IntlckChrgPlg_rAct_Sq "" UBYTE SigQly_COMPU_VERB 1 100 0.00 15.0000000000 FORMAT "%13.10" ECU_ADDRESS 0x60023794
 /begin IF_DATA XCPplus 0x0102
  /begin DAQ_EVENT VARIABLE /end DAQ_EVENT
 /end IF_DATA
/end MEASUREMENT
/begin MEASUREMENT IntlckChrgPlg_ratActPosnB1 "" SWORD rel_q0p0078125 1 100 -256.0000 255.9922 FORMAT "%8.4" ECU_ADDRESS 0x6001FDA6
 /begin IF_DATA XCPplus 0x0102
  /begin DAQ_EVENT VARIABLE /end DAQ_EVENT
 /end IF_DATA
/end MEASUREMENT
/begin MEASUREMENT IntlckChrgPlg_rMax "" SWORD DtyCyc 1 100 -327.6800 327.6700 FORMAT "%8.4" ECU_ADDRESS 0x6001FDAC
 /begin IF_DATA XCPplus 0x0102
  /begin DAQ_EVENT VARIABLE /end DAQ_EVENT
 /end IF_DATA
/end MEASUREMENT
/begin MEASUREMENT IntlckChrgPlg_rMin "" SWORD DtyCyc 1 100 -327.6800 327.6700 FORMAT "%8.4" ECU_ADDRESS 0x6001FDAA
 /begin IF_DATA XCPplus 0x0102
  /begin DAQ_EVENT VARIABLE /end DAQ_EVENT
 /end IF_DATA
/end MEASUREMENT
/begin MEASUREMENT IntlckChrgPlg_rPs "" SWORD DtyCyc 1 100 -327.6800 327.6700 FORMAT "%8.4" ECU_ADDRESS 0x6001FDA8
 /begin IF_DATA XCPplus 0x0102
  /begin DAQ_EVENT VARIABLE /end DAQ_EVENT
 /end IF_DATA
/end MEASUREMENT
/begin MEASUREMENT IntlckChrgPlg_selfDiagPostDrv_mp "" UBYTE OneToOne 1 100 0.00 255.0 FORMAT "%5.1" ECU_ADDRESS 0x70006C02 /end MEASUREMENT
/begin MEASUREMENT IntlckChrgPlg_SigTyp "" UBYTE OneToOne 1 100 0.00 255.0 FORMAT "%5.1" ECU_ADDRESS 0x6002312C
 /begin IF_DATA XCPplus 0x0102
  /begin DAQ_EVENT VARIABLE /end DAQ_EVENT
 /end IF_DATA
/end MEASUREMENT
/begin MEASUREMENT IntlckChrgPlg_stElecDiag "" UBYTE OneToOne 1 100 0.00 255.0 FORMAT "%5.1" ECU_ADDRESS 0x60023536
 /begin IF_DATA XCPplus 0x0102
  /begin DAQ_EVENT VARIABLE /end DAQ_EVENT
 /end IF_DATA
/end MEASUREMENT
/begin MEASUREMENT IntlckChrgPlg_stElecDiagExtCtrld "" UBYTE OneToOne 1 100 0.00 255.0 FORMAT "%5.1" ECU_ADDRESS 0x60023535
 /begin IF_DATA XCPplus 0x0102
  /begin DAQ_EVENT VARIABLE /end DAQ_EVENT
 /end IF_DATA
/end MEASUREMENT
/begin MEASUREMENT IntlckChrgPlg_stHbrg_mp "" ULONG OneToOne 1 100 0.00 4294967295.00 FORMAT "%13.2" MATRIX_DIM 2 ECU_ADDRESS 0x7000686C /end MEASUREMENT
/begin MEASUREMENT IntlckChrgPlg_stHlfbrOpnLdDia "" UBYTE OneToOne 1 100 0.00 255.0 FORMAT "%5.1" ECU_ADDRESS 0x60023533
 /begin IF_DATA XCPplus 0x0102
  /begin DAQ_EVENT VARIABLE /end DAQ_EVENT
 /end IF_DATA
/end MEASUREMENT
/begin MEASUREMENT IntlckChrgPlg_stMon "" ULONG OneToOne 1 100 0.00 4294967295.00 FORMAT "%13.2" ECU_ADDRESS 0x60001038
 /begin IF_DATA XCPplus 0x0102
  /begin DAQ_EVENT VARIABLE /end DAQ_EVENT
 /end IF_DATA
/end MEASUREMENT
/begin MEASUREMENT IntlckChrgPlg_stMonActrPwrStgDrvr "" ULONG OneToOne 1 100 0.00 2147483647.00 FORMAT "%13.2" ECU_ADDRESS 0x60000EE0
 /begin IF_DATA XCPplus 0x0102
  /begin DAQ_EVENT VARIABLE /end DAQ_EVENT
 /end IF_DATA
/end MEASUREMENT
/begin MEASUREMENT IntlckChrgPlg_stMonDD "" ULONG OneToOne 1 100 0.00 4294967295.00 FORMAT "%13.2" ECU_ADDRESS 0x60001034
 /begin IF_DATA XCPplus 0x0102
  /begin DAQ_EVENT VARIABLE /end DAQ_EVENT
 /end IF_DATA
/end MEASUREMENT
/begin MEASUREMENT IntlckChrgPlg_stMonDDSens "" ULONG OneToOne 1 100 0.00 4294967295.00 FORMAT "%13.2" ECU_ADDRESS 0x60001030
 /begin IF_DATA XCPplus 0x0102
  /begin DAQ_EVENT VARIABLE /end DAQ_EVENT
 /end IF_DATA
/end MEASUREMENT
/begin MEASUREMENT IntlckChrgPlg_stMonGlbElecdd "" ULONG OneToOne 1 100 0.00 2147483647.00 FORMAT "%13.2" ECU_ADDRESS 0x60000EDC
 /begin IF_DATA XCPplus 0x0102
  /begin DAQ_EVENT VARIABLE /end DAQ_EVENT
 /end IF_DATA
/end MEASUREMENT
/begin MEASUREMENT IntlckChrgPlg_stOpnLdMod_mp "" UBYTE OneToOne 1 100 0.00 255.0 FORMAT "%5.1" ECU_ADDRESS 0x6002312B
 /begin IF_DATA XCPplus 0x0102
  /begin DAQ_EVENT VARIABLE /end DAQ_EVENT
 /end IF_DATA
/end MEASUREMENT
/begin MEASUREMENT IntlckChrgPlg_stPs "" UBYTE OneToOne 1 100 0.00 255.0 FORMAT "%5.1" ECU_ADDRESS 0x60023793
 /begin IF_DATA XCPplus 0x0102
  /begin DAQ_EVENT VARIABLE /end DAQ_EVENT
 /end IF_DATA
/end MEASUREMENT
/begin MEASUREMENT IntlckChrgPlg_stPwrStgDrvr "" UBYTE OneToOne 1 100 0.00 255.0 FORMAT "%5.1" ECU_ADDRESS 0x60023532
 /begin IF_DATA XCPplus 0x0102
  /begin DAQ_EVENT VARIABLE /end DAQ_EVENT
 /end IF_DATA
/end MEASUREMENT
/begin MEASUREMENT IntlckChrgPlg_swtConf2C "" ULONG OneToOne 1 100 0.00 4294967295.00 FORMAT "%13.2" ECU_ADDRESS 0x60000764 /end MEASUREMENT
/begin MEASUREMENT IntlckChrgPlg_swtConfActrPwrStgDrvr "" UBYTE OneToOne 1 100 0.00 255.0 FORMAT "%5.1" ECU_ADDRESS 0x60023531 /end MEASUREMENT
/begin MEASUREMENT IntlckChrgPlg_swtConfC "" ULONG OneToOne 1 100 0.00 4294967295.00 FORMAT "%13.2" ECU_ADDRESS 0x60000760 /end MEASUREMENT
/begin MEASUREMENT IntlckChrgPlg_swtConfStdActrSwVersC "" ULONG OneToOne 1 100 0.00 4294967295.00 FORMAT "%13.2" ECU_ADDRESS 0x6000075C /end MEASUREMENT
/begin MEASUREMENT IntlckChrgPlg_tiPeriod "" ULONG Time_usec_q1_COMPU 1 100 0.00 4294967295.00 FORMAT "%13.2" ECU_ADDRESS 0x60000ED8
 /begin IF_DATA XCPplus 0x0102
  /begin DAQ_EVENT VARIABLE /end DAQ_EVENT
 /end IF_DATA
/end MEASUREMENT
/begin MEASUREMENT LinSm_stComMode "LIN current communication mode" UBYTE ModeType_VERB 1 100 0.00 2.00000000000 FORMAT "%13.11" ECU_ADDRESS 0x60023792
 /begin IF_DATA XCPplus 0x0102
  /begin DAQ_EVENT VARIABLE /end DAQ_EVENT
 /end IF_DATA
/end MEASUREMENT
/begin MEASUREMENT LLim_aMSL_MP "Acceleration limit from Maximum SL" SWORD Acc 1 100 -32.76800 32.76700 FORMAT "%8.5" ECU_ADDRESS 0x70006C2E
 /begin IF_DATA XCPplus 0x0102
  /begin DAQ_EVENT VARIABLE /end DAQ_EVENT
 /end IF_DATA
/end MEASUREMENT
/begin MEASUREMENT LLim_aReq "Requested acceleration of Speed Limiter" SWORD Acc 1 100 -32.76800 32.76700 FORMAT "%8.5" ECU_ADDRESS 0x60000248
 /begin IF_DATA XCPplus 0x0102
  /begin DAQ_EVENT VARIABLE /end DAQ_EVENT
 /end IF_DATA
/end MEASUREMENT
/begin MEASUREMENT LLim_flgRvGearActv "Flag for the status of reverse drive position" UBYTE B_TRUE 1 100 0.00 1.00000000000 BIT_MASK 0x1 FORMAT "%13.11" ECU_ADDRESS 0x6002312A
 /begin IF_DATA XCPplus 0x0102
  /begin DAQ_EVENT VARIABLE /end DAQ_EVENT
 /end IF_DATA
/end MEASUREMENT
/begin MEASUREMENT LLim_stReq "Status of acceleration request of Speed Limiter" UBYTE OneToOne 1 100 0.00 1.000 FORMAT "%5.3" ECU_ADDRESS 0x60000241
 /begin IF_DATA XCPplus 0x0102
  /begin DAQ_EVENT VARIABLE /end DAQ_EVENT
 /end IF_DATA
/end MEASUREMENT
/begin MEASUREMENT LLim_vDifMSL_MP "difference of current velocity to maximum vehicle velocity" SWORD Vel 1 100 -327.6800 327.6700 FORMAT "%8.4" ECU_ADDRESS 0x70006C2C
 /begin IF_DATA XCPplus 0x0102
  /begin DAQ_EVENT VARIABLE /end DAQ_EVENT
 /end IF_DATA
/end MEASUREMENT
/begin MEASUREMENT LLim_vMaxMSL "Current arbitrated vehicle speed limit" SWORD Vel 1 100 -327.6800 327.6700 FORMAT "%8.4" ECU_ADDRESS 0x60000246
 /begin IF_DATA XCPplus 0x0102
  /begin DAQ_EVENT VARIABLE /end DAQ_EVENT
 /end IF_DATA
/end MEASUREMENT
/begin MEASUREMENT LvGrid_EnvtSlewRateLimRMP_I.State "Class instannce of Ramp Switch for temperature slew rate limiter / State of the ramp" FLOAT32_IEEE OneToOne 1 100 -1.00000000E+037 1.00000000E+037 FORMAT "%13.3" ECU_ADDRESS 0x6000074C /end MEASUREMENT
/begin MEASUREMENT LvGrid_EnvtSlewRateLimRMP_I.Dir "Class instannce of Ramp Switch for temperature slew rate limiter / Ramp direction" SBYTE OneToOne 1 100 -128.0 127.0 FORMAT "%5.1" ECU_ADDRESS 0x60000750 /end MEASUREMENT
/begin MEASUREMENT LvGrid_EnvtSlewRateLimRMP_I.Switch "Class instannce of Ramp Switch for temperature slew rate limiter / Position of switch" SBYTE OneToOne 1 100 -128.0 127.0 FORMAT "%5.1" ECU_ADDRESS 0x60000751 /end MEASUREMENT
/begin MEASUREMENT LvGrid_stDcdcRedUReq "DCDC converter LV limt request" UBYTE B_TRUE 1 100 0.00 1.00000000000 BIT_MASK 0x1 FORMAT "%13.11" ECU_ADDRESS 0x70000138
 /begin IF_DATA XCPplus 0x0102
  /begin DAQ_EVENT VARIABLE /end DAQ_EVENT
 /end IF_DATA
/end MEASUREMENT
/begin MEASUREMENT LvGrid_tFild "Filtered battery temperature" SWORD Temp_Cels 1 100 -3549.940 3003.560 FORMAT "%8.3" ECU_ADDRESS 0x6001F416
 /begin IF_DATA XCPplus 0x0102
  /begin DAQ_EVENT VARIABLE /end DAQ_EVENT
 /end IF_DATA
/end MEASUREMENT
/begin MEASUREMENT LvGrid_uCnvtnlCChrgnMod "Conventianal charge mode set-point voltage of DCDC" SWORD spg_q0p0039 1 100 -128.0000 127.9961 FORMAT "%8.4" ECU_ADDRESS 0x6001F414
 /begin IF_DATA XCPplus 0x0102
  /begin DAQ_EVENT VARIABLE /end DAQ_EVENT
 /end IF_DATA
/end MEASUREMENT
/begin MEASUREMENT LvGrid_uCnvtnlSocChrgnMod "Conventional SOC charge mode set point voltage of DCDC converter" SWORD spg_q0p0039 1 100 -128.0000 127.9961 FORMAT "%8.4" ECU_ADDRESS 0x6001F412
 /begin IF_DATA XCPplus 0x0102
  /begin DAQ_EVENT VARIABLE /end DAQ_EVENT
 /end IF_DATA
/end MEASUREMENT
/begin MEASUREMENT LvGrid_uCnvtnlTChrgnMod "Conventional temperature charge mode set point voltage of DCDC converter" SWORD spg_q0p0039 1 100 -128.0000 127.9961 FORMAT "%8.4" ECU_ADDRESS 0x6001F410
 /begin IF_DATA XCPplus 0x0102
  /begin DAQ_EVENT VARIABLE /end DAQ_EVENT
 /end IF_DATA
/end MEASUREMENT
/begin MEASUREMENT LvGrid_uDesDcdc "Desired voltage set point of DCDC converter on LV side" SWORD spg_q0p0039 1 100 -128.0000 127.9961 FORMAT "%8.4" ECU_ADDRESS 0x6001FA7E
 /begin IF_DATA XCPplus 0x0102
  /begin DAQ_EVENT VARIABLE /end DAQ_EVENT
 /end IF_DATA
/end MEASUREMENT
/begin MEASUREMENT LvGrid_uDesDcdcRaw "Desired voltage set point of DCDC converter on LV side" SWORD spg_q0p0039 1 100 -128.0000 127.9961 FORMAT "%8.4" ECU_ADDRESS 0x6001FA7C
 /begin IF_DATA XCPplus 0x0102
  /begin DAQ_EVENT VARIABLE /end DAQ_EVENT
 /end IF_DATA
/end MEASUREMENT
/begin MEASUREMENT LvGrid_uDesDcdcSlewRateRMP_I.State "Class instannce of Ramp Switch for desired voltage slew rate limiter / State of the ramp" SLONG OneToOne 1 100 -2147483648.00 2147483647.00 FORMAT "%13.2" ECU_ADDRESS 0x6000073C /end MEASUREMENT
/begin MEASUREMENT LvGrid_uDesDcdcSlewRateRMP_I.Dir "Class instannce of Ramp Switch for desired voltage slew rate limiter / Ramp Direction" SBYTE OneToOne 1 100 -128.0 127.0 FORMAT "%5.1" ECU_ADDRESS 0x60000740 /end MEASUREMENT
/begin MEASUREMENT LvGrid_uDesDcdcSlewRateRMP_I.Switch "Class instannce of Ramp Switch for desired voltage slew rate limiter / Position of switch" SBYTE OneToOne 1 100 -128.0 127.0 FORMAT "%5.1" ECU_ADDRESS 0x60000741 /end MEASUREMENT
/begin MEASUREMENT MedTPmp_st "Medium temperature pumo status" UBYTE OneToOne 1 100 0.00 255.0 FORMAT "%5.1" ECU_ADDRESS 0x60023445
 /begin IF_DATA XCPplus 0x0102
  /begin DAQ_EVENT VARIABLE /end DAQ_EVENT
 /end IF_DATA
/end MEASUREMENT
/begin MEASUREMENT MILLmp_stMIL "MIL status (permanently illuminated, off, blink frequency)" UBYTE OneToOne 1 100 0.00 255.0 FORMAT "%5.1" ECU_ADDRESS 0x60023884
 /begin IF_DATA XCPplus 0x0102
  /begin DAQ_EVENT VARIABLE /end DAQ_EVENT
 /end IF_DATA
/end MEASUREMENT
/begin MEASUREMENT MILLmp_stMILWoTstr "MIL status without tester intervention" UBYTE OneToOne 1 100 0.00 255.0 FORMAT "%5.1" ECU_ADDRESS 0x60025765
 /begin IF_DATA XCPplus 0x0102
  /begin DAQ_EVENT VARIABLE /end DAQ_EVENT
 /end IF_DATA
/end MEASUREMENT
/begin MEASUREMENT MILLmp_stPs "status of the MIL lamp (on, off)" UBYTE OneToOne 1 100 0.00 255.0 BIT_MASK 0x1 FORMAT "%5.1" ECU_ADDRESS 0x60023882
 /begin IF_DATA XCPplus 0x0102
  /begin DAQ_EVENT VARIABLE /end DAQ_EVENT
 /end IF_DATA
/end MEASUREMENT
/begin MEASUREMENT MILLmp_stReqBln "MIL request register for blinking MIL requests" ULONG OneToOne 1 100 0.00 4294967295.00 FORMAT "%13.2" ECU_ADDRESS 0x60035E70
 /begin IF_DATA XCPplus 0x0102
  /begin DAQ_EVENT VARIABLE /end DAQ_EVENT
 /end IF_DATA
/end MEASUREMENT
/begin MEASUREMENT MILLmp_stReqOn "MIL request register for continuous MIL requests" ULONG OneToOne 1 100 0.00 4294967295.00 FORMAT "%13.2" ECU_ADDRESS 0x60035E74
 /begin IF_DATA XCPplus 0x0102
  /begin DAQ_EVENT VARIABLE /end DAQ_EVENT
 /end IF_DATA
/end MEASUREMENT
/begin MEASUREMENT MILLmp_stSt "state of the MIL's state machine" UBYTE MILLmp_StVerb 1 100 0.00 34.0000000000 FORMAT "%13.10" ECU_ADDRESS 0x60025767
 /begin IF_DATA XCPplus 0x0102
  /begin DAQ_EVENT VARIABLE /end DAQ_EVENT
 /end IF_DATA
/end MEASUREMENT
/begin MEASUREMENT MILLmp_tiRmnBln "remaining time for MIL trigger during MIL_BLINK" UBYTE t50msxs_q0p05 1 100 0.00 12.75 FORMAT "%5.2" ECU_ADDRESS 0x60025764
 /begin IF_DATA XCPplus 0x0102
  /begin DAQ_EVENT VARIABLE /end DAQ_EVENT
 /end IF_DATA
/end MEASUREMENT
/begin MEASUREMENT MILLmp_tiRmnSt "remaining state time for states with time trigger" UBYTE t200msxs_ub_b51 1 100 0.00 51.00 FORMAT "%5.2" ECU_ADDRESS 0x60025766
 /begin IF_DATA XCPplus 0x0102
  /begin DAQ_EVENT VARIABLE /end DAQ_EVENT
 /end IF_DATA
/end MEASUREMENT
/begin MEASUREMENT MoCADC_bChkActv "Bit info ADC check by Null Load Testimpuls is active" UBYTE B_TRUE 1 100 0.00 1.00000000000 BIT_MASK 0x8 FORMAT "%13.11" ECU_ADDRESS 0x6002CB9B /end MEASUREMENT
/begin MEASUREMENT MoCADC_bDef "Bit info ADC check detected an error" UBYTE B_TRUE 1 100 0.00 1.00000000000 BIT_MASK 0x80 FORMAT "%13.11" ECU_ADDRESS 0x6002CB9B /end MEASUREMENT
/begin MEASUREMENT MoCADC_bNTPActv "Null load test impulse check active in ADC monitoring" UBYTE B_TRUE 1 100 0.00 1.00000000000 BIT_MASK 0x1 FORMAT "%13.11" ECU_ADDRESS 0x6002CB9B /end MEASUREMENT
/begin MEASUREMENT MoCADC_bNTPBnk1ChkActv "Null load test impulse check active in Bank1 ADC monitoring" UBYTE B_TRUE 1 100 0.00 1.00000000000 BIT_MASK 0x1 FORMAT "%13.11" ECU_ADDRESS 0x6002CB9C
 /begin IF_DATA XCPplus 0x0102
  /begin DAQ_EVENT VARIABLE /end DAQ_EVENT
 /end IF_DATA
/end MEASUREMENT
/begin MEASUREMENT MoCADC_bNTPBnk1Rel "Null load test impulse was released in Bank1" UBYTE B_TRUE 1 100 0.00 1.00000000000 BIT_MASK 0x2 FORMAT "%13.11" ECU_ADDRESS 0x6002CB9C
 /begin IF_DATA XCPplus 0x0102
  /begin DAQ_EVENT VARIABLE /end DAQ_EVENT
 /end IF_DATA
/end MEASUREMENT
/begin MEASUREMENT MoCADC_bNTPErr "Bitinfo in MoCADC_st for irreversible error in ADC check by NuLL Load Testimpuls" UBYTE B_TRUE 1 100 0.00 1.00000000000 BIT_MASK 0x40 FORMAT "%13.11" ECU_ADDRESS 0x6002CB9B /end MEASUREMENT
/begin MEASUREMENT MoCADC_bNTPRel "Null load test impulse was released" UBYTE B_TRUE 1 100 0.00 1.00000000000 BIT_MASK 0x2 FORMAT "%13.11" ECU_ADDRESS 0x6002CB9B /end MEASUREMENT
/begin MEASUREMENT MoCADC_bTstErr "Bitinfo in MoCADC_st for testvoltage out of permissible range" UBYTE B_TRUE 1 100 0.00 1.00000000000 BIT_MASK 0x4 FORMAT "%13.11" ECU_ADDRESS 0x6002CB9B /end MEASUREMENT
/begin MEASUREMENT MoCADC_cntrDebNTP "Error counter for verifying of Null-load-Test-pulse" UBYTE OneToOne 1 100 0.00 255.0 FORMAT "%5.1" ECU_ADDRESS 0x6002CBA2
 /begin IF_DATA XCPplus 0x0102
  /begin DAQ_EVENT VARIABLE /end DAQ_EVENT
 /end IF_DATA
/end MEASUREMENT
/begin MEASUREMENT MoCADC_cntrDebNTPCpl "Double storage for error counter for testing with null load test pulse procedure" UBYTE OneToOne 1 100 0.00 255.0 FORMAT "%5.1" ECU_ADDRESS 0x6002C1C5
 /begin IF_DATA XCPplus 0x0102
  /begin DAQ_EVENT VARIABLE /end DAQ_EVENT
 /end IF_DATA
/end MEASUREMENT
/begin MEASUREMENT MoCADC_cntrDebTest "Error counter for testing the test voltage" UBYTE OneToOne 1 100 0.00 255.0 FORMAT "%5.1" ECU_ADDRESS 0x6002CBA1
 /begin IF_DATA XCPplus 0x0102
  /begin DAQ_EVENT VARIABLE /end DAQ_EVENT
 /end IF_DATA
/end MEASUREMENT
/begin MEASUREMENT MoCADC_cntrDebTestCpl "Double storage for error counter for testing with test voltage" UBYTE OneToOne 1 100 0.00 255.0 FORMAT "%5.1" ECU_ADDRESS 0x6002C1C4
 /begin IF_DATA XCPplus 0x0102
  /begin DAQ_EVENT VARIABLE /end DAQ_EVENT
 /end IF_DATA
/end MEASUREMENT
/begin MEASUREMENT MoCADC_cntrTestVoltTestBnk1 "counter of testflag in diagnosis for ADC in Bank1 - testvoltage check" UBYTE OneToOne 1 100 0.00 255.0 FORMAT "%5.1" ECU_ADDRESS 0x6002CBA0
 /begin IF_DATA XCPplus 0x0102
  /begin DAQ_EVENT VARIABLE /end DAQ_EVENT
 /end IF_DATA
/end MEASUREMENT
/begin MEASUREMENT MoCADC_flgClrNTP "Flag bit to indicate request to clear fault memory" UBYTE B_TRUE 1 100 0.00 1.00000000000 BIT_MASK 0x1 FORMAT "%13.11" ECU_ADDRESS 0x70000136
 /begin IF_DATA XCPplus 0x0102
  /begin DAQ_EVENT VARIABLE /end DAQ_EVENT
 /end IF_DATA
/end MEASUREMENT
/begin MEASUREMENT MoCADC_flgClrTest "Flag bit to indicate request to clear fault memory" UBYTE B_TRUE 1 100 0.00 1.00000000000 BIT_MASK 0x1 FORMAT "%13.11" ECU_ADDRESS 0x70000135
 /begin IF_DATA XCPplus 0x0102
  /begin DAQ_EVENT VARIABLE /end DAQ_EVENT
 /end IF_DATA
/end MEASUREMENT
/begin MEASUREMENT MoCADC_flgNTPTestBnk1 "Indicates that the NTP test on bank1 is executed atleast once" UBYTE OneToOne 1 100 0.00 255.0 FORMAT "%5.1" ECU_ADDRESS 0x6002CB9F /end MEASUREMENT
/begin MEASUREMENT MoCADC_st "Status Info of ADC monitoring" UBYTE dez 1 100 0.00 255.0 FORMAT "%5.1" ECU_ADDRESS 0x6002CB9B
 /begin IF_DATA XCPplus 0x0102
  /begin DAQ_EVENT VARIABLE /end DAQ_EVENT
 /end IF_DATA
/end MEASUREMENT
/begin MEASUREMENT MoCADC_stCheckState "Status state machine for NTP execution and evaluation in MoCADC_Co_Proc_1ms Task" UBYTE OneToOne 1 100 0.00 255.0 FORMAT "%5.1" ECU_ADDRESS 0x6002CB9E
 /begin IF_DATA XCPplus 0x0102
  /begin DAQ_EVENT VARIABLE /end DAQ_EVENT
 /end IF_DATA
/end MEASUREMENT
/begin MEASUREMENT MoCADC_stCheckStateCpl "Complement of MoCADC_stCheckState" UBYTE OneToOne 1 100 0.00 255.0 FORMAT "%5.1" ECU_ADDRESS 0x6002C1C3
 /begin IF_DATA XCPplus 0x0102
  /begin DAQ_EVENT VARIABLE /end DAQ_EVENT
 /end IF_DATA
/end MEASUREMENT
/begin MEASUREMENT MoCADC_stCpl "Double storage of status Info of ADC monitoring" UBYTE dez 1 100 0.00 255.0 FORMAT "%5.1" ECU_ADDRESS 0x6002C1C2
 /begin IF_DATA XCPplus 0x0102
  /begin DAQ_EVENT VARIABLE /end DAQ_EVENT
 /end IF_DATA
/end MEASUREMENT
/begin MEASUREMENT MoCADC_stIrrvErrMsg "Status Info of Irreversible error in Null load test pulse and Test Voltage" UBYTE dez 1 100 0.00 255.0 FORMAT "%5.1" ECU_ADDRESS 0x7000142E
 /begin IF_DATA XCPplus 0x0102
  /begin DAQ_EVENT VARIABLE /end DAQ_EVENT
 /end IF_DATA
/end MEASUREMENT
/begin MEASUREMENT MoCADC_stMsg "Status info from ADC Monitoring, message forLevel1" UBYTE dez 1 100 0.00 255.0 FORMAT "%5.1" ECU_ADDRESS 0x7000121C
 /begin IF_DATA XCPplus 0x0102
  /begin DAQ_EVENT VARIABLE /end DAQ_EVENT
 /end IF_DATA
/end MEASUREMENT
/begin MEASUREMENT MoCADC_stNTPBnk1Req "Status Info of Null load test pulse request in bank1" UBYTE OneToOne 1 100 0.00 255.0 FORMAT "%5.1" ECU_ADDRESS 0x6002CB9D /end MEASUREMENT
/begin MEASUREMENT MoCADC_stNTPTest "Status Info of NTP monitoring" UBYTE dez 1 100 0.00 255.0 FORMAT "%5.1" ECU_ADDRESS 0x6002CB9C
 /begin IF_DATA XCPplus 0x0102
  /begin DAQ_EVENT VARIABLE /end DAQ_EVENT
 /end IF_DATA
/end MEASUREMENT
/begin MEASUREMENT MoCADC_stNTPTestCpl "Double storage for Status for null load test pulse procedure" UBYTE dez 1 100 0.00 255.0 FORMAT "%5.1" ECU_ADDRESS 0x6002C1C1
 /begin IF_DATA XCPplus 0x0102
  /begin DAQ_EVENT VARIABLE /end DAQ_EVENT
 /end IF_DATA
/end MEASUREMENT
/begin MEASUREMENT MoCADC_uNTPBnk1_mp "Voltage at the channel where pulldown is done in ADC bank1" UWORD spg_q0p00977 1 100 0.00 639.9902 FORMAT "%8.4" ECU_ADDRESS 0x70006982 /end MEASUREMENT
/begin MEASUREMENT MoCADC_uTest_mp "Voltage at ADC test voltage input in Bank1" SWORD spg_q4p88_mV 1 100 -160000.0 159995.1 FORMAT "%8.1" ECU_ADDRESS 0x70006980 /end MEASUREMENT
/begin MEASUREMENT MoCCom_bPFCNew "condition new question received for program flow check" UBYTE B_TRUE 1 100 0.00 1.00000000000 BIT_MASK 0x2 FORMAT "%13.11" ECU_ADDRESS 0x6002B8A4
 /begin IF_DATA XCPplus 0x0102
  /begin DAQ_EVENT VARIABLE /end DAQ_EVENT
 /end IF_DATA
/end MEASUREMENT
/begin MEASUREMENT MoCCom_bSwShrNew "new question received for software sharing module" UBYTE B_TRUE 1 100 0.00 1.00000000000 BIT_MASK 0x10 FORMAT "%13.11" ECU_ADDRESS 0x6002B8A4 /end MEASUREMENT
/begin MEASUREMENT MoCCom_cntrInCorrRespTime "Incorrect response time counter" UBYTE OneToOne 1 100 0.00 255.0 FORMAT "%5.1" ECU_ADDRESS 0x6002C1C0 /end MEASUREMENT
/begin MEASUREMENT MoCCom_cntrSyncMonModl "Counter to increment when incomplete response is received" UBYTE OneToOne 1 100 0.00 255.0 FORMAT "%5.1" ECU_ADDRESS 0x6002C1BF /end MEASUREMENT
/begin MEASUREMENT MoCCom_cntrWDAErrThd "Error counter threshold of the external monitoring module" UBYTE OneToOne 1 100 3.000 4.000 FORMAT "%5.3" ECU_ADDRESS 0x6002C1AE /end MEASUREMENT
/begin MEASUREMENT MoCCom_cntrWDAErrThdCpl "Complement of Error counter threshold of the external monitoring module" UBYTE OneToOne 1 100 0.00 255.0 FORMAT "%5.1" ECU_ADDRESS 0x6002C1BE /end MEASUREMENT
/begin MEASUREMENT MoCCom_cntrWDAErrThdMsg "Error counter threshold of the external monitoring module (a message for Level 1)" UBYTE dez 1 100 3.000 4.000 FORMAT "%5.3" ECU_ADDRESS 0x7000142D /end MEASUREMENT
/begin MEASUREMENT MoCCom_ctBusErr "error counter for communication bus error between FC and other ASICS like power stage ASIC, Monitoring module etc" UBYTE OneToOne 1 100 0.00 255.0 FORMAT "%5.1" ECU_ADDRESS 0x6002C1BD /end MEASUREMENT
/begin MEASUREMENT MoCCom_ctBusErrCpl "Complement variable for bus errors" UBYTE OneToOne 1 100 0.00 255.0 FORMAT "%5.1" ECU_ADDRESS 0x6002C1BC /end MEASUREMENT
/begin MEASUREMENT MoCCom_ctErrFC "error counter for failure in function controller" UBYTE OneToOne 1 100 0.00 255.0 FORMAT "%5.1" ECU_ADDRESS 0x6002C1AD /end MEASUREMENT
/begin MEASUREMENT MoCCom_ctErrFCCpl "RAM data redundancy for MoCCom_ctErrFC" UBYTE OneToOne 1 100 0.00 255.0 FORMAT "%5.1" ECU_ADDRESS 0x6002C1BB /end MEASUREMENT
/begin MEASUREMENT MoCCom_ctErrMM "error counter of monitoring module" UBYTE OneToOne 1 100 0.00 255.0 FORMAT "%5.1" ECU_ADDRESS 0x6002C1AC /end MEASUREMENT
/begin MEASUREMENT MoCCom_ctErrMMMsg "info for level 1: error counter of monitoring module" UBYTE dez 1 100 0.00 255.0 FORMAT "%5.1" ECU_ADDRESS 0x7000142C /end MEASUREMENT
/begin MEASUREMENT MoCCom_ctErrMMOld "old value of the error count got from the monitoring module" UBYTE OneToOne 1 100 0.00 255.0 FORMAT "%5.1" ECU_ADDRESS 0x6002C1BA /end MEASUREMENT
/begin MEASUREMENT MoCCom_ctErrOSTimeout "error counter for timeout of operating system" UBYTE OneToOne 1 100 0.00 255.0 FORMAT "%5.1" ECU_ADDRESS 0x6002C1B9 /end MEASUREMENT
/begin MEASUREMENT MoCCom_Query "Enlarged query from monitoring module" ULONG dez 1 100 0.00 4294967295.00 FORMAT "%13.2" ECU_ADDRESS 0x6002C1A4 /end MEASUREMENT
/begin MEASUREMENT MoCCom_Response "Response to the query from monitoring module" ULONG dez 1 100 0.00 4294967295.00 FORMAT "%13.2" ECU_ADDRESS 0x6002C1A8 /end MEASUREMENT
/begin MEASUREMENT MoCCom_Response_mp "copy of the response to the monitoring module" ULONG dez 1 100 0.00 4294967295.00 FORMAT "%13.2" ECU_ADDRESS 0x70006868 /end MEASUREMENT
/begin MEASUREMENT MoCCom_stBusErr "Status variable for bus error" UBYTE OneToOne 1 100 0.00 255.0 FORMAT "%5.1" ECU_ADDRESS 0x6002C1B8 /end MEASUREMENT
/begin MEASUREMENT MoCCom_stCheckState "Actual step of MoCCOM inner state machine" UBYTE MoCCom_stCheckState_Compu 1 100 0.00 7.00000000000 FORMAT "%13.11" ECU_ADDRESS 0x6002C1B7 /end MEASUREMENT
/begin MEASUREMENT MoCCom_stCheckStateCpl "complement variable for actual step of moccom inner state machine" UBYTE OneToOne 1 100 0.00 255.0 FORMAT "%5.1" ECU_ADDRESS 0x6002C1B6 /end MEASUREMENT
/begin MEASUREMENT MoCCom_stComActvOld "Variable to update the SOP test active status" UBYTE OneToOne 1 100 0.00 255.0 FORMAT "%5.1" ECU_ADDRESS 0x6002C1B5 /end MEASUREMENT
/begin MEASUREMENT MoCCom_stComActvOldCpl "Complement of MoCCom_stComActvOld" UBYTE OneToOne 1 100 0.00 255.0 FORMAT "%5.1" ECU_ADDRESS 0x6002C1B4 /end MEASUREMENT
/begin MEASUREMENT MoCCom_stComState "Actual step of MoCCOM WD communication state machine" UBYTE MoCCom_stComState_Compu 1 100 0.00 2.00000000000 FORMAT "%13.11" ECU_ADDRESS 0x6002C1B3 /end MEASUREMENT
/begin MEASUREMENT MoCCom_stErrEna "status variable, if reinitialisation of power stages CJ945 and CY372 is necessary" UBYTE OneToOne 1 100 0.00 255.0 FORMAT "%5.1" ECU_ADDRESS 0x6002C1B2 /end MEASUREMENT
/begin MEASUREMENT MoCCom_stErrEnaCpl "double storaged status variable, if reinitialisation of power stages CJ945 and CY372 is necessary" UBYTE OneToOne 1 100 0.00 255.0 FORMAT "%5.1" ECU_ADDRESS 0x6002C1B1 /end MEASUREMENT
/begin MEASUREMENT MoCCom_stQueryNew "Bitbase for info 'new query from monitoring module'" UBYTE OneToOne 1 100 0.00 255.0 FORMAT "%5.1" ECU_ADDRESS 0x6002B8A4 /end MEASUREMENT
/begin MEASUREMENT MoCCom_stWdgThdErr "Status variable for watchdog threshold error" UBYTE OneToOne 1 100 0.00 255.0 FORMAT "%5.1" ECU_ADDRESS 0x6002C1B0 /end MEASUREMENT
/begin MEASUREMENT MoCCom_stWdgTiWinErr "Status variable for watchdog time window error" UBYTE OneToOne 1 100 0.00 255.0 FORMAT "%5.1" ECU_ADDRESS 0x6002C1AF /end MEASUREMENT
/begin MEASUREMENT MoCCom_SwShrPtlResp "Partial response contribution from software sharing modules" ULONG OneToOne 1 100 0.00 4294967295.00 FORMAT "%13.2" ECU_ADDRESS 0x6002C1A0 /end MEASUREMENT
/begin MEASUREMENT MoCCPU_PartResp "Partial response from instruction test to monitoring module" ULONG OneToOne 1 100 0.00 4294967295.00 FORMAT "%13.2" ECU_ADDRESS 0x6002C19C
 /begin IF_DATA XCPplus 0x0102
  /begin DAQ_EVENT VARIABLE /end DAQ_EVENT
 /end IF_DATA
/end MEASUREMENT
/begin MEASUREMENT MoCEMM_idxNumCurrErr "Variable to store the number of current error requests" UWORD OneToOne 1 100 0.00 65535.00 FORMAT "%8.2" ECU_ADDRESS 0x6002B8A2 /end MEASUREMENT
/begin MEASUREMENT MoCEMM_stEmmAlrms "State of EMM alarm groups" ULONG dez 1 100 0.00 4294967295.00 FORMAT "%13.2" MATRIX_DIM 22 ECU_ADDRESS 0x6002CB40
 /begin IF_DATA XCPplus 0x0102
  /begin DAQ_EVENT VARIABLE /end DAQ_EVENT
 /end IF_DATA
/end MEASUREMENT
/begin MEASUREMENT MoCEMM_stEmmAlrmsCpl "Complement of MoCEMM_stEmmAlrms" ULONG dez 1 100 0.00 4294967295.00 FORMAT "%13.2" MATRIX_DIM 22 ECU_ADDRESS 0x6002C140
 /begin IF_DATA XCPplus 0x0102
  /begin DAQ_EVENT VARIABLE /end DAQ_EVENT
 /end IF_DATA
/end MEASUREMENT
/begin MEASUREMENT MoCEMM_stEmmAlrmsMsg "State of EMM alarm groups" ULONG dez 1 100 0.00 4294967295.00 FORMAT "%13.2" MATRIX_DIM 22 ECU_ADDRESS 0x70001430
 /begin IF_DATA XCPplus 0x0102
  /begin DAQ_EVENT VARIABLE /end DAQ_EVENT
 /end IF_DATA
/end MEASUREMENT
/begin MEASUREMENT MoCEMM_stEmmAlrmsNv "State of EMM alarm groups in NV-Ram" ULONG dez 1 100 0.00 4294967295.00 FORMAT "%13.2" MATRIX_DIM 22 ECU_ADDRESS 0x60035F88 /end MEASUREMENT
/begin MEASUREMENT MoCEMM_stEmmErrorPin "Physical state of error pin" UBYTE dez 1 100 0.00 255.0 FORMAT "%5.1" ECU_ADDRESS 0x6002CB98
 /begin IF_DATA XCPplus 0x0102
  /begin DAQ_EVENT VARIABLE /end DAQ_EVENT
 /end IF_DATA
/end MEASUREMENT
/begin MEASUREMENT MoCEMM_stEmmErrorPinCpl "Complement of physical state of error pin" UBYTE dez 1 100 0.00 255.0 FORMAT "%5.1" ECU_ADDRESS 0x6002C19B
 /begin IF_DATA XCPplus 0x0102
  /begin DAQ_EVENT VARIABLE /end DAQ_EVENT
 /end IF_DATA
/end MEASUREMENT
/begin MEASUREMENT MoCEMM_stEmmGPIO "State of Master controllers output GPIO line" UBYTE dez 1 100 0.00 255.0 FORMAT "%5.1" ECU_ADDRESS 0x6002C19A /end MEASUREMENT
/begin MEASUREMENT MoCEMM_stPwrOnRstHdl "Variable to store the status of execution of power-on reset handler" UBYTE OneToOne 1 100 0.00 255.0 FORMAT "%5.1" ECU_ADDRESS 0x6002CB9A /end MEASUREMENT
/begin MEASUREMENT MoCEMM_stPwrOnRstHdlCpl "Complement variable to store the status of execution of power-on reset handler" UBYTE OneToOne 1 100 0.00 255.0 FORMAT "%5.1" ECU_ADDRESS 0x6002C199 /end MEASUREMENT
/begin MEASUREMENT MoCEMM_stPwrOnRstReq "Variable to store the status of power-on reset request" UBYTE OneToOne 1 100 0.00 255.0 FORMAT "%5.1" ECU_ADDRESS 0x6002CB99 /end MEASUREMENT
/begin MEASUREMENT MoCEMM_stPwrOnRstReqCpl "Complement variable to store the status of power-on reset request" UBYTE OneToOne 1 100 0.00 255.0 FORMAT "%5.1" ECU_ADDRESS 0x6002C198 /end MEASUREMENT
/begin MEASUREMENT MoCEMM_structCurrReq.MoCEMM_cntrInfo "Structure to store the current PORST request / Structure member to store number of power on resets" ULONG OneToOne 1 100 0.00 4294967295.00 FORMAT "%13.2" ECU_ADDRESS 0x700016A8 /end MEASUREMENT
/begin MEASUREMENT MoCEMM_structCurrReq.MoCEMM_blkInfo "Structure to store the current PORST request / Structure member to store error ID, error statues and Diagnosis data" ULONG OneToOne 1 100 0.00 4294967295.00 FORMAT "%13.2" MATRIX_DIM 17 ECU_ADDRESS 0x700016AC /end MEASUREMENT
/begin MEASUREMENT MoCEMM_structCurrReq.MoCEMM_cntrInfoCpl "Structure to store the current PORST request / Complement of MoCEMM_cntrInfo" ULONG OneToOne 1 100 0.00 4294967295.00 FORMAT "%13.2" ECU_ADDRESS 0x70001750 /end MEASUREMENT
/begin MEASUREMENT MoCEMM_structFlash.MoCEMM_cntrInfo "Structure to store the error information from NvM memory. / Structure member to store number of power on resets" ULONG OneToOne 1 100 0.00 4294967295.00 FORMAT "%13.2" ECU_ADDRESS 0x700015FC /end MEASUREMENT
/begin MEASUREMENT MoCEMM_structFlash.MoCEMM_blkInfo "Structure to store the error information from NvM memory. / Structure member to store error ID, error statues and Diagnosis data" ULONG OneToOne 1 100 0.00 4294967295.00 FORMAT "%13.2" MATRIX_DIM 41 ECU_ADDRESS 0x70001600 /end MEASUREMENT
/begin MEASUREMENT MoCEMM_structFlash.MoCEMM_cntrInfoCpl "Structure to store the error information from NvM memory. / Complement of MoCEMM_cntrInfo" ULONG OneToOne 1 100 0.00 4294967295.00 FORMAT "%13.2" ECU_ADDRESS 0x700016A4 /end MEASUREMENT
/begin MEASUREMENT MoCEMM_stSWErrorPinReqAry "Status array for errorpin handler which software modules are in fault state" ULONG MoExe_Co_PFC_ID_Compu 1 100 0.00 16777471.0000 FORMAT "%13.4" MATRIX_DIM 10 ECU_ADDRESS 0x70039BD4 /end MEASUREMENT
/begin MEASUREMENT MoCEMM_stSWErrorPinReqAryCpl "Complement of MoCEMM_stSWErrorPinReqAry" ULONG OneToOne 1 100 0.00 4294967295.00 FORMAT "%13.2" MATRIX_DIM 10 ECU_ADDRESS 0x70039BAC /end MEASUREMENT
/begin MEASUREMENT MoCEMM_wdgTout "Variable to store timeout of internal watchdog" ULONG OneToOne 1 100 0.00 4294967295.00 FORMAT "%13.2" ECU_ADDRESS 0x70039BA8 /end MEASUREMENT
/begin MEASUREMENT MoCGTM_aryCMPErrBit "Output array obtained from CMP_IRQ_NOTIFY" UBYTE OneToOne 1 100 0.00 255.0 FORMAT "%5.1" MATRIX_DIM 4 ECU_ADDRESS 0x6002CB3C
 /begin IF_DATA XCPplus 0x0102
  /begin DAQ_EVENT VARIABLE /end DAQ_EVENT
 /end IF_DATA
/end MEASUREMENT
/begin MEASUREMENT MoCGTM_aryCMPErrBitCpl "Complement variable for Output array obtained from CMP_IRQ_NOTIFY" UBYTE OneToOne 1 100 0.00 255.0 FORMAT "%5.1" MATRIX_DIM 4 ECU_ADDRESS 0x6002C13C
 /begin IF_DATA XCPplus 0x0102
  /begin DAQ_EVENT VARIABLE /end DAQ_EVENT
 /end IF_DATA
/end MEASUREMENT
/begin MEASUREMENT MoCGTM_bbOut1 "Bit bases for storing status of compare bit" UBYTE OneToOne 1 100 0.00 255.0 FORMAT "%5.1" ECU_ADDRESS 0x6002CB2C /end MEASUREMENT
/begin MEASUREMENT MoCGTM_bbOut1Cpl "complement variable for MoCGTMCo_bbOut1" UBYTE OneToOne 1 100 0.00 255.0 FORMAT "%5.1" ECU_ADDRESS 0x6002C13B /end MEASUREMENT
/begin MEASUREMENT MoCGTM_cmpErrAryIdx "Array index for CMP unit check" UBYTE OneToOne 1 100 0.00 255.0 FORMAT "%5.1" ECU_ADDRESS 0x6002CB3B
 /begin IF_DATA XCPplus 0x0102
  /begin DAQ_EVENT VARIABLE /end DAQ_EVENT
 /end IF_DATA
/end MEASUREMENT
/begin MEASUREMENT MoCGTM_cmpErrAryIdxCpl "Complement variable for MoCGTM_cmpErrAryIdx" UBYTE OneToOne 1 100 0.00 255.0 FORMAT "%5.1" ECU_ADDRESS 0x6002C13A
 /begin IF_DATA XCPplus 0x0102
  /begin DAQ_EVENT VARIABLE /end DAQ_EVENT
 /end IF_DATA
/end MEASUREMENT
/begin MEASUREMENT MoCGTM_cntrBadcase "Number of bad cases triggered by MCS" ULONG OneToOne 1 100 0.00 4294967295.00 FORMAT "%13.2" ECU_ADDRESS 0x6002CB28
 /begin IF_DATA XCPplus 0x0102
  /begin DAQ_EVENT VARIABLE /end DAQ_EVENT
 /end IF_DATA
/end MEASUREMENT
/begin MEASUREMENT MoCGTM_cntrCMPErrbit "Number of times badcase detected by CMP unit" ULONG OneToOne 1 100 0.00 4294967295.00 FORMAT "%13.2" ECU_ADDRESS 0x6002CB24
 /begin IF_DATA XCPplus 0x0102
  /begin DAQ_EVENT VARIABLE /end DAQ_EVENT
 /end IF_DATA
/end MEASUREMENT
/begin MEASUREMENT MoCGTM_cntrCMPErrbitCpl "Complement variable for MoCGTM_CMPErrbitCnt" ULONG OneToOne 1 100 0.00 4294967295.00 FORMAT "%13.2" ECU_ADDRESS 0x6002C130
 /begin IF_DATA XCPplus 0x0102
  /begin DAQ_EVENT VARIABLE /end DAQ_EVENT
 /end IF_DATA
/end MEASUREMENT
/begin MEASUREMENT MoCGTM_cntrCMPErrbitHeal "Healing counter for MoCGTM_cntrCMPErrbit" UBYTE OneToOne 1 100 0.00 255.0 FORMAT "%5.1" ECU_ADDRESS 0x6002CB3A
 /begin IF_DATA XCPplus 0x0102
  /begin DAQ_EVENT VARIABLE /end DAQ_EVENT
 /end IF_DATA
/end MEASUREMENT
/begin MEASUREMENT MoCGTM_cntrCMPErrbitHealCpl "Complement variable for MoCGTM_cntrCMPErrbitHeal" UBYTE OneToOne 1 100 0.00 255.0 FORMAT "%5.1" ECU_ADDRESS 0x6002C139
 /begin IF_DATA XCPplus 0x0102
  /begin DAQ_EVENT VARIABLE /end DAQ_EVENT
 /end IF_DATA
/end MEASUREMENT
/begin MEASUREMENT MoCGTM_cntrDebErr "Error Debounce Counter for Pattern Mismatch error" UBYTE OneToOne 1 100 0.00 255.0 FORMAT "%5.1" ECU_ADDRESS 0x6002CB39
 /begin IF_DATA XCPplus 0x0102
  /begin DAQ_EVENT VARIABLE /end DAQ_EVENT
 /end IF_DATA
/end MEASUREMENT
/begin MEASUREMENT MoCGTM_cntrDebErrCpl "Complement of the Error Debounce Counter for Pattern Mismatch error" UBYTE OneToOne 1 100 0.00 255.0 FORMAT "%5.1" ECU_ADDRESS 0x6002C138
 /begin IF_DATA XCPplus 0x0102
  /begin DAQ_EVENT VARIABLE /end DAQ_EVENT
 /end IF_DATA
/end MEASUREMENT
/begin MEASUREMENT MoCGTM_cntrDebErrMax "Max. deviation between badcase created and detected occurred" UBYTE OneToOne 1 100 0.00 255.0 FORMAT "%5.1" ECU_ADDRESS 0x6002C137
 /begin IF_DATA XCPplus 0x0102
  /begin DAQ_EVENT VARIABLE /end DAQ_EVENT
 /end IF_DATA
/end MEASUREMENT
/begin MEASUREMENT MoCGTM_cntrErrClkMon "Debounce counter for error in clock monitoring" UBYTE OneToOne 1 100 0.00 255.0 FORMAT "%5.1" ECU_ADDRESS 0x6002CB38
 /begin IF_DATA XCPplus 0x0102
  /begin DAQ_EVENT VARIABLE /end DAQ_EVENT
 /end IF_DATA
/end MEASUREMENT
/begin MEASUREMENT MoCGTM_cntrErrClkMonCpl "Complement variable for Debounce counter for error in clock monitoring" UBYTE OneToOne 1 100 0.00 255.0 FORMAT "%5.1" ECU_ADDRESS 0x6002C136
 /begin IF_DATA XCPplus 0x0102
  /begin DAQ_EVENT VARIABLE /end DAQ_EVENT
 /end IF_DATA
/end MEASUREMENT
/begin MEASUREMENT MoCGTM_cntrMCS1 "Number of times MCS1 triggered from core" ULONG OneToOne 1 100 0.00 4294967295.00 FORMAT "%13.2" ECU_ADDRESS 0x6002CB20
 /begin IF_DATA XCPplus 0x0102
  /begin DAQ_EVENT VARIABLE /end DAQ_EVENT
 /end IF_DATA
/end MEASUREMENT
/begin MEASUREMENT MoCGTM_cntrMCS1Old "previous raster value of Number of times MCS1 triggered from core" ULONG OneToOne 1 100 0.00 4294967295.00 FORMAT "%13.2" ECU_ADDRESS 0x6002CB1C
 /begin IF_DATA XCPplus 0x0102
  /begin DAQ_EVENT VARIABLE /end DAQ_EVENT
 /end IF_DATA
/end MEASUREMENT
/begin MEASUREMENT MoCGTM_cntrMCS1OldCpl "complement variable for MoCGTM_cntrMCS1Old" ULONG OneToOne 1 100 0.00 4294967295.00 FORMAT "%13.2" ECU_ADDRESS 0x6002C12C
 /begin IF_DATA XCPplus 0x0102
  /begin DAQ_EVENT VARIABLE /end DAQ_EVENT
 /end IF_DATA
/end MEASUREMENT
/begin MEASUREMENT MoCGTM_cntrMCS2 "Number of times MCS2 triggered from core" ULONG OneToOne 1 100 0.00 4294967295.00 FORMAT "%13.2" ECU_ADDRESS 0x6002CB18
 /begin IF_DATA XCPplus 0x0102
  /begin DAQ_EVENT VARIABLE /end DAQ_EVENT
 /end IF_DATA
/end MEASUREMENT
/begin MEASUREMENT MoCGTM_cntrMCS2Old "previous raster value of Number of times MCS2 triggered from core" ULONG OneToOne 1 100 0.00 4294967295.00 FORMAT "%13.2" ECU_ADDRESS 0x6002CB14
 /begin IF_DATA XCPplus 0x0102
  /begin DAQ_EVENT VARIABLE /end DAQ_EVENT
 /end IF_DATA
/end MEASUREMENT
/begin MEASUREMENT MoCGTM_cntrMCS2OldCpl "complement variable for MoCGTM_cntrMCS2Old" ULONG OneToOne 1 100 0.00 4294967295.00 FORMAT "%13.2" ECU_ADDRESS 0x6002C128
 /begin IF_DATA XCPplus 0x0102
  /begin DAQ_EVENT VARIABLE /end DAQ_EVENT
 /end IF_DATA
/end MEASUREMENT
/begin MEASUREMENT MoCGTM_cntrMCS3 "Number of times MCS3 triggered from core" ULONG OneToOne 1 100 0.00 4294967295.00 FORMAT "%13.2" ECU_ADDRESS 0x6002CB10
 /begin IF_DATA XCPplus 0x0102
  /begin DAQ_EVENT VARIABLE /end DAQ_EVENT
 /end IF_DATA
/end MEASUREMENT
/begin MEASUREMENT MoCGTM_cntrMCS3Old "previous raster value of Number of times MCS3 triggered from core" ULONG OneToOne 1 100 0.00 4294967295.00 FORMAT "%13.2" ECU_ADDRESS 0x6002CB0C
 /begin IF_DATA XCPplus 0x0102
  /begin DAQ_EVENT VARIABLE /end DAQ_EVENT
 /end IF_DATA
/end MEASUREMENT
/begin MEASUREMENT MoCGTM_cntrMCS3OldCpl "complement variable for MoCGTM_cntrMCS3Old" ULONG OneToOne 1 100 0.00 4294967295.00 FORMAT "%13.2" ECU_ADDRESS 0x6002C124
 /begin IF_DATA XCPplus 0x0102
  /begin DAQ_EVENT VARIABLE /end DAQ_EVENT
 /end IF_DATA
/end MEASUREMENT
/begin MEASUREMENT MoCGTM_cntrMsmCMPErrBit "Number of mismatch between MoCGTM_aryCMPErrBit and MoCGTM_exptCMPErrBit_CA" UBYTE OneToOne 1 100 0.00 255.0 FORMAT "%5.1" ECU_ADDRESS 0x6002CB37
 /begin IF_DATA XCPplus 0x0102
  /begin DAQ_EVENT VARIABLE /end DAQ_EVENT
 /end IF_DATA
/end MEASUREMENT
/begin MEASUREMENT MoCGTM_cntrRouteSigErr "Number of time signal routing error occured in GTM" UBYTE OneToOne 1 100 0.00 255.0 FORMAT "%5.1" ECU_ADDRESS 0x6002CB36
 /begin IF_DATA XCPplus 0x0102
  /begin DAQ_EVENT VARIABLE /end DAQ_EVENT
 /end IF_DATA
/end MEASUREMENT
/begin MEASUREMENT MoCGTM_cntrRouteSigErrCpl "Complement variable for MoCGTM_cntrRouteSigErr" UBYTE OneToOne 1 100 0.00 255.0 FORMAT "%5.1" ECU_ADDRESS 0x6002C135
 /begin IF_DATA XCPplus 0x0102
  /begin DAQ_EVENT VARIABLE /end DAQ_EVENT
 /end IF_DATA
/end MEASUREMENT
/begin MEASUREMENT MoCGTM_currChksVal "Value of calculated checksum of current MCS module" ULONG OneToOne 1 100 0.00 4294967295.00 FORMAT "%13.2" ECU_ADDRESS 0x6002CB08 /end MEASUREMENT
/begin MEASUREMENT MoCGTM_currChksValCpl "Complement of value of calculated checksum of current MCS module" ULONG OneToOne 1 100 0.00 4294967295.00 FORMAT "%13.2" ECU_ADDRESS 0x6002C120 /end MEASUREMENT
/begin MEASUREMENT MoCGTM_currMCSModlAryIdx "Array index for MCS modules used during MCS ROM memory check" UBYTE OneToOne 1 100 0.00 255.0 FORMAT "%5.1" ECU_ADDRESS 0x6002CB35 /end MEASUREMENT
/begin MEASUREMENT MoCGTM_flgCmpErr "compare error bit status" UBYTE B_TRUE 1 100 0.00 1.00000000000 BIT_MASK 0x1 FORMAT "%13.11" ECU_ADDRESS 0x6002CB2C /end MEASUREMENT
/begin MEASUREMENT MoCGTM_McsData_ptr1Cpl "Complement for MCS data pointer1" ULONG OneToOne 1 100 0.00 4294967295.00 FORMAT "%13.2" ECU_ADDRESS 0x6002C11C
 /begin IF_DATA XCPplus 0x0102
  /begin DAQ_EVENT VARIABLE /end DAQ_EVENT
 /end IF_DATA
/end MEASUREMENT
/begin MEASUREMENT MoCGTM_McsData_ptr2Cpl "Complement for MCS data pointer2" ULONG OneToOne 1 100 0.00 4294967295.00 FORMAT "%13.2" ECU_ADDRESS 0x6002C118
 /begin IF_DATA XCPplus 0x0102
  /begin DAQ_EVENT VARIABLE /end DAQ_EVENT
 /end IF_DATA
/end MEASUREMENT
/begin MEASUREMENT MoCGTM_McsData_ptr3Cpl "Complement for MCS data pointer3" ULONG OneToOne 1 100 0.00 4294967295.00 FORMAT "%13.2" ECU_ADDRESS 0x6002C114
 /begin IF_DATA XCPplus 0x0102
  /begin DAQ_EVENT VARIABLE /end DAQ_EVENT
 /end IF_DATA
/end MEASUREMENT
/begin MEASUREMENT MoCGTM_numMCS1Ch "MCS channel number selected for MCS1" UBYTE OneToOne 1 100 0.00 255.0 FORMAT "%5.1" ECU_ADDRESS 0x6002CB34 /end MEASUREMENT
/begin MEASUREMENT MoCGTM_numMCS1Modl "MCS module number selected for MCS1" UBYTE OneToOne 1 100 0.00 255.0 FORMAT "%5.1" ECU_ADDRESS 0x6002CB33 /end MEASUREMENT
/begin MEASUREMENT MoCGTM_numMCS2Ch "MCS channel number selected for MCS2" UBYTE OneToOne 1 100 0.00 255.0 FORMAT "%5.1" ECU_ADDRESS 0x6002CB32 /end MEASUREMENT
/begin MEASUREMENT MoCGTM_numMCS2Modl "MCS module number selected for MCS2" UBYTE OneToOne 1 100 0.00 255.0 FORMAT "%5.1" ECU_ADDRESS 0x6002CB31 /end MEASUREMENT
/begin MEASUREMENT MoCGTM_numMCS3Ch "MCS channel number selected for MCS3" UBYTE OneToOne 1 100 0.00 255.0 FORMAT "%5.1" ECU_ADDRESS 0x6002CB30 /end MEASUREMENT
/begin MEASUREMENT MoCGTM_numMCS3Modl "MCS module number selected for MCS3" UBYTE OneToOne 1 100 0.00 255.0 FORMAT "%5.1" ECU_ADDRESS 0x6002CB2F /end MEASUREMENT
/begin MEASUREMENT MoCGTM_PtlResp "Partial respose of MoCGTM_Co" ULONG OneToOne 1 100 0.00 4294967295.00 FORMAT "%13.2" ECU_ADDRESS 0x6002C104
 /begin IF_DATA XCPplus 0x0102
  /begin DAQ_EVENT VARIABLE /end DAQ_EVENT
 /end IF_DATA
/end MEASUREMENT
/begin MEASUREMENT MoCGTM_PtlRespCpl "Complement variable for MoCGTM_PtlResp" ULONG OneToOne 1 100 0.00 4294967295.00 FORMAT "%13.2" ECU_ADDRESS 0x6002C110
 /begin IF_DATA XCPplus 0x0102
  /begin DAQ_EVENT VARIABLE /end DAQ_EVENT
 /end IF_DATA
/end MEASUREMENT
/begin MEASUREMENT MoCGTM_stBadcaseTrig "Indicates creation of badcase in MCS2" ULONG OneToOne 1 100 0.00 4294967295.00 FORMAT "%13.2" ECU_ADDRESS 0x6002CB04
 /begin IF_DATA XCPplus 0x0102
  /begin DAQ_EVENT VARIABLE /end DAQ_EVENT
 /end IF_DATA
/end MEASUREMENT
/begin MEASUREMENT MoCGTM_stErr "Indicates failure in BSW function call" UBYTE OneToOne 1 100 0.00 255.0 FORMAT "%5.1" ECU_ADDRESS 0x6002CB2E
 /begin IF_DATA XCPplus 0x0102
  /begin DAQ_EVENT VARIABLE /end DAQ_EVENT
 /end IF_DATA
/end MEASUREMENT
/begin MEASUREMENT MoCGTM_stErrChks "Status of checksum error in MCS ROM check" UBYTE OneToOne 1 100 0.00 255.0 FORMAT "%5.1" ECU_ADDRESS 0x6002CB2D /end MEASUREMENT
/begin MEASUREMENT MoCGTM_stErrCpl "Complement variable for MoCGTM_stErr" UBYTE OneToOne 1 100 0.00 255.0 FORMAT "%5.1" ECU_ADDRESS 0x6002C134
 /begin IF_DATA XCPplus 0x0102
  /begin DAQ_EVENT VARIABLE /end DAQ_EVENT
 /end IF_DATA
/end MEASUREMENT
/begin MEASUREMENT MoCGTM_tiCurrMCSVal "Timestamp at which TIM read to be performed after MCS trigger from safety core" ULONG OneToOne 1 100 0.00 4294967295.00 FORMAT "%13.2" ECU_ADDRESS 0x6002CB00
 /begin IF_DATA XCPplus 0x0102
  /begin DAQ_EVENT VARIABLE /end DAQ_EVENT
 /end IF_DATA
/end MEASUREMENT
/begin MEASUREMENT MoCGTM_tiCurrTskcall "Time stamp current task call" ULONG OneToOne 1 100 0.00 4294967295.00 FORMAT "%13.2" ECU_ADDRESS 0x6002C10C
 /begin IF_DATA XCPplus 0x0102
  /begin DAQ_EVENT VARIABLE /end DAQ_EVENT
 /end IF_DATA
/end MEASUREMENT
/begin MEASUREMENT MoCGTM_tiEClkPerd "Period in terms of CMU_CLK1 ticks of the ECLK signal recieved in TIM channel" ULONG OneToOne 1 100 0.00 4294967295.00 FORMAT "%13.2" ECU_ADDRESS 0x6002CAFC
 /begin IF_DATA XCPplus 0x0102
  /begin DAQ_EVENT VARIABLE /end DAQ_EVENT
 /end IF_DATA
/end MEASUREMENT
/begin MEASUREMENT MoCGTM_tiEClkTOn "Duty cycle in terms of CMU_CLK1 ticks of the ECLK signal recieved in TIM channel" ULONG OneToOne 1 100 0.00 4294967295.00 FORMAT "%13.2" ECU_ADDRESS 0x6002CAF8
 /begin IF_DATA XCPplus 0x0102
  /begin DAQ_EVENT VARIABLE /end DAQ_EVENT
 /end IF_DATA
/end MEASUREMENT
/begin MEASUREMENT MoCGTM_tiExeMCS1_MP "Measurement of time taken for complete execution of MCS1 in ticks" ULONG RBPtCel_ti_0p4_1 1 100 0.00 1717986918.00 FORMAT "%13.2" ECU_ADDRESS 0x70006864 /end MEASUREMENT
/begin MEASUREMENT MoCGTM_tiExeMCS2_MP "Measurement of time taken for complete execution of MCS2 in ticks" ULONG RBPtCel_ti_0p4_1 1 100 0.00 1717986918.00 FORMAT "%13.2" ECU_ADDRESS 0x70006860 /end MEASUREMENT
/begin MEASUREMENT MoCGTM_tiExeMCS3_MP "Measurement of time taken for complete execution of MCS3 in ticks" ULONG RBPtCel_ti_0p4_1 1 100 0.00 1717986918.00 FORMAT "%13.2" ECU_ADDRESS 0x7000685C /end MEASUREMENT
/begin MEASUREMENT MoCGTM_tiFallEdgeBadcase_MP "Measurement point for Falling edge time stamp in MCS2 during badcase" ULONG OneToOne 1 100 0.00 4294967295.00 FORMAT "%13.2" ECU_ADDRESS 0x70006858 /end MEASUREMENT
/begin MEASUREMENT MoCGTM_tiFallEdgeMCS1_MP "Measurement point for Falling edge time stamp in MCS1" ULONG OneToOne 1 100 0.00 4294967295.00 FORMAT "%13.2" ECU_ADDRESS 0x70006854 /end MEASUREMENT
/begin MEASUREMENT MoCGTM_tiFallEdgeMCS2_MP "Measurement point for Falling edge time stamp in MCS2" ULONG OneToOne 1 100 0.00 4294967295.00 FORMAT "%13.2" ECU_ADDRESS 0x70006850 /end MEASUREMENT
/begin MEASUREMENT MoCGTM_tiMCSTIMRead "Current rising edge time stamp received from TIM before the control trigger from safety core is passed" ULONG OneToOne 1 100 0.00 4294967295.00 FORMAT "%13.2" ECU_ADDRESS 0x6002CAF4
 /begin IF_DATA XCPplus 0x0102
  /begin DAQ_EVENT VARIABLE /end DAQ_EVENT
 /end IF_DATA
/end MEASUREMENT
/begin MEASUREMENT MoCGTM_tiPrevMCS1Trig_MP "Measurement point for Timestamp of previous trigger for MCS1 execution from safety core" ULONG OneToOne 1 100 0.00 4294967295.00 FORMAT "%13.2" ECU_ADDRESS 0x7000684C /end MEASUREMENT
/begin MEASUREMENT MoCGTM_tiPrevMCS2Trig_MP "Measurement point for Timestamp of previous trigger for MCS2 execution from safety core" ULONG OneToOne 1 100 0.00 4294967295.00 FORMAT "%13.2" ECU_ADDRESS 0x70006848 /end MEASUREMENT
/begin MEASUREMENT MoCGTM_tiPrevMCS3Trig_MP "Measurement point for Timestamp of previous trigger for MCS3 execution from safety core" ULONG OneToOne 1 100 0.00 4294967295.00 FORMAT "%13.2" ECU_ADDRESS 0x70006844 /end MEASUREMENT
/begin MEASUREMENT MoCGTM_tiPrevTskcall "Time stamp previous task call" ULONG OneToOne 1 100 0.00 4294967295.00 FORMAT "%13.2" ECU_ADDRESS 0x6002C108
 /begin IF_DATA XCPplus 0x0102
  /begin DAQ_EVENT VARIABLE /end DAQ_EVENT
 /end IF_DATA
/end MEASUREMENT
/begin MEASUREMENT MoCGTM_tiRisngEdgeMCS1_MP "Measurement point for Rising edge time stamp in MCS1" ULONG OneToOne 1 100 0.00 4294967295.00 FORMAT "%13.2" ECU_ADDRESS 0x70006840 /end MEASUREMENT
/begin MEASUREMENT MoCGTM_tiRisngEdgeMCS2_MP "Measurement point for Rising edge time stamp in MCS2" ULONG OneToOne 1 100 0.00 4294967295.00 FORMAT "%13.2" ECU_ADDRESS 0x7000683C /end MEASUREMENT
/begin MEASUREMENT MoCGTM_tiTskCalldst_MP "Measurepoint time between two task calls" ULONG OneToOne 1 100 0.00 4294967295.00 FORMAT "%13.2" ECU_ADDRESS 0x70006838 /end MEASUREMENT
/begin MEASUREMENT MoCHwLogicTest_flgAlvTestChk "Standby SMU alivetest check error" UBYTE B_TRUE 1 100 0.00 1.00000000000 BIT_MASK 0x8 FORMAT "%13.11" ECU_ADDRESS 0x6002B8A0 /end MEASUREMENT
/begin MEASUREMENT MoCHwLogicTest_flgFwChk "Firmware check error" UBYTE B_TRUE 1 100 0.00 1.00000000000 BIT_MASK 0x1 FORMAT "%13.11" ECU_ADDRESS 0x6002B8A0 /end MEASUREMENT
/begin MEASUREMENT MoCHwLogicTest_flgMONBISTChk "MONBIST error" UBYTE B_TRUE 1 100 0.00 1.00000000000 BIT_MASK 0x2 FORMAT "%13.11" ECU_ADDRESS 0x6002B8A0 /end MEASUREMENT
/begin MEASUREMENT MoCHwLogicTest_flgSFFDChk "Safety flip-flop test error" UBYTE B_TRUE 1 100 0.00 1.00000000000 BIT_MASK 0x4 FORMAT "%13.11" ECU_ADDRESS 0x6002B8A0 /end MEASUREMENT
/begin MEASUREMENT MoCHwLogicTest_flgTempChk "Temperature latent fault check error" UBYTE B_TRUE 1 100 0.00 1.00000000000 BIT_MASK 0x10 FORMAT "%13.11" ECU_ADDRESS 0x6002B8A0 /end MEASUREMENT
/begin MEASUREMENT MoCHwLogicTest_flgUCBErrChk "Safety critical register evaluation check error" UBYTE B_TRUE 1 100 0.00 1.00000000000 BIT_MASK 0x20 FORMAT "%13.11" ECU_ADDRESS 0x6002B8A0 /end MEASUREMENT
/begin MEASUREMENT MoCHwLogicTest_PtlResp "Partial response from HW Logic Test module" ULONG OneToOne 1 100 0.00 4294967295.00 FORMAT "%13.2" ECU_ADDRESS 0x6002B89C /end MEASUREMENT
/begin MEASUREMENT MoCHwLogicTest_stErr "Status word to report hardware logic test error" UBYTE OneToOne 1 100 0.00 255.0 FORMAT "%5.1" ECU_ADDRESS 0x6002B8A0 /end MEASUREMENT
/begin MEASUREMENT MoCIWDH_bbLoc1 "Bit bases for storing status of concatenated value read from ring buffer" UBYTE OneToOne 1 100 0.00 255.0 FORMAT "%5.1" ECU_ADDRESS 0x6002CAF2
 /begin IF_DATA XCPplus 0x0102
  /begin DAQ_EVENT VARIABLE /end DAQ_EVENT
 /end IF_DATA
/end MEASUREMENT
/begin MEASUREMENT MoCIWDH_bbLoc1Cpl "complement variable for MoCIWDH_bbLoc1" UBYTE OneToOne 1 100 0.00 255.0 FORMAT "%5.1" ECU_ADDRESS 0x6002C100
 /begin IF_DATA XCPplus 0x0102
  /begin DAQ_EVENT VARIABLE /end DAQ_EVENT
 /end IF_DATA
/end MEASUREMENT
/begin MEASUREMENT MoCIWDH_cntChksAry "Array to hold the Number of entries made into each ring buffer by each task-core combination" UBYTE OneToOne 1 100 0.00 255.0 FORMAT "%5.1" MATRIX_DIM 1 ECU_ADDRESS 0x6002CAF1
 /begin IF_DATA XCPplus 0x0102
  /begin DAQ_EVENT VARIABLE /end DAQ_EVENT
 /end IF_DATA
/end MEASUREMENT
/begin MEASUREMENT MoCIWDH_cntrRollgAry "Array to hold the internal watchdog handler rolling counter value" ULONG OneToOne 1 100 0.00 4294967295.00 FORMAT "%13.2" MATRIX_DIM 1 ECU_ADDRESS 0x6002CAEC
 /begin IF_DATA XCPplus 0x0102
  /begin DAQ_EVENT VARIABLE /end DAQ_EVENT
 /end IF_DATA
/end MEASUREMENT
/begin MEASUREMENT MoCIWDH_cntrRollgAryCpl "Double storage for Array to hold the internal watchdog handler rolling counter value" ULONG OneToOne 1 100 0.00 4294967295.00 FORMAT "%13.2" MATRIX_DIM 1 ECU_ADDRESS 0x6002C0FC
 /begin IF_DATA XCPplus 0x0102
  /begin DAQ_EVENT VARIABLE /end DAQ_EVENT
 /end IF_DATA
/end MEASUREMENT
/begin MEASUREMENT MoCIWDH_flgConcatValErr "status of concatenated value read from ring buffer" UBYTE B_TRUE 1 100 0.00 1.00000000000 BIT_MASK 0x1 FORMAT "%13.11" ECU_ADDRESS 0x6002CAF2 /end MEASUREMENT
/begin MEASUREMENT MoCIWDH_numChksAry "Extracted checksum from the concatenated value read from each task-core combination ring buffer" ULONG OneToOne 1 100 0.00 4294967295.00 FORMAT "%13.2" MATRIX_DIM 1 ECU_ADDRESS 0x6002CAE8
 /begin IF_DATA XCPplus 0x0102
  /begin DAQ_EVENT VARIABLE /end DAQ_EVENT
 /end IF_DATA
/end MEASUREMENT
/begin MEASUREMENT MoCIWDH_numConcatValAry "Concatenated value of PFC checksum and rolling counter of each task-core combination" ULONG OneToOne 1 100 0.00 4294967295.00 FORMAT "%13.2" MATRIX_DIM 1 ECU_ADDRESS 0x6002CAE4
 /begin IF_DATA XCPplus 0x0102
  /begin DAQ_EVENT VARIABLE /end DAQ_EVENT
 /end IF_DATA
/end MEASUREMENT
/begin MEASUREMENT MoCIWDH_PtlResp "Partial response of MoCIWDH_Co" ULONG OneToOne 1 100 0.00 4294967295.00 FORMAT "%13.2" ECU_ADDRESS 0x6002C0F4
 /begin IF_DATA XCPplus 0x0102
  /begin DAQ_EVENT VARIABLE /end DAQ_EVENT
 /end IF_DATA
/end MEASUREMENT
/begin MEASUREMENT MoCIWDH_PtlRespCpl "Double storage for Partial response of MoCIWDH_Co" ULONG OneToOne 1 100 0.00 4294967295.00 FORMAT "%13.2" ECU_ADDRESS 0x6002C0F8
 /begin IF_DATA XCPplus 0x0102
  /begin DAQ_EVENT VARIABLE /end DAQ_EVENT
 /end IF_DATA
/end MEASUREMENT
/begin MEASUREMENT MoCIWDH_stErrAry "Status word to report internal watchdog handler errors for each task-core combination" UBYTE OneToOne 1 100 0.00 255.0 FORMAT "%5.1" MATRIX_DIM 1 ECU_ADDRESS 0x6002CAF0
 /begin IF_DATA XCPplus 0x0102
  /begin DAQ_EVENT VARIABLE /end DAQ_EVENT
 /end IF_DATA
/end MEASUREMENT
/begin MEASUREMENT MoCMemStrtUp_adrEccErr "Backup of the memory address of the last occured uncorrectable ECC errors" ULONG OneToOne 1 100 0.00 4294967295.00 FORMAT "%13.2" ECU_ADDRESS 0x70039B94 /end MEASUREMENT
/begin MEASUREMENT MoCMemStrtUp_chkRamTest "Variable to corrupt Ram check in the next startup" UBYTE OneToOne 1 100 0.00 255.0 FORMAT "%5.1" ECU_ADDRESS 0x70039BA5 /end MEASUREMENT
/begin MEASUREMENT MoCMemStrtUp_chkRomTest "Variable to corrupt Rom check in the next startup" UBYTE OneToOne 1 100 0.00 255.0 FORMAT "%5.1" ECU_ADDRESS 0x70039BA4 /end MEASUREMENT
/begin MEASUREMENT MoCMemStrtUp_tiRamChk "Variable to store runtime of RAM test during startup" ULONG OneToOne 1 100 0.00 4294967295.00 FORMAT "%13.2" ECU_ADDRESS 0x70039BA0 /end MEASUREMENT
/begin MEASUREMENT MoCMemStrtUp_tiRomChk "Variable to store runtime of ROM test during startup" ULONG OneToOne 1 100 0.00 4294967295.00 FORMAT "%13.2" ECU_ADDRESS 0x70039B9C /end MEASUREMENT
/begin MEASUREMENT MoCMemStrtUp_toutWdg "Variable to store timeout of internal watchdog" ULONG OneToOne 1 100 0.00 4294967295.00 FORMAT "%13.2" ECU_ADDRESS 0x70039B98 /end MEASUREMENT
/begin MEASUREMENT MoCMem_adChkSumBlk "Addresses of checksum blocks configured for cyclic memory check" ULONG dez 1 100 0.00 4294967295.00 FORMAT "%13.2" MATRIX_DIM 2 ECU_ADDRESS 0x6002B890 /end MEASUREMENT
/begin MEASUREMENT MoCMem_adChkSumBlkCpl "Double storage for MoCMem_adChkSumBlk" ULONG dez 1 100 0.00 4294967295.00 FORMAT "%13.2" MATRIX_DIM 2 ECU_ADDRESS 0x6002C0E4 /end MEASUREMENT
/begin MEASUREMENT MoCMem_ctDebErrChkROM "error debounce counter for cyclical ROM-test" UBYTE OneToOne 1 100 0.00 255.0 FORMAT "%5.1" ECU_ADDRESS 0x6002CAE1
 /begin IF_DATA XCPplus 0x0102
  /begin DAQ_EVENT VARIABLE /end DAQ_EVENT
 /end IF_DATA
/end MEASUREMENT
/begin MEASUREMENT MoCMem_ctDebErrChkROMCpl "complement of the error debounce counter for cyclical ROM-test" UBYTE OneToOne 1 100 0.00 255.0 FORMAT "%5.1" ECU_ADDRESS 0x6002C0F0
 /begin IF_DATA XCPplus 0x0102
  /begin DAQ_EVENT VARIABLE /end DAQ_EVENT
 /end IF_DATA
/end MEASUREMENT
/begin MEASUREMENT MoCMem_ctDebHealChkROM "error healing counter for cyclical ROM-test" UWORD OneToOne 1 100 0.00 65535.00 FORMAT "%8.2" ECU_ADDRESS 0x6002CAC2 /end MEASUREMENT
/begin MEASUREMENT MoCMem_ctDebHealChkROMCpl "complement of the error healing counter for cyclical ROM-test" UWORD OneToOne 1 100 0.00 65535.00 FORMAT "%8.2" ECU_ADDRESS 0x6002C0CE /end MEASUREMENT
/begin MEASUREMENT MoCMem_ctLrnROM "Counter for the learn process of the ROM check" UBYTE OneToOne 1 100 0.00 255.0 FORMAT "%5.1" ECU_ADDRESS 0x6002CAE0 /end MEASUREMENT
/begin MEASUREMENT MoCMem_ctLrnROMCpl "Complement of the counter for the learn process of the ROM check" UBYTE OneToOne 1 100 0.00 255.0 FORMAT "%5.1" ECU_ADDRESS 0x6002C0EF /end MEASUREMENT
/begin MEASUREMENT MoCMem_idxCSAry "Array index to point to the desired checksum block" UBYTE OneToOne 1 100 0.00 255.0 FORMAT "%5.1" ECU_ADDRESS 0x6002CADF
 /begin IF_DATA XCPplus 0x0102
  /begin DAQ_EVENT VARIABLE /end DAQ_EVENT
 /end IF_DATA
/end MEASUREMENT
/begin MEASUREMENT MoCMem_idxCSAryCpl "Double storage for MoCMem_idxCSAry" UBYTE OneToOne 1 100 0.00 255.0 FORMAT "%5.1" ECU_ADDRESS 0x6002C0EE
 /begin IF_DATA XCPplus 0x0102
  /begin DAQ_EVENT VARIABLE /end DAQ_EVENT
 /end IF_DATA
/end MEASUREMENT
/begin MEASUREMENT MoCMem_nrRomChk "Number of 32-bit memory cells to be tested in cyclical ROM check" UWORD OneToOne 1 100 0.00 65535.00 FORMAT "%8.2" MATRIX_DIM 4 ECU_ADDRESS 0x6002CABA /end MEASUREMENT
/begin MEASUREMENT MoCMem_nrRomChkCpl "Double storage of the number of 32-bit memory cells to be tested in cyclical ROM check" UWORD OneToOne 1 100 0.00 65535.00 FORMAT "%8.2" MATRIX_DIM 4 ECU_ADDRESS 0x6002C0C6 /end MEASUREMENT
/begin MEASUREMENT MoCMem_nrRomChkSize "Memory size in Byte that is tested in the cyclic ROM check" ULONG OneToOne 1 100 0.00 4294967295.00 FORMAT "%13.2" ECU_ADDRESS 0x6002CAD8 /end MEASUREMENT
/begin MEASUREMENT MoCMem_numChkSumCurrent "current checksum for cyclical ROM-check" ULONG OneToOne 1 100 0.00 4294967295.00 FORMAT "%13.2" ECU_ADDRESS 0x6002CAD4
 /begin IF_DATA XCPplus 0x0102
  /begin DAQ_EVENT VARIABLE /end DAQ_EVENT
 /end IF_DATA
/end MEASUREMENT
/begin MEASUREMENT MoCMem_numChkSumCurrentCpl "RAM data redundancy for MoCMem_numChkSumCurrent" ULONG OneToOne 1 100 0.00 4294967295.00 FORMAT "%13.2" ECU_ADDRESS 0x6002C0E0
 /begin IF_DATA XCPplus 0x0102
  /begin DAQ_EVENT VARIABLE /end DAQ_EVENT
 /end IF_DATA
/end MEASUREMENT
/begin MEASUREMENT MoCMem_RomCurrentPtr "pointer with the address for the cyclic checked ROM area which should be checkt at the next cyclic call of the cyclic ROM check" ULONG default 1 100 0.00 4294967295.00 FORMAT "%13.2" ECU_ADDRESS 0x6002CAD0
 /begin IF_DATA XCPplus 0x0102
  /begin DAQ_EVENT VARIABLE /end DAQ_EVENT
 /end IF_DATA
/end MEASUREMENT
/begin MEASUREMENT MoCMem_RomCurrentPtrCpl "duplicate storage of MoCMem_RomCurrentPtrCpl" ULONG OneToOne 1 100 0.00 4294967295.00 FORMAT "%13.2" ECU_ADDRESS 0x6002C0DC
 /begin IF_DATA XCPplus 0x0102
  /begin DAQ_EVENT VARIABLE /end DAQ_EVENT
 /end IF_DATA
/end MEASUREMENT
/begin MEASUREMENT MoCMem_stDataCycChkBlk "DME support available for data set block" UBYTE OneToOne 1 100 0.00 255.0 FORMAT "%5.1" MATRIX_DIM 2 ECU_ADDRESS 0x6002CADD /end MEASUREMENT
/begin MEASUREMENT MoCMem_stDataCycChkBlkCpl "Double storage of DME support available for data set block" UBYTE OneToOne 1 100 0.00 255.0 FORMAT "%5.1" MATRIX_DIM 2 ECU_ADDRESS 0x6002C0EC /end MEASUREMENT
/begin MEASUREMENT MoCMem_stDisChk "State of the deactivation of the ROM cyclic test" UBYTE OneToOne 1 100 0.00 255.0 FORMAT "%5.1" ECU_ADDRESS 0x6002CADC /end MEASUREMENT
/begin MEASUREMENT MoCMem_tiROMAccus "Sum of the intervals between function calls during the learn process" ULONG OneToOne 1 100 0.00 4294967295.00 FORMAT "%13.2" ECU_ADDRESS 0x6002CACC /end MEASUREMENT
/begin MEASUREMENT MoCMem_tiROMAccusCpl "Complement of the sum of the intervals between function calls during the learn process" ULONG OneToOne 1 100 0.00 4294967295.00 FORMAT "%13.2" ECU_ADDRESS 0x6002C0D8 /end MEASUREMENT
/begin MEASUREMENT MoCMem_tiROMus "Timestamp of the current call" ULONG OneToOne 1 100 0.00 4294967295.00 FORMAT "%13.2" ECU_ADDRESS 0x6002CAC8 /end MEASUREMENT
/begin MEASUREMENT MoCMem_tiROMusCpl "Complement of the timestamp of the current call" ULONG OneToOne 1 100 0.00 4294967295.00 FORMAT "%13.2" ECU_ADDRESS 0x6002C0D4 /end MEASUREMENT
/begin MEASUREMENT MoCMem_tiROMusOld "Timestamp of the previous call" ULONG OneToOne 1 100 0.00 4294967295.00 FORMAT "%13.2" ECU_ADDRESS 0x6002CAC4 /end MEASUREMENT
/begin MEASUREMENT MoCMem_tiROMusOldCpl "Complement of the timestamp of the previous call" ULONG OneToOne 1 100 0.00 4294967295.00 FORMAT "%13.2" ECU_ADDRESS 0x6002C0D0 /end MEASUREMENT
/begin MEASUREMENT MoCPFC_Checksum "Inter result of checksum calculation in the program flow check" ULONG OneToOne 1 100 0.00 4294967295.00 FORMAT "%13.2" ECU_ADDRESS 0x6002C0BC
 /begin IF_DATA XCPplus 0x0102
  /begin DAQ_EVENT VARIABLE /end DAQ_EVENT
 /end IF_DATA
/end MEASUREMENT
/begin MEASUREMENT MoCPFC_Checkword "Modul specific signature for building the checksum of the PFC in function monitoring" ULONG OneToOne 1 100 0.00 4294967295.00 FORMAT "%13.2" ECU_ADDRESS 0x6002C0C0
 /begin IF_DATA XCPplus 0x0102
  /begin DAQ_EVENT VARIABLE /end DAQ_EVENT
 /end IF_DATA
/end MEASUREMENT
/begin MEASUREMENT MoCPFC_Counter "Module call counter for program flow check in monitoring" UBYTE OneToOne 1 100 0.00 255.0 FORMAT "%5.1" ECU_ADDRESS 0x6002C0C4
 /begin IF_DATA XCPplus 0x0102
  /begin DAQ_EVENT VARIABLE /end DAQ_EVENT
 /end IF_DATA
/end MEASUREMENT
/begin MEASUREMENT MoCPFC_PtlResp "Partial response from program flow check to monitoring module" ULONG OneToOne 1 100 0.00 4294967295.00 FORMAT "%13.2" ECU_ADDRESS 0x6002C0B8
 /begin IF_DATA XCPplus 0x0102
  /begin DAQ_EVENT VARIABLE /end DAQ_EVENT
 /end IF_DATA
/end MEASUREMENT
/begin MEASUREMENT MoCSCC_stLfastWrkarndActv_MP "State of deactivation of crossbar MPU check for activation of LFAST interface" UBYTE OneToOne 1 100 0.00 255.0 FORMAT "%5.1" ECU_ADDRESS 0x70006C01 /end MEASUREMENT
/begin MEASUREMENT MoCSCC_stMstInstFnd "State of found Master instance" ULONG dez 1 100 0.00 4294967295.00 FORMAT "%13.2" ECU_ADDRESS 0x60000728 /end MEASUREMENT
/begin FUNCTION Inm_Linsched "850.1.0   LIN State Machine" /begin DEF_CHARACTERISTIC Inm_ctWkUpPttTx_C Inm_swtLIN_C Inm_tiLINStBy_C /end DEF_CHARACTERISTIC /begin IN_MEASUREMENT Com_bLINComReq /end IN_MEASUREMENT
 /begin OUT_MEASUREMENT Com_stNwCmdLIN Inm_stLINStM Inm_stLINSubStM Inm_swtLIN LinSm_stComMode /end OUT_MEASUREMENT
 /begin LOC_MEASUREMENT Inm_bLinRunNetCmdReq Inm_bLinRunSched Inm_bLINWkUpSuc_mp Inm_bMnWkUp_mp Inm_flgSchedEndNetCmd Inm_stLINStMTrans_mp /end LOC_MEASUREMENT
 FUNCTION_VERSION "850.1.0" /end FUNCTION
/begin FUNCTION IntlckChrgPlgPosn_DELib_SimpleSwt "4.6.0"
 /begin DEF_CHARACTERISTIC DDRC_DurDeb.IntlckChrgPlgPosn_tiRngFltDebOk_C DDRC_DurDeb.IntlckChrgPlgPosn_tiRngFltDebDef_C DDRC_DurDeb.IntlckChrgPlgPosn_tiSrcMaxDebOk_C DDRC_DurDeb.IntlckChrgPlgPosn_tiSrcMaxDebDef_C DDRC_DurDeb.IntlckChrgPlgPosn_tiSrcMinDebOk_C DDRC_DurDeb.IntlckChrgPlgPosn_tiSrcMinDebDef_C DDRC_RatDeb.IntlckChrgPlgPosn_tiRngFltUDRat_C DDRC_RatDeb.IntlckChrgPlgPosn_tiSrcMaxUDRat_C DDRC_RatDeb.IntlckChrgPlgPosn_tiSrcMinUDRat_C DFC_CtlMsk2.DFC_IntlckChrgPlgPosnRngFlt_C DFC_CtlMsk2.DFC_IntlckChrgPlgPosnSrcMax_C DFC_CtlMsk2.DFC_IntlckChrgPlgPosnSrcMin_C DFC_DisblMsk2.DFC_IntlckChrgPlgPosnRngFlt_C DFC_DisblMsk2.DFC_IntlckChrgPlgPosnSrcMax_C DFC_DisblMsk2.DFC_IntlckChrgPlgPosnSrcMin_C IntlckChrgPlgPosn_stReplcmtVal_C IntlckChrgPlgPosn_SwtGASD_I.flgIvt_C IntlckChrgPlgPosn_SwtGASD_I.tiDebHiLo_C IntlckChrgPlgPosn_SwtGASD_I.tiDebLoHi_C IntlckChrgPlgPosn_SwtGASD_I.uAdcHysLe_C IntlckChrgPlgPosn_SwtGASD_I.uAdcHysRi_C IntlckChrgPlgPosn_SwtGASD_I.uSrcMax_C IntlckChrgPlgPosn_SwtGASD_I.uSrcMin_C /end DEF_CHARACTERISTIC
 /begin OUT_MEASUREMENT DDRC_St.DFC_IntlckChrgPlgPosnRngFlt DDRC_St.DFC_IntlckChrgPlgPosnSrcMax DDRC_St.DFC_IntlckChrgPlgPosnSrcMin DFC_st.DFC_IntlckChrgPlgPosnRngFlt DFC_st.DFC_IntlckChrgPlgPosnSrcMax DFC_st.DFC_IntlckChrgPlgPosnSrcMin DINH_nrActvInhReas.FId_IntlckChrgPlgPosnAdcInvld DINH_stFId.FId_IntlckChrgPlgPosnAdcInvld IntlckChrgPlgPosn_st IntlckChrgPlgPosn_stRaw IntlckChrgPlgPosn_st_Sq /end OUT_MEASUREMENT
 /begin LOC_MEASUREMENT IntlckChrgPlgPosn_SwtGASD_I.stHLR_I IntlckChrgPlgPosn_uRaw /end LOC_MEASUREMENT
 FUNCTION_VERSION "4.6.0" /end FUNCTION
/begin FUNCTION IntlckChrgPlg_DELib_ActrPwrStgDrvr "1.0.0"
 /begin DEF_CHARACTERISTIC IntlckChrgPlg_ActrPwrStgDrvr_Cal.swtConf_C IntlckChrgPlg_ActrPwrStgDrvr_Cal.stMOCSOPChk_C IntlckChrgPlg_ActrPwrStgDrvr_Cal.swtPSDis_C IntlckChrgPlg_tiPwmPer_C IntlckChrgPlg_tiPwmPer_MAP /end DEF_CHARACTERISTIC
 /begin IN_MEASUREMENT DevLib_stPwrStgEnaCond Epm_nEng IntlckChrgPlg_rPs IntlckChrgPlg_stElecDiag IntlckChrgPlg_stElecDiagExtCtrld IntlckChrgPlg_stPs IntlckChrgPlg_tiPeriod VehV_v /end IN_MEASUREMENT
 /begin OUT_MEASUREMENT IntlckChrgPlg_flgActrSwtOffReq IntlckChrgPlg_flgElecDiagSwtOffReq IntlckChrgPlg_flgPwrStgReq IntlckChrgPlg_stMonActrPwrStgDrvr IntlckChrgPlg_stPwrStgDrvr IntlckChrgPlg_swtConfActrPwrStgDrvr /end OUT_MEASUREMENT
 /begin LOC_MEASUREMENT IntlckChrgPlg_numSigID IntlckChrgPlg_SigTyp IntlckChrgPlg_stMonGlbElecdd /end LOC_MEASUREMENT
 FUNCTION_VERSION "1.0.0" /end FUNCTION
/begin FUNCTION IntlckChrgPlg_DELib_DevDrvrOutpDutyCycRamp "1.0.0" FUNCTION_VERSION "1.0.0" /end FUNCTION
/begin FUNCTION IntlckChrgPlg_DELib_StdActrAvs "2.0.0" /begin IN_MEASUREMENT IntlckChrgPlg_swtConfC /end IN_MEASUREMENT FUNCTION_VERSION "2.0.0" /end FUNCTION
/begin FUNCTION IntlckChrgPlg_DELib_StdActrCoorr "8.1.0"
 /begin DEF_CHARACTERISTIC IntlckChrgPlg_StdCal.tiDesValFlt_C IntlckChrgPlg_StdCal.rPsOff_C IntlckChrgPlg_StdCal.rActrStop_C IntlckChrgPlg_StdCal.rHysHigh_C IntlckChrgPlg_StdCal.rHysLow_C IntlckChrgPlg_StdCal.stPwrStgDiaDis_C IntlckChrgPlg_StdCal.stPlausDiaDis_C IntlckChrgPlg_StdCal.stPwrStgDis_C IntlckChrgPlg_StdCal.stActrStop_C IntlckChrgPlg_StdCal.stAllPwrStgDiaEna_C IntlckChrgPlg_StdCal.swtDesVal_C IntlckChrgPlg_StdCal.numDiagTry_C IntlckChrgPlg_StdCal.rDesValOff_C IntlckChrgPlg_StdCal.rDesValOn_C IntlckChrgPlg_StdCal.numEngDaFrqPs_C IntlckChrgPlg_StdCal.tiSlwRespSimPT1_C IntlckChrgPlg_StdCal.uHiBattThd_C IntlckChrgPlg_StdCal.uLoBattThd_C IntlckChrgPlg_StdCal.tiDebBattVoltOk_C IntlckChrgPlg_StdCal.tiDebBattVoltDfct_C IntlckChrgPlg_StdCal.mskActrActv_C IntlckChrgPlg_StdCal.tiDlyActrActvn_C IntlckChrgPlg_StdCal.rPsActrOff_C IntlckChrgPlg_StdCal.uBattMin_C IntlckChrgPlg_StdCal.uBattMax_C IntlckChrgPlg_StdCal.tiShOffCtrlDne_C IntlckChrgPlg_StdCal.swtDeactvn_C IntlckChrgPlg_StdCal.tiSelfDiagStrt_C IntlckChrgPlg_StdCal.flgReacvnPostDrv_C IntlckChrgPlg_StdCal.rPsRlyOff_C IntlckChrgPlg_StdCal.tiRlyOnDly_C IntlckChrgPlg_StdCal.nFMInWinMsk_C IntlckChrgPlg_StdCal.tiFMInDeb_C IntlckChrgPlg_StdCal.tiJamActrWait_C /end DEF_CHARACTERISTIC
 /begin IN_MEASUREMENT BattU_u CoEng_st CoEng_stOld DELib_idxArrSnsr DELib_xArrSnsr Epm_nEng Epm_stSpd IntlckChrgPlg_rPs IntlckChrgPlg_stMon IntlckChrgPlg_swtConf2C IntlckChrgPlg_swtConfC IntlckChrgPlg_swtConfStdActrSwVersC SyC_stSub /end IN_MEASUREMENT
 FUNCTION_VERSION "8.1.0" /end FUNCTION
/begin FUNCTION IntlckChrgPlg_DELib_StdActrDd "8.2.0"
 /begin DEF_CHARACTERISTIC IntlckChrgPlg_HalfBrdgCal.tiBtwOpnLd_C IntlckChrgPlg_HalfBrdgCal.tiPwmPerHbrNotTstd_C IntlckChrgPlg_rCnv_MAP IntlckChrgPlg_swtBattCorSqd_C /end DEF_CHARACTERISTIC
 /begin REF_CHARACTERISTIC IntlckChrgPlg_PwmOutCal.rMin_C IntlckChrgPlg_PwmOutCal.rMax_C IntlckChrgPlg_PwmOutCal.swtBattCor_C IntlckChrgPlg_StdCal.tiDesValFlt_C IntlckChrgPlg_StdCal.rPsOff_C IntlckChrgPlg_StdCal.rActrStop_C IntlckChrgPlg_StdCal.rHysHigh_C IntlckChrgPlg_StdCal.rHysLow_C IntlckChrgPlg_StdCal.stPwrStgDiaDis_C IntlckChrgPlg_StdCal.stPlausDiaDis_C IntlckChrgPlg_StdCal.stPwrStgDis_C IntlckChrgPlg_StdCal.stActrStop_C IntlckChrgPlg_StdCal.stAllPwrStgDiaEna_C IntlckChrgPlg_StdCal.swtDesVal_C IntlckChrgPlg_StdCal.numDiagTry_C IntlckChrgPlg_StdCal.rDesValOff_C IntlckChrgPlg_StdCal.rDesValOn_C IntlckChrgPlg_StdCal.numEngDaFrqPs_C IntlckChrgPlg_StdCal.tiSlwRespSimPT1_C IntlckChrgPlg_StdCal.uHiBattThd_C IntlckChrgPlg_StdCal.uLoBattThd_C IntlckChrgPlg_StdCal.tiDebBattVoltOk_C IntlckChrgPlg_StdCal.tiDebBattVoltDfct_C IntlckChrgPlg_StdCal.mskActrActv_C IntlckChrgPlg_StdCal.tiDlyActrActvn_C IntlckChrgPlg_StdCal.rPsActrOff_C IntlckChrgPlg_StdCal.uBattMin_C IntlckChrgPlg_StdCal.uBattMax_C IntlckChrgPlg_StdCal.tiShOffCtrlDne_C IntlckChrgPlg_StdCal.swtDeactvn_C IntlckChrgPlg_StdCal.tiSelfDiagStrt_C IntlckChrgPlg_StdCal.flgReacvnPostDrv_C IntlckChrgPlg_StdCal.rPsRlyOff_C IntlckChrgPlg_StdCal.tiRlyOnDly_C IntlckChrgPlg_StdCal.nFMInWinMsk_C IntlckChrgPlg_StdCal.tiFMInDeb_C IntlckChrgPlg_StdCal.tiJamActrWait_C /end REF_CHARACTERISTIC
 /begin IN_MEASUREMENT BattU_facCor DELib_idxArrSnsr DELib_xArrSnsr DevLib_stPwrStgEnaCond EnvP_p IntlckChrgPlg_flgPwrStgReq IntlckChrgPlg_stMon IntlckChrgPlg_swtConf2C IntlckChrgPlg_swtConfC IntlckChrgPlg_swtConfStdActrSwVersC /end IN_MEASUREMENT
 /begin OUT_MEASUREMENT DINH_nrActvInhReas.FId_IntlckChrgPlgActrOff DINH_nrActvInhReas.FId_IntlckChrgPlgHbrdgNotTstd DINH_stFId.FId_IntlckChrgPlgActrOff DINH_stFId.FId_IntlckChrgPlgHbrdgNotTstd IntlckChrgPlg_flgActrReq IntlckChrgPlg_rActr IntlckChrgPlg_rMax IntlckChrgPlg_rMin IntlckChrgPlg_rPs IntlckChrgPlg_stMonDD IntlckChrgPlg_stPs IntlckChrgPlg_tiPeriod /end OUT_MEASUREMENT
 FUNCTION_VERSION "8.2.0" /end FUNCTION
/begin FUNCTION IntlckChrgPlg_DELib_StdActrDesValCntr "3.0.0" FUNCTION_VERSION "3.0.0" /end FUNCTION
/begin FUNCTION IntlckChrgPlg_DELib_StdActrInin "9.5.0"
 /begin DEF_CHARACTERISTIC IntlckChrgPlg_swtConf2_C IntlckChrgPlg_swtConfStdActrSwVers162_C IntlckChrgPlg_swtConf_C /end DEF_CHARACTERISTIC
 /begin OUT_MEASUREMENT IntlckChrgPlg_swtConf2C IntlckChrgPlg_swtConfC IntlckChrgPlg_swtConfStdActrSwVersC /end OUT_MEASUREMENT
 FUNCTION_VERSION "9.5.0" /end FUNCTION
/begin FUNCTION IntlckChrgPlg_DELib_StdActrSnsrDd "6.4.0" /begin DEF_CHARACTERISTIC IntlckChrgPlg_ratActLin_CUR /end DEF_CHARACTERISTIC
 /begin REF_CHARACTERISTIC IntlckChrgPlg_StdCal.tiDesValFlt_C IntlckChrgPlg_StdCal.rPsOff_C IntlckChrgPlg_StdCal.rActrStop_C IntlckChrgPlg_StdCal.rHysHigh_C IntlckChrgPlg_StdCal.rHysLow_C IntlckChrgPlg_StdCal.stPwrStgDiaDis_C IntlckChrgPlg_StdCal.stPlausDiaDis_C IntlckChrgPlg_StdCal.stPwrStgDis_C IntlckChrgPlg_StdCal.stActrStop_C IntlckChrgPlg_StdCal.stAllPwrStgDiaEna_C IntlckChrgPlg_StdCal.swtDesVal_C IntlckChrgPlg_StdCal.numDiagTry_C IntlckChrgPlg_StdCal.rDesValOff_C IntlckChrgPlg_StdCal.rDesValOn_C IntlckChrgPlg_StdCal.numEngDaFrqPs_C IntlckChrgPlg_StdCal.tiSlwRespSimPT1_C IntlckChrgPlg_StdCal.uHiBattThd_C IntlckChrgPlg_StdCal.uLoBattThd_C IntlckChrgPlg_StdCal.tiDebBattVoltOk_C IntlckChrgPlg_StdCal.tiDebBattVoltDfct_C IntlckChrgPlg_StdCal.mskActrActv_C IntlckChrgPlg_StdCal.tiDlyActrActvn_C IntlckChrgPlg_StdCal.rPsActrOff_C IntlckChrgPlg_StdCal.uBattMin_C IntlckChrgPlg_StdCal.uBattMax_C IntlckChrgPlg_StdCal.tiShOffCtrlDne_C IntlckChrgPlg_StdCal.swtDeactvn_C IntlckChrgPlg_StdCal.tiSelfDiagStrt_C IntlckChrgPlg_StdCal.flgReacvnPostDrv_C IntlckChrgPlg_StdCal.rPsRlyOff_C IntlckChrgPlg_StdCal.tiRlyOnDly_C IntlckChrgPlg_StdCal.nFMInWinMsk_C IntlckChrgPlg_StdCal.tiFMInDeb_C IntlckChrgPlg_StdCal.tiJamActrWait_C IntlckChrgPlg_swtConf2_C IntlckChrgPlg_swtConf_C /end REF_CHARACTERISTIC
 /begin IN_MEASUREMENT IntlckChrgPlg_stMon IntlckChrgPlg_swtConf2C IntlckChrgPlg_swtConfC IntlckChrgPlg_swtConfStdActrSwVersC /end IN_MEASUREMENT
 /begin OUT_MEASUREMENT IntlckChrgPlg_rAct IntlckChrgPlg_rAct_Sq IntlckChrgPlg_ratActPosnB1 IntlckChrgPlg_stMonDDSens /end OUT_MEASUREMENT
 FUNCTION_VERSION "6.4.0" /end FUNCTION
/begin FUNCTION IntlckChrgPlg_DELib_StdActrVd "5.0.0" FUNCTION_VERSION "5.0.0" /end FUNCTION
/begin FUNCTION IntlckChrgPlg_DELib_StdActrVdMon "9.3.0"
 /begin DEF_CHARACTERISTIC DDRC_DurDeb.IntlckChrgPlg_tiHBrgOpnLdDebOk_C DDRC_DurDeb.IntlckChrgPlg_tiHBrgOpnLdDebDef_C DDRC_DurDeb.IntlckChrgPlg_tiHBrgOvrCurrDebOk_C DDRC_DurDeb.IntlckChrgPlg_tiHBrgOvrCurrDebDef_C DDRC_DurDeb.IntlckChrgPlg_tiHBrgOvrTempDebOk_C DDRC_DurDeb.IntlckChrgPlg_tiHBrgOvrTempDebDef_C DDRC_DurDeb.IntlckChrgPlg_tiHBrgShCirBatt1DebOk_C DDRC_DurDeb.IntlckChrgPlg_tiHBrgShCirBatt1DebDef_C DDRC_DurDeb.IntlckChrgPlg_tiHBrgShCirBatt2DebOk_C DDRC_DurDeb.IntlckChrgPlg_tiHBrgShCirBatt2DebDef_C DDRC_DurDeb.IntlckChrgPlg_tiHBrgShCirGnd1DebOk_C DDRC_DurDeb.IntlckChrgPlg_tiHBrgShCirGnd1DebDef_C DDRC_DurDeb.IntlckChrgPlg_tiHBrgShCirGnd2DebOk_C DDRC_DurDeb.IntlckChrgPlg_tiHBrgShCirGnd2DebDef_C DDRC_DurDeb.IntlckChrgPlg_tiHBrgShCirOvrLdDebOk_C DDRC_DurDeb.IntlckChrgPlg_tiHBrgShCirOvrLdDebDef_C DDRC_DurDeb.IntlckChrgPlg_tiHBrgTempOvrCurrDebOk_C DDRC_DurDeb.IntlckChrgPlg_tiHBrgTempOvrCurrDebDef_C DDRC_DurDeb.IntlckChrgPlg_tiHBrgUndrVltgDebOk_C DDRC_DurDeb.IntlckChrgPlg_tiHBrgUndrVltgDebDef_C DDRC_RatDeb.IntlckChrgPlg_tiHBrgOpnLdUDRat_C DDRC_RatDeb.IntlckChrgPlg_tiHBrgOvrCurrUDRat_C DDRC_RatDeb.IntlckChrgPlg_tiHBrgOvrTempUDRat_C DDRC_RatDeb.IntlckChrgPlg_tiHBrgShCirBatt1UDRat_C DDRC_RatDeb.IntlckChrgPlg_tiHBrgShCirBatt2UDRat_C DDRC_RatDeb.IntlckChrgPlg_tiHBrgShCirGnd1UDRat_C DDRC_RatDeb.IntlckChrgPlg_tiHBrgShCirGnd2UDRat_C DDRC_RatDeb.IntlckChrgPlg_tiHBrgShCirOvrLdUDRat_C DDRC_RatDeb.IntlckChrgPlg_tiHBrgTempOvrCurrUDRat_C DDRC_RatDeb.IntlckChrgPlg_tiHBrgUndrVltgUDRat_C DFC_CtlMsk2.DFC_IntlckChrgPlgHBrgOpnLd_C DFC_CtlMsk2.DFC_IntlckChrgPlgHBrgOvrCurr_C DFC_CtlMsk2.DFC_IntlckChrgPlgHBrgOvrTemp_C DFC_CtlMsk2.DFC_IntlckChrgPlgHBrgShCirBatt1_C DFC_CtlMsk2.DFC_IntlckChrgPlgHBrgShCirBatt2_C DFC_CtlMsk2.DFC_IntlckChrgPlgHBrgShCirGnd1_C DFC_CtlMsk2.DFC_IntlckChrgPlgHBrgShCirGnd2_C DFC_CtlMsk2.DFC_IntlckChrgPlgHBrgShCirOvrLd_C DFC_CtlMsk2.DFC_IntlckChrgPlgHBrgTempOvrCurr_C DFC_CtlMsk2.DFC_IntlckChrgPlgHBrgUndrVltg_C DFC_DisblMsk2.DFC_IntlckChrgPlgHBrgOpnLd_C DFC_DisblMsk2.DFC_IntlckChrgPlgHBrgOvrCurr_C DFC_DisblMsk2.DFC_IntlckChrgPlgHBrgOvrTemp_C DFC_DisblMsk2.DFC_IntlckChrgPlgHBrgShCirBatt1_C DFC_DisblMsk2.DFC_IntlckChrgPlgHBrgShCirBatt2_C DFC_DisblMsk2.DFC_IntlckChrgPlgHBrgShCirGnd1_C DFC_DisblMsk2.DFC_IntlckChrgPlgHBrgShCirGnd2_C DFC_DisblMsk2.DFC_IntlckChrgPlgHBrgShCirOvrLd_C DFC_DisblMsk2.DFC_IntlckChrgPlgHBrgTempOvrCurr_C DFC_DisblMsk2.DFC_IntlckChrgPlgHBrgUndrVltg_C IntlckChrgPlg_numStdActr_C IntlckChrgPlg_PwmOutCal.rMin_C IntlckChrgPlg_PwmOutCal.rMax_C IntlckChrgPlg_PwmOutCal.swtBattCor_C IntlckChrgPlg_StdHbrDiaCal.tiBtwTestPrel_C IntlckChrgPlg_StdHbrDiaCal.tiBtwTestPrmnt_C IntlckChrgPlg_StdHbrDiaCal.tiBtwTestPrmntOl_C IntlckChrgPlg_StdHbrDiaCal.tiOpenLoadDiagDurn_C IntlckChrgPlg_StdHbrDiaCal.tiExtdOpenLoadDiagDurn_C /end DEF_CHARACTERISTIC
 /begin REF_CHARACTERISTIC IntlckChrgPlg_HalfBrdgCal.tiBtwOpnLd_C IntlckChrgPlg_HalfBrdgCal.tiPwmPerHbrNotTstd_C IntlckChrgPlg_StdCal.tiDesValFlt_C IntlckChrgPlg_StdCal.rPsOff_C IntlckChrgPlg_StdCal.rActrStop_C IntlckChrgPlg_StdCal.rHysHigh_C IntlckChrgPlg_StdCal.rHysLow_C IntlckChrgPlg_StdCal.stPwrStgDiaDis_C IntlckChrgPlg_StdCal.stPlausDiaDis_C IntlckChrgPlg_StdCal.stPwrStgDis_C IntlckChrgPlg_StdCal.stActrStop_C IntlckChrgPlg_StdCal.stAllPwrStgDiaEna_C IntlckChrgPlg_StdCal.swtDesVal_C IntlckChrgPlg_StdCal.numDiagTry_C IntlckChrgPlg_StdCal.rDesValOff_C IntlckChrgPlg_StdCal.rDesValOn_C IntlckChrgPlg_StdCal.numEngDaFrqPs_C IntlckChrgPlg_StdCal.tiSlwRespSimPT1_C IntlckChrgPlg_StdCal.uHiBattThd_C IntlckChrgPlg_StdCal.uLoBattThd_C IntlckChrgPlg_StdCal.tiDebBattVoltOk_C IntlckChrgPlg_StdCal.tiDebBattVoltDfct_C IntlckChrgPlg_StdCal.mskActrActv_C IntlckChrgPlg_StdCal.tiDlyActrActvn_C IntlckChrgPlg_StdCal.rPsActrOff_C IntlckChrgPlg_StdCal.uBattMin_C IntlckChrgPlg_StdCal.uBattMax_C IntlckChrgPlg_StdCal.tiShOffCtrlDne_C IntlckChrgPlg_StdCal.swtDeactvn_C IntlckChrgPlg_StdCal.tiSelfDiagStrt_C IntlckChrgPlg_StdCal.flgReacvnPostDrv_C IntlckChrgPlg_StdCal.rPsRlyOff_C IntlckChrgPlg_StdCal.tiRlyOnDly_C IntlckChrgPlg_StdCal.nFMInWinMsk_C IntlckChrgPlg_StdCal.tiFMInDeb_C IntlckChrgPlg_StdCal.tiJamActrWait_C /end REF_CHARACTERISTIC
 /begin IN_MEASUREMENT BattU_facCor BattU_u CoEng_tiNormal DELib_idxArrSnsr DELib_xArrSnsr DevLib_stPwrStgEnaCond EnvT_t IntlckChrgPlg_rPs IntlckChrgPlg_stMonDDSens IntlckChrgPlg_stPs IntlckChrgPlg_stPwrStgDrvr IntlckChrgPlg_swtConf2C IntlckChrgPlg_swtConfC IntlckChrgPlg_swtConfStdActrSwVersC /end IN_MEASUREMENT
 /begin OUT_MEASUREMENT DDRC_St.DFC_IntlckChrgPlgHBrgOpnLd DDRC_St.DFC_IntlckChrgPlgHBrgOvrCurr DDRC_St.DFC_IntlckChrgPlgHBrgOvrTemp DDRC_St.DFC_IntlckChrgPlgHBrgShCirBatt1 DDRC_St.DFC_IntlckChrgPlgHBrgShCirBatt2 DDRC_St.DFC_IntlckChrgPlgHBrgShCirGnd1 DDRC_St.DFC_IntlckChrgPlgHBrgShCirGnd2 DDRC_St.DFC_IntlckChrgPlgHBrgShCirOvrLd DDRC_St.DFC_IntlckChrgPlgHBrgTempOvrCurr DDRC_St.DFC_IntlckChrgPlgHBrgUndrVltg DFC_st.DFC_IntlckChrgPlgHBrgOpnLd DFC_st.DFC_IntlckChrgPlgHBrgOvrCurr DFC_st.DFC_IntlckChrgPlgHBrgOvrTemp DFC_st.DFC_IntlckChrgPlgHBrgShCirBatt1 DFC_st.DFC_IntlckChrgPlgHBrgShCirBatt2 DFC_st.DFC_IntlckChrgPlgHBrgShCirGnd1 DFC_st.DFC_IntlckChrgPlgHBrgShCirGnd2 DFC_st.DFC_IntlckChrgPlgHBrgShCirOvrLd DFC_st.DFC_IntlckChrgPlgHBrgTempOvrCurr DFC_st.DFC_IntlckChrgPlgHBrgUndrVltg DINH_nrActvInhReas.FId_IntlckChrgPlgMon DINH_nrActvInhReas.FId_IntlckChrgPlgPwrStg DINH_stFId.FId_IntlckChrgPlgMon DINH_stFId.FId_IntlckChrgPlgPwrStg IntlckChrgPlg_stElecDiag IntlckChrgPlg_stElecDiagExtCtrld IntlckChrgPlg_stHlfbrOpnLdDia IntlckChrgPlg_stMon /end OUT_MEASUREMENT
 /begin LOC_MEASUREMENT IntlckChrgPlg_selfDiagPostDrv_mp IntlckChrgPlg_stHbrg_mp IntlckChrgPlg_stOpnLdMod_mp /end LOC_MEASUREMENT
 FUNCTION_VERSION "9.3.0" /end FUNCTION
/begin FUNCTION IvtrECU_Ivtr "850.0.0   Process for reception of the message from Inverter ECU" /begin IN_MEASUREMENT Com_stOffsEm01 Com_valOffsEm01 DcmDspUDS_bIvtrOffsReqFlg /end IN_MEASUREMENT
 /begin OUT_MEASUREMENT Com_cntrRxFrm0x497 Com_EvecntrDF0ASrv Com_EveDetnDF0ASrv Com_St1StsDF0ASrv Com_St2StsDF0ASrv Com_stCmdOffsEM01 Com_stIvtrOffsRd Com_stsEepRetVal Com_valEepOffsEM01 /end OUT_MEASUREMENT
 FUNCTION_VERSION "850.0.0" /end FUNCTION
/begin FUNCTION LLim_calcLim "101.3.0   Acceleration request from Speed Limiter"
 /begin DEF_CHARACTERISTIC LLim_aDifNeg_C LLim_aDifPos_C LLim_aMSL_T LLim_axMax_C LLim_vMaxFixdNorm_C LLim_vMaxFixdRvs_C LLim_vThd_C /end DEF_CHARACTERISTIC
 /begin IN_MEASUREMENT DrvMod_stPosn VehMot_aPrpCurr VehV_vSign /end IN_MEASUREMENT
 /begin OUT_MEASUREMENT LLim_aReq LLim_stReq LLim_vMaxMSL /end OUT_MEASUREMENT
 /begin LOC_MEASUREMENT LLim_aMSL_MP LLim_flgRvGearActv LLim_vDifMSL_MP /end LOC_MEASUREMENT
 FUNCTION_VERSION "101.3.0" /end FUNCTION
/begin FUNCTION LvGrid_SpCalc "1400.0.0  Setpoints in Low Voltage system"
 /begin DEF_CHARACTERISTIC LvGrid_duDcdcLimRampStepNeg_C LvGrid_duDcdcLimRampStepPos_C LvGrid_duRampStepNeg_C LvGrid_duRampStepPos_C LvGrid_maskDcdcULimReqSq_C LvGrid_maskEbsSocLvBattSq_C LvGrid_maskEbsTLvBattSq_C LvGrid_maskEbsUBattFildSq_C LvGrid_tAmbInit_C LvGrid_tiDcdcRedUReqTOut_C LvGrid_tiOnDlyFrwdMod_C LvGrid_tRampStepNeg_C LvGrid_tRampStepPos_C LvGrid_uDcdcFrwd_C LvGrid_uDcdcLvRedReq_C LvGrid_uDesDcdcAllwbl_C LvGrid_uDesDcdcInit_C LvGrid_uDesDcdcRMPInit_C LvGrid_uDesDcdcSocErrSub_C LvGrid_uDesDcdcTErrSub_C LvGrid_uNrmSocBatt_T LvGrid_uNrmTBatt_T /end DEF_CHARACTERISTIC
 /begin IN_MEASUREMENT BattU_u Dcdc_stOperModAct Ebs_ratSocFild Ebs_ratSocFild_Sq Ebs_stDcdcULimReq Ebs_stDcdcULimReq_Sq Ebs_tLvBatt Ebs_tLvBatt_Sq Ebs_uBattFild Ebs_uBattFild_Sq /end IN_MEASUREMENT
 /begin OUT_MEASUREMENT DINH_nrActvInhReas.FId_LvGridSocErr DINH_nrActvInhReas.FId_LvGridTErr DINH_nrActvInhReas.FId_LvGridUErr DINH_stFId.FId_LvGridSocErr DINH_stFId.FId_LvGridTErr DINH_stFId.FId_LvGridUErr LvGrid_uDesDcdcRaw /end OUT_MEASUREMENT
 /begin LOC_MEASUREMENT LvGrid_EnvtSlewRateLimRMP_I.State LvGrid_EnvtSlewRateLimRMP_I.Dir LvGrid_EnvtSlewRateLimRMP_I.Switch LvGrid_stDcdcRedUReq LvGrid_tFild LvGrid_uCnvtnlCChrgnMod LvGrid_uCnvtnlSocChrgnMod LvGrid_uCnvtnlTChrgnMod LvGrid_uDesDcdcSlewRateRMP_I.State LvGrid_uDesDcdcSlewRateRMP_I.Dir LvGrid_uDesDcdcSlewRateRMP_I.Switch /end LOC_MEASUREMENT
 FUNCTION_VERSION "1400.0.0" /end FUNCTION
/begin FUNCTION LvGrid_TestPls "1.0.0     Low voltage set point modulation for test pulse" /begin IN_MEASUREMENT LvGrid_uDesDcdcRaw /end IN_MEASUREMENT
 /begin OUT_MEASUREMENT DINH_nrActvInhReas.FId_LvGridTestPlsReq DINH_stFId.FId_LvGridTestPlsReq LvGrid_uDesDcdc /end OUT_MEASUREMENT
 FUNCTION_VERSION "1.0.0" /end FUNCTION
/begin FUNCTION MEDC_Compu_Core_CELPrj "30059.0.0 Computation Methods for core, which are migrated from DS classis" FUNCTION_VERSION "30059.0.0" /end FUNCTION
/begin FUNCTION MEDC_Compu_Custom "30059.0.0_BSW_STLA_N_D060I10deprectared: have to be migrated to CEL_Compu" FUNCTION_VERSION "30059.0.0_BSW_STLA_N_D060I10" /end FUNCTION
/begin FUNCTION MEDC_Compu_Custom_CELPrj "30090.0.0 Customer specific computation formulas from Clearcase" FUNCTION_VERSION "30090.0.0" /end FUNCTION
/begin FUNCTION MEDC_Compu_DS_CELPrj "30088.0.0 computation methods of DS from Clearcase" FUNCTION_VERSION "30088.0.0" /end FUNCTION
/begin FUNCTION MEDC_Compu_DS_GS_CELPrj "30090.0.0 computation methods, common used by DS and GS from Clearcase" FUNCTION_VERSION "30090.0.0" /end FUNCTION
/begin FUNCTION MEDC_FixConst_Core_CELPrj "30088.0.0 central system constants of the core from Clearcase" FUNCTION_VERSION "30088.0.0" /end FUNCTION
/begin FUNCTION MEDC_FixConst_Custom "30059.0.0_VCU_BSW_STLA_N_D060I10deprectared: have to be migrated to CEL_Const" FUNCTION_VERSION "30059.0.0_VCU_BSW_STLA_N_D060I10" /end FUNCTION
/begin FUNCTION MEDC_FixConst_Custom_CELPrj "30088.0.0 Customer specific central system constants from Clearcase" FUNCTION_VERSION "30088.0.0" /end FUNCTION
/begin FUNCTION MEDC_FixConst_DS_CELPrj "30088.0.0 DS central system constants from Clearcase" FUNCTION_VERSION "30088.0.0" /end FUNCTION
/begin FUNCTION MEDC_FixConst_DS_GS_CELPrj "30090.0.0 central systemkonstants, common used by DS and GS from Clearcase" FUNCTION_VERSION "30090.0.0" /end FUNCTION
/begin FUNCTION MEDC_MoCompu_CELPrj "1.4.0     Computation formulas for monitoring" FUNCTION_VERSION "1.4.0" /end FUNCTION
/begin FUNCTION MEDC_Models_DS_CELPrj "30088.0.0 models DS from Clearcase" FUNCTION_VERSION "30088.0.0" /end FUNCTION
/begin FUNCTION MEDC_Models_DS_GS_CELPrj "30088.0.0 common models GS and DS from Clearcase" FUNCTION_VERSION "30088.0.0" /end FUNCTION
/begin FUNCTION MEDC_SimpleModels "30001.0.0 Simple models for diesel gasoline systems" FUNCTION_VERSION "30001.0.0" /end FUNCTION
/begin FUNCTION MedTPmp_VD "7.2.0     Virtual driver for the coolant pump in the medium temperature cooling circuit."
 /begin DEF_CHARACTERISTIC MedTPmp_dratNegSlop_C MedTPmp_dratPosSlop_C MedTPmp_ratDes_M MedTPmp_ratSCtPmp1Delta_C MedTPmp_ratSCtPmp1Lo_C MedTPmp_tiSpplCooltPmpRly_C /end DEF_CHARACTERISTIC
 /begin IN_MEASUREMENT SCtPmp1_r SpplCooltPmpRly_r WtrPmp1_mfDesMedT WtrPmp1_pLossMedT /end IN_MEASUREMENT
 /begin OUT_MEASUREMENT DINH_nrActvInhReas.FId_MedTPmpFlt DINH_nrActvInhReas.FId_MedTPmpPwrCtrlRly DINH_stFId.FId_MedTPmpFlt DINH_stFId.FId_MedTPmpPwrCtrlRly MedTPmp_st /end OUT_MEASUREMENT
 FUNCTION_VERSION "7.2.0" /end FUNCTION
/begin FUNCTION MILLmp_DD "4.11.0    Device Driver for the MIL Control" /begin IN_MEASUREMENT MILLmp_stReqBln MILLmp_stReqOn SyC_stSub /end IN_MEASUREMENT /begin OUT_MEASUREMENT ErrLmp_stMIL MILLmp_stMIL MILLmp_stPs /end OUT_MEASUREMENT /begin LOC_MEASUREMENT MILLmp_tiRmnBln /end LOC_MEASUREMENT FUNCTION_VERSION "4.11.0" /end FUNCTION
/begin FUNCTION MILLmp_VD "7.16.0    Virtual Device for the MIL Control" /begin DEF_CHARACTERISTIC MILLmp_cwReqActv_C MILLmp_tiAftStrt_C MILLmp_tiVisTst_C /end DEF_CHARACTERISTIC /begin IN_MEASUREMENT SyC_stSub /end IN_MEASUREMENT /begin OUT_MEASUREMENT MILLmp_stReqBln MILLmp_stReqOn /end OUT_MEASUREMENT /begin LOC_MEASUREMENT MILLmp_stMILWoTstr MILLmp_stSt MILLmp_tiRmnSt /end LOC_MEASUREMENT FUNCTION_VERSION "7.16.0" /end FUNCTION
/begin FUNCTION MoCADC_Co "103.0.0   Microcontroller Monitoring: AD-converter"
 /begin DEF_CHARACTERISTIC DFC_CtlMsk2.DFC_MoCADCNTPBnk1_C DFC_CtlMsk2.DFC_MoCADCTestVoltBnk1_C DFC_DisblMsk2.DFC_MoCADCNTPBnk1_C DFC_DisblMsk2.DFC_MoCADCTestVoltBnk1_C MoCADC_cntrDebNTP_C MoCADC_cntrDebTest_C MoCADC_cntrRstNTP_C MoCADC_cntrRstTest_C MoCADC_uNTPBnk1Max_C MoCADC_uTestMax_C MoCADC_uTestMin_C /end DEF_CHARACTERISTIC
 /begin IN_MEASUREMENT MoGlbl_vblStructCpl.Mo_stCplChk MoGlbl_vblStructCpl.Mo_stMoCCpl Mo_ctRst Mo_ctRstCpl Mo_stMoF Mo_stMoFCpl /end IN_MEASUREMENT
 /begin OUT_MEASUREMENT DFC_st.DFC_MoCADCNTPBnk1 DFC_st.DFC_MoCADCTestVoltBnk1 MoCADC_bChkActv MoCADC_bDef MoCADC_bNTPActv MoCADC_bNTPErr MoCADC_bNTPRel MoCADC_bTstErr MoCADC_st MoCADC_stIrrvErrMsg MoCADC_stMsg /end OUT_MEASUREMENT
 /begin LOC_MEASUREMENT MoCADC_bNTPBnk1ChkActv MoCADC_bNTPBnk1Rel MoCADC_cntrDebNTP MoCADC_cntrDebNTPCpl MoCADC_cntrDebTest MoCADC_cntrDebTestCpl MoCADC_cntrTestVoltTestBnk1 MoCADC_flgClrNTP MoCADC_flgClrTest MoCADC_flgNTPTestBnk1 MoCADC_stCheckState MoCADC_stCheckStateCpl MoCADC_stCpl MoCADC_stNTPBnk1Req MoCADC_stNTPTest MoCADC_stNTPTestCpl MoCADC_uNTPBnk1_mp MoCADC_uTest_mp /end LOC_MEASUREMENT
 FUNCTION_VERSION "103.0.0" /end FUNCTION
/begin FUNCTION MoCCom_Co "81.26.0   Microcontroller Monitoring: Query-response-communication between MM and FC"
 /begin IN_MEASUREMENT MoCCPU_PartResp MoCGTM_PtlResp MoCHwLogicTest_PtlResp MoCIWDH_PtlResp MoCPFC_PtlResp MoCSOP_stActvMsg MoCSOP_stComActv MoCSOP_stComActvCpl /end IN_MEASUREMENT
 /begin OUT_MEASUREMENT MoCCom_bPFCNew MoCCom_bSwShrNew MoCCom_cntrWDAErrThd MoCCom_cntrWDAErrThdMsg MoCCom_ctErrFC MoCCom_ctErrMM MoCCom_ctErrMMMsg MoCCom_Query MoCCom_stQueryNew MoCCom_SwShrPtlResp /end OUT_MEASUREMENT
 /begin LOC_MEASUREMENT MoCCom_cntrInCorrRespTime MoCCom_cntrSyncMonModl MoCCom_cntrWDAErrThdCpl MoCCom_ctBusErr MoCCom_ctBusErrCpl MoCCom_ctErrFCCpl MoCCom_ctErrMMOld MoCCom_ctErrOSTimeout MoCCom_Response MoCCom_Response_mp MoCCom_stBusErr MoCCom_stCheckState MoCCom_stCheckStateCpl MoCCom_stComActvOld MoCCom_stComActvOldCpl MoCCom_stComState MoCCom_stErrEna MoCCom_stErrEnaCpl MoCCom_stWdgThdErr MoCCom_stWdgTiWinErr /end LOC_MEASUREMENT
 FUNCTION_VERSION "81.26.0" /end FUNCTION
/begin FUNCTION MoCCPU_Co "80.6.0    Microcontroller Monitoring: Instruction test" /begin DEF_CHARACTERISTIC MoCCPU_stLockStepTstActv_CW /end DEF_CHARACTERISTIC /begin OUT_MEASUREMENT MoCCPU_PartResp /end OUT_MEASUREMENT FUNCTION_VERSION "80.6.0" /end FUNCTION
/begin FUNCTION MoCEMM_Co "1.24.0    Microcontroller Monitoring: Error Management Module(EMM)" /begin IN_MEASUREMENT MoCSOP_stComActv /end IN_MEASUREMENT
 /begin OUT_MEASUREMENT MoCEMM_stEmmAlrms MoCEMM_stEmmAlrmsMsg MoCEMM_stEmmAlrmsNv MoCEMM_stEmmErrorPin /end OUT_MEASUREMENT
 /begin LOC_MEASUREMENT MoCEMM_idxNumCurrErr MoCEMM_stEmmAlrmsCpl MoCEMM_stEmmErrorPinCpl MoCEMM_stEmmGPIO MoCEMM_stPwrOnRstHdl MoCEMM_stPwrOnRstHdlCpl MoCEMM_stPwrOnRstReq MoCEMM_stPwrOnRstReqCpl MoCEMM_structCurrReq.MoCEMM_cntrInfo MoCEMM_structCurrReq.MoCEMM_blkInfo MoCEMM_structCurrReq.MoCEMM_cntrInfoCpl MoCEMM_structFlash.MoCEMM_cntrInfo MoCEMM_structFlash.MoCEMM_blkInfo MoCEMM_structFlash.MoCEMM_cntrInfoCpl MoCEMM_stSWErrorPinReqAry MoCEMM_stSWErrorPinReqAryCpl MoCEMM_wdgTout /end LOC_MEASUREMENT
 FUNCTION_VERSION "1.24.0" /end FUNCTION
/begin FUNCTION MoCGTM_Co "1.16.0    Microcontroller Monitoring: Generic Timer Module (GTM)"
 /begin DEF_CHARACTERISTIC MoCGTM_cntrCMPErrbitHealMax_C MoCGTM_cntrDebErrMax_C MoCGTM_cntrErrClkMonMax_C MoCGTM_stChksTstActv_CW MoCGTM_stClkMonTestActv_CW MoCGTM_stSWResetDem_CW MoCGTM_stTestActv_CW MoCGTM_tiEClkPerdMax_C MoCGTM_tiEClkPerdMin_C MoCGTM_tiEClkTOnMax_C MoCGTM_tiEClkTOnMin_C /end DEF_CHARACTERISTIC
 /begin OUT_MEASUREMENT MoCGTM_bbOut1 MoCGTM_flgCmpErr MoCGTM_PtlResp /end OUT_MEASUREMENT
 /begin LOC_MEASUREMENT MoCGTM_aryCMPErrBit MoCGTM_aryCMPErrBitCpl MoCGTM_bbOut1Cpl MoCGTM_cmpErrAryIdx MoCGTM_cmpErrAryIdxCpl MoCGTM_cntrBadcase MoCGTM_cntrCMPErrbit MoCGTM_cntrCMPErrbitCpl MoCGTM_cntrCMPErrbitHeal MoCGTM_cntrCMPErrbitHealCpl MoCGTM_cntrDebErr MoCGTM_cntrDebErrCpl MoCGTM_cntrDebErrMax MoCGTM_cntrErrClkMon MoCGTM_cntrErrClkMonCpl MoCGTM_cntrMCS1 MoCGTM_cntrMCS1Old MoCGTM_cntrMCS1OldCpl MoCGTM_cntrMCS2 MoCGTM_cntrMCS2Old MoCGTM_cntrMCS2OldCpl MoCGTM_cntrMCS3 MoCGTM_cntrMCS3Old MoCGTM_cntrMCS3OldCpl MoCGTM_cntrMsmCMPErrBit MoCGTM_cntrRouteSigErr MoCGTM_cntrRouteSigErrCpl MoCGTM_currChksVal MoCGTM_currChksValCpl MoCGTM_currMCSModlAryIdx MoCGTM_McsData_ptr1Cpl MoCGTM_McsData_ptr2Cpl MoCGTM_McsData_ptr3Cpl MoCGTM_numMCS1Ch MoCGTM_numMCS1Modl MoCGTM_numMCS2Ch MoCGTM_numMCS2Modl MoCGTM_numMCS3Ch MoCGTM_numMCS3Modl MoCGTM_PtlRespCpl MoCGTM_stBadcaseTrig MoCGTM_stErr MoCGTM_stErrChks MoCGTM_stErrCpl MoCGTM_tiCurrMCSVal MoCGTM_tiCurrTskcall MoCGTM_tiEClkPerd MoCGTM_tiEClkTOn MoCGTM_tiExeMCS1_MP MoCGTM_tiExeMCS2_MP MoCGTM_tiExeMCS3_MP MoCGTM_tiFallEdgeBadcase_MP MoCGTM_tiFallEdgeMCS1_MP MoCGTM_tiFallEdgeMCS2_MP MoCGTM_tiMCSTIMRead MoCGTM_tiPrevMCS1Trig_MP MoCGTM_tiPrevMCS2Trig_MP MoCGTM_tiPrevMCS3Trig_MP MoCGTM_tiPrevTskcall MoCGTM_tiRisngEdgeMCS1_MP MoCGTM_tiRisngEdgeMCS2_MP MoCGTM_tiTskCalldst_MP /end LOC_MEASUREMENT
 FUNCTION_VERSION "1.16.0" /end FUNCTION
/begin FUNCTION MoCHwLogicTest_Co "1.4.0     Microcontroller Monitoring: Hardware Logic Test"
 /begin DEF_CHARACTERISTIC MoCHwLogicTest_stTestActv_CW MoCHwLogicTest_swtDisblErrReactn_CW MoCHwLogicTest_swtDisblFwChk_CA /end DEF_CHARACTERISTIC
 /begin OUT_MEASUREMENT MoCHwLogicTest_PtlResp /end OUT_MEASUREMENT
 /begin LOC_MEASUREMENT MoCHwLogicTest_flgAlvTestChk MoCHwLogicTest_flgFwChk MoCHwLogicTest_flgMONBISTChk MoCHwLogicTest_flgSFFDChk MoCHwLogicTest_flgTempChk MoCHwLogicTest_flgUCBErrChk MoCHwLogicTest_stErr /end LOC_MEASUREMENT
 FUNCTION_VERSION "1.4.0" /end FUNCTION
/begin FUNCTION MoCIWDH_Co "2.1.0     Microcontroller Monitoring: Internal watchdog handler" /begin DEF_CHARACTERISTIC MoCIWDH_stPtlRespTstActv_CW /end DEF_CHARACTERISTIC /begin OUT_MEASUREMENT MoCIWDH_PtlResp /end OUT_MEASUREMENT
 /begin LOC_MEASUREMENT MoCIWDH_bbLoc1 MoCIWDH_bbLoc1Cpl MoCIWDH_cntChksAry MoCIWDH_cntrRollgAry MoCIWDH_cntrRollgAryCpl MoCIWDH_flgConcatValErr MoCIWDH_numChksAry MoCIWDH_numConcatValAry MoCIWDH_PtlRespCpl MoCIWDH_stErrAry /end LOC_MEASUREMENT
 FUNCTION_VERSION "2.1.0" /end FUNCTION
/begin FUNCTION MoCMemStrtUp_Co "1.0.0     Microcontroller Monitoring: Startup memory test" /begin DEF_CHARACTERISTIC MoCMemStrtUp_chkRamTest_C MoCMemStrtUp_chkRomTest_C /end DEF_CHARACTERISTIC /begin OUT_MEASUREMENT MoCMemStrtUp_adrEccErr /end OUT_MEASUREMENT
 /begin LOC_MEASUREMENT MoCMemStrtUp_chkRamTest MoCMemStrtUp_chkRomTest MoCMemStrtUp_tiRamChk MoCMemStrtUp_tiRomChk MoCMemStrtUp_toutWdg /end LOC_MEASUREMENT
 FUNCTION_VERSION "1.0.0" /end FUNCTION
/begin FUNCTION MoCMem_Co "80.24.1   Microcontroller Monitoring: Cyclic memory test"
 /begin DEF_CHARACTERISTIC MoCMem_ctDebErrChkRAM_C MoCMem_ctDebErrChkROM_C MoCMem_ctDebHealChkRAMCpl_C MoCMem_ctDebHealChkRAM_C MoCMem_ctDebHealChkROMCpl_C MoCMem_ctDebHealChkROM_C MoCMem_noMEMChkRstCpl_CW MoCMem_noMEMChkRst_CW MoCMem_numRamChk_C MoCMem_numRomChk_CA MoCMem_RamTst_CW MoCMem_RomTst_CW MoCMem_stSwtAutRamChkConf_C MoCMem_stSwtAutRomChkConf_C /end DEF_CHARACTERISTIC
 /begin IN_MEASUREMENT MoExe_ctCyc /end IN_MEASUREMENT
 /begin LOC_MEASUREMENT MoCMem_adChkSumBlk MoCMem_adChkSumBlkCpl MoCMem_ctDebErrChkROM MoCMem_ctDebErrChkROMCpl MoCMem_ctDebHealChkROM MoCMem_ctDebHealChkROMCpl MoCMem_ctLrnROM MoCMem_ctLrnROMCpl MoCMem_idxCSAry MoCMem_idxCSAryCpl MoCMem_nrRomChk MoCMem_nrRomChkCpl MoCMem_nrRomChkSize MoCMem_numChkSumCurrent MoCMem_numChkSumCurrentCpl MoCMem_RomCurrentPtr MoCMem_RomCurrentPtrCpl MoCMem_stDataCycChkBlk MoCMem_stDataCycChkBlkCpl MoCMem_stDisChk MoCMem_tiROMAccus MoCMem_tiROMAccusCpl MoCMem_tiROMus MoCMem_tiROMusCpl MoCMem_tiROMusOld MoCMem_tiROMusOldCpl /end LOC_MEASUREMENT
 FUNCTION_VERSION "80.24.1" /end FUNCTION
/begin FUNCTION MoCPFC_Co "14.4.0    Microcontroller Monitoring: Program flow check" /begin DEF_CHARACTERISTIC MoCPFC_stPtlRespTestActv_CW /end DEF_CHARACTERISTIC /begin IN_MEASUREMENT MoCCom_bPFCNew MoCCom_Query /end IN_MEASUREMENT /begin OUT_MEASUREMENT MoCPFC_Checksum MoCPFC_PtlResp /end OUT_MEASUREMENT /begin LOC_MEASUREMENT MoCPFC_Checkword MoCPFC_Counter /end LOC_MEASUREMENT FUNCTION_VERSION "14.4.0" /end FUNCTION
/begin FUNCTION MoCSCC_Co "1.27.0    Microcontroller Monitoring: Safety feature Configuration Check(SCC)"
 /begin DEF_CHARACTERISTIC MoCSCC_cntrDebMax_C MoCSCC_stSCCTstActv_CW MoCSCC_swtDisblEmmChk_CA MoCSCC_swtLfastWrkarndActv_CW /end DEF_CHARACTERISTIC
 /begin REF_CHARACTERISTIC MoCSOP_stReqCANFrTest_C /end REF_CHARACTERISTIC
 /begin IN_MEASUREMENT MoCSOP_stComActv /end IN_MEASUREMENT
 /begin LOC_MEASUREMENT MoCSCC_stLfastWrkarndActv_MP MoCSCC_stMstInstFnd /end LOC_MEASUREMENT
 FUNCTION_VERSION "1.27.0" /end FUNCTION
/*********** End of merged COMPU_METHOD blocks ***********/
/begin COMPU_METHOD Acc "" RAT_FUNC "%6.5" "m/s^2" COEFFS 0 1000 0 0 0 1 /end COMPU_METHOD
/begin COMPU_METHOD boolean "" RAT_FUNC "%6.2" "-" COEFFS 0 1 0 0 0 1 /end COMPU_METHOD
/begin COMPU_METHOD B_TRUE "" TAB_VERB "%6.3" "" COMPU_TAB_REF B_TRUE /end COMPU_METHOD
/begin COMPU_VTAB B_TRUE "" TAB_VERB 2 0 "FALSE" 1 "TRUE" /end COMPU_VTAB
/begin COMPU_METHOD DDRCTime_ms "" RAT_FUNC "%6.1" "ms" COEFFS 0 1 0 0 0 10 /end COMPU_METHOD
/begin COMPU_METHOD DDRC_Ratio "" TAB_VERB "%6.3" "-" COMPU_TAB_REF DDRC_Ratio /end COMPU_METHOD
/begin COMPU_VTAB DDRC_Ratio "" TAB_VERB 4 1 "Ratio1" 2 "Ratio2" 3 "Ratio3" 4 "Ratio4" /end COMPU_VTAB
/begin COMPU_METHOD DELIB_ALLTEMP_VERB_COMPU "" TAB_VERB "%6.3" "" COMPU_TAB_REF DELIB_ALLTEMP_VERB_COMPU /end COMPU_METHOD
/begin COMPU_VTAB DELIB_ALLTEMP_VERB_COMPU "" TAB_VERB 6 85 "ACCHRGRINTKT" 86 "DCCHRGRINTKT" 0 "ENVT" 89 "HEATRCORET" 254 "DFLTEMP" 255 "NOTEMP" /end COMPU_VTAB
/begin COMPU_METHOD dez "" RAT_FUNC "%6.2" "" COEFFS 0 1 0 0 0 1 /end COMPU_METHOD
/begin COMPU_METHOD DFC_OneToOne "" RAT_FUNC "%6.2" "-" COEFFS 0 1 0 0 0 1 /end COMPU_METHOD
/begin COMPU_METHOD DFES_OneToOne "" RAT_FUNC "%6.2" "-" COEFFS 0 1 0 0 0 1 /end COMPU_METHOD
/begin COMPU_METHOD DINH_ct_Compu "" RAT_FUNC "%6.0" "" COEFFS 0 -1 4096 0 0 1 /end COMPU_METHOD
/begin COMPU_METHOD DtyCyc "" RAT_FUNC "%6.4" "%" COEFFS 0 100 0 0 0 1 /end COMPU_METHOD
/begin COMPU_METHOD EngN "" RAT_FUNC "%6.3" "rpm" COEFFS 0 2 0 0 0 1 /end COMPU_METHOD
/begin COMPU_METHOD Ext_stNwCmdLIN_VERB "" TAB_VERB "%6.3" "" COMPU_TAB_REF Ext_stNwCmdLIN_VERB /end COMPU_METHOD
/begin COMPU_VTAB Ext_stNwCmdLIN_VERB "" TAB_VERB 3 0 "Preparation_a_la_mise_en_veille" 1 "Autorisation_du_reveil" 255 "Invalide" /end COMPU_VTAB
/begin COMPU_METHOD MILLmp_StVerb "" TAB_VERB "%6.3" "" COMPU_TAB_REF MILLmp_StVerb /end COMPU_METHOD
/begin COMPU_VTAB MILLmp_StVerb "" TAB_VERB 6 0 "Init_State" 1 "Inactive" 2 "VisTest" 4 "DisplayErrStatus" 18 "VisTestTimerRun" 34 "SyncTimerRun" /end COMPU_VTAB
/begin COMPU_METHOD MoCCom_stCheckState_Compu "" TAB_VERB "%6.3" "" COMPU_TAB_REF MoCCom_stCheckState_Compu /end COMPU_METHOD
/begin COMPU_VTAB MoCCom_stCheckState_Compu "" TAB_VERB 8 0 "MOCCOM_CO_COR_IN_TIME_AND_VALUE_1" 1 "MOCCOM_CO_COR_IN_TIME_AND_VALUE_2" 2 "MOCCOM_CO_TOO_EARLY" 3 "MOCCOM_CO_COR_IN_TIME_AND_VALUE_3" 4 "MOCCOM_CO_TOO_LATE" 5 "MOCCOM_CO_COR_IN_TIME_AND_VALUE_4A" 6 "MOCCOM_CO_COR_IN_TIME_AND_VALUE_4B" 7 "MOCCOM_CO_COR_IN_TIME_INC_IN_VALUE" /end COMPU_VTAB
/begin COMPU_METHOD MoCCom_stComState_Compu "" TAB_VERB "%6.3" "" COMPU_TAB_REF MoCCom_stComState_Compu /end COMPU_METHOD
/begin COMPU_VTAB MoCCom_stComState_Compu "" TAB_VERB 3 0 "MOCCOM_CO_SYNCHRONIZING" 1 "MOCCOM_CO_RECEIVING_QUERY" 2 "MOCCOM_CO_SENDING_RESP" /end COMPU_VTAB
/begin COMPU_METHOD MOCFC_NRFASTCYCBLK_SC_Compu "" RAT_FUNC "%6.2" "" COEFFS 0 1 0 0 0 1 /end COMPU_METHOD
/begin COMPU_METHOD MOCFC_POSTBLDCHKS_SC_Compu "" TAB_VERB "%6.3" "" COMPU_TAB_REF MOCFC_POSTBLDCHKS_SC_Compu /end COMPU_METHOD
/begin COMPU_VTAB MOCFC_POSTBLDCHKS_SC_Compu "" TAB_VERB 2 0 "False" 1 "True" /end COMPU_VTAB
/begin COMPU_METHOD MOCFC_SCCERRREACTN_SC_Compu "" TAB_VERB "%6.3" "" COMPU_TAB_REF MOCFC_SCCERRREACTN_SC_Compu /end COMPU_METHOD
/begin COMPU_VTAB MOCFC_SCCERRREACTN_SC_Compu "" TAB_VERB 2 0 "Disable" 1 "Enable" /end COMPU_VTAB
/begin COMPU_METHOD MOCMM_ABESHTOFFPAHTESTENA_SC_Compu "" TAB_VERB "%6.3" "" COMPU_TAB_REF MOCMM_ABESHTOFFPAHTESTENA_SC_Compu /end COMPU_METHOD
/begin COMPU_VTAB MOCMM_ABESHTOFFPAHTESTENA_SC_Compu "" TAB_VERB 2 0 "False" 1 "True" /end COMPU_VTAB
/begin COMPU_METHOD MOCMM_CANSHOFFPAHTESTENA_SC_Compu "" TAB_VERB "%6.3" "" COMPU_TAB_REF MOCMM_CANSHOFFPAHTESTENA_SC_Compu /end COMPU_METHOD
/begin COMPU_VTAB MOCMM_CANSHOFFPAHTESTENA_SC_Compu "" TAB_VERB 2 0 "Disabled" 1 "Enabled" /end COMPU_VTAB
/begin COMPU_METHOD MOCMM_FRSHOFFPAHTESTENA_SC_Compu "" TAB_VERB "%6.3" "" COMPU_TAB_REF MOCMM_FRSHOFFPAHTESTENA_SC_Compu /end COMPU_METHOD
/begin COMPU_VTAB MOCMM_FRSHOFFPAHTESTENA_SC_Compu "" TAB_VERB 2 0 "Disabled" 1 "Enabled" /end COMPU_VTAB
/begin COMPU_METHOD MOCMM_MCUINJSHTOFFPAHTESTENA_SC_Compu "" TAB_VERB "%6.3" "" COMPU_TAB_REF MOCMM_MCUINJSHTOFFPAHTESTENA_SC_Compu /end COMPU_METHOD
/begin COMPU_VTAB MOCMM_MCUINJSHTOFFPAHTESTENA_SC_Compu "" TAB_VERB 2 0 "False" 1 "True" /end COMPU_VTAB
/begin COMPU_METHOD MOCMM_NRTRCV_SC_Compu "" RAT_FUNC "%6.2" "" COEFFS 0 1 0 0 0 1 /end COMPU_METHOD
/begin COMPU_METHOD MOCMM_UCHIP_SC_Compu "" TAB_VERB "%6.3" "" COMPU_TAB_REF MOCMM_UCHIP_SC_Compu /end COMPU_METHOD
/begin COMPU_VTAB MOCMM_UCHIP_SC_Compu "" TAB_VERB 2 0 "False" 1 "True" /end COMPU_VTAB
/begin COMPU_METHOD ModeType_VERB "" TAB_VERB "%6.3" "" COMPU_TAB_REF ModeType_VERB /end COMPU_METHOD
/begin COMPU_VTAB ModeType_VERB "" TAB_VERB 3 0 "No_COM" 1 "Silent" 2 "FULL_COM" /end COMPU_VTAB
/begin COMPU_METHOD MoExe_Co_PFC_ID_Compu "" TAB_VERB "%6.3" "" COMPU_TAB_REF MoExe_Co_PFC_ID_Compu /end COMPU_METHOD
/begin COMPU_VTAB MoExe_Co_PFC_ID_Compu "" TAB_VERB 98 0 "-" 16777471 "MOCEMM_CO_REQERRPIN_ID_HW" 16777217 "MOCEMM_CO_REQERRPIN_ID_MOCMEM" 16777216 "MOCEMM_CO_REQERRPIN_ID_MOCCOM" 16777218 "MOCEMM_CO_REQERRPIN_ID_MOCSOP" 16777225 "MOCEMM_CO_REQERRPIN_ID_MOCADC" 16777220 "MOCEMM_CO_REQERRPIN_ID_MOFWDA" 16777219 "MOCEMM_CO_REQERRPIN_ID_MOCEMM" 16777221 "MOCEMM_CO_REQERRPIN_ID_OCWDATEST" 16777222 "MOCEMM_CO_REQERRPIN_ID_SWSHRL2" 16777223 "MOCEMM_CO_REQERRPIN_ID_MOCGTM" 16777224 "MOCEMM_CO_REQERRPIN_ID_MOCSCC" 16777226 "MOCEMM_CO_REQERRPIN_ID_MOCIWDH" 10 "MO_GLBL_PROC_CORE1_10MS_NR1_PFC_ID" 83 "MO_GLBL_PROC_MANYCORE_CORE1_10MS_NR1_PFC_ID" 2 "MOCADC_CO_PROC_CORE1_10MS_NR1_PFC_ID" 84 "MOCCOM_CO_PROC_CORE1_10MS_NR1_PFC_ID" 80 "MOCCPU_CO_PROC_CORE1_10MS_NR1_PFC_ID" 7 "MOCEMM_CO_PROC_CORE1_10MS_NR1_PFC_ID" 9 "MOCGTM_CO_PROC_CORE1_10MS_NR1_PFC_ID" 81 "MOCIWDH_CO_PROC_CORE1_10MS_NR1_PFC_ID" 5 "MOCMEM_CO_CHKCSA_PROC_CORE1_10MS_NR1_PFC_ID" 76 "MOCMEM_CO_CHKRAM_PROC_CORE1_10MS_NR1_PFC_ID" 8 "MOCMEM_CO_CHKROM_PROC_CORE1_10MS_NR1_PFC_ID" 4 "MOCMEM_CO_CHKSTCK_PROC_CORE1_10MS_NR1_PFC_ID" 78 "MOCMEM_CO_ERRHDL_PROC_CORE1_10MS_NR1_PFC_ID" 82 "MOCPFC_CO_IWDH_PROC_CORE1_10MS_NR1_PFC_ID" 79 "MOCPFC_CO_MANYCORE_PROC_CORE1_10MS_NR1_PFC_ID" 77 "MOCSCC_CO_PROC_CORE1_10MS_NR1_PFC_ID" 85 "MOCSOP_CO_PROC_CORE1_10MS_NR1_PFC_ID" 6 "MOCSOP_CO_PROC_10MS_CORE1_10MS_NR1_PFC_ID" 1 "MOEXE_CO_TASK_CORE1_TASK10MS_NR1_PFC_ID" 28 "MOFACCR_BRKPLAUS_PROC_CORE1_10MS_NR1_PFC_ID" 26 "MOFACCR_INP_PROC_CORE1_10MS_NR1_PFC_ID" 27 "MOFACCR_RAT_PROC_CORE1_10MS_NR1_PFC_ID" 17 "MOFBAS_INP_PROC_CORE1_10MS_NR1_PFC_ID" 22 "MOFBAS_VEHSPD_PROC_CORE1_10MS_NR1_PFC_ID" 18 "MOFBRK_INP_PROC_CORE1_10MS_NR1_PFC_ID" 74 "MOFCBNPRECDNG_CO_PROC_CORE1_10MS_NR1_PFC_ID" 31 "MOFDRVRASSC_CRSCTRL_PROC_CORE1_10MS_NR1_PFC_ID" 16 "MOFEMGYOFF_EMAC_PROC_CORE1_10MS_NR1_PFC_ID" 72 "MOFERRHNDLG_REACTN_PROC_CORE1_10MS_NR1_PFC_ID" 32 "MOFESCASSC_ESC_PROC_CORE1_10MS_NR1_PFC_ID" 23 "MOFEVMNGT_BMS_PROC_CORE1_10MS_NR1_PFC_ID" 25 "MOFEVMNGT_DCDC_PROC_CORE1_10MS_NR1_PFC_ID" 20 "MOFEVMNGT_EM_PROC_CORE1_10MS_NR1_PFC_ID" 21 "MOFEVMNGT_EM_PROC_2_CORE1_10MS_NR1_PFC_ID" 24 "MOFEXTCPT_AUXCPT_PROC_CORE1_10MS_NR1_PFC_ID" 57 "MOFEXTCPT_VACPMP_PROC_CORE1_10MS_NR1_PFC_ID" 13 "MOFFRM_RX_PROC_CORE1_10MS_NR1_PFC_ID" 75 "MOFFRM_TX_PROC_CORE1_10MS_NR1_PFC_ID" 14 "MOFIN_CO_PROC_CORE1_10MS_NR1_PFC_ID" 30 "MOFPTST_RAT_PROC_CORE1_10MS_NR1_PFC_ID" 19 "MOFRELSMNGT_PTRELS_PROC_CORE1_10MS_NR1_PFC_ID" 43 "MOFTQPTDAXLE_COMP_PROC_CORE1_10MS_NR1_PFC_ID" 42 "MOFTQPTDAXLE_COORN_PROC_CORE1_10MS_NR1_PFC_ID" 40 "MOFTQPTDAXLE_DISTBN_PROC_CORE1_10MS_NR1_PFC_ID" 41 "MOFTQPTDAXLE_FIL_PROC_CORE1_10MS_NR1_PFC_ID" 46 "MOFTQPTDAXLESEC_COMP_PROC_CORE1_10MS_NR1_PFC_ID" 45 "MOFTQPTDAXLESEC_COORN_PROC_CORE1_10MS_NR1_PFC_ID" 44 "MOFTQPTDAXLESEC_FIL_PROC_CORE1_10MS_NR1_PFC_ID" 51 "MOFTQPTDEM_COMP_PROC_CORE1_10MS_NR1_PFC_ID" 49 "MOFTQPTDEM_COORN_PROC_CORE1_10MS_NR1_PFC_ID" 48 "MOFTQPTDEM_LOSS_PROC_CORE1_10MS_NR1_PFC_ID" 50 "MOFTQPTDEM_TRAN_PROC_CORE1_10MS_NR1_PFC_ID" 47 "MOFTQPTDEM_WHLDISTBN_PROC_CORE1_10MS_NR1_PFC_ID" 56 "MOFTQPTDEMSEC_COMP_PROC_CORE1_10MS_NR1_PFC_ID" 54 "MOFTQPTDEMSEC_COORN_PROC_CORE1_10MS_NR1_PFC_ID" 53 "MOFTQPTDEMSEC_LOSS_PROC_CORE1_10MS_NR1_PFC_ID" 55 "MOFTQPTDEMSEC_TRAN_PROC_CORE1_10MS_NR1_PFC_ID" 52 "MOFTQPTDEMSEC_WHLDISTBN_PROC_CORE1_10MS_NR1_PFC_ID" 73 "MOFTQPTDOUT_LIMN_PROC_CORE1_10MS_NR1_PFC_ID" 39 "MOFTQPTDVEH_COMP_PROC_CORE1_10MS_NR1_PFC_ID" 37 "MOFTQPTDVEH_COORN_PROC_CORE1_10MS_NR1_PFC_ID" 34 "MOFTQPTDVEH_DRVAWY_PROC_CORE1_10MS_NR1_PFC_ID" 35 "MOFTQPTDVEH_DRVPROG_PROC_CORE1_10MS_NR1_PFC_ID" 36 "MOFTQPTDVEH_DRVRDMD_PROC_CORE1_10MS_NR1_PFC_ID" 38 "MOFTQPTDVEH_FIL_PROC_CORE1_10MS_NR1_PFC_ID" 29 "MOFTQPTDVEH_ONEPEDLDRVG_PROC_CORE1_10MS_NR1_PFC_ID" 15 "MOFTRSMASSC_GEARLVRCOORR_PROC_CORE1_10MS_NR1_PFC_ID" 33 "MOFTRSMASSC_TRSM_PROC_CORE1_10MS_NR1_PFC_ID" 11 "MOFVAR_POSTBLDSEL_PROC_CORE1_10MS_NR1_PFC_ID" 12 "MOFWDA_CO_PROC_CORE1_10MS_NR1_PFC_ID" 68 "MONEGYCHRGNCOORR_COORR_PROC_CORE1_10MS_NR1_PFC_ID" 69 "MONEGYCHRGNCOORR_INFO_PROC_CORE1_10MS_NR1_PFC_ID" 67 "MONEGYCHRGNCOORR_PREPROC_PROC_CORE1_10MS_NR1_PFC_ID" 71 "MONEGYCHRGNERRREACTN_COORR_PROC_CORE1_10MS_NR1_PFC_ID" 70 "MONEGYCHRGNIF_LVL1_PROC_CORE1_10MS_NR1_PFC_ID" 62 "MONEGYCHRGNINLET_INFO_PROC_CORE1_10MS_NR1_PFC_ID" 58 "MONEGYCHRGNINLET_INP_PROC_CORE1_10MS_NR1_PFC_ID" 61 "MONEGYCHRGNINLET_LOCK_PROC_CORE1_10MS_NR1_PFC_ID" 60 "MONEGYCHRGNINLET_PLG_PROC_CORE1_10MS_NR1_PFC_ID" 59 "MONEGYCHRGNINLET_PREPROC_PROC_CORE1_10MS_NR1_PFC_ID" 66 "MONEGYCHRGNT_INFO_PROC_CORE1_10MS_NR1_PFC_ID" 63 "MONEGYCHRGNT_INP_PROC_CORE1_10MS_NR1_PFC_ID" 65 "MONEGYCHRGNT_PLAUSSIG_PROC_CORE1_10MS_NR1_PFC_ID" 64 "MONEGYCHRGNT_PREPROC_PROC_CORE1_10MS_NR1_PFC_ID" 3 "MOSYSCTRL_CO_PROC_CORE1_10MS_NR1_PFC_ID" /end COMPU_VTAB
/begin COMPU_METHOD mOilAsh_g "" RAT_FUNC "%6.4" "g" COEFFS 0 100 0 0 0 1 /end COMPU_METHOD
/begin COMPU_METHOD Molmass "" RAT_FUNC "%6.4" "g/mol" COEFFS 0 100 0 0 0 1 /end COMPU_METHOD
/begin COMPU_METHOD MO_CMNDSLGSLSW_SC_Compu "" TAB_VERB "%6.3" "" COMPU_TAB_REF MO_CMNDSLGSLSW_SC_Compu /end COMPU_METHOD
/begin COMPU_VTAB MO_CMNDSLGSLSW_SC_Compu "" TAB_VERB 2 0 "False" 1 "True" /end COMPU_VTAB
/begin COMPU_METHOD MO_COMCUST_SC_Compu "" TAB_VERB "%6.3" "" COMPU_TAB_REF MO_COMCUST_SC_Compu /end COMPU_METHOD
/begin COMPU_VTAB MO_COMCUST_SC_Compu "" TAB_VERB 24 1 "PSA" 2 "HMC" 3 "CVP" 4 "NEVS" 5 "BMW" 6 "STREETSCOOTER" 7 "VOLVO" 8 "VW" 9 "JLR" 10 "DAIMLER" 11 "SUZUKI" 12 "EGO" 13 "BYTON" 14 "FCCU" 15 "RBCD" 16 "ISUZU" 17 "KAMAZ" 18 "TOGG" 19 "NAVISTAR" 20 "HONDA" 21 "MAN" 22 "NISSAN" 23 "RSA" 24 "NIKOLA" /end COMPU_VTAB
/begin COMPU_METHOD MO_EXTDTSK_SC_Compu "" TAB_VERB "%6.3" "" COMPU_TAB_REF MO_EXTDTSK_SC_Compu /end COMPU_METHOD
/begin COMPU_VTAB MO_EXTDTSK_SC_Compu "" TAB_VERB 4 0 "Disabled" 2 "2ms" 4 "4ms" 5 "5ms" /end COMPU_VTAB
/begin COMPU_METHOD MO_FRDMINTFRMETHOD_SC_Compu "" TAB_VERB "%6.3" "" COMPU_TAB_REF MO_FRDMINTFRMETHOD_SC_Compu /end COMPU_METHOD
/begin COMPU_VTAB MO_FRDMINTFRMETHOD_SC_Compu "" TAB_VERB 3 0 "CPL" 1 "MPU" 2 "CPL_MPU" /end COMPU_VTAB
/begin COMPU_METHOD MO_LBISTENA_SC_Compu "" TAB_VERB "%6.3" "" COMPU_TAB_REF MO_LBISTENA_SC_Compu /end COMPU_METHOD
/begin COMPU_VTAB MO_LBISTENA_SC_Compu "" TAB_VERB 2 0 "Disabled" 1 "Enabled" /end COMPU_VTAB
/begin COMPU_METHOD MO_MAXVALINDCR_SC_Compu "" TAB_VERB "%6.3" "" COMPU_TAB_REF MO_MAXVALINDCR_SC_Compu /end COMPU_METHOD
/begin COMPU_VTAB MO_MAXVALINDCR_SC_Compu "" TAB_VERB 2 0 "Disabled" 1 "Enabled" /end COMPU_VTAB
/begin COMPU_METHOD MO_NRSLOTS_SC_Compu "" RAT_FUNC "%6.2" "" COEFFS 0 1 0 0 0 1 /end COMPU_METHOD
/begin COMPU_METHOD MO_NRUSEDCORESFTY_SC_Compu "" TAB_VERB "%6.3" "" COMPU_TAB_REF MO_NRUSEDCORESFTY_SC_Compu /end COMPU_METHOD
/begin COMPU_VTAB MO_NRUSEDCORESFTY_SC_Compu "" TAB_VERB 15 1 "Core0" 2 "Core1" 3 "Core0_and_Core1" 4 "Core2" 5 "Core0_and_Core2" 6 "Core1_and_Core2" 7 "Core0_Core1_and_Core2" 8 "Core3" 9 "Core0_and_Core3" 10 "Core1_and_Core3" 11 "Core0_Core1_and_Core3" 12 "Core2_and_Core3" 13 "Core0_Core2_and_Core3" 14 "Core1_Core2_and_Core3" 15 "Core0_Core1_Core2_and_Core3" /end COMPU_VTAB
/begin COMPU_METHOD MO_RAMCHKTYP_SC_Compu "" TAB_VERB "%6.3" "" COMPU_TAB_REF MO_RAMCHKTYP_SC_Compu /end COMPU_METHOD
/begin COMPU_VTAB MO_RAMCHKTYP_SC_Compu "" TAB_VERB 2 1 "Default" 2 "MBIST" /end COMPU_VTAB
/begin COMPU_METHOD MO_ROM_SY_Compu "" TAB_VERB "%6.3" "" COMPU_TAB_REF MO_ROM_SY_Compu /end COMPU_METHOD
/begin COMPU_VTAB MO_ROM_SY_Compu "" TAB_VERB 2 0 "False" 1 "True" /end COMPU_VTAB
/begin COMPU_METHOD MO_VDD5MONHWTYP_SC_Compu "" TAB_VERB "%6.3" "" COMPU_TAB_REF MO_VDD5MONHWTYP_SC_Compu /end COMPU_METHOD
/begin COMPU_VTAB MO_VDD5MONHWTYP_SC_Compu "" TAB_VERB 2 0 "ASIC" 1 "DIPO_CIRC" /end COMPU_VTAB
/begin COMPU_METHOD MRly_stActDid_VERB "" TAB_VERB "%6.3" "" COMPU_TAB_REF MRly_stActDid_VERB /end COMPU_METHOD
/begin COMPU_VTAB MRly_stActDid_VERB "" TAB_VERB 3 0 "MRLY_ST_OPEN" 1 "MRLY_ST_CLOSED" 2 "MRLY_ST_STUCK_CLOSED" /end COMPU_VTAB
/begin COMPU_METHOD MRLY_STACTDSQENA_SC_Compu "" TAB_VERB "%6.3" "" COMPU_TAB_REF MRLY_STACTDSQENA_SC_Compu /end COMPU_METHOD
/begin COMPU_VTAB MRLY_STACTDSQENA_SC_Compu "" TAB_VERB 2 0 "Disabled" 1 "Enabled" /end COMPU_VTAB
/begin COMPU_METHOD mSoot_g "" RAT_FUNC "%6.4" "g" COEFFS 0 100 0 0 0 1 /end COMPU_METHOD
/begin COMPU_METHOD MsPerVol "" RAT_FUNC "%6.5" "g/l" COEFFS 0 1000 0 0 0 1 /end COMPU_METHOD
/begin COMPU_METHOD MsPrTime_mgprsec_q0p1_COMPU "" RAT_FUNC "%6.3" "mg/s" COEFFS 0 10 0 0 0 1 /end COMPU_METHOD
/begin COMPU_METHOD Ms_g_q0p001_COMPU "" RAT_FUNC "%6.5" "g" COEFFS 0 1000 0 0 0 1 /end COMPU_METHOD
/begin COMPU_METHOD Ms_kg_COMPU "" RAT_FUNC "%6.4" "kg" COEFFS 0 100 0 0 0 1 /end COMPU_METHOD
/begin COMPU_METHOD Ms_O2 "" RAT_FUNC "%6.5" "g" COEFFS 0 1000 0 0 0 1 /end COMPU_METHOD
/begin COMPU_METHOD Ms_SOx "" RAT_FUNC "%6.5" "g" COEFFS 0 3278.68852459016 0 0 0 1 /end COMPU_METHOD
/begin COMPU_METHOD Ms_SOxLdTot "" RAT_FUNC "%6.3" "mg" COEFFS 0 2 0 0 0 1 /end COMPU_METHOD
/begin COMPU_METHOD Ms_SOxNOx "" RAT_FUNC "%8.7" "g" COEFFS 0 100000 0 0 0 1 /end COMPU_METHOD
/begin COMPU_METHOD MULTIHSS_SC_Compu "" TAB_VERB "%6.3" "" COMPU_TAB_REF MULTIHSS_SC_Compu /end COMPU_METHOD
/begin COMPU_VTAB MULTIHSS_SC_Compu "" TAB_VERB 7 0 "no_MultiHss" 1 "one_MultiHss" 2 "two_MultiHss" 3 "three_MultiHss" 4 "four_MultiHss" 5 "five_MultiHss" 6 "six_MultiHss" /end COMPU_VTAB
/begin COMPU_METHOD M_NOxLd_LoRes "" RAT_FUNC "%6.4" "g" COEFFS 0 250 0 0 0 1 /end COMPU_METHOD
/begin COMPU_METHOD NmPerSec "" RAT_FUNC "%6.3" "Nm/s" COEFFS 0 10 0 0 0 1 /end COMPU_METHOD
/begin COMPU_METHOD NOREINI_SC_Compu "" TAB_VERB "%6.3" "" COMPU_TAB_REF NOREINI_SC_Compu /end COMPU_METHOD
/begin COMPU_VTAB NOREINI_SC_Compu "" TAB_VERB 2 0 "Reini" 1 "NoReini" /end COMPU_VTAB
/begin COMPU_METHOD nox "" RAT_FUNC "%6.2" "ppm" COEFFS 0 1 0 0 0 1 /end COMPU_METHOD
/begin COMPU_METHOD NOxFlwEG "" RAT_FUNC "%6.4" "Gram/s" COEFFS 0 40 0 0 0 1 /end COMPU_METHOD
/begin COMPU_METHOD NOxLdPerFl "" RAT_FUNC "%6.5" "1/l" COEFFS 0 8192 0 0 0 1 /end COMPU_METHOD
/begin COMPU_METHOD NOxMassFlw "" RAT_FUNC "%6.5" "mg/s" COEFFS 0 1000 0 0 0 1 /end COMPU_METHOD
/begin COMPU_METHOD NOxMassPerTime "" RAT_FUNC "%6.3" "mg/s" COEFFS 0 10 0 0 0 1 /end COMPU_METHOD
/begin COMPU_METHOD NSCRgn_Time_S "" RAT_FUNC "%6.4" "s" COEFFS 0 100 0 0 0 1 /end COMPU_METHOD
/begin COMPU_METHOD NSC_CT_SENSORS_SY_Compu "" TAB_VERB "%6.3" "" COMPU_TAB_REF NSC_CT_SENSORS_SY_Compu /end COMPU_METHOD
/begin COMPU_VTAB NSC_CT_SENSORS_SY_Compu "" TAB_VERB 5 0 "ZERO" 1 "ONE" 2 "TWO" 3 "THREE" 4 "FOUR" /end COMPU_VTAB
/begin COMPU_METHOD NUMCYLMAX_SY_Compu "" TAB_VERB "%6.3" "" COMPU_TAB_REF NUMCYLMAX_SY_Compu /end COMPU_METHOD
/begin COMPU_VTAB NUMCYLMAX_SY_Compu "" TAB_VERB 12 1 "ONE_CLYL" 2 "TWO_CYL" 3 "THREE_CYL" 4 "FOUR_CYL" 5 "FIVE_CYL" 6 "SIX_CYL" 7 "SEVEN_CYL" 8 "EIGHT_CYL" 10 "TEN_CYL" 12 "TWELVE_CYL" 16 "SIXTEEN_CYL" 24 "Twentyfour_CYL" /end COMPU_VTAB
/begin COMPU_METHOD NUMFANS_SY_Compu "" TAB_VERB "%6.3" "" COMPU_TAB_REF NUMFANS_SY_Compu /end COMPU_METHOD
/begin COMPU_VTAB NUMFANS_SY_Compu "" TAB_VERB 6 0 "0" 1 "1" 2 "2" 3 "3" 4 "4" 12 "12" /end COMPU_VTAB
/begin COMPU_METHOD NUMPSICCHP_SY_Compu "" TAB_VERB "%6.3" "" COMPU_TAB_REF NUMPSICCHP_SY_Compu /end COMPU_METHOD
/begin COMPU_VTAB NUMPSICCHP_SY_Compu "" TAB_VERB 5 1 "1" 2 "2" 3 "3" 4 "4" 5 "5" /end COMPU_VTAB
/begin COMPU_METHOD NUMVEHVSENS_SY_Compu "" RAT_FUNC "%6.2" "" COEFFS 0 1 0 0 0 1 /end COMPU_METHOD
/begin COMPU_METHOD O2 "" RAT_FUNC "%8.7" "-" COEFFS 0 100000 0 0 0 1 /end COMPU_METHOD
/begin COMPU_METHOD O2MassPerTime "" RAT_FUNC "%6.4" "Kg/h" COEFFS 0 100 0 0 0 1 /end COMPU_METHOD
/begin COMPU_METHOD O2MassPerTimeLo "" RAT_FUNC "%6.4" "Kg/h" COEFFS 0 50 0 0 0 1 /end COMPU_METHOD
/begin COMPU_METHOD OBD_PHYSMEDM_SY_Compu "" TAB_VERB "%6.3" "" COMPU_TAB_REF OBD_PHYSMEDM_SY_Compu /end COMPU_METHOD
/begin COMPU_VTAB OBD_PHYSMEDM_SY_Compu "" TAB_VERB 2 0 "OBD_PHYSMEDM_CAN" 1 "OBD_PHYSMEDM_KLINE" /end COMPU_VTAB
/begin COMPU_METHOD OBS_SY_Compu "" TAB_VERB "%6.3" "" COMPU_TAB_REF OBS_SY_Compu /end COMPU_METHOD
/begin COMPU_VTAB OBS_SY_Compu "" TAB_VERB 2 0 "NOOBS" 1 "SMP480" /end COMPU_VTAB
/begin COMPU_METHOD OILCOOLRDST_TYPAVL_SC_Compu "" TAB_VERB "%6.3" "" COMPU_TAB_REF OILCOOLRDST_TYPAVL_SC_Compu /end COMPU_METHOD
/begin COMPU_VTAB OILCOOLRDST_TYPAVL_SC_Compu "" TAB_VERB 2 0 "False" 1 "True" /end COMPU_VTAB
/begin COMPU_METHOD OILGLRYT_TYPAVL_SC_Compu "" TAB_VERB "%6.3" "" COMPU_TAB_REF OILGLRYT_TYPAVL_SC_Compu /end COMPU_METHOD
/begin COMPU_VTAB OILGLRYT_TYPAVL_SC_Compu "" TAB_VERB 2 0 "False" 1 "True" /end COMPU_VTAB
/begin COMPU_METHOD OilMassPerTime "" RAT_FUNC "%7.6" "mg/s" COEFFS 0 10000 0 0 0 1 /end COMPU_METHOD
/begin COMPU_METHOD OilMassPerTimeLo "" RAT_FUNC "%6.4" "mg/s" COEFFS 0 500 0 0 0 1 /end COMPU_METHOD
/begin COMPU_METHOD OilMFl_mgps_q0p1 "" RAT_FUNC "%6.3" "mg/s" COEFFS 0 10 0 0 0 1 /end COMPU_METHOD
/begin COMPU_METHOD OilMsPrc_q0p01 "" RAT_FUNC "%6.4" "%" COEFFS 0 100 0 0 0 1 /end COMPU_METHOD
/begin COMPU_METHOD OilMs_mg "" RAT_FUNC "%6.2" "mg" COEFFS 0 1 0 0 0 1 /end COMPU_METHOD
/begin COMPU_METHOD OilMs_q0p1 "" RAT_FUNC "%6.3" "g" COEFFS 0 10 0 0 0 1 /end COMPU_METHOD
/begin COMPU_METHOD OilMs_q10 "" RAT_FUNC "%6.1" "g" COEFFS 0 0.1 0 0 0 1 /end COMPU_METHOD
/begin COMPU_METHOD OILP_TYPAVL_SY_Compu "" TAB_VERB "%6.3" "" COMPU_TAB_REF OILP_TYPAVL_SY_Compu /end COMPU_METHOD
/begin COMPU_VTAB OILP_TYPAVL_SY_Compu "" TAB_VERB 2 0 "False" 1 "True" /end COMPU_VTAB
/begin COMPU_METHOD OILSWMPT_TYPAVL_SC_Compu "" TAB_VERB "%6.3" "" COMPU_TAB_REF OILSWMPT_TYPAVL_SC_Compu /end COMPU_METHOD
/begin COMPU_VTAB OILSWMPT_TYPAVL_SC_Compu "" TAB_VERB 2 0 "False" 1 "True" /end COMPU_VTAB
/begin COMPU_METHOD OILT_TYPAVL_SY_Compu "" TAB_VERB "%6.3" "" COMPU_TAB_REF OILT_TYPAVL_SY_Compu /end COMPU_METHOD
/begin COMPU_VTAB OILT_TYPAVL_SY_Compu "" TAB_VERB 2 0 "False" 1 "True" /end COMPU_VTAB
/begin COMPU_METHOD Oil_lvl_mm_q0p004 "" RAT_FUNC "%6.4" "mm" COEFFS 0 250 0 0 0 1 /end COMPU_METHOD
/begin COMPU_METHOD OneToOne "" RAT_FUNC "%6.2" "-" COEFFS 0 1 0 0 0 1 /end COMPU_METHOD
/begin COMPU_METHOD PAIRFLTDSPRS_SY_Compu "" TAB_VERB "%6.3" "" COMPU_TAB_REF PAIRFLTDSPRS_SY_Compu /end COMPU_METHOD
/begin COMPU_VTAB PAIRFLTDSPRS_SY_Compu "" TAB_VERB 2 0 "False" 1 "True" /end COMPU_VTAB
/begin COMPU_METHOD PAIRFLTDS_TYPAVL_SY_Compu "" TAB_VERB "%6.3" "" COMPU_TAB_REF PAIRFLTDS_TYPAVL_SY_Compu /end COMPU_METHOD
/begin COMPU_VTAB PAIRFLTDS_TYPAVL_SY_Compu "" TAB_VERB 2 0 "False" 1 "True" /end COMPU_VTAB
/begin COMPU_METHOD PASSDOORRDNT_TYPAVL_SC_Compu "" TAB_VERB "%6.3" "" COMPU_TAB_REF PASSDOORRDNT_TYPAVL_SC_Compu /end COMPU_METHOD
/begin COMPU_VTAB PASSDOORRDNT_TYPAVL_SC_Compu "" TAB_VERB 2 0 "False" 1 "True" /end COMPU_VTAB
/begin COMPU_METHOD PCMPRUSSENS_SY_Compu "" TAB_VERB "%6.3" "" COMPU_TAB_REF PCMPRUSSENS_SY_Compu /end COMPU_METHOD
/begin COMPU_VTAB PCMPRUSSENS_SY_Compu "" TAB_VERB 2 0 "False" 1 "True" /end COMPU_VTAB
/begin COMPU_METHOD PENVPRSNT_SC_Compu "" TAB_VERB "%6.3" "" COMPU_TAB_REF PENVPRSNT_SC_Compu /end COMPU_METHOD
/begin COMPU_VTAB PENVPRSNT_SC_Compu "" TAB_VERB 2 0 "False" 1 "True" /end COMPU_VTAB
/begin COMPU_METHOD PENVREJHIVALERR_SC_Compu "" TAB_VERB "%6.3" "" COMPU_TAB_REF PENVREJHIVALERR_SC_Compu /end COMPU_METHOD
/begin COMPU_VTAB PENVREJHIVALERR_SC_Compu "" TAB_VERB 2 0 "Disable" 1 "Enable" /end COMPU_VTAB
/begin COMPU_METHOD Prc "" RAT_FUNC "%6.4" "%" COEFFS 0 81.92 0 0 0 1 /end COMPU_METHOD
/begin COMPU_METHOD Pres_hPa "" RAT_FUNC "%6.2" "hPa" COEFFS 0 1 0 0 0 1 /end COMPU_METHOD
/begin COMPU_METHOD q1p220703Em4_kg_DIV_s "" RAT_FUNC "%6.5" "kg/s" COEFFS 0 10000000000000 0 0 0 1220703125 /end COMPU_METHOD
/begin COMPU_METHOD q1p52588Em3_DegCgrd_DIV_s "" RAT_FUNC "%6.4" "deg C/s" COEFFS 0 100000000 0 0 0 152587.8906 /end COMPU_METHOD
/begin COMPU_METHOD q5p96046Em5_V_DIV_s "" RAT_FUNC "%7.6" "V/s" COEFFS 0 100000000 0 0 0 5960.464478 /end COMPU_METHOD
/begin COMPU_METHOD RBPtCel_Perc_0p012207_1 "" RAT_FUNC "%6.4" "%" COEFFS 0 81.92 0 0 0 1 /end COMPU_METHOD
/begin COMPU_METHOD RBPtCel_p_0p1_4 "" RAT_FUNC "%6.3" "hPa" COEFFS 0 10 0 0 0 1 /end COMPU_METHOD
/begin COMPU_METHOD RBPtCel_ti_0p01_1 "" RAT_FUNC "%6.4" "s" COEFFS 0 100 0 0 0 1 /end COMPU_METHOD
/begin COMPU_METHOD RBPtCel_ti_0p4_1 "" RAT_FUNC "%6.3" "us" COEFFS 0 5 0 0 0 2 /end COMPU_METHOD
/begin COMPU_METHOD RBPtCel_ti_10p0_1 "" RAT_FUNC "%6.1" "ms" COEFFS 0 1 0 0 0 10 /end COMPU_METHOD
/begin COMPU_METHOD RBPtCel_ti_10p0_3 "" RAT_FUNC "%6.1" "s" COEFFS 0 1 0 0 0 10 /end COMPU_METHOD
/begin COMPU_METHOD RBPtCel_ti_5p12em4_1 "" RAT_FUNC "%6.5" "s" COEFFS 0 15625 0 0 0 8 /end COMPU_METHOD
/begin COMPU_METHOD RBPtCel_u_0p2_1 "" RAT_FUNC "%6.3" "mV" COEFFS 0 5 0 0 0 1 /end COMPU_METHOD
/begin COMPU_METHOD rel_q0p0078125 "" RAT_FUNC "%6.4" "%" COEFFS 0 128 0 0 0 1 /end COMPU_METHOD
/begin COMPU_METHOD rel_q1 "" RAT_FUNC "%6.2" "%" COEFFS 0 1 0 0 0 1 /end COMPU_METHOD
/begin COMPU_METHOD RmpPrc "" RAT_FUNC "%6.5" "%/s" COEFFS 0 5368.70912 0 0 0 1 /end COMPU_METHOD
/begin COMPU_METHOD SigQly_COMPU_VERB "" TAB_VERB "%6.3" "" COMPU_TAB_REF SigQly_COMPU_VERB /end COMPU_METHOD
/begin COMPU_VTAB SigQly_COMPU_VERB "" TAB_VERB 16 0 "SIGQLY_NOTCALC" 1 "SIGQLY_INIT" 2 "SIGQLY_OK" 3 "SIGQLY_MODEL" 4 "SIGQLY_REPLACEMENT" 5 "SIGQLY_FROZEN" 6 "SIGQLY_INVALID" 7 "SIGQLY_RESERVED_7" 8 "SIGQLY_RESERVED_8" 9 "SIGQLY_RESERVED_9" 10 "SIGQLY_RESERVED_10" 11 "SIGQLY_RESERVED_11" 12 "SIGQLY_RESERVED_12" 13 "SIGQLY_RESERVED_13" 14 "SIGQLY_RESERVED_14" 15 "SIGQLY_RESERVED_15" /end COMPU_VTAB
/begin COMPU_METHOD spg_q0p0039 "" RAT_FUNC "%6.4" "V" COEFFS 0 256 0 0 0 1 /end COMPU_METHOD
/begin COMPU_METHOD spg_q0p00977 "" RAT_FUNC "%6.4" "V" COEFFS 0 256 0 0 0 2.5 /end COMPU_METHOD
/begin COMPU_METHOD spg_q4p88_mV "" RAT_FUNC "%6.2" "mV" COEFFS 0 1024 0 0 0 5000 /end COMPU_METHOD
/begin COMPU_METHOD St1StsDF0ASrv_VERB "" TAB_VERB "%6.3" "" COMPU_TAB_REF St1StsDF0ASrv_VERB /end COMPU_METHOD
/begin COMPU_VTAB St1StsDF0ASrv_VERB "" TAB_VERB 4 0 "DEFAULT_STATE" 1 "STATE1_STARTED" 2 "STATE1_FRAME_TRANSMITTED" 3 "STATE1_SUCCESSFULL" /end COMPU_VTAB
/begin COMPU_METHOD St2StsDF0ASrv_VERB "" TAB_VERB "%6.3" "" COMPU_TAB_REF St2StsDF0ASrv_VERB /end COMPU_METHOD
/begin COMPU_VTAB St2StsDF0ASrv_VERB "" TAB_VERB 9 0 "DEFAULT_STATE" 1 "STATE2_FRAME_NOT_RECEIVED" 2 "STATE2_RUNNING_NO_NEW_FRAME_RECEIVED" 3 "STATE2_VALID_FRAME_RECEIVED" 4 "STATE2_INVALID_FRAME_RECEIVED" 5 "STATE2_EEP_READ_PENDING" 6 "STATE2_FRAME_TRANSMITTED" 7 "STATE2_EEP_READ_UNSUCCESSFULL" 8 "STATE2_SUCCESSFULL" /end COMPU_VTAB
/begin COMPU_METHOD t200msxs_ub_b51 "" RAT_FUNC "%6.3" "s" COEFFS 0 1 0 0 0 0.2 /end COMPU_METHOD
/begin COMPU_METHOD t20ms_ub_b5100 "" RAT_FUNC "%7.2" "ms" COEFFS 0 1 0 0 0 20 /end COMPU_METHOD
/begin COMPU_METHOD t50msxs_q0p05 "" RAT_FUNC "%6.4" "s" COEFFS 0 1 0 0 0 0.05 /end COMPU_METHOD
/begin COMPU_METHOD Temp_Cels "" RAT_FUNC "%6.1" "deg C" COEFFS 0 10 2731.4 0 0 1 /end COMPU_METHOD
/begin COMPU_METHOD TimeDelay_s "" RAT_FUNC "%6.1" "s" COEFFS 0 0 1 0 0.00023283064365387 0 /end COMPU_METHOD
/begin COMPU_METHOD Time_ms "" RAT_FUNC "%6.1" "ms" COEFFS 0 0.1 0 0 0 1 /end COMPU_METHOD
/begin COMPU_METHOD Time_s "" RAT_FUNC "%6.4" "s" COEFFS 0 100 0 0 0 1 /end COMPU_METHOD
/begin COMPU_METHOD Time_sec_q1_COMPU "" RAT_FUNC "%6.2" "s" COEFFS 0 1 0 0 0 1 /end COMPU_METHOD
/begin COMPU_METHOD Time_usec_q1_COMPU "" RAT_FUNC "%6.2" "us" COEFFS 0 1 0 0 0 1 /end COMPU_METHOD
/begin COMPU_METHOD TiSec_q0p1_COMPU "" RAT_FUNC "%6.3" "s" COEFFS 0 10 0 0 0 1 /end COMPU_METHOD
/begin COMPU_METHOD t_q0p1 "" RAT_FUNC "%6.3" "s" COEFFS 0 10 0 0 0 1 /end COMPU_METHOD
/begin COMPU_METHOD Vel "" RAT_FUNC "%6.4" "km/h" COEFFS 0 100 0 0 0 1 /end COMPU_METHOD
/begin COMPU_METHOD Volt_Batt "" RAT_FUNC "%6.1" "mV" COEFFS 0 0.05 0 0 0 1 /end COMPU_METHOD
/begin COMPU_METHOD default "" RAT_FUNC "%6.2" "" COEFFS 0 1 0 0 0 1 /end COMPU_METHOD
/begin RECORD_LAYOUT RB_Curve_S16_S16 NO_AXIS_PTS_X 1 SWORD AXIS_PTS_X 2 SWORD INDEX_INCR DIRECT FNC_VALUES 3 SWORD COLUMN_DIR DIRECT /end RECORD_LAYOUT
/begin RECORD_LAYOUT RB_Curve_U8_S16_sao NO_AXIS_PTS_X 1 UBYTE AXIS_PTS_X 2 UBYTE INDEX_INCR DIRECT FNC_VALUES 3 SWORD COLUMN_DIR DIRECT STATIC_ADDRESS_OFFSETS /end RECORD_LAYOUT
/begin RECORD_LAYOUT RB_Map_S16S16_S16 NO_AXIS_PTS_X 1 SWORD NO_AXIS_PTS_Y 2 SWORD AXIS_PTS_X 3 SWORD INDEX_INCR DIRECT AXIS_PTS_Y 4 SWORD INDEX_INCR DIRECT FNC_VALUES 5 SWORD COLUMN_DIR DIRECT /end RECORD_LAYOUT
/begin RECORD_LAYOUT RB_Map_S16S16_U16_sao NO_AXIS_PTS_X 1 SWORD NO_AXIS_PTS_Y 2 SWORD AXIS_PTS_X 3 SWORD INDEX_INCR DIRECT AXIS_PTS_Y 4 SWORD INDEX_INCR DIRECT FNC_VALUES 5 UWORD COLUMN_DIR DIRECT STATIC_ADDRESS_OFFSETS /end RECORD_LAYOUT
/begin RECORD_LAYOUT RB_Val_Ws16 FNC_VALUES 1 SWORD COLUMN_DIR DIRECT /end RECORD_LAYOUT
/begin RECORD_LAYOUT RB_Val_Wu16 FNC_VALUES 1 UWORD COLUMN_DIR DIRECT /end RECORD_LAYOUT
/begin RECORD_LAYOUT RB_Val_Wu32 FNC_VALUES 1 ULONG COLUMN_DIR DIRECT /end RECORD_LAYOUT
/begin RECORD_LAYOUT RB_Val_Wu8 FNC_VALUES 1 UBYTE COLUMN_DIR DIRECT /end RECORD_LAYOUT
/begin RECORD_LAYOUT ValA_Wu16 FNC_VALUES 1 UWORD COLUMN_DIR DIRECT /end RECORD_LAYOUT
/begin RECORD_LAYOUT ValA_Wu32 FNC_VALUES 1 ULONG COLUMN_DIR DIRECT /end RECORD_LAYOUT
/begin RECORD_LAYOUT Val_Ws16 FNC_VALUES 1 SWORD COLUMN_DIR DIRECT /end RECORD_LAYOUT
/begin RECORD_LAYOUT Val_Ws32 FNC_VALUES 1 SLONG COLUMN_DIR DIRECT /end RECORD_LAYOUT
/begin RECORD_LAYOUT Val_Wu16 FNC_VALUES 1 UWORD COLUMN_DIR DIRECT /end RECORD_LAYOUT
/begin RECORD_LAYOUT Val_Wu32 FNC_VALUES 1 ULONG COLUMN_DIR DIRECT /end RECORD_LAYOUT
/begin RECORD_LAYOUT Val_Wu8 FNC_VALUES 1 UBYTE COLUMN_DIR DIRECT /end RECORD_LAYOUT
/end MODULE
/end PROJECT

/*-- Generated by A2L Merger 4.4.0 --*/
/* Created by DAMOS++ V5.8.21 WinServer 2016 */
ASAP2_VERSION 1 70
/begin PROJECT MDG1C "VC1CP091_STLA_N_D061I3"
/begin HEADER "" VERSION "VC1CP091_STLA_N_D061I3" PROJECT_NO MDG1C /end HEADER
/begin MODULE DIM ""
/begin MOD_PAR "VC1CP091_STLA_N_D061I3" VERSION "VC1CP091_STLA_N_D061I3" ADDR_EPK 0x80240228 EPK "57/1/VC1CP091_IFX3_40/14/MDG1C//VC1CP091_STLA_N_D061I3///" CUSTOMER_NO "14" USER "" PHONE_NO "" ECU "VC1CP091_IFX3_40" CPU_TYPE "IFX"
 /begin MEMORY_SEGMENT Pst80000000 "" RESERVED FLASH INTERN 0x80000000 0x20 -1 -1 -1 -1 -1 /end MEMORY_SEGMENT
 /begin MEMORY_SEGMENT Pst80000020 "" RESERVED FLASH INTERN 0x80000020 0xFFE0 -1 -1 -1 -1 -1 /end MEMORY_SEGMENT
 /begin MEMORY_SEGMENT Pst80050000 "" CODE FLASH INTERN 0x80050000 0x30000 -1 -1 -1 -1 -1
  /begin IF_DATA ETK_XETK
   /begin ETK_XETK_ACCESS SERIAL_INTERFACE /end ETK_XETK_ACCESS
  /end IF_DATA
 /end MEMORY_SEGMENT
 /begin MEMORY_SEGMENT Pst80080000 "" CODE FLASH INTERN 0x80080000 0x1BFAE0 -1 -1 -1 -1 -1
  /begin IF_DATA ETK_XETK
   /begin ETK_XETK_ACCESS SERIAL_INTERFACE /end ETK_XETK_ACCESS
  /end IF_DATA
 /end MEMORY_SEGMENT
 /begin MEMORY_SEGMENT Pst8023FAE0 "" RESERVED FLASH INTERN 0x8023FAE0 0x520 -1 -1 -1 -1 -1 /end MEMORY_SEGMENT
 /begin MEMORY_SEGMENT Pst8033FAE0 "" RESERVED FLASH INTERN 0x8033FAE0 0x520 -1 -1 -1 -1 -1
  /begin IF_DATA ETK_XETK WRITE_AT_DATA_UPDATE USE_FILE ETK_XETK_REF 1 2 3 4 5 7 8 /end IF_DATA
 /end MEMORY_SEGMENT
 /begin MEMORY_SEGMENT Pst80340000 "" CODE FLASH INTERN 0x80340000 0x2BFAE0 -1 -1 -1 -1 -1
  /begin IF_DATA ETK_XETK
   /begin ETK_XETK_ACCESS SERIAL_INTERFACE /end ETK_XETK_ACCESS
  /end IF_DATA
 /end MEMORY_SEGMENT
 /begin MEMORY_SEGMENT Pst805FFAE0 "" RESERVED FLASH INTERN 0x805FFAE0 0x520 -1 -1 -1 -1 -1 /end MEMORY_SEGMENT
 /begin MEMORY_SEGMENT Dst80240000 "" DATA FLASH INTERN 0x80240000 0xFFAE0 -1 -1 -1 -1 -1
  /begin IF_DATA ETK_XETK
   /begin ETK_XETK_ACCESS SERIAL_INTERFACE /end ETK_XETK_ACCESS
  /end IF_DATA
  /begin IF_DATA XCPplus 0x0102
   /begin SEGMENT 7 0x02 0x00 0x00 0x00
    /begin CHECKSUM XCP_CRC_32 /* checksum: add bytes to 16bit result */ MAX_BLOCK_SIZE 0xFFFFFFFF /end CHECKSUM
    /begin PAGE 0x00 /* page number */ ECU_ACCESS_DONT_CARE XCP_READ_ACCESS_DONT_CARE XCP_WRITE_ACCESS_NOT_ALLOWED /end PAGE
    /begin PAGE 0x01 /* page number */ ECU_ACCESS_DONT_CARE XCP_READ_ACCESS_DONT_CARE XCP_WRITE_ACCESS_WITH_ECU_ONLY /end PAGE
   /end SEGMENT
  /end IF_DATA
 /end MEMORY_SEGMENT
 /begin MEMORY_SEGMENT RamF0138000 "" VARIABLES RAM INTERN 0xF0138000 0x2FFD -1 -1 -1 -1 -1
  /begin IF_DATA ETK_XETK
   /begin ETK_XETK_ACCESS SERIAL_INTERFACE /end ETK_XETK_ACCESS
  /end IF_DATA
  /begin IF_DATA XCPplus 0x0102
   /begin SEGMENT 0 0x00 0x00 0x00 0x00 /end SEGMENT
  /end IF_DATA
 /end MEMORY_SEGMENT
 /begin MEMORY_SEGMENT RamF0140000 "" VARIABLES RAM INTERN 0xF0140000 0x2FFD -1 -1 -1 -1 -1
  /begin IF_DATA ETK_XETK
   /begin ETK_XETK_ACCESS SERIAL_INTERFACE /end ETK_XETK_ACCESS
  /end IF_DATA
  /begin IF_DATA XCPplus 0x0102
   /begin SEGMENT 1 0x00 0x00 0x00 0x00 /end SEGMENT
  /end IF_DATA
 /end MEMORY_SEGMENT
 /begin MEMORY_SEGMENT RamF0148000 "" VARIABLES RAM INTERN 0xF0148000 0x2FFD -1 -1 -1 -1 -1
  /begin IF_DATA ETK_XETK
   /begin ETK_XETK_ACCESS SERIAL_INTERFACE /end ETK_XETK_ACCESS
  /end IF_DATA
  /begin IF_DATA XCPplus 0x0102
   /begin SEGMENT 2 0x00 0x00 0x00 0x00 /end SEGMENT
  /end IF_DATA
 /end MEMORY_SEGMENT
 /begin MEMORY_SEGMENT RamF0150000 "" VARIABLES RAM INTERN 0xF0150000 0x2FFD -1 -1 -1 -1 -1
  /begin IF_DATA ETK_XETK
   /begin ETK_XETK_ACCESS SERIAL_INTERFACE /end ETK_XETK_ACCESS
  /end IF_DATA
  /begin IF_DATA XCPplus 0x0102
   /begin SEGMENT 3 0x00 0x00 0x00 0x00 /end SEGMENT
  /end IF_DATA
 /end MEMORY_SEGMENT
 /begin MEMORY_SEGMENT RamF0158000 "" VARIABLES RAM INTERN 0xF0158000 0x2FFD -1 -1 -1 -1 -1
  /begin IF_DATA ETK_XETK
   /begin ETK_XETK_ACCESS SERIAL_INTERFACE /end ETK_XETK_ACCESS
  /end IF_DATA
  /begin IF_DATA XCPplus 0x0102
   /begin SEGMENT 4 0x00 0x00 0x00 0x00 /end SEGMENT
  /end IF_DATA
 /end MEMORY_SEGMENT
 /begin MEMORY_SEGMENT RamAFE00000 "" VARIABLES RAM INTERN 0xAFE00000 0x80000 -1 -1 -1 -1 -1
  /begin IF_DATA ETK_XETK
   /begin ETK_XETK_ACCESS SERIAL_INTERFACE /end ETK_XETK_ACCESS
  /end IF_DATA
  /begin IF_DATA XCPplus 0x0102
   /begin SEGMENT 9 0x00 0x00 0x00 0x00 /end SEGMENT
  /end IF_DATA
 /end MEMORY_SEGMENT
 /begin MEMORY_SEGMENT Ram70100000 "" VARIABLES RAM INTERN 0x70100000 0x10000 -1 -1 -1 -1 -1
  /begin IF_DATA ETK_XETK
   /begin ETK_XETK_ACCESS SERIAL_INTERFACE /end ETK_XETK_ACCESS
  /end IF_DATA
  /begin IF_DATA XCPplus 0x0102
   /begin SEGMENT 10 0x00 0x00 0x00 0x00 /end SEGMENT
  /end IF_DATA
 /end MEMORY_SEGMENT
 /begin MEMORY_SEGMENT Ram60100000 "" VARIABLES RAM INTERN 0x60100000 0x10000 -1 -1 -1 -1 -1
  /begin IF_DATA ETK_XETK
   /begin ETK_XETK_ACCESS SERIAL_INTERFACE /end ETK_XETK_ACCESS
  /end IF_DATA
  /begin IF_DATA XCPplus 0x0102
   /begin SEGMENT 11 0x00 0x00 0x00 0x00 /end SEGMENT
  /end IF_DATA
 /end MEMORY_SEGMENT
 /begin MEMORY_SEGMENT Ram50100000 "" VARIABLES RAM INTERN 0x50100000 0x10000 -1 -1 -1 -1 -1
  /begin IF_DATA ETK_XETK
   /begin ETK_XETK_ACCESS SERIAL_INTERFACE /end ETK_XETK_ACCESS
  /end IF_DATA
  /begin IF_DATA XCPplus 0x0102
   /begin SEGMENT 12 0x00 0x00 0x00 0x00 /end SEGMENT
  /end IF_DATA
 /end MEMORY_SEGMENT
 /begin MEMORY_SEGMENT Ram70000000 "" VARIABLES RAM INTERN 0x70000000 0x3C000 -1 -1 -1 -1 -1
  /begin IF_DATA ETK_XETK
   /begin ETK_XETK_ACCESS SERIAL_INTERFACE /end ETK_XETK_ACCESS
  /end IF_DATA
  /begin IF_DATA XCPplus 0x0102
   /begin SEGMENT 13 0x00 0x00 0x00 0x00 /end SEGMENT
  /end IF_DATA
 /end MEMORY_SEGMENT
 /begin MEMORY_SEGMENT Ram60000000 "" VARIABLES RAM INTERN 0x60000000 0x3C000 -1 -1 -1 -1 -1
  /begin IF_DATA ETK_XETK
   /begin ETK_XETK_ACCESS SERIAL_INTERFACE /end ETK_XETK_ACCESS
  /end IF_DATA
  /begin IF_DATA XCPplus 0x0102
   /begin SEGMENT 14 0x00 0x00 0x00 0x00 /end SEGMENT
  /end IF_DATA
 /end MEMORY_SEGMENT
 /begin MEMORY_SEGMENT Ram50000000 "" VARIABLES RAM INTERN 0x50000000 0x18000 -1 -1 -1 -1 -1
  /begin IF_DATA ETK_XETK
   /begin ETK_XETK_ACCESS SERIAL_INTERFACE /end ETK_XETK_ACCESS
  /end IF_DATA
  /begin IF_DATA XCPplus 0x0102
   /begin SEGMENT 15 0x00 0x00 0x00 0x00 /end SEGMENT
  /end IF_DATA
 /end MEMORY_SEGMENT
 /begin MEMORY_SEGMENT RamB0000000 "" VARIABLES RAM INTERN 0xB0000000 0x10000 -1 -1 -1 -1 -1
  /begin IF_DATA ETK_XETK
   /begin ETK_XETK_ACCESS SERIAL_INTERFACE /end ETK_XETK_ACCESS
  /end IF_DATA
  /begin IF_DATA XCPplus 0x0102
   /begin SEGMENT 16 0x00 0x00 0x00 0x00 /end SEGMENT
  /end IF_DATA
 /end MEMORY_SEGMENT
 /begin MEMORY_SEGMENT RamB0010000 "" VARIABLES RAM INTERN 0xB0010000 0x10000 -1 -1 -1 -1 -1
  /begin IF_DATA ETK_XETK
   /begin ETK_XETK_ACCESS SERIAL_INTERFACE /end ETK_XETK_ACCESS
  /end IF_DATA
  /begin IF_DATA XCPplus 0x0102
   /begin SEGMENT 17 0x00 0x00 0x00 0x00 /end SEGMENT
  /end IF_DATA
 /end MEMORY_SEGMENT
 /begin MEMORY_SEGMENT RamB0020000 "" VARIABLES RAM INTERN 0xB0020000 0x10000 -1 -1 -1 -1 -1
  /begin IF_DATA ETK_XETK
   /begin ETK_XETK_ACCESS SERIAL_INTERFACE /end ETK_XETK_ACCESS
  /end IF_DATA
  /begin IF_DATA XCPplus 0x0102
   /begin SEGMENT 18 0x00 0x00 0x00 0x00 /end SEGMENT
  /end IF_DATA
 /end MEMORY_SEGMENT
 /begin MEMORY_SEGMENT RamB0400000 "" VARIABLES RAM INTERN 0xB0400000 0x8000 -1 -1 -1 -1 -1
  /begin IF_DATA ETK_XETK
   /begin ETK_XETK_ACCESS SERIAL_INTERFACE /end ETK_XETK_ACCESS
  /end IF_DATA
  /begin IF_DATA XCPplus 0x0102
   /begin SEGMENT 19 0x00 0x00 0x00 0x00 /end SEGMENT
  /end IF_DATA
 /end MEMORY_SEGMENT
 /begin MEMORY_SEGMENT RamB92F5560 "" VARIABLES RAM INTERN 0xB92F5560 0xAAA0 -1 -1 -1 -1 -1
  /begin IF_DATA ETK_XETK
   /begin ETK_XETK_ACCESS SERIAL_INTERFACE /end ETK_XETK_ACCESS
  /end IF_DATA
  /begin IF_DATA XCPplus 0x0102
   /begin SEGMENT 20 0x00 0x00 0x00 0x00 /end SEGMENT
  /end IF_DATA
 /end MEMORY_SEGMENT
 /begin MEMORY_SEGMENT RamB92E0000 "" CALIBRATION_VARIABLES RAM INTERN 0xB92E0000 0x15560 -1 -1 -1 -1 -1
  /begin IF_DATA ETK_XETK
   /begin ETK_XETK_ACCESS SERIAL_INTERFACE /end ETK_XETK_ACCESS
  /end IF_DATA
  /begin IF_DATA XCPplus 0x0102
   /begin SEGMENT 21 0x00 0x00 0x00 0x00 /end SEGMENT
  /end IF_DATA
 /end MEMORY_SEGMENT
 /begin CALIBRATION_METHOD /* name calibration methode */ "DataSetId" /* version calibration metode */ 256 /begin CALIBRATION_HANDLE /* adr data set id characteristic */ 0x80254938 /end CALIBRATION_HANDLE /end CALIBRATION_METHOD
 /begin CALIBRATION_METHOD /* Method name */ "ReconfigurableSizeMoveableEmuRAM" /* Method version */ 1
  /begin CALIBRATION_HANDLE /* Handle Range Lower */ 0 /* Handle Range Upper */ 31 /* Page Size (min) */ 0x20 /* Page Size (max) */ 0x20000 /* Number of EnumRanges */ 1 /* Emu RAM start address */ 0xB9000000 /* Emu RAM size */ 0x2E0000 /end CALIBRATION_HANDLE
 /end CALIBRATION_METHOD
 /begin CALIBRATION_METHOD /* Method name */ "EmuNonVolatileRam" /* Method version */ 1
  /begin CALIBRATION_HANDLE /* ENV RAM start address */ 0x60034928 /* ENV RAM size */ 0x2800 /end CALIBRATION_HANDLE
 /end CALIBRATION_METHOD
 SYSTEM_CONSTANT "ACCHI_RES" "0.0001"
 SYSTEM_CONSTANT "EXTERNAL HEXFILE POST TREATMENT NAME" "hpt_hexmodX_v820.dll"
 SYSTEM_CONSTANT "EXTERNAL HEXFILE POST TREATMENT PARAMETER" "BLK_START=0x80000020"
 SYSTEM_CONSTANT "ACCHRGNPWRSTGCTRL_TYPAVL_SC" "0"
 SYSTEM_CONSTANT "ACCHRGRINTKT_TYPAVL_SC" "1"
 SYSTEM_CONSTANT "ACCLNTP_SENSTYP_SY" "0"
 SYSTEM_CONSTANT "ACCPED_VEL_INTPOL" "1"
 SYSTEM_CONSTANT "ACCPED_VN_INTPOL" "0"
 SYSTEM_CONSTANT "ACC_SY" "0"
 SYSTEM_CONSTANT "ACTRLIB_IINITSPEZIAL_SY" "0"
 SYSTEM_CONSTANT "ACTRPWRSTGDRVR_SWTCONF_DIGOUT_BP" "3"
 SYSTEM_CONSTANT "ACTRPWRSTGDRVR_SWTCONF_ENA_BP" "0"
 SYSTEM_CONSTANT "ACTRPWRSTGDRVR_SWTCONF_HALFBRDGOUT_BP" "1"
 SYSTEM_CONSTANT "ACTRPWRSTGDRVR_SWTCONF_PWMOUT_BP" "2"
 SYSTEM_CONSTANT "ACTRPWRSTGDRVR_SWTCONF_PWMPINSHARE_BP" "4"
 SYSTEM_CONSTANT "ACTR_ACTVN_ALWYS_BP" "0"
 SYSTEM_CONSTANT "ACTR_ACTVN_DRIVE_BP" "3"
 SYSTEM_CONSTANT "ACTR_ACTVN_T15_BP" "1"
 SYSTEM_CONSTANT "ACTR_ACTVN_WAKEUP_BP" "2"
 SYSTEM_CONSTANT "ACTR_DEACTVN_POSTDRIVE_BP" "1"
 SYSTEM_CONSTANT "ACTR_DEACTVN_PREDRIVE_BP" "0"
 SYSTEM_CONSTANT "ACTR_DEACTVN_PWRSTGENACOND_BP" "5"
 SYSTEM_CONSTANT "ACTYP_MECHELEC" "4"
 SYSTEM_CONSTANT "ACTYP_SY" "3"
 SYSTEM_CONSTANT "AC_DEMAND_SY" "1"
 SYSTEM_CONSTANT "ADASUSG_PESLONG_SC" "0"
 SYSTEM_CONSTANT "ADASUSG_PESMED_SC" "0"
 SYSTEM_CONSTANT "ADDHTR_CONST" "360"
 SYSTEM_CONSTANT "ADDLEONV_SC" "0"
 SYSTEM_CONSTANT "AFSP_TYPAVL_SC" "0"
 SYSTEM_CONSTANT "AFST_SY" "0"
 SYSTEM_CONSTANT "AFST_TYPAVL_SY" "0"
 SYSTEM_CONSTANT "AIRBENA_SC" "1"
 SYSTEM_CONSTANT "AIRBG_ATS_SC" "0"
 SYSTEM_CONSTANT "AIRBG_AVS_SC" "1"
 SYSTEM_CONSTANT "AIRBG_SIGTYP_SY" "2"
 SYSTEM_CONSTANT "AIRCTL_NUMBUFDDTEGRLPPOS" "26"
 SYSTEM_CONSTANT "AIRHUMT_TYPAVL_SC" "0"
 SYSTEM_CONSTANT "AIRMASS_2_RES_REV" "10"
 SYSTEM_CONSTANT "AIRMSPRTIMEQ0P0003_RES" "0.0003"
 SYSTEM_CONSTANT "AIRMSQ0P1_RES" "0.1"
 SYSTEM_CONSTANT "AIRMSQ0P1_RES_REV" "10"
 SYSTEM_CONSTANT "AIRPIN_TYPAVL_SY" "0"
 SYSTEM_CONSTANT "AIRPOUT_TYPAVL_SC" "0"
 SYSTEM_CONSTANT "AIRSNSR_DSQACTVT_SC" "0"
 SYSTEM_CONSTANT "AIRSNSR_PSCCENGSTRT_SC" "0"
 SYSTEM_CONSTANT "AIRSYS_AREAEFFONE" "1"
 SYSTEM_CONSTANT "AIRSYS_AREAEFFONE_SY" "1"
 SYSTEM_CONSTANT "AIRSYS_ASYMC_SC" "0"
 SYSTEM_CONSTANT "AIRSYS_MINDEADTIME_SY" "1"
 SYSTEM_CONSTANT "AIRSYS_TEMPTHRPST" "300"
 SYSTEM_CONSTANT "AIRSYS_TEMPTHRPST_SY" "300"
 SYSTEM_CONSTANT "AIRTIN_TYPAVL_SC" "0"
 SYSTEM_CONSTANT "AIRTOUT_TYPAVL_SY" "0"
 SYSTEM_CONSTANT "ALTCRNT_LIM_RES" "0.25"
 SYSTEM_CONSTANT "ALTCRNT_OUT_RES" "0.125"
 SYSTEM_CONSTANT "ALTLD_RES" "3.125"
 SYSTEM_CONSTANT "ALTVLTG_OFS" "10.6"
 SYSTEM_CONSTANT "ALTVLTG_RES_SY" "0.1"
 SYSTEM_CONSTANT "ALT_CHPTEMP_OFS" "-32"
 SYSTEM_CONSTANT "ALT_CHPTEMP_RES" "8"
 SYSTEM_CONSTANT "AMPC_RES_REV" "10"
 SYSTEM_CONSTANT "AMPT_NOXLDUNLD_RES" "0.0001"
 SYSTEM_CONSTANT "AMPT_NOXLDUNLD_RES_REV" "10000"
 SYSTEM_CONSTANT "AMPT_NOXRGN_MIN" "0"
 SYSTEM_CONSTANT "AMPT_NOXRGN_RES" "0.0005"
 SYSTEM_CONSTANT "AMPT_NOXRGN_RES_REV" "2000"
 SYSTEM_CONSTANT "AMPT_NOX_RES" "1e-005"
 SYSTEM_CONSTANT "AMPT_NOX_RES_REV" "100000"
 SYSTEM_CONSTANT "AMPT_RES_2" "3.2e-005"
 SYSTEM_CONSTANT "AMPT_RES_2_REV" "31250"
 SYSTEM_CONSTANT "AMPT_SOX1_MIN" "0"
 SYSTEM_CONSTANT "AMPT_SOX1_RES" "0.003"
 SYSTEM_CONSTANT "APP1_BP" "0"
 SYSTEM_CONSTANT "APP2_BP" "1"
 SYSTEM_CONSTANT "APPDEF_BP" "2"
 SYSTEM_CONSTANT "APPLIMP_BP" "3"
 SYSTEM_CONSTANT "APPVIRTZRPNTENAD_SC" "1"
 SYSTEM_CONSTANT "APP_CHN1_SSPMONNUM_SY" "1"
 SYSTEM_CONSTANT "APP_CHN2_SSPMONNUM_SY" "2"
 SYSTEM_CONSTANT "APP_ENAALIVEDET_BP" "0"
 SYSTEM_CONSTANT "APP_ENAALTERRSTGY_BP" "9"
 SYSTEM_CONSTANT "APP_ENAAPPGRAD_BP" "3"
 SYSTEM_CONSTANT "APP_ENABRKEDGEDET_BP" "2"
 SYSTEM_CONSTANT "APP_ENABRKPLAUSCON_BP" "15"
 SYSTEM_CONSTANT "APP_ENABRKRSTCON_BP" "4"
 SYSTEM_CONSTANT "APP_ENADFCPLAUSBRK_SY" "0"
 SYSTEM_CONSTANT "APP_ENAFLT_BP" "10"
 SYSTEM_CONSTANT "APP_ENAFLT_SY" "1"
 SYSTEM_CONSTANT "APP_ENAKD_BP" "13"
 SYSTEM_CONSTANT "APP_ENAMSTAPP1_BP" "8"
 SYSTEM_CONSTANT "APP_ENAPINCONF2_BP" "7"
 SYSTEM_CONSTANT "APP_ENAPLABRKCHK_BP" "6"
 SYSTEM_CONSTANT "APP_ENAPREUNJIT_BP" "14"
 SYSTEM_CONSTANT "APP_ENATHRVLVLIM_BP" "1"
 SYSTEM_CONSTANT "APP_ENAUNJIT_BP" "12"
 SYSTEM_CONSTANT "APP_ENAUNJIT_SY" "1"
 SYSTEM_CONSTANT "APP_ENAVEHDYNREQ_BP" "5"
 SYSTEM_CONSTANT "APP_PLAUSBRKMONAVL_SC" "1"
 SYSTEM_CONSTANT "APP_SC" "1"
 SYSTEM_CONSTANT "APP_SWTPLAUSBRKSRC_SC" "0"
 SYSTEM_CONSTANT "ARBLD_SC" "1"
 SYSTEM_CONSTANT "ARVERS_SC" "2"
 SYSTEM_CONSTANT "ASMOD_FACRSTOICH" "14.5"
 SYSTEM_CONSTANT "ASMOD_HTFLW_RES" "2"
 SYSTEM_CONSTANT "ASMOD_NUMEOMCOEMI_SY" "3"
 SYSTEM_CONSTANT "ASMOD_PHC" "3"
 SYSTEM_CONSTANT "ASMOD_QLMBD" "100"
 SYSTEM_CONSTANT "ASMOD_RGN" "4"
 SYSTEM_CONSTANT "ASMOD_RM" "2"
 SYSTEM_CONSTANT "ATNMSPRKG_SC" "0"
 SYSTEM_CONSTANT "ATS_BRK_APP_SC" "0"
 SYSTEM_CONSTANT "ATS_ENGSPDMON_SUPPORT" "1"
 SYSTEM_CONSTANT "ATS_RCCACT_SC" "0"
 SYSTEM_CONSTANT "ATS_RCCSUPPORT" "0"
 SYSTEM_CONSTANT "ATS_SPCTMR_SC" "0"
 SYSTEM_CONSTANT "AVS_NUMADJVAL" "12"
 SYSTEM_CONSTANT "BASEMAP_INTRPNFAC_FIVE" "5"
 SYSTEM_CONSTANT "BASEMAP_INTRPNFAC_SIX" "6"
 SYSTEM_CONSTANT "BATTSENS_SY" "1"
 SYSTEM_CONSTANT "BATTU_FACREPLCMT" "1"
 SYSTEM_CONSTANT "BATTU_FACTONE" "1"
 SYSTEM_CONSTANT "BATTU_ZERO_VOLT" "0"
 SYSTEM_CONSTANT "BIDEV_PASSDOORSWTIFTYP_SC" "0"
 SYSTEM_CONSTANT "BIDEV_POSTDRVLAMP_SC" "0"
 SYSTEM_CONSTANT "BIDEV_WAKEUPCHRGR_SC" "0"
 SYSTEM_CONSTANT "BLOWRIFTYP_SC" "4"
 SYSTEM_CONSTANT "BRKBSTP2_TYPAVL_SC" "0"
 SYSTEM_CONSTANT "BRKBSTPMDLENA_SC" "0"
 SYSTEM_CONSTANT "BRKBSTPMP_ATS_SC" "0"
 SYSTEM_CONSTANT "BRKBSTPMP_LFTICNTRENA_SC" "0"
 SYSTEM_CONSTANT "BRKBSTPMP_OVLDPROTNENA_SC" "1"
 SYSTEM_CONSTANT "BRKBSTPMP_SC" "1"
 SYSTEM_CONSTANT "BRKBSTPMP_SWTPLAUSGENN_SC" "1"
 SYSTEM_CONSTANT "BRKBSTP_QUAL_ALLOK" "0"
 SYSTEM_CONSTANT "BRKBSTP_QUAL_FROZEN" "8"
 SYSTEM_CONSTANT "BRKBSTP_QUAL_INVALID" "15"
 SYSTEM_CONSTANT "BRKBSTP_STSIGQLYFRZN" "8"
 SYSTEM_CONSTANT "BRKBSTP_STSIGQLYINVLD" "15"
 SYSTEM_CONSTANT "BRKBSTP_STSIGQLYOK" "0"
 SYSTEM_CONSTANT "BRKBSTP_SWTADC_SC" "1"
 SYSTEM_CONSTANT "BRKBSTP_SWTPLAUSCNS_SC" "0"
 SYSTEM_CONSTANT "BRKBSTP_TYPAVL_SC" "0"
 SYSTEM_CONSTANT "BRKBST_BACKUP_MODE_BRKPED" "2"
 SYSTEM_CONSTANT "BRKBST_BACKUP_MODE_PERD" "3"
 SYSTEM_CONSTANT "BRKBST_DEACTV_MODE" "0"
 SYSTEM_CONSTANT "BRKBST_MDLAIRMF_SC" "0"
 SYSTEM_CONSTANT "BRKBST_NORMAL_MODE" "1"
 SYSTEM_CONSTANT "BRKGTOZR_SC" "0"
 SYSTEM_CONSTANT "BRKPEDLEVLN_SC" "1"
 SYSTEM_CONSTANT "BRKP_ACQHWENA_SC" "0"
 SYSTEM_CONSTANT "BRKP_SC" "0"
 SYSTEM_CONSTANT "BRKSELSIG_QUAL_ALL_OK" "0"
 SYSTEM_CONSTANT "BRKSELSIG_QUAL_FROZEN" "8"
 SYSTEM_CONSTANT "BRKSELSIG_QUAL_INVALID" "15"
 SYSTEM_CONSTANT "BRKVEHSPDPLAUS_SY" "0"
 SYSTEM_CONSTANT "BRK_EXTBRKINTVBRKP_SC" "0"
 SYSTEM_CONSTANT "BRK_FLGSWTSTUCKDIAG_SC" "0"
 SYSTEM_CONSTANT "BRK_MAISNSRAUTDETNENA_SC" "0"
 SYSTEM_CONSTANT "BRK_PLAUSBRKSTBRKP_SC" "0"
 SYSTEM_CONSTANT "BRK_QUAL_ALL_OK" "0"
 SYSTEM_CONSTANT "BRK_QUAL_FROZEN" "8"
 SYSTEM_CONSTANT "BRK_QUAL_INVALID" "15"
 SYSTEM_CONSTANT "BRK_RATSRCADC_SC" "0"
 SYSTEM_CONSTANT "BRK_RAT_SC" "0"
 SYSTEM_CONSTANT "BRK_RDNTSNSRAUTDETNENA_SC" "0"
 SYSTEM_CONSTANT "BRK_ST_MAYBEPRESSED" "1"
 SYSTEM_CONSTANT "BRK_ST_NOTPRESSED" "0"
 SYSTEM_CONSTANT "BRK_ST_PRESSED" "3"
 SYSTEM_CONSTANT "BRK_SWTADC_SC" "0"
 SYSTEM_CONSTANT "BRK_SWTBRKP_SC" "0"
 SYSTEM_CONSTANT "BRK_SWTMAICAN_SC" "1"
 SYSTEM_CONSTANT "BRK_SWTMAIDIO_SC" "0"
 SYSTEM_CONSTANT "BRK_SWTPLAUS_SC" "1"
 SYSTEM_CONSTANT "BRK_SWTPWM_SC" "0"
 SYSTEM_CONSTANT "BRK_SWTRDNTCAN_SC" "0"
 SYSTEM_CONSTANT "BRK_SWTRDNTDIO_SC" "1"
 SYSTEM_CONSTANT "BSWDEVLERRDETNACTVN_SC" "1"
 SYSTEM_CONSTANT "BSWLIB_TRAPLOG_SC" "0"
 SYSTEM_CONSTANT "BYPASS_SY" "1"
 SYSTEM_CONSTANT "C126_dist_km_u32_q1p0_COMPU_RES" "1"
 SYSTEM_CONSTANT "CACDSPLP_TYPAVL_SC" "0"
 SYSTEM_CONSTANT "CACDSP_TYPAVL_SY" "0"
 SYSTEM_CONSTANT "CACDSTLP_TYPAVL_SC" "0"
 SYSTEM_CONSTANT "CACDST_TYPAVL_SY" "0"
 SYSTEM_CONSTANT "CACUSP_TYPAVL_SY" "0"
 SYSTEM_CONSTANT "CACUST_TYPAVL_SY" "0"
 SYSTEM_CONSTANT "CAIRHT_SY" "1"
 SYSTEM_CONSTANT "CALORIFIC_VALUE" "42.5"
 SYSTEM_CONSTANT "CALORY_RES_REV" "1"
 SYSTEM_CONSTANT "CALWUP_SY" "1"
 SYSTEM_CONSTANT "CAMLIFT_RES_REV" "256"
 SYSTEM_CONSTANT "CAMPAR_A_RES_REV" "1024"
 SYSTEM_CONSTANT "CAMSLP_RES_REV" "1024"
 SYSTEM_CONSTANT "CANIPCORETYPE_SC" "0"
 SYSTEM_CONSTANT "CANNM_SC" "0"
 SYSTEM_CONSTANT "CANSM_SC" "1"
 SYSTEM_CONSTANT "CANTP_SC" "1"
 SYSTEM_CONSTANT "CANTSYN_SC" "0"
 SYSTEM_CONSTANT "CAN_MDS_SC" "0"
 SYSTEM_CONSTANT "CARBMDLYR19UPD2016_SC" "0"
 SYSTEM_CONSTANT "CAS_I1_SY" "0"
 SYSTEM_CONSTANT "CAS_I2_SY" "0"
 SYSTEM_CONSTANT "CAS_MAX" "2"
 SYSTEM_CONSTANT "CAS_O1_SY" "0"
 SYSTEM_CONSTANT "CAS_O2_SY" "0"
 SYSTEM_CONSTANT "CBNHEATGSWT_TYPAVL_SC" "1"
 SYSTEM_CONSTANT "CCACHPDST_TYPAVL_SY" "0"
 SYSTEM_CONSTANT "CCACLPDST_TYPAVL_SY" "0"
 SYSTEM_CONSTANT "CCSCOM_EGYTRFMOD_AC1PHA" "1"
 SYSTEM_CONSTANT "CCSCOM_EGYTRFMOD_AC3PHA" "2"
 SYSTEM_CONSTANT "CCSCOM_EGYTRFMOD_DCEXTD" "4"
 SYSTEM_CONSTANT "CCSPWRLINECHPRST_TYPAVL_SC" "1"
 SYSTEM_CONSTANT "CCSPWRLINECHPVCCENA_TYPAVL_SC" "1"
 SYSTEM_CONSTANT "CCSPWRLINECHPVCC_TYPAVL_SC" "1"
 SYSTEM_CONSTANT "CCSPWRLINECOMCHPT_TYPAVL_SC" "1"
 SYSTEM_CONSTANT "CDGEN_ENV_SC" "2"
 SYSTEM_CONSTANT "CELPRJ_SIMPLEMDLENA_SC" "1"
 SYSTEM_CONSTANT "CENGDST_TYPAVL_SY" "0"
 SYSTEM_CONSTANT "CENGUST2_TYPAVL_SC" "0"
 SYSTEM_CONSTANT "CENGUST_TYPAVL_SY" "0"
 SYSTEM_CONSTANT "CHDT_TYPAVL_SC" "0"
 SYSTEM_CONSTANT "CHGRPLUG_AUX_CLSD" "1"
 SYSTEM_CONSTANT "CHGRPLUG_AUX_ERR" "2"
 SYSTEM_CONSTANT "CHGRPLUG_AUX_OPEN" "0"
 SYSTEM_CONSTANT "CHGRPLUG_CTPSWTACTR_CLOSED" "1"
 SYSTEM_CONSTANT "CHGRPLUG_CTPSWTACTR_OPEN" "0"
 SYSTEM_CONSTANT "CHGRPLUG_CTPSWTACTR_STUCK_CLOSD" "3"
 SYSTEM_CONSTANT "CHGRPLUG_CTPSWTACTR_STUCK_OPEN" "2"
 SYSTEM_CONSTANT "CHGRPLUG_CTP_B1" "2"
 SYSTEM_CONSTANT "CHGRPLUG_CTP_B2" "3"
 SYSTEM_CONSTANT "CHGRPLUG_CTP_C1" "4"
 SYSTEM_CONSTANT "CHGRPLUG_CTP_C2" "5"
 SYSTEM_CONSTANT "CHGRPLUG_CTP_D1" "6"
 SYSTEM_CONSTANT "CHGRPLUG_CTP_D2" "7"
 SYSTEM_CONSTANT "CHGRPLUG_CTP_ERR" "0"
 SYSTEM_CONSTANT "CHGRPLUG_CTP_IMPS" "1"
 SYSTEM_CONSTANT "CHGRPLUG_CTP_X1" "8"
 SYSTEM_CONSTANT "CHGRPLUG_CTP_X2" "9"
 SYSTEM_CONSTANT "CHGRPLUG_LOCK_CLSD" "2"
 SYSTEM_CONSTANT "CHGRPLUG_LOCK_CLSDLIM" "3"
 SYSTEM_CONSTANT "CHGRPLUG_LOCK_ERR" "9"
 SYSTEM_CONSTANT "CHGRPLUG_LOCK_OPEN" "0"
 SYSTEM_CONSTANT "CHGRPLUG_LOCK_PND" "1"
 SYSTEM_CONSTANT "CHGRPLUG_PXP_ERR" "4"
 SYSTEM_CONSTANT "CHGRPLUG_PXP_INI" "5"
 SYSTEM_CONSTANT "CHGRPLUG_PXP_PLGD" "1"
 SYSTEM_CONSTANT "CHGRPLUG_PXP_PSDSWT" "3"
 SYSTEM_CONSTANT "CHGRPLUG_PXP_UNPL" "0"
 SYSTEM_CONSTANT "CHGRPLUG_ST_LOCK" "0"
 SYSTEM_CONSTANT "CHGRPLUG_ST_STUCK_CLOSED" "3"
 SYSTEM_CONSTANT "CHGRPLUG_ST_STUCK_OPEN" "2"
 SYSTEM_CONSTANT "CHGRPLUG_ST_UNLOCK" "1"
 SYSTEM_CONSTANT "CHGRPLUG_TSNSR_ERR" "2"
 SYSTEM_CONSTANT "CHGRPLUG_TSNSR_IMPS" "3"
 SYSTEM_CONSTANT "CHGRPLUG_TSNSR_INI" "0"
 SYSTEM_CONSTANT "CHGRPLUG_TSNSR_VLD" "1"
 SYSTEM_CONSTANT "CHRCTL_EIAECD_SY" "0"
 SYSTEM_CONSTANT "CHRGCIL_HMICHRGNSTOP_SC" "1"
 SYSTEM_CONSTANT "CHRGCIL_HMIPLGUNLCK_SC" "1"
 SYSTEM_CONSTANT "CHRGCIL_HMIVEHCENLOCK_SC" "0"
 SYSTEM_CONSTANT "CHRGCIL_HMI_CHRGNSTOP" "1"
 SYSTEM_CONSTANT "CHRGCIL_HMI_CHRGNSTOPUNLCKPLG" "2"
 SYSTEM_CONSTANT "CHRGCIL_HMI_LOCKPLG" "3"
 SYSTEM_CONSTANT "CHRGCIL_HMI_NOREQ" "0"
 SYSTEM_CONSTANT "CHRGCIL_HMI_UNLCKPLG" "4"
 SYSTEM_CONSTANT "CHRGCNTCT_CLSD" "1"
 SYSTEM_CONSTANT "CHRGCNTCT_ERR" "5"
 SYSTEM_CONSTANT "CHRGCNTCT_INI" "6"
 SYSTEM_CONSTANT "CHRGCNTCT_OPEND" "0"
 SYSTEM_CONSTANT "CHRGCNTCT_PTLWLDD" "4"
 SYSTEM_CONSTANT "CHRGCNTCT_WLDCHK" "2"
 SYSTEM_CONSTANT "CHRGCNTCT_WLDD" "3"
 SYSTEM_CONSTANT "CHRGCOM_AVL" "2"
 SYSTEM_CONSTANT "CHRGCOM_ERR" "3"
 SYSTEM_CONSTANT "CHRGCOM_INI" "0"
 SYSTEM_CONSTANT "CHRGCOM_PND" "1"
 SYSTEM_CONSTANT "CHRGCTRL_CCSACCTRL_SC" "1"
 SYSTEM_CONSTANT "CHRGCTRL_CCSDCCTRL_SC" "1"
 SYSTEM_CONSTANT "CHRGCTRL_CHRGN" "2"
 SYSTEM_CONSTANT "CHRGCTRL_CLOSE" "2"
 SYSTEM_CONSTANT "CHRGCTRL_CNTCTCTRL_SC" "1"
 SYSTEM_CONSTANT "CHRGCTRL_CRITERR" "5"
 SYSTEM_CONSTANT "CHRGCTRL_EMGYOPEN" "1"
 SYSTEM_CONSTANT "CHRGCTRL_FINSH" "4"
 SYSTEM_CONSTANT "CHRGCTRL_INI" "0"
 SYSTEM_CONSTANT "CHRGCTRL_MNRERR" "6"
 SYSTEM_CONSTANT "CHRGCTRL_MOD_AC_EXT" "1"
 SYSTEM_CONSTANT "CHRGCTRL_MOD_CCS_AC" "2"
 SYSTEM_CONSTANT "CHRGCTRL_MOD_CCS_DC" "3"
 SYSTEM_CONSTANT "CHRGCTRL_MOD_CHADEMO" "4"
 SYSTEM_CONSTANT "CHRGCTRL_MOD_CHINA" "5"
 SYSTEM_CONSTANT "CHRGCTRL_MOD_NOT_AVL" "9"
 SYSTEM_CONSTANT "CHRGCTRL_MOD_NO_CHRGN" "0"
 SYSTEM_CONSTANT "CHRGCTRL_OPEN" "0"
 SYSTEM_CONSTANT "CHRGCTRL_PREP" "1"
 SYSTEM_CONSTANT "CHRGCTRL_STFLAP_CLSD" "1"
 SYSTEM_CONSTANT "CHRGCTRL_STFLAP_OPEN" "0"
 SYSTEM_CONSTANT "CHRGCTRL_STFLAP_PSD" "2"
 SYSTEM_CONSTANT "CHRGCTRL_STFLAP_SIGNOTAVL" "3"
 SYSTEM_CONSTANT "CHRGCTRL_STOP" "3"
 SYSTEM_CONSTANT "CHRGCTRL_SUB_CHRGNLOOP" "7"
 SYSTEM_CONSTANT "CHRGCTRL_SUB_CHRGPRMEXCH" "2"
 SYSTEM_CONSTANT "CHRGCTRL_SUB_EVRDY" "3"
 SYSTEM_CONSTANT "CHRGCTRL_SUB_FINSH" "10"
 SYSTEM_CONSTANT "CHRGCTRL_SUB_INI" "0"
 SYSTEM_CONSTANT "CHRGCTRL_SUB_ISODISAD" "4"
 SYSTEM_CONSTANT "CHRGCTRL_SUB_PREC" "5"
 SYSTEM_CONSTANT "CHRGCTRL_SUB_PRECFINSH" "6"
 SYSTEM_CONSTANT "CHRGCTRL_SUB_RENEGT" "11"
 SYSTEM_CONSTANT "CHRGCTRL_SUB_SELD" "1"
 SYSTEM_CONSTANT "CHRGCTRL_SUB_STOP" "8"
 SYSTEM_CONSTANT "CHRGCTRL_SUB_WLDCHK" "9"
 SYSTEM_CONSTANT "CHRGIF_CTRLPLT_SC" "1"
 SYSTEM_CONSTANT "CHRGIF_PLGINTLCK_SC" "1"
 SYSTEM_CONSTANT "CHRGIF_PROXPLT_SC" "1"
 SYSTEM_CONSTANT "CHRGIF_TMONCCSAC_SC" "0"
 SYSTEM_CONSTANT "CHRGIF_TMONCCSDC_SC" "1"
 SYSTEM_CONSTANT "CHRGIF_TMONCHADEMO_SC" "0"
 SYSTEM_CONSTANT "CHRGIF_TMONCHINA_SC" "0"
 SYSTEM_CONSTANT "CHRGIF_TMON_SC" "1"
 SYSTEM_CONSTANT "CHRGNCOM_AVL" "2"
 SYSTEM_CONSTANT "CHRGNCOM_ERR" "0"
 SYSTEM_CONSTANT "CHRGNCOM_INI" "1"
 SYSTEM_CONSTANT "CHRGNCOM_NOT_AVL" "3"
 SYSTEM_CONSTANT "CHRGNFCTSFTY_CCSPLGLOCK_SC" "1"
 SYSTEM_CONSTANT "CHRGNMOD_CCS_AC" "2"
 SYSTEM_CONSTANT "CHRGNMOD_CCS_DC" "3"
 SYSTEM_CONSTANT "CHRGNMOD_CHADEMO" "4"
 SYSTEM_CONSTANT "CHRGNMOD_CHINA_AC" "5"
 SYSTEM_CONSTANT "CHRGNMOD_CHINA_DC" "6"
 SYSTEM_CONSTANT "CHRGNMOD_NOT_AVL" "1"
 SYSTEM_CONSTANT "CHRGNMOD_NO_CHRGN" "0"
 SYSTEM_CONSTANT "CHRGNPLGLOCK_ERR" "3"
 SYSTEM_CONSTANT "CHRGNPLGLOCK_INI" "0"
 SYSTEM_CONSTANT "CHRGNPLGLOCK_LCKD" "2"
 SYSTEM_CONSTANT "CHRGNPLGLOCK_RELS_PROHB" "0"
 SYSTEM_CONSTANT "CHRGNPLGLOCK_RELS_PTD" "1"
 SYSTEM_CONSTANT "CHRGNPLGLOCK_UNLCKD" "1"
 SYSTEM_CONSTANT "CHRGNPLG_DETD" "2"
 SYSTEM_CONSTANT "CHRGNPLG_ERR" "4"
 SYSTEM_CONSTANT "CHRGNPLG_INI" "0"
 SYSTEM_CONSTANT "CHRGNPLG_MPL_PLGD" "5"
 SYSTEM_CONSTANT "CHRGNPLG_PLGD" "3"
 SYSTEM_CONSTANT "CHRGNPLG_UNPLGD" "1"
 SYSTEM_CONSTANT "CHRGN_ABORT" "2"
 SYSTEM_CONSTANT "CHRGN_PROHB" "0"
 SYSTEM_CONSTANT "CHRGN_PTD" "1"
 SYSTEM_CONSTANT "CHRGPLG_INTLCK_ERR" "9"
 SYSTEM_CONSTANT "CHRGPLG_INTLCK_INI" "0"
 SYSTEM_CONSTANT "CHRGPLG_INTLCK_LOCKDELEC" "3"
 SYSTEM_CONSTANT "CHRGPLG_INTLCK_LOCKDMECL" "4"
 SYSTEM_CONSTANT "CHRGPLG_INTLCK_LOCKREQ" "0"
 SYSTEM_CONSTANT "CHRGPLG_INTLCK_NOTAVL" "2"
 SYSTEM_CONSTANT "CHRGPLG_INTLCK_STYREQ" "2"
 SYSTEM_CONSTANT "CHRGPLG_INTLCK_UNLCKD" "1"
 SYSTEM_CONSTANT "CHRGPLG_INTLCK_UNLCKREQ" "1"
 SYSTEM_CONSTANT "CHRGPLG_PLGD" "2"
 SYSTEM_CONSTANT "CHRGPLG_PTLPLGD" "1"
 SYSTEM_CONSTANT "CHRGPLG_TMON_CRITERR" "4"
 SYSTEM_CONSTANT "CHRGPLG_TMON_INI" "0"
 SYSTEM_CONSTANT "CHRGPLG_TMON_MNRERR" "3"
 SYSTEM_CONSTANT "CHRGPLG_TMON_NOTAVL" "2"
 SYSTEM_CONSTANT "CHRGPLG_TMON_OK" "1"
 SYSTEM_CONSTANT "CHRGPLG_UNPLGD" "0"
 SYSTEM_CONSTANT "CHRGRRLY_CLSD" "2"
 SYSTEM_CONSTANT "CHRGRRLY_ERR" "7"
 SYSTEM_CONSTANT "CHRGRRLY_INI" "0"
 SYSTEM_CONSTANT "CHRGRRLY_OPEN" "4"
 SYSTEM_CONSTANT "CHRGRRLY_PREC" "1"
 SYSTEM_CONSTANT "CHRGRRLY_PTLWLDD" "5"
 SYSTEM_CONSTANT "CHRGRRLY_WLDCHK" "3"
 SYSTEM_CONSTANT "CHRGRRLY_WLDD" "6"
 SYSTEM_CONSTANT "CHRGRSWT_SC" "0"
 SYSTEM_CONSTANT "CHRGSDL_TICALCN_CC" "3"
 SYSTEM_CONSTANT "CHRGSDL_TICALCN_CMPL" "5"
 SYSTEM_CONSTANT "CHRGSDL_TICALCN_CV" "4"
 SYSTEM_CONSTANT "CHRGSDL_TICALCN_IDLE" "0"
 SYSTEM_CONSTANT "CHRGSDL_TICALCN_INI" "1"
 SYSTEM_CONSTANT "CHRGSDL_TICALCN_PRE" "2"
 SYSTEM_CONSTANT "CHRGSDL_TICALCN_SC" "1"
 SYSTEM_CONSTANT "CHRGSEQIF_ACEXTCHRGR_SC" "1"
 SYSTEM_CONSTANT "CHRGSEQIF_CCS_SC" "2"
 SYSTEM_CONSTANT "CHRGSEQIF_CHADEMO_SC" "0"
 SYSTEM_CONSTANT "CHRGSEQIF_CHINAGBT_SC" "0"
 SYSTEM_CONSTANT "CHRGTYP_CCS_SC" "4"
 SYSTEM_CONSTANT "CJ721_SC" "0"
 SYSTEM_CONSTANT "CJ722_SC" "0"
 SYSTEM_CONSTANT "CJ950_SY" "0"
 SYSTEM_CONSTANT "CJ960_SC" "0"
 SYSTEM_CONSTANT "CJ970_SC" "1"
 SYSTEM_CONSTANT "CLNTVLV_SY" "0"
 SYSTEM_CONSTANT "CMBDCHRGNSYS_EVERRCOD_BATT" "7"
 SYSTEM_CONSTANT "CMBDCHRGNSYS_EVERRCOD_GEAR" "3"
 SYSTEM_CONSTANT "CMBDCHRGNSYS_EVERRCOD_IDFTL" "8"
 SYSTEM_CONSTANT "CMBDCHRGNSYS_EVERRCOD_NOERR" "0"
 SYSTEM_CONSTANT "CMBDCHRGNSYS_EVERRCOD_NOTCMPBL" "13"
 SYSTEM_CONSTANT "CMBDCHRGNSYS_EVERRCOD_OTHFLT" "14"
 SYSTEM_CONSTANT "CMBDCHRGNSYS_EVERRCOD_PLGLOCK" "4"
 SYSTEM_CONSTANT "CMBDCHRGNSYS_EVERRCOD_TBATT" "2"
 SYSTEM_CONSTANT "CMBDCHRGNSYS_EVERRCOD_UBATT" "9"
 SYSTEM_CONSTANT "CMBTYP_DS" "0"
 SYSTEM_CONSTANT "CMBTYP_GS" "1"
 SYSTEM_CONSTANT "CMBTYP_SY" "1"
 SYSTEM_CONSTANT "CMPRHP2DST_TYPAVL_SC" "0"
 SYSTEM_CONSTANT "CNVTCOEFFCATAIR_RES_REV" "50"
 SYSTEM_CONSTANT "COENG_FINISH" "5"
 SYSTEM_CONSTANT "COENG_ST_AUTOSTOPPING" "64"
 SYSTEM_CONSTANT "COENG_ST_FINISH" "16384"
 SYSTEM_CONSTANT "COENG_ST_READY" "4"
 SYSTEM_CONSTANT "COENG_ST_RUNNING" "1024"
 SYSTEM_CONSTANT "COENG_ST_STANDBY" "0"
 SYSTEM_CONSTANT "COENG_ST_STARTING" "16"
 SYSTEM_CONSTANT "COENG_ST_STOPPING" "4096"
 SYSTEM_CONSTANT "COEOM_INJCRVMI1NUMMAP_SY" "0"
 SYSTEM_CONSTANT "COEOM_INJCRVMI1NUMSWTDES_SY" "1"
 SYSTEM_CONSTANT "COEOM_INJCRVMI1NUMSWTMAX_SY" "0"
 SYSTEM_CONSTANT "COEOM_INJCRVMI1NUMSWTSET_SY" "0"
 SYSTEM_CONSTANT "COEOM_INJCRVPII1NUMMAP_SY" "0"
 SYSTEM_CONSTANT "COEOM_INJCRVPII1NUMSWTDES_SY" "1"
 SYSTEM_CONSTANT "COEOM_INJCRVPII1NUMSWTMAX_SY" "0"
 SYSTEM_CONSTANT "COEOM_INJCRVPII1NUMSWTSET_SY" "0"
 SYSTEM_CONSTANT "COEOM_INJCRVPII2NUMMAP_SY" "0"
 SYSTEM_CONSTANT "COEOM_INJCRVPII2NUMSWTDES_SY" "1"
 SYSTEM_CONSTANT "COEOM_INJCRVPII2NUMSWTMAX_SY" "0"
 SYSTEM_CONSTANT "COEOM_INJCRVPII2NUMSWTSET_SY" "0"
 SYSTEM_CONSTANT "COEOM_INJCRVPOI1NUMMAP_SY" "0"
 SYSTEM_CONSTANT "COEOM_INJCRVPOI1NUMSWTDES_SY" "1"
 SYSTEM_CONSTANT "COEOM_INJCRVPOI1NUMSWTMAX_SY" "0"
 SYSTEM_CONSTANT "COEOM_INJCRVPOI1NUMSWTSET_SY" "0"
 SYSTEM_CONSTANT "COEOM_INJCRVPOI2NUMMAP_SY" "0"
 SYSTEM_CONSTANT "COEOM_INJCRVPOI2NUMSWTDES_SY" "1"
 SYSTEM_CONSTANT "COEOM_INJCRVPOI2NUMSWTMAX_SY" "0"
 SYSTEM_CONSTANT "COEOM_INJCRVPOI2NUMSWTSET_SY" "0"
 SYSTEM_CONSTANT "COEOM_INJCRVPOI3NUMMAP_SY" "0"
 SYSTEM_CONSTANT "COEOM_INJCRVPOI3NUMSWTDES_SY" "1"
 SYSTEM_CONSTANT "COEOM_INJCRVPOI3NUMSWTMAX_SY" "0"
 SYSTEM_CONSTANT "COEOM_INJCRVPOI3NUMSWTSET_SY" "0"
 SYSTEM_CONSTANT "COEOM_TYP_SY" "1"
 SYSTEM_CONSTANT "COMM_SC" "1"
 SYSTEM_CONSTANT "COMPACCPED_ON" "1"
 SYSTEM_CONSTANT "COMPACCPED_SY" "0"
 SYSTEM_CONSTANT "COM_NORMALMODE" "1"
 SYSTEM_CONSTANT "COM_SC" "1"
 SYSTEM_CONSTANT "CONDRDSFLDP_TYPAVL_SC" "0"
 SYSTEM_CONSTANT "CONDRDSFLDT_TYPAVL_SC" "0"
 SYSTEM_CONSTANT "CONDRUSCOOLTT_TYPAVL_SC" "0"
 SYSTEM_CONSTANT "CONDRUSFLDT_TYPAVL_SC" "0"
 SYSTEM_CONSTANT "CONV_MGS2KGS" "1000000"
 SYSTEM_CONSTANT "COOLTPIN_TYPAVL_SC" "0"
 SYSTEM_CONSTANT "COOLTPOUT_TYPAVL_SC" "0"
 SYSTEM_CONSTANT "COOLTTIN_TYPAVL_SC" "0"
 SYSTEM_CONSTANT "COOLTTOUT_TYPAVL_SY" "0"
 SYSTEM_CONSTANT "COOLTTRADROUT_TYPAVL_SC" "0"
 SYSTEM_CONSTANT "COOPCLSTRCORE_SC" "1"
 SYSTEM_CONSTANT "COOPRGNBRKACTV_SC" "0"
 SYSTEM_CONSTANT "COPTEV_DCS_BP" "2"
 SYSTEM_CONSTANT "COPTEV_DYNLIMDMAX" "6"
 SYSTEM_CONSTANT "COPTEV_DYNLIMDMIN" "7"
 SYSTEM_CONSTANT "COPTEV_TCS_BP" "3"
 SYSTEM_CONSTANT "COPTEV_TRSMPROTNMAX_BP" "5"
 SYSTEM_CONSTANT "COPTEV_TRSMPROTNMIN_BP" "4"
 SYSTEM_CONSTANT "COVMD_CRCTL" "1"
 SYSTEM_CONSTANT "CPUDEVICE_SC" "13"
 SYSTEM_CONSTANT "CPUVENDOR_SC" "1"
 SYSTEM_CONSTANT "CRCSP_TYPAVL_SC" "0"
 SYSTEM_CONSTANT "CRCTL_SY" "0"
 SYSTEM_CONSTANT "CRC_SWTNEUT" "1"
 SYSTEM_CONSTANT "CRKCSPABSLT_TYPAVL_SY" "0"
 SYSTEM_CONSTANT "CSSWTIFTYP_SC" "0"
 SYSTEM_CONSTANT "CTEGRCLRDS_TYPAVL_SC" "0"
 SYSTEM_CONSTANT "CTEGRCLRLPUS_TYPAVL_SC" "0"
 SYSTEM_CONSTANT "CTEGRCLRUS_TYPAVL_SY" "0"
 SYSTEM_CONSTANT "CTEVCHRGRDS_TYPAVL_SY" "0"
 SYSTEM_CONSTANT "CTEVEMDS_TYPAVL_SY" "0"
 SYSTEM_CONSTANT "CTEVHTRDS_TYPAVL_SC" "0"
 SYSTEM_CONSTANT "CTEVHTREXCHGDS_TYPAVL_SC" "0"
 SYSTEM_CONSTANT "CTEVHTRUS_TYPAVL_SC" "0"
 SYSTEM_CONSTANT "CTEVINVRUS_TYPAVL_SY" "0"
 SYSTEM_CONSTANT "CTEVLEDS_TYPAVL_SY" "0"
 SYSTEM_CONSTANT "CTPFRQ_TYPAVL_SC" "1"
 SYSTEM_CONSTANT "CTPSWTACTR_TYPAVL_SC" "1"
 SYSTEM_CONSTANT "CTPSWTDIAG_TYPAVL_SC" "1"
 SYSTEM_CONSTANT "CURR_RES" "1"
 SYSTEM_CONSTANT "CVN_USE_DATA" "1"
 SYSTEM_CONSTANT "CVN_USE_EEP" "0"
 SYSTEM_CONSTANT "CVN_USE_ENVRAM" "1"
 SYSTEM_CONSTANT "CVN_USE_MEM" "1"
 SYSTEM_CONSTANT "CY326_SC" "0"
 SYSTEM_CONSTANT "CY327_SY" "0"
 SYSTEM_CONSTANT "CY329_SC" "1"
 SYSTEM_CONSTANT "CYL_MAX" "4"
 SYSTEM_CONSTANT "DCCHRGNRLYNEGPOSN_TYPAVL_SC" "1"
 SYSTEM_CONSTANT "DCCHRGNRLYNEG_TYPAVL_SC" "1"
 SYSTEM_CONSTANT "DCCHRGNRLYPOSPOSN_TYPAVL_SC" "1"
 SYSTEM_CONSTANT "DCCHRGNRLYPOS_TYPAVL_SC" "1"
 SYSTEM_CONSTANT "DCCHRGNRLY_TYPAVL_SC" "1"
 SYSTEM_CONSTANT "DCCHRGRINTKT2_TYPAVL_SC" "1"
 SYSTEM_CONSTANT "DCCHRGRINTKT_TYPAVL_SC" "1"
 SYSTEM_CONSTANT "DCCNTCT_CLSD" "2"
 SYSTEM_CONSTANT "DCCNTCT_INVLD" "0"
 SYSTEM_CONSTANT "DCCNTCT_OPEN" "1"
 SYSTEM_CONSTANT "DCDC02USGTYP_SC" "0"
 SYSTEM_CONSTANT "DCDC_ST_DCHA" "7"
 SYSTEM_CONSTANT "DCDC_ST_DCHACMPL" "2"
 SYSTEM_CONSTANT "DCDC_ST_DCHAINACTV" "0"
 SYSTEM_CONSTANT "DCDC_ST_DCHAPROGRS" "1"
 SYSTEM_CONSTANT "DCDC_ST_DCHARINVLD" "7"
 SYSTEM_CONSTANT "DCDC_ST_DCHARNOTAVL" "3"
 SYSTEM_CONSTANT "DCDC_ST_DCHAROCFLT" "5"
 SYSTEM_CONSTANT "DCDC_ST_DCHARSCFLT" "4"
 SYSTEM_CONSTANT "DCDC_ST_DCHARSRVD" "6"
 SYSTEM_CONSTANT "DCDC_ST_FAILR" "5"
 SYSTEM_CONSTANT "DCDC_ST_FWD" "1"
 SYSTEM_CONSTANT "DCDC_ST_INIT" "6"
 SYSTEM_CONSTANT "DCDC_ST_OFF" "0"
 SYSTEM_CONSTANT "DCDC_ST_PREC" "4"
 SYSTEM_CONSTANT "DCMAPPL_NUM_ATS_CONFIG" "23"
 SYSTEM_CONSTANT "DCS_OVRDS_ENGPRT" "1"
 SYSTEM_CONSTANT "DDRC_DTRFRZINFHEALDEB_SY" "0"
 SYSTEM_CONSTANT "DDRC_DTRUPDSUP_SY" "0"
 SYSTEM_CONSTANT "DDRC_NUM_DFC_EVTROW" "312"
 SYSTEM_CONSTANT "DDRC_NUM_DFC_EVTROW_SML" "1"
 SYSTEM_CONSTANT "DDRC_NUM_DFC_EVTUD" "2"
 SYSTEM_CONSTANT "DDRC_NUM_DFC_EVTUD_SML" "5"
 SYSTEM_CONSTANT "DDRC_NUM_DFC_TIROW" "180"
 SYSTEM_CONSTANT "DDRC_NUM_DFC_TIROW_SML" "26"
 SYSTEM_CONSTANT "DDRC_NUM_DFC_TIUD" "85"
 SYSTEM_CONSTANT "DDRC_NUM_DFC_TIUD_SML" "65"
 SYSTEM_CONSTANT "DDVOL_RES" "10"
 SYSTEM_CONSTANT "DEDIA_DBG_SC" "1"
 SYSTEM_CONSTANT "DEDIA_VRNTCONF_SY" "0"
 SYSTEM_CONSTANT "DELIB_CMN_STMONACTRCOORRSIMPLE_ATSACTV_BP" "0"
 SYSTEM_CONSTANT "DELIB_CMN_STMONACTRCOORRSIMPLE_ATSINTVALLWD_BP" "1"
 SYSTEM_CONSTANT "DELIB_CMN_STMONACTRELECDRVRSIMPLE_ATSINTVALLWD_BP" "1"
 SYSTEM_CONSTANT "DELIB_CMN_STMONACTRELECDRVRSIMPLE_PSACTVN_BP" "0"
 SYSTEM_CONSTANT "DELIB_CMN_STMONVRNTCODSIMPLE_FULLDEACTV_BP" "0"
 SYSTEM_CONSTANT "DELIB_CMN_STMONVRNTCODSIMPLE_OLDEACTV_BP" "1"
 SYSTEM_CONSTANT "DELIB_CMN_SWTCONFACTRCOORRSIMPLE_ENA_BP" "0"
 SYSTEM_CONSTANT "DELIB_CMN_SWTCONFACTRCOORRSIMPLE_SIGINV_BP" "1"
 SYSTEM_CONSTANT "DELIB_CMN_SWTCONFACTRELECDRVRSIMPLE_ENA_BP" "0"
 SYSTEM_CONSTANT "DELIB_CMN_SWTCONFACTRELECMONSIMPLE_DIAGTESTPLSDI_BP" "3"
 SYSTEM_CONSTANT "DELIB_CMN_SWTCONFACTRELECMONSIMPLE_DIGMON_BP" "2"
 SYSTEM_CONSTANT "DELIB_CMN_SWTCONFACTRELECMONSIMPLE_ENA_BP" "0"
 SYSTEM_CONSTANT "DELIB_CMN_SWTCONFACTRELECMONSIMPLE_PWMMON_BP" "1"
 SYSTEM_CONSTANT "DELIB_CMN_SWTCONFACTRHLDILIMNSIMPLE_ENA_BP" "0"
 SYSTEM_CONSTANT "DELIB_CMN_SWTCONFACTRPSDRVRSIMPLE_BATTCORRN_BP" "3"
 SYSTEM_CONSTANT "DELIB_CMN_SWTCONFACTRPSDRVRSIMPLE_DIGOUT_BP" "2"
 SYSTEM_CONSTANT "DELIB_CMN_SWTCONFACTRPSDRVRSIMPLE_ENA_BP" "0"
 SYSTEM_CONSTANT "DELIB_CMN_SWTCONFACTRPSDRVRSIMPLE_PWMOUT_BP" "1"
 SYSTEM_CONSTANT "DELIB_CMN_SWTCONFFIR_ENA_BP" "0"
 SYSTEM_CONSTANT "DELIB_CMN_SWTCONFPLL_ENA_BP" "0"
 SYSTEM_CONSTANT "DELIB_CMN_SWTCONFPLL_HEMENA_BP" "1"
 SYSTEM_CONSTANT "DELIB_CMN_SWTCONFVRNTCODSIMPLE_FULLDEACTV_BP" "0"
 SYSTEM_CONSTANT "DELIB_CMN_SWTCONFVRNTCODSIMPLE_OLDEACTV_BP" "1"
 SYSTEM_CONSTANT "DELIB_DBG_SC" "0"
 SYSTEM_CONSTANT "DELIB_DEVDRVROUTPDUTYCYCRAMP_ENA_BP" "0"
 SYSTEM_CONSTANT "DELIB_DSQACTVT_SC" "0"
 SYSTEM_CONSTANT "DELIB_DYNSDLDEACTV_SC" "0"
 SYSTEM_CONSTANT "DELIB_ELECACTRTYPAVL_SC" "0"
 SYSTEM_CONSTANT "DELIB_ELECACTR_STMONELECDIAGOL_IBASDOLTESTRATACTV_BP" "0"
 SYSTEM_CONSTANT "DELIB_ENGDATENG_TYPAVL_SC" "0"
 SYSTEM_CONSTANT "DELIB_FACPRECTLDWNTEMPCORRSIZECUR_SC" "2"
 SYSTEM_CONSTANT "DELIB_FACPRECTLUPTEMPCORRSIZECUR_SC" "2"
 SYSTEM_CONSTANT "DELIB_FACTQLOSSCMPSIZECUR_SC" "2"
 SYSTEM_CONSTANT "DELIB_GLBSRVGRDTLIMN_SWTCONF_ENABLE_BP" "0"
 SYSTEM_CONSTANT "DELIB_GLBSRVGRDTLIMN_SWTCONF_TSTRACTV_BP" "1"
 SYSTEM_CONSTANT "DELIB_GLBSRVSPFIL_SWTCONF_ENABLE_BP" "0"
 SYSTEM_CONSTANT "DELIB_HVDDC_TYPAVL_SC" "0"
 SYSTEM_CONSTANT "DELIB_MDLEXHSNSRAVL_SC" "0"
 SYSTEM_CONSTANT "DELIB_PMINLRNSIZECUR_SC" "2"
 SYSTEM_CONSTANT "DELIB_RACTRLIM2SIZECUR_SC" "2"
 SYSTEM_CONSTANT "DELIB_RDIAVALMINSIZECUR_SC" "2"
 SYSTEM_CONSTANT "DELIB_RPRECTLDWNMAINMAPSIZEX_SC" "2"
 SYSTEM_CONSTANT "DELIB_RPRECTLDWNMAINMAPSIZEY_SC" "2"
 SYSTEM_CONSTANT "DELIB_RPRECTLDWNMAPSIZEX_SC" "2"
 SYSTEM_CONSTANT "DELIB_RPRECTLDWNMAPSIZEY_SC" "2"
 SYSTEM_CONSTANT "DELIB_RPRECTLUPMAINMAPSIZEX_SC" "2"
 SYSTEM_CONSTANT "DELIB_RPRECTLUPMAINMAPSIZEY_SC" "2"
 SYSTEM_CONSTANT "DELIB_RPRECTLUPMAPSIZEX_SC" "2"
 SYSTEM_CONSTANT "DELIB_RPRECTLUPMAPSIZEY_SC" "2"
 SYSTEM_CONSTANT "DELIB_RPSMAXMAPSIZEX_SC" "2"
 SYSTEM_CONSTANT "DELIB_RPSMAXMAPSIZEY_SC" "2"
 SYSTEM_CONSTANT "DELIB_RQONE02051207_SC" "0"
 SYSTEM_CONSTANT "DELIB_RQONE02093116_SC" "0"
 SYSTEM_CONSTANT "DELIB_SENTCALULINSIZECUR_SC" "2"
 SYSTEM_CONSTANT "DELIB_SENT_SNSRERR_BP" "2"
 SYSTEM_CONSTANT "DELIB_SIMPLESWTAVL_SC" "1"
 SYSTEM_CONSTANT "DELIB_STCFCTACTR_ENA_BP" "0"
 SYSTEM_CONSTANT "DELIB_STCFCTACTR_FILDIR_BP" "2"
 SYSTEM_CONSTANT "DELIB_STCFCTACTR_TRLPTRDIR_BP" "1"
 SYSTEM_CONSTANT "DELIB_STDACTRTYPAVL_SC" "1"
 SYSTEM_CONSTANT "DELIB_STDACTRVDMON_DIGPWRSTGDIAG_FIRSTTMRCYC" "1"
 SYSTEM_CONSTANT "DELIB_STDACTRVDMON_DIGPWRSTGDIAG_SECTMRCYC" "2"
 SYSTEM_CONSTANT "DELIB_STDACTRVDMON_DIGPWRSTGDIAG_START" "0"
 SYSTEM_CONSTANT "DELIB_STDACTRVDMON_DIGPWRSTGDIAG_WAIT" "3"
 SYSTEM_CONSTANT "DELIB_STDACTR_VDMONLIB_FALSE" "0"
 SYSTEM_CONSTANT "DELIB_STDACTR_VDMONLIB_TRUE" "1"
 SYSTEM_CONSTANT "DELIB_STDIAGCURR_OLSCG_BP" "1"
 SYSTEM_CONSTANT "DELIB_STDIAGCURR_SWT_BP" "0"
 SYSTEM_CONSTANT "DELIB_STDSENSTYPAVL_SC" "1"
 SYSTEM_CONSTANT "DELIB_STFIXADJVAL_CHKSUM_ERR_BP" "0"
 SYSTEM_CONSTANT "DELIB_STFIXADJVAL_INTEGER_ERR_BP" "1"
 SYSTEM_CONSTANT "DELIB_STFIXADJVAL_RANGE_ERR_BP" "2"
 SYSTEM_CONSTANT "DELIB_STGRDTLIMNENVRL_CLNVRFYACTV_BP" "2"
 SYSTEM_CONSTANT "DELIB_STGRDTLIMNENVRL_ECU_POSTDRIVE_BP" "5"
 SYSTEM_CONSTANT "DELIB_STGRDTLIMNENVRL_ECU_PREDRIVE_BP" "4"
 SYSTEM_CONSTANT "DELIB_STGRDTLIMNENVRL_ENG_NOT_CRANKING_BP" "8"
 SYSTEM_CONSTANT "DELIB_STGRDTLIMNENVRL_ENG_NOT_RUNNING_BP" "9"
 SYSTEM_CONSTANT "DELIB_STGRDTLIMNENVRL_ENG_NOT_STOPPING_BP" "10"
 SYSTEM_CONSTANT "DELIB_STGRDTLIMNENVRL_INDEPENDENT_OF_ENVCOND_BP" "0"
 SYSTEM_CONSTANT "DELIB_STGRDTLIMNENVRL_LRN_ACTIVE_BP" "3"
 SYSTEM_CONSTANT "DELIB_STGRDTLIMNENVRL_T15_OFF_BP" "7"
 SYSTEM_CONSTANT "DELIB_STGRDTLIMNENVRL_T15_ON_BP" "6"
 SYSTEM_CONSTANT "DELIB_STGRDTLIMNENVRL_TEMP_VALID_NOT_REACHED_BP" "1"
 SYSTEM_CONSTANT "DELIB_STMONGOVROUTPRAMP_LNRGOVRLMT_BP" "0"
 SYSTEM_CONSTANT "DELIB_STMONGRDTLIMN_ININDONE_BP" "0"
 SYSTEM_CONSTANT "DELIB_STMONRCOIL_INIDONE_BP" "0"
 SYSTEM_CONSTANT "DELIB_STMONRCOIL_RPL_BP" "1"
 SYSTEM_CONSTANT "DELIB_TIDIAGDISSIZECUR_SC" "2"
 SYSTEM_CONSTANT "DELIB_TOTALSNSR_SC" "10"
 SYSTEM_CONSTANT "DELIB_UTOFFSADJCLSDSIZECRV_SC" "2"
 SYSTEM_CONSTANT "DELIB_UTOFFSADJOPENDSIZECRV_SC" "2"
 SYSTEM_CONSTANT "DELIB_VARIANT" "1170"
 SYSTEM_CONSTANT "DELIB_VERSION" "1621"
 SYSTEM_CONSTANT "DEM_ENABLECONDITION_CONFIG" "0"
 SYSTEM_CONSTANT "DEM_GENERAL_INTERFACE_SUPPORT" "0"
 SYSTEM_CONSTANT "DENSFINE_RES_REV" "500"
 SYSTEM_CONSTANT "DEVLIB_4WINDIACMPNENA_SY" "0"
 SYSTEM_CONSTANT "DEVLIB_ACTRPRTCMPNENA_SY" "0"
 SYSTEM_CONSTANT "DEVLIB_DBG_SY" "1"
 SYSTEM_CONSTANT "DEVLIB_DEFECT_RAMP_ACTIVE_BP" "4"
 SYSTEM_CONSTANT "DEVLIB_DEFECT_RAMP_COMPLETED_BP" "3"
 SYSTEM_CONSTANT "DEVLIB_DGK_ACTV" "1"
 SYSTEM_CONSTANT "DEVLIB_DGK_NOTACTV" "0"
 SYSTEM_CONSTANT "DEVLIB_DIACTLLINECMPNENA_SY" "0"
 SYSTEM_CONSTANT "DEVLIB_FRZVAL_EXTMODE" "8"
 SYSTEM_CONSTANT "DEVLIB_FRZVAL_MODE" "1"
 SYSTEM_CONSTANT "DEVLIB_HBRGENA_SY" "0"
 SYSTEM_CONSTANT "DEVLIB_HEALING_RAMP_ACTIVE_BP" "2"
 SYSTEM_CONSTANT "DEVLIB_HEALING_RAMP_DESIRED_BP" "1"
 SYSTEM_CONSTANT "DEVLIB_JMPVAL_MODE" "2"
 SYSTEM_CONSTANT "DEVLIB_PHYSRNGCHK_SY" "1"
 SYSTEM_CONSTANT "DEVLIB_PSOFFOPNLD_SY" "0"
 SYSTEM_CONSTANT "DEVLIB_PSSTATEMOCSOPINI_SY" "0"
 SYSTEM_CONSTANT "DEVLIB_PWRSTGSTATEMOCSOPCHK_SY" "1"
 SYSTEM_CONSTANT "DEVLIB_RMPVAL_MODE" "4"
 SYSTEM_CONSTANT "DEVLIB_SENSVAL_MODE" "0"
 SYSTEM_CONSTANT "DFC_CALPRMSTATDISBLMSK_SC" "0"
 SYSTEM_CONSTANT "DFC_CTLDISBLLAYOUT_SY" "1"
 SYSTEM_CONSTANT "DFC_CTLMSKBYTES_SY" "1"
 SYSTEM_CONSTANT "DFC_CTLMSK_RESCANCMSK" "1"
 SYSTEM_CONSTANT "DFC_CTLMSK_RESINIMSK" "1"
 SYSTEM_CONSTANT "DFC_DISBLMSKBYTES_SY" "2"
 SYSTEM_CONSTANT "DFC_SETSTATDITHOAPI_SC" "0"
 SYSTEM_CONSTANT "DFESOBSVR_BSIMIRRSIZE_SC" "0"
 SYSTEM_CONSTANT "DFES_ACTVENHMTSIMCONDPID9F_SC" "0"
 SYSTEM_CONSTANT "DFES_ACTVSIMRCDNPID03_SC" "0"
 SYSTEM_CONSTANT "DFES_ADDLMILMOD_SC" "0"
 SYSTEM_CONSTANT "DFES_AGINGCTR_VAR1" "0"
 SYSTEM_CONSTANT "DFES_BLKENTRY_SY" "0"
 SYSTEM_CONSTANT "DFES_COMMILDEB_SY" "0"
 SYSTEM_CONSTANT "DFES_DTC_TSTFAIL_SY" "0"
 SYSTEM_CONSTANT "DFES_EOLCLR_SY" "1"
 SYSTEM_CONSTANT "DFES_EXTDFLT_SY" "0"
 SYSTEM_CONSTANT "DFES_IMDTNVSTORG_SC" "0"
 SYSTEM_CONSTANT "DFES_IRV_SY" "0"
 SYSTEM_CONSTANT "DFES_MONITORING_LEN_SY" "2"
 SYSTEM_CONSTANT "DFES_NUMENTRIES_SY" "20"
 SYSTEM_CONSTANT "DFES_NUM_COMMON_ENV_DID" "25"
 SYSTEM_CONSTANT "DFES_NUM_COMMON_ENV_SIGNALS" "0"
 SYSTEM_CONSTANT "DFES_NUM_ENTRY_U8_BITBASE" "3"
 SYSTEM_CONSTANT "DFES_NUM_ENV_BLK" "2"
 SYSTEM_CONSTANT "DFES_NUM_ENV_BYT" "90"
 SYSTEM_CONSTANT "DFES_NUM_ENV_DID" "20"
 SYSTEM_CONSTANT "DFES_NUM_ENV_SIGNALS" "0"
 SYSTEM_CONSTANT "DFES_NUM_EXFRZFR_BYT" "0"
 SYSTEM_CONSTANT "DFES_NUM_FRFR_DID" "1"
 SYSTEM_CONSTANT "DFES_NUM_FRZFR_BYT" "1"
 SYSTEM_CONSTANT "DFES_PDTC_SY" "0"
 SYSTEM_CONSTANT "DFES_SIMCOND_READONLY" "0"
 SYSTEM_CONSTANT "DFES_VIS_BUF_SY" "1"
 SYSTEM_CONSTANT "DIAACTR_ELECCTRLLINEDIAGCPTENA_SC" "0"
 SYSTEM_CONSTANT "DIAACTR_ELECHBRDGDIAGENA_SC" "1"
 SYSTEM_CONSTANT "DIAACTR_ELECHBRDGDIAG_CTRLNOT" "0"
 SYSTEM_CONSTANT "DIAACTR_ELECHBRDGDIAG_CTRLSWTOFF" "1"
 SYSTEM_CONSTANT "DIAACTR_ELECHBRDGDIAG_CTRLSWTOFFDIAG" "3"
 SYSTEM_CONSTANT "DIAACTR_ELECHBRDGDIAG_CTRLTESTPLS" "2"
 SYSTEM_CONSTANT "DIAACTR_ELECHBRDGDIAG_DIAG_OK" "0"
 SYSTEM_CONSTANT "DIAACTR_ELECHBRDGDIAG_DIAG_TRO_SIGNOTINI" "1"
 SYSTEM_CONSTANT "DIAACTR_ELECHBRDGDIAG_ERRCURRLIMN" "9"
 SYSTEM_CONSTANT "DIAACTR_ELECHBRDGDIAG_ERRCURRREDN" "10"
 SYSTEM_CONSTANT "DIAACTR_ELECHBRDGDIAG_ERRINI_FAIL_ERRARYFULL" "1"
 SYSTEM_CONSTANT "DIAACTR_ELECHBRDGDIAG_ERRINI_FAIL_INVLDERRTYPE" "2"
 SYSTEM_CONSTANT "DIAACTR_ELECHBRDGDIAG_ERRINI_FAIL_MPLDFC" "3"
 SYSTEM_CONSTANT "DIAACTR_ELECHBRDGDIAG_ERRINI_FAIL_MPLERRTYP" "4"
 SYSTEM_CONSTANT "DIAACTR_ELECHBRDGDIAG_ERRINI_SUC" "0"
 SYSTEM_CONSTANT "DIAACTR_ELECHBRDGDIAG_ERROPENLOAD" "7"
 SYSTEM_CONSTANT "DIAACTR_ELECHBRDGDIAG_ERROVERT" "6"
 SYSTEM_CONSTANT "DIAACTR_ELECHBRDGDIAG_ERRSCB1" "1"
 SYSTEM_CONSTANT "DIAACTR_ELECHBRDGDIAG_ERRSCB2" "2"
 SYSTEM_CONSTANT "DIAACTR_ELECHBRDGDIAG_ERRSCG1" "3"
 SYSTEM_CONSTANT "DIAACTR_ELECHBRDGDIAG_ERRSCG2" "4"
 SYSTEM_CONSTANT "DIAACTR_ELECHBRDGDIAG_ERRSCOL" "5"
 SYSTEM_CONSTANT "DIAACTR_ELECHBRDGDIAG_ERRUNDRU" "8"
 SYSTEM_CONSTANT "DIAACTR_ELECHBRDGDIAG_OLABORT" "4"
 SYSTEM_CONSTANT "DIAACTR_ELECHBRDGDIAG_OLABORT_ACCPT" "0"
 SYSTEM_CONSTANT "DIAACTR_ELECHBRDGDIAG_OLABORT_REJ_OLDIAGNOTACTV" "4"
 SYSTEM_CONSTANT "DIAACTR_ELECHBRDGDIAG_OLABORT_REJ_OLERRNOTINI" "3"
 SYSTEM_CONSTANT "DIAACTR_ELECHBRDGDIAG_OLABORT_REJ_OLMODINCOR" "2"
 SYSTEM_CONSTANT "DIAACTR_ELECHBRDGDIAG_OLABORT_REJ_SIGNOTINI" "1"
 SYSTEM_CONSTANT "DIAACTR_ELECHBRDGDIAG_OLMODACTV" "2"
 SYSTEM_CONSTANT "DIAACTR_ELECHBRDGDIAG_OLMODNOTCFG" "0"
 SYSTEM_CONSTANT "DIAACTR_ELECHBRDGDIAG_OLMODSWTOFF" "1"
 SYSTEM_CONSTANT "DIAACTR_ELECHBRDGDIAG_OLNOTREQD" "0"
 SYSTEM_CONSTANT "DIAACTR_ELECHBRDGDIAG_OLOVER" "3"
 SYSTEM_CONSTANT "DIAACTR_ELECHBRDGDIAG_OLREQD" "1"
 SYSTEM_CONSTANT "DIAACTR_ELECHBRDGDIAG_OLREQ_ACCPT" "0"
 SYSTEM_CONSTANT "DIAACTR_ELECHBRDGDIAG_OLREQ_REJ_OLDIAGACTV" "4"
 SYSTEM_CONSTANT "DIAACTR_ELECHBRDGDIAG_OLREQ_REJ_OLERRNOTINI" "3"
 SYSTEM_CONSTANT "DIAACTR_ELECHBRDGDIAG_OLREQ_REJ_OLMODINCOR" "2"
 SYSTEM_CONSTANT "DIAACTR_ELECHBRDGDIAG_OLREQ_REJ_SIGNOTINI" "1"
 SYSTEM_CONSTANT "DIAACTR_ELECHBRDGDIAG_OLRUNNG" "2"
 SYSTEM_CONSTANT "DIAACTR_ELECHBRDGDIAG_SETOLMOD_FAIL_INVLDMOD" "1"
 SYSTEM_CONSTANT "DIAACTR_ELECHBRDGDIAG_SETOLMOD_FAIL_OLMODNOTSWIL" "2"
 SYSTEM_CONSTANT "DIAACTR_ELECHBRDGDIAG_SETOLMOD_SUC" "0"
 SYSTEM_CONSTANT "DIAACTR_ELECHBRDGDIAG_SIGNALTYPE_HBR" "0"
 SYSTEM_CONSTANT "DIAACTR_ELECHBRDGDIAG_SIGNALTYPE_HLFBR" "1"
 SYSTEM_CONSTANT "DIAACTR_ELECPSDIAGCMPNENA_SC" "1"
 SYSTEM_CONSTANT "DIAACTR_ELECPSDIAGERRINFO_SC" "1"
 SYSTEM_CONSTANT "DIAACTR_ERRTYPE_NRMAX" "4"
 SYSTEM_CONSTANT "DIAACTR_ERRTYPE_OL" "3"
 SYSTEM_CONSTANT "DIAACTR_ERRTYPE_OT" "4"
 SYSTEM_CONSTANT "DIAACTR_ERRTYPE_SCB" "1"
 SYSTEM_CONSTANT "DIAACTR_ERRTYPE_SCG" "2"
 SYSTEM_CONSTANT "DIAACTR_ERRTYPE_UNDEFINED" "0"
 SYSTEM_CONSTANT "DIAACTR_SIGTYPE_DIGOUT" "1"
 SYSTEM_CONSTANT "DIAACTR_SIGTYPE_PMD" "3"
 SYSTEM_CONSTANT "DIAACTR_SIGTYPE_PWMOUT" "2"
 SYSTEM_CONSTANT "DIAACTR_SIGTYPE_UNDEFINED" "0"
 SYSTEM_CONSTANT "DIABAS_ATSLRGIDSUPRT_SC" "0"
 SYSTEM_CONSTANT "DIABAS_ATSSUSP_SC" "1"
 SYSTEM_CONSTANT "DIABAS_ATS_SC" "1"
 SYSTEM_CONSTANT "DIABAS_AVS_SY" "1"
 SYSTEM_CONSTANT "DIABAS_BSWVERS_SC" "30"
 SYSTEM_CONSTANT "DIABAS_CALIDCVNCTRL_SC" "1"
 SYSTEM_CONSTANT "DIABAS_CALIDCVNLENSEQ_SC" "0"
 SYSTEM_CONSTANT "DIABAS_CRCTAB_SY" "0"
 SYSTEM_CONSTANT "DIABAS_ETCINTSTATE_SC" "0"
 SYSTEM_CONSTANT "DIABAS_IFFLOATSIG_SC" "0"
 SYSTEM_CONSTANT "DIABAS_PNDRPRTMOD2_SC" "0"
 SYSTEM_CONSTANT "DIABAS_PRMIDAUTVIEW_SC" "0"
 SYSTEM_CONSTANT "DIABAS_SCRCTL_RCNT_RESET_SY" "0"
 SYSTEM_CONSTANT "DIABAS_SRV8_SC" "0"
 SYSTEM_CONSTANT "DIACTR_TSTPLSCNTR_CFG_ALL" "0"
 SYSTEM_CONSTANT "DIACTR_TSTPLSCNTR_CFG_SCB" "1"
 SYSTEM_CONSTANT "DIACTR_TSTPLSCNTR_CFG_SCG" "2"
 SYSTEM_CONSTANT "DIAGADAPT_SC" "1"
 SYSTEM_CONSTANT "DIAGCOM_CALCAN_SC" "0"
 SYSTEM_CONSTANT "DINH_DEF25DEB0DI_SC" "0"
 SYSTEM_CONSTANT "DINH_FID_VIEW_SC" "0"
 SYSTEM_CONSTANT "DINH_NEWTRIPWITHFCMCLR_SC" "0"
 SYSTEM_CONSTANT "DIPO_SY" "1"
 SYSTEM_CONSTANT "DISTAB_SY" "1"
 SYSTEM_CONSTANT "DIUMPR_500MD_SY" "0"
 SYSTEM_CONSTANT "DIUMPR_COLDSTARTDEN_SC" "0"
 SYSTEM_CONSTANT "DIUMPR_DATAFROMCAN_SC" "0"
 SYSTEM_CONSTANT "DIUMPR_DSTTRVLDSNCERST_SC" "0"
 SYSTEM_CONSTANT "DIUMPR_EVAPDENOMTIPRPSYSOFF_SC" "0"
 SYSTEM_CONSTANT "DIUMPR_EVAPDEN_SY" "0"
 SYSTEM_CONSTANT "DIUMPR_FUENGOPERTI_SC" "0"
 SYSTEM_CONSTANT "DIUMPR_IGNCYCTMR_SC" "0"
 SYSTEM_CONSTANT "DIUMPR_NUMDENOMIDXGRP_SY" "0"
 SYSTEM_CONSTANT "DIUMPR_NUMMSGGRPS" "0"
 SYSTEM_CONSTANT "DIUMPR_NUMRATCFG" "0"
 SYSTEM_CONSTANT "DIUMPR_NUMRATCLB" "0"
 SYSTEM_CONSTANT "DIUMPR_NUMSIGCLB" "0"
 SYSTEM_CONSTANT "DIUMPR_NUM_GROUPS_SY" "0"
 SYSTEM_CONSTANT "DM_SOX2_RES_FL" "0.004"
 SYSTEM_CONSTANT "DOIP_SC" "0"
 SYSTEM_CONSTANT "DPDIFFTMP_RES" "100"
 SYSTEM_CONSTANT "DPDIFF_RES" "0.1"
 SYSTEM_CONSTANT "DPRC_100" "100"
 SYSTEM_CONSTANT "DPRC_M_100" "-100"
 SYSTEM_CONSTANT "DREQSWT_CLRSWTSIG_SY" "0"
 SYSTEM_CONSTANT "DRESFLW_RES" "0.001"
 SYSTEM_CONSTANT "DRESFLW_RES_REV" "1000"
 SYSTEM_CONSTANT "DRVGRDN_PROHB" "0"
 SYSTEM_CONSTANT "DRVGRDN_PTD" "1"
 SYSTEM_CONSTANT "DRVMODSELN_STGEARPOSNB1" "24"
 SYSTEM_CONSTANT "DRVMODSELN_STGEARPOSNB2" "44"
 SYSTEM_CONSTANT "DRVMODSELN_STGEARPOSNF1" "11"
 SYSTEM_CONSTANT "DRVMODSELN_STGEARPOSNF2" "22"
 SYSTEM_CONSTANT "DRVMODSELN_STGEARPOSNH" "5"
 SYSTEM_CONSTANT "DRVMOD_DRV" "3"
 SYSTEM_CONSTANT "DRVMOD_NEUT" "2"
 SYSTEM_CONSTANT "DRVMOD_NOREQ" "6"
 SYSTEM_CONSTANT "DRVMOD_PARK" "0"
 SYSTEM_CONSTANT "DRVMOD_RVS" "1"
 SYSTEM_CONSTANT "DRVPRGSWT_ECOMODACTV" "1"
 SYSTEM_CONSTANT "DRVPRGSWT_ECOSWT_SC" "3"
 SYSTEM_CONSTANT "DRVPRGSWT_NORMMODACTV" "0"
 SYSTEM_CONSTANT "DRVPRGSWT_NRRCPTSTG_SC" "4"
 SYSTEM_CONSTANT "DRVPRGSWT_NUMMODE" "0"
 SYSTEM_CONSTANT "DRVPRGSWT_NUMSPRT" "0"
 SYSTEM_CONSTANT "DRVPRGSWT_NUMWNTR" "0"
 SYSTEM_CONSTANT "DRVPRGSWT_RCPTSWT_SC" "0"
 SYSTEM_CONSTANT "DRVPRGSWT_SPTMODACTV" "2"
 SYSTEM_CONSTANT "DRVPRGSWT_SPTSWT_SC" "0"
 SYSTEM_CONSTANT "DRVPRG_SC" "1"
 SYSTEM_CONSTANT "DRVPROGCOORR_SC" "1"
 SYSTEM_CONSTANT "DRVRBLTIFTYP_SC" "4"
 SYSTEM_CONSTANT "DRVRDOORIFTYP_SC" "4"
 SYSTEM_CONSTANT "DSCHED_COEOMEXT_SC" "0"
 SYSTEM_CONSTANT "DSCHED_COEOM_SY" "0"
 SYSTEM_CONSTANT "DSCHED_FIDMAXPRIOLST_SY" "0"
 SYSTEM_CONSTANT "DSCHED_FTI_SY" "0"
 SYSTEM_CONSTANT "DSCHED_PRIOACTVJMP_SY" "0"
 SYSTEM_CONSTANT "DSCHED_PRIODFCSTLDF_SY" "0"
 SYSTEM_CONSTANT "DSCHED_PRIODFCSTTST_SY" "0"
 SYSTEM_CONSTANT "DSCHED_PRIOPHYSURGENCY_SY" "0"
 SYSTEM_CONSTANT "DSCHED_PRIORMPCALC_SY" "0"
 SYSTEM_CONSTANT "DSCHED_RATECALC_SY" "0"
 SYSTEM_CONSTANT "DSCHED_WTT_SY" "0"
 SYSTEM_CONSTANT "DSHBTESTSUPRT_SC" "0"
 SYSTEM_CONSTANT "DSM2AUTOSAR_ASWPF_SC" "0"
 SYSTEM_CONSTANT "DSM2AUTOSAR_DCMIF_SC" "0"
 SYSTEM_CONSTANT "DSM2AUTOSAR_DEMBSWERRORBUFFERSIZE" "30"
 SYSTEM_CONSTANT "DSM2AUTOSAR_DEV_ERROR_DETECT" "1"
 SYSTEM_CONSTANT "DSM2AUTOSAR_NRDEMCLIENT" "0"
 SYSTEM_CONSTANT "DSM2AUTOSAR_NRDEMCLIENTFULLSUPPORT" "0"
 SYSTEM_CONSTANT "DSM2AUTOSAR_NRDEMCLIENTNOFULLSUPPORT" "0"
 SYSTEM_CONSTANT "DSM2AUTOSAR_NRDEMCLIENTRTESUPPORT" "0"
 SYSTEM_CONSTANT "DSM2AUTOSAR_SC" "1"
 SYSTEM_CONSTANT "DSM2AUTOSAR_SECFCM_SC" "0"
 SYSTEM_CONSTANT "DSM2SG_EXCH_SC" "0"
 SYSTEM_CONSTANT "DSMAUX_READONLY" "0"
 SYSTEM_CONSTANT "DSMAUX_ROEBUFLEN" "5"
 SYSTEM_CONSTANT "DSMAUX_ROEBUFUSEENVRAM" "0"
 SYSTEM_CONSTANT "DSMAUX_TCSORT_SY" "0"
 SYSTEM_CONSTANT "DSMBAS_CENSUPPDIUMPR_SC" "0"
 SYSTEM_CONSTANT "DSMBAS_CENSUPPDTR_SC" "0"
 SYSTEM_CONSTANT "DSMBAS_ENACFMDFLTCNTR_SC" "0"
 SYSTEM_CONSTANT "DSMBAS_ENAOPTMZDRDNFORCMPHCPT_SC" "0"
 SYSTEM_CONSTANT "DSMBAS_ENASIMRCDN_SC" "0"
 SYSTEM_CONSTANT "DSMBAS_ENASVS_SC" "1"
 SYSTEM_CONSTANT "DSMBAS_ENVTLBLKUPD_SC" "0"
 SYSTEM_CONSTANT "DSMBAS_KEYONCYCFLCTRIG_SC" "0"
 SYSTEM_CONSTANT "DSMBAS_MILWODEV_SC" "0"
 SYSTEM_CONSTANT "DSMBAS_NEWDCYCWITHFCMCLR_SC" "0"
 SYSTEM_CONSTANT "DSMBAS_NODFP_SC" "0"
 SYSTEM_CONSTANT "DSMBAS_NODIAGCSDL_SC" "1"
 SYSTEM_CONSTANT "DSMBAS_NODTR_SC" "1"
 SYSTEM_CONSTANT "DSMBAS_PNDRPRTMOD2_SC" "1"
 SYSTEM_CONSTANT "DSMBAS_PREFAILDINTDEB_SC" "0"
 SYSTEM_CONSTANT "DSMBAS_REINIMETHSELN_SC" "0"
 SYSTEM_CONSTANT "DSMBAS_SELNPID93BHVR_SC" "0"
 SYSTEM_CONSTANT "DSMBAS_SELPID41BHVR_SC" "0"
 SYSTEM_CONSTANT "DSMBAS_TESTFAILDSNCELSTCLR_SC" "0"
 SYSTEM_CONSTANT "DSMCONF_DEBMULDCY_SC" "0"
 SYSTEM_CONSTANT "DSMCONF_DFCCTTSTD" "0"
 SYSTEM_CONSTANT "DSMCONF_DTCTABLE_DTCM" "1"
 SYSTEM_CONSTANT "DSMCONF_DTCTABLE_DTCX" "0"
 SYSTEM_CONSTANT "DSMCONF_NUM_CLASSES" "4"
 SYSTEM_CONSTANT "DSMCONF_SUPGLBCTLMSK" "0"
 SYSTEM_CONSTANT "DSMCONF_SUPGLBDBLV" "1"
 SYSTEM_CONSTANT "DSMCONF_SUPGLBDISBLMSK" "0"
 SYSTEM_CONSTANT "DSMCONF_SUPGLBDTCFUNCUNIT" "1"
 SYSTEM_CONSTANT "DSMCONF_SUPGLBDTCGROUP" "1"
 SYSTEM_CONSTANT "DSMCONF_SUPGLBDTCSEVERITY" "1"
 SYSTEM_CONSTANT "DSMCONF_SUPGLBENVREF" "0"
 SYSTEM_CONSTANT "DSMCONF_SUPGLBFAULTTYP" "0"
 SYSTEM_CONSTANT "DSMCONF_SUPGLBFLTCLS" "0"
 SYSTEM_CONSTANT "DSMCONF_SUP_DFC_STUNCFMDTHISKEYONCYC" "0"
 SYSTEM_CONSTANT "DSMCONF_SUP_TNPSCPU" "0"
 SYSTEM_CONSTANT "DSMCONF_SUP_TNPSDTCC" "0"
 SYSTEM_CONSTANT "DSMDFC_BAS16BITARYSIZE" "61"
 SYSTEM_CONSTANT "DSMDUR_MIL_GLB_SY" "0"
 SYSTEM_CONSTANT "DSMDUR_NUM_DFES_CNT" "0"
 SYSTEM_CONSTANT "DSMDUR_NUM_GLB_CNT" "0"
 SYSTEM_CONSTANT "DSMDUR_SUPPID4D_SC" "0"
 SYSTEM_CONSTANT "DSMDUR_SUPPID4E_SC" "0"
 SYSTEM_CONSTANT "DSMRDY_ENA_FLSYSFORCELABEL_SC" "0"
 SYSTEM_CONSTANT "DSMRDY_ENGSPEC_SY" "1"
 SYSTEM_CONSTANT "DSMRDY_ENVCOND_SUP" "0"
 SYSTEM_CONSTANT "DSMRDY_FIDINH_SUP" "0"
 SYSTEM_CONSTANT "DSMRDY_FLSYSNONCONT" "0"
 SYSTEM_CONSTANT "DSMRDY_INHP41_SY" "0"
 SYSTEM_CONSTANT "DSMRDY_READONLY" "0"
 SYSTEM_CONSTANT "DSMRDY_READONLYGRP" "0"
 SYSTEM_CONSTANT "DSMRDY_SIZE_LST_Cat" "15"
 SYSTEM_CONSTANT "DSMRDY_SIZE_LST_ComprCmpnt" "15"
 SYSTEM_CONSTANT "DSMRDY_SIZE_LST_EGR" "15"
 SYSTEM_CONSTANT "DSMRDY_SIZE_LST_EvpSys" "15"
 SYSTEM_CONSTANT "DSMRDY_SIZE_LST_FlSys" "15"
 SYSTEM_CONSTANT "DSMRDY_SIZE_LST_GPF" "15"
 SYSTEM_CONSTANT "DSMRDY_SIZE_LST_HtCat" "15"
 SYSTEM_CONSTANT "DSMRDY_SIZE_LST_Misf" "15"
 SYSTEM_CONSTANT "DSMRDY_SIZE_LST_O2Sens" "15"
 SYSTEM_CONSTANT "DSMRDY_SIZE_LST_O2SensHt" "15"
 SYSTEM_CONSTANT "DSMRDY_SIZE_LST_SecAirSys" "15"
 SYSTEM_CONSTANT "DSMRDY_STDCONFIG" "0"
 SYSTEM_CONSTANT "DSMRDY_SUPPID41_SY" "0"
 SYSTEM_CONSTANT "DSMRDY_VERS_SC" "1"
 SYSTEM_CONSTANT "DSM_CONF_SUP_DFC_STCLCTLDF" "1"
 SYSTEM_CONSTANT "DSM_CONF_SUP_DSMRDY_CT" "0"
 SYSTEM_CONSTANT "DSM_CONF_SUP_DSMRDY_XWHY" "0"
 SYSTEM_CONSTANT "DSM_DISBLGRPSIZE_SY" "0"
 SYSTEM_CONSTANT "DSM_DOBD_SC" "0"
 SYSTEM_CONSTANT "DSM_DSM2SG_SY" "0"
 SYSTEM_CONSTANT "DSM_DSMAPLCTRLDDIAGCYC_SC" "0"
 SYSTEM_CONSTANT "DSM_FAILCNT_SY" "0"
 SYSTEM_CONSTANT "DSM_FAULTSEQ_SY" "0"
 SYSTEM_CONSTANT "DSM_INHRLS_SY" "0"
 SYSTEM_CONSTANT "DSM_MPU_ENABLED" "0"
 SYSTEM_CONSTANT "DSM_NUMDFC" "965"
 SYSTEM_CONSTANT "DSM_NUMFID" "1140"
 SYSTEM_CONSTANT "DSM_NUM_MPU_PARTITIONS" "0"
 SYSTEM_CONSTANT "DSM_WUCDET_SY" "5"
 SYSTEM_CONSTANT "DTR_LEGIFC_SY" "0"
 SYSTEM_CONSTANT "DTTEMP_300" "300"
 SYSTEM_CONSTANT "DTTEMP_M_300" "-300"
 SYSTEM_CONSTANT "DTY_CYC_ZERO" "0"
 SYSTEM_CONSTANT "DT_KELV_RES" "0.1"
 SYSTEM_CONSTANT "DVOL_RES" "0.1"
 SYSTEM_CONSTANT "D_FLCONS_RES" "0.01"
 SYSTEM_CONSTANT "ECBVLV_TYPAVL_SY" "0"
 SYSTEM_CONSTANT "ECUOFF_TMR_SY" "4"
 SYSTEM_CONSTANT "ECUTYP_SC" "2"
 SYSTEM_CONSTANT "ECU_GENR_SY" "6"
 SYSTEM_CONSTANT "EDRVMULTIGEARTRSM_SC" "0"
 SYSTEM_CONSTANT "EEM_ACTV" "132"
 SYSTEM_CONSTANT "EEM_BATTCHAC_ERR" "15"
 SYSTEM_CONSTANT "EEM_BATTCHAC_LO" "2"
 SYSTEM_CONSTANT "EEM_FATALFLT" "134"
 SYSTEM_CONSTANT "EEM_FAULTEXIT" "6"
 SYSTEM_CONSTANT "EEM_IGNORE" "128"
 SYSTEM_CONSTANT "EEM_IGNORE2" "135"
 SYSTEM_CONSTANT "EEM_NORMAL" "10"
 SYSTEM_CONSTANT "EEM_OFF" "0"
 SYSTEM_CONSTANT "EEM_OFFREQUEST" "12"
 SYSTEM_CONSTANT "EEM_PRECHARGE" "1"
 SYSTEM_CONSTANT "EEM_RDYHV" "131"
 SYSTEM_CONSTANT "EEM_RDYOFF" "133"
 SYSTEM_CONSTANT "EEM_RDYPRECHARGE" "130"
 SYSTEM_CONSTANT "EEM_STARTUP" "129"
 SYSTEM_CONSTANT "EEM_ST_DCDCFWD" "1"
 SYSTEM_CONSTANT "EEM_ST_DCDCOFF" "0"
 SYSTEM_CONSTANT "EEM_ST_DCDCPREC" "4"
 SYSTEM_CONSTANT "EGREVAPRUSFLDP_TYPAVL_SC" "0"
 SYSTEM_CONSTANT "EGRVLVINSDT_TYPAVL_SC" "0"
 SYSTEM_CONSTANT "EGRVLVI_TYPAVL_SC" "0"
 SYSTEM_CONSTANT "EGRVLVLPI_TYPAVL_SC" "0"
 SYSTEM_CONSTANT "EGTCOND_ACTV_BP" "0"
 SYSTEM_CONSTANT "EGTSWT_FACT" "16384000"
 SYSTEM_CONSTANT "EGTSWT_FACT_S16" "16384"
 SYSTEM_CONSTANT "EGTSWT_NRM_EXP" "14"
 SYSTEM_CONSTANT "EGTSWT_RES" "6.103515625e-008"
 SYSTEM_CONSTANT "EGTSWT_RES_S16" "6.103515625e-005"
 SYSTEM_CONSTANT "ELDEV_DSQACTVT_SC" "1"
 SYSTEM_CONSTANT "ELEC_ERR_MAX" "1"
 SYSTEM_CONSTANT "ELEC_ERR_MIN" "0"
 SYSTEM_CONSTANT "ELEC_IMPS" "2"
 SYSTEM_CONSTANT "ELEC_LOCKD" "3"
 SYSTEM_CONSTANT "ELEC_PLGD" "3"
 SYSTEM_CONSTANT "ELEC_UNLOCKD" "4"
 SYSTEM_CONSTANT "ELEC_UNPLGD" "4"
 SYSTEM_CONSTANT "ELM_ACTVSC" "21"
 SYSTEM_CONSTANT "ELM_DCHA" "27"
 SYSTEM_CONSTANT "ELM_EMGYSHTDWN" "30"
 SYSTEM_CONSTANT "ELM_ENGSTRT" "3"
 SYSTEM_CONSTANT "ELM_FAILR" "31"
 SYSTEM_CONSTANT "ELM_FW" "20"
 SYSTEM_CONSTANT "ELM_HILLHLD" "15"
 SYSTEM_CONSTANT "ELM_ICTRL" "8"
 SYSTEM_CONSTANT "ELM_IDLECTL" "9"
 SYSTEM_CONSTANT "ELM_INI" "0"
 SYSTEM_CONSTANT "ELM_ISOMON" "10"
 SYSTEM_CONSTANT "ELM_OFF" "29"
 SYSTEM_CONSTANT "ELM_OFFSETCALIB" "6"
 SYSTEM_CONSTANT "ELM_PRERUN" "1"
 SYSTEM_CONSTANT "ELM_QUAL_ALL_OK" "0"
 SYSTEM_CONSTANT "ELM_QUAL_DEFAULT" "12"
 SYSTEM_CONSTANT "ELM_QUAL_FROZEN" "8"
 SYSTEM_CONSTANT "ELM_QUAL_INIT" "10"
 SYSTEM_CONSTANT "ELM_QUAL_INVALID" "15"
 SYSTEM_CONSTANT "ELM_QUAL_SENDERINIT" "11"
 SYSTEM_CONSTANT "ELM_SHTDWN" "28"
 SYSTEM_CONSTANT "ELM_SPDCTLP" "50"
 SYSTEM_CONSTANT "ELM_SPDCTLPI" "51"
 SYSTEM_CONSTANT "ELM_SPDCTRL" "5"
 SYSTEM_CONSTANT "ELM_STBY" "2"
 SYSTEM_CONSTANT "ELM_TRQCTL" "4"
 SYSTEM_CONSTANT "ELM_VLTGCTL" "7"
 SYSTEM_CONSTANT "ELSS_HVENA_SC" "1"
 SYSTEM_CONSTANT "ElSS_HVVAR_SC" "21"
 SYSTEM_CONSTANT "ELSS_LVBATTTESTPLS_SC" "0"
 SYSTEM_CONSTANT "ELTS_EVINFOENA_SC" "1"
 SYSTEM_CONSTANT "EM01PRSNT_SC" "1"
 SYSTEM_CONSTANT "EM02PRSNT_SC" "0"
 SYSTEM_CONSTANT "EM03PRSNT_SC" "0"
 SYSTEM_CONSTANT "EM04PRSNT_SC" "0"
 SYSTEM_CONSTANT "EM05PRSNT_SC" "0"
 SYSTEM_CONSTANT "EMGYSHOFFIN2_TYPAVL_SC" "0"
 SYSTEM_CONSTANT "EMGYSTRTSWT2_TYPAVL_SC" "0"
 SYSTEM_CONSTANT "EMWAKEUPSIG_TYPAVL_SC" "0"
 SYSTEM_CONSTANT "ENADATASETID_CALPAR_SC" "1"
 SYSTEM_CONSTANT "ENERGY_J_HI_RES" "1"
 SYSTEM_CONSTANT "ENERGY_Q0P0001_RES" "0.0001"
 SYSTEM_CONSTANT "ENERGY_Q0P0001_RES_REV" "10000"
 SYSTEM_CONSTANT "ENERGY_Q0P001_RES" "0.001"
 SYSTEM_CONSTANT "ENERGY_Q0P001_RES_REV" "1000"
 SYSTEM_CONSTANT "ENERGY_RES" "1"
 SYSTEM_CONSTANT "ENGCMPTMTT_TYPAVL_SY" "0"
 SYSTEM_CONSTANT "ENGDA_CTFLD_NUM" "1"
 SYSTEM_CONSTANT "ENGMIDT_TYPAVL_SC" "0"
 SYSTEM_CONSTANT "ENGOILT_TYPAVL_SC" "0"
 SYSTEM_CONSTANT "ENRGPERMASS_RES" "0.1"
 SYSTEM_CONSTANT "ENVP_ATS_SY" "0"
 SYSTEM_CONSTANT "ENVP_TYPAVL_SY" "1"
 SYSTEM_CONSTANT "ENVT_TYPAVL_SY" "1"
 SYSTEM_CONSTANT "EPMHCRS_NUMINC" "0"
 SYSTEM_CONSTANT "EPM_SPD_ZERO" "0"
 SYSTEM_CONSTANT "EPM_TDCDSTCLB_SC" "0"
 SYSTEM_CONSTANT "ERCLNTVLVI_TYPAVL_SC" "0"
 SYSTEM_CONSTANT "ERCLNTVLVT_TYPAVL_SC" "0"
 SYSTEM_CONSTANT "ERRLMP_ATSINTVMOD_SY" "0"
 SYSTEM_CONSTANT "ERRLMP_UNIFY_SC" "1"
 SYSTEM_CONSTANT "ESC_ACTVTSYNCHAINCFG_SC" "2"
 SYSTEM_CONSTANT "ESC_DT_NESTING_DEPTH" "12"
 SYSTEM_CONSTANT "ESC_ENAPROCGROUP_SC" "0"
 SYSTEM_CONSTANT "ESC_NRAGEVEWCYC_SC" "0"
 SYSTEM_CONSTANT "ESC_NRTSKAGEVE_SC" "0"
 SYSTEM_CONSTANT "ESC_SAMPLETICALCN_SC" "0"
 SYSTEM_CONSTANT "ESC_SELNCAMSFTTSKACTVN_SC" "0"
 SYSTEM_CONSTANT "ESC_SELNMETHSYNSDL_SC" "0"
 SYSTEM_CONSTANT "ESC_SELNNOTSTDTISYNCNTSK_SC" "0"
 SYSTEM_CONSTANT "ESC_SELSAMPLETICFGMETHOD_SC" "0"
 SYSTEM_CONSTANT "ESC_SYNCTASK_SC" "1"
 SYSTEM_CONSTANT "ETA_THM_ENG_ONE" "1"
 SYSTEM_CONSTANT "ETCLB_NUM_RAILP_CLB_PNT" "2"
 SYSTEM_CONSTANT "ETCTL_ACTV_BP" "0"
 SYSTEM_CONSTANT "ETC_Act_SY" "1"
 SYSTEM_CONSTANT "ETHIPCORETYPE_SC" "2"
 SYSTEM_CONSTANT "ETHSWT_SC" "0"
 SYSTEM_CONSTANT "ETHTSYN_SC" "0"
 SYSTEM_CONSTANT "ETH_SC" "0"
 SYSTEM_CONSTANT "ETKS_SY" "1"
 SYSTEM_CONSTANT "ETS_INJPOI1" "4"
 SYSTEM_CONSTANT "ETS_LEAN_SY" "0"
 SYSTEM_CONSTANT "ETS_NSC_SY" "0"
 SYSTEM_CONSTANT "ETS_NUMINPMSK_SY" "0"
 SYSTEM_CONSTANT "ETS_PFLT1_SY" "0"
 SYSTEM_CONSTANT "ETS_PFLT2_1" "31"
 SYSTEM_CONSTANT "ETS_PFLT2_SY" "0"
 SYSTEM_CONSTANT "ETS_PHC_SY" "0"
 SYSTEM_CONSTANT "ETS_SOX_SY" "0"
 SYSTEM_CONSTANT "EVAPRDSMIXFLDP_TYPAVL_SC" "0"
 SYSTEM_CONSTANT "EVAPRDSMIXFLDT_TYPAVL_SC" "0"
 SYSTEM_CONSTANT "EVREX_SY" "0"
 SYSTEM_CONSTANT "EVTYP_SY" "1"
 SYSTEM_CONSTANT "EXHEVAPRDSFLDT_TYPAVL_SC" "0"
 SYSTEM_CONSTANT "EXHEVAPRDSGAST_TYPAVL_SC" "0"
 SYSTEM_CONSTANT "EXHEVAPRUSFLDP_TYPAVL_SC" "0"
 SYSTEM_CONSTANT "EXHEVAPRUSFLDT_TYPAVL_SC" "0"
 SYSTEM_CONSTANT "EXHEVAPRUSGAST_TYPAVL_SC" "0"
 SYSTEM_CONSTANT "EXHFLPLPI_TYPAVL_SC" "0"
 SYSTEM_CONSTANT "EXHPPFLT_TYPAVL_SY" "0"
 SYSTEM_CONSTANT "EXTCHRGNREQ_DIACTV" "1"
 SYSTEM_CONSTANT "EXTCHRGNREQ_DINOTACTV" "0"
 SYSTEM_CONSTANT "EXTCRASH_DETD" "1"
 SYSTEM_CONSTANT "FACT100_ZERO" "0"
 SYSTEM_CONSTANT "FACT16_EXP" "16"
 SYSTEM_CONSTANT "FACT16_RES_REV" "65536"
 SYSTEM_CONSTANT "FACT1_ZERO" "0"
 SYSTEM_CONSTANT "FACT26_EXP" "26"
 SYSTEM_CONSTANT "FACT26_RES_REV" "67108864"
 SYSTEM_CONSTANT "FACT6_RES_REV" "500"
 SYSTEM_CONSTANT "FACT9_RES_REV" "5000"
 SYSTEM_CONSTANT "FACTLOW1_RES_REV" "25"
 SYSTEM_CONSTANT "FACT_INVN2OMEGA" "9.548828125"
 SYSTEM_CONSTANT "FACT_NSCAGETOT_RES" "3"
 SYSTEM_CONSTANT "FACT_NSCAGE_RES" "0.001"
 SYSTEM_CONSTANT "FACT_NSCEFF_RES" "0.0001"
 SYSTEM_CONSTANT "FACT_NSCEFF_RES_REV" "10000"
 SYSTEM_CONSTANT "FACT_NSC_MAX" "1"
 SYSTEM_CONSTANT "FACT_NSC_MIN" "0"
 SYSTEM_CONSTANT "FACT_NSC_RES" "0.001"
 SYSTEM_CONSTANT "FACT_NSC_RES_REV" "1000"
 SYSTEM_CONSTANT "FACT_OIL_VOLSNGLDIFF" "32000"
 SYSTEM_CONSTANT "FACT_Q0P001_RES" "0.001"
 SYSTEM_CONSTANT "FACT_Q0P001_RES_REV" "1000"
 SYSTEM_CONSTANT "FACT_VOLNSC_RES" "1e-006"
 SYSTEM_CONSTANT "FAC_AG_CRS_HI_RESO" "128"
 SYSTEM_CONSTANT "FAC_MASSINJ_TO_QNTINJ" "10000"
 SYSTEM_CONSTANT "FAC_QNTADJ_TO_QNTINJ_0" "1000"
 SYSTEM_CONSTANT "FAC_QNTADJ_TO_QNTINJ_1" "1500"
 SYSTEM_CONSTANT "FAC_QNTADJ_TO_QNTINJ_2" "2500"
 SYSTEM_CONSTANT "FAC_QNTADJ_TO_QNTINJ_3" "5000"
 SYSTEM_CONSTANT "FAC_QNTADJ_TO_QNTINJ_RES" "100"
 SYSTEM_CONSTANT "FAC_T_INC_PER_DUR_HI_RESO" "256"
 SYSTEM_CONSTANT "FAN1_TYPAVL_SC" "1"
 SYSTEM_CONSTANT "FANCTL_HOTLMP" "0"
 SYSTEM_CONSTANT "FANCTL_HOTLMPWRN" "1"
 SYSTEM_CONSTANT "FANRLY1POSN_TYPAVL_SC" "1"
 SYSTEM_CONSTANT "FANRLY1_TYPAVL_SC" "0"
 SYSTEM_CONSTANT "FANSPD_TYPAVL_SC" "1"
 SYSTEM_CONSTANT "FINAL_DEFECT" "0"
 SYSTEM_CONSTANT "FLCONS1_RES" "0.01"
 SYSTEM_CONSTANT "FLCONS2_RES" "1"
 SYSTEM_CONSTANT "FLCONS2_RES_HIGH_REV" "20"
 SYSTEM_CONSTANT "FLCONS2_RES_REV" "1"
 SYSTEM_CONSTANT "FLCONS3_MIN" "0"
 SYSTEM_CONSTANT "FLCONS_SDET_MIN" "0.01"
 SYSTEM_CONSTANT "FLEXPSCTRLRNR_SC" "0"
 SYSTEM_CONSTANT "FLFLTDSP_TYPAVL_SC" "0"
 SYSTEM_CONSTANT "FLMNG_R_STOICH_CONF" "14.5"
 SYSTEM_CONSTANT "FLOATIFRESLSELN_SC" "0"
 SYSTEM_CONSTANT "FLOWFCTCRITAIR" "0.48417899"
 SYSTEM_CONSTANT "FLVOL_RES" "0.05"
 SYSTEM_CONSTANT "FLXR_SY" "0"
 SYSTEM_CONSTANT "FREONP_TYPAVL_SC" "1"
 SYSTEM_CONSTANT "FRIPCORETYPE_SC" "1"
 SYSTEM_CONSTANT "FRNM_SC" "0"
 SYSTEM_CONSTANT "FRTP_SC" "0"
 SYSTEM_CONSTANT "FRTSYN_SC" "0"
 SYSTEM_CONSTANT "FSPDSFLDP_TYPAVL_SC" "0"
 SYSTEM_CONSTANT "FUELP_TYPAVL_SY" "0"
 SYSTEM_CONSTANT "FUELT2_TYPAVL_SC" "0"
 SYSTEM_CONSTANT "FUELT_TYPAVL_SY" "0"
 SYSTEM_CONSTANT "GBXOILP_TYPAVL_SY" "0"
 SYSTEM_CONSTANT "GBXOILT_TYPAVL_SY" "0"
 SYSTEM_CONSTANT "GBX_GEARLVR_D" "5"
 SYSTEM_CONSTANT "GBX_GEARLVR_N" "6"
 SYSTEM_CONSTANT "GBX_GEARLVR_P" "8"
 SYSTEM_CONSTANT "GBX_GEARLVR_R" "7"
 SYSTEM_CONSTANT "GDI_SY" "0"
 SYSTEM_CONSTANT "GEAR0" "0"
 SYSTEM_CONSTANT "GEAR1" "1"
 SYSTEM_CONSTANT "GEAR2" "2"
 SYSTEM_CONSTANT "GEAR3" "3"
 SYSTEM_CONSTANT "GEAR4" "4"
 SYSTEM_CONSTANT "GEAR5" "5"
 SYSTEM_CONSTANT "GEAR6" "6"
 SYSTEM_CONSTANT "GEAR7" "7"
 SYSTEM_CONSTANT "GEARLVR_DRV" "3"
 SYSTEM_CONSTANT "GEARLVR_ERR" "255"
 SYSTEM_CONSTANT "GEARLVR_NEUT" "6"
 SYSTEM_CONSTANT "GEARLVR_PARK" "12"
 SYSTEM_CONSTANT "GEARLVR_RVS" "9"
 SYSTEM_CONSTANT "GLBDALSUMAVS_SY" "0"
 SYSTEM_CONSTANT "GLBDA_ACTRACTVN_SC" "0"
 SYSTEM_CONSTANT "GLBDA_LSUMMODE_SC" "0"
 SYSTEM_CONSTANT "GLBDA_STTRQDEM_DCS_BP" "5"
 SYSTEM_CONSTANT "GLBDA_STTRQDEM_TCS_BP" "4"
 SYSTEM_CONSTANT "GLWCTL_TIME_MS_RES" "10"
 SYSTEM_CONSTANT "GSSYS_TYPEEXHFLW_SY" "1"
 SYSTEM_CONSTANT "GSSYS_TYPPCR_SY" "1"
 SYSTEM_CONSTANT "HCMPT_Q0P0000004_ZERO" "0"
 SYSTEM_CONSTANT "HEATRCORET_TYPAVL_SC" "1"
 SYSTEM_CONSTANT "HEATRRLY1_TYPAVL_SC" "1"
 SYSTEM_CONSTANT "HEAT_CAPACITY_RES_REV" "10"
 SYSTEM_CONSTANT "HEM_SY" "0"
 SYSTEM_CONSTANT "HESRV_CSTNCCHKECU1" "1"
 SYSTEM_CONSTANT "HESRV_CSTNCCHKECU2" "2"
 SYSTEM_CONSTANT "HESRV_HCU" "3"
 SYSTEM_CONSTANT "HESRV_HETYP_SY" "255"
 SYSTEM_CONSTANT "HESRV_NOTUSED" "0"
 SYSTEM_CONSTANT "HESRV_VCU" "2"
 SYSTEM_CONSTANT "HEVPLINAVL_SC" "0"
 SYSTEM_CONSTANT "HEVTYP_SY" "0"
 SYSTEM_CONSTANT "HLCCCS_APPLPTCOL_DIN" "2"
 SYSTEM_CONSTANT "HLCCCS_APPLPTCOL_ISO" "1"
 SYSTEM_CONSTANT "HLCCCS_APPLPTCOL_NONE" "0"
 SYSTEM_CONSTANT "HLCCCS_CBLCHK" "3"
 SYSTEM_CONSTANT "HLCCCS_CHRGPRM" "2"
 SYSTEM_CONSTANT "HLCCCS_CMPBLTY_CMPBL" "1"
 SYSTEM_CONSTANT "HLCCCS_CMPBLTY_INI" "0"
 SYSTEM_CONSTANT "HLCCCS_CMPBLTY_NOTCMPBL" "2"
 SYSTEM_CONSTANT "HLCCCS_ERR" "9"
 SYSTEM_CONSTANT "HLCCCS_EVSEDCISO_FLT" "4"
 SYSTEM_CONSTANT "HLCCCS_EVSEDCISO_INVLD" "1"
 SYSTEM_CONSTANT "HLCCCS_EVSEDCISO_NODATA" "0"
 SYSTEM_CONSTANT "HLCCCS_EVSEDCISO_NODEV" "5"
 SYSTEM_CONSTANT "HLCCCS_EVSEDCISO_VLD" "2"
 SYSTEM_CONSTANT "HLCCCS_EVSEDCISO_WARN" "3"
 SYSTEM_CONSTANT "HLCCCS_EXPO_EGY" "1"
 SYSTEM_CONSTANT "HLCCCS_EXPO_I" "-1"
 SYSTEM_CONSTANT "HLCCCS_EXPO_PWR" "1"
 SYSTEM_CONSTANT "HLCCCS_EXPO_TI" "1"
 SYSTEM_CONSTANT "HLCCCS_EXPO_U" "-1"
 SYSTEM_CONSTANT "HLCCCS_FINSH" "8"
 SYSTEM_CONSTANT "HLCCCS_FWDWNL_FAILD" "3"
 SYSTEM_CONSTANT "HLCCCS_FWDWNL_NONE" "0"
 SYSTEM_CONSTANT "HLCCCS_FWDWNL_STRTD" "1"
 SYSTEM_CONSTANT "HLCCCS_FWDWNL_SUC" "2"
 SYSTEM_CONSTANT "HLCCCS_INI" "0"
 SYSTEM_CONSTANT "HLCCCS_MSGST_PROCN" "2"
 SYSTEM_CONSTANT "HLCCCS_PREC" "4"
 SYSTEM_CONSTANT "HLCCCS_PWRDLV" "5"
 SYSTEM_CONSTANT "HLCCCS_SDLTPL_ENTRYMAX" "12"
 SYSTEM_CONSTANT "HLCCCS_SETUP" "1"
 SYSTEM_CONSTANT "HLCCCS_SLACERR_ATTENRNG" "23"
 SYSTEM_CONSTANT "HLCCCS_SLACERR_LOSTLINK" "26"
 SYSTEM_CONSTANT "HLCCCS_SLACERR_NOEVSE" "24"
 SYSTEM_CONSTANT "HLCCCS_SLACERR_NOLINK" "25"
 SYSTEM_CONSTANT "HLCCCS_SLACERR_NORESP" "22"
 SYSTEM_CONSTANT "HLCCCS_SLACERR_PLCREBOOT" "27"
 SYSTEM_CONSTANT "HLCCCS_SLACERR_PREPFAILD" "21"
 SYSTEM_CONSTANT "HLCCCS_SLACINFO_ABORT" "1"
 SYSTEM_CONSTANT "HLCCCS_SLACINFO_LEAVESUC" "8"
 SYSTEM_CONSTANT "HLCCCS_SLACINFO_NEWEVSEADDED" "4"
 SYSTEM_CONSTANT "HLCCCS_SLACINFO_NOERR" "0"
 SYSTEM_CONSTANT "HLCCCS_SLACINFO_UKWNMSG" "2"
 SYSTEM_CONSTANT "HLCCCS_SLACINFO_UNEXPTMSG" "3"
 SYSTEM_CONSTANT "HLCCCS_SLACINFO_WAITFORAMPMAP" "7"
 SYSTEM_CONSTANT "HLCCCS_SLACINFO_WAITFORLINK" "5"
 SYSTEM_CONSTANT "HLCCCS_SLACINFO_WAITFORLINKDOWN" "6"
 SYSTEM_CONSTANT "HLCCCS_SLACRDY_INI" "0"
 SYSTEM_CONSTANT "HLCCCS_SLACRDY_NOTRDY" "2"
 SYSTEM_CONSTANT "HLCCCS_SLACRDY_RDY" "1"
 SYSTEM_CONSTANT "HLCCCS_SLACSTEP_AMPMAP" "12"
 SYSTEM_CONSTANT "HLCCCS_SLACSTEP_ATTENCHAR" "5"
 SYSTEM_CONSTANT "HLCCCS_SLACSTEP_CNCT" "14"
 SYSTEM_CONSTANT "HLCCCS_SLACSTEP_MATCH" "9"
 SYSTEM_CONSTANT "HLCCCS_SLACSTEP_MNBCSOUND" "4"
 SYSTEM_CONSTANT "HLCCCS_SLACSTEP_NONE" "0"
 SYSTEM_CONSTANT "HLCCCS_SLACSTEP_PARM" "2"
 SYSTEM_CONSTANT "HLCCCS_SLACSTEP_PREP" "1"
 SYSTEM_CONSTANT "HLCCCS_SLACSTEP_SELEVSE" "6"
 SYSTEM_CONSTANT "HLCCCS_SLACSTEP_SETKEY" "10"
 SYSTEM_CONSTANT "HLCCCS_SLACSTEP_STARTATTENCHAR" "3"
 SYSTEM_CONSTANT "HLCCCS_SLACSTEP_VLDT1" "7"
 SYSTEM_CONSTANT "HLCCCS_SLACSTEP_VLDT2" "8"
 SYSTEM_CONSTANT "HLCCCS_SLACSTEP_WAITFORLINK" "11"
 SYSTEM_CONSTANT "HLCCCS_SLACSTEP_WAITFORSTABLINK" "13"
 SYSTEM_CONSTANT "HLCCCS_SLACVLDNMOD_FRCDVLDN" "2"
 SYSTEM_CONSTANT "HLCCCS_SLACVLDNMOD_NOVLDN" "0"
 SYSTEM_CONSTANT "HLCCCS_SLACVLDNMOD_OPTVLDN" "1"
 SYSTEM_CONSTANT "HLCCCS_SLACWARN_ATTENPROFGROUP" "14"
 SYSTEM_CONSTANT "HLCCCS_SLACWARN_DFTNMK" "19"
 SYSTEM_CONSTANT "HLCCCS_SLACWARN_INVLDMSG" "10"
 SYSTEM_CONSTANT "HLCCCS_SLACWARN_LEAVEFAILD" "20"
 SYSTEM_CONSTANT "HLCCCS_SLACWARN_LINKWOSLAC" "9"
 SYSTEM_CONSTANT "HLCCCS_SLACWARN_MPLDRCTEVSE" "15"
 SYSTEM_CONSTANT "HLCCCS_SLACWARN_NUMSOUNDLIM" "13"
 SYSTEM_CONSTANT "HLCCCS_SLACWARN_ONLYINDRCTEVSE" "16"
 SYSTEM_CONSTANT "HLCCCS_SLACWARN_REJMSG" "18"
 SYSTEM_CONSTANT "HLCCCS_SLACWARN_TOOMANYEVSE" "12"
 SYSTEM_CONSTANT "HLCCCS_SLACWARN_TOUTMSG" "11"
 SYSTEM_CONSTANT "HLCCCS_SLACWARN_UKWNEVSE" "17"
 SYSTEM_CONSTANT "HLCCCS_STOP" "7"
 SYSTEM_CONSTANT "HLCCCS_TCPSOCK_CLSD" "0"
 SYSTEM_CONSTANT "HLCCCS_TCPSOCK_CNCT" "1"
 SYSTEM_CONSTANT "HLCCCS_TCPSOCK_CNCTD" "2"
 SYSTEM_CONSTANT "HLCCCS_TCPSOCK_DISCNCT" "3"
 SYSTEM_CONSTANT "HLCCCS_V2GMSG_PREPREQ" "0"
 SYSTEM_CONSTANT "HLCCCS_V2GMSG_PROCNRESP" "2"
 SYSTEM_CONSTANT "HLCCCS_V2GMSG_WAITFORRESP" "1"
 SYSTEM_CONSTANT "HLCCCS_WLDCHK" "6"
 SYSTEM_CONSTANT "HOODSWTIFTYP_SC" "0"
 SYSTEM_CONSTANT "HPDIFF_TYPAVL_SC" "0"
 SYSTEM_CONSTANT "HPIN_TYPAVL_SC" "0"
 SYSTEM_CONSTANT "HPOUTPRR_TYPAVL_SY" "0"
 SYSTEM_CONSTANT "HTANKP_TYPAVL_SY" "0"
 SYSTEM_CONSTANT "HTANKT_TYPAVL_SY" "0"
 SYSTEM_CONSTANT "HTIN_TYPAVL_SC" "0"
 SYSTEM_CONSTANT "HTOUT_TYPAVL_SC" "0"
 SYSTEM_CONSTANT "HVACHEATPMPP_TYPAVL_SC" "0"
 SYSTEM_CONSTANT "HVACHEATPMPT_TYPAVL_SC" "0"
 SYSTEM_CONSTANT "HVACSPT_TYPAVL_SC" "0"
 SYSTEM_CONSTANT "HVBATT_STFLTEMGY_BP" "5"
 SYSTEM_CONSTANT "HVBATT_STFLTIHI_BP" "2"
 SYSTEM_CONSTANT "HVBATT_STFLTISO_BP" "4"
 SYSTEM_CONSTANT "HVBATT_STFLTLEAK_BP" "6"
 SYSTEM_CONSTANT "HVBATT_STFLTTHI_BP" "3"
 SYSTEM_CONSTANT "HVBATT_STFLTTLO_BP" "7"
 SYSTEM_CONSTANT "HVBATT_STFLTUHI_BP" "0"
 SYSTEM_CONSTANT "HVBATT_STFLTULO_BP" "1"
 SYSTEM_CONSTANT "HVGRID_PRIOSIZE" "12"
 SYSTEM_CONSTANT "HVGRID_PRIOSIZEPLUS" "13"
 SYSTEM_CONSTANT "HVINTLCKOUT1_TYPAVL_SC" "0"
 SYSTEM_CONSTANT "HVINTLCKOUT2_TYPAVL_SC" "0"
 SYSTEM_CONSTANT "HVINTLCKOUT3_TYPAVL_SC" "0"
 SYSTEM_CONSTANT "HWDPD_SC" "0"
 SYSTEM_CONSTANT "HW_VCU_SC" "91"
 SYSTEM_CONSTANT "HYBTOPO_NO" "0"
 SYSTEM_CONSTANT "HYBTOPO_P0" "1"
 SYSTEM_CONSTANT "HYBTOPO_P0_P4" "6"
 SYSTEM_CONSTANT "HYBTOPO_P1" "2"
 SYSTEM_CONSTANT "HYBTOPO_P2" "3"
 SYSTEM_CONSTANT "HYBTOPO_P3" "4"
 SYSTEM_CONSTANT "HYBTOPO_P4" "5"
 SYSTEM_CONSTANT "HYDSTORGHIPT_TYPAVL_SC" "0"
 SYSTEM_CONSTANT "HYDSTORGLOPT_TYPAVL_SC" "0"
 SYSTEM_CONSTANT "HYDSYSHIPTSEC_TYPAVL_SC" "0"
 SYSTEM_CONSTANT "HYDSYSLOPT_TYPAVL_SC" "0"
 SYSTEM_CONSTANT "I15031SRV9NOXBIN_SC" "0"
 SYSTEM_CONSTANT "I15031SRV9VT_SC" "0"
 SYSTEM_CONSTANT "I15031SRV9VT_STORGRSTBHVR_SC" "1"
 SYSTEM_CONSTANT "I15031_CVNALG_SC" "1"
 SYSTEM_CONSTANT "I15031_CVN_CRC_DIABAS" "1"
 SYSTEM_CONSTANT "I15031_CVN_CRC_SECULIBS" "2"
 SYSTEM_CONSTANT "I15031_CVN_SHA_BCL" "3"
 SYSTEM_CONSTANT "I15031_CVN_SHA_HSM" "4"
 SYSTEM_CONSTANT "I15031_CVN_TIMER" "12000"
 SYSTEM_CONSTANT "I15031_ELEMSTRTSIZE_SC" "257"
 SYSTEM_CONSTANT "I15031_EXTCVNSTORGBHVR_SC" "1"
 SYSTEM_CONSTANT "I15031_ITID_RANGE_ARRAY_SIZE" "8"
 SYSTEM_CONSTANT "I15031_MODRULECUST_SC" "0"
 SYSTEM_CONSTANT "I15031_OBD_CNTL_SC" "1"
 SYSTEM_CONSTANT "I15031_PID6B_SC" "0"
 SYSTEM_CONSTANT "I15031_PID6F_SC" "0"
 SYSTEM_CONSTANT "I15031_PID94_SC" "0"
 SYSTEM_CONSTANT "I15031_PID_RANGE_ARRAY_SIZE" "8"
 SYSTEM_CONSTANT "I15031_ST_SUPP_PID_SC" "0"
 SYSTEM_CONSTANT "I15031_VISYSIZE_SC" "256"
 SYSTEM_CONSTANT "I27145_SC" "0"
 SYSTEM_CONSTANT "IDEAL_GAS_VOL" "22.4"
 SYSTEM_CONSTANT "INIT_ZERO" "0"
 SYSTEM_CONSTANT "INJCRV_ANGLE" "0"
 SYSTEM_CONSTANT "INJCRV_INJMASSPIIFACT_SY" "1"
 SYSTEM_CONSTANT "INJCRV_TIME" "1"
 SYSTEM_CONSTANT "INJMSQ0P1_RES" "0.1"
 SYSTEM_CONSTANT "INJMSQ0P2_RES" "0.2"
 SYSTEM_CONSTANT "INJSYS_INJRLSSETPOINT_SY" "0"
 SYSTEM_CONSTANT "INJSYS_POI1SETPOINT_SY" "0"
 SYSTEM_CONSTANT "INJSYS_POI2SETPOINT_SY" "0"
 SYSTEM_CONSTANT "INJSYS_POI3SETPOINT_SY" "0"
 SYSTEM_CONSTANT "INJTIME_US_ZERO" "0"
 SYSTEM_CONSTANT "INJVLV_ABE_ACTIVE" "0"
 SYSTEM_CONSTANT "INJVLV_ABE_NOTACTIVE" "1"
 SYSTEM_CONSTANT "INJ_MASS100_MAX" "100"
 SYSTEM_CONSTANT "INJ_MASSCYC_MAX" "327.67"
 SYSTEM_CONSTANT "INJ_MASSCYC_MIN" "0"
 SYSTEM_CONSTANT "INJ_MASSCYC_RES" "0.01"
 SYSTEM_CONSTANT "INJ_MASSCYC_RES_INV" "100"
 SYSTEM_CONSTANT "INJ_MASSCYC_RES_REV" "100"
 SYSTEM_CONSTANT "INJ_MASSCYC_ZERO" "0"
 SYSTEM_CONSTANT "INJ_MASSINJ_RES" "0.01"
 SYSTEM_CONSTANT "INJ_MASSMIN_MAX" "10"
 SYSTEM_CONSTANT "INJ_MASSPII1_MAX" "10"
 SYSTEM_CONSTANT "INJ_MASSPII2_MAX" "10"
 SYSTEM_CONSTANT "INJ_MASSPII3_MAX" "10"
 SYSTEM_CONSTANT "INJ_MASSPOI0_MAX" "10"
 SYSTEM_CONSTANT "INJ_MASSPOI1_MAX" "10"
 SYSTEM_CONSTANT "INJ_MASSPOI2_MAX" "10"
 SYSTEM_CONSTANT "INJ_MASSPOI3_MAX" "10"
 SYSTEM_CONSTANT "INJ_MASS_MAX" "327.67"
 SYSTEM_CONSTANT "INJ_MASS_MIN" "0"
 SYSTEM_CONSTANT "INJ_MASS_ONE" "1"
 SYSTEM_CONSTANT "INJ_MASS_RES" "0.01"
 SYSTEM_CONSTANT "INJ_MASS_RES_INV" "100"
 SYSTEM_CONSTANT "INJ_MASS_ZERO" "0"
 SYSTEM_CONSTANT "INJ_QNTINJ_MAX" "100"
 SYSTEM_CONSTANT "INJ_QNTINJ_MIN" "0"
 SYSTEM_CONSTANT "INJ_QNTINJ_RES" "0.01"
 SYSTEM_CONSTANT "INJ_QNTINJ_ZERO" "0"
 SYSTEM_CONSTANT "INJ_QNT_RES" "0.1"
 SYSTEM_CONSTANT "INTKAIRT_INTKMNFLD_SC" "0"
 SYSTEM_CONSTANT "INTKAIRT_SNSR1POS_SC" "0"
 SYSTEM_CONSTANT "INTKAIRT_SNSR2POS_SC" "0"
 SYSTEM_CONSTANT "INTKAIRT_SNSR3POS_SC" "0"
 SYSTEM_CONSTANT "INTKAIRT_TYPAVL_SC" "0"
 SYSTEM_CONSTANT "INTLCKCHRGPLGI_TYPAVL_SC" "0"
 SYSTEM_CONSTANT "INTLCKCHRGPLGPOSN_TYPAVL_SC" "1"
 SYSTEM_CONSTANT "INTLCKCHRGPLG_TYPAVL_SC" "1"
 SYSTEM_CONSTANT "IOEXTDEV_CJ260_SC" "0"
 SYSTEM_CONSTANT "IOEXTDEV_PORTEXP_SC" "0"
 SYSTEM_CONSTANT "IPDUM_SC" "1"
 SYSTEM_CONSTANT "IUMPR_SY" "0"
 SYSTEM_CONSTANT "IUMPR_VERS_SY" "1"
 SYSTEM_CONSTANT "IVTRTMDLTYP_SC" "0"
 SYSTEM_CONSTANT "I_COIL_MAX" "5000"
 SYSTEM_CONSTANT "I_COIL_MIN" "0"
 SYSTEM_CONSTANT "J1939NM_SC" "0"
 SYSTEM_CONSTANT "J1939RM_SC" "0"
 SYSTEM_CONSTANT "J1939TP_SC" "0"
 SYSTEM_CONSTANT "KAPPADRYAIR" "1.4"
 SYSTEM_CONSTANT "KAPPA_DRYAIR" "1.4"
 SYSTEM_CONSTANT "KD_PRAIL2Q_1_MAX" "0.5"
 SYSTEM_CONSTANT "KD_PRAIL2Q_1_NRM" "4"
 SYSTEM_CONSTANT "KD_PRC_RES" "0.000125"
 SYSTEM_CONSTANT "KGH_TO_KGS" "3600"
 SYSTEM_CONSTANT "KIDRVAWY_SY" "1"
 SYSTEM_CONSTANT "KI_PRAIL2Q_1_MAX" "2"
 SYSTEM_CONSTANT "KI_PRAIL2Q_1_NRM" "1"
 SYSTEM_CONSTANT "KLINE_SY" "0"
 SYSTEM_CONSTANT "KP_LMBDREC2INJMASS_1_MAX" "250"
 SYSTEM_CONSTANT "KP_LMBDREC2INJMASS_1_NRM" "2"
 SYSTEM_CONSTANT "KP_LMBDREC2INJMASS_1_RES_REV" "4"
 SYSTEM_CONSTANT "KP_PRAIL2Q_1_MAX" "0.2"
 SYSTEM_CONSTANT "KP_PRAIL2Q_1_NRM" "2"
 SYSTEM_CONSTANT "L9779_SC" "0"
 SYSTEM_CONSTANT "L9959_SC" "2"
 SYSTEM_CONSTANT "L9966_SC" "0"
 SYSTEM_CONSTANT "LAMBDAREC_RESVAL" "0.001"
 SYSTEM_CONSTANT "LAMBDA_INJMASS_RES" "1450"
 SYSTEM_CONSTANT "LAMBDA_MIN" "0"
 SYSTEM_CONSTANT "LAMBDA_ONE" "1"
 SYSTEM_CONSTANT "LAMBDA_REC_ZERO" "0"
 SYSTEM_CONSTANT "LAMBDA_TEN" "10"
 SYSTEM_CONSTANT "LAMBDA_ZERO" "0"
 SYSTEM_CONSTANT "LAMCTLDESVAL_NUM" "2"
 SYSTEM_CONSTANT "LAMCTLGOV_NUM" "2"
 SYSTEM_CONSTANT "LAMCTLMON_DVT_MAX" "10"
 SYSTEM_CONSTANT "LAMCTLMON_NUM_RM" "2"
 SYSTEM_CONSTANT "LAMCTLMON_TIME_MAX" "20"
 SYSTEM_CONSTANT "LAMCTLPRECTL_NUM" "2"
 SYSTEM_CONSTANT "LAMCTL_ACTVMONFDBKCTL_BP" "1"
 SYSTEM_CONSTANT "LAMCTL_DFL" "0"
 SYSTEM_CONSTANT "LAMCTL_SWTACTV_BP" "0"
 SYSTEM_CONSTANT "LDCOM_SC" "0"
 SYSTEM_CONSTANT "LENGTH_MM_RES" "1"
 SYSTEM_CONSTANT "LENGTH_M_PER_KM" "1000"
 SYSTEM_CONSTANT "LINIPCORETYPE_SC" "1"
 SYSTEM_CONSTANT "LIN_SY" "1"
 SYSTEM_CONSTANT "LLIM_ACTIVE" "3"
 SYSTEM_CONSTANT "LLIM_OFF" "1"
 SYSTEM_CONSTANT "LLIM_STANDBY" "2"
 SYSTEM_CONSTANT "LLIM_STREQONE" "1"
 SYSTEM_CONSTANT "LLIM_STREQZR" "0"
 SYSTEM_CONSTANT "LSM_SY" "0"
 SYSTEM_CONSTANT "LSU_CT_SENSORS" "0"
 SYSTEM_CONSTANT "LSU_CT_SENSORS_MAX" "4"
 SYSTEM_CONSTANT "LSU_CT_SENSORS_SY" "0"
 SYSTEM_CONSTANT "LSU_CT_SENSORS_TWFLW_SYS" "0"
 SYSTEM_CONSTANT "MASS_CONV_G2MG" "1000"
 SYSTEM_CONSTANT "MASS_CONV_KG2G" "1000"
 SYSTEM_CONSTANT "MASS_MOL_EG" "28.5"
 SYSTEM_CONSTANT "MASS_Q1_RES_REV" "1"
 SYSTEM_CONSTANT "MDG1CPUDEVICE_SC" "13"
 SYSTEM_CONSTANT "MDG1CPUSTEP_SC" "110"
 SYSTEM_CONSTANT "MDG1CPUVENDOR_SC" "1"
 SYSTEM_CONSTANT "MDG1MSGCNCPT_SC" "1"
 SYSTEM_CONSTANT "MEM_CENDIAGACTVD_SC" "1"
 SYSTEM_CONSTANT "MEM_DIAGACTVDEXTD_SC" "0"
 SYSTEM_CONSTANT "MILLMP_ENGSTRTWITH2SECCDN_SC" "1"
 SYSTEM_CONSTANT "MILLMP_PWRSTG_SY" "0"
 SYSTEM_CONSTANT "MILLMP_SUPRT_ATS_SY" "0"
 SYSTEM_CONSTANT "MOCADC_DEF_MSK" "128"
 SYSTEM_CONSTANT "MOCADC_NTPACTV_MSK" "1"
 SYSTEM_CONSTANT "MOCCOM_CO_CPUNEW_MSK" "1"
 SYSTEM_CONSTANT "MOCCOM_CO_NUM_ANSW" "16"
 SYSTEM_CONSTANT "MOCCOM_CO_PCPNEW_MSK" "4"
 SYSTEM_CONSTANT "MOCCOM_CO_PFCNEW_MSK" "2"
 SYSTEM_CONSTANT "MOCCPU_IT_SY" "5"
 SYSTEM_CONSTANT "MOCEMM_CO_ARYSIZE_SWERRPINREQ" "10"
 SYSTEM_CONSTANT "MOCEMM_CO_BACKWCMBPLTYMANYCORE_SHIFT" "24"
 SYSTEM_CONSTANT "MOCEMM_CO_CORE0_LCKSTEPCHK_ERROR" "7"
 SYSTEM_CONSTANT "MOCEMM_CO_CORE1_LCKSTEPCHK_ERROR" "8"
 SYSTEM_CONSTANT "MOCEMM_CO_CORE2_LCKSTEPCHK_ERROR" "11"
 SYSTEM_CONSTANT "MOCEMM_CO_CORE3_LCKSTEPCHK_ERROR" "12"
 SYSTEM_CONSTANT "MOCEMM_CO_HWLT_FWCHK_ERROR" "1"
 SYSTEM_CONSTANT "MOCEMM_CO_HWLT_LBIST_ERROR" "10"
 SYSTEM_CONSTANT "MOCEMM_CO_HWLT_MBIST_ERROR" "9"
 SYSTEM_CONSTANT "MOCEMM_CO_HWLT_MONBIST_ERROR" "3"
 SYSTEM_CONSTANT "MOCEMM_CO_HWLT_SFFDCHK_ERROR" "4"
 SYSTEM_CONSTANT "MOCEMM_CO_HWLT_STDBYSMUALVTEST_ERROR" "2"
 SYSTEM_CONSTANT "MOCEMM_CO_HWLT_TEMPCHK_ERROR" "5"
 SYSTEM_CONSTANT "MOCEMM_CO_HWLT_UCBCHK_ERROR" "6"
 SYSTEM_CONSTANT "MOCEMM_CO_NO_ERROR" "0"
 SYSTEM_CONSTANT "MOCEMM_CO_NROFALRMREG" "22"
 SYSTEM_CONSTANT "MOCEMM_CO_REQERRPIN_ID_HW" "255"
 SYSTEM_CONSTANT "MOCEMM_CO_REQERRPIN_ID_MOCADC" "9"
 SYSTEM_CONSTANT "MOCEMM_CO_REQERRPIN_ID_MOCCOM" "0"
 SYSTEM_CONSTANT "MOCEMM_CO_REQERRPIN_ID_MOCEMM" "3"
 SYSTEM_CONSTANT "MOCEMM_CO_REQERRPIN_ID_MOCGTM" "7"
 SYSTEM_CONSTANT "MOCEMM_CO_REQERRPIN_ID_MOCMEM" "1"
 SYSTEM_CONSTANT "MOCEMM_CO_REQERRPIN_ID_MOCMPU" "10"
 SYSTEM_CONSTANT "MOCEMM_CO_REQERRPIN_ID_MOCSCC" "8"
 SYSTEM_CONSTANT "MOCEMM_CO_REQERRPIN_ID_MOCSOP" "2"
 SYSTEM_CONSTANT "MOCEMM_CO_REQERRPIN_ID_MOFWDA" "4"
 SYSTEM_CONSTANT "MOCEMM_CO_REQERRPIN_ID_OCWDATEST" "5"
 SYSTEM_CONSTANT "MOCEMM_CO_REQERRPIN_ID_SWSHRL2" "6"
 SYSTEM_CONSTANT "MOCFC_ADCTESTADDLBNK_SC" "0"
 SYSTEM_CONSTANT "MOCFC_GTMCLKMON_SC" "1"
 SYSTEM_CONSTANT "MOCFC_GTMCONNTYP_SC" "1"
 SYSTEM_CONSTANT "MOCFC_NRCYCBLK_SC" "2"
 SYSTEM_CONSTANT "MOCFC_NRFASTCYCBLK_SC" "0"
 SYSTEM_CONSTANT "MOCFC_POSTBLDCHKS_SC" "0"
 SYSTEM_CONSTANT "MOCFC_SCCERRREACTN_SC" "1"
 SYSTEM_CONSTANT "MOCGTM_NRCMPERRBITS" "4"
 SYSTEM_CONSTANT "MOCIWDH_CO_CNTTSKTMESYNC" "1"
 SYSTEM_CONSTANT "MOCMEMSTRTUP_CO_TESTREQ" "51"
 SYSTEM_CONSTANT "MOCMEM_CONF_NOF_RAMCHK" "32"
 SYSTEM_CONSTANT "MOCMEM_CONF_NOF_ROMCHK" "250"
 SYSTEM_CONSTANT "MOCMEM_CO_CHKSUM_VAL_START" "4294967295"
 SYSTEM_CONSTANT "MOCMEM_CO_FASTROM_TEST_ERRSIMN" "50"
 SYSTEM_CONSTANT "MOCMEM_CO_NOCHECK" "85"
 SYSTEM_CONSTANT "MOCMEM_CO_PATTERN" "2863311530"
 SYSTEM_CONSTANT "MOCMEM_CO_PATTERN_55_IDX" "1"
 SYSTEM_CONSTANT "MOCMEM_CO_PATTERN_AA_IDX" "0"
 SYSTEM_CONSTANT "MOCMEM_CO_PATTERN_CPL" "1431655765"
 SYSTEM_CONSTANT "MOCMEM_CO_PATTERN_NUMBER" "2"
 SYSTEM_CONSTANT "MOCMEM_CO_RAM_TEST_ERRSIMN" "51"
 SYSTEM_CONSTANT "MOCMEM_CO_ROM_TEST_ERRSIMN" "51"
 SYSTEM_CONSTANT "MOCMEM_CO_STACK_CSA_TEST_ERRSIMN" "50"
 SYSTEM_CONSTANT "MOCMM_ABESHTOFFPAHTESTENA_SC" "1"
 SYSTEM_CONSTANT "MOCMM_CANSHOFFPAHTESTENA_SC" "1"
 SYSTEM_CONSTANT "MOCMM_FRSHOFFPAHTESTENA_SC" "0"
 SYSTEM_CONSTANT "MOCMM_MCUINJSHTOFFPAHTESTENA_SC" "0"
 SYSTEM_CONSTANT "MOCMM_NRTRCV_SC" "4"
 SYSTEM_CONSTANT "MOCMM_UCHIP_SC" "0"
 SYSTEM_CONSTANT "MOCPFC_CO_RINGBUFLENTISYNCN" "6"
 SYSTEM_CONSTANT "MOCSOP_CO_ACTIVE" "0"
 SYSTEM_CONSTANT "MOCSOP_CO_CANTESTICO_MSK" "1"
 SYSTEM_CONSTANT "MOCSOP_CO_CANTEST_WDAERR_MSK" "1"
 SYSTEM_CONSTANT "MOCSOP_CO_COM_MP_ARRAY_SIZE" "12"
 SYSTEM_CONSTANT "MOCSOP_CO_FRTESTICO_MSK" "2"
 SYSTEM_CONSTANT "MOCSOP_CO_FRTEST_WDAERR_MSK" "2"
 SYSTEM_CONSTANT "MOCSOP_CO_INACTIVE" "1"
 SYSTEM_CONSTANT "MOCSOP_CO_INHBLINE_ACTV" "0"
 SYSTEM_CONSTANT "MOCSOP_CO_INHBLINE_INACTV" "1"
 SYSTEM_CONSTANT "MOCSOP_CO_INJTESTICO_MSK" "1"
 SYSTEM_CONSTANT "MOCSOP_CO_INJTEST_WDAERR_MSK" "1"
 SYSTEM_CONSTANT "MOCSOP_CO_INJ_MP_ARRAY_SIZE" "10"
 SYSTEM_CONSTANT "MOCSOP_CO_MP_ARRAY_SIZE" "25"
 SYSTEM_CONSTANT "MOCSOP_CO_NO_OF_CTRL_LINES" "0"
 SYSTEM_CONSTANT "MOCSOP_CO_NO_OF_FB_LINES" "4"
 SYSTEM_CONSTANT "MOCSOP_CO_NO_OF_INHIBIT_LINES" "0"
 SYSTEM_CONSTANT "MOCSOP_CO_NO_OF_MAIN_PVMT_SIGNALS" "2"
 SYSTEM_CONSTANT "MOFFRM_LIB_ADD4BIT" "15"
 SYSTEM_CONSTANT "MOFFRM_LIB_ADD4HMC" "3"
 SYSTEM_CONSTANT "MOFFRM_LIB_ADD4PSA" "0"
 SYSTEM_CONSTANT "MOFFRM_LIB_ADD8CVP" "6"
 SYSTEM_CONSTANT "MOFFRM_LIB_ADD8HMC" "4"
 SYSTEM_CONSTANT "MOFFRM_LIB_ALVCNTRJMP" "200"
 SYSTEM_CONSTANT "MOFFRM_LIB_BITPAR1CGWHMC" "11"
 SYSTEM_CONSTANT "MOFFRM_LIB_BITPAR1CLU11HMC" "12"
 SYSTEM_CONSTANT "MOFFRM_LIB_BITPAR1CLUHMC" "10"
 SYSTEM_CONSTANT "MOFFRM_LIB_BITPAR2HMC" "5"
 SYSTEM_CONSTANT "MOFFRM_LIB_BMW" "5"
 SYSTEM_CONSTANT "MOFFRM_LIB_BYTON" "13"
 SYSTEM_CONSTANT "MOFFRM_LIB_CRC16ARPROF1VRNT1" "13"
 SYSTEM_CONSTANT "MOFFRM_LIB_CRC16ARPROF5VRNT" "14"
 SYSTEM_CONSTANT "MOFFRM_LIB_CRC4ADDNIB" "25"
 SYSTEM_CONSTANT "MOFFRM_LIB_CRC4SMC" "1"
 SYSTEM_CONSTANT "MOFFRM_LIB_CRC8ADDBYTEDATAID" "34"
 SYSTEM_CONSTANT "MOFFRM_LIB_CRC8ARPROF1VRNT1" "2"
 SYSTEM_CONSTANT "MOFFRM_LIB_CRC8ARPROF1VRNT1XOR" "9"
 SYSTEM_CONSTANT "MOFFRM_LIB_CRC8BMW" "7"
 SYSTEM_CONSTANT "MOFFRM_LIB_CRC8BMWADV" "8"
 SYSTEM_CONSTANT "MOFFRM_LIB_CRC8E2EPROF2VRNT1" "33"
 SYSTEM_CONSTANT "MOFFRM_LIB_CRC8SAEJ18501D" "16"
 SYSTEM_CONSTANT "MOFFRM_LIB_CRCADD2SIG" "18"
 SYSTEM_CONSTANT "MOFFRM_LIB_CRCSAEJ1939VRNT2" "27"
 SYSTEM_CONSTANT "MOFFRM_LIB_CVP" "3"
 SYSTEM_CONSTANT "MOFFRM_LIB_EGO" "12"
 SYSTEM_CONSTANT "MOFFRM_LIB_FLGALVERR_MASK" "2"
 SYSTEM_CONSTANT "MOFFRM_LIB_FLGALVERR_MSK" "2"
 SYSTEM_CONSTANT "MOFFRM_LIB_FLGALVFRZ_MASK" "1"
 SYSTEM_CONSTANT "MOFFRM_LIB_FLGALVFRZ_MSK" "1"
 SYSTEM_CONSTANT "MOFFRM_LIB_FLGALVSUM_MASK" "3"
 SYSTEM_CONSTANT "MOFFRM_LIB_FLGALVSUM_MSK" "3"
 SYSTEM_CONSTANT "MOFFRM_LIB_FLGCRCERR_MASK" "8"
 SYSTEM_CONSTANT "MOFFRM_LIB_FLGCRCERR_MSK" "8"
 SYSTEM_CONSTANT "MOFFRM_LIB_FLGCRCFRZ_MASK" "4"
 SYSTEM_CONSTANT "MOFFRM_LIB_FLGCRCFRZ_MSK" "4"
 SYSTEM_CONSTANT "MOFFRM_LIB_FLGCRCSUM_MASK" "12"
 SYSTEM_CONSTANT "MOFFRM_LIB_FLGCRCSUM_MSK" "12"
 SYSTEM_CONSTANT "MOFFRM_LIB_FLGDICHKS_MASK" "64"
 SYSTEM_CONSTANT "MOFFRM_LIB_FLGDICHKS_MSK" "64"
 SYSTEM_CONSTANT "MOFFRM_LIB_FLGERRSUM_MASK" "10"
 SYSTEM_CONSTANT "MOFFRM_LIB_FLGERRSUM_MSK" "10"
 SYSTEM_CONSTANT "MOFFRM_LIB_FLGFIRSTMSG_MASK" "128"
 SYSTEM_CONSTANT "MOFFRM_LIB_FLGFIRSTMSG_MSK" "128"
 SYSTEM_CONSTANT "MOFFRM_LIB_FLGFRZSUM_MASK" "5"
 SYSTEM_CONSTANT "MOFFRM_LIB_FLGFRZSUM_MSK" "5"
 SYSTEM_CONSTANT "MOFFRM_LIB_FLGSIGINVLDVAL_MSK" "32"
 SYSTEM_CONSTANT "MOFFRM_LIB_HMC" "2"
 SYSTEM_CONSTANT "MOFFRM_LIB_HONDA" "20"
 SYSTEM_CONSTANT "MOFFRM_LIB_INTEL" "1"
 SYSTEM_CONSTANT "MOFFRM_LIB_MAN" "21"
 SYSTEM_CONSTANT "MOFFRM_LIB_MOTOROLA" "0"
 SYSTEM_CONSTANT "MOFFRM_LIB_NEVS" "4"
 SYSTEM_CONSTANT "MOFFRM_LIB_NOEVAL" "255"
 SYSTEM_CONSTANT "MOFFRM_LIB_PSA" "1"
 SYSTEM_CONSTANT "MOFFRM_LIB_SMC" "11"
 SYSTEM_CONSTANT "MOFFRM_LIB_STREETSCOOTER" "6"
 SYSTEM_CONSTANT "MOFFRM_LIB_VOLVO" "7"
 SYSTEM_CONSTANT "MOFFRM_LIB_XOR4PSA" "1"
 SYSTEM_CONSTANT "MOFFRM_RX_ADVDEBALV_ACTV" "0"
 SYSTEM_CONSTANT "MOFFRM_RX_ADVDEBCHKS_ACTV" "0"
 SYSTEM_CONSTANT "MOFFRM_RX_FLGALVERR_MASK" "2"
 SYSTEM_CONSTANT "MOFFRM_RX_FLGALVFRZ_MASK" "1"
 SYSTEM_CONSTANT "MOFFRM_RX_FLGALVSUM_MASK" "3"
 SYSTEM_CONSTANT "MOFFRM_RX_FLGCRCERR_MASK" "8"
 SYSTEM_CONSTANT "MOFFRM_RX_FLGCRCFRZ_MASK" "4"
 SYSTEM_CONSTANT "MOFFRM_RX_FLGCRCSUM_MASK" "12"
 SYSTEM_CONSTANT "MOFFRM_RX_FLGDICHKS_MASK" "64"
 SYSTEM_CONSTANT "MOFFRM_RX_FLGERRSUM_MASK" "10"
 SYSTEM_CONSTANT "MOFFRM_RX_FLGFIRSTMSG_MASK" "128"
 SYSTEM_CONSTANT "MOFFRM_RX_FLGFRZSUM_MASK" "5"
 SYSTEM_CONSTANT "MOFFRM_RX_FLGTIOUTERR_MASK" "2"
 SYSTEM_CONSTANT "MOFFRM_RX_FLGTIOUTFRZ_MASK" "1"
 SYSTEM_CONSTANT "MOFFRM_RX_FLGTIOUTSUM_MASK" "3"
 SYSTEM_CONSTANT "MOF_PTACTV_BP" "1"
 SYSTEM_CONSTANT "MOLMASS_RES" "0.01"
 SYSTEM_CONSTANT "MOMENT_INERTIA_RES" "100"
 SYSTEM_CONSTANT "MoXEMM_CO_CLEAR_ERROR" "65535"
 SYSTEM_CONSTANT "MO_2ECU_BP" "0"
 SYSTEM_CONSTANT "MO_AXLEHEV_BP" "2"
 SYSTEM_CONSTANT "MO_CMNDSLGSLSW_SC" "1"
 SYSTEM_CONSTANT "MO_COMCUST_SC" "1"
 SYSTEM_CONSTANT "MO_ECOM_MSK" "128"
 SYSTEM_CONSTANT "MO_EMEM_MSK" "8"
 SYSTEM_CONSTANT "MO_EPCP_MSK" "64"
 SYSTEM_CONSTANT "MO_ERAM_MSK" "1"
 SYSTEM_CONSTANT "MO_EROMSPG_MSK" "2"
 SYSTEM_CONSTANT "MO_EROMXPG_MSK" "4"
 SYSTEM_CONSTANT "MO_EXTDTSK_SC" "0"
 SYSTEM_CONSTANT "MO_FRDMINTFRMETHOD_SC" "0"
 SYSTEM_CONSTANT "MO_HEV_BP" "0"
 SYSTEM_CONSTANT "MO_LBISTENA_SC" "0"
 SYSTEM_CONSTANT "MO_MAXVALINDCR_SC" "0"
 SYSTEM_CONSTANT "MO_NRSLOTS_SC" "4"
 SYSTEM_CONSTANT "MO_NRUSEDCORESFTY_SC" "2"
 SYSTEM_CONSTANT "MO_PHEV_BP" "1"
 SYSTEM_CONSTANT "MO_PRCMAX_SY" "256"
 SYSTEM_CONSTANT "MO_RAMCHKTYP_SC" "1"
 SYSTEM_CONSTANT "MO_REQRAMCHKEXT_MSK" "32"
 SYSTEM_CONSTANT "MO_REQROMCHKEXT_MSK" "16"
 SYSTEM_CONSTANT "MO_ROM_SY" "1"
 SYSTEM_CONSTANT "MO_SGR_BP" "3"
 SYSTEM_CONSTANT "MO_VDD5MONHWTYP_SC" "0"
 SYSTEM_CONSTANT "MRLY_STACTDSQENA_SC" "0"
 SYSTEM_CONSTANT "MRLY_ST_CLOSED" "1"
 SYSTEM_CONSTANT "MRLY_ST_OPEN" "0"
 SYSTEM_CONSTANT "MRLY_ST_STUCK_CLOSED" "2"
 SYSTEM_CONSTANT "MSPERVOL_RES" "0.001"
 SYSTEM_CONSTANT "MSPERVOL_RES_REV" "1000"
 SYSTEM_CONSTANT "MS_O2_RES" "0.001"
 SYSTEM_CONSTANT "MS_O2_RES_REV" "1000"
 SYSTEM_CONSTANT "MS_SOXLDTOT_RES" "0.5"
 SYSTEM_CONSTANT "MS_SOXLDTOT_RES_FL" "0.5"
 SYSTEM_CONSTANT "MS_SOXLDTOT_RES_REV" "2"
 SYSTEM_CONSTANT "MS_SOXNOX_RES" "1e-005"
 SYSTEM_CONSTANT "MS_SOXNOX_RES_REV" "100000"
 SYSTEM_CONSTANT "MS_SOX_RES" "0.000305"
 SYSTEM_CONSTANT "MULTIHSS_SC" "0"
 SYSTEM_CONSTANT "M_NOXLD_LORES_RES" "0.004"
 SYSTEM_CONSTANT "M_NOXLD_LORES_RES_REV" "250"
 SYSTEM_CONSTANT "M_SOOT_RES1" "0.004"
 SYSTEM_CONSTANT "M_SOOT_RES1_REV" "250"
 SYSTEM_CONSTANT "NOREINI_SC" "1"
 SYSTEM_CONSTANT "NORM_AIRMASS_INJCRV_FACT1" "1280"
 SYSTEM_CONSTANT "NORM_DVOL_X_DT" "360000"
 SYSTEM_CONSTANT "NORM_HCMPTQ0P00000042HCMPT" "4"
 SYSTEM_CONSTANT "NORM_HCMPTQ0P82HCMPT" "8"
 SYSTEM_CONSTANT "NORM_MNOXLOAD2LR" "400"
 SYSTEM_CONSTANT "NORM_Q_BY_RHO" "1000"
 SYSTEM_CONSTANT "NORM_SEC_US" "1000000"
 SYSTEM_CONSTANT "NORM_TIME2LR" "100"
 SYSTEM_CONSTANT "NOXFLWEG_RES" "0.025"
 SYSTEM_CONSTANT "NOXFLW_RES" "0.001"
 SYSTEM_CONSTANT "NOXMASSFLW_RES" "0.001"
 SYSTEM_CONSTANT "NOXMASSFLW_RES_REV" "1000"
 SYSTEM_CONSTANT "NOX_FLD" "10"
 SYSTEM_CONSTANT "NOX_RES" "1"
 SYSTEM_CONSTANT "NRM_DVOL_X_DT" "360000"
 SYSTEM_CONSTANT "NRM_DVOL_X_DT_HIGH" "18000"
 SYSTEM_CONSTANT "NRM_EXPO_AG_CRS_HI_RESO" "7"
 SYSTEM_CONSTANT "NRM_EXPO_T_INC_PER_DUR_HI_RESO" "8"
 SYSTEM_CONSTANT "NRM_EXP_RES_TRIGO_FUNC" "12"
 SYSTEM_CONSTANT "NRM_Q_BY_RHO" "1000"
 SYSTEM_CONSTANT "NRM_VOL_L_TO_UL" "20"
 SYSTEM_CONSTANT "NSCDS_CT_SENSORS" "1"
 SYSTEM_CONSTANT "NSCLD_MTOTSTRTRGN_MIN" "0.001"
 SYSTEM_CONSTANT "NSCLD_RDCAGTMIN" "-1e-005"
 SYSTEM_CONSTANT "NSCMON_TIAFTLM_MAX" "65.536"
 SYSTEM_CONSTANT "NSCMON_UBINLAM_MAX" "2000"
 SYSTEM_CONSTANT "NSCRGN_TIME_100_RES" "0.01"
 SYSTEM_CONSTANT "NSC_ACTV_BP" "1"
 SYSTEM_CONSTANT "NSC_AMPTNOXLDUNLD_MAX" "0"
 SYSTEM_CONSTANT "NSC_AMPTNOXLDUNLD_MIN" "-10"
 SYSTEM_CONSTANT "NSC_AMPTNOXRGN_MAX" "0"
 SYSTEM_CONSTANT "NSC_AMPTNOX_MIN" "0"
 SYSTEM_CONSTANT "NSC_CT_SENSORS" "0"
 SYSTEM_CONSTANT "NSC_CT_SENSORS_SY" "0"
 SYSTEM_CONSTANT "NSC_CT_SENSORS_TWFLW_SYS" "0"
 SYSTEM_CONSTANT "NSC_MSO2_MIN" "0"
 SYSTEM_CONSTANT "NSC_MSPERVOL_MIN" "0"
 SYSTEM_CONSTANT "NSC_MSSOXNOX_MAX" "0.1"
 SYSTEM_CONSTANT "NSC_MSSOXNOX_MIN" "0"
 SYSTEM_CONSTANT "NSC_NOXMASSFLW_MIN" "0"
 SYSTEM_CONSTANT "NSC_NOX_ZERO" "0"
 SYSTEM_CONSTANT "NSC_SWTACTV_BP" "0"
 SYSTEM_CONSTANT "NSC_TIMEMAX_SY" "327.5"
 SYSTEM_CONSTANT "NUMCYLMAX_SY" "4"
 SYSTEM_CONSTANT "NUMFANS_SY" "1"
 SYSTEM_CONSTANT "NUMPSICCHP_SY" "1"
 SYSTEM_CONSTANT "NUMVEHVSENS_SY" "0"
 SYSTEM_CONSTANT "NUM_CHIP" "1"
 SYSTEM_CONSTANT "O2MPT_RES_REV" "100"
 SYSTEM_CONSTANT "O2_RES" "1e-005"
 SYSTEM_CONSTANT "OBD_PHYSMEDM_SY" "0"
 SYSTEM_CONSTANT "OBS_SY" "1"
 SYSTEM_CONSTANT "OCWDA_CO_UBATTLOWLIM" "8000"
 SYSTEM_CONSTANT "OILCOOLRDST_TYPAVL_SC" "0"
 SYSTEM_CONSTANT "OILGLRYT_TYPAVL_SC" "0"
 SYSTEM_CONSTANT "OILLVL_MMQ0P004_RES" "0.004"
 SYSTEM_CONSTANT "OILLVL_MMQ0P004_RESREV" "250"
 SYSTEM_CONSTANT "OILMFL_MGPS_Q0P1_RES" "0.1"
 SYSTEM_CONSTANT "OILMFL_MGPS_Q0P1_RES_REV" "10"
 SYSTEM_CONSTANT "OILMSPRCQ0P01_100" "100"
 SYSTEM_CONSTANT "OILMSPRC_Q0P01_RES" "0.01"
 SYSTEM_CONSTANT "OILMSPRC_Q0P01_RES_REV" "100"
 SYSTEM_CONSTANT "OILMS_MG_RES" "1"
 SYSTEM_CONSTANT "OILMS_MG_RES_REV" "1"
 SYSTEM_CONSTANT "OILMS_Q0P1_RES" "0.1"
 SYSTEM_CONSTANT "OILMS_Q0P1_RES_REV" "10"
 SYSTEM_CONSTANT "OILMS_Q10_RES" "10"
 SYSTEM_CONSTANT "OILP_TYPAVL_SY" "0"
 SYSTEM_CONSTANT "OILSWMPT_TYPAVL_SC" "0"
 SYSTEM_CONSTANT "OILT_TYPAVL_SY" "0"
 SYSTEM_CONSTANT "PAIRFLTDSPRS_SY" "0"
 SYSTEM_CONSTANT "PAIRFLTDS_TYPAVL_SY" "0"
 SYSTEM_CONSTANT "PASSDOORRDNT_TYPAVL_SC" "0"
 SYSTEM_CONSTANT "PCMPRUSSENS_SY" "0"
 SYSTEM_CONSTANT "PENVPRSNT_SC" "1"
 SYSTEM_CONSTANT "PENVREJHIVALERR_SC" "0"
 SYSTEM_CONSTANT "PENVSNSRTYP_SC" "1"
 SYSTEM_CONSTANT "PERMSPLYSYS_SY" "0"
 SYSTEM_CONSTANT "PEXHMNFLD_TYPAVL_SC" "0"
 SYSTEM_CONSTANT "PFLTLD_RO2EG" "0.2315"
 SYSTEM_CONSTANT "PFLTLD_RO2EGONE" "1"
 SYSTEM_CONSTANT "PFLTLD_RO2STOICH" "0.2315"
 SYSTEM_CONSTANT "PFLTLD_RO2STOICHONE" "1"
 SYSTEM_CONSTANT "PFLTPOPPRC_RES" "0.1"
 SYSTEM_CONSTANT "PFLT_ACTV_BP" "0"
 SYSTEM_CONSTANT "PHI_COR_MAX" "10"
 SYSTEM_CONSTANT "PHI_MI_EARL" "40"
 SYSTEM_CONSTANT "PHI_MI_LATE" "-10"
 SYSTEM_CONSTANT "PHI_PII_EARL_ABS" "100"
 SYSTEM_CONSTANT "PHI_PII_EARL_REL" "90"
 SYSTEM_CONSTANT "PHI_PII_LATE_REL" "5"
 SYSTEM_CONSTANT "PHI_POI0_EARLY" "-40"
 SYSTEM_CONSTANT "PHI_POI0_LATE" "-100"
 SYSTEM_CONSTANT "PHI_POI1_EARL" "-40"
 SYSTEM_CONSTANT "PHI_POI1_LATE" "-100"
 SYSTEM_CONSTANT "PHI_POI1_ZERO" "0"
 SYSTEM_CONSTANT "PHI_POI2_LATE" "-40"
 SYSTEM_CONSTANT "PHI_ZERO" "0"
 SYSTEM_CONSTANT "PI" "3.14159265359"
 SYSTEM_CONSTANT "PII321_MI1_POI321" "0"
 SYSTEM_CONSTANT "PII321_UNDEFD_MI1_POI21" "1"
 SYSTEM_CONSTANT "PIICLB_ANGLE32FAC2ANGLE_CNV" "6553600"
 SYSTEM_CONSTANT "PIICLB_FACTS32_RES" "65536"
 SYSTEM_CONSTANT "PIICLB_INJMASSS32_RES" "6553600"
 SYSTEM_CONSTANT "PIICLB_INJMASSS32_ZERO" "0"
 SYSTEM_CONSTANT "PIICLB_RCNFDMAX" "32766"
 SYSTEM_CONSTANT "PIICLB_STATE_CALC" "2"
 SYSTEM_CONSTANT "PIICLB_STATE_CLB" "1"
 SYSTEM_CONSTANT "PIICLB_STATE_INIT" "255"
 SYSTEM_CONSTANT "PIICLB_STATE_START" "0"
 SYSTEM_CONSTANT "PIICLB_STRLS_DISABLED" "1"
 SYSTEM_CONSTANT "PIICLB_STRLS_RELEASED" "0"
 SYSTEM_CONSTANT "PIICLB_TRQBYETA2QNT32_CNV" "83886080"
 SYSTEM_CONSTANT "PIICLB_TRQDT1KDMUL" "65536000"
 SYSTEM_CONSTANT "PIICLB_TRQPERSEC_RES" "1000"
 SYSTEM_CONSTANT "PIICLB_UPDT_COL" "1"
 SYSTEM_CONSTANT "PIICLB_UPDT_SEQ" "0"
 SYSTEM_CONSTANT "PIICLB_VARIANT_NONE" "0"
 SYSTEM_CONSTANT "PIICLB_VARIANT_PIC" "1"
 SYSTEM_CONSTANT "PIICLB_VARIANT_PICALL" "2"
 SYSTEM_CONSTANT "PINTKVUS_SNSR1PRSNT_SC" "0"
 SYSTEM_CONSTANT "PINTKVUS_TYPAVL_SY" "0"
 SYSTEM_CONSTANT "PLGPLT_CHRGRSTOP" "1"
 SYSTEM_CONSTANT "PLGPLT_CHRGRSTRT" "2"
 SYSTEM_CONSTANT "PLGPLT_ERR" "3"
 SYSTEM_CONSTANT "PLGPLT_INI" "0"
 SYSTEM_CONSTANT "PLGPLT_PLGD" "2"
 SYSTEM_CONSTANT "PLGPLT_UNPLGD" "1"
 SYSTEM_CONSTANT "PLGPLT_VEH_CHRGN_PRMS" "4"
 SYSTEM_CONSTANT "PMAXCTL_FACKPNRM8" "8"
 SYSTEM_CONSTANT "PMP_QNT_MAX" "1500"
 SYSTEM_CONSTANT "PMP_QNT_RES" "0.1"
 SYSTEM_CONSTANT "PMP_QNT_ZERO" "0"
 SYSTEM_CONSTANT "PNRM" "1013"
 SYSTEM_CONSTANT "POFFSADPN_SC" "0"
 SYSTEM_CONSTANT "POILVT_TYPAVL_SC" "0"
 SYSTEM_CONSTANT "POSMCCTL_FACKDNRM4" "4"
 SYSTEM_CONSTANT "POSMCCTL_FACKINRM2" "2"
 SYSTEM_CONSTANT "POSMCCTL_FACKPNRM32" "32"
 SYSTEM_CONSTANT "POSTDRV_SOFTRST_SY" "0"
 SYSTEM_CONSTANT "POUTLVLVDS_TYPAVL_SC" "0"
 SYSTEM_CONSTANT "PPFLTDIFFASICT_TYPAVL_SC" "0"
 SYSTEM_CONSTANT "PPFLTDIFFCH1_TYPAVL_SC" "0"
 SYSTEM_CONSTANT "PPFLTDIFFCH2_TYPAVL_SC" "0"
 SYSTEM_CONSTANT "PPFLTDIFF_TYPAVL_SY" "0"
 SYSTEM_CONSTANT "PPFLTDIFF_TYPTWINFLW_SC" "0"
 SYSTEM_CONSTANT "PPFLTDS_TYPAVL_SC" "0"
 SYSTEM_CONSTANT "PPFLTUS_TYPAVL_SY" "0"
 SYSTEM_CONSTANT "PRCFACT100_FULLNEG" "-100"
 SYSTEM_CONSTANT "PRCFACT100_FULLPOS" "100"
 SYSTEM_CONSTANT "PRCFACT100_ZERO" "0"
 SYSTEM_CONSTANT "PRC_M_100" "-100"
 SYSTEM_CONSTANT "PRECOPT_SC" "1"
 SYSTEM_CONSTANT "PREFSCALE_RES" "1000"
 SYSTEM_CONSTANT "PRES_AIR_MAX" "3500"
 SYSTEM_CONSTANT "PRES_AIR_MIN" "0"
 SYSTEM_CONSTANT "PRES_BAR_RES" "1"
 SYSTEM_CONSTANT "PRES_HPA_2000" "2000"
 SYSTEM_CONSTANT "PRES_RAIL_GRADHI_TO_VAL" "60"
 SYSTEM_CONSTANT "PRES_RAIL_GRAD_TO_VAL" "4"
 SYSTEM_CONSTANT "PRES_RAIL_RES" "100"
 SYSTEM_CONSTANT "PRES_RAIL_RES_REV" "100"
 SYSTEM_CONSTANT "PRES_TIME_RES" "400"
 SYSTEM_CONSTANT "PRES_TIME_RES_REV" "400"
 SYSTEM_CONSTANT "PRKBRK_APPLD" "2"
 SYSTEM_CONSTANT "PRKBRK_ERR" "255"
 SYSTEM_CONSTANT "PRKBRK_NOT_APPLD" "1"
 SYSTEM_CONSTANT "PRKGHEATR_TYPAVL_SC" "0"
 SYSTEM_CONSTANT "PSSC014EU6_SY" "10"
 SYSTEM_CONSTANT "PSSC040EVCUSCVRNT_SC" "1"
 SYSTEM_CONSTANT "PS_NUMSENS_SY" "0"
 SYSTEM_CONSTANT "PTHRVLVDS_TYPAVL_SC" "0"
 SYSTEM_CONSTANT "PTHRVLVUS_SNSR1PRSNT_SC" "0"
 SYSTEM_CONSTANT "PTRBNABSLTUS_TYPAVL_SC" "0"
 SYSTEM_CONSTANT "PTRBNDS_TYPAVL_SY" "0"
 SYSTEM_CONSTANT "PTRBNUS_TYPAVL_SY" "0"
 SYSTEM_CONSTANT "PWMCTP_TYPAVL_SC" "1"
 SYSTEM_CONSTANT "PWRDISTBNUNITT_TYPAVL_SC" "1"
 SYSTEM_CONSTANT "PWRSQ_TEMPSQQ0P01_RES" "0.01"
 SYSTEM_CONSTANT "PWR_HIGH_RES_REV" "10"
 SYSTEM_CONSTANT "PWR_KW_RES" "0.01"
 SYSTEM_CONSTANT "PWR_Q1_RES" "1"
 SYSTEM_CONSTANT "PWR_Q50_RES" "50"
 SYSTEM_CONSTANT "PWR_TEMPQ0P001_RES" "0.01"
 SYSTEM_CONSTANT "PWR_TEMPQ0P1_RES" "0.1"
 SYSTEM_CONSTANT "PWR_W_ZERO" "0"
 SYSTEM_CONSTANT "PWR_ZERO" "0"
 SYSTEM_CONSTANT "QNTR_EXP" "10"
 SYSTEM_CONSTANT "QNTR_MAX" "24"
 SYSTEM_CONSTANT "QNTR_MIN" "0.0009765625"
 SYSTEM_CONSTANT "QNTR_RES" "0.0009765625"
 SYSTEM_CONSTANT "QNTR_RES_REV" "1024"
 SYSTEM_CONSTANT "QNTSEL_SY" "0"
 SYSTEM_CONSTANT "Qp_RES" "10"
 SYSTEM_CONSTANT "RAIL_MEUN" "1"
 SYSTEM_CONSTANT "RAIL_PCV" "0"
 SYSTEM_CONSTANT "RAIL_PRES_ZERO" "0"
 SYSTEM_CONSTANT "RATAM_RES" "0.01"
 SYSTEM_CONSTANT "RATAM_RES_HIGH" "0.001"
 SYSTEM_CONSTANT "RATAM_RES_REV" "100"
 SYSTEM_CONSTANT "RATAM_RES_REV_HIGH" "1000"
 SYSTEM_CONSTANT "RATCM_RES" "1e-006"
 SYSTEM_CONSTANT "RATO2DRYAIR" "0.2315"
 SYSTEM_CONSTANT "RATPCRITAIR" "0.52828199"
 SYSTEM_CONSTANT "RAT_AIR_PRES_RES" "0.001"
 SYSTEM_CONSTANT "RAT_HIGH_RES" "0.001"
 SYSTEM_CONSTANT "RAT_HIGH_RES_REV" "1000"
 SYSTEM_CONSTANT "RAT_HIRES_CPP" "0.0001"
 SYSTEM_CONSTANT "RAT_HIRES_CPP_REV" "10000"
 SYSTEM_CONSTANT "RBANDSTYPE_SC" "0"
 SYSTEM_CONSTANT "RBA_SWTRACEENA_SC" "1"
 SYSTEM_CONSTANT "RBPTCEL_A_ZR" "0"
 SYSTEM_CONSTANT "RBPTCEL_BMS_STHAD_ENAD" "0"
 SYSTEM_CONSTANT "RBPTCEL_BMS_STHAD_NOTUSED" "1"
 SYSTEM_CONSTANT "RBPTCEL_BMS_STHAD_PRMNTNOTENAD" "3"
 SYSTEM_CONSTANT "RBPTCEL_BMS_STHAD_SIGNOTAVL" "7"
 SYSTEM_CONSTANT "RBPTCEL_BMS_STHAD_TMPNOTENAD" "2"
 SYSTEM_CONSTANT "RBPTCEL_CLUCLSD" "0"
 SYSTEM_CONSTANT "RBPTCEL_CLUGEARDISENGMT" "5"
 SYSTEM_CONSTANT "RBPTCEL_CLUGEARSHIFT" "7"
 SYSTEM_CONSTANT "RBPTCEL_CLULNCH" "3"
 SYSTEM_CONSTANT "RBPTCEL_CLUOPEN" "1"
 SYSTEM_CONSTANT "RBPTCEL_CLUSHIFTSUPRT" "6"
 SYSTEM_CONSTANT "RBPTCEL_CLUTQTRCK" "4"
 SYSTEM_CONSTANT "RBPTCEL_CLUTRAN" "2"
 SYSTEM_CONSTANT "RBPTCEL_CNVN_F_ZR" "0"
 SYSTEM_CONSTANT "RBPTCEL_CNVN_P_ZR" "0"
 SYSTEM_CONSTANT "RBPTCEL_DST_ZR" "0"
 SYSTEM_CONSTANT "RBPTCEL_FRQ_ZR" "0"
 SYSTEM_CONSTANT "RBPTCEL_F_ZR" "0"
 SYSTEM_CONSTANT "RBPTCEL_GRDTN_ZR" "0"
 SYSTEM_CONSTANT "RBPTCEL_GRDTRAT_ZR" "0"
 SYSTEM_CONSTANT "RBPTCEL_I_ZR" "0"
 SYSTEM_CONSTANT "RBPTCEL_MOFDISCNCT_CMDCHRGCLSD" "4"
 SYSTEM_CONSTANT "RBPTCEL_MOFDISCNCT_CMDCLSD" "2"
 SYSTEM_CONSTANT "RBPTCEL_MOFDISCNCT_CMDDCHACLSD" "5"
 SYSTEM_CONSTANT "RBPTCEL_MOFDISCNCT_CMDOPEN" "0"
 SYSTEM_CONSTANT "RBPTCEL_P_ZR" "0"
 SYSTEM_CONSTANT "RBPTCEL_RAT" "0"
 SYSTEM_CONSTANT "RBPTCEL_RAT_1" "100"
 SYSTEM_CONSTANT "RBPTCEL_RAT_ZR" "0"
 SYSTEM_CONSTANT "RBPTCEL_RMDETNUS_BITPOSN_0" "0"
 SYSTEM_CONSTANT "RBPTCEL_SPD_ZR" "0"
 SYSTEM_CONSTANT "RBPTCEL_SSWTSECVC_DISAD" "0"
 SYSTEM_CONSTANT "RBPTCEL_SSWTSECVC_ENAD" "1"
 SYSTEM_CONSTANT "RBPTCEL_TI_ZR" "0"
 SYSTEM_CONSTANT "RBPTCEL_TQ_ZR" "0"
 SYSTEM_CONSTANT "RBPTCEL_T_ZR" "0"
 SYSTEM_CONSTANT "RBPTCEL_U_ZR" "0"
 SYSTEM_CONSTANT "RBPTCEL_VF_ZR" "0"
 SYSTEM_CONSTANT "RBPTCEL_V_ZR" "0"
 SYSTEM_CONSTANT "RCPTSRC_BRKPEDL" "2"
 SYSTEM_CONSTANT "RESIST_RES" "0.1"
 SYSTEM_CONSTANT "RESO_T_INC_PER_DUR_TTH_ADAP" "10"
 SYSTEM_CONSTANT "REVCNT_RES" "16"
 SYSTEM_CONSTANT "REVCNT_RES_EXP" "4"
 SYSTEM_CONSTANT "REVGEAR1" "-1"
 SYSTEM_CONSTANT "RHO_FUEL_RES" "0.1"
 SYSTEM_CONSTANT "RHUSTGYPRS_SY" "0"
 SYSTEM_CONSTANT "RMPSQRVLG_S_1000_REF" "1000"
 SYSTEM_CONSTANT "RMPSQRVLG_S_100_REF" "100"
 SYSTEM_CONSTANT "RMPSQRVLG_S_REF" "1000"
 SYSTEM_CONSTANT "RMPSQRVLG_S_RES" "65536"
 SYSTEM_CONSTANT "RMTAPP_ENBL_SY" "0"
 SYSTEM_CONSTANT "RNOX_ZERO" "0"
 SYSTEM_CONSTANT "R_COIL_MAX" "5000"
 SYSTEM_CONSTANT "R_COIL_MIN" "0"
 SYSTEM_CONSTANT "R_RES" "1"
 SYSTEM_CONSTANT "SCALEFACDIV_RES" "200"
 SYSTEM_CONSTANT "SCR_AMPERE_RES_REV" "5"
 SYSTEM_CONSTANT "SCR_DTTEMP_RES_REV" "10"
 SYSTEM_CONSTANT "SCR_FLVOL_RES_REV" "20"
 SYSTEM_CONSTANT "SCR_KPA_100_RES_REV" "0.01"
 SYSTEM_CONSTANT "SCR_KPA_10_RES_REV" "0.1"
 SYSTEM_CONSTANT "SCR_NOXFLW_RES_REV" "1000"
 SYSTEM_CONSTANT "SCR_ONEMIOPPMNOX_SY" "1000000"
 SYSTEM_CONSTANT "SCR_PRES_HPA_RES_REV" "1"
 SYSTEM_CONSTANT "SCR_UC_VOLT_RES_REV" "10"
 SYSTEM_CONSTANT "SCR_VOLTQ0P0001227_RES" "0.0001220703125"
 SYSTEM_CONSTANT "SCR_VOLT_Q0P002_RES_REV" "500"
 SYSTEM_CONSTANT "SCTPMP1T_TYPAVL_SY" "0"
 SYSTEM_CONSTANT "SCTPMP1_TYPAVL_SY" "1"
 SYSTEM_CONSTANT "SCTPMPRLY_TYPAVL_SC" "1"
 SYSTEM_CONSTANT "SD_SC" "0"
 SYSTEM_CONSTANT "SEAWTRP_TYPAVL_SC" "0"
 SYSTEM_CONSTANT "SEAWTRT_TYPAVL_SC" "0"
 SYSTEM_CONSTANT "SECUPCK_SC" "1"
 SYSTEM_CONSTANT "SEC_RES" "1"
 SYSTEM_CONSTANT "SENT_SC" "0"
 SYSTEM_CONSTANT "SEPAIRVOLTHRVLVUS_SC" "0"
 SYSTEM_CONSTANT "SETPOINTCALC_TRQBASED_SY" "0"
 SYSTEM_CONSTANT "SIA_GENR_SY" "0"
 SYSTEM_CONSTANT "SIA_OEM" "1"
 SYSTEM_CONSTANT "SIA_PRJ_ID_SY" "5"
 SYSTEM_CONSTANT "SIA_RB" "0"
 SYSTEM_CONSTANT "SIGNALS_AUTOPIDTABLE_SUPPORTED" "0"
 SYSTEM_CONSTANT "SIGNALS_BIT_DATATYPE_SUPPORTED" "0"
 SYSTEM_CONSTANT "SIGNALS_EXT2INT_2DARRAY_SUPPORTED" "0"
 SYSTEM_CONSTANT "SIGNALS_FLOAT_SUPPORTED" "0"
 SYSTEM_CONSTANT "SIGNALS_FORCE_PAVAST_IMPORT_STANDARD_SUPPORTED" "0"
 SYSTEM_CONSTANT "SIGNALS_INT2EXT_2DARRAY_SUPPORTED" "0"
 SYSTEM_CONSTANT "Signals_Mode1PidSize_SY" "206"
 SYSTEM_CONSTANT "Signals_NumberPID_SY" "67"
 SYSTEM_CONSTANT "Signals_NumberSigNumExt_SY" "3"
 SYSTEM_CONSTANT "Signals_NumberSigNumIntStd_SY" "270"
 SYSTEM_CONSTANT "Signals_NumberSigNumInt_SY" "313"
 SYSTEM_CONSTANT "SIGNALS_OBDDIDSUPRT_SC" "0"
 SYSTEM_CONSTANT "SIGNALS_STDARRSIG_SUPPORTED" "0"
 SYSTEM_CONSTANT "Signals_SupportArray_Length_SY" "0"
 SYSTEM_CONSTANT "SIGNALS_VIRTUAL_ACCTL_FLGCMPRENA_DID_S" "276"
 SYSTEM_CONSTANT "SIGNALS_VIRTUAL_BRKBSTPMP_BPMPSTRT_DID_S" "277"
 SYSTEM_CONSTANT "SIGNALS_VIRTUAL_BRKBSTPMP_FLGHSACTR_DID_S" "278"
 SYSTEM_CONSTANT "SIGNALS_VIRTUAL_BRKBSTPMP_FLGLSACTR_DID_S" "279"
 SYSTEM_CONSTANT "SIGNALS_VIRTUAL_BRKBST_FLGBKUPMODACTV_DID_S" "280"
 SYSTEM_CONSTANT "SIGNALS_VIRTUAL_CBNHEATGHEATR_FLGHSACTR_DID_S" "281"
 SYSTEM_CONSTANT "SIGNALS_VIRTUAL_CBNHEATGHEATR_FLGLSACTR_DID_S" "282"
 SYSTEM_CONSTANT "SIGNALS_VIRTUAL_CHRGNCNTCT_FLGHSACTR_DID_S" "283"
 SYSTEM_CONSTANT "SIGNALS_VIRTUAL_CHRGNCNTCT_FLGLSNEGACTR_DID_S" "284"
 SYSTEM_CONSTANT "SIGNALS_VIRTUAL_CHRGNCNTCT_FLGLSPOSACTR_DID_S" "285"
 SYSTEM_CONSTANT "SIGNALS_VIRTUAL_COMEMAC_FLGIMOBAUTHENT_DID_S" "286"
 SYSTEM_CONSTANT "SIGNALS_VIRTUAL_COMEMAC_STPWRAUTHN_DID_S" "287"
 SYSTEM_CONSTANT "SIGNALS_VIRTUAL_COM_BPRECONDELECWKUREQ_DID_S" "288"
 SYSTEM_CONSTANT "SIGNALS_VIRTUAL_COM_BREFOGRLYST_DID_S" "289"
 SYSTEM_CONSTANT "SIGNALS_VIRTUAL_COM_BSTPDLYHMIWKUREQ_DID_S" "290"
 SYSTEM_CONSTANT "SIGNALS_VIRTUAL_COM_FLGBLOWRAUTHN_DID_S" "291"
 SYSTEM_CONSTANT "SIGNALS_VIRTUAL_COM_FLGBRKALRT_DID_S" "292"
 SYSTEM_CONSTANT "SIGNALS_VIRTUAL_COM_FLGBRKMAIDIAG_DID_S" "293"
 SYSTEM_CONSTANT "SIGNALS_VIRTUAL_COM_FLGBRKMAI_DID_S" "294"
 SYSTEM_CONSTANT "SIGNALS_VIRTUAL_COM_FLGCURMEASMTVLD_DID_S" "295"
 SYSTEM_CONSTANT "SIGNALS_VIRTUAL_COM_FLGDRVAWY_DID_S" "296"
 SYSTEM_CONSTANT "SIGNALS_VIRTUAL_COM_FLGGEARLVRMOVMT_DID_S" "297"
 SYSTEM_CONSTANT "SIGNALS_VIRTUAL_COM_FLGGUNUNLCKREQ_DID_S" "298"
 SYSTEM_CONSTANT "SIGNALS_VIRTUAL_COM_FLGHVBATTAUTHN_DID_S" "299"
 SYSTEM_CONSTANT "SIGNALS_VIRTUAL_COM_FLGRSTTRIPAEE_DID_S" "300"
 SYSTEM_CONSTANT "SIGNALS_VIRTUAL_COM_FLGTPCBMEASMTVLD_DID_S" "301"
 SYSTEM_CONSTANT "SIGNALS_VIRTUAL_COM_STABSACTV_DID_S" "302"
 SYSTEM_CONSTANT "SIGNALS_VIRTUAL_COM_STACTX_DID_S" "303"
 SYSTEM_CONSTANT "SIGNALS_VIRTUAL_COM_STBRKCNTCTINDCN_DID_S" "304"
 SYSTEM_CONSTANT "SIGNALS_VIRTUAL_COM_STCMDOFFSEM01_DID_S" "305"
 SYSTEM_CONSTANT "SIGNALS_VIRTUAL_COM_STDOOR1_DID_S" "306"
 SYSTEM_CONSTANT "SIGNALS_VIRTUAL_COM_STDOOR2_DID_S" "307"
 SYSTEM_CONSTANT "SIGNALS_VIRTUAL_COM_STDOOR3_DID_S" "308"
 SYSTEM_CONSTANT "SIGNALS_VIRTUAL_COM_STDOOR4_DID_S" "309"
 SYSTEM_CONSTANT "SIGNALS_VIRTUAL_COM_STELCMPRSTATTX_DID_S" "310"
 SYSTEM_CONSTANT "SIGNALS_VIRTUAL_DCDC_FLGDESLVGRIDULIM_DID_S" "311"
 SYSTEM_CONSTANT "SIGNALS_VIRTUAL_EEM_FLGFSTHVSHDWN_DID_S" "312"
 SYSTEM_CONSTANT "SIGNALS_VIRTUAL_HVBATT_FLGISOMEASMTDIREQ_DID_S" "313"
 SYSTEM_CONSTANT "SIGQLY_FROZEN" "32"
 SYSTEM_CONSTANT "SIGQLY_INIT" "2"
 SYSTEM_CONSTANT "SIGQLY_INVALID" "64"
 SYSTEM_CONSTANT "SIGQLY_MODEL" "8"
 SYSTEM_CONSTANT "SIGQLY_NOTCALC" "1"
 SYSTEM_CONSTANT "SIGQLY_OK" "4"
 SYSTEM_CONSTANT "SIGQLY_REPLACEMENT" "16"
 SYSTEM_CONSTANT "Sig_I15031_LeanAppl_SY" "1"
 SYSTEM_CONSTANT "SOTMASSPERSEC_RES" "0.1"
 SYSTEM_CONSTANT "SOTMASSPERSEC_RES_REV" "10"
 SYSTEM_CONSTANT "SPAVEL_RES" "10"
 SYSTEM_CONSTANT "SPDLIM_SY" "1"
 SYSTEM_CONSTANT "SPECHEATFINE_RES_REV" "5"
 SYSTEM_CONSTANT "SPECHEAT_RES" "2"
 SYSTEM_CONSTANT "SPECIFICHEAT_RES" "0.0001"
 SYSTEM_CONSTANT "SPECIFICHEAT_RES_REV" "10000"
 SYSTEM_CONSTANT "SPPLCOOLTPMPRLY_TYPAVL_SC" "1"
 SYSTEM_CONSTANT "SSWTS_TYPE_DATASET" "2"
 SYSTEM_CONSTANT "STRTTRQ_OFF" "0"
 SYSTEM_CONSTANT "STRTTRQ_ON" "1"
 SYSTEM_CONSTANT "STSP_SY" "0"
 SYSTEM_CONSTANT "SVSLMP_DISPSUPRT_SC" "0"
 SYSTEM_CONSTANT "SVSLMP_PWRSTG_SY" "0"
 SYSTEM_CONSTANT "SVSLMP_SUPRT_ATS_SY" "0"
 SYSTEM_CONSTANT "SWT_DISABLED" "0"
 SYSTEM_CONSTANT "SWT_ENABLED" "1"
 SYSTEM_CONSTANT "SYC_AFTRUNDIAG_SC" "0"
 SYSTEM_CONSTANT "SYC_CAL_PERMSPLYSYS_SY" "0"
 SYSTEM_CONSTANT "SYC_CNTPOSTDRV_SC" "0"
 SYSTEM_CONSTANT "SYC_COORD_SC" "0"
 SYSTEM_CONSTANT "SYC_DRIVE" "4"
 SYSTEM_CONSTANT "SYC_ENALCYPROLG_SC" "0"
 SYSTEM_CONSTANT "SYC_ENASYSCTRLSUBST_SC" "1"
 SYSTEM_CONSTANT "SYC_FSTSWOFF_SY" "0"
 SYSTEM_CONSTANT "SYC_INI" "0"
 SYSTEM_CONSTANT "SYC_INIEND" "2"
 SYSTEM_CONSTANT "SYC_INISYN" "1"
 SYSTEM_CONSTANT "SYC_MRLY_SC" "1"
 SYSTEM_CONSTANT "SYC_PERPH_SC" "0"
 SYSTEM_CONSTANT "SYC_POSTDRIVE" "5"
 SYSTEM_CONSTANT "SYC_POST_OS_EXIT" "6"
 SYSTEM_CONSTANT "SYC_POWERUNDERVOLTAGE_SC" "1"
 SYSTEM_CONSTANT "SYC_POWER_SC" "1"
 SYSTEM_CONSTANT "SYC_PREDRIVE" "3"
 SYSTEM_CONSTANT "SYC_PREDRV_NWM" "4"
 SYSTEM_CONSTANT "SYC_PROLGPREDRV_SC" "0"
 SYSTEM_CONSTANT "SYC_SHUTDOWNSERVICES_SC" "1"
 SYSTEM_CONSTANT "SYC_SYSTYP_SC" "1"
 SYSTEM_CONSTANT "SYC_T15POSTPREDRV_SWRST_SY" "0"
 SYSTEM_CONSTANT "SYC_WREEPBLK_SY" "1"
 SYSTEM_CONSTANT "SYC_X2ME_SC" "0"
 SYSTEM_CONSTANT "SYSA_DSQACTVT_SC" "1"
 SYSTEM_CONSTANT "SYSB_CUST_SC" "2"
 SYSTEM_CONSTANT "SYSB_ENAUSER_SC" "1"
 SYSTEM_CONSTANT "SYSB_PHYTERMINAL15_SC" "1"
 SYSTEM_CONSTANT "SYSDIAG_NRAFTRUNCOORRARRELEM_SC" "0"
 SYSTEM_CONSTANT "SY_ATMTURB" "0"
 SYSTEM_CONSTANT "SY_AUFLAD" "0"
 SYSTEM_CONSTANT "SY_BKV" "2"
 SYSTEM_CONSTANT "SY_DLDP" "0"
 SYSTEM_CONSTANT "SY_DMDSTQ" "1"
 SYSTEM_CONSTANT "SY_DMTL" "0"
 SYSTEM_CONSTANT "SY_DSNDK" "0"
 SYSTEM_CONSTANT "SY_EGAS" "1"
 SYSTEM_CONSTANT "SY_HFM" "0"
 SYSTEM_CONSTANT "SY_INHIBIT" "0"
 SYSTEM_CONSTANT "SY_KDS" "0"
 SYSTEM_CONSTANT "SY_KORRZ" "1"
 SYSTEM_CONSTANT "SY_LAYER" "0"
 SYSTEM_CONSTANT "SY_MDMXEXC" "1"
 SYSTEM_CONSTANT "SY_NVLD" "0"
 SYSTEM_CONSTANT "SY_PTL" "0"
 SYSTEM_CONSTANT "SY_SGANZ" "1"
 SYSTEM_CONSTANT "SY_SVBB" "1"
 SYSTEM_CONSTANT "SY_TEETH" "60"
 SYSTEM_CONSTANT "SY_UBSQ_W" "1"
 SYSTEM_CONSTANT "SY_VARCODE" "1"
 SYSTEM_CONSTANT "SY_VD" "0"
 SYSTEM_CONSTANT "SY_WNBM" "1"
 SYSTEM_CONSTANT "SY_ZYLZA" "6"
 SYSTEM_CONSTANT "SY_ZYLZG" "6"
 SYSTEM_CONSTANT "T15RAWDSQENA_SC" "0"
 SYSTEM_CONSTANT "T15_WKDETN_SC" "0"
 SYSTEM_CONSTANT "T87_MON_SY" "0"
 SYSTEM_CONSTANT "TBLOWBYHEATR_TYPAVL_SC" "0"
 SYSTEM_CONSTANT "TECU_TMSGFMT_SC" "1"
 SYSTEM_CONSTANT "TEGMOD_HEATFLOWKW_RES" "100000"
 SYSTEM_CONSTANT "TEGMOD_HEATFLOW_INTER_RES" "360"
 SYSTEM_CONSTANT "TEGMOD_HEATKJ_RES" "100"
 SYSTEM_CONSTANT "TEGMOD_INTER_RES" "1"
 SYSTEM_CONSTANT "TEGRCLR2DS_TYPAVL_SY" "0"
 SYSTEM_CONSTANT "TEGRCLRDS_TYPAVL_SY" "0"
 SYSTEM_CONSTANT "TEGRCLRLPDS_TYPAVL_SC" "0"
 SYSTEM_CONSTANT "TEGRCLRUS_TYPAVL_SY" "0"
 SYSTEM_CONSTANT "TEGRVLVHOTDS_TYPAVL_SC" "0"
 SYSTEM_CONSTANT "TEMPCELS_ZERO" "0"
 SYSTEM_CONSTANT "TEMP_20_CELS" "20"
 SYSTEM_CONSTANT "TEMP_CELS_1200" "1200"
 SYSTEM_CONSTANT "TEMP_CELS_150" "150"
 SYSTEM_CONSTANT "TEMP_CELS_1500" "1500"
 SYSTEM_CONSTANT "TEMP_CELS_MAX" "3003.56"
 SYSTEM_CONSTANT "TEMP_CELS_MIN" "-3549.94"
 SYSTEM_CONSTANT "TEMP_CELS_M_100" "-100"
 SYSTEM_CONSTANT "TEMP_CELS_M_200" "-200"
 SYSTEM_CONSTANT "TEMP_DEFECT" "1"
 SYSTEM_CONSTANT "TEMP_KELV_1000" "1000"
 SYSTEM_CONSTANT "TEMP_KELV_1200" "1200"
 SYSTEM_CONSTANT "TEMP_KELV_M_1000" "-1000"
 SYSTEM_CONSTANT "TEMP_KELV_M_200" "-200"
 SYSTEM_CONSTANT "THERMMOD_ACTVCOOLGAFTRUNLT" "11"
 SYSTEM_CONSTANT "THERMMOD_ACTVCOOLGLT" "7"
 SYSTEM_CONSTANT "THERMMOD_ACTVCOOLGMAXLT" "8"
 SYSTEM_CONSTANT "THERMMOD_ACTVHEATGLT" "4"
 SYSTEM_CONSTANT "THERMMOD_AFTRUNCMPL" "8"
 SYSTEM_CONSTANT "THERMMOD_AFTRUNCMPLLT" "12"
 SYSTEM_CONSTANT "THERMMOD_AIRFLOW" "2"
 SYSTEM_CONSTANT "THERMMOD_BATTCOLD" "4"
 SYSTEM_CONSTANT "THERMMOD_BATTHOT" "1"
 SYSTEM_CONSTANT "THERMMOD_BATTOK" "3"
 SYSTEM_CONSTANT "THERMMOD_BATTVERYCOLD" "5"
 SYSTEM_CONSTANT "THERMMOD_BATTVERYHOT" "0"
 SYSTEM_CONSTANT "THERMMOD_BATTWRM" "2"
 SYSTEM_CONSTANT "THERMMOD_COOLG" "0"
 SYSTEM_CONSTANT "THERMMOD_CTRLOFF" "3"
 SYSTEM_CONSTANT "THERMMOD_CTRLOFFLT" "3"
 SYSTEM_CONSTANT "THERMMOD_FLOWONLY" "4"
 SYSTEM_CONSTANT "THERMMOD_FLOWONLYAFTRUNLT" "9"
 SYSTEM_CONSTANT "THERMMOD_FLOWONLYLT" "5"
 SYSTEM_CONSTANT "THERMMOD_HEATG" "2"
 SYSTEM_CONSTANT "THERMMOD_INIAFTRUN" "2"
 SYSTEM_CONSTANT "THERMMOD_INIAFTRUNLT" "2"
 SYSTEM_CONSTANT "THERMMOD_INIRUN" "1"
 SYSTEM_CONSTANT "THERMMOD_INIRUNLT" "1"
 SYSTEM_CONSTANT "THERMMOD_INISTRT" "0"
 SYSTEM_CONSTANT "THERMMOD_INISTRTLT" "0"
 SYSTEM_CONSTANT "THERMMOD_INRNG" "1"
 SYSTEM_CONSTANT "THERMMOD_OFF" "0"
 SYSTEM_CONSTANT "THERMMOD_ON" "1"
 SYSTEM_CONSTANT "THERMMOD_OPMODAFTRUN" "5"
 SYSTEM_CONSTANT "THERMMOD_OPMODAFTRUNSHTOFF" "6"
 SYSTEM_CONSTANT "THERMMOD_OPMODCHRG" "2"
 SYSTEM_CONSTANT "THERMMOD_OPMODDRV" "3"
 SYSTEM_CONSTANT "THERMMOD_OPMODINIAFTRUN" "4"
 SYSTEM_CONSTANT "THERMMOD_OPMODINIRUN" "1"
 SYSTEM_CONSTANT "THERMMOD_OPMODSTRTDLY" "0"
 SYSTEM_CONSTANT "THERMMOD_PASCOOLG" "5"
 SYSTEM_CONSTANT "THERMMOD_PASCOOLGAFTRUN" "6"
 SYSTEM_CONSTANT "THERMMOD_PASCOOLGAFTRUNLT" "10"
 SYSTEM_CONSTANT "THERMMOD_PASCOOLGLT" "6"
 SYSTEM_CONSTANT "THERMMOD_PMP" "1"
 SYSTEM_CONSTANT "THERMMOD_PROTNCOOLGAFTRUN" "7"
 SYSTEM_CONSTANT "THRVLVI_TYPAVL_SC" "0"
 SYSTEM_CONSTANT "THRVLVUST_TYPAVL_SC" "0"
 SYSTEM_CONSTANT "THRVLV_OPENPOSNLRN_SC" "0"
 SYSTEM_CONSTANT "THS_LOTCIRCACTVCOOLG_SC" "0"
 SYSTEM_CONSTANT "THS_LOTCIRCACTVHEATG_SC" "0"
 SYSTEM_CONSTANT "THS_LOTCIRCPRSNT_SC" "0"
 SYSTEM_CONSTANT "TIMEDELAY_S_2_MIN" "0.001"
 SYSTEM_CONSTANT "TIMEDELAY_S_2_NRM" "8"
 SYSTEM_CONSTANT "TIME_5S_NRM_SY" "5"
 SYSTEM_CONSTANT "TIME_DEB_10MS" "10000"
 SYSTEM_CONSTANT "TIME_DT_1000MS" "1000000"
 SYSTEM_CONSTANT "TIME_DT_100MS" "100000"
 SYSTEM_CONSTANT "TIME_DT_10MS" "10000"
 SYSTEM_CONSTANT "TIME_DT_1S" "1000000"
 SYSTEM_CONSTANT "TIME_DT_200MS" "200000"
 SYSTEM_CONSTANT "TIME_MS_10MS_RES" "10"
 SYSTEM_CONSTANT "TIME_S_100US_RES" "0.0001"
 SYSTEM_CONSTANT "TIME_S_100US_RES_REV" "10000"
 SYSTEM_CONSTANT "TIME_S_12000" "12000"
 SYSTEM_CONSTANT "TIME_S_LORES_ONE" "1"
 SYSTEM_CONSTANT "Time_s_LORES_RES" "1"
 SYSTEM_CONSTANT "Time_s_LORES_RES_REV" "1"
 SYSTEM_CONSTANT "TIME_S_LORES_ZERO" "0"
 SYSTEM_CONSTANT "TIME_S_NSCRGN_MAX" "327.66"
 SYSTEM_CONSTANT "TIME_TICK_SEC_INV" "100"
 SYSTEM_CONSTANT "TINTKVUS_TYPAVL_SY" "0"
 SYSTEM_CONSTANT "TI_PII_EARL_REL" "13000"
 SYSTEM_CONSTANT "TI_POI2_LATE_REL" "-13000"
 SYSTEM_CONSTANT "TLE75602_SC" "2"
 SYSTEM_CONSTANT "TNRM" "0"
 SYSTEM_CONSTANT "TOXDCAT_TYPAVL_SC" "0"
 SYSTEM_CONSTANT "TOXICATDS_TYPAVL_SY" "0"
 SYSTEM_CONSTANT "TOXICATUS_TYPAVL_SY" "0"
 SYSTEM_CONSTANT "TPFLTDS_TYPAVL_SY" "0"
 SYSTEM_CONSTANT "TPFLTUS_TYPAVL_SY" "0"
 SYSTEM_CONSTANT "TPS65917_SC" "0"
 SYSTEM_CONSTANT "TRANSFORMER_BASD_SC" "0"
 SYSTEM_CONSTANT "TRA_AST" "2"
 SYSTEM_CONSTANT "TRA_AT" "1"
 SYSTEM_CONSTANT "TRA_CVT" "3"
 SYSTEM_CONSTANT "TRA_DCT" "4"
 SYSTEM_CONSTANT "TRA_MT" "0"
 SYSTEM_CONSTANT "TRBCHINSDT_TYPAVL_SC" "0"
 SYSTEM_CONSTANT "TRBHP2I_TYPAVL_SC" "0"
 SYSTEM_CONSTANT "TRBHPBYPI_TYPAVL_SC" "0"
 SYSTEM_CONSTANT "TRBHPI_TYPAVL_SC" "0"
 SYSTEM_CONSTANT "TRBLPI_TYPAVL_SC" "0"
 SYSTEM_CONSTANT "TRBNBYVLV1INSDT_TYPAVL_SC" "0"
 SYSTEM_CONSTANT "TRBNBYVLV2INSDT_TYPAVL_SC" "0"
 SYSTEM_CONSTANT "TRQSEL_SY" "1"
 SYSTEM_CONSTANT "TRQ_ZERO" "0"
 SYSTEM_CONSTANT "TTLMP_SC" "1"
 SYSTEM_CONSTANT "TTRBNUS_TYPAVL_SY" "0"
 SYSTEM_CONSTANT "TTRBUSASICT_TYPAVL_SC" "0"
 SYSTEM_CONSTANT "TWALLTC_MDLAVL_SC" "0"
 SYSTEM_CONSTANT "TWO_POW_NRM_EXP_RES_TRIGO_FUNC" "4096"
 SYSTEM_CONSTANT "TWTRCOOLRDS_TYPAVL_SC" "0"
 SYSTEM_CONSTANT "T_EXHGS_MAX" "1050"
 SYSTEM_CONSTANT "T_EXHGS_MIN" "-45"
 SYSTEM_CONSTANT "UART_SY" "0"
 SYSTEM_CONSTANT "UBFAILSRC_SY" "1"
 SYSTEM_CONSTANT "UCATDST2_TYPAVL_SC" "0"
 SYSTEM_CONSTANT "UCATDST_TYPAVL_SC" "0"
 SYSTEM_CONSTANT "UCATUST2_TYPAVL_SC" "0"
 SYSTEM_CONSTANT "UCATUST_TYPAVL_SC" "0"
 SYSTEM_CONSTANT "UCTP_TYPAVL_SC" "1"
 SYSTEM_CONSTANT "UDPNM_SC" "0"
 SYSTEM_CONSTANT "UPXP1_TYPAVL_SC" "1"
 SYSTEM_CONSTANT "VEHCOORN_CHRG" "5"
 SYSTEM_CONSTANT "VEHCOORN_DRV" "3"
 SYSTEM_CONSTANT "VEHCOORN_DRVGREQMETHOD_SC" "1"
 SYSTEM_CONSTANT "VEHCOORN_HVIDLESHTOFF_SC" "1"
 SYSTEM_CONSTANT "VEHCOORN_HVREADY" "2"
 SYSTEM_CONSTANT "VEHCOORN_RNGPREDROUTEPROFENA_SC" "0"
 SYSTEM_CONSTANT "VEHCOORN_SHTDWN" "6"
 SYSTEM_CONSTANT "VEHCOORN_STBY" "0"
 SYSTEM_CONSTANT "VEHCOORN_STRTUP" "1"
 SYSTEM_CONSTANT "VEHDEV_APPPIDENA_SC" "0"
 SYSTEM_CONSTANT "VEHDEV_DSQACTV_SC" "0"
 SYSTEM_CONSTANT "VEHDEV_HNDBRKENA_SC" "0"
 SYSTEM_CONSTANT "VEHDRVEV_DSBCOFFREQ" "0"
 SYSTEM_CONSTANT "VEHDRVEV_DSBCONREQ" "2"
 SYSTEM_CONSTANT "VEHTYPSELN_SC" "0"
 SYSTEM_CONSTANT "VEHTYP_SC" "2"
 SYSTEM_CONSTANT "VEHVPWMOUT_SC" "0"
 SYSTEM_CONSTANT "VEHV_CANSAFE_SC" "1"
 SYSTEM_CONSTANT "VEHV_CAN_SC" "1"
 SYSTEM_CONSTANT "VEHV_DUALCANSRCACTV_SC" "0"
 SYSTEM_CONSTANT "VEHV_DUALSIG_SC" "1"
 SYSTEM_CONSTANT "VEHV_PWMVLDYCHK_SC" "0"
 SYSTEM_CONSTANT "VEHV_PWM_SC" "0"
 SYSTEM_CONSTANT "VEHV_QLY_FROZEN" "8"
 SYSTEM_CONSTANT "VEHV_QLY_INVALID" "15"
 SYSTEM_CONSTANT "VEHV_QLY_MODEL" "4"
 SYSTEM_CONSTANT "VEHV_QLY_OK" "0"
 SYSTEM_CONSTANT "VEHV_SGLWHLDIAG_SY" "0"
 SYSTEM_CONSTANT "VEHV_SHAFTSPD_SC" "0"
 SYSTEM_CONSTANT "VEHV_SWTASRC_SC" "1"
 SYSTEM_CONSTANT "VEHV_SWTPLAUSFCO_SC" "0"
 SYSTEM_CONSTANT "VEHV_SWTPLAUSPWR_SC" "0"
 SYSTEM_CONSTANT "VEHV_SWTPLAUSREF_SC" "0"
 SYSTEM_CONSTANT "VEHV_SWTPLAUSV2N_SC" "0"
 SYSTEM_CONSTANT "VEL_KMH_0" "0"
 SYSTEM_CONSTANT "VEL_KMH_300" "300"
 SYSTEM_CONSTANT "VEL_KMH_M_300" "-300"
 SYSTEM_CONSTANT "VIRTETH_SC" "0"
 SYSTEM_CONSTANT "VLVLFTI_TYPAVL_SC" "0"
 SYSTEM_CONSTANT "VNQ6040_SC" "0"
 SYSTEM_CONSTANT "VOL_FILGLVL_RES" "1"
 SYSTEM_CONSTANT "VOL_FILGLVL_RES_REV" "1"
 SYSTEM_CONSTANT "VOL_NSC_RES" "0.0001"
 SYSTEM_CONSTANT "VOL_NSC_RES_FL" "0.0001"
 SYSTEM_CONSTANT "VOL_NSC_RES_REV" "10000"
 SYSTEM_CONSTANT "VOL_RES_REV" "100"
 SYSTEM_CONSTANT "VSWVLVI_TYPAVL_SC" "0"
 SYSTEM_CONSTANT "V_CAM_RES_REV" "256"
 SYSTEM_CONSTANT "WDGS_CFGADPR_SC" "1"
 SYSTEM_CONSTANT "WHRCOOLTPDIF_TYPAVL_SC" "0"
 SYSTEM_CONSTANT "WIPRIFTYP_SC" "0"
 SYSTEM_CONSTANT "WTRCACT_TYPAVL_SC" "0"
 SYSTEM_CONSTANT "WTRCOOLTP1_TYPAVL_SY" "0"
 SYSTEM_CONSTANT "WTRCOOLTP_TYPAVL_SY" "0"
 SYSTEM_CONSTANT "XCORECDD_SC" "0"
 SYSTEM_CONSTANT "XCPVERS_SC" "3"
 SYSTEM_CONSTANT "XCP_SY" "1"
 SYSTEM_CONSTANT "XDI_SC" "1"
 SYSTEM_CONSTANT "ZERO" "0" /end MOD_PAR
/begin MOD_COMMON "" BYTE_ORDER MSB_LAST ALIGNMENT_BYTE 1 ALIGNMENT_WORD 2 ALIGNMENT_LONG 4 ALIGNMENT_INT64 4 ALIGNMENT_FLOAT32_IEEE 4 ALIGNMENT_FLOAT64_IEEE 4 DATA_SIZE 32 /end MOD_COMMON
/begin IF_DATA ASAP1B_Bypass
 /begin TP_BLOB 0x102 /* Bypass version */ 0x102 /* Blob version */ /end TP_BLOB
/end IF_DATA
/begin IF_DATA ETK_XETK
 /begin ETK_XETK_LIST /* version */ ETK_XETK_AML_VERSION_2_3_0
  /begin ETK 1 INTERFACE_SPEED_100MBIT /* Interface */ CONFIG "CpuType" "TC37xED_A" CONFIG "EtkId" "162" CONFIG "EtkSubId" "0" CONFIG "HardwAdvId" "0" CONFIG "TriggerInterface" "reg" CONFIG "PullCalWakeup" "0" CONFIG "WatchdogDisable" "1" CONFIG "RegPollRate" "50" CONFIG "PowerFailDetection" "SBRAM" CONFIG "Startup" "reg" CONFIG "StartupTimeout" "-1" CONFIG "DebArb" "1" CONFIG "WatchdogPolarity" "1" CONFIG "DapClockSpeed" "100" CONFIG "DapBlock" "1" CONFIG "Dap2Pin" "0" DISPLAY_NAME "ETK-S20/21" /end ETK
  /begin XETK 2 /* ETK_XETK_ID BR-XETK-S3 */ CONFIG "CpuType" "TC37xED_A" CONFIG "BaseId" "21" CONFIG "Extension" "2" CONFIG "DapClockSpeed" "100" CONFIG "DapBlock" "1" CONFIG "Dap2Pin" "0" CONFIG "EcuWatchdogPolarity" "1" CONFIG "HandshakeTimeout" "-1" CONFIG "EcuTrigRegPollRate" "50" CONFIG "PowerFailDetection" "SBRAM" CONFIG "TriggerInterface" "reg" CONFIG "EcuWatchdogControlDisabled" "0" CONFIG "EcuWatchdogEnabled" "1" DISPLAY_NAME "BR-XETK-S3" /end XETK
  /begin XETK 3 CONFIG "CpuType" "TC37xED_A" CONFIG "BaseId" "11" CONFIG "Extension" "2" CONFIG "DapClockSpeed" "100" CONFIG "DapBlock" "1" CONFIG "Dap2Pin" "0" CONFIG "EcuWatchdogPolarity" "1" CONFIG "HandshakeTimeout" "-1" CONFIG "EcuTrigRegPollRate" "50" CONFIG "PowerFailDetection" "SBRAM" CONFIG "TriggerInterface" "reg" CONFIG "EcuWatchdogControlDisabled" "0" CONFIG "EcuWatchdogEnabled" "1" DISPLAY_NAME "XETK-S20/21" /end XETK
  /begin XETK 4 CONFIG "CpuType" "TC37xED_A" CONFIG "BaseId" "14" CONFIG "Extension" "2" CONFIG "DapClockSpeed" "100" CONFIG "DapBlock" "1" CONFIG "Dap2Pin" "0" CONFIG "EcuWatchdogPolarity" "1" CONFIG "HandshakeTimeout" "-1" CONFIG "EcuTrigRegPollRate" "50" CONFIG "PowerFailDetection" "SBRAM" CONFIG "TriggerInterface" "reg" CONFIG "EcuWatchdogControlDisabled" "0" CONFIG "EcuWatchdogEnabled" "1" DISPLAY_NAME "XETK-S30/31" /end XETK
  /begin XETK 5 CONFIG "CpuType" "TC37xED_A" CONFIG "BaseId" "16" CONFIG "Extension" "2" CONFIG "DapClockSpeed" "100" CONFIG "DapBlock" "1" CONFIG "Dap2Pin" "0" CONFIG "EcuWatchdogPolarity" "1" CONFIG "HandshakeTimeout" "-1" CONFIG "EcuTrigRegPollRate" "50" CONFIG "PowerFailDetection" "SBRAM" CONFIG "TriggerInterface" "reg" CONFIG "EcuWatchdogControlDisabled" "0" CONFIG "EcuWatchdogEnabled" "1" DISPLAY_NAME "BR-XETK-S1/2" /end XETK
  /begin FETK 7 CONFIG "CpuType" "TC37xED_A" CONFIG "BaseId" "6" CONFIG "Extension" "0" CONFIG "DapClockSpeed" "100" CONFIG "Dap2Pin" "0" CONFIG "WatchdogControlDisabled" "0" CONFIG "WatchdogDisable" "0" CONFIG "WatchdogPolarity" "1" CONFIG "StartupTimeout" "-1" DISPLAY_NAME "FETK-T1/2 (Serial debug interface based data acquisition)" /end FETK
  /begin FETK 8 CONFIG "CpuType" "TC37xED_A" CONFIG "BaseId" "7" CONFIG "Extension" "0" CONFIG "DapClockSpeed" "100" CONFIG "Dap2Pin" "0" CONFIG "WatchdogControlDisabled" "0" CONFIG "WatchdogDisable" "0" CONFIG "WatchdogPolarity" "1" CONFIG "StartupTimeout" "-1" DISPLAY_NAME "FETK-S1/2 " /end FETK
  /begin RASTER_CHECK OFFLINE_DEVICE 1 /* device with id 1 is the default device for offline raster check */ ONLINE_RESPECT_OFFLINE_LIMIT /end RASTER_CHECK
 /end ETK_XETK_LIST
 /begin TP_BLOB /* ByteOrder */ BYTE_ORDER_MSB_LAST /begin DISTAB_CFG /* Distab Type */ 17 /end DISTAB_CFG
  /begin ECU_EVENT_LIST 0xB92F5560 /* start address of ECU event list */ ETK_XETK_REF 1 2 3 4 5 7 8 /end ECU_EVENT_LIST
  TABLE_ALIGNMENT ALIGNMENT_4_BYTE
  /begin EVENT_CONFIG_OUTPUT_AREA 0xB92FB5E8 /* start of event config area */ 12324 /* size in bytes of event config area */ 0xB92FE60C /* start of event output area */ 6144 /* size in bytes of event output area */ ETK_XETK_REF 1 2 3 4 5 7 8 /end EVENT_CONFIG_OUTPUT_AREA
  /begin DATA_ACQUISITION PRIORITY_RANGE 1 4 ETK_XETK_REF 1 2 3 4 5 7 8 /end DATA_ACQUISITION
  /begin ECU_PROPERTY OVERALL_PERFORMANCE 303030 1212120 CORE_PERFORMANCE 3 303030 1212120 CORE_PERFORMANCE 1 454545 1818180 CORE_PERFORMANCE 2 454545 1818180 ETK_XETK_REF 1 2 3 4 5 7 8 /end ECU_PROPERTY
  /begin TRIGGER_CFG TRIGGER 29 DIRECT ECU_ID 29 TRIGGER 30 DIRECT ECU_ID 30 TRIGGER 31 DIRECT ECU_ID 31 TRIGGER 32 DIRECT ECU_ID 32 ETK_XETK_REF 1 2 3 4 5 /end TRIGGER_CFG
  /begin TRIGGER_CFG TRIGGER 93 DIRECT ECU_ID 93 TRIGGER 94 DIRECT ECU_ID 94 TRIGGER 95 DIRECT ECU_ID 95 TRIGGER 96 DIRECT ECU_ID 96 ETK_XETK_REF 7 8 /end TRIGGER_CFG
  /begin CODE_CHK /* Address ECU DATA section */ 0x80240118 /* Address ECU RAM section */ 0xB92FFFC0 /* Length ECU DATA sections */ 8 PATTERN_REFRESH_TIMEOUT 0x200 ERROR_BEHAVIOR PERMANENT_RESET ETK_XETK_REF 1 2 3 4 5 7 8 /end CODE_CHK
  /begin COLDSTART_HANDSHAKE /* Address of ETKS coldstart pattern */ 0xB92FFFD8 WAIT /* Dyn. length for wait pattern */ 0xE5 0xAD 0xEC 0x4D READY /* Dyn. length for ready pattern */ 0xDE 0xC0 0xED 0xFE ETK_XETK_REF 1 2 3 4 5 7 8 /end COLDSTART_HANDSHAKE
  /begin PAGE_SWITCH_METHOD 2 /* version */ MAILBOX 3 /* MBX_Version */ /* Version of mailbox */ 200 /* MBX_PageSetupTime */ /* max time the ECU needs to set up page in ms */ 0xB92FFFF0 /* MBX_StartAddress */ /* Start address of table */ AUTOSTART_BEHAVIOR LAST_ACTIVE_PAGE /* Table to be filled by INCA with info */ /* for the current active page */ OMD 0xB92FFE10 /* OMD_ADDRESS */ 2 /* OMD_CID */ 0 /* OMD_VERSION */ 0x1A8 /* OMD_MAX_LEN */ 23 /* OMD_NUMBER_OF_EMU_HANDLES */ CODE_CHK_PATTERN_WP 0xB92FFFC8 /* Start address of WP CodeCheck Pattern */ ETK_XETK_REF 1 2 3 4 5 7 8 /end PAGE_SWITCH_METHOD
  /begin ECU_DEFINED_ERRORCODES ERROR_ENTRY 0x00000001 "OMD error" ERROR_ENTRY 0x45525201 "ECU will be reset - STOP engine!" ERROR_ENTRY 0x45525202 "ECU does not support Programming at T15 OFF" ERROR_ENTRY 0x45525203 "Mail Box Version is invalid" ERROR_ENTRY 0x45525204 "Call Back Function is not configured" /end ECU_DEFINED_ERRORCODES
  /begin CAL_WAKEUP /* 1 = wake up enabled, 0=disabled */ CAL_WAKEUP_PIN 1 CAL_TOOL_PRESENT /* address for the pattern */ 0xB92FFFB8 /* CAL_TOOL_PRESENT_PATTERN */ 0x12345678 /* ECU timeout for shutdown in s */ 2 ETK_XETK_REF 1 2 3 4 5 7 8 /end CAL_WAKEUP
  /begin DATA_FREEZE CONFIG "SAFETY_MAILBOX_ADDRESS" "0xB92FFFE4" CONFIG "SAFETY_MAILBOX_VERSION" "0x4D310100" CONFIG "SAFETY_MAILBOX_WAITMSG" "Datafreeze is pending" CONFIG "SAFETY_MAILBOX_WAITTOUT" "2000" CONFIG "STARTUP_MAILBOX_ADDRESS" "0x7003BE00" CONFIG "STARTUP_MAILBOX_VERSION" "0x4D320100" CONFIG "VALIDATE_PATTERN" "0x80240000 0x100" CONFIG "INVALIDATE_PATTERN" "0x80240120 0x00044408000004009011000208408C0090508808031010614000280812047640" ETK_XETK_REF 1 2 3 4 5 7 8 /end DATA_FREEZE
 /end TP_BLOB
 /begin SOURCE "10ms time synchronous" 4 1
  /begin QP_BLOB 3 2 9000
   /begin ETK_XETK_SPECIFIC TRG_NBR 0 /begin ECU_PROPERTY PERFORMANCE 1 0 0 /end ECU_PROPERTY ETK_XETK_REF 1 2 3 4 5 7 8 /end ETK_XETK_SPECIFIC
  /end QP_BLOB
 /end SOURCE
 /begin SOURCE "100ms time synchronous" 5 1
  /begin QP_BLOB 4 1 90000
   /begin ETK_XETK_SPECIFIC TRG_NBR 0 /begin ECU_PROPERTY PERFORMANCE 1 0 0 /end ECU_PROPERTY ETK_XETK_REF 1 2 3 4 5 7 8 /end ETK_XETK_SPECIFIC
  /end QP_BLOB
 /end SOURCE
 /begin SOURCE "1ms time synchronous" 3 1
  /begin QP_BLOB 1 4 900
   /begin ETK_XETK_SPECIFIC TRG_NBR 0 /begin ECU_PROPERTY PERFORMANCE 1 0 0 /end ECU_PROPERTY ETK_XETK_REF 1 2 3 4 5 7 8 /end ETK_XETK_SPECIFIC
  /end QP_BLOB
 /end SOURCE
 /begin SOURCE "5ms time synchronous" 3 5
  /begin QP_BLOB 2 3 4500
   /begin ETK_XETK_SPECIFIC TRG_NBR 0 /begin ECU_PROPERTY PERFORMANCE 1 0 0 /end ECU_PROPERTY ETK_XETK_REF 1 2 3 4 5 7 8 /end ETK_XETK_SPECIFIC
  /end QP_BLOB
 /end SOURCE
/end IF_DATA
/begin IF_DATA SERVICE_BASED_BYPASS
 /begin SERVICES SERVICE_AML_VERSION_3_1_1 4 /* BaseOffsetValue */ 14 /* NumSrvPts */ "rba_SvbbEtk_SrvPtResId_KWB" /* SERVICE_POINTS_RESOURCE_ID */ "rba_SvbbEtk_SrvPtEnabled_KWB" /* SrvPtEnabled */ "rba_SvbbEtk_TimeOutPre_KWB" /* TimeOutMaxPre*/ "rba_SvbbEtk_TimeOutPost_KWB" /* TimeOutMaxPost*/ DOUBLE_BUFFERING_USED "rba_SvbbEtk_DisableProcExec_KWB" /* DisableFctExec*/ /begin IMPLEMENTED_SBB_VERSIONS SBB_V2_1 SBB_V3_1 /end IMPLEMENTED_SBB_VERSIONS /begin SERVICE_POINT 2 "rba_SvbbEtk_T10msByp" PRIORITY 2 HOOKED /end SERVICE_POINT /begin SERVICE_POINT 1 "rba_Svbb_DummyActivate" PRIORITY 1 /end SERVICE_POINT
  /begin SERVICE_POINT 3 "Rte_task_RteCont_T_100ms_rba_Etks_100ms_Proc" PRIORITY 3 /end SERVICE_POINT
  /begin SERVICE_POINT 4 "Rte_task_RteCont_T_100ms_rba_Etks_100ms_Proc_CalWup" PRIORITY 4 /end SERVICE_POINT
  /begin SERVICE_POINT 5 "Rte_task_RteCont_T_10ms_rba_Etks_CalWupCheck_Proc" PRIORITY 5 /end SERVICE_POINT
  /begin SERVICE_POINT 6 "Rte_task_RteCont_T_10ms_rba_Etks_DataFreezeCalWup_Proc" PRIORITY 6 /end SERVICE_POINT
  /begin SERVICE_POINT 7 "Rte_task_RteCont_T_10ms_rba_Etks_DataFreeze_Proc" PRIORITY 7 /end SERVICE_POINT
  /begin SERVICE_POINT 8 "Rte_task_RteCont_T_10ms_rba_Etks_PageSwitch_Proc" PRIORITY 8 /end SERVICE_POINT
  /begin SERVICE_POINT 9 "Rte_task_RteCont_T_10ms_rba_Etks_PageSwitch_Proc_CalWup" PRIORITY 9 /end SERVICE_POINT
  SBB_DYNAMIC_STRUCTURE 2 /* SBBDynStructVer */ 0xB92F5610 /* ResWorkArea: resource working area address,
where resource blocks and address tables and default value tables are
allocated. Located e.g. in ETK DATA region for parallel ETK types and ETK
RAM regions for serial ETK types */ 0x30D8 /* ResWorkArea: length of the resource working
area in bytes */ 0xB92F8704 /* EcuWrtblResWorkArea: where RAM resource blocks
and data tables are allocated. Located e.g. in ETK RAM for parallel ETKs
and ECU RAM for serial ETKs */ 12000 /* EcuWrtblResWorkAreaLength: length of the ECU
writable resource working area in bytes */
  /begin TRIGGER_SEPARATED_FROM_CHANNEL
   /begin TRIGGER_CFG TRIGGER 1 DIRECT TRIGGER 2 DIRECT TRIGGER 3 DIRECT TRIGGER 4 DIRECT TRIGGER 5 DIRECT TRIGGER 6 DIRECT TRIGGER 7 DIRECT TRIGGER 8 DIRECT TRIGGER 9 DIRECT TRIGGER 10 DIRECT TRIGGER 11 DIRECT TRIGGER 12 DIRECT TRIGGER 13 DIRECT TRIGGER 14 DIRECT TRIGGER 15 DIRECT TRIGGER 16 DIRECT TRIGGER 17 DIRECT TRIGGER 18 DIRECT TRIGGER 19 DIRECT TRIGGER 20 DIRECT TRIGGER 21 DIRECT TRIGGER 22 DIRECT TRIGGER 23 DIRECT TRIGGER 24 DIRECT TRIGGER 25 DIRECT TRIGGER 26 DIRECT TRIGGER 27 DIRECT TRIGGER 28 DIRECT ETK_XETK_REF 1 2 3 4 5 /end TRIGGER_CFG
   /begin TRIGGER_CFG TRIGGER 1 DIRECT TRIGGER 2 DIRECT TRIGGER 3 DIRECT TRIGGER 4 DIRECT TRIGGER 5 DIRECT TRIGGER 6 DIRECT TRIGGER 7 DIRECT TRIGGER 8 DIRECT TRIGGER 9 DIRECT TRIGGER 10 DIRECT TRIGGER 11 DIRECT TRIGGER 12 DIRECT TRIGGER 13 DIRECT TRIGGER 14 DIRECT TRIGGER 15 DIRECT TRIGGER 16 DIRECT TRIGGER 17 DIRECT TRIGGER 18 DIRECT TRIGGER 19 DIRECT TRIGGER 20 DIRECT TRIGGER 21 DIRECT TRIGGER 22 DIRECT TRIGGER 23 DIRECT TRIGGER 24 DIRECT TRIGGER 25 DIRECT TRIGGER 26 DIRECT TRIGGER 27 DIRECT TRIGGER 28 DIRECT TRIGGER 29 DIRECT TRIGGER 30 DIRECT TRIGGER 31 DIRECT TRIGGER 32 DIRECT TRIGGER 33 DIRECT TRIGGER 34 DIRECT TRIGGER 35 DIRECT TRIGGER 36 DIRECT TRIGGER 37 DIRECT TRIGGER 38 DIRECT TRIGGER 39 DIRECT TRIGGER 40 DIRECT TRIGGER 41 DIRECT TRIGGER 42 DIRECT TRIGGER 43 DIRECT TRIGGER 44 DIRECT TRIGGER 45 DIRECT TRIGGER 46 DIRECT TRIGGER 47 DIRECT TRIGGER 48 DIRECT TRIGGER 49 DIRECT TRIGGER 50 DIRECT TRIGGER 51 DIRECT TRIGGER 52 DIRECT TRIGGER 53 DIRECT TRIGGER 54 DIRECT TRIGGER 55 DIRECT TRIGGER 56 DIRECT TRIGGER 57 DIRECT TRIGGER 58 DIRECT TRIGGER 59 DIRECT TRIGGER 60 DIRECT TRIGGER 61 DIRECT TRIGGER 62 DIRECT TRIGGER 63 DIRECT TRIGGER 64 DIRECT TRIGGER 65 DIRECT TRIGGER 66 DIRECT TRIGGER 67 DIRECT TRIGGER 68 DIRECT TRIGGER 69 DIRECT TRIGGER 70 DIRECT TRIGGER 71 DIRECT TRIGGER 72 DIRECT TRIGGER 73 DIRECT TRIGGER 74 DIRECT TRIGGER 75 DIRECT TRIGGER 76 DIRECT TRIGGER 77 DIRECT TRIGGER 78 DIRECT TRIGGER 79 DIRECT TRIGGER 80 DIRECT TRIGGER 81 DIRECT TRIGGER 82 DIRECT TRIGGER 83 DIRECT TRIGGER 84 DIRECT TRIGGER 85 DIRECT TRIGGER 86 DIRECT TRIGGER 87 DIRECT TRIGGER 88 DIRECT TRIGGER 89 DIRECT TRIGGER 90 DIRECT TRIGGER 91 DIRECT TRIGGER 92 DIRECT ETK_XETK_REF 6 7 8 /end TRIGGER_CFG
   /begin DATA_ACQUISITION PRIORITY_RANGE 5 32 ETK_XETK_REF 1 2 3 4 5 /end DATA_ACQUISITION
   /begin DATA_ACQUISITION PRIORITY_RANGE 5 64 ETK_XETK_REF 6 7 8 /end DATA_ACQUISITION
  /end TRIGGER_SEPARATED_FROM_CHANNEL
 /end SERVICES
/end IF_DATA
/*Service_Based_Bypass*/
/begin IF_DATA XCPplus 0x0102
 /begin PAG /* MAX_SEGMENTS */ 22 /end PAG
 /begin PROTOCOL_LAYER 0x0102 1000 1000 0 0 0 0 0 8 8 BYTE_ORDER_MSB_LAST ADDRESS_GRANULARITY_BYTE OPTIONAL_CMD GET_COMM_MODE_INFO OPTIONAL_CMD GET_ID OPTIONAL_CMD SET_MTA OPTIONAL_CMD UPLOAD OPTIONAL_CMD SHORT_UPLOAD OPTIONAL_CMD BUILD_CHECKSUM OPTIONAL_CMD DOWNLOAD OPTIONAL_CMD DOWNLOAD_NEXT OPTIONAL_CMD DOWNLOAD_MAX OPTIONAL_CMD SET_CAL_PAGE OPTIONAL_CMD GET_CAL_PAGE OPTIONAL_CMD COPY_CAL_PAGE OPTIONAL_CMD CLEAR_DAQ_LIST OPTIONAL_CMD SET_DAQ_PTR OPTIONAL_CMD WRITE_DAQ OPTIONAL_CMD SET_DAQ_LIST_MODE OPTIONAL_CMD START_STOP_DAQ_LIST OPTIONAL_CMD START_STOP_SYNCH OPTIONAL_CMD FREE_DAQ OPTIONAL_CMD ALLOC_DAQ OPTIONAL_CMD ALLOC_ODT OPTIONAL_CMD ALLOC_ODT_ENTRY COMMUNICATION_MODE_SUPPORTED BLOCK SLAVE MASTER 255 0 /end PROTOCOL_LAYER
 /begin DAQ DYNAMIC 65535 4 0 OPTIMISATION_TYPE_DEFAULT ADDRESS_EXTENSION_FREE IDENTIFICATION_FIELD_TYPE_ABSOLUTE GRANULARITY_ODT_ENTRY_SIZE_DAQ_BYTE 255 OVERLOAD_INDICATION_EVENT PRESCALER_SUPPORTED /begin STIM GRANULARITY_ODT_ENTRY_SIZE_STIM_BYTE 255 /end STIM /begin DAQ_MEMORY_CONSUMPTION 5495 60 6 5 2 3 /end DAQ_MEMORY_CONSUMPTION /begin EVENT "10ms time synchronous" "10_ms" 0 DAQ 1 10 6 7 /end EVENT /begin EVENT "100ms time synchronous" "100_ms" 1 DAQ 1 100 6 5 /end EVENT /begin EVENT "1ms time synchronous" "1_ms" 2 DAQ 1 1 6 6 /end EVENT /begin EVENT "5ms time synchronous" "5_ms" 3 DAQ 1 5 6 4 /end EVENT /end DAQ
 /begin XCP_ON_CAN /************************ start of CAN *********************/ 0x0102 /* XCP on CAN version */ CAN_ID_MASTER 0x708 /* CMD/STIM CAN-ID */ /* master -> slave */ CAN_ID_SLAVE 0x709 /* RES/ERR/EV/SERV/DAQ CAN-ID */ /* slave -> master */ /* Bit31= 1: extended identifier */ BAUDRATE 1000000 /* BAUDRATE [Hz] */ SAMPLE_POINT 75 /* sample point */ /* [% complete bit time] */ BTL_CYCLES 20 /* BTL_CYCLES */ /* [slots per bit time] */ SJW 3 /* length synchr. segment */ /* [BTL_CYCLES] */ MAX_BUS_LOAD 100 /* maximum available bus */ /************************* end of CAN **********************/
  /begin PROTOCOL_LAYER 0x0102 1000 1000 0 0 0 0 0 8 8 BYTE_ORDER_MSB_LAST ADDRESS_GRANULARITY_BYTE OPTIONAL_CMD GET_COMM_MODE_INFO OPTIONAL_CMD GET_ID OPTIONAL_CMD SET_MTA OPTIONAL_CMD UPLOAD OPTIONAL_CMD SHORT_UPLOAD OPTIONAL_CMD BUILD_CHECKSUM OPTIONAL_CMD DOWNLOAD OPTIONAL_CMD DOWNLOAD_NEXT OPTIONAL_CMD DOWNLOAD_MAX OPTIONAL_CMD SET_CAL_PAGE OPTIONAL_CMD GET_CAL_PAGE OPTIONAL_CMD COPY_CAL_PAGE OPTIONAL_CMD CLEAR_DAQ_LIST OPTIONAL_CMD SET_DAQ_PTR OPTIONAL_CMD WRITE_DAQ OPTIONAL_CMD SET_DAQ_LIST_MODE OPTIONAL_CMD START_STOP_DAQ_LIST OPTIONAL_CMD START_STOP_SYNCH OPTIONAL_CMD FREE_DAQ OPTIONAL_CMD ALLOC_DAQ OPTIONAL_CMD ALLOC_ODT OPTIONAL_CMD ALLOC_ODT_ENTRY COMMUNICATION_MODE_SUPPORTED BLOCK SLAVE MASTER 255 0 /end PROTOCOL_LAYER
  /begin DAQ DYNAMIC 65535 4 0 OPTIMISATION_TYPE_DEFAULT ADDRESS_EXTENSION_FREE IDENTIFICATION_FIELD_TYPE_ABSOLUTE GRANULARITY_ODT_ENTRY_SIZE_DAQ_BYTE 255 OVERLOAD_INDICATION_EVENT PRESCALER_SUPPORTED /begin STIM GRANULARITY_ODT_ENTRY_SIZE_STIM_BYTE 255 /end STIM /begin DAQ_MEMORY_CONSUMPTION 5495 60 6 5 2 3 /end DAQ_MEMORY_CONSUMPTION /begin EVENT "10ms time synchronous" "10_ms" 0 DAQ 1 10 6 7 /end EVENT /begin EVENT "100ms time synchronous" "100_ms" 1 DAQ 1 100 6 5 /end EVENT /begin EVENT "1ms time synchronous" "1_ms" 2 DAQ 1 1 6 6 /end EVENT /begin EVENT "5ms time synchronous" "5_ms" 3 DAQ 1 5 6 4 /end EVENT /end DAQ
  TRANSPORT_LAYER_INSTANCE "Calibration and measurement on XCP CAN" /end XCP_ON_CAN
 /begin XCP_ON_CAN /************************ start of CAN *********************/ 0x0102 /* XCP on CAN version */ CAN_ID_MASTER 0x708 /* CMD/STIM CAN-ID */ /* master -> slave */ CAN_ID_SLAVE 0x709 /* RES/ERR/EV/SERV/DAQ CAN-ID */ /* slave -> master */ /* Bit31= 1: extended identifier */ BAUDRATE 500000 /* BAUDRATE [Hz] */ SAMPLE_POINT 75 /* sample point */ /* [% complete bit time] */ BTL_CYCLES 8 /* BTL_CYCLES */ /* [slots per bit time] */ SJW 2 /* length synchr. segment */ /* [BTL_CYCLES] */ MAX_BUS_LOAD 50 /* maximum available bus */ /************************* end of CAN **********************/
  /begin PROTOCOL_LAYER 0x0102 1000 1000 0 0 0 0 0 8 8 BYTE_ORDER_MSB_LAST ADDRESS_GRANULARITY_BYTE OPTIONAL_CMD GET_COMM_MODE_INFO OPTIONAL_CMD GET_ID OPTIONAL_CMD SET_MTA OPTIONAL_CMD UPLOAD OPTIONAL_CMD SHORT_UPLOAD OPTIONAL_CMD BUILD_CHECKSUM OPTIONAL_CMD DOWNLOAD OPTIONAL_CMD DOWNLOAD_NEXT OPTIONAL_CMD DOWNLOAD_MAX OPTIONAL_CMD SET_CAL_PAGE OPTIONAL_CMD GET_CAL_PAGE OPTIONAL_CMD COPY_CAL_PAGE OPTIONAL_CMD CLEAR_DAQ_LIST OPTIONAL_CMD SET_DAQ_PTR OPTIONAL_CMD WRITE_DAQ OPTIONAL_CMD SET_DAQ_LIST_MODE OPTIONAL_CMD START_STOP_DAQ_LIST OPTIONAL_CMD START_STOP_SYNCH OPTIONAL_CMD FREE_DAQ OPTIONAL_CMD ALLOC_DAQ OPTIONAL_CMD ALLOC_ODT OPTIONAL_CMD ALLOC_ODT_ENTRY COMMUNICATION_MODE_SUPPORTED BLOCK SLAVE MASTER 255 0 /end PROTOCOL_LAYER
  /begin DAQ DYNAMIC 65535 4 0 OPTIMISATION_TYPE_DEFAULT ADDRESS_EXTENSION_FREE IDENTIFICATION_FIELD_TYPE_ABSOLUTE GRANULARITY_ODT_ENTRY_SIZE_DAQ_BYTE 255 OVERLOAD_INDICATION_EVENT PRESCALER_SUPPORTED /begin STIM GRANULARITY_ODT_ENTRY_SIZE_STIM_BYTE 255 /end STIM /begin DAQ_MEMORY_CONSUMPTION 5495 60 6 5 2 3 /end DAQ_MEMORY_CONSUMPTION /begin EVENT "10ms time synchronous" "10_ms" 0 DAQ 1 10 6 7 /end EVENT /begin EVENT "100ms time synchronous" "100_ms" 1 DAQ 1 100 6 5 /end EVENT /begin EVENT "1ms time synchronous" "1_ms" 2 DAQ 1 1 6 6 /end EVENT /begin EVENT "5ms time synchronous" "5_ms" 3 DAQ 1 5 6 4 /end EVENT /end DAQ
  TRANSPORT_LAYER_INSTANCE "Calibration and measurement on HSN1 CAN" /end XCP_ON_CAN
/end IF_DATA
/*********** Start of merged CHARACTERISTIC blocks ***********/
/begin CHARACTERISTIC Com_stCDE_RESEAU_LIN_VCU_TxPduCtrl_C "Calibration parameter to control Ipdu CDE_RESEAU_LIN_VCU_Tx" VALUE 0x8024034A DefaultValueRecordLayout_AUTOSAR_Platform_BaseTypes_boolean 1.0 AUTOSAR_Com_CompuMethods_Com_IPduStatus_enum_type 0.0 1. FORMAT "%5.0" /end CHARACTERISTIC
/begin CHARACTERISTIC Com_stCLUSTER_5E7_RxPduCtrl_C "Calibration parameter to control Ipdu CLUSTER_5E7_Rx" VALUE 0x80240349 DefaultValueRecordLayout_AUTOSAR_Platform_BaseTypes_boolean 1.0 AUTOSAR_Com_CompuMethods_Com_IPduStatus_enum_type 0.0 1. FORMAT "%5.0" /end CHARACTERISTIC
/begin CHARACTERISTIC Com_stCONTEXTE_1_5B2_RxPduCtrl_C "Calibration parameter to control Ipdu CONTEXTE_1_5B2_Rx" VALUE 0x80240348 DefaultValueRecordLayout_AUTOSAR_Platform_BaseTypes_boolean 1.0 AUTOSAR_Com_CompuMethods_Com_IPduStatus_enum_type 0.0 1. FORMAT "%5.0" /end CHARACTERISTIC
/begin CHARACTERISTIC Com_stDAT3_BSI_4F2h_RxPduCtrl_C "Calibration parameter to control Ipdu DAT3_BSI_4F2h_Rx" VALUE 0x80240347 DefaultValueRecordLayout_AUTOSAR_Platform_BaseTypes_boolean 1.0 AUTOSAR_Com_CompuMethods_Com_IPduStatus_enum_type 0.0 1. FORMAT "%5.0" /end CHARACTERISTIC
/begin CHARACTERISTIC Com_stDAT_TBMU_454_TxPduCtrl_C "Calibration parameter to control Ipdu DAT_TBMU_454_Tx" VALUE 0x80240346 DefaultValueRecordLayout_AUTOSAR_Platform_BaseTypes_boolean 1.0 AUTOSAR_Com_CompuMethods_Com_IPduStatus_enum_type 0.0 1. FORMAT "%5.0" /end CHARACTERISTIC
/begin CHARACTERISTIC Com_stDCDC_283h_RxPduCtrl_C "Calibration parameter to control Ipdu DCDC_283h_Rx" VALUE 0x80240345 DefaultValueRecordLayout_AUTOSAR_Platform_BaseTypes_boolean 1.0 AUTOSAR_Com_CompuMethods_Com_IPduStatus_enum_type 0.0 1. FORMAT "%5.0" /end CHARACTERISTIC
/begin CHARACTERISTIC Com_stDCDC_293h_RxPduCtrl_C "Calibration parameter to control Ipdu DCDC_293h_Rx" VALUE 0x80240344 DefaultValueRecordLayout_AUTOSAR_Platform_BaseTypes_boolean 1.0 AUTOSAR_Com_CompuMethods_Com_IPduStatus_enum_type 0.0 1. FORMAT "%5.0" /end CHARACTERISTIC
/begin CHARACTERISTIC Com_stDCDC_473h_RxPduCtrl_C "Calibration parameter to control Ipdu DCDC_473h_Rx" VALUE 0x80240343 DefaultValueRecordLayout_AUTOSAR_Platform_BaseTypes_boolean 1.0 AUTOSAR_Com_CompuMethods_Com_IPduStatus_enum_type 0.0 1. FORMAT "%5.0" /end CHARACTERISTIC
/begin CHARACTERISTIC Com_stDCDC_663h_RxPduCtrl_C "Calibration parameter to control Ipdu DCDC_663h_Rx" VALUE 0x80240342 DefaultValueRecordLayout_AUTOSAR_Platform_BaseTypes_boolean 1.0 AUTOSAR_Com_CompuMethods_Com_IPduStatus_enum_type 0.0 1. FORMAT "%5.0" /end CHARACTERISTIC
/begin CHARACTERISTIC Com_stE_VCU_522_TxPduCtrl_C "Calibration parameter to control Ipdu E_VCU_522_Tx" VALUE 0x80240341 DefaultValueRecordLayout_AUTOSAR_Platform_BaseTypes_boolean 1.0 AUTOSAR_Com_CompuMethods_Com_IPduStatus_enum_type 0.0 1. FORMAT "%5.0" /end CHARACTERISTIC
/begin CHARACTERISTIC Com_stHS3_AUTO_GEARBOX_SWITCH_REQ_TxPduCtrl_C "Calibration parameter to control Ipdu HS3_AUTO_GEARBOX_SWITCH_REQ_Tx" VALUE 0x80240340 DefaultValueRecordLayout_AUTOSAR_Platform_BaseTypes_boolean 1.0 AUTOSAR_Com_CompuMethods_Com_IPduStatus_enum_type 0.0 1. FORMAT "%5.0" /end CHARACTERISTIC
/begin CHARACTERISTIC Com_stHS3_AUTO_GEARBOX_SWITCH_STATUS_RxPduCtrl_C "Calibration parameter to control Ipdu HS3_AUTO_GEARBOX_SWITCH_STATUS_Rx" VALUE 0x8024033F DefaultValueRecordLayout_AUTOSAR_Platform_BaseTypes_boolean 1.0 AUTOSAR_Com_CompuMethods_Com_IPduStatus_enum_type 0.0 1. FORMAT "%5.0" /end CHARACTERISTIC
/begin CHARACTERISTIC Com_stHSN1_GW_RX_04D_RxPduCtrl_C "Calibration parameter to control Ipdu HSN1_GW_RX_04D_Rx" VALUE 0x8024033E DefaultValueRecordLayout_AUTOSAR_Platform_BaseTypes_boolean 1.0 AUTOSAR_Com_CompuMethods_Com_IPduStatus_enum_type 0.0 1. FORMAT "%5.0" /end CHARACTERISTIC
/begin CHARACTERISTIC Com_stHSN1_GW_RX_06D_RxPduCtrl_C "Calibration parameter to control Ipdu HSN1_GW_RX_06D_Rx" VALUE 0x8024033D DefaultValueRecordLayout_AUTOSAR_Platform_BaseTypes_boolean 1.0 AUTOSAR_Com_CompuMethods_Com_IPduStatus_enum_type 0.0 1. FORMAT "%5.0" /end CHARACTERISTIC
/begin CHARACTERISTIC Com_stHSN1_GW_RX_0AE_RxPduCtrl_C "Calibration parameter to control Ipdu HSN1_GW_RX_0AE_Rx" VALUE 0x8024033C DefaultValueRecordLayout_AUTOSAR_Platform_BaseTypes_boolean 1.0 AUTOSAR_Com_CompuMethods_Com_IPduStatus_enum_type 0.0 1. FORMAT "%5.0" /end CHARACTERISTIC
/begin CHARACTERISTIC Com_stHSN1_GW_RX_492_RxPduCtrl_C "Calibration parameter to control Ipdu HSN1_GW_RX_492_Rx" VALUE 0x8024033B DefaultValueRecordLayout_AUTOSAR_Platform_BaseTypes_boolean 1.0 AUTOSAR_Com_CompuMethods_Com_IPduStatus_enum_type 0.0 1. FORMAT "%5.0" /end CHARACTERISTIC
/begin CHARACTERISTIC Com_stHSN1_GW_RX_4B2_RxPduCtrl_C "Calibration parameter to control Ipdu HSN1_GW_RX_4B2_Rx" VALUE 0x8024033A DefaultValueRecordLayout_AUTOSAR_Platform_BaseTypes_boolean 1.0 AUTOSAR_Com_CompuMethods_Com_IPduStatus_enum_type 0.0 1. FORMAT "%5.0" /end CHARACTERISTIC
/begin CHARACTERISTIC Com_stHSN1_GW_RX_4C8_RxPduCtrl_C "Calibration parameter to control Ipdu HSN1_GW_RX_4C8_Rx" VALUE 0x80240339 DefaultValueRecordLayout_AUTOSAR_Platform_BaseTypes_boolean 1.0 AUTOSAR_Com_CompuMethods_Com_IPduStatus_enum_type 0.0 1. FORMAT "%5.0" /end CHARACTERISTIC
/begin CHARACTERISTIC Com_stHSN1_GW_RX_4D2_RxPduCtrl_C "Calibration parameter to control Ipdu HSN1_GW_RX_4D2_Rx" VALUE 0x80240338 DefaultValueRecordLayout_AUTOSAR_Platform_BaseTypes_boolean 1.0 AUTOSAR_Com_CompuMethods_Com_IPduStatus_enum_type 0.0 1. FORMAT "%5.0" /end CHARACTERISTIC
/begin CHARACTERISTIC Com_stHSN3_GW_RX_0A6_RxPduCtrl_C "Calibration parameter to control Ipdu HSN3_GW_RX_0A6_Rx" VALUE 0x80240337 DefaultValueRecordLayout_AUTOSAR_Platform_BaseTypes_boolean 1.0 AUTOSAR_Com_CompuMethods_Com_IPduStatus_enum_type 0.0 1. FORMAT "%5.0" /end CHARACTERISTIC
/begin CHARACTERISTIC Com_stHSN3_GW_RX_0C6_RxPduCtrl_C "Calibration parameter to control Ipdu HSN3_GW_RX_0C6_Rx" VALUE 0x80240336 DefaultValueRecordLayout_AUTOSAR_Platform_BaseTypes_boolean 1.0 AUTOSAR_Com_CompuMethods_Com_IPduStatus_enum_type 0.0 1. FORMAT "%5.0" /end CHARACTERISTIC
/begin CHARACTERISTIC Com_stHSN3_GW_RX_0E6_RxPduCtrl_C "Calibration parameter to control Ipdu HSN3_GW_RX_0E6_Rx" VALUE 0x80240335 DefaultValueRecordLayout_AUTOSAR_Platform_BaseTypes_boolean 1.0 AUTOSAR_Com_CompuMethods_Com_IPduStatus_enum_type 0.0 1. FORMAT "%5.0" /end CHARACTERISTIC
/begin CHARACTERISTIC Com_stHSN3_GW_RX_334_RxPduCtrl_C "Calibration parameter to control Ipdu HSN3_GW_RX_334_Rx" VALUE 0x80240334 DefaultValueRecordLayout_AUTOSAR_Platform_BaseTypes_boolean 1.0 AUTOSAR_Com_CompuMethods_Com_IPduStatus_enum_type 0.0 1. FORMAT "%5.0" /end CHARACTERISTIC
/begin CHARACTERISTIC Com_stHSN3_GW_RX_3F4_RxPduCtrl_C "Calibration parameter to control Ipdu HSN3_GW_RX_3F4_Rx" VALUE 0x80240333 DefaultValueRecordLayout_AUTOSAR_Platform_BaseTypes_boolean 1.0 AUTOSAR_Com_CompuMethods_Com_IPduStatus_enum_type 0.0 1. FORMAT "%5.0" /end CHARACTERISTIC
/begin CHARACTERISTIC Com_stHSN3_GW_RX_423_RxPduCtrl_C "Calibration parameter to control Ipdu HSN3_GW_RX_423_Rx" VALUE 0x80240332 DefaultValueRecordLayout_AUTOSAR_Platform_BaseTypes_boolean 1.0 AUTOSAR_Com_CompuMethods_Com_IPduStatus_enum_type 0.0 1. FORMAT "%5.0" /end CHARACTERISTIC
/begin CHARACTERISTIC Com_stHSN3_GW_RX_434_RxPduCtrl_C "Calibration parameter to control Ipdu HSN3_GW_RX_434_Rx" VALUE 0x80240331 DefaultValueRecordLayout_AUTOSAR_Platform_BaseTypes_boolean 1.0 AUTOSAR_Com_CompuMethods_Com_IPduStatus_enum_type 0.0 1. FORMAT "%5.0" /end CHARACTERISTIC
/begin CHARACTERISTIC Com_stHSN3_GW_RX_494_RxPduCtrl_C "Calibration parameter to control Ipdu HSN3_GW_RX_494_Rx" VALUE 0x80240330 DefaultValueRecordLayout_AUTOSAR_Platform_BaseTypes_boolean 1.0 AUTOSAR_Com_CompuMethods_Com_IPduStatus_enum_type 0.0 1. FORMAT "%5.0" /end CHARACTERISTIC
/begin CHARACTERISTIC Com_stHSN3_GW_RX_5B1_RxPduCtrl_C "Calibration parameter to control Ipdu HSN3_GW_RX_5B1_Rx" VALUE 0x8024032F DefaultValueRecordLayout_AUTOSAR_Platform_BaseTypes_boolean 1.0 AUTOSAR_Com_CompuMethods_Com_IPduStatus_enum_type 0.0 1. FORMAT "%5.0" /end CHARACTERISTIC
/begin CHARACTERISTIC Com_stHSN3_GW_RX_615_RxPduCtrl_C "Calibration parameter to control Ipdu HSN3_GW_RX_615_Rx" VALUE 0x8024032E DefaultValueRecordLayout_AUTOSAR_Platform_BaseTypes_boolean 1.0 AUTOSAR_Com_CompuMethods_Com_IPduStatus_enum_type 0.0 1. FORMAT "%5.0" /end CHARACTERISTIC
/begin CHARACTERISTIC Com_stHSN3_GW_RX_625_RxPduCtrl_C "Calibration parameter to control Ipdu HSN3_GW_RX_625_Rx" VALUE 0x8024032D DefaultValueRecordLayout_AUTOSAR_Platform_BaseTypes_boolean 1.0 AUTOSAR_Com_CompuMethods_Com_IPduStatus_enum_type 0.0 1. FORMAT "%5.0" /end CHARACTERISTIC
/begin CHARACTERISTIC Com_stHSN3_GW_RX_66B_RxPduCtrl_C "Calibration parameter to control Ipdu HSN3_GW_RX_66B_Rx" VALUE 0x8024032C DefaultValueRecordLayout_AUTOSAR_Platform_BaseTypes_boolean 1.0 AUTOSAR_Com_CompuMethods_Com_IPduStatus_enum_type 0.0 1. FORMAT "%5.0" /end CHARACTERISTIC
/begin CHARACTERISTIC Com_stHSN3_GW_RX_766_RxPduCtrl_C "Calibration parameter to control Ipdu HSN3_GW_RX_766_Rx" VALUE 0x8024032B DefaultValueRecordLayout_AUTOSAR_Platform_BaseTypes_boolean 1.0 AUTOSAR_Com_CompuMethods_Com_IPduStatus_enum_type 0.0 1. FORMAT "%5.0" /end CHARACTERISTIC
/begin CHARACTERISTIC Com_stHSN3_GW_RX_774_RxPduCtrl_C "Calibration parameter to control Ipdu HSN3_GW_RX_774_Rx" VALUE 0x8024032A DefaultValueRecordLayout_AUTOSAR_Platform_BaseTypes_boolean 1.0 AUTOSAR_Com_CompuMethods_Com_IPduStatus_enum_type 0.0 1. FORMAT "%5.0" /end CHARACTERISTIC
/begin CHARACTERISTIC Com_stHVAC_PANEL_26h_RxPduCtrl_C "Calibration parameter to control Ipdu HVAC_PANEL_26h_Rx" VALUE 0x80240329 DefaultValueRecordLayout_AUTOSAR_Platform_BaseTypes_boolean 1.0 AUTOSAR_Com_CompuMethods_Com_IPduStatus_enum_type 0.0 1. FORMAT "%5.0" /end CHARACTERISTIC
/begin CHARACTERISTIC Com_stHVBAT_205h_RxPduCtrl_C "Calibration parameter to control Ipdu HVBAT_205h_Rx" VALUE 0x80240328 DefaultValueRecordLayout_AUTOSAR_Platform_BaseTypes_boolean 1.0 AUTOSAR_Com_CompuMethods_Com_IPduStatus_enum_type 0.0 1. FORMAT "%5.0" /end CHARACTERISTIC
/begin CHARACTERISTIC Com_stHVBAT_275h_RxPduCtrl_C "Calibration parameter to control Ipdu HVBAT_275h_Rx" VALUE 0x80240327 DefaultValueRecordLayout_AUTOSAR_Platform_BaseTypes_boolean 1.0 AUTOSAR_Com_CompuMethods_Com_IPduStatus_enum_type 0.0 1. FORMAT "%5.0" /end CHARACTERISTIC
/begin CHARACTERISTIC Com_stHVBAT_285h_RxPduCtrl_C "Calibration parameter to control Ipdu HVBAT_285h_Rx" VALUE 0x80240326 DefaultValueRecordLayout_AUTOSAR_Platform_BaseTypes_boolean 1.0 AUTOSAR_Com_CompuMethods_Com_IPduStatus_enum_type 0.0 1. FORMAT "%5.0" /end CHARACTERISTIC
/begin CHARACTERISTIC Com_stHVBAT_325h_RxPduCtrl_C "Calibration parameter to control Ipdu HVBAT_325h_Rx" VALUE 0x80240325 DefaultValueRecordLayout_AUTOSAR_Platform_BaseTypes_boolean 1.0 AUTOSAR_Com_CompuMethods_Com_IPduStatus_enum_type 0.0 1. FORMAT "%5.0" /end CHARACTERISTIC
/begin CHARACTERISTIC Com_stHVBAT_335h_RxPduCtrl_C "Calibration parameter to control Ipdu HVBAT_335h_Rx" VALUE 0x80240324 DefaultValueRecordLayout_AUTOSAR_Platform_BaseTypes_boolean 1.0 AUTOSAR_Com_CompuMethods_Com_IPduStatus_enum_type 0.0 1. FORMAT "%5.0" /end CHARACTERISTIC
/begin CHARACTERISTIC Com_stHVBAT_455h_RxPduCtrl_C "Calibration parameter to control Ipdu HVBAT_455h_Rx" VALUE 0x80240323 DefaultValueRecordLayout_AUTOSAR_Platform_BaseTypes_boolean 1.0 AUTOSAR_Com_CompuMethods_Com_IPduStatus_enum_type 0.0 1. FORMAT "%5.0" /end CHARACTERISTIC
/begin CHARACTERISTIC Com_stHVBAT_535_RxPduCtrl_C "Calibration parameter to control Ipdu HVBAT_535_Rx" VALUE 0x80240322 DefaultValueRecordLayout_AUTOSAR_Platform_BaseTypes_boolean 1.0 AUTOSAR_Com_CompuMethods_Com_IPduStatus_enum_type 0.0 1. FORMAT "%5.0" /end CHARACTERISTIC
/begin CHARACTERISTIC Com_stHVBAT_595h_RxPduCtrl_C "Calibration parameter to control Ipdu HVBAT_595h_Rx" VALUE 0x80240321 DefaultValueRecordLayout_AUTOSAR_Platform_BaseTypes_boolean 1.0 AUTOSAR_Com_CompuMethods_Com_IPduStatus_enum_type 0.0 1. FORMAT "%5.0" /end CHARACTERISTIC
/begin CHARACTERISTIC Com_stHVBAT_635h_RxPduCtrl_C "Calibration parameter to control Ipdu HVBAT_635h_Rx" VALUE 0x80240320 DefaultValueRecordLayout_AUTOSAR_Platform_BaseTypes_boolean 1.0 AUTOSAR_Com_CompuMethods_Com_IPduStatus_enum_type 0.0 1. FORMAT "%5.0" /end CHARACTERISTIC
/begin CHARACTERISTIC Com_stHVBAT_645h_RxPduCtrl_C "Calibration parameter to control Ipdu HVBAT_645h_Rx" VALUE 0x8024031F DefaultValueRecordLayout_AUTOSAR_Platform_BaseTypes_boolean 1.0 AUTOSAR_Com_CompuMethods_Com_IPduStatus_enum_type 0.0 1. FORMAT "%5.0" /end CHARACTERISTIC
/begin CHARACTERISTIC Com_stHVBAT_665h_RxPduCtrl_C "Calibration parameter to control Ipdu HVBAT_665h_Rx" VALUE 0x8024031E DefaultValueRecordLayout_AUTOSAR_Platform_BaseTypes_boolean 1.0 AUTOSAR_Com_CompuMethods_Com_IPduStatus_enum_type 0.0 1. FORMAT "%5.0" /end CHARACTERISTIC
/begin CHARACTERISTIC Com_stHVBAT_675h_RxPduCtrl_C "Calibration parameter to control Ipdu HVBAT_675h_Rx" VALUE 0x8024031D DefaultValueRecordLayout_AUTOSAR_Platform_BaseTypes_boolean 1.0 AUTOSAR_Com_CompuMethods_Com_IPduStatus_enum_type 0.0 1. FORMAT "%5.0" /end CHARACTERISTIC
/begin CHARACTERISTIC Com_stHVBAT_THERMAL_5B5_RxPduCtrl_C "Calibration parameter to control Ipdu HVBAT_THERMAL_5B5_Rx" VALUE 0x8024031C DefaultValueRecordLayout_AUTOSAR_Platform_BaseTypes_boolean 1.0 AUTOSAR_Com_CompuMethods_Com_IPduStatus_enum_type 0.0 1. FORMAT "%5.0" /end CHARACTERISTIC
/begin CHARACTERISTIC Com_stHVBAT_VCU_435h_RxPduCtrl_C "Calibration parameter to control Ipdu HVBAT_VCU_435h_Rx" VALUE 0x8024031B DefaultValueRecordLayout_AUTOSAR_Platform_BaseTypes_boolean 1.0 AUTOSAR_Com_CompuMethods_Com_IPduStatus_enum_type 0.0 1. FORMAT "%5.0" /end CHARACTERISTIC
/begin CHARACTERISTIC Com_stHVBAT_VCU_543_RxPduCtrl_C "Calibration parameter to control Ipdu HVBAT_VCU_543_Rx" VALUE 0x8024031A DefaultValueRecordLayout_AUTOSAR_Platform_BaseTypes_boolean 1.0 AUTOSAR_Com_CompuMethods_Com_IPduStatus_enum_type 0.0 1. FORMAT "%5.0" /end CHARACTERISTIC
/begin CHARACTERISTIC Com_stHVBAT_VCU_583_RxPduCtrl_C "Calibration parameter to control Ipdu HVBAT_VCU_583_Rx" VALUE 0x80240319 DefaultValueRecordLayout_AUTOSAR_Platform_BaseTypes_boolean 1.0 AUTOSAR_Com_CompuMethods_Com_IPduStatus_enum_type 0.0 1. FORMAT "%5.0" /end CHARACTERISTIC
/begin CHARACTERISTIC Com_stINV_217h_RxPduCtrl_C "Calibration parameter to control Ipdu INV_217h_Rx" VALUE 0x80240318 DefaultValueRecordLayout_AUTOSAR_Platform_BaseTypes_boolean 1.0 AUTOSAR_Com_CompuMethods_Com_IPduStatus_enum_type 0.0 1. FORMAT "%5.0" /end CHARACTERISTIC
/begin CHARACTERISTIC Com_stINV_227h_RxPduCtrl_C "Calibration parameter to control Ipdu INV_227h_Rx" VALUE 0x80240317 DefaultValueRecordLayout_AUTOSAR_Platform_BaseTypes_boolean 1.0 AUTOSAR_Com_CompuMethods_Com_IPduStatus_enum_type 0.0 1. FORMAT "%5.0" /end CHARACTERISTIC
/begin CHARACTERISTIC Com_stINV_237_RxPduCtrl_C "Calibration parameter to control Ipdu INV_237_Rx" VALUE 0x80240316 DefaultValueRecordLayout_AUTOSAR_Platform_BaseTypes_boolean 1.0 AUTOSAR_Com_CompuMethods_Com_IPduStatus_enum_type 0.0 1. FORMAT "%5.0" /end CHARACTERISTIC
/begin CHARACTERISTIC Com_stINV_427h_RxPduCtrl_C "Calibration parameter to control Ipdu INV_427h_Rx" VALUE 0x80240315 DefaultValueRecordLayout_AUTOSAR_Platform_BaseTypes_boolean 1.0 AUTOSAR_Com_CompuMethods_Com_IPduStatus_enum_type 0.0 1. FORMAT "%5.0" /end CHARACTERISTIC
/begin CHARACTERISTIC Com_stINV_497h_RxPduCtrl_C "Calibration parameter to control Ipdu INV_497h_Rx" VALUE 0x80240314 DefaultValueRecordLayout_AUTOSAR_Platform_BaseTypes_boolean 1.0 AUTOSAR_Com_CompuMethods_Com_IPduStatus_enum_type 0.0 1. FORMAT "%5.0" /end CHARACTERISTIC
/begin CHARACTERISTIC Com_stINV_IMMO_5C7_RxPduCtrl_C "Calibration parameter to control Ipdu INV_IMMO_5C7_Rx" VALUE 0x80240313 DefaultValueRecordLayout_AUTOSAR_Platform_BaseTypes_boolean 1.0 AUTOSAR_Com_CompuMethods_Com_IPduStatus_enum_type 0.0 1. FORMAT "%5.0" /end CHARACTERISTIC
/begin CHARACTERISTIC Com_stIS_DAT6_BSI_592h_MUX0_RxPduCtrl_C "Calibration parameter to control Ipdu IS_DAT6_BSI_592h_MUX0_Rx" VALUE 0x80240312 DefaultValueRecordLayout_AUTOSAR_Platform_BaseTypes_boolean 1.0 AUTOSAR_Com_CompuMethods_Com_IPduStatus_enum_type 0.0 1. FORMAT "%5.0" /end CHARACTERISTIC
/begin CHARACTERISTIC Com_stIS_DAT6_BSI_592h_MUX1_RxPduCtrl_C "Calibration parameter to control Ipdu IS_DAT6_BSI_592h_MUX1_Rx" VALUE 0x80240311 DefaultValueRecordLayout_AUTOSAR_Platform_BaseTypes_boolean 1.0 AUTOSAR_Com_CompuMethods_Com_IPduStatus_enum_type 0.0 1. FORMAT "%5.0" /end CHARACTERISTIC
/begin CHARACTERISTIC Com_stIS_DAT6_BSI_592h_MUX2_RxPduCtrl_C "Calibration parameter to control Ipdu IS_DAT6_BSI_592h_MUX2_Rx" VALUE 0x80240310 DefaultValueRecordLayout_AUTOSAR_Platform_BaseTypes_boolean 1.0 AUTOSAR_Com_CompuMethods_Com_IPduStatus_enum_type 0.0 1. FORMAT "%5.0" /end CHARACTERISTIC
/begin CHARACTERISTIC Com_stIS_DAT6_BSI_592h_RxPduCtrl_C "Calibration parameter to control Ipdu IS_DAT6_BSI_592h_Rx" VALUE 0x8024030F DefaultValueRecordLayout_AUTOSAR_Platform_BaseTypes_boolean 1.0 AUTOSAR_Com_CompuMethods_Com_IPduStatus_enum_type 0.0 1. FORMAT "%5.0" /end CHARACTERISTIC
/begin CHARACTERISTIC Com_stIS_DAT_ABR_50Dh_RxPduCtrl_C "Calibration parameter to control Ipdu IS_DAT_ABR_50Dh_Rx" VALUE 0x8024030E DefaultValueRecordLayout_AUTOSAR_Platform_BaseTypes_boolean 1.0 AUTOSAR_Com_CompuMethods_Com_IPduStatus_enum_type 0.0 1. FORMAT "%5.0" /end CHARACTERISTIC
/begin CHARACTERISTIC Com_stIS_DAT_BSI_412h_RxPduCtrl_C "Calibration parameter to control Ipdu IS_DAT_BSI_412h_Rx" VALUE 0x8024030D DefaultValueRecordLayout_AUTOSAR_Platform_BaseTypes_boolean 1.0 AUTOSAR_Com_CompuMethods_Com_IPduStatus_enum_type 0.0 1. FORMAT "%5.0" /end CHARACTERISTIC
/begin CHARACTERISTIC Com_stIS_DYN3_CMM_468h_TxPduCtrl_C "Calibration parameter to control Ipdu IS_DYN3_CMM_468h_Tx" VALUE 0x8024030C DefaultValueRecordLayout_AUTOSAR_Platform_BaseTypes_boolean 1.0 AUTOSAR_Com_CompuMethods_Com_IPduStatus_enum_type 0.0 1. FORMAT "%5.0" /end CHARACTERISTIC
/begin CHARACTERISTIC Com_stIS_DYN_ABR_38Dh_RxPduCtrl_C "Calibration parameter to control Ipdu IS_DYN_ABR_38Dh_Rx" VALUE 0x8024030B DefaultValueRecordLayout_AUTOSAR_Platform_BaseTypes_boolean 1.0 AUTOSAR_Com_CompuMethods_Com_IPduStatus_enum_type 0.0 1. FORMAT "%5.0" /end CHARACTERISTIC
/begin CHARACTERISTIC Com_stIS_DYN_VCU_208h_TxPduCtrl_C "Calibration parameter to control Ipdu IS_DYN_VCU_208h_Tx" VALUE 0x8024030A DefaultValueRecordLayout_AUTOSAR_Platform_BaseTypes_boolean 1.0 AUTOSAR_Com_CompuMethods_Com_IPduStatus_enum_type 0.0 1. FORMAT "%5.0" /end CHARACTERISTIC
/begin CHARACTERISTIC Com_stIS_INTE_ELECTRON_BSI_092h_RxPduCtrl_C "Calibration parameter to control Ipdu IS_INTE_ELECTRON_BSI_092h_Rx" VALUE 0x80240309 DefaultValueRecordLayout_AUTOSAR_Platform_BaseTypes_boolean 1.0 AUTOSAR_Com_CompuMethods_Com_IPduStatus_enum_type 0.0 1. FORMAT "%5.0" /end CHARACTERISTIC
/begin CHARACTERISTIC Com_stOBC_273h_RxPduCtrl_C "Calibration parameter to control Ipdu OBC_273h_Rx" VALUE 0x80240308 DefaultValueRecordLayout_AUTOSAR_Platform_BaseTypes_boolean 1.0 AUTOSAR_Com_CompuMethods_Com_IPduStatus_enum_type 0.0 1. FORMAT "%5.0" /end CHARACTERISTIC
/begin CHARACTERISTIC Com_stOBC_453h_RxPduCtrl_C "Calibration parameter to control Ipdu OBC_453h_Rx" VALUE 0x80240307 DefaultValueRecordLayout_AUTOSAR_Platform_BaseTypes_boolean 1.0 AUTOSAR_Com_CompuMethods_Com_IPduStatus_enum_type 0.0 1. FORMAT "%5.0" /end CHARACTERISTIC
/begin CHARACTERISTIC Com_stOBC_463h_RxPduCtrl_C "Calibration parameter to control Ipdu OBC_463h_Rx" VALUE 0x80240306 DefaultValueRecordLayout_AUTOSAR_Platform_BaseTypes_boolean 1.0 AUTOSAR_Com_CompuMethods_Com_IPduStatus_enum_type 0.0 1. FORMAT "%5.0" /end CHARACTERISTIC
/begin CHARACTERISTIC Com_stPDU_BusVoltages_308_RxPduCtrl_C "Calibration parameter to control Ipdu PDU_BusVoltages_308_Rx" VALUE 0x80240305 DefaultValueRecordLayout_AUTOSAR_Platform_BaseTypes_boolean 1.0 AUTOSAR_Com_CompuMethods_Com_IPduStatus_enum_type 0.0 1. FORMAT "%5.0" /end CHARACTERISTIC
/begin CHARACTERISTIC Com_stPDU_Current_318_RxPduCtrl_C "Calibration parameter to control Ipdu PDU_Current_318_Rx" VALUE 0x80240304 DefaultValueRecordLayout_AUTOSAR_Platform_BaseTypes_boolean 1.0 AUTOSAR_Com_CompuMethods_Com_IPduStatus_enum_type 0.0 1. FORMAT "%5.0" /end CHARACTERISTIC
/begin CHARACTERISTIC Com_stRMS1_VCU_5C1_TxPduCtrl_C "Calibration parameter to control Ipdu RMS1_VCU_5C1_Tx" VALUE 0x80240303 DefaultValueRecordLayout_AUTOSAR_Platform_BaseTypes_boolean 1.0 AUTOSAR_Com_CompuMethods_Com_IPduStatus_enum_type 0.0 1. FORMAT "%5.0" /end CHARACTERISTIC
/begin CHARACTERISTIC Com_stRMS2_VCU_5C3_TxPduCtrl_C "Calibration parameter to control Ipdu RMS2_VCU_5C3_Tx" VALUE 0x80240302 DefaultValueRecordLayout_AUTOSAR_Platform_BaseTypes_boolean 1.0 AUTOSAR_Com_CompuMethods_Com_IPduStatus_enum_type 0.0 1. FORMAT "%5.0" /end CHARACTERISTIC
/begin CHARACTERISTIC Com_stRMS3_TBMU_5A3_TxPduCtrl_C "Calibration parameter to control Ipdu RMS3_TBMU_5A3_Tx" VALUE 0x80240301 DefaultValueRecordLayout_AUTOSAR_Platform_BaseTypes_boolean 1.0 AUTOSAR_Com_CompuMethods_Com_IPduStatus_enum_type 0.0 1. FORMAT "%5.0" /end CHARACTERISTIC
/begin CHARACTERISTIC Com_stRMS5_VCU_563_TxPduCtrl_C "Calibration parameter to control Ipdu RMS5_VCU_563_Tx" VALUE 0x80240300 DefaultValueRecordLayout_AUTOSAR_Platform_BaseTypes_boolean 1.0 AUTOSAR_Com_CompuMethods_Com_IPduStatus_enum_type 0.0 1. FORMAT "%5.0" /end CHARACTERISTIC
/begin CHARACTERISTIC Com_stSC_INFO_BCCM_442h_RxPduCtrl_C "Calibration parameter to control Ipdu SC_INFO_BCCM_442h_Rx" VALUE 0x802402FF DefaultValueRecordLayout_AUTOSAR_Platform_BaseTypes_boolean 1.0 AUTOSAR_Com_CompuMethods_Com_IPduStatus_enum_type 0.0 1. FORMAT "%5.0" /end CHARACTERISTIC
/begin CHARACTERISTIC Com_stVCU_0x50F_TxPduCtrl_C "Calibration parameter to control Ipdu VCU_0x50F_Tx" VALUE 0x802402FE DefaultValueRecordLayout_AUTOSAR_Platform_BaseTypes_boolean 1.0 AUTOSAR_Com_CompuMethods_Com_IPduStatus_enum_type 0.0 1. FORMAT "%5.0" /end CHARACTERISTIC
/begin CHARACTERISTIC Com_stVCU_211h_TxPduCtrl_C "Calibration parameter to control Ipdu VCU_211h_Tx" VALUE 0x802402FD DefaultValueRecordLayout_AUTOSAR_Platform_BaseTypes_boolean 1.0 AUTOSAR_Com_CompuMethods_Com_IPduStatus_enum_type 0.0 1. FORMAT "%5.0" /end CHARACTERISTIC
/begin CHARACTERISTIC Com_stVCU_221h_TxPduCtrl_C "Calibration parameter to control Ipdu VCU_221h_Tx" VALUE 0x802402FC DefaultValueRecordLayout_AUTOSAR_Platform_BaseTypes_boolean 1.0 AUTOSAR_Com_CompuMethods_Com_IPduStatus_enum_type 0.0 1. FORMAT "%5.0" /end CHARACTERISTIC
/begin CHARACTERISTIC Com_stVCU_241h_TxPduCtrl_C "Calibration parameter to control Ipdu VCU_241h_Tx" VALUE 0x802402FB DefaultValueRecordLayout_AUTOSAR_Platform_BaseTypes_boolean 1.0 AUTOSAR_Com_CompuMethods_Com_IPduStatus_enum_type 0.0 1. FORMAT "%5.0" /end CHARACTERISTIC
/begin CHARACTERISTIC Com_stVCU_25h_TxPduCtrl_C "Calibration parameter to control Ipdu VCU_25h_Tx" VALUE 0x802402FA DefaultValueRecordLayout_AUTOSAR_Platform_BaseTypes_boolean 1.0 AUTOSAR_Com_CompuMethods_Com_IPduStatus_enum_type 0.0 1. FORMAT "%5.0" /end CHARACTERISTIC
/begin CHARACTERISTIC Com_stVCU_262_TxPduCtrl_C "Calibration parameter to control Ipdu VCU_262_Tx" VALUE 0x802402F9 DefaultValueRecordLayout_AUTOSAR_Platform_BaseTypes_boolean 1.0 AUTOSAR_Com_CompuMethods_Com_IPduStatus_enum_type 0.0 1. FORMAT "%5.0" /end CHARACTERISTIC
/begin CHARACTERISTIC Com_stVCU_281h_TxPduCtrl_C "Calibration parameter to control Ipdu VCU_281h_Tx" VALUE 0x802402F8 DefaultValueRecordLayout_AUTOSAR_Platform_BaseTypes_boolean 1.0 AUTOSAR_Com_CompuMethods_Com_IPduStatus_enum_type 0.0 1. FORMAT "%5.0" /end CHARACTERISTIC
/begin CHARACTERISTIC Com_stVCU_321h_TxPduCtrl_C "Calibration parameter to control Ipdu VCU_321h_Tx" VALUE 0x802402F7 DefaultValueRecordLayout_AUTOSAR_Platform_BaseTypes_boolean 1.0 AUTOSAR_Com_CompuMethods_Com_IPduStatus_enum_type 0.0 1. FORMAT "%5.0" /end CHARACTERISTIC
/begin CHARACTERISTIC Com_stVCU_331h_TxPduCtrl_C "Calibration parameter to control Ipdu VCU_331h_Tx" VALUE 0x802402F6 DefaultValueRecordLayout_AUTOSAR_Platform_BaseTypes_boolean 1.0 AUTOSAR_Com_CompuMethods_Com_IPduStatus_enum_type 0.0 1. FORMAT "%5.0" /end CHARACTERISTIC
/begin CHARACTERISTIC Com_stVCU_421h_TxPduCtrl_C "Calibration parameter to control Ipdu VCU_421h_Tx" VALUE 0x802402F5 DefaultValueRecordLayout_AUTOSAR_Platform_BaseTypes_boolean 1.0 AUTOSAR_Com_CompuMethods_Com_IPduStatus_enum_type 0.0 1. FORMAT "%5.0" /end CHARACTERISTIC
/begin CHARACTERISTIC Com_stVCU_481h_TxPduCtrl_C "Calibration parameter to control Ipdu VCU_481h_Tx" VALUE 0x802402F4 DefaultValueRecordLayout_AUTOSAR_Platform_BaseTypes_boolean 1.0 AUTOSAR_Com_CompuMethods_Com_IPduStatus_enum_type 0.0 1. FORMAT "%5.0" /end CHARACTERISTIC
/begin CHARACTERISTIC Com_stVCU_4A2_TxPduCtrl_C "Calibration parameter to control Ipdu VCU_4A2_Tx" VALUE 0x802402F3 DefaultValueRecordLayout_AUTOSAR_Platform_BaseTypes_boolean 1.0 AUTOSAR_Com_CompuMethods_Com_IPduStatus_enum_type 0.0 1. FORMAT "%5.0" /end CHARACTERISTIC
/begin CHARACTERISTIC Com_stVCU_501h_TxPduCtrl_C "Calibration parameter to control Ipdu VCU_501h_Tx" VALUE 0x802402F2 DefaultValueRecordLayout_AUTOSAR_Platform_BaseTypes_boolean 1.0 AUTOSAR_Com_CompuMethods_Com_IPduStatus_enum_type 0.0 1. FORMAT "%5.0" /end CHARACTERISTIC
/begin CHARACTERISTIC Com_stVCU_5A2_TxPduCtrl_C "Calibration parameter to control Ipdu VCU_5A2_Tx" VALUE 0x802402F1 DefaultValueRecordLayout_AUTOSAR_Platform_BaseTypes_boolean 1.0 AUTOSAR_Com_CompuMethods_Com_IPduStatus_enum_type 0.0 1. FORMAT "%5.0" /end CHARACTERISTIC
/begin CHARACTERISTIC Com_stVCU_5D1h_TxPduCtrl_C "Calibration parameter to control Ipdu VCU_5D1h_Tx" VALUE 0x802402F0 DefaultValueRecordLayout_AUTOSAR_Platform_BaseTypes_boolean 1.0 AUTOSAR_Com_CompuMethods_Com_IPduStatus_enum_type 0.0 1. FORMAT "%5.0" /end CHARACTERISTIC
/begin CHARACTERISTIC Com_stVCU_5F1h_TxPduCtrl_C "Calibration parameter to control Ipdu VCU_5F1h_Tx" VALUE 0x802402EF DefaultValueRecordLayout_AUTOSAR_Platform_BaseTypes_boolean 1.0 AUTOSAR_Com_CompuMethods_Com_IPduStatus_enum_type 0.0 1. FORMAT "%5.0" /end CHARACTERISTIC
/begin CHARACTERISTIC Com_stVCU_AIRBAG_351h_RxPduCtrl_C "Calibration parameter to control Ipdu VCU_AIRBAG_351h_Rx" VALUE 0x802402EE DefaultValueRecordLayout_AUTOSAR_Platform_BaseTypes_boolean 1.0 AUTOSAR_Com_CompuMethods_Com_IPduStatus_enum_type 0.0 1. FORMAT "%5.0" /end CHARACTERISTIC
/begin CHARACTERISTIC Com_stVCU_CTRL_INPUT_201h_TxPduCtrl_C "Calibration parameter to control Ipdu VCU_CTRL_INPUT_201h_Tx" VALUE 0x802402ED DefaultValueRecordLayout_AUTOSAR_Platform_BaseTypes_boolean 1.0 AUTOSAR_Com_CompuMethods_Com_IPduStatus_enum_type 0.0 1. FORMAT "%5.0" /end CHARACTERISTIC
/begin CHARACTERISTIC Com_stVCU_HVAC_231h_TxPduCtrl_C "Calibration parameter to control Ipdu VCU_HVAC_231h_Tx" VALUE 0x802402EC DefaultValueRecordLayout_AUTOSAR_Platform_BaseTypes_boolean 1.0 AUTOSAR_Com_CompuMethods_Com_IPduStatus_enum_type 0.0 1. FORMAT "%5.0" /end CHARACTERISTIC
/begin CHARACTERISTIC Com_stVCU_INV_491h_TxPduCtrl_C "Calibration parameter to control Ipdu VCU_INV_491h_Tx" VALUE 0x802402EB DefaultValueRecordLayout_AUTOSAR_Platform_BaseTypes_boolean 1.0 AUTOSAR_Com_CompuMethods_Com_IPduStatus_enum_type 0.0 1. FORMAT "%5.0" /end CHARACTERISTIC
/begin CHARACTERISTIC Com_stVCU_VERS_111h_TxPduCtrl_C "Calibration parameter to control Ipdu VCU_VERS_111h_Tx" VALUE 0x802402EA DefaultValueRecordLayout_AUTOSAR_Platform_BaseTypes_boolean 1.0 AUTOSAR_Com_CompuMethods_Com_IPduStatus_enum_type 0.0 1. FORMAT "%5.0" /end CHARACTERISTIC
/begin CHARACTERISTIC Com_stVCU_eBCCM_432h_RxPduCtrl_C "Calibration parameter to control Ipdu VCU_eBCCM_432h_Rx" VALUE 0x802402E9 DefaultValueRecordLayout_AUTOSAR_Platform_BaseTypes_boolean 1.0 AUTOSAR_Com_CompuMethods_Com_IPduStatus_enum_type 0.0 1. FORMAT "%5.0" /end CHARACTERISTIC
/begin CHARACTERISTIC Com_stVCU_eBCCM_552h_RxPduCtrl_C "Calibration parameter to control Ipdu VCU_eBCCM_552h_Rx" VALUE 0x802402E8 DefaultValueRecordLayout_AUTOSAR_Platform_BaseTypes_boolean 1.0 AUTOSAR_Com_CompuMethods_Com_IPduStatus_enum_type 0.0 1. FORMAT "%5.0" /end CHARACTERISTIC
/begin CHARACTERISTIC Com_stVCU_eCOMP_CONTROL_341_TxPduCtrl_C "Calibration parameter to control Ipdu VCU_eCOMP_CONTROL_341_Tx" VALUE 0x802402E7 DefaultValueRecordLayout_AUTOSAR_Platform_BaseTypes_boolean 1.0 AUTOSAR_Com_CompuMethods_Com_IPduStatus_enum_type 0.0 1. FORMAT "%5.0" /end CHARACTERISTIC
/begin CHARACTERISTIC Com_steBCCM_082h_RxPduCtrl_C "Calibration parameter to control Ipdu eBCCM_082h_Rx" VALUE 0x802402E6 DefaultValueRecordLayout_AUTOSAR_Platform_BaseTypes_boolean 1.0 AUTOSAR_Com_CompuMethods_Com_IPduStatus_enum_type 0.0 1. FORMAT "%5.0" /end CHARACTERISTIC
/begin CHARACTERISTIC Com_steCOMP_Information_47B_RxPduCtrl_C "Calibration parameter to control Ipdu eCOMP_Information_47B_Rx" VALUE 0x802402E5 DefaultValueRecordLayout_AUTOSAR_Platform_BaseTypes_boolean 1.0 AUTOSAR_Com_CompuMethods_Com_IPduStatus_enum_type 0.0 1. FORMAT "%5.0" /end CHARACTERISTIC
/begin CHARACTERISTIC Com_steCOMP_Information_48B_RxPduCtrl_C "Calibration parameter to control Ipdu eCOMP_Information_48B_Rx" VALUE 0x802402E4 DefaultValueRecordLayout_AUTOSAR_Platform_BaseTypes_boolean 1.0 AUTOSAR_Com_CompuMethods_Com_IPduStatus_enum_type 0.0 1. FORMAT "%5.0" /end CHARACTERISTIC
/begin MEASUREMENT Com_SigType_au16 "Measurement variable for Signals of type - uint16,sint16. To refer Individual element in the Buffer array, Fetch Buffer Index from Com_PBcfg.c for each signal." UWORD RB_RBA_Common_CentralElements_CompuMethods_Identical 1 100 0.0 65535. FORMAT "%5.0" ECU_ADDRESS 0x6002119C MATRIX_DIM 55 /end MEASUREMENT
/begin MEASUREMENT Com_SigType_au32 "Measurement variable for Signals of type - uint32,sint32. To refer Individual element in the Buffer array, Fetch Buffer Index from Com_PBcfg.c for each signal." ULONG RB_RBA_Common_CentralElements_CompuMethods_Identical 1 100 0.0 4.E9 FORMAT "%5.0" ECU_ADDRESS 0x60019290 MATRIX_DIM 4 /end MEASUREMENT
/begin MEASUREMENT Com_SigType_au8 "Measurement variable for Signals of type - uint8,sint8,boolean,uint8_n. To refer Individual element in the Buffer array, Fetch Buffer Index from Com_PBcfg.c for each signal." UBYTE RB_RBA_Common_CentralElements_CompuMethods_Identical 1 100 0.0 255. FORMAT "%5.0" ECU_ADDRESS 0x60023FA2 MATRIX_DIM 213 /end MEASUREMENT
/begin MEASUREMENT Com_dCDE_RESEAU_LIN_VCU_TxByte "Tx Ipdu buffer of IPdu -CDE_RESEAU_LIN_VCU_Tx- as a Measurement parameter" UBYTE RB_RBA_Common_CentralElements_CompuMethods_Identical 1 100 0.0 255. FORMAT "%5.0" ECU_ADDRESS 0x60024437 MATRIX_DIM 8 /end MEASUREMENT
/begin MEASUREMENT Com_dCLUSTER_5E7_RxByte "Rx Local Ipdu buffer of IPdu -CLUSTER_5E7_Rx- as a Measurement parameter" UBYTE RB_RBA_Common_CentralElements_CompuMethods_Identical 1 100 0.0 255. FORMAT "%5.0" ECU_ADDRESS 0x60024351 MATRIX_DIM 8 /end MEASUREMENT
/begin MEASUREMENT Com_dCONTEXTE_1_5B2_RxByte "Rx Local Ipdu buffer of IPdu -CONTEXTE_1_5B2_Rx- as a Measurement parameter" UBYTE RB_RBA_Common_CentralElements_CompuMethods_Identical 1 100 0.0 255. FORMAT "%5.0" ECU_ADDRESS 0x60024349 MATRIX_DIM 8 /end MEASUREMENT
/begin MEASUREMENT Com_dDAT3_BSI_4F2h_RxByte "Rx Local Ipdu buffer of IPdu -DAT3_BSI_4F2h_Rx- as a Measurement parameter" UBYTE RB_RBA_Common_CentralElements_CompuMethods_Identical 1 100 0.0 255. FORMAT "%5.0" ECU_ADDRESS 0x60024341 MATRIX_DIM 8 /end MEASUREMENT
/begin MEASUREMENT Com_dDAT_TBMU_454_TxByte "Tx Ipdu buffer of IPdu -DAT_TBMU_454_Tx- as a Measurement parameter" UBYTE RB_RBA_Common_CentralElements_CompuMethods_Identical 1 100 0.0 255. FORMAT "%5.0" ECU_ADDRESS 0x6002442F MATRIX_DIM 8 /end MEASUREMENT
/begin MEASUREMENT Com_dDCDC_283h_RxByte "Rx Local Ipdu buffer of IPdu -DCDC_283h_Rx- as a Measurement parameter" UBYTE RB_RBA_Common_CentralElements_CompuMethods_Identical 1 100 0.0 255. FORMAT "%5.0" ECU_ADDRESS 0x60024339 MATRIX_DIM 8 /end MEASUREMENT
/begin MEASUREMENT Com_dDCDC_293h_RxByte "Rx Local Ipdu buffer of IPdu -DCDC_293h_Rx- as a Measurement parameter" UBYTE RB_RBA_Common_CentralElements_CompuMethods_Identical 1 100 0.0 255. FORMAT "%5.0" ECU_ADDRESS 0x60024331 MATRIX_DIM 8 /end MEASUREMENT
/begin MEASUREMENT Com_dDCDC_473h_RxByte "Rx Local Ipdu buffer of IPdu -DCDC_473h_Rx- as a Measurement parameter" UBYTE RB_RBA_Common_CentralElements_CompuMethods_Identical 1 100 0.0 255. FORMAT "%5.0" ECU_ADDRESS 0x60024329 MATRIX_DIM 8 /end MEASUREMENT
/begin MEASUREMENT Com_dDCDC_663h_RxByte "Rx Local Ipdu buffer of IPdu -DCDC_663h_Rx- as a Measurement parameter" UBYTE RB_RBA_Common_CentralElements_CompuMethods_Identical 1 100 0.0 255. FORMAT "%5.0" ECU_ADDRESS 0x60024321 MATRIX_DIM 8 /end MEASUREMENT
/begin MEASUREMENT Com_dE_VCU_522_TxByte "Tx Ipdu buffer of IPdu -E_VCU_522_Tx- as a Measurement parameter" UBYTE RB_RBA_Common_CentralElements_CompuMethods_Identical 1 100 0.0 255. FORMAT "%5.0" ECU_ADDRESS 0x60024427 MATRIX_DIM 8 /end MEASUREMENT
/begin MEASUREMENT Com_dHS3_AUTO_GEARBOX_SWITCH_REQ_TxByte "Tx Ipdu buffer of IPdu -HS3_AUTO_GEARBOX_SWITCH_REQ_Tx- as a Measurement parameter" UBYTE RB_RBA_Common_CentralElements_CompuMethods_Identical 1 100 0.0 255. FORMAT "%5.0" ECU_ADDRESS 0x60024423 MATRIX_DIM 4 /end MEASUREMENT
/begin MEASUREMENT Com_dHS3_AUTO_GEARBOX_SWITCH_STATUS_RxByte "Rx Local Ipdu buffer of IPdu -HS3_AUTO_GEARBOX_SWITCH_STATUS_Rx- as a Measurement parameter" UBYTE RB_RBA_Common_CentralElements_CompuMethods_Identical 1 100 0.0 255. FORMAT "%5.0" ECU_ADDRESS 0x60024319 MATRIX_DIM 8 /end MEASUREMENT
/begin MEASUREMENT Com_dHSN1_GW_RX_04D_RxByte "Rx Local Ipdu buffer of IPdu -HSN1_GW_RX_04D_Rx- as a Measurement parameter" UBYTE RB_RBA_Common_CentralElements_CompuMethods_Identical 1 100 0.0 255. FORMAT "%5.0" ECU_ADDRESS 0x60024311 MATRIX_DIM 8 /end MEASUREMENT
/begin MEASUREMENT Com_dHSN1_GW_RX_06D_RxByte "Rx Local Ipdu buffer of IPdu -HSN1_GW_RX_06D_Rx- as a Measurement parameter" UBYTE RB_RBA_Common_CentralElements_CompuMethods_Identical 1 100 0.0 255. FORMAT "%5.0" ECU_ADDRESS 0x60024309 MATRIX_DIM 8 /end MEASUREMENT
/begin MEASUREMENT Com_dHSN1_GW_RX_0AE_RxByte "Rx Local Ipdu buffer of IPdu -HSN1_GW_RX_0AE_Rx- as a Measurement parameter" UBYTE RB_RBA_Common_CentralElements_CompuMethods_Identical 1 100 0.0 255. FORMAT "%5.0" ECU_ADDRESS 0x60024304 MATRIX_DIM 5 /end MEASUREMENT
/begin MEASUREMENT Com_dHSN1_GW_RX_492_RxByte "Rx Local Ipdu buffer of IPdu -HSN1_GW_RX_492_Rx- as a Measurement parameter" UBYTE RB_RBA_Common_CentralElements_CompuMethods_Identical 1 100 0.0 255. FORMAT "%5.0" ECU_ADDRESS 0x600242FE MATRIX_DIM 6 /end MEASUREMENT
/begin MEASUREMENT Com_dHSN1_GW_RX_4B2_RxByte "Rx Local Ipdu buffer of IPdu -HSN1_GW_RX_4B2_Rx- as a Measurement parameter" UBYTE RB_RBA_Common_CentralElements_CompuMethods_Identical 1 100 0.0 255. FORMAT "%5.0" ECU_ADDRESS 0x600242F6 MATRIX_DIM 8 /end MEASUREMENT
/begin MEASUREMENT Com_dHSN1_GW_RX_4C8_RxByte "Rx Local Ipdu buffer of IPdu -HSN1_GW_RX_4C8_Rx- as a Measurement parameter" UBYTE RB_RBA_Common_CentralElements_CompuMethods_Identical 1 100 0.0 255. FORMAT "%5.0" ECU_ADDRESS 0x600242EE MATRIX_DIM 8 /end MEASUREMENT
/begin MEASUREMENT Com_dHSN1_GW_RX_4D2_RxByte "Rx Local Ipdu buffer of IPdu -HSN1_GW_RX_4D2_Rx- as a Measurement parameter" UBYTE RB_RBA_Common_CentralElements_CompuMethods_Identical 1 100 0.0 255. FORMAT "%5.0" ECU_ADDRESS 0x600242EB MATRIX_DIM 3 /end MEASUREMENT
/begin MEASUREMENT Com_dHSN3_GW_RX_0A6_RxByte "Rx Local Ipdu buffer of IPdu -HSN3_GW_RX_0A6_Rx- as a Measurement parameter" UBYTE RB_RBA_Common_CentralElements_CompuMethods_Identical 1 100 0.0 255. FORMAT "%5.0" ECU_ADDRESS 0x600242E6 MATRIX_DIM 5 /end MEASUREMENT
/begin MEASUREMENT Com_dHSN3_GW_RX_0C6_RxByte "Rx Local Ipdu buffer of IPdu -HSN3_GW_RX_0C6_Rx- as a Measurement parameter" UBYTE RB_RBA_Common_CentralElements_CompuMethods_Identical 1 100 0.0 255. FORMAT "%5.0" ECU_ADDRESS 0x600242DE MATRIX_DIM 8 /end MEASUREMENT
/begin MEASUREMENT Com_dHSN3_GW_RX_0E6_RxByte "Rx Local Ipdu buffer of IPdu -HSN3_GW_RX_0E6_Rx- as a Measurement parameter" UBYTE RB_RBA_Common_CentralElements_CompuMethods_Identical 1 100 0.0 255. FORMAT "%5.0" ECU_ADDRESS 0x600242D6 MATRIX_DIM 8 /end MEASUREMENT
/begin MEASUREMENT Com_dHSN3_GW_RX_334_RxByte "Rx Local Ipdu buffer of IPdu -HSN3_GW_RX_334_Rx- as a Measurement parameter" UBYTE RB_RBA_Common_CentralElements_CompuMethods_Identical 1 100 0.0 255. FORMAT "%5.0" ECU_ADDRESS 0x600242CE MATRIX_DIM 8 /end MEASUREMENT
/begin MEASUREMENT Com_dHSN3_GW_RX_3F4_RxByte "Rx Local Ipdu buffer of IPdu -HSN3_GW_RX_3F4_Rx- as a Measurement parameter" UBYTE RB_RBA_Common_CentralElements_CompuMethods_Identical 1 100 0.0 255. FORMAT "%5.0" ECU_ADDRESS 0x600242C6 MATRIX_DIM 8 /end MEASUREMENT
/begin MEASUREMENT Com_dHSN3_GW_RX_423_RxByte "Rx Local Ipdu buffer of IPdu -HSN3_GW_RX_423_Rx- as a Measurement parameter" UBYTE RB_RBA_Common_CentralElements_CompuMethods_Identical 1 100 0.0 255. FORMAT "%5.0" ECU_ADDRESS 0x600242BE MATRIX_DIM 8 /end MEASUREMENT
/begin MEASUREMENT Com_dHSN3_GW_RX_434_RxByte "Rx Local Ipdu buffer of IPdu -HSN3_GW_RX_434_Rx- as a Measurement parameter" UBYTE RB_RBA_Common_CentralElements_CompuMethods_Identical 1 100 0.0 255. FORMAT "%5.0" ECU_ADDRESS 0x600242B6 MATRIX_DIM 8 /end MEASUREMENT
/begin MEASUREMENT Com_dHSN3_GW_RX_494_RxByte "Rx Local Ipdu buffer of IPdu -HSN3_GW_RX_494_Rx- as a Measurement parameter" UBYTE RB_RBA_Common_CentralElements_CompuMethods_Identical 1 100 0.0 255. FORMAT "%5.0" ECU_ADDRESS 0x600242AE MATRIX_DIM 8 /end MEASUREMENT
/begin MEASUREMENT Com_dHSN3_GW_RX_5B1_RxByte "Rx Local Ipdu buffer of IPdu -HSN3_GW_RX_5B1_Rx- as a Measurement parameter" UBYTE RB_RBA_Common_CentralElements_CompuMethods_Identical 1 100 0.0 255. FORMAT "%5.0" ECU_ADDRESS 0x600242A6 MATRIX_DIM 8 /end MEASUREMENT
/begin MEASUREMENT Com_dHSN3_GW_RX_615_RxByte "Rx Local Ipdu buffer of IPdu -HSN3_GW_RX_615_Rx- as a Measurement parameter" UBYTE RB_RBA_Common_CentralElements_CompuMethods_Identical 1 100 0.0 255. FORMAT "%5.0" ECU_ADDRESS 0x6002429E MATRIX_DIM 8 /end MEASUREMENT
/begin MEASUREMENT Com_dHSN3_GW_RX_625_RxByte "Rx Local Ipdu buffer of IPdu -HSN3_GW_RX_625_Rx- as a Measurement parameter" UBYTE RB_RBA_Common_CentralElements_CompuMethods_Identical 1 100 0.0 255. FORMAT "%5.0" ECU_ADDRESS 0x60024296 MATRIX_DIM 8 /end MEASUREMENT
/begin MEASUREMENT Com_dHSN3_GW_RX_66B_RxByte "Rx Local Ipdu buffer of IPdu -HSN3_GW_RX_66B_Rx- as a Measurement parameter" UBYTE RB_RBA_Common_CentralElements_CompuMethods_Identical 1 100 0.0 255. FORMAT "%5.0" ECU_ADDRESS 0x6002428E MATRIX_DIM 8 /end MEASUREMENT
/begin MEASUREMENT Com_dHSN3_GW_RX_766_RxByte "Rx Local Ipdu buffer of IPdu -HSN3_GW_RX_766_Rx- as a Measurement parameter" UBYTE RB_RBA_Common_CentralElements_CompuMethods_Identical 1 100 0.0 255. FORMAT "%5.0" ECU_ADDRESS 0x60024286 MATRIX_DIM 8 /end MEASUREMENT
/begin MEASUREMENT Com_dHSN3_GW_RX_774_RxByte "Rx Local Ipdu buffer of IPdu -HSN3_GW_RX_774_Rx- as a Measurement parameter" UBYTE RB_RBA_Common_CentralElements_CompuMethods_Identical 1 100 0.0 255. FORMAT "%5.0" ECU_ADDRESS 0x6002427E MATRIX_DIM 8 /end MEASUREMENT
/begin MEASUREMENT Com_dHVAC_PANEL_26h_RxByte "Rx Local Ipdu buffer of IPdu -HVAC_PANEL_26h_Rx- as a Measurement parameter" UBYTE RB_RBA_Common_CentralElements_CompuMethods_Identical 1 100 0.0 255. FORMAT "%5.0" ECU_ADDRESS 0x60024276 MATRIX_DIM 8 /end MEASUREMENT
/begin MEASUREMENT Com_dHVBAT_205h_RxByte "Rx Local Ipdu buffer of IPdu -HVBAT_205h_Rx- as a Measurement parameter" UBYTE RB_RBA_Common_CentralElements_CompuMethods_Identical 1 100 0.0 255. FORMAT "%5.0" ECU_ADDRESS 0x6002426E MATRIX_DIM 8 /end MEASUREMENT
/begin MEASUREMENT Com_dHVBAT_275h_RxByte "Rx Local Ipdu buffer of IPdu -HVBAT_275h_Rx- as a Measurement parameter" UBYTE RB_RBA_Common_CentralElements_CompuMethods_Identical 1 100 0.0 255. FORMAT "%5.0" ECU_ADDRESS 0x60024266 MATRIX_DIM 8 /end MEASUREMENT
/begin MEASUREMENT Com_dHVBAT_285h_RxByte "Rx Local Ipdu buffer of IPdu -HVBAT_285h_Rx- as a Measurement parameter" UBYTE RB_RBA_Common_CentralElements_CompuMethods_Identical 1 100 0.0 255. FORMAT "%5.0" ECU_ADDRESS 0x6002425E MATRIX_DIM 8 /end MEASUREMENT
/begin MEASUREMENT Com_dHVBAT_325h_RxByte "Rx Local Ipdu buffer of IPdu -HVBAT_325h_Rx- as a Measurement parameter" UBYTE RB_RBA_Common_CentralElements_CompuMethods_Identical 1 100 0.0 255. FORMAT "%5.0" ECU_ADDRESS 0x60024256 MATRIX_DIM 8 /end MEASUREMENT
/begin MEASUREMENT Com_dHVBAT_335h_RxByte "Rx Local Ipdu buffer of IPdu -HVBAT_335h_Rx- as a Measurement parameter" UBYTE RB_RBA_Common_CentralElements_CompuMethods_Identical 1 100 0.0 255. FORMAT "%5.0" ECU_ADDRESS 0x6002424E MATRIX_DIM 8 /end MEASUREMENT
/begin MEASUREMENT Com_dHVBAT_455h_RxByte "Rx Local Ipdu buffer of IPdu -HVBAT_455h_Rx- as a Measurement parameter" UBYTE RB_RBA_Common_CentralElements_CompuMethods_Identical 1 100 0.0 255. FORMAT "%5.0" ECU_ADDRESS 0x60024246 MATRIX_DIM 8 /end MEASUREMENT
/begin MEASUREMENT Com_dHVBAT_535_RxByte "Rx Local Ipdu buffer of IPdu -HVBAT_535_Rx- as a Measurement parameter" UBYTE RB_RBA_Common_CentralElements_CompuMethods_Identical 1 100 0.0 255. FORMAT "%5.0" ECU_ADDRESS 0x6002423E MATRIX_DIM 8 /end MEASUREMENT
/begin MEASUREMENT Com_dHVBAT_595h_RxByte "Rx Local Ipdu buffer of IPdu -HVBAT_595h_Rx- as a Measurement parameter" UBYTE RB_RBA_Common_CentralElements_CompuMethods_Identical 1 100 0.0 255. FORMAT "%5.0" ECU_ADDRESS 0x60024236 MATRIX_DIM 8 /end MEASUREMENT
/begin MEASUREMENT Com_dHVBAT_635h_RxByte "Rx Local Ipdu buffer of IPdu -HVBAT_635h_Rx- as a Measurement parameter" UBYTE RB_RBA_Common_CentralElements_CompuMethods_Identical 1 100 0.0 255. FORMAT "%5.0" ECU_ADDRESS 0x6002422E MATRIX_DIM 8 /end MEASUREMENT
/begin MEASUREMENT Com_dHVBAT_645h_RxByte "Rx Local Ipdu buffer of IPdu -HVBAT_645h_Rx- as a Measurement parameter" UBYTE RB_RBA_Common_CentralElements_CompuMethods_Identical 1 100 0.0 255. FORMAT "%5.0" ECU_ADDRESS 0x60024226 MATRIX_DIM 8 /end MEASUREMENT
/begin MEASUREMENT Com_dHVBAT_665h_RxByte "Rx Local Ipdu buffer of IPdu -HVBAT_665h_Rx- as a Measurement parameter" UBYTE RB_RBA_Common_CentralElements_CompuMethods_Identical 1 100 0.0 255. FORMAT "%5.0" ECU_ADDRESS 0x6002421E MATRIX_DIM 8 /end MEASUREMENT
/begin MEASUREMENT Com_dHVBAT_675h_RxByte "Rx Local Ipdu buffer of IPdu -HVBAT_675h_Rx- as a Measurement parameter" UBYTE RB_RBA_Common_CentralElements_CompuMethods_Identical 1 100 0.0 255. FORMAT "%5.0" ECU_ADDRESS 0x60024216 MATRIX_DIM 8 /end MEASUREMENT
/begin MEASUREMENT Com_dHVBAT_THERMAL_5B5_RxByte "Rx Local Ipdu buffer of IPdu -HVBAT_THERMAL_5B5_Rx- as a Measurement parameter" UBYTE RB_RBA_Common_CentralElements_CompuMethods_Identical 1 100 0.0 255. FORMAT "%5.0" ECU_ADDRESS 0x6002420E MATRIX_DIM 8 /end MEASUREMENT
/begin MEASUREMENT Com_dHVBAT_VCU_435h_RxByte "Rx Local Ipdu buffer of IPdu -HVBAT_VCU_435h_Rx- as a Measurement parameter" UBYTE RB_RBA_Common_CentralElements_CompuMethods_Identical 1 100 0.0 255. FORMAT "%5.0" ECU_ADDRESS 0x60024206 MATRIX_DIM 8 /end MEASUREMENT
/begin MEASUREMENT Com_dHVBAT_VCU_543_RxByte "Rx Local Ipdu buffer of IPdu -HVBAT_VCU_543_Rx- as a Measurement parameter" UBYTE RB_RBA_Common_CentralElements_CompuMethods_Identical 1 100 0.0 255. FORMAT "%5.0" ECU_ADDRESS 0x600241FE MATRIX_DIM 8 /end MEASUREMENT
/begin MEASUREMENT Com_dHVBAT_VCU_583_RxByte "Rx Local Ipdu buffer of IPdu -HVBAT_VCU_583_Rx- as a Measurement parameter" UBYTE RB_RBA_Common_CentralElements_CompuMethods_Identical 1 100 0.0 255. FORMAT "%5.0" ECU_ADDRESS 0x600241F6 MATRIX_DIM 8 /end MEASUREMENT
/begin MEASUREMENT Com_dINV_217h_RxByte "Rx Local Ipdu buffer of IPdu -INV_217h_Rx- as a Measurement parameter" UBYTE RB_RBA_Common_CentralElements_CompuMethods_Identical 1 100 0.0 255. FORMAT "%5.0" ECU_ADDRESS 0x600241EE MATRIX_DIM 8 /end MEASUREMENT
/begin MEASUREMENT Com_dINV_227h_RxByte "Rx Local Ipdu buffer of IPdu -INV_227h_Rx- as a Measurement parameter" UBYTE RB_RBA_Common_CentralElements_CompuMethods_Identical 1 100 0.0 255. FORMAT "%5.0" ECU_ADDRESS 0x600241E6 MATRIX_DIM 8 /end MEASUREMENT
/begin MEASUREMENT Com_dINV_237_RxByte "Rx Local Ipdu buffer of IPdu -INV_237_Rx- as a Measurement parameter" UBYTE RB_RBA_Common_CentralElements_CompuMethods_Identical 1 100 0.0 255. FORMAT "%5.0" ECU_ADDRESS 0x600241DE MATRIX_DIM 8 /end MEASUREMENT
/begin MEASUREMENT Com_dINV_427h_RxByte "Rx Local Ipdu buffer of IPdu -INV_427h_Rx- as a Measurement parameter" UBYTE RB_RBA_Common_CentralElements_CompuMethods_Identical 1 100 0.0 255. FORMAT "%5.0" ECU_ADDRESS 0x600241D6 MATRIX_DIM 8 /end MEASUREMENT
/begin MEASUREMENT Com_dINV_497h_RxByte "Rx Local Ipdu buffer of IPdu -INV_497h_Rx- as a Measurement parameter" UBYTE RB_RBA_Common_CentralElements_CompuMethods_Identical 1 100 0.0 255. FORMAT "%5.0" ECU_ADDRESS 0x600241CE MATRIX_DIM 8 /end MEASUREMENT
/begin MEASUREMENT Com_dINV_IMMO_5C7_RxByte "Rx Local Ipdu buffer of IPdu -INV_IMMO_5C7_Rx- as a Measurement parameter" UBYTE RB_RBA_Common_CentralElements_CompuMethods_Identical 1 100 0.0 255. FORMAT "%5.0" ECU_ADDRESS 0x600241C6 MATRIX_DIM 8 /end MEASUREMENT
/begin MEASUREMENT Com_dIS_DAT6_BSI_592h_MUX0_RxByte "Rx Local Ipdu buffer of IPdu -IS_DAT6_BSI_592h_MUX0_Rx- as a Measurement parameter" UBYTE RB_RBA_Common_CentralElements_CompuMethods_Identical 1 100 0.0 255. FORMAT "%5.0" ECU_ADDRESS 0x600241BE MATRIX_DIM 8 /end MEASUREMENT
/begin MEASUREMENT Com_dIS_DAT6_BSI_592h_MUX1_RxByte "Rx Local Ipdu buffer of IPdu -IS_DAT6_BSI_592h_MUX1_Rx- as a Measurement parameter" UBYTE RB_RBA_Common_CentralElements_CompuMethods_Identical 1 100 0.0 255. FORMAT "%5.0" ECU_ADDRESS 0x600241B6 MATRIX_DIM 8 /end MEASUREMENT
/begin MEASUREMENT Com_dIS_DAT6_BSI_592h_MUX2_RxByte "Rx Local Ipdu buffer of IPdu -IS_DAT6_BSI_592h_MUX2_Rx- as a Measurement parameter" UBYTE RB_RBA_Common_CentralElements_CompuMethods_Identical 1 100 0.0 255. FORMAT "%5.0" ECU_ADDRESS 0x600241AE MATRIX_DIM 8 /end MEASUREMENT
/begin MEASUREMENT Com_dIS_DAT6_BSI_592h_RxByte "Rx Local Ipdu buffer of IPdu -IS_DAT6_BSI_592h_Rx- as a Measurement parameter" UBYTE RB_RBA_Common_CentralElements_CompuMethods_Identical 1 100 0.0 255. FORMAT "%5.0" ECU_ADDRESS 0x600241A6 MATRIX_DIM 8 /end MEASUREMENT
/begin MEASUREMENT Com_dIS_DAT_ABR_50Dh_RxByte "Rx Local Ipdu buffer of IPdu -IS_DAT_ABR_50Dh_Rx- as a Measurement parameter" UBYTE RB_RBA_Common_CentralElements_CompuMethods_Identical 1 100 0.0 255. FORMAT "%5.0" ECU_ADDRESS 0x6002419E MATRIX_DIM 8 /end MEASUREMENT
/begin MEASUREMENT Com_dIS_DAT_BSI_412h_RxByte "Rx Local Ipdu buffer of IPdu -IS_DAT_BSI_412h_Rx- as a Measurement parameter" UBYTE RB_RBA_Common_CentralElements_CompuMethods_Identical 1 100 0.0 255. FORMAT "%5.0" ECU_ADDRESS 0x60024196 MATRIX_DIM 8 /end MEASUREMENT
/begin MEASUREMENT Com_dIS_DYN3_CMM_468h_TxByte "Tx Ipdu buffer of IPdu -IS_DYN3_CMM_468h_Tx- as a Measurement parameter" UBYTE RB_RBA_Common_CentralElements_CompuMethods_Identical 1 100 0.0 255. FORMAT "%5.0" ECU_ADDRESS 0x6002441B MATRIX_DIM 8 /end MEASUREMENT
/begin MEASUREMENT Com_dIS_DYN_ABR_38Dh_RxByte "Rx Local Ipdu buffer of IPdu -IS_DYN_ABR_38Dh_Rx- as a Measurement parameter" UBYTE RB_RBA_Common_CentralElements_CompuMethods_Identical 1 100 0.0 255. FORMAT "%5.0" ECU_ADDRESS 0x6002418E MATRIX_DIM 8 /end MEASUREMENT
/begin MEASUREMENT Com_dIS_DYN_VCU_208h_TxByte "Tx Ipdu buffer of IPdu -IS_DYN_VCU_208h_Tx- as a Measurement parameter" UBYTE RB_RBA_Common_CentralElements_CompuMethods_Identical 1 100 0.0 255. FORMAT "%5.0" ECU_ADDRESS 0x60024413 MATRIX_DIM 8 /end MEASUREMENT
/begin MEASUREMENT Com_dIS_INTE_ELECTRON_BSI_092h_RxByte "Rx Local Ipdu buffer of IPdu -IS_INTE_ELECTRON_BSI_092h_Rx- as a Measurement parameter" UBYTE RB_RBA_Common_CentralElements_CompuMethods_Identical 1 100 0.0 255. FORMAT "%5.0" ECU_ADDRESS 0x60024186 MATRIX_DIM 8 /end MEASUREMENT
/begin MEASUREMENT Com_dOBC_273h_RxByte "Rx Local Ipdu buffer of IPdu -OBC_273h_Rx- as a Measurement parameter" UBYTE RB_RBA_Common_CentralElements_CompuMethods_Identical 1 100 0.0 255. FORMAT "%5.0" ECU_ADDRESS 0x6002417E MATRIX_DIM 8 /end MEASUREMENT
/begin MEASUREMENT Com_dOBC_453h_RxByte "Rx Local Ipdu buffer of IPdu -OBC_453h_Rx- as a Measurement parameter" UBYTE RB_RBA_Common_CentralElements_CompuMethods_Identical 1 100 0.0 255. FORMAT "%5.0" ECU_ADDRESS 0x60024176 MATRIX_DIM 8 /end MEASUREMENT
/begin MEASUREMENT Com_dOBC_463h_RxByte "Rx Local Ipdu buffer of IPdu -OBC_463h_Rx- as a Measurement parameter" UBYTE RB_RBA_Common_CentralElements_CompuMethods_Identical 1 100 0.0 255. FORMAT "%5.0" ECU_ADDRESS 0x6002416E MATRIX_DIM 8 /end MEASUREMENT
/begin MEASUREMENT Com_dPDU_BusVoltages_308_RxByte "Rx Local Ipdu buffer of IPdu -PDU_BusVoltages_308_Rx- as a Measurement parameter" UBYTE RB_RBA_Common_CentralElements_CompuMethods_Identical 1 100 0.0 255. FORMAT "%5.0" ECU_ADDRESS 0x60024166 MATRIX_DIM 8 /end MEASUREMENT
/begin MEASUREMENT Com_dPDU_Current_318_RxByte "Rx Local Ipdu buffer of IPdu -PDU_Current_318_Rx- as a Measurement parameter" UBYTE RB_RBA_Common_CentralElements_CompuMethods_Identical 1 100 0.0 255. FORMAT "%5.0" ECU_ADDRESS 0x6002415E MATRIX_DIM 8 /end MEASUREMENT
/begin MEASUREMENT Com_dRMS1_VCU_5C1_TxByte "Tx Ipdu buffer of IPdu -RMS1_VCU_5C1_Tx- as a Measurement parameter" UBYTE RB_RBA_Common_CentralElements_CompuMethods_Identical 1 100 0.0 255. FORMAT "%5.0" ECU_ADDRESS 0x6002440B MATRIX_DIM 8 /end MEASUREMENT
/begin MEASUREMENT Com_dRMS2_VCU_5C3_TxByte "Tx Ipdu buffer of IPdu -RMS2_VCU_5C3_Tx- as a Measurement parameter" UBYTE RB_RBA_Common_CentralElements_CompuMethods_Identical 1 100 0.0 255. FORMAT "%5.0" ECU_ADDRESS 0x60024403 MATRIX_DIM 8 /end MEASUREMENT
/begin MEASUREMENT Com_dRMS3_TBMU_5A3_TxByte "Tx Ipdu buffer of IPdu -RMS3_TBMU_5A3_Tx- as a Measurement parameter" UBYTE RB_RBA_Common_CentralElements_CompuMethods_Identical 1 100 0.0 255. FORMAT "%5.0" ECU_ADDRESS 0x600243FB MATRIX_DIM 8 /end MEASUREMENT
/begin MEASUREMENT Com_dRMS5_VCU_563_TxByte "Tx Ipdu buffer of IPdu -RMS5_VCU_563_Tx- as a Measurement parameter" UBYTE RB_RBA_Common_CentralElements_CompuMethods_Identical 1 100 0.0 255. FORMAT "%5.0" ECU_ADDRESS 0x600243F4 MATRIX_DIM 7 /end MEASUREMENT
/begin MEASUREMENT Com_dSC_INFO_BCCM_442h_RxByte "Rx Local Ipdu buffer of IPdu -SC_INFO_BCCM_442h_Rx- as a Measurement parameter" UBYTE RB_RBA_Common_CentralElements_CompuMethods_Identical 1 100 0.0 255. FORMAT "%5.0" ECU_ADDRESS 0x60024156 MATRIX_DIM 8 /end MEASUREMENT
/begin MEASUREMENT Com_dVCU_0x50F_TxByte "Tx Ipdu buffer of IPdu -VCU_0x50F_Tx- as a Measurement parameter" UBYTE RB_RBA_Common_CentralElements_CompuMethods_Identical 1 100 0.0 255. FORMAT "%5.0" ECU_ADDRESS 0x600243EC MATRIX_DIM 8 /end MEASUREMENT
/begin MEASUREMENT Com_dVCU_211h_TxByte "Tx Ipdu buffer of IPdu -VCU_211h_Tx- as a Measurement parameter" UBYTE RB_RBA_Common_CentralElements_CompuMethods_Identical 1 100 0.0 255. FORMAT "%5.0" ECU_ADDRESS 0x600243E4 MATRIX_DIM 8 /end MEASUREMENT
/begin MEASUREMENT Com_dVCU_221h_TxByte "Tx Ipdu buffer of IPdu -VCU_221h_Tx- as a Measurement parameter" UBYTE RB_RBA_Common_CentralElements_CompuMethods_Identical 1 100 0.0 255. FORMAT "%5.0" ECU_ADDRESS 0x600243DC MATRIX_DIM 8 /end MEASUREMENT
/begin MEASUREMENT Com_dVCU_241h_TxByte "Tx Ipdu buffer of IPdu -VCU_241h_Tx- as a Measurement parameter" UBYTE RB_RBA_Common_CentralElements_CompuMethods_Identical 1 100 0.0 255. FORMAT "%5.0" ECU_ADDRESS 0x600243D4 MATRIX_DIM 8 /end MEASUREMENT
/begin MEASUREMENT Com_dVCU_25h_TxByte "Tx Ipdu buffer of IPdu -VCU_25h_Tx- as a Measurement parameter" UBYTE RB_RBA_Common_CentralElements_CompuMethods_Identical 1 100 0.0 255. FORMAT "%5.0" ECU_ADDRESS 0x600243CC MATRIX_DIM 8 /end MEASUREMENT
/begin MEASUREMENT Com_dVCU_262_TxByte "Tx Ipdu buffer of IPdu -VCU_262_Tx- as a Measurement parameter" UBYTE RB_RBA_Common_CentralElements_CompuMethods_Identical 1 100 0.0 255. FORMAT "%5.0" ECU_ADDRESS 0x600243CB MATRIX_DIM 1 /end MEASUREMENT
/begin MEASUREMENT Com_dVCU_281h_TxByte "Tx Ipdu buffer of IPdu -VCU_281h_Tx- as a Measurement parameter" UBYTE RB_RBA_Common_CentralElements_CompuMethods_Identical 1 100 0.0 255. FORMAT "%5.0" ECU_ADDRESS 0x600243C3 MATRIX_DIM 8 /end MEASUREMENT
/begin MEASUREMENT Com_dVCU_321h_TxByte "Tx Ipdu buffer of IPdu -VCU_321h_Tx- as a Measurement parameter" UBYTE RB_RBA_Common_CentralElements_CompuMethods_Identical 1 100 0.0 255. FORMAT "%5.0" ECU_ADDRESS 0x600243BB MATRIX_DIM 8 /end MEASUREMENT
/begin MEASUREMENT Com_dVCU_331h_TxByte "Tx Ipdu buffer of IPdu -VCU_331h_Tx- as a Measurement parameter" UBYTE RB_RBA_Common_CentralElements_CompuMethods_Identical 1 100 0.0 255. FORMAT "%5.0" ECU_ADDRESS 0x600243B3 MATRIX_DIM 8 /end MEASUREMENT
/begin MEASUREMENT Com_dVCU_421h_TxByte "Tx Ipdu buffer of IPdu -VCU_421h_Tx- as a Measurement parameter" UBYTE RB_RBA_Common_CentralElements_CompuMethods_Identical 1 100 0.0 255. FORMAT "%5.0" ECU_ADDRESS 0x600243AB MATRIX_DIM 8 /end MEASUREMENT
/begin MEASUREMENT Com_dVCU_481h_TxByte "Tx Ipdu buffer of IPdu -VCU_481h_Tx- as a Measurement parameter" UBYTE RB_RBA_Common_CentralElements_CompuMethods_Identical 1 100 0.0 255. FORMAT "%5.0" ECU_ADDRESS 0x600243A3 MATRIX_DIM 8 /end MEASUREMENT
/begin MEASUREMENT Com_dVCU_4A2_TxByte "Tx Ipdu buffer of IPdu -VCU_4A2_Tx- as a Measurement parameter" UBYTE RB_RBA_Common_CentralElements_CompuMethods_Identical 1 100 0.0 255. FORMAT "%5.0" ECU_ADDRESS 0x600243A1 MATRIX_DIM 2 /end MEASUREMENT
/begin MEASUREMENT Com_dVCU_501h_TxByte "Tx Ipdu buffer of IPdu -VCU_501h_Tx- as a Measurement parameter" UBYTE RB_RBA_Common_CentralElements_CompuMethods_Identical 1 100 0.0 255. FORMAT "%5.0" ECU_ADDRESS 0x60024399 MATRIX_DIM 8 /end MEASUREMENT
/begin MEASUREMENT Com_dVCU_5A2_TxByte "Tx Ipdu buffer of IPdu -VCU_5A2_Tx- as a Measurement parameter" UBYTE RB_RBA_Common_CentralElements_CompuMethods_Identical 1 100 0.0 255. FORMAT "%5.0" ECU_ADDRESS 0x60024391 MATRIX_DIM 8 /end MEASUREMENT
/begin MEASUREMENT Com_dVCU_5D1h_TxByte "Tx Ipdu buffer of IPdu -VCU_5D1h_Tx- as a Measurement parameter" UBYTE RB_RBA_Common_CentralElements_CompuMethods_Identical 1 100 0.0 255. FORMAT "%5.0" ECU_ADDRESS 0x60024389 MATRIX_DIM 8 /end MEASUREMENT
/begin MEASUREMENT Com_dVCU_5F1h_TxByte "Tx Ipdu buffer of IPdu -VCU_5F1h_Tx- as a Measurement parameter" UBYTE RB_RBA_Common_CentralElements_CompuMethods_Identical 1 100 0.0 255. FORMAT "%5.0" ECU_ADDRESS 0x60024381 MATRIX_DIM 8 /end MEASUREMENT
/begin MEASUREMENT Com_dVCU_AIRBAG_351h_RxByte "Rx Local Ipdu buffer of IPdu -VCU_AIRBAG_351h_Rx- as a Measurement parameter" UBYTE RB_RBA_Common_CentralElements_CompuMethods_Identical 1 100 0.0 255. FORMAT "%5.0" ECU_ADDRESS 0x6002414E MATRIX_DIM 8 /end MEASUREMENT
/begin MEASUREMENT Com_dVCU_CTRL_INPUT_201h_TxByte "Tx Ipdu buffer of IPdu -VCU_CTRL_INPUT_201h_Tx- as a Measurement parameter" UBYTE RB_RBA_Common_CentralElements_CompuMethods_Identical 1 100 0.0 255. FORMAT "%5.0" ECU_ADDRESS 0x60024379 MATRIX_DIM 8 /end MEASUREMENT
/begin MEASUREMENT Com_dVCU_HVAC_231h_TxByte "Tx Ipdu buffer of IPdu -VCU_HVAC_231h_Tx- as a Measurement parameter" UBYTE RB_RBA_Common_CentralElements_CompuMethods_Identical 1 100 0.0 255. FORMAT "%5.0" ECU_ADDRESS 0x60024371 MATRIX_DIM 8 /end MEASUREMENT
/begin MEASUREMENT Com_dVCU_INV_491h_TxByte "Tx Ipdu buffer of IPdu -VCU_INV_491h_Tx- as a Measurement parameter" UBYTE RB_RBA_Common_CentralElements_CompuMethods_Identical 1 100 0.0 255. FORMAT "%5.0" ECU_ADDRESS 0x60024369 MATRIX_DIM 8 /end MEASUREMENT
/begin MEASUREMENT Com_dVCU_VERS_111h_TxByte "Tx Ipdu buffer of IPdu -VCU_VERS_111h_Tx- as a Measurement parameter" UBYTE RB_RBA_Common_CentralElements_CompuMethods_Identical 1 100 0.0 255. FORMAT "%5.0" ECU_ADDRESS 0x60024361 MATRIX_DIM 8 /end MEASUREMENT
/begin MEASUREMENT Com_dVCU_eBCCM_432h_RxByte "Rx Local Ipdu buffer of IPdu -VCU_eBCCM_432h_Rx- as a Measurement parameter" UBYTE RB_RBA_Common_CentralElements_CompuMethods_Identical 1 100 0.0 255. FORMAT "%5.0" ECU_ADDRESS 0x60024146 MATRIX_DIM 8 /end MEASUREMENT
/begin MEASUREMENT Com_dVCU_eBCCM_552h_RxByte "Rx Local Ipdu buffer of IPdu -VCU_eBCCM_552h_Rx- as a Measurement parameter" UBYTE RB_RBA_Common_CentralElements_CompuMethods_Identical 1 100 0.0 255. FORMAT "%5.0" ECU_ADDRESS 0x6002413E MATRIX_DIM 8 /end MEASUREMENT
/begin MEASUREMENT Com_dVCU_eCOMP_CONTROL_341_TxByte "Tx Ipdu buffer of IPdu -VCU_eCOMP_CONTROL_341_Tx- as a Measurement parameter" UBYTE RB_RBA_Common_CentralElements_CompuMethods_Identical 1 100 0.0 255. FORMAT "%5.0" ECU_ADDRESS 0x60024359 MATRIX_DIM 8 /end MEASUREMENT
/begin MEASUREMENT Com_deBCCM_082h_RxByte "Rx Local Ipdu buffer of IPdu -eBCCM_082h_Rx- as a Measurement parameter" UBYTE RB_RBA_Common_CentralElements_CompuMethods_Identical 1 100 0.0 255. FORMAT "%5.0" ECU_ADDRESS 0x60024136 MATRIX_DIM 8 /end MEASUREMENT
/begin MEASUREMENT Com_deCOMP_Information_47B_RxByte "Rx Local Ipdu buffer of IPdu -eCOMP_Information_47B_Rx- as a Measurement parameter" UBYTE RB_RBA_Common_CentralElements_CompuMethods_Identical 1 100 0.0 255. FORMAT "%5.0" ECU_ADDRESS 0x6002412E MATRIX_DIM 8 /end MEASUREMENT
/begin MEASUREMENT Com_deCOMP_Information_48B_RxByte "Rx Local Ipdu buffer of IPdu -eCOMP_Information_48B_Rx- as a Measurement parameter" UBYTE RB_RBA_Common_CentralElements_CompuMethods_Identical 1 100 0.0 255. FORMAT "%5.0" ECU_ADDRESS 0x60024126 MATRIX_DIM 8 /end MEASUREMENT
/*********** Start of merged FUNCTION blocks ***********/
/begin FUNCTION Com "13.16.3  McFunction Com Created by MCFunctionUpdater"
 /begin DEF_CHARACTERISTIC Com_stCDE_RESEAU_LIN_VCU_TxPduCtrl_C Com_stCLUSTER_5E7_RxPduCtrl_C Com_stCONTEXTE_1_5B2_RxPduCtrl_C Com_stDAT3_BSI_4F2h_RxPduCtrl_C Com_stDAT_TBMU_454_TxPduCtrl_C Com_stDCDC_283h_RxPduCtrl_C Com_stDCDC_293h_RxPduCtrl_C Com_stDCDC_473h_RxPduCtrl_C Com_stDCDC_663h_RxPduCtrl_C Com_stE_VCU_522_TxPduCtrl_C Com_stHS3_AUTO_GEARBOX_SWITCH_REQ_TxPduCtrl_C Com_stHS3_AUTO_GEARBOX_SWITCH_STATUS_RxPduCtrl_C Com_stHSN1_GW_RX_04D_RxPduCtrl_C Com_stHSN1_GW_RX_06D_RxPduCtrl_C Com_stHSN1_GW_RX_0AE_RxPduCtrl_C Com_stHSN1_GW_RX_492_RxPduCtrl_C Com_stHSN1_GW_RX_4B2_RxPduCtrl_C Com_stHSN1_GW_RX_4C8_RxPduCtrl_C Com_stHSN1_GW_RX_4D2_RxPduCtrl_C Com_stHSN3_GW_RX_0A6_RxPduCtrl_C Com_stHSN3_GW_RX_0C6_RxPduCtrl_C Com_stHSN3_GW_RX_0E6_RxPduCtrl_C Com_stHSN3_GW_RX_334_RxPduCtrl_C Com_stHSN3_GW_RX_3F4_RxPduCtrl_C Com_stHSN3_GW_RX_423_RxPduCtrl_C Com_stHSN3_GW_RX_434_RxPduCtrl_C Com_stHSN3_GW_RX_494_RxPduCtrl_C Com_stHSN3_GW_RX_5B1_RxPduCtrl_C Com_stHSN3_GW_RX_615_RxPduCtrl_C Com_stHSN3_GW_RX_625_RxPduCtrl_C Com_stHSN3_GW_RX_66B_RxPduCtrl_C Com_stHSN3_GW_RX_766_RxPduCtrl_C Com_stHSN3_GW_RX_774_RxPduCtrl_C Com_stHVAC_PANEL_26h_RxPduCtrl_C Com_stHVBAT_205h_RxPduCtrl_C Com_stHVBAT_275h_RxPduCtrl_C Com_stHVBAT_285h_RxPduCtrl_C Com_stHVBAT_325h_RxPduCtrl_C Com_stHVBAT_335h_RxPduCtrl_C Com_stHVBAT_455h_RxPduCtrl_C Com_stHVBAT_535_RxPduCtrl_C Com_stHVBAT_595h_RxPduCtrl_C Com_stHVBAT_635h_RxPduCtrl_C Com_stHVBAT_645h_RxPduCtrl_C Com_stHVBAT_665h_RxPduCtrl_C Com_stHVBAT_675h_RxPduCtrl_C Com_stHVBAT_THERMAL_5B5_RxPduCtrl_C Com_stHVBAT_VCU_435h_RxPduCtrl_C Com_stHVBAT_VCU_543_RxPduCtrl_C Com_stHVBAT_VCU_583_RxPduCtrl_C Com_stINV_217h_RxPduCtrl_C Com_stINV_227h_RxPduCtrl_C Com_stINV_237_RxPduCtrl_C Com_stINV_427h_RxPduCtrl_C Com_stINV_497h_RxPduCtrl_C Com_stINV_IMMO_5C7_RxPduCtrl_C Com_stIS_DAT6_BSI_592h_MUX0_RxPduCtrl_C Com_stIS_DAT6_BSI_592h_MUX1_RxPduCtrl_C Com_stIS_DAT6_BSI_592h_MUX2_RxPduCtrl_C Com_stIS_DAT6_BSI_592h_RxPduCtrl_C Com_stIS_DAT_ABR_50Dh_RxPduCtrl_C Com_stIS_DAT_BSI_412h_RxPduCtrl_C Com_stIS_DYN3_CMM_468h_TxPduCtrl_C Com_stIS_DYN_ABR_38Dh_RxPduCtrl_C Com_stIS_DYN_VCU_208h_TxPduCtrl_C Com_stIS_INTE_ELECTRON_BSI_092h_RxPduCtrl_C Com_stOBC_273h_RxPduCtrl_C Com_stOBC_453h_RxPduCtrl_C Com_stOBC_463h_RxPduCtrl_C Com_stPDU_BusVoltages_308_RxPduCtrl_C Com_stPDU_Current_318_RxPduCtrl_C Com_stRMS1_VCU_5C1_TxPduCtrl_C Com_stRMS2_VCU_5C3_TxPduCtrl_C Com_stRMS3_TBMU_5A3_TxPduCtrl_C Com_stRMS5_VCU_563_TxPduCtrl_C Com_stSC_INFO_BCCM_442h_RxPduCtrl_C Com_stVCU_0x50F_TxPduCtrl_C Com_stVCU_211h_TxPduCtrl_C Com_stVCU_221h_TxPduCtrl_C Com_stVCU_241h_TxPduCtrl_C Com_stVCU_25h_TxPduCtrl_C Com_stVCU_262_TxPduCtrl_C Com_stVCU_281h_TxPduCtrl_C Com_stVCU_321h_TxPduCtrl_C Com_stVCU_331h_TxPduCtrl_C Com_stVCU_421h_TxPduCtrl_C Com_stVCU_481h_TxPduCtrl_C Com_stVCU_4A2_TxPduCtrl_C Com_stVCU_501h_TxPduCtrl_C Com_stVCU_5A2_TxPduCtrl_C Com_stVCU_5D1h_TxPduCtrl_C Com_stVCU_5F1h_TxPduCtrl_C Com_stVCU_AIRBAG_351h_RxPduCtrl_C Com_stVCU_CTRL_INPUT_201h_TxPduCtrl_C Com_stVCU_HVAC_231h_TxPduCtrl_C Com_stVCU_INV_491h_TxPduCtrl_C Com_stVCU_VERS_111h_TxPduCtrl_C Com_stVCU_eBCCM_432h_RxPduCtrl_C Com_stVCU_eBCCM_552h_RxPduCtrl_C Com_stVCU_eCOMP_CONTROL_341_TxPduCtrl_C Com_steBCCM_082h_RxPduCtrl_C Com_steCOMP_Information_47B_RxPduCtrl_C Com_steCOMP_Information_48B_RxPduCtrl_C /end DEF_CHARACTERISTIC
 /begin LOC_MEASUREMENT Com_SigType_au16 Com_SigType_au32 Com_SigType_au8 Com_dCDE_RESEAU_LIN_VCU_TxByte Com_dCLUSTER_5E7_RxByte Com_dCONTEXTE_1_5B2_RxByte Com_dDAT3_BSI_4F2h_RxByte Com_dDAT_TBMU_454_TxByte Com_dDCDC_283h_RxByte Com_dDCDC_293h_RxByte Com_dDCDC_473h_RxByte Com_dDCDC_663h_RxByte Com_dE_VCU_522_TxByte Com_dHS3_AUTO_GEARBOX_SWITCH_REQ_TxByte Com_dHS3_AUTO_GEARBOX_SWITCH_STATUS_RxByte Com_dHSN1_GW_RX_04D_RxByte Com_dHSN1_GW_RX_06D_RxByte Com_dHSN1_GW_RX_0AE_RxByte Com_dHSN1_GW_RX_492_RxByte Com_dHSN1_GW_RX_4B2_RxByte Com_dHSN1_GW_RX_4C8_RxByte Com_dHSN1_GW_RX_4D2_RxByte Com_dHSN3_GW_RX_0A6_RxByte Com_dHSN3_GW_RX_0C6_RxByte Com_dHSN3_GW_RX_0E6_RxByte Com_dHSN3_GW_RX_334_RxByte Com_dHSN3_GW_RX_3F4_RxByte Com_dHSN3_GW_RX_423_RxByte Com_dHSN3_GW_RX_434_RxByte Com_dHSN3_GW_RX_494_RxByte Com_dHSN3_GW_RX_5B1_RxByte Com_dHSN3_GW_RX_615_RxByte Com_dHSN3_GW_RX_625_RxByte Com_dHSN3_GW_RX_66B_RxByte Com_dHSN3_GW_RX_766_RxByte Com_dHSN3_GW_RX_774_RxByte Com_dHVAC_PANEL_26h_RxByte Com_dHVBAT_205h_RxByte Com_dHVBAT_275h_RxByte Com_dHVBAT_285h_RxByte Com_dHVBAT_325h_RxByte Com_dHVBAT_335h_RxByte Com_dHVBAT_455h_RxByte Com_dHVBAT_535_RxByte Com_dHVBAT_595h_RxByte Com_dHVBAT_635h_RxByte Com_dHVBAT_645h_RxByte Com_dHVBAT_665h_RxByte Com_dHVBAT_675h_RxByte Com_dHVBAT_THERMAL_5B5_RxByte Com_dHVBAT_VCU_435h_RxByte Com_dHVBAT_VCU_543_RxByte Com_dHVBAT_VCU_583_RxByte Com_dINV_217h_RxByte Com_dINV_227h_RxByte Com_dINV_237_RxByte Com_dINV_427h_RxByte Com_dINV_497h_RxByte Com_dINV_IMMO_5C7_RxByte Com_dIS_DAT6_BSI_592h_MUX0_RxByte Com_dIS_DAT6_BSI_592h_MUX1_RxByte Com_dIS_DAT6_BSI_592h_MUX2_RxByte Com_dIS_DAT6_BSI_592h_RxByte Com_dIS_DAT_ABR_50Dh_RxByte Com_dIS_DAT_BSI_412h_RxByte Com_dIS_DYN3_CMM_468h_TxByte Com_dIS_DYN_ABR_38Dh_RxByte Com_dIS_DYN_VCU_208h_TxByte Com_dIS_INTE_ELECTRON_BSI_092h_RxByte Com_dOBC_273h_RxByte Com_dOBC_453h_RxByte Com_dOBC_463h_RxByte Com_dPDU_BusVoltages_308_RxByte Com_dPDU_Current_318_RxByte Com_dRMS1_VCU_5C1_TxByte Com_dRMS2_VCU_5C3_TxByte Com_dRMS3_TBMU_5A3_TxByte Com_dRMS5_VCU_563_TxByte Com_dSC_INFO_BCCM_442h_RxByte Com_dVCU_0x50F_TxByte Com_dVCU_211h_TxByte Com_dVCU_221h_TxByte Com_dVCU_241h_TxByte Com_dVCU_25h_TxByte Com_dVCU_262_TxByte Com_dVCU_281h_TxByte Com_dVCU_321h_TxByte Com_dVCU_331h_TxByte Com_dVCU_421h_TxByte Com_dVCU_481h_TxByte Com_dVCU_4A2_TxByte Com_dVCU_501h_TxByte Com_dVCU_5A2_TxByte Com_dVCU_5D1h_TxByte Com_dVCU_5F1h_TxByte Com_dVCU_AIRBAG_351h_RxByte Com_dVCU_CTRL_INPUT_201h_TxByte Com_dVCU_HVAC_231h_TxByte Com_dVCU_INV_491h_TxByte Com_dVCU_VERS_111h_TxByte Com_dVCU_eBCCM_432h_RxByte Com_dVCU_eBCCM_552h_RxByte Com_dVCU_eCOMP_CONTROL_341_TxByte Com_deBCCM_082h_RxByte Com_deCOMP_Information_47B_RxByte Com_deCOMP_Information_48B_RxByte /end LOC_MEASUREMENT
 FUNCTION_VERSION "13.16.3" /end FUNCTION
/*********** Start of merged COMPU_METHOD blocks ***********/
/begin COMPU_METHOD RB_RBA_Common_CentralElements_CompuMethods_Identical "The internal value and the physical one are identical. No physical unit available" RAT_FUNC "%10.5" "noUnit" COEFFS 0.0 1.0 0.0 0.0 0.0 1.0 REF_UNIT RB_RBA_Common_CentralElements_Units_NoUnit /end COMPU_METHOD
/begin COMPU_METHOD AUTOSAR_Com_CompuMethods_Com_IPduStatus_enum_type "Computation Method for ComIPdu Calibration Status" TAB_VERB "%10.5" "noUnit" COMPU_TAB_REF AUTOSAR_Com_CompuMethods_Com_IPduStatus_enum_type REF_UNIT AUTOSAR_Com_Units_NoUnit /end COMPU_METHOD
/begin COMPU_METHOD AccGrv "" RAT_FUNC "%6.4" "g" COEFFS 0 100 0 0 0 1 /end COMPU_METHOD
/begin COMPU_VTAB AUTOSAR_Com_CompuMethods_Com_IPduStatus_enum_type "Computation Method for ComIPdu Calibration Status" TAB_VERB 2 0 "INACTIVE" 1 "ACTIVE" /end COMPU_VTAB
/*********** Start of merged RECORD_LAYOUT blocks ***********/
/begin RECORD_LAYOUT DefaultValueRecordLayout_AUTOSAR_Platform_BaseTypes_boolean FNC_VALUES 1 UBYTE COLUMN_DIR DIRECT STATIC_ADDRESS_OFFSETS /end RECORD_LAYOUT
/*********** Start of merged UNIT blocks ***********/
/begin UNIT RB_RBA_Common_CentralElements_Units_NoUnit "No Unit" "noUnit" EXTENDED_SI SI_EXPONENTS 0 0 0 0 0 0 0 /end UNIT
/begin UNIT AUTOSAR_Com_Units_NoUnit "No Unit" "noUnit" EXTENDED_SI SI_EXPONENTS 0 0 0 0 0 0 0 /end UNIT
/*********** End of merged UNIT blocks ***********/
/end MODULE
/end PROJECT

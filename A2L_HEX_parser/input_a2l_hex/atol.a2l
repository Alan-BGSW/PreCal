ASAP2_VERSION 1 70
/begin PROJECT MDG1C "VC1CP091_STLA_N_D061I3"
/begin HEADER "" VERSION "VC1CP091_STLA_N_D061I3" PROJECT_NO MDG1C /end HEADER
/begin MODULE DIM ""
/begin MOD_COMMON "" BYTE_ORDER MSB_LAST ALIGNMENT_BYTE 1 ALIGNMENT_WORD 2 ALIGNMENT_LONG 4 ALIGNMENT_INT64 4 ALIGNMENT_FLOAT32_IEEE 4 ALIGNMENT_FLOAT64_IEEE 4 DATA_SIZE 32 /end MOD_COMMON
/begin MEASUREMENT DFC_b.TST_ComInvld_473h_DCDC_Coolant_Temperature "" UBYTE DFC_OneToOne 1 100 0.00 1.000 BIT_MASK 0x8 FORMAT "%5.3" ECU_ADDRESS 0x60034B97 /end MEASUREMENT
/begin MEASUREMENT DFC_b.TST_ComInvld_473h_DCDC_TEMPERATURE "" UBYTE DFC_OneToOne 1 100 0.00 1.000 BIT_MASK 0x8 FORMAT "%5.3" ECU_ADDRESS 0x60034B98 /end MEASUREMENT
/begin MEASUREMENT DFC_b.TST_ComInvld_47Bh_eCOMP_BusBarCurrent "" UBYTE DFC_OneToOne 1 100 0.00 1.000 BIT_MASK 0x8 FORMAT "%5.3" ECU_ADDRESS 0x60034B99 /end MEASUREMENT
/begin MEASUREMENT DFC_b.TST_ComInvld_47Bh_eCOMP_BusBarVoltage "" UBYTE DFC_OneToOne 1 100 0.00 1.000 BIT_MASK 0x8 FORMAT "%5.3" ECU_ADDRESS 0x60034B9A /end MEASUREMENT
/begin MEASUREMENT DFC_b.TST_ComInvld_47Bh_eCOMP_CompressorSpeed "" UBYTE DFC_OneToOne 1 100 0.00 1.000 BIT_MASK 0x8 FORMAT "%5.3" ECU_ADDRESS 0x60034B9B /end MEASUREMENT
/begin MEASUREMENT DFC_b.TST_ComInvld_47Bh_eCOMP_IGBT_Temp "" UBYTE DFC_OneToOne 1 100 0.00 1.000 BIT_MASK 0x8 FORMAT "%5.3" ECU_ADDRESS 0x60034B9C /end MEASUREMENT
/begin MEASUREMENT DFC_b.TST_ComInvld_47Bh_eCOMP_PeakPhaCurrent "" UBYTE DFC_OneToOne 1 100 0.00 1.000 BIT_MASK 0x8 FORMAT "%5.3" ECU_ADDRESS 0x60034B9D /end MEASUREMENT
/begin MEASUREMENT DFC_b.TST_ComInvld_47Bh_eCOMP_Power_consumption "" UBYTE DFC_OneToOne 1 100 0.00 1.000 BIT_MASK 0x8 FORMAT "%5.3" ECU_ADDRESS 0x60034B9E /end MEASUREMENT
/begin MEASUREMENT DFC_b.TST_ComInvld_4F2h_STATUS_SOC "" UBYTE DFC_OneToOne 1 100 0.00 1.000 BIT_MASK 0x8 FORMAT "%5.3" ECU_ADDRESS 0x60034B9F /end MEASUREMENT
/begin MEASUREMENT DFC_b.TST_ComInvld_4F2h_TEMP_BATT_STATUS "" UBYTE DFC_OneToOne 1 100 0.00 1.000 BIT_MASK 0x8 FORMAT "%5.3" ECU_ADDRESS 0x60034BA0 /end MEASUREMENT
/begin MEASUREMENT DFC_b.TST_ComInvld_4F2h_VALEUR_SOC_ETENDUE "" UBYTE DFC_OneToOne 1 100 0.00 1.000 BIT_MASK 0x8 FORMAT "%5.3" ECU_ADDRESS 0x60034BA1 /end MEASUREMENT
/begin MEASUREMENT DFC_b.TST_ComInvld_535h_HV_BATT_TEMP_AVG "" UBYTE DFC_OneToOne 1 100 0.00 1.000 BIT_MASK 0x8 FORMAT "%5.3" ECU_ADDRESS 0x60034BA2 /end MEASUREMENT
/begin MEASUREMENT DFC_b.TST_ComInvld_543h_HVBAT_RESTBATTENERGY "" UBYTE DFC_OneToOne 1 100 0.00 1.000 BIT_MASK 0x8 FORMAT "%5.3" ECU_ADDRESS 0x60034BA3 /end MEASUREMENT
/begin MEASUREMENT DFC_b.TST_ComInvld_543h_HVBAT_SOH "" UBYTE DFC_OneToOne 1 100 0.00 1.000 BIT_MASK 0x8 FORMAT "%5.3" ECU_ADDRESS 0x60034BA4 /end MEASUREMENT
/begin MEASUREMENT DFC_b.TST_ComInvld_543h_HV_BATT_SOH_RES "" UBYTE DFC_OneToOne 1 100 0.00 1.000 BIT_MASK 0x8 FORMAT "%5.3" ECU_ADDRESS 0x60034BA5 /end MEASUREMENT
/begin MEASUREMENT DFC_b.TST_ComInvld_552h_CPT_TEMPOREL "" UBYTE DFC_OneToOne 1 100 0.00 1.000 BIT_MASK 0x8 FORMAT "%5.3" ECU_ADDRESS 0x60034BA6 /end MEASUREMENT
/begin MEASUREMENT DFC_b.TST_ComInvld_552h_KILOMETRAGE "" UBYTE DFC_OneToOne 1 100 0.00 1.000 BIT_MASK 0x8 FORMAT "%5.3" ECU_ADDRESS 0x60034BA7 /end MEASUREMENT
/begin MEASUREMENT DFC_b.TST_ComInvld_583h_HV_BATT_DISCONT_CSE_OPEN "" UBYTE DFC_OneToOne 1 100 0.00 1.000 BIT_MASK 0x8 FORMAT "%5.3" ECU_ADDRESS 0x60034BA8 /end MEASUREMENT
/begin MEASUREMENT DFC_b.TST_ComInvld_592h_CALIBRE_IBATT "" UBYTE DFC_OneToOne 1 100 0.00 1.000 BIT_MASK 0x8 FORMAT "%5.3" ECU_ADDRESS 0x60034BA9 /end MEASUREMENT
/begin MEASUREMENT DFC_b.TST_ComInvld_592h_IBATT_1 "" UBYTE DFC_OneToOne 1 100 0.00 1.000 BIT_MASK 0x8 FORMAT "%5.3" ECU_ADDRESS 0x60034BAA /end MEASUREMENT
/begin MEASUREMENT DFC_b.TST_ComInvld_592h_IBATT_2 "" UBYTE DFC_OneToOne 1 100 0.00 1.000 BIT_MASK 0x8 FORMAT "%5.3" ECU_ADDRESS 0x60034BAB /end MEASUREMENT
/begin MEASUREMENT DFC_b.TST_ComInvld_592h_IBATT_3 "" UBYTE DFC_OneToOne 1 100 0.00 1.000 BIT_MASK 0x8 FORMAT "%5.3" ECU_ADDRESS 0x60034BAC /end MEASUREMENT
/begin MEASUREMENT DFC_b.TST_ComInvld_592h_TEMP_BATT "" UBYTE DFC_OneToOne 1 100 0.00 1.000 BIT_MASK 0x8 FORMAT "%5.3" ECU_ADDRESS 0x60034BAD /end MEASUREMENT
/begin MEASUREMENT DFC_b.TST_ComInvld_592h_U_BATT_BECB "" UBYTE DFC_OneToOne 1 100 0.00 1.000 BIT_MASK 0x8 FORMAT "%5.3" ECU_ADDRESS 0x60034BAE /end MEASUREMENT
/begin MEASUREMENT DFC_b.TST_ComInvld_595h_HVBAT_TIME_TO_CHRG_80 "" UBYTE DFC_OneToOne 1 100 0.00 1.000 BIT_MASK 0x8 FORMAT "%5.3" ECU_ADDRESS 0x60034BAF /end MEASUREMENT
/begin MEASUREMENT DFC_b.TST_ComInvld_5B2h_TEMP_AIR_EXT "" UBYTE DFC_OneToOne 1 100 0.00 1.000 BIT_MASK 0x8 FORMAT "%5.3" ECU_ADDRESS 0x60034BB0 /end MEASUREMENT
/begin MEASUREMENT DFC_b.TST_ComInvld_5B5h_HVBAT_THERMAL_RUNAWAY "" UBYTE DFC_OneToOne 1 100 0.00 1.000 BIT_MASK 0x8 FORMAT "%5.3" ECU_ADDRESS 0x60034BB1 /end MEASUREMENT
/begin MEASUREMENT DFC_b.TST_ComInvld_635h_HVBAT_NEG_CONT_COUNT_SEG1 "" UBYTE DFC_OneToOne 1 100 0.00 1.000 BIT_MASK 0x8 FORMAT "%5.3" ECU_ADDRESS 0x60034BB2 /end MEASUREMENT
/begin MEASUREMENT DFC_b.TST_ComInvld_635h_HVBAT_NEG_CONT_COUNT_SEG3 "" UBYTE DFC_OneToOne 1 100 0.00 1.000 BIT_MASK 0x8 FORMAT "%5.3" ECU_ADDRESS 0x60034BB3 /end MEASUREMENT
/begin MEASUREMENT DFC_b.TST_ComInvld_635h_HVBAT_NEG_CONT_COUNT_SEG4 "" UBYTE DFC_OneToOne 1 100 0.00 1.000 BIT_MASK 0x8 FORMAT "%5.3" ECU_ADDRESS 0x60034BB4 /end MEASUREMENT
/begin MEASUREMENT DFC_b.TST_ComInvld_635h_HVBAT_PST_CONT_COUNT_SEG1 "" UBYTE DFC_OneToOne 1 100 0.00 1.000 BIT_MASK 0x8 FORMAT "%5.3" ECU_ADDRESS 0x60034BB5 /end MEASUREMENT
/begin MEASUREMENT DFC_b.TST_ComInvld_635h_HVBAT_PST_CONT_COUNT_SEG3 "" UBYTE DFC_OneToOne 1 100 0.00 1.000 BIT_MASK 0x8 FORMAT "%5.3" ECU_ADDRESS 0x60034BB6 /end MEASUREMENT
/begin MEASUREMENT DFC_b.TST_ComInvld_635h_HVBAT_PST_CONT_COUNT_SEG4 "" UBYTE DFC_OneToOne 1 100 0.00 1.000 BIT_MASK 0x8 FORMAT "%5.3" ECU_ADDRESS 0x60034BB7 /end MEASUREMENT
/begin MEASUREMENT DFC_b.TST_ComInvld_645h_HVBAT_PRECHRGE_CONT_COUNT_SEG1 "" UBYTE DFC_OneToOne 1 100 0.00 1.000 BIT_MASK 0x8 FORMAT "%5.3" ECU_ADDRESS 0x60034BB8 /end MEASUREMENT
/begin MEASUREMENT DFC_b.TST_ComInvld_645h_HVBAT_PRECHRGE_CONT_COUNT_SEG2 "" UBYTE DFC_OneToOne 1 100 0.00 1.000 BIT_MASK 0x8 FORMAT "%5.3" ECU_ADDRESS 0x60034BB9 /end MEASUREMENT
/begin MEASUREMENT DFC_b.TST_ComInvld_675h_HVBAT_REMAININGBATTCAPACITY "" UBYTE DFC_OneToOne 1 100 0.00 1.000 BIT_MASK 0x8 FORMAT "%5.3" ECU_ADDRESS 0x60034BBA /end MEASUREMENT
/begin MEASUREMENT DFC_b.TST_ACCmprFltLvl1 "" UBYTE DFC_OneToOne 1 100 0.00 1.000 BIT_MASK 0x8 FORMAT "%5.3" ECU_ADDRESS 0x60034BBB /end MEASUREMENT
/begin MEASUREMENT DFC_b.TST_ACCmprFltLvl2 "" UBYTE DFC_OneToOne 1 100 0.00 1.000 BIT_MASK 0x8 FORMAT "%5.3" ECU_ADDRESS 0x60034BBC /end MEASUREMENT
/begin MEASUREMENT DFC_b.TST_ACCmprFltLvl3 "" UBYTE DFC_OneToOne 1 100 0.00 1.000 BIT_MASK 0x8 FORMAT "%5.3" ECU_ADDRESS 0x60034BBD /end MEASUREMENT
/begin MEASUREMENT DFC_b.TST_ACCmprFltLvl4 "" UBYTE DFC_OneToOne 1 100 0.00 1.000 BIT_MASK 0x8 FORMAT "%5.3" ECU_ADDRESS 0x60034BBE /end MEASUREMENT
/begin MEASUREMENT DFC_b.TST_ACCmprHiPFlt "" UBYTE DFC_OneToOne 1 100 0.00 1.000 BIT_MASK 0x8 FORMAT "%5.3" ECU_ADDRESS 0x60034BBF /end MEASUREMENT
/begin MEASUREMENT DFC_b.TST_ACCmprInvldCmprSt "" UBYTE DFC_OneToOne 1 100 0.00 1.000 BIT_MASK 0x8 FORMAT "%5.3" ECU_ADDRESS 0x60034BC0 /end MEASUREMENT
/begin MEASUREMENT DFC_b.TST_ACCmprInvldElecActPwr "" UBYTE DFC_OneToOne 1 100 0.00 1.000 BIT_MASK 0x8 FORMAT "%5.3" ECU_ADDRESS 0x60034BC1 /end MEASUREMENT
/begin MEASUREMENT DFC_b.TST_ACCmprLoPFlt "" UBYTE DFC_OneToOne 1 100 0.00 1.000 BIT_MASK 0x8 FORMAT "%5.3" ECU_ADDRESS 0x60034BC2 /end MEASUREMENT
/begin MEASUREMENT DFC_b.TST_AcChrgrIntkTSRCMin "" UBYTE DFC_OneToOne 1 100 0.00 1.000 BIT_MASK 0x8 FORMAT "%5.3" ECU_ADDRESS 0x60034BC3 /end MEASUREMENT
/begin MEASUREMENT DFC_b.TST_BattUBMaxBatt "" UBYTE DFC_OneToOne 1 100 0.00 1.000 BIT_MASK 0x8 FORMAT "%5.3" ECU_ADDRESS 0x60034BC4 /end MEASUREMENT
/begin MEASUREMENT DFC_b.TST_BattUBMaxNoBatt "" UBYTE DFC_OneToOne 1 100 0.00 1.000 BIT_MASK 0x8 FORMAT "%5.3" ECU_ADDRESS 0x60034BC5 /end MEASUREMENT
/begin MEASUREMENT DFC_b.TST_BattUBMinBatt "" UBYTE DFC_OneToOne 1 100 0.00 1.000 BIT_MASK 0x8 FORMAT "%5.3" ECU_ADDRESS 0x60034BC6 /end MEASUREMENT
/begin MEASUREMENT DFC_b.TST_BattUBMinNoBatt "" UBYTE DFC_OneToOne 1 100 0.00 1.000 BIT_MASK 0x8 FORMAT "%5.3" ECU_ADDRESS 0x60034BC7 /end MEASUREMENT
/begin MEASUREMENT DFC_b.TST_BattUSRCMax "" UBYTE DFC_OneToOne 1 100 0.00 1.000 BIT_MASK 0x8 FORMAT "%5.3" ECU_ADDRESS 0x60034BC8 /end MEASUREMENT
/begin MEASUREMENT DFC_b.TST_BattUSRCMin "" UBYTE DFC_OneToOne 1 100 0.00 1.000 BIT_MASK 0x8 FORMAT "%5.3" ECU_ADDRESS 0x60034BC9 /end MEASUREMENT
/begin MEASUREMENT DFC_b.TST_BrkBstPHiCautionDfct "" UBYTE DFC_OneToOne 1 100 0.00 1.000 BIT_MASK 0x8 FORMAT "%5.3" ECU_ADDRESS 0x60034BCA /end MEASUREMENT
/begin MEASUREMENT DFC_b.TST_BrkBstPHiWarnDfct "" UBYTE DFC_OneToOne 1 100 0.00 1.000 BIT_MASK 0x8 FORMAT "%5.3" ECU_ADDRESS 0x60034BCB /end MEASUREMENT
/begin MEASUREMENT DFC_b.TST_BrkBstPSnsr12PlausDfct "" UBYTE DFC_OneToOne 1 100 0.00 1.000 BIT_MASK 0x8 FORMAT "%5.3" ECU_ADDRESS 0x60034BCC /end MEASUREMENT
/begin MEASUREMENT DFC_b.TST_BrkBstPSnsr1Scb "" UBYTE DFC_OneToOne 1 100 0.00 1.000 BIT_MASK 0x8 FORMAT "%5.3" ECU_ADDRESS 0x60034BCD /end MEASUREMENT
/begin MEASUREMENT DFC_b.TST_BrkBstPSnsr1Scg "" UBYTE DFC_OneToOne 1 100 0.00 1.000 BIT_MASK 0x8 FORMAT "%5.3" ECU_ADDRESS 0x60034BCE /end MEASUREMENT
/begin MEASUREMENT DFC_b.TST_BrkBstPSnsr2Scb "" UBYTE DFC_OneToOne 1 100 0.00 1.000 BIT_MASK 0x8 FORMAT "%5.3" ECU_ADDRESS 0x60034BCF /end MEASUREMENT
/begin MEASUREMENT DFC_b.TST_BrkBstPSnsr2Scg "" UBYTE DFC_OneToOne 1 100 0.00 1.000 BIT_MASK 0x8 FORMAT "%5.3" ECU_ADDRESS 0x60034BD0 /end MEASUREMENT
/begin MEASUREMENT DFC_b.TST_BrkBstPSnsrMax "" UBYTE DFC_OneToOne 1 100 0.00 1.000 BIT_MASK 0x8 FORMAT "%5.3" ECU_ADDRESS 0x60034BD1 /end MEASUREMENT
/begin MEASUREMENT DFC_b.TST_BrkBstPSnsrMin "" UBYTE DFC_OneToOne 1 100 0.00 1.000 BIT_MASK 0x8 FORMAT "%5.3" ECU_ADDRESS 0x60034BD2 /end MEASUREMENT
/begin MEASUREMENT DFC_b.TST_BrkBstPhyRngChkMax "" UBYTE DFC_OneToOne 1 100 0.00 1.000 BIT_MASK 0x8 FORMAT "%5.3" ECU_ADDRESS 0x60034BD3 /end MEASUREMENT
/begin MEASUREMENT DFC_b.TST_BrkBstPhyRngChkMin "" UBYTE DFC_OneToOne 1 100 0.00 1.000 BIT_MASK 0x8 FORMAT "%5.3" ECU_ADDRESS 0x60034BD4 /end MEASUREMENT
/begin MEASUREMENT DFC_b.TST_BrkBstPmpHsScb "" UBYTE DFC_OneToOne 1 100 0.00 1.000 BIT_MASK 0x8 FORMAT "%5.3" ECU_ADDRESS 0x60034BD5 /end MEASUREMENT
/begin MEASUREMENT DFC_b.TST_BrkBstPmpHsScg "" UBYTE DFC_OneToOne 1 100 0.00 1.000 BIT_MASK 0x8 FORMAT "%5.3" ECU_ADDRESS 0x60034BD6 /end MEASUREMENT
/begin MEASUREMENT DFC_b.TST_BrkBstPmpLsOl "" UBYTE DFC_OneToOne 1 100 0.00 1.000 BIT_MASK 0x8 FORMAT "%5.3" ECU_ADDRESS 0x60034BD7 /end MEASUREMENT
/begin MEASUREMENT DFC_b.TST_BrkBstPmpLsScb "" UBYTE DFC_OneToOne 1 100 0.00 1.000 BIT_MASK 0x8 FORMAT "%5.3" ECU_ADDRESS 0x60034BD8 /end MEASUREMENT
/begin MEASUREMENT DFC_b.TST_BrkBstPmpLsScg "" UBYTE DFC_OneToOne 1 100 0.00 1.000 BIT_MASK 0x8 FORMAT "%5.3" ECU_ADDRESS 0x60034BD9 /end MEASUREMENT
/begin MEASUREMENT DFC_b.TST_CbnHeatgHeatrRlyOpend "" UBYTE DFC_OneToOne 1 100 0.00 1.000 BIT_MASK 0x8 FORMAT "%5.3" ECU_ADDRESS 0x60034BDA /end MEASUREMENT
/begin MEASUREMENT DFC_b.TST_CbnHeatgHeatrRlyWldd "" UBYTE DFC_OneToOne 1 100 0.00 1.000 BIT_MASK 0x8 FORMAT "%5.3" ECU_ADDRESS 0x60034BDB /end MEASUREMENT
/begin MEASUREMENT DFC_b.TST_CcsDcIBattExcdd "" UBYTE DFC_OneToOne 1 100 0.00 1.000 BIT_MASK 0x8 FORMAT "%5.3" ECU_ADDRESS 0x60034BDC /end MEASUREMENT
/begin MEASUREMENT DFC_b.TST_CcsDcIEvseOutDe "" UBYTE DFC_OneToOne 1 100 0.00 1.000 BIT_MASK 0x8 FORMAT "%5.3" ECU_ADDRESS 0x60034BDD /end MEASUREMENT
/begin MEASUREMENT DFC_b.TST_CcsDcIOutDe "" UBYTE DFC_OneToOne 1 100 0.00 1.000 BIT_MASK 0x8 FORMAT "%5.3" ECU_ADDRESS 0x60034BDE /end MEASUREMENT
/begin MEASUREMENT DFC_b.TST_CcsDcIOutExcdd "" UBYTE DFC_OneToOne 1 100 0.00 1.000 BIT_MASK 0x8 FORMAT "%5.3" ECU_ADDRESS 0x60034BDF /end MEASUREMENT
/begin MEASUREMENT DFC_b.TST_CcsDcUOutDe "" UBYTE DFC_OneToOne 1 100 0.00 1.000 BIT_MASK 0x8 FORMAT "%5.3" ECU_ADDRESS 0x60034BE0 /end MEASUREMENT
/begin MEASUREMENT DFC_b.TST_CcsDcUOutExcdd "" UBYTE DFC_OneToOne 1 100 0.00 1.000 BIT_MASK 0x8 FORMAT "%5.3" ECU_ADDRESS 0x60034BE1 /end MEASUREMENT
/begin MEASUREMENT DFC_b.TST_CcsPwrLineChpRstOL "" UBYTE DFC_OneToOne 1 100 0.00 1.000 BIT_MASK 0x8 FORMAT "%5.3" ECU_ADDRESS 0x60034BE2 /end MEASUREMENT
/begin MEASUREMENT DFC_b.TST_CcsPwrLineChpRstOvrTemp "" UBYTE DFC_OneToOne 1 100 0.00 1.000 BIT_MASK 0x8 FORMAT "%5.3" ECU_ADDRESS 0x60034BE3 /end MEASUREMENT
/begin MEASUREMENT DFC_b.TST_CcsPwrLineChpRstSCB "" UBYTE DFC_OneToOne 1 100 0.00 1.000 BIT_MASK 0x8 FORMAT "%5.3" ECU_ADDRESS 0x60034BE4 /end MEASUREMENT
/begin MEASUREMENT DFC_b.TST_CcsPwrLineChpRstSCG "" UBYTE DFC_OneToOne 1 100 0.00 1.000 BIT_MASK 0x8 FORMAT "%5.3" ECU_ADDRESS 0x60034BE5 /end MEASUREMENT
/begin MEASUREMENT DFC_b.TST_CcsPwrLineChpVccEnaOL "" UBYTE DFC_OneToOne 1 100 0.00 1.000 BIT_MASK 0x8 FORMAT "%5.3" ECU_ADDRESS 0x60034BE6 /end MEASUREMENT
/begin MEASUREMENT DFC_b.TST_CcsPwrLineChpVccEnaOvrTemp "" UBYTE DFC_OneToOne 1 100 0.00 1.000 BIT_MASK 0x8 FORMAT "%5.3" ECU_ADDRESS 0x60034BE7 /end MEASUREMENT
/begin MEASUREMENT DFC_b.TST_CcsPwrLineChpVccEnaSCB "" UBYTE DFC_OneToOne 1 100 0.00 1.000 BIT_MASK 0x8 FORMAT "%5.3" ECU_ADDRESS 0x60034BE8 /end MEASUREMENT
/begin MEASUREMENT DFC_b.TST_CcsPwrLineChpVccEnaSCG "" UBYTE DFC_OneToOne 1 100 0.00 1.000 BIT_MASK 0x8 FORMAT "%5.3" ECU_ADDRESS 0x60034BE9 /end MEASUREMENT
/begin MEASUREMENT DFC_b.TST_CcsPwrLineChpVccSRCMin "" UBYTE DFC_OneToOne 1 100 0.00 1.000 BIT_MASK 0x8 FORMAT "%5.3" ECU_ADDRESS 0x60034BEA /end MEASUREMENT
/begin MEASUREMENT DFC_b.TST_CcsPwrLineComChpTSRCMin "" UBYTE DFC_OneToOne 1 100 0.00 1.000 BIT_MASK 0x8 FORMAT "%5.3" ECU_ADDRESS 0x60034BEB /end MEASUREMENT
/begin MEASUREMENT DFC_b.TST_CtPSwtActrOL "" UBYTE DFC_OneToOne 1 100 0.00 1.000 BIT_MASK 0x8 FORMAT "%5.3" ECU_ADDRESS 0x60034BEC /end MEASUREMENT
/begin MEASUREMENT DFC_b.TST_CtPSwtActrOvrTemp "" UBYTE DFC_OneToOne 1 100 0.00 1.000 BIT_MASK 0x8 FORMAT "%5.3" ECU_ADDRESS 0x60034BED /end MEASUREMENT
/begin MEASUREMENT DFC_b.TST_CtPSwtActrSCB "" UBYTE DFC_OneToOne 1 100 0.00 1.000 BIT_MASK 0x8 FORMAT "%5.3" ECU_ADDRESS 0x60034BEE /end MEASUREMENT
/begin MEASUREMENT DFC_b.TST_CtPSwtActrSCG "" UBYTE DFC_OneToOne 1 100 0.00 1.000 BIT_MASK 0x8 FORMAT "%5.3" ECU_ADDRESS 0x60034BEF /end MEASUREMENT
/begin MEASUREMENT DFC_b.TST_CtPSwtDiagSRCMin "" UBYTE DFC_OneToOne 1 100 0.00 1.000 BIT_MASK 0x8 FORMAT "%5.3" ECU_ADDRESS 0x60034BF0 /end MEASUREMENT
/begin MEASUREMENT DFC_b.TST_CtpCarrFrqSRCMin "" UBYTE DFC_OneToOne 1 100 0.00 1.000 BIT_MASK 0x8 FORMAT "%5.3" ECU_ADDRESS 0x60034BF1 /end MEASUREMENT
/begin MEASUREMENT DFC_b.TST_DcChrgrIntkT2SRCMin "" UBYTE DFC_OneToOne 1 100 0.00 1.000 BIT_MASK 0x8 FORMAT "%5.3" ECU_ADDRESS 0x60034BF2 /end MEASUREMENT
/begin MEASUREMENT DFC_b.TST_DcChrgrIntkTSRCMin "" UBYTE DFC_OneToOne 1 100 0.00 1.000 BIT_MASK 0x8 FORMAT "%5.3" ECU_ADDRESS 0x60034BF3 /end MEASUREMENT
/begin MEASUREMENT DFC_b.TST_DevLibBattUHi "" UBYTE DFC_OneToOne 1 100 0.00 1.000 BIT_MASK 0x8 FORMAT "%5.3" ECU_ADDRESS 0x60034BF4 /end MEASUREMENT
/begin MEASUREMENT DFC_b.TST_DevLibBattULo "" UBYTE DFC_OneToOne 1 100 0.00 1.000 BIT_MASK 0x8 FORMAT "%5.3" ECU_ADDRESS 0x60034BF5 /end MEASUREMENT
/begin MEASUREMENT DFC_b.TST_EmWakeupSigOL "" UBYTE DFC_OneToOne 1 100 0.00 1.000 BIT_MASK 0x8 FORMAT "%5.3" ECU_ADDRESS 0x60034BF6 /end MEASUREMENT
/begin MEASUREMENT DFC_b.TST_EmWakeupSigOvrTemp "" UBYTE DFC_OneToOne 1 100 0.00 1.000 BIT_MASK 0x8 FORMAT "%5.3" ECU_ADDRESS 0x60034BF7 /end MEASUREMENT
/begin MEASUREMENT DFC_b.TST_EmWakeupSigSCB "" UBYTE DFC_OneToOne 1 100 0.00 1.000 BIT_MASK 0x8 FORMAT "%5.3" ECU_ADDRESS 0x60034BF8 /end MEASUREMENT
/begin MEASUREMENT DFC_b.TST_EmWakeupSigSCG "" UBYTE DFC_OneToOne 1 100 0.00 1.000 BIT_MASK 0x8 FORMAT "%5.3" ECU_ADDRESS 0x60034BF9 /end MEASUREMENT
/begin MEASUREMENT DFC_b.TST_Fan1OL "" UBYTE DFC_OneToOne 1 100 0.00 1.000 BIT_MASK 0x8 FORMAT "%5.3" ECU_ADDRESS 0x60034BFA /end MEASUREMENT
/begin MEASUREMENT DFC_b.TST_Fan1OvrTemp "" UBYTE DFC_OneToOne 1 100 0.00 1.000 BIT_MASK 0x8 FORMAT "%5.3" ECU_ADDRESS 0x60034BFB /end MEASUREMENT
/begin MEASUREMENT DFC_b.TST_Fan1SCB "" UBYTE DFC_OneToOne 1 100 0.00 1.000 BIT_MASK 0x8 FORMAT "%5.3" ECU_ADDRESS 0x60034BFC /end MEASUREMENT
/begin MEASUREMENT DFC_b.TST_FanRlySCB "" UBYTE DFC_OneToOne 1 100 0.00 1.000 BIT_MASK 0x8 FORMAT "%5.3" ECU_ADDRESS 0x60034BFD /end MEASUREMENT
/begin MEASUREMENT DFC_b.TST_FanRlySCG "" UBYTE DFC_OneToOne 1 100 0.00 1.000 BIT_MASK 0x8 FORMAT "%5.3" ECU_ADDRESS 0x60034BFE /end MEASUREMENT
/begin MEASUREMENT DFC_b.TST_FanSpdSRCMin "" UBYTE DFC_OneToOne 1 100 0.00 1.000 BIT_MASK 0x8 FORMAT "%5.3" ECU_ADDRESS 0x60034BFF /end MEASUREMENT
/begin MEASUREMENT DFC_b.TST_FreonPSRCMin "" UBYTE DFC_OneToOne 1 100 0.00 1.000 BIT_MASK 0x8 FORMAT "%5.3" ECU_ADDRESS 0x60034C00 /end MEASUREMENT
/begin MEASUREMENT DFC_b.TST_HLCCcsPLnCChipTHi "" UBYTE DFC_OneToOne 1 100 0.00 1.000 BIT_MASK 0x8 FORMAT "%5.3" ECU_ADDRESS 0x60034C01 /end MEASUREMENT
/begin MEASUREMENT DFC_b.TST_HeatrCoreTSRCMin "" UBYTE DFC_OneToOne 1 100 0.00 1.000 BIT_MASK 0x8 FORMAT "%5.3" ECU_ADDRESS 0x60034C02 /end MEASUREMENT
/begin MEASUREMENT DFC_b.TST_PwmCtPSRCMin "" UBYTE DFC_OneToOne 1 100 0.00 1.000 BIT_MASK 0x8 FORMAT "%5.3" ECU_ADDRESS 0x60034C03 /end MEASUREMENT
/begin MEASUREMENT DFC_b.TST_PwrDistbnUnitTSRCMin "" UBYTE DFC_OneToOne 1 100 0.00 1.000 BIT_MASK 0x8 FORMAT "%5.3" ECU_ADDRESS 0x60034C04 /end MEASUREMENT
/begin MEASUREMENT DFC_b.TST_SCtPmp1OL "" UBYTE DFC_OneToOne 1 100 0.00 1.000 BIT_MASK 0x8 FORMAT "%5.3" ECU_ADDRESS 0x60034C05 /end MEASUREMENT
/begin MEASUREMENT DFC_b.TST_SCtPmp1OvrTemp "" UBYTE DFC_OneToOne 1 100 0.00 1.000 BIT_MASK 0x8 FORMAT "%5.3" ECU_ADDRESS 0x60034C06 /end MEASUREMENT
/begin MEASUREMENT DFC_b.TST_SCtPmp1SCB "" UBYTE DFC_OneToOne 1 100 0.00 1.000 BIT_MASK 0x8 FORMAT "%5.3" ECU_ADDRESS 0x60034C07 /end MEASUREMENT
/begin MEASUREMENT DFC_b.TST_SCtPmpRlyOL "" UBYTE DFC_OneToOne 1 100 0.00 1.000 BIT_MASK 0x8 FORMAT "%5.3" ECU_ADDRESS 0x60034C08 /end MEASUREMENT
/begin MEASUREMENT DFC_b.TST_SCtPmpRlyOvrTemp "" UBYTE DFC_OneToOne 1 100 0.00 1.000 BIT_MASK 0x8 FORMAT "%5.3" ECU_ADDRESS 0x60034C09 /end MEASUREMENT
/begin MEASUREMENT DFC_b.TST_SCtPmpRlySCB "" UBYTE DFC_OneToOne 1 100 0.00 1.000 BIT_MASK 0x8 FORMAT "%5.3" ECU_ADDRESS 0x60034C0A /end MEASUREMENT
/begin MEASUREMENT DFC_b.TST_SpplCooltPmpRlyOL "" UBYTE DFC_OneToOne 1 100 0.00 1.000 BIT_MASK 0x8 FORMAT "%5.3" ECU_ADDRESS 0x60034C0B /end MEASUREMENT
/begin MEASUREMENT DFC_b.TST_SpplCooltPmpRlyOvrTemp "" UBYTE DFC_OneToOne 1 100 0.00 1.000 BIT_MASK 0x8 FORMAT "%5.3" ECU_ADDRESS 0x60034C0C /end MEASUREMENT
/begin MEASUREMENT DFC_b.TST_SpplCooltPmpRlySCB "" UBYTE DFC_OneToOne 1 100 0.00 1.000 BIT_MASK 0x8 FORMAT "%5.3" ECU_ADDRESS 0x60034C0D /end MEASUREMENT
/begin MEASUREMENT DFC_b.TST_UCtPSRCMin "" UBYTE DFC_OneToOne 1 100 0.00 1.000 BIT_MASK 0x8 FORMAT "%5.3" ECU_ADDRESS 0x60034C0E /end MEASUREMENT
/begin MEASUREMENT DFC_b.TST_UPxP1SRCMin "" UBYTE DFC_OneToOne 1 100 0.00 1.000 BIT_MASK 0x8 FORMAT "%5.3" ECU_ADDRESS 0x60034C0F /end MEASUREMENT
/begin MEASUREMENT DFC_b.TST_ComHSN1CANMute "" UBYTE DFC_OneToOne 1 100 0.00 1.000 BIT_MASK 0x8 FORMAT "%5.3" ECU_ADDRESS 0x60034C10 /end MEASUREMENT
/begin MEASUREMENT DFC_b.TST_ComHSN3CANMute "" UBYTE DFC_OneToOne 1 100 0.00 1.000 BIT_MASK 0x8 FORMAT "%5.3" ECU_ADDRESS 0x60034C11 /end MEASUREMENT
/begin MEASUREMENT DFC_b.TST_AcChrgrIntkTPhysRngHi "" UBYTE DFC_OneToOne 1 100 0.00 1.000 BIT_MASK 0x8 FORMAT "%5.3" ECU_ADDRESS 0x60034C12 /end MEASUREMENT
/begin MEASUREMENT DFC_b.TST_AcChrgrIntkTPhysRngLo "" UBYTE DFC_OneToOne 1 100 0.00 1.000 BIT_MASK 0x8 FORMAT "%5.3" ECU_ADDRESS 0x60034C13 /end MEASUREMENT
/begin MEASUREMENT DFC_b.TST_AcChrgrIntkTSRCOpn "" UBYTE DFC_OneToOne 1 100 0.00 1.000 BIT_MASK 0x8 FORMAT "%5.3" ECU_ADDRESS 0x60034C14 /end MEASUREMENT
/begin MEASUREMENT DFC_b.TST_CcsPwrLineChpVccPhysRngHi "" UBYTE DFC_OneToOne 1 100 0.00 1.000 BIT_MASK 0x8 FORMAT "%5.3" ECU_ADDRESS 0x60034C15 /end MEASUREMENT
/begin MEASUREMENT DFC_b.TST_CcsPwrLineChpVccPhysRngLo "" UBYTE DFC_OneToOne 1 100 0.00 1.000 BIT_MASK 0x8 FORMAT "%5.3" ECU_ADDRESS 0x60034C16 /end MEASUREMENT
/begin MEASUREMENT DFC_b.TST_CcsPwrLineChpVccSRCOpn "" UBYTE DFC_OneToOne 1 100 0.00 1.000 BIT_MASK 0x8 FORMAT "%5.3" ECU_ADDRESS 0x60034C17 /end MEASUREMENT
/begin MEASUREMENT DFC_b.TST_CcsPwrLineComChpTPhysRngHi "" UBYTE DFC_OneToOne 1 100 0.00 1.000 BIT_MASK 0x8 FORMAT "%5.3" ECU_ADDRESS 0x60034C18 /end MEASUREMENT
/begin MEASUREMENT DFC_b.TST_CcsPwrLineComChpTPhysRngLo "" UBYTE DFC_OneToOne 1 100 0.00 1.000 BIT_MASK 0x8 FORMAT "%5.3" ECU_ADDRESS 0x60034C19 /end MEASUREMENT
/begin MEASUREMENT DFC_b.TST_CcsPwrLineComChpTSRCOpn "" UBYTE DFC_OneToOne 1 100 0.00 1.000 BIT_MASK 0x8 FORMAT "%5.3" ECU_ADDRESS 0x60034C1A /end MEASUREMENT
/begin MEASUREMENT DFC_b.TST_CtPSwtDiagPhysRngHi "" UBYTE DFC_OneToOne 1 100 0.00 1.000 BIT_MASK 0x8 FORMAT "%5.3" ECU_ADDRESS 0x60034C1B /end MEASUREMENT
/begin MEASUREMENT DFC_b.TST_CtPSwtDiagPhysRngLo "" UBYTE DFC_OneToOne 1 100 0.00 1.000 BIT_MASK 0x8 FORMAT "%5.3" ECU_ADDRESS 0x60034C1C /end MEASUREMENT
/begin MEASUREMENT DFC_b.TST_CtPSwtDiagSRCOpn "" UBYTE DFC_OneToOne 1 100 0.00 1.000 BIT_MASK 0x8 FORMAT "%5.3" ECU_ADDRESS 0x60034C1D /end MEASUREMENT
/begin MEASUREMENT DFC_b.TST_CtpCarrFrqPhysRngHi "" UBYTE DFC_OneToOne 1 100 0.00 1.000 BIT_MASK 0x8 FORMAT "%5.3" ECU_ADDRESS 0x60034C1E /end MEASUREMENT
/begin MEASUREMENT DFC_b.TST_CtpCarrFrqPhysRngLo "" UBYTE DFC_OneToOne 1 100 0.00 1.000 BIT_MASK 0x8 FORMAT "%5.3" ECU_ADDRESS 0x60034C1F /end MEASUREMENT
/begin MEASUREMENT DFC_b.TST_CtpCarrFrqSRCMax "" UBYTE DFC_OneToOne 1 100 0.00 1.000 BIT_MASK 0x8 FORMAT "%5.3" ECU_ADDRESS 0x60034C20 /end MEASUREMENT
/begin MEASUREMENT DFC_b.TST_DcChrgrIntkT2PhysRngHi "" UBYTE DFC_OneToOne 1 100 0.00 1.000 BIT_MASK 0x8 FORMAT "%5.3" ECU_ADDRESS 0x60034C21 /end MEASUREMENT
/begin MEASUREMENT DFC_b.TST_DcChrgrIntkT2PhysRngLo "" UBYTE DFC_OneToOne 1 100 0.00 1.000 BIT_MASK 0x8 FORMAT "%5.3" ECU_ADDRESS 0x60034C22 /end MEASUREMENT
/begin MEASUREMENT DFC_b.TST_DcChrgrIntkT2SRCOpn "" UBYTE DFC_OneToOne 1 100 0.00 1.000 BIT_MASK 0x8 FORMAT "%5.3" ECU_ADDRESS 0x60034C23 /end MEASUREMENT
/begin MEASUREMENT DFC_b.TST_DcChrgrIntkTPhysRngHi "" UBYTE DFC_OneToOne 1 100 0.00 1.000 BIT_MASK 0x8 FORMAT "%5.3" ECU_ADDRESS 0x60034C24 /end MEASUREMENT
/begin MEASUREMENT DFC_b.TST_DcChrgrIntkTPhysRngLo "" UBYTE DFC_OneToOne 1 100 0.00 1.000 BIT_MASK 0x8 FORMAT "%5.3" ECU_ADDRESS 0x60034C25 /end MEASUREMENT
/begin MEASUREMENT DFC_b.TST_DcChrgrIntkTSRCOpn "" UBYTE DFC_OneToOne 1 100 0.00 1.000 BIT_MASK 0x8 FORMAT "%5.3" ECU_ADDRESS 0x60034C26 /end MEASUREMENT
/begin MEASUREMENT DFC_b.TST_Fan1SCG "" UBYTE DFC_OneToOne 1 100 0.00 1.000 BIT_MASK 0x8 FORMAT "%5.3" ECU_ADDRESS 0x60034C27 /end MEASUREMENT
/begin MEASUREMENT DFC_b.TST_FanSpdPhysRngHi "" UBYTE DFC_OneToOne 1 100 0.00 1.000 BIT_MASK 0x8 FORMAT "%5.3" ECU_ADDRESS 0x60034C28 /end MEASUREMENT
/begin MEASUREMENT DFC_b.TST_FanSpdPhysRngLo "" UBYTE DFC_OneToOne 1 100 0.00 1.000 BIT_MASK 0x8 FORMAT "%5.3" ECU_ADDRESS 0x60034C29 /end MEASUREMENT
/begin MEASUREMENT DFC_b.TST_FanSpdSRCOpn "" UBYTE DFC_OneToOne 1 100 0.00 1.000 BIT_MASK 0x8 FORMAT "%5.3" ECU_ADDRESS 0x60034C2A /end MEASUREMENT
/begin MEASUREMENT DFC_b.TST_FreonPPhysRngHi "" UBYTE DFC_OneToOne 1 100 0.00 1.000 BIT_MASK 0x8 FORMAT "%5.3" ECU_ADDRESS 0x60034C2B /end MEASUREMENT
/begin MEASUREMENT DFC_b.TST_FreonPPhysRngLo "" UBYTE DFC_OneToOne 1 100 0.00 1.000 BIT_MASK 0x8 FORMAT "%5.3" ECU_ADDRESS 0x60034C2C /end MEASUREMENT
/begin MEASUREMENT DFC_b.TST_FreonPSRCOpn "" UBYTE DFC_OneToOne 1 100 0.00 1.000 BIT_MASK 0x8 FORMAT "%5.3" ECU_ADDRESS 0x60034C2D /end MEASUREMENT
/begin MEASUREMENT DFC_b.TST_HeatrCoreTPhysRngHi "" UBYTE DFC_OneToOne 1 100 0.00 1.000 BIT_MASK 0x8 FORMAT "%5.3" ECU_ADDRESS 0x60034C2E /end MEASUREMENT
/begin MEASUREMENT DFC_b.TST_HeatrCoreTPhysRngLo "" UBYTE DFC_OneToOne 1 100 0.00 1.000 BIT_MASK 0x8 FORMAT "%5.3" ECU_ADDRESS 0x60034C2F /end MEASUREMENT
/begin MEASUREMENT DFC_b.TST_HeatrCoreTSRCOpn "" UBYTE DFC_OneToOne 1 100 0.00 1.000 BIT_MASK 0x8 FORMAT "%5.3" ECU_ADDRESS 0x60034C30 /end MEASUREMENT
/begin MEASUREMENT DFC_b.TST_HvGridUMaxSftyLim "" UBYTE DFC_OneToOne 1 100 0.00 1.000 BIT_MASK 0x8 FORMAT "%5.3" ECU_ADDRESS 0x60034C31 /end MEASUREMENT
/begin MEASUREMENT DFC_b.TST_HvGridUMinSftyLim "" UBYTE DFC_OneToOne 1 100 0.00 1.000 BIT_MASK 0x8 FORMAT "%5.3" ECU_ADDRESS 0x60034C32 /end MEASUREMENT
/begin MEASUREMENT DFC_b.TST_HvGridUPlausy "" UBYTE DFC_OneToOne 1 100 0.00 1.000 BIT_MASK 0x8 FORMAT "%5.3" ECU_ADDRESS 0x60034C33 /end MEASUREMENT
/begin MEASUREMENT DFC_b.TST_IntlckChrgPlgHBrgOpnLd "" UBYTE DFC_OneToOne 1 100 0.00 1.000 BIT_MASK 0x8 FORMAT "%5.3" ECU_ADDRESS 0x60034C34 /end MEASUREMENT
/begin MEASUREMENT DFC_b.TST_IntlckChrgPlgHBrgOvrCurr "" UBYTE DFC_OneToOne 1 100 0.00 1.000 BIT_MASK 0x8 FORMAT "%5.3" ECU_ADDRESS 0x60034C35 /end MEASUREMENT
/begin MEASUREMENT DFC_b.TST_IntlckChrgPlgHBrgOvrTemp "" UBYTE DFC_OneToOne 1 100 0.00 1.000 BIT_MASK 0x8 FORMAT "%5.3" ECU_ADDRESS 0x60034C36 /end MEASUREMENT
/begin MEASUREMENT DFC_b.TST_IntlckChrgPlgHBrgShCirBatt1 "" UBYTE DFC_OneToOne 1 100 0.00 1.000 BIT_MASK 0x8 FORMAT "%5.3" ECU_ADDRESS 0x60034C37 /end MEASUREMENT
/begin MEASUREMENT DFC_b.TST_IntlckChrgPlgHBrgShCirBatt2 "" UBYTE DFC_OneToOne 1 100 0.00 1.000 BIT_MASK 0x8 FORMAT "%5.3" ECU_ADDRESS 0x60034C38 /end MEASUREMENT
/begin MEASUREMENT DFC_b.TST_IntlckChrgPlgHBrgShCirGnd1 "" UBYTE DFC_OneToOne 1 100 0.00 1.000 BIT_MASK 0x8 FORMAT "%5.3" ECU_ADDRESS 0x60034C39 /end MEASUREMENT
/begin MEASUREMENT DFC_b.TST_IntlckChrgPlgHBrgShCirGnd2 "" UBYTE DFC_OneToOne 1 100 0.00 1.000 BIT_MASK 0x8 FORMAT "%5.3" ECU_ADDRESS 0x60034C3A /end MEASUREMENT
/begin MEASUREMENT DFC_b.TST_IntlckChrgPlgHBrgShCirOvrLd "" UBYTE DFC_OneToOne 1 100 0.00 1.000 BIT_MASK 0x8 FORMAT "%5.3" ECU_ADDRESS 0x60034C3B /end MEASUREMENT
/begin MEASUREMENT DFC_b.TST_IntlckChrgPlgHBrgTempOvrCurr "" UBYTE DFC_OneToOne 1 100 0.00 1.000 BIT_MASK 0x8 FORMAT "%5.3" ECU_ADDRESS 0x60034C3C /end MEASUREMENT
/begin MEASUREMENT DFC_b.TST_IntlckChrgPlgHBrgUndrVltg "" UBYTE DFC_OneToOne 1 100 0.00 1.000 BIT_MASK 0x8 FORMAT "%5.3" ECU_ADDRESS 0x60034C3D /end MEASUREMENT
/begin MEASUREMENT DFC_b.TST_IntlckChrgPlgPosnRngFlt "" UBYTE DFC_OneToOne 1 100 0.00 1.000 BIT_MASK 0x8 FORMAT "%5.3" ECU_ADDRESS 0x60034C3E /end MEASUREMENT
/begin MEASUREMENT DFC_b.TST_IntlckChrgPlgPosnSrcMax "" UBYTE DFC_OneToOne 1 100 0.00 1.000 BIT_MASK 0x8 FORMAT "%5.3" ECU_ADDRESS 0x60034C3F /end MEASUREMENT
/begin MEASUREMENT DFC_b.TST_IntlckChrgPlgPosnSrcMin "" UBYTE DFC_OneToOne 1 100 0.00 1.000 BIT_MASK 0x8 FORMAT "%5.3" ECU_ADDRESS 0x60034C40 /end MEASUREMENT
/begin MEASUREMENT DFC_b.TST_PwmCtPPhysRngHi "" UBYTE DFC_OneToOne 1 100 0.00 1.000 BIT_MASK 0x8 FORMAT "%5.3" ECU_ADDRESS 0x60034C41 /end MEASUREMENT
/begin MEASUREMENT DFC_b.TST_PwmCtPPhysRngLo "" UBYTE DFC_OneToOne 1 100 0.00 1.000 BIT_MASK 0x8 FORMAT "%5.3" ECU_ADDRESS 0x60034C42 /end MEASUREMENT
/begin MEASUREMENT DFC_b.TST_PwmCtPSRCMax "" UBYTE DFC_OneToOne 1 100 0.00 1.000 BIT_MASK 0x8 FORMAT "%5.3" ECU_ADDRESS 0x60034C43 /end MEASUREMENT
/begin MEASUREMENT DFC_b.TST_PwrDistbnUnitTPhysRngHi "" UBYTE DFC_OneToOne 1 100 0.00 1.000 BIT_MASK 0x8 FORMAT "%5.3" ECU_ADDRESS 0x60034C44 /end MEASUREMENT
/begin MEASUREMENT DFC_b.TST_PwrDistbnUnitTPhysRngLo "" UBYTE DFC_OneToOne 1 100 0.00 1.000 BIT_MASK 0x8 FORMAT "%5.3" ECU_ADDRESS 0x60034C45 /end MEASUREMENT
/begin MEASUREMENT DFC_b.TST_PwrDistbnUnitTSRCOpn "" UBYTE DFC_OneToOne 1 100 0.00 1.000 BIT_MASK 0x8 FORMAT "%5.3" ECU_ADDRESS 0x60034C46 /end MEASUREMENT
/begin MEASUREMENT DFC_b.TST_SCtPmpRlySCG "" UBYTE DFC_OneToOne 1 100 0.00 1.000 BIT_MASK 0x8 FORMAT "%5.3" ECU_ADDRESS 0x60034C47 /end MEASUREMENT
/begin MEASUREMENT DFC_b.TST_SpplCooltPmpRlySCG "" UBYTE DFC_OneToOne 1 100 0.00 1.000 BIT_MASK 0x8 FORMAT "%5.3" ECU_ADDRESS 0x60034C48 /end MEASUREMENT
/begin MEASUREMENT DFC_b.TST_UCtPPhysRngHi "" UBYTE DFC_OneToOne 1 100 0.00 1.000 BIT_MASK 0x8 FORMAT "%5.3" ECU_ADDRESS 0x60034C49 /end MEASUREMENT
/begin MEASUREMENT DFC_b.TST_UCtPPhysRngLo "" UBYTE DFC_OneToOne 1 100 0.00 1.000 BIT_MASK 0x8 FORMAT "%5.3" ECU_ADDRESS 0x60034C4A /end MEASUREMENT
/begin MEASUREMENT DFC_b.TST_UCtPSRCOpn "" UBYTE DFC_OneToOne 1 100 0.00 1.000 BIT_MASK 0x8 FORMAT "%5.3" ECU_ADDRESS 0x60034C4B /end MEASUREMENT
/begin MEASUREMENT DFC_b.TST_UPxP1PhysRngHi "" UBYTE DFC_OneToOne 1 100 0.00 1.000 BIT_MASK 0x8 FORMAT "%5.3" ECU_ADDRESS 0x60034C4C /end MEASUREMENT
/begin MEASUREMENT DFC_b.TST_UPxP1PhysRngLo "" UBYTE DFC_OneToOne 1 100 0.00 1.000 BIT_MASK 0x8 FORMAT "%5.3" ECU_ADDRESS 0x60034C4D /end MEASUREMENT
/begin MEASUREMENT DFC_b.TST_UPxP1SRCOpn "" UBYTE DFC_OneToOne 1 100 0.00 1.000 BIT_MASK 0x8 FORMAT "%5.3" ECU_ADDRESS 0x60034C4E /end MEASUREMENT
/begin MEASUREMENT DFC_b.TST_VehVPhysRngHi "" UBYTE DFC_OneToOne 1 100 0.00 1.000 BIT_MASK 0x8 FORMAT "%5.3" ECU_ADDRESS 0x60034C4F /end MEASUREMENT
/begin MEASUREMENT DFC_b.TST_VehVPhysRngLo "" UBYTE DFC_OneToOne 1 100 0.00 1.000 BIT_MASK 0x8 FORMAT "%5.3" ECU_ADDRESS 0x60034C50 /end MEASUREMENT
/begin MEASUREMENT DFC_b.TST_VehVSigCan "" UBYTE DFC_OneToOne 1 100 0.00 1.000 BIT_MASK 0x8 FORMAT "%5.3" ECU_ADDRESS 0x60034C51 /end MEASUREMENT
/begin MEASUREMENT DFC_b.TST_VehVSigCanSafe "" UBYTE DFC_OneToOne 1 100 0.00 1.000 BIT_MASK 0x8 FORMAT "%5.3" ECU_ADDRESS 0x60034C52 /end MEASUREMENT
/begin MEASUREMENT DFC_b.TST_SCtPmp1DiagGrdKey1 "" UBYTE DFC_OneToOne 1 100 0.00 1.000 BIT_MASK 0x8 FORMAT "%5.3" ECU_ADDRESS 0x60034C53 /end MEASUREMENT
/begin MEASUREMENT DFC_b.TST_SCtPmp1DiagGrdKey2 "" UBYTE DFC_OneToOne 1 100 0.00 1.000 BIT_MASK 0x8 FORMAT "%5.3" ECU_ADDRESS 0x60034C54 /end MEASUREMENT
/begin MEASUREMENT DFC_b.TST_SCtPmp1DiagGrdKey3 "" UBYTE DFC_OneToOne 1 100 0.00 1.000 BIT_MASK 0x8 FORMAT "%5.3" ECU_ADDRESS 0x60034C55 /end MEASUREMENT
/begin MEASUREMENT DFC_b.TST_SCtPmp1DiagGrdKey4 "" UBYTE DFC_OneToOne 1 100 0.00 1.000 BIT_MASK 0x8 FORMAT "%5.3" ECU_ADDRESS 0x60034C56 /end MEASUREMENT
/begin MEASUREMENT DFC_b.TST_SCtPmp1DiagGrdKey5 "" UBYTE DFC_OneToOne 1 100 0.00 1.000 BIT_MASK 0x8 FORMAT "%5.3" ECU_ADDRESS 0x60034C57 /end MEASUREMENT
/begin MEASUREMENT DFC_b.TST_ChrgPlgLiveCntctHzrdCcs "" UBYTE DFC_OneToOne 1 100 0.00 1.000 BIT_MASK 0x8 FORMAT "%5.3" ECU_ADDRESS 0x60034C58 /end MEASUREMENT
/begin MEASUREMENT DFC_b.TST_ChrgPlgProxPltImps "" UBYTE DFC_OneToOne 1 100 0.00 1.000 BIT_MASK 0x8 FORMAT "%5.3" ECU_ADDRESS 0x60034C59 /end MEASUREMENT
/begin MEASUREMENT DFC_b.TST_ChrgPlgTHiCcsDc "" UBYTE DFC_OneToOne 1 100 0.00 1.000 BIT_MASK 0x8 FORMAT "%5.3" ECU_ADDRESS 0x60034C5A /end MEASUREMENT
/begin MEASUREMENT DFC_b.TST_ElMActvDchaFailr "" UBYTE DFC_OneToOne 1 100 0.00 1.000 BIT_MASK 0x8 FORMAT "%5.3" ECU_ADDRESS 0x60034C5B /end MEASUREMENT
/begin MEASUREMENT DFC_b.TST_ElMActvDchaFlt "" UBYTE DFC_OneToOne 1 100 0.00 1.000 BIT_MASK 0x8 FORMAT "%5.3" ECU_ADDRESS 0x60034C5C /end MEASUREMENT
/begin MEASUREMENT DFC_b.TST_ElMFbdnIvtrModDrv01 "" UBYTE DFC_OneToOne 1 100 0.00 1.000 BIT_MASK 0x8 FORMAT "%5.3" ECU_ADDRESS 0x60034C5D /end MEASUREMENT
/begin MEASUREMENT DFC_b.TST_ElMImobAuthent "" UBYTE DFC_OneToOne 1 100 0.00 1.000 BIT_MASK 0x8 FORMAT "%5.3" ECU_ADDRESS 0x60034C5E /end MEASUREMENT
/begin MEASUREMENT DFC_b.TST_ElMIsoMonFlt "" UBYTE DFC_OneToOne 1 100 0.00 1.000 BIT_MASK 0x8 FORMAT "%5.3" ECU_ADDRESS 0x60034C5F /end MEASUREMENT
/begin MEASUREMENT DFC_b.TST_ElMIsoMonPlausyFlt "" UBYTE DFC_OneToOne 1 100 0.00 1.000 BIT_MASK 0x8 FORMAT "%5.3" ECU_ADDRESS 0x60034C60 /end MEASUREMENT
/begin MEASUREMENT DFC_b.TST_ElMIvtrCooltT01 "" UBYTE DFC_OneToOne 1 100 0.00 1.000 BIT_MASK 0x8 FORMAT "%5.3" ECU_ADDRESS 0x60034C61 /end MEASUREMENT
/begin MEASUREMENT DFC_b.TST_ElMIvtrEmgyShtDwn01 "" UBYTE DFC_OneToOne 1 100 0.00 1.000 BIT_MASK 0x8 FORMAT "%5.3" ECU_ADDRESS 0x60034C62 /end MEASUREMENT
/begin MEASUREMENT DFC_b.TST_ElMIvtrFailr01 "" UBYTE DFC_OneToOne 1 100 0.00 1.000 BIT_MASK 0x8 FORMAT "%5.3" ECU_ADDRESS 0x60034C63 /end MEASUREMENT
/begin MEASUREMENT DFC_b.TST_ElMIvtrIntlck01 "" UBYTE DFC_OneToOne 1 100 0.00 1.000 BIT_MASK 0x8 FORMAT "%5.3" ECU_ADDRESS 0x60034C64 /end MEASUREMENT
/begin MEASUREMENT DFC_b.TST_ElMIvtrTErr01 "" UBYTE DFC_OneToOne 1 100 0.00 1.000 BIT_MASK 0x8 FORMAT "%5.3" ECU_ADDRESS 0x60034C65 /end MEASUREMENT
/begin MEASUREMENT DFC_b.TST_ElMOverSpdNeg01 "" UBYTE DFC_OneToOne 1 100 0.00 1.000 BIT_MASK 0x8 FORMAT "%5.3" ECU_ADDRESS 0x60034C66 /end MEASUREMENT
/begin MEASUREMENT DFC_b.TST_ElMOverSpdPos01 "" UBYTE DFC_OneToOne 1 100 0.00 1.000 BIT_MASK 0x8 FORMAT "%5.3" ECU_ADDRESS 0x60034C67 /end MEASUREMENT
/begin MEASUREMENT DFC_b.TST_ElMOverTqNeg01 "" UBYTE DFC_OneToOne 1 100 0.00 1.000 BIT_MASK 0x8 FORMAT "%5.3" ECU_ADDRESS 0x60034C68 /end MEASUREMENT
/begin MEASUREMENT DFC_b.TST_ElMOverTqPos01 "" UBYTE DFC_OneToOne 1 100 0.00 1.000 BIT_MASK 0x8 FORMAT "%5.3" ECU_ADDRESS 0x60034C69 /end MEASUREMENT
/begin MEASUREMENT DFC_b.TST_ElMPwrAuthn "" UBYTE DFC_OneToOne 1 100 0.00 1.000 BIT_MASK 0x8 FORMAT "%5.3" ECU_ADDRESS 0x60034C6A /end MEASUREMENT
/begin MEASUREMENT DFC_b.TST_ElMSpdErr01 "" UBYTE DFC_OneToOne 1 100 0.00 1.000 BIT_MASK 0x8 FORMAT "%5.3" ECU_ADDRESS 0x60034C6B /end MEASUREMENT
/begin MEASUREMENT DFC_b.TST_ElMSvs01 "" UBYTE DFC_OneToOne 1 100 0.00 1.000 BIT_MASK 0x8 FORMAT "%5.3" ECU_ADDRESS 0x60034C6C /end MEASUREMENT
/begin MEASUREMENT DFC_b.TST_PEnvCcMax "" UBYTE DFC_OneToOne 1 100 0.00 1.000 BIT_MASK 0x8 FORMAT "%5.3" ECU_ADDRESS 0x60034C6D /end MEASUREMENT
/begin MEASUREMENT DFC_b.TST_PEnvCcMin "" UBYTE DFC_OneToOne 1 100 0.00 1.000 BIT_MASK 0x8 FORMAT "%5.3" ECU_ADDRESS 0x60034C6E /end MEASUREMENT
/begin MEASUREMENT DFC_b.TST_PEnvRngChkMax "" UBYTE DFC_OneToOne 1 100 0.00 1.000 BIT_MASK 0x8 FORMAT "%5.3" ECU_ADDRESS 0x60034C6F /end MEASUREMENT
/begin MEASUREMENT DFC_b.TST_PEnvRngChkMin "" UBYTE DFC_OneToOne 1 100 0.00 1.000 BIT_MASK 0x8 FORMAT "%5.3" ECU_ADDRESS 0x60034C70 /end MEASUREMENT
/begin MEASUREMENT DFC_b.TST_PEnvSnsrPlaus "" UBYTE DFC_OneToOne 1 100 0.00 1.000 BIT_MASK 0x8 FORMAT "%5.3" ECU_ADDRESS 0x60034C71 /end MEASUREMENT
/begin MEASUREMENT DFC_b.TST_BrkBstPmpPlausGenn "" UBYTE DFC_OneToOne 1 100 0.00 1.000 BIT_MASK 0x8 FORMAT "%5.3" ECU_ADDRESS 0x60034C72 /end MEASUREMENT
/begin MEASUREMENT DFC_b.TST_CbnHeatrRlyLfLoWarn "" UBYTE DFC_OneToOne 1 100 0.00 1.000 BIT_MASK 0x8 FORMAT "%5.3" ECU_ADDRESS 0x60034C73 /end MEASUREMENT
/begin MEASUREMENT DFC_b.TST_ChgrPlugLockPinByndClsd "" UBYTE DFC_OneToOne 1 100 0.00 1.000 BIT_MASK 0x8 FORMAT "%5.3" ECU_ADDRESS 0x60034C74 /end MEASUREMENT
/begin MEASUREMENT DFC_b.TST_ChgrPlugLockPinMoveWoCmd "" UBYTE DFC_OneToOne 1 100 0.00 1.000 BIT_MASK 0x8 FORMAT "%5.3" ECU_ADDRESS 0x60034C75 /end MEASUREMENT
/begin MEASUREMENT DFC_b.TST_ChgrPlugLockPinStuckInClsd "" UBYTE DFC_OneToOne 1 100 0.00 1.000 BIT_MASK 0x8 FORMAT "%5.3" ECU_ADDRESS 0x60034C76 /end MEASUREMENT
/begin MEASUREMENT DFC_b.TST_ChgrPlugLockPinStuckInOpen "" UBYTE DFC_OneToOne 1 100 0.00 1.000 BIT_MASK 0x8 FORMAT "%5.3" ECU_ADDRESS 0x60034C77 /end MEASUREMENT
/begin MEASUREMENT DFC_b.TST_ChrgrStErr "" UBYTE DFC_OneToOne 1 100 0.00 1.000 BIT_MASK 0x8 FORMAT "%5.3" ECU_ADDRESS 0x60034C78 /end MEASUREMENT
/begin MEASUREMENT DFC_b.TST_ComHSN1BusOff "" UBYTE DFC_OneToOne 1 100 0.00 1.000 BIT_MASK 0x8 FORMAT "%5.3" ECU_ADDRESS 0x60034C79 /end MEASUREMENT
/begin MEASUREMENT DFC_b.TST_ComHSN3BusOff "" UBYTE DFC_OneToOne 1 100 0.00 1.000 BIT_MASK 0x8 FORMAT "%5.3" ECU_ADDRESS 0x60034C7A /end MEASUREMENT
/begin MEASUREMENT DFC_b.TST_ComVCInval "" UBYTE DFC_OneToOne 1 100 0.00 1.000 BIT_MASK 0x8 FORMAT "%5.3" ECU_ADDRESS 0x60034C7B /end MEASUREMENT
/begin MEASUREMENT DFC_b.TST_EemDcdcPrecSpdInhb "" UBYTE DFC_OneToOne 1 100 0.00 1.000 BIT_MASK 0x8 FORMAT "%5.3" ECU_ADDRESS 0x60034C7C /end MEASUREMENT
/begin MEASUREMENT DFC_b.TST_ExpPwrLatch "" UBYTE DFC_OneToOne 1 100 0.00 1.000 BIT_MASK 0x8 FORMAT "%5.3" ECU_ADDRESS 0x60034C7D /end MEASUREMENT
/begin MEASUREMENT DFC_b.TST_FanMaxOvrd "" UBYTE DFC_OneToOne 1 100 0.00 1.000 BIT_MASK 0x8 FORMAT "%5.3" ECU_ADDRESS 0x60034C7E /end MEASUREMENT
/begin MEASUREMENT DFC_b.TST_HLCCcsGnrlComErr "" UBYTE DFC_OneToOne 1 100 0.00 1.000 BIT_MASK 0x8 FORMAT "%5.3" ECU_ADDRESS 0x60034C7F /end MEASUREMENT
/begin MEASUREMENT DFC_b.TST_InmLINNodeHVACPanelAbsnt "" UBYTE DFC_OneToOne 1 100 0.00 1.000 BIT_MASK 0x8 FORMAT "%5.3" ECU_ADDRESS 0x60034C80 /end MEASUREMENT
/begin MEASUREMENT DFC_b.TST_ResetRcvNotAllwd "" UBYTE DFC_OneToOne 1 100 0.00 1.000 BIT_MASK 0x8 FORMAT "%5.3" ECU_ADDRESS 0x60034C81 /end MEASUREMENT
/begin MEASUREMENT DFC_b.TST_TelltlCooltPlaus "" UBYTE DFC_OneToOne 1 100 0.00 1.000 BIT_MASK 0x8 FORMAT "%5.3" ECU_ADDRESS 0x60034C82 /end MEASUREMENT
/begin MEASUREMENT DFC_b.TST_MRlyOL "" UBYTE DFC_OneToOne 1 100 0.00 1.000 BIT_MASK 0x8 FORMAT "%5.3" ECU_ADDRESS 0x60034C83 /end MEASUREMENT
/begin MEASUREMENT DFC_b.TST_MRlySCB "" UBYTE DFC_OneToOne 1 100 0.00 1.000 BIT_MASK 0x8 FORMAT "%5.3" ECU_ADDRESS 0x60034C84 /end MEASUREMENT
/begin MEASUREMENT DFC_b.TST_MRlySCG "" UBYTE DFC_OneToOne 1 100 0.00 1.000 BIT_MASK 0x8 FORMAT "%5.3" ECU_ADDRESS 0x60034C85 /end MEASUREMENT
/begin MEASUREMENT DFC_b.TST_SSpMon1 "" UBYTE DFC_OneToOne 1 100 0.00 1.000 BIT_MASK 0x8 FORMAT "%5.3" ECU_ADDRESS 0x60034C86 /end MEASUREMENT
/begin MEASUREMENT DFC_b.TST_SSpMon1OV "" UBYTE DFC_OneToOne 1 100 0.00 1.000 BIT_MASK 0x8 FORMAT "%5.3" ECU_ADDRESS 0x60034C87 /end MEASUREMENT
/begin MEASUREMENT DFC_b.TST_SSpMon1SCG "" UBYTE DFC_OneToOne 1 100 0.00 1.000 BIT_MASK 0x8 FORMAT "%5.3" ECU_ADDRESS 0x60034C88 /end MEASUREMENT
/begin MEASUREMENT DFC_b.TST_SSpMon1UV "" UBYTE DFC_OneToOne 1 100 0.00 1.000 BIT_MASK 0x8 FORMAT "%5.3" ECU_ADDRESS 0x60034C89 /end MEASUREMENT
/begin MEASUREMENT DFC_b.TST_SSpMon2 "" UBYTE DFC_OneToOne 1 100 0.00 1.000 BIT_MASK 0x8 FORMAT "%5.3" ECU_ADDRESS 0x60034C8A /end MEASUREMENT
/begin MEASUREMENT DFC_b.TST_SSpMon2OV "" UBYTE DFC_OneToOne 1 100 0.00 1.000 BIT_MASK 0x8 FORMAT "%5.3" ECU_ADDRESS 0x60034C8B /end MEASUREMENT
/begin MEASUREMENT DFC_b.TST_SSpMon2SCG "" UBYTE DFC_OneToOne 1 100 0.00 1.000 BIT_MASK 0x8 FORMAT "%5.3" ECU_ADDRESS 0x60034C8C /end MEASUREMENT
/begin MEASUREMENT DFC_b.TST_SSpMon2UV "" UBYTE DFC_OneToOne 1 100 0.00 1.000 BIT_MASK 0x8 FORMAT "%5.3" ECU_ADDRESS 0x60034C8D /end MEASUREMENT
/begin MEASUREMENT DFC_b.TST_SSpMon3 "" UBYTE DFC_OneToOne 1 100 0.00 1.000 BIT_MASK 0x8 FORMAT "%5.3" ECU_ADDRESS 0x60034C8E /end MEASUREMENT
/begin MEASUREMENT DFC_b.TST_SSpMon3OV "" UBYTE DFC_OneToOne 1 100 0.00 1.000 BIT_MASK 0x8 FORMAT "%5.3" ECU_ADDRESS 0x60034C8F /end MEASUREMENT
/begin MEASUREMENT DFC_b.TST_SSpMon3SCG "" UBYTE DFC_OneToOne 1 100 0.00 1.000 BIT_MASK 0x8 FORMAT "%5.3" ECU_ADDRESS 0x60034C90 /end MEASUREMENT
/begin MEASUREMENT DFC_b.TST_SSpMon3UV "" UBYTE DFC_OneToOne 1 100 0.00 1.000 BIT_MASK 0x8 FORMAT "%5.3" ECU_ADDRESS 0x60034C91 /end MEASUREMENT
/begin MEASUREMENT DFC_b.TST_CANSM_E_BUS_OFF_NETWORK_HSN1_CAN "" UBYTE DFC_OneToOne 1 100 0.00 1.000 BIT_MASK 0x8 FORMAT "%5.3" ECU_ADDRESS 0x60034C92 /end MEASUREMENT
/begin MEASUREMENT DFC_b.TST_CANSM_E_BUS_OFF_NETWORK_HSN3_CAN "" UBYTE DFC_OneToOne 1 100 0.00 1.000 BIT_MASK 0x8 FORMAT "%5.3" ECU_ADDRESS 0x60034C93 /end MEASUREMENT
/begin MEASUREMENT DFC_b.TST_CANSM_E_BUS_OFF_NETWORK_HSN4_CAN "" UBYTE DFC_OneToOne 1 100 0.00 1.000 BIT_MASK 0x8 FORMAT "%5.3" ECU_ADDRESS 0x60034C94 /end MEASUREMENT
/begin MEASUREMENT DFC_b.TST_CANSM_E_BUS_OFF_NETWORK_XCP_CAN "" UBYTE DFC_OneToOne 1 100 0.00 1.000 BIT_MASK 0x8 FORMAT "%5.3" ECU_ADDRESS 0x60034C95 /end MEASUREMENT
/begin MEASUREMENT DFC_b.TST_CANTRCV_E_NO_TRCV_CONTROL_0 "" UBYTE DFC_OneToOne 1 100 0.00 1.000 BIT_MASK 0x8 FORMAT "%5.3" ECU_ADDRESS 0x60034C96 /end MEASUREMENT
/begin MEASUREMENT DFC_b.TST_CAN_E_TIMEOUT "" UBYTE DFC_OneToOne 1 100 0.00 1.000 BIT_MASK 0x8 FORMAT "%5.3" ECU_ADDRESS 0x60034C97 /end MEASUREMENT
/begin MEASUREMENT DFC_b.TST_COMM_E_NET_START_IND_CHANNEL_0 "" UBYTE DFC_OneToOne 1 100 0.00 1.000 BIT_MASK 0x8 FORMAT "%5.3" ECU_ADDRESS 0x60034C98 /end MEASUREMENT
/begin MEASUREMENT DFC_b.TST_COMM_E_NET_START_IND_CHANNEL_1 "" UBYTE DFC_OneToOne 1 100 0.00 1.000 BIT_MASK 0x8 FORMAT "%5.3" ECU_ADDRESS 0x60034C99 /end MEASUREMENT
/begin MEASUREMENT DFC_b.TST_COMM_E_NET_START_IND_CHANNEL_2 "" UBYTE DFC_OneToOne 1 100 0.00 1.000 BIT_MASK 0x8 FORMAT "%5.3" ECU_ADDRESS 0x60034C9A /end MEASUREMENT
/begin MEASUREMENT DFC_b.TST_COMM_E_NET_START_IND_CHANNEL_3 "" UBYTE DFC_OneToOne 1 100 0.00 1.000 BIT_MASK 0x8 FORMAT "%5.3" ECU_ADDRESS 0x60034C9B /end MEASUREMENT
/begin MEASUREMENT DFC_b.TST_COMM_E_NET_START_IND_CHANNEL_4 "" UBYTE DFC_OneToOne 1 100 0.00 1.000 BIT_MASK 0x8 FORMAT "%5.3" ECU_ADDRESS 0x60034C9C /end MEASUREMENT
/begin MEASUREMENT DFC_b.TST_COMM_E_NET_START_IND_CHANNEL_5 "" UBYTE DFC_OneToOne 1 100 0.00 1.000 BIT_MASK 0x8 FORMAT "%5.3" ECU_ADDRESS 0x60034C9D /end MEASUREMENT
/begin MEASUREMENT DFC_b.TST_LIN_E_TIMEOUT "" UBYTE DFC_OneToOne 1 100 0.00 1.000 BIT_MASK 0x8 FORMAT "%5.3" ECU_ADDRESS 0x60034C9E /end MEASUREMENT
/begin MEASUREMENT DFC_b.TST_rba_EcuCtrl_TOMaxProlg "" UBYTE DFC_OneToOne 1 100 0.00 1.000 BIT_MASK 0x8 FORMAT "%5.3" ECU_ADDRESS 0x60034C9F /end MEASUREMENT
/begin MEASUREMENT DFC_b.TST_rba_EcuCtrl_TOMaxShutDwn "" UBYTE DFC_OneToOne 1 100 0.00 1.000 BIT_MASK 0x8 FORMAT "%5.3" ECU_ADDRESS 0x60034CA0 /end MEASUREMENT
/begin MEASUREMENT DFC_b.TST_rba_MultiStackTrace_Threshold "" UBYTE DFC_OneToOne 1 100 0.00 1.000 BIT_MASK 0x8 FORMAT "%5.3" ECU_ADDRESS 0x60034CA1 /end MEASUREMENT
/begin MEASUREMENT DFC_b.TST_rba_SyC_CustStates_Degraded_disord_Event "" UBYTE DFC_OneToOne 1 100 0.00 1.000 BIT_MASK 0x8 FORMAT "%5.3" ECU_ADDRESS 0x60034CA2 /end MEASUREMENT
/begin MEASUREMENT DFC_b.TST_rba_SyC_CustStates_Degraded_incst_Event "" UBYTE DFC_OneToOne 1 100 0.00 1.000 BIT_MASK 0x8 FORMAT "%5.3" ECU_ADDRESS 0x60034CA3 /end MEASUREMENT
/begin MEASUREMENT DFC_b.TST_rba_SyC_CustStates_TransNoWakReq_Event "" UBYTE DFC_OneToOne 1 100 0.00 1.000 BIT_MASK 0x8 FORMAT "%5.3" ECU_ADDRESS 0x60034CA4 /end MEASUREMENT
/begin MEASUREMENT DFC_b.TST_RBA_IOEXTLIB_KEEPALIVE_DRV "" UBYTE DFC_OneToOne 1 100 0.00 1.000 BIT_MASK 0x8 FORMAT "%5.3" ECU_ADDRESS 0x60034CA5 /end MEASUREMENT
/begin MEASUREMENT DFC_b.TST_RBA_IOEXTLIB_KEEPALIVE_INI "" UBYTE DFC_OneToOne 1 100 0.00 1.000 BIT_MASK 0x8 FORMAT "%5.3" ECU_ADDRESS 0x60034CA6 /end MEASUREMENT
/begin MEASUREMENT DFC_b.TST_rba_IoSigRtc_StopCounter "" UBYTE DFC_OneToOne 1 100 0.00 1.000 BIT_MASK 0x8 FORMAT "%5.3" ECU_ADDRESS 0x60034CA7 /end MEASUREMENT
/begin MEASUREMENT DFC_b.TST_rba_MRly_Diag_Stk_Event "" UBYTE DFC_OneToOne 1 100 0.00 1.000 BIT_MASK 0x8 FORMAT "%5.3" ECU_ADDRESS 0x60034CA8 /end MEASUREMENT
/begin MEASUREMENT DFC_b.TST_rba_MemDiag_MemReadErr "" UBYTE DFC_OneToOne 1 100 0.00 1.000 BIT_MASK 0x8 FORMAT "%5.3" ECU_ADDRESS 0x60034CA9 /end MEASUREMENT
/begin MEASUREMENT DFC_b.TST_rba_MemDiag_MemWrErr "" UBYTE DFC_OneToOne 1 100 0.00 1.000 BIT_MASK 0x8 FORMAT "%5.3" ECU_ADDRESS 0x60034CAA /end MEASUREMENT
/begin MEASUREMENT DFC_b.TST_rba_SyC_IrrSwOffTrigEngRun_Event "" UBYTE DFC_OneToOne 1 100 0.00 1.000 BIT_MASK 0x8 FORMAT "%5.3" ECU_ADDRESS 0x60034CAB /end MEASUREMENT
/begin MEASUREMENT DFC_b.TST_AcChrgrIntkTSRCMax "" UBYTE DFC_OneToOne 1 100 0.00 1.000 BIT_MASK 0x8 FORMAT "%5.3" ECU_ADDRESS 0x60034CAC /end MEASUREMENT
/begin MEASUREMENT DFC_b.TST_AcChrgrIntkTTmpErr "" UBYTE DFC_OneToOne 1 100 0.00 1.000 BIT_MASK 0x8 FORMAT "%5.3" ECU_ADDRESS 0x60034CAD /end MEASUREMENT
/begin MEASUREMENT DFC_b.TST_AcFlt "" UBYTE DFC_OneToOne 1 100 0.00 1.000 BIT_MASK 0x8 FORMAT "%5.3" ECU_ADDRESS 0x60034CAE /end MEASUREMENT
/begin MEASUREMENT DFC_b.TST_AppAllSnsrDfct "" UBYTE DFC_OneToOne 1 100 0.00 1.000 BIT_MASK 0x8 FORMAT "%5.3" ECU_ADDRESS 0x60034CAF /end MEASUREMENT
/begin MEASUREMENT DFC_b.TST_BattUPwrFail "" UBYTE DFC_OneToOne 1 100 0.00 1.000 BIT_MASK 0x8 FORMAT "%5.3" ECU_ADDRESS 0x60034CB0 /end MEASUREMENT
/begin MEASUREMENT DFC_b.TST_BrkBstBkupOvrn "" UBYTE DFC_OneToOne 1 100 0.00 1.000 BIT_MASK 0x8 FORMAT "%5.3" ECU_ADDRESS 0x60034CB1 /end MEASUREMENT
/begin MEASUREMENT DFC_b.TST_BrkBstPmpOvld "" UBYTE DFC_OneToOne 1 100 0.00 1.000 BIT_MASK 0x8 FORMAT "%5.3" ECU_ADDRESS 0x60034CB2 /end MEASUREMENT
/begin MEASUREMENT DFC_b.TST_BrkPlausChk "" UBYTE DFC_OneToOne 1 100 0.00 1.000 BIT_MASK 0x8 FORMAT "%5.3" ECU_ADDRESS 0x60034CB3 /end MEASUREMENT
/begin MEASUREMENT DFC_b.TST_CbnHeatgSwtTmpErr "" UBYTE DFC_OneToOne 1 100 0.00 1.000 BIT_MASK 0x8 FORMAT "%5.3" ECU_ADDRESS 0x60034CB4 /end MEASUREMENT
/begin MEASUREMENT DFC_b.TST_CcsPwrLineChpVccSRCMax "" UBYTE DFC_OneToOne 1 100 0.00 1.000 BIT_MASK 0x8 FORMAT "%5.3" ECU_ADDRESS 0x60034CB5 /end MEASUREMENT
/begin MEASUREMENT DFC_b.TST_CcsPwrLineChpVccTmpErr "" UBYTE DFC_OneToOne 1 100 0.00 1.000 BIT_MASK 0x8 FORMAT "%5.3" ECU_ADDRESS 0x60034CB6 /end MEASUREMENT
/begin MEASUREMENT DFC_b.TST_CcsPwrLineComChpTSRCMax "" UBYTE DFC_OneToOne 1 100 0.00 1.000 BIT_MASK 0x8 FORMAT "%5.3" ECU_ADDRESS 0x60034CB7 /end MEASUREMENT
/begin MEASUREMENT DFC_b.TST_CcsPwrLineComChpTTmpErr "" UBYTE DFC_OneToOne 1 100 0.00 1.000 BIT_MASK 0x8 FORMAT "%5.3" ECU_ADDRESS 0x60034CB8 /end MEASUREMENT
/begin MEASUREMENT DFC_b.TST_ChgrPlugCtpCarrFrqErr "" UBYTE DFC_OneToOne 1 100 0.00 1.000 BIT_MASK 0x8 FORMAT "%5.3" ECU_ADDRESS 0x60034CB9 /end MEASUREMENT
/begin MEASUREMENT DFC_b.TST_ChgrPlugCtpSwtStuckClsd "" UBYTE DFC_OneToOne 1 100 0.00 1.000 BIT_MASK 0x8 FORMAT "%5.3" ECU_ADDRESS 0x60034CBA /end MEASUREMENT
/begin MEASUREMENT DFC_b.TST_ChgrPlugCtpSwtStuckOpen "" UBYTE DFC_OneToOne 1 100 0.00 1.000 BIT_MASK 0x8 FORMAT "%5.3" ECU_ADDRESS 0x60034CBB /end MEASUREMENT
/begin MEASUREMENT DFC_b.TST_ChgrPlugCtpUErrHi "" UBYTE DFC_OneToOne 1 100 0.00 1.000 BIT_MASK 0x8 FORMAT "%5.3" ECU_ADDRESS 0x60034CBC /end MEASUREMENT
/begin MEASUREMENT DFC_b.TST_ChgrPlugPxp1SrcErr "" UBYTE DFC_OneToOne 1 100 0.00 1.000 BIT_MASK 0x8 FORMAT "%5.3" ECU_ADDRESS 0x60034CBD /end MEASUREMENT
/begin MEASUREMENT DFC_b.TST_ChrgCntctAllWldd "" UBYTE DFC_OneToOne 1 100 0.00 1.000 BIT_MASK 0x8 FORMAT "%5.3" ECU_ADDRESS 0x60034CBE /end MEASUREMENT
/begin MEASUREMENT DFC_b.TST_ChrgCntctNegOperErr "" UBYTE DFC_OneToOne 1 100 0.00 1.000 BIT_MASK 0x8 FORMAT "%5.3" ECU_ADDRESS 0x60034CBF /end MEASUREMENT
/begin MEASUREMENT DFC_b.TST_ChrgCntctNegOperWarn "" UBYTE DFC_OneToOne 1 100 0.00 1.000 BIT_MASK 0x8 FORMAT "%5.3" ECU_ADDRESS 0x60034CC0 /end MEASUREMENT
/begin MEASUREMENT DFC_b.TST_ChrgCntctNegWldd "" UBYTE DFC_OneToOne 1 100 0.00 1.000 BIT_MASK 0x8 FORMAT "%5.3" ECU_ADDRESS 0x60034CC1 /end MEASUREMENT
/begin MEASUREMENT DFC_b.TST_ChrgCntctPosOperErr "" UBYTE DFC_OneToOne 1 100 0.00 1.000 BIT_MASK 0x8 FORMAT "%5.3" ECU_ADDRESS 0x60034CC2 /end MEASUREMENT
/begin MEASUREMENT DFC_b.TST_ChrgCntctPosOperWarn "" UBYTE DFC_OneToOne 1 100 0.00 1.000 BIT_MASK 0x8 FORMAT "%5.3" ECU_ADDRESS 0x60034CC3 /end MEASUREMENT
/begin MEASUREMENT DFC_b.TST_ChrgCntctPosWldd "" UBYTE DFC_OneToOne 1 100 0.00 1.000 BIT_MASK 0x8 FORMAT "%5.3" ECU_ADDRESS 0x60034CC4 /end MEASUREMENT
/begin MEASUREMENT DFC_b.TST_ChrgCntctStuckOpen "" UBYTE DFC_OneToOne 1 100 0.00 1.000 BIT_MASK 0x8 FORMAT "%5.3" ECU_ADDRESS 0x60034CC5 /end MEASUREMENT
/begin MEASUREMENT DFC_b.TST_ChrgPlgIntlckFaild "" UBYTE DFC_OneToOne 1 100 0.00 1.000 BIT_MASK 0x8 FORMAT "%5.3" ECU_ADDRESS 0x60034CC6 /end MEASUREMENT
/begin MEASUREMENT DFC_b.TST_ChrgnUnplRqrd "" UBYTE DFC_OneToOne 1 100 0.00 1.000 BIT_MASK 0x8 FORMAT "%5.3" ECU_ADDRESS 0x60034CC7 /end MEASUREMENT
/begin MEASUREMENT DFC_b.TST_CoElMOffsCalibActv01 "" UBYTE DFC_OneToOne 1 100 0.00 1.000 BIT_MASK 0x8 FORMAT "%5.3" ECU_ADDRESS 0x60034CC8 /end MEASUREMENT
/begin MEASUREMENT DFC_b.TST_CtPSwtDiagSRCMax "" UBYTE DFC_OneToOne 1 100 0.00 1.000 BIT_MASK 0x8 FORMAT "%5.3" ECU_ADDRESS 0x60034CC9 /end MEASUREMENT
/begin MEASUREMENT DFC_b.TST_CtPSwtDiagTmpErr "" UBYTE DFC_OneToOne 1 100 0.00 1.000 BIT_MASK 0x8 FORMAT "%5.3" ECU_ADDRESS 0x60034CCA /end MEASUREMENT
/begin MEASUREMENT DFC_b.TST_CtpCarrFrqTmpErr "" UBYTE DFC_OneToOne 1 100 0.00 1.000 BIT_MASK 0x8 FORMAT "%5.3" ECU_ADDRESS 0x60034CCB /end MEASUREMENT
/begin MEASUREMENT DFC_b.TST_DcChrgrIntkT2SRCMax "" UBYTE DFC_OneToOne 1 100 0.00 1.000 BIT_MASK 0x8 FORMAT "%5.3" ECU_ADDRESS 0x60034CCC /end MEASUREMENT
/begin MEASUREMENT DFC_b.TST_DcChrgrIntkT2TmpErr "" UBYTE DFC_OneToOne 1 100 0.00 1.000 BIT_MASK 0x8 FORMAT "%5.3" ECU_ADDRESS 0x60034CCD /end MEASUREMENT
/begin MEASUREMENT DFC_b.TST_DcChrgrIntkTSRCMax "" UBYTE DFC_OneToOne 1 100 0.00 1.000 BIT_MASK 0x8 FORMAT "%5.3" ECU_ADDRESS 0x60034CCE /end MEASUREMENT
/begin MEASUREMENT DFC_b.TST_DcChrgrIntkTTmpErr "" UBYTE DFC_OneToOne 1 100 0.00 1.000 BIT_MASK 0x8 FORMAT "%5.3" ECU_ADDRESS 0x60034CCF /end MEASUREMENT
/begin MEASUREMENT DFC_b.TST_EChrDvPlinCntrThdExcdd "" UBYTE DFC_OneToOne 1 100 0.00 1.000 BIT_MASK 0x8 FORMAT "%5.3" ECU_ADDRESS 0x60034CD0 /end MEASUREMENT
/begin MEASUREMENT DFC_b.TST_EemDiagCtctrClsTout "" UBYTE DFC_OneToOne 1 100 0.00 1.000 BIT_MASK 0x8 FORMAT "%5.3" ECU_ADDRESS 0x60034CD1 /end MEASUREMENT
/begin MEASUREMENT DFC_b.TST_EemDiagDcdcOffTOut "" UBYTE DFC_OneToOne 1 100 0.00 1.000 BIT_MASK 0x8 FORMAT "%5.3" ECU_ADDRESS 0x60034CD2 /end MEASUREMENT
/begin MEASUREMENT DFC_b.TST_EemDiagHvCnsrOffTOut "" UBYTE DFC_OneToOne 1 100 0.00 1.000 BIT_MASK 0x8 FORMAT "%5.3" ECU_ADDRESS 0x60034CD3 /end MEASUREMENT
/begin MEASUREMENT DFC_b.TST_EemDiagHvbOffTOut "" UBYTE DFC_OneToOne 1 100 0.00 1.000 BIT_MASK 0x8 FORMAT "%5.3" ECU_ADDRESS 0x60034CD4 /end MEASUREMENT
/begin MEASUREMENT DFC_b.TST_FanSpdSRCMax "" UBYTE DFC_OneToOne 1 100 0.00 1.000 BIT_MASK 0x8 FORMAT "%5.3" ECU_ADDRESS 0x60034CD5 /end MEASUREMENT
/begin MEASUREMENT DFC_b.TST_FanSpdTmpErr "" UBYTE DFC_OneToOne 1 100 0.00 1.000 BIT_MASK 0x8 FORMAT "%5.3" ECU_ADDRESS 0x60034CD6 /end MEASUREMENT
/begin MEASUREMENT DFC_b.TST_FreonPSRCMax "" UBYTE DFC_OneToOne 1 100 0.00 1.000 BIT_MASK 0x8 FORMAT "%5.3" ECU_ADDRESS 0x60034CD7 /end MEASUREMENT
/begin MEASUREMENT DFC_b.TST_FreonPTmpErr "" UBYTE DFC_OneToOne 1 100 0.00 1.000 BIT_MASK 0x8 FORMAT "%5.3" ECU_ADDRESS 0x60034CD8 /end MEASUREMENT
/begin MEASUREMENT DFC_b.TST_HeatrCoreTSRCMax "" UBYTE DFC_OneToOne 1 100 0.00 1.000 BIT_MASK 0x8 FORMAT "%5.3" ECU_ADDRESS 0x60034CD9 /end MEASUREMENT
/begin MEASUREMENT DFC_b.TST_HeatrCoreTTmpErr "" UBYTE DFC_OneToOne 1 100 0.00 1.000 BIT_MASK 0x8 FORMAT "%5.3" ECU_ADDRESS 0x60034CDA /end MEASUREMENT
/begin MEASUREMENT DFC_b.TST_HvGridSocMinLim "" UBYTE DFC_OneToOne 1 100 0.00 1.000 BIT_MASK 0x8 FORMAT "%5.3" ECU_ADDRESS 0x60034CDB /end MEASUREMENT
/begin MEASUREMENT DFC_b.TST_HvacBlwrFrntFlt "" UBYTE DFC_OneToOne 1 100 0.00 1.000 BIT_MASK 0x8 FORMAT "%5.3" ECU_ADDRESS 0x60034CDC /end MEASUREMENT
/begin MEASUREMENT DFC_b.TST_HvacEvapElecFlt "" UBYTE DFC_OneToOne 1 100 0.00 1.000 BIT_MASK 0x8 FORMAT "%5.3" ECU_ADDRESS 0x60034CDD /end MEASUREMENT
/begin MEASUREMENT DFC_b.TST_HvacEvapElecFltGnd "" UBYTE DFC_OneToOne 1 100 0.00 1.000 BIT_MASK 0x8 FORMAT "%5.3" ECU_ADDRESS 0x60034CDE /end MEASUREMENT
/begin MEASUREMENT DFC_b.TST_HvacKnobPosnFlt "" UBYTE DFC_OneToOne 1 100 0.00 1.000 BIT_MASK 0x8 FORMAT "%5.3" ECU_ADDRESS 0x60034CDF /end MEASUREMENT
/begin MEASUREMENT DFC_b.TST_InvBinID "" UBYTE DFC_OneToOne 1 100 0.00 1.000 BIT_MASK 0x8 FORMAT "%5.3" ECU_ADDRESS 0x60034CE0 /end MEASUREMENT
/begin MEASUREMENT DFC_b.TST_InvCalID "" UBYTE DFC_OneToOne 1 100 0.00 1.000 BIT_MASK 0x8 FORMAT "%5.3" ECU_ADDRESS 0x60034CE1 /end MEASUREMENT
/begin MEASUREMENT DFC_b.TST_InvErotan "" UBYTE DFC_OneToOne 1 100 0.00 1.000 BIT_MASK 0x8 FORMAT "%5.3" ECU_ADDRESS 0x60034CE2 /end MEASUREMENT
/begin MEASUREMENT DFC_b.TST_InvVinID "" UBYTE DFC_OneToOne 1 100 0.00 1.000 BIT_MASK 0x8 FORMAT "%5.3" ECU_ADDRESS 0x60034CE3 /end MEASUREMENT
/begin MEASUREMENT DFC_b.TST_MOXEMM_SMU_ALM0_0 "" UBYTE DFC_OneToOne 1 100 0.00 1.000 BIT_MASK 0x8 FORMAT "%5.3" ECU_ADDRESS 0x60034CE4 /end MEASUREMENT
/begin MEASUREMENT DFC_b.TST_MOXEMM_SMU_ALM0_1 "" UBYTE DFC_OneToOne 1 100 0.00 1.000 BIT_MASK 0x8 FORMAT "%5.3" ECU_ADDRESS 0x60034CE5 /end MEASUREMENT
/begin MEASUREMENT DFC_b.TST_MOXEMM_SMU_ALM0_10 "" UBYTE DFC_OneToOne 1 100 0.00 1.000 BIT_MASK 0x8 FORMAT "%5.3" ECU_ADDRESS 0x60034CE6 /end MEASUREMENT
/begin MEASUREMENT DFC_b.TST_MOXEMM_SMU_ALM0_11 "" UBYTE DFC_OneToOne 1 100 0.00 1.000 BIT_MASK 0x8 FORMAT "%5.3" ECU_ADDRESS 0x60034CE7 /end MEASUREMENT
/begin MEASUREMENT DFC_b.TST_MOXEMM_SMU_ALM0_13 "" UBYTE DFC_OneToOne 1 100 0.00 1.000 BIT_MASK 0x8 FORMAT "%5.3" ECU_ADDRESS 0x60034CE8 /end MEASUREMENT
/begin MEASUREMENT DFC_b.TST_MOXEMM_SMU_ALM0_14 "" UBYTE DFC_OneToOne 1 100 0.00 1.000 BIT_MASK 0x8 FORMAT "%5.3" ECU_ADDRESS 0x60034CE9 /end MEASUREMENT
/begin MEASUREMENT DFC_b.TST_MOXEMM_SMU_ALM0_2 "" UBYTE DFC_OneToOne 1 100 0.00 1.000 BIT_MASK 0x8 FORMAT "%5.3" ECU_ADDRESS 0x60034CEA /end MEASUREMENT
/begin MEASUREMENT DFC_b.TST_MOXEMM_SMU_ALM0_22 "" UBYTE DFC_OneToOne 1 100 0.00 1.000 BIT_MASK 0x8 FORMAT "%5.3" ECU_ADDRESS 0x60034CEB /end MEASUREMENT
/begin MEASUREMENT DFC_b.TST_MOXEMM_SMU_ALM0_23 "" UBYTE DFC_OneToOne 1 100 0.00 1.000 BIT_MASK 0x8 FORMAT "%5.3" ECU_ADDRESS 0x60034CEC /end MEASUREMENT
/begin MEASUREMENT DFC_b.TST_MOXEMM_SMU_ALM0_4 "" UBYTE DFC_OneToOne 1 100 0.00 1.000 BIT_MASK 0x8 FORMAT "%5.3" ECU_ADDRESS 0x60034CED /end MEASUREMENT
/begin MEASUREMENT DFC_b.TST_MOXEMM_SMU_ALM0_5 "" UBYTE DFC_OneToOne 1 100 0.00 1.000 BIT_MASK 0x8 FORMAT "%5.3" ECU_ADDRESS 0x60034CEE /end MEASUREMENT
/begin MEASUREMENT DFC_b.TST_MOXEMM_SMU_ALM0_7 "" UBYTE DFC_OneToOne 1 100 0.00 1.000 BIT_MASK 0x8 FORMAT "%5.3" ECU_ADDRESS 0x60034CEF /end MEASUREMENT
/begin MEASUREMENT DFC_b.TST_MOXEMM_SMU_ALM0_8 "" UBYTE DFC_OneToOne 1 100 0.00 1.000 BIT_MASK 0x8 FORMAT "%5.3" ECU_ADDRESS 0x60034CF0 /end MEASUREMENT
/begin MEASUREMENT DFC_b.TST_MOXEMM_SMU_ALM10_16 "" UBYTE DFC_OneToOne 1 100 0.00 1.000 BIT_MASK 0x8 FORMAT "%5.3" ECU_ADDRESS 0x60034CF1 /end MEASUREMENT
/begin MEASUREMENT DFC_b.TST_MOXEMM_SMU_ALM10_17 "" UBYTE DFC_OneToOne 1 100 0.00 1.000 BIT_MASK 0x8 FORMAT "%5.3" ECU_ADDRESS 0x60034CF2 /end MEASUREMENT
/begin MEASUREMENT DFC_b.TST_MOXEMM_SMU_ALM10_21 "" UBYTE DFC_OneToOne 1 100 0.00 1.000 BIT_MASK 0x8 FORMAT "%5.3" ECU_ADDRESS 0x60034CF3 /end MEASUREMENT
/begin MEASUREMENT DFC_b.TST_MOXEMM_SMU_ALM11_0 "" UBYTE DFC_OneToOne 1 100 0.00 1.000 BIT_MASK 0x8 FORMAT "%5.3" ECU_ADDRESS 0x60034CF4 /end MEASUREMENT
/begin MEASUREMENT DFC_b.TST_MOXEMM_SMU_ALM11_1 "" UBYTE DFC_OneToOne 1 100 0.00 1.000 BIT_MASK 0x8 FORMAT "%5.3" ECU_ADDRESS 0x60034CF5 /end MEASUREMENT
/begin MEASUREMENT DFC_b.TST_MOXEMM_SMU_ALM11_2 "" UBYTE DFC_OneToOne 1 100 0.00 1.000 BIT_MASK 0x8 FORMAT "%5.3" ECU_ADDRESS 0x60034CF6 /end MEASUREMENT
/begin MEASUREMENT DFC_b.TST_MOXEMM_SMU_ALM11_3 "" UBYTE DFC_OneToOne 1 100 0.00 1.000 BIT_MASK 0x8 FORMAT "%5.3" ECU_ADDRESS 0x60034CF7 /end MEASUREMENT
/begin MEASUREMENT DFC_b.TST_MOXEMM_SMU_ALM11_4 "" UBYTE DFC_OneToOne 1 100 0.00 1.000 BIT_MASK 0x8 FORMAT "%5.3" ECU_ADDRESS 0x60034CF8 /end MEASUREMENT
/begin MEASUREMENT DFC_b.TST_MOXEMM_SMU_ALM11_5 "" UBYTE DFC_OneToOne 1 100 0.00 1.000 BIT_MASK 0x8 FORMAT "%5.3" ECU_ADDRESS 0x60034CF9 /end MEASUREMENT
/begin MEASUREMENT DFC_b.TST_MOXEMM_SMU_ALM11_8 "" UBYTE DFC_OneToOne 1 100 0.00 1.000 BIT_MASK 0x8 FORMAT "%5.3" ECU_ADDRESS 0x60034CFA /end MEASUREMENT
/begin MEASUREMENT DFC_b.TST_MOXEMM_SMU_ALM11_9 "" UBYTE DFC_OneToOne 1 100 0.00 1.000 BIT_MASK 0x8 FORMAT "%5.3" ECU_ADDRESS 0x60034CFB /end MEASUREMENT
/begin MEASUREMENT DFC_b.TST_MOXEMM_SMU_ALM1_0 "" UBYTE DFC_OneToOne 1 100 0.00 1.000 BIT_MASK 0x8 FORMAT "%5.3" ECU_ADDRESS 0x60034CFC /end MEASUREMENT
/begin MEASUREMENT DFC_b.TST_MOXEMM_SMU_ALM1_1 "" UBYTE DFC_OneToOne 1 100 0.00 1.000 BIT_MASK 0x8 FORMAT "%5.3" ECU_ADDRESS 0x60034CFD /end MEASUREMENT
/begin MEASUREMENT DFC_b.TST_MOXEMM_SMU_ALM1_10 "" UBYTE DFC_OneToOne 1 100 0.00 1.000 BIT_MASK 0x8 FORMAT "%5.3" ECU_ADDRESS 0x60034CFE /end MEASUREMENT
/begin MEASUREMENT DFC_b.TST_MOXEMM_SMU_ALM1_11 "" UBYTE DFC_OneToOne 1 100 0.00 1.000 BIT_MASK 0x8 FORMAT "%5.3" ECU_ADDRESS 0x60034CFF /end MEASUREMENT
/begin MEASUREMENT DFC_b.TST_MOXEMM_SMU_ALM1_13 "" UBYTE DFC_OneToOne 1 100 0.00 1.000 BIT_MASK 0x8 FORMAT "%5.3" ECU_ADDRESS 0x60034D00 /end MEASUREMENT
/begin MEASUREMENT DFC_b.TST_MOXEMM_SMU_ALM1_14 "" UBYTE DFC_OneToOne 1 100 0.00 1.000 BIT_MASK 0x8 FORMAT "%5.3" ECU_ADDRESS 0x60034D01 /end MEASUREMENT
/begin MEASUREMENT DFC_b.TST_MOXEMM_SMU_ALM1_2 "" UBYTE DFC_OneToOne 1 100 0.00 1.000 BIT_MASK 0x8 FORMAT "%5.3" ECU_ADDRESS 0x60034D02 /end MEASUREMENT
/begin MEASUREMENT DFC_b.TST_MOXEMM_SMU_ALM1_22 "" UBYTE DFC_OneToOne 1 100 0.00 1.000 BIT_MASK 0x8 FORMAT "%5.3" ECU_ADDRESS 0x60034D03 /end MEASUREMENT
/begin MEASUREMENT DFC_b.TST_MOXEMM_SMU_ALM1_23 "" UBYTE DFC_OneToOne 1 100 0.00 1.000 BIT_MASK 0x8 FORMAT "%5.3" ECU_ADDRESS 0x60034D04 /end MEASUREMENT
/begin MEASUREMENT DFC_b.TST_MOXEMM_SMU_ALM1_4 "" UBYTE DFC_OneToOne 1 100 0.00 1.000 BIT_MASK 0x8 FORMAT "%5.3" ECU_ADDRESS 0x60034D05 /end MEASUREMENT
/begin MEASUREMENT DFC_b.TST_MOXEMM_SMU_ALM1_5 "" UBYTE DFC_OneToOne 1 100 0.00 1.000 BIT_MASK 0x8 FORMAT "%5.3" ECU_ADDRESS 0x60034D06 /end MEASUREMENT
/begin MEASUREMENT DFC_b.TST_MOXEMM_SMU_ALM1_7 "" UBYTE DFC_OneToOne 1 100 0.00 1.000 BIT_MASK 0x8 FORMAT "%5.3" ECU_ADDRESS 0x60034D07 /end MEASUREMENT
/begin MEASUREMENT DFC_b.TST_MOXEMM_SMU_ALM1_8 "" UBYTE DFC_OneToOne 1 100 0.00 1.000 BIT_MASK 0x8 FORMAT "%5.3" ECU_ADDRESS 0x60034D08 /end MEASUREMENT
/begin MEASUREMENT DFC_b.TST_MOXEMM_SMU_ALM21_0 "" UBYTE DFC_OneToOne 1 100 0.00 1.000 BIT_MASK 0x8 FORMAT "%5.3" ECU_ADDRESS 0x60034D09 /end MEASUREMENT
/begin MEASUREMENT DFC_b.TST_MOXEMM_SMU_ALM21_16 "" UBYTE DFC_OneToOne 1 100 0.00 1.000 BIT_MASK 0x8 FORMAT "%5.3" ECU_ADDRESS 0x60034D0A /end MEASUREMENT
/begin MEASUREMENT DFC_b.TST_MOXEMM_SMU_ALM21_3 "" UBYTE DFC_OneToOne 1 100 0.00 1.000 BIT_MASK 0x8 FORMAT "%5.3" ECU_ADDRESS 0x60034D0B /end MEASUREMENT
/begin MEASUREMENT DFC_b.TST_MOXEMM_SMU_ALM2_1 "" UBYTE DFC_OneToOne 1 100 0.00 1.000 BIT_MASK 0x8 FORMAT "%5.3" ECU_ADDRESS 0x60034D0C /end MEASUREMENT
/begin MEASUREMENT DFC_b.TST_MOXEMM_SMU_ALM2_10 "" UBYTE DFC_OneToOne 1 100 0.00 1.000 BIT_MASK 0x8 FORMAT "%5.3" ECU_ADDRESS 0x60034D0D /end MEASUREMENT
/begin MEASUREMENT DFC_b.TST_MOXEMM_SMU_ALM2_11 "" UBYTE DFC_OneToOne 1 100 0.00 1.000 BIT_MASK 0x8 FORMAT "%5.3" ECU_ADDRESS 0x60034D0E /end MEASUREMENT
/begin MEASUREMENT DFC_b.TST_MOXEMM_SMU_ALM2_13 "" UBYTE DFC_OneToOne 1 100 0.00 1.000 BIT_MASK 0x8 FORMAT "%5.3" ECU_ADDRESS 0x60034D0F /end MEASUREMENT
/begin MEASUREMENT DFC_b.TST_MOXEMM_SMU_ALM2_14 "" UBYTE DFC_OneToOne 1 100 0.00 1.000 BIT_MASK 0x8 FORMAT "%5.3" ECU_ADDRESS 0x60034D10 /end MEASUREMENT
/begin MEASUREMENT DFC_b.TST_MOXEMM_SMU_ALM2_22 "" UBYTE DFC_OneToOne 1 100 0.00 1.000 BIT_MASK 0x8 FORMAT "%5.3" ECU_ADDRESS 0x60034D11 /end MEASUREMENT
/begin MEASUREMENT DFC_b.TST_MOXEMM_SMU_ALM2_23 "" UBYTE DFC_OneToOne 1 100 0.00 1.000 BIT_MASK 0x8 FORMAT "%5.3" ECU_ADDRESS 0x60034D12 /end MEASUREMENT
/begin MEASUREMENT DFC_b.TST_MOXEMM_SMU_ALM2_4 "" UBYTE DFC_OneToOne 1 100 0.00 1.000 BIT_MASK 0x8 FORMAT "%5.3" ECU_ADDRESS 0x60034D13 /end MEASUREMENT
/begin MEASUREMENT DFC_b.TST_MOXEMM_SMU_ALM2_5 "" UBYTE DFC_OneToOne 1 100 0.00 1.000 BIT_MASK 0x8 FORMAT "%5.3" ECU_ADDRESS 0x60034D14 /end MEASUREMENT
/begin MEASUREMENT DFC_b.TST_MOXEMM_SMU_ALM2_7 "" UBYTE DFC_OneToOne 1 100 0.00 1.000 BIT_MASK 0x8 FORMAT "%5.3" ECU_ADDRESS 0x60034D15 /end MEASUREMENT
/begin MEASUREMENT DFC_b.TST_MOXEMM_SMU_ALM2_8 "" UBYTE DFC_OneToOne 1 100 0.00 1.000 BIT_MASK 0x8 FORMAT "%5.3" ECU_ADDRESS 0x60034D16 /end MEASUREMENT
/begin MEASUREMENT DFC_b.TST_MOXEMM_SMU_ALM6_0 "" UBYTE DFC_OneToOne 1 100 0.00 1.000 BIT_MASK 0x8 FORMAT "%5.3" ECU_ADDRESS 0x60034D17 /end MEASUREMENT
/begin MEASUREMENT DFC_b.TST_MOXEMM_SMU_ALM6_11 "" UBYTE DFC_OneToOne 1 100 0.00 1.000 BIT_MASK 0x8 FORMAT "%5.3" ECU_ADDRESS 0x60034D18 /end MEASUREMENT
/begin MEASUREMENT DFC_b.TST_MOXEMM_SMU_ALM6_12 "" UBYTE DFC_OneToOne 1 100 0.00 1.000 BIT_MASK 0x8 FORMAT "%5.3" ECU_ADDRESS 0x60034D19 /end MEASUREMENT
/begin MEASUREMENT DFC_b.TST_MOXEMM_SMU_ALM6_14 "" UBYTE DFC_OneToOne 1 100 0.00 1.000 BIT_MASK 0x8 FORMAT "%5.3" ECU_ADDRESS 0x60034D1A /end MEASUREMENT
/begin MEASUREMENT DFC_b.TST_MOXEMM_SMU_ALM6_15 "" UBYTE DFC_OneToOne 1 100 0.00 1.000 BIT_MASK 0x8 FORMAT "%5.3" ECU_ADDRESS 0x60034D1B /end MEASUREMENT
/begin MEASUREMENT DFC_b.TST_MOXEMM_SMU_ALM6_17 "" UBYTE DFC_OneToOne 1 100 0.00 1.000 BIT_MASK 0x8 FORMAT "%5.3" ECU_ADDRESS 0x60034D1C /end MEASUREMENT
/begin MEASUREMENT DFC_b.TST_MOXEMM_SMU_ALM6_18 "" UBYTE DFC_OneToOne 1 100 0.00 1.000 BIT_MASK 0x8 FORMAT "%5.3" ECU_ADDRESS 0x60034D1D /end MEASUREMENT
/begin MEASUREMENT DFC_b.TST_MOXEMM_SMU_ALM6_20 "" UBYTE DFC_OneToOne 1 100 0.00 1.000 BIT_MASK 0x8 FORMAT "%5.3" ECU_ADDRESS 0x60034D1E /end MEASUREMENT
/begin MEASUREMENT DFC_b.TST_MOXEMM_SMU_ALM6_21 "" UBYTE DFC_OneToOne 1 100 0.00 1.000 BIT_MASK 0x8 FORMAT "%5.3" ECU_ADDRESS 0x60034D1F /end MEASUREMENT
/begin MEASUREMENT DFC_b.TST_MOXEMM_SMU_ALM6_25 "" UBYTE DFC_OneToOne 1 100 0.00 1.000 BIT_MASK 0x8 FORMAT "%5.3" ECU_ADDRESS 0x60034D20 /end MEASUREMENT
/begin MEASUREMENT DFC_b.TST_MOXEMM_SMU_ALM6_4 "" UBYTE DFC_OneToOne 1 100 0.00 1.000 BIT_MASK 0x8 FORMAT "%5.3" ECU_ADDRESS 0x60034D21 /end MEASUREMENT
/begin MEASUREMENT DFC_b.TST_MOXEMM_SMU_ALM6_5 "" UBYTE DFC_OneToOne 1 100 0.00 1.000 BIT_MASK 0x8 FORMAT "%5.3" ECU_ADDRESS 0x60034D22 /end MEASUREMENT
/begin MEASUREMENT DFC_b.TST_MOXEMM_SMU_ALM6_7 "" UBYTE DFC_OneToOne 1 100 0.00 1.000 BIT_MASK 0x8 FORMAT "%5.3" ECU_ADDRESS 0x60034D23 /end MEASUREMENT
/begin MEASUREMENT DFC_b.TST_MOXEMM_SMU_ALM6_8 "" UBYTE DFC_OneToOne 1 100 0.00 1.000 BIT_MASK 0x8 FORMAT "%5.3" ECU_ADDRESS 0x60034D24 /end MEASUREMENT
/begin MEASUREMENT DFC_b.TST_MOXEMM_SMU_ALM7_1 "" UBYTE DFC_OneToOne 1 100 0.00 1.000 BIT_MASK 0x8 FORMAT "%5.3" ECU_ADDRESS 0x60034D25 /end MEASUREMENT
/begin MEASUREMENT DFC_b.TST_MOXEMM_SMU_ALM7_12 "" UBYTE DFC_OneToOne 1 100 0.00 1.000 BIT_MASK 0x8 FORMAT "%5.3" ECU_ADDRESS 0x60034D26 /end MEASUREMENT
/begin MEASUREMENT DFC_b.TST_MOXEMM_SMU_ALM7_13 "" UBYTE DFC_OneToOne 1 100 0.00 1.000 BIT_MASK 0x8 FORMAT "%5.3" ECU_ADDRESS 0x60034D27 /end MEASUREMENT
/begin MEASUREMENT DFC_b.TST_MOXEMM_SMU_ALM7_14 "" UBYTE DFC_OneToOne 1 100 0.00 1.000 BIT_MASK 0x8 FORMAT "%5.3" ECU_ADDRESS 0x60034D28 /end MEASUREMENT
/begin MEASUREMENT DFC_b.TST_MOXEMM_SMU_ALM7_15 "" UBYTE DFC_OneToOne 1 100 0.00 1.000 BIT_MASK 0x8 FORMAT "%5.3" ECU_ADDRESS 0x60034D29 /end MEASUREMENT
/begin MEASUREMENT DFC_b.TST_MOXEMM_SMU_ALM7_16 "" UBYTE DFC_OneToOne 1 100 0.00 1.000 BIT_MASK 0x8 FORMAT "%5.3" ECU_ADDRESS 0x60034D2A /end MEASUREMENT
/begin MEASUREMENT DFC_b.TST_MOXEMM_SMU_ALM7_17 "" UBYTE DFC_OneToOne 1 100 0.00 1.000 BIT_MASK 0x8 FORMAT "%5.3" ECU_ADDRESS 0x60034D2B /end MEASUREMENT
/begin MEASUREMENT DFC_b.TST_MOXEMM_SMU_ALM7_2 "" UBYTE DFC_OneToOne 1 100 0.00 1.000 BIT_MASK 0x8 FORMAT "%5.3" ECU_ADDRESS 0x60034D2C /end MEASUREMENT
/begin MEASUREMENT DFC_b.TST_MOXEMM_SMU_ALM7_20 "" UBYTE DFC_OneToOne 1 100 0.00 1.000 BIT_MASK 0x8 FORMAT "%5.3" ECU_ADDRESS 0x60034D2D /end MEASUREMENT
/begin MEASUREMENT DFC_b.TST_MOXEMM_SMU_ALM7_25 "" UBYTE DFC_OneToOne 1 100 0.00 1.000 BIT_MASK 0x8 FORMAT "%5.3" ECU_ADDRESS 0x60034D2E /end MEASUREMENT
/begin MEASUREMENT DFC_b.TST_MOXEMM_SMU_ALM7_26 "" UBYTE DFC_OneToOne 1 100 0.00 1.000 BIT_MASK 0x8 FORMAT "%5.3" ECU_ADDRESS 0x60034D2F /end MEASUREMENT
/begin MEASUREMENT DFC_b.TST_MOXEMM_SMU_ALM7_28 "" UBYTE DFC_OneToOne 1 100 0.00 1.000 BIT_MASK 0x8 FORMAT "%5.3" ECU_ADDRESS 0x60034D30 /end MEASUREMENT
/begin MEASUREMENT DFC_b.TST_MOXEMM_SMU_ALM7_29 "" UBYTE DFC_OneToOne 1 100 0.00 1.000 BIT_MASK 0x8 FORMAT "%5.3" ECU_ADDRESS 0x60034D31 /end MEASUREMENT
/begin MEASUREMENT DFC_b.TST_MOXEMM_SMU_ALM7_30 "" UBYTE DFC_OneToOne 1 100 0.00 1.000 BIT_MASK 0x8 FORMAT "%5.3" ECU_ADDRESS 0x60034D32 /end MEASUREMENT
/begin MEASUREMENT DFC_b.TST_MOXEMM_SMU_ALM7_31 "" UBYTE DFC_OneToOne 1 100 0.00 1.000 BIT_MASK 0x8 FORMAT "%5.3" ECU_ADDRESS 0x60034D33 /end MEASUREMENT
/begin MEASUREMENT DFC_b.TST_MOXEMM_SMU_ALM8_0 "" UBYTE DFC_OneToOne 1 100 0.00 1.000 BIT_MASK 0x8 FORMAT "%5.3" ECU_ADDRESS 0x60034D34 /end MEASUREMENT
/begin MEASUREMENT DFC_b.TST_MOXEMM_SMU_ALM8_1 "" UBYTE DFC_OneToOne 1 100 0.00 1.000 BIT_MASK 0x8 FORMAT "%5.3" ECU_ADDRESS 0x60034D35 /end MEASUREMENT
/begin MEASUREMENT DFC_b.TST_MOXEMM_SMU_ALM8_10 "" UBYTE DFC_OneToOne 1 100 0.00 1.000 BIT_MASK 0x8 FORMAT "%5.3" ECU_ADDRESS 0x60034D36 /end MEASUREMENT
/begin MEASUREMENT DFC_b.TST_MOXEMM_SMU_ALM8_11 "" UBYTE DFC_OneToOne 1 100 0.00 1.000 BIT_MASK 0x8 FORMAT "%5.3" ECU_ADDRESS 0x60034D37 /end MEASUREMENT
/begin MEASUREMENT DFC_b.TST_MOXEMM_SMU_ALM8_12 "" UBYTE DFC_OneToOne 1 100 0.00 1.000 BIT_MASK 0x8 FORMAT "%5.3" ECU_ADDRESS 0x60034D38 /end MEASUREMENT
/begin MEASUREMENT DFC_b.TST_MOXEMM_SMU_ALM8_16 "" UBYTE DFC_OneToOne 1 100 0.00 1.000 BIT_MASK 0x8 FORMAT "%5.3" ECU_ADDRESS 0x60034D39 /end MEASUREMENT
/begin MEASUREMENT DFC_b.TST_MOXEMM_SMU_ALM8_18 "" UBYTE DFC_OneToOne 1 100 0.00 1.000 BIT_MASK 0x8 FORMAT "%5.3" ECU_ADDRESS 0x60034D3A /end MEASUREMENT
/begin MEASUREMENT DFC_b.TST_MOXEMM_SMU_ALM8_2 "" UBYTE DFC_OneToOne 1 100 0.00 1.000 BIT_MASK 0x8 FORMAT "%5.3" ECU_ADDRESS 0x60034D3B /end MEASUREMENT
/begin MEASUREMENT DFC_b.TST_MOXEMM_SMU_ALM8_3 "" UBYTE DFC_OneToOne 1 100 0.00 1.000 BIT_MASK 0x8 FORMAT "%5.3" ECU_ADDRESS 0x60034D3C /end MEASUREMENT
/begin MEASUREMENT DFC_b.TST_MOXEMM_SMU_ALM8_31 "" UBYTE DFC_OneToOne 1 100 0.00 1.000 BIT_MASK 0x8 FORMAT "%5.3" ECU_ADDRESS 0x60034D3D /end MEASUREMENT
/begin MEASUREMENT DFC_b.TST_MOXEMM_SMU_ALM8_4 "" UBYTE DFC_OneToOne 1 100 0.00 1.000 BIT_MASK 0x8 FORMAT "%5.3" ECU_ADDRESS 0x60034D3E /end MEASUREMENT
/begin MEASUREMENT DFC_b.TST_MOXEMM_SMU_ALM9_0 "" UBYTE DFC_OneToOne 1 100 0.00 1.000 BIT_MASK 0x8 FORMAT "%5.3" ECU_ADDRESS 0x60034D3F /end MEASUREMENT
/begin MEASUREMENT DFC_b.TST_MOXEMM_SMU_ALM9_15 "" UBYTE DFC_OneToOne 1 100 0.00 1.000 BIT_MASK 0x8 FORMAT "%5.3" ECU_ADDRESS 0x60034D40 /end MEASUREMENT
/begin MEASUREMENT DFC_b.TST_MOXEMM_SMU_ALM9_3 "" UBYTE DFC_OneToOne 1 100 0.00 1.000 BIT_MASK 0x8 FORMAT "%5.3" ECU_ADDRESS 0x60034D41 /end MEASUREMENT
/begin MEASUREMENT DFC_b.TST_MoCADCNTPBnk1 "" UBYTE DFC_OneToOne 1 100 0.00 1.000 BIT_MASK 0x8 FORMAT "%5.3" ECU_ADDRESS 0x60034D42 /end MEASUREMENT
/begin MEASUREMENT DFC_b.TST_MoCADCTestVoltBnk1 "" UBYTE DFC_OneToOne 1 100 0.00 1.000 BIT_MASK 0x8 FORMAT "%5.3" ECU_ADDRESS 0x60034D43 /end MEASUREMENT
/begin MEASUREMENT DFC_b.TST_MoCSOPICO "" UBYTE DFC_OneToOne 1 100 0.00 1.000 BIT_MASK 0x8 FORMAT "%5.3" ECU_ADDRESS 0x60034D44 /end MEASUREMENT
/begin MEASUREMENT DFC_b.TST_MoFAccr "" UBYTE DFC_OneToOne 1 100 0.00 1.000 BIT_MASK 0x8 FORMAT "%5.3" ECU_ADDRESS 0x60034D45 /end MEASUREMENT
/begin MEASUREMENT DFC_b.TST_MoFCbnPreCdngOvrheat "" UBYTE DFC_OneToOne 1 100 0.00 1.000 BIT_MASK 0x8 FORMAT "%5.3" ECU_ADDRESS 0x60034D46 /end MEASUREMENT
/begin MEASUREMENT DFC_b.TST_MoFCbnPreCdngTmrExpi "" UBYTE DFC_OneToOne 1 100 0.00 1.000 BIT_MASK 0x8 FORMAT "%5.3" ECU_ADDRESS 0x60034D47 /end MEASUREMENT
/begin MEASUREMENT DFC_b.TST_MoFEvMngtBms "" UBYTE DFC_OneToOne 1 100 0.00 1.000 BIT_MASK 0x8 FORMAT "%5.3" ECU_ADDRESS 0x60034D48 /end MEASUREMENT
/begin MEASUREMENT DFC_b.TST_MoFEvMngtDcdc "" UBYTE DFC_OneToOne 1 100 0.00 1.000 BIT_MASK 0x8 FORMAT "%5.3" ECU_ADDRESS 0x60034D49 /end MEASUREMENT
/begin MEASUREMENT DFC_b.TST_MoFEvMngtEm01 "" UBYTE DFC_OneToOne 1 100 0.00 1.000 BIT_MASK 0x8 FORMAT "%5.3" ECU_ADDRESS 0x60034D4A /end MEASUREMENT
/begin MEASUREMENT DFC_b.TST_MoFEvMngtEm01BrkgToZr "" UBYTE DFC_OneToOne 1 100 0.00 1.000 BIT_MASK 0x8 FORMAT "%5.3" ECU_ADDRESS 0x60034D4B /end MEASUREMENT
/begin MEASUREMENT DFC_b.TST_MoFEvMngtEm01EngSpd "" UBYTE DFC_OneToOne 1 100 0.00 1.000 BIT_MASK 0x8 FORMAT "%5.3" ECU_ADDRESS 0x60034D4C /end MEASUREMENT
/begin MEASUREMENT DFC_b.TST_MoFEvMngtEm02EngSpd "" UBYTE DFC_OneToOne 1 100 0.00 1.000 BIT_MASK 0x8 FORMAT "%5.3" ECU_ADDRESS 0x60034D4D /end MEASUREMENT
/begin MEASUREMENT DFC_b.TST_MoFEvMngtEm02Lvl1 "" UBYTE DFC_OneToOne 1 100 0.00 1.000 BIT_MASK 0x8 FORMAT "%5.3" ECU_ADDRESS 0x60034D4E /end MEASUREMENT
/begin MEASUREMENT DFC_b.TST_MoFEvMngtEm02Lvl2 "" UBYTE DFC_OneToOne 1 100 0.00 1.000 BIT_MASK 0x8 FORMAT "%5.3" ECU_ADDRESS 0x60034D4F /end MEASUREMENT
/begin MEASUREMENT DFC_b.TST_MoFExtCptAuxCpt "" UBYTE DFC_OneToOne 1 100 0.00 1.000 BIT_MASK 0x8 FORMAT "%5.3" ECU_ADDRESS 0x60034D50 /end MEASUREMENT
/begin MEASUREMENT DFC_b.TST_MoFExtCptVacPmpErr "" UBYTE DFC_OneToOne 1 100 0.00 1.000 BIT_MASK 0x8 FORMAT "%5.3" ECU_ADDRESS 0x60034D51 /end MEASUREMENT
/begin MEASUREMENT DFC_b.TST_MoFTqPtdAxle "" UBYTE DFC_OneToOne 1 100 0.00 1.000 BIT_MASK 0x8 FORMAT "%5.3" ECU_ADDRESS 0x60034D52 /end MEASUREMENT
/begin MEASUREMENT DFC_b.TST_MoFTqPtdAxleSec "" UBYTE DFC_OneToOne 1 100 0.00 1.000 BIT_MASK 0x8 FORMAT "%5.3" ECU_ADDRESS 0x60034D53 /end MEASUREMENT
/begin MEASUREMENT DFC_b.TST_MoFTqPtdEmPtRels "" UBYTE DFC_OneToOne 1 100 0.00 1.000 BIT_MASK 0x8 FORMAT "%5.3" ECU_ADDRESS 0x60034D54 /end MEASUREMENT
/begin MEASUREMENT DFC_b.TST_MoFTqPtdEmPtRelsSec "" UBYTE DFC_OneToOne 1 100 0.00 1.000 BIT_MASK 0x8 FORMAT "%5.3" ECU_ADDRESS 0x60034D55 /end MEASUREMENT
/begin MEASUREMENT DFC_b.TST_MoFTqPtdEmSign "" UBYTE DFC_OneToOne 1 100 0.00 1.000 BIT_MASK 0x8 FORMAT "%5.3" ECU_ADDRESS 0x60034D56 /end MEASUREMENT
/begin MEASUREMENT DFC_b.TST_MoFTqPtdEmSignSec "" UBYTE DFC_OneToOne 1 100 0.00 1.000 BIT_MASK 0x8 FORMAT "%5.3" ECU_ADDRESS 0x60034D57 /end MEASUREMENT
/begin MEASUREMENT DFC_b.TST_MoFTqPtdEmTq "" UBYTE DFC_OneToOne 1 100 0.00 1.000 BIT_MASK 0x8 FORMAT "%5.3" ECU_ADDRESS 0x60034D58 /end MEASUREMENT
/begin MEASUREMENT DFC_b.TST_MoFTqPtdEmTqSec "" UBYTE DFC_OneToOne 1 100 0.00 1.000 BIT_MASK 0x8 FORMAT "%5.3" ECU_ADDRESS 0x60034D59 /end MEASUREMENT
/begin MEASUREMENT DFC_b.TST_MoFTqPtdVeh "" UBYTE DFC_OneToOne 1 100 0.00 1.000 BIT_MASK 0x8 FORMAT "%5.3" ECU_ADDRESS 0x60034D5A /end MEASUREMENT
/begin MEASUREMENT DFC_b.TST_MoFVarPostBldSel "" UBYTE DFC_OneToOne 1 100 0.00 1.000 BIT_MASK 0x8 FORMAT "%5.3" ECU_ADDRESS 0x60034D5B /end MEASUREMENT
/begin MEASUREMENT DFC_b.TST_MoSysCtrlReIni "" UBYTE DFC_OneToOne 1 100 0.00 1.000 BIT_MASK 0x8 FORMAT "%5.3" ECU_ADDRESS 0x60034D5C /end MEASUREMENT
/begin MEASUREMENT DFC_b.TST_MoXEMMHwLTMCUFW "" UBYTE DFC_OneToOne 1 100 0.00 1.000 BIT_MASK 0x8 FORMAT "%5.3" ECU_ADDRESS 0x60034D5D /end MEASUREMENT
/begin MEASUREMENT DFC_b.TST_MoXEMMHwLTMonBIST "" UBYTE DFC_OneToOne 1 100 0.00 1.000 BIT_MASK 0x8 FORMAT "%5.3" ECU_ADDRESS 0x60034D5E /end MEASUREMENT
/begin MEASUREMENT DFC_b.TST_MoXEMMHwLTRegMonTest "" UBYTE DFC_OneToOne 1 100 0.00 1.000 BIT_MASK 0x8 FORMAT "%5.3" ECU_ADDRESS 0x60034D5F /end MEASUREMENT
/begin MEASUREMENT DFC_b.TST_MoXEMMHwLTStbySMUAlvTest "" UBYTE DFC_OneToOne 1 100 0.00 1.000 BIT_MASK 0x8 FORMAT "%5.3" ECU_ADDRESS 0x60034D60 /end MEASUREMENT
/begin MEASUREMENT DFC_b.TST_MoXEMMHwLTTempSens "" UBYTE DFC_OneToOne 1 100 0.00 1.000 BIT_MASK 0x8 FORMAT "%5.3" ECU_ADDRESS 0x60034D61 /end MEASUREMENT
/begin MEASUREMENT DFC_b.TST_MoXEMMHwLTUCBCfg "" UBYTE DFC_OneToOne 1 100 0.00 1.000 BIT_MASK 0x8 FORMAT "%5.3" ECU_ADDRESS 0x60034D62 /end MEASUREMENT
/begin MEASUREMENT DFC_b.TST_MonEgyChrgnCoorr_AcChrgnWoMofRels "" UBYTE DFC_OneToOne 1 100 0.00 1.000 BIT_MASK 0x8 FORMAT "%5.3" ECU_ADDRESS 0x60034D63 /end MEASUREMENT
/begin MEASUREMENT DFC_b.TST_MonEgyChrgnCoorr_ChrgnAbortIgr "" UBYTE DFC_OneToOne 1 100 0.00 1.000 BIT_MASK 0x8 FORMAT "%5.3" ECU_ADDRESS 0x60034D64 /end MEASUREMENT
/begin MEASUREMENT DFC_b.TST_MonEgyChrgnCoorr_DcCntctFailr "" UBYTE DFC_OneToOne 1 100 0.00 1.000 BIT_MASK 0x8 FORMAT "%5.3" ECU_ADDRESS 0x60034D65 /end MEASUREMENT
/begin MEASUREMENT DFC_b.TST_MonEgyChrgnCoorr_ExtChrgnShtOffReq "" UBYTE DFC_OneToOne 1 100 0.00 1.000 BIT_MASK 0x8 FORMAT "%5.3" ECU_ADDRESS 0x60034D66 /end MEASUREMENT
/begin MEASUREMENT DFC_b.TST_MonEgyChrgnCoorr_ImpsChrgnMod "" UBYTE DFC_OneToOne 1 100 0.00 1.000 BIT_MASK 0x8 FORMAT "%5.3" ECU_ADDRESS 0x60034D67 /end MEASUREMENT
/begin MEASUREMENT DFC_b.TST_MonEgyChrgnCoorr_ImpsChrgnPrms "" UBYTE DFC_OneToOne 1 100 0.00 1.000 BIT_MASK 0x8 FORMAT "%5.3" ECU_ADDRESS 0x60034D68 /end MEASUREMENT
/begin MEASUREMENT DFC_b.TST_MonEgyChrgnCoorr_ImpsUDcIntk "" UBYTE DFC_OneToOne 1 100 0.00 1.000 BIT_MASK 0x8 FORMAT "%5.3" ECU_ADDRESS 0x60034D69 /end MEASUREMENT
/begin MEASUREMENT DFC_b.TST_MonEgyChrgnCoorr_PlgLockMovmt "" UBYTE DFC_OneToOne 1 100 0.00 1.000 BIT_MASK 0x8 FORMAT "%5.3" ECU_ADDRESS 0x60034D6A /end MEASUREMENT
/begin MEASUREMENT DFC_b.TST_MonEgyChrgnCoorr_VehCrashDetn "" UBYTE DFC_OneToOne 1 100 0.00 1.000 BIT_MASK 0x8 FORMAT "%5.3" ECU_ADDRESS 0x60034D6B /end MEASUREMENT
/begin MEASUREMENT DFC_b.TST_MonEgyChrgnErrReactn_SftySwt "" UBYTE DFC_OneToOne 1 100 0.00 1.000 BIT_MASK 0x8 FORMAT "%5.3" ECU_ADDRESS 0x60034D6C /end MEASUREMENT
/begin MEASUREMENT DFC_b.TST_MonEgyChrgnInlet_CcsPlgCtp "" UBYTE DFC_OneToOne 1 100 0.00 1.000 BIT_MASK 0x8 FORMAT "%5.3" ECU_ADDRESS 0x60034D6D /end MEASUREMENT
/begin MEASUREMENT DFC_b.TST_MonEgyChrgnInlet_CcsPlgCtpPwm "" UBYTE DFC_OneToOne 1 100 0.00 1.000 BIT_MASK 0x8 FORMAT "%5.3" ECU_ADDRESS 0x60034D6E /end MEASUREMENT
/begin MEASUREMENT DFC_b.TST_MonEgyChrgnInlet_CcsPlgLockCtrlImpsAtmpt "" UBYTE DFC_OneToOne 1 100 0.00 1.000 BIT_MASK 0x8 FORMAT "%5.3" ECU_ADDRESS 0x60034D6F /end MEASUREMENT
/begin MEASUREMENT DFC_b.TST_MonEgyChrgnInlet_CcsPlgLockSnsrSigRngChk "" UBYTE DFC_OneToOne 1 100 0.00 1.000 BIT_MASK 0x8 FORMAT "%5.3" ECU_ADDRESS 0x60034D70 /end MEASUREMENT
/begin MEASUREMENT DFC_b.TST_MonEgyChrgnInlet_CcsPlgLockStImps "" UBYTE DFC_OneToOne 1 100 0.00 1.000 BIT_MASK 0x8 FORMAT "%5.3" ECU_ADDRESS 0x60034D71 /end MEASUREMENT
/begin MEASUREMENT DFC_b.TST_MonEgyChrgnInlet_CcsPlgPxp "" UBYTE DFC_OneToOne 1 100 0.00 1.000 BIT_MASK 0x8 FORMAT "%5.3" ECU_ADDRESS 0x60034D72 /end MEASUREMENT
/begin MEASUREMENT DFC_b.TST_MonEgyChrgnT_Snsr1GrdtChk "" UBYTE DFC_OneToOne 1 100 0.00 1.000 BIT_MASK 0x8 FORMAT "%5.3" ECU_ADDRESS 0x60034D73 /end MEASUREMENT
/begin MEASUREMENT DFC_b.TST_MonEgyChrgnT_Snsr1SigRngChk "" UBYTE DFC_OneToOne 1 100 0.00 1.000 BIT_MASK 0x8 FORMAT "%5.3" ECU_ADDRESS 0x60034D74 /end MEASUREMENT
/begin MEASUREMENT DFC_b.TST_MonEgyChrgnT_Snsr2GrdtChk "" UBYTE DFC_OneToOne 1 100 0.00 1.000 BIT_MASK 0x8 FORMAT "%5.3" ECU_ADDRESS 0x60034D75 /end MEASUREMENT
/begin MEASUREMENT DFC_b.TST_MonEgyChrgnT_Snsr2SigRngChk "" UBYTE DFC_OneToOne 1 100 0.00 1.000 BIT_MASK 0x8 FORMAT "%5.3" ECU_ADDRESS 0x60034D76 /end MEASUREMENT
/begin MEASUREMENT DFC_b.TST_MonEgyChrgnT_SnsrDif "" UBYTE DFC_OneToOne 1 100 0.00 1.000 BIT_MASK 0x8 FORMAT "%5.3" ECU_ADDRESS 0x60034D77 /end MEASUREMENT
/begin MEASUREMENT DFC_b.TST_OCWDAABEActv "" UBYTE DFC_OneToOne 1 100 0.00 1.000 BIT_MASK 0x8 FORMAT "%5.3" ECU_ADDRESS 0x60034D78 /end MEASUREMENT
/begin MEASUREMENT DFC_b.TST_OCWDACom "" UBYTE DFC_OneToOne 1 100 0.00 1.000 BIT_MASK 0x8 FORMAT "%5.3" ECU_ADDRESS 0x60034D79 /end MEASUREMENT
/begin MEASUREMENT DFC_b.TST_OCWDAErrPin "" UBYTE DFC_OneToOne 1 100 0.00 1.000 BIT_MASK 0x8 FORMAT "%5.3" ECU_ADDRESS 0x60034D7A /end MEASUREMENT
/begin MEASUREMENT DFC_b.TST_OCWDAOvrVltg "" UBYTE DFC_OneToOne 1 100 0.00 1.000 BIT_MASK 0x8 FORMAT "%5.3" ECU_ADDRESS 0x60034D7B /end MEASUREMENT
/begin MEASUREMENT DFC_b.TST_PUmax "" UBYTE DFC_OneToOne 1 100 0.00 1.000 BIT_MASK 0x8 FORMAT "%5.3" ECU_ADDRESS 0x60034D7C /end MEASUREMENT
/begin MEASUREMENT DFC_b.TST_PwmCtPTmpErr "" UBYTE DFC_OneToOne 1 100 0.00 1.000 BIT_MASK 0x8 FORMAT "%5.3" ECU_ADDRESS 0x60034D7D /end MEASUREMENT
/begin MEASUREMENT DFC_b.TST_PwrDistbnUnitTSRCMax "" UBYTE DFC_OneToOne 1 100 0.00 1.000 BIT_MASK 0x8 FORMAT "%5.3" ECU_ADDRESS 0x60034D7E /end MEASUREMENT
/begin MEASUREMENT DFC_b.TST_PwrDistbnUnitTTmpErr "" UBYTE DFC_OneToOne 1 100 0.00 1.000 BIT_MASK 0x8 FORMAT "%5.3" ECU_ADDRESS 0x60034D7F /end MEASUREMENT
/begin MEASUREMENT DFC_b.TST_SCtPmp1DiagGrdKeyErr "" UBYTE DFC_OneToOne 1 100 0.00 1.000 BIT_MASK 0x8 FORMAT "%5.3" ECU_ADDRESS 0x60034D80 /end MEASUREMENT
/begin MEASUREMENT DFC_b.TST_SRCHighAPP1 "" UBYTE DFC_OneToOne 1 100 0.00 1.000 BIT_MASK 0x8 FORMAT "%5.3" ECU_ADDRESS 0x60034D81 /end MEASUREMENT
/begin MEASUREMENT DFC_b.TST_SRCHighAPP2 "" UBYTE DFC_OneToOne 1 100 0.00 1.000 BIT_MASK 0x8 FORMAT "%5.3" ECU_ADDRESS 0x60034D82 /end MEASUREMENT
/begin MEASUREMENT DFC_b.TST_SRCLowAPP1 "" UBYTE DFC_OneToOne 1 100 0.00 1.000 BIT_MASK 0x8 FORMAT "%5.3" ECU_ADDRESS 0x60034D83 /end MEASUREMENT
/begin MEASUREMENT DFC_b.TST_SRCLowAPP2 "" UBYTE DFC_OneToOne 1 100 0.00 1.000 BIT_MASK 0x8 FORMAT "%5.3" ECU_ADDRESS 0x60034D84 /end MEASUREMENT
/begin MEASUREMENT DFC_b.TST_SWReset_0 "" UBYTE DFC_OneToOne 1 100 0.00 1.000 BIT_MASK 0x8 FORMAT "%5.3" ECU_ADDRESS 0x60034D85 /end MEASUREMENT
/begin MEASUREMENT DFC_b.TST_SWReset_1 "" UBYTE DFC_OneToOne 1 100 0.00 1.000 BIT_MASK 0x8 FORMAT "%5.3" ECU_ADDRESS 0x60034D86 /end MEASUREMENT
/begin MEASUREMENT DFC_b.TST_SWReset_2 "" UBYTE DFC_OneToOne 1 100 0.00 1.000 BIT_MASK 0x8 FORMAT "%5.3" ECU_ADDRESS 0x60034D87 /end MEASUREMENT
/begin MEASUREMENT DFC_b.TST_Sia_InvldCode "" UBYTE DFC_OneToOne 1 100 0.00 1.000 BIT_MASK 0x8 FORMAT "%5.3" ECU_ADDRESS 0x60034D88 /end MEASUREMENT
/begin MEASUREMENT DFC_b.TST_Sia_InvldKey "" UBYTE DFC_OneToOne 1 100 0.00 1.000 BIT_MASK 0x8 FORMAT "%5.3" ECU_ADDRESS 0x60034D89 /end MEASUREMENT
/begin MEASUREMENT DFC_b.TST_Sia_NoRespUCx "" UBYTE DFC_OneToOne 1 100 0.00 1.000 BIT_MASK 0x8 FORMAT "%5.3" ECU_ADDRESS 0x60034D8A /end MEASUREMENT
/begin MEASUREMENT DFC_b.TST_Sia_TprotRttp "" UBYTE DFC_OneToOne 1 100 0.00 1.000 BIT_MASK 0x8 FORMAT "%5.3" ECU_ADDRESS 0x60034D8B /end MEASUREMENT
/begin MEASUREMENT DFC_b.TST_StrtUpEvStandStillDeactvn "" UBYTE DFC_OneToOne 1 100 0.00 1.000 BIT_MASK 0x8 FORMAT "%5.3" ECU_ADDRESS 0x60034D8C /end MEASUREMENT
/begin MEASUREMENT DFC_b.TST_SyncAPP "" UBYTE DFC_OneToOne 1 100 0.00 1.000 BIT_MASK 0x8 FORMAT "%5.3" ECU_ADDRESS 0x60034D8D /end MEASUREMENT
/begin MEASUREMENT DFC_b.TST_UCtPSRCMax "" UBYTE DFC_OneToOne 1 100 0.00 1.000 BIT_MASK 0x8 FORMAT "%5.3" ECU_ADDRESS 0x60034D8E /end MEASUREMENT
/begin MEASUREMENT DFC_b.TST_UCtPTmpErr "" UBYTE DFC_OneToOne 1 100 0.00 1.000 BIT_MASK 0x8 FORMAT "%5.3" ECU_ADDRESS 0x60034D8F /end MEASUREMENT
/begin MEASUREMENT DFC_b.TST_UPxP1SRCMax "" UBYTE DFC_OneToOne 1 100 0.00 1.000 BIT_MASK 0x8 FORMAT "%5.3" ECU_ADDRESS 0x60034D90 /end MEASUREMENT
/begin MEASUREMENT DFC_b.TST_UPxP1TmpErr "" UBYTE DFC_OneToOne 1 100 0.00 1.000 BIT_MASK 0x8 FORMAT "%5.3" ECU_ADDRESS 0x60034D91 /end MEASUREMENT
/begin MEASUREMENT DFC_b.TST_VehVObd "" UBYTE DFC_OneToOne 1 100 0.00 1.000 BIT_MASK 0x8 FORMAT "%5.3" ECU_ADDRESS 0x60034D92 /end MEASUREMENT
/begin MEASUREMENT DFC_b.LDF_ACCmprFltLvlRes "" UBYTE DFC_OneToOne 1 100 0.00 1.000 BIT_MASK 0x10 FORMAT "%5.3" ECU_ADDRESS 0x600349CF /end MEASUREMENT
/begin MEASUREMENT DFC_b.LDF_AbgHiSigFlt "" UBYTE DFC_OneToOne 1 100 0.00 1.000 BIT_MASK 0x10 FORMAT "%5.3" ECU_ADDRESS 0x600349D0 /end MEASUREMENT
/begin MEASUREMENT DFC_b.LDF_AbgIntPatFlt "" UBYTE DFC_OneToOne 1 100 0.00 1.000 BIT_MASK 0x10 FORMAT "%5.3" ECU_ADDRESS 0x600349D1 /end MEASUREMENT
/begin MEASUREMENT DFC_b.LDF_AbgLoSigFlt "" UBYTE DFC_OneToOne 1 100 0.00 1.000 BIT_MASK 0x10 FORMAT "%5.3" ECU_ADDRESS 0x600349D2 /end MEASUREMENT
/begin MEASUREMENT DFC_b.LDF_AbgUnkwnErrSigFlt "" UBYTE DFC_OneToOne 1 100 0.00 1.000 BIT_MASK 0x10 FORMAT "%5.3" ECU_ADDRESS 0x600349D3 /end MEASUREMENT
/begin MEASUREMENT DFC_b.LDF_AcExtChrgrIBattExcdd "" UBYTE DFC_OneToOne 1 100 0.00 1.000 BIT_MASK 0x10 FORMAT "%5.3" ECU_ADDRESS 0x600349D4 /end MEASUREMENT
/begin MEASUREMENT DFC_b.LDF_AcExtChrgrIInExcdd "" UBYTE DFC_OneToOne 1 100 0.00 1.000 BIT_MASK 0x10 FORMAT "%5.3" ECU_ADDRESS 0x600349D5 /end MEASUREMENT
/begin MEASUREMENT DFC_b.LDF_AcExtChrgrIOutDe "" UBYTE DFC_OneToOne 1 100 0.00 1.000 BIT_MASK 0x10 FORMAT "%5.3" ECU_ADDRESS 0x600349D6 /end MEASUREMENT
/begin MEASUREMENT DFC_b.LDF_AcExtChrgrIOutExcdd "" UBYTE DFC_OneToOne 1 100 0.00 1.000 BIT_MASK 0x10 FORMAT "%5.3" ECU_ADDRESS 0x600349D7 /end MEASUREMENT
/begin MEASUREMENT DFC_b.LDF_AcExtChrgrUOutDe "" UBYTE DFC_OneToOne 1 100 0.00 1.000 BIT_MASK 0x10 FORMAT "%5.3" ECU_ADDRESS 0x600349D8 /end MEASUREMENT
/begin MEASUREMENT DFC_b.LDF_AdpActvDChaFailr "" UBYTE DFC_OneToOne 1 100 0.00 1.000 BIT_MASK 0x10 FORMAT "%5.3" ECU_ADDRESS 0x600349D9 /end MEASUREMENT
/begin MEASUREMENT DFC_b.LDF_AirbcuFlt "" UBYTE DFC_OneToOne 1 100 0.00 1.000 BIT_MASK 0x10 FORMAT "%5.3" ECU_ADDRESS 0x600349DA /end MEASUREMENT
/begin MEASUREMENT DFC_b.LDF_Airbg "" UBYTE DFC_OneToOne 1 100 0.00 1.000 BIT_MASK 0x10 FORMAT "%5.3" ECU_ADDRESS 0x600349DB /end MEASUREMENT
/begin MEASUREMENT DFC_b.LDF_AirbgCan "" UBYTE DFC_OneToOne 1 100 0.00 1.000 BIT_MASK 0x10 FORMAT "%5.3" ECU_ADDRESS 0x600349DC /end MEASUREMENT
/begin MEASUREMENT DFC_b.LDF_AirbgCanHWPlaus "" UBYTE DFC_OneToOne 1 100 0.00 1.000 BIT_MASK 0x10 FORMAT "%5.3" ECU_ADDRESS 0x600349DD /end MEASUREMENT
/begin MEASUREMENT DFC_b.LDF_AirbgHWCanPlaus "" UBYTE DFC_OneToOne 1 100 0.00 1.000 BIT_MASK 0x10 FORMAT "%5.3" ECU_ADDRESS 0x600349DE /end MEASUREMENT
/begin MEASUREMENT DFC_b.LDF_AirbgMnr "" UBYTE DFC_OneToOne 1 100 0.00 1.000 BIT_MASK 0x10 FORMAT "%5.3" ECU_ADDRESS 0x600349DF /end MEASUREMENT
/begin MEASUREMENT DFC_b.LDF_AirbgPerHi "" UBYTE DFC_OneToOne 1 100 0.00 1.000 BIT_MASK 0x10 FORMAT "%5.3" ECU_ADDRESS 0x600349E0 /end MEASUREMENT
/begin MEASUREMENT DFC_b.LDF_AirbgPerdRngFlt "" UBYTE DFC_OneToOne 1 100 0.00 1.000 BIT_MASK 0x10 FORMAT "%5.3" ECU_ADDRESS 0x600349E1 /end MEASUREMENT
/begin MEASUREMENT DFC_b.LDF_BlowrRlyErr "" UBYTE DFC_OneToOne 1 100 0.00 1.000 BIT_MASK 0x10 FORMAT "%5.3" ECU_ADDRESS 0x600349E2 /end MEASUREMENT
/begin MEASUREMENT DFC_b.LDF_BrkBstPmpActtnDfct "" UBYTE DFC_OneToOne 1 100 0.00 1.000 BIT_MASK 0x10 FORMAT "%5.3" ECU_ADDRESS 0x600349E3 /end MEASUREMENT
/begin MEASUREMENT DFC_b.LDF_BrkBstPmpDeactvnDfct "" UBYTE DFC_OneToOne 1 100 0.00 1.000 BIT_MASK 0x10 FORMAT "%5.3" ECU_ADDRESS 0x600349E4 /end MEASUREMENT
/begin MEASUREMENT DFC_b.LDF_BrkSwtFlt "" UBYTE DFC_OneToOne 1 100 0.00 1.000 BIT_MASK 0x10 FORMAT "%5.3" ECU_ADDRESS 0x600349E5 /end MEASUREMENT
/begin MEASUREMENT DFC_b.LDF_CbnHeatgHeatrHsScb "" UBYTE DFC_OneToOne 1 100 0.00 1.000 BIT_MASK 0x10 FORMAT "%5.3" ECU_ADDRESS 0x600349E6 /end MEASUREMENT
/begin MEASUREMENT DFC_b.LDF_CbnHeatgHeatrHsScg "" UBYTE DFC_OneToOne 1 100 0.00 1.000 BIT_MASK 0x10 FORMAT "%5.3" ECU_ADDRESS 0x600349E7 /end MEASUREMENT
/begin MEASUREMENT DFC_b.LDF_CbnHeatgHeatrLsOl "" UBYTE DFC_OneToOne 1 100 0.00 1.000 BIT_MASK 0x10 FORMAT "%5.3" ECU_ADDRESS 0x600349E8 /end MEASUREMENT
/begin MEASUREMENT DFC_b.LDF_CbnHeatgHeatrLsScb "" UBYTE DFC_OneToOne 1 100 0.00 1.000 BIT_MASK 0x10 FORMAT "%5.3" ECU_ADDRESS 0x600349E9 /end MEASUREMENT
/begin MEASUREMENT DFC_b.LDF_CbnHeatgHeatrLsScg "" UBYTE DFC_OneToOne 1 100 0.00 1.000 BIT_MASK 0x10 FORMAT "%5.3" ECU_ADDRESS 0x600349EA /end MEASUREMENT
/begin MEASUREMENT DFC_b.LDF_CbnHeatgHeatrUnUsed "" UBYTE DFC_OneToOne 1 100 0.00 1.000 BIT_MASK 0x10 FORMAT "%5.3" ECU_ADDRESS 0x600349EB /end MEASUREMENT
/begin MEASUREMENT DFC_b.LDF_ChrgnCntctHsOt "" UBYTE DFC_OneToOne 1 100 0.00 1.000 BIT_MASK 0x10 FORMAT "%5.3" ECU_ADDRESS 0x600349EC /end MEASUREMENT
/begin MEASUREMENT DFC_b.LDF_ChrgnCntctHsScb "" UBYTE DFC_OneToOne 1 100 0.00 1.000 BIT_MASK 0x10 FORMAT "%5.3" ECU_ADDRESS 0x600349ED /end MEASUREMENT
/begin MEASUREMENT DFC_b.LDF_ChrgnCntctHsScg "" UBYTE DFC_OneToOne 1 100 0.00 1.000 BIT_MASK 0x10 FORMAT "%5.3" ECU_ADDRESS 0x600349EE /end MEASUREMENT
/begin MEASUREMENT DFC_b.LDF_ChrgnCntctLsNegOl "" UBYTE DFC_OneToOne 1 100 0.00 1.000 BIT_MASK 0x10 FORMAT "%5.3" ECU_ADDRESS 0x600349EF /end MEASUREMENT
/begin MEASUREMENT DFC_b.LDF_ChrgnCntctLsNegOt "" UBYTE DFC_OneToOne 1 100 0.00 1.000 BIT_MASK 0x10 FORMAT "%5.3" ECU_ADDRESS 0x600349F0 /end MEASUREMENT
/begin MEASUREMENT DFC_b.LDF_ChrgnCntctLsNegScb "" UBYTE DFC_OneToOne 1 100 0.00 1.000 BIT_MASK 0x10 FORMAT "%5.3" ECU_ADDRESS 0x600349F1 /end MEASUREMENT
/begin MEASUREMENT DFC_b.LDF_ChrgnCntctLsNegScg "" UBYTE DFC_OneToOne 1 100 0.00 1.000 BIT_MASK 0x10 FORMAT "%5.3" ECU_ADDRESS 0x600349F2 /end MEASUREMENT
/begin MEASUREMENT DFC_b.LDF_ChrgnCntctLsPosOl "" UBYTE DFC_OneToOne 1 100 0.00 1.000 BIT_MASK 0x10 FORMAT "%5.3" ECU_ADDRESS 0x600349F3 /end MEASUREMENT
/begin MEASUREMENT DFC_b.LDF_ChrgnCntctLsPosOt "" UBYTE DFC_OneToOne 1 100 0.00 1.000 BIT_MASK 0x10 FORMAT "%5.3" ECU_ADDRESS 0x600349F4 /end MEASUREMENT
/begin MEASUREMENT DFC_b.LDF_ChrgnCntctLsPosScb "" UBYTE DFC_OneToOne 1 100 0.00 1.000 BIT_MASK 0x10 FORMAT "%5.3" ECU_ADDRESS 0x600349F5 /end MEASUREMENT
/begin MEASUREMENT DFC_b.LDF_ChrgnCntctLsPosScg "" UBYTE DFC_OneToOne 1 100 0.00 1.000 BIT_MASK 0x10 FORMAT "%5.3" ECU_ADDRESS 0x600349F6 /end MEASUREMENT
/begin MEASUREMENT DFC_b.LDF_ChrgnCntctUnUsed "" UBYTE DFC_OneToOne 1 100 0.00 1.000 BIT_MASK 0x10 FORMAT "%5.3" ECU_ADDRESS 0x600349F7 /end MEASUREMENT
/begin MEASUREMENT DFC_b.LDF_ComBrkMai "" UBYTE DFC_OneToOne 1 100 0.00 1.000 BIT_MASK 0x10 FORMAT "%5.3" ECU_ADDRESS 0x600349F8 /end MEASUREMENT
/begin MEASUREMENT DFC_b.LDF_ComChrgrEVCont "" UBYTE DFC_OneToOne 1 100 0.00 1.000 BIT_MASK 0x10 FORMAT "%5.3" ECU_ADDRESS 0x600349F9 /end MEASUREMENT
/begin MEASUREMENT DFC_b.LDF_ComChrgrEVtBlink "" UBYTE DFC_OneToOne 1 100 0.00 1.000 BIT_MASK 0x10 FORMAT "%5.3" ECU_ADDRESS 0x600349FA /end MEASUREMENT
/begin MEASUREMENT DFC_b.LDF_ComChrgrMstBlink "" UBYTE DFC_OneToOne 1 100 0.00 1.000 BIT_MASK 0x10 FORMAT "%5.3" ECU_ADDRESS 0x600349FB /end MEASUREMENT
/begin MEASUREMENT DFC_b.LDF_ComChrgrMstCont "" UBYTE DFC_OneToOne 1 100 0.00 1.000 BIT_MASK 0x10 FORMAT "%5.3" ECU_ADDRESS 0x600349FC /end MEASUREMENT
/begin MEASUREMENT DFC_b.LDF_ComChrgrSVSBlink "" UBYTE DFC_OneToOne 1 100 0.00 1.000 BIT_MASK 0x10 FORMAT "%5.3" ECU_ADDRESS 0x600349FD /end MEASUREMENT
/begin MEASUREMENT DFC_b.LDF_ComChrgrSVSCont "" UBYTE DFC_OneToOne 1 100 0.00 1.000 BIT_MASK 0x10 FORMAT "%5.3" ECU_ADDRESS 0x600349FE /end MEASUREMENT
/begin MEASUREMENT DFC_b.LDF_ComDcdcEVBlink "" UBYTE DFC_OneToOne 1 100 0.00 1.000 BIT_MASK 0x10 FORMAT "%5.3" ECU_ADDRESS 0x600349FF /end MEASUREMENT
/begin MEASUREMENT DFC_b.LDF_ComDcdcEVCont "" UBYTE DFC_OneToOne 1 100 0.00 1.000 BIT_MASK 0x10 FORMAT "%5.3" ECU_ADDRESS 0x60034A00 /end MEASUREMENT
/begin MEASUREMENT DFC_b.LDF_ComDcdcFltLvl2 "" UBYTE DFC_OneToOne 1 100 0.00 1.000 BIT_MASK 0x10 FORMAT "%5.3" ECU_ADDRESS 0x60034A01 /end MEASUREMENT
/begin MEASUREMENT DFC_b.LDF_ComDcdcFltLvl3 "" UBYTE DFC_OneToOne 1 100 0.00 1.000 BIT_MASK 0x10 FORMAT "%5.3" ECU_ADDRESS 0x60034A02 /end MEASUREMENT
/begin MEASUREMENT DFC_b.LDF_ComDcdcFltLvl4 "" UBYTE DFC_OneToOne 1 100 0.00 1.000 BIT_MASK 0x10 FORMAT "%5.3" ECU_ADDRESS 0x60034A03 /end MEASUREMENT
/begin MEASUREMENT DFC_b.LDF_ComDcdcFltLvl5 "" UBYTE DFC_OneToOne 1 100 0.00 1.000 BIT_MASK 0x10 FORMAT "%5.3" ECU_ADDRESS 0x60034A04 /end MEASUREMENT
/begin MEASUREMENT DFC_b.LDF_ComDcdcFltLvlRes "" UBYTE DFC_OneToOne 1 100 0.00 1.000 BIT_MASK 0x10 FORMAT "%5.3" ECU_ADDRESS 0x60034A05 /end MEASUREMENT
/begin MEASUREMENT DFC_b.LDF_ComDcdcMstBlink "" UBYTE DFC_OneToOne 1 100 0.00 1.000 BIT_MASK 0x10 FORMAT "%5.3" ECU_ADDRESS 0x60034A06 /end MEASUREMENT
/begin MEASUREMENT DFC_b.LDF_ComDcdcMstCont "" UBYTE DFC_OneToOne 1 100 0.00 1.000 BIT_MASK 0x10 FORMAT "%5.3" ECU_ADDRESS 0x60034A07 /end MEASUREMENT
/begin MEASUREMENT DFC_b.LDF_ComDcdcSVSBlink "" UBYTE DFC_OneToOne 1 100 0.00 1.000 BIT_MASK 0x10 FORMAT "%5.3" ECU_ADDRESS 0x60034A08 /end MEASUREMENT
/begin MEASUREMENT DFC_b.LDF_ComDcdcSVSCont "" UBYTE DFC_OneToOne 1 100 0.00 1.000 BIT_MASK 0x10 FORMAT "%5.3" ECU_ADDRESS 0x60034A09 /end MEASUREMENT
/begin MEASUREMENT DFC_b.LDF_ComElMIIvtrFltLvl2 "" UBYTE DFC_OneToOne 1 100 0.00 1.000 BIT_MASK 0x10 FORMAT "%5.3" ECU_ADDRESS 0x60034A0A /end MEASUREMENT
/begin MEASUREMENT DFC_b.LDF_ComElMIIvtrFltLvl3 "" UBYTE DFC_OneToOne 1 100 0.00 1.000 BIT_MASK 0x10 FORMAT "%5.3" ECU_ADDRESS 0x60034A0B /end MEASUREMENT
/begin MEASUREMENT DFC_b.LDF_ComElMIIvtrFltLvl4 "" UBYTE DFC_OneToOne 1 100 0.00 1.000 BIT_MASK 0x10 FORMAT "%5.3" ECU_ADDRESS 0x60034A0C /end MEASUREMENT
/begin MEASUREMENT DFC_b.LDF_ComElMIIvtrFltLvl5 "" UBYTE DFC_OneToOne 1 100 0.00 1.000 BIT_MASK 0x10 FORMAT "%5.3" ECU_ADDRESS 0x60034A0D /end MEASUREMENT
/begin MEASUREMENT DFC_b.LDF_ComElMIIvtrFltLvlRes "" UBYTE DFC_OneToOne 1 100 0.00 1.000 BIT_MASK 0x10 FORMAT "%5.3" ECU_ADDRESS 0x60034A0E /end MEASUREMENT
/begin MEASUREMENT DFC_b.LDF_ComEmacEVBlink "" UBYTE DFC_OneToOne 1 100 0.00 1.000 BIT_MASK 0x10 FORMAT "%5.3" ECU_ADDRESS 0x60034A0F /end MEASUREMENT
/begin MEASUREMENT DFC_b.LDF_ComEmacEVCont "" UBYTE DFC_OneToOne 1 100 0.00 1.000 BIT_MASK 0x10 FORMAT "%5.3" ECU_ADDRESS 0x60034A10 /end MEASUREMENT
/begin MEASUREMENT DFC_b.LDF_ComEmacMstCont "" UBYTE DFC_OneToOne 1 100 0.00 1.000 BIT_MASK 0x10 FORMAT "%5.3" ECU_ADDRESS 0x60034A11 /end MEASUREMENT
/begin MEASUREMENT DFC_b.LDF_ComEmacMsttBlink "" UBYTE DFC_OneToOne 1 100 0.00 1.000 BIT_MASK 0x10 FORMAT "%5.3" ECU_ADDRESS 0x60034A12 /end MEASUREMENT
/begin MEASUREMENT DFC_b.LDF_ComEmacSVSBlink "" UBYTE DFC_OneToOne 1 100 0.00 1.000 BIT_MASK 0x10 FORMAT "%5.3" ECU_ADDRESS 0x60034A13 /end MEASUREMENT
/begin MEASUREMENT DFC_b.LDF_ComEmacSVSCont "" UBYTE DFC_OneToOne 1 100 0.00 1.000 BIT_MASK 0x10 FORMAT "%5.3" ECU_ADDRESS 0x60034A14 /end MEASUREMENT
/begin MEASUREMENT DFC_b.LDF_ComGunCntInfoWkuReq "" UBYTE DFC_OneToOne 1 100 0.00 1.000 BIT_MASK 0x10 FORMAT "%5.3" ECU_ADDRESS 0x60034A15 /end MEASUREMENT
/begin MEASUREMENT DFC_b.LDF_ComHillHldFlt "" UBYTE DFC_OneToOne 1 100 0.00 1.000 BIT_MASK 0x10 FORMAT "%5.3" ECU_ADDRESS 0x60034A16 /end MEASUREMENT
/begin MEASUREMENT DFC_b.LDF_ComHvBattRchrgWkuReq "" UBYTE DFC_OneToOne 1 100 0.00 1.000 BIT_MASK 0x10 FORMAT "%5.3" ECU_ADDRESS 0x60034A17 /end MEASUREMENT
/begin MEASUREMENT DFC_b.LDF_ComHvbFltLvl2 "" UBYTE DFC_OneToOne 1 100 0.00 1.000 BIT_MASK 0x10 FORMAT "%5.3" ECU_ADDRESS 0x60034A18 /end MEASUREMENT
/begin MEASUREMENT DFC_b.LDF_ComHvbFltLvl3 "" UBYTE DFC_OneToOne 1 100 0.00 1.000 BIT_MASK 0x10 FORMAT "%5.3" ECU_ADDRESS 0x60034A19 /end MEASUREMENT
/begin MEASUREMENT DFC_b.LDF_ComHvbFltLvl4 "" UBYTE DFC_OneToOne 1 100 0.00 1.000 BIT_MASK 0x10 FORMAT "%5.3" ECU_ADDRESS 0x60034A1A /end MEASUREMENT
/begin MEASUREMENT DFC_b.LDF_ComHvbFltLvl5 "" UBYTE DFC_OneToOne 1 100 0.00 1.000 BIT_MASK 0x10 FORMAT "%5.3" ECU_ADDRESS 0x60034A1B /end MEASUREMENT
/begin MEASUREMENT DFC_b.LDF_ComHvbFltLvlRes "" UBYTE DFC_OneToOne 1 100 0.00 1.000 BIT_MASK 0x10 FORMAT "%5.3" ECU_ADDRESS 0x60034A1C /end MEASUREMENT
/begin MEASUREMENT DFC_b.LDF_ComHvbMstBlink "" UBYTE DFC_OneToOne 1 100 0.00 1.000 BIT_MASK 0x10 FORMAT "%5.3" ECU_ADDRESS 0x60034A1D /end MEASUREMENT
/begin MEASUREMENT DFC_b.LDF_ComHvbMstCont "" UBYTE DFC_OneToOne 1 100 0.00 1.000 BIT_MASK 0x10 FORMAT "%5.3" ECU_ADDRESS 0x60034A1E /end MEASUREMENT
/begin MEASUREMENT DFC_b.LDF_ComImmoUnlockWkuReq "" UBYTE DFC_OneToOne 1 100 0.00 1.000 BIT_MASK 0x10 FORMAT "%5.3" ECU_ADDRESS 0x60034A1F /end MEASUREMENT
/begin MEASUREMENT DFC_b.LDF_ComInfoReqPtlWkuReq "" UBYTE DFC_OneToOne 1 100 0.00 1.000 BIT_MASK 0x10 FORMAT "%5.3" ECU_ADDRESS 0x60034A20 /end MEASUREMENT
/begin MEASUREMENT DFC_b.LDF_ComOBCFltLvl2 "" UBYTE DFC_OneToOne 1 100 0.00 1.000 BIT_MASK 0x10 FORMAT "%5.3" ECU_ADDRESS 0x60034A21 /end MEASUREMENT
/begin MEASUREMENT DFC_b.LDF_ComOBCFltLvl3 "" UBYTE DFC_OneToOne 1 100 0.00 1.000 BIT_MASK 0x10 FORMAT "%5.3" ECU_ADDRESS 0x60034A22 /end MEASUREMENT
/begin MEASUREMENT DFC_b.LDF_ComOBCFltLvl4 "" UBYTE DFC_OneToOne 1 100 0.00 1.000 BIT_MASK 0x10 FORMAT "%5.3" ECU_ADDRESS 0x60034A23 /end MEASUREMENT
/begin MEASUREMENT DFC_b.LDF_ComOBCFltLvl5 "" UBYTE DFC_OneToOne 1 100 0.00 1.000 BIT_MASK 0x10 FORMAT "%5.3" ECU_ADDRESS 0x60034A24 /end MEASUREMENT
/begin MEASUREMENT DFC_b.LDF_ComOBCFltLvlRes "" UBYTE DFC_OneToOne 1 100 0.00 1.000 BIT_MASK 0x10 FORMAT "%5.3" ECU_ADDRESS 0x60034A25 /end MEASUREMENT
/begin MEASUREMENT DFC_b.LDF_ComPostOperationWkuReq "" UBYTE DFC_OneToOne 1 100 0.00 1.000 BIT_MASK 0x10 FORMAT "%5.3" ECU_ADDRESS 0x60034A26 /end MEASUREMENT
/begin MEASUREMENT DFC_b.LDF_ComPreCondElecWkuReq "" UBYTE DFC_OneToOne 1 100 0.00 1.000 BIT_MASK 0x10 FORMAT "%5.3" ECU_ADDRESS 0x60034A27 /end MEASUREMENT
/begin MEASUREMENT DFC_b.LDF_ComRemUnlckWkuReq "" UBYTE DFC_OneToOne 1 100 0.00 1.000 BIT_MASK 0x10 FORMAT "%5.3" ECU_ADDRESS 0x60034A28 /end MEASUREMENT
/begin MEASUREMENT DFC_b.LDF_ComStpDlyHMIWkuReq "" UBYTE DFC_OneToOne 1 100 0.00 1.000 BIT_MASK 0x10 FORMAT "%5.3" ECU_ADDRESS 0x60034A29 /end MEASUREMENT
/begin MEASUREMENT DFC_b.LDF_ComflgCurMeasmtErr "" UBYTE DFC_OneToOne 1 100 0.00 1.000 BIT_MASK 0x10 FORMAT "%5.3" ECU_ADDRESS 0x60034A2A /end MEASUREMENT
/begin MEASUREMENT DFC_b.LDF_ComflgCurMeasmtSysErr "" UBYTE DFC_OneToOne 1 100 0.00 1.000 BIT_MASK 0x10 FORMAT "%5.3" ECU_ADDRESS 0x60034A2B /end MEASUREMENT
/begin MEASUREMENT DFC_b.LDF_ComflgCurMeasmtVld "" UBYTE DFC_OneToOne 1 100 0.00 1.000 BIT_MASK 0x10 FORMAT "%5.3" ECU_ADDRESS 0x60034A2C /end MEASUREMENT
/begin MEASUREMENT DFC_b.LDF_ComflgCurRngErr "" UBYTE DFC_OneToOne 1 100 0.00 1.000 BIT_MASK 0x10 FORMAT "%5.3" ECU_ADDRESS 0x60034A2D /end MEASUREMENT
/begin MEASUREMENT DFC_b.LDF_ComflgTPcbMeasmtErr "" UBYTE DFC_OneToOne 1 100 0.00 1.000 BIT_MASK 0x10 FORMAT "%5.3" ECU_ADDRESS 0x60034A2E /end MEASUREMENT
/begin MEASUREMENT DFC_b.LDF_ComflgTPcbMeasmtVld "" UBYTE DFC_OneToOne 1 100 0.00 1.000 BIT_MASK 0x10 FORMAT "%5.3" ECU_ADDRESS 0x60034A2F /end MEASUREMENT
/begin MEASUREMENT DFC_b.LDF_ComflgTPcbRngErr "" UBYTE DFC_OneToOne 1 100 0.00 1.000 BIT_MASK 0x10 FORMAT "%5.3" ECU_ADDRESS 0x60034A30 /end MEASUREMENT
/begin MEASUREMENT DFC_b.LDF_ComflgTPcbSysErr "" UBYTE DFC_OneToOne 1 100 0.00 1.000 BIT_MASK 0x10 FORMAT "%5.3" ECU_ADDRESS 0x60034A31 /end MEASUREMENT
/begin MEASUREMENT DFC_b.LDF_ComflgTShntMeasmtErr "" UBYTE DFC_OneToOne 1 100 0.00 1.000 BIT_MASK 0x10 FORMAT "%5.3" ECU_ADDRESS 0x60034A32 /end MEASUREMENT
/begin MEASUREMENT DFC_b.LDF_ComflgTShntMeasmtVld "" UBYTE DFC_OneToOne 1 100 0.00 1.000 BIT_MASK 0x10 FORMAT "%5.3" ECU_ADDRESS 0x60034A33 /end MEASUREMENT
/begin MEASUREMENT DFC_b.LDF_ComflgTShntRngErr "" UBYTE DFC_OneToOne 1 100 0.00 1.000 BIT_MASK 0x10 FORMAT "%5.3" ECU_ADDRESS 0x60034A34 /end MEASUREMENT
/begin MEASUREMENT DFC_b.LDF_ComflgTShntSysErr "" UBYTE DFC_OneToOne 1 100 0.00 1.000 BIT_MASK 0x10 FORMAT "%5.3" ECU_ADDRESS 0x60034A35 /end MEASUREMENT
/begin MEASUREMENT DFC_b.LDF_ComflgVoltMeasmtErr "" UBYTE DFC_OneToOne 1 100 0.00 1.000 BIT_MASK 0x10 FORMAT "%5.3" ECU_ADDRESS 0x60034A36 /end MEASUREMENT
/begin MEASUREMENT DFC_b.LDF_ComflgVoltMeasmtSysErr "" UBYTE DFC_OneToOne 1 100 0.00 1.000 BIT_MASK 0x10 FORMAT "%5.3" ECU_ADDRESS 0x60034A37 /end MEASUREMENT
/begin MEASUREMENT DFC_b.LDF_ComflgVoltMeasmtVld "" UBYTE DFC_OneToOne 1 100 0.00 1.000 BIT_MASK 0x10 FORMAT "%5.3" ECU_ADDRESS 0x60034A38 /end MEASUREMENT
/begin MEASUREMENT DFC_b.LDF_ComflgVoltRngErr "" UBYTE DFC_OneToOne 1 100 0.00 1.000 BIT_MASK 0x10 FORMAT "%5.3" ECU_ADDRESS 0x60034A39 /end MEASUREMENT
/begin MEASUREMENT DFC_b.LDF_CrashEveOcc "" UBYTE DFC_OneToOne 1 100 0.00 1.000 BIT_MASK 0x10 FORMAT "%5.3" ECU_ADDRESS 0x60034A3A /end MEASUREMENT
/begin MEASUREMENT DFC_b.LDF_DcdcFwdModStuck "" UBYTE DFC_OneToOne 1 100 0.00 1.000 BIT_MASK 0x10 FORMAT "%5.3" ECU_ADDRESS 0x60034A3B /end MEASUREMENT
/begin MEASUREMENT DFC_b.LDF_DcdcLvUDifMaxFlt "" UBYTE DFC_OneToOne 1 100 0.00 1.000 BIT_MASK 0x10 FORMAT "%5.3" ECU_ADDRESS 0x60034A3C /end MEASUREMENT
/begin MEASUREMENT DFC_b.LDF_DcdcOffModStuck "" UBYTE DFC_OneToOne 1 100 0.00 1.000 BIT_MASK 0x10 FORMAT "%5.3" ECU_ADDRESS 0x60034A3D /end MEASUREMENT
/begin MEASUREMENT DFC_b.LDF_DcdcOperModFailr "" UBYTE DFC_OneToOne 1 100 0.00 1.000 BIT_MASK 0x10 FORMAT "%5.3" ECU_ADDRESS 0x60034A3E /end MEASUREMENT
/begin MEASUREMENT DFC_b.LDF_DcdcPrecModStuck "" UBYTE DFC_OneToOne 1 100 0.00 1.000 BIT_MASK 0x10 FORMAT "%5.3" ECU_ADDRESS 0x60034A3F /end MEASUREMENT
/begin MEASUREMENT DFC_b.LDF_DrvDoorOpn "" UBYTE DFC_OneToOne 1 100 0.00 1.000 BIT_MASK 0x10 FORMAT "%5.3" ECU_ADDRESS 0x60034A40 /end MEASUREMENT
/begin MEASUREMENT DFC_b.LDF_DrvModPosnDfct "" UBYTE DFC_OneToOne 1 100 0.00 1.000 BIT_MASK 0x10 FORMAT "%5.3" ECU_ADDRESS 0x60034A41 /end MEASUREMENT
/begin MEASUREMENT DFC_b.LDF_DrvStbltOpn "" UBYTE DFC_OneToOne 1 100 0.00 1.000 BIT_MASK 0x10 FORMAT "%5.3" ECU_ADDRESS 0x60034A42 /end MEASUREMENT
/begin MEASUREMENT DFC_b.LDF_ETogFailrLvl3 "" UBYTE DFC_OneToOne 1 100 0.00 1.000 BIT_MASK 0x10 FORMAT "%5.3" ECU_ADDRESS 0x60034A43 /end MEASUREMENT
/begin MEASUREMENT DFC_b.LDF_ETogFailrLvl4 "" UBYTE DFC_OneToOne 1 100 0.00 1.000 BIT_MASK 0x10 FORMAT "%5.3" ECU_ADDRESS 0x60034A44 /end MEASUREMENT
/begin MEASUREMENT DFC_b.LDF_EbsLvBattSocDiagLo "" UBYTE DFC_OneToOne 1 100 0.00 1.000 BIT_MASK 0x10 FORMAT "%5.3" ECU_ADDRESS 0x60034A45 /end MEASUREMENT
/begin MEASUREMENT DFC_b.LDF_EbsLvBattUDiagDiOper "" UBYTE DFC_OneToOne 1 100 0.00 1.000 BIT_MASK 0x10 FORMAT "%5.3" ECU_ADDRESS 0x60034A46 /end MEASUREMENT
/begin MEASUREMENT DFC_b.LDF_EbsLvBattUDiagFltLvl1 "" UBYTE DFC_OneToOne 1 100 0.00 1.000 BIT_MASK 0x10 FORMAT "%5.3" ECU_ADDRESS 0x60034A47 /end MEASUREMENT
/begin MEASUREMENT DFC_b.LDF_EbsLvBattUDiagFltLvl2 "" UBYTE DFC_OneToOne 1 100 0.00 1.000 BIT_MASK 0x10 FORMAT "%5.3" ECU_ADDRESS 0x60034A48 /end MEASUREMENT
/begin MEASUREMENT DFC_b.LDF_EbsLvBattUDiagLo "" UBYTE DFC_OneToOne 1 100 0.00 1.000 BIT_MASK 0x10 FORMAT "%5.3" ECU_ADDRESS 0x60034A49 /end MEASUREMENT
/begin MEASUREMENT DFC_b.LDF_EbsSnsrSt "" UBYTE DFC_OneToOne 1 100 0.00 1.000 BIT_MASK 0x10 FORMAT "%5.3" ECU_ADDRESS 0x60034A4A /end MEASUREMENT
/begin MEASUREMENT DFC_b.LDF_EbsSofASILErr "" UBYTE DFC_OneToOne 1 100 0.00 1.000 BIT_MASK 0x10 FORMAT "%5.3" ECU_ADDRESS 0x60034A4B /end MEASUREMENT
/begin MEASUREMENT DFC_b.LDF_ElTSPtSysLimDrvErr "" UBYTE DFC_OneToOne 1 100 0.00 1.000 BIT_MASK 0x10 FORMAT "%5.3" ECU_ADDRESS 0x60034A4C /end MEASUREMENT
/begin MEASUREMENT DFC_b.LDF_ElTSPtSysLimRgnErr "" UBYTE DFC_OneToOne 1 100 0.00 1.000 BIT_MASK 0x10 FORMAT "%5.3" ECU_ADDRESS 0x60034A4D /end MEASUREMENT
/begin MEASUREMENT DFC_b.LDF_HLCCcsFwDwnl "" UBYTE DFC_OneToOne 1 100 0.00 1.000 BIT_MASK 0x10 FORMAT "%5.3" ECU_ADDRESS 0x60034A4E /end MEASUREMENT
/begin MEASUREMENT DFC_b.LDF_HvBattChrgPwrMax "" UBYTE DFC_OneToOne 1 100 0.00 1.000 BIT_MASK 0x10 FORMAT "%5.3" ECU_ADDRESS 0x60034A4F /end MEASUREMENT
/begin MEASUREMENT DFC_b.LDF_HvBattCrashDetd "" UBYTE DFC_OneToOne 1 100 0.00 1.000 BIT_MASK 0x10 FORMAT "%5.3" ECU_ADDRESS 0x60034A50 /end MEASUREMENT
/begin MEASUREMENT DFC_b.LDF_HvBattDchaPwrMax "" UBYTE DFC_OneToOne 1 100 0.00 1.000 BIT_MASK 0x10 FORMAT "%5.3" ECU_ADDRESS 0x60034A51 /end MEASUREMENT
/begin MEASUREMENT DFC_b.LDF_HvBattEmgyOff "" UBYTE DFC_OneToOne 1 100 0.00 1.000 BIT_MASK 0x10 FORMAT "%5.3" ECU_ADDRESS 0x60034A52 /end MEASUREMENT
/begin MEASUREMENT DFC_b.LDF_HvBattEmgyOffIntlck "" UBYTE DFC_OneToOne 1 100 0.00 1.000 BIT_MASK 0x10 FORMAT "%5.3" ECU_ADDRESS 0x60034A53 /end MEASUREMENT
/begin MEASUREMENT DFC_b.LDF_HvBattEmgyOffReq "" UBYTE DFC_OneToOne 1 100 0.00 1.000 BIT_MASK 0x10 FORMAT "%5.3" ECU_ADDRESS 0x60034A54 /end MEASUREMENT
/begin MEASUREMENT DFC_b.LDF_HvBattFltMod "" UBYTE DFC_OneToOne 1 100 0.00 1.000 BIT_MASK 0x10 FORMAT "%5.3" ECU_ADDRESS 0x60034A55 /end MEASUREMENT
/begin MEASUREMENT DFC_b.LDF_HvBattIReqToChrgrErr "" UBYTE DFC_OneToOne 1 100 0.00 1.000 BIT_MASK 0x10 FORMAT "%5.3" ECU_ADDRESS 0x60034A56 /end MEASUREMENT
/begin MEASUREMENT DFC_b.LDF_HvBattIReqToChrgrIni "" UBYTE DFC_OneToOne 1 100 0.00 1.000 BIT_MASK 0x10 FORMAT "%5.3" ECU_ADDRESS 0x60034A57 /end MEASUREMENT
/begin MEASUREMENT DFC_b.LDF_HvBattIninTout "" UBYTE DFC_OneToOne 1 100 0.00 1.000 BIT_MASK 0x10 FORMAT "%5.3" ECU_ADDRESS 0x60034A58 /end MEASUREMENT
/begin MEASUREMENT DFC_b.LDF_HvBattIntlckSt "" UBYTE DFC_OneToOne 1 100 0.00 1.000 BIT_MASK 0x10 FORMAT "%5.3" ECU_ADDRESS 0x60034A59 /end MEASUREMENT
/begin MEASUREMENT DFC_b.LDF_HvBattIsoFlt "" UBYTE DFC_OneToOne 1 100 0.00 1.000 BIT_MASK 0x10 FORMAT "%5.3" ECU_ADDRESS 0x60034A5A /end MEASUREMENT
/begin MEASUREMENT DFC_b.LDF_HvBattLimdPwr "" UBYTE DFC_OneToOne 1 100 0.00 1.000 BIT_MASK 0x10 FORMAT "%5.3" ECU_ADDRESS 0x60034A5B /end MEASUREMENT
/begin MEASUREMENT DFC_b.LDF_HvBattMaiSwtClsngFlt "" UBYTE DFC_OneToOne 1 100 0.00 1.000 BIT_MASK 0x10 FORMAT "%5.3" ECU_ADDRESS 0x60034A5C /end MEASUREMENT
/begin MEASUREMENT DFC_b.LDF_HvBattMaiSwtFlt "" UBYTE DFC_OneToOne 1 100 0.00 1.000 BIT_MASK 0x10 FORMAT "%5.3" ECU_ADDRESS 0x60034A5D /end MEASUREMENT
/begin MEASUREMENT DFC_b.LDF_HvBattMaiSwtOpen "" UBYTE DFC_OneToOne 1 100 0.00 1.000 BIT_MASK 0x10 FORMAT "%5.3" ECU_ADDRESS 0x60034A5E /end MEASUREMENT
/begin MEASUREMENT DFC_b.LDF_HvBattMaiSwtOpngFlt "" UBYTE DFC_OneToOne 1 100 0.00 1.000 BIT_MASK 0x10 FORMAT "%5.3" ECU_ADDRESS 0x60034A5F /end MEASUREMENT
/begin MEASUREMENT DFC_b.LDF_HvBattMaiSwtWldd "" UBYTE DFC_OneToOne 1 100 0.00 1.000 BIT_MASK 0x10 FORMAT "%5.3" ECU_ADDRESS 0x60034A60 /end MEASUREMENT
/begin MEASUREMENT DFC_b.LDF_HvBattNegCntctrCntErr "" UBYTE DFC_OneToOne 1 100 0.00 1.000 BIT_MASK 0x10 FORMAT "%5.3" ECU_ADDRESS 0x60034A61 /end MEASUREMENT
/begin MEASUREMENT DFC_b.LDF_HvBattOperModChrgPlausy "" UBYTE DFC_OneToOne 1 100 0.00 1.000 BIT_MASK 0x10 FORMAT "%5.3" ECU_ADDRESS 0x60034A62 /end MEASUREMENT
/begin MEASUREMENT DFC_b.LDF_HvBattOverTDern "" UBYTE DFC_OneToOne 1 100 0.00 1.000 BIT_MASK 0x10 FORMAT "%5.3" ECU_ADDRESS 0x60034A63 /end MEASUREMENT
/begin MEASUREMENT DFC_b.LDF_HvBattPosCntctrCntErr "" UBYTE DFC_OneToOne 1 100 0.00 1.000 BIT_MASK 0x10 FORMAT "%5.3" ECU_ADDRESS 0x60034A64 /end MEASUREMENT
/begin MEASUREMENT DFC_b.LDF_HvBattPrecCntctrCntErr "" UBYTE DFC_OneToOne 1 100 0.00 1.000 BIT_MASK 0x10 FORMAT "%5.3" ECU_ADDRESS 0x60034A65 /end MEASUREMENT
/begin MEASUREMENT DFC_b.LDF_HvBattPwrDistbnTDern "" UBYTE DFC_OneToOne 1 100 0.00 1.000 BIT_MASK 0x10 FORMAT "%5.3" ECU_ADDRESS 0x60034A66 /end MEASUREMENT
/begin MEASUREMENT DFC_b.LDF_HvBattPwrDistbnTInhbn "" UBYTE DFC_OneToOne 1 100 0.00 1.000 BIT_MASK 0x10 FORMAT "%5.3" ECU_ADDRESS 0x60034A67 /end MEASUREMENT
/begin MEASUREMENT DFC_b.LDF_HvBattRatRSohErr "" UBYTE DFC_OneToOne 1 100 0.00 1.000 BIT_MASK 0x10 FORMAT "%5.3" ECU_ADDRESS 0x60034A68 /end MEASUREMENT
/begin MEASUREMENT DFC_b.LDF_HvBattRatSohErr "" UBYTE DFC_OneToOne 1 100 0.00 1.000 BIT_MASK 0x10 FORMAT "%5.3" ECU_ADDRESS 0x60034A69 /end MEASUREMENT
/begin MEASUREMENT DFC_b.LDF_HvBattSngIsoWarn "" UBYTE DFC_OneToOne 1 100 0.00 1.000 BIT_MASK 0x10 FORMAT "%5.3" ECU_ADDRESS 0x60034A6A /end MEASUREMENT
/begin MEASUREMENT DFC_b.LDF_HvBattSrvPlgDiscnct "" UBYTE DFC_OneToOne 1 100 0.00 1.000 BIT_MASK 0x10 FORMAT "%5.3" ECU_ADDRESS 0x60034A6B /end MEASUREMENT
/begin MEASUREMENT DFC_b.LDF_HvBattUNomChrgnErr "" UBYTE DFC_OneToOne 1 100 0.00 1.000 BIT_MASK 0x10 FORMAT "%5.3" ECU_ADDRESS 0x60034A6C /end MEASUREMENT
/begin MEASUREMENT DFC_b.LDF_HvBattUNomChrgnIni "" UBYTE DFC_OneToOne 1 100 0.00 1.000 BIT_MASK 0x10 FORMAT "%5.3" ECU_ADDRESS 0x60034A6D /end MEASUREMENT
/begin MEASUREMENT DFC_b.LDF_HvBattUnderTDern "" UBYTE DFC_OneToOne 1 100 0.00 1.000 BIT_MASK 0x10 FORMAT "%5.3" ECU_ADDRESS 0x60034A6E /end MEASUREMENT
/begin MEASUREMENT DFC_b.LDF_HvbEVLmpBlink "" UBYTE DFC_OneToOne 1 100 0.00 1.000 BIT_MASK 0x10 FORMAT "%5.3" ECU_ADDRESS 0x60034A6F /end MEASUREMENT
/begin MEASUREMENT DFC_b.LDF_HvbEVLmpCont "" UBYTE DFC_OneToOne 1 100 0.00 1.000 BIT_MASK 0x10 FORMAT "%5.3" ECU_ADDRESS 0x60034A70 /end MEASUREMENT
/begin MEASUREMENT DFC_b.LDF_HvbSVSBlink "" UBYTE DFC_OneToOne 1 100 0.00 1.000 BIT_MASK 0x10 FORMAT "%5.3" ECU_ADDRESS 0x60034A71 /end MEASUREMENT
/begin MEASUREMENT DFC_b.LDF_HvbSVSCont "" UBYTE DFC_OneToOne 1 100 0.00 1.000 BIT_MASK 0x10 FORMAT "%5.3" ECU_ADDRESS 0x60034A72 /end MEASUREMENT
/begin MEASUREMENT DFC_b.LDF_InmLINBusBlk "" UBYTE DFC_OneToOne 1 100 0.00 1.000 BIT_MASK 0x10 FORMAT "%5.3" ECU_ADDRESS 0x60034A73 /end MEASUREMENT
/begin MEASUREMENT DFC_b.LDF_PDUProgmFailr "" UBYTE DFC_OneToOne 1 100 0.00 1.000 BIT_MASK 0x10 FORMAT "%5.3" ECU_ADDRESS 0x60034A74 /end MEASUREMENT
/begin MEASUREMENT DFC_b.LDF_PEnvSigRngMax "" UBYTE DFC_OneToOne 1 100 0.00 1.000 BIT_MASK 0x10 FORMAT "%5.3" ECU_ADDRESS 0x60034A75 /end MEASUREMENT
/begin MEASUREMENT DFC_b.LDF_PEnvSigRngMin "" UBYTE DFC_OneToOne 1 100 0.00 1.000 BIT_MASK 0x10 FORMAT "%5.3" ECU_ADDRESS 0x60034A76 /end MEASUREMENT
/begin MEASUREMENT DFC_b.LDF_PLnCChpDeactvnFaild "" UBYTE DFC_OneToOne 1 100 0.00 1.000 BIT_MASK 0x10 FORMAT "%5.3" ECU_ADDRESS 0x60034A77 /end MEASUREMENT
/begin MEASUREMENT DFC_b.LDF_PrkgBrkFailr "" UBYTE DFC_OneToOne 1 100 0.00 1.000 BIT_MASK 0x10 FORMAT "%5.3" ECU_ADDRESS 0x60034A78 /end MEASUREMENT
/begin MEASUREMENT DFC_b.LDF_PtSysLimErr "" UBYTE DFC_OneToOne 1 100 0.00 1.000 BIT_MASK 0x10 FORMAT "%5.3" ECU_ADDRESS 0x60034A79 /end MEASUREMENT
/begin MEASUREMENT DFC_b.LDF_PwrMaxDchaShoLo "" UBYTE DFC_OneToOne 1 100 0.00 1.000 BIT_MASK 0x10 FORMAT "%5.3" ECU_ADDRESS 0x60034A7A /end MEASUREMENT
/begin MEASUREMENT DFC_b.LDF_SCtPmp1FailSafeNotSuc "" UBYTE DFC_OneToOne 1 100 0.00 1.000 BIT_MASK 0x10 FORMAT "%5.3" ECU_ADDRESS 0x60034A7B /end MEASUREMENT
/begin MEASUREMENT DFC_b.LDF_SCtPmp1SCG "" UBYTE DFC_OneToOne 1 100 0.00 1.000 BIT_MASK 0x10 FORMAT "%5.3" ECU_ADDRESS 0x60034A7C /end MEASUREMENT
/begin MEASUREMENT DFC_b.LDF_VehCoornDrvrNotPrsnt "" UBYTE DFC_OneToOne 1 100 0.00 1.000 BIT_MASK 0x10 FORMAT "%5.3" ECU_ADDRESS 0x60034A7D /end MEASUREMENT
/begin MEASUREMENT DFC_b.LDF_VehVCanAvl "" UBYTE DFC_OneToOne 1 100 0.00 1.000 BIT_MASK 0x10 FORMAT "%5.3" ECU_ADDRESS 0x60034A7E /end MEASUREMENT
/begin MEASUREMENT DFC_b.LDF_VehVCanErr "" UBYTE DFC_OneToOne 1 100 0.00 1.000 BIT_MASK 0x10 FORMAT "%5.3" ECU_ADDRESS 0x60034A7F /end MEASUREMENT
/begin MEASUREMENT DFC_b.LDF_eTogFailrLvlRes "" UBYTE DFC_OneToOne 1 100 0.00 1.000 BIT_MASK 0x10 FORMAT "%5.3" ECU_ADDRESS 0x60034A80 /end MEASUREMENT
/begin MEASUREMENT DFC_b.LDF_flgBrkMaiDiag "" UBYTE DFC_OneToOne 1 100 0.00 1.000 BIT_MASK 0x10 FORMAT "%5.3" ECU_ADDRESS 0x60034A81 /end MEASUREMENT
/begin MEASUREMENT DFC_b.LDF_stHvbIsoMeasmtRes "" UBYTE DFC_OneToOne 1 100 0.00 1.000 BIT_MASK 0x10 FORMAT "%5.3" ECU_ADDRESS 0x60034A82 /end MEASUREMENT
/begin MEASUREMENT DFC_b.LDF_BrkBstPmpPLeakDfct "" UBYTE DFC_OneToOne 1 100 0.00 1.000 BIT_MASK 0x10 FORMAT "%5.3" ECU_ADDRESS 0x60034A83 /end MEASUREMENT
/begin MEASUREMENT DFC_b.LDF_Com082hTooShort "" UBYTE DFC_OneToOne 1 100 0.00 1.000 BIT_MASK 0x10 FORMAT "%5.3" ECU_ADDRESS 0x60034A84 /end MEASUREMENT
/begin MEASUREMENT DFC_b.LDF_Com092hTooShort "" UBYTE DFC_OneToOne 1 100 0.00 1.000 BIT_MASK 0x10 FORMAT "%5.3" ECU_ADDRESS 0x60034A85 /end MEASUREMENT
/begin MEASUREMENT DFC_b.LDF_Com205hAbsent "" UBYTE DFC_OneToOne 1 100 0.00 1.000 BIT_MASK 0x10 FORMAT "%5.3" ECU_ADDRESS 0x60034A86 /end MEASUREMENT
/begin MEASUREMENT DFC_b.LDF_Com205hChecksum "" UBYTE DFC_OneToOne 1 100 0.00 1.000 BIT_MASK 0x10 FORMAT "%5.3" ECU_ADDRESS 0x60034A87 /end MEASUREMENT
/begin MEASUREMENT DFC_b.LDF_Com205hCounter "" UBYTE DFC_OneToOne 1 100 0.00 1.000 BIT_MASK 0x10 FORMAT "%5.3" ECU_ADDRESS 0x60034A88 /end MEASUREMENT
/begin MEASUREMENT DFC_b.LDF_Com205hTooShort "" UBYTE DFC_OneToOne 1 100 0.00 1.000 BIT_MASK 0x10 FORMAT "%5.3" ECU_ADDRESS 0x60034A89 /end MEASUREMENT
/begin MEASUREMENT DFC_b.LDF_Com217hAbsent "" UBYTE DFC_OneToOne 1 100 0.00 1.000 BIT_MASK 0x10 FORMAT "%5.3" ECU_ADDRESS 0x60034A8A /end MEASUREMENT
/begin MEASUREMENT DFC_b.LDF_Com217hChecksum "" UBYTE DFC_OneToOne 1 100 0.00 1.000 BIT_MASK 0x10 FORMAT "%5.3" ECU_ADDRESS 0x60034A8B /end MEASUREMENT
/begin MEASUREMENT DFC_b.LDF_Com217hCounter "" UBYTE DFC_OneToOne 1 100 0.00 1.000 BIT_MASK 0x10 FORMAT "%5.3" ECU_ADDRESS 0x60034A8C /end MEASUREMENT
/begin MEASUREMENT DFC_b.LDF_Com217hTooShort "" UBYTE DFC_OneToOne 1 100 0.00 1.000 BIT_MASK 0x10 FORMAT "%5.3" ECU_ADDRESS 0x60034A8D /end MEASUREMENT
/begin MEASUREMENT DFC_b.LDF_Com227hAbsent "" UBYTE DFC_OneToOne 1 100 0.00 1.000 BIT_MASK 0x10 FORMAT "%5.3" ECU_ADDRESS 0x60034A8E /end MEASUREMENT
/begin MEASUREMENT DFC_b.LDF_Com227hTooShort "" UBYTE DFC_OneToOne 1 100 0.00 1.000 BIT_MASK 0x10 FORMAT "%5.3" ECU_ADDRESS 0x60034A8F /end MEASUREMENT
/begin MEASUREMENT DFC_b.LDF_Com237hAbsent "" UBYTE DFC_OneToOne 1 100 0.00 1.000 BIT_MASK 0x10 FORMAT "%5.3" ECU_ADDRESS 0x60034A90 /end MEASUREMENT
/begin MEASUREMENT DFC_b.LDF_Com237hChecksum "" UBYTE DFC_OneToOne 1 100 0.00 1.000 BIT_MASK 0x10 FORMAT "%5.3" ECU_ADDRESS 0x60034A91 /end MEASUREMENT
/begin MEASUREMENT DFC_b.LDF_Com237hCounter "" UBYTE DFC_OneToOne 1 100 0.00 1.000 BIT_MASK 0x10 FORMAT "%5.3" ECU_ADDRESS 0x60034A92 /end MEASUREMENT
/begin MEASUREMENT DFC_b.LDF_Com237hTooShort "" UBYTE DFC_OneToOne 1 100 0.00 1.000 BIT_MASK 0x10 FORMAT "%5.3" ECU_ADDRESS 0x60034A93 /end MEASUREMENT
/begin MEASUREMENT DFC_b.LDF_Com259hAbsent "" UBYTE DFC_OneToOne 1 100 0.00 1.000 BIT_MASK 0x10 FORMAT "%5.3" ECU_ADDRESS 0x60034A94 /end MEASUREMENT
/begin MEASUREMENT DFC_b.LDF_Com259hChecksum "" UBYTE DFC_OneToOne 1 100 0.00 1.000 BIT_MASK 0x10 FORMAT "%5.3" ECU_ADDRESS 0x60034A95 /end MEASUREMENT
/begin MEASUREMENT DFC_b.LDF_Com259hCounter "" UBYTE DFC_OneToOne 1 100 0.00 1.000 BIT_MASK 0x10 FORMAT "%5.3" ECU_ADDRESS 0x60034A96 /end MEASUREMENT
/begin MEASUREMENT DFC_b.LDF_Com259hTooShort "" UBYTE DFC_OneToOne 1 100 0.00 1.000 BIT_MASK 0x10 FORMAT "%5.3" ECU_ADDRESS 0x60034A97 /end MEASUREMENT
/begin MEASUREMENT DFC_b.LDF_Com26hAbsent "" UBYTE DFC_OneToOne 1 100 0.00 1.000 BIT_MASK 0x10 FORMAT "%5.3" ECU_ADDRESS 0x60034A98 /end MEASUREMENT
/begin MEASUREMENT DFC_b.LDF_Com26hTooShort "" UBYTE DFC_OneToOne 1 100 0.00 1.000 BIT_MASK 0x10 FORMAT "%5.3" ECU_ADDRESS 0x60034A99 /end MEASUREMENT
/begin MEASUREMENT DFC_b.LDF_Com273hAbsent "" UBYTE DFC_OneToOne 1 100 0.00 1.000 BIT_MASK 0x10 FORMAT "%5.3" ECU_ADDRESS 0x60034A9A /end MEASUREMENT
/begin MEASUREMENT DFC_b.LDF_Com273hChecksum "" UBYTE DFC_OneToOne 1 100 0.00 1.000 BIT_MASK 0x10 FORMAT "%5.3" ECU_ADDRESS 0x60034A9B /end MEASUREMENT
/begin MEASUREMENT DFC_b.LDF_Com273hCounter "" UBYTE DFC_OneToOne 1 100 0.00 1.000 BIT_MASK 0x10 FORMAT "%5.3" ECU_ADDRESS 0x60034A9C /end MEASUREMENT
/begin MEASUREMENT DFC_b.LDF_Com273hTooShort "" UBYTE DFC_OneToOne 1 100 0.00 1.000 BIT_MASK 0x10 FORMAT "%5.3" ECU_ADDRESS 0x60034A9D /end MEASUREMENT
/begin MEASUREMENT DFC_b.LDF_Com275hAbsent "" UBYTE DFC_OneToOne 1 100 0.00 1.000 BIT_MASK 0x10 FORMAT "%5.3" ECU_ADDRESS 0x60034A9E /end MEASUREMENT
/begin MEASUREMENT DFC_b.LDF_Com275hChecksum "" UBYTE DFC_OneToOne 1 100 0.00 1.000 BIT_MASK 0x10 FORMAT "%5.3" ECU_ADDRESS 0x60034A9F /end MEASUREMENT
/begin MEASUREMENT DFC_b.LDF_Com275hCounter "" UBYTE DFC_OneToOne 1 100 0.00 1.000 BIT_MASK 0x10 FORMAT "%5.3" ECU_ADDRESS 0x60034AA0 /end MEASUREMENT
/begin MEASUREMENT DFC_b.LDF_Com275hTooShort "" UBYTE DFC_OneToOne 1 100 0.00 1.000 BIT_MASK 0x10 FORMAT "%5.3" ECU_ADDRESS 0x60034AA1 /end MEASUREMENT
/begin MEASUREMENT DFC_b.LDF_Com283hAbsent "" UBYTE DFC_OneToOne 1 100 0.00 1.000 BIT_MASK 0x10 FORMAT "%5.3" ECU_ADDRESS 0x60034AA2 /end MEASUREMENT
/begin MEASUREMENT DFC_b.LDF_Com283hTooShort "" UBYTE DFC_OneToOne 1 100 0.00 1.000 BIT_MASK 0x10 FORMAT "%5.3" ECU_ADDRESS 0x60034AA3 /end MEASUREMENT
/begin MEASUREMENT DFC_b.LDF_Com285hAbsent "" UBYTE DFC_OneToOne 1 100 0.00 1.000 BIT_MASK 0x10 FORMAT "%5.3" ECU_ADDRESS 0x60034AA4 /end MEASUREMENT
/begin MEASUREMENT DFC_b.LDF_Com285hChecksum "" UBYTE DFC_OneToOne 1 100 0.00 1.000 BIT_MASK 0x10 FORMAT "%5.3" ECU_ADDRESS 0x60034AA5 /end MEASUREMENT
/begin MEASUREMENT DFC_b.LDF_Com285hCounter "" UBYTE DFC_OneToOne 1 100 0.00 1.000 BIT_MASK 0x10 FORMAT "%5.3" ECU_ADDRESS 0x60034AA6 /end MEASUREMENT
/begin MEASUREMENT DFC_b.LDF_Com285hTooShort "" UBYTE DFC_OneToOne 1 100 0.00 1.000 BIT_MASK 0x10 FORMAT "%5.3" ECU_ADDRESS 0x60034AA7 /end MEASUREMENT
/begin MEASUREMENT DFC_b.LDF_Com293hAbsent "" UBYTE DFC_OneToOne 1 100 0.00 1.000 BIT_MASK 0x10 FORMAT "%5.3" ECU_ADDRESS 0x60034AA8 /end MEASUREMENT
/begin MEASUREMENT DFC_b.LDF_Com293hChecksum "" UBYTE DFC_OneToOne 1 100 0.00 1.000 BIT_MASK 0x10 FORMAT "%5.3" ECU_ADDRESS 0x60034AA9 /end MEASUREMENT
/begin MEASUREMENT DFC_b.LDF_Com293hCounter "" UBYTE DFC_OneToOne 1 100 0.00 1.000 BIT_MASK 0x10 FORMAT "%5.3" ECU_ADDRESS 0x60034AAA /end MEASUREMENT
/begin MEASUREMENT DFC_b.LDF_Com293hTooShort "" UBYTE DFC_OneToOne 1 100 0.00 1.000 BIT_MASK 0x10 FORMAT "%5.3" ECU_ADDRESS 0x60034AAB /end MEASUREMENT
/begin MEASUREMENT DFC_b.LDF_Com308hAbsent "" UBYTE DFC_OneToOne 1 100 0.00 1.000 BIT_MASK 0x10 FORMAT "%5.3" ECU_ADDRESS 0x60034AAC /end MEASUREMENT
/begin MEASUREMENT DFC_b.LDF_Com308hChecksum "" UBYTE DFC_OneToOne 1 100 0.00 1.000 BIT_MASK 0x10 FORMAT "%5.3" ECU_ADDRESS 0x60034AAD /end MEASUREMENT
/begin MEASUREMENT DFC_b.LDF_Com308hCounter "" UBYTE DFC_OneToOne 1 100 0.00 1.000 BIT_MASK 0x10 FORMAT "%5.3" ECU_ADDRESS 0x60034AAE /end MEASUREMENT
/begin MEASUREMENT DFC_b.LDF_Com308hTooShort "" UBYTE DFC_OneToOne 1 100 0.00 1.000 BIT_MASK 0x10 FORMAT "%5.3" ECU_ADDRESS 0x60034AAF /end MEASUREMENT
/begin MEASUREMENT DFC_b.LDF_Com318hAbsent "" UBYTE DFC_OneToOne 1 100 0.00 1.000 BIT_MASK 0x10 FORMAT "%5.3" ECU_ADDRESS 0x60034AB0 /end MEASUREMENT
/begin MEASUREMENT DFC_b.LDF_Com318hChecksum "" UBYTE DFC_OneToOne 1 100 0.00 1.000 BIT_MASK 0x10 FORMAT "%5.3" ECU_ADDRESS 0x60034AB1 /end MEASUREMENT
/begin MEASUREMENT DFC_b.LDF_Com318hCounter "" UBYTE DFC_OneToOne 1 100 0.00 1.000 BIT_MASK 0x10 FORMAT "%5.3" ECU_ADDRESS 0x60034AB2 /end MEASUREMENT
/begin MEASUREMENT DFC_b.LDF_Com318hTooShort "" UBYTE DFC_OneToOne 1 100 0.00 1.000 BIT_MASK 0x10 FORMAT "%5.3" ECU_ADDRESS 0x60034AB3 /end MEASUREMENT
/begin MEASUREMENT DFC_b.LDF_Com325hAbsent "" UBYTE DFC_OneToOne 1 100 0.00 1.000 BIT_MASK 0x10 FORMAT "%5.3" ECU_ADDRESS 0x60034AB4 /end MEASUREMENT
/begin MEASUREMENT DFC_b.LDF_Com325hChecksum "" UBYTE DFC_OneToOne 1 100 0.00 1.000 BIT_MASK 0x10 FORMAT "%5.3" ECU_ADDRESS 0x60034AB5 /end MEASUREMENT
/begin MEASUREMENT DFC_b.LDF_Com325hCounter "" UBYTE DFC_OneToOne 1 100 0.00 1.000 BIT_MASK 0x10 FORMAT "%5.3" ECU_ADDRESS 0x60034AB6 /end MEASUREMENT
/begin MEASUREMENT DFC_b.LDF_Com325hTooShort "" UBYTE DFC_OneToOne 1 100 0.00 1.000 BIT_MASK 0x10 FORMAT "%5.3" ECU_ADDRESS 0x60034AB7 /end MEASUREMENT
/begin MEASUREMENT DFC_b.LDF_Com335hAbsent "" UBYTE DFC_OneToOne 1 100 0.00 1.000 BIT_MASK 0x10 FORMAT "%5.3" ECU_ADDRESS 0x60034AB8 /end MEASUREMENT
/begin MEASUREMENT DFC_b.LDF_Com335hChecksum "" UBYTE DFC_OneToOne 1 100 0.00 1.000 BIT_MASK 0x10 FORMAT "%5.3" ECU_ADDRESS 0x60034AB9 /end MEASUREMENT
/begin MEASUREMENT DFC_b.LDF_Com335hCounter "" UBYTE DFC_OneToOne 1 100 0.00 1.000 BIT_MASK 0x10 FORMAT "%5.3" ECU_ADDRESS 0x60034ABA /end MEASUREMENT
/begin MEASUREMENT DFC_b.LDF_Com335hTooShort "" UBYTE DFC_OneToOne 1 100 0.00 1.000 BIT_MASK 0x10 FORMAT "%5.3" ECU_ADDRESS 0x60034ABB /end MEASUREMENT
/begin MEASUREMENT DFC_b.LDF_Com351hAbsent "" UBYTE DFC_OneToOne 1 100 0.00 1.000 BIT_MASK 0x10 FORMAT "%5.3" ECU_ADDRESS 0x60034ABC /end MEASUREMENT
/begin MEASUREMENT DFC_b.LDF_Com351hTooShort "" UBYTE DFC_OneToOne 1 100 0.00 1.000 BIT_MASK 0x10 FORMAT "%5.3" ECU_ADDRESS 0x60034ABD /end MEASUREMENT
/begin MEASUREMENT DFC_b.LDF_Com38DhAbsent "" UBYTE DFC_OneToOne 1 100 0.00 1.000 BIT_MASK 0x10 FORMAT "%5.3" ECU_ADDRESS 0x60034ABE /end MEASUREMENT
/begin MEASUREMENT DFC_b.LDF_Com38DhChecksum "" UBYTE DFC_OneToOne 1 100 0.00 1.000 BIT_MASK 0x10 FORMAT "%5.3" ECU_ADDRESS 0x60034ABF /end MEASUREMENT
/begin MEASUREMENT DFC_b.LDF_Com38DhCounter "" UBYTE DFC_OneToOne 1 100 0.00 1.000 BIT_MASK 0x10 FORMAT "%5.3" ECU_ADDRESS 0x60034AC0 /end MEASUREMENT
/begin MEASUREMENT DFC_b.LDF_Com38DhTooShort "" UBYTE DFC_OneToOne 1 100 0.00 1.000 BIT_MASK 0x10 FORMAT "%5.3" ECU_ADDRESS 0x60034AC1 /end MEASUREMENT
/begin MEASUREMENT DFC_b.LDF_Com412hAbsent "" UBYTE DFC_OneToOne 1 100 0.00 1.000 BIT_MASK 0x10 FORMAT "%5.3" ECU_ADDRESS 0x60034AC2 /end MEASUREMENT
/begin MEASUREMENT DFC_b.LDF_Com412hChecksum "" UBYTE DFC_OneToOne 1 100 0.00 1.000 BIT_MASK 0x10 FORMAT "%5.3" ECU_ADDRESS 0x60034AC3 /end MEASUREMENT
/begin MEASUREMENT DFC_b.LDF_Com412hCounter "" UBYTE DFC_OneToOne 1 100 0.00 1.000 BIT_MASK 0x10 FORMAT "%5.3" ECU_ADDRESS 0x60034AC4 /end MEASUREMENT
/begin MEASUREMENT DFC_b.LDF_Com412hTooShort "" UBYTE DFC_OneToOne 1 100 0.00 1.000 BIT_MASK 0x10 FORMAT "%5.3" ECU_ADDRESS 0x60034AC5 /end MEASUREMENT
/begin MEASUREMENT DFC_b.LDF_Com427hAbsent "" UBYTE DFC_OneToOne 1 100 0.00 1.000 BIT_MASK 0x10 FORMAT "%5.3" ECU_ADDRESS 0x60034AC6 /end MEASUREMENT
/begin MEASUREMENT DFC_b.LDF_Com427hTooShort "" UBYTE DFC_OneToOne 1 100 0.00 1.000 BIT_MASK 0x10 FORMAT "%5.3" ECU_ADDRESS 0x60034AC7 /end MEASUREMENT
/begin MEASUREMENT DFC_b.LDF_Com432hAbsent "" UBYTE DFC_OneToOne 1 100 0.00 1.000 BIT_MASK 0x10 FORMAT "%5.3" ECU_ADDRESS 0x60034AC8 /end MEASUREMENT
/begin MEASUREMENT DFC_b.LDF_Com432hChecksum "" UBYTE DFC_OneToOne 1 100 0.00 1.000 BIT_MASK 0x10 FORMAT "%5.3" ECU_ADDRESS 0x60034AC9 /end MEASUREMENT
/begin MEASUREMENT DFC_b.LDF_Com432hCounter "" UBYTE DFC_OneToOne 1 100 0.00 1.000 BIT_MASK 0x10 FORMAT "%5.3" ECU_ADDRESS 0x60034ACA /end MEASUREMENT
/begin MEASUREMENT DFC_b.LDF_Com432hTooShort "" UBYTE DFC_OneToOne 1 100 0.00 1.000 BIT_MASK 0x10 FORMAT "%5.3" ECU_ADDRESS 0x60034ACB /end MEASUREMENT
/begin MEASUREMENT DFC_b.LDF_Com435hAbsent "" UBYTE DFC_OneToOne 1 100 0.00 1.000 BIT_MASK 0x10 FORMAT "%5.3" ECU_ADDRESS 0x60034ACC /end MEASUREMENT
/begin MEASUREMENT DFC_b.LDF_Com435hTooShort "" UBYTE DFC_OneToOne 1 100 0.00 1.000 BIT_MASK 0x10 FORMAT "%5.3" ECU_ADDRESS 0x60034ACD /end MEASUREMENT
/begin MEASUREMENT DFC_b.LDF_Com442hAbsent "" UBYTE DFC_OneToOne 1 100 0.00 1.000 BIT_MASK 0x10 FORMAT "%5.3" ECU_ADDRESS 0x60034ACE /end MEASUREMENT
/begin MEASUREMENT DFC_b.LDF_Com442hTooShort "" UBYTE DFC_OneToOne 1 100 0.00 1.000 BIT_MASK 0x10 FORMAT "%5.3" ECU_ADDRESS 0x60034ACF /end MEASUREMENT
/begin MEASUREMENT DFC_b.LDF_Com453hAbsent "" UBYTE DFC_OneToOne 1 100 0.00 1.000 BIT_MASK 0x10 FORMAT "%5.3" ECU_ADDRESS 0x60034AD0 /end MEASUREMENT
/begin MEASUREMENT DFC_b.LDF_Com453hTooShort "" UBYTE DFC_OneToOne 1 100 0.00 1.000 BIT_MASK 0x10 FORMAT "%5.3" ECU_ADDRESS 0x60034AD1 /end MEASUREMENT
/begin MEASUREMENT DFC_b.LDF_Com455hAbsent "" UBYTE DFC_OneToOne 1 100 0.00 1.000 BIT_MASK 0x10 FORMAT "%5.3" ECU_ADDRESS 0x60034AD2 /end MEASUREMENT
/begin MEASUREMENT DFC_b.LDF_Com455hTooShort "" UBYTE DFC_OneToOne 1 100 0.00 1.000 BIT_MASK 0x10 FORMAT "%5.3" ECU_ADDRESS 0x60034AD3 /end MEASUREMENT
/begin MEASUREMENT DFC_b.LDF_Com463hAbsent "" UBYTE DFC_OneToOne 1 100 0.00 1.000 BIT_MASK 0x10 FORMAT "%5.3" ECU_ADDRESS 0x60034AD4 /end MEASUREMENT
/begin MEASUREMENT DFC_b.LDF_Com463hTooShort "" UBYTE DFC_OneToOne 1 100 0.00 1.000 BIT_MASK 0x10 FORMAT "%5.3" ECU_ADDRESS 0x60034AD5 /end MEASUREMENT
/begin MEASUREMENT DFC_b.LDF_Com473hAbsent "" UBYTE DFC_OneToOne 1 100 0.00 1.000 BIT_MASK 0x10 FORMAT "%5.3" ECU_ADDRESS 0x60034AD6 /end MEASUREMENT
/begin MEASUREMENT DFC_b.LDF_Com473hTooShort "" UBYTE DFC_OneToOne 1 100 0.00 1.000 BIT_MASK 0x10 FORMAT "%5.3" ECU_ADDRESS 0x60034AD7 /end MEASUREMENT
/begin MEASUREMENT DFC_b.LDF_Com47BhAbsent "" UBYTE DFC_OneToOne 1 100 0.00 1.000 BIT_MASK 0x10 FORMAT "%5.3" ECU_ADDRESS 0x60034AD8 /end MEASUREMENT
/begin MEASUREMENT DFC_b.LDF_Com47BhTooShort "" UBYTE DFC_OneToOne 1 100 0.00 1.000 BIT_MASK 0x10 FORMAT "%5.3" ECU_ADDRESS 0x60034AD9 /end MEASUREMENT
/begin MEASUREMENT DFC_b.LDF_Com48BhAbsent "" UBYTE DFC_OneToOne 1 100 0.00 1.000 BIT_MASK 0x10 FORMAT "%5.3" ECU_ADDRESS 0x60034ADA /end MEASUREMENT
/begin MEASUREMENT DFC_b.LDF_Com48BhTooShort "" UBYTE DFC_OneToOne 1 100 0.00 1.000 BIT_MASK 0x10 FORMAT "%5.3" ECU_ADDRESS 0x60034ADB /end MEASUREMENT
/begin MEASUREMENT DFC_b.LDF_Com497hTooShort "" UBYTE DFC_OneToOne 1 100 0.00 1.000 BIT_MASK 0x10 FORMAT "%5.3" ECU_ADDRESS 0x60034ADC /end MEASUREMENT
/begin MEASUREMENT DFC_b.LDF_Com4F2hAbsent "" UBYTE DFC_OneToOne 1 100 0.00 1.000 BIT_MASK 0x10 FORMAT "%5.3" ECU_ADDRESS 0x60034ADD /end MEASUREMENT
/begin MEASUREMENT DFC_b.LDF_Com4F2hChecksum "" UBYTE DFC_OneToOne 1 100 0.00 1.000 BIT_MASK 0x10 FORMAT "%5.3" ECU_ADDRESS 0x60034ADE /end MEASUREMENT
/begin MEASUREMENT DFC_b.LDF_Com4F2hCounter "" UBYTE DFC_OneToOne 1 100 0.00 1.000 BIT_MASK 0x10 FORMAT "%5.3" ECU_ADDRESS 0x60034ADF /end MEASUREMENT
/begin MEASUREMENT DFC_b.LDF_Com4F2hTooShort "" UBYTE DFC_OneToOne 1 100 0.00 1.000 BIT_MASK 0x10 FORMAT "%5.3" ECU_ADDRESS 0x60034AE0 /end MEASUREMENT
/begin MEASUREMENT DFC_b.LDF_Com50DhAbsent "" UBYTE DFC_OneToOne 1 100 0.00 1.000 BIT_MASK 0x10 FORMAT "%5.3" ECU_ADDRESS 0x60034AE1 /end MEASUREMENT
/begin MEASUREMENT DFC_b.LDF_Com50DhTooShort "" UBYTE DFC_OneToOne 1 100 0.00 1.000 BIT_MASK 0x10 FORMAT "%5.3" ECU_ADDRESS 0x60034AE2 /end MEASUREMENT
/begin MEASUREMENT DFC_b.LDF_Com535hAbsent "" UBYTE DFC_OneToOne 1 100 0.00 1.000 BIT_MASK 0x10 FORMAT "%5.3" ECU_ADDRESS 0x60034AE3 /end MEASUREMENT
/begin MEASUREMENT DFC_b.LDF_Com535hTooShort "" UBYTE DFC_OneToOne 1 100 0.00 1.000 BIT_MASK 0x10 FORMAT "%5.3" ECU_ADDRESS 0x60034AE4 /end MEASUREMENT
/begin MEASUREMENT DFC_b.LDF_Com543hAbsent "" UBYTE DFC_OneToOne 1 100 0.00 1.000 BIT_MASK 0x10 FORMAT "%5.3" ECU_ADDRESS 0x60034AE5 /end MEASUREMENT
/begin MEASUREMENT DFC_b.LDF_Com543hTooShort "" UBYTE DFC_OneToOne 1 100 0.00 1.000 BIT_MASK 0x10 FORMAT "%5.3" ECU_ADDRESS 0x60034AE6 /end MEASUREMENT
/begin MEASUREMENT DFC_b.LDF_Com552hAbsent "" UBYTE DFC_OneToOne 1 100 0.00 1.000 BIT_MASK 0x10 FORMAT "%5.3" ECU_ADDRESS 0x60034AE7 /end MEASUREMENT
/begin MEASUREMENT DFC_b.LDF_Com552hTooShort "" UBYTE DFC_OneToOne 1 100 0.00 1.000 BIT_MASK 0x10 FORMAT "%5.3" ECU_ADDRESS 0x60034AE8 /end MEASUREMENT
/begin MEASUREMENT DFC_b.LDF_Com583hAbsent "" UBYTE DFC_OneToOne 1 100 0.00 1.000 BIT_MASK 0x10 FORMAT "%5.3" ECU_ADDRESS 0x60034AE9 /end MEASUREMENT
/begin MEASUREMENT DFC_b.LDF_Com583hTooShort "" UBYTE DFC_OneToOne 1 100 0.00 1.000 BIT_MASK 0x10 FORMAT "%5.3" ECU_ADDRESS 0x60034AEA /end MEASUREMENT
/begin MEASUREMENT DFC_b.LDF_Com592hAbsent "" UBYTE DFC_OneToOne 1 100 0.00 1.000 BIT_MASK 0x10 FORMAT "%5.3" ECU_ADDRESS 0x60034AEB /end MEASUREMENT
/begin MEASUREMENT DFC_b.LDF_Com592hChecksum "" UBYTE DFC_OneToOne 1 100 0.00 1.000 BIT_MASK 0x10 FORMAT "%5.3" ECU_ADDRESS 0x60034AEC /end MEASUREMENT
/begin MEASUREMENT DFC_b.LDF_Com592hCounter "" UBYTE DFC_OneToOne 1 100 0.00 1.000 BIT_MASK 0x10 FORMAT "%5.3" ECU_ADDRESS 0x60034AED /end MEASUREMENT
/begin MEASUREMENT DFC_b.LDF_Com592hTooShort "" UBYTE DFC_OneToOne 1 100 0.00 1.000 BIT_MASK 0x10 FORMAT "%5.3" ECU_ADDRESS 0x60034AEE /end MEASUREMENT
/begin MEASUREMENT DFC_b.LDF_Com595hAbsent "" UBYTE DFC_OneToOne 1 100 0.00 1.000 BIT_MASK 0x10 FORMAT "%5.3" ECU_ADDRESS 0x60034AEF /end MEASUREMENT
/begin MEASUREMENT DFC_b.LDF_Com595hChecksum "" UBYTE DFC_OneToOne 1 100 0.00 1.000 BIT_MASK 0x10 FORMAT "%5.3" ECU_ADDRESS 0x60034AF0 /end MEASUREMENT
/begin MEASUREMENT DFC_b.LDF_Com595hCounter "" UBYTE DFC_OneToOne 1 100 0.00 1.000 BIT_MASK 0x10 FORMAT "%5.3" ECU_ADDRESS 0x60034AF1 /end MEASUREMENT
/begin MEASUREMENT DFC_b.LDF_Com595hTooShort "" UBYTE DFC_OneToOne 1 100 0.00 1.000 BIT_MASK 0x10 FORMAT "%5.3" ECU_ADDRESS 0x60034AF2 /end MEASUREMENT
/begin MEASUREMENT DFC_b.LDF_Com5B2hAbsent "" UBYTE DFC_OneToOne 1 100 0.00 1.000 BIT_MASK 0x10 FORMAT "%5.3" ECU_ADDRESS 0x60034AF3 /end MEASUREMENT
/begin MEASUREMENT DFC_b.LDF_Com5B2hTooShort "" UBYTE DFC_OneToOne 1 100 0.00 1.000 BIT_MASK 0x10 FORMAT "%5.3" ECU_ADDRESS 0x60034AF4 /end MEASUREMENT
/begin MEASUREMENT DFC_b.LDF_Com5B5hAbsent "" UBYTE DFC_OneToOne 1 100 0.00 1.000 BIT_MASK 0x10 FORMAT "%5.3" ECU_ADDRESS 0x60034AF5 /end MEASUREMENT
/begin MEASUREMENT DFC_b.LDF_Com5B5hChecksum "" UBYTE DFC_OneToOne 1 100 0.00 1.000 BIT_MASK 0x10 FORMAT "%5.3" ECU_ADDRESS 0x60034AF6 /end MEASUREMENT
/begin MEASUREMENT DFC_b.LDF_Com5B5hCounter "" UBYTE DFC_OneToOne 1 100 0.00 1.000 BIT_MASK 0x10 FORMAT "%5.3" ECU_ADDRESS 0x60034AF7 /end MEASUREMENT
/begin MEASUREMENT DFC_b.LDF_Com5B5hTooShort "" UBYTE DFC_OneToOne 1 100 0.00 1.000 BIT_MASK 0x10 FORMAT "%5.3" ECU_ADDRESS 0x60034AF8 /end MEASUREMENT
/begin MEASUREMENT DFC_b.LDF_Com5C7hTooShort "" UBYTE DFC_OneToOne 1 100 0.00 1.000 BIT_MASK 0x10 FORMAT "%5.3" ECU_ADDRESS 0x60034AF9 /end MEASUREMENT
/begin MEASUREMENT DFC_b.LDF_Com5E7hAbsent "" UBYTE DFC_OneToOne 1 100 0.00 1.000 BIT_MASK 0x10 FORMAT "%5.3" ECU_ADDRESS 0x60034AFA /end MEASUREMENT
/begin MEASUREMENT DFC_b.LDF_Com5E7hTooShort "" UBYTE DFC_OneToOne 1 100 0.00 1.000 BIT_MASK 0x10 FORMAT "%5.3" ECU_ADDRESS 0x60034AFB /end MEASUREMENT
/begin MEASUREMENT DFC_b.LDF_Com635hTooShort "" UBYTE DFC_OneToOne 1 100 0.00 1.000 BIT_MASK 0x10 FORMAT "%5.3" ECU_ADDRESS 0x60034AFC /end MEASUREMENT
/begin MEASUREMENT DFC_b.LDF_Com645hTooShort "" UBYTE DFC_OneToOne 1 100 0.00 1.000 BIT_MASK 0x10 FORMAT "%5.3" ECU_ADDRESS 0x60034AFD /end MEASUREMENT
/begin MEASUREMENT DFC_b.LDF_Com663hAbsent "" UBYTE DFC_OneToOne 1 100 0.00 1.000 BIT_MASK 0x10 FORMAT "%5.3" ECU_ADDRESS 0x60034AFE /end MEASUREMENT
/begin MEASUREMENT DFC_b.LDF_Com663hTooShort "" UBYTE DFC_OneToOne 1 100 0.00 1.000 BIT_MASK 0x10 FORMAT "%5.3" ECU_ADDRESS 0x60034AFF /end MEASUREMENT
/begin MEASUREMENT DFC_b.LDF_Com665hAbsent "" UBYTE DFC_OneToOne 1 100 0.00 1.000 BIT_MASK 0x10 FORMAT "%5.3" ECU_ADDRESS 0x60034B00 /end MEASUREMENT
/begin MEASUREMENT DFC_b.LDF_Com665hTooShort "" UBYTE DFC_OneToOne 1 100 0.00 1.000 BIT_MASK 0x10 FORMAT "%5.3" ECU_ADDRESS 0x60034B01 /end MEASUREMENT
/begin MEASUREMENT DFC_b.LDF_Com675hAbsent "" UBYTE DFC_OneToOne 1 100 0.00 1.000 BIT_MASK 0x10 FORMAT "%5.3" ECU_ADDRESS 0x60034B02 /end MEASUREMENT
/begin MEASUREMENT DFC_b.LDF_Com675hTooShort "" UBYTE DFC_OneToOne 1 100 0.00 1.000 BIT_MASK 0x10 FORMAT "%5.3" ECU_ADDRESS 0x60034B03 /end MEASUREMENT
/begin MEASUREMENT DFC_b.LDF_ComFrbd_205h_HVBAT_PACK_CURRENT "" UBYTE DFC_OneToOne 1 100 0.00 1.000 BIT_MASK 0x10 FORMAT "%5.3" ECU_ADDRESS 0x60034B04 /end MEASUREMENT
/begin MEASUREMENT DFC_b.LDF_ComFrbd_205h_HVBAT_SOC_DISPLAY "" UBYTE DFC_OneToOne 1 100 0.00 1.000 BIT_MASK 0x10 FORMAT "%5.3" ECU_ADDRESS 0x60034B05 /end MEASUREMENT
/begin MEASUREMENT DFC_b.LDF_ComFrbd_205h_HVBAT_VOLTAGE "" UBYTE DFC_OneToOne 1 100 0.00 1.000 BIT_MASK 0x10 FORMAT "%5.3" ECU_ADDRESS 0x60034B06 /end MEASUREMENT
/begin MEASUREMENT DFC_b.LDF_ComFrbd_217h_INV_DC_BUS_VOLTAGE "" UBYTE DFC_OneToOne 1 100 0.00 1.000 BIT_MASK 0x10 FORMAT "%5.3" ECU_ADDRESS 0x60034B07 /end MEASUREMENT
/begin MEASUREMENT DFC_b.LDF_ComFrbd_217h_INV_MTR_ACTUAL_TRQ "" UBYTE DFC_OneToOne 1 100 0.00 1.000 BIT_MASK 0x10 FORMAT "%5.3" ECU_ADDRESS 0x60034B08 /end MEASUREMENT
/begin MEASUREMENT DFC_b.LDF_ComFrbd_217h_INV_MTR_SPEED "" UBYTE DFC_OneToOne 1 100 0.00 1.000 BIT_MASK 0x10 FORMAT "%5.3" ECU_ADDRESS 0x60034B09 /end MEASUREMENT
/begin MEASUREMENT DFC_b.LDF_ComFrbd_217h_INV_MTR_TRQ "" UBYTE DFC_OneToOne 1 100 0.00 1.000 BIT_MASK 0x10 FORMAT "%5.3" ECU_ADDRESS 0x60034B0A /end MEASUREMENT
/begin MEASUREMENT DFC_b.LDF_ComFrbd_227h_INV_DC_CURRENT "" UBYTE DFC_OneToOne 1 100 0.00 1.000 BIT_MASK 0x10 FORMAT "%5.3" ECU_ADDRESS 0x60034B0B /end MEASUREMENT
/begin MEASUREMENT DFC_b.LDF_ComFrbd_227h_INV_MOTORING_PEAK_TRQ "" UBYTE DFC_OneToOne 1 100 0.00 1.000 BIT_MASK 0x10 FORMAT "%5.3" ECU_ADDRESS 0x60034B0C /end MEASUREMENT
/begin MEASUREMENT DFC_b.LDF_ComFrbd_227h_INV_MTR_INST_INPUT_POWER "" UBYTE DFC_OneToOne 1 100 0.00 1.000 BIT_MASK 0x10 FORMAT "%5.3" ECU_ADDRESS 0x60034B0D /end MEASUREMENT
/begin MEASUREMENT DFC_b.LDF_ComFrbd_227h_INV_REGEN_PEAK_TRQ "" UBYTE DFC_OneToOne 1 100 0.00 1.000 BIT_MASK 0x10 FORMAT "%5.3" ECU_ADDRESS 0x60034B0E /end MEASUREMENT
/begin MEASUREMENT DFC_b.LDF_ComFrbd_237h_INV_ACTIVE_DISCHARGE_STATUS "" UBYTE DFC_OneToOne 1 100 0.00 1.000 BIT_MASK 0x10 FORMAT "%5.3" ECU_ADDRESS 0x60034B0F /end MEASUREMENT
/begin MEASUREMENT DFC_b.LDF_ComFrbd_237h_INV_CTRL_MODE_ACK "" UBYTE DFC_OneToOne 1 100 0.00 1.000 BIT_MASK 0x10 FORMAT "%5.3" ECU_ADDRESS 0x60034B10 /end MEASUREMENT
/begin MEASUREMENT DFC_b.LDF_ComFrbd_237h_INV_EV_WARNING "" UBYTE DFC_OneToOne 1 100 0.00 1.000 BIT_MASK 0x10 FORMAT "%5.3" ECU_ADDRESS 0x60034B11 /end MEASUREMENT
/begin MEASUREMENT DFC_b.LDF_ComFrbd_237h_INV_FAULT_LEVEL "" UBYTE DFC_OneToOne 1 100 0.00 1.000 BIT_MASK 0x10 FORMAT "%5.3" ECU_ADDRESS 0x60034B12 /end MEASUREMENT
/begin MEASUREMENT DFC_b.LDF_ComFrbd_237h_INV_MASTER_STOP "" UBYTE DFC_OneToOne 1 100 0.00 1.000 BIT_MASK 0x10 FORMAT "%5.3" ECU_ADDRESS 0x60034B13 /end MEASUREMENT
/begin MEASUREMENT DFC_b.LDF_ComFrbd_237h_INV_SERVICE_DUE "" UBYTE DFC_OneToOne 1 100 0.00 1.000 BIT_MASK 0x10 FORMAT "%5.3" ECU_ADDRESS 0x60034B14 /end MEASUREMENT
/begin MEASUREMENT DFC_b.LDF_ComFrbd_237h_INV_STAB_MIN_TRQ "" UBYTE DFC_OneToOne 1 100 0.00 1.000 BIT_MASK 0x10 FORMAT "%5.3" ECU_ADDRESS 0x60034B15 /end MEASUREMENT
/begin MEASUREMENT DFC_b.LDF_ComFrbd_259h_TGLM_FAILURE_STATE "" UBYTE DFC_OneToOne 1 100 0.00 1.000 BIT_MASK 0x10 FORMAT "%5.3" ECU_ADDRESS 0x60034B16 /end MEASUREMENT
/begin MEASUREMENT DFC_b.LDF_ComFrbd_259h_TGLM_MODE_PUSH "" UBYTE DFC_OneToOne 1 100 0.00 1.000 BIT_MASK 0x10 FORMAT "%5.3" ECU_ADDRESS 0x60034B17 /end MEASUREMENT
/begin MEASUREMENT DFC_b.LDF_ComFrbd_259h_TOGGLE_MONOSTABLE_POS "" UBYTE DFC_OneToOne 1 100 0.00 1.000 BIT_MASK 0x10 FORMAT "%5.3" ECU_ADDRESS 0x60034B18 /end MEASUREMENT
/begin MEASUREMENT DFC_b.LDF_ComFrbd_273h_OBC_outputpower_capability "" UBYTE DFC_OneToOne 1 100 0.00 1.000 BIT_MASK 0x10 FORMAT "%5.3" ECU_ADDRESS 0x60034B19 /end MEASUREMENT
/begin MEASUREMENT DFC_b.LDF_ComFrbd_275h_HVBAT_DISCHARGE_30S_AVAILABLE_CURRENT "" UBYTE DFC_OneToOne 1 100 0.00 1.000 BIT_MASK 0x10 FORMAT "%5.3" ECU_ADDRESS 0x60034B1A /end MEASUREMENT
/begin MEASUREMENT DFC_b.LDF_ComFrbd_275h_HVBAT_DISCHARGE_30S_AVAILABLE_POWER "" UBYTE DFC_OneToOne 1 100 0.00 1.000 BIT_MASK 0x10 FORMAT "%5.3" ECU_ADDRESS 0x60034B1B /end MEASUREMENT
/begin MEASUREMENT DFC_b.LDF_ComFrbd_283h_DCDC_IN_CURRENT "" UBYTE DFC_OneToOne 1 100 0.00 1.000 BIT_MASK 0x10 FORMAT "%5.3" ECU_ADDRESS 0x60034B1C /end MEASUREMENT
/begin MEASUREMENT DFC_b.LDF_ComFrbd_283h_DCDC_IN_VOLTAGE "" UBYTE DFC_OneToOne 1 100 0.00 1.000 BIT_MASK 0x10 FORMAT "%5.3" ECU_ADDRESS 0x60034B1D /end MEASUREMENT
/begin MEASUREMENT DFC_b.LDF_ComFrbd_283h_DCDC_OUT_CURRENT "" UBYTE DFC_OneToOne 1 100 0.00 1.000 BIT_MASK 0x10 FORMAT "%5.3" ECU_ADDRESS 0x60034B1E /end MEASUREMENT
/begin MEASUREMENT DFC_b.LDF_ComFrbd_283h_DCDC_OUT_VOLTAGE "" UBYTE DFC_OneToOne 1 100 0.00 1.000 BIT_MASK 0x10 FORMAT "%5.3" ECU_ADDRESS 0x60034B1F /end MEASUREMENT
/begin MEASUREMENT DFC_b.LDF_ComFrbd_285h_HVBAT_REGEN_CHG_30S_CURRENT_LIMIT "" UBYTE DFC_OneToOne 1 100 0.00 1.000 BIT_MASK 0x10 FORMAT "%5.3" ECU_ADDRESS 0x60034B20 /end MEASUREMENT
/begin MEASUREMENT DFC_b.LDF_ComFrbd_285h_HVBAT_REGEN_CHRG_30S_POWER_LIMIT "" UBYTE DFC_OneToOne 1 100 0.00 1.000 BIT_MASK 0x10 FORMAT "%5.3" ECU_ADDRESS 0x60034B21 /end MEASUREMENT
/begin MEASUREMENT DFC_b.LDF_ComFrbd_293h_DCDC_outputpower_capability "" UBYTE DFC_OneToOne 1 100 0.00 1.000 BIT_MASK 0x10 FORMAT "%5.3" ECU_ADDRESS 0x60034B22 /end MEASUREMENT
/begin MEASUREMENT DFC_b.LDF_ComFrbd_325h_HVBAT_INSULATION_RESISTANCE "" UBYTE DFC_OneToOne 1 100 0.00 1.000 BIT_MASK 0x10 FORMAT "%5.3" ECU_ADDRESS 0x60034B23 /end MEASUREMENT
/begin MEASUREMENT DFC_b.LDF_ComFrbd_325h_HVBAT_TEMPERATURE "" UBYTE DFC_OneToOne 1 100 0.00 1.000 BIT_MASK 0x10 FORMAT "%5.3" ECU_ADDRESS 0x60034B24 /end MEASUREMENT
/begin MEASUREMENT DFC_b.LDF_ComFrbd_335h_HVBAT_CHRG_CONTINUOUS_CURR_MAX "" UBYTE DFC_OneToOne 1 100 0.00 1.000 BIT_MASK 0x10 FORMAT "%5.3" ECU_ADDRESS 0x60034B25 /end MEASUREMENT
/begin MEASUREMENT DFC_b.LDF_ComFrbd_335h_HVBAT_CHRG_COTINUOUS_CURR_REQ "" UBYTE DFC_OneToOne 1 100 0.00 1.000 BIT_MASK 0x10 FORMAT "%5.3" ECU_ADDRESS 0x60034B26 /end MEASUREMENT
/begin MEASUREMENT DFC_b.LDF_ComFrbd_335h_HVBAT_CHRG_MAX_VOLT "" UBYTE DFC_OneToOne 1 100 0.00 1.000 BIT_MASK 0x10 FORMAT "%5.3" ECU_ADDRESS 0x60034B27 /end MEASUREMENT
/begin MEASUREMENT DFC_b.LDF_ComFrbd_335h_HVBAT_DC_BUS_VOLTAGE "" UBYTE DFC_OneToOne 1 100 0.00 1.000 BIT_MASK 0x10 FORMAT "%5.3" ECU_ADDRESS 0x60034B28 /end MEASUREMENT
/begin MEASUREMENT DFC_b.LDF_ComFrbd_427h_INV_OP_MODE "" UBYTE DFC_OneToOne 1 100 0.00 1.000 BIT_MASK 0x10 FORMAT "%5.3" ECU_ADDRESS 0x60034B29 /end MEASUREMENT
/begin MEASUREMENT DFC_b.LDF_ComFrbd_427h_INV_PERMISIBLE_TORQUE "" UBYTE DFC_OneToOne 1 100 0.00 1.000 BIT_MASK 0x10 FORMAT "%5.3" ECU_ADDRESS 0x60034B2A /end MEASUREMENT
/begin MEASUREMENT DFC_b.LDF_ComFrbd_435h_HVBAT_MAX_CELL_VOLT "" UBYTE DFC_OneToOne 1 100 0.00 1.000 BIT_MASK 0x10 FORMAT "%5.3" ECU_ADDRESS 0x60034B2B /end MEASUREMENT
/begin MEASUREMENT DFC_b.LDF_ComFrbd_435h_HVBAT_MAX_CELL_VOLT_NUM "" UBYTE DFC_OneToOne 1 100 0.00 1.000 BIT_MASK 0x10 FORMAT "%5.3" ECU_ADDRESS 0x60034B2C /end MEASUREMENT
/begin MEASUREMENT DFC_b.LDF_ComFrbd_435h_HVBAT_MAX_SENSOR_TEMP "" UBYTE DFC_OneToOne 1 100 0.00 1.000 BIT_MASK 0x10 FORMAT "%5.3" ECU_ADDRESS 0x60034B2D /end MEASUREMENT
/begin MEASUREMENT DFC_b.LDF_ComFrbd_435h_HVBAT_MIN_CELL_VOLT "" UBYTE DFC_OneToOne 1 100 0.00 1.000 BIT_MASK 0x10 FORMAT "%5.3" ECU_ADDRESS 0x60034B2E /end MEASUREMENT
/begin MEASUREMENT DFC_b.LDF_ComFrbd_435h_HVBAT_MIN_CELL_VOLT_NUM "" UBYTE DFC_OneToOne 1 100 0.00 1.000 BIT_MASK 0x10 FORMAT "%5.3" ECU_ADDRESS 0x60034B2F /end MEASUREMENT
/begin MEASUREMENT DFC_b.LDF_ComFrbd_453h_OBC_IN_CURRENT "" UBYTE DFC_OneToOne 1 100 0.00 1.000 BIT_MASK 0x10 FORMAT "%5.3" ECU_ADDRESS 0x60034B30 /end MEASUREMENT
/begin MEASUREMENT DFC_b.LDF_ComFrbd_453h_OBC_IN_VOLTAGE "" UBYTE DFC_OneToOne 1 100 0.00 1.000 BIT_MASK 0x10 FORMAT "%5.3" ECU_ADDRESS 0x60034B31 /end MEASUREMENT
/begin MEASUREMENT DFC_b.LDF_ComFrbd_453h_OBC_IP_POWER "" UBYTE DFC_OneToOne 1 100 0.00 1.000 BIT_MASK 0x10 FORMAT "%5.3" ECU_ADDRESS 0x60034B32 /end MEASUREMENT
/begin MEASUREMENT DFC_b.LDF_ComFrbd_455h_HVBAT_NOMINAL_VOLTAGE "" UBYTE DFC_OneToOne 1 100 0.00 1.000 BIT_MASK 0x10 FORMAT "%5.3" ECU_ADDRESS 0x60034B33 /end MEASUREMENT
/begin MEASUREMENT DFC_b.LDF_ComFrbd_463h_OBC_OUT_CURRENT "" UBYTE DFC_OneToOne 1 100 0.00 1.000 BIT_MASK 0x10 FORMAT "%5.3" ECU_ADDRESS 0x60034B34 /end MEASUREMENT
/begin MEASUREMENT DFC_b.LDF_ComFrbd_463h_OBC_OUT_VOLTAGE "" UBYTE DFC_OneToOne 1 100 0.00 1.000 BIT_MASK 0x10 FORMAT "%5.3" ECU_ADDRESS 0x60034B35 /end MEASUREMENT
/begin MEASUREMENT DFC_b.LDF_ComFrbd_463h_OBC_TEMPERATURE "" UBYTE DFC_OneToOne 1 100 0.00 1.000 BIT_MASK 0x10 FORMAT "%5.3" ECU_ADDRESS 0x60034B36 /end MEASUREMENT
/begin MEASUREMENT DFC_b.LDF_ComFrbd_473h_DCDC_Coolant_Temperature "" UBYTE DFC_OneToOne 1 100 0.00 1.000 BIT_MASK 0x10 FORMAT "%5.3" ECU_ADDRESS 0x60034B37 /end MEASUREMENT
/begin MEASUREMENT DFC_b.LDF_ComFrbd_473h_DCDC_TEMPERATURE "" UBYTE DFC_OneToOne 1 100 0.00 1.000 BIT_MASK 0x10 FORMAT "%5.3" ECU_ADDRESS 0x60034B38 /end MEASUREMENT
/begin MEASUREMENT DFC_b.LDF_ComFrbd_47Bh_eCOMP_BusBarCurrent "" UBYTE DFC_OneToOne 1 100 0.00 1.000 BIT_MASK 0x10 FORMAT "%5.3" ECU_ADDRESS 0x60034B39 /end MEASUREMENT
/begin MEASUREMENT DFC_b.LDF_ComFrbd_47Bh_eCOMP_BusBarVoltage "" UBYTE DFC_OneToOne 1 100 0.00 1.000 BIT_MASK 0x10 FORMAT "%5.3" ECU_ADDRESS 0x60034B3A /end MEASUREMENT
/begin MEASUREMENT DFC_b.LDF_ComFrbd_47Bh_eCOMP_CompressorSpeed "" UBYTE DFC_OneToOne 1 100 0.00 1.000 BIT_MASK 0x10 FORMAT "%5.3" ECU_ADDRESS 0x60034B3B /end MEASUREMENT
/begin MEASUREMENT DFC_b.LDF_ComFrbd_47Bh_eCOMP_IGBT_Temp "" UBYTE DFC_OneToOne 1 100 0.00 1.000 BIT_MASK 0x10 FORMAT "%5.3" ECU_ADDRESS 0x60034B3C /end MEASUREMENT
/begin MEASUREMENT DFC_b.LDF_ComFrbd_47Bh_eCOMP_PeakPhaCurrent "" UBYTE DFC_OneToOne 1 100 0.00 1.000 BIT_MASK 0x10 FORMAT "%5.3" ECU_ADDRESS 0x60034B3D /end MEASUREMENT
/begin MEASUREMENT DFC_b.LDF_ComFrbd_47Bh_eCOMP_Power_consumption "" UBYTE DFC_OneToOne 1 100 0.00 1.000 BIT_MASK 0x10 FORMAT "%5.3" ECU_ADDRESS 0x60034B3E /end MEASUREMENT
/begin MEASUREMENT DFC_b.LDF_ComFrbd_48Bh_eCOMP_Fault_Level "" UBYTE DFC_OneToOne 1 100 0.00 1.000 BIT_MASK 0x10 FORMAT "%5.3" ECU_ADDRESS 0x60034B3F /end MEASUREMENT
/begin MEASUREMENT DFC_b.LDF_ComFrbd_4F2h_VALEUR_SOC_ETENDUE "" UBYTE DFC_OneToOne 1 100 0.00 1.000 BIT_MASK 0x10 FORMAT "%5.3" ECU_ADDRESS 0x60034B40 /end MEASUREMENT
/begin MEASUREMENT DFC_b.LDF_ComFrbd_535h_HV_BATT_TEMP_AVG "" UBYTE DFC_OneToOne 1 100 0.00 1.000 BIT_MASK 0x10 FORMAT "%5.3" ECU_ADDRESS 0x60034B41 /end MEASUREMENT
/begin MEASUREMENT DFC_b.LDF_ComFrbd_543h_HVBAT_RESTBATTENERGY "" UBYTE DFC_OneToOne 1 100 0.00 1.000 BIT_MASK 0x10 FORMAT "%5.3" ECU_ADDRESS 0x60034B42 /end MEASUREMENT
/begin MEASUREMENT DFC_b.LDF_ComFrbd_543h_HVBAT_SOH "" UBYTE DFC_OneToOne 1 100 0.00 1.000 BIT_MASK 0x10 FORMAT "%5.3" ECU_ADDRESS 0x60034B43 /end MEASUREMENT
/begin MEASUREMENT DFC_b.LDF_ComFrbd_543h_HV_BATT_SOH_RES "" UBYTE DFC_OneToOne 1 100 0.00 1.000 BIT_MASK 0x10 FORMAT "%5.3" ECU_ADDRESS 0x60034B44 /end MEASUREMENT
/begin MEASUREMENT DFC_b.LDF_ComFrbd_592h_IBATT_1 "" UBYTE DFC_OneToOne 1 100 0.00 1.000 BIT_MASK 0x10 FORMAT "%5.3" ECU_ADDRESS 0x60034B45 /end MEASUREMENT
/begin MEASUREMENT DFC_b.LDF_ComFrbd_592h_IBATT_2 "" UBYTE DFC_OneToOne 1 100 0.00 1.000 BIT_MASK 0x10 FORMAT "%5.3" ECU_ADDRESS 0x60034B46 /end MEASUREMENT
/begin MEASUREMENT DFC_b.LDF_ComFrbd_592h_IBATT_3 "" UBYTE DFC_OneToOne 1 100 0.00 1.000 BIT_MASK 0x10 FORMAT "%5.3" ECU_ADDRESS 0x60034B47 /end MEASUREMENT
/begin MEASUREMENT DFC_b.LDF_ComFrbd_592h_TEMP_BATT "" UBYTE DFC_OneToOne 1 100 0.00 1.000 BIT_MASK 0x10 FORMAT "%5.3" ECU_ADDRESS 0x60034B48 /end MEASUREMENT
/begin MEASUREMENT DFC_b.LDF_ComFrbd_592h_U_BATT_BECB "" UBYTE DFC_OneToOne 1 100 0.00 1.000 BIT_MASK 0x10 FORMAT "%5.3" ECU_ADDRESS 0x60034B49 /end MEASUREMENT
/begin MEASUREMENT DFC_b.LDF_ComFrbd_595h_HVBAT_TIME_TO_CHRG_80 "" UBYTE DFC_OneToOne 1 100 0.00 1.000 BIT_MASK 0x10 FORMAT "%5.3" ECU_ADDRESS 0x60034B4A /end MEASUREMENT
/begin MEASUREMENT DFC_b.LDF_ComFrbd_5B2h_TEMP_AIR_EXT "" UBYTE DFC_OneToOne 1 100 0.00 1.000 BIT_MASK 0x10 FORMAT "%5.3" ECU_ADDRESS 0x60034B4B /end MEASUREMENT
/begin MEASUREMENT DFC_b.LDF_ComFrbd_635h_HVBAT_NEG_CONT_COUNT_SEG1 "" UBYTE DFC_OneToOne 1 100 0.00 1.000 BIT_MASK 0x10 FORMAT "%5.3" ECU_ADDRESS 0x60034B4C /end MEASUREMENT
/begin MEASUREMENT DFC_b.LDF_ComFrbd_635h_HVBAT_NEG_CONT_COUNT_SEG3 "" UBYTE DFC_OneToOne 1 100 0.00 1.000 BIT_MASK 0x10 FORMAT "%5.3" ECU_ADDRESS 0x60034B4D /end MEASUREMENT
/begin MEASUREMENT DFC_b.LDF_ComFrbd_635h_HVBAT_NEG_CONT_COUNT_SEG4 "" UBYTE DFC_OneToOne 1 100 0.00 1.000 BIT_MASK 0x10 FORMAT "%5.3" ECU_ADDRESS 0x60034B4E /end MEASUREMENT
/begin MEASUREMENT DFC_b.LDF_ComFrbd_635h_HVBAT_PST_CONT_COUNT_SEG1 "" UBYTE DFC_OneToOne 1 100 0.00 1.000 BIT_MASK 0x10 FORMAT "%5.3" ECU_ADDRESS 0x60034B4F /end MEASUREMENT
/begin MEASUREMENT DFC_b.LDF_ComFrbd_635h_HVBAT_PST_CONT_COUNT_SEG3 "" UBYTE DFC_OneToOne 1 100 0.00 1.000 BIT_MASK 0x10 FORMAT "%5.3" ECU_ADDRESS 0x60034B50 /end MEASUREMENT
/begin MEASUREMENT DFC_b.LDF_ComFrbd_635h_HVBAT_PST_CONT_COUNT_SEG4 "" UBYTE DFC_OneToOne 1 100 0.00 1.000 BIT_MASK 0x10 FORMAT "%5.3" ECU_ADDRESS 0x60034B51 /end MEASUREMENT
/begin MEASUREMENT DFC_b.LDF_ComFrbd_645h_HVBAT_PRECHRGE_CONT_COUNT_SEG1 "" UBYTE DFC_OneToOne 1 100 0.00 1.000 BIT_MASK 0x10 FORMAT "%5.3" ECU_ADDRESS 0x60034B52 /end MEASUREMENT
/begin MEASUREMENT DFC_b.LDF_ComFrbd_645h_HVBAT_PRECHRGE_CONT_COUNT_SEG2 "" UBYTE DFC_OneToOne 1 100 0.00 1.000 BIT_MASK 0x10 FORMAT "%5.3" ECU_ADDRESS 0x60034B53 /end MEASUREMENT
/begin MEASUREMENT DFC_b.LDF_ComFrbd_675h_HVBAT_REMAININGBATTCAPACITY "" UBYTE DFC_OneToOne 1 100 0.00 1.000 BIT_MASK 0x10 FORMAT "%5.3" ECU_ADDRESS 0x60034B54 /end MEASUREMENT
/begin MEASUREMENT DFC_b.LDF_ComInvld_205h_HVBAT_CHARGING_STATUS "" UBYTE DFC_OneToOne 1 100 0.00 1.000 BIT_MASK 0x10 FORMAT "%5.3" ECU_ADDRESS 0x60034B55 /end MEASUREMENT
/begin MEASUREMENT DFC_b.LDF_ComInvld_205h_HVBAT_PACK_CURRENT "" UBYTE DFC_OneToOne 1 100 0.00 1.000 BIT_MASK 0x10 FORMAT "%5.3" ECU_ADDRESS 0x60034B56 /end MEASUREMENT
/begin MEASUREMENT DFC_b.LDF_ComInvld_205h_HVBAT_SOC_DISPLAY "" UBYTE DFC_OneToOne 1 100 0.00 1.000 BIT_MASK 0x10 FORMAT "%5.3" ECU_ADDRESS 0x60034B57 /end MEASUREMENT
/begin MEASUREMENT DFC_b.LDF_ComInvld_205h_HVBAT_VOLTAGE "" UBYTE DFC_OneToOne 1 100 0.00 1.000 BIT_MASK 0x10 FORMAT "%5.3" ECU_ADDRESS 0x60034B58 /end MEASUREMENT
/begin MEASUREMENT DFC_b.LDF_ComInvld_217h_INV_DC_BUS_VOLTAGE "" UBYTE DFC_OneToOne 1 100 0.00 1.000 BIT_MASK 0x10 FORMAT "%5.3" ECU_ADDRESS 0x60034B59 /end MEASUREMENT
/begin MEASUREMENT DFC_b.LDF_ComInvld_217h_INV_MTR_ACTUAL_TRQ "" UBYTE DFC_OneToOne 1 100 0.00 1.000 BIT_MASK 0x10 FORMAT "%5.3" ECU_ADDRESS 0x60034B5A /end MEASUREMENT
/begin MEASUREMENT DFC_b.LDF_ComInvld_217h_INV_MTR_SPEED "" UBYTE DFC_OneToOne 1 100 0.00 1.000 BIT_MASK 0x10 FORMAT "%5.3" ECU_ADDRESS 0x60034B5B /end MEASUREMENT
/begin MEASUREMENT DFC_b.LDF_ComInvld_217h_INV_MTR_TRQ "" UBYTE DFC_OneToOne 1 100 0.00 1.000 BIT_MASK 0x10 FORMAT "%5.3" ECU_ADDRESS 0x60034B5C /end MEASUREMENT
/begin MEASUREMENT DFC_b.LDF_ComInvld_227h_INV_DC_CURRENT "" UBYTE DFC_OneToOne 1 100 0.00 1.000 BIT_MASK 0x10 FORMAT "%5.3" ECU_ADDRESS 0x60034B5D /end MEASUREMENT
/begin MEASUREMENT DFC_b.LDF_ComInvld_227h_INV_MOTORING_PEAK_TRQ "" UBYTE DFC_OneToOne 1 100 0.00 1.000 BIT_MASK 0x10 FORMAT "%5.3" ECU_ADDRESS 0x60034B5E /end MEASUREMENT
/begin MEASUREMENT DFC_b.LDF_ComInvld_227h_INV_MTR_INST_INPUT_POWER "" UBYTE DFC_OneToOne 1 100 0.00 1.000 BIT_MASK 0x10 FORMAT "%5.3" ECU_ADDRESS 0x60034B5F /end MEASUREMENT
/begin MEASUREMENT DFC_b.LDF_ComInvld_227h_INV_REGEN_PEAK_TRQ "" UBYTE DFC_OneToOne 1 100 0.00 1.000 BIT_MASK 0x10 FORMAT "%5.3" ECU_ADDRESS 0x60034B60 /end MEASUREMENT
/begin MEASUREMENT DFC_b.LDF_ComInvld_237h_INV_ACTIVE_DISCHARGE_STATUS "" UBYTE DFC_OneToOne 1 100 0.00 1.000 BIT_MASK 0x10 FORMAT "%5.3" ECU_ADDRESS 0x60034B61 /end MEASUREMENT
/begin MEASUREMENT DFC_b.LDF_ComInvld_237h_INV_FAULT_LEVEL "" UBYTE DFC_OneToOne 1 100 0.00 1.000 BIT_MASK 0x10 FORMAT "%5.3" ECU_ADDRESS 0x60034B62 /end MEASUREMENT
/begin MEASUREMENT DFC_b.LDF_ComInvld_237h_INV_STAB_MIN_TRQ "" UBYTE DFC_OneToOne 1 100 0.00 1.000 BIT_MASK 0x10 FORMAT "%5.3" ECU_ADDRESS 0x60034B63 /end MEASUREMENT
/begin MEASUREMENT DFC_b.LDF_ComInvld_259h_TGLM_MODE_PUSH "" UBYTE DFC_OneToOne 1 100 0.00 1.000 BIT_MASK 0x10 FORMAT "%5.3" ECU_ADDRESS 0x60034B64 /end MEASUREMENT
/begin MEASUREMENT DFC_b.LDF_ComInvld_259h_TOGGLE_MONOSTABLE_POS "" UBYTE DFC_OneToOne 1 100 0.00 1.000 BIT_MASK 0x10 FORMAT "%5.3" ECU_ADDRESS 0x60034B65 /end MEASUREMENT
/begin MEASUREMENT DFC_b.LDF_ComInvld_26h_AC_SWITCH_REQ "" UBYTE DFC_OneToOne 1 100 0.00 1.000 BIT_MASK 0x10 FORMAT "%5.3" ECU_ADDRESS 0x60034B66 /end MEASUREMENT
/begin MEASUREMENT DFC_b.LDF_ComInvld_26h_BLOWER_POSITION "" UBYTE DFC_OneToOne 1 100 0.00 1.000 BIT_MASK 0x10 FORMAT "%5.3" ECU_ADDRESS 0x60034B67 /end MEASUREMENT
/begin MEASUREMENT DFC_b.LDF_ComInvld_26h_EVAP_SENSOR_FAULT "" UBYTE DFC_OneToOne 1 100 0.00 1.000 BIT_MASK 0x10 FORMAT "%5.3" ECU_ADDRESS 0x60034B68 /end MEASUREMENT
/begin MEASUREMENT DFC_b.LDF_ComInvld_26h_EVAP_SENSOR_VALUE "" UBYTE DFC_OneToOne 1 100 0.00 1.000 BIT_MASK 0x10 FORMAT "%5.3" ECU_ADDRESS 0x60034B69 /end MEASUREMENT
/begin MEASUREMENT DFC_b.LDF_ComInvld_26h_POTENTIOMETER_FAULT "" UBYTE DFC_OneToOne 1 100 0.00 1.000 BIT_MASK 0x10 FORMAT "%5.3" ECU_ADDRESS 0x60034B6A /end MEASUREMENT
/begin MEASUREMENT DFC_b.LDF_ComInvld_26h_REAR_DEFOG_REQ "" UBYTE DFC_OneToOne 1 100 0.00 1.000 BIT_MASK 0x10 FORMAT "%5.3" ECU_ADDRESS 0x60034B6B /end MEASUREMENT
/begin MEASUREMENT DFC_b.LDF_ComInvld_26h_TEMP_POSITION "" UBYTE DFC_OneToOne 1 100 0.00 1.000 BIT_MASK 0x10 FORMAT "%5.3" ECU_ADDRESS 0x60034B6C /end MEASUREMENT
/begin MEASUREMENT DFC_b.LDF_ComInvld_273h_OBC_FAULT_LEVEL "" UBYTE DFC_OneToOne 1 100 0.00 1.000 BIT_MASK 0x10 FORMAT "%5.3" ECU_ADDRESS 0x60034B6D /end MEASUREMENT
/begin MEASUREMENT DFC_b.LDF_ComInvld_273h_OBC_outputpower_capability "" UBYTE DFC_OneToOne 1 100 0.00 1.000 BIT_MASK 0x10 FORMAT "%5.3" ECU_ADDRESS 0x60034B6E /end MEASUREMENT
/begin MEASUREMENT DFC_b.LDF_ComInvld_275h_HVBAT_DISCHARGE_30S_AVAILABLE_CURRENT "" UBYTE DFC_OneToOne 1 100 0.00 1.000 BIT_MASK 0x10 FORMAT "%5.3" ECU_ADDRESS 0x60034B6F /end MEASUREMENT
/begin MEASUREMENT DFC_b.LDF_ComInvld_275h_HVBAT_DISCHARGE_30S_AVAILABLE_POWER "" UBYTE DFC_OneToOne 1 100 0.00 1.000 BIT_MASK 0x10 FORMAT "%5.3" ECU_ADDRESS 0x60034B70 /end MEASUREMENT
/begin MEASUREMENT DFC_b.LDF_ComInvld_283h_DCDC_IN_CURRENT "" UBYTE DFC_OneToOne 1 100 0.00 1.000 BIT_MASK 0x10 FORMAT "%5.3" ECU_ADDRESS 0x60034B71 /end MEASUREMENT
/begin MEASUREMENT DFC_b.LDF_ComInvld_283h_DCDC_IN_VOLTAGE "" UBYTE DFC_OneToOne 1 100 0.00 1.000 BIT_MASK 0x10 FORMAT "%5.3" ECU_ADDRESS 0x60034B72 /end MEASUREMENT
/begin MEASUREMENT DFC_b.LDF_ComInvld_283h_DCDC_OUT_CURRENT "" UBYTE DFC_OneToOne 1 100 0.00 1.000 BIT_MASK 0x10 FORMAT "%5.3" ECU_ADDRESS 0x60034B73 /end MEASUREMENT
/begin MEASUREMENT DFC_b.LDF_ComInvld_283h_DCDC_OUT_VOLTAGE "" UBYTE DFC_OneToOne 1 100 0.00 1.000 BIT_MASK 0x10 FORMAT "%5.3" ECU_ADDRESS 0x60034B74 /end MEASUREMENT
/begin MEASUREMENT DFC_b.LDF_ComInvld_285h_HVBAT_REGEN_CHG_30S_CURRENT_LIMIT "" UBYTE DFC_OneToOne 1 100 0.00 1.000 BIT_MASK 0x10 FORMAT "%5.3" ECU_ADDRESS 0x60034B75 /end MEASUREMENT
/begin MEASUREMENT DFC_b.LDF_ComInvld_285h_HVBAT_REGEN_CHRG_30S_POWER_LIMIT "" UBYTE DFC_OneToOne 1 100 0.00 1.000 BIT_MASK 0x10 FORMAT "%5.3" ECU_ADDRESS 0x60034B76 /end MEASUREMENT
/begin MEASUREMENT DFC_b.LDF_ComInvld_293h_DCDC_FAULT_LEVEL "" UBYTE DFC_OneToOne 1 100 0.00 1.000 BIT_MASK 0x10 FORMAT "%5.3" ECU_ADDRESS 0x60034B77 /end MEASUREMENT
/begin MEASUREMENT DFC_b.LDF_ComInvld_293h_DCDC_outputpower_capability "" UBYTE DFC_OneToOne 1 100 0.00 1.000 BIT_MASK 0x10 FORMAT "%5.3" ECU_ADDRESS 0x60034B78 /end MEASUREMENT
/begin MEASUREMENT DFC_b.LDF_ComInvld_325h_HVBAT_EPLUG_STATUS "" UBYTE DFC_OneToOne 1 100 0.00 1.000 BIT_MASK 0x10 FORMAT "%5.3" ECU_ADDRESS 0x60034B79 /end MEASUREMENT
/begin MEASUREMENT DFC_b.LDF_ComInvld_325h_HVBAT_HVIL_STS "" UBYTE DFC_OneToOne 1 100 0.00 1.000 BIT_MASK 0x10 FORMAT "%5.3" ECU_ADDRESS 0x60034B7A /end MEASUREMENT
/begin MEASUREMENT DFC_b.LDF_ComInvld_325h_HVBAT_INSULATION_FAULT "" UBYTE DFC_OneToOne 1 100 0.00 1.000 BIT_MASK 0x10 FORMAT "%5.3" ECU_ADDRESS 0x60034B7B /end MEASUREMENT
/begin MEASUREMENT DFC_b.LDF_ComInvld_325h_HVBAT_INSULATION_RESISTANCE "" UBYTE DFC_OneToOne 1 100 0.00 1.000 BIT_MASK 0x10 FORMAT "%5.3" ECU_ADDRESS 0x60034B7C /end MEASUREMENT
/begin MEASUREMENT DFC_b.LDF_ComInvld_325h_HVBAT_TEMPERATURE "" UBYTE DFC_OneToOne 1 100 0.00 1.000 BIT_MASK 0x10 FORMAT "%5.3" ECU_ADDRESS 0x60034B7D /end MEASUREMENT
/begin MEASUREMENT DFC_b.LDF_ComInvld_335h_HVBAT_CHRG_CONTINUOUS_CURR_MAX "" UBYTE DFC_OneToOne 1 100 0.00 1.000 BIT_MASK 0x10 FORMAT "%5.3" ECU_ADDRESS 0x60034B7E /end MEASUREMENT
/begin MEASUREMENT DFC_b.LDF_ComInvld_335h_HVBAT_CHRG_COTINUOUS_CURR_REQ "" UBYTE DFC_OneToOne 1 100 0.00 1.000 BIT_MASK 0x10 FORMAT "%5.3" ECU_ADDRESS 0x60034B7F /end MEASUREMENT
/begin MEASUREMENT DFC_b.LDF_ComInvld_335h_HVBAT_CHRG_MAX_VOLT "" UBYTE DFC_OneToOne 1 100 0.00 1.000 BIT_MASK 0x10 FORMAT "%5.3" ECU_ADDRESS 0x60034B80 /end MEASUREMENT
/begin MEASUREMENT DFC_b.LDF_ComInvld_335h_HVBAT_DC_BUS_VOLTAGE "" UBYTE DFC_OneToOne 1 100 0.00 1.000 BIT_MASK 0x10 FORMAT "%5.3" ECU_ADDRESS 0x60034B81 /end MEASUREMENT
/begin MEASUREMENT DFC_b.LDF_ComInvld_38Dh_VITESSE_VEHICULE_ROUES "" UBYTE DFC_OneToOne 1 100 0.00 1.000 BIT_MASK 0x10 FORMAT "%5.3" ECU_ADDRESS 0x60034B82 /end MEASUREMENT
/begin MEASUREMENT DFC_b.LDF_ComInvld_38Dh_VVH_INDISP "" UBYTE DFC_OneToOne 1 100 0.00 1.000 BIT_MASK 0x10 FORMAT "%5.3" ECU_ADDRESS 0x60034B83 /end MEASUREMENT
/begin MEASUREMENT DFC_b.LDF_ComInvld_427h_INV_COOLANT_TEMP "" UBYTE DFC_OneToOne 1 100 0.00 1.000 BIT_MASK 0x10 FORMAT "%5.3" ECU_ADDRESS 0x60034B84 /end MEASUREMENT
/begin MEASUREMENT DFC_b.LDF_ComInvld_427h_INV_MOTOR_TEMP "" UBYTE DFC_OneToOne 1 100 0.00 1.000 BIT_MASK 0x10 FORMAT "%5.3" ECU_ADDRESS 0x60034B85 /end MEASUREMENT
/begin MEASUREMENT DFC_b.LDF_ComInvld_427h_INV_OP_MODE "" UBYTE DFC_OneToOne 1 100 0.00 1.000 BIT_MASK 0x10 FORMAT "%5.3" ECU_ADDRESS 0x60034B86 /end MEASUREMENT
/begin MEASUREMENT DFC_b.LDF_ComInvld_427h_INV_PERMISIBLE_TORQUE "" UBYTE DFC_OneToOne 1 100 0.00 1.000 BIT_MASK 0x10 FORMAT "%5.3" ECU_ADDRESS 0x60034B87 /end MEASUREMENT
/begin MEASUREMENT DFC_b.LDF_ComInvld_427h_INV_TEMP "" UBYTE DFC_OneToOne 1 100 0.00 1.000 BIT_MASK 0x10 FORMAT "%5.3" ECU_ADDRESS 0x60034B88 /end MEASUREMENT
/begin MEASUREMENT DFC_b.LDF_ComInvld_432h_REVEIL_PRINCIPAL "" UBYTE DFC_OneToOne 1 100 0.00 1.000 BIT_MASK 0x10 FORMAT "%5.3" ECU_ADDRESS 0x60034B89 /end MEASUREMENT
/begin MEASUREMENT DFC_b.LDF_ComInvld_435h_HVBAT_MAX_CELL_VOLT "" UBYTE DFC_OneToOne 1 100 0.00 1.000 BIT_MASK 0x10 FORMAT "%5.3" ECU_ADDRESS 0x60034B8A /end MEASUREMENT
/begin MEASUREMENT DFC_b.LDF_ComInvld_435h_HVBAT_MAX_CELL_VOLT_NUM "" UBYTE DFC_OneToOne 1 100 0.00 1.000 BIT_MASK 0x10 FORMAT "%5.3" ECU_ADDRESS 0x60034B8B /end MEASUREMENT
/begin MEASUREMENT DFC_b.LDF_ComInvld_435h_HVBAT_MAX_SENSOR_TEMP "" UBYTE DFC_OneToOne 1 100 0.00 1.000 BIT_MASK 0x10 FORMAT "%5.3" ECU_ADDRESS 0x60034B8C /end MEASUREMENT
/begin MEASUREMENT DFC_b.LDF_ComInvld_435h_HVBAT_MIN_CELL_VOLT "" UBYTE DFC_OneToOne 1 100 0.00 1.000 BIT_MASK 0x10 FORMAT "%5.3" ECU_ADDRESS 0x60034B8D /end MEASUREMENT
/begin MEASUREMENT DFC_b.LDF_ComInvld_435h_HVBAT_MIN_CELL_VOLT_NUM "" UBYTE DFC_OneToOne 1 100 0.00 1.000 BIT_MASK 0x10 FORMAT "%5.3" ECU_ADDRESS 0x60034B8E /end MEASUREMENT
/begin MEASUREMENT DFC_b.LDF_ComInvld_442h_BCCM_BLOWER_RELAY_STS "" UBYTE DFC_OneToOne 1 100 0.00 1.000 BIT_MASK 0x10 FORMAT "%5.3" ECU_ADDRESS 0x60034B8F /end MEASUREMENT
/begin MEASUREMENT DFC_b.LDF_ComInvld_453h_OBC_IN_CURRENT "" UBYTE DFC_OneToOne 1 100 0.00 1.000 BIT_MASK 0x10 FORMAT "%5.3" ECU_ADDRESS 0x60034B90 /end MEASUREMENT
/begin MEASUREMENT DFC_b.LDF_ComInvld_453h_OBC_IN_VOLTAGE "" UBYTE DFC_OneToOne 1 100 0.00 1.000 BIT_MASK 0x10 FORMAT "%5.3" ECU_ADDRESS 0x60034B91 /end MEASUREMENT
/begin MEASUREMENT DFC_b.LDF_ComInvld_453h_OBC_IP_POWER "" UBYTE DFC_OneToOne 1 100 0.00 1.000 BIT_MASK 0x10 FORMAT "%5.3" ECU_ADDRESS 0x60034B92 /end MEASUREMENT
/begin MEASUREMENT DFC_b.LDF_ComInvld_455h_HVBAT_NOMINAL_VOLTAGE "" UBYTE DFC_OneToOne 1 100 0.00 1.000 BIT_MASK 0x10 FORMAT "%5.3" ECU_ADDRESS 0x60034B93 /end MEASUREMENT
/begin MEASUREMENT DFC_b.LDF_ComInvld_463h_OBC_OUT_CURRENT "" UBYTE DFC_OneToOne 1 100 0.00 1.000 BIT_MASK 0x10 FORMAT "%5.3" ECU_ADDRESS 0x60034B94 /end MEASUREMENT
/begin MEASUREMENT DFC_b.LDF_ComInvld_463h_OBC_OUT_VOLTAGE "" UBYTE DFC_OneToOne 1 100 0.00 1.000 BIT_MASK 0x10 FORMAT "%5.3" ECU_ADDRESS 0x60034B95 /end MEASUREMENT
/begin MEASUREMENT DFC_b.LDF_ComInvld_463h_OBC_TEMPERATURE "" UBYTE DFC_OneToOne 1 100 0.00 1.000 BIT_MASK 0x10 FORMAT "%5.3" ECU_ADDRESS 0x60034B96 /end MEASUREMENT
/begin MEASUREMENT DFC_b.LDF_ComInvld_473h_DCDC_Coolant_Temperature "" UBYTE DFC_OneToOne 1 100 0.00 1.000 BIT_MASK 0x10 FORMAT "%5.3" ECU_ADDRESS 0x60034B97 /end MEASUREMENT
/begin MEASUREMENT DFC_b.LDF_ComInvld_473h_DCDC_TEMPERATURE "" UBYTE DFC_OneToOne 1 100 0.00 1.000 BIT_MASK 0x10 FORMAT "%5.3" ECU_ADDRESS 0x60034B98 /end MEASUREMENT
/begin MEASUREMENT DFC_b.LDF_ComInvld_47Bh_eCOMP_BusBarCurrent "" UBYTE DFC_OneToOne 1 100 0.00 1.000 BIT_MASK 0x10 FORMAT "%5.3" ECU_ADDRESS 0x60034B99 /end MEASUREMENT
/begin MEASUREMENT DFC_b.LDF_ComInvld_47Bh_eCOMP_BusBarVoltage "" UBYTE DFC_OneToOne 1 100 0.00 1.000 BIT_MASK 0x10 FORMAT "%5.3" ECU_ADDRESS 0x60034B9A /end MEASUREMENT
/begin MEASUREMENT DFC_b.LDF_ComInvld_47Bh_eCOMP_CompressorSpeed "" UBYTE DFC_OneToOne 1 100 0.00 1.000 BIT_MASK 0x10 FORMAT "%5.3" ECU_ADDRESS 0x60034B9B /end MEASUREMENT
/begin MEASUREMENT DFC_b.LDF_ComInvld_47Bh_eCOMP_IGBT_Temp "" UBYTE DFC_OneToOne 1 100 0.00 1.000 BIT_MASK 0x10 FORMAT "%5.3" ECU_ADDRESS 0x60034B9C /end MEASUREMENT
/begin MEASUREMENT DFC_b.LDF_ComInvld_47Bh_eCOMP_PeakPhaCurrent "" UBYTE DFC_OneToOne 1 100 0.00 1.000 BIT_MASK 0x10 FORMAT "%5.3" ECU_ADDRESS 0x60034B9D /end MEASUREMENT
/begin MEASUREMENT DFC_b.LDF_ComInvld_47Bh_eCOMP_Power_consumption "" UBYTE DFC_OneToOne 1 100 0.00 1.000 BIT_MASK 0x10 FORMAT "%5.3" ECU_ADDRESS 0x60034B9E /end MEASUREMENT
/begin MEASUREMENT DFC_b.LDF_ComInvld_4F2h_STATUS_SOC "" UBYTE DFC_OneToOne 1 100 0.00 1.000 BIT_MASK 0x10 FORMAT "%5.3" ECU_ADDRESS 0x60034B9F /end MEASUREMENT
/begin MEASUREMENT DFC_b.LDF_ComInvld_4F2h_TEMP_BATT_STATUS "" UBYTE DFC_OneToOne 1 100 0.00 1.000 BIT_MASK 0x10 FORMAT "%5.3" ECU_ADDRESS 0x60034BA0 /end MEASUREMENT
/begin MEASUREMENT DFC_b.LDF_ComInvld_4F2h_VALEUR_SOC_ETENDUE "" UBYTE DFC_OneToOne 1 100 0.00 1.000 BIT_MASK 0x10 FORMAT "%5.3" ECU_ADDRESS 0x60034BA1 /end MEASUREMENT
/begin MEASUREMENT DFC_b.LDF_ComInvld_535h_HV_BATT_TEMP_AVG "" UBYTE DFC_OneToOne 1 100 0.00 1.000 BIT_MASK 0x10 FORMAT "%5.3" ECU_ADDRESS 0x60034BA2 /end MEASUREMENT
/begin MEASUREMENT DFC_b.LDF_ComInvld_543h_HVBAT_RESTBATTENERGY "" UBYTE DFC_OneToOne 1 100 0.00 1.000 BIT_MASK 0x10 FORMAT "%5.3" ECU_ADDRESS 0x60034BA3 /end MEASUREMENT
/begin MEASUREMENT DFC_b.LDF_ComInvld_543h_HVBAT_SOH "" UBYTE DFC_OneToOne 1 100 0.00 1.000 BIT_MASK 0x10 FORMAT "%5.3" ECU_ADDRESS 0x60034BA4 /end MEASUREMENT
/begin MEASUREMENT DFC_b.LDF_ComInvld_543h_HV_BATT_SOH_RES "" UBYTE DFC_OneToOne 1 100 0.00 1.000 BIT_MASK 0x10 FORMAT "%5.3" ECU_ADDRESS 0x60034BA5 /end MEASUREMENT
/begin MEASUREMENT DFC_b.LDF_ComInvld_552h_CPT_TEMPOREL "" UBYTE DFC_OneToOne 1 100 0.00 1.000 BIT_MASK 0x10 FORMAT "%5.3" ECU_ADDRESS 0x60034BA6 /end MEASUREMENT
/begin MEASUREMENT DFC_b.LDF_ComInvld_552h_KILOMETRAGE "" UBYTE DFC_OneToOne 1 100 0.00 1.000 BIT_MASK 0x10 FORMAT "%5.3" ECU_ADDRESS 0x60034BA7 /end MEASUREMENT
/begin MEASUREMENT DFC_b.LDF_ComInvld_583h_HV_BATT_DISCONT_CSE_OPEN "" UBYTE DFC_OneToOne 1 100 0.00 1.000 BIT_MASK 0x10 FORMAT "%5.3" ECU_ADDRESS 0x60034BA8 /end MEASUREMENT
/begin MEASUREMENT DFC_b.LDF_ComInvld_592h_CALIBRE_IBATT "" UBYTE DFC_OneToOne 1 100 0.00 1.000 BIT_MASK 0x10 FORMAT "%5.3" ECU_ADDRESS 0x60034BA9 /end MEASUREMENT
/begin MEASUREMENT DFC_b.LDF_ComInvld_592h_IBATT_1 "" UBYTE DFC_OneToOne 1 100 0.00 1.000 BIT_MASK 0x10 FORMAT "%5.3" ECU_ADDRESS 0x60034BAA /end MEASUREMENT
/begin MEASUREMENT DFC_b.LDF_ComInvld_592h_IBATT_2 "" UBYTE DFC_OneToOne 1 100 0.00 1.000 BIT_MASK 0x10 FORMAT "%5.3" ECU_ADDRESS 0x60034BAB /end MEASUREMENT
/begin MEASUREMENT DFC_b.LDF_ComInvld_592h_IBATT_3 "" UBYTE DFC_OneToOne 1 100 0.00 1.000 BIT_MASK 0x10 FORMAT "%5.3" ECU_ADDRESS 0x60034BAC /end MEASUREMENT
/begin MEASUREMENT DFC_b.LDF_ComInvld_592h_TEMP_BATT "" UBYTE DFC_OneToOne 1 100 0.00 1.000 BIT_MASK 0x10 FORMAT "%5.3" ECU_ADDRESS 0x60034BAD /end MEASUREMENT
/begin MEASUREMENT DFC_b.LDF_ComInvld_592h_U_BATT_BECB "" UBYTE DFC_OneToOne 1 100 0.00 1.000 BIT_MASK 0x10 FORMAT "%5.3" ECU_ADDRESS 0x60034BAE /end MEASUREMENT
/begin MEASUREMENT DFC_b.LDF_ComInvld_595h_HVBAT_TIME_TO_CHRG_80 "" UBYTE DFC_OneToOne 1 100 0.00 1.000 BIT_MASK 0x10 FORMAT "%5.3" ECU_ADDRESS 0x60034BAF /end MEASUREMENT
/begin MEASUREMENT DFC_b.LDF_ComInvld_5B2h_TEMP_AIR_EXT "" UBYTE DFC_OneToOne 1 100 0.00 1.000 BIT_MASK 0x10 FORMAT "%5.3" ECU_ADDRESS 0x60034BB0 /end MEASUREMENT
/begin MEASUREMENT DFC_b.LDF_ComInvld_5B5h_HVBAT_THERMAL_RUNAWAY "" UBYTE DFC_OneToOne 1 100 0.00 1.000 BIT_MASK 0x10 FORMAT "%5.3" ECU_ADDRESS 0x60034BB1 /end MEASUREMENT
/begin MEASUREMENT DFC_b.LDF_ComInvld_635h_HVBAT_NEG_CONT_COUNT_SEG1 "" UBYTE DFC_OneToOne 1 100 0.00 1.000 BIT_MASK 0x10 FORMAT "%5.3" ECU_ADDRESS 0x60034BB2 /end MEASUREMENT
/begin MEASUREMENT DFC_b.LDF_ComInvld_635h_HVBAT_NEG_CONT_COUNT_SEG3 "" UBYTE DFC_OneToOne 1 100 0.00 1.000 BIT_MASK 0x10 FORMAT "%5.3" ECU_ADDRESS 0x60034BB3 /end MEASUREMENT
/begin MEASUREMENT DFC_b.LDF_ComInvld_635h_HVBAT_NEG_CONT_COUNT_SEG4 "" UBYTE DFC_OneToOne 1 100 0.00 1.000 BIT_MASK 0x10 FORMAT "%5.3" ECU_ADDRESS 0x60034BB4 /end MEASUREMENT
/begin MEASUREMENT DFC_b.LDF_ComInvld_635h_HVBAT_PST_CONT_COUNT_SEG1 "" UBYTE DFC_OneToOne 1 100 0.00 1.000 BIT_MASK 0x10 FORMAT "%5.3" ECU_ADDRESS 0x60034BB5 /end MEASUREMENT
/begin MEASUREMENT DFC_b.LDF_ComInvld_635h_HVBAT_PST_CONT_COUNT_SEG3 "" UBYTE DFC_OneToOne 1 100 0.00 1.000 BIT_MASK 0x10 FORMAT "%5.3" ECU_ADDRESS 0x60034BB6 /end MEASUREMENT
/begin MEASUREMENT DFC_b.LDF_ComInvld_635h_HVBAT_PST_CONT_COUNT_SEG4 "" UBYTE DFC_OneToOne 1 100 0.00 1.000 BIT_MASK 0x10 FORMAT "%5.3" ECU_ADDRESS 0x60034BB7 /end MEASUREMENT
/begin MEASUREMENT DFC_b.LDF_ComInvld_645h_HVBAT_PRECHRGE_CONT_COUNT_SEG1 "" UBYTE DFC_OneToOne 1 100 0.00 1.000 BIT_MASK 0x10 FORMAT "%5.3" ECU_ADDRESS 0x60034BB8 /end MEASUREMENT
/begin MEASUREMENT DFC_b.LDF_ComInvld_645h_HVBAT_PRECHRGE_CONT_COUNT_SEG2 "" UBYTE DFC_OneToOne 1 100 0.00 1.000 BIT_MASK 0x10 FORMAT "%5.3" ECU_ADDRESS 0x60034BB9 /end MEASUREMENT
/begin MEASUREMENT DFC_b.LDF_ComInvld_675h_HVBAT_REMAININGBATTCAPACITY "" UBYTE DFC_OneToOne 1 100 0.00 1.000 BIT_MASK 0x10 FORMAT "%5.3" ECU_ADDRESS 0x60034BBA /end MEASUREMENT
/begin MEASUREMENT DFC_b.LDF_ACCmprFltLvl1 "" UBYTE DFC_OneToOne 1 100 0.00 1.000 BIT_MASK 0x10 FORMAT "%5.3" ECU_ADDRESS 0x60034BBB /end MEASUREMENT
/begin MEASUREMENT DFC_b.LDF_ACCmprFltLvl2 "" UBYTE DFC_OneToOne 1 100 0.00 1.000 BIT_MASK 0x10 FORMAT "%5.3" ECU_ADDRESS 0x60034BBC /end MEASUREMENT
/begin MEASUREMENT DFC_b.LDF_ACCmprFltLvl3 "" UBYTE DFC_OneToOne 1 100 0.00 1.000 BIT_MASK 0x10 FORMAT "%5.3" ECU_ADDRESS 0x60034BBD /end MEASUREMENT
/begin MEASUREMENT DFC_b.LDF_ACCmprFltLvl4 "" UBYTE DFC_OneToOne 1 100 0.00 1.000 BIT_MASK 0x10 FORMAT "%5.3" ECU_ADDRESS 0x60034BBE /end MEASUREMENT
/begin MEASUREMENT DFC_b.LDF_ACCmprHiPFlt "" UBYTE DFC_OneToOne 1 100 0.00 1.000 BIT_MASK 0x10 FORMAT "%5.3" ECU_ADDRESS 0x60034BBF /end MEASUREMENT
/begin MEASUREMENT DFC_b.LDF_ACCmprInvldCmprSt "" UBYTE DFC_OneToOne 1 100 0.00 1.000 BIT_MASK 0x10 FORMAT "%5.3" ECU_ADDRESS 0x60034BC0 /end MEASUREMENT
/begin MEASUREMENT DFC_b.LDF_ACCmprInvldElecActPwr "" UBYTE DFC_OneToOne 1 100 0.00 1.000 BIT_MASK 0x10 FORMAT "%5.3" ECU_ADDRESS 0x60034BC1 /end MEASUREMENT
/begin MEASUREMENT DFC_b.LDF_ACCmprLoPFlt "" UBYTE DFC_OneToOne 1 100 0.00 1.000 BIT_MASK 0x10 FORMAT "%5.3" ECU_ADDRESS 0x60034BC2 /end MEASUREMENT
/begin MEASUREMENT DFC_b.LDF_AcChrgrIntkTSRCMin "" UBYTE DFC_OneToOne 1 100 0.00 1.000 BIT_MASK 0x10 FORMAT "%5.3" ECU_ADDRESS 0x60034BC3 /end MEASUREMENT
/begin MEASUREMENT DFC_b.LDF_BattUBMaxBatt "" UBYTE DFC_OneToOne 1 100 0.00 1.000 BIT_MASK 0x10 FORMAT "%5.3" ECU_ADDRESS 0x60034BC4 /end MEASUREMENT
/begin MEASUREMENT DFC_b.LDF_BattUBMaxNoBatt "" UBYTE DFC_OneToOne 1 100 0.00 1.000 BIT_MASK 0x10 FORMAT "%5.3" ECU_ADDRESS 0x60034BC5 /end MEASUREMENT
/begin MEASUREMENT DFC_b.LDF_BattUBMinBatt "" UBYTE DFC_OneToOne 1 100 0.00 1.000 BIT_MASK 0x10 FORMAT "%5.3" ECU_ADDRESS 0x60034BC6 /end MEASUREMENT
/begin MEASUREMENT DFC_b.LDF_BattUBMinNoBatt "" UBYTE DFC_OneToOne 1 100 0.00 1.000 BIT_MASK 0x10 FORMAT "%5.3" ECU_ADDRESS 0x60034BC7 /end MEASUREMENT
/begin MEASUREMENT DFC_b.LDF_BattUSRCMax "" UBYTE DFC_OneToOne 1 100 0.00 1.000 BIT_MASK 0x10 FORMAT "%5.3" ECU_ADDRESS 0x60034BC8 /end MEASUREMENT
/begin MEASUREMENT DFC_b.LDF_BattUSRCMin "" UBYTE DFC_OneToOne 1 100 0.00 1.000 BIT_MASK 0x10 FORMAT "%5.3" ECU_ADDRESS 0x60034BC9 /end MEASUREMENT
/begin MEASUREMENT DFC_b.LDF_BrkBstPHiCautionDfct "" UBYTE DFC_OneToOne 1 100 0.00 1.000 BIT_MASK 0x10 FORMAT "%5.3" ECU_ADDRESS 0x60034BCA /end MEASUREMENT
/begin MEASUREMENT DFC_b.LDF_BrkBstPHiWarnDfct "" UBYTE DFC_OneToOne 1 100 0.00 1.000 BIT_MASK 0x10 FORMAT "%5.3" ECU_ADDRESS 0x60034BCB /end MEASUREMENT
/begin MEASUREMENT DFC_b.LDF_BrkBstPSnsr12PlausDfct "" UBYTE DFC_OneToOne 1 100 0.00 1.000 BIT_MASK 0x10 FORMAT "%5.3" ECU_ADDRESS 0x60034BCC /end MEASUREMENT
/begin MEASUREMENT DFC_b.LDF_BrkBstPSnsr1Scb "" UBYTE DFC_OneToOne 1 100 0.00 1.000 BIT_MASK 0x10 FORMAT "%5.3" ECU_ADDRESS 0x60034BCD /end MEASUREMENT
/begin MEASUREMENT DFC_b.LDF_BrkBstPSnsr1Scg "" UBYTE DFC_OneToOne 1 100 0.00 1.000 BIT_MASK 0x10 FORMAT "%5.3" ECU_ADDRESS 0x60034BCE /end MEASUREMENT
/begin MEASUREMENT DFC_b.LDF_BrkBstPSnsr2Scb "" UBYTE DFC_OneToOne 1 100 0.00 1.000 BIT_MASK 0x10 FORMAT "%5.3" ECU_ADDRESS 0x60034BCF /end MEASUREMENT
/begin MEASUREMENT DFC_b.LDF_BrkBstPSnsr2Scg "" UBYTE DFC_OneToOne 1 100 0.00 1.000 BIT_MASK 0x10 FORMAT "%5.3" ECU_ADDRESS 0x60034BD0 /end MEASUREMENT
/begin MEASUREMENT DFC_b.LDF_BrkBstPSnsrMax "" UBYTE DFC_OneToOne 1 100 0.00 1.000 BIT_MASK 0x10 FORMAT "%5.3" ECU_ADDRESS 0x60034BD1 /end MEASUREMENT
/begin MEASUREMENT DFC_b.LDF_BrkBstPSnsrMin "" UBYTE DFC_OneToOne 1 100 0.00 1.000 BIT_MASK 0x10 FORMAT "%5.3" ECU_ADDRESS 0x60034BD2 /end MEASUREMENT
/begin MEASUREMENT DFC_b.LDF_BrkBstPhyRngChkMax "" UBYTE DFC_OneToOne 1 100 0.00 1.000 BIT_MASK 0x10 FORMAT "%5.3" ECU_ADDRESS 0x60034BD3 /end MEASUREMENT
/begin MEASUREMENT DFC_b.LDF_BrkBstPhyRngChkMin "" UBYTE DFC_OneToOne 1 100 0.00 1.000 BIT_MASK 0x10 FORMAT "%5.3" ECU_ADDRESS 0x60034BD4 /end MEASUREMENT
/begin MEASUREMENT DFC_b.LDF_BrkBstPmpHsScb "" UBYTE DFC_OneToOne 1 100 0.00 1.000 BIT_MASK 0x10 FORMAT "%5.3" ECU_ADDRESS 0x60034BD5 /end MEASUREMENT
/begin MEASUREMENT DFC_b.LDF_BrkBstPmpHsScg "" UBYTE DFC_OneToOne 1 100 0.00 1.000 BIT_MASK 0x10 FORMAT "%5.3" ECU_ADDRESS 0x60034BD6 /end MEASUREMENT
/begin MEASUREMENT DFC_b.LDF_BrkBstPmpLsOl "" UBYTE DFC_OneToOne 1 100 0.00 1.000 BIT_MASK 0x10 FORMAT "%5.3" ECU_ADDRESS 0x60034BD7 /end MEASUREMENT
/begin MEASUREMENT DFC_b.LDF_BrkBstPmpLsScb "" UBYTE DFC_OneToOne 1 100 0.00 1.000 BIT_MASK 0x10 FORMAT "%5.3" ECU_ADDRESS 0x60034BD8 /end MEASUREMENT
/begin MEASUREMENT DFC_b.LDF_BrkBstPmpLsScg "" UBYTE DFC_OneToOne 1 100 0.00 1.000 BIT_MASK 0x10 FORMAT "%5.3" ECU_ADDRESS 0x60034BD9 /end MEASUREMENT
/begin MEASUREMENT DFC_b.LDF_CbnHeatgHeatrRlyOpend "" UBYTE DFC_OneToOne 1 100 0.00 1.000 BIT_MASK 0x10 FORMAT "%5.3" ECU_ADDRESS 0x60034BDA /end MEASUREMENT
/begin MEASUREMENT DFC_b.LDF_CbnHeatgHeatrRlyWldd "" UBYTE DFC_OneToOne 1 100 0.00 1.000 BIT_MASK 0x10 FORMAT "%5.3" ECU_ADDRESS 0x60034BDB /end MEASUREMENT
/begin MEASUREMENT DFC_b.LDF_CcsDcIBattExcdd "" UBYTE DFC_OneToOne 1 100 0.00 1.000 BIT_MASK 0x10 FORMAT "%5.3" ECU_ADDRESS 0x60034BDC /end MEASUREMENT
/begin MEASUREMENT DFC_b.LDF_CcsDcIEvseOutDe "" UBYTE DFC_OneToOne 1 100 0.00 1.000 BIT_MASK 0x10 FORMAT "%5.3" ECU_ADDRESS 0x60034BDD /end MEASUREMENT
/begin MEASUREMENT DFC_b.LDF_CcsDcIOutDe "" UBYTE DFC_OneToOne 1 100 0.00 1.000 BIT_MASK 0x10 FORMAT "%5.3" ECU_ADDRESS 0x60034BDE /end MEASUREMENT
/begin MEASUREMENT DFC_b.LDF_CcsDcIOutExcdd "" UBYTE DFC_OneToOne 1 100 0.00 1.000 BIT_MASK 0x10 FORMAT "%5.3" ECU_ADDRESS 0x60034BDF /end MEASUREMENT
/begin MEASUREMENT DFC_b.LDF_CcsDcUOutDe "" UBYTE DFC_OneToOne 1 100 0.00 1.000 BIT_MASK 0x10 FORMAT "%5.3" ECU_ADDRESS 0x60034BE0 /end MEASUREMENT
/begin MEASUREMENT DFC_b.LDF_CcsDcUOutExcdd "" UBYTE DFC_OneToOne 1 100 0.00 1.000 BIT_MASK 0x10 FORMAT "%5.3" ECU_ADDRESS 0x60034BE1 /end MEASUREMENT
/begin MEASUREMENT DFC_b.LDF_CcsPwrLineChpRstOL "" UBYTE DFC_OneToOne 1 100 0.00 1.000 BIT_MASK 0x10 FORMAT "%5.3" ECU_ADDRESS 0x60034BE2 /end MEASUREMENT
/begin MEASUREMENT DFC_b.LDF_CcsPwrLineChpRstOvrTemp "" UBYTE DFC_OneToOne 1 100 0.00 1.000 BIT_MASK 0x10 FORMAT "%5.3" ECU_ADDRESS 0x60034BE3 /end MEASUREMENT
/begin MEASUREMENT DFC_b.LDF_CcsPwrLineChpRstSCB "" UBYTE DFC_OneToOne 1 100 0.00 1.000 BIT_MASK 0x10 FORMAT "%5.3" ECU_ADDRESS 0x60034BE4 /end MEASUREMENT
/begin MEASUREMENT DFC_b.LDF_CcsPwrLineChpRstSCG "" UBYTE DFC_OneToOne 1 100 0.00 1.000 BIT_MASK 0x10 FORMAT "%5.3" ECU_ADDRESS 0x60034BE5 /end MEASUREMENT
/begin MEASUREMENT DFC_b.LDF_CcsPwrLineChpVccEnaOL "" UBYTE DFC_OneToOne 1 100 0.00 1.000 BIT_MASK 0x10 FORMAT "%5.3" ECU_ADDRESS 0x60034BE6 /end MEASUREMENT
/begin MEASUREMENT DFC_b.LDF_CcsPwrLineChpVccEnaOvrTemp "" UBYTE DFC_OneToOne 1 100 0.00 1.000 BIT_MASK 0x10 FORMAT "%5.3" ECU_ADDRESS 0x60034BE7 /end MEASUREMENT
/begin MEASUREMENT DFC_b.LDF_CcsPwrLineChpVccEnaSCB "" UBYTE DFC_OneToOne 1 100 0.00 1.000 BIT_MASK 0x10 FORMAT "%5.3" ECU_ADDRESS 0x60034BE8 /end MEASUREMENT
/begin MEASUREMENT DFC_b.LDF_CcsPwrLineChpVccEnaSCG "" UBYTE DFC_OneToOne 1 100 0.00 1.000 BIT_MASK 0x10 FORMAT "%5.3" ECU_ADDRESS 0x60034BE9 /end MEASUREMENT
/begin MEASUREMENT DFC_b.LDF_CcsPwrLineChpVccSRCMin "" UBYTE DFC_OneToOne 1 100 0.00 1.000 BIT_MASK 0x10 FORMAT "%5.3" ECU_ADDRESS 0x60034BEA /end MEASUREMENT
/begin MEASUREMENT DFC_b.LDF_CcsPwrLineComChpTSRCMin "" UBYTE DFC_OneToOne 1 100 0.00 1.000 BIT_MASK 0x10 FORMAT "%5.3" ECU_ADDRESS 0x60034BEB /end MEASUREMENT
/begin MEASUREMENT DFC_b.LDF_CtPSwtActrOL "" UBYTE DFC_OneToOne 1 100 0.00 1.000 BIT_MASK 0x10 FORMAT "%5.3" ECU_ADDRESS 0x60034BEC /end MEASUREMENT
/begin MEASUREMENT DFC_b.LDF_CtPSwtActrOvrTemp "" UBYTE DFC_OneToOne 1 100 0.00 1.000 BIT_MASK 0x10 FORMAT "%5.3" ECU_ADDRESS 0x60034BED /end MEASUREMENT
/begin MEASUREMENT DFC_b.LDF_CtPSwtActrSCB "" UBYTE DFC_OneToOne 1 100 0.00 1.000 BIT_MASK 0x10 FORMAT "%5.3" ECU_ADDRESS 0x60034BEE /end MEASUREMENT
/begin MEASUREMENT DFC_b.LDF_CtPSwtActrSCG "" UBYTE DFC_OneToOne 1 100 0.00 1.000 BIT_MASK 0x10 FORMAT "%5.3" ECU_ADDRESS 0x60034BEF /end MEASUREMENT
/begin MEASUREMENT DFC_b.LDF_CtPSwtDiagSRCMin "" UBYTE DFC_OneToOne 1 100 0.00 1.000 BIT_MASK 0x10 FORMAT "%5.3" ECU_ADDRESS 0x60034BF0 /end MEASUREMENT
/begin MEASUREMENT DFC_b.LDF_CtpCarrFrqSRCMin "" UBYTE DFC_OneToOne 1 100 0.00 1.000 BIT_MASK 0x10 FORMAT "%5.3" ECU_ADDRESS 0x60034BF1 /end MEASUREMENT
/begin MEASUREMENT DFC_b.LDF_DcChrgrIntkT2SRCMin "" UBYTE DFC_OneToOne 1 100 0.00 1.000 BIT_MASK 0x10 FORMAT "%5.3" ECU_ADDRESS 0x60034BF2 /end MEASUREMENT
/begin MEASUREMENT DFC_b.LDF_DcChrgrIntkTSRCMin "" UBYTE DFC_OneToOne 1 100 0.00 1.000 BIT_MASK 0x10 FORMAT "%5.3" ECU_ADDRESS 0x60034BF3 /end MEASUREMENT
/begin MEASUREMENT DFC_b.LDF_DevLibBattUHi "" UBYTE DFC_OneToOne 1 100 0.00 1.000 BIT_MASK 0x10 FORMAT "%5.3" ECU_ADDRESS 0x60034BF4 /end MEASUREMENT
/begin MEASUREMENT DFC_b.LDF_DevLibBattULo "" UBYTE DFC_OneToOne 1 100 0.00 1.000 BIT_MASK 0x10 FORMAT "%5.3" ECU_ADDRESS 0x60034BF5 /end MEASUREMENT
/begin MEASUREMENT DFC_b.LDF_EmWakeupSigOL "" UBYTE DFC_OneToOne 1 100 0.00 1.000 BIT_MASK 0x10 FORMAT "%5.3" ECU_ADDRESS 0x60034BF6 /end MEASUREMENT
/begin MEASUREMENT DFC_b.LDF_EmWakeupSigOvrTemp "" UBYTE DFC_OneToOne 1 100 0.00 1.000 BIT_MASK 0x10 FORMAT "%5.3" ECU_ADDRESS 0x60034BF7 /end MEASUREMENT
/begin MEASUREMENT DFC_b.LDF_EmWakeupSigSCB "" UBYTE DFC_OneToOne 1 100 0.00 1.000 BIT_MASK 0x10 FORMAT "%5.3" ECU_ADDRESS 0x60034BF8 /end MEASUREMENT
/begin FUNCTION DFC "30000.32.0Diagnostic Fault Check"
 /begin OUT_MEASUREMENT DFC_b.TST_ComInvld_473h_DCDC_Coolant_Temperature DFC_b.TST_ComInvld_473h_DCDC_TEMPERATURE DFC_b.TST_ComInvld_47Bh_eCOMP_BusBarCurrent DFC_b.TST_ComInvld_47Bh_eCOMP_BusBarVoltage DFC_b.TST_ComInvld_47Bh_eCOMP_CompressorSpeed DFC_b.TST_ComInvld_47Bh_eCOMP_IGBT_Temp DFC_b.TST_ComInvld_47Bh_eCOMP_PeakPhaCurrent DFC_b.TST_ComInvld_47Bh_eCOMP_Power_consumption DFC_b.TST_ComInvld_4F2h_STATUS_SOC DFC_b.TST_ComInvld_4F2h_TEMP_BATT_STATUS DFC_b.TST_ComInvld_4F2h_VALEUR_SOC_ETENDUE DFC_b.TST_ComInvld_535h_HV_BATT_TEMP_AVG DFC_b.TST_ComInvld_543h_HVBAT_RESTBATTENERGY DFC_b.TST_ComInvld_543h_HVBAT_SOH DFC_b.TST_ComInvld_543h_HV_BATT_SOH_RES DFC_b.TST_ComInvld_552h_CPT_TEMPOREL DFC_b.TST_ComInvld_552h_KILOMETRAGE DFC_b.TST_ComInvld_583h_HV_BATT_DISCONT_CSE_OPEN DFC_b.TST_ComInvld_592h_CALIBRE_IBATT DFC_b.TST_ComInvld_592h_IBATT_1 DFC_b.TST_ComInvld_592h_IBATT_2 DFC_b.TST_ComInvld_592h_IBATT_3 DFC_b.TST_ComInvld_592h_TEMP_BATT DFC_b.TST_ComInvld_592h_U_BATT_BECB DFC_b.TST_ComInvld_595h_HVBAT_TIME_TO_CHRG_80 DFC_b.TST_ComInvld_5B2h_TEMP_AIR_EXT DFC_b.TST_ComInvld_5B5h_HVBAT_THERMAL_RUNAWAY DFC_b.TST_ComInvld_635h_HVBAT_NEG_CONT_COUNT_SEG1 DFC_b.TST_ComInvld_635h_HVBAT_NEG_CONT_COUNT_SEG3 DFC_b.TST_ComInvld_635h_HVBAT_NEG_CONT_COUNT_SEG4 DFC_b.TST_ComInvld_635h_HVBAT_PST_CONT_COUNT_SEG1 DFC_b.TST_ComInvld_635h_HVBAT_PST_CONT_COUNT_SEG3 DFC_b.TST_ComInvld_635h_HVBAT_PST_CONT_COUNT_SEG4 DFC_b.TST_ComInvld_645h_HVBAT_PRECHRGE_CONT_COUNT_SEG1 DFC_b.TST_ComInvld_645h_HVBAT_PRECHRGE_CONT_COUNT_SEG2 DFC_b.TST_ComInvld_675h_HVBAT_REMAININGBATTCAPACITY DFC_b.TST_ACCmprFltLvl1 DFC_b.TST_ACCmprFltLvl2 DFC_b.TST_ACCmprFltLvl3 DFC_b.TST_ACCmprFltLvl4 DFC_b.TST_ACCmprHiPFlt DFC_b.TST_ACCmprInvldCmprSt DFC_b.TST_ACCmprInvldElecActPwr DFC_b.TST_ACCmprLoPFlt DFC_b.TST_AcChrgrIntkTSRCMin DFC_b.TST_BattUBMaxBatt DFC_b.TST_BattUBMaxNoBatt DFC_b.TST_BattUBMinBatt DFC_b.TST_BattUBMinNoBatt DFC_b.TST_BattUSRCMax DFC_b.TST_BattUSRCMin DFC_b.TST_BrkBstPHiCautionDfct DFC_b.TST_BrkBstPHiWarnDfct DFC_b.TST_BrkBstPSnsr12PlausDfct DFC_b.TST_BrkBstPSnsr1Scb DFC_b.TST_BrkBstPSnsr1Scg DFC_b.TST_BrkBstPSnsr2Scb DFC_b.TST_BrkBstPSnsr2Scg DFC_b.TST_BrkBstPSnsrMax DFC_b.TST_BrkBstPSnsrMin DFC_b.TST_BrkBstPhyRngChkMax DFC_b.TST_BrkBstPhyRngChkMin DFC_b.TST_BrkBstPmpHsScb DFC_b.TST_BrkBstPmpHsScg DFC_b.TST_BrkBstPmpLsOl DFC_b.TST_BrkBstPmpLsScb DFC_b.TST_BrkBstPmpLsScg DFC_b.TST_CbnHeatgHeatrRlyOpend DFC_b.TST_CbnHeatgHeatrRlyWldd DFC_b.TST_CcsDcIBattExcdd DFC_b.TST_CcsDcIEvseOutDe DFC_b.TST_CcsDcIOutDe DFC_b.TST_CcsDcIOutExcdd DFC_b.TST_CcsDcUOutDe DFC_b.TST_CcsDcUOutExcdd DFC_b.TST_CcsPwrLineChpRstOL DFC_b.TST_CcsPwrLineChpRstOvrTemp DFC_b.TST_CcsPwrLineChpRstSCB DFC_b.TST_CcsPwrLineChpRstSCG DFC_b.TST_CcsPwrLineChpVccEnaOL DFC_b.TST_CcsPwrLineChpVccEnaOvrTemp DFC_b.TST_CcsPwrLineChpVccEnaSCB DFC_b.TST_CcsPwrLineChpVccEnaSCG DFC_b.TST_CcsPwrLineChpVccSRCMin DFC_b.TST_CcsPwrLineComChpTSRCMin DFC_b.TST_CtPSwtActrOL DFC_b.TST_CtPSwtActrOvrTemp DFC_b.TST_CtPSwtActrSCB DFC_b.TST_CtPSwtActrSCG DFC_b.TST_CtPSwtDiagSRCMin DFC_b.TST_CtpCarrFrqSRCMin DFC_b.TST_DcChrgrIntkT2SRCMin DFC_b.TST_DcChrgrIntkTSRCMin DFC_b.TST_DevLibBattUHi DFC_b.TST_DevLibBattULo DFC_b.TST_EmWakeupSigOL DFC_b.TST_EmWakeupSigOvrTemp DFC_b.TST_EmWakeupSigSCB DFC_b.TST_EmWakeupSigSCG DFC_b.TST_Fan1OL DFC_b.TST_Fan1OvrTemp DFC_b.TST_Fan1SCB DFC_b.TST_FanRlySCB DFC_b.TST_FanRlySCG DFC_b.TST_FanSpdSRCMin DFC_b.TST_FreonPSRCMin DFC_b.TST_HLCCcsPLnCChipTHi DFC_b.TST_HeatrCoreTSRCMin DFC_b.TST_PwmCtPSRCMin DFC_b.TST_PwrDistbnUnitTSRCMin DFC_b.TST_SCtPmp1OL DFC_b.TST_SCtPmp1OvrTemp DFC_b.TST_SCtPmp1SCB DFC_b.TST_SCtPmpRlyOL DFC_b.TST_SCtPmpRlyOvrTemp DFC_b.TST_SCtPmpRlySCB DFC_b.TST_SpplCooltPmpRlyOL DFC_b.TST_SpplCooltPmpRlyOvrTemp DFC_b.TST_SpplCooltPmpRlySCB DFC_b.TST_UCtPSRCMin DFC_b.TST_UPxP1SRCMin DFC_b.TST_ComHSN1CANMute DFC_b.TST_ComHSN3CANMute DFC_b.TST_AcChrgrIntkTPhysRngHi DFC_b.TST_AcChrgrIntkTPhysRngLo DFC_b.TST_AcChrgrIntkTSRCOpn DFC_b.TST_CcsPwrLineChpVccPhysRngHi DFC_b.TST_CcsPwrLineChpVccPhysRngLo DFC_b.TST_CcsPwrLineChpVccSRCOpn DFC_b.TST_CcsPwrLineComChpTPhysRngHi DFC_b.TST_CcsPwrLineComChpTPhysRngLo DFC_b.TST_CcsPwrLineComChpTSRCOpn DFC_b.TST_CtPSwtDiagPhysRngHi DFC_b.TST_CtPSwtDiagPhysRngLo DFC_b.TST_CtPSwtDiagSRCOpn DFC_b.TST_CtpCarrFrqPhysRngHi DFC_b.TST_CtpCarrFrqPhysRngLo DFC_b.TST_CtpCarrFrqSRCMax DFC_b.TST_DcChrgrIntkT2PhysRngHi DFC_b.TST_DcChrgrIntkT2PhysRngLo DFC_b.TST_DcChrgrIntkT2SRCOpn DFC_b.TST_DcChrgrIntkTPhysRngHi DFC_b.TST_DcChrgrIntkTPhysRngLo DFC_b.TST_DcChrgrIntkTSRCOpn DFC_b.TST_Fan1SCG DFC_b.TST_FanSpdPhysRngHi DFC_b.TST_FanSpdPhysRngLo DFC_b.TST_FanSpdSRCOpn DFC_b.TST_FreonPPhysRngHi DFC_b.TST_FreonPPhysRngLo DFC_b.TST_FreonPSRCOpn DFC_b.TST_HeatrCoreTPhysRngHi DFC_b.TST_HeatrCoreTPhysRngLo DFC_b.TST_HeatrCoreTSRCOpn DFC_b.TST_HvGridUMaxSftyLim DFC_b.TST_HvGridUMinSftyLim DFC_b.TST_HvGridUPlausy DFC_b.TST_IntlckChrgPlgHBrgOpnLd DFC_b.TST_IntlckChrgPlgHBrgOvrCurr DFC_b.TST_IntlckChrgPlgHBrgOvrTemp DFC_b.TST_IntlckChrgPlgHBrgShCirBatt1 DFC_b.TST_IntlckChrgPlgHBrgShCirBatt2 DFC_b.TST_IntlckChrgPlgHBrgShCirGnd1 DFC_b.TST_IntlckChrgPlgHBrgShCirGnd2 DFC_b.TST_IntlckChrgPlgHBrgShCirOvrLd DFC_b.TST_IntlckChrgPlgHBrgTempOvrCurr DFC_b.TST_IntlckChrgPlgHBrgUndrVltg DFC_b.TST_IntlckChrgPlgPosnRngFlt DFC_b.TST_IntlckChrgPlgPosnSrcMax DFC_b.TST_IntlckChrgPlgPosnSrcMin DFC_b.TST_PwmCtPPhysRngHi DFC_b.TST_PwmCtPPhysRngLo DFC_b.TST_PwmCtPSRCMax DFC_b.TST_PwrDistbnUnitTPhysRngHi DFC_b.TST_PwrDistbnUnitTPhysRngLo DFC_b.TST_PwrDistbnUnitTSRCOpn DFC_b.TST_SCtPmpRlySCG DFC_b.TST_SpplCooltPmpRlySCG DFC_b.TST_UCtPPhysRngHi DFC_b.TST_UCtPPhysRngLo DFC_b.TST_UCtPSRCOpn DFC_b.TST_UPxP1PhysRngHi DFC_b.TST_UPxP1PhysRngLo DFC_b.TST_UPxP1SRCOpn DFC_b.TST_VehVPhysRngHi DFC_b.TST_VehVPhysRngLo DFC_b.TST_VehVSigCan DFC_b.TST_VehVSigCanSafe DFC_b.TST_SCtPmp1DiagGrdKey1 DFC_b.TST_SCtPmp1DiagGrdKey2 DFC_b.TST_SCtPmp1DiagGrdKey3 DFC_b.TST_SCtPmp1DiagGrdKey4 DFC_b.TST_SCtPmp1DiagGrdKey5 DFC_b.TST_ChrgPlgLiveCntctHzrdCcs DFC_b.TST_ChrgPlgProxPltImps DFC_b.TST_ChrgPlgTHiCcsDc DFC_b.TST_ElMActvDchaFailr DFC_b.TST_ElMActvDchaFlt DFC_b.TST_ElMFbdnIvtrModDrv01 DFC_b.TST_ElMImobAuthent DFC_b.TST_ElMIsoMonFlt DFC_b.TST_ElMIsoMonPlausyFlt DFC_b.TST_ElMIvtrCooltT01 DFC_b.TST_ElMIvtrEmgyShtDwn01 DFC_b.TST_ElMIvtrFailr01 DFC_b.TST_ElMIvtrIntlck01 DFC_b.TST_ElMIvtrTErr01 DFC_b.TST_ElMOverSpdNeg01 DFC_b.TST_ElMOverSpdPos01 DFC_b.TST_ElMOverTqNeg01 DFC_b.TST_ElMOverTqPos01 DFC_b.TST_ElMPwrAuthn DFC_b.TST_ElMSpdErr01 DFC_b.TST_ElMSvs01 DFC_b.TST_PEnvCcMax DFC_b.TST_PEnvCcMin DFC_b.TST_PEnvRngChkMax DFC_b.TST_PEnvRngChkMin DFC_b.TST_PEnvSnsrPlaus DFC_b.TST_BrkBstPmpPlausGenn DFC_b.TST_CbnHeatrRlyLfLoWarn DFC_b.TST_ChgrPlugLockPinByndClsd DFC_b.TST_ChgrPlugLockPinMoveWoCmd DFC_b.TST_ChgrPlugLockPinStuckInClsd DFC_b.TST_ChgrPlugLockPinStuckInOpen DFC_b.TST_ChrgrStErr DFC_b.TST_ComHSN1BusOff DFC_b.TST_ComHSN3BusOff DFC_b.TST_ComVCInval DFC_b.TST_EemDcdcPrecSpdInhb DFC_b.TST_ExpPwrLatch DFC_b.TST_FanMaxOvrd DFC_b.TST_HLCCcsGnrlComErr DFC_b.TST_InmLINNodeHVACPanelAbsnt DFC_b.TST_ResetRcvNotAllwd DFC_b.TST_TelltlCooltPlaus DFC_b.TST_MRlyOL DFC_b.TST_MRlySCB DFC_b.TST_MRlySCG DFC_b.TST_SSpMon1 DFC_b.TST_SSpMon1OV DFC_b.TST_SSpMon1SCG DFC_b.TST_SSpMon1UV DFC_b.TST_SSpMon2 DFC_b.TST_SSpMon2OV DFC_b.TST_SSpMon2SCG DFC_b.TST_SSpMon2UV DFC_b.TST_SSpMon3 DFC_b.TST_SSpMon3OV DFC_b.TST_SSpMon3SCG DFC_b.TST_SSpMon3UV DFC_b.TST_CANSM_E_BUS_OFF_NETWORK_HSN1_CAN DFC_b.TST_CANSM_E_BUS_OFF_NETWORK_HSN3_CAN DFC_b.TST_CANSM_E_BUS_OFF_NETWORK_HSN4_CAN DFC_b.TST_CANSM_E_BUS_OFF_NETWORK_XCP_CAN DFC_b.TST_CANTRCV_E_NO_TRCV_CONTROL_0 DFC_b.TST_CAN_E_TIMEOUT DFC_b.TST_COMM_E_NET_START_IND_CHANNEL_0 DFC_b.TST_COMM_E_NET_START_IND_CHANNEL_1 DFC_b.TST_COMM_E_NET_START_IND_CHANNEL_2 DFC_b.TST_COMM_E_NET_START_IND_CHANNEL_3 DFC_b.TST_COMM_E_NET_START_IND_CHANNEL_4 DFC_b.TST_COMM_E_NET_START_IND_CHANNEL_5 DFC_b.TST_LIN_E_TIMEOUT DFC_b.TST_rba_EcuCtrl_TOMaxProlg DFC_b.TST_rba_EcuCtrl_TOMaxShutDwn DFC_b.TST_rba_MultiStackTrace_Threshold DFC_b.TST_rba_SyC_CustStates_Degraded_disord_Event DFC_b.TST_rba_SyC_CustStates_Degraded_incst_Event DFC_b.TST_rba_SyC_CustStates_TransNoWakReq_Event DFC_b.TST_RBA_IOEXTLIB_KEEPALIVE_DRV DFC_b.TST_RBA_IOEXTLIB_KEEPALIVE_INI DFC_b.TST_rba_IoSigRtc_StopCounter DFC_b.TST_rba_MRly_Diag_Stk_Event DFC_b.TST_rba_MemDiag_MemReadErr DFC_b.TST_rba_MemDiag_MemWrErr DFC_b.TST_rba_SyC_IrrSwOffTrigEngRun_Event DFC_b.TST_AcChrgrIntkTSRCMax DFC_b.TST_AcChrgrIntkTTmpErr DFC_b.TST_AcFlt DFC_b.TST_AppAllSnsrDfct DFC_b.TST_BattUPwrFail DFC_b.TST_BrkBstBkupOvrn DFC_b.TST_BrkBstPmpOvld DFC_b.TST_BrkPlausChk DFC_b.TST_CbnHeatgSwtTmpErr DFC_b.TST_CcsPwrLineChpVccSRCMax DFC_b.TST_CcsPwrLineChpVccTmpErr DFC_b.TST_CcsPwrLineComChpTSRCMax DFC_b.TST_CcsPwrLineComChpTTmpErr DFC_b.TST_ChgrPlugCtpCarrFrqErr DFC_b.TST_ChgrPlugCtpSwtStuckClsd DFC_b.TST_ChgrPlugCtpSwtStuckOpen DFC_b.TST_ChgrPlugCtpUErrHi DFC_b.TST_ChgrPlugPxp1SrcErr DFC_b.TST_ChrgCntctAllWldd DFC_b.TST_ChrgCntctNegOperErr DFC_b.TST_ChrgCntctNegOperWarn DFC_b.TST_ChrgCntctNegWldd DFC_b.TST_ChrgCntctPosOperErr DFC_b.TST_ChrgCntctPosOperWarn DFC_b.TST_ChrgCntctPosWldd DFC_b.TST_ChrgCntctStuckOpen DFC_b.TST_ChrgPlgIntlckFaild DFC_b.TST_ChrgnUnplRqrd DFC_b.TST_CoElMOffsCalibActv01 DFC_b.TST_CtPSwtDiagSRCMax DFC_b.TST_CtPSwtDiagTmpErr DFC_b.TST_CtpCarrFrqTmpErr DFC_b.TST_DcChrgrIntkT2SRCMax DFC_b.TST_DcChrgrIntkT2TmpErr DFC_b.TST_DcChrgrIntkTSRCMax DFC_b.TST_DcChrgrIntkTTmpErr DFC_b.TST_EChrDvPlinCntrThdExcdd DFC_b.TST_EemDiagCtctrClsTout DFC_b.TST_EemDiagDcdcOffTOut DFC_b.TST_EemDiagHvCnsrOffTOut DFC_b.TST_EemDiagHvbOffTOut DFC_b.TST_FanSpdSRCMax DFC_b.TST_FanSpdTmpErr DFC_b.TST_FreonPSRCMax DFC_b.TST_FreonPTmpErr DFC_b.TST_HeatrCoreTSRCMax DFC_b.TST_HeatrCoreTTmpErr DFC_b.TST_HvGridSocMinLim DFC_b.TST_HvacBlwrFrntFlt DFC_b.TST_HvacEvapElecFlt DFC_b.TST_HvacEvapElecFltGnd DFC_b.TST_HvacKnobPosnFlt DFC_b.TST_InvBinID DFC_b.TST_InvCalID DFC_b.TST_InvErotan DFC_b.TST_InvVinID DFC_b.TST_MOXEMM_SMU_ALM0_0 DFC_b.TST_MOXEMM_SMU_ALM0_1 DFC_b.TST_MOXEMM_SMU_ALM0_10 DFC_b.TST_MOXEMM_SMU_ALM0_11 DFC_b.TST_MOXEMM_SMU_ALM0_13 DFC_b.TST_MOXEMM_SMU_ALM0_14 DFC_b.TST_MOXEMM_SMU_ALM0_2 DFC_b.TST_MOXEMM_SMU_ALM0_22 DFC_b.TST_MOXEMM_SMU_ALM0_23 DFC_b.TST_MOXEMM_SMU_ALM0_4 DFC_b.TST_MOXEMM_SMU_ALM0_5 DFC_b.TST_MOXEMM_SMU_ALM0_7 DFC_b.TST_MOXEMM_SMU_ALM0_8 DFC_b.TST_MOXEMM_SMU_ALM10_16 DFC_b.TST_MOXEMM_SMU_ALM10_17 DFC_b.TST_MOXEMM_SMU_ALM10_21 DFC_b.TST_MOXEMM_SMU_ALM11_0 DFC_b.TST_MOXEMM_SMU_ALM11_1 DFC_b.TST_MOXEMM_SMU_ALM11_2 DFC_b.TST_MOXEMM_SMU_ALM11_3 DFC_b.TST_MOXEMM_SMU_ALM11_4 DFC_b.TST_MOXEMM_SMU_ALM11_5 DFC_b.TST_MOXEMM_SMU_ALM11_8 DFC_b.TST_MOXEMM_SMU_ALM11_9 DFC_b.TST_MOXEMM_SMU_ALM1_0 DFC_b.TST_MOXEMM_SMU_ALM1_1 DFC_b.TST_MOXEMM_SMU_ALM1_10 DFC_b.TST_MOXEMM_SMU_ALM1_11 DFC_b.TST_MOXEMM_SMU_ALM1_13 DFC_b.TST_MOXEMM_SMU_ALM1_14 DFC_b.TST_MOXEMM_SMU_ALM1_2 DFC_b.TST_MOXEMM_SMU_ALM1_22 DFC_b.TST_MOXEMM_SMU_ALM1_23 DFC_b.TST_MOXEMM_SMU_ALM1_4 DFC_b.TST_MOXEMM_SMU_ALM1_5 DFC_b.TST_MOXEMM_SMU_ALM1_7 DFC_b.TST_MOXEMM_SMU_ALM1_8 DFC_b.TST_MOXEMM_SMU_ALM21_0 DFC_b.TST_MOXEMM_SMU_ALM21_16 DFC_b.TST_MOXEMM_SMU_ALM21_3 DFC_b.TST_MOXEMM_SMU_ALM2_1 DFC_b.TST_MOXEMM_SMU_ALM2_10 DFC_b.TST_MOXEMM_SMU_ALM2_11 DFC_b.TST_MOXEMM_SMU_ALM2_13 DFC_b.TST_MOXEMM_SMU_ALM2_14 DFC_b.TST_MOXEMM_SMU_ALM2_22 DFC_b.TST_MOXEMM_SMU_ALM2_23 DFC_b.TST_MOXEMM_SMU_ALM2_4 DFC_b.TST_MOXEMM_SMU_ALM2_5 DFC_b.TST_MOXEMM_SMU_ALM2_7 DFC_b.TST_MOXEMM_SMU_ALM2_8 DFC_b.TST_MOXEMM_SMU_ALM6_0 DFC_b.TST_MOXEMM_SMU_ALM6_11 DFC_b.TST_MOXEMM_SMU_ALM6_12 DFC_b.TST_MOXEMM_SMU_ALM6_14 DFC_b.TST_MOXEMM_SMU_ALM6_15 DFC_b.TST_MOXEMM_SMU_ALM6_17 DFC_b.TST_MOXEMM_SMU_ALM6_18 DFC_b.TST_MOXEMM_SMU_ALM6_20 DFC_b.TST_MOXEMM_SMU_ALM6_21 DFC_b.TST_MOXEMM_SMU_ALM6_25 DFC_b.TST_MOXEMM_SMU_ALM6_4 DFC_b.TST_MOXEMM_SMU_ALM6_5 DFC_b.TST_MOXEMM_SMU_ALM6_7 DFC_b.TST_MOXEMM_SMU_ALM6_8 DFC_b.TST_MOXEMM_SMU_ALM7_1 DFC_b.TST_MOXEMM_SMU_ALM7_12 DFC_b.TST_MOXEMM_SMU_ALM7_13 DFC_b.TST_MOXEMM_SMU_ALM7_14 DFC_b.TST_MOXEMM_SMU_ALM7_15 DFC_b.TST_MOXEMM_SMU_ALM7_16 DFC_b.TST_MOXEMM_SMU_ALM7_17 DFC_b.TST_MOXEMM_SMU_ALM7_2 DFC_b.TST_MOXEMM_SMU_ALM7_20 DFC_b.TST_MOXEMM_SMU_ALM7_25 DFC_b.TST_MOXEMM_SMU_ALM7_26 DFC_b.TST_MOXEMM_SMU_ALM7_28 DFC_b.TST_MOXEMM_SMU_ALM7_29 DFC_b.TST_MOXEMM_SMU_ALM7_30 DFC_b.TST_MOXEMM_SMU_ALM7_31 DFC_b.TST_MOXEMM_SMU_ALM8_0 DFC_b.TST_MOXEMM_SMU_ALM8_1 DFC_b.TST_MOXEMM_SMU_ALM8_10 DFC_b.TST_MOXEMM_SMU_ALM8_11 DFC_b.TST_MOXEMM_SMU_ALM8_12 DFC_b.TST_MOXEMM_SMU_ALM8_16 DFC_b.TST_MOXEMM_SMU_ALM8_18 DFC_b.TST_MOXEMM_SMU_ALM8_2 DFC_b.TST_MOXEMM_SMU_ALM8_3 DFC_b.TST_MOXEMM_SMU_ALM8_31 DFC_b.TST_MOXEMM_SMU_ALM8_4 DFC_b.TST_MOXEMM_SMU_ALM9_0 DFC_b.TST_MOXEMM_SMU_ALM9_15 DFC_b.TST_MOXEMM_SMU_ALM9_3 DFC_b.TST_MoCADCNTPBnk1 DFC_b.TST_MoCADCTestVoltBnk1 DFC_b.TST_MoCSOPICO DFC_b.TST_MoFAccr DFC_b.TST_MoFCbnPreCdngOvrheat DFC_b.TST_MoFCbnPreCdngTmrExpi DFC_b.TST_MoFEvMngtBms DFC_b.TST_MoFEvMngtDcdc DFC_b.TST_MoFEvMngtEm01 DFC_b.TST_MoFEvMngtEm01BrkgToZr DFC_b.TST_MoFEvMngtEm01EngSpd DFC_b.TST_MoFEvMngtEm02EngSpd DFC_b.TST_MoFEvMngtEm02Lvl1 DFC_b.TST_MoFEvMngtEm02Lvl2 DFC_b.TST_MoFExtCptAuxCpt DFC_b.TST_MoFExtCptVacPmpErr DFC_b.TST_MoFTqPtdAxle DFC_b.TST_MoFTqPtdAxleSec DFC_b.TST_MoFTqPtdEmPtRels DFC_b.TST_MoFTqPtdEmPtRelsSec DFC_b.TST_MoFTqPtdEmSign DFC_b.TST_MoFTqPtdEmSignSec DFC_b.TST_MoFTqPtdEmTq DFC_b.TST_MoFTqPtdEmTqSec DFC_b.TST_MoFTqPtdVeh DFC_b.TST_MoFVarPostBldSel DFC_b.TST_MoSysCtrlReIni DFC_b.TST_MoXEMMHwLTMCUFW DFC_b.TST_MoXEMMHwLTMonBIST DFC_b.TST_MoXEMMHwLTRegMonTest DFC_b.TST_MoXEMMHwLTStbySMUAlvTest DFC_b.TST_MoXEMMHwLTTempSens DFC_b.TST_MoXEMMHwLTUCBCfg DFC_b.TST_MonEgyChrgnCoorr_AcChrgnWoMofRels DFC_b.TST_MonEgyChrgnCoorr_ChrgnAbortIgr DFC_b.TST_MonEgyChrgnCoorr_DcCntctFailr DFC_b.TST_MonEgyChrgnCoorr_ExtChrgnShtOffReq DFC_b.TST_MonEgyChrgnCoorr_ImpsChrgnMod DFC_b.TST_MonEgyChrgnCoorr_ImpsChrgnPrms DFC_b.TST_MonEgyChrgnCoorr_ImpsUDcIntk DFC_b.TST_MonEgyChrgnCoorr_PlgLockMovmt DFC_b.TST_MonEgyChrgnCoorr_VehCrashDetn DFC_b.TST_MonEgyChrgnErrReactn_SftySwt DFC_b.TST_MonEgyChrgnInlet_CcsPlgCtp DFC_b.TST_MonEgyChrgnInlet_CcsPlgCtpPwm DFC_b.TST_MonEgyChrgnInlet_CcsPlgLockCtrlImpsAtmpt DFC_b.TST_MonEgyChrgnInlet_CcsPlgLockSnsrSigRngChk DFC_b.TST_MonEgyChrgnInlet_CcsPlgLockStImps DFC_b.TST_MonEgyChrgnInlet_CcsPlgPxp DFC_b.TST_MonEgyChrgnT_Snsr1GrdtChk DFC_b.TST_MonEgyChrgnT_Snsr1SigRngChk DFC_b.TST_MonEgyChrgnT_Snsr2GrdtChk DFC_b.TST_MonEgyChrgnT_Snsr2SigRngChk DFC_b.TST_MonEgyChrgnT_SnsrDif DFC_b.TST_OCWDAABEActv DFC_b.TST_OCWDACom DFC_b.TST_OCWDAErrPin DFC_b.TST_OCWDAOvrVltg DFC_b.TST_PUmax DFC_b.TST_PwmCtPTmpErr DFC_b.TST_PwrDistbnUnitTSRCMax DFC_b.TST_PwrDistbnUnitTTmpErr DFC_b.TST_SCtPmp1DiagGrdKeyErr DFC_b.TST_SRCHighAPP1 DFC_b.TST_SRCHighAPP2 DFC_b.TST_SRCLowAPP1 DFC_b.TST_SRCLowAPP2 DFC_b.TST_SWReset_0 DFC_b.TST_SWReset_1 DFC_b.TST_SWReset_2 DFC_b.TST_Sia_InvldCode DFC_b.TST_Sia_InvldKey DFC_b.TST_Sia_NoRespUCx DFC_b.TST_Sia_TprotRttp DFC_b.TST_StrtUpEvStandStillDeactvn DFC_b.TST_SyncAPP DFC_b.TST_UCtPSRCMax DFC_b.TST_UCtPTmpErr DFC_b.TST_UPxP1SRCMax DFC_b.TST_UPxP1TmpErr DFC_b.TST_VehVObd DFC_b.LDF_ACCmprFltLvlRes DFC_b.LDF_AbgHiSigFlt DFC_b.LDF_AbgIntPatFlt DFC_b.LDF_AbgLoSigFlt DFC_b.LDF_AbgUnkwnErrSigFlt DFC_b.LDF_AcExtChrgrIBattExcdd DFC_b.LDF_AcExtChrgrIInExcdd DFC_b.LDF_AcExtChrgrIOutDe DFC_b.LDF_AcExtChrgrIOutExcdd DFC_b.LDF_AcExtChrgrUOutDe DFC_b.LDF_AdpActvDChaFailr DFC_b.LDF_AirbcuFlt DFC_b.LDF_Airbg DFC_b.LDF_AirbgCan DFC_b.LDF_AirbgCanHWPlaus DFC_b.LDF_AirbgHWCanPlaus DFC_b.LDF_AirbgMnr DFC_b.LDF_AirbgPerHi DFC_b.LDF_AirbgPerdRngFlt DFC_b.LDF_BlowrRlyErr DFC_b.LDF_BrkBstPmpActtnDfct DFC_b.LDF_BrkBstPmpDeactvnDfct DFC_b.LDF_BrkSwtFlt DFC_b.LDF_CbnHeatgHeatrHsScb DFC_b.LDF_CbnHeatgHeatrHsScg DFC_b.LDF_CbnHeatgHeatrLsOl DFC_b.LDF_CbnHeatgHeatrLsScb DFC_b.LDF_CbnHeatgHeatrLsScg DFC_b.LDF_CbnHeatgHeatrUnUsed DFC_b.LDF_ChrgnCntctHsOt DFC_b.LDF_ChrgnCntctHsScb DFC_b.LDF_ChrgnCntctHsScg DFC_b.LDF_ChrgnCntctLsNegOl DFC_b.LDF_ChrgnCntctLsNegOt DFC_b.LDF_ChrgnCntctLsNegScb DFC_b.LDF_ChrgnCntctLsNegScg DFC_b.LDF_ChrgnCntctLsPosOl DFC_b.LDF_ChrgnCntctLsPosOt DFC_b.LDF_ChrgnCntctLsPosScb DFC_b.LDF_ChrgnCntctLsPosScg DFC_b.LDF_ChrgnCntctUnUsed DFC_b.LDF_ComBrkMai DFC_b.LDF_ComChrgrEVCont DFC_b.LDF_ComChrgrEVtBlink DFC_b.LDF_ComChrgrMstBlink DFC_b.LDF_ComChrgrMstCont DFC_b.LDF_ComChrgrSVSBlink DFC_b.LDF_ComChrgrSVSCont DFC_b.LDF_ComDcdcEVBlink DFC_b.LDF_ComDcdcEVCont DFC_b.LDF_ComDcdcFltLvl2 DFC_b.LDF_ComDcdcFltLvl3 DFC_b.LDF_ComDcdcFltLvl4 DFC_b.LDF_ComDcdcFltLvl5 DFC_b.LDF_ComDcdcFltLvlRes DFC_b.LDF_ComDcdcMstBlink DFC_b.LDF_ComDcdcMstCont DFC_b.LDF_ComDcdcSVSBlink DFC_b.LDF_ComDcdcSVSCont DFC_b.LDF_ComElMIIvtrFltLvl2 DFC_b.LDF_ComElMIIvtrFltLvl3 DFC_b.LDF_ComElMIIvtrFltLvl4 DFC_b.LDF_ComElMIIvtrFltLvl5 DFC_b.LDF_ComElMIIvtrFltLvlRes DFC_b.LDF_ComEmacEVBlink DFC_b.LDF_ComEmacEVCont DFC_b.LDF_ComEmacMstCont DFC_b.LDF_ComEmacMsttBlink DFC_b.LDF_ComEmacSVSBlink DFC_b.LDF_ComEmacSVSCont DFC_b.LDF_ComGunCntInfoWkuReq DFC_b.LDF_ComHillHldFlt DFC_b.LDF_ComHvBattRchrgWkuReq DFC_b.LDF_ComHvbFltLvl2 DFC_b.LDF_ComHvbFltLvl3 DFC_b.LDF_ComHvbFltLvl4 DFC_b.LDF_ComHvbFltLvl5 DFC_b.LDF_ComHvbFltLvlRes DFC_b.LDF_ComHvbMstBlink DFC_b.LDF_ComHvbMstCont DFC_b.LDF_ComImmoUnlockWkuReq DFC_b.LDF_ComInfoReqPtlWkuReq DFC_b.LDF_ComOBCFltLvl2 DFC_b.LDF_ComOBCFltLvl3 DFC_b.LDF_ComOBCFltLvl4 DFC_b.LDF_ComOBCFltLvl5 DFC_b.LDF_ComOBCFltLvlRes DFC_b.LDF_ComPostOperationWkuReq DFC_b.LDF_ComPreCondElecWkuReq DFC_b.LDF_ComRemUnlckWkuReq DFC_b.LDF_ComStpDlyHMIWkuReq DFC_b.LDF_ComflgCurMeasmtErr DFC_b.LDF_ComflgCurMeasmtSysErr DFC_b.LDF_ComflgCurMeasmtVld DFC_b.LDF_ComflgCurRngErr DFC_b.LDF_ComflgTPcbMeasmtErr DFC_b.LDF_ComflgTPcbMeasmtVld DFC_b.LDF_ComflgTPcbRngErr DFC_b.LDF_ComflgTPcbSysErr DFC_b.LDF_ComflgTShntMeasmtErr DFC_b.LDF_ComflgTShntMeasmtVld DFC_b.LDF_ComflgTShntRngErr DFC_b.LDF_ComflgTShntSysErr DFC_b.LDF_ComflgVoltMeasmtErr DFC_b.LDF_ComflgVoltMeasmtSysErr DFC_b.LDF_ComflgVoltMeasmtVld DFC_b.LDF_ComflgVoltRngErr DFC_b.LDF_CrashEveOcc DFC_b.LDF_DcdcFwdModStuck DFC_b.LDF_DcdcLvUDifMaxFlt DFC_b.LDF_DcdcOffModStuck DFC_b.LDF_DcdcOperModFailr DFC_b.LDF_DcdcPrecModStuck DFC_b.LDF_DrvDoorOpn DFC_b.LDF_DrvModPosnDfct DFC_b.LDF_DrvStbltOpn DFC_b.LDF_ETogFailrLvl3 DFC_b.LDF_ETogFailrLvl4 DFC_b.LDF_EbsLvBattSocDiagLo DFC_b.LDF_EbsLvBattUDiagDiOper DFC_b.LDF_EbsLvBattUDiagFltLvl1 DFC_b.LDF_EbsLvBattUDiagFltLvl2 DFC_b.LDF_EbsLvBattUDiagLo DFC_b.LDF_EbsSnsrSt DFC_b.LDF_EbsSofASILErr DFC_b.LDF_ElTSPtSysLimDrvErr DFC_b.LDF_ElTSPtSysLimRgnErr DFC_b.LDF_HLCCcsFwDwnl DFC_b.LDF_HvBattChrgPwrMax DFC_b.LDF_HvBattCrashDetd DFC_b.LDF_HvBattDchaPwrMax DFC_b.LDF_HvBattEmgyOff DFC_b.LDF_HvBattEmgyOffIntlck DFC_b.LDF_HvBattEmgyOffReq DFC_b.LDF_HvBattFltMod DFC_b.LDF_HvBattIReqToChrgrErr DFC_b.LDF_HvBattIReqToChrgrIni DFC_b.LDF_HvBattIninTout DFC_b.LDF_HvBattIntlckSt DFC_b.LDF_HvBattIsoFlt DFC_b.LDF_HvBattLimdPwr DFC_b.LDF_HvBattMaiSwtClsngFlt DFC_b.LDF_HvBattMaiSwtFlt DFC_b.LDF_HvBattMaiSwtOpen DFC_b.LDF_HvBattMaiSwtOpngFlt DFC_b.LDF_HvBattMaiSwtWldd DFC_b.LDF_HvBattNegCntctrCntErr DFC_b.LDF_HvBattOperModChrgPlausy DFC_b.LDF_HvBattOverTDern DFC_b.LDF_HvBattPosCntctrCntErr DFC_b.LDF_HvBattPrecCntctrCntErr DFC_b.LDF_HvBattPwrDistbnTDern DFC_b.LDF_HvBattPwrDistbnTInhbn DFC_b.LDF_HvBattRatRSohErr DFC_b.LDF_HvBattRatSohErr DFC_b.LDF_HvBattSngIsoWarn DFC_b.LDF_HvBattSrvPlgDiscnct DFC_b.LDF_HvBattUNomChrgnErr DFC_b.LDF_HvBattUNomChrgnIni DFC_b.LDF_HvBattUnderTDern DFC_b.LDF_HvbEVLmpBlink DFC_b.LDF_HvbEVLmpCont DFC_b.LDF_HvbSVSBlink DFC_b.LDF_HvbSVSCont DFC_b.LDF_InmLINBusBlk DFC_b.LDF_PDUProgmFailr DFC_b.LDF_PEnvSigRngMax DFC_b.LDF_PEnvSigRngMin DFC_b.LDF_PLnCChpDeactvnFaild DFC_b.LDF_PrkgBrkFailr DFC_b.LDF_PtSysLimErr DFC_b.LDF_PwrMaxDchaShoLo DFC_b.LDF_SCtPmp1FailSafeNotSuc DFC_b.LDF_SCtPmp1SCG DFC_b.LDF_VehCoornDrvrNotPrsnt DFC_b.LDF_VehVCanAvl DFC_b.LDF_VehVCanErr DFC_b.LDF_eTogFailrLvlRes DFC_b.LDF_flgBrkMaiDiag DFC_b.LDF_stHvbIsoMeasmtRes DFC_b.LDF_BrkBstPmpPLeakDfct DFC_b.LDF_Com082hTooShort DFC_b.LDF_Com092hTooShort DFC_b.LDF_Com205hAbsent DFC_b.LDF_Com205hChecksum DFC_b.LDF_Com205hCounter DFC_b.LDF_Com205hTooShort DFC_b.LDF_Com217hAbsent DFC_b.LDF_Com217hChecksum DFC_b.LDF_Com217hCounter DFC_b.LDF_Com217hTooShort DFC_b.LDF_Com227hAbsent DFC_b.LDF_Com227hTooShort DFC_b.LDF_Com237hAbsent DFC_b.LDF_Com237hChecksum DFC_b.LDF_Com237hCounter DFC_b.LDF_Com237hTooShort DFC_b.LDF_Com259hAbsent DFC_b.LDF_Com259hChecksum DFC_b.LDF_Com259hCounter DFC_b.LDF_Com259hTooShort DFC_b.LDF_Com26hAbsent DFC_b.LDF_Com26hTooShort DFC_b.LDF_Com273hAbsent DFC_b.LDF_Com273hChecksum DFC_b.LDF_Com273hCounter DFC_b.LDF_Com273hTooShort DFC_b.LDF_Com275hAbsent DFC_b.LDF_Com275hChecksum DFC_b.LDF_Com275hCounter DFC_b.LDF_Com275hTooShort DFC_b.LDF_Com283hAbsent DFC_b.LDF_Com283hTooShort DFC_b.LDF_Com285hAbsent DFC_b.LDF_Com285hChecksum DFC_b.LDF_Com285hCounter DFC_b.LDF_Com285hTooShort DFC_b.LDF_Com293hAbsent DFC_b.LDF_Com293hChecksum DFC_b.LDF_Com293hCounter DFC_b.LDF_Com293hTooShort DFC_b.LDF_Com308hAbsent DFC_b.LDF_Com308hChecksum DFC_b.LDF_Com308hCounter DFC_b.LDF_Com308hTooShort DFC_b.LDF_Com318hAbsent DFC_b.LDF_Com318hChecksum DFC_b.LDF_Com318hCounter DFC_b.LDF_Com318hTooShort DFC_b.LDF_Com325hAbsent DFC_b.LDF_Com325hChecksum DFC_b.LDF_Com325hCounter DFC_b.LDF_Com325hTooShort DFC_b.LDF_Com335hAbsent DFC_b.LDF_Com335hChecksum DFC_b.LDF_Com335hCounter DFC_b.LDF_Com335hTooShort DFC_b.LDF_Com351hAbsent DFC_b.LDF_Com351hTooShort DFC_b.LDF_Com38DhAbsent DFC_b.LDF_Com38DhChecksum DFC_b.LDF_Com38DhCounter DFC_b.LDF_Com38DhTooShort DFC_b.LDF_Com412hAbsent DFC_b.LDF_Com412hChecksum DFC_b.LDF_Com412hCounter DFC_b.LDF_Com412hTooShort DFC_b.LDF_Com427hAbsent DFC_b.LDF_Com427hTooShort DFC_b.LDF_Com432hAbsent DFC_b.LDF_Com432hChecksum DFC_b.LDF_Com432hCounter DFC_b.LDF_Com432hTooShort DFC_b.LDF_Com435hAbsent DFC_b.LDF_Com435hTooShort DFC_b.LDF_Com442hAbsent DFC_b.LDF_Com442hTooShort DFC_b.LDF_Com453hAbsent DFC_b.LDF_Com453hTooShort DFC_b.LDF_Com455hAbsent DFC_b.LDF_Com455hTooShort DFC_b.LDF_Com463hAbsent DFC_b.LDF_Com463hTooShort DFC_b.LDF_Com473hAbsent DFC_b.LDF_Com473hTooShort DFC_b.LDF_Com47BhAbsent DFC_b.LDF_Com47BhTooShort DFC_b.LDF_Com48BhAbsent DFC_b.LDF_Com48BhTooShort DFC_b.LDF_Com497hTooShort DFC_b.LDF_Com4F2hAbsent DFC_b.LDF_Com4F2hChecksum DFC_b.LDF_Com4F2hCounter DFC_b.LDF_Com4F2hTooShort DFC_b.LDF_Com50DhAbsent DFC_b.LDF_Com50DhTooShort DFC_b.LDF_Com535hAbsent DFC_b.LDF_Com535hTooShort DFC_b.LDF_Com543hAbsent DFC_b.LDF_Com543hTooShort DFC_b.LDF_Com552hAbsent DFC_b.LDF_Com552hTooShort DFC_b.LDF_Com583hAbsent DFC_b.LDF_Com583hTooShort DFC_b.LDF_Com592hAbsent DFC_b.LDF_Com592hChecksum DFC_b.LDF_Com592hCounter DFC_b.LDF_Com592hTooShort DFC_b.LDF_Com595hAbsent DFC_b.LDF_Com595hChecksum DFC_b.LDF_Com595hCounter DFC_b.LDF_Com595hTooShort DFC_b.LDF_Com5B2hAbsent DFC_b.LDF_Com5B2hTooShort DFC_b.LDF_Com5B5hAbsent DFC_b.LDF_Com5B5hChecksum DFC_b.LDF_Com5B5hCounter DFC_b.LDF_Com5B5hTooShort DFC_b.LDF_Com5C7hTooShort DFC_b.LDF_Com5E7hAbsent DFC_b.LDF_Com5E7hTooShort DFC_b.LDF_Com635hTooShort DFC_b.LDF_Com645hTooShort DFC_b.LDF_Com663hAbsent DFC_b.LDF_Com663hTooShort DFC_b.LDF_Com665hAbsent DFC_b.LDF_Com665hTooShort DFC_b.LDF_Com675hAbsent DFC_b.LDF_Com675hTooShort DFC_b.LDF_ComFrbd_205h_HVBAT_PACK_CURRENT DFC_b.LDF_ComFrbd_205h_HVBAT_SOC_DISPLAY DFC_b.LDF_ComFrbd_205h_HVBAT_VOLTAGE DFC_b.LDF_ComFrbd_217h_INV_DC_BUS_VOLTAGE DFC_b.LDF_ComFrbd_217h_INV_MTR_ACTUAL_TRQ DFC_b.LDF_ComFrbd_217h_INV_MTR_SPEED DFC_b.LDF_ComFrbd_217h_INV_MTR_TRQ DFC_b.LDF_ComFrbd_227h_INV_DC_CURRENT DFC_b.LDF_ComFrbd_227h_INV_MOTORING_PEAK_TRQ DFC_b.LDF_ComFrbd_227h_INV_MTR_INST_INPUT_POWER DFC_b.LDF_ComFrbd_227h_INV_REGEN_PEAK_TRQ DFC_b.LDF_ComFrbd_237h_INV_ACTIVE_DISCHARGE_STATUS DFC_b.LDF_ComFrbd_237h_INV_CTRL_MODE_ACK DFC_b.LDF_ComFrbd_237h_INV_EV_WARNING DFC_b.LDF_ComFrbd_237h_INV_FAULT_LEVEL DFC_b.LDF_ComFrbd_237h_INV_MASTER_STOP DFC_b.LDF_ComFrbd_237h_INV_SERVICE_DUE DFC_b.LDF_ComFrbd_237h_INV_STAB_MIN_TRQ DFC_b.LDF_ComFrbd_259h_TGLM_FAILURE_STATE DFC_b.LDF_ComFrbd_259h_TGLM_MODE_PUSH DFC_b.LDF_ComFrbd_259h_TOGGLE_MONOSTABLE_POS DFC_b.LDF_ComFrbd_273h_OBC_outputpower_capability DFC_b.LDF_ComFrbd_275h_HVBAT_DISCHARGE_30S_AVAILABLE_CURRENT DFC_b.LDF_ComFrbd_275h_HVBAT_DISCHARGE_30S_AVAILABLE_POWER DFC_b.LDF_ComFrbd_283h_DCDC_IN_CURRENT DFC_b.LDF_ComFrbd_283h_DCDC_IN_VOLTAGE DFC_b.LDF_ComFrbd_283h_DCDC_OUT_CURRENT DFC_b.LDF_ComFrbd_283h_DCDC_OUT_VOLTAGE DFC_b.LDF_ComFrbd_285h_HVBAT_REGEN_CHG_30S_CURRENT_LIMIT DFC_b.LDF_ComFrbd_285h_HVBAT_REGEN_CHRG_30S_POWER_LIMIT DFC_b.LDF_ComFrbd_293h_DCDC_outputpower_capability DFC_b.LDF_ComFrbd_325h_HVBAT_INSULATION_RESISTANCE DFC_b.LDF_ComFrbd_325h_HVBAT_TEMPERATURE DFC_b.LDF_ComFrbd_335h_HVBAT_CHRG_CONTINUOUS_CURR_MAX DFC_b.LDF_ComFrbd_335h_HVBAT_CHRG_COTINUOUS_CURR_REQ DFC_b.LDF_ComFrbd_335h_HVBAT_CHRG_MAX_VOLT DFC_b.LDF_ComFrbd_335h_HVBAT_DC_BUS_VOLTAGE DFC_b.LDF_ComFrbd_427h_INV_OP_MODE DFC_b.LDF_ComFrbd_427h_INV_PERMISIBLE_TORQUE DFC_b.LDF_ComFrbd_435h_HVBAT_MAX_CELL_VOLT DFC_b.LDF_ComFrbd_435h_HVBAT_MAX_CELL_VOLT_NUM DFC_b.LDF_ComFrbd_435h_HVBAT_MAX_SENSOR_TEMP DFC_b.LDF_ComFrbd_435h_HVBAT_MIN_CELL_VOLT DFC_b.LDF_ComFrbd_435h_HVBAT_MIN_CELL_VOLT_NUM DFC_b.LDF_ComFrbd_453h_OBC_IN_CURRENT DFC_b.LDF_ComFrbd_453h_OBC_IN_VOLTAGE DFC_b.LDF_ComFrbd_453h_OBC_IP_POWER DFC_b.LDF_ComFrbd_455h_HVBAT_NOMINAL_VOLTAGE DFC_b.LDF_ComFrbd_463h_OBC_OUT_CURRENT DFC_b.LDF_ComFrbd_463h_OBC_OUT_VOLTAGE DFC_b.LDF_ComFrbd_463h_OBC_TEMPERATURE DFC_b.LDF_ComFrbd_473h_DCDC_Coolant_Temperature DFC_b.LDF_ComFrbd_473h_DCDC_TEMPERATURE DFC_b.LDF_ComFrbd_47Bh_eCOMP_BusBarCurrent DFC_b.LDF_ComFrbd_47Bh_eCOMP_BusBarVoltage DFC_b.LDF_ComFrbd_47Bh_eCOMP_CompressorSpeed DFC_b.LDF_ComFrbd_47Bh_eCOMP_IGBT_Temp DFC_b.LDF_ComFrbd_47Bh_eCOMP_PeakPhaCurrent DFC_b.LDF_ComFrbd_47Bh_eCOMP_Power_consumption DFC_b.LDF_ComFrbd_48Bh_eCOMP_Fault_Level DFC_b.LDF_ComFrbd_4F2h_VALEUR_SOC_ETENDUE DFC_b.LDF_ComFrbd_535h_HV_BATT_TEMP_AVG DFC_b.LDF_ComFrbd_543h_HVBAT_RESTBATTENERGY DFC_b.LDF_ComFrbd_543h_HVBAT_SOH DFC_b.LDF_ComFrbd_543h_HV_BATT_SOH_RES DFC_b.LDF_ComFrbd_592h_IBATT_1 DFC_b.LDF_ComFrbd_592h_IBATT_2 DFC_b.LDF_ComFrbd_592h_IBATT_3 DFC_b.LDF_ComFrbd_592h_TEMP_BATT DFC_b.LDF_ComFrbd_592h_U_BATT_BECB DFC_b.LDF_ComFrbd_595h_HVBAT_TIME_TO_CHRG_80 DFC_b.LDF_ComFrbd_5B2h_TEMP_AIR_EXT DFC_b.LDF_ComFrbd_635h_HVBAT_NEG_CONT_COUNT_SEG1 DFC_b.LDF_ComFrbd_635h_HVBAT_NEG_CONT_COUNT_SEG3 DFC_b.LDF_ComFrbd_635h_HVBAT_NEG_CONT_COUNT_SEG4 DFC_b.LDF_ComFrbd_635h_HVBAT_PST_CONT_COUNT_SEG1 DFC_b.LDF_ComFrbd_635h_HVBAT_PST_CONT_COUNT_SEG3 DFC_b.LDF_ComFrbd_635h_HVBAT_PST_CONT_COUNT_SEG4 DFC_b.LDF_ComFrbd_645h_HVBAT_PRECHRGE_CONT_COUNT_SEG1 DFC_b.LDF_ComFrbd_645h_HVBAT_PRECHRGE_CONT_COUNT_SEG2 DFC_b.LDF_ComFrbd_675h_HVBAT_REMAININGBATTCAPACITY DFC_b.LDF_ComInvld_205h_HVBAT_CHARGING_STATUS DFC_b.LDF_ComInvld_205h_HVBAT_PACK_CURRENT DFC_b.LDF_ComInvld_205h_HVBAT_SOC_DISPLAY DFC_b.LDF_ComInvld_205h_HVBAT_VOLTAGE DFC_b.LDF_ComInvld_217h_INV_DC_BUS_VOLTAGE DFC_b.LDF_ComInvld_217h_INV_MTR_ACTUAL_TRQ DFC_b.LDF_ComInvld_217h_INV_MTR_SPEED DFC_b.LDF_ComInvld_217h_INV_MTR_TRQ DFC_b.LDF_ComInvld_227h_INV_DC_CURRENT DFC_b.LDF_ComInvld_227h_INV_MOTORING_PEAK_TRQ DFC_b.LDF_ComInvld_227h_INV_MTR_INST_INPUT_POWER DFC_b.LDF_ComInvld_227h_INV_REGEN_PEAK_TRQ DFC_b.LDF_ComInvld_237h_INV_ACTIVE_DISCHARGE_STATUS DFC_b.LDF_ComInvld_237h_INV_FAULT_LEVEL DFC_b.LDF_ComInvld_237h_INV_STAB_MIN_TRQ DFC_b.LDF_ComInvld_259h_TGLM_MODE_PUSH DFC_b.LDF_ComInvld_259h_TOGGLE_MONOSTABLE_POS DFC_b.LDF_ComInvld_26h_AC_SWITCH_REQ DFC_b.LDF_ComInvld_26h_BLOWER_POSITION DFC_b.LDF_ComInvld_26h_EVAP_SENSOR_FAULT DFC_b.LDF_ComInvld_26h_EVAP_SENSOR_VALUE DFC_b.LDF_ComInvld_26h_POTENTIOMETER_FAULT DFC_b.LDF_ComInvld_26h_REAR_DEFOG_REQ DFC_b.LDF_ComInvld_26h_TEMP_POSITION DFC_b.LDF_ComInvld_273h_OBC_FAULT_LEVEL DFC_b.LDF_ComInvld_273h_OBC_outputpower_capability DFC_b.LDF_ComInvld_275h_HVBAT_DISCHARGE_30S_AVAILABLE_CURRENT DFC_b.LDF_ComInvld_275h_HVBAT_DISCHARGE_30S_AVAILABLE_POWER DFC_b.LDF_ComInvld_283h_DCDC_IN_CURRENT DFC_b.LDF_ComInvld_283h_DCDC_IN_VOLTAGE DFC_b.LDF_ComInvld_283h_DCDC_OUT_CURRENT DFC_b.LDF_ComInvld_283h_DCDC_OUT_VOLTAGE DFC_b.LDF_ComInvld_285h_HVBAT_REGEN_CHG_30S_CURRENT_LIMIT DFC_b.LDF_ComInvld_285h_HVBAT_REGEN_CHRG_30S_POWER_LIMIT DFC_b.LDF_ComInvld_293h_DCDC_FAULT_LEVEL DFC_b.LDF_ComInvld_293h_DCDC_outputpower_capability DFC_b.LDF_ComInvld_325h_HVBAT_EPLUG_STATUS DFC_b.LDF_ComInvld_325h_HVBAT_HVIL_STS DFC_b.LDF_ComInvld_325h_HVBAT_INSULATION_FAULT DFC_b.LDF_ComInvld_325h_HVBAT_INSULATION_RESISTANCE DFC_b.LDF_ComInvld_325h_HVBAT_TEMPERATURE DFC_b.LDF_ComInvld_335h_HVBAT_CHRG_CONTINUOUS_CURR_MAX DFC_b.LDF_ComInvld_335h_HVBAT_CHRG_COTINUOUS_CURR_REQ DFC_b.LDF_ComInvld_335h_HVBAT_CHRG_MAX_VOLT DFC_b.LDF_ComInvld_335h_HVBAT_DC_BUS_VOLTAGE DFC_b.LDF_ComInvld_38Dh_VITESSE_VEHICULE_ROUES DFC_b.LDF_ComInvld_38Dh_VVH_INDISP DFC_b.LDF_ComInvld_427h_INV_COOLANT_TEMP DFC_b.LDF_ComInvld_427h_INV_MOTOR_TEMP DFC_b.LDF_ComInvld_427h_INV_OP_MODE DFC_b.LDF_ComInvld_427h_INV_PERMISIBLE_TORQUE DFC_b.LDF_ComInvld_427h_INV_TEMP DFC_b.LDF_ComInvld_432h_REVEIL_PRINCIPAL DFC_b.LDF_ComInvld_435h_HVBAT_MAX_CELL_VOLT DFC_b.LDF_ComInvld_435h_HVBAT_MAX_CELL_VOLT_NUM DFC_b.LDF_ComInvld_435h_HVBAT_MAX_SENSOR_TEMP DFC_b.LDF_ComInvld_435h_HVBAT_MIN_CELL_VOLT DFC_b.LDF_ComInvld_435h_HVBAT_MIN_CELL_VOLT_NUM DFC_b.LDF_ComInvld_442h_BCCM_BLOWER_RELAY_STS DFC_b.LDF_ComInvld_453h_OBC_IN_CURRENT DFC_b.LDF_ComInvld_453h_OBC_IN_VOLTAGE DFC_b.LDF_ComInvld_453h_OBC_IP_POWER DFC_b.LDF_ComInvld_455h_HVBAT_NOMINAL_VOLTAGE DFC_b.LDF_ComInvld_463h_OBC_OUT_CURRENT DFC_b.LDF_ComInvld_463h_OBC_OUT_VOLTAGE DFC_b.LDF_ComInvld_463h_OBC_TEMPERATURE DFC_b.LDF_ComInvld_473h_DCDC_Coolant_Temperature DFC_b.LDF_ComInvld_473h_DCDC_TEMPERATURE DFC_b.LDF_ComInvld_47Bh_eCOMP_BusBarCurrent DFC_b.LDF_ComInvld_47Bh_eCOMP_BusBarVoltage DFC_b.LDF_ComInvld_47Bh_eCOMP_CompressorSpeed DFC_b.LDF_ComInvld_47Bh_eCOMP_IGBT_Temp DFC_b.LDF_ComInvld_47Bh_eCOMP_PeakPhaCurrent DFC_b.LDF_ComInvld_47Bh_eCOMP_Power_consumption DFC_b.LDF_ComInvld_4F2h_STATUS_SOC DFC_b.LDF_ComInvld_4F2h_TEMP_BATT_STATUS DFC_b.LDF_ComInvld_4F2h_VALEUR_SOC_ETENDUE DFC_b.LDF_ComInvld_535h_HV_BATT_TEMP_AVG DFC_b.LDF_ComInvld_543h_HVBAT_RESTBATTENERGY DFC_b.LDF_ComInvld_543h_HVBAT_SOH DFC_b.LDF_ComInvld_543h_HV_BATT_SOH_RES DFC_b.LDF_ComInvld_552h_CPT_TEMPOREL DFC_b.LDF_ComInvld_552h_KILOMETRAGE DFC_b.LDF_ComInvld_583h_HV_BATT_DISCONT_CSE_OPEN DFC_b.LDF_ComInvld_592h_CALIBRE_IBATT DFC_b.LDF_ComInvld_592h_IBATT_1 DFC_b.LDF_ComInvld_592h_IBATT_2 DFC_b.LDF_ComInvld_592h_IBATT_3 DFC_b.LDF_ComInvld_592h_TEMP_BATT DFC_b.LDF_ComInvld_592h_U_BATT_BECB DFC_b.LDF_ComInvld_595h_HVBAT_TIME_TO_CHRG_80 DFC_b.LDF_ComInvld_5B2h_TEMP_AIR_EXT DFC_b.LDF_ComInvld_5B5h_HVBAT_THERMAL_RUNAWAY DFC_b.LDF_ComInvld_635h_HVBAT_NEG_CONT_COUNT_SEG1 DFC_b.LDF_ComInvld_635h_HVBAT_NEG_CONT_COUNT_SEG3 DFC_b.LDF_ComInvld_635h_HVBAT_NEG_CONT_COUNT_SEG4 DFC_b.LDF_ComInvld_635h_HVBAT_PST_CONT_COUNT_SEG1 DFC_b.LDF_ComInvld_635h_HVBAT_PST_CONT_COUNT_SEG3 DFC_b.LDF_ComInvld_635h_HVBAT_PST_CONT_COUNT_SEG4 DFC_b.LDF_ComInvld_645h_HVBAT_PRECHRGE_CONT_COUNT_SEG1 DFC_b.LDF_ComInvld_645h_HVBAT_PRECHRGE_CONT_COUNT_SEG2 DFC_b.LDF_ComInvld_675h_HVBAT_REMAININGBATTCAPACITY DFC_b.LDF_ACCmprFltLvl1 DFC_b.LDF_ACCmprFltLvl2 DFC_b.LDF_ACCmprFltLvl3 DFC_b.LDF_ACCmprFltLvl4 DFC_b.LDF_ACCmprHiPFlt DFC_b.LDF_ACCmprInvldCmprSt DFC_b.LDF_ACCmprInvldElecActPwr DFC_b.LDF_ACCmprLoPFlt DFC_b.LDF_AcChrgrIntkTSRCMin DFC_b.LDF_BattUBMaxBatt DFC_b.LDF_BattUBMaxNoBatt DFC_b.LDF_BattUBMinBatt DFC_b.LDF_BattUBMinNoBatt DFC_b.LDF_BattUSRCMax DFC_b.LDF_BattUSRCMin DFC_b.LDF_BrkBstPHiCautionDfct DFC_b.LDF_BrkBstPHiWarnDfct DFC_b.LDF_BrkBstPSnsr12PlausDfct DFC_b.LDF_BrkBstPSnsr1Scb DFC_b.LDF_BrkBstPSnsr1Scg DFC_b.LDF_BrkBstPSnsr2Scb DFC_b.LDF_BrkBstPSnsr2Scg DFC_b.LDF_BrkBstPSnsrMax DFC_b.LDF_BrkBstPSnsrMin DFC_b.LDF_BrkBstPhyRngChkMax DFC_b.LDF_BrkBstPhyRngChkMin DFC_b.LDF_BrkBstPmpHsScb DFC_b.LDF_BrkBstPmpHsScg DFC_b.LDF_BrkBstPmpLsOl DFC_b.LDF_BrkBstPmpLsScb DFC_b.LDF_BrkBstPmpLsScg DFC_b.LDF_CbnHeatgHeatrRlyOpend DFC_b.LDF_CbnHeatgHeatrRlyWldd DFC_b.LDF_CcsDcIBattExcdd DFC_b.LDF_CcsDcIEvseOutDe DFC_b.LDF_CcsDcIOutDe DFC_b.LDF_CcsDcIOutExcdd DFC_b.LDF_CcsDcUOutDe DFC_b.LDF_CcsDcUOutExcdd DFC_b.LDF_CcsPwrLineChpRstOL DFC_b.LDF_CcsPwrLineChpRstOvrTemp DFC_b.LDF_CcsPwrLineChpRstSCB DFC_b.LDF_CcsPwrLineChpRstSCG DFC_b.LDF_CcsPwrLineChpVccEnaOL DFC_b.LDF_CcsPwrLineChpVccEnaOvrTemp DFC_b.LDF_CcsPwrLineChpVccEnaSCB DFC_b.LDF_CcsPwrLineChpVccEnaSCG DFC_b.LDF_CcsPwrLineChpVccSRCMin DFC_b.LDF_CcsPwrLineComChpTSRCMin DFC_b.LDF_CtPSwtActrOL DFC_b.LDF_CtPSwtActrOvrTemp DFC_b.LDF_CtPSwtActrSCB DFC_b.LDF_CtPSwtActrSCG DFC_b.LDF_CtPSwtDiagSRCMin DFC_b.LDF_CtpCarrFrqSRCMin DFC_b.LDF_DcChrgrIntkT2SRCMin DFC_b.LDF_DcChrgrIntkTSRCMin DFC_b.LDF_DevLibBattUHi DFC_b.LDF_DevLibBattULo DFC_b.LDF_EmWakeupSigOL DFC_b.LDF_EmWakeupSigOvrTemp DFC_b.LDF_EmWakeupSigSCB /end OUT_MEASUREMENT
 FUNCTION_VERSION "30000.32.0" /end FUNCTION
/begin COMPU_METHOD DFC_OneToOne "" RAT_FUNC "%6.2" "-" COEFFS 0 1 0 0 0 1 /end COMPU_METHOD
/end MODULE
/end PROJECT

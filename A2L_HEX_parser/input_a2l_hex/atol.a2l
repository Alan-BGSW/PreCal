ASAP2_VERSION 1 70
/begin PROJECT MDG1C "VC1CP091_STLA_N_D061I3"
/begin HEADER "" VERSION "VC1CP091_STLA_N_D061I3" PROJECT_NO MDG1C /end HEADER
/begin MODULE DIM ""
/begin MOD_COMMON "" BYTE_ORDER MSB_LAST ALIGNMENT_BYTE 1 ALIGNMENT_WORD 2 ALIGNMENT_LONG 4 ALIGNMENT_INT64 4 ALIGNMENT_FLOAT32_IEEE 4 ALIGNMENT_FLOAT64_IEEE 4 DATA_SIZE 32 /end MOD_COMMON
/begin CHARACTERISTIC DDRC_DebArTime.DFC_MRlyOL.tiLimFaild_C "" VALUE 0x80250198 RB_Val_Ws16 327660.0 DDRCTime_ms 10.0 327670.0 FORMAT "%8.1" EXTENDED_LIMITS -327680.0 327670.0 /end CHARACTERISTIC
/begin CHARACTERISTIC DDRC_DebArTime.DFC_MRlyOL.tiLimPassd_C "" VALUE 0x8025019A RB_Val_Ws16 327670.0 DDRCTime_ms -327680.0 -10.0 FORMAT "%8.1" EXTENDED_LIMITS -327680.0 327670.0 /end CHARACTERISTIC
/begin CHARACTERISTIC DDRC_DebArTime.DFC_MRlySCB.tiLimFaild_C "" VALUE 0x8025019E RB_Val_Ws16 327660.0 DDRCTime_ms 10.0 327670.0 FORMAT "%8.1" EXTENDED_LIMITS -327680.0 327670.0 /end CHARACTERISTIC
/begin CHARACTERISTIC DDRC_DebArTime.DFC_MRlySCB.tiLimPassd_C "" VALUE 0x802501A0 RB_Val_Ws16 327670.0 DDRCTime_ms -327680.0 -10.0 FORMAT "%8.1" EXTENDED_LIMITS -327680.0 327670.0 /end CHARACTERISTIC
/begin CHARACTERISTIC DDRC_DebArTime.DFC_MRlySCG.tiLimFaild_C "" VALUE 0x802501A4 RB_Val_Ws16 327660.0 DDRCTime_ms 10.0 327670.0 FORMAT "%8.1" EXTENDED_LIMITS -327680.0 327670.0 /end CHARACTERISTIC
/begin CHARACTERISTIC DDRC_DebArTime.DFC_MRlySCG.tiLimPassd_C "" VALUE 0x802501A6 RB_Val_Ws16 327670.0 DDRCTime_ms -327680.0 -10.0 FORMAT "%8.1" EXTENDED_LIMITS -327680.0 327670.0 /end CHARACTERISTIC
/begin CHARACTERISTIC DDRC_DebArTime.DFC_SSpMon1.tiLimFaild_C "" VALUE 0x802501AA RB_Val_Ws16 327660.0 DDRCTime_ms 10.0 327670.0 FORMAT "%8.1" EXTENDED_LIMITS -327680.0 327670.0 /end CHARACTERISTIC
/begin CHARACTERISTIC DDRC_DebArTime.DFC_SSpMon1.tiLimPassd_C "" VALUE 0x802501AC RB_Val_Ws16 327670.0 DDRCTime_ms -327680.0 -10.0 FORMAT "%8.1" EXTENDED_LIMITS -327680.0 327670.0 /end CHARACTERISTIC
/begin CHARACTERISTIC DDRC_DebArTime.DFC_SSpMon1OV.tiLimFaild_C "" VALUE 0x802501B0 RB_Val_Ws16 327660.0 DDRCTime_ms 10.0 327670.0 FORMAT "%8.1" EXTENDED_LIMITS -327680.0 327670.0 /end CHARACTERISTIC
/begin CHARACTERISTIC DDRC_DebArTime.DFC_SSpMon1OV.tiLimPassd_C "" VALUE 0x802501B2 RB_Val_Ws16 327670.0 DDRCTime_ms -327680.0 -10.0 FORMAT "%8.1" EXTENDED_LIMITS -327680.0 327670.0 /end CHARACTERISTIC
/begin CHARACTERISTIC DDRC_DebArTime.DFC_SSpMon1SCG.tiLimFaild_C "" VALUE 0x802501B6 RB_Val_Ws16 327660.0 DDRCTime_ms 10.0 327670.0 FORMAT "%8.1" EXTENDED_LIMITS -327680.0 327670.0 /end CHARACTERISTIC
/begin CHARACTERISTIC DDRC_DebArTime.DFC_SSpMon1SCG.tiLimPassd_C "" VALUE 0x802501B8 RB_Val_Ws16 327670.0 DDRCTime_ms -327680.0 -10.0 FORMAT "%8.1" EXTENDED_LIMITS -327680.0 327670.0 /end CHARACTERISTIC
/begin CHARACTERISTIC DDRC_DebArTime.DFC_SSpMon1UV.tiLimFaild_C "" VALUE 0x802501BC RB_Val_Ws16 327660.0 DDRCTime_ms 10.0 327670.0 FORMAT "%8.1" EXTENDED_LIMITS -327680.0 327670.0 /end CHARACTERISTIC
/begin CHARACTERISTIC DDRC_DebArTime.DFC_SSpMon1UV.tiLimPassd_C "" VALUE 0x802501BE RB_Val_Ws16 327670.0 DDRCTime_ms -327680.0 -10.0 FORMAT "%8.1" EXTENDED_LIMITS -327680.0 327670.0 /end CHARACTERISTIC
/begin CHARACTERISTIC DDRC_DebArTime.DFC_SSpMon2.tiLimFaild_C "" VALUE 0x802501C2 RB_Val_Ws16 327660.0 DDRCTime_ms 10.0 327670.0 FORMAT "%8.1" EXTENDED_LIMITS -327680.0 327670.0 /end CHARACTERISTIC
/begin CHARACTERISTIC DDRC_DebArTime.DFC_SSpMon2.tiLimPassd_C "" VALUE 0x802501C4 RB_Val_Ws16 327670.0 DDRCTime_ms -327680.0 -10.0 FORMAT "%8.1" EXTENDED_LIMITS -327680.0 327670.0 /end CHARACTERISTIC
/begin CHARACTERISTIC DDRC_DebArTime.DFC_SSpMon2OV.tiLimFaild_C "" VALUE 0x802501C8 RB_Val_Ws16 327660.0 DDRCTime_ms 10.0 327670.0 FORMAT "%8.1" EXTENDED_LIMITS -327680.0 327670.0 /end CHARACTERISTIC
/begin CHARACTERISTIC DDRC_DebArTime.DFC_SSpMon2OV.tiLimPassd_C "" VALUE 0x802501CA RB_Val_Ws16 327670.0 DDRCTime_ms -327680.0 -10.0 FORMAT "%8.1" EXTENDED_LIMITS -327680.0 327670.0 /end CHARACTERISTIC
/begin CHARACTERISTIC DDRC_DebArTime.DFC_SSpMon2SCG.tiLimFaild_C "" VALUE 0x802501CE RB_Val_Ws16 327660.0 DDRCTime_ms 10.0 327670.0 FORMAT "%8.1" EXTENDED_LIMITS -327680.0 327670.0 /end CHARACTERISTIC
/begin CHARACTERISTIC DDRC_DebArTime.DFC_SSpMon2SCG.tiLimPassd_C "" VALUE 0x802501D0 RB_Val_Ws16 327670.0 DDRCTime_ms -327680.0 -10.0 FORMAT "%8.1" EXTENDED_LIMITS -327680.0 327670.0 /end CHARACTERISTIC
/begin CHARACTERISTIC DDRC_DebArTime.DFC_SSpMon2UV.tiLimFaild_C "" VALUE 0x802501D4 RB_Val_Ws16 327660.0 DDRCTime_ms 10.0 327670.0 FORMAT "%8.1" EXTENDED_LIMITS -327680.0 327670.0 /end CHARACTERISTIC
/begin CHARACTERISTIC DDRC_DebArTime.DFC_SSpMon2UV.tiLimPassd_C "" VALUE 0x802501D6 RB_Val_Ws16 327670.0 DDRCTime_ms -327680.0 -10.0 FORMAT "%8.1" EXTENDED_LIMITS -327680.0 327670.0 /end CHARACTERISTIC
/begin CHARACTERISTIC DDRC_DebArTime.DFC_SSpMon3.tiLimFaild_C "" VALUE 0x802501DA RB_Val_Ws16 327660.0 DDRCTime_ms 10.0 327670.0 FORMAT "%8.1" EXTENDED_LIMITS -327680.0 327670.0 /end CHARACTERISTIC
/begin CHARACTERISTIC DDRC_DebArTime.DFC_SSpMon3.tiLimPassd_C "" VALUE 0x802501DC RB_Val_Ws16 327670.0 DDRCTime_ms -327680.0 -10.0 FORMAT "%8.1" EXTENDED_LIMITS -327680.0 327670.0 /end CHARACTERISTIC
/begin CHARACTERISTIC DDRC_DebArTime.DFC_SSpMon3OV.tiLimFaild_C "" VALUE 0x802501E0 RB_Val_Ws16 327660.0 DDRCTime_ms 10.0 327670.0 FORMAT "%8.1" EXTENDED_LIMITS -327680.0 327670.0 /end CHARACTERISTIC
/begin CHARACTERISTIC DDRC_DebArTime.DFC_SSpMon3OV.tiLimPassd_C "" VALUE 0x802501E2 RB_Val_Ws16 327670.0 DDRCTime_ms -327680.0 -10.0 FORMAT "%8.1" EXTENDED_LIMITS -327680.0 327670.0 /end CHARACTERISTIC
/begin CHARACTERISTIC DDRC_DebArTime.DFC_SSpMon3SCG.tiLimFaild_C "" VALUE 0x802501E6 RB_Val_Ws16 327660.0 DDRCTime_ms 10.0 327670.0 FORMAT "%8.1" EXTENDED_LIMITS -327680.0 327670.0 /end CHARACTERISTIC
/begin CHARACTERISTIC DDRC_DebArTime.DFC_SSpMon3SCG.tiLimPassd_C "" VALUE 0x802501E8 RB_Val_Ws16 327670.0 DDRCTime_ms -327680.0 -10.0 FORMAT "%8.1" EXTENDED_LIMITS -327680.0 327670.0 /end CHARACTERISTIC
/begin CHARACTERISTIC DDRC_DebArTime.DFC_SSpMon3UV.tiLimFaild_C "" VALUE 0x802501EC RB_Val_Ws16 327660.0 DDRCTime_ms 10.0 327670.0 FORMAT "%8.1" EXTENDED_LIMITS -327680.0 327670.0 /end CHARACTERISTIC
/begin CHARACTERISTIC DDRC_DebArTime.DFC_SSpMon3UV.tiLimPassd_C "" VALUE 0x802501EE RB_Val_Ws16 327670.0 DDRCTime_ms -327680.0 -10.0 FORMAT "%8.1" EXTENDED_LIMITS -327680.0 327670.0 /end CHARACTERISTIC
/begin CHARACTERISTIC DDRC_DurDeb.PwrDistbnUnitT_tiSRCMinDebOk_C "" VALUE 0x80240994 Val_Wu16 655350.0 DDRCTime_ms 0.00 655350.0 FORMAT "%8.1" /end CHARACTERISTIC
/begin CHARACTERISTIC DDRC_DurDeb.PwrDistbnUnitT_tiSRCMinDebDef_C "" VALUE 0x80240996 Val_Wu16 655350.0 DDRCTime_ms 0.00 655350.0 FORMAT "%8.1" /end CHARACTERISTIC
/begin CHARACTERISTIC DDRC_DurDeb.SCtPmp1_tiOLDebOk_C "" VALUE 0x80240998 Val_Wu16 655350.0 DDRCTime_ms 0.00 655350.0 FORMAT "%8.1" /end CHARACTERISTIC
/begin CHARACTERISTIC DDRC_DurDeb.SCtPmp1_tiOLDebDef_C "" VALUE 0x8024099A Val_Wu16 655350.0 DDRCTime_ms 0.00 655350.0 FORMAT "%8.1" /end CHARACTERISTIC
/begin CHARACTERISTIC DDRC_DurDeb.SCtPmp1_tiOvrTempDebOk_C "" VALUE 0x8024099C Val_Wu16 655350.0 DDRCTime_ms 0.00 655350.0 FORMAT "%8.1" /end CHARACTERISTIC
/begin CHARACTERISTIC DDRC_DurDeb.SCtPmp1_tiOvrTempDebDef_C "" VALUE 0x8024099E Val_Wu16 655350.0 DDRCTime_ms 0.00 655350.0 FORMAT "%8.1" /end CHARACTERISTIC
/begin CHARACTERISTIC DDRC_DurDeb.SCtPmp1_tiSCBDebOk_C "" VALUE 0x802409A0 Val_Wu16 655350.0 DDRCTime_ms 0.00 655350.0 FORMAT "%8.1" /end CHARACTERISTIC
/begin CHARACTERISTIC DDRC_DurDeb.SCtPmp1_tiSCBDebDef_C "" VALUE 0x802409A2 Val_Wu16 655350.0 DDRCTime_ms 0.00 655350.0 FORMAT "%8.1" /end CHARACTERISTIC
/begin CHARACTERISTIC DDRC_DurDeb.PwrDistbnUnitT_tiPhysRngHiDebOk_C "" VALUE 0x80240A94 Val_Wu16 655350.0 DDRCTime_ms 0.00 655350.0 FORMAT "%8.1" /end CHARACTERISTIC
/begin CHARACTERISTIC DDRC_DurDeb.PwrDistbnUnitT_tiPhysRngHiDebDef_C "" VALUE 0x80240A96 Val_Wu16 655350.0 DDRCTime_ms 0.00 655350.0 FORMAT "%8.1" /end CHARACTERISTIC
/begin CHARACTERISTIC DDRC_DurDeb.PwrDistbnUnitT_tiPhysRngLoDebOk_C "" VALUE 0x80240A98 Val_Wu16 655350.0 DDRCTime_ms 0.00 655350.0 FORMAT "%8.1" /end CHARACTERISTIC
/begin CHARACTERISTIC DDRC_DurDeb.PwrDistbnUnitT_tiPhysRngLoDebDef_C "" VALUE 0x80240A9A Val_Wu16 655350.0 DDRCTime_ms 0.00 655350.0 FORMAT "%8.1" /end CHARACTERISTIC
/begin CHARACTERISTIC DDRC_DurDeb.PwrDistbnUnitT_tiSRCOpnDebOk_C "" VALUE 0x80240A9C Val_Wu16 655350.0 DDRCTime_ms 0.00 655350.0 FORMAT "%8.1" /end CHARACTERISTIC
/begin CHARACTERISTIC DDRC_DurDeb.PwrDistbnUnitT_tiSRCOpnDebDef_C "" VALUE 0x80240A9E Val_Wu16 655350.0 DDRCTime_ms 0.00 655350.0 FORMAT "%8.1" /end CHARACTERISTIC
/begin CHARACTERISTIC DDRC_DurDeb.SCtPmp1_numDiagGrdKey1DebOk_C "" VALUE 0x80240AD0 Val_Wu16 65535.00 OneToOne 0.00 65535.00 FORMAT "%8.2" /end CHARACTERISTIC
/begin CHARACTERISTIC DDRC_DurDeb.SCtPmp1_numDiagGrdKey1DebDef_C "" VALUE 0x80240AD2 Val_Wu16 65535.00 OneToOne 0.00 65535.00 FORMAT "%8.2" /end CHARACTERISTIC
/begin CHARACTERISTIC DDRC_DurDeb.SCtPmp1_numDiagGrdKey2DebOk_C "" VALUE 0x80240AD4 Val_Wu16 65535.00 OneToOne 0.00 65535.00 FORMAT "%8.2" /end CHARACTERISTIC
/begin CHARACTERISTIC DDRC_DurDeb.SCtPmp1_numDiagGrdKey2DebDef_C "" VALUE 0x80240AD6 Val_Wu16 65535.00 OneToOne 0.00 65535.00 FORMAT "%8.2" /end CHARACTERISTIC
/begin CHARACTERISTIC DDRC_DurDeb.SCtPmp1_numDiagGrdKey3DebOk_C "" VALUE 0x80240AD8 Val_Wu16 65535.00 OneToOne 0.00 65535.00 FORMAT "%8.2" /end CHARACTERISTIC
/begin CHARACTERISTIC DDRC_DurDeb.SCtPmp1_numDiagGrdKey3DebDef_C "" VALUE 0x80240ADA Val_Wu16 65535.00 OneToOne 0.00 65535.00 FORMAT "%8.2" /end CHARACTERISTIC
/begin CHARACTERISTIC DDRC_DurDeb.SCtPmp1_numDiagGrdKey4DebOk_C "" VALUE 0x80240ADC Val_Wu16 65535.00 OneToOne 0.00 65535.00 FORMAT "%8.2" /end CHARACTERISTIC
/begin CHARACTERISTIC DDRC_DurDeb.SCtPmp1_numDiagGrdKey4DebDef_C "" VALUE 0x80240ADE Val_Wu16 65535.00 OneToOne 0.00 65535.00 FORMAT "%8.2" /end CHARACTERISTIC
/begin CHARACTERISTIC DDRC_DurDeb.SCtPmp1_numDiagGrdKey5DebOk_C "" VALUE 0x80240AE0 Val_Wu16 65535.00 OneToOne 0.00 65535.00 FORMAT "%8.2" /end CHARACTERISTIC
/begin CHARACTERISTIC DDRC_DurDeb.SCtPmp1_numDiagGrdKey5DebDef_C "" VALUE 0x80240AE2 Val_Wu16 65535.00 OneToOne 0.00 65535.00 FORMAT "%8.2" /end CHARACTERISTIC
/begin CHARACTERISTIC DDRC_DurDeb.SCtPmp1_tiFailSafeNotSucDebOk_C "" VALUE 0x80240DA4 Val_Wu16 655350.0 DDRCTime_ms 0.00 655350.0 FORMAT "%8.1" /end CHARACTERISTIC
/begin CHARACTERISTIC DDRC_DurDeb.SCtPmp1_tiFailSafeNotSucDebDef_C "" VALUE 0x80240DA6 Val_Wu16 655350.0 DDRCTime_ms 0.00 655350.0 FORMAT "%8.1" /end CHARACTERISTIC
/begin CHARACTERISTIC DDRC_DurDeb.SCtPmp1_tiSCGDebOk_C "" VALUE 0x80240DA8 Val_Wu16 655350.0 DDRCTime_ms 0.00 655350.0 FORMAT "%8.1" /end CHARACTERISTIC
/begin CHARACTERISTIC DDRC_DurDeb.SCtPmp1_tiSCGDebDef_C "" VALUE 0x80240DAA Val_Wu16 655350.0 DDRCTime_ms 0.00 655350.0 FORMAT "%8.1" /end CHARACTERISTIC
/begin CHARACTERISTIC DDRC_RatDeb.PwrDistbnUnitT_tiSRCMinUDRat_C "" VALUE 0x80248A69 Val_Wu8 3.00000000000 DDRC_Ratio 1.00000000000 4.00000000000 FORMAT "%13.11" /end CHARACTERISTIC
/begin CHARACTERISTIC DDRC_RatDeb.SCtPmp1_tiOLUDRat_C "" VALUE 0x80248A6A Val_Wu8 3.00000000000 DDRC_Ratio 1.00000000000 4.00000000000 FORMAT "%13.11" /end CHARACTERISTIC
/begin CHARACTERISTIC DDRC_RatDeb.SCtPmp1_tiOvrTempUDRat_C "" VALUE 0x80248A6B Val_Wu8 3.00000000000 DDRC_Ratio 1.00000000000 4.00000000000 FORMAT "%13.11" /end CHARACTERISTIC
/begin CHARACTERISTIC DDRC_RatDeb.SCtPmp1_tiSCBUDRat_C "" VALUE 0x80248A6C Val_Wu8 3.00000000000 DDRC_Ratio 1.00000000000 4.00000000000 FORMAT "%13.11" /end CHARACTERISTIC
/begin CHARACTERISTIC DDRC_RatDeb.PwrDistbnUnitT_tiPhysRngHiUDRat_C "" VALUE 0x80248AA9 Val_Wu8 3.00000000000 DDRC_Ratio 1.00000000000 4.00000000000 FORMAT "%13.11" /end CHARACTERISTIC
/begin CHARACTERISTIC DDRC_RatDeb.PwrDistbnUnitT_tiPhysRngLoUDRat_C "" VALUE 0x80248AAA Val_Wu8 3.00000000000 DDRC_Ratio 1.00000000000 4.00000000000 FORMAT "%13.11" /end CHARACTERISTIC
/begin CHARACTERISTIC DDRC_RatDeb.PwrDistbnUnitT_tiSRCOpnUDRat_C "" VALUE 0x80248AAB Val_Wu8 3.00000000000 DDRC_Ratio 1.00000000000 4.00000000000 FORMAT "%13.11" /end CHARACTERISTIC
/begin CHARACTERISTIC DDRC_RatDeb.SCtPmp1_numDiagGrdKey1UDRat_C "" VALUE 0x80248AB8 Val_Wu8 3.00000000000 DDRC_Ratio 1.00000000000 4.00000000000 FORMAT "%13.11" /end CHARACTERISTIC
/begin CHARACTERISTIC DDRC_RatDeb.SCtPmp1_numDiagGrdKey2UDRat_C "" VALUE 0x80248AB9 Val_Wu8 3.00000000000 DDRC_Ratio 1.00000000000 4.00000000000 FORMAT "%13.11" /end CHARACTERISTIC
/begin CHARACTERISTIC DDRC_RatDeb.SCtPmp1_numDiagGrdKey3UDRat_C "" VALUE 0x80248ABA Val_Wu8 3.00000000000 DDRC_Ratio 1.00000000000 4.00000000000 FORMAT "%13.11" /end CHARACTERISTIC
/begin CHARACTERISTIC DDRC_RatDeb.SCtPmp1_numDiagGrdKey4UDRat_C "" VALUE 0x80248ABB Val_Wu8 3.00000000000 DDRC_Ratio 1.00000000000 4.00000000000 FORMAT "%13.11" /end CHARACTERISTIC
/begin CHARACTERISTIC DDRC_RatDeb.SCtPmp1_numDiagGrdKey5UDRat_C "" VALUE 0x80248ABC Val_Wu8 3.00000000000 DDRC_Ratio 1.00000000000 4.00000000000 FORMAT "%13.11" /end CHARACTERISTIC
/begin CHARACTERISTIC DFC_CtlMsk2.DFC_SCtPmp1FailSafeNotSuc_C "" VALUE 0x80241399 Val_Wu8 255.0 DFES_OneToOne 0.00 255.0 FORMAT "%5.1" /end CHARACTERISTIC
/begin CHARACTERISTIC DFC_CtlMsk2.DFC_SCtPmp1SCG_C "" VALUE 0x8024139A Val_Wu8 255.0 DFES_OneToOne 0.00 255.0 FORMAT "%5.1" /end CHARACTERISTIC
/begin CHARACTERISTIC DFC_CtlMsk2.DFC_PwrDistbnUnitTSRCMin_C "" VALUE 0x80241522 Val_Wu8 255.0 DFES_OneToOne 0.00 255.0 FORMAT "%5.1" /end CHARACTERISTIC
/begin CHARACTERISTIC DFC_CtlMsk2.DFC_SCtPmp1OL_C "" VALUE 0x80241523 Val_Wu8 255.0 DFES_OneToOne 0.00 255.0 FORMAT "%5.1" /end CHARACTERISTIC
/begin CHARACTERISTIC DFC_CtlMsk2.DFC_SCtPmp1OvrTemp_C "" VALUE 0x80241524 Val_Wu8 255.0 DFES_OneToOne 0.00 255.0 FORMAT "%5.1" /end CHARACTERISTIC
/begin CHARACTERISTIC DFC_CtlMsk2.DFC_SCtPmp1SCB_C "" VALUE 0x80241525 Val_Wu8 255.0 DFES_OneToOne 0.00 255.0 FORMAT "%5.1" /end CHARACTERISTIC
/begin CHARACTERISTIC DFC_CtlMsk2.DFC_PwrDistbnUnitTPhysRngHi_C "" VALUE 0x80241562 Val_Wu8 255.0 DFES_OneToOne 0.00 255.0 FORMAT "%5.1" /end CHARACTERISTIC
/begin CHARACTERISTIC DFC_CtlMsk2.DFC_PwrDistbnUnitTPhysRngLo_C "" VALUE 0x80241563 Val_Wu8 255.0 DFES_OneToOne 0.00 255.0 FORMAT "%5.1" /end CHARACTERISTIC
/begin CHARACTERISTIC DFC_CtlMsk2.DFC_PwrDistbnUnitTSRCOpn_C "" VALUE 0x80241564 Val_Wu8 255.0 DFES_OneToOne 0.00 255.0 FORMAT "%5.1" /end CHARACTERISTIC
/begin CHARACTERISTIC DFC_CtlMsk2.DFC_SCtPmp1DiagGrdKey1_C "" VALUE 0x80241571 Val_Wu8 255.0 DFES_OneToOne 0.00 255.0 FORMAT "%5.1" /end CHARACTERISTIC
/begin CHARACTERISTIC DFC_CtlMsk2.DFC_SCtPmp1DiagGrdKey2_C "" VALUE 0x80241572 Val_Wu8 255.0 DFES_OneToOne 0.00 255.0 FORMAT "%5.1" /end CHARACTERISTIC
/begin CHARACTERISTIC DFC_CtlMsk2.DFC_SCtPmp1DiagGrdKey3_C "" VALUE 0x80241573 Val_Wu8 255.0 DFES_OneToOne 0.00 255.0 FORMAT "%5.1" /end CHARACTERISTIC
/begin CHARACTERISTIC DFC_CtlMsk2.DFC_SCtPmp1DiagGrdKey4_C "" VALUE 0x80241574 Val_Wu8 255.0 DFES_OneToOne 0.00 255.0 FORMAT "%5.1" /end CHARACTERISTIC
/begin CHARACTERISTIC DFC_CtlMsk2.DFC_SCtPmp1DiagGrdKey5_C "" VALUE 0x80241575 Val_Wu8 255.0 DFES_OneToOne 0.00 255.0 FORMAT "%5.1" /end CHARACTERISTIC
/begin CHARACTERISTIC DFC_CtlMsk2.DFC_MRlyOL_C "" VALUE 0x802415A1 Val_Wu8 255.0 DFES_OneToOne 0.00 255.0 FORMAT "%5.1" /end CHARACTERISTIC
/begin CHARACTERISTIC DFC_CtlMsk2.DFC_MRlySCB_C "" VALUE 0x802415A2 Val_Wu8 255.0 DFES_OneToOne 0.00 255.0 FORMAT "%5.1" /end CHARACTERISTIC
/begin CHARACTERISTIC DFC_CtlMsk2.DFC_MRlySCG_C "" VALUE 0x802415A3 Val_Wu8 255.0 DFES_OneToOne 0.00 255.0 FORMAT "%5.1" /end CHARACTERISTIC
/begin CHARACTERISTIC DFC_CtlMsk2.DFC_SSpMon1_C "" VALUE 0x802415A4 Val_Wu8 255.0 DFES_OneToOne 0.00 255.0 FORMAT "%5.1" /end CHARACTERISTIC
/begin CHARACTERISTIC DFC_CtlMsk2.DFC_SSpMon1OV_C "" VALUE 0x802415A5 Val_Wu8 255.0 DFES_OneToOne 0.00 255.0 FORMAT "%5.1" /end CHARACTERISTIC
/begin CHARACTERISTIC DFC_CtlMsk2.DFC_SSpMon1SCG_C "" VALUE 0x802415A6 Val_Wu8 255.0 DFES_OneToOne 0.00 255.0 FORMAT "%5.1" /end CHARACTERISTIC
/begin CHARACTERISTIC DFC_CtlMsk2.DFC_SSpMon1UV_C "" VALUE 0x802415A7 Val_Wu8 255.0 DFES_OneToOne 0.00 255.0 FORMAT "%5.1" /end CHARACTERISTIC
/begin CHARACTERISTIC DFC_CtlMsk2.DFC_SSpMon2_C "" VALUE 0x802415A8 Val_Wu8 255.0 DFES_OneToOne 0.00 255.0 FORMAT "%5.1" /end CHARACTERISTIC
/begin CHARACTERISTIC DFC_CtlMsk2.DFC_SSpMon2OV_C "" VALUE 0x802415A9 Val_Wu8 255.0 DFES_OneToOne 0.00 255.0 FORMAT "%5.1" /end CHARACTERISTIC
/begin CHARACTERISTIC DFC_CtlMsk2.DFC_SSpMon2SCG_C "" VALUE 0x802415AA Val_Wu8 255.0 DFES_OneToOne 0.00 255.0 FORMAT "%5.1" /end CHARACTERISTIC
/begin CHARACTERISTIC DFC_CtlMsk2.DFC_SSpMon2UV_C "" VALUE 0x802415AB Val_Wu8 255.0 DFES_OneToOne 0.00 255.0 FORMAT "%5.1" /end CHARACTERISTIC
/begin CHARACTERISTIC DFC_CtlMsk2.DFC_SSpMon3_C "" VALUE 0x802415AC Val_Wu8 255.0 DFES_OneToOne 0.00 255.0 FORMAT "%5.1" /end CHARACTERISTIC
/begin CHARACTERISTIC DFC_CtlMsk2.DFC_SSpMon3OV_C "" VALUE 0x802415AD Val_Wu8 255.0 DFES_OneToOne 0.00 255.0 FORMAT "%5.1" /end CHARACTERISTIC
/begin CHARACTERISTIC DFC_CtlMsk2.DFC_SSpMon3SCG_C "" VALUE 0x802415AE Val_Wu8 255.0 DFES_OneToOne 0.00 255.0 FORMAT "%5.1" /end CHARACTERISTIC
/begin CHARACTERISTIC DFC_CtlMsk2.DFC_SSpMon3UV_C "" VALUE 0x802415AF Val_Wu8 255.0 DFES_OneToOne 0.00 255.0 FORMAT "%5.1" /end CHARACTERISTIC
/begin CHARACTERISTIC DFC_CtlMsk2.DFC_rba_EcuCtrl_TOMaxProlg_C "" VALUE 0x802415BD Val_Wu8 255.0 DFES_OneToOne 0.00 255.0 FORMAT "%5.1" /end CHARACTERISTIC
/begin CHARACTERISTIC DFC_CtlMsk2.DFC_rba_EcuCtrl_TOMaxShutDwn_C "" VALUE 0x802415BE Val_Wu8 255.0 DFES_OneToOne 0.00 255.0 FORMAT "%5.1" /end CHARACTERISTIC
/begin CHARACTERISTIC DFC_CtlMsk2.DFC_rba_IoSigRtc_StopCounter_C "" VALUE 0x802415C5 Val_Wu8 255.0 DFES_OneToOne 0.00 255.0 FORMAT "%5.1" /end CHARACTERISTIC
/begin CHARACTERISTIC DFC_CtlMsk2.DFC_rba_MemDiag_MemReadErr_C "" VALUE 0x802415C7 Val_Wu8 255.0 DFES_OneToOne 0.00 255.0 FORMAT "%5.1" /end CHARACTERISTIC
/begin CHARACTERISTIC DFC_CtlMsk2.DFC_rba_MemDiag_MemWrErr_C "" VALUE 0x802415C8 Val_Wu8 255.0 DFES_OneToOne 0.00 255.0 FORMAT "%5.1" /end CHARACTERISTIC
/begin CHARACTERISTIC DFC_CtlMsk2.DFC_PwrDistbnUnitTSRCMax_C "" VALUE 0x8024169C Val_Wu8 255.0 DFES_OneToOne 0.00 255.0 FORMAT "%5.1" /end CHARACTERISTIC
/begin CHARACTERISTIC DFC_CtlMsk2.DFC_PwrDistbnUnitTTmpErr_C "" VALUE 0x8024169D Val_Wu8 255.0 DFES_OneToOne 0.00 255.0 FORMAT "%5.1" /end CHARACTERISTIC
/begin CHARACTERISTIC DFC_CtlMsk2.DFC_SCtPmp1DiagGrdKeyErr_C "" VALUE 0x8024169E Val_Wu8 255.0 DFES_OneToOne 0.00 255.0 FORMAT "%5.1" /end CHARACTERISTIC
/begin CHARACTERISTIC DFC_DisblMsk2.DFC_SCtPmp1FailSafeNotSuc_C "" VALUE 0x80248C18 Val_Wu16 65535.00 DFES_OneToOne 0.00 65535.00 FORMAT "%8.2" /end CHARACTERISTIC
/begin CHARACTERISTIC DFC_DisblMsk2.DFC_SCtPmp1SCG_C "" VALUE 0x80248C1A Val_Wu16 65535.00 DFES_OneToOne 0.00 65535.00 FORMAT "%8.2" /end CHARACTERISTIC
/begin CHARACTERISTIC DFC_DisblMsk2.DFC_PwrDistbnUnitTSRCMin_C "" VALUE 0x80248F2A Val_Wu16 65535.00 DFES_OneToOne 0.00 65535.00 FORMAT "%8.2" /end CHARACTERISTIC
/begin CHARACTERISTIC DFC_DisblMsk2.DFC_SCtPmp1OL_C "" VALUE 0x80248F2C Val_Wu16 65535.00 DFES_OneToOne 0.00 65535.00 FORMAT "%8.2" /end CHARACTERISTIC
/begin CHARACTERISTIC DFC_DisblMsk2.DFC_SCtPmp1OvrTemp_C "" VALUE 0x80248F2E Val_Wu16 65535.00 DFES_OneToOne 0.00 65535.00 FORMAT "%8.2" /end CHARACTERISTIC
/begin CHARACTERISTIC DFC_DisblMsk2.DFC_SCtPmp1SCB_C "" VALUE 0x80248F30 Val_Wu16 65535.00 DFES_OneToOne 0.00 65535.00 FORMAT "%8.2" /end CHARACTERISTIC
/begin CHARACTERISTIC DFC_DisblMsk2.DFC_PwrDistbnUnitTPhysRngHi_C "" VALUE 0x80248FAA Val_Wu16 65535.00 DFES_OneToOne 0.00 65535.00 FORMAT "%8.2" /end CHARACTERISTIC
/begin CHARACTERISTIC DFC_DisblMsk2.DFC_PwrDistbnUnitTPhysRngLo_C "" VALUE 0x80248FAC Val_Wu16 65535.00 DFES_OneToOne 0.00 65535.00 FORMAT "%8.2" /end CHARACTERISTIC
/begin CHARACTERISTIC DFC_DisblMsk2.DFC_PwrDistbnUnitTSRCOpn_C "" VALUE 0x80248FAE Val_Wu16 65535.00 DFES_OneToOne 0.00 65535.00 FORMAT "%8.2" /end CHARACTERISTIC
/begin CHARACTERISTIC DFC_DisblMsk2.DFC_SCtPmp1DiagGrdKey1_C "" VALUE 0x80248FC8 Val_Wu16 65535.00 DFES_OneToOne 0.00 65535.00 FORMAT "%8.2" /end CHARACTERISTIC
/begin CHARACTERISTIC DFC_DisblMsk2.DFC_SCtPmp1DiagGrdKey2_C "" VALUE 0x80248FCA Val_Wu16 65535.00 DFES_OneToOne 0.00 65535.00 FORMAT "%8.2" /end CHARACTERISTIC
/begin CHARACTERISTIC DFC_DisblMsk2.DFC_SCtPmp1DiagGrdKey3_C "" VALUE 0x80248FCC Val_Wu16 65535.00 DFES_OneToOne 0.00 65535.00 FORMAT "%8.2" /end CHARACTERISTIC
/begin CHARACTERISTIC DFC_DisblMsk2.DFC_SCtPmp1DiagGrdKey4_C "" VALUE 0x80248FCE Val_Wu16 65535.00 DFES_OneToOne 0.00 65535.00 FORMAT "%8.2" /end CHARACTERISTIC
/begin CHARACTERISTIC DFC_DisblMsk2.DFC_SCtPmp1DiagGrdKey5_C "" VALUE 0x80248FD0 Val_Wu16 65535.00 DFES_OneToOne 0.00 65535.00 FORMAT "%8.2" /end CHARACTERISTIC
/begin CHARACTERISTIC DFC_DisblMsk2.DFC_MRlyOL_C "" VALUE 0x80249028 Val_Wu16 65535.00 DFES_OneToOne 0.00 65535.00 FORMAT "%8.2" /end CHARACTERISTIC
/begin CHARACTERISTIC DFC_DisblMsk2.DFC_MRlySCB_C "" VALUE 0x8024902A Val_Wu16 65535.00 DFES_OneToOne 0.00 65535.00 FORMAT "%8.2" /end CHARACTERISTIC
/begin CHARACTERISTIC DFC_DisblMsk2.DFC_MRlySCG_C "" VALUE 0x8024902C Val_Wu16 65535.00 DFES_OneToOne 0.00 65535.00 FORMAT "%8.2" /end CHARACTERISTIC
/begin CHARACTERISTIC DFC_DisblMsk2.DFC_SSpMon1_C "" VALUE 0x8024902E Val_Wu16 65535.00 DFES_OneToOne 0.00 65535.00 FORMAT "%8.2" /end CHARACTERISTIC
/begin CHARACTERISTIC DFC_DisblMsk2.DFC_SSpMon1OV_C "" VALUE 0x80249030 Val_Wu16 65535.00 DFES_OneToOne 0.00 65535.00 FORMAT "%8.2" /end CHARACTERISTIC
/begin CHARACTERISTIC DFC_DisblMsk2.DFC_SSpMon1SCG_C "" VALUE 0x80249032 Val_Wu16 65535.00 DFES_OneToOne 0.00 65535.00 FORMAT "%8.2" /end CHARACTERISTIC
/begin CHARACTERISTIC DFC_DisblMsk2.DFC_SSpMon1UV_C "" VALUE 0x80249034 Val_Wu16 65535.00 DFES_OneToOne 0.00 65535.00 FORMAT "%8.2" /end CHARACTERISTIC
/begin CHARACTERISTIC DFC_DisblMsk2.DFC_SSpMon2_C "" VALUE 0x80249036 Val_Wu16 65535.00 DFES_OneToOne 0.00 65535.00 FORMAT "%8.2" /end CHARACTERISTIC
/begin CHARACTERISTIC DFC_DisblMsk2.DFC_SSpMon2OV_C "" VALUE 0x80249038 Val_Wu16 65535.00 DFES_OneToOne 0.00 65535.00 FORMAT "%8.2" /end CHARACTERISTIC
/begin CHARACTERISTIC DFC_DisblMsk2.DFC_SSpMon2SCG_C "" VALUE 0x8024903A Val_Wu16 65535.00 DFES_OneToOne 0.00 65535.00 FORMAT "%8.2" /end CHARACTERISTIC
/begin CHARACTERISTIC DFC_DisblMsk2.DFC_SSpMon2UV_C "" VALUE 0x8024903C Val_Wu16 65535.00 DFES_OneToOne 0.00 65535.00 FORMAT "%8.2" /end CHARACTERISTIC
/begin CHARACTERISTIC DFC_DisblMsk2.DFC_SSpMon3_C "" VALUE 0x8024903E Val_Wu16 65535.00 DFES_OneToOne 0.00 65535.00 FORMAT "%8.2" /end CHARACTERISTIC
/begin CHARACTERISTIC DFC_DisblMsk2.DFC_SSpMon3OV_C "" VALUE 0x80249040 Val_Wu16 65535.00 DFES_OneToOne 0.00 65535.00 FORMAT "%8.2" /end CHARACTERISTIC
/begin CHARACTERISTIC DFC_DisblMsk2.DFC_SSpMon3SCG_C "" VALUE 0x80249042 Val_Wu16 65535.00 DFES_OneToOne 0.00 65535.00 FORMAT "%8.2" /end CHARACTERISTIC
/begin CHARACTERISTIC DFC_DisblMsk2.DFC_SSpMon3UV_C "" VALUE 0x80249044 Val_Wu16 65535.00 DFES_OneToOne 0.00 65535.00 FORMAT "%8.2" /end CHARACTERISTIC
/begin CHARACTERISTIC DFC_DisblMsk2.DFC_rba_EcuCtrl_TOMaxProlg_C "" VALUE 0x80249060 Val_Wu16 65535.00 DFES_OneToOne 0.00 65535.00 FORMAT "%8.2" /end CHARACTERISTIC
/begin CHARACTERISTIC DFC_DisblMsk2.DFC_rba_EcuCtrl_TOMaxShutDwn_C "" VALUE 0x80249062 Val_Wu16 65535.00 DFES_OneToOne 0.00 65535.00 FORMAT "%8.2" /end CHARACTERISTIC
/begin CHARACTERISTIC DFC_DisblMsk2.DFC_rba_IoSigRtc_StopCounter_C "" VALUE 0x80249070 Val_Wu16 65535.00 DFES_OneToOne 0.00 65535.00 FORMAT "%8.2" /end CHARACTERISTIC
/begin CHARACTERISTIC DFC_DisblMsk2.DFC_rba_MemDiag_MemReadErr_C "" VALUE 0x80249074 Val_Wu16 65535.00 DFES_OneToOne 0.00 65535.00 FORMAT "%8.2" /end CHARACTERISTIC
/begin CHARACTERISTIC DFC_DisblMsk2.DFC_rba_MemDiag_MemWrErr_C "" VALUE 0x80249076 Val_Wu16 65535.00 DFES_OneToOne 0.00 65535.00 FORMAT "%8.2" /end CHARACTERISTIC
/begin CHARACTERISTIC DFC_DisblMsk2.DFC_PwrDistbnUnitTSRCMax_C "" VALUE 0x8024921E Val_Wu16 65535.00 DFES_OneToOne 0.00 65535.00 FORMAT "%8.2" /end CHARACTERISTIC
/begin CHARACTERISTIC DFC_DisblMsk2.DFC_PwrDistbnUnitTTmpErr_C "" VALUE 0x80249220 Val_Wu16 65535.00 DFES_OneToOne 0.00 65535.00 FORMAT "%8.2" /end CHARACTERISTIC
/begin CHARACTERISTIC DFC_DisblMsk2.DFC_SCtPmp1DiagGrdKeyErr_C "" VALUE 0x80249222 Val_Wu16 65535.00 DFES_OneToOne 0.00 65535.00 FORMAT "%8.2" /end CHARACTERISTIC
/begin CHARACTERISTIC Eep_ClrWrCounter_CW "" VALUE 0x8024028E Val_Wu8 255.0 OneToOne 0.00 255.0 FORMAT "%5.1" /end CHARACTERISTIC
/begin CHARACTERISTIC Eep_EnFirstInit_CW "" VALUE 0x8024028D Val_Wu8 255.0 OneToOne 0.00 255.0 FORMAT "%5.1" /end CHARACTERISTIC
/begin CHARACTERISTIC Eep_EnvRamClr_CW "" VALUE 0x8024028C Val_Wu8 255.0 OneToOne 0.00 255.0 FORMAT "%5.1" /end CHARACTERISTIC
/begin CHARACTERISTIC PwrDistbnUnitT_ADCCal.numSRCTempSel_C "Calibration structure for ADC and SENT / Selection of temperature for signal range check" VALUE 0x802513E4 RB_Val_Wu8 255.000000000 DELIB_ALLTEMP_VERB_COMPU 0.00 255.000000000 FORMAT "%13.9" /end CHARACTERISTIC
/begin CHARACTERISTIC PwrDistbnUnitT_ADCCal.tiSRCMaxDebOK_C "Calibration structure for ADC and SENT / Error healing deounce time" VALUE 0x802513E8 RB_Val_Ws32 42949672950.0 Time_ms -21474836480.0 21474836470.0 FORMAT "%13.1" /end CHARACTERISTIC
/begin CHARACTERISTIC PwrDistbnUnitT_ADCCal.uSRCMax_C "Calibration structure for ADC and SENT / Maximum threshold voltage for SRC" VALUE 0x802513EC RB_Val_Ws16 13107.00 Volt -6553.600 6553.400 FORMAT "%8.3" /end CHARACTERISTIC
/begin CHARACTERISTIC PwrDistbnUnitT_ADCCal.uSRCMin_C "Calibration structure for ADC and SENT / Minimum threshold voltage for SRC" VALUE 0x802513EE RB_Val_Ws16 13107.00 Volt -6553.600 6553.400 FORMAT "%8.3" /end CHARACTERISTIC
/begin CHARACTERISTIC PwrDistbnUnitT_ADCCal.uSRCOpn_C "Calibration structure for ADC and SENT / Maximum threshold for open SRC connection error." VALUE 0x802513F0 RB_Val_Ws16 13107.00 Volt -6553.600 6553.400 FORMAT "%8.3" /end CHARACTERISTIC
/begin CHARACTERISTIC PwrDistbnUnitT_ADCSensTransf_f_CUR "" CURVE 0x8026686C RB_Curve_R32_R32_sao 2.00000000E+037 RBPtCel_t_1p0_3 -1.00000000E+037 1.00000000E+037 FORMAT "%13.3" EXTENDED_LIMITS -3.40282347E+038 3.40282347E+038
 /begin AXIS_DESCR STD_AXIS PwrDistbnUnitT_uRaw_f RBPtCel_u_1p0_2 25 -1.00000000E+037 1.00000000E+037 FORMAT "%13.3" EXTENDED_LIMITS -3.40282347E+038 3.40282347E+038 DEPOSIT ABSOLUTE /end AXIS_DESCR
/end CHARACTERISTIC
/begin CHARACTERISTIC PwrDistbnUnitT_DigSensCal.tiDebPos_C " / debounce time of rising edge" VALUE 0x802669F0 Val_Ws16 655350.0 Time_ms -327680.0 327670.0 FORMAT "%8.1" /end CHARACTERISTIC
/begin CHARACTERISTIC PwrDistbnUnitT_DigSensCal.tiDebNeg_C " / debounce time of falling edge" VALUE 0x802669F2 Val_Ws16 655350.0 Time_ms -327680.0 327670.0 FORMAT "%8.1" /end CHARACTERISTIC
/begin CHARACTERISTIC PwrDistbnUnitT_dtGradLim_f_C "" VALUE 0x802669F4 Val_Wr32 2.00000000E+037 RBPtCel_dt_1p0_1 -1.00000000E+037 1.00000000E+037 FORMAT "%13.3" EXTENDED_LIMITS -3.40282347E+038 3.40282347E+038 /end CHARACTERISTIC
/begin CHARACTERISTIC PwrDistbnUnitT_numStdSens_C "" VALUE 0x80266A18 Val_Wu32 4294967295.00 OneToOne 0.00 4294967295.00 FORMAT "%13.2" /end CHARACTERISTIC
/begin CHARACTERISTIC PwrDistbnUnitT_numTempErrDef_C "" VALUE 0x80266A1C Val_Wu8 255.0 OneToOne 0.00 255.0 FORMAT "%5.1" /end CHARACTERISTIC
/begin CHARACTERISTIC PwrDistbnUnitT_numtSel_C "" VALUE 0x80266A1E Val_Wu16 255.000000000 DELIB_ALLTEMP_VERB_COMPU 0.00 255.000000000 FORMAT "%13.9" /end CHARACTERISTIC
/begin CHARACTERISTIC PwrDistbnUnitT_RmpSlp_f.Pos_C " / Positive ramp slope dy/dt" VALUE 0x802669F8 Kw_Wr32 2.00000000E+038 RBPtCel_dt_1p0_1 -1.00000000E+038 1.00000000E+038 FORMAT "%13.3" EXTENDED_LIMITS -3.40282347E+038 3.40282347E+038 /end CHARACTERISTIC
/begin CHARACTERISTIC PwrDistbnUnitT_RmpSlp_f.Neg_C " / Negative ramp slope dy/dt" VALUE 0x802669FC Kw_Wr32 2.00000000E+038 RBPtCel_dt_1p0_1 -1.00000000E+038 1.00000000E+038 FORMAT "%13.3" EXTENDED_LIMITS -3.40282347E+038 3.40282347E+038 /end CHARACTERISTIC
/begin CHARACTERISTIC PwrDistbnUnitT_stEnhPhysSRCRls_MAP "" MAP 0x80266A20 RB_Map_S16S16_U8_sao 255.0 OneToOne 0.00 255.0 FORMAT "%5.1"
 /begin AXIS_DESCR STD_AXIS Epm_nEng EngN 25 -16384.00 16383.50 FORMAT "%8.2" DEPOSIT ABSOLUTE /end AXIS_DESCR
 /begin AXIS_DESCR STD_AXIS InjCtl_qSetUnBal InjMass 25 -327.6800 327.6700 FORMAT "%8.4" DEPOSIT ABSOLUTE /end AXIS_DESCR
/end CHARACTERISTIC
/begin CHARACTERISTIC PwrDistbnUnitT_swtConfStdSens2_C "" VALUE 0x802669DC Val_Wu32 4294967295.00 OneToOne 0.00 4294967295.00 FORMAT "%13.2" /end CHARACTERISTIC
/begin CHARACTERISTIC PwrDistbnUnitT_swtConfStdSensSwVers162_C "" VALUE 0x802669E0 Val_Wu32 4294967295.00 OneToOne 0.00 4294967295.00 FORMAT "%13.2" /end CHARACTERISTIC
/begin CHARACTERISTIC PwrDistbnUnitT_swtConfStdSens_C "" VALUE 0x802669E4 Val_Wu32 4294967295.00 OneToOne 0.00 4294967295.00 FORMAT "%13.2" /end CHARACTERISTIC
/begin CHARACTERISTIC PwrDistbnUnitT_tDflVal_f_C "" VALUE 0x80266A00 Val_Wr32 2.00000000E+037 RBPtCel_t_1p0_3 -1.00000000E+037 1.00000000E+037 FORMAT "%13.3" EXTENDED_LIMITS -3.40282347E+038 3.40282347E+038 /end CHARACTERISTIC
/begin CHARACTERISTIC PwrDistbnUnitT_tEnhPhysSRCMax_f_MAP "" MAP 0x80266CFC RB_Map_S16S16_R32_sao 2.00000000E+037 RBPtCel_t_1p0_3 -1.00000000E+037 1.00000000E+037 FORMAT "%13.3" EXTENDED_LIMITS -3.40282347E+038 3.40282347E+038
 /begin AXIS_DESCR STD_AXIS Epm_nEng EngN 25 -16384.00 16383.50 FORMAT "%8.2" DEPOSIT ABSOLUTE /end AXIS_DESCR
 /begin AXIS_DESCR STD_AXIS InjCtl_qSetUnBal InjMass 25 -327.6800 327.6700 FORMAT "%8.4" DEPOSIT ABSOLUTE /end AXIS_DESCR
/end CHARACTERISTIC
/begin CHARACTERISTIC PwrDistbnUnitT_tEnhPhysSRCMin_f_MAP "" MAP 0x80267728 RB_Map_S16S16_R32_sao 2.00000000E+037 RBPtCel_t_1p0_3 -1.00000000E+037 1.00000000E+037 FORMAT "%13.3" EXTENDED_LIMITS -3.40282347E+038 3.40282347E+038
 /begin AXIS_DESCR STD_AXIS Epm_nEng EngN 25 -16384.00 16383.50 FORMAT "%8.2" DEPOSIT ABSOLUTE /end AXIS_DESCR
 /begin AXIS_DESCR STD_AXIS InjCtl_qSetUnBal InjMass 25 -327.6800 327.6700 FORMAT "%8.4" DEPOSIT ABSOLUTE /end AXIS_DESCR
/end CHARACTERISTIC
/begin CHARACTERISTIC PwrDistbnUnitT_tHiLimit_f_C "" VALUE 0x80266A04 Val_Wr32 2.00000000E+037 RBPtCel_t_1p0_3 -1.00000000E+037 1.00000000E+037 FORMAT "%13.3" EXTENDED_LIMITS -3.40282347E+038 3.40282347E+038 /end CHARACTERISTIC
/begin CHARACTERISTIC PwrDistbnUnitT_tiEngOnMin_C "" VALUE 0x80268154 Val_Wu32 42949672950.0 Time_ms 0.00 42949672950.0 FORMAT "%13.1" /end CHARACTERISTIC
/begin CHARACTERISTIC PwrDistbnUnitT_tiPT1Fil_C "" VALUE 0x802669D0 Val_Ws32 4294.9672940000000 TimeDelay_s 0.0000020000000 4294.9672959999998 FORMAT "%19.14" EXTENDED_LIMITS 0.000002000000001 4294.9672959999998 /end CHARACTERISTIC
/begin CHARACTERISTIC PwrDistbnUnitT_tiPT1_f_C "" VALUE 0x80266A08 Val_Wr32 2.00000000E+037 RBPtCel_ti_1p0_2 -1.00000000E+037 1.00000000E+037 FORMAT "%13.3" EXTENDED_LIMITS -3.40282347E+038 3.40282347E+038 /end CHARACTERISTIC
/begin CHARACTERISTIC PwrDistbnUnitT_tiSRCMaxDefDeb_CUR "" CURVE 0x80266938 RB_Curve_S16_S32_sao 42949672950.0 Time_ms -21474836480.0 21474836470.0 FORMAT "%13.1"
 /begin AXIS_DESCR STD_AXIS PwrDistbnUnitT_tRefSnsr_mp Temp_Cels 25 -3549.940 3003.560 FORMAT "%8.3" DEPOSIT ABSOLUTE /end AXIS_DESCR
/end CHARACTERISTIC
/begin CHARACTERISTIC PwrDistbnUnitT_tiTempErrOk_C "" VALUE 0x80268158 Val_Ws16 655350.0 Time_ms -327680.0 327670.0 FORMAT "%8.1" /end CHARACTERISTIC
/begin CHARACTERISTIC PwrDistbnUnitT_tLoLimit_f_C "" VALUE 0x80266A0C Val_Wr32 2.00000000E+037 RBPtCel_t_1p0_3 -1.00000000E+037 1.00000000E+037 FORMAT "%13.3" EXTENDED_LIMITS -3.40282347E+038 3.40282347E+038 /end CHARACTERISTIC
/begin CHARACTERISTIC PwrDistbnUnitT_TransStg_f.Dfl_r32_C " / This is SW-CALPRM-PROTOTYPE" VALUE 0x80266A10 Kw_Wr32 2.00000000E+037 RBPtCel_t_1p0_3 -1.00000000E+037 1.00000000E+037 FORMAT "%13.3" EXTENDED_LIMITS -3.40282347E+038 3.40282347E+038 /end CHARACTERISTIC
/begin CHARACTERISTIC PwrDistbnUnitT_TransStg_f.stSensId_C " / This is SW-CALPRM-PROTOTYPE" VALUE 0x80266A14 Kw_Wu8 255.0 OneToOne 0.00 255.0 FORMAT "%5.1" /end CHARACTERISTIC
/begin CHARACTERISTIC PwrDistbnUnitT_tSnsrMax_f_C "" VALUE 0x8026815C Val_Wr32 2.00000000E+037 RBPtCel_t_1p0_3 -1.00000000E+037 1.00000000E+037 FORMAT "%13.3" EXTENDED_LIMITS -3.40282347E+038 3.40282347E+038 /end CHARACTERISTIC
/begin CHARACTERISTIC PwrDistbnUnitT_tSnsrMin_f_C "" VALUE 0x80268160 Val_Wr32 2.00000000E+037 RBPtCel_t_1p0_3 -1.00000000E+037 1.00000000E+037 FORMAT "%13.3" EXTENDED_LIMITS -3.40282347E+038 3.40282347E+038 /end CHARACTERISTIC
/begin CHARACTERISTIC rba_EcuCtrl_MaxClientTO_C "" VALUE 0x8024E70C Val_Wu32 172800.000000 Time_s 0.00 172800.000000 FORMAT "%13.6" EXTENDED_LIMITS 0.00 42949672.9500 /end CHARACTERISTIC
/begin CHARACTERISTIC rba_EcuCtrl_MaxShortenTime_C "" VALUE 0x8024E710 Val_Wu32 172800.000000 Time_s 0.00 172800.000000 FORMAT "%13.6" EXTENDED_LIMITS 0.00 42949672.9500 /end CHARACTERISTIC
/begin CHARACTERISTIC rba_EcuCtrl_MaxShutDownTO_C "" VALUE 0x8024E714 Val_Wu32 172800.000000 Time_s 0.00 172800.000000 FORMAT "%13.6" EXTENDED_LIMITS 0.00 42949672.9500 /end CHARACTERISTIC
/begin CHARACTERISTIC rba_SvbbEtk_DisableProcExec_KWB "" VAL_BLK 0xB92E008A ValA_Wu8 255.0 OneToOne 0.00 255.0 FORMAT "%5.1" MATRIX_DIM 15 MAX_REFRESH 3 200 /end CHARACTERISTIC
/begin CHARACTERISTIC rba_SvbbEtk_ResIdSrvPt_KWB "" VAL_BLK 0xB92E0028 ValA_Wu16 14.0000000000 rba_SvbbEtk_SpName 0.00 14.0000000000 FORMAT "%13.10" MATRIX_DIM 14 MAX_REFRESH 3 200 /end CHARACTERISTIC
/begin CHARACTERISTIC rba_SvbbEtk_SrvPtEnabled_KWB "" VAL_BLK 0xB92E007C ValA_Wu8 255.0 OneToOne 0.00 255.0 FORMAT "%5.1" MATRIX_DIM 14 MAX_REFRESH 3 200 /end CHARACTERISTIC
/begin CHARACTERISTIC rba_SvbbEtk_SrvPtResId_KWB "" VAL_BLK 0xB92E0099 ValA_Wu8 255.0 OneToOne 0.00 255.0 FORMAT "%5.1" MATRIX_DIM 15 MAX_REFRESH 3 200 /end CHARACTERISTIC
/begin CHARACTERISTIC rba_SvbbEtk_TimeOutPost_KWB "" VAL_BLK 0xB92E0060 ValA_Wu16 500.0000 rba_Svbb_Time_us 0.00 500.0000 FORMAT "%8.4" EXTENDED_LIMITS 0.00 655.3500 MATRIX_DIM 14 MAX_REFRESH 3 200 /end CHARACTERISTIC
/begin CHARACTERISTIC rba_SvbbEtk_TimeOutPre_KWB "" VAL_BLK 0xB92E0044 ValA_Wu16 500.0000 rba_Svbb_Time_us 0.00 500.0000 FORMAT "%8.4" EXTENDED_LIMITS 0.00 655.3500 MATRIX_DIM 14 MAX_REFRESH 3 200 /end CHARACTERISTIC
/begin CHARACTERISTIC RefgntCirc_facPRefgntCoeff0_C "offset value for calculation of evaporator temperature based on pressure value" VALUE 0x802513F4 RB_Val_Wr32 2.000000000000E+037 q1 -1.000000000000E+037 1.000000000000E+037 FORMAT "%15.12" EXTENDED_LIMITS -3.402823466385E+038 3.402823466385E+038 /end CHARACTERISTIC
/begin CHARACTERISTIC RefgntCirc_facPRefgntCoeff1_C "linear term value for calculation of evaporator temperature based on pressure value" VALUE 0x802513F8 RB_Val_Wr32 2.000000000000E+037 q1 -1.000000000000E+037 1.000000000000E+037 FORMAT "%15.12" EXTENDED_LIMITS -3.402823466385E+038 3.402823466385E+038 /end CHARACTERISTIC
/begin CHARACTERISTIC RefgntCirc_facPRefgntCoeff2_C "quadratic term value for calculation of evaporator temperature based on pressure value" VALUE 0x802513FC RB_Val_Wr32 2.000000000000E+037 q1 -1.000000000000E+037 1.000000000000E+037 FORMAT "%15.12" EXTENDED_LIMITS -3.402823466385E+038 3.402823466385E+038 /end CHARACTERISTIC
/begin CHARACTERISTIC RefgntCirc_pRefgntDft_C "Default value in case of any error in the equation" VALUE 0x80251400 RB_Val_Ws16 131070.0 PresAC_hPa -65536.00 65534.00 FORMAT "%8.2" /end CHARACTERISTIC
/begin CHARACTERISTIC RefgntCirc_stCmprShtOffMask_C "compressor shut off mask" VALUE 0x80251402 RB_Val_Wu16 65535.00 q1 0.00 65535.00 FORMAT "%8.2" /end CHARACTERISTIC
/begin CHARACTERISTIC RefgntCirc_tiVlvCycCls_C "time for cyclic valve activation" VALUE 0x80251404 RB_Val_Wu16 655.3500 q0p01_s 0.00 655.3500 FORMAT "%8.4" /end CHARACTERISTIC
/begin CHARACTERISTIC RefgntCirc_tiVlvCycRels_C "time between cyclic valve activation" VALUE 0x80251406 RB_Val_Wu16 655.3500 q0p01_s 0.00 655.3500 FORMAT "%8.4" /end CHARACTERISTIC
/begin CHARACTERISTIC SCtPmp1_ActrPwrStgDrvr_Cal.swtConf_C "e_:Calibration Parameter Structure for Linear Governor limitation Feature:_e;d_:Applikationsstruktur für das lineare Reglerbegrenzungsfeature:_d / e_:Minimum allowable motor torque/ motor torque threshold in downward direction to activate ramping:_e;d_:Minimales erlaubtes Motormoment in Richtung unten um Rampe zu aktivieren:_d" VALUE 0x80251408 Val_Wu8 255.0 OneToOne 0.00 255.0 FORMAT "%5.1" /end CHARACTERISTIC
/begin CHARACTERISTIC SCtPmp1_ActrPwrStgDrvr_Cal.stMOCSOPChk_C "e_:Calibration Parameter Structure for Linear Governor limitation Feature:_e;d_:Applikationsstruktur für das lineare Reglerbegrenzungsfeature:_d / e_:Minimum upper motor torque:_e;d_:Minimum des oberen Motordrehmoments:_d" VALUE 0x80251409 Val_Wu8 255.0 OneToOne 0.00 255.0 FORMAT "%5.1" /end CHARACTERISTIC
/begin CHARACTERISTIC SCtPmp1_ActrPwrStgDrvr_Cal.swtPSDis_C "e_:Calibration Parameter Structure for Linear Governor limitation Feature:_e;d_:Applikationsstruktur für das lineare Reglerbegrenzungsfeature:_d / e_:Minimum motor initial torque:_e;d_:Minimum des initialen Motormoments:_d" VALUE 0x8025140A Val_Wu16 65535.00 OneToOne 0.00 65535.00 FORMAT "%8.2" /end CHARACTERISTIC
/begin CHARACTERISTIC SCtPmp1_DevDrvrOutpDutyCycRampCal.swtConf_C " / e_:Configuration switch to activate Linear governor limitation:_e;d_:Konfigurationsschalter zum Aktivieren der Linearen Reglerbegrenzung:_d" VALUE 0x8025140C RB_Val_Wu8 7.000 OneToOne 0.00 7.000 FORMAT "%5.3" EXTENDED_LIMITS 0.00 255.0 /end CHARACTERISTIC
/begin CHARACTERISTIC SCtPmp1_DiagGrdKeyCal.swtDGK_C " / DGK main switch" VALUE 0x80268858 Val_Wu8 255.0 OneToOne 0.00 255.0 FORMAT "%5.1" /end CHARACTERISTIC
/begin CHARACTERISTIC SCtPmp1_DiagGrdKeyCal.tiDGKErrDebDef_C " / Debounce time to defect for DFC_PrfXXXDiagGrdKeyErrBXXX" VALUE 0x8026885C Val_Wu32 42949672950.0 Time_ms 0.00 42949672950.0 FORMAT "%13.1" /end CHARACTERISTIC
/begin CHARACTERISTIC SCtPmp1_DiagGrdKeyCal.tiDGKErrDebOK_C " / Debounce time to ok (healing) for DFC_PrfXXXDiagGrdKeyErrBXXX" VALUE 0x80268860 Val_Wu32 42949672950.0 Time_ms 0.00 42949672950.0 FORMAT "%13.1" /end CHARACTERISTIC
/begin CHARACTERISTIC SCtPmp1_DiagGrdKeyCal.tiAlvErrDly_C " / delay time for alive error" VALUE 0x80268864 Val_Ws16 655.3500 Time_s -327.6800 327.6700 FORMAT "%8.4" /end CHARACTERISTIC
/begin CHARACTERISTIC SCtPmp1_DiagGrdKeyWinCal1.tiSCGMin_C " / Minimum SCG time to detect DGK window" VALUE 0x80268868 Val_Ws16 655350.0 Time_ms -327680.0 327670.0 FORMAT "%8.1" /end CHARACTERISTIC
/begin CHARACTERISTIC SCtPmp1_DiagGrdKeyWinCal1.tiSCGMax_C " / Maximum SCG time to detect DGK window" VALUE 0x8026886A Val_Ws16 655350.0 Time_ms -327680.0 327670.0 FORMAT "%8.1" /end CHARACTERISTIC
/begin CHARACTERISTIC SCtPmp1_DiagGrdKeyWinCal1.tiPausPatMin_C " / Minimum Pause time to detect DGK window" VALUE 0x8026886C Val_Ws32 42949672950.0 Time_ms -21474836480.0 21474836470.0 FORMAT "%13.1" /end CHARACTERISTIC
/begin CHARACTERISTIC SCtPmp1_DiagGrdKeyWinCal1.tiPausPatMax_C " / Maximum Pause time to detect DGK window" VALUE 0x80268870 Val_Ws32 42949672950.0 Time_ms -21474836480.0 21474836470.0 FORMAT "%13.1" /end CHARACTERISTIC
/begin CHARACTERISTIC SCtPmp1_DiagGrdKeyWinCal2.tiSCGMin_C " / Minimum SCG time to detect DGK window" VALUE 0x80268874 Val_Ws16 655350.0 Time_ms -327680.0 327670.0 FORMAT "%8.1" /end CHARACTERISTIC
/begin CHARACTERISTIC SCtPmp1_DiagGrdKeyWinCal2.tiSCGMax_C " / Maximum SCG time to detect DGK window" VALUE 0x80268876 Val_Ws16 655350.0 Time_ms -327680.0 327670.0 FORMAT "%8.1" /end CHARACTERISTIC
/begin CHARACTERISTIC SCtPmp1_DiagGrdKeyWinCal2.tiPausPatMin_C " / Minimum Pause time to detect DGK window" VALUE 0x80268878 Val_Ws32 42949672950.0 Time_ms -21474836480.0 21474836470.0 FORMAT "%13.1" /end CHARACTERISTIC
/begin CHARACTERISTIC SCtPmp1_DiagGrdKeyWinCal2.tiPausPatMax_C " / Maximum Pause time to detect DGK window" VALUE 0x8026887C Val_Ws32 42949672950.0 Time_ms -21474836480.0 21474836470.0 FORMAT "%13.1" /end CHARACTERISTIC
/begin CHARACTERISTIC SCtPmp1_DiagGrdKeyWinCal3.tiSCGMin_C " / Minimum SCG time to detect DGK window" VALUE 0x80268880 Val_Ws16 655350.0 Time_ms -327680.0 327670.0 FORMAT "%8.1" /end CHARACTERISTIC
/begin CHARACTERISTIC SCtPmp1_DiagGrdKeyWinCal3.tiSCGMax_C " / Maximum SCG time to detect DGK window" VALUE 0x80268882 Val_Ws16 655350.0 Time_ms -327680.0 327670.0 FORMAT "%8.1" /end CHARACTERISTIC
/begin CHARACTERISTIC SCtPmp1_DiagGrdKeyWinCal3.tiPausPatMin_C " / Minimum Pause time to detect DGK window" VALUE 0x80268884 Val_Ws32 42949672950.0 Time_ms -21474836480.0 21474836470.0 FORMAT "%13.1" /end CHARACTERISTIC
/begin CHARACTERISTIC SCtPmp1_DiagGrdKeyWinCal3.tiPausPatMax_C " / Maximum Pause time to detect DGK window" VALUE 0x80268888 Val_Ws32 42949672950.0 Time_ms -21474836480.0 21474836470.0 FORMAT "%13.1" /end CHARACTERISTIC
/begin CHARACTERISTIC SCtPmp1_DiagGrdKeyWinCal4.tiSCGMin_C " / Minimum SCG time to detect DGK window" VALUE 0x8026888C Val_Ws16 655350.0 Time_ms -327680.0 327670.0 FORMAT "%8.1" /end CHARACTERISTIC
/begin CHARACTERISTIC SCtPmp1_DiagGrdKeyWinCal4.tiSCGMax_C " / Maximum SCG time to detect DGK window" VALUE 0x8026888E Val_Ws16 655350.0 Time_ms -327680.0 327670.0 FORMAT "%8.1" /end CHARACTERISTIC
/begin CHARACTERISTIC SCtPmp1_DiagGrdKeyWinCal4.tiPausPatMin_C " / Minimum Pause time to detect DGK window" VALUE 0x80268890 Val_Ws32 42949672950.0 Time_ms -21474836480.0 21474836470.0 FORMAT "%13.1" /end CHARACTERISTIC
/begin CHARACTERISTIC SCtPmp1_DiagGrdKeyWinCal4.tiPausPatMax_C " / Maximum Pause time to detect DGK window" VALUE 0x80268894 Val_Ws32 42949672950.0 Time_ms -21474836480.0 21474836470.0 FORMAT "%13.1" /end CHARACTERISTIC
/begin CHARACTERISTIC SCtPmp1_DiagGrdKeyWinCal5.tiSCGMin_C " / Minimum SCG time to detect DGK window" VALUE 0x80268898 Val_Ws16 655350.0 Time_ms -327680.0 327670.0 FORMAT "%8.1" /end CHARACTERISTIC
/begin CHARACTERISTIC SCtPmp1_DiagGrdKeyWinCal5.tiSCGMax_C " / Maximum SCG time to detect DGK window" VALUE 0x8026889A Val_Ws16 655350.0 Time_ms -327680.0 327670.0 FORMAT "%8.1" /end CHARACTERISTIC
/begin CHARACTERISTIC SCtPmp1_DiagGrdKeyWinCal5.tiPausPatMin_C " / Minimum Pause time to detect DGK window" VALUE 0x8026889C Val_Ws32 42949672950.0 Time_ms -21474836480.0 21474836470.0 FORMAT "%13.1" /end CHARACTERISTIC
/begin CHARACTERISTIC SCtPmp1_DiagGrdKeyWinCal5.tiPausPatMax_C " / Maximum Pause time to detect DGK window" VALUE 0x802688A0 Val_Ws32 42949672950.0 Time_ms -21474836480.0 21474836470.0 FORMAT "%13.1" /end CHARACTERISTIC
/begin CHARACTERISTIC SCtPmp1_frqPs_CUR "" CURVE 0x80268224 RB_Curve_S16_S16 6553.500 TVAVSADIA_FRQ -3276.800 3276.700 FORMAT "%8.3"
 /begin AXIS_DESCR STD_AXIS SCtPmp1_tEngDaFrqPs_mp Temp_Cels 25 -3549.940 3003.560 FORMAT "%8.3" DEPOSIT ABSOLUTE /end AXIS_DESCR
/end CHARACTERISTIC
/begin CHARACTERISTIC SCtPmp1_numStdActr_C "" VALUE 0x802688A4 Val_Wu32 4294967295.00 OneToOne 0.00 4294967295.00 FORMAT "%13.2" /end CHARACTERISTIC
/begin CHARACTERISTIC SCtPmp1_psDiagPwmOut.nrTstPls_C " / Maximum number of test impulses possible in one driving cycle." VALUE 0x802688A8 Kw_Wu32 4294967295.00 OneToOne 0.00 4294967295.00 FORMAT "%13.2" /end CHARACTERISTIC
/begin CHARACTERISTIC SCtPmp1_psDiagPwmOut.tiBtwElecFlt_C " / Time between test in case a short circuit or open load is detected." VALUE 0x802688AC Kw_Ws16 655350.0 Time_ms -327680.0 327670.0 FORMAT "%8.1" /end CHARACTERISTIC
/begin CHARACTERISTIC SCtPmp1_psDiagPwmOut.tiBtwOTFlt_C " / Time between test when an over temperature error is detected." VALUE 0x802688AE Kw_Ws16 655.3500 Time_s -327.6800 327.6700 FORMAT "%8.4" /end CHARACTERISTIC
/begin CHARACTERISTIC SCtPmp1_Pwm.tiPer_C " / Reference value for period duration (small type to limit dynamic range)" VALUE 0x80268164 Kw_Ws16 65535.00 OneToOne -32768.00 32767.00 FORMAT "%8.2" /end CHARACTERISTIC
/begin CHARACTERISTIC SCtPmp1_Pwm.stLvl_C " / Reference value for phase relationship in period units" VALUE 0x80268166 Kw_Wu8 255.0 OneToOne 0.00 255.0 FORMAT "%5.1" /end CHARACTERISTIC
/begin CHARACTERISTIC SCtPmp1_Pwm.rMaxDty_C " / Reference value for maximum duty cycle" VALUE 0x80268168 Kw_Ws16 655.3500 DtyCyc -327.6800 327.6700 FORMAT "%8.4" /end CHARACTERISTIC
/begin CHARACTERISTIC SCtPmp1_Pwm.rPerUn_C " / us per Pwmout_tiPeriod unit (1==us, 1000=ms)" VALUE 0x8026816A Kw_Ws16 65535.00 TimeDT -32768.00 32767.00 FORMAT "%8.2" /end CHARACTERISTIC
/begin CHARACTERISTIC SCtPmp1_Pwm.tiPh_C " / Phase shift for the PWM signal" VALUE 0x8026816C Kw_Ws16 65535.00 OneToOne -32768.00 32767.00 FORMAT "%8.2" /end CHARACTERISTIC
/begin CHARACTERISTIC SCtPmp1_PwmOutCal.rMin_C " / Lower threshold to limit the duty cycle output" VALUE 0x802688B0 Val_Ws16 655.3500 DtyCyc -327.6800 327.6700 FORMAT "%8.4" /end CHARACTERISTIC
/begin CHARACTERISTIC SCtPmp1_PwmOutCal.rMax_C " / Upper threshold to limit the duty cycle output" VALUE 0x802688B2 Val_Ws16 655.3500 DtyCyc -327.6800 327.6700 FORMAT "%8.4" /end CHARACTERISTIC
/begin CHARACTERISTIC SCtPmp1_PwmOutCal.swtBattCor_C " / Battery voltage correction for the output duty cycle active" VALUE 0x802688B4 Val_Wu8 255.0 OneToOne 0.00 255.0 FORMAT "%5.1" /end CHARACTERISTIC
/begin CHARACTERISTIC SCtPmp1_ratActLin_CUR "" CURVE 0x802687E4 RB_Curve_S16_S16 511.9922 rel_q0p0078125 -256.0000 255.9922 FORMAT "%8.4"
 /begin AXIS_DESCR STD_AXIS SCtPmp1_rAct Prc 25 -400.0000 399.9878 FORMAT "%8.4" DEPOSIT ABSOLUTE /end AXIS_DESCR
/end CHARACTERISTIC
/begin CHARACTERISTIC SCtPmp1_rCnv_MAP "" MAP 0x8026828A RB_Map_S16S16_S16 655.3500 DtyCyc -327.6800 327.6700 FORMAT "%8.4"
 /begin AXIS_DESCR STD_AXIS SCtPmp1_rActr Prc 25 -400.0000 399.9878 FORMAT "%8.4" DEPOSIT ABSOLUTE /end AXIS_DESCR
 /begin AXIS_DESCR STD_AXIS EnvP_p Pres_hPa 25 -32768.00 32767.00 FORMAT "%8.2" DEPOSIT ABSOLUTE /end AXIS_DESCR
/end CHARACTERISTIC
/begin CHARACTERISTIC SCtPmp1_rDesActrATS_CUR "" CURVE 0x8025140E RB_Curve_S16_S16 799.9878 Prc -400.0000 399.9878 FORMAT "%8.4"
 /begin AXIS_DESCR STD_AXIS SCtPmp1_rDesValATS Prc 25 -400.0000 399.9878 FORMAT "%8.4" DEPOSIT ABSOLUTE /end AXIS_DESCR
/end CHARACTERISTIC
/begin CHARACTERISTIC SCtPmp1_rDesActr_CUR "" CURVE 0x80268170 RB_Curve_S16_S16 799.9878 Prc -400.0000 399.9878 FORMAT "%8.4"
 /begin AXIS_DESCR STD_AXIS SCtPmp1_r Prc 25 -400.0000 399.9878 FORMAT "%8.4" DEPOSIT ABSOLUTE /end AXIS_DESCR
/end CHARACTERISTIC
/begin CHARACTERISTIC SCtPmp1_StdActrRmpSlp.Pos_C " / Slope if the ramp has to be increased" VALUE 0x8026884C Kw_Ws32 399999.999814 RmpPrc 0.00 399999.999814 FORMAT "%13.6" EXTENDED_LIMITS -400000.000000 399999.999814 /end CHARACTERISTIC
/begin CHARACTERISTIC SCtPmp1_StdActrRmpSlp.Neg_C " / negative ramp slope" VALUE 0x80268850 Kw_Ws32 799999.999814 RmpPrc -400000.000000 399999.999814 FORMAT "%13.6" /end CHARACTERISTIC
/begin CHARACTERISTIC SCtPmp1_StdActrTransStg.Dfl_C " / Fixed replacement value" VALUE 0x80268854 Kw_Ws16 799.9878 Prc -400.0000 399.9878 FORMAT "%8.4" /end CHARACTERISTIC
/begin CHARACTERISTIC SCtPmp1_StdActrTransStg.stSensId_C " / Sensor Id word" VALUE 0x80268856 Kw_Wu8 255.0 OneToOne 0.00 255.0 FORMAT "%5.1" /end CHARACTERISTIC
/begin CHARACTERISTIC SCtPmp1_StdCal.tiDesValFlt_C " / PT1 Filter time constant for setpoint to calculate simulated feedback" VALUE 0x802681D8 Val_Ws32 4294.9672940000000 TimeDelay_s 0.0000020000000 4294.9672959999998 FORMAT "%19.14" EXTENDED_LIMITS 0.000002000000001 4294.9672959999998 /end CHARACTERISTIC
/begin CHARACTERISTIC SCtPmp1_StdCal.rPsOff_C " / Dutycycle value for actuator switch off" VALUE 0x802681DC Val_Ws16 655.3500 DtyCyc -327.6800 327.6700 FORMAT "%8.4" /end CHARACTERISTIC
/begin CHARACTERISTIC SCtPmp1_StdCal.rActrStop_C " / Actuator shut off PWM duty cycle" VALUE 0x802681DE Val_Ws16 655.3500 DtyCyc -327.6800 327.6700 FORMAT "%8.4" /end CHARACTERISTIC
/begin CHARACTERISTIC SCtPmp1_StdCal.rHysHigh_C " / e_:upper hysteresis threshold:_e;d_:Obere Hystereseschwelle:_d" VALUE 0x802681E0 Val_Ws16 655.3500 DtyCyc -327.6800 327.6700 FORMAT "%8.4" /end CHARACTERISTIC
/begin CHARACTERISTIC SCtPmp1_StdCal.rHysLow_C " / e_:lower hysteresis threshold:_e;d_:Untere Hystereseschwelle:_d" VALUE 0x802681E2 Val_Ws16 655.3500 DtyCyc -327.6800 327.6700 FORMAT "%8.4" /end CHARACTERISTIC
/begin CHARACTERISTIC SCtPmp1_StdCal.stPwrStgDiaDis_C " / Mask to disable powerstage diagnosis" VALUE 0x802681E4 Val_Wu16 65535.00 OneToOne 0.00 65535.00 FORMAT "%8.2" /end CHARACTERISTIC
/begin CHARACTERISTIC SCtPmp1_StdCal.stPlausDiaDis_C " / e_:Mask to disable plausibility diagnosis:_e;d_:Maske zur Deaktivierung der Plausibilitätsdiagnose:_d" VALUE 0x802681E6 Val_Wu16 65535.00 OneToOne 0.00 65535.00 FORMAT "%8.2" /end CHARACTERISTIC
/begin CHARACTERISTIC SCtPmp1_StdCal.stPwrStgDis_C " / Mask to disable powerstage actuation under different conditions" VALUE 0x802681E8 Val_Wu16 65535.00 OneToOne 0.00 65535.00 FORMAT "%8.2" /end CHARACTERISTIC
/begin CHARACTERISTIC SCtPmp1_StdCal.stActrStop_C " / Bitcoded value of the states where actuator switchoff signal should be sent" VALUE 0x802681EA Val_Wu16 65535.00 OneToOne 0.00 65535.00 FORMAT "%8.2" /end CHARACTERISTIC
/begin CHARACTERISTIC SCtPmp1_StdCal.stAllPwrStgDiaEna_C " / Switch configuration for power stage diagnosis for digital actuators" VALUE 0x802681EC Val_Wu8 255.0 OneToOne 0.00 255.0 FORMAT "%5.1" /end CHARACTERISTIC
/begin CHARACTERISTIC SCtPmp1_StdCal.swtDesVal_C " / Switch to select default setpoint" VALUE 0x802681ED Val_Wu8 255.0 OneToOne 0.00 255.0 FORMAT "%5.1" /end CHARACTERISTIC
/begin CHARACTERISTIC SCtPmp1_StdCal.numDiagTry_C " / Counter to limit the number of active diagnosis" VALUE 0x802681EE Val_Wu8 255.0 OneToOne 0.00 255.0 FORMAT "%5.1" /end CHARACTERISTIC
/begin CHARACTERISTIC SCtPmp1_StdCal.rDesValOff_C " / Default desired value in case of power stage errors" VALUE 0x802681F0 Val_Ws16 799.9878 Prc -400.0000 399.9878 FORMAT "%8.4" /end CHARACTERISTIC
/begin CHARACTERISTIC SCtPmp1_StdCal.rDesValOn_C " / Default desired value for On position" VALUE 0x802681F2 Val_Ws16 799.9878 Prc -400.0000 399.9878 FORMAT "%8.4" /end CHARACTERISTIC
/begin CHARACTERISTIC SCtPmp1_StdCal.numEngDaFrqPs_C " / variable frequency option in PWM signals" VALUE 0x802681F4 Val_Wu16 255.000000000 DELIB_ALLTEMP_VERB_COMPU 0.00 255.000000000 FORMAT "%13.9" /end CHARACTERISTIC
/begin CHARACTERISTIC SCtPmp1_StdCal.tiSlwRespSimPT1_C " / PT1 Filter time constant for slow response simulation" VALUE 0x802681F8 Val_Ws32 4294.9672940000000 TimeDelay_s 0.0000020000000 4294.9672959999998 FORMAT "%19.14" EXTENDED_LIMITS 0.000002000000001 4294.9672959999998 /end CHARACTERISTIC
/begin CHARACTERISTIC SCtPmp1_StdCal.uHiBattThd_C " / Upper hysteresis threshold for BattU_u" VALUE 0x802681FC Val_Ws16 1310700. Volt_Batt -655360.0 655340.0 FORMAT "%8.1" /end CHARACTERISTIC
/begin CHARACTERISTIC SCtPmp1_StdCal.uLoBattThd_C " / Lower hysteresis threshold for BattU_u" VALUE 0x802681FE Val_Ws16 1310700. Volt_Batt -655360.0 655340.0 FORMAT "%8.1" /end CHARACTERISTIC
/begin CHARACTERISTIC SCtPmp1_StdCal.tiDebBattVoltOk_C " / Healing time of defected battery voltage" VALUE 0x80268200 Val_Ws16 655350.0 Time_ms -327680.0 327670.0 FORMAT "%8.1" /end CHARACTERISTIC
/begin CHARACTERISTIC SCtPmp1_StdCal.tiDebBattVoltDfct_C " / Debounce time to sense Battery voltage Defect" VALUE 0x80268202 Val_Ws16 655350.0 Time_ms -327680.0 327670.0 FORMAT "%8.1" /end CHARACTERISTIC
/begin CHARACTERISTIC SCtPmp1_StdCal.mskActrActv_C " / Bitmask to choose in which engine states the actuator is activated" VALUE 0x80268204 Val_Wu8 255.0 OneToOne 0.00 255.0 FORMAT "%5.1" /end CHARACTERISTIC
/begin CHARACTERISTIC SCtPmp1_StdCal.tiDlyActrActvn_C " / Delay for actuator activation" VALUE 0x80268206 Val_Wu16 6553.500 TiSec_q0p1_COMPU 0.00 6553.500 FORMAT "%8.3" /end CHARACTERISTIC
/begin CHARACTERISTIC SCtPmp1_StdCal.rPsActrOff_C " / Replacement value for powerstage dutycycle when actuator is not activated" VALUE 0x80268208 Val_Ws16 655.3500 DtyCyc -327.6800 327.6700 FORMAT "%8.4" /end CHARACTERISTIC
/begin CHARACTERISTIC SCtPmp1_StdCal.uBattMin_C " / Minimum value of battery voltage to enable Clean and Verify" VALUE 0x8026820A Val_Ws16 1310700. Volt_Batt -655360.0 655340.0 FORMAT "%8.1" /end CHARACTERISTIC
/begin CHARACTERISTIC SCtPmp1_StdCal.uBattMax_C " / Maximum value of battery voltage to enable zero point adaption" VALUE 0x8026820C Val_Ws16 1310700. Volt_Batt -655360.0 655340.0 FORMAT "%8.1" /end CHARACTERISTIC
/begin CHARACTERISTIC SCtPmp1_StdCal.tiShOffCtrlDne_C " / Delay for deactivation of the actuator when shut off is done" VALUE 0x8026820E Val_Ws16 655350.0 Time_ms -327680.0 327670.0 FORMAT "%8.1" /end CHARACTERISTIC
/begin CHARACTERISTIC SCtPmp1_StdCal.swtDeactvn_C " / bitmask to deactivate the actuator by calibration" VALUE 0x80268210 Val_Wu8 255.0 OneToOne 0.00 255.0 FORMAT "%5.1" /end CHARACTERISTIC
/begin CHARACTERISTIC SCtPmp1_StdCal.tiSelfDiagStrt_C " / Delay time to start the self diagnosis of the powertstage once the engine state has reached the required state." VALUE 0x80268212 Val_Ws16 655350.0 Time_ms -327680.0 327670.0 FORMAT "%8.1" /end CHARACTERISTIC
/begin CHARACTERISTIC SCtPmp1_StdCal.flgReacvnPostDrv_C " / e_:Reactivation of actuator at transition into POSTDRIVE.:_e;d_:Reaktivierung des Stellers beim Ã?bergang in den POSTDRIVE.:_d" VALUE 0x80268214 Val_Wu8 255.0 OneToOne 0.00 255.0 FORMAT "%5.1" /end CHARACTERISTIC
/begin CHARACTERISTIC SCtPmp1_StdCal.rPsRlyOff_C " / e_:Calibration to indicate the switch-off dutycycle:_e;d_:Kalibrierung zur Anzeige des Ausschaltzyklus:_d" VALUE 0x80268216 Val_Ws16 655.3500 DtyCyc -327.6800 327.6700 FORMAT "%8.4" /end CHARACTERISTIC
/begin CHARACTERISTIC SCtPmp1_StdCal.tiRlyOnDly_C " / e_:Calibration to delay the enabling of powerstage:_e;d_:Kalibrierung, um die Aktivierung der Endstufe zu verzögern:_d" VALUE 0x80268218 Val_Ws16 33.55392 RBPtCel_ti_5p12em4_1 -16.77722 16.77670 FORMAT "%8.5" /end CHARACTERISTIC
/begin CHARACTERISTIC SCtPmp1_StdCal.nFMInWinMsk_C " / e_:Calibration mask to select the proper window representing the actuator jammed error:_e;d_:Maske für die Auswahl des Frequenzfensters für das blockierte Ventil:_d" VALUE 0x8026821C Val_Wu32 4294967295.00 OneToOne 0.00 4294967295.00 FORMAT "%13.2" /end CHARACTERISTIC
/begin CHARACTERISTIC SCtPmp1_StdCal.tiFMInDeb_C " / e_:Time for debouncing the frequency window::_e;d_:Zeit zum Entprellen des Frequenzfensters:_d" VALUE 0x80268220 Val_Wu8 2550. Time_ms 0.00 2550. FORMAT "%5.0" /end CHARACTERISTIC
/begin CHARACTERISTIC SCtPmp1_StdCal.tiJamActrWait_C " / e_:Time to start the jammed actuator debouncing after the preliminary error:_e;d_:Zeit zum Starten der Entprellung des blockierten Stellers nach dem vorläufigen Fehler:_d" VALUE 0x80268222 Val_Ws16 6553.500 t_q0p1 -3276.800 3276.700 FORMAT "%8.3" /end CHARACTERISTIC
/begin CHARACTERISTIC SCtPmp1_stMonDiagGrdKeyFailSafe_C "" VALUE 0x80251474 Val_Wu16 65535.00 OneToOne 0.00 65535.00 FORMAT "%8.2" /end CHARACTERISTIC
/begin CHARACTERISTIC SCtPmp1_swtBattCorSqd_C "" VALUE 0x802687D4 Val_Wu8 255.0 OneToOne 0.00 255.0 FORMAT "%5.1" /end CHARACTERISTIC
/begin CHARACTERISTIC SCtPmp1_swtConf2_C "" VALUE 0x802687D8 Val_Wu32 4294967295.00 OneToOne 0.00 4294967295.00 FORMAT "%13.2" /end CHARACTERISTIC
/begin CHARACTERISTIC SCtPmp1_swtConfStdActrSwVers162_C "" VALUE 0x802687DC Val_Wu32 4294967295.00 OneToOne 0.00 4294967295.00 FORMAT "%13.2" /end CHARACTERISTIC
/begin CHARACTERISTIC SCtPmp1_swtConf_C "" VALUE 0x802687E0 Val_Wu32 4294967295.00 OneToOne 0.00 4294967295.00 FORMAT "%13.2" /end CHARACTERISTIC
/begin CHARACTERISTIC SCtPmp1_swtPsDiag_C "" VALUE 0x802688B6 Val_Wu8 255.0 OneToOne 0.00 255.0 FORMAT "%5.1" /end CHARACTERISTIC
/begin CHARACTERISTIC SCtPmpRly_ActrPwrStgDrvr_Cal.swtConf_C "e_:Calibration Parameter Structure for Linear Governor limitation Feature:_e;d_:Applikationsstruktur für das lineare Reglerbegrenzungsfeature:_d / e_:Minimum allowable motor torque/ motor torque threshold in downward direction to activate ramping:_e;d_:Minimales erlaubtes Motormoment in Richtung unten um Rampe zu aktivieren:_d" VALUE 0x80251476 Val_Wu8 255.0 OneToOne 0.00 255.0 FORMAT "%5.1" /end CHARACTERISTIC
/begin CHARACTERISTIC SCtPmpRly_ActrPwrStgDrvr_Cal.stMOCSOPChk_C "e_:Calibration Parameter Structure for Linear Governor limitation Feature:_e;d_:Applikationsstruktur für das lineare Reglerbegrenzungsfeature:_d / e_:Minimum upper motor torque:_e;d_:Minimum des oberen Motordrehmoments:_d" VALUE 0x80251477 Val_Wu8 255.0 OneToOne 0.00 255.0 FORMAT "%5.1" /end CHARACTERISTIC
/begin CHARACTERISTIC SCtPmpRly_ActrPwrStgDrvr_Cal.swtPSDis_C "e_:Calibration Parameter Structure for Linear Governor limitation Feature:_e;d_:Applikationsstruktur für das lineare Reglerbegrenzungsfeature:_d / e_:Minimum motor initial torque:_e;d_:Minimum des initialen Motormoments:_d" VALUE 0x80251478 Val_Wu16 65535.00 OneToOne 0.00 65535.00 FORMAT "%8.2" /end CHARACTERISTIC
/begin CHARACTERISTIC SCtPmpRly_DevDrvrOutpDutyCycRampCal.swtConf_C " / e_:Configuration switch to activate Linear governor limitation:_e;d_:Konfigurationsschalter zum Aktivieren der Linearen Reglerbegrenzung:_d" VALUE 0x8025147A RB_Val_Wu8 7.000 OneToOne 0.00 7.000 FORMAT "%5.3" EXTENDED_LIMITS 0.00 255.0 /end CHARACTERISTIC
/begin CHARACTERISTIC SCtPmpRly_rCnv_MAP "" MAP 0x8026896C RB_Map_S16S16_S16 655.3500 DtyCyc -327.6800 327.6700 FORMAT "%8.4"
 /begin AXIS_DESCR STD_AXIS SCtPmpRly_rActr Prc 25 -400.0000 399.9878 FORMAT "%8.4" DEPOSIT ABSOLUTE /end AXIS_DESCR
 /begin AXIS_DESCR STD_AXIS EnvP_p Pres_hPa 25 -32768.00 32767.00 FORMAT "%8.2" DEPOSIT ABSOLUTE /end AXIS_DESCR
/end CHARACTERISTIC
/begin CHARACTERISTIC SCtPmpRly_rDesActr_CUR "" CURVE 0x802688B8 RB_Curve_S16_S16 799.9878 Prc -400.0000 399.9878 FORMAT "%8.4"
 /begin AXIS_DESCR STD_AXIS SCtPmpRly_r Prc 25 -400.0000 399.9878 FORMAT "%8.4" DEPOSIT ABSOLUTE /end AXIS_DESCR
/end CHARACTERISTIC
/begin CHARACTERISTIC SCtPmpRly_StdCal.tiDesValFlt_C " / PT1 Filter time constant for setpoint to calculate simulated feedback" VALUE 0x80268920 Val_Ws32 4294.9672940000000 TimeDelay_s 0.0000020000000 4294.9672959999998 FORMAT "%19.14" EXTENDED_LIMITS 0.000002000000001 4294.9672959999998 /end CHARACTERISTIC
/begin CHARACTERISTIC SCtPmpRly_StdCal.rPsOff_C " / Dutycycle value for actuator switch off" VALUE 0x80268924 Val_Ws16 655.3500 DtyCyc -327.6800 327.6700 FORMAT "%8.4" /end CHARACTERISTIC
/begin CHARACTERISTIC SCtPmpRly_StdCal.rActrStop_C " / Actuator shut off PWM duty cycle" VALUE 0x80268926 Val_Ws16 655.3500 DtyCyc -327.6800 327.6700 FORMAT "%8.4" /end CHARACTERISTIC
/begin CHARACTERISTIC SCtPmpRly_StdCal.rHysHigh_C " / e_:upper hysteresis threshold:_e;d_:Obere Hystereseschwelle:_d" VALUE 0x80268928 Val_Ws16 655.3500 DtyCyc -327.6800 327.6700 FORMAT "%8.4" /end CHARACTERISTIC
/begin CHARACTERISTIC SCtPmpRly_StdCal.rHysLow_C " / e_:lower hysteresis threshold:_e;d_:Untere Hystereseschwelle:_d" VALUE 0x8026892A Val_Ws16 655.3500 DtyCyc -327.6800 327.6700 FORMAT "%8.4" /end CHARACTERISTIC
/begin CHARACTERISTIC SCtPmpRly_StdCal.stPwrStgDiaDis_C " / Mask to disable powerstage diagnosis" VALUE 0x8026892C Val_Wu16 65535.00 OneToOne 0.00 65535.00 FORMAT "%8.2" /end CHARACTERISTIC
/begin CHARACTERISTIC SCtPmpRly_StdCal.stPlausDiaDis_C " / e_:Mask to disable plausibility diagnosis:_e;d_:Maske zur Deaktivierung der Plausibilitätsdiagnose:_d" VALUE 0x8026892E Val_Wu16 65535.00 OneToOne 0.00 65535.00 FORMAT "%8.2" /end CHARACTERISTIC
/begin CHARACTERISTIC SCtPmpRly_StdCal.stPwrStgDis_C " / Mask to disable powerstage actuation under different conditions" VALUE 0x80268930 Val_Wu16 65535.00 OneToOne 0.00 65535.00 FORMAT "%8.2" /end CHARACTERISTIC
/begin CHARACTERISTIC SCtPmpRly_StdCal.stActrStop_C " / Bitcoded value of the states where actuator switchoff signal should be sent" VALUE 0x80268932 Val_Wu16 65535.00 OneToOne 0.00 65535.00 FORMAT "%8.2" /end CHARACTERISTIC
/begin CHARACTERISTIC SCtPmpRly_StdCal.stAllPwrStgDiaEna_C " / Switch configuration for power stage diagnosis for digital actuators" VALUE 0x80268934 Val_Wu8 255.0 OneToOne 0.00 255.0 FORMAT "%5.1" /end CHARACTERISTIC
/begin CHARACTERISTIC SCtPmpRly_StdCal.swtDesVal_C " / Switch to select default setpoint" VALUE 0x80268935 Val_Wu8 255.0 OneToOne 0.00 255.0 FORMAT "%5.1" /end CHARACTERISTIC
/begin CHARACTERISTIC SCtPmpRly_StdCal.numDiagTry_C " / Counter to limit the number of active diagnosis" VALUE 0x80268936 Val_Wu8 255.0 OneToOne 0.00 255.0 FORMAT "%5.1" /end CHARACTERISTIC
/begin CHARACTERISTIC SCtPmpRly_StdCal.rDesValOff_C " / Default desired value in case of power stage errors" VALUE 0x80268938 Val_Ws16 799.9878 Prc -400.0000 399.9878 FORMAT "%8.4" /end CHARACTERISTIC
/begin CHARACTERISTIC SCtPmpRly_StdCal.rDesValOn_C " / Default desired value for On position" VALUE 0x8026893A Val_Ws16 799.9878 Prc -400.0000 399.9878 FORMAT "%8.4" /end CHARACTERISTIC
/begin CHARACTERISTIC SCtPmpRly_StdCal.numEngDaFrqPs_C " / variable frequency option in PWM signals" VALUE 0x8026893C Val_Wu16 255.000000000 DELIB_ALLTEMP_VERB_COMPU 0.00 255.000000000 FORMAT "%13.9" /end CHARACTERISTIC
/begin CHARACTERISTIC SCtPmpRly_StdCal.tiSlwRespSimPT1_C " / PT1 Filter time constant for slow response simulation" VALUE 0x80268940 Val_Ws32 4294.9672940000000 TimeDelay_s 0.0000020000000 4294.9672959999998 FORMAT "%19.14" EXTENDED_LIMITS 0.000002000000001 4294.9672959999998 /end CHARACTERISTIC
/begin CHARACTERISTIC SCtPmpRly_StdCal.uHiBattThd_C " / Upper hysteresis threshold for BattU_u" VALUE 0x80268944 Val_Ws16 1310700. Volt_Batt -655360.0 655340.0 FORMAT "%8.1" /end CHARACTERISTIC
/begin CHARACTERISTIC SCtPmpRly_StdCal.uLoBattThd_C " / Lower hysteresis threshold for BattU_u" VALUE 0x80268946 Val_Ws16 1310700. Volt_Batt -655360.0 655340.0 FORMAT "%8.1" /end CHARACTERISTIC
/begin CHARACTERISTIC SCtPmpRly_StdCal.tiDebBattVoltOk_C " / Healing time of defected battery voltage" VALUE 0x80268948 Val_Ws16 655350.0 Time_ms -327680.0 327670.0 FORMAT "%8.1" /end CHARACTERISTIC
/begin CHARACTERISTIC SCtPmpRly_StdCal.tiDebBattVoltDfct_C " / Debounce time to sense Battery voltage Defect" VALUE 0x8026894A Val_Ws16 655350.0 Time_ms -327680.0 327670.0 FORMAT "%8.1" /end CHARACTERISTIC
/begin CHARACTERISTIC SCtPmpRly_StdCal.mskActrActv_C " / Bitmask to choose in which engine states the actuator is activated" VALUE 0x8026894C Val_Wu8 255.0 OneToOne 0.00 255.0 FORMAT "%5.1" /end CHARACTERISTIC
/begin CHARACTERISTIC SCtPmpRly_StdCal.tiDlyActrActvn_C " / Delay for actuator activation" VALUE 0x8026894E Val_Wu16 6553.500 TiSec_q0p1_COMPU 0.00 6553.500 FORMAT "%8.3" /end CHARACTERISTIC
/begin CHARACTERISTIC SCtPmpRly_StdCal.rPsActrOff_C " / Replacement value for powerstage dutycycle when actuator is not activated" VALUE 0x80268950 Val_Ws16 655.3500 DtyCyc -327.6800 327.6700 FORMAT "%8.4" /end CHARACTERISTIC
/begin CHARACTERISTIC SCtPmpRly_StdCal.uBattMin_C " / Minimum value of battery voltage to enable Clean and Verify" VALUE 0x80268952 Val_Ws16 1310700. Volt_Batt -655360.0 655340.0 FORMAT "%8.1" /end CHARACTERISTIC
/begin CHARACTERISTIC SCtPmpRly_StdCal.uBattMax_C " / Maximum value of battery voltage to enable zero point adaption" VALUE 0x80268954 Val_Ws16 1310700. Volt_Batt -655360.0 655340.0 FORMAT "%8.1" /end CHARACTERISTIC
/begin CHARACTERISTIC SCtPmpRly_StdCal.tiShOffCtrlDne_C " / Delay for deactivation of the actuator when shut off is done" VALUE 0x80268956 Val_Ws16 655350.0 Time_ms -327680.0 327670.0 FORMAT "%8.1" /end CHARACTERISTIC
/begin CHARACTERISTIC SCtPmpRly_StdCal.swtDeactvn_C " / bitmask to deactivate the actuator by calibration" VALUE 0x80268958 Val_Wu8 255.0 OneToOne 0.00 255.0 FORMAT "%5.1" /end CHARACTERISTIC
/begin CHARACTERISTIC SCtPmpRly_StdCal.tiSelfDiagStrt_C " / Delay time to start the self diagnosis of the powertstage once the engine state has reached the required state." VALUE 0x8026895A Val_Ws16 655350.0 Time_ms -327680.0 327670.0 FORMAT "%8.1" /end CHARACTERISTIC
/begin CHARACTERISTIC SCtPmpRly_StdCal.flgReacvnPostDrv_C " / e_:Reactivation of actuator at transition into POSTDRIVE.:_e;d_:Reaktivierung des Stellers beim Ã?bergang in den POSTDRIVE.:_d" VALUE 0x8026895C Val_Wu8 255.0 OneToOne 0.00 255.0 FORMAT "%5.1" /end CHARACTERISTIC
/begin CHARACTERISTIC SCtPmpRly_StdCal.rPsRlyOff_C " / e_:Calibration to indicate the switch-off dutycycle:_e;d_:Kalibrierung zur Anzeige des Ausschaltzyklus:_d" VALUE 0x8026895E Val_Ws16 655.3500 DtyCyc -327.6800 327.6700 FORMAT "%8.4" /end CHARACTERISTIC
/begin CHARACTERISTIC SCtPmpRly_StdCal.tiRlyOnDly_C " / e_:Calibration to delay the enabling of powerstage:_e;d_:Kalibrierung, um die Aktivierung der Endstufe zu verzögern:_d" VALUE 0x80268960 Val_Ws16 33.55392 RBPtCel_ti_5p12em4_1 -16.77722 16.77670 FORMAT "%8.5" /end CHARACTERISTIC
/begin CHARACTERISTIC SCtPmpRly_StdCal.nFMInWinMsk_C " / e_:Calibration mask to select the proper window representing the actuator jammed error:_e;d_:Maske für die Auswahl des Frequenzfensters für das blockierte Ventil:_d" VALUE 0x80268964 Val_Wu32 4294967295.00 OneToOne 0.00 4294967295.00 FORMAT "%13.2" /end CHARACTERISTIC
/begin CHARACTERISTIC SCtPmpRly_StdCal.tiFMInDeb_C " / e_:Time for debouncing the frequency window::_e;d_:Zeit zum Entprellen des Frequenzfensters:_d" VALUE 0x80268968 Val_Wu8 2550. Time_ms 0.00 2550. FORMAT "%5.0" /end CHARACTERISTIC
/begin CHARACTERISTIC SCtPmpRly_StdCal.tiJamActrWait_C " / e_:Time to start the jammed actuator debouncing after the preliminary error:_e;d_:Zeit zum Starten der Entprellung des blockierten Stellers nach dem vorläufigen Fehler:_d" VALUE 0x8026896A Val_Ws16 6553.500 t_q0p1 -3276.800 3276.700 FORMAT "%8.3" /end CHARACTERISTIC
/begin MEASUREMENT B_eepwf "" UBYTE B_TRUE 1 100 0.00 1.00000000000 BIT_MASK 0x1 FORMAT "%13.11" ECU_ADDRESS 0x70000114 /end MEASUREMENT
/begin MEASUREMENT B_pwf "" UBYTE B_TRUE 1 100 0.00 1.00000000000 BIT_MASK 0x1 FORMAT "%13.11" ECU_ADDRESS 0x70000113 /end MEASUREMENT
/begin MEASUREMENT DDRC_ctArDebLvl.DFC_MRlyOL "" SWORD DFC_OneToOne 1 100 -32768.00 32767.00 FORMAT "%8.2" ECU_ADDRESS 0x60021F32 /end MEASUREMENT
/begin MEASUREMENT DDRC_ctArDebLvl.DFC_MRlySCB "" SWORD DFC_OneToOne 1 100 -32768.00 32767.00 FORMAT "%8.2" ECU_ADDRESS 0x60021F34 /end MEASUREMENT
/begin MEASUREMENT DDRC_ctArDebLvl.DFC_MRlySCG "" SWORD DFC_OneToOne 1 100 -32768.00 32767.00 FORMAT "%8.2" ECU_ADDRESS 0x60021F36 /end MEASUREMENT
/begin MEASUREMENT DDRC_ctArDebLvl.DFC_SSpMon1 "" SWORD DFC_OneToOne 1 100 -32768.00 32767.00 FORMAT "%8.2" ECU_ADDRESS 0x60021F38 /end MEASUREMENT
/begin MEASUREMENT DDRC_ctArDebLvl.DFC_SSpMon1OV "" SWORD DFC_OneToOne 1 100 -32768.00 32767.00 FORMAT "%8.2" ECU_ADDRESS 0x60021F3A /end MEASUREMENT
/begin MEASUREMENT DDRC_ctArDebLvl.DFC_SSpMon1SCG "" SWORD DFC_OneToOne 1 100 -32768.00 32767.00 FORMAT "%8.2" ECU_ADDRESS 0x60021F3C /end MEASUREMENT
/begin MEASUREMENT DDRC_ctArDebLvl.DFC_SSpMon1UV "" SWORD DFC_OneToOne 1 100 -32768.00 32767.00 FORMAT "%8.2" ECU_ADDRESS 0x60021F3E /end MEASUREMENT
/begin MEASUREMENT DDRC_ctArDebLvl.DFC_SSpMon2 "" SWORD DFC_OneToOne 1 100 -32768.00 32767.00 FORMAT "%8.2" ECU_ADDRESS 0x60021F40 /end MEASUREMENT
/begin MEASUREMENT DDRC_ctArDebLvl.DFC_SSpMon2OV "" SWORD DFC_OneToOne 1 100 -32768.00 32767.00 FORMAT "%8.2" ECU_ADDRESS 0x60021F42 /end MEASUREMENT
/begin MEASUREMENT DDRC_ctArDebLvl.DFC_SSpMon2SCG "" SWORD DFC_OneToOne 1 100 -32768.00 32767.00 FORMAT "%8.2" ECU_ADDRESS 0x60021F44 /end MEASUREMENT
/begin MEASUREMENT DDRC_ctArDebLvl.DFC_SSpMon2UV "" SWORD DFC_OneToOne 1 100 -32768.00 32767.00 FORMAT "%8.2" ECU_ADDRESS 0x60021F46 /end MEASUREMENT
/begin MEASUREMENT DDRC_ctArDebLvl.DFC_SSpMon3 "" SWORD DFC_OneToOne 1 100 -32768.00 32767.00 FORMAT "%8.2" ECU_ADDRESS 0x60021F48 /end MEASUREMENT
/begin MEASUREMENT DDRC_ctArDebLvl.DFC_SSpMon3OV "" SWORD DFC_OneToOne 1 100 -32768.00 32767.00 FORMAT "%8.2" ECU_ADDRESS 0x60021F4A /end MEASUREMENT
/begin MEASUREMENT DDRC_ctArDebLvl.DFC_SSpMon3SCG "" SWORD DFC_OneToOne 1 100 -32768.00 32767.00 FORMAT "%8.2" ECU_ADDRESS 0x60021F4C /end MEASUREMENT
/begin MEASUREMENT DDRC_ctArDebLvl.DFC_SSpMon3UV "" SWORD DFC_OneToOne 1 100 -32768.00 32767.00 FORMAT "%8.2" ECU_ADDRESS 0x60021F4E /end MEASUREMENT
/begin MEASUREMENT DDRC_ctArDebLvl.DFC_rba_EcuCtrl_TOMaxProlg "" SWORD DFC_OneToOne 1 100 -32768.00 32767.00 FORMAT "%8.2" ECU_ADDRESS 0x60021F6A /end MEASUREMENT
/begin MEASUREMENT DDRC_ctArDebLvl.DFC_rba_EcuCtrl_TOMaxShutDwn "" SWORD DFC_OneToOne 1 100 -32768.00 32767.00 FORMAT "%8.2" ECU_ADDRESS 0x60021F6C /end MEASUREMENT
/begin MEASUREMENT DDRC_St.DFC_SCtPmp1FailSafeNotSuc "" ULONG DFC_OneToOne 1 100 0.00 536870911.000 BIT_MASK 0x1fffffff FORMAT "%13.3" ECU_ADDRESS 0x6001C460 /end MEASUREMENT
/begin MEASUREMENT DDRC_St.DFC_SCtPmp1SCG "" ULONG DFC_OneToOne 1 100 0.00 536870911.000 BIT_MASK 0x1fffffff FORMAT "%13.3" ECU_ADDRESS 0x6001C464 /end MEASUREMENT
/begin MEASUREMENT DDRC_St.DFC_PwrDistbnUnitTSRCMin "" ULONG DFC_OneToOne 1 100 0.00 536870911.000 BIT_MASK 0x1fffffff FORMAT "%13.3" ECU_ADDRESS 0x6001CA84 /end MEASUREMENT
/begin MEASUREMENT DDRC_St.DFC_SCtPmp1OL "" ULONG DFC_OneToOne 1 100 0.00 536870911.000 BIT_MASK 0x1fffffff FORMAT "%13.3" ECU_ADDRESS 0x6001CA88 /end MEASUREMENT
/begin MEASUREMENT DDRC_St.DFC_SCtPmp1OvrTemp "" ULONG DFC_OneToOne 1 100 0.00 536870911.000 BIT_MASK 0x1fffffff FORMAT "%13.3" ECU_ADDRESS 0x6001CA8C /end MEASUREMENT
/begin MEASUREMENT DDRC_St.DFC_SCtPmp1SCB "" ULONG DFC_OneToOne 1 100 0.00 536870911.000 BIT_MASK 0x1fffffff FORMAT "%13.3" ECU_ADDRESS 0x6001CA90 /end MEASUREMENT
/begin MEASUREMENT DDRC_St.DFC_PwrDistbnUnitTPhysRngHi "" UWORD DFC_OneToOne 1 100 0.00 8191.000 BIT_MASK 0x1fff FORMAT "%8.3" ECU_ADDRESS 0x60021FDA /end MEASUREMENT
/begin MEASUREMENT DDRC_St.DFC_PwrDistbnUnitTPhysRngLo "" UWORD DFC_OneToOne 1 100 0.00 8191.000 BIT_MASK 0x1fff FORMAT "%8.3" ECU_ADDRESS 0x60021FDC /end MEASUREMENT
/begin MEASUREMENT DDRC_St.DFC_PwrDistbnUnitTSRCOpn "" UWORD DFC_OneToOne 1 100 0.00 8191.000 BIT_MASK 0x1fff FORMAT "%8.3" ECU_ADDRESS 0x60021FDE /end MEASUREMENT
/begin MEASUREMENT DDRC_St.DFC_SCtPmp1DiagGrdKey1 "" UWORD DFC_OneToOne 1 100 0.00 8191.000 BIT_MASK 0x1fff FORMAT "%8.3" ECU_ADDRESS 0x60021FF8 /end MEASUREMENT
/begin MEASUREMENT DDRC_St.DFC_SCtPmp1DiagGrdKey2 "" UWORD DFC_OneToOne 1 100 0.00 8191.000 BIT_MASK 0x1fff FORMAT "%8.3" ECU_ADDRESS 0x60021FFA /end MEASUREMENT
/begin MEASUREMENT DDRC_St.DFC_SCtPmp1DiagGrdKey3 "" UWORD DFC_OneToOne 1 100 0.00 8191.000 BIT_MASK 0x1fff FORMAT "%8.3" ECU_ADDRESS 0x60021FFC /end MEASUREMENT
/begin MEASUREMENT DDRC_St.DFC_SCtPmp1DiagGrdKey4 "" UWORD DFC_OneToOne 1 100 0.00 8191.000 BIT_MASK 0x1fff FORMAT "%8.3" ECU_ADDRESS 0x60021FFE /end MEASUREMENT
/begin MEASUREMENT DDRC_St.DFC_SCtPmp1DiagGrdKey5 "" UWORD DFC_OneToOne 1 100 0.00 8191.000 BIT_MASK 0x1fff FORMAT "%8.3" ECU_ADDRESS 0x60022000 /end MEASUREMENT
/begin MEASUREMENT DDRC_stLstRprtEve.DFC_MRlyOL "" UBYTE DDRC_LstRprtEve_VERB 1 100 0.00 255.000000000 FORMAT "%13.9" ECU_ADDRESS 0x60024957 /end MEASUREMENT
/begin MEASUREMENT DDRC_stLstRprtEve.DFC_MRlySCB "" UBYTE DDRC_LstRprtEve_VERB 1 100 0.00 255.000000000 FORMAT "%13.9" ECU_ADDRESS 0x60024958 /end MEASUREMENT
/begin MEASUREMENT DDRC_stLstRprtEve.DFC_MRlySCG "" UBYTE DDRC_LstRprtEve_VERB 1 100 0.00 255.000000000 FORMAT "%13.9" ECU_ADDRESS 0x60024959 /end MEASUREMENT
/begin MEASUREMENT DDRC_stLstRprtEve.DFC_SSpMon1 "" UBYTE DDRC_LstRprtEve_VERB 1 100 0.00 255.000000000 FORMAT "%13.9" ECU_ADDRESS 0x6002495A /end MEASUREMENT
/begin MEASUREMENT DDRC_stLstRprtEve.DFC_SSpMon1OV "" UBYTE DDRC_LstRprtEve_VERB 1 100 0.00 255.000000000 FORMAT "%13.9" ECU_ADDRESS 0x6002495B /end MEASUREMENT
/begin MEASUREMENT DDRC_stLstRprtEve.DFC_SSpMon1SCG "" UBYTE DDRC_LstRprtEve_VERB 1 100 0.00 255.000000000 FORMAT "%13.9" ECU_ADDRESS 0x6002495C /end MEASUREMENT
/begin MEASUREMENT DDRC_stLstRprtEve.DFC_SSpMon1UV "" UBYTE DDRC_LstRprtEve_VERB 1 100 0.00 255.000000000 FORMAT "%13.9" ECU_ADDRESS 0x6002495D /end MEASUREMENT
/begin MEASUREMENT DDRC_stLstRprtEve.DFC_SSpMon2 "" UBYTE DDRC_LstRprtEve_VERB 1 100 0.00 255.000000000 FORMAT "%13.9" ECU_ADDRESS 0x6002495E /end MEASUREMENT
/begin MEASUREMENT DDRC_stLstRprtEve.DFC_SSpMon2OV "" UBYTE DDRC_LstRprtEve_VERB 1 100 0.00 255.000000000 FORMAT "%13.9" ECU_ADDRESS 0x6002495F /end MEASUREMENT
/begin MEASUREMENT DDRC_stLstRprtEve.DFC_SSpMon2SCG "" UBYTE DDRC_LstRprtEve_VERB 1 100 0.00 255.000000000 FORMAT "%13.9" ECU_ADDRESS 0x60024960 /end MEASUREMENT
/begin MEASUREMENT DDRC_stLstRprtEve.DFC_SSpMon2UV "" UBYTE DDRC_LstRprtEve_VERB 1 100 0.00 255.000000000 FORMAT "%13.9" ECU_ADDRESS 0x60024961 /end MEASUREMENT
/begin MEASUREMENT DDRC_stLstRprtEve.DFC_SSpMon3 "" UBYTE DDRC_LstRprtEve_VERB 1 100 0.00 255.000000000 FORMAT "%13.9" ECU_ADDRESS 0x60024962 /end MEASUREMENT
/begin MEASUREMENT DDRC_stLstRprtEve.DFC_SSpMon3OV "" UBYTE DDRC_LstRprtEve_VERB 1 100 0.00 255.000000000 FORMAT "%13.9" ECU_ADDRESS 0x60024963 /end MEASUREMENT
/begin MEASUREMENT DDRC_stLstRprtEve.DFC_SSpMon3SCG "" UBYTE DDRC_LstRprtEve_VERB 1 100 0.00 255.000000000 FORMAT "%13.9" ECU_ADDRESS 0x60024964 /end MEASUREMENT
/begin MEASUREMENT DDRC_stLstRprtEve.DFC_SSpMon3UV "" UBYTE DDRC_LstRprtEve_VERB 1 100 0.00 255.000000000 FORMAT "%13.9" ECU_ADDRESS 0x60024965 /end MEASUREMENT
/begin MEASUREMENT DDRC_stLstRprtEve.DFC_rba_EcuCtrl_TOMaxProlg "" UBYTE DDRC_LstRprtEve_VERB 1 100 0.00 255.000000000 FORMAT "%13.9" ECU_ADDRESS 0x60024973 /end MEASUREMENT
/begin MEASUREMENT DDRC_stLstRprtEve.DFC_rba_EcuCtrl_TOMaxShutDwn "" UBYTE DDRC_LstRprtEve_VERB 1 100 0.00 255.000000000 FORMAT "%13.9" ECU_ADDRESS 0x60024974 /end MEASUREMENT
/begin MEASUREMENT DFC_st.DFC_SCtPmp1FailSafeNotSuc "" UBYTE DFC_OneToOne 1 100 0.00 255.0 FORMAT "%5.1" ECU_ADDRESS 0x60034A7B /end MEASUREMENT
/begin MEASUREMENT DFC_st.DFC_SCtPmp1SCG "" UBYTE DFC_OneToOne 1 100 0.00 255.0 FORMAT "%5.1" ECU_ADDRESS 0x60034A7C /end MEASUREMENT
/begin MEASUREMENT DFC_st.DFC_PwrDistbnUnitTSRCMin "" UBYTE DFC_OneToOne 1 100 0.00 255.0 FORMAT "%5.1" ECU_ADDRESS 0x60034C04 /end MEASUREMENT
/begin MEASUREMENT DFC_st.DFC_SCtPmp1OL "" UBYTE DFC_OneToOne 1 100 0.00 255.0 FORMAT "%5.1" ECU_ADDRESS 0x60034C05 /end MEASUREMENT
/begin MEASUREMENT DFC_st.DFC_SCtPmp1OvrTemp "" UBYTE DFC_OneToOne 1 100 0.00 255.0 FORMAT "%5.1" ECU_ADDRESS 0x60034C06 /end MEASUREMENT
/begin MEASUREMENT DFC_st.DFC_SCtPmp1SCB "" UBYTE DFC_OneToOne 1 100 0.00 255.0 FORMAT "%5.1" ECU_ADDRESS 0x60034C07 /end MEASUREMENT
/begin MEASUREMENT DFC_st.DFC_PwrDistbnUnitTPhysRngHi "" UBYTE DFC_OneToOne 1 100 0.00 255.0 FORMAT "%5.1" ECU_ADDRESS 0x60034C44 /end MEASUREMENT
/begin MEASUREMENT DFC_st.DFC_PwrDistbnUnitTPhysRngLo "" UBYTE DFC_OneToOne 1 100 0.00 255.0 FORMAT "%5.1" ECU_ADDRESS 0x60034C45 /end MEASUREMENT
/begin MEASUREMENT DFC_st.DFC_PwrDistbnUnitTSRCOpn "" UBYTE DFC_OneToOne 1 100 0.00 255.0 FORMAT "%5.1" ECU_ADDRESS 0x60034C46 /end MEASUREMENT
/begin MEASUREMENT DFC_st.DFC_SCtPmp1DiagGrdKey1 "" UBYTE DFC_OneToOne 1 100 0.00 255.0 FORMAT "%5.1" ECU_ADDRESS 0x60034C53 /end MEASUREMENT
/begin MEASUREMENT DFC_st.DFC_SCtPmp1DiagGrdKey2 "" UBYTE DFC_OneToOne 1 100 0.00 255.0 FORMAT "%5.1" ECU_ADDRESS 0x60034C54 /end MEASUREMENT
/begin MEASUREMENT DFC_st.DFC_SCtPmp1DiagGrdKey3 "" UBYTE DFC_OneToOne 1 100 0.00 255.0 FORMAT "%5.1" ECU_ADDRESS 0x60034C55 /end MEASUREMENT
/begin MEASUREMENT DFC_st.DFC_SCtPmp1DiagGrdKey4 "" UBYTE DFC_OneToOne 1 100 0.00 255.0 FORMAT "%5.1" ECU_ADDRESS 0x60034C56 /end MEASUREMENT
/begin MEASUREMENT DFC_st.DFC_SCtPmp1DiagGrdKey5 "" UBYTE DFC_OneToOne 1 100 0.00 255.0 FORMAT "%5.1" ECU_ADDRESS 0x60034C57 /end MEASUREMENT
/begin MEASUREMENT DFC_st.DFC_MRlyOL "" UBYTE DFC_OneToOne 1 100 0.00 255.0 FORMAT "%5.1" ECU_ADDRESS 0x60034C83 /end MEASUREMENT
/begin MEASUREMENT DFC_st.DFC_MRlySCB "" UBYTE DFC_OneToOne 1 100 0.00 255.0 FORMAT "%5.1" ECU_ADDRESS 0x60034C84 /end MEASUREMENT
/begin MEASUREMENT DFC_st.DFC_MRlySCG "" UBYTE DFC_OneToOne 1 100 0.00 255.0 FORMAT "%5.1" ECU_ADDRESS 0x60034C85 /end MEASUREMENT
/begin MEASUREMENT DFC_st.DFC_SSpMon1 "" UBYTE DFC_OneToOne 1 100 0.00 255.0 FORMAT "%5.1" ECU_ADDRESS 0x60034C86 /end MEASUREMENT
/begin MEASUREMENT DFC_st.DFC_SSpMon1OV "" UBYTE DFC_OneToOne 1 100 0.00 255.0 FORMAT "%5.1" ECU_ADDRESS 0x60034C87 /end MEASUREMENT
/begin MEASUREMENT DFC_st.DFC_SSpMon1SCG "" UBYTE DFC_OneToOne 1 100 0.00 255.0 FORMAT "%5.1" ECU_ADDRESS 0x60034C88 /end MEASUREMENT
/begin MEASUREMENT DFC_st.DFC_SSpMon1UV "" UBYTE DFC_OneToOne 1 100 0.00 255.0 FORMAT "%5.1" ECU_ADDRESS 0x60034C89 /end MEASUREMENT
/begin MEASUREMENT DFC_st.DFC_SSpMon2 "" UBYTE DFC_OneToOne 1 100 0.00 255.0 FORMAT "%5.1" ECU_ADDRESS 0x60034C8A /end MEASUREMENT
/begin MEASUREMENT DFC_st.DFC_SSpMon2OV "" UBYTE DFC_OneToOne 1 100 0.00 255.0 FORMAT "%5.1" ECU_ADDRESS 0x60034C8B /end MEASUREMENT
/begin MEASUREMENT DFC_st.DFC_SSpMon2SCG "" UBYTE DFC_OneToOne 1 100 0.00 255.0 FORMAT "%5.1" ECU_ADDRESS 0x60034C8C /end MEASUREMENT
/begin MEASUREMENT DFC_st.DFC_SSpMon2UV "" UBYTE DFC_OneToOne 1 100 0.00 255.0 FORMAT "%5.1" ECU_ADDRESS 0x60034C8D /end MEASUREMENT
/begin MEASUREMENT DFC_st.DFC_SSpMon3 "" UBYTE DFC_OneToOne 1 100 0.00 255.0 FORMAT "%5.1" ECU_ADDRESS 0x60034C8E /end MEASUREMENT
/begin MEASUREMENT DFC_st.DFC_SSpMon3OV "" UBYTE DFC_OneToOne 1 100 0.00 255.0 FORMAT "%5.1" ECU_ADDRESS 0x60034C8F /end MEASUREMENT
/begin MEASUREMENT DFC_st.DFC_SSpMon3SCG "" UBYTE DFC_OneToOne 1 100 0.00 255.0 FORMAT "%5.1" ECU_ADDRESS 0x60034C90 /end MEASUREMENT
/begin MEASUREMENT DFC_st.DFC_SSpMon3UV "" UBYTE DFC_OneToOne 1 100 0.00 255.0 FORMAT "%5.1" ECU_ADDRESS 0x60034C91 /end MEASUREMENT
/begin MEASUREMENT DFC_st.DFC_rba_EcuCtrl_TOMaxProlg "" UBYTE DFC_OneToOne 1 100 0.00 255.0 FORMAT "%5.1" ECU_ADDRESS 0x60034C9F /end MEASUREMENT
/begin MEASUREMENT DFC_st.DFC_rba_EcuCtrl_TOMaxShutDwn "" UBYTE DFC_OneToOne 1 100 0.00 255.0 FORMAT "%5.1" ECU_ADDRESS 0x60034CA0 /end MEASUREMENT
/begin MEASUREMENT DFC_st.DFC_rba_IoSigRtc_StopCounter "" UBYTE DFC_OneToOne 1 100 0.00 255.0 FORMAT "%5.1" ECU_ADDRESS 0x60034CA7 /end MEASUREMENT
/begin MEASUREMENT DFC_st.DFC_rba_MemDiag_MemReadErr "" UBYTE DFC_OneToOne 1 100 0.00 255.0 FORMAT "%5.1" ECU_ADDRESS 0x60034CA9 /end MEASUREMENT
/begin MEASUREMENT DFC_st.DFC_rba_MemDiag_MemWrErr "" UBYTE DFC_OneToOne 1 100 0.00 255.0 FORMAT "%5.1" ECU_ADDRESS 0x60034CAA /end MEASUREMENT
/begin MEASUREMENT DFC_st.DFC_PwrDistbnUnitTSRCMax "" UBYTE DFC_OneToOne 1 100 0.00 255.0 FORMAT "%5.1" ECU_ADDRESS 0x60034D7E /end MEASUREMENT
/begin MEASUREMENT DFC_st.DFC_PwrDistbnUnitTTmpErr "" UBYTE DFC_OneToOne 1 100 0.00 255.0 FORMAT "%5.1" ECU_ADDRESS 0x60034D7F /end MEASUREMENT
/begin MEASUREMENT DFC_st.DFC_SCtPmp1DiagGrdKeyErr "" UBYTE DFC_OneToOne 1 100 0.00 255.0 FORMAT "%5.1" ECU_ADDRESS 0x60034D80 /end MEASUREMENT
/begin MEASUREMENT DINH_nrActvInhReas.FId_FiMFID_rba_MRly_Diag_Stk "" UWORD DINH_ct_Compu 1 100 -4095.000 4096.000 BIT_MASK 0x1fff FORMAT "%8.3" ECU_ADDRESS 0x60021488 /end MEASUREMENT
/begin MEASUREMENT DINH_nrActvInhReas.FId_PwrDistbnUnitTEnhdSRCMax "" UWORD DINH_ct_Compu 1 100 -4095.000 4096.000 BIT_MASK 0x1fff FORMAT "%8.3" ECU_ADDRESS 0x6002152A /end MEASUREMENT
/begin MEASUREMENT DINH_nrActvInhReas.FId_PwrDistbnUnitTFrzVal "" UWORD DINH_ct_Compu 1 100 -4095.000 4096.000 BIT_MASK 0x1fff FORMAT "%8.3" ECU_ADDRESS 0x6002152C /end MEASUREMENT
/begin MEASUREMENT DINH_nrActvInhReas.FId_PwrDistbnUnitTPhysRng "" UWORD DINH_ct_Compu 1 100 -4095.000 4096.000 BIT_MASK 0x1fff FORMAT "%8.3" ECU_ADDRESS 0x6002152E /end MEASUREMENT
/begin MEASUREMENT DINH_nrActvInhReas.FId_PwrDistbnUnitTRplVal "" UWORD DINH_ct_Compu 1 100 -4095.000 4096.000 BIT_MASK 0x1fff FORMAT "%8.3" ECU_ADDRESS 0x60021530 /end MEASUREMENT
/begin MEASUREMENT DINH_nrActvInhReas.FId_PwrDistbnUnitTSSpMon "" UWORD DINH_ct_Compu 1 100 -4095.000 4096.000 BIT_MASK 0x1fff FORMAT "%8.3" ECU_ADDRESS 0x60021532 /end MEASUREMENT
/begin MEASUREMENT DINH_nrActvInhReas.FId_PwrDistbnUnitTTmpErrCnt "" UWORD DINH_ct_Compu 1 100 -4095.000 4096.000 BIT_MASK 0x1fff FORMAT "%8.3" ECU_ADDRESS 0x60021534 /end MEASUREMENT
/begin MEASUREMENT DINH_nrActvInhReas.FId_SCtPmp1ActrOff "" UWORD DINH_ct_Compu 1 100 -4095.000 4096.000 BIT_MASK 0x1fff FORMAT "%8.3" ECU_ADDRESS 0x60021536 /end MEASUREMENT
/begin MEASUREMENT DINH_nrActvInhReas.FId_SCtPmp1CircErr "" UWORD DINH_ct_Compu 1 100 -4095.000 4096.000 BIT_MASK 0x1fff FORMAT "%8.3" ECU_ADDRESS 0x60021538 /end MEASUREMENT
/begin MEASUREMENT DINH_nrActvInhReas.FId_SCtPmp1Mon "" UWORD DINH_ct_Compu 1 100 -4095.000 4096.000 BIT_MASK 0x1fff FORMAT "%8.3" ECU_ADDRESS 0x6002153A /end MEASUREMENT
/begin MEASUREMENT DINH_nrActvInhReas.FId_SCtPmp1Off "" UWORD DINH_ct_Compu 1 100 -4095.000 4096.000 BIT_MASK 0x1fff FORMAT "%8.3" ECU_ADDRESS 0x6002153C /end MEASUREMENT
/begin MEASUREMENT DINH_nrActvInhReas.FId_SCtPmp1PsErr "" UWORD DINH_ct_Compu 1 100 -4095.000 4096.000 BIT_MASK 0x1fff FORMAT "%8.3" ECU_ADDRESS 0x6002153E /end MEASUREMENT
/begin MEASUREMENT DINH_nrActvInhReas.FId_SCtPmp1PwrStg "" UWORD DINH_ct_Compu 1 100 -4095.000 4096.000 BIT_MASK 0x1fff FORMAT "%8.3" ECU_ADDRESS 0x60021542 /end MEASUREMENT
/begin MEASUREMENT DINH_nrActvInhReas.FId_SCtPmp1QlySensFrzn "" UWORD DINH_ct_Compu 1 100 -4095.000 4096.000 BIT_MASK 0x1fff FORMAT "%8.3" ECU_ADDRESS 0x60021544 /end MEASUREMENT
/begin MEASUREMENT DINH_nrActvInhReas.FId_SCtPmp1QlySensRplVal "" UWORD DINH_ct_Compu 1 100 -4095.000 4096.000 BIT_MASK 0x1fff FORMAT "%8.3" ECU_ADDRESS 0x60021546 /end MEASUREMENT
/begin MEASUREMENT DINH_nrActvInhReas.FId_SCtPmpRlyActrOff "" UWORD DINH_ct_Compu 1 100 -4095.000 4096.000 BIT_MASK 0x1fff FORMAT "%8.3" ECU_ADDRESS 0x6002154A /end MEASUREMENT
/begin MEASUREMENT DINH_nrActvInhReas.FId_SCtPmpRlyOff "" UWORD DINH_ct_Compu 1 100 -4095.000 4096.000 BIT_MASK 0x1fff FORMAT "%8.3" ECU_ADDRESS 0x6002154E /end MEASUREMENT
/begin MEASUREMENT DINH_stFId.FId_FiMFID_rba_MRly_Diag_Stk "" UWORD DFC_OneToOne 1 100 0.00 65535.00 FORMAT "%8.2" ECU_ADDRESS 0x60021488 /end MEASUREMENT
/begin MEASUREMENT DINH_stFId.FId_PwrDistbnUnitTEnhdSRCMax "" UWORD DFC_OneToOne 1 100 0.00 65535.00 FORMAT "%8.2" ECU_ADDRESS 0x6002152A /end MEASUREMENT
/begin MEASUREMENT DINH_stFId.FId_PwrDistbnUnitTFrzVal "" UWORD DFC_OneToOne 1 100 0.00 65535.00 FORMAT "%8.2" ECU_ADDRESS 0x6002152C /end MEASUREMENT
/begin MEASUREMENT DINH_stFId.FId_PwrDistbnUnitTPhysRng "" UWORD DFC_OneToOne 1 100 0.00 65535.00 FORMAT "%8.2" ECU_ADDRESS 0x6002152E /end MEASUREMENT
/begin MEASUREMENT DINH_stFId.FId_PwrDistbnUnitTRplVal "" UWORD DFC_OneToOne 1 100 0.00 65535.00 FORMAT "%8.2" ECU_ADDRESS 0x60021530 /end MEASUREMENT
/begin MEASUREMENT DINH_stFId.FId_PwrDistbnUnitTSSpMon "" UWORD DFC_OneToOne 1 100 0.00 65535.00 FORMAT "%8.2" ECU_ADDRESS 0x60021532 /end MEASUREMENT
/begin MEASUREMENT DINH_stFId.FId_PwrDistbnUnitTTmpErrCnt "" UWORD DFC_OneToOne 1 100 0.00 65535.00 FORMAT "%8.2" ECU_ADDRESS 0x60021534 /end MEASUREMENT
/begin MEASUREMENT DINH_stFId.FId_SCtPmp1ActrOff "" UWORD DFC_OneToOne 1 100 0.00 65535.00 FORMAT "%8.2" ECU_ADDRESS 0x60021536 /end MEASUREMENT
/begin MEASUREMENT DINH_stFId.FId_SCtPmp1CircErr "" UWORD DFC_OneToOne 1 100 0.00 65535.00 FORMAT "%8.2" ECU_ADDRESS 0x60021538 /end MEASUREMENT
/begin MEASUREMENT DINH_stFId.FId_SCtPmp1Mon "" UWORD DFC_OneToOne 1 100 0.00 65535.00 FORMAT "%8.2" ECU_ADDRESS 0x6002153A /end MEASUREMENT
/begin MEASUREMENT DINH_stFId.FId_SCtPmp1Off "" UWORD DFC_OneToOne 1 100 0.00 65535.00 FORMAT "%8.2" ECU_ADDRESS 0x6002153C /end MEASUREMENT
/begin MEASUREMENT DINH_stFId.FId_SCtPmp1PsErr "" UWORD DFC_OneToOne 1 100 0.00 65535.00 FORMAT "%8.2" ECU_ADDRESS 0x6002153E /end MEASUREMENT
/begin MEASUREMENT DINH_stFId.FId_SCtPmp1PwrStg "" UWORD DFC_OneToOne 1 100 0.00 65535.00 FORMAT "%8.2" ECU_ADDRESS 0x60021542 /end MEASUREMENT
/begin MEASUREMENT DINH_stFId.FId_SCtPmp1QlySensFrzn "" UWORD DFC_OneToOne 1 100 0.00 65535.00 FORMAT "%8.2" ECU_ADDRESS 0x60021544 /end MEASUREMENT
/begin MEASUREMENT DINH_stFId.FId_SCtPmp1QlySensRplVal "" UWORD DFC_OneToOne 1 100 0.00 65535.00 FORMAT "%8.2" ECU_ADDRESS 0x60021546 /end MEASUREMENT
/begin MEASUREMENT DINH_stFId.FId_SCtPmpRlyActrOff "" UWORD DFC_OneToOne 1 100 0.00 65535.00 FORMAT "%8.2" ECU_ADDRESS 0x6002154A /end MEASUREMENT
/begin MEASUREMENT DINH_stFId.FId_SCtPmpRlyOff "" UWORD DFC_OneToOne 1 100 0.00 65535.00 FORMAT "%8.2" ECU_ADDRESS 0x6002154E /end MEASUREMENT
/begin MEASUREMENT Eep_ctAbsCallWrFkt "" UWORD OneToOne 1 100 0.00 65535.00 FORMAT "%8.2" ECU_ADDRESS 0x60034948 /end MEASUREMENT
/begin MEASUREMENT Eep_ctCallWrFkt "" UWORD OneToOne 1 100 0.00 65535.00 FORMAT "%8.2" ECU_ADDRESS 0x60034084 /end MEASUREMENT
/begin MEASUREMENT Eep_ctMaxCallWrFkt "" UWORD OneToOne 1 100 0.00 65535.00 FORMAT "%8.2" ECU_ADDRESS 0x6003494A /end MEASUREMENT
/begin MEASUREMENT Eep_EnvRamHist "History state ENVRAM(Emulated Non Volatile Random Access Memory)" UBYTE OneToOne 1 100 0.00 255.0 FORMAT "%5.1" ECU_ADDRESS 0x60023934 /end MEASUREMENT
/begin MEASUREMENT Eep_EnvRamInvld "Invalidity state ENVRAM(Emulated Non Volatile Random Access Memory)" UBYTE OneToOne 1 100 0.00 255.0 FORMAT "%5.1" ECU_ADDRESS 0x60023935 /end MEASUREMENT
/begin MEASUREMENT Eep_PostdrvBlkIdx_s16 "" SWORD OneToOne 1 100 -32768.00 32767.00 FORMAT "%8.2" ECU_ADDRESS 0x6001FF28 /end MEASUREMENT
/begin MEASUREMENT Eep_stBlk "" UWORD OneToOne 1 100 0.00 65535.00 FORMAT "%8.2" MATRIX_DIM 25 ECU_ADDRESS 0x6001FF2A /end MEASUREMENT
/begin MEASUREMENT Eep_stMain "" SLONG Eep_MainStates_Verb 1 100 0.00 14.0000000000 FORMAT "%13.10" ECU_ADDRESS 0x60001378 /end MEASUREMENT
/begin MEASUREMENT Eep_stPostDrv "" UBYTE Eep_PostDrvState_Verb 1 100 0.00 4.00000000000 FORMAT "%13.11" ECU_ADDRESS 0x60023932 /end MEASUREMENT
/begin MEASUREMENT PwrDistbnUnitT_DDstSnsrState_mp "" UBYTE OneToOne 1 100 0.00 255.0 FORMAT "%5.1" ECU_ADDRESS 0x70006B5D /end MEASUREMENT
/begin MEASUREMENT PwrDistbnUnitT_FirCalc.cntrAvrgZr " / Counter for 0-division in FIR (indicates failure)" UBYTE OneToOne 1 100 0.00 255.0 FORMAT "%5.1" ECU_ADDRESS 0x6001F3FC /end MEASUREMENT
/begin MEASUREMENT PwrDistbnUnitT_FirCalc.flgRdDne " / FIR: reading from uRaw-sum done" UBYTE OneToOne 1 100 0.00 1.000 BIT_MASK 0x1 FORMAT "%5.3" ECU_ADDRESS 0x6001F3FD /end MEASUREMENT
/begin MEASUREMENT PwrDistbnUnitT_FirCalc.uRawAvrg " / FIR: simple average calculated uRaw" SWORD Volt 1 100 -6553.600 6553.400 FORMAT "%8.3" ECU_ADDRESS 0x6001F3FE /end MEASUREMENT
/begin MEASUREMENT PwrDistbnUnitT_FirCalc.uRawFir " / FIR: Calculated uRaw" SWORD Volt 1 100 -6553.600 6553.400 FORMAT "%8.3" ECU_ADDRESS 0x6001F400 /end MEASUREMENT
/begin MEASUREMENT PwrDistbnUnitT_FirRead.cntr " / Counter for simple average FIR" UBYTE OneToOne 1 100 0.00 255.0 FORMAT "%5.1" ECU_ADDRESS 0x60000650 /end MEASUREMENT
/begin MEASUREMENT PwrDistbnUnitT_FirRead.flgFirstRun " / FIR: 1st run after init" UBYTE OneToOne 1 100 0.00 1.000 BIT_MASK 0x1 FORMAT "%5.3" ECU_ADDRESS 0x60000651 /end MEASUREMENT
/begin MEASUREMENT PwrDistbnUnitT_FirRead.idxArr " / FIR ringbuffer: actual index" UBYTE OneToOne 1 100 0.00 255.0 FORMAT "%5.1" ECU_ADDRESS 0x60000652 /end MEASUREMENT
/begin MEASUREMENT PwrDistbnUnitT_FirRead.uSum " / Simple average FIR: sum of uRaws" SLONG Volt 1 100 -429496729.600 429496729.400 FORMAT "%13.3" ECU_ADDRESS 0x60000654 /end MEASUREMENT
/begin MEASUREMENT PwrDistbnUnitT_stMonStdSens "" ULONG OneToOne 1 100 0.00 4294967295.00 FORMAT "%13.2" ECU_ADDRESS 0x60001028
 /begin IF_DATA XCPplus 0x0102
  /begin DAQ_EVENT VARIABLE /end DAQ_EVENT
 /end IF_DATA
/end MEASUREMENT
/begin MEASUREMENT PwrDistbnUnitT_stSnsrActv "" UBYTE OneToOne 1 100 0.00 255.0 BIT_MASK 0x1 FORMAT "%5.1" ECU_ADDRESS 0x600236A4
 /begin IF_DATA XCPplus 0x0102
  /begin DAQ_EVENT VARIABLE /end DAQ_EVENT
 /end IF_DATA
/end MEASUREMENT
/begin MEASUREMENT PwrDistbnUnitT_stSnsrDdCalc "" UBYTE OneToOne 1 100 0.00 255.0 BIT_MASK 0x1 FORMAT "%5.1" ECU_ADDRESS 0x600236A3
 /begin IF_DATA XCPplus 0x0102
  /begin DAQ_EVENT VARIABLE /end DAQ_EVENT
 /end IF_DATA
/end MEASUREMENT
/begin MEASUREMENT PwrDistbnUnitT_stSnsrDdReadCalc "" UBYTE OneToOne 1 100 0.00 255.0 BIT_MASK 0x1 FORMAT "%5.1" ECU_ADDRESS 0x600236A2
 /begin IF_DATA XCPplus 0x0102
  /begin DAQ_EVENT VARIABLE /end DAQ_EVENT
 /end IF_DATA
/end MEASUREMENT
/begin MEASUREMENT PwrDistbnUnitT_swtConfStdSens2C "" ULONG OneToOne 1 100 0.00 4294967295.00 FORMAT "%13.2" ECU_ADDRESS 0x6000064C /end MEASUREMENT
/begin MEASUREMENT PwrDistbnUnitT_swtConfStdSensC "" ULONG OneToOne 1 100 0.00 4294967295.00 FORMAT "%13.2" ECU_ADDRESS 0x60000648 /end MEASUREMENT
/begin MEASUREMENT PwrDistbnUnitT_swtConfStdSensSwVersC "" ULONG OneToOne 1 100 0.00 4294967295.00 FORMAT "%13.2" ECU_ADDRESS 0x60000644 /end MEASUREMENT
/begin MEASUREMENT PwrDistbnUnitT_swtSensMode "" UBYTE OneToOne 1 100 0.00 255.0 FORMAT "%5.1" ECU_ADDRESS 0x6002378B /end MEASUREMENT
/begin MEASUREMENT PwrDistbnUnitT_swtSensPres "" UBYTE OneToOne 1 100 0.00 255.0 FORMAT "%5.1" ECU_ADDRESS 0x6002378A
 /begin IF_DATA XCPplus 0x0102
  /begin DAQ_EVENT VARIABLE /end DAQ_EVENT
 /end IF_DATA
/end MEASUREMENT
/begin MEASUREMENT PwrDistbnUnitT_tDynThresPhysRngHi_f_mp "" FLOAT32_IEEE RBPtCel_t_1p0_3 1 100 -1.00000000E+037 1.00000000E+037 FORMAT "%13.3" ECU_ADDRESS 0x70006820 /end MEASUREMENT
/begin MEASUREMENT PwrDistbnUnitT_tDynThresPhysRngLo_f_mp "" FLOAT32_IEEE RBPtCel_t_1p0_3 1 100 -1.00000000E+037 1.00000000E+037 FORMAT "%13.3" ECU_ADDRESS 0x7000681C /end MEASUREMENT
/begin MEASUREMENT PwrDistbnUnitT_tiSRCMaxDefDeb "" SLONG Time_ms 1 100 -21474836480.0 21474836470.0 FORMAT "%13.1" ECU_ADDRESS 0x600010A4
 /begin IF_DATA XCPplus 0x0102
  /begin DAQ_EVENT VARIABLE /end DAQ_EVENT
 /end IF_DATA
/end MEASUREMENT
/begin MEASUREMENT PwrDistbnUnitT_tRefSnsr_mp "" SWORD Temp_Cels 1 100 -3549.940 3003.560 FORMAT "%8.3" ECU_ADDRESS 0x7000694A /end MEASUREMENT
/begin MEASUREMENT PwrDistbnUnitT_tSensCpl "" SWORD OneToOne 1 100 -32768.00 32767.00 FORMAT "%8.2" ECU_ADDRESS 0x6001FD92
 /begin IF_DATA XCPplus 0x0102
  /begin DAQ_EVENT VARIABLE /end DAQ_EVENT
 /end IF_DATA
/end MEASUREMENT
/begin MEASUREMENT PwrDistbnUnitT_tSensGradLim_f_mp "" FLOAT32_IEEE RBPtCel_t_1p0_3 1 100 -1.00000000E+037 1.00000000E+037 FORMAT "%13.3" ECU_ADDRESS 0x70006824
 /begin IF_DATA XCPplus 0x0102
  /begin DAQ_EVENT VARIABLE /end DAQ_EVENT
 /end IF_DATA
/end MEASUREMENT
/begin MEASUREMENT PwrDistbnUnitT_tSensOffsCorrd_f "" FLOAT32_IEEE RBPtCel_t_1p0_3 1 100 -1.00000000E+037 1.00000000E+037 FORMAT "%13.3" ECU_ADDRESS 0x60001124
 /begin IF_DATA XCPplus 0x0102
  /begin DAQ_EVENT VARIABLE /end DAQ_EVENT
 /end IF_DATA
/end MEASUREMENT
/begin MEASUREMENT PwrDistbnUnitT_tSensPT1Fltd_mp "" SWORD RBPtCel_t_1p0_3 1 100 -32768.00 32767.00 FORMAT "%8.2" ECU_ADDRESS 0x70006948 /end MEASUREMENT
/begin MEASUREMENT PwrDistbnUnitT_tSensUnFltd "" SWORD RBPtCel_t_1p0_3 1 100 -32768.00 32767.00 FORMAT "%8.2" ECU_ADDRESS 0x6001FD8E
 /begin IF_DATA XCPplus 0x0102
  /begin DAQ_EVENT VARIABLE /end DAQ_EVENT
 /end IF_DATA
/end MEASUREMENT
/begin MEASUREMENT PwrDistbnUnitT_tSens_f "" FLOAT32_IEEE RBPtCel_t_1p0_3 1 100 -1.00000000E+037 1.00000000E+037 FORMAT "%13.3" ECU_ADDRESS 0x60001120
 /begin IF_DATA XCPplus 0x0102
  /begin DAQ_EVENT VARIABLE /end DAQ_EVENT
 /end IF_DATA
/end MEASUREMENT
/begin MEASUREMENT PwrDistbnUnitT_tUnFlt_f "" FLOAT32_IEEE RBPtCel_t_1p0_3 1 100 -1.00000000E+037 1.00000000E+037 FORMAT "%13.3" ECU_ADDRESS 0x6000111C
 /begin IF_DATA XCPplus 0x0102
  /begin DAQ_EVENT VARIABLE /end DAQ_EVENT
 /end IF_DATA
/end MEASUREMENT
/begin MEASUREMENT PwrDistbnUnitT_t_f "Actual physical value" FLOAT32_IEEE RBPtCel_t_1p0_3 1 100 -1.00000000E+037 1.00000000E+037 FORMAT "%13.3" ECU_ADDRESS 0x60001118
 /begin IF_DATA XCPplus 0x0102
  /begin DAQ_EVENT VARIABLE /end DAQ_EVENT
 /end IF_DATA
/end MEASUREMENT
/begin MEASUREMENT PwrDistbnUnitT_t_f_Sq "" UBYTE SigQly_COMPU_VERB 1 100 0.00 15.0000000000 FORMAT "%13.10" ECU_ADDRESS 0x60023789
 /begin IF_DATA XCPplus 0x0102
  /begin DAQ_EVENT VARIABLE /end DAQ_EVENT
 /end IF_DATA
/end MEASUREMENT
/begin MEASUREMENT PwrDistbnUnitT_uRaw "" SWORD Volt 1 100 -6553.600 6553.400 FORMAT "%8.3" ECU_ADDRESS 0x6001FD8C
 /begin IF_DATA XCPplus 0x0102
  /begin DAQ_EVENT VARIABLE /end DAQ_EVENT
 /end IF_DATA
/end MEASUREMENT
/begin MEASUREMENT PwrDistbnUnitT_uRawPT1Fltd "" SWORD Volt 1 100 -6553.600 6553.400 FORMAT "%8.3" ECU_ADDRESS 0x6001FD8A
 /begin IF_DATA XCPplus 0x0102
  /begin DAQ_EVENT VARIABLE /end DAQ_EVENT
 /end IF_DATA
/end MEASUREMENT
/begin MEASUREMENT PwrDistbnUnitT_uRawPT1FltdSens "" SWORD Volt 1 100 -6553.600 6553.400 FORMAT "%8.3" ECU_ADDRESS 0x6001FD88
 /begin IF_DATA XCPplus 0x0102
  /begin DAQ_EVENT VARIABLE /end DAQ_EVENT
 /end IF_DATA
/end MEASUREMENT
/begin MEASUREMENT PwrDistbnUnitT_uRawUnFltd "" SWORD Volt 1 100 -6553.600 6553.400 FORMAT "%8.3" ECU_ADDRESS 0x6001FD86
 /begin IF_DATA XCPplus 0x0102
  /begin DAQ_EVENT VARIABLE /end DAQ_EVENT
 /end IF_DATA
/end MEASUREMENT
/begin MEASUREMENT PwrDistbnUnitT_uRaw_f "" FLOAT32_IEEE RBPtCel_u_1p0_2 1 100 -1.00000000E+037 1.00000000E+037 FORMAT "%13.3" ECU_ADDRESS 0x60001114
 /begin IF_DATA XCPplus 0x0102
  /begin DAQ_EVENT VARIABLE /end DAQ_EVENT
 /end IF_DATA
/end MEASUREMENT
/begin MEASUREMENT rba_EcuCtrl_ActiveClientLookup "" UBYTE rba_EcuCtrl_ClientVerb 1 100 0.00 24. FORMAT "%2.0" MATRIX_DIM 16 ECU_ADDRESS 0x60023751 /end MEASUREMENT
/begin MEASUREMENT rba_EcuCtrl_RessourceActv "" UWORD OneToOne 1 100 0.00 65535.00 FORMAT "%8.2" ECU_ADDRESS 0x6001FC94 /end MEASUREMENT
/begin MEASUREMENT rba_EcuCtrl_RessourceActv_DSM_BegPd "" UWORD rba_EcuCtrl_stVerb 1 100 0.00 0.00 BIT_MASK 0x1 FORMAT "%4.2" ECU_ADDRESS 0x6001FC94 /end MEASUREMENT
/begin MEASUREMENT rba_EcuCtrl_RessourceActv_DSM_EndPd "" UWORD rba_EcuCtrl_stVerb 1 100 0.00 0.00 BIT_MASK 0x2 FORMAT "%4.2" ECU_ADDRESS 0x6001FC94 /end MEASUREMENT
/begin MEASUREMENT rba_EcuCtrl_RessourceActv_DSM_EndPreDrv "" UWORD rba_EcuCtrl_stVerb 1 100 0.00 0.00 BIT_MASK 0x4 FORMAT "%4.2" ECU_ADDRESS 0x6001FC94 /end MEASUREMENT
/begin MEASUREMENT rba_EcuCtrl_RessourceActv_MemAfterSwOn "" UWORD rba_EcuCtrl_stVerb 1 100 0.00 0.00 BIT_MASK 0x10 FORMAT "%4.2" ECU_ADDRESS 0x6001FC94 /end MEASUREMENT
/begin MEASUREMENT rba_EcuCtrl_RessourceActv_Mem_EndPd "" UWORD rba_EcuCtrl_stVerb 1 100 0.00 0.00 BIT_MASK 0x20 FORMAT "%4.2" ECU_ADDRESS 0x6001FC94 /end MEASUREMENT
/begin MEASUREMENT rba_EcuCtrl_RessourceActv_MRly "" UWORD rba_EcuCtrl_stVerb 1 100 0.00 0.00 BIT_MASK 0x8 FORMAT "%4.2" ECU_ADDRESS 0x6001FC94 /end MEASUREMENT
/begin MEASUREMENT rba_EcuCtrl_RessourceActv_NwM "" UWORD rba_EcuCtrl_stVerb 1 100 0.00 0.00 BIT_MASK 0x40 FORMAT "%4.2" ECU_ADDRESS 0x6001FC94 /end MEASUREMENT
/begin MEASUREMENT rba_EcuCtrl_RessourceActv_StayOn "" UWORD rba_EcuCtrl_stVerb 1 100 0.00 0.00 BIT_MASK 0x80 FORMAT "%4.2" ECU_ADDRESS 0x6001FC94 /end MEASUREMENT
/begin MEASUREMENT rba_EcuCtrl_RessourceActv_SwOn "" UWORD rba_EcuCtrl_stVerb 1 100 0.00 0.00 BIT_MASK 0x100 FORMAT "%4.2" ECU_ADDRESS 0x6001FC94 /end MEASUREMENT
/begin MEASUREMENT rba_EcuCtrl_RessourceInfo "" UWORD OneToOne 1 100 0.00 65535.00 FORMAT "%8.2" ECU_ADDRESS 0x6001FC92 /end MEASUREMENT
/begin MEASUREMENT rba_EcuCtrl_RessourceInfo_DSM_BegPd "" UWORD rba_EcuCtrl_stVerb 1 100 0.00 0.00 BIT_MASK 0x1 FORMAT "%4.2" ECU_ADDRESS 0x6001FC92 /end MEASUREMENT
/begin MEASUREMENT rba_EcuCtrl_RessourceInfo_DSM_EndPd "" UWORD rba_EcuCtrl_stVerb 1 100 0.00 0.00 BIT_MASK 0x2 FORMAT "%4.2" ECU_ADDRESS 0x6001FC92 /end MEASUREMENT
/begin MEASUREMENT rba_EcuCtrl_RessourceInfo_DSM_EndPreDrv "" UWORD rba_EcuCtrl_stVerb 1 100 0.00 0.00 BIT_MASK 0x4 FORMAT "%4.2" ECU_ADDRESS 0x6001FC92 /end MEASUREMENT
/begin MEASUREMENT rba_EcuCtrl_RessourceInfo_MemAfterSwOn "" UWORD rba_EcuCtrl_stVerb 1 100 0.00 0.00 BIT_MASK 0x10 FORMAT "%4.2" ECU_ADDRESS 0x6001FC92 /end MEASUREMENT
/begin MEASUREMENT rba_EcuCtrl_RessourceInfo_Mem_EndPd "" UWORD rba_EcuCtrl_stVerb 1 100 0.00 0.00 BIT_MASK 0x20 FORMAT "%4.2" ECU_ADDRESS 0x6001FC92 /end MEASUREMENT
/begin MEASUREMENT rba_EcuCtrl_RessourceInfo_MRly "" UWORD rba_EcuCtrl_stVerb 1 100 0.00 0.00 BIT_MASK 0x8 FORMAT "%4.2" ECU_ADDRESS 0x6001FC92 /end MEASUREMENT
/begin MEASUREMENT rba_EcuCtrl_RessourceInfo_NwM "" UWORD rba_EcuCtrl_stVerb 1 100 0.00 0.00 BIT_MASK 0x40 FORMAT "%4.2" ECU_ADDRESS 0x6001FC92 /end MEASUREMENT
/begin MEASUREMENT rba_EcuCtrl_RessourceInfo_StayOn "" UWORD rba_EcuCtrl_stVerb 1 100 0.00 0.00 BIT_MASK 0x80 FORMAT "%4.2" ECU_ADDRESS 0x6001FC92 /end MEASUREMENT
/begin MEASUREMENT rba_EcuCtrl_RessourceInfo_SwOn "" UWORD rba_EcuCtrl_stVerb 1 100 0.00 0.00 BIT_MASK 0x100 FORMAT "%4.2" ECU_ADDRESS 0x6001FC92 /end MEASUREMENT
/begin MEASUREMENT rba_EcuCtrl_stClient.ChrgSys_Ctrl_PreDrv "" UBYTE rba_EcuCtrl_stVerb 1 100 0.00 0.00 FORMAT "%4.2" ECU_ADDRESS 0x70002210 /end MEASUREMENT
/begin MEASUREMENT rba_EcuCtrl_stClient.ChrgSys_Ctrl_PstDrv "" UBYTE rba_EcuCtrl_stVerb 1 100 0.00 0.00 FORMAT "%4.2" ECU_ADDRESS 0x70002212 /end MEASUREMENT
/begin MEASUREMENT rba_EcuCtrl_stClient.Epm_nEngNotZero "" UBYTE rba_EcuCtrl_stVerb 1 100 0.00 0.00 FORMAT "%4.2" ECU_ADDRESS 0x70002214 /end MEASUREMENT
/begin MEASUREMENT rba_EcuCtrl_stClient.Fan1_stdactr_PreDrv "" UBYTE rba_EcuCtrl_stVerb 1 100 0.00 0.00 FORMAT "%4.2" ECU_ADDRESS 0x70002216 /end MEASUREMENT
/begin MEASUREMENT rba_EcuCtrl_stClient.Fan1_stdactr_PstDrv "" UBYTE rba_EcuCtrl_stVerb 1 100 0.00 0.00 FORMAT "%4.2" ECU_ADDRESS 0x70002218 /end MEASUREMENT
/begin MEASUREMENT rba_EcuCtrl_stClient.Internal_PartialWakeup "" UBYTE rba_EcuCtrl_stVerb 1 100 0.00 0.00 FORMAT "%4.2" ECU_ADDRESS 0x7000221A /end MEASUREMENT
/begin MEASUREMENT rba_EcuCtrl_stClient.IntlckChrgPlg_stdactr_PreDrv "" UBYTE rba_EcuCtrl_stVerb 1 100 0.00 0.00 FORMAT "%4.2" ECU_ADDRESS 0x7000221C /end MEASUREMENT
/begin MEASUREMENT rba_EcuCtrl_stClient.IntlckChrgPlg_stdactr_PstDrv "" UBYTE rba_EcuCtrl_stVerb 1 100 0.00 0.00 FORMAT "%4.2" ECU_ADDRESS 0x7000221E /end MEASUREMENT
/begin MEASUREMENT rba_EcuCtrl_stClient.PartialWakeup "" UBYTE rba_EcuCtrl_stVerb 1 100 0.00 0.00 FORMAT "%4.2" ECU_ADDRESS 0x70002220 /end MEASUREMENT
/begin MEASUREMENT rba_EcuCtrl_stClient.SCtPmp1_stdactr_PreDrv "" UBYTE rba_EcuCtrl_stVerb 1 100 0.00 0.00 FORMAT "%4.2" ECU_ADDRESS 0x70002222 /end MEASUREMENT
/begin MEASUREMENT rba_EcuCtrl_stClient.SCtPmp1_stdactr_PstDrv "" UBYTE rba_EcuCtrl_stVerb 1 100 0.00 0.00 FORMAT "%4.2" ECU_ADDRESS 0x70002224 /end MEASUREMENT
/begin MEASUREMENT rba_EcuCtrl_stClient.SCtPmpRly_stdactr_PreDrv "" UBYTE rba_EcuCtrl_stVerb 1 100 0.00 0.00 FORMAT "%4.2" ECU_ADDRESS 0x70002226 /end MEASUREMENT
/begin MEASUREMENT rba_EcuCtrl_stClient.SCtPmpRly_stdactr_PstDrv "" UBYTE rba_EcuCtrl_stVerb 1 100 0.00 0.00 FORMAT "%4.2" ECU_ADDRESS 0x70002228 /end MEASUREMENT
/begin MEASUREMENT rba_EcuCtrl_stClient.SpplCooltPmpRly_stdactr_PreDrv "" UBYTE rba_EcuCtrl_stVerb 1 100 0.00 0.00 FORMAT "%4.2" ECU_ADDRESS 0x7000222A /end MEASUREMENT
/begin MEASUREMENT rba_EcuCtrl_stClient.SpplCooltPmpRly_stdactr_PstDrv "" UBYTE rba_EcuCtrl_stVerb 1 100 0.00 0.00 FORMAT "%4.2" ECU_ADDRESS 0x7000222C /end MEASUREMENT
/begin MEASUREMENT rba_EcuCtrl_stClient.SysA_DelMinPostDrv "" UBYTE rba_EcuCtrl_stVerb 1 100 0.00 0.00 FORMAT "%4.2" ECU_ADDRESS 0x7000222E /end MEASUREMENT
/begin MEASUREMENT rba_EcuCtrl_stClient.SysA_DelMinPreDrv "" UBYTE rba_EcuCtrl_stVerb 1 100 0.00 0.00 FORMAT "%4.2" ECU_ADDRESS 0x70002230 /end MEASUREMENT
/begin MEASUREMENT rba_EcuCtrl_stClient.SysA_PrlgPostDrv "" UBYTE rba_EcuCtrl_stVerb 1 100 0.00 0.00 FORMAT "%4.2" ECU_ADDRESS 0x70002232 /end MEASUREMENT
/begin MEASUREMENT rba_EcuCtrl_stClient.SysA_PrlgPreDrv "" UBYTE rba_EcuCtrl_stVerb 1 100 0.00 0.00 FORMAT "%4.2" ECU_ADDRESS 0x70002234 /end MEASUREMENT
/begin MEASUREMENT rba_EcuCtrl_stClient.T15 "" UBYTE rba_EcuCtrl_stVerb 1 100 0.00 0.00 FORMAT "%4.2" ECU_ADDRESS 0x70002236 /end MEASUREMENT
/begin MEASUREMENT rba_EcuCtrl_stClient.ThermMod_OperMod_PreDrv "" UBYTE rba_EcuCtrl_stVerb 1 100 0.00 0.00 FORMAT "%4.2" ECU_ADDRESS 0x70002238 /end MEASUREMENT
/begin MEASUREMENT rba_EcuCtrl_stClient.ThermMod_OperMod_PstDrv "" UBYTE rba_EcuCtrl_stVerb 1 100 0.00 0.00 FORMAT "%4.2" ECU_ADDRESS 0x7000223A /end MEASUREMENT
/begin MEASUREMENT rba_EcuCtrl_stClient.Transitory "" UBYTE rba_EcuCtrl_stVerb 1 100 0.00 0.00 FORMAT "%4.2" ECU_ADDRESS 0x7000223C /end MEASUREMENT
/begin MEASUREMENT rba_EcuCtrl_stClient.eem_prolgecuactv_PreDrv "" UBYTE rba_EcuCtrl_stVerb 1 100 0.00 0.00 FORMAT "%4.2" ECU_ADDRESS 0x7000223E /end MEASUREMENT
/begin MEASUREMENT rba_EcuCtrl_stClient.eem_prolgecuactv_PstDrv "" UBYTE rba_EcuCtrl_stVerb 1 100 0.00 0.00 FORMAT "%4.2" ECU_ADDRESS 0x70002240 /end MEASUREMENT
/begin MEASUREMENT rba_EcuCtrl_stMn "" UBYTE rba_EcuCtrl_stMnVerb 1 100 0.00 2. FORMAT "%2.0" ECU_ADDRESS 0x60023750 /end MEASUREMENT
/begin MEASUREMENT rba_EcuCtrl_stRessource.DSM_BegPd "" UBYTE rba_EcuCtrl_stVerb 1 100 0.00 0.00 FORMAT "%4.2" ECU_ADDRESS 0x70002206 /end MEASUREMENT
/begin MEASUREMENT rba_EcuCtrl_stRessource.DSM_EndPd "" UBYTE rba_EcuCtrl_stVerb 1 100 0.00 0.00 FORMAT "%4.2" ECU_ADDRESS 0x70002207 /end MEASUREMENT
/begin MEASUREMENT rba_EcuCtrl_stRessource.DSM_EndPreDrv "" UBYTE rba_EcuCtrl_stVerb 1 100 0.00 0.00 FORMAT "%4.2" ECU_ADDRESS 0x70002208 /end MEASUREMENT
/begin MEASUREMENT rba_EcuCtrl_stRessource.MRly "" UBYTE rba_EcuCtrl_stVerb 1 100 0.00 0.00 FORMAT "%4.2" ECU_ADDRESS 0x70002209 /end MEASUREMENT
/begin MEASUREMENT rba_EcuCtrl_stRessource.MemAfterSwOn "" UBYTE rba_EcuCtrl_stVerb 1 100 0.00 0.00 FORMAT "%4.2" ECU_ADDRESS 0x7000220A /end MEASUREMENT
/begin MEASUREMENT rba_EcuCtrl_stRessource.Mem_EndPd "" UBYTE rba_EcuCtrl_stVerb 1 100 0.00 0.00 FORMAT "%4.2" ECU_ADDRESS 0x7000220B /end MEASUREMENT
/begin MEASUREMENT rba_EcuCtrl_stRessource.NwM "" UBYTE rba_EcuCtrl_stVerb 1 100 0.00 0.00 FORMAT "%4.2" ECU_ADDRESS 0x7000220C /end MEASUREMENT
/begin MEASUREMENT rba_EcuCtrl_stRessource.StayOn "" UBYTE rba_EcuCtrl_stVerb 1 100 0.00 0.00 FORMAT "%4.2" ECU_ADDRESS 0x7000220D /end MEASUREMENT
/begin MEASUREMENT rba_EcuCtrl_stRessource.SwOn "" UBYTE rba_EcuCtrl_stVerb 1 100 0.00 0.00 FORMAT "%4.2" ECU_ADDRESS 0x7000220E /end MEASUREMENT
/begin MEASUREMENT rba_EcuCtrl_stSub "" UBYTE rba_EcuCtrl_stSubVerb 1 100 0.00 5. FORMAT "%2.0" ECU_ADDRESS 0x6002374F /end MEASUREMENT
/begin MEASUREMENT rba_EcuCtrl_tiLastShutdown "" ULONG Time_s 1 100 0.00 42949672.9500 FORMAT "%13.4" ECU_ADDRESS 0x60035F7C /end MEASUREMENT
/begin MEASUREMENT rba_EcuCtrl_xClientActvInfo "" UBYTE default 1 100 0.00 255.0 FORMAT "%5.1" MATRIX_DIM 4 ECU_ADDRESS 0x60023015 /end MEASUREMENT
/begin MEASUREMENT rba_EcuCtrl_xClientActvInfo_ChrgSys_Ctrl_PreDrv "" UBYTE rba_EcuCtrl_stVerbCall 1 100 0.00 1. BIT_MASK 0x1 FORMAT "%2.0" ECU_ADDRESS 0x60023015 /end MEASUREMENT
/begin MEASUREMENT rba_EcuCtrl_xClientActvInfo_ChrgSys_Ctrl_PstDrv "" UBYTE rba_EcuCtrl_stVerbCall 1 100 0.00 1. BIT_MASK 0x2 FORMAT "%2.0" ECU_ADDRESS 0x60023015 /end MEASUREMENT
/begin MEASUREMENT rba_EcuCtrl_xClientActvInfo_eem_prolgecuactv_PreDrv "" UBYTE rba_EcuCtrl_stVerbCall 1 100 0.00 1. BIT_MASK 0x80 FORMAT "%2.0" ECU_ADDRESS 0x60023017 /end MEASUREMENT
/begin MEASUREMENT rba_EcuCtrl_xClientActvInfo_eem_prolgecuactv_PstDrv "" UBYTE rba_EcuCtrl_stVerbCall 1 100 0.00 1. BIT_MASK 0x1 FORMAT "%2.0" ECU_ADDRESS 0x60023018 /end MEASUREMENT
/begin MEASUREMENT rba_EcuCtrl_xClientActvInfo_Epm_nEngNotZero "" UBYTE rba_EcuCtrl_stVerbCall 1 100 0.00 1. BIT_MASK 0x4 FORMAT "%2.0" ECU_ADDRESS 0x60023015 /end MEASUREMENT
/begin MEASUREMENT rba_EcuCtrl_xClientActvInfo_Fan1_stdactr_PreDrv "" UBYTE rba_EcuCtrl_stVerbCall 1 100 0.00 1. BIT_MASK 0x8 FORMAT "%2.0" ECU_ADDRESS 0x60023015 /end MEASUREMENT
/begin MEASUREMENT rba_EcuCtrl_xClientActvInfo_Fan1_stdactr_PstDrv "" UBYTE rba_EcuCtrl_stVerbCall 1 100 0.00 1. BIT_MASK 0x10 FORMAT "%2.0" ECU_ADDRESS 0x60023015 /end MEASUREMENT
/begin MEASUREMENT rba_EcuCtrl_xClientActvInfo_Internal_PartialWakeup "" UBYTE rba_EcuCtrl_stVerbCall 1 100 0.00 1. BIT_MASK 0x20 FORMAT "%2.0" ECU_ADDRESS 0x60023015 /end MEASUREMENT
/begin MEASUREMENT rba_EcuCtrl_xClientActvInfo_IntlckChrgPlg_stdactr_PreDrv "" UBYTE rba_EcuCtrl_stVerbCall 1 100 0.00 1. BIT_MASK 0x40 FORMAT "%2.0" ECU_ADDRESS 0x60023015 /end MEASUREMENT
/begin MEASUREMENT rba_EcuCtrl_xClientActvInfo_IntlckChrgPlg_stdactr_PstDrv "" UBYTE rba_EcuCtrl_stVerbCall 1 100 0.00 1. BIT_MASK 0x80 FORMAT "%2.0" ECU_ADDRESS 0x60023015 /end MEASUREMENT
/begin MEASUREMENT rba_EcuCtrl_xClientActvInfo_PartialWakeup "" UBYTE rba_EcuCtrl_stVerbCall 1 100 0.00 1. BIT_MASK 0x1 FORMAT "%2.0" ECU_ADDRESS 0x60023016 /end MEASUREMENT
/begin MEASUREMENT rba_EcuCtrl_xClientActvInfo_SCtPmp1_stdactr_PreDrv "" UBYTE rba_EcuCtrl_stVerbCall 1 100 0.00 1. BIT_MASK 0x2 FORMAT "%2.0" ECU_ADDRESS 0x60023016 /end MEASUREMENT
/begin MEASUREMENT rba_EcuCtrl_xClientActvInfo_SCtPmp1_stdactr_PstDrv "" UBYTE rba_EcuCtrl_stVerbCall 1 100 0.00 1. BIT_MASK 0x4 FORMAT "%2.0" ECU_ADDRESS 0x60023016 /end MEASUREMENT
/begin MEASUREMENT rba_EcuCtrl_xClientActvInfo_SCtPmpRly_stdactr_PreDrv "" UBYTE rba_EcuCtrl_stVerbCall 1 100 0.00 1. BIT_MASK 0x8 FORMAT "%2.0" ECU_ADDRESS 0x60023016 /end MEASUREMENT
/begin MEASUREMENT rba_EcuCtrl_xClientActvInfo_SCtPmpRly_stdactr_PstDrv "" UBYTE rba_EcuCtrl_stVerbCall 1 100 0.00 1. BIT_MASK 0x10 FORMAT "%2.0" ECU_ADDRESS 0x60023016 /end MEASUREMENT
/begin MEASUREMENT rba_EcuCtrl_xClientActvInfo_SpplCooltPmpRly_stdactr_PreDrv "" UBYTE rba_EcuCtrl_stVerbCall 1 100 0.00 1. BIT_MASK 0x20 FORMAT "%2.0" ECU_ADDRESS 0x60023016 /end MEASUREMENT
/begin MEASUREMENT rba_EcuCtrl_xClientActvInfo_SpplCooltPmpRly_stdactr_PstDrv "" UBYTE rba_EcuCtrl_stVerbCall 1 100 0.00 1. BIT_MASK 0x40 FORMAT "%2.0" ECU_ADDRESS 0x60023016 /end MEASUREMENT
/begin MEASUREMENT rba_EcuCtrl_xClientActvInfo_SysA_DelMinPostDrv "" UBYTE rba_EcuCtrl_stVerbCall 1 100 0.00 1. BIT_MASK 0x80 FORMAT "%2.0" ECU_ADDRESS 0x60023016 /end MEASUREMENT
/begin MEASUREMENT rba_EcuCtrl_xClientActvInfo_SysA_DelMinPreDrv "" UBYTE rba_EcuCtrl_stVerbCall 1 100 0.00 1. BIT_MASK 0x1 FORMAT "%2.0" ECU_ADDRESS 0x60023017 /end MEASUREMENT
/begin MEASUREMENT rba_EcuCtrl_xClientActvInfo_SysA_PrlgPostDrv "" UBYTE rba_EcuCtrl_stVerbCall 1 100 0.00 1. BIT_MASK 0x2 FORMAT "%2.0" ECU_ADDRESS 0x60023017 /end MEASUREMENT
/begin MEASUREMENT rba_EcuCtrl_xClientActvInfo_SysA_PrlgPreDrv "" UBYTE rba_EcuCtrl_stVerbCall 1 100 0.00 1. BIT_MASK 0x4 FORMAT "%2.0" ECU_ADDRESS 0x60023017 /end MEASUREMENT
/begin MEASUREMENT rba_EcuCtrl_xClientActvInfo_T15 "" UBYTE rba_EcuCtrl_stVerbCall 1 100 0.00 1. BIT_MASK 0x8 FORMAT "%2.0" ECU_ADDRESS 0x60023017 /end MEASUREMENT
/begin MEASUREMENT rba_EcuCtrl_xClientActvInfo_ThermMod_OperMod_PreDrv "" UBYTE rba_EcuCtrl_stVerbCall 1 100 0.00 1. BIT_MASK 0x10 FORMAT "%2.0" ECU_ADDRESS 0x60023017 /end MEASUREMENT
/begin MEASUREMENT rba_EcuCtrl_xClientActvInfo_ThermMod_OperMod_PstDrv "" UBYTE rba_EcuCtrl_stVerbCall 1 100 0.00 1. BIT_MASK 0x20 FORMAT "%2.0" ECU_ADDRESS 0x60023017 /end MEASUREMENT
/begin MEASUREMENT rba_EcuCtrl_xClientActvInfo_Transitory "" UBYTE rba_EcuCtrl_stVerbCall 1 100 0.00 1. BIT_MASK 0x40 FORMAT "%2.0" ECU_ADDRESS 0x60023017 /end MEASUREMENT
/begin MEASUREMENT rba_EcuCtrl_xClientDeactvInfo "" UBYTE default 1 100 0.00 255.0 FORMAT "%5.1" MATRIX_DIM 4 ECU_ADDRESS 0x60023011 /end MEASUREMENT
/begin MEASUREMENT rba_EcuCtrl_xClientDeactvInfo_ChrgSys_Ctrl_PreDrv "" UBYTE rba_EcuCtrl_stVerbCall 1 100 0.00 1. BIT_MASK 0x1 FORMAT "%2.0" ECU_ADDRESS 0x60023011 /end MEASUREMENT
/begin MEASUREMENT rba_EcuCtrl_xClientDeactvInfo_ChrgSys_Ctrl_PstDrv "" UBYTE rba_EcuCtrl_stVerbCall 1 100 0.00 1. BIT_MASK 0x2 FORMAT "%2.0" ECU_ADDRESS 0x60023011 /end MEASUREMENT
/begin MEASUREMENT rba_EcuCtrl_xClientDeactvInfo_eem_prolgecuactv_PreDrv "" UBYTE rba_EcuCtrl_stVerbCall 1 100 0.00 1. BIT_MASK 0x80 FORMAT "%2.0" ECU_ADDRESS 0x60023013 /end MEASUREMENT
/begin MEASUREMENT rba_EcuCtrl_xClientDeactvInfo_eem_prolgecuactv_PstDrv "" UBYTE rba_EcuCtrl_stVerbCall 1 100 0.00 1. BIT_MASK 0x1 FORMAT "%2.0" ECU_ADDRESS 0x60023014 /end MEASUREMENT
/begin MEASUREMENT rba_EcuCtrl_xClientDeactvInfo_Epm_nEngNotZero "" UBYTE rba_EcuCtrl_stVerbCall 1 100 0.00 1. BIT_MASK 0x4 FORMAT "%2.0" ECU_ADDRESS 0x60023011 /end MEASUREMENT
/begin MEASUREMENT rba_EcuCtrl_xClientDeactvInfo_Fan1_stdactr_PreDrv "" UBYTE rba_EcuCtrl_stVerbCall 1 100 0.00 1. BIT_MASK 0x8 FORMAT "%2.0" ECU_ADDRESS 0x60023011 /end MEASUREMENT
/begin MEASUREMENT rba_EcuCtrl_xClientDeactvInfo_Fan1_stdactr_PstDrv "" UBYTE rba_EcuCtrl_stVerbCall 1 100 0.00 1. BIT_MASK 0x10 FORMAT "%2.0" ECU_ADDRESS 0x60023011 /end MEASUREMENT
/begin MEASUREMENT rba_EcuCtrl_xClientDeactvInfo_Internal_PartialWakeup "" UBYTE rba_EcuCtrl_stVerbCall 1 100 0.00 1. BIT_MASK 0x20 FORMAT "%2.0" ECU_ADDRESS 0x60023011 /end MEASUREMENT
/begin MEASUREMENT rba_EcuCtrl_xClientDeactvInfo_IntlckChrgPlg_stdactr_PreDrv "" UBYTE rba_EcuCtrl_stVerbCall 1 100 0.00 1. BIT_MASK 0x40 FORMAT "%2.0" ECU_ADDRESS 0x60023011 /end MEASUREMENT
/begin MEASUREMENT rba_EcuCtrl_xClientDeactvInfo_IntlckChrgPlg_stdactr_PstDrv "" UBYTE rba_EcuCtrl_stVerbCall 1 100 0.00 1. BIT_MASK 0x80 FORMAT "%2.0" ECU_ADDRESS 0x60023011 /end MEASUREMENT
/begin MEASUREMENT rba_EcuCtrl_xClientDeactvInfo_PartialWakeup "" UBYTE rba_EcuCtrl_stVerbCall 1 100 0.00 1. BIT_MASK 0x1 FORMAT "%2.0" ECU_ADDRESS 0x60023012 /end MEASUREMENT
/begin MEASUREMENT rba_EcuCtrl_xClientDeactvInfo_SCtPmp1_stdactr_PreDrv "" UBYTE rba_EcuCtrl_stVerbCall 1 100 0.00 1. BIT_MASK 0x2 FORMAT "%2.0" ECU_ADDRESS 0x60023012 /end MEASUREMENT
/begin MEASUREMENT rba_EcuCtrl_xClientDeactvInfo_SCtPmp1_stdactr_PstDrv "" UBYTE rba_EcuCtrl_stVerbCall 1 100 0.00 1. BIT_MASK 0x4 FORMAT "%2.0" ECU_ADDRESS 0x60023012 /end MEASUREMENT
/begin MEASUREMENT rba_EcuCtrl_xClientDeactvInfo_SCtPmpRly_stdactr_PreDrv "" UBYTE rba_EcuCtrl_stVerbCall 1 100 0.00 1. BIT_MASK 0x8 FORMAT "%2.0" ECU_ADDRESS 0x60023012 /end MEASUREMENT
/begin MEASUREMENT rba_EcuCtrl_xClientDeactvInfo_SCtPmpRly_stdactr_PstDrv "" UBYTE rba_EcuCtrl_stVerbCall 1 100 0.00 1. BIT_MASK 0x10 FORMAT "%2.0" ECU_ADDRESS 0x60023012 /end MEASUREMENT
/begin MEASUREMENT rba_EcuCtrl_xClientDeactvInfo_SpplCooltPmpRly_stdactr_PreDrv "" UBYTE rba_EcuCtrl_stVerbCall 1 100 0.00 1. BIT_MASK 0x20 FORMAT "%2.0" ECU_ADDRESS 0x60023012 /end MEASUREMENT
/begin MEASUREMENT rba_EcuCtrl_xClientDeactvInfo_SpplCooltPmpRly_stdactr_PstDrv "" UBYTE rba_EcuCtrl_stVerbCall 1 100 0.00 1. BIT_MASK 0x40 FORMAT "%2.0" ECU_ADDRESS 0x60023012 /end MEASUREMENT
/begin MEASUREMENT rba_EcuCtrl_xClientDeactvInfo_SysA_DelMinPostDrv "" UBYTE rba_EcuCtrl_stVerbCall 1 100 0.00 1. BIT_MASK 0x80 FORMAT "%2.0" ECU_ADDRESS 0x60023012 /end MEASUREMENT
/begin MEASUREMENT rba_EcuCtrl_xClientDeactvInfo_SysA_DelMinPreDrv "" UBYTE rba_EcuCtrl_stVerbCall 1 100 0.00 1. BIT_MASK 0x1 FORMAT "%2.0" ECU_ADDRESS 0x60023013 /end MEASUREMENT
/begin MEASUREMENT rba_EcuCtrl_xClientDeactvInfo_SysA_PrlgPostDrv "" UBYTE rba_EcuCtrl_stVerbCall 1 100 0.00 1. BIT_MASK 0x2 FORMAT "%2.0" ECU_ADDRESS 0x60023013 /end MEASUREMENT
/begin MEASUREMENT rba_EcuCtrl_xClientDeactvInfo_SysA_PrlgPreDrv "" UBYTE rba_EcuCtrl_stVerbCall 1 100 0.00 1. BIT_MASK 0x4 FORMAT "%2.0" ECU_ADDRESS 0x60023013 /end MEASUREMENT
/begin MEASUREMENT rba_EcuCtrl_xClientDeactvInfo_T15 "" UBYTE rba_EcuCtrl_stVerbCall 1 100 0.00 1. BIT_MASK 0x8 FORMAT "%2.0" ECU_ADDRESS 0x60023013 /end MEASUREMENT
/begin MEASUREMENT rba_EcuCtrl_xClientDeactvInfo_ThermMod_OperMod_PreDrv "" UBYTE rba_EcuCtrl_stVerbCall 1 100 0.00 1. BIT_MASK 0x10 FORMAT "%2.0" ECU_ADDRESS 0x60023013 /end MEASUREMENT
/begin MEASUREMENT rba_EcuCtrl_xClientDeactvInfo_ThermMod_OperMod_PstDrv "" UBYTE rba_EcuCtrl_stVerbCall 1 100 0.00 1. BIT_MASK 0x20 FORMAT "%2.0" ECU_ADDRESS 0x60023013 /end MEASUREMENT
/begin MEASUREMENT rba_EcuCtrl_xClientDeactvInfo_Transitory "" UBYTE rba_EcuCtrl_stVerbCall 1 100 0.00 1. BIT_MASK 0x40 FORMAT "%2.0" ECU_ADDRESS 0x60023013 /end MEASUREMENT
/begin MEASUREMENT rba_EcuCtrl_xClientToutBits "" UBYTE default 1 100 0.00 255.0 FORMAT "%5.1" MATRIX_DIM 4 ECU_ADDRESS 0x60035F80 /end MEASUREMENT
/begin MEASUREMENT rba_EcuCtrl_xClientToutInfo_ChrgSys_Ctrl_PreDrv "" UBYTE rba_EcuCtrl_stVerbTout 1 100 0.00 1. BIT_MASK 0x1 FORMAT "%2.0" ECU_ADDRESS 0x60035F80 /end MEASUREMENT
/begin MEASUREMENT rba_EcuCtrl_xClientToutInfo_ChrgSys_Ctrl_PstDrv "" UBYTE rba_EcuCtrl_stVerbTout 1 100 0.00 1. BIT_MASK 0x2 FORMAT "%2.0" ECU_ADDRESS 0x60035F80 /end MEASUREMENT
/begin MEASUREMENT rba_EcuCtrl_xClientToutInfo_eem_prolgecuactv_PreDrv "" UBYTE rba_EcuCtrl_stVerbTout 1 100 0.00 1. BIT_MASK 0x80 FORMAT "%2.0" ECU_ADDRESS 0x60035F82 /end MEASUREMENT
/begin MEASUREMENT rba_EcuCtrl_xClientToutInfo_eem_prolgecuactv_PstDrv "" UBYTE rba_EcuCtrl_stVerbTout 1 100 0.00 1. BIT_MASK 0x1 FORMAT "%2.0" ECU_ADDRESS 0x60035F83 /end MEASUREMENT
/begin MEASUREMENT rba_EcuCtrl_xClientToutInfo_Epm_nEngNotZero "" UBYTE rba_EcuCtrl_stVerbTout 1 100 0.00 1. BIT_MASK 0x4 FORMAT "%2.0" ECU_ADDRESS 0x60035F80 /end MEASUREMENT
/begin MEASUREMENT rba_EcuCtrl_xClientToutInfo_Fan1_stdactr_PreDrv "" UBYTE rba_EcuCtrl_stVerbTout 1 100 0.00 1. BIT_MASK 0x8 FORMAT "%2.0" ECU_ADDRESS 0x60035F80 /end MEASUREMENT
/begin MEASUREMENT rba_EcuCtrl_xClientToutInfo_Fan1_stdactr_PstDrv "" UBYTE rba_EcuCtrl_stVerbTout 1 100 0.00 1. BIT_MASK 0x10 FORMAT "%2.0" ECU_ADDRESS 0x60035F80 /end MEASUREMENT
/begin MEASUREMENT rba_EcuCtrl_xClientToutInfo_Internal_PartialWakeup "" UBYTE rba_EcuCtrl_stVerbTout 1 100 0.00 1. BIT_MASK 0x20 FORMAT "%2.0" ECU_ADDRESS 0x60035F80 /end MEASUREMENT
/begin MEASUREMENT rba_EcuCtrl_xClientToutInfo_IntlckChrgPlg_stdactr_PreDrv "" UBYTE rba_EcuCtrl_stVerbTout 1 100 0.00 1. BIT_MASK 0x40 FORMAT "%2.0" ECU_ADDRESS 0x60035F80 /end MEASUREMENT
/begin MEASUREMENT rba_EcuCtrl_xClientToutInfo_IntlckChrgPlg_stdactr_PstDrv "" UBYTE rba_EcuCtrl_stVerbTout 1 100 0.00 1. BIT_MASK 0x80 FORMAT "%2.0" ECU_ADDRESS 0x60035F80 /end MEASUREMENT
/begin MEASUREMENT rba_EcuCtrl_xClientToutInfo_PartialWakeup "" UBYTE rba_EcuCtrl_stVerbTout 1 100 0.00 1. BIT_MASK 0x1 FORMAT "%2.0" ECU_ADDRESS 0x60035F81 /end MEASUREMENT
/begin MEASUREMENT rba_EcuCtrl_xClientToutInfo_SCtPmp1_stdactr_PreDrv "" UBYTE rba_EcuCtrl_stVerbTout 1 100 0.00 1. BIT_MASK 0x2 FORMAT "%2.0" ECU_ADDRESS 0x60035F81 /end MEASUREMENT
/begin MEASUREMENT rba_EcuCtrl_xClientToutInfo_SCtPmp1_stdactr_PstDrv "" UBYTE rba_EcuCtrl_stVerbTout 1 100 0.00 1. BIT_MASK 0x4 FORMAT "%2.0" ECU_ADDRESS 0x60035F81 /end MEASUREMENT
/begin MEASUREMENT rba_EcuCtrl_xClientToutInfo_SCtPmpRly_stdactr_PreDrv "" UBYTE rba_EcuCtrl_stVerbTout 1 100 0.00 1. BIT_MASK 0x8 FORMAT "%2.0" ECU_ADDRESS 0x60035F81 /end MEASUREMENT
/begin MEASUREMENT rba_EcuCtrl_xClientToutInfo_SCtPmpRly_stdactr_PstDrv "" UBYTE rba_EcuCtrl_stVerbTout 1 100 0.00 1. BIT_MASK 0x10 FORMAT "%2.0" ECU_ADDRESS 0x60035F81 /end MEASUREMENT
/begin MEASUREMENT rba_EcuCtrl_xClientToutInfo_SpplCooltPmpRly_stdactr_PreDrv "" UBYTE rba_EcuCtrl_stVerbTout 1 100 0.00 1. BIT_MASK 0x20 FORMAT "%2.0" ECU_ADDRESS 0x60035F81 /end MEASUREMENT
/begin MEASUREMENT rba_EcuCtrl_xClientToutInfo_SpplCooltPmpRly_stdactr_PstDrv "" UBYTE rba_EcuCtrl_stVerbTout 1 100 0.00 1. BIT_MASK 0x40 FORMAT "%2.0" ECU_ADDRESS 0x60035F81 /end MEASUREMENT
/begin MEASUREMENT rba_EcuCtrl_xClientToutInfo_SysA_DelMinPostDrv "" UBYTE rba_EcuCtrl_stVerbTout 1 100 0.00 1. BIT_MASK 0x80 FORMAT "%2.0" ECU_ADDRESS 0x60035F81 /end MEASUREMENT
/begin MEASUREMENT rba_EcuCtrl_xClientToutInfo_SysA_DelMinPreDrv "" UBYTE rba_EcuCtrl_stVerbTout 1 100 0.00 1. BIT_MASK 0x1 FORMAT "%2.0" ECU_ADDRESS 0x60035F82 /end MEASUREMENT
/begin MEASUREMENT rba_EcuCtrl_xClientToutInfo_SysA_PrlgPostDrv "" UBYTE rba_EcuCtrl_stVerbTout 1 100 0.00 1. BIT_MASK 0x2 FORMAT "%2.0" ECU_ADDRESS 0x60035F82 /end MEASUREMENT
/begin MEASUREMENT rba_EcuCtrl_xClientToutInfo_SysA_PrlgPreDrv "" UBYTE rba_EcuCtrl_stVerbTout 1 100 0.00 1. BIT_MASK 0x4 FORMAT "%2.0" ECU_ADDRESS 0x60035F82 /end MEASUREMENT
/begin MEASUREMENT rba_EcuCtrl_xClientToutInfo_T15 "" UBYTE rba_EcuCtrl_stVerbTout 1 100 0.00 1. BIT_MASK 0x8 FORMAT "%2.0" ECU_ADDRESS 0x60035F82 /end MEASUREMENT
/begin MEASUREMENT rba_EcuCtrl_xClientToutInfo_ThermMod_OperMod_PreDrv "" UBYTE rba_EcuCtrl_stVerbTout 1 100 0.00 1. BIT_MASK 0x10 FORMAT "%2.0" ECU_ADDRESS 0x60035F82 /end MEASUREMENT
/begin MEASUREMENT rba_EcuCtrl_xClientToutInfo_ThermMod_OperMod_PstDrv "" UBYTE rba_EcuCtrl_stVerbTout 1 100 0.00 1. BIT_MASK 0x20 FORMAT "%2.0" ECU_ADDRESS 0x60035F82 /end MEASUREMENT
/begin MEASUREMENT rba_EcuCtrl_xClientToutInfo_Transitory "" UBYTE rba_EcuCtrl_stVerbTout 1 100 0.00 1. BIT_MASK 0x40 FORMAT "%2.0" ECU_ADDRESS 0x60035F82 /end MEASUREMENT
/begin MEASUREMENT rba_MemDiagExtd_nrLstReadSngErr "Block id of last occurred read error for single storage blocks" UWORD OneToOne 1 100 0.00 65535.00 FORMAT "%8.2" ECU_ADDRESS 0x600347B6 /end MEASUREMENT
/begin MEASUREMENT rba_MemDiag_flgInhbDiag "Diagnosis is inhibited" UBYTE B_TRUE 1 100 0.00 1.00000000000 BIT_MASK 0x1 FORMAT "%13.11" ECU_ADDRESS 0x70000112
 /begin IF_DATA XCPplus 0x0102
  /begin DAQ_EVENT VARIABLE /end DAQ_EVENT
 /end IF_DATA
/end MEASUREMENT
/begin MEASUREMENT rba_MemDiag_nrLstReadErr "Block id of last occurred read error" UWORD OneToOne 1 100 0.00 65535.00 FORMAT "%8.2" ECU_ADDRESS 0x600347B4 /end MEASUREMENT
/begin MEASUREMENT rba_MemDiag_nrLstWrErr "Block id of last occurred write error" UWORD OneToOne 1 100 0.00 65535.00 FORMAT "%8.2" ECU_ADDRESS 0x600347B2 /end MEASUREMENT
/begin MEASUREMENT RefgntCirc_flgCmprShtOff "AC compressor shut off condition" UBYTE B_TRUE 1 100 0.00 1.00000000000 BIT_MASK 0x1 FORMAT "%13.11" ECU_ADDRESS 0x70000111
 /begin IF_DATA XCPplus 0x0102
  /begin DAQ_EVENT VARIABLE /end DAQ_EVENT
 /end IF_DATA
/end MEASUREMENT
/begin MEASUREMENT RefgntCirc_pwrRefgntDes "desired refrigerant power" SWORD RBPtCel_pwr_25p0_1 1 100 -819200.0 819175.0 FORMAT "%8.1" ECU_ADDRESS 0x6001F9DC
 /begin IF_DATA XCPplus 0x0102
  /begin DAQ_EVENT VARIABLE /end DAQ_EVENT
 /end IF_DATA
/end MEASUREMENT
/begin MEASUREMENT RefgntCirc_stAcDes "desired AC status" UBYTE q1 1 100 0.00 255.0 FORMAT "%5.1" ECU_ADDRESS 0x60023441
 /begin IF_DATA XCPplus 0x0102
  /begin DAQ_EVENT VARIABLE /end DAQ_EVENT
 /end IF_DATA
/end MEASUREMENT
/begin MEASUREMENT RefgntCirc_stAcFrntVlv "valve status AC front" UBYTE q1 1 100 0.00 255.0 FORMAT "%5.1" ECU_ADDRESS 0x60023440
 /begin IF_DATA XCPplus 0x0102
  /begin DAQ_EVENT VARIABLE /end DAQ_EVENT
 /end IF_DATA
/end MEASUREMENT
/begin MEASUREMENT RefgntCirc_stChillrVlv "valve status chiller" UBYTE q1 1 100 0.00 255.0 FORMAT "%5.1" ECU_ADDRESS 0x6002343F
 /begin IF_DATA XCPplus 0x0102
  /begin DAQ_EVENT VARIABLE /end DAQ_EVENT
 /end IF_DATA
/end MEASUREMENT
/begin MEASUREMENT RefgntCirc_stCmprOvrdReq "comprssor control override request" UBYTE q1 1 100 0.00 255.0 FORMAT "%5.1" ECU_ADDRESS 0x6002343E
 /begin IF_DATA XCPplus 0x0102
  /begin DAQ_EVENT VARIABLE /end DAQ_EVENT
 /end IF_DATA
/end MEASUREMENT
/begin MEASUREMENT Reset_APP_rUnFlt "Protected copy of APP_rUnFlt for freeze frame" SWORD Prc 1 100 -400.0000 399.9878 FORMAT "%8.4" ECU_ADDRESS 0x600347B0 /end MEASUREMENT
/begin MEASUREMENT Reset_BattU_u "Battery voltage" SWORD Volt_Batt 1 100 -655360.0 655340.0 FORMAT "%8.1" ECU_ADDRESS 0x600347AE /end MEASUREMENT
/begin MEASUREMENT Reset_Emac_tqDesCom01 "" SWORD Trq 1 100 -3276.800 3276.700 FORMAT "%8.3" ECU_ADDRESS 0x600347AC /end MEASUREMENT
/begin MEASUREMENT Reset_Env_ctRst "Reset counter which counts all resets" UBYTE OneToOne 1 100 0.00 255.0 FORMAT "%5.1" ECU_ADDRESS 0x6002343D /end MEASUREMENT
/begin MEASUREMENT Reset_Env_xGrp "Reset group of last reset" UBYTE OneToOne 1 100 0.00 255.0 FORMAT "%5.1" ECU_ADDRESS 0x60023010 /end MEASUREMENT
/begin MEASUREMENT Reset_Env_xId "Reset-ID of the last reset reason (Copy of Reset_Env.xId)" UWORD OneToOne 1 100 0.00 65535.00 FORMAT "%8.2" ECU_ADDRESS 0x6001F3FA /end MEASUREMENT
/begin MEASUREMENT Reset_GlbDa_lTotDst "total distance since first start captured at software reset" SLONG Length 1 100 -2147483648.00 2147483647.00 FORMAT "%13.2" ECU_ADDRESS 0x600347A8 /end MEASUREMENT
/begin MEASUREMENT Reset_SyC_stRCD "" UBYTE SyC_stRCDVerb 1 100 0.00 6.00000000000 FORMAT "%13.11" ECU_ADDRESS 0x600347A7 /end MEASUREMENT
/begin MEASUREMENT Reset_T15_st "Protected copy of T15_st for freeze frame" UBYTE OneToOne 1 100 0.00 255.0 BIT_MASK 0x1 FORMAT "%5.1" ECU_ADDRESS 0x600347A6 /end MEASUREMENT
/begin MEASUREMENT Reset_VehV_v "Protected copy of Veh_v for freeze frame" SWORD Vel 1 100 -327.6800 327.6700 FORMAT "%8.4" ECU_ADDRESS 0x600347EC /end MEASUREMENT
/begin MEASUREMENT SCtPmp1_DiagGrdKey.stBits " / status of DGK, shows current state" UBYTE OneToOne 1 100 0.00 255.0 FORMAT "%5.1" ECU_ADDRESS 0x60000624 /end MEASUREMENT
/begin MEASUREMENT SCtPmp1_DiagGrdKey.tiDifSCGDisad " / The time how long SCG was detected before SCG was disabled" SLONG Time_ms 1 100 -21474836480.0 21474836470.0 FORMAT "%13.1" ECU_ADDRESS 0x60000628 /end MEASUREMENT
/begin MEASUREMENT SCtPmp1_DiagGrdKey.tiSCGDet " / Error time for DGK window" SLONG Time_ms 1 100 -21474836480.0 21474836470.0 FORMAT "%13.1" ECU_ADDRESS 0x6000062C /end MEASUREMENT
/begin MEASUREMENT SCtPmp1_DiagGrdKey.tiPausDet " / Pause time for DGK window" SLONG Time_ms 1 100 -21474836480.0 21474836470.0 FORMAT "%13.1" ECU_ADDRESS 0x60000630 /end MEASUREMENT
/begin MEASUREMENT SCtPmp1_DiagGrdKey.stAliveBits " / State bits for alive error DFC" UBYTE OneToOne 1 100 0.00 255.0 FORMAT "%5.1" ECU_ADDRESS 0x60000634 /end MEASUREMENT
/begin MEASUREMENT SCtPmp1_DiagGrdKey.ctGlbDefReIni " / e_:Variable to store SyC_ctPostDrvLeave:_e;d_:Variable zur Speicherung von SyC_ctPostDrvLeave:_d" UBYTE OneToOne 1 100 0.00 255.0 FORMAT "%5.1" ECU_ADDRESS 0x60000635 /end MEASUREMENT
/begin MEASUREMENT SCtPmp1_flgActrReq "" UBYTE OneToOne 1 100 0.00 255.0 BIT_MASK 0x1 FORMAT "%5.1" ECU_ADDRESS 0x6002348E /end MEASUREMENT
/begin MEASUREMENT SCtPmp1_flgActrSwtOffReq "" UBYTE OneToOne 1 100 0.00 255.0 FORMAT "%5.1" ECU_ADDRESS 0x60023511
 /begin IF_DATA XCPplus 0x0102
  /begin DAQ_EVENT VARIABLE /end DAQ_EVENT
 /end IF_DATA
/end MEASUREMENT
/begin MEASUREMENT SCtPmp1_flgElecDiagSwtOffReq "" UBYTE OneToOne 1 100 0.00 255.0 FORMAT "%5.1" ECU_ADDRESS 0x60023510
 /begin IF_DATA XCPplus 0x0102
  /begin DAQ_EVENT VARIABLE /end DAQ_EVENT
 /end IF_DATA
/end MEASUREMENT
/begin MEASUREMENT SCtPmp1_flgMonXPostDrv_mp "" UBYTE OneToOne 1 100 0.00 255.0 FORMAT "%5.1" ECU_ADDRESS 0x70006B5C /end MEASUREMENT
/begin MEASUREMENT SCtPmp1_flgPwrStgReq "" UBYTE OneToOne 1 100 0.00 1.000 FORMAT "%5.3" ECU_ADDRESS 0x6002350F
 /begin IF_DATA XCPplus 0x0102
  /begin DAQ_EVENT VARIABLE /end DAQ_EVENT
 /end IF_DATA
/end MEASUREMENT
/begin MEASUREMENT SCtPmp1_numSigID "" UWORD OneToOne 1 100 0.00 65535.00 FORMAT "%8.2" ECU_ADDRESS 0x6001F3F8 /end MEASUREMENT
/begin MEASUREMENT SCtPmp1_r "Control value provided by governor" SWORD Prc 1 100 -400.0000 399.9878 FORMAT "%8.4" ECU_ADDRESS 0x6001FD84
 /begin IF_DATA XCPplus 0x0102
  /begin DAQ_EVENT VARIABLE /end DAQ_EVENT
 /end IF_DATA
/end MEASUREMENT
/begin MEASUREMENT SCtPmp1_rAct "" SWORD Prc 1 100 -400.0000 399.9878 FORMAT "%8.4" ECU_ADDRESS 0x6001FD82
 /begin IF_DATA XCPplus 0x0102
  /begin DAQ_EVENT VARIABLE /end DAQ_EVENT
 /end IF_DATA
/end MEASUREMENT
/begin MEASUREMENT SCtPmp1_rActr "" SWORD Prc 1 100 -400.0000 399.9878 FORMAT "%8.4" ECU_ADDRESS 0x6001FD80
 /begin IF_DATA XCPplus 0x0102
  /begin DAQ_EVENT VARIABLE /end DAQ_EVENT
 /end IF_DATA
/end MEASUREMENT
/begin MEASUREMENT SCtPmp1_rAct_Sq "" UBYTE SigQly_COMPU_VERB 1 100 0.00 15.0000000000 FORMAT "%13.10" ECU_ADDRESS 0x60023788
 /begin IF_DATA XCPplus 0x0102
  /begin DAQ_EVENT VARIABLE /end DAQ_EVENT
 /end IF_DATA
/end MEASUREMENT
/begin MEASUREMENT SCtPmp1_ratActPosnB1 "" SWORD rel_q0p0078125 1 100 -256.0000 255.9922 FORMAT "%8.4" ECU_ADDRESS 0x6001FD74
 /begin IF_DATA XCPplus 0x0102
  /begin DAQ_EVENT VARIABLE /end DAQ_EVENT
 /end IF_DATA
/end MEASUREMENT
/begin MEASUREMENT SCtPmp1_rDesVal "" SWORD Prc 1 100 -400.0000 399.9878 FORMAT "%8.4" ECU_ADDRESS 0x6001FD7E
 /begin IF_DATA XCPplus 0x0102
  /begin DAQ_EVENT VARIABLE /end DAQ_EVENT
 /end IF_DATA
/end MEASUREMENT
/begin MEASUREMENT SCtPmp1_rDesValATS "" SWORD Prc 1 100 -400.0000 399.9878 FORMAT "%8.4" ECU_ADDRESS 0x700012BE
 /begin IF_DATA XCPplus 0x0102
  /begin DAQ_EVENT VARIABLE /end DAQ_EVENT
 /end IF_DATA
/end MEASUREMENT
/begin MEASUREMENT SCtPmp1_rGovActr "" SWORD Prc 1 100 -400.0000 399.9878 FORMAT "%8.4" ECU_ADDRESS 0x70001528
 /begin IF_DATA XCPplus 0x0102
  /begin DAQ_EVENT VARIABLE /end DAQ_EVENT
 /end IF_DATA
/end MEASUREMENT
/begin MEASUREMENT SCtPmp1_rMax "" SWORD DtyCyc 1 100 -327.6800 327.6700 FORMAT "%8.4" ECU_ADDRESS 0x6001FD7C
 /begin IF_DATA XCPplus 0x0102
  /begin DAQ_EVENT VARIABLE /end DAQ_EVENT
 /end IF_DATA
/end MEASUREMENT
/begin MEASUREMENT SCtPmp1_rMin "" SWORD DtyCyc 1 100 -327.6800 327.6700 FORMAT "%8.4" ECU_ADDRESS 0x6001FD7A
 /begin IF_DATA XCPplus 0x0102
  /begin DAQ_EVENT VARIABLE /end DAQ_EVENT
 /end IF_DATA
/end MEASUREMENT
/begin MEASUREMENT SCtPmp1_rPs "Output signal to actuator" SWORD DtyCyc 1 100 -327.6800 327.6700 FORMAT "%8.4" ECU_ADDRESS 0x6001FD78
 /begin IF_DATA XCPplus 0x0102
  /begin DAQ_EVENT VARIABLE /end DAQ_EVENT
 /end IF_DATA
/end MEASUREMENT
/begin MEASUREMENT SCtPmp1_rPsDiaLim_mp "" SWORD DtyCyc 1 100 -327.6800 327.6700 FORMAT "%8.4" ECU_ADDRESS 0x70006946 /end MEASUREMENT
/begin MEASUREMENT SCtPmp1_rSens "" SWORD Prc 1 100 -400.0000 399.9878 FORMAT "%8.4" ECU_ADDRESS 0x6001FD76
 /begin IF_DATA XCPplus 0x0102
  /begin DAQ_EVENT VARIABLE /end DAQ_EVENT
 /end IF_DATA
/end MEASUREMENT
/begin MEASUREMENT SCtPmp1_selfDiagPostDrv_mp "" UBYTE OneToOne 1 100 0.00 255.0 FORMAT "%5.1" ECU_ADDRESS 0x70006B5B /end MEASUREMENT
/begin MEASUREMENT SCtPmp1_SigTyp "" UBYTE OneToOne 1 100 0.00 255.0 FORMAT "%5.1" ECU_ADDRESS 0x6002300F
 /begin IF_DATA XCPplus 0x0102
  /begin DAQ_EVENT VARIABLE /end DAQ_EVENT
 /end IF_DATA
/end MEASUREMENT
/begin MEASUREMENT SCtPmp1_stActrAvl "" UBYTE B_TRUE 1 100 0.00 1.00000000000 BIT_MASK 0x1 FORMAT "%13.11" ECU_ADDRESS 0x6002348D
 /begin IF_DATA XCPplus 0x0102
  /begin DAQ_EVENT VARIABLE /end DAQ_EVENT
 /end IF_DATA
/end MEASUREMENT
/begin MEASUREMENT SCtPmp1_stCoEng "" UBYTE OneToOne 1 100 0.00 255.0 FORMAT "%5.1" ECU_ADDRESS 0x60023787
 /begin IF_DATA XCPplus 0x0102
  /begin DAQ_EVENT VARIABLE /end DAQ_EVENT
 /end IF_DATA
/end MEASUREMENT
/begin MEASUREMENT SCtPmp1_stDeactvn "" UBYTE OneToOne 1 100 0.00 255.0 FORMAT "%5.1" ECU_ADDRESS 0x60023786
 /begin IF_DATA XCPplus 0x0102
  /begin DAQ_EVENT VARIABLE /end DAQ_EVENT
 /end IF_DATA
/end MEASUREMENT
/begin MEASUREMENT SCtPmp1_stDesVal "" UBYTE OneToOne 1 100 0.00 255.0 FORMAT "%5.1" ECU_ADDRESS 0x60023785
 /begin IF_DATA XCPplus 0x0102
  /begin DAQ_EVENT VARIABLE /end DAQ_EVENT
 /end IF_DATA
/end MEASUREMENT
/begin MEASUREMENT SCtPmp1_stElecDiag "" UBYTE OneToOne 1 100 0.00 255.0 FORMAT "%5.1" ECU_ADDRESS 0x6002350E
 /begin IF_DATA XCPplus 0x0102
  /begin DAQ_EVENT VARIABLE /end DAQ_EVENT
 /end IF_DATA
/end MEASUREMENT
/begin MEASUREMENT SCtPmp1_stErrInfo "" ULONG OneToOne 1 100 0.00 4294967295.00 FORMAT "%13.2" ECU_ADDRESS 0x60001024
 /begin IF_DATA XCPplus 0x0102
  /begin DAQ_EVENT VARIABLE /end DAQ_EVENT
 /end IF_DATA
/end MEASUREMENT
/begin MEASUREMENT SCtPmp1_stMon "" ULONG OneToOne 1 100 0.00 4294967295.00 FORMAT "%13.2" ECU_ADDRESS 0x60001020
 /begin IF_DATA XCPplus 0x0102
  /begin DAQ_EVENT VARIABLE /end DAQ_EVENT
 /end IF_DATA
/end MEASUREMENT
/begin MEASUREMENT SCtPmp1_stMonActrPwrStgDrvr "" ULONG OneToOne 1 100 0.00 2147483647.00 FORMAT "%13.2" ECU_ADDRESS 0x60000ECC
 /begin IF_DATA XCPplus 0x0102
  /begin DAQ_EVENT VARIABLE /end DAQ_EVENT
 /end IF_DATA
/end MEASUREMENT
/begin MEASUREMENT SCtPmp1_stMonCo "" ULONG OneToOne 1 100 0.00 4294967295.00 FORMAT "%13.2" ECU_ADDRESS 0x6000101C
 /begin IF_DATA XCPplus 0x0102
  /begin DAQ_EVENT VARIABLE /end DAQ_EVENT
 /end IF_DATA
/end MEASUREMENT
/begin MEASUREMENT SCtPmp1_stMonDD "" ULONG OneToOne 1 100 0.00 4294967295.00 FORMAT "%13.2" ECU_ADDRESS 0x60001018
 /begin IF_DATA XCPplus 0x0102
  /begin DAQ_EVENT VARIABLE /end DAQ_EVENT
 /end IF_DATA
/end MEASUREMENT
/begin MEASUREMENT SCtPmp1_stMonDDSens "" ULONG OneToOne 1 100 0.00 4294967295.00 FORMAT "%13.2" ECU_ADDRESS 0x60001014
 /begin IF_DATA XCPplus 0x0102
  /begin DAQ_EVENT VARIABLE /end DAQ_EVENT
 /end IF_DATA
/end MEASUREMENT
/begin MEASUREMENT SCtPmp1_stMonDiagGrdKey "" UWORD OneToOne 1 100 0.00 65535.00 FORMAT "%8.2" ECU_ADDRESS 0x6001FC98
 /begin IF_DATA XCPplus 0x0102
  /begin DAQ_EVENT VARIABLE /end DAQ_EVENT
 /end IF_DATA
/end MEASUREMENT
/begin MEASUREMENT SCtPmp1_stMonGlbElecdd "" ULONG OneToOne 1 100 0.00 2147483647.00 FORMAT "%13.2" ECU_ADDRESS 0x60000EC8
 /begin IF_DATA XCPplus 0x0102
  /begin DAQ_EVENT VARIABLE /end DAQ_EVENT
 /end IF_DATA
/end MEASUREMENT
/begin MEASUREMENT SCtPmp1_stPs "" UBYTE OneToOne 1 100 0.00 255.0 FORMAT "%5.1" ECU_ADDRESS 0x60023784
 /begin IF_DATA XCPplus 0x0102
  /begin DAQ_EVENT VARIABLE /end DAQ_EVENT
 /end IF_DATA
/end MEASUREMENT
/begin MEASUREMENT SCtPmp1_stPwrStgDrvr "" UBYTE OneToOne 1 100 0.00 255.0 FORMAT "%5.1" ECU_ADDRESS 0x6002350D
 /begin IF_DATA XCPplus 0x0102
  /begin DAQ_EVENT VARIABLE /end DAQ_EVENT
 /end IF_DATA
/end MEASUREMENT
/begin MEASUREMENT SCtPmp1_stPwrStgEnaCond "" UBYTE OneToOne 1 100 0.00 255.0 FORMAT "%5.1" ECU_ADDRESS 0x60023783
 /begin IF_DATA XCPplus 0x0102
  /begin DAQ_EVENT VARIABLE /end DAQ_EVENT
 /end IF_DATA
/end MEASUREMENT
/begin MEASUREMENT SCtPmp1_swtConf2C "" ULONG OneToOne 1 100 0.00 4294967295.00 FORMAT "%13.2" ECU_ADDRESS 0x60000640 /end MEASUREMENT
/begin MEASUREMENT SCtPmp1_swtConfActrPwrStgDrvr "" UBYTE OneToOne 1 100 0.00 255.0 FORMAT "%5.1" ECU_ADDRESS 0x6002350C /end MEASUREMENT
/begin MEASUREMENT SCtPmp1_swtConfC "" ULONG OneToOne 1 100 0.00 4294967295.00 FORMAT "%13.2" ECU_ADDRESS 0x6000063C /end MEASUREMENT
/begin MEASUREMENT SCtPmp1_swtConfDevDrvrOutpDutyCycRampC "" UBYTE OneToOne 1 100 0.00 255.0 FORMAT "%5.1" ECU_ADDRESS 0x700014B4 /end MEASUREMENT
/begin MEASUREMENT SCtPmp1_swtConfStdActrSwVersC "" ULONG OneToOne 1 100 0.00 4294967295.00 FORMAT "%13.2" ECU_ADDRESS 0x60000638 /end MEASUREMENT
/begin MEASUREMENT SCtPmp1_tEngDaFrqPs_mp "" SWORD Temp_Cels 1 100 -3549.940 3003.560 FORMAT "%8.3" ECU_ADDRESS 0x70006944
 /begin IF_DATA XCPplus 0x0102
  /begin DAQ_EVENT VARIABLE /end DAQ_EVENT
 /end IF_DATA
/end MEASUREMENT
/begin MEASUREMENT SCtPmp1_tiPeriod "" ULONG Time_usec_q1_COMPU 1 100 0.00 4294967295.00 FORMAT "%13.2" ECU_ADDRESS 0x60000EC4
 /begin IF_DATA XCPplus 0x0102
  /begin DAQ_EVENT VARIABLE /end DAQ_EVENT
 /end IF_DATA
/end MEASUREMENT
/begin MEASUREMENT SCtPmpRly_flgActrReq "" UBYTE OneToOne 1 100 0.00 255.0 BIT_MASK 0x1 FORMAT "%5.1" ECU_ADDRESS 0x6002348C /end MEASUREMENT
/begin MEASUREMENT SCtPmpRly_flgActrSwtOffReq "" UBYTE OneToOne 1 100 0.00 255.0 FORMAT "%5.1" ECU_ADDRESS 0x6002350B
 /begin IF_DATA XCPplus 0x0102
  /begin DAQ_EVENT VARIABLE /end DAQ_EVENT
 /end IF_DATA
/end MEASUREMENT
/begin MEASUREMENT SCtPmpRly_flgElecDiagSwtOffReq "" UBYTE OneToOne 1 100 0.00 255.0 FORMAT "%5.1" ECU_ADDRESS 0x6002350A
 /begin IF_DATA XCPplus 0x0102
  /begin DAQ_EVENT VARIABLE /end DAQ_EVENT
 /end IF_DATA
/end MEASUREMENT
/begin MEASUREMENT SCtPmpRly_flgMonXPostDrv_mp "" UBYTE OneToOne 1 100 0.00 255.0 FORMAT "%5.1" ECU_ADDRESS 0x70006B5A /end MEASUREMENT
/begin MEASUREMENT SCtPmpRly_flgPwrStgReq "" UBYTE OneToOne 1 100 0.00 1.000 FORMAT "%5.3" ECU_ADDRESS 0x60023509
 /begin IF_DATA XCPplus 0x0102
  /begin DAQ_EVENT VARIABLE /end DAQ_EVENT
 /end IF_DATA
/end MEASUREMENT
/begin MEASUREMENT SCtPmpRly_numSigID "" UWORD OneToOne 1 100 0.00 65535.00 FORMAT "%8.2" ECU_ADDRESS 0x6001F3F6 /end MEASUREMENT
/begin MEASUREMENT SCtPmpRly_r "Variable for auxillary water pump relay status" SWORD Prc 1 100 -400.0000 399.9878 FORMAT "%8.4" ECU_ADDRESS 0x6001FD72
 /begin IF_DATA XCPplus 0x0102
  /begin DAQ_EVENT VARIABLE /end DAQ_EVENT
 /end IF_DATA
/end MEASUREMENT
/begin MEASUREMENT SCtPmpRly_rActr "" SWORD Prc 1 100 -400.0000 399.9878 FORMAT "%8.4" ECU_ADDRESS 0x6001FD6E
 /begin IF_DATA XCPplus 0x0102
  /begin DAQ_EVENT VARIABLE /end DAQ_EVENT
 /end IF_DATA
/end MEASUREMENT
/begin MEASUREMENT SCtPmpRly_rGovActr "" SWORD Prc 1 100 -400.0000 399.9878 FORMAT "%8.4" ECU_ADDRESS 0x70001526
 /begin IF_DATA XCPplus 0x0102
  /begin DAQ_EVENT VARIABLE /end DAQ_EVENT
 /end IF_DATA
/end MEASUREMENT
/begin MEASUREMENT SCtPmpRly_rMax "" SWORD DtyCyc 1 100 -327.6800 327.6700 FORMAT "%8.4" ECU_ADDRESS 0x6001FD6A
 /begin IF_DATA XCPplus 0x0102
  /begin DAQ_EVENT VARIABLE /end DAQ_EVENT
 /end IF_DATA
/end MEASUREMENT
/begin MEASUREMENT SCtPmpRly_rMin "" SWORD DtyCyc 1 100 -327.6800 327.6700 FORMAT "%8.4" ECU_ADDRESS 0x6001FD68
 /begin IF_DATA XCPplus 0x0102
  /begin DAQ_EVENT VARIABLE /end DAQ_EVENT
 /end IF_DATA
/end MEASUREMENT
/begin MEASUREMENT SCtPmpRly_rPs "" SWORD DtyCyc 1 100 -327.6800 327.6700 FORMAT "%8.4" ECU_ADDRESS 0x6001FD66
 /begin IF_DATA XCPplus 0x0102
  /begin DAQ_EVENT VARIABLE /end DAQ_EVENT
 /end IF_DATA
/end MEASUREMENT
/begin MEASUREMENT SCtPmpRly_SigTyp "" UBYTE OneToOne 1 100 0.00 255.0 FORMAT "%5.1" ECU_ADDRESS 0x6002300E
 /begin IF_DATA XCPplus 0x0102
  /begin DAQ_EVENT VARIABLE /end DAQ_EVENT
 /end IF_DATA
/end MEASUREMENT
/begin MEASUREMENT SCtPmpRly_stCoEng "" UBYTE OneToOne 1 100 0.00 255.0 FORMAT "%5.1" ECU_ADDRESS 0x60023781
 /begin IF_DATA XCPplus 0x0102
  /begin DAQ_EVENT VARIABLE /end DAQ_EVENT
 /end IF_DATA
/end MEASUREMENT
/begin MEASUREMENT SCtPmpRly_stDeactvn "" UBYTE OneToOne 1 100 0.00 255.0 FORMAT "%5.1" ECU_ADDRESS 0x60023780
 /begin IF_DATA XCPplus 0x0102
  /begin DAQ_EVENT VARIABLE /end DAQ_EVENT
 /end IF_DATA
/end MEASUREMENT
/begin MEASUREMENT SCtPmpRly_stDesVal "" UBYTE OneToOne 1 100 0.00 255.0 FORMAT "%5.1" ECU_ADDRESS 0x6002377F
 /begin IF_DATA XCPplus 0x0102
  /begin DAQ_EVENT VARIABLE /end DAQ_EVENT
 /end IF_DATA
/end MEASUREMENT
/begin MEASUREMENT SCtPmpRly_stMonActrPwrStgDrvr "" ULONG OneToOne 1 100 0.00 2147483647.00 FORMAT "%13.2" ECU_ADDRESS 0x60000EC0
 /begin IF_DATA XCPplus 0x0102
  /begin DAQ_EVENT VARIABLE /end DAQ_EVENT
 /end IF_DATA
/end MEASUREMENT
/begin MEASUREMENT SCtPmpRly_stMonCo "" ULONG OneToOne 1 100 0.00 4294967295.00 FORMAT "%13.2" ECU_ADDRESS 0x60001008
 /begin IF_DATA XCPplus 0x0102
  /begin DAQ_EVENT VARIABLE /end DAQ_EVENT
 /end IF_DATA
/end MEASUREMENT
/begin MEASUREMENT SCtPmpRly_stMonDD "" ULONG OneToOne 1 100 0.00 4294967295.00 FORMAT "%13.2" ECU_ADDRESS 0x60001004
 /begin IF_DATA XCPplus 0x0102
  /begin DAQ_EVENT VARIABLE /end DAQ_EVENT
 /end IF_DATA
/end MEASUREMENT
/begin MEASUREMENT SCtPmpRly_stMonGlbElecdd "" ULONG OneToOne 1 100 0.00 2147483647.00 FORMAT "%13.2" ECU_ADDRESS 0x60000EBC
 /begin IF_DATA XCPplus 0x0102
  /begin DAQ_EVENT VARIABLE /end DAQ_EVENT
 /end IF_DATA
/end MEASUREMENT
/begin MEASUREMENT SCtPmpRly_stPs "" UBYTE OneToOne 1 100 0.00 255.0 FORMAT "%5.1" ECU_ADDRESS 0x6002377E
 /begin IF_DATA XCPplus 0x0102
  /begin DAQ_EVENT VARIABLE /end DAQ_EVENT
 /end IF_DATA
/end MEASUREMENT
/begin MEASUREMENT SCtPmpRly_stPwrStgDrvr "" UBYTE OneToOne 1 100 0.00 255.0 FORMAT "%5.1" ECU_ADDRESS 0x60023507
 /begin IF_DATA XCPplus 0x0102
  /begin DAQ_EVENT VARIABLE /end DAQ_EVENT
 /end IF_DATA
/end MEASUREMENT
/begin MEASUREMENT SCtPmpRly_swtConfActrPwrStgDrvr "" UBYTE OneToOne 1 100 0.00 255.0 FORMAT "%5.1" ECU_ADDRESS 0x60023506 /end MEASUREMENT
/begin MEASUREMENT SCtPmpRly_swtConfDevDrvrOutpDutyCycRampC "" UBYTE OneToOne 1 100 0.00 255.0 FORMAT "%5.1" ECU_ADDRESS 0x700014B3 /end MEASUREMENT
/begin FUNCTION PwrDistbnUnitT_DELib_StdSensDd "10.2.0"
 /begin DEF_CHARACTERISTIC DDRC_DurDeb.PwrDistbnUnitT_tiSRCMinDebOk_C DDRC_DurDeb.PwrDistbnUnitT_tiSRCMinDebDef_C DDRC_DurDeb.PwrDistbnUnitT_tiSRCOpnDebOk_C DDRC_DurDeb.PwrDistbnUnitT_tiSRCOpnDebDef_C DDRC_RatDeb.PwrDistbnUnitT_tiSRCMinUDRat_C DDRC_RatDeb.PwrDistbnUnitT_tiSRCOpnUDRat_C DFC_CtlMsk2.DFC_PwrDistbnUnitTSRCMin_C DFC_CtlMsk2.DFC_PwrDistbnUnitTSRCOpn_C DFC_CtlMsk2.DFC_PwrDistbnUnitTSRCMax_C DFC_DisblMsk2.DFC_PwrDistbnUnitTSRCMin_C DFC_DisblMsk2.DFC_PwrDistbnUnitTSRCOpn_C DFC_DisblMsk2.DFC_PwrDistbnUnitTSRCMax_C PwrDistbnUnitT_ADCCal.numSRCTempSel_C PwrDistbnUnitT_ADCCal.tiSRCMaxDebOK_C PwrDistbnUnitT_ADCCal.uSRCMax_C PwrDistbnUnitT_ADCCal.uSRCMin_C PwrDistbnUnitT_ADCCal.uSRCOpn_C PwrDistbnUnitT_ADCSensTransf_f_CUR PwrDistbnUnitT_tiSRCMaxDefDeb_CUR /end DEF_CHARACTERISTIC
 /begin REF_CHARACTERISTIC PwrDistbnUnitT_tiPT1Fil_C PwrDistbnUnitT_TransStg_f.Dfl_r32_C PwrDistbnUnitT_TransStg_f.stSensId_C /end REF_CHARACTERISTIC
 /begin IN_MEASUREMENT DELib_idxArrSnsr DELib_xArrSnsr PwrDistbnUnitT_FirRead.cntr PwrDistbnUnitT_FirRead.flgFirstRun PwrDistbnUnitT_FirRead.idxArr PwrDistbnUnitT_FirRead.uSum PwrDistbnUnitT_stSnsrDdReadCalc PwrDistbnUnitT_swtConfStdSens2C PwrDistbnUnitT_swtConfStdSensC PwrDistbnUnitT_swtConfStdSensSwVersC PwrDistbnUnitT_uRawPT1FltdSens PwrDistbnUnitT_uRawUnFltd /end IN_MEASUREMENT
 /begin OUT_MEASUREMENT DDRC_St.DFC_PwrDistbnUnitTSRCMin DDRC_St.DFC_PwrDistbnUnitTSRCOpn DFC_st.DFC_PwrDistbnUnitTSRCMin DFC_st.DFC_PwrDistbnUnitTSRCOpn DFC_st.DFC_PwrDistbnUnitTSRCMax DINH_nrActvInhReas.FId_PwrDistbnUnitTEnhdSRCMax DINH_nrActvInhReas.FId_PwrDistbnUnitTSSpMon DINH_stFId.FId_PwrDistbnUnitTEnhdSRCMax DINH_stFId.FId_PwrDistbnUnitTSSpMon PwrDistbnUnitT_FirCalc.cntrAvrgZr PwrDistbnUnitT_FirCalc.flgRdDne PwrDistbnUnitT_FirCalc.uRawAvrg PwrDistbnUnitT_FirCalc.uRawFir PwrDistbnUnitT_stSnsrDdCalc PwrDistbnUnitT_swtSensPres PwrDistbnUnitT_tiSRCMaxDefDeb PwrDistbnUnitT_tSensCpl PwrDistbnUnitT_tSensUnFltd PwrDistbnUnitT_tSens_f PwrDistbnUnitT_uRaw PwrDistbnUnitT_uRaw_f /end OUT_MEASUREMENT
 /begin LOC_MEASUREMENT PwrDistbnUnitT_DDstSnsrState_mp PwrDistbnUnitT_tRefSnsr_mp PwrDistbnUnitT_tSensPT1Fltd_mp /end LOC_MEASUREMENT
 FUNCTION_VERSION "10.2.0" /end FUNCTION
/begin FUNCTION PwrDistbnUnitT_DELib_StdSensDdRead "10.4.0" /begin DEF_CHARACTERISTIC PwrDistbnUnitT_tiPT1Fil_C /end DEF_CHARACTERISTIC
 /begin IN_MEASUREMENT PwrDistbnUnitT_FirCalc.cntrAvrgZr PwrDistbnUnitT_FirCalc.flgRdDne PwrDistbnUnitT_FirCalc.uRawAvrg PwrDistbnUnitT_FirCalc.uRawFir PwrDistbnUnitT_swtConfStdSens2C PwrDistbnUnitT_swtConfStdSensC /end IN_MEASUREMENT
 /begin OUT_MEASUREMENT PwrDistbnUnitT_FirRead.cntr PwrDistbnUnitT_FirRead.flgFirstRun PwrDistbnUnitT_FirRead.idxArr PwrDistbnUnitT_FirRead.uSum PwrDistbnUnitT_stSnsrDdReadCalc PwrDistbnUnitT_uRawPT1Fltd PwrDistbnUnitT_uRawPT1FltdSens PwrDistbnUnitT_uRawUnFltd /end OUT_MEASUREMENT
 FUNCTION_VERSION "10.4.0" /end FUNCTION
/begin FUNCTION PwrDistbnUnitT_DELib_StdSensDdSENTSlowRead "3.2.0"
 /begin IN_MEASUREMENT PwrDistbnUnitT_swtConfStdSens2C PwrDistbnUnitT_swtConfStdSensC PwrDistbnUnitT_swtConfStdSensSwVersC /end IN_MEASUREMENT
 FUNCTION_VERSION "3.2.0" /end FUNCTION
/begin FUNCTION PwrDistbnUnitT_DELib_StdSensExtDiag "8.1.0"
 /begin IN_MEASUREMENT DELib_idxArrSnsr DELib_xArrSnsr DSM_TripChgFinshd PwrDistbnUnitT_swtConfStdSensC PwrDistbnUnitT_swtConfStdSensSwVersC SyC_stSub /end IN_MEASUREMENT
 FUNCTION_VERSION "8.1.0" /end FUNCTION
/begin FUNCTION PwrDistbnUnitT_DELib_StdSensInin "8.2.0"
 /begin DEF_CHARACTERISTIC PwrDistbnUnitT_swtConfStdSens2_C PwrDistbnUnitT_swtConfStdSensSwVers162_C PwrDistbnUnitT_swtConfStdSens_C /end DEF_CHARACTERISTIC
 /begin REF_CHARACTERISTIC PwrDistbnUnitT_tiPT1Fil_C /end REF_CHARACTERISTIC
 /begin OUT_MEASUREMENT PwrDistbnUnitT_swtConfStdSens2C PwrDistbnUnitT_swtConfStdSensC PwrDistbnUnitT_swtConfStdSensSwVersC PwrDistbnUnitT_swtSensMode /end OUT_MEASUREMENT
 FUNCTION_VERSION "8.2.0" /end FUNCTION
/begin FUNCTION PwrDistbnUnitT_DELib_StdSensVd "11.0.0"
 /begin DEF_CHARACTERISTIC PwrDistbnUnitT_DigSensCal.tiDebPos_C PwrDistbnUnitT_DigSensCal.tiDebNeg_C PwrDistbnUnitT_dtGradLim_f_C PwrDistbnUnitT_RmpSlp_f.Pos_C PwrDistbnUnitT_RmpSlp_f.Neg_C PwrDistbnUnitT_tDflVal_f_C PwrDistbnUnitT_tHiLimit_f_C PwrDistbnUnitT_tiPT1_f_C PwrDistbnUnitT_tLoLimit_f_C PwrDistbnUnitT_TransStg_f.Dfl_r32_C PwrDistbnUnitT_TransStg_f.stSensId_C /end DEF_CHARACTERISTIC
 /begin IN_MEASUREMENT PwrDistbnUnitT_stSnsrDdCalc PwrDistbnUnitT_swtConfStdSensC PwrDistbnUnitT_swtConfStdSensSwVersC PwrDistbnUnitT_tSens_f /end IN_MEASUREMENT
 /begin OUT_MEASUREMENT DINH_nrActvInhReas.FId_PwrDistbnUnitTFrzVal DINH_nrActvInhReas.FId_PwrDistbnUnitTRplVal DINH_stFId.FId_PwrDistbnUnitTFrzVal DINH_stFId.FId_PwrDistbnUnitTRplVal PwrDistbnUnitT_tSensOffsCorrd_f PwrDistbnUnitT_tUnFlt_f PwrDistbnUnitT_t_f PwrDistbnUnitT_t_f_Sq /end OUT_MEASUREMENT
 /begin LOC_MEASUREMENT PwrDistbnUnitT_tSensGradLim_f_mp /end LOC_MEASUREMENT
 FUNCTION_VERSION "11.0.0" /end FUNCTION
/begin FUNCTION PwrDistbnUnitT_DELib_StdSensVdMon "9.2.0"
 /begin DEF_CHARACTERISTIC DDRC_DurDeb.PwrDistbnUnitT_tiPhysRngHiDebOk_C DDRC_DurDeb.PwrDistbnUnitT_tiPhysRngHiDebDef_C DDRC_DurDeb.PwrDistbnUnitT_tiPhysRngLoDebOk_C DDRC_DurDeb.PwrDistbnUnitT_tiPhysRngLoDebDef_C DDRC_RatDeb.PwrDistbnUnitT_tiPhysRngHiUDRat_C DDRC_RatDeb.PwrDistbnUnitT_tiPhysRngLoUDRat_C DFC_CtlMsk2.DFC_PwrDistbnUnitTPhysRngHi_C DFC_CtlMsk2.DFC_PwrDistbnUnitTPhysRngLo_C DFC_CtlMsk2.DFC_PwrDistbnUnitTTmpErr_C DFC_DisblMsk2.DFC_PwrDistbnUnitTPhysRngHi_C DFC_DisblMsk2.DFC_PwrDistbnUnitTPhysRngLo_C DFC_DisblMsk2.DFC_PwrDistbnUnitTTmpErr_C PwrDistbnUnitT_numStdSens_C PwrDistbnUnitT_numTempErrDef_C PwrDistbnUnitT_numtSel_C PwrDistbnUnitT_stEnhPhysSRCRls_MAP PwrDistbnUnitT_tEnhPhysSRCMax_f_MAP PwrDistbnUnitT_tEnhPhysSRCMin_f_MAP PwrDistbnUnitT_tiEngOnMin_C PwrDistbnUnitT_tiTempErrOk_C PwrDistbnUnitT_tSnsrMax_f_C PwrDistbnUnitT_tSnsrMin_f_C /end DEF_CHARACTERISTIC
 /begin IN_MEASUREMENT CoEng_tiNormal DELib_idxArrSnsr DELib_xArrSnsr DSM_TripChgFinshd Epm_nEng InjCtl_qSetUnBal PwrDistbnUnitT_stSnsrDdCalc PwrDistbnUnitT_swtConfStdSensC PwrDistbnUnitT_swtConfStdSensSwVersC PwrDistbnUnitT_tSens_f /end IN_MEASUREMENT
 /begin OUT_MEASUREMENT DDRC_St.DFC_PwrDistbnUnitTPhysRngHi DDRC_St.DFC_PwrDistbnUnitTPhysRngLo DFC_st.DFC_PwrDistbnUnitTPhysRngHi DFC_st.DFC_PwrDistbnUnitTPhysRngLo DFC_st.DFC_PwrDistbnUnitTTmpErr DINH_nrActvInhReas.FId_PwrDistbnUnitTPhysRng DINH_nrActvInhReas.FId_PwrDistbnUnitTTmpErrCnt DINH_stFId.FId_PwrDistbnUnitTPhysRng DINH_stFId.FId_PwrDistbnUnitTTmpErrCnt PwrDistbnUnitT_stSnsrActv /end OUT_MEASUREMENT
 /begin LOC_MEASUREMENT PwrDistbnUnitT_stMonStdSens PwrDistbnUnitT_tDynThresPhysRngHi_f_mp PwrDistbnUnitT_tDynThresPhysRngLo_f_mp /end LOC_MEASUREMENT
 FUNCTION_VERSION "9.2.0" /end FUNCTION
/begin FUNCTION rba_BypAdapt "1.44.0    Adapter to the DGS Bypass functionality"
 /begin DEF_CHARACTERISTIC rba_SvbbEtk_DisableProcExec_KWB rba_SvbbEtk_ResIdSrvPt_KWB rba_SvbbEtk_SrvPtEnabled_KWB rba_SvbbEtk_SrvPtResId_KWB rba_SvbbEtk_TimeOutPost_KWB rba_SvbbEtk_TimeOutPre_KWB /end DEF_CHARACTERISTIC
 FUNCTION_VERSION "1.44.0" /end FUNCTION
/begin FUNCTION rba_DcmCore_If "1.16.0    MSR Interface generator for Autosar DCM" FUNCTION_VERSION "1.16.0" /end FUNCTION
/begin FUNCTION rba_DiagAdapt "1.13.0    Adaption of the Diagcom Interfaces to Autosar DCM to enable usage of ComDia and DiaBas with DCM" FUNCTION_VERSION "1.13.0" /end FUNCTION
/begin FUNCTION rba_EcuCtrl "1.8.0_1.2.0Ecu state handling"
 /begin DEF_CHARACTERISTIC DFC_CtlMsk2.DFC_rba_EcuCtrl_TOMaxProlg_C DFC_CtlMsk2.DFC_rba_EcuCtrl_TOMaxShutDwn_C DFC_DisblMsk2.DFC_rba_EcuCtrl_TOMaxProlg_C DFC_DisblMsk2.DFC_rba_EcuCtrl_TOMaxShutDwn_C rba_EcuCtrl_MaxClientTO_C rba_EcuCtrl_MaxShortenTime_C rba_EcuCtrl_MaxShutDownTO_C /end DEF_CHARACTERISTIC
 /begin IN_MEASUREMENT T15_st /end IN_MEASUREMENT
 /begin OUT_MEASUREMENT DDRC_ctArDebLvl.DFC_rba_EcuCtrl_TOMaxProlg DDRC_ctArDebLvl.DFC_rba_EcuCtrl_TOMaxShutDwn DDRC_stLstRprtEve.DFC_rba_EcuCtrl_TOMaxProlg DDRC_stLstRprtEve.DFC_rba_EcuCtrl_TOMaxShutDwn DFC_st.DFC_rba_EcuCtrl_TOMaxProlg DFC_st.DFC_rba_EcuCtrl_TOMaxShutDwn rba_EcuCtrl_RessourceActv rba_EcuCtrl_RessourceInfo rba_EcuCtrl_stClient.ChrgSys_Ctrl_PreDrv rba_EcuCtrl_stClient.ChrgSys_Ctrl_PstDrv rba_EcuCtrl_stClient.Epm_nEngNotZero rba_EcuCtrl_stClient.Fan1_stdactr_PreDrv rba_EcuCtrl_stClient.Fan1_stdactr_PstDrv rba_EcuCtrl_stClient.Internal_PartialWakeup rba_EcuCtrl_stClient.IntlckChrgPlg_stdactr_PreDrv rba_EcuCtrl_stClient.IntlckChrgPlg_stdactr_PstDrv rba_EcuCtrl_stClient.PartialWakeup rba_EcuCtrl_stClient.SCtPmp1_stdactr_PreDrv rba_EcuCtrl_stClient.SCtPmp1_stdactr_PstDrv rba_EcuCtrl_stClient.SCtPmpRly_stdactr_PreDrv rba_EcuCtrl_stClient.SCtPmpRly_stdactr_PstDrv rba_EcuCtrl_stClient.SpplCooltPmpRly_stdactr_PreDrv rba_EcuCtrl_stClient.SpplCooltPmpRly_stdactr_PstDrv rba_EcuCtrl_stClient.SysA_DelMinPostDrv rba_EcuCtrl_stClient.SysA_DelMinPreDrv rba_EcuCtrl_stClient.SysA_PrlgPostDrv rba_EcuCtrl_stClient.SysA_PrlgPreDrv rba_EcuCtrl_stClient.T15 rba_EcuCtrl_stClient.ThermMod_OperMod_PreDrv rba_EcuCtrl_stClient.ThermMod_OperMod_PstDrv rba_EcuCtrl_stClient.Transitory rba_EcuCtrl_stClient.eem_prolgecuactv_PreDrv rba_EcuCtrl_stClient.eem_prolgecuactv_PstDrv rba_EcuCtrl_stMn rba_EcuCtrl_stSub rba_EcuCtrl_tiLastShutdown /end OUT_MEASUREMENT
 /begin LOC_MEASUREMENT rba_EcuCtrl_ActiveClientLookup rba_EcuCtrl_RessourceActv_DSM_BegPd rba_EcuCtrl_RessourceActv_DSM_EndPd rba_EcuCtrl_RessourceActv_DSM_EndPreDrv rba_EcuCtrl_RessourceActv_MemAfterSwOn rba_EcuCtrl_RessourceActv_Mem_EndPd rba_EcuCtrl_RessourceActv_MRly rba_EcuCtrl_RessourceActv_NwM rba_EcuCtrl_RessourceActv_StayOn rba_EcuCtrl_RessourceActv_SwOn rba_EcuCtrl_RessourceInfo_DSM_BegPd rba_EcuCtrl_RessourceInfo_DSM_EndPd rba_EcuCtrl_RessourceInfo_DSM_EndPreDrv rba_EcuCtrl_RessourceInfo_MemAfterSwOn rba_EcuCtrl_RessourceInfo_Mem_EndPd rba_EcuCtrl_RessourceInfo_MRly rba_EcuCtrl_RessourceInfo_NwM rba_EcuCtrl_RessourceInfo_StayOn rba_EcuCtrl_RessourceInfo_SwOn rba_EcuCtrl_stRessource.DSM_BegPd rba_EcuCtrl_stRessource.DSM_EndPd rba_EcuCtrl_stRessource.DSM_EndPreDrv rba_EcuCtrl_stRessource.MRly rba_EcuCtrl_stRessource.MemAfterSwOn rba_EcuCtrl_stRessource.Mem_EndPd rba_EcuCtrl_stRessource.NwM rba_EcuCtrl_stRessource.StayOn rba_EcuCtrl_stRessource.SwOn rba_EcuCtrl_xClientActvInfo rba_EcuCtrl_xClientActvInfo_ChrgSys_Ctrl_PreDrv rba_EcuCtrl_xClientActvInfo_ChrgSys_Ctrl_PstDrv rba_EcuCtrl_xClientActvInfo_eem_prolgecuactv_PreDrv rba_EcuCtrl_xClientActvInfo_eem_prolgecuactv_PstDrv rba_EcuCtrl_xClientActvInfo_Epm_nEngNotZero rba_EcuCtrl_xClientActvInfo_Fan1_stdactr_PreDrv rba_EcuCtrl_xClientActvInfo_Fan1_stdactr_PstDrv rba_EcuCtrl_xClientActvInfo_Internal_PartialWakeup rba_EcuCtrl_xClientActvInfo_IntlckChrgPlg_stdactr_PreDrv rba_EcuCtrl_xClientActvInfo_IntlckChrgPlg_stdactr_PstDrv rba_EcuCtrl_xClientActvInfo_PartialWakeup rba_EcuCtrl_xClientActvInfo_SCtPmp1_stdactr_PreDrv rba_EcuCtrl_xClientActvInfo_SCtPmp1_stdactr_PstDrv rba_EcuCtrl_xClientActvInfo_SCtPmpRly_stdactr_PreDrv rba_EcuCtrl_xClientActvInfo_SCtPmpRly_stdactr_PstDrv rba_EcuCtrl_xClientActvInfo_SpplCooltPmpRly_stdactr_PreDrv rba_EcuCtrl_xClientActvInfo_SpplCooltPmpRly_stdactr_PstDrv rba_EcuCtrl_xClientActvInfo_SysA_DelMinPostDrv rba_EcuCtrl_xClientActvInfo_SysA_DelMinPreDrv rba_EcuCtrl_xClientActvInfo_SysA_PrlgPostDrv rba_EcuCtrl_xClientActvInfo_SysA_PrlgPreDrv rba_EcuCtrl_xClientActvInfo_T15 rba_EcuCtrl_xClientActvInfo_ThermMod_OperMod_PreDrv rba_EcuCtrl_xClientActvInfo_ThermMod_OperMod_PstDrv rba_EcuCtrl_xClientActvInfo_Transitory rba_EcuCtrl_xClientDeactvInfo rba_EcuCtrl_xClientDeactvInfo_ChrgSys_Ctrl_PreDrv rba_EcuCtrl_xClientDeactvInfo_ChrgSys_Ctrl_PstDrv rba_EcuCtrl_xClientDeactvInfo_eem_prolgecuactv_PreDrv rba_EcuCtrl_xClientDeactvInfo_eem_prolgecuactv_PstDrv rba_EcuCtrl_xClientDeactvInfo_Epm_nEngNotZero rba_EcuCtrl_xClientDeactvInfo_Fan1_stdactr_PreDrv rba_EcuCtrl_xClientDeactvInfo_Fan1_stdactr_PstDrv rba_EcuCtrl_xClientDeactvInfo_Internal_PartialWakeup rba_EcuCtrl_xClientDeactvInfo_IntlckChrgPlg_stdactr_PreDrv rba_EcuCtrl_xClientDeactvInfo_IntlckChrgPlg_stdactr_PstDrv rba_EcuCtrl_xClientDeactvInfo_PartialWakeup rba_EcuCtrl_xClientDeactvInfo_SCtPmp1_stdactr_PreDrv rba_EcuCtrl_xClientDeactvInfo_SCtPmp1_stdactr_PstDrv rba_EcuCtrl_xClientDeactvInfo_SCtPmpRly_stdactr_PreDrv rba_EcuCtrl_xClientDeactvInfo_SCtPmpRly_stdactr_PstDrv rba_EcuCtrl_xClientDeactvInfo_SpplCooltPmpRly_stdactr_PreDrv rba_EcuCtrl_xClientDeactvInfo_SpplCooltPmpRly_stdactr_PstDrv rba_EcuCtrl_xClientDeactvInfo_SysA_DelMinPostDrv rba_EcuCtrl_xClientDeactvInfo_SysA_DelMinPreDrv rba_EcuCtrl_xClientDeactvInfo_SysA_PrlgPostDrv rba_EcuCtrl_xClientDeactvInfo_SysA_PrlgPreDrv rba_EcuCtrl_xClientDeactvInfo_T15 rba_EcuCtrl_xClientDeactvInfo_ThermMod_OperMod_PreDrv rba_EcuCtrl_xClientDeactvInfo_ThermMod_OperMod_PstDrv rba_EcuCtrl_xClientDeactvInfo_Transitory rba_EcuCtrl_xClientToutBits rba_EcuCtrl_xClientToutInfo_ChrgSys_Ctrl_PreDrv rba_EcuCtrl_xClientToutInfo_ChrgSys_Ctrl_PstDrv rba_EcuCtrl_xClientToutInfo_eem_prolgecuactv_PreDrv rba_EcuCtrl_xClientToutInfo_eem_prolgecuactv_PstDrv rba_EcuCtrl_xClientToutInfo_Epm_nEngNotZero rba_EcuCtrl_xClientToutInfo_Fan1_stdactr_PreDrv rba_EcuCtrl_xClientToutInfo_Fan1_stdactr_PstDrv rba_EcuCtrl_xClientToutInfo_Internal_PartialWakeup rba_EcuCtrl_xClientToutInfo_IntlckChrgPlg_stdactr_PreDrv rba_EcuCtrl_xClientToutInfo_IntlckChrgPlg_stdactr_PstDrv rba_EcuCtrl_xClientToutInfo_PartialWakeup rba_EcuCtrl_xClientToutInfo_SCtPmp1_stdactr_PreDrv rba_EcuCtrl_xClientToutInfo_SCtPmp1_stdactr_PstDrv rba_EcuCtrl_xClientToutInfo_SCtPmpRly_stdactr_PreDrv rba_EcuCtrl_xClientToutInfo_SCtPmpRly_stdactr_PstDrv rba_EcuCtrl_xClientToutInfo_SpplCooltPmpRly_stdactr_PreDrv rba_EcuCtrl_xClientToutInfo_SpplCooltPmpRly_stdactr_PstDrv rba_EcuCtrl_xClientToutInfo_SysA_DelMinPostDrv rba_EcuCtrl_xClientToutInfo_SysA_DelMinPreDrv rba_EcuCtrl_xClientToutInfo_SysA_PrlgPostDrv rba_EcuCtrl_xClientToutInfo_SysA_PrlgPreDrv rba_EcuCtrl_xClientToutInfo_T15 rba_EcuCtrl_xClientToutInfo_ThermMod_OperMod_PreDrv rba_EcuCtrl_xClientToutInfo_ThermMod_OperMod_PstDrv rba_EcuCtrl_xClientToutInfo_Transitory /end LOC_MEASUREMENT
 FUNCTION_VERSION "1.8.0_1.2.0" /end FUNCTION
/begin FUNCTION rba_EepAdaptDGS "1.39.0    Eep adapter" /begin DEF_CHARACTERISTIC Eep_ClrWrCounter_CW Eep_EnFirstInit_CW Eep_EnvRamClr_CW /end DEF_CHARACTERISTIC /begin OUT_MEASUREMENT B_eepwf B_pwf Eep_EnvRamHist Eep_EnvRamInvld /end OUT_MEASUREMENT
 /begin LOC_MEASUREMENT Eep_ctAbsCallWrFkt Eep_ctCallWrFkt Eep_ctMaxCallWrFkt Eep_PostdrvBlkIdx_s16 Eep_stBlk Eep_stMain Eep_stPostDrv /end LOC_MEASUREMENT
 FUNCTION_VERSION "1.39.0" /end FUNCTION
/begin FUNCTION rba_IoDiagPwr "1.18.0    IO Diagnose Power"
 /begin DEF_CHARACTERISTIC DDRC_DebArTime.DFC_MRlyOL.tiLimFaild_C DDRC_DebArTime.DFC_MRlyOL.tiLimPassd_C DDRC_DebArTime.DFC_MRlySCB.tiLimFaild_C DDRC_DebArTime.DFC_MRlySCB.tiLimPassd_C DDRC_DebArTime.DFC_MRlySCG.tiLimFaild_C DDRC_DebArTime.DFC_MRlySCG.tiLimPassd_C DDRC_DebArTime.DFC_SSpMon1.tiLimFaild_C DDRC_DebArTime.DFC_SSpMon1.tiLimPassd_C DDRC_DebArTime.DFC_SSpMon1OV.tiLimFaild_C DDRC_DebArTime.DFC_SSpMon1OV.tiLimPassd_C DDRC_DebArTime.DFC_SSpMon1SCG.tiLimFaild_C DDRC_DebArTime.DFC_SSpMon1SCG.tiLimPassd_C DDRC_DebArTime.DFC_SSpMon1UV.tiLimFaild_C DDRC_DebArTime.DFC_SSpMon1UV.tiLimPassd_C DDRC_DebArTime.DFC_SSpMon2.tiLimFaild_C DDRC_DebArTime.DFC_SSpMon2.tiLimPassd_C DDRC_DebArTime.DFC_SSpMon2OV.tiLimFaild_C DDRC_DebArTime.DFC_SSpMon2OV.tiLimPassd_C DDRC_DebArTime.DFC_SSpMon2SCG.tiLimFaild_C DDRC_DebArTime.DFC_SSpMon2SCG.tiLimPassd_C DDRC_DebArTime.DFC_SSpMon2UV.tiLimFaild_C DDRC_DebArTime.DFC_SSpMon2UV.tiLimPassd_C DDRC_DebArTime.DFC_SSpMon3.tiLimFaild_C DDRC_DebArTime.DFC_SSpMon3.tiLimPassd_C DDRC_DebArTime.DFC_SSpMon3OV.tiLimFaild_C DDRC_DebArTime.DFC_SSpMon3OV.tiLimPassd_C DDRC_DebArTime.DFC_SSpMon3SCG.tiLimFaild_C DDRC_DebArTime.DFC_SSpMon3SCG.tiLimPassd_C DDRC_DebArTime.DFC_SSpMon3UV.tiLimFaild_C DDRC_DebArTime.DFC_SSpMon3UV.tiLimPassd_C DFC_CtlMsk2.DFC_MRlyOL_C DFC_CtlMsk2.DFC_MRlySCB_C DFC_CtlMsk2.DFC_MRlySCG_C DFC_CtlMsk2.DFC_SSpMon1_C DFC_CtlMsk2.DFC_SSpMon1OV_C DFC_CtlMsk2.DFC_SSpMon1SCG_C DFC_CtlMsk2.DFC_SSpMon1UV_C DFC_CtlMsk2.DFC_SSpMon2_C DFC_CtlMsk2.DFC_SSpMon2OV_C DFC_CtlMsk2.DFC_SSpMon2SCG_C DFC_CtlMsk2.DFC_SSpMon2UV_C DFC_CtlMsk2.DFC_SSpMon3_C DFC_CtlMsk2.DFC_SSpMon3OV_C DFC_CtlMsk2.DFC_SSpMon3SCG_C DFC_CtlMsk2.DFC_SSpMon3UV_C DFC_DisblMsk2.DFC_MRlyOL_C DFC_DisblMsk2.DFC_MRlySCB_C DFC_DisblMsk2.DFC_MRlySCG_C DFC_DisblMsk2.DFC_SSpMon1_C DFC_DisblMsk2.DFC_SSpMon1OV_C DFC_DisblMsk2.DFC_SSpMon1SCG_C DFC_DisblMsk2.DFC_SSpMon1UV_C DFC_DisblMsk2.DFC_SSpMon2_C DFC_DisblMsk2.DFC_SSpMon2OV_C DFC_DisblMsk2.DFC_SSpMon2SCG_C DFC_DisblMsk2.DFC_SSpMon2UV_C DFC_DisblMsk2.DFC_SSpMon3_C DFC_DisblMsk2.DFC_SSpMon3OV_C DFC_DisblMsk2.DFC_SSpMon3SCG_C DFC_DisblMsk2.DFC_SSpMon3UV_C /end DEF_CHARACTERISTIC
 /begin OUT_MEASUREMENT DDRC_ctArDebLvl.DFC_MRlyOL DDRC_ctArDebLvl.DFC_MRlySCB DDRC_ctArDebLvl.DFC_MRlySCG DDRC_ctArDebLvl.DFC_SSpMon1 DDRC_ctArDebLvl.DFC_SSpMon1OV DDRC_ctArDebLvl.DFC_SSpMon1SCG DDRC_ctArDebLvl.DFC_SSpMon1UV DDRC_ctArDebLvl.DFC_SSpMon2 DDRC_ctArDebLvl.DFC_SSpMon2OV DDRC_ctArDebLvl.DFC_SSpMon2SCG DDRC_ctArDebLvl.DFC_SSpMon2UV DDRC_ctArDebLvl.DFC_SSpMon3 DDRC_ctArDebLvl.DFC_SSpMon3OV DDRC_ctArDebLvl.DFC_SSpMon3SCG DDRC_ctArDebLvl.DFC_SSpMon3UV DDRC_stLstRprtEve.DFC_MRlyOL DDRC_stLstRprtEve.DFC_MRlySCB DDRC_stLstRprtEve.DFC_MRlySCG DDRC_stLstRprtEve.DFC_SSpMon1 DDRC_stLstRprtEve.DFC_SSpMon1OV DDRC_stLstRprtEve.DFC_SSpMon1SCG DDRC_stLstRprtEve.DFC_SSpMon1UV DDRC_stLstRprtEve.DFC_SSpMon2 DDRC_stLstRprtEve.DFC_SSpMon2OV DDRC_stLstRprtEve.DFC_SSpMon2SCG DDRC_stLstRprtEve.DFC_SSpMon2UV DDRC_stLstRprtEve.DFC_SSpMon3 DDRC_stLstRprtEve.DFC_SSpMon3OV DDRC_stLstRprtEve.DFC_SSpMon3SCG DDRC_stLstRprtEve.DFC_SSpMon3UV DFC_st.DFC_MRlyOL DFC_st.DFC_MRlySCB DFC_st.DFC_MRlySCG DFC_st.DFC_SSpMon1 DFC_st.DFC_SSpMon1OV DFC_st.DFC_SSpMon1SCG DFC_st.DFC_SSpMon1UV DFC_st.DFC_SSpMon2 DFC_st.DFC_SSpMon2OV DFC_st.DFC_SSpMon2SCG DFC_st.DFC_SSpMon2UV DFC_st.DFC_SSpMon3 DFC_st.DFC_SSpMon3OV DFC_st.DFC_SSpMon3SCG DFC_st.DFC_SSpMon3UV /end OUT_MEASUREMENT
 FUNCTION_VERSION "1.18.0" /end FUNCTION
/begin FUNCTION rba_IoSigRtc "1.28.1    IO Signals: Real Time Clocks"
 /begin DEF_CHARACTERISTIC DFC_CtlMsk2.DFC_rba_IoSigRtc_StopCounter_C DFC_DisblMsk2.DFC_rba_IoSigRtc_StopCounter_C /end DEF_CHARACTERISTIC
 /begin OUT_MEASUREMENT DFC_st.DFC_rba_IoSigRtc_StopCounter /end OUT_MEASUREMENT
 FUNCTION_VERSION "1.28.1" /end FUNCTION
/begin FUNCTION rba_MemDiag "2.8.0     OBD diagnosis for memory components"
 /begin DEF_CHARACTERISTIC DFC_CtlMsk2.DFC_rba_MemDiag_MemReadErr_C DFC_CtlMsk2.DFC_rba_MemDiag_MemWrErr_C DFC_DisblMsk2.DFC_rba_MemDiag_MemReadErr_C DFC_DisblMsk2.DFC_rba_MemDiag_MemWrErr_C /end DEF_CHARACTERISTIC
 /begin OUT_MEASUREMENT DFC_st.DFC_rba_MemDiag_MemReadErr DFC_st.DFC_rba_MemDiag_MemWrErr rba_MemDiagExtd_nrLstReadSngErr rba_MemDiag_flgInhbDiag rba_MemDiag_nrLstReadErr rba_MemDiag_nrLstWrErr /end OUT_MEASUREMENT
 FUNCTION_VERSION "2.8.0" /end FUNCTION
/begin FUNCTION rba_MRly_Diag_Stk ""
 /begin OUT_MEASUREMENT DINH_nrActvInhReas.FId_FiMFID_rba_MRly_Diag_Stk DINH_stFId.FId_FiMFID_rba_MRly_Diag_Stk /end OUT_MEASUREMENT
/end FUNCTION
/begin FUNCTION RefgntCirc_Ctrl "2.1.0     Refrigerant circuit component control"
 /begin DEF_CHARACTERISTIC RefgntCirc_facPRefgntCoeff0_C RefgntCirc_facPRefgntCoeff1_C RefgntCirc_facPRefgntCoeff2_C RefgntCirc_pRefgntDft_C RefgntCirc_stCmprShtOffMask_C RefgntCirc_tiVlvCycCls_C RefgntCirc_tiVlvCycRels_C /end DEF_CHARACTERISTIC
 /begin IN_MEASUREMENT ACCmpr_stLim ACCtl_stAcCtrlr Eem_stHv HvacLvl_pwrRefgntDes HvacMod_flgAcDes RefgntChillrVlv_stCtrlr ThermLoTChillr_pwrRefgntDes ThermLoTChillr_stReq /end IN_MEASUREMENT
 /begin OUT_MEASUREMENT RefgntCirc_pwrRefgntDes RefgntCirc_stAcDes RefgntCirc_stAcFrntVlv RefgntCirc_stChillrVlv RefgntCirc_stCmprOvrdReq /end OUT_MEASUREMENT
 /begin LOC_MEASUREMENT RefgntCirc_flgCmprShtOff /end LOC_MEASUREMENT
 FUNCTION_VERSION "2.1.0" /end FUNCTION
/begin FUNCTION Reset_CallBack "8.5.0_VC1CP091_STLA_N_D060I2callback function for Reset-Package"
 /begin IN_MEASUREMENT APP_rUnFlt BattU_u Emac_tqDesCom01 GlbDa_lTotDst SyC_stRCD T15_st VehV_v /end IN_MEASUREMENT
 /begin OUT_MEASUREMENT Reset_Env_ctRst Reset_Env_xGrp Reset_Env_xId Reset_VehV_v /end OUT_MEASUREMENT
 /begin LOC_MEASUREMENT Reset_APP_rUnFlt Reset_BattU_u Reset_Emac_tqDesCom01 Reset_GlbDa_lTotDst Reset_SyC_stRCD Reset_T15_st /end LOC_MEASUREMENT
 FUNCTION_VERSION "8.5.0_VC1CP091_STLA_N_D060I2" /end FUNCTION
/begin FUNCTION RSSO_DySched "19.0.0_STLA_N_C030CRSSO Dysched file for MDG1 BSW" FUNCTION_VERSION "19.0.0_STLA_N_C030C" /end FUNCTION
/begin FUNCTION SCtPmp1_DELib_ActrPwrStgDrvr "1.0.0"
 /begin DEF_CHARACTERISTIC SCtPmp1_ActrPwrStgDrvr_Cal.swtConf_C SCtPmp1_ActrPwrStgDrvr_Cal.stMOCSOPChk_C SCtPmp1_ActrPwrStgDrvr_Cal.swtPSDis_C SCtPmp1_Pwm.tiPer_C SCtPmp1_Pwm.stLvl_C SCtPmp1_Pwm.rMaxDty_C SCtPmp1_Pwm.rPerUn_C SCtPmp1_Pwm.tiPh_C /end DEF_CHARACTERISTIC
 /begin IN_MEASUREMENT DevLib_stPwrStgEnaCond SCtPmp1_rPs SCtPmp1_stElecDiag SCtPmp1_stPs SCtPmp1_tiPeriod /end IN_MEASUREMENT
 /begin OUT_MEASUREMENT SCtPmp1_flgActrSwtOffReq SCtPmp1_flgElecDiagSwtOffReq SCtPmp1_flgPwrStgReq SCtPmp1_stActrAvl SCtPmp1_stMonActrPwrStgDrvr SCtPmp1_stPwrStgDrvr SCtPmp1_swtConfActrPwrStgDrvr /end OUT_MEASUREMENT
 /begin LOC_MEASUREMENT SCtPmp1_numSigID SCtPmp1_SigTyp SCtPmp1_stMonGlbElecdd /end LOC_MEASUREMENT
 FUNCTION_VERSION "1.0.0" /end FUNCTION
/begin FUNCTION SCtPmp1_DELib_DevDrvrOutpDutyCycRamp "1.0.0" /begin DEF_CHARACTERISTIC SCtPmp1_DevDrvrOutpDutyCycRampCal.swtConf_C /end DEF_CHARACTERISTIC /begin IN_MEASUREMENT SCtPmp1_rActr /end IN_MEASUREMENT /begin OUT_MEASUREMENT SCtPmp1_rGovActr SCtPmp1_swtConfDevDrvrOutpDutyCycRampC /end OUT_MEASUREMENT FUNCTION_VERSION "1.0.0" /end FUNCTION
/begin FUNCTION SCtPmp1_DELib_StdActrAvs "2.0.0" /begin IN_MEASUREMENT SCtPmp1_swtConfC /end IN_MEASUREMENT FUNCTION_VERSION "2.0.0" /end FUNCTION
/begin FUNCTION SCtPmp1_DELib_StdActrCoorr "8.1.0"
 /begin DEF_CHARACTERISTIC DDRC_DurDeb.SCtPmp1_tiFailSafeNotSucDebOk_C DDRC_DurDeb.SCtPmp1_tiFailSafeNotSucDebDef_C DFC_CtlMsk2.DFC_SCtPmp1FailSafeNotSuc_C DFC_DisblMsk2.DFC_SCtPmp1FailSafeNotSuc_C SCtPmp1_rDesActrATS_CUR SCtPmp1_rDesActr_CUR SCtPmp1_StdCal.tiDesValFlt_C SCtPmp1_StdCal.rPsOff_C SCtPmp1_StdCal.rActrStop_C SCtPmp1_StdCal.rHysHigh_C SCtPmp1_StdCal.rHysLow_C SCtPmp1_StdCal.stPwrStgDiaDis_C SCtPmp1_StdCal.stPlausDiaDis_C SCtPmp1_StdCal.stPwrStgDis_C SCtPmp1_StdCal.stActrStop_C SCtPmp1_StdCal.stAllPwrStgDiaEna_C SCtPmp1_StdCal.swtDesVal_C SCtPmp1_StdCal.numDiagTry_C SCtPmp1_StdCal.rDesValOff_C SCtPmp1_StdCal.rDesValOn_C SCtPmp1_StdCal.numEngDaFrqPs_C SCtPmp1_StdCal.tiSlwRespSimPT1_C SCtPmp1_StdCal.uHiBattThd_C SCtPmp1_StdCal.uLoBattThd_C SCtPmp1_StdCal.tiDebBattVoltOk_C SCtPmp1_StdCal.tiDebBattVoltDfct_C SCtPmp1_StdCal.mskActrActv_C SCtPmp1_StdCal.tiDlyActrActvn_C SCtPmp1_StdCal.rPsActrOff_C SCtPmp1_StdCal.uBattMin_C SCtPmp1_StdCal.uBattMax_C SCtPmp1_StdCal.tiShOffCtrlDne_C SCtPmp1_StdCal.swtDeactvn_C SCtPmp1_StdCal.tiSelfDiagStrt_C SCtPmp1_StdCal.flgReacvnPostDrv_C SCtPmp1_StdCal.rPsRlyOff_C SCtPmp1_StdCal.tiRlyOnDly_C SCtPmp1_StdCal.nFMInWinMsk_C SCtPmp1_StdCal.tiFMInDeb_C SCtPmp1_StdCal.tiJamActrWait_C SCtPmp1_stMonDiagGrdKeyFailSafe_C /end DEF_CHARACTERISTIC
 /begin IN_MEASUREMENT BattU_u CoEng_st CoEng_stOld DELib_idxArrSnsr DELib_xArrSnsr Epm_nEng Epm_stSpd SCtPmp1_rDesVal SCtPmp1_rPs SCtPmp1_stMon SCtPmp1_stMonDiagGrdKey SCtPmp1_swtConf2C SCtPmp1_swtConfC SCtPmp1_swtConfStdActrSwVersC SyC_stSub /end IN_MEASUREMENT
 /begin OUT_MEASUREMENT DDRC_St.DFC_SCtPmp1FailSafeNotSuc DFC_st.DFC_SCtPmp1FailSafeNotSuc DINH_nrActvInhReas.FId_SCtPmp1Off DINH_stFId.FId_SCtPmp1Off SCtPmp1_r SCtPmp1_stDesVal SCtPmp1_stMonCo /end OUT_MEASUREMENT
 /begin LOC_MEASUREMENT SCtPmp1_flgMonXPostDrv_mp SCtPmp1_rDesValATS SCtPmp1_stCoEng SCtPmp1_stDeactvn /end LOC_MEASUREMENT
 FUNCTION_VERSION "8.1.0" /end FUNCTION
/begin FUNCTION SCtPmp1_DELib_StdActrDd "8.2.0" /begin DEF_CHARACTERISTIC SCtPmp1_frqPs_CUR SCtPmp1_rCnv_MAP SCtPmp1_swtBattCorSqd_C /end DEF_CHARACTERISTIC
 /begin REF_CHARACTERISTIC SCtPmp1_Pwm.tiPer_C SCtPmp1_Pwm.stLvl_C SCtPmp1_Pwm.rMaxDty_C SCtPmp1_Pwm.rPerUn_C SCtPmp1_Pwm.tiPh_C SCtPmp1_PwmOutCal.rMin_C SCtPmp1_PwmOutCal.rMax_C SCtPmp1_PwmOutCal.swtBattCor_C SCtPmp1_StdCal.tiDesValFlt_C SCtPmp1_StdCal.rPsOff_C SCtPmp1_StdCal.rActrStop_C SCtPmp1_StdCal.rHysHigh_C SCtPmp1_StdCal.rHysLow_C SCtPmp1_StdCal.stPwrStgDiaDis_C SCtPmp1_StdCal.stPlausDiaDis_C SCtPmp1_StdCal.stPwrStgDis_C SCtPmp1_StdCal.stActrStop_C SCtPmp1_StdCal.stAllPwrStgDiaEna_C SCtPmp1_StdCal.swtDesVal_C SCtPmp1_StdCal.numDiagTry_C SCtPmp1_StdCal.rDesValOff_C SCtPmp1_StdCal.rDesValOn_C SCtPmp1_StdCal.numEngDaFrqPs_C SCtPmp1_StdCal.tiSlwRespSimPT1_C SCtPmp1_StdCal.uHiBattThd_C SCtPmp1_StdCal.uLoBattThd_C SCtPmp1_StdCal.tiDebBattVoltOk_C SCtPmp1_StdCal.tiDebBattVoltDfct_C SCtPmp1_StdCal.mskActrActv_C SCtPmp1_StdCal.tiDlyActrActvn_C SCtPmp1_StdCal.rPsActrOff_C SCtPmp1_StdCal.uBattMin_C SCtPmp1_StdCal.uBattMax_C SCtPmp1_StdCal.tiShOffCtrlDne_C SCtPmp1_StdCal.swtDeactvn_C SCtPmp1_StdCal.tiSelfDiagStrt_C SCtPmp1_StdCal.flgReacvnPostDrv_C SCtPmp1_StdCal.rPsRlyOff_C SCtPmp1_StdCal.tiRlyOnDly_C SCtPmp1_StdCal.nFMInWinMsk_C SCtPmp1_StdCal.tiFMInDeb_C SCtPmp1_StdCal.tiJamActrWait_C /end REF_CHARACTERISTIC
 /begin IN_MEASUREMENT BattU_facCor DELib_idxArrSnsr DELib_xArrSnsr DevLib_stPwrStgEnaCond EnvP_p SCtPmp1_flgPwrStgReq SCtPmp1_stMon SCtPmp1_stMonCo SCtPmp1_swtConf2C SCtPmp1_swtConfC SCtPmp1_swtConfStdActrSwVersC /end IN_MEASUREMENT
 /begin OUT_MEASUREMENT DINH_nrActvInhReas.FId_SCtPmp1ActrOff DINH_stFId.FId_SCtPmp1ActrOff SCtPmp1_flgActrReq SCtPmp1_rActr SCtPmp1_rMax SCtPmp1_rMin SCtPmp1_rPs SCtPmp1_stMonDD SCtPmp1_stPs SCtPmp1_tiPeriod /end OUT_MEASUREMENT
 /begin LOC_MEASUREMENT SCtPmp1_rPsDiaLim_mp SCtPmp1_tEngDaFrqPs_mp /end LOC_MEASUREMENT
 FUNCTION_VERSION "8.2.0" /end FUNCTION
/begin FUNCTION SCtPmp1_DELib_StdActrDesValCntr "3.0.0" FUNCTION_VERSION "3.0.0" /end FUNCTION
/begin FUNCTION SCtPmp1_DELib_StdActrInin "9.5.0"
 /begin DEF_CHARACTERISTIC SCtPmp1_swtConf2_C SCtPmp1_swtConfStdActrSwVers162_C SCtPmp1_swtConf_C /end DEF_CHARACTERISTIC
 /begin OUT_MEASUREMENT SCtPmp1_swtConf2C SCtPmp1_swtConfC SCtPmp1_swtConfStdActrSwVersC /end OUT_MEASUREMENT
 FUNCTION_VERSION "9.5.0" /end FUNCTION
/begin FUNCTION SCtPmp1_DELib_StdActrSnsrDd "6.4.0"
 /begin DEF_CHARACTERISTIC SCtPmp1_ratActLin_CUR SCtPmp1_StdActrRmpSlp.Pos_C SCtPmp1_StdActrRmpSlp.Neg_C SCtPmp1_StdActrTransStg.Dfl_C SCtPmp1_StdActrTransStg.stSensId_C /end DEF_CHARACTERISTIC
 /begin REF_CHARACTERISTIC SCtPmp1_StdCal.tiDesValFlt_C SCtPmp1_StdCal.rPsOff_C SCtPmp1_StdCal.rActrStop_C SCtPmp1_StdCal.rHysHigh_C SCtPmp1_StdCal.rHysLow_C SCtPmp1_StdCal.stPwrStgDiaDis_C SCtPmp1_StdCal.stPlausDiaDis_C SCtPmp1_StdCal.stPwrStgDis_C SCtPmp1_StdCal.stActrStop_C SCtPmp1_StdCal.stAllPwrStgDiaEna_C SCtPmp1_StdCal.swtDesVal_C SCtPmp1_StdCal.numDiagTry_C SCtPmp1_StdCal.rDesValOff_C SCtPmp1_StdCal.rDesValOn_C SCtPmp1_StdCal.numEngDaFrqPs_C SCtPmp1_StdCal.tiSlwRespSimPT1_C SCtPmp1_StdCal.uHiBattThd_C SCtPmp1_StdCal.uLoBattThd_C SCtPmp1_StdCal.tiDebBattVoltOk_C SCtPmp1_StdCal.tiDebBattVoltDfct_C SCtPmp1_StdCal.mskActrActv_C SCtPmp1_StdCal.tiDlyActrActvn_C SCtPmp1_StdCal.rPsActrOff_C SCtPmp1_StdCal.uBattMin_C SCtPmp1_StdCal.uBattMax_C SCtPmp1_StdCal.tiShOffCtrlDne_C SCtPmp1_StdCal.swtDeactvn_C SCtPmp1_StdCal.tiSelfDiagStrt_C SCtPmp1_StdCal.flgReacvnPostDrv_C SCtPmp1_StdCal.rPsRlyOff_C SCtPmp1_StdCal.tiRlyOnDly_C SCtPmp1_StdCal.nFMInWinMsk_C SCtPmp1_StdCal.tiFMInDeb_C SCtPmp1_StdCal.tiJamActrWait_C SCtPmp1_swtConf2_C SCtPmp1_swtConf_C /end REF_CHARACTERISTIC
 /begin IN_MEASUREMENT SCtPmp1_rDesVal SCtPmp1_stDesVal SCtPmp1_stMon SCtPmp1_swtConf2C SCtPmp1_swtConfC SCtPmp1_swtConfStdActrSwVersC /end IN_MEASUREMENT
 /begin OUT_MEASUREMENT DINH_nrActvInhReas.FId_SCtPmp1QlySensFrzn DINH_nrActvInhReas.FId_SCtPmp1QlySensRplVal DINH_stFId.FId_SCtPmp1QlySensFrzn DINH_stFId.FId_SCtPmp1QlySensRplVal SCtPmp1_rAct SCtPmp1_rAct_Sq SCtPmp1_ratActPosnB1 SCtPmp1_stMonDDSens /end OUT_MEASUREMENT
 /begin LOC_MEASUREMENT SCtPmp1_rSens /end LOC_MEASUREMENT
 FUNCTION_VERSION "6.4.0" /end FUNCTION
/begin FUNCTION SCtPmp1_DELib_StdActrVd "5.0.0" /begin IN_MEASUREMENT SCtPmp1_rGovActr SCtPmp1_swtConfC /end IN_MEASUREMENT /begin OUT_MEASUREMENT SCtPmp1_rDesVal /end OUT_MEASUREMENT FUNCTION_VERSION "5.0.0" /end FUNCTION
/begin FUNCTION SCtPmp1_DELib_StdActrVdMon "9.3.0"
 /begin DEF_CHARACTERISTIC DDRC_DurDeb.SCtPmp1_tiOLDebOk_C DDRC_DurDeb.SCtPmp1_tiOLDebDef_C DDRC_DurDeb.SCtPmp1_tiOvrTempDebOk_C DDRC_DurDeb.SCtPmp1_tiOvrTempDebDef_C DDRC_DurDeb.SCtPmp1_tiSCBDebOk_C DDRC_DurDeb.SCtPmp1_tiSCBDebDef_C DDRC_DurDeb.SCtPmp1_numDiagGrdKey1DebOk_C DDRC_DurDeb.SCtPmp1_numDiagGrdKey1DebDef_C DDRC_DurDeb.SCtPmp1_numDiagGrdKey2DebOk_C DDRC_DurDeb.SCtPmp1_numDiagGrdKey2DebDef_C DDRC_DurDeb.SCtPmp1_numDiagGrdKey3DebOk_C DDRC_DurDeb.SCtPmp1_numDiagGrdKey3DebDef_C DDRC_DurDeb.SCtPmp1_numDiagGrdKey4DebOk_C DDRC_DurDeb.SCtPmp1_numDiagGrdKey4DebDef_C DDRC_DurDeb.SCtPmp1_numDiagGrdKey5DebOk_C DDRC_DurDeb.SCtPmp1_numDiagGrdKey5DebDef_C DDRC_DurDeb.SCtPmp1_tiSCGDebOk_C DDRC_DurDeb.SCtPmp1_tiSCGDebDef_C DDRC_RatDeb.SCtPmp1_tiOLUDRat_C DDRC_RatDeb.SCtPmp1_tiOvrTempUDRat_C DDRC_RatDeb.SCtPmp1_tiSCBUDRat_C DDRC_RatDeb.SCtPmp1_numDiagGrdKey1UDRat_C DDRC_RatDeb.SCtPmp1_numDiagGrdKey2UDRat_C DDRC_RatDeb.SCtPmp1_numDiagGrdKey3UDRat_C DDRC_RatDeb.SCtPmp1_numDiagGrdKey4UDRat_C DDRC_RatDeb.SCtPmp1_numDiagGrdKey5UDRat_C DFC_CtlMsk2.DFC_SCtPmp1SCG_C DFC_CtlMsk2.DFC_SCtPmp1OL_C DFC_CtlMsk2.DFC_SCtPmp1OvrTemp_C DFC_CtlMsk2.DFC_SCtPmp1SCB_C DFC_CtlMsk2.DFC_SCtPmp1DiagGrdKey1_C DFC_CtlMsk2.DFC_SCtPmp1DiagGrdKey2_C DFC_CtlMsk2.DFC_SCtPmp1DiagGrdKey3_C DFC_CtlMsk2.DFC_SCtPmp1DiagGrdKey4_C DFC_CtlMsk2.DFC_SCtPmp1DiagGrdKey5_C DFC_CtlMsk2.DFC_SCtPmp1DiagGrdKeyErr_C DFC_DisblMsk2.DFC_SCtPmp1SCG_C DFC_DisblMsk2.DFC_SCtPmp1OL_C DFC_DisblMsk2.DFC_SCtPmp1OvrTemp_C DFC_DisblMsk2.DFC_SCtPmp1SCB_C DFC_DisblMsk2.DFC_SCtPmp1DiagGrdKey1_C DFC_DisblMsk2.DFC_SCtPmp1DiagGrdKey2_C DFC_DisblMsk2.DFC_SCtPmp1DiagGrdKey3_C DFC_DisblMsk2.DFC_SCtPmp1DiagGrdKey4_C DFC_DisblMsk2.DFC_SCtPmp1DiagGrdKey5_C DFC_DisblMsk2.DFC_SCtPmp1DiagGrdKeyErr_C SCtPmp1_DiagGrdKeyCal.swtDGK_C SCtPmp1_DiagGrdKeyCal.tiDGKErrDebDef_C SCtPmp1_DiagGrdKeyCal.tiDGKErrDebOK_C SCtPmp1_DiagGrdKeyCal.tiAlvErrDly_C SCtPmp1_DiagGrdKeyWinCal1.tiSCGMin_C SCtPmp1_DiagGrdKeyWinCal1.tiSCGMax_C SCtPmp1_DiagGrdKeyWinCal1.tiPausPatMin_C SCtPmp1_DiagGrdKeyWinCal1.tiPausPatMax_C SCtPmp1_DiagGrdKeyWinCal2.tiSCGMin_C SCtPmp1_DiagGrdKeyWinCal2.tiSCGMax_C SCtPmp1_DiagGrdKeyWinCal2.tiPausPatMin_C SCtPmp1_DiagGrdKeyWinCal2.tiPausPatMax_C SCtPmp1_DiagGrdKeyWinCal3.tiSCGMin_C SCtPmp1_DiagGrdKeyWinCal3.tiSCGMax_C SCtPmp1_DiagGrdKeyWinCal3.tiPausPatMin_C SCtPmp1_DiagGrdKeyWinCal3.tiPausPatMax_C SCtPmp1_DiagGrdKeyWinCal4.tiSCGMin_C SCtPmp1_DiagGrdKeyWinCal4.tiSCGMax_C SCtPmp1_DiagGrdKeyWinCal4.tiPausPatMin_C SCtPmp1_DiagGrdKeyWinCal4.tiPausPatMax_C SCtPmp1_DiagGrdKeyWinCal5.tiSCGMin_C SCtPmp1_DiagGrdKeyWinCal5.tiSCGMax_C SCtPmp1_DiagGrdKeyWinCal5.tiPausPatMin_C SCtPmp1_DiagGrdKeyWinCal5.tiPausPatMax_C SCtPmp1_numStdActr_C SCtPmp1_psDiagPwmOut.nrTstPls_C SCtPmp1_psDiagPwmOut.tiBtwElecFlt_C SCtPmp1_psDiagPwmOut.tiBtwOTFlt_C SCtPmp1_PwmOutCal.rMin_C SCtPmp1_PwmOutCal.rMax_C SCtPmp1_PwmOutCal.swtBattCor_C SCtPmp1_swtPsDiag_C /end DEF_CHARACTERISTIC
 /begin REF_CHARACTERISTIC SCtPmp1_StdCal.tiDesValFlt_C SCtPmp1_StdCal.rPsOff_C SCtPmp1_StdCal.rActrStop_C SCtPmp1_StdCal.rHysHigh_C SCtPmp1_StdCal.rHysLow_C SCtPmp1_StdCal.stPwrStgDiaDis_C SCtPmp1_StdCal.stPlausDiaDis_C SCtPmp1_StdCal.stPwrStgDis_C SCtPmp1_StdCal.stActrStop_C SCtPmp1_StdCal.stAllPwrStgDiaEna_C SCtPmp1_StdCal.swtDesVal_C SCtPmp1_StdCal.numDiagTry_C SCtPmp1_StdCal.rDesValOff_C SCtPmp1_StdCal.rDesValOn_C SCtPmp1_StdCal.numEngDaFrqPs_C SCtPmp1_StdCal.tiSlwRespSimPT1_C SCtPmp1_StdCal.uHiBattThd_C SCtPmp1_StdCal.uLoBattThd_C SCtPmp1_StdCal.tiDebBattVoltOk_C SCtPmp1_StdCal.tiDebBattVoltDfct_C SCtPmp1_StdCal.mskActrActv_C SCtPmp1_StdCal.tiDlyActrActvn_C SCtPmp1_StdCal.rPsActrOff_C SCtPmp1_StdCal.uBattMin_C SCtPmp1_StdCal.uBattMax_C SCtPmp1_StdCal.tiShOffCtrlDne_C SCtPmp1_StdCal.swtDeactvn_C SCtPmp1_StdCal.tiSelfDiagStrt_C SCtPmp1_StdCal.flgReacvnPostDrv_C SCtPmp1_StdCal.rPsRlyOff_C SCtPmp1_StdCal.tiRlyOnDly_C SCtPmp1_StdCal.nFMInWinMsk_C SCtPmp1_StdCal.tiFMInDeb_C SCtPmp1_StdCal.tiJamActrWait_C /end REF_CHARACTERISTIC
 /begin IN_MEASUREMENT BattU_facCor BattU_u CoEng_st CoEng_tiNormal DELib_idxArrSnsr DELib_xArrSnsr DevLib_stPwrStgEnaCond EnvT_t SCtPmp1_rPs SCtPmp1_stActrAvl SCtPmp1_stMonCo SCtPmp1_stMonDDSens SCtPmp1_stPs SCtPmp1_stPwrStgDrvr SCtPmp1_swtConf2C SCtPmp1_swtConfC SCtPmp1_swtConfStdActrSwVersC SyC_ctPostDrvLeave /end IN_MEASUREMENT
 /begin OUT_MEASUREMENT DDRC_St.DFC_SCtPmp1SCG DDRC_St.DFC_SCtPmp1OL DDRC_St.DFC_SCtPmp1OvrTemp DDRC_St.DFC_SCtPmp1SCB DDRC_St.DFC_SCtPmp1DiagGrdKey1 DDRC_St.DFC_SCtPmp1DiagGrdKey2 DDRC_St.DFC_SCtPmp1DiagGrdKey3 DDRC_St.DFC_SCtPmp1DiagGrdKey4 DDRC_St.DFC_SCtPmp1DiagGrdKey5 DFC_st.DFC_SCtPmp1SCG DFC_st.DFC_SCtPmp1OL DFC_st.DFC_SCtPmp1OvrTemp DFC_st.DFC_SCtPmp1SCB DFC_st.DFC_SCtPmp1DiagGrdKey1 DFC_st.DFC_SCtPmp1DiagGrdKey2 DFC_st.DFC_SCtPmp1DiagGrdKey3 DFC_st.DFC_SCtPmp1DiagGrdKey4 DFC_st.DFC_SCtPmp1DiagGrdKey5 DFC_st.DFC_SCtPmp1DiagGrdKeyErr DINH_nrActvInhReas.FId_SCtPmp1CircErr DINH_nrActvInhReas.FId_SCtPmp1Mon DINH_nrActvInhReas.FId_SCtPmp1PsErr DINH_nrActvInhReas.FId_SCtPmp1PwrStg DINH_stFId.FId_SCtPmp1CircErr DINH_stFId.FId_SCtPmp1Mon DINH_stFId.FId_SCtPmp1PsErr DINH_stFId.FId_SCtPmp1PwrStg SCtPmp1_stElecDiag SCtPmp1_stErrInfo SCtPmp1_stMon SCtPmp1_stMonDiagGrdKey SCtPmp1_stPwrStgEnaCond /end OUT_MEASUREMENT
 /begin LOC_MEASUREMENT SCtPmp1_DiagGrdKey.stBits SCtPmp1_DiagGrdKey.tiDifSCGDisad SCtPmp1_DiagGrdKey.tiSCGDet SCtPmp1_DiagGrdKey.tiPausDet SCtPmp1_DiagGrdKey.stAliveBits SCtPmp1_DiagGrdKey.ctGlbDefReIni SCtPmp1_selfDiagPostDrv_mp /end LOC_MEASUREMENT
 FUNCTION_VERSION "9.3.0" /end FUNCTION
/begin FUNCTION SCtPmpRly_DELib_ActrPwrStgDrvr "1.0.0"
 /begin DEF_CHARACTERISTIC SCtPmpRly_ActrPwrStgDrvr_Cal.swtConf_C SCtPmpRly_ActrPwrStgDrvr_Cal.stMOCSOPChk_C SCtPmpRly_ActrPwrStgDrvr_Cal.swtPSDis_C /end DEF_CHARACTERISTIC
 /begin IN_MEASUREMENT DevLib_stPwrStgEnaCond SCtPmpRly_rPs SCtPmpRly_stElecDiag SCtPmpRly_stPs /end IN_MEASUREMENT
 /begin OUT_MEASUREMENT SCtPmpRly_flgActrSwtOffReq SCtPmpRly_flgElecDiagSwtOffReq SCtPmpRly_flgPwrStgReq SCtPmpRly_stMonActrPwrStgDrvr SCtPmpRly_stPwrStgDrvr SCtPmpRly_swtConfActrPwrStgDrvr /end OUT_MEASUREMENT
 /begin LOC_MEASUREMENT SCtPmpRly_numSigID SCtPmpRly_SigTyp SCtPmpRly_stMonGlbElecdd /end LOC_MEASUREMENT
 FUNCTION_VERSION "1.0.0" /end FUNCTION
/begin FUNCTION SCtPmpRly_DELib_DevDrvrOutpDutyCycRamp "1.0.0" /begin DEF_CHARACTERISTIC SCtPmpRly_DevDrvrOutpDutyCycRampCal.swtConf_C /end DEF_CHARACTERISTIC /begin IN_MEASUREMENT SCtPmpRly_rActr /end IN_MEASUREMENT
 /begin OUT_MEASUREMENT SCtPmpRly_rGovActr SCtPmpRly_swtConfDevDrvrOutpDutyCycRampC /end OUT_MEASUREMENT
 FUNCTION_VERSION "1.0.0" /end FUNCTION
/begin FUNCTION SCtPmpRly_DELib_StdActrAvs "2.0.0" /begin IN_MEASUREMENT SCtPmpRly_swtConfC /end IN_MEASUREMENT FUNCTION_VERSION "2.0.0" /end FUNCTION
/begin FUNCTION SCtPmpRly_DELib_StdActrCoorr "8.1.0"
 /begin DEF_CHARACTERISTIC SCtPmpRly_rDesActr_CUR SCtPmpRly_StdCal.tiDesValFlt_C SCtPmpRly_StdCal.rPsOff_C SCtPmpRly_StdCal.rActrStop_C SCtPmpRly_StdCal.rHysHigh_C SCtPmpRly_StdCal.rHysLow_C SCtPmpRly_StdCal.stPwrStgDiaDis_C SCtPmpRly_StdCal.stPlausDiaDis_C SCtPmpRly_StdCal.stPwrStgDis_C SCtPmpRly_StdCal.stActrStop_C SCtPmpRly_StdCal.stAllPwrStgDiaEna_C SCtPmpRly_StdCal.swtDesVal_C SCtPmpRly_StdCal.numDiagTry_C SCtPmpRly_StdCal.rDesValOff_C SCtPmpRly_StdCal.rDesValOn_C SCtPmpRly_StdCal.numEngDaFrqPs_C SCtPmpRly_StdCal.tiSlwRespSimPT1_C SCtPmpRly_StdCal.uHiBattThd_C SCtPmpRly_StdCal.uLoBattThd_C SCtPmpRly_StdCal.tiDebBattVoltOk_C SCtPmpRly_StdCal.tiDebBattVoltDfct_C SCtPmpRly_StdCal.mskActrActv_C SCtPmpRly_StdCal.tiDlyActrActvn_C SCtPmpRly_StdCal.rPsActrOff_C SCtPmpRly_StdCal.uBattMin_C SCtPmpRly_StdCal.uBattMax_C SCtPmpRly_StdCal.tiShOffCtrlDne_C SCtPmpRly_StdCal.swtDeactvn_C SCtPmpRly_StdCal.tiSelfDiagStrt_C SCtPmpRly_StdCal.flgReacvnPostDrv_C SCtPmpRly_StdCal.rPsRlyOff_C SCtPmpRly_StdCal.tiRlyOnDly_C SCtPmpRly_StdCal.nFMInWinMsk_C SCtPmpRly_StdCal.tiFMInDeb_C SCtPmpRly_StdCal.tiJamActrWait_C /end DEF_CHARACTERISTIC
 /begin IN_MEASUREMENT BattU_u CoEng_st CoEng_stOld DELib_idxArrSnsr DELib_xArrSnsr Epm_nEng Epm_stSpd SCtPmpRly_rDesVal SCtPmpRly_rPs SCtPmpRly_stMon SCtPmpRly_swtConf2C SCtPmpRly_swtConfC SCtPmpRly_swtConfStdActrSwVersC SyC_stSub /end IN_MEASUREMENT
 /begin OUT_MEASUREMENT DINH_nrActvInhReas.FId_SCtPmpRlyOff DINH_stFId.FId_SCtPmpRlyOff SCtPmpRly_r SCtPmpRly_stDesVal SCtPmpRly_stMonCo /end OUT_MEASUREMENT
 /begin LOC_MEASUREMENT SCtPmpRly_flgMonXPostDrv_mp SCtPmpRly_stCoEng SCtPmpRly_stDeactvn /end LOC_MEASUREMENT
 FUNCTION_VERSION "8.1.0" /end FUNCTION
/begin FUNCTION SCtPmpRly_DELib_StdActrDd "8.2.0" /begin DEF_CHARACTERISTIC SCtPmpRly_rCnv_MAP /end DEF_CHARACTERISTIC
 /begin REF_CHARACTERISTIC SCtPmpRly_StdCal.tiDesValFlt_C SCtPmpRly_StdCal.rPsOff_C SCtPmpRly_StdCal.rActrStop_C SCtPmpRly_StdCal.rHysHigh_C SCtPmpRly_StdCal.rHysLow_C SCtPmpRly_StdCal.stPwrStgDiaDis_C SCtPmpRly_StdCal.stPlausDiaDis_C SCtPmpRly_StdCal.stPwrStgDis_C SCtPmpRly_StdCal.stActrStop_C SCtPmpRly_StdCal.stAllPwrStgDiaEna_C SCtPmpRly_StdCal.swtDesVal_C SCtPmpRly_StdCal.numDiagTry_C SCtPmpRly_StdCal.rDesValOff_C SCtPmpRly_StdCal.rDesValOn_C SCtPmpRly_StdCal.numEngDaFrqPs_C SCtPmpRly_StdCal.tiSlwRespSimPT1_C SCtPmpRly_StdCal.uHiBattThd_C SCtPmpRly_StdCal.uLoBattThd_C SCtPmpRly_StdCal.tiDebBattVoltOk_C SCtPmpRly_StdCal.tiDebBattVoltDfct_C SCtPmpRly_StdCal.mskActrActv_C SCtPmpRly_StdCal.tiDlyActrActvn_C SCtPmpRly_StdCal.rPsActrOff_C SCtPmpRly_StdCal.uBattMin_C SCtPmpRly_StdCal.uBattMax_C SCtPmpRly_StdCal.tiShOffCtrlDne_C SCtPmpRly_StdCal.swtDeactvn_C SCtPmpRly_StdCal.tiSelfDiagStrt_C SCtPmpRly_StdCal.flgReacvnPostDrv_C SCtPmpRly_StdCal.rPsRlyOff_C SCtPmpRly_StdCal.tiRlyOnDly_C SCtPmpRly_StdCal.nFMInWinMsk_C SCtPmpRly_StdCal.tiFMInDeb_C SCtPmpRly_StdCal.tiJamActrWait_C /end REF_CHARACTERISTIC
 /begin IN_MEASUREMENT BattU_facCor DELib_idxArrSnsr DELib_xArrSnsr DevLib_stPwrStgEnaCond EnvP_p SCtPmpRly_flgPwrStgReq SCtPmpRly_stMon SCtPmpRly_stMonCo SCtPmpRly_swtConf2C SCtPmpRly_swtConfC SCtPmpRly_swtConfStdActrSwVersC /end IN_MEASUREMENT
 /begin OUT_MEASUREMENT DINH_nrActvInhReas.FId_SCtPmpRlyActrOff DINH_stFId.FId_SCtPmpRlyActrOff SCtPmpRly_flgActrReq SCtPmpRly_rActr SCtPmpRly_rMax SCtPmpRly_rMin SCtPmpRly_rPs SCtPmpRly_stMonDD SCtPmpRly_stPs /end OUT_MEASUREMENT
 FUNCTION_VERSION "8.2.0" /end FUNCTION
/begin FUNCTION SCtPmpRly_DELib_StdActrDesValCntr "3.0.0" FUNCTION_VERSION "3.0.0" /end FUNCTION
/begin COMPU_METHOD B_TRUE "" TAB_VERB "%6.3" "" COMPU_TAB_REF B_TRUE /end COMPU_METHOD
/begin COMPU_VTAB B_TRUE "" TAB_VERB 2 0 "FALSE" 1 "TRUE" /end COMPU_VTAB
/begin COMPU_METHOD DDRCTime_ms "" RAT_FUNC "%6.1" "ms" COEFFS 0 1 0 0 0 10 /end COMPU_METHOD
/begin COMPU_METHOD DDRC_LstRprtEve_VERB "" TAB_VERB "%6.3" "" COMPU_TAB_REF DDRC_LstRprtEve_VERB /end COMPU_METHOD
/begin COMPU_VTAB DDRC_LstRprtEve_VERB "" TAB_VERB 5 0 "PASSED" 1 "FAILED" 2 "PREPASSED" 3 "PREFAILED" 255 "INVALID" /end COMPU_VTAB
/begin COMPU_METHOD DDRC_Ratio "" TAB_VERB "%6.3" "-" COMPU_TAB_REF DDRC_Ratio /end COMPU_METHOD
/begin COMPU_VTAB DDRC_Ratio "" TAB_VERB 4 1 "Ratio1" 2 "Ratio2" 3 "Ratio3" 4 "Ratio4" /end COMPU_VTAB
/begin COMPU_METHOD DELIB_ALLTEMP_VERB_COMPU "" TAB_VERB "%6.3" "" COMPU_TAB_REF DELIB_ALLTEMP_VERB_COMPU /end COMPU_METHOD
/begin COMPU_VTAB DELIB_ALLTEMP_VERB_COMPU "" TAB_VERB 6 85 "ACCHRGRINTKT" 86 "DCCHRGRINTKT" 0 "ENVT" 89 "HEATRCORET" 254 "DFLTEMP" 255 "NOTEMP" /end COMPU_VTAB
/begin COMPU_METHOD DFC_OneToOne "" RAT_FUNC "%6.2" "-" COEFFS 0 1 0 0 0 1 /end COMPU_METHOD
/begin COMPU_METHOD DFES_OneToOne "" RAT_FUNC "%6.2" "-" COEFFS 0 1 0 0 0 1 /end COMPU_METHOD
/begin COMPU_METHOD DINH_ct_Compu "" RAT_FUNC "%6.0" "" COEFFS 0 -1 4096 0 0 1 /end COMPU_METHOD
/begin COMPU_METHOD DtyCyc "" RAT_FUNC "%6.4" "%" COEFFS 0 100 0 0 0 1 /end COMPU_METHOD
/begin COMPU_METHOD Eep_MainStates_Verb "" TAB_VERB "%6.3" "" COMPU_TAB_REF Eep_MainStates_Verb /end COMPU_METHOD
/begin COMPU_VTAB Eep_MainStates_Verb "" TAB_VERB 15 0 "EEP_SHUTDWN_RUN" 1 "EEP_INI_RUN" 2 "EEP_MIGRATION_RUN" 3 "EEP_INI_INTERNAL" 4 "EEP_NORMAL_RUN" 5 "EEP_BEGPD_REQUEST" 6 "EEP_BEGPD_RUN" 7 "EEP_ENDPD_REQUEST" 8 "EEP_ENDPD_RUN" 9 "EEP_PREDRV_REQUEST" 10 "EEP_PREDRV_RUN" 11 "EEP_FIRSTINIT_INI" 12 "EEP_RAM_INI" 13 "EEP_ENVRAM_INI" 14 "EEP_REINIT_INI" /end COMPU_VTAB
/begin COMPU_METHOD Eep_PostDrvState_Verb "" TAB_VERB "%6.3" "" COMPU_TAB_REF Eep_PostDrvState_Verb /end COMPU_METHOD
/begin COMPU_VTAB Eep_PostDrvState_Verb "" TAB_VERB 5 0 "EEP_POSTDRV_INI" 1 "EEP_POSTDRV_SEARCHBLKIDX" 2 "EEP_POSTDRV_SAVEBLK" 3 "EEP_POSTDRV_SAVEBLK_PENDING" 4 "EEP_POSTDRV_WAIT" /end COMPU_VTAB
/begin COMPU_METHOD EngN "" RAT_FUNC "%6.3" "rpm" COEFFS 0 2 0 0 0 1 /end COMPU_METHOD
/begin COMPU_METHOD InjMass "" RAT_FUNC "%6.4" "mg/hub" COEFFS 0 100 0 0 0 1 /end COMPU_METHOD
/begin COMPU_METHOD Length "" RAT_FUNC "%6.2" "m" COEFFS 0 1 0 0 0 1 /end COMPU_METHOD
/begin COMPU_METHOD OneToOne "" RAT_FUNC "%6.2" "-" COEFFS 0 1 0 0 0 1 /end COMPU_METHOD
/begin COMPU_METHOD Prc "" RAT_FUNC "%6.4" "%" COEFFS 0 81.92 0 0 0 1 /end COMPU_METHOD
/begin COMPU_METHOD PresAC_hPa "" RAT_FUNC "%6.2" "hPa" COEFFS 0 0.5 0 0 0 1 /end COMPU_METHOD
/begin COMPU_METHOD Pres_hPa "" RAT_FUNC "%6.2" "hPa" COEFFS 0 1 0 0 0 1 /end COMPU_METHOD
/begin COMPU_METHOD q0p01_s "" RAT_FUNC "%6.4" "s" COEFFS 0 100 0 0 0 1 /end COMPU_METHOD
/begin COMPU_METHOD q1 "" RAT_FUNC "%6.2" "-" COEFFS 0 1 0 0 0 1 /end COMPU_METHOD
/begin COMPU_METHOD rba_EcuCtrl_ClientVerb "" TAB_VERB "%2.1" "" COMPU_TAB_REF rba_EcuCtrl_ClientVerb /end COMPU_METHOD
/begin COMPU_VTAB rba_EcuCtrl_ClientVerb "" TAB_VERB 25 0 "ChrgSys_Ctrl_PreDrv" 1 "ChrgSys_Ctrl_PstDrv" 2 "Epm_nEngNotZero" 3 "Fan1_stdactr_PreDrv" 4 "Fan1_stdactr_PstDrv" 5 "Internal_PartialWakeup" 6 "IntlckChrgPlg_stdactr_PreDrv" 7 "IntlckChrgPlg_stdactr_PstDrv" 8 "PartialWakeup" 9 "SCtPmp1_stdactr_PreDrv" 10 "SCtPmp1_stdactr_PstDrv" 11 "SCtPmpRly_stdactr_PreDrv" 12 "SCtPmpRly_stdactr_PstDrv" 13 "SpplCooltPmpRly_stdactr_PreDrv" 14 "SpplCooltPmpRly_stdactr_PstDrv" 15 "SysA_DelMinPostDrv" 16 "SysA_DelMinPreDrv" 17 "SysA_PrlgPostDrv" 18 "SysA_PrlgPreDrv" 19 "T15" 20 "ThermMod_OperMod_PreDrv" 21 "ThermMod_OperMod_PstDrv" 22 "Transitory" 23 "eem_prolgecuactv_PreDrv" 24 "eem_prolgecuactv_PstDrv" DEFAULT_VALUE "none" /end COMPU_VTAB
/begin COMPU_METHOD rba_EcuCtrl_stMnVerb "" TAB_VERB "%2.1" "" COMPU_TAB_REF rba_EcuCtrl_stMnVerb /end COMPU_METHOD
/begin COMPU_VTAB rba_EcuCtrl_stMnVerb "" TAB_VERB 3 0 "Boot" 1 "Run" 2 "Shutdown" DEFAULT_VALUE "Invalid" /end COMPU_VTAB
/begin COMPU_METHOD rba_EcuCtrl_stSubVerb "" TAB_VERB "%2.1" "" COMPU_TAB_REF rba_EcuCtrl_stSubVerb /end COMPU_METHOD
/begin COMPU_VTAB rba_EcuCtrl_stSubVerb "" TAB_VERB 6 0 "Init" 1 "RunSwOn" 2 "RunSwOff" 3 "PrepShutDwn" 4 "ShutDwn" 5 "ShutOff" DEFAULT_VALUE "Invalid" /end COMPU_VTAB
/begin COMPU_METHOD rba_EcuCtrl_stVerb "" TAB_VERB "%2.1" "" COMPU_TAB_REF rba_EcuCtrl_stVerb /end COMPU_METHOD
/begin COMPU_VTAB rba_EcuCtrl_stVerb "" TAB_VERB 1 0 "Inactive" DEFAULT_VALUE "Active" /end COMPU_VTAB
/begin COMPU_METHOD rba_EcuCtrl_stVerbCall "" TAB_VERB "%2.1" "" COMPU_TAB_REF rba_EcuCtrl_stVerbCall /end COMPU_METHOD
/begin COMPU_VTAB rba_EcuCtrl_stVerbCall "" TAB_VERB 2 0 "Not executed" 1 "Executed" /end COMPU_VTAB
/begin COMPU_METHOD rba_EcuCtrl_stVerbTout "" TAB_VERB "%2.1" "" COMPU_TAB_REF rba_EcuCtrl_stVerbTout /end COMPU_METHOD
/begin COMPU_VTAB rba_EcuCtrl_stVerbTout "" TAB_VERB 2 0 "Not active at timeout" 1 "Active at timout" /end COMPU_VTAB
/begin COMPU_METHOD rba_SvbbEtk_SpName "" TAB_VERB "%6.3" "" COMPU_TAB_REF rba_SvbbEtk_SpName /end COMPU_METHOD
/begin COMPU_VTAB rba_SvbbEtk_SpName "" TAB_VERB 15 0 "Disable" 1 "rba_Svbb_DummyActivate" 2 "rba_SvbbEtk_T10msByp" 3 "Rte_task_RteCont_T_100ms_rba_Etks_100ms_Proc" 4 "Rte_task_RteCont_T_100ms_rba_Etks_100ms_Proc_CalWup" 5 "Rte_task_RteCont_T_10ms_rba_Etks_CalWupCheck_Proc" 6 "Rte_task_RteCont_T_10ms_rba_Etks_DataFreezeCalWup_Proc" 7 "Rte_task_RteCont_T_10ms_rba_Etks_DataFreeze_Proc" 8 "Rte_task_RteCont_T_10ms_rba_Etks_PageSwitch_Proc" 9 "Rte_task_RteCont_T_10ms_rba_Etks_PageSwitch_Proc_CalWup" 10 "ReservedForEHooks_10" 11 "ReservedForEHooks_11" 12 "ReservedForEHooks_12" 13 "ReservedForEHooks_13" 14 "ReservedForEHooks_14" /end COMPU_VTAB
/begin COMPU_METHOD rba_Svbb_Time_us "" RAT_FUNC "%6.4" "" COEFFS 0 100 0 0 0 1 /end COMPU_METHOD
/begin COMPU_METHOD RBPtCel_dt_1p0_1 "" RAT_FUNC "%6.2" "K/s" COEFFS 0 1 0 0 0 1 /end COMPU_METHOD
/begin COMPU_METHOD RBPtCel_pwr_25p0_1 "" RAT_FUNC "%6.1" "W" COEFFS 0 1 0 0 0 25 /end COMPU_METHOD
/begin COMPU_METHOD RBPtCel_ti_1p0_2 "" RAT_FUNC "%6.2" "s" COEFFS 0 1 0 0 0 1 /end COMPU_METHOD
/begin COMPU_METHOD RBPtCel_ti_5p12em4_1 "" RAT_FUNC "%6.5" "s" COEFFS 0 15625 0 0 0 8 /end COMPU_METHOD
/begin COMPU_METHOD RBPtCel_t_1p0_3 "" RAT_FUNC "%6.2" "Deg C" COEFFS 0 1 0 0 0 1 /end COMPU_METHOD
/begin COMPU_METHOD RBPtCel_u_1p0_2 "" RAT_FUNC "%6.2" "mV" COEFFS 0 1 0 0 0 1 /end COMPU_METHOD
/begin COMPU_METHOD rel_q0p0078125 "" RAT_FUNC "%6.4" "%" COEFFS 0 128 0 0 0 1 /end COMPU_METHOD
/begin COMPU_METHOD RmpPrc "" RAT_FUNC "%6.5" "%/s" COEFFS 0 5368.70912 0 0 0 1 /end COMPU_METHOD
/begin COMPU_METHOD SigQly_COMPU_VERB "" TAB_VERB "%6.3" "" COMPU_TAB_REF SigQly_COMPU_VERB /end COMPU_METHOD
/begin COMPU_VTAB SigQly_COMPU_VERB "" TAB_VERB 16 0 "SIGQLY_NOTCALC" 1 "SIGQLY_INIT" 2 "SIGQLY_OK" 3 "SIGQLY_MODEL" 4 "SIGQLY_REPLACEMENT" 5 "SIGQLY_FROZEN" 6 "SIGQLY_INVALID" 7 "SIGQLY_RESERVED_7" 8 "SIGQLY_RESERVED_8" 9 "SIGQLY_RESERVED_9" 10 "SIGQLY_RESERVED_10" 11 "SIGQLY_RESERVED_11" 12 "SIGQLY_RESERVED_12" 13 "SIGQLY_RESERVED_13" 14 "SIGQLY_RESERVED_14" 15 "SIGQLY_RESERVED_15" /end COMPU_VTAB
/begin COMPU_METHOD SVSLMP_SUPRT_ATS_SY_Compu "" TAB_VERB "%6.3" "" COMPU_TAB_REF SVSLMP_SUPRT_ATS_SY_Compu /end COMPU_METHOD
/begin COMPU_VTAB SVSLMP_SUPRT_ATS_SY_Compu "" TAB_VERB 2 0 "False" 1 "True" /end COMPU_VTAB
/begin COMPU_METHOD SYC_AFTRUNDIAG_SC_Compu "" TAB_VERB "%6.3" "" COMPU_TAB_REF SYC_AFTRUNDIAG_SC_Compu /end COMPU_METHOD
/begin COMPU_VTAB SYC_AFTRUNDIAG_SC_Compu "" TAB_VERB 2 0 "False" 1 "True" /end COMPU_VTAB
/begin COMPU_METHOD SYC_CAL_PERMSPLYSYS_SY_Compu "" TAB_VERB "%6.3" "" COMPU_TAB_REF SYC_CAL_PERMSPLYSYS_SY_Compu /end COMPU_METHOD
/begin COMPU_VTAB SYC_CAL_PERMSPLYSYS_SY_Compu "" TAB_VERB 2 0 "False" 1 "True" /end COMPU_VTAB
/begin COMPU_METHOD SYC_CNTPOSTDRV_SC_Compu "" TAB_VERB "%6.3" "" COMPU_TAB_REF SYC_CNTPOSTDRV_SC_Compu /end COMPU_METHOD
/begin COMPU_VTAB SYC_CNTPOSTDRV_SC_Compu "" TAB_VERB 2 0 "False" 1 "True" /end COMPU_VTAB
/begin COMPU_METHOD SYC_COORD_SC_Compu "" TAB_VERB "%6.3" "" COMPU_TAB_REF SYC_COORD_SC_Compu /end COMPU_METHOD
/begin COMPU_VTAB SYC_COORD_SC_Compu "" TAB_VERB 2 0 "False" 1 "True" /end COMPU_VTAB
/begin COMPU_METHOD SYC_ENALCYPROLG_SC_Compu "" TAB_VERB "%6.3" "" COMPU_TAB_REF SYC_ENALCYPROLG_SC_Compu /end COMPU_METHOD
/begin COMPU_VTAB SYC_ENALCYPROLG_SC_Compu "" TAB_VERB 2 0 "False" 1 "True" /end COMPU_VTAB
/begin COMPU_METHOD SYC_ENASYSCTRLSUBST_SC_Compu "" TAB_VERB "%6.3" "" COMPU_TAB_REF SYC_ENASYSCTRLSUBST_SC_Compu /end COMPU_METHOD
/begin COMPU_VTAB SYC_ENASYSCTRLSUBST_SC_Compu "" TAB_VERB 2 0 "False" 1 "True" /end COMPU_VTAB
/begin COMPU_METHOD SYC_FSTSWOFF_SY_Compu "" TAB_VERB "%6.3" "" COMPU_TAB_REF SYC_FSTSWOFF_SY_Compu /end COMPU_METHOD
/begin COMPU_VTAB SYC_FSTSWOFF_SY_Compu "" TAB_VERB 2 0 "False" 1 "True" /end COMPU_VTAB
/begin COMPU_METHOD SYC_MRLY_SC_Compu "" TAB_VERB "%6.3" "" COMPU_TAB_REF SYC_MRLY_SC_Compu /end COMPU_METHOD
/begin COMPU_VTAB SYC_MRLY_SC_Compu "" TAB_VERB 2 0 "False" 1 "True" /end COMPU_VTAB
/begin COMPU_METHOD SYC_PERPH_SC_Compu "" TAB_VERB "%6.3" "" COMPU_TAB_REF SYC_PERPH_SC_Compu /end COMPU_METHOD
/begin COMPU_VTAB SYC_PERPH_SC_Compu "" TAB_VERB 2 0 "False" 1 "True" /end COMPU_VTAB
/begin COMPU_METHOD SYC_POWERUNDERVOLTAGE_SC_Compu "" TAB_VERB "%6.3" "" COMPU_TAB_REF SYC_POWERUNDERVOLTAGE_SC_Compu /end COMPU_METHOD
/begin COMPU_VTAB SYC_POWERUNDERVOLTAGE_SC_Compu "" TAB_VERB 2 0 "False" 1 "True" /end COMPU_VTAB
/begin COMPU_METHOD SYC_POWER_SC_Compu "" TAB_VERB "%6.3" "" COMPU_TAB_REF SYC_POWER_SC_Compu /end COMPU_METHOD
/begin COMPU_VTAB SYC_POWER_SC_Compu "" TAB_VERB 2 0 "False" 1 "True" /end COMPU_VTAB
/begin COMPU_METHOD SYC_PROLGPREDRV_SC_Compu "" TAB_VERB "%6.3" "" COMPU_TAB_REF SYC_PROLGPREDRV_SC_Compu /end COMPU_METHOD
/begin COMPU_VTAB SYC_PROLGPREDRV_SC_Compu "" TAB_VERB 2 0 "False" 1 "True" /end COMPU_VTAB
/begin COMPU_METHOD SYC_SHUTDOWNSERVICES_SC_Compu "" TAB_VERB "%6.3" "" COMPU_TAB_REF SYC_SHUTDOWNSERVICES_SC_Compu /end COMPU_METHOD
/begin COMPU_VTAB SYC_SHUTDOWNSERVICES_SC_Compu "" TAB_VERB 2 0 "False" 1 "True" /end COMPU_VTAB
/begin COMPU_METHOD SyC_stRCDVerb "" TAB_VERB "%6.3" "" COMPU_TAB_REF SyC_stRCDVerb /end COMPU_METHOD
/begin COMPU_VTAB SyC_stRCDVerb "" TAB_VERB 7 0 "SYC_UNKNOWN" 1 "SYC_PARTIALWAKEUP" 2 "SYC_INTERNAL_PARTIALWAKEUP" 3 "SYC_TRANSITORY" 4 "SYC_NOMINAL_MAINWAKEUP" 5 "SYC_DEGRADED_MAINWAKEUP" 6 "SYC_SHUTDOWN_PREPARATION" /end COMPU_VTAB
/begin COMPU_METHOD SYC_SYSTYP_SC_Compu "" TAB_VERB "%6.3" "" COMPU_TAB_REF SYC_SYSTYP_SC_Compu /end COMPU_METHOD
/begin COMPU_VTAB SYC_SYSTYP_SC_Compu "" TAB_VERB 2 0 "SysB" 1 "EcuCtrl" /end COMPU_VTAB
/begin COMPU_METHOD SYC_T15POSTPREDRV_SWRST_SY_Compu "" TAB_VERB "%6.3" "" COMPU_TAB_REF SYC_T15POSTPREDRV_SWRST_SY_Compu /end COMPU_METHOD
/begin COMPU_VTAB SYC_T15POSTPREDRV_SWRST_SY_Compu "" TAB_VERB 2 0 "False" 1 "True" /end COMPU_VTAB
/begin COMPU_METHOD SYC_WREEPBLK_SY_Compu "" TAB_VERB "%6.3" "" COMPU_TAB_REF SYC_WREEPBLK_SY_Compu /end COMPU_METHOD
/begin COMPU_VTAB SYC_WREEPBLK_SY_Compu "" TAB_VERB 2 0 "EEP-Block for SyC is not written" 1 "EEP-Block for SyC is written" /end COMPU_VTAB
/begin COMPU_METHOD SYC_X2ME_SC_Compu "" TAB_VERB "%6.3" "" COMPU_TAB_REF SYC_X2ME_SC_Compu /end COMPU_METHOD
/begin COMPU_VTAB SYC_X2ME_SC_Compu "" TAB_VERB 2 0 "False" 1 "True" /end COMPU_VTAB
/begin COMPU_METHOD SYSA_DSQACTVT_SC_Compu "" TAB_VERB "%6.3" "" COMPU_TAB_REF SYSA_DSQACTVT_SC_Compu /end COMPU_METHOD
/begin COMPU_VTAB SYSA_DSQACTVT_SC_Compu "" TAB_VERB 2 0 "Inactive" 1 "Active" /end COMPU_VTAB
/begin COMPU_METHOD SYSB_CUST_SC_Compu "" TAB_VERB "%6.3" "" COMPU_TAB_REF SYSB_CUST_SC_Compu /end COMPU_METHOD
/begin COMPU_VTAB SYSB_CUST_SC_Compu "" TAB_VERB 3 0 "NONE" 1 "HCP1" 2 "STELLANTIS_PSA" /end COMPU_VTAB
/begin COMPU_METHOD SYSB_ENAUSER_SC_Compu "" TAB_VERB "%6.3" "" COMPU_TAB_REF SYSB_ENAUSER_SC_Compu /end COMPU_METHOD
/begin COMPU_VTAB SYSB_ENAUSER_SC_Compu "" TAB_VERB 2 0 "False" 1 "True" /end COMPU_VTAB
/begin COMPU_METHOD SYSB_PHYTERMINAL15_SC_Compu "" TAB_VERB "%6.3" "" COMPU_TAB_REF SYSB_PHYTERMINAL15_SC_Compu /end COMPU_METHOD
/begin COMPU_VTAB SYSB_PHYTERMINAL15_SC_Compu "" TAB_VERB 2 0 "False" 1 "True" /end COMPU_VTAB
/begin COMPU_METHOD SYSDIAG_NRAFTRUNCOORRARRELEM_SC_Compu "" RAT_FUNC "%6.2" "" COEFFS 0 1 0 0 0 1 /end COMPU_METHOD
/begin COMPU_METHOD SY_ATMTURB_Compu "" TAB_VERB "%6.3" "" COMPU_TAB_REF SY_ATMTURB_Compu /end COMPU_METHOD
/begin COMPU_VTAB SY_ATMTURB_Compu "" TAB_VERB 2 0 "ATMTURB_NOPRES" 1 "ATMTURB_PRES" /end COMPU_VTAB
/begin COMPU_METHOD SY_AUFLAD_Compu "" TAB_VERB "%6.3" "" COMPU_TAB_REF SY_AUFLAD_Compu /end COMPU_METHOD
/begin COMPU_VTAB SY_AUFLAD_Compu "" TAB_VERB 2 0 "no_supercharging" 1 "supercharging" /end COMPU_VTAB
/begin COMPU_METHOD SY_BKV_Compu "" TAB_VERB "%6.3" "" COMPU_TAB_REF SY_BKV_Compu /end COMPU_METHOD
/begin COMPU_VTAB SY_BKV_Compu "" TAB_VERB 3 0 "ohne Drucksensor oder -schalter" 1 "Druckschalter" 2 "Drucksensor" /end COMPU_VTAB
/begin COMPU_METHOD SY_DLDP_Compu "" TAB_VERB "%6.3" "" COMPU_TAB_REF SY_DLDP_Compu /end COMPU_METHOD
/begin COMPU_VTAB SY_DLDP_Compu "" TAB_VERB 2 0 "kein DLDP System" 1 "DLDP System" /end COMPU_VTAB
/begin COMPU_METHOD SY_DMDSTQ_Compu "" RAT_FUNC "%6.2" "" COEFFS 0 1 0 0 0 1 /end COMPU_METHOD
/begin COMPU_METHOD SY_DMTL_Compu "" TAB_VERB "%6.3" "" COMPU_TAB_REF SY_DMTL_Compu /end COMPU_METHOD
/begin COMPU_VTAB SY_DMTL_Compu "" TAB_VERB 2 0 "DMTL_NotAvailable" 1 "DMTL_Available" /end COMPU_VTAB
/begin COMPU_METHOD SY_DSNDK_Compu "" TAB_VERB "%6.3" "" COMPU_TAB_REF SY_DSNDK_Compu /end COMPU_METHOD
/begin COMPU_VTAB SY_DSNDK_Compu "" TAB_VERB 2 0 "no pressure sensor downstream throttle valve insta" 1 "pressure sensor downstream throttle valve installe" /end COMPU_VTAB
/begin COMPU_METHOD SY_EGAS_Compu "" TAB_VERB "%6.3" "" COMPU_TAB_REF SY_EGAS_Compu /end COMPU_METHOD
/begin COMPU_VTAB SY_EGAS_Compu "" TAB_VERB 2 0 "kein E-GAS System" 1 "E-GAS System" /end COMPU_VTAB
/begin COMPU_METHOD SY_HFM_Compu "" TAB_VERB "%6.3" "" COMPU_TAB_REF SY_HFM_Compu /end COMPU_METHOD
/begin COMPU_VTAB SY_HFM_Compu "" TAB_VERB 3 0 "kein HFM verbaut" 1 "HFM verbaut (vor Verdichter)" 2 "HFM verbaut (nach Verdichter)" /end COMPU_VTAB
/begin COMPU_METHOD SY_INHIBIT_Compu "" TAB_VERB "%6.3" "" COMPU_TAB_REF SY_INHIBIT_Compu /end COMPU_METHOD
/begin COMPU_VTAB SY_INHIBIT_Compu "" TAB_VERB 3 0 "Kein Inhibitor" 1 "Inhibitor zur Fehlerpfad-spezifischen Sperrung" 2 "Inhibitor zur Fehler-Typ-spezifischen Sperrung" /end COMPU_VTAB
/begin COMPU_METHOD SY_KDS_Compu "" TAB_VERB "%6.3" "" COMPU_TAB_REF SY_KDS_Compu /end COMPU_METHOD
/begin COMPU_VTAB SY_KDS_Compu "" TAB_VERB 2 0 "False" 1 "True" /end COMPU_VTAB
/begin COMPU_METHOD SY_KORRZ_Compu "" RAT_FUNC "%6.2" "" COEFFS 0 1 0 0 0 1 /end COMPU_METHOD
/begin COMPU_METHOD SY_LAYER_Compu "" TAB_VERB "%6.3" "" COMPU_TAB_REF SY_LAYER_Compu /end COMPU_METHOD
/begin COMPU_VTAB SY_LAYER_Compu "" TAB_VERB 2 0 "False" 1 "True" /end COMPU_VTAB
/begin COMPU_METHOD SY_MDMXEXC_Compu "" TAB_VERB "%6.3" "" COMPU_TAB_REF SY_MDMXEXC_Compu /end COMPU_METHOD
/begin COMPU_VTAB SY_MDMXEXC_Compu "" TAB_VERB 2 0 "False" 1 "True" /end COMPU_VTAB
/begin COMPU_METHOD SY_NVLD_Compu "" TAB_VERB "%6.3" "" COMPU_TAB_REF SY_NVLD_Compu /end COMPU_METHOD
/begin COMPU_VTAB SY_NVLD_Compu "" TAB_VERB 2 0 "False" 1 "True" /end COMPU_VTAB
/begin COMPU_METHOD SY_PTL_Compu "" TAB_VERB "%6.3" "" COMPU_TAB_REF SY_PTL_Compu /end COMPU_METHOD
/begin COMPU_VTAB SY_PTL_Compu "" TAB_VERB 2 0 "relative inner moment" 1 "Physical Torque Levels" /end COMPU_VTAB
/begin COMPU_METHOD SY_SGANZ_Compu "" TAB_VERB "%6.3" "" COMPU_TAB_REF SY_SGANZ_Compu /end COMPU_METHOD
/begin COMPU_VTAB SY_SGANZ_Compu "" TAB_VERB 3 1 "Ein Steuergeräte Motormanagement Konzept" 2 "Zwei Steuergeräte Motormanagement Konzept" 3 "Drei Steuergeräte Motormanagement Konzept" /end COMPU_VTAB
/begin COMPU_METHOD SY_SVBB_Compu "" TAB_VERB "%6.3" "" COMPU_TAB_REF SY_SVBB_Compu /end COMPU_METHOD
/begin COMPU_VTAB SY_SVBB_Compu "" TAB_VERB 2 0 "NOSVBB" 1 "SVBBETAS" /end COMPU_VTAB
/begin COMPU_METHOD SY_TEETH_Compu "" TAB_VERB "%6.3" "" COMPU_TAB_REF SY_TEETH_Compu /end COMPU_METHOD
/begin COMPU_VTAB SY_TEETH_Compu "" TAB_VERB 5 12 "number_of_crankshaft_wheel_teeth_is_12_minus_x" 24 "number_of_crankshaft_wheel_teeth_is_24_minus_x" 30 "number_of_crankshaft_wheel_teeth_is_30_minus_x" 36 "number of crankshaft wheel teeth is 36 minus x" 60 "number of crankshaft wheel teeth is 60 minus x" /end COMPU_VTAB
/begin COMPU_METHOD SY_UBSQ_W_Compu "" RAT_FUNC "%6.2" "" COEFFS 0 1 0 0 0 1 /end COMPU_METHOD
/begin COMPU_METHOD SY_VARCODE_Compu "" TAB_VERB "%6.3" "" COMPU_TAB_REF SY_VARCODE_Compu /end COMPU_METHOD
/begin COMPU_VTAB SY_VARCODE_Compu "" TAB_VERB 2 0 "Variantencodierung-Schnittstelle nicht freigegeben" 1 "Variantencodierung-Schnittstelle freigegeben" /end COMPU_VTAB
/begin COMPU_METHOD SY_VD_Compu "" TAB_VERB "%6.3" "" COMPU_TAB_REF SY_VD_Compu /end COMPU_METHOD
/begin COMPU_VTAB SY_VD_Compu "" TAB_VERB 4 0 "no booster" 1 "TC (ATL)" 2 "compressor" 3 "SC-E (EZV)" /end COMPU_VTAB
/begin COMPU_METHOD SY_WNBM_Compu "" RAT_FUNC "%6.2" "" COEFFS 0 1 0 0 0 1 /end COMPU_METHOD
/begin COMPU_METHOD SY_ZYLZA_Compu "" TAB_VERB "%6.3" "" COMPU_TAB_REF SY_ZYLZA_Compu /end COMPU_METHOD
/begin COMPU_VTAB SY_ZYLZA_Compu "" TAB_VERB 11 1 "1" 2 "2" 3 "3" 4 "4" 5 "5" 6 "6" 8 "8" 10 "10" 12 "12" 16 "16" 18 "18" /end COMPU_VTAB
/begin COMPU_METHOD SY_ZYLZG_Compu "" RAT_FUNC "%6.2" "" COEFFS 0 1 0 0 0 1 /end COMPU_METHOD
/begin COMPU_METHOD T15RAWDSQENA_SC_Compu "" TAB_VERB "%6.3" "" COMPU_TAB_REF T15RAWDSQENA_SC_Compu /end COMPU_METHOD
/begin COMPU_VTAB T15RAWDSQENA_SC_Compu "" TAB_VERB 2 0 "Disabled" 1 "Enabled" /end COMPU_VTAB
/begin COMPU_METHOD T15_WKDETN_SC_Compu "" TAB_VERB "%6.3" "" COMPU_TAB_REF T15_WKDETN_SC_Compu /end COMPU_METHOD
/begin COMPU_VTAB T15_WKDETN_SC_Compu "" TAB_VERB 2 0 "False" 1 "True" /end COMPU_VTAB
/begin COMPU_METHOD T87_MON_SY_Compu "" TAB_VERB "%6.3" "" COMPU_TAB_REF T87_MON_SY_Compu /end COMPU_METHOD
/begin COMPU_VTAB T87_MON_SY_Compu "" TAB_VERB 2 0 "No Diag for Open Load" 1 "Open Load Diag active" /end COMPU_VTAB
/begin COMPU_METHOD TBLOWBYHEATR_TYPAVL_SC_Compu "" TAB_VERB "%6.3" "" COMPU_TAB_REF TBLOWBYHEATR_TYPAVL_SC_Compu /end COMPU_METHOD
/begin COMPU_VTAB TBLOWBYHEATR_TYPAVL_SC_Compu "" TAB_VERB 2 0 "False" 1 "True" /end COMPU_VTAB
/begin COMPU_METHOD TECU_TMSGFMT_SC_Compu "" TAB_VERB "%6.3" "" COMPU_TAB_REF TECU_TMSGFMT_SC_Compu /end COMPU_METHOD
/begin COMPU_VTAB TECU_TMSGFMT_SC_Compu "" TAB_VERB 2 1 "MSG" 2 "MSG_ARRAY" /end COMPU_VTAB
/begin COMPU_METHOD TEGRCLR2DS_TYPAVL_SY_Compu "" TAB_VERB "%6.3" "" COMPU_TAB_REF TEGRCLR2DS_TYPAVL_SY_Compu /end COMPU_METHOD
/begin COMPU_VTAB TEGRCLR2DS_TYPAVL_SY_Compu "" TAB_VERB 2 0 "0" 1 "1" /end COMPU_VTAB
/begin COMPU_METHOD TEGRCLRDS_TYPAVL_SY_Compu "" TAB_VERB "%6.3" "" COMPU_TAB_REF TEGRCLRDS_TYPAVL_SY_Compu /end COMPU_METHOD
/begin COMPU_VTAB TEGRCLRDS_TYPAVL_SY_Compu "" TAB_VERB 2 0 "False" 1 "True" /end COMPU_VTAB
/begin COMPU_METHOD TEGRCLRLPDS_TYPAVL_SC_Compu "" TAB_VERB "%6.3" "" COMPU_TAB_REF TEGRCLRLPDS_TYPAVL_SC_Compu /end COMPU_METHOD
/begin COMPU_VTAB TEGRCLRLPDS_TYPAVL_SC_Compu "" TAB_VERB 2 0 "False" 1 "True" /end COMPU_VTAB
/begin COMPU_METHOD TEGRCLRUS_TYPAVL_SY_Compu "" TAB_VERB "%6.3" "" COMPU_TAB_REF TEGRCLRUS_TYPAVL_SY_Compu /end COMPU_METHOD
/begin COMPU_VTAB TEGRCLRUS_TYPAVL_SY_Compu "" TAB_VERB 2 0 "False" 1 "True" /end COMPU_VTAB
/begin COMPU_METHOD TEGRVLVHOTDS_TYPAVL_SC_Compu "" TAB_VERB "%6.3" "" COMPU_TAB_REF TEGRVLVHOTDS_TYPAVL_SC_Compu /end COMPU_METHOD
/begin COMPU_VTAB TEGRVLVHOTDS_TYPAVL_SC_Compu "" TAB_VERB 2 0 "False" 1 "True" /end COMPU_VTAB
/begin COMPU_METHOD Temp_Cels "" RAT_FUNC "%6.1" "deg C" COEFFS 0 10 2731.4 0 0 1 /end COMPU_METHOD
/begin COMPU_METHOD TimeDelay_s "" RAT_FUNC "%6.1" "s" COEFFS 0 0 1 0 0.00023283064365387 0 /end COMPU_METHOD
/begin COMPU_METHOD TimeDT "" RAT_FUNC "%6.2" "us" COEFFS 0 1 0 0 0 1 /end COMPU_METHOD
/begin COMPU_METHOD Time_ms "" RAT_FUNC "%6.1" "ms" COEFFS 0 0.1 0 0 0 1 /end COMPU_METHOD
/begin COMPU_METHOD Time_s "" RAT_FUNC "%6.4" "s" COEFFS 0 100 0 0 0 1 /end COMPU_METHOD
/begin COMPU_METHOD Time_usec_q1_COMPU "" RAT_FUNC "%6.2" "us" COEFFS 0 1 0 0 0 1 /end COMPU_METHOD
/begin COMPU_METHOD TiSec_q0p1_COMPU "" RAT_FUNC "%6.3" "s" COEFFS 0 10 0 0 0 1 /end COMPU_METHOD
/begin COMPU_METHOD Trq "" RAT_FUNC "%6.3" "Nm" COEFFS 0 10 0 0 0 1 /end COMPU_METHOD
/begin COMPU_METHOD TVAVSADIA_FRQ "" RAT_FUNC "%6.3" "Hz" COEFFS 0 10 0 0 0 1 /end COMPU_METHOD
/begin COMPU_METHOD t_q0p1 "" RAT_FUNC "%6.3" "s" COEFFS 0 10 0 0 0 1 /end COMPU_METHOD
/begin COMPU_METHOD Vel "" RAT_FUNC "%6.4" "km/h" COEFFS 0 100 0 0 0 1 /end COMPU_METHOD
/begin COMPU_METHOD Volt "" RAT_FUNC "%6.3" "mV" COEFFS 0 5 0 0 0 1 /end COMPU_METHOD
/begin COMPU_METHOD Volt_Batt "" RAT_FUNC "%6.1" "mV" COEFFS 0 0.05 0 0 0 1 /end COMPU_METHOD
/begin COMPU_METHOD default "" RAT_FUNC "%6.2" "" COEFFS 0 1 0 0 0 1 /end COMPU_METHOD
/begin RECORD_LAYOUT Kw_Wr32 FNC_VALUES 1 FLOAT32_IEEE COLUMN_DIR DIRECT /end RECORD_LAYOUT
/begin RECORD_LAYOUT Kw_Ws16 FNC_VALUES 1 SWORD COLUMN_DIR DIRECT /end RECORD_LAYOUT
/begin RECORD_LAYOUT Kw_Ws32 FNC_VALUES 1 SLONG COLUMN_DIR DIRECT /end RECORD_LAYOUT
/begin RECORD_LAYOUT Kw_Wu32 FNC_VALUES 1 ULONG COLUMN_DIR DIRECT /end RECORD_LAYOUT
/begin RECORD_LAYOUT Kw_Wu8 FNC_VALUES 1 UBYTE COLUMN_DIR DIRECT /end RECORD_LAYOUT
/begin RECORD_LAYOUT RB_Curve_R32_R32_sao NO_AXIS_PTS_X 1 ULONG AXIS_PTS_X 2 FLOAT32_IEEE INDEX_INCR DIRECT FNC_VALUES 3 FLOAT32_IEEE COLUMN_DIR DIRECT STATIC_ADDRESS_OFFSETS /end RECORD_LAYOUT
/begin RECORD_LAYOUT RB_Curve_S16_S16 NO_AXIS_PTS_X 1 SWORD AXIS_PTS_X 2 SWORD INDEX_INCR DIRECT FNC_VALUES 3 SWORD COLUMN_DIR DIRECT /end RECORD_LAYOUT
/begin RECORD_LAYOUT RB_Curve_S16_S32_sao NO_AXIS_PTS_X 1 SWORD AXIS_PTS_X 2 SWORD INDEX_INCR DIRECT FNC_VALUES 3 SLONG COLUMN_DIR DIRECT STATIC_ADDRESS_OFFSETS /end RECORD_LAYOUT
/begin RECORD_LAYOUT RB_Map_S16S16_R32_sao NO_AXIS_PTS_X 1 SWORD NO_AXIS_PTS_Y 2 SWORD AXIS_PTS_X 3 SWORD INDEX_INCR DIRECT AXIS_PTS_Y 4 SWORD INDEX_INCR DIRECT FNC_VALUES 5 FLOAT32_IEEE COLUMN_DIR DIRECT STATIC_ADDRESS_OFFSETS /end RECORD_LAYOUT
/begin RECORD_LAYOUT RB_Map_S16S16_S16 NO_AXIS_PTS_X 1 SWORD NO_AXIS_PTS_Y 2 SWORD AXIS_PTS_X 3 SWORD INDEX_INCR DIRECT AXIS_PTS_Y 4 SWORD INDEX_INCR DIRECT FNC_VALUES 5 SWORD COLUMN_DIR DIRECT /end RECORD_LAYOUT
/begin RECORD_LAYOUT RB_Map_S16S16_U8_sao NO_AXIS_PTS_X 1 SWORD NO_AXIS_PTS_Y 2 SWORD AXIS_PTS_X 3 SWORD INDEX_INCR DIRECT AXIS_PTS_Y 4 SWORD INDEX_INCR DIRECT FNC_VALUES 5 UBYTE COLUMN_DIR DIRECT STATIC_ADDRESS_OFFSETS /end RECORD_LAYOUT
/begin RECORD_LAYOUT RB_Val_Wr32 FNC_VALUES 1 FLOAT32_IEEE COLUMN_DIR DIRECT /end RECORD_LAYOUT
/begin RECORD_LAYOUT RB_Val_Ws16 FNC_VALUES 1 SWORD COLUMN_DIR DIRECT /end RECORD_LAYOUT
/begin RECORD_LAYOUT RB_Val_Ws32 FNC_VALUES 1 SLONG COLUMN_DIR DIRECT /end RECORD_LAYOUT
/begin RECORD_LAYOUT RB_Val_Wu16 FNC_VALUES 1 UWORD COLUMN_DIR DIRECT /end RECORD_LAYOUT
/begin RECORD_LAYOUT RB_Val_Wu8 FNC_VALUES 1 UBYTE COLUMN_DIR DIRECT /end RECORD_LAYOUT
/begin RECORD_LAYOUT ValA_Wu16 FNC_VALUES 1 UWORD COLUMN_DIR DIRECT /end RECORD_LAYOUT
/begin RECORD_LAYOUT ValA_Wu8 FNC_VALUES 1 UBYTE COLUMN_DIR DIRECT /end RECORD_LAYOUT
/begin RECORD_LAYOUT Val_Wr32 FNC_VALUES 1 FLOAT32_IEEE COLUMN_DIR DIRECT /end RECORD_LAYOUT
/begin RECORD_LAYOUT Val_Ws16 FNC_VALUES 1 SWORD COLUMN_DIR DIRECT /end RECORD_LAYOUT
/begin RECORD_LAYOUT Val_Ws32 FNC_VALUES 1 SLONG COLUMN_DIR DIRECT /end RECORD_LAYOUT
/begin RECORD_LAYOUT Val_Wu16 FNC_VALUES 1 UWORD COLUMN_DIR DIRECT /end RECORD_LAYOUT
/begin RECORD_LAYOUT Val_Wu32 FNC_VALUES 1 ULONG COLUMN_DIR DIRECT /end RECORD_LAYOUT
/begin RECORD_LAYOUT Val_Wu8 FNC_VALUES 1 UBYTE COLUMN_DIR DIRECT /end RECORD_LAYOUT
/end MODULE
/end PROJECT

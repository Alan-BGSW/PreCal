ASAP2_VERSION 1 70
/begin PROJECT MDG1C "VC1CP091_STLA_N_D061I3"
/begin HEADER "" VERSION "VC1CP091_STLA_N_D061I3" PROJECT_NO MDG1C /end HEADER
/begin MODULE DIM ""
/begin MOD_COMMON "" BYTE_ORDER MSB_LAST ALIGNMENT_BYTE 1 ALIGNMENT_WORD 2 ALIGNMENT_LONG 4 ALIGNMENT_INT64 4 ALIGNMENT_FLOAT32_IEEE 4 ALIGNMENT_FLOAT64_IEEE 4 DATA_SIZE 32 /end MOD_COMMON
/begin CHARACTERISTIC rba_BypEtk_Fan1_rDesVal_bypass_CST.Vector_u16 "Value must not be changed manually. This is done automatically by Ascet/Intecrio/" VALUE 0xB92E0024 DefaultValueRecordLayout_AUTOSAR_Platform_BaseTypes_uint16 65535.0 RB_RBA_Common_CentralElements_CompuMethods_Identical 0.0 65535.0 FORMAT "%5.1" MAX_REFRESH 3 200 /end CHARACTERISTIC
/begin CHARACTERISTIC rba_BypEtk_Fan1_rDesVal_bypass_CST.Channel_u16 "Value must not be changed manually. This is done automatically by Ascet/Intecrio/" VALUE 0xB92E0026 DefaultValueRecordLayout_AUTOSAR_Platform_BaseTypes_uint16 65535.0 RB_RBA_Common_CentralElements_CompuMethods_Identical 0.0 65535.0 FORMAT "%5.1" MAX_REFRESH 3 200 /end CHARACTERISTIC
/begin CHARACTERISTIC rba_BypEtk_Fan1_rPs_bypass_CST.Vector_u16 "Value must not be changed manually. This is done automatically by Ascet/Intecrio/" VALUE 0xB92E0020 DefaultValueRecordLayout_AUTOSAR_Platform_BaseTypes_uint16 65535.0 RB_RBA_Common_CentralElements_CompuMethods_Identical 0.0 65535.0 FORMAT "%5.1" MAX_REFRESH 3 200 /end CHARACTERISTIC
/begin CHARACTERISTIC rba_BypEtk_Fan1_rPs_bypass_CST.Channel_u16 "Value must not be changed manually. This is done automatically by Ascet/Intecrio/" VALUE 0xB92E0022 DefaultValueRecordLayout_AUTOSAR_Platform_BaseTypes_uint16 65535.0 RB_RBA_Common_CentralElements_CompuMethods_Identical 0.0 65535.0 FORMAT "%5.1" MAX_REFRESH 3 200 /end CHARACTERISTIC
/begin CHARACTERISTIC rba_BypEtk_IntlckChrgPlg_rPs_bypass_CST.Vector_u16 "Value must not be changed manually. This is done automatically by Ascet/Intecrio/" VALUE 0xB92E001C DefaultValueRecordLayout_AUTOSAR_Platform_BaseTypes_uint16 65535.0 RB_RBA_Common_CentralElements_CompuMethods_Identical 0.0 65535.0 FORMAT "%5.1" MAX_REFRESH 3 200 /end CHARACTERISTIC
/begin CHARACTERISTIC rba_BypEtk_IntlckChrgPlg_rPs_bypass_CST.Channel_u16 "Value must not be changed manually. This is done automatically by Ascet/Intecrio/" VALUE 0xB92E001E DefaultValueRecordLayout_AUTOSAR_Platform_BaseTypes_uint16 65535.0 RB_RBA_Common_CentralElements_CompuMethods_Identical 0.0 65535.0 FORMAT "%5.1" MAX_REFRESH 3 200 /end CHARACTERISTIC
/begin CHARACTERISTIC rba_BypEtk_SCtPmp1_rDesVal_bypass_CST.Vector_u16 "Value must not be changed manually. This is done automatically by Ascet/Intecrio/" VALUE 0xB92E0018 DefaultValueRecordLayout_AUTOSAR_Platform_BaseTypes_uint16 65535.0 RB_RBA_Common_CentralElements_CompuMethods_Identical 0.0 65535.0 FORMAT "%5.1" MAX_REFRESH 3 200 /end CHARACTERISTIC
/begin CHARACTERISTIC rba_BypEtk_SCtPmp1_rDesVal_bypass_CST.Channel_u16 "Value must not be changed manually. This is done automatically by Ascet/Intecrio/" VALUE 0xB92E001A DefaultValueRecordLayout_AUTOSAR_Platform_BaseTypes_uint16 65535.0 RB_RBA_Common_CentralElements_CompuMethods_Identical 0.0 65535.0 FORMAT "%5.1" MAX_REFRESH 3 200 /end CHARACTERISTIC
/begin CHARACTERISTIC rba_BypEtk_SCtPmp1_rPs_bypass_CST.Vector_u16 "Value must not be changed manually. This is done automatically by Ascet/Intecrio/" VALUE 0xB92E0014 DefaultValueRecordLayout_AUTOSAR_Platform_BaseTypes_uint16 65535.0 RB_RBA_Common_CentralElements_CompuMethods_Identical 0.0 65535.0 FORMAT "%5.1" MAX_REFRESH 3 200 /end CHARACTERISTIC
/begin CHARACTERISTIC rba_BypEtk_SCtPmp1_rPs_bypass_CST.Channel_u16 "Value must not be changed manually. This is done automatically by Ascet/Intecrio/" VALUE 0xB92E0016 DefaultValueRecordLayout_AUTOSAR_Platform_BaseTypes_uint16 65535.0 RB_RBA_Common_CentralElements_CompuMethods_Identical 0.0 65535.0 FORMAT "%5.1" MAX_REFRESH 3 200 /end CHARACTERISTIC
/begin CHARACTERISTIC rba_BypEtk_SCtPmpRly_rDesVal_bypass_CST.Vector_u16 "Value must not be changed manually. This is done automatically by Ascet/Intecrio/" VALUE 0xB92E0010 DefaultValueRecordLayout_AUTOSAR_Platform_BaseTypes_uint16 65535.0 RB_RBA_Common_CentralElements_CompuMethods_Identical 0.0 65535.0 FORMAT "%5.1" MAX_REFRESH 3 200 /end CHARACTERISTIC
/begin CHARACTERISTIC rba_BypEtk_SCtPmpRly_rDesVal_bypass_CST.Channel_u16 "Value must not be changed manually. This is done automatically by Ascet/Intecrio/" VALUE 0xB92E0012 DefaultValueRecordLayout_AUTOSAR_Platform_BaseTypes_uint16 65535.0 RB_RBA_Common_CentralElements_CompuMethods_Identical 0.0 65535.0 FORMAT "%5.1" MAX_REFRESH 3 200 /end CHARACTERISTIC
/begin CHARACTERISTIC rba_BypEtk_SCtPmpRly_rPs_bypass_CST.Vector_u16 "Value must not be changed manually. This is done automatically by Ascet/Intecrio/" VALUE 0xB92E000C DefaultValueRecordLayout_AUTOSAR_Platform_BaseTypes_uint16 65535.0 RB_RBA_Common_CentralElements_CompuMethods_Identical 0.0 65535.0 FORMAT "%5.1" MAX_REFRESH 3 200 /end CHARACTERISTIC
/begin CHARACTERISTIC rba_BypEtk_SCtPmpRly_rPs_bypass_CST.Channel_u16 "Value must not be changed manually. This is done automatically by Ascet/Intecrio/" VALUE 0xB92E000E DefaultValueRecordLayout_AUTOSAR_Platform_BaseTypes_uint16 65535.0 RB_RBA_Common_CentralElements_CompuMethods_Identical 0.0 65535.0 FORMAT "%5.1" MAX_REFRESH 3 200 /end CHARACTERISTIC
/begin CHARACTERISTIC rba_BypEtk_SpplCooltPmpRly_rDesVal_bypass_CST.Vector_u16 "Value must not be changed manually. This is done automatically by Ascet/Intecrio/" VALUE 0xB92E0008 DefaultValueRecordLayout_AUTOSAR_Platform_BaseTypes_uint16 65535.0 RB_RBA_Common_CentralElements_CompuMethods_Identical 0.0 65535.0 FORMAT "%5.1" MAX_REFRESH 3 200 /end CHARACTERISTIC
/begin CHARACTERISTIC rba_BypEtk_SpplCooltPmpRly_rDesVal_bypass_CST.Channel_u16 "Value must not be changed manually. This is done automatically by Ascet/Intecrio/" VALUE 0xB92E000A DefaultValueRecordLayout_AUTOSAR_Platform_BaseTypes_uint16 65535.0 RB_RBA_Common_CentralElements_CompuMethods_Identical 0.0 65535.0 FORMAT "%5.1" MAX_REFRESH 3 200 /end CHARACTERISTIC
/begin CHARACTERISTIC rba_BypEtk_SpplCooltPmpRly_rPs_bypass_CST.Vector_u16 "Value must not be changed manually. This is done automatically by Ascet/Intecrio/" VALUE 0xB92E0004 DefaultValueRecordLayout_AUTOSAR_Platform_BaseTypes_uint16 65535.0 RB_RBA_Common_CentralElements_CompuMethods_Identical 0.0 65535.0 FORMAT "%5.1" MAX_REFRESH 3 200 /end CHARACTERISTIC
/begin CHARACTERISTIC rba_BypEtk_SpplCooltPmpRly_rPs_bypass_CST.Channel_u16 "Value must not be changed manually. This is done automatically by Ascet/Intecrio/" VALUE 0xB92E0006 DefaultValueRecordLayout_AUTOSAR_Platform_BaseTypes_uint16 65535.0 RB_RBA_Common_CentralElements_CompuMethods_Identical 0.0 65535.0 FORMAT "%5.1" MAX_REFRESH 3 200 /end CHARACTERISTIC
/begin CHARACTERISTIC rba_CalWup_Finish_C "Leave Calibration Wakeup calibration label" VALUE 0x802402D6 DefaultValueRecordLayout_AUTOSAR_Platform_BaseTypes_uint16 65535.0 RB_RBA_Common_CentralElements_CompuMethods_Identical 0.0 65535. FORMAT "%5.0" /end CHARACTERISTIC
/begin CHARACTERISTIC rba_CalWup_WakeupEnable_C "Enable Calibration Wakeup" VALUE 0x802402D4 DefaultValueRecordLayout_AUTOSAR_Platform_BaseTypes_uint16 65535.0 RB_RBA_Common_CentralElements_CompuMethods_Identical 0.0 65535. FORMAT "%5.0" /end CHARACTERISTIC
/begin CHARACTERISTIC rba_MRly_Diag_Stk_tiOkError_C "Debounce time of main relay sticky diagnosis for detecting an error" VALUE 0x802402CC DefaultValueRecordLayout_AUTOSAR_Platform_BaseTypes_uint32 3000.0 RB_RBA_rba_MRly_BswModuleDescriptions_rba_MRly_Calibration_Common_milliseconds_CompuMethod 0.0 3000. FORMAT "%5.0" /end CHARACTERISTIC
/begin CHARACTERISTIC rba_MultiStackTrace_ResetMaxValues "Reset max stack values saved in NvM" VALUE 0x802402E2 DefaultValueRecordLayout_AUTOSAR_Platform_BaseTypes_uint8 1.0 RB_RBA_Common_CentralElements_CompuMethods_Identical 0.0 1. FORMAT "%5.0" /end CHARACTERISTIC
/begin CHARACTERISTIC rba_MultiStackTrace_ThresholdSwitch "Select the Stack Limit Threshold Range from 0-5" VALUE 0x802402E1 DefaultValueRecordLayout_AUTOSAR_Platform_BaseTypes_uint8 5.0 RB_RBA_Common_CentralElements_CompuMethods_Identical 0.0 5. FORMAT "%5.0" /end CHARACTERISTIC
/begin CHARACTERISTIC rba_OsMeasmt_CoreLoadThresholdValue_C "Set a Threshold CoreLoad value for the dem event generation" VALUE 0x802402D2 DefaultValueRecordLayout_AUTOSAR_Platform_BaseTypes_uint16 655.0 RB_RBA_rba_OsMeasmt_CompuMethods_rba_OsMeasmt_PercConversion 0.0 655.00 FORMAT "%5.2" /end CHARACTERISTIC
/begin CHARACTERISTIC rba_OsMeasmt_ResetMaxCoreLoadValues_C "Reset max core load values saved in NvM" VALUE 0x802402E0 DefaultValueRecordLayout_AUTOSAR_Platform_BaseTypes_uint8 1.0 RB_RBA_Common_CentralElements_CompuMethods_Identical 0.0 1. FORMAT "%5.0" /end CHARACTERISTIC
/begin CHARACTERISTIC rba_OsMeasmt_ResetResponseTimeValues_C "Reset max response time values saved in NvM" VALUE 0x802402DF DefaultValueRecordLayout_AUTOSAR_Platform_BaseTypes_uint8 1.0 RB_RBA_Common_CentralElements_CompuMethods_Identical 0.0 1. FORMAT "%5.0" /end CHARACTERISTIC
/begin CHARACTERISTIC rba_OsMeasmt_SwTrace_InitMode_C "Init mode which shall be used for the rba_SwTrace / Gliwa T1 initialization" VALUE 0x802402DE DefaultValueRecordLayout_AUTOSAR_Platform_BaseTypes_uint8 2.0 RB_RBA_rba_OsMeasmt_CompuMethods_rba_OsMeasmt_SwTrace_InitMode_CompuMethod 0.0 2. FORMAT "%5.0" /end CHARACTERISTIC
/begin CHARACTERISTIC rba_Reset_rstExtHistBuf_C "calibration label to reset the extended reset history buffer" VALUE 0x802402DD DefaultValueRecordLayout_AUTOSAR_Platform_BaseTypes_uint8 255.0 RB_RBA_Common_CentralElements_CompuMethods_Identical 0.0 255.0 FORMAT "%5.1" /end CHARACTERISTIC
/begin CHARACTERISTIC rba_Reset_rstHistBuf_C "calibration label to reset the reset history buffer" VALUE 0x802402DC DefaultValueRecordLayout_AUTOSAR_Platform_BaseTypes_uint8 255.0 RB_RBA_Common_CentralElements_CompuMethods_Identical 0.0 255.0 FORMAT "%5.1" /end CHARACTERISTIC
/begin CHARACTERISTIC rba_Reset_xGrpId_C "calibration label for setting the reset group for triggering a reset" VALUE 0x802402DB DefaultValueRecordLayout_AUTOSAR_Platform_BaseTypes_uint8 255.0 RB_RBA_Common_CentralElements_CompuMethods_Identical 0.0 255.0 FORMAT "%5.1" /end CHARACTERISTIC
/begin CHARACTERISTIC rba_Reset_xTrgId_C "calibration label for triggering a reset" VALUE 0x802402D0 DefaultValueRecordLayout_AUTOSAR_Platform_BaseTypes_uint16 65535.0 RB_RBA_Common_CentralElements_CompuMethods_Identical 0.0 65535.0 FORMAT "%5.1" /end CHARACTERISTIC
/begin CHARACTERISTIC rba_SvbbEtk_Enable_C "Enable Service Based Bypass" VALUE 0x802402DA DefaultValueRecordLayout_AUTOSAR_Platform_BaseTypes_uint8 255.0 RB_RBA_rba_SvbbEtk_CompuMethods_rba_SvbbEtk_Enable_CM 0.0 255.0 FORMAT "%5.1" /end CHARACTERISTIC
/begin CHARACTERISTIC rba_SvbbEtk_MaxLostRaster_C "Set maximum number of allowed task delays. 0-254: max allowed Task delay for Service Based Bypass, 255: No Monitoring of Task delay" VALUE 0x802402D9 DefaultValueRecordLayout_AUTOSAR_Platform_BaseTypes_uint8 255.0 RB_RBA_Common_CentralElements_CompuMethods_Identical 0.0 255.0 FORMAT "%5.1" /end CHARACTERISTIC
/begin CHARACTERISTIC rba_SvbbEtk_WaitForBypconfigInIni_C "maximum delay of ECU intialization until Bypass config is downloaded by ETK in ms" VALUE 0x802402D8 DefaultValueRecordLayout_AUTOSAR_Platform_BaseTypes_uint8 255.0 RB_RBA_Common_CentralElements_CompuMethods_Identical 0.0 255.0 FORMAT "%5.1" /end CHARACTERISTIC
/begin CHARACTERISTIC rba_SyC_CustStates_VehvRcd_Thrshld_C "Customer States Vehicle velocity threshold in kmph" VALUE 0x802402C8 DefaultValueRecordLayout_AUTOSAR_Platform_BaseTypes_sint32 60000.0 RB_RBA_rba_SyC_CustStates_BswModuleDescriptions_rba_SyC_CustStates_Calibration_Velocity_kmph_CompuMethod -30000. 30000. FORMAT "%5.0" /end CHARACTERISTIC
/begin CHARACTERISTIC rba_SyC_Custstates_Degrad2Nominaltimeout_C "Customer States Degrad2Nominal timeout in ms" VALUE 0x802402C4 DefaultValueRecordLayout_AUTOSAR_Platform_BaseTypes_uint32 60000.0 RB_RBA_rba_SyC_CustStates_BswModuleDescriptions_rba_SyC_CustStates_Calibration_Time_Common_milliseconds_CompuMethod 0.0 60000. FORMAT "%5.0" /end CHARACTERISTIC
/begin CHARACTERISTIC rba_SyC_Custstates_Degrad2Transtimeout_C "Customer States Degraded to Transitory Timeout in s" VALUE 0x802402C0 DefaultValueRecordLayout_AUTOSAR_Platform_BaseTypes_uint32 72000.0 RB_RBA_rba_SyC_CustStates_BswModuleDescriptions_rba_SyC_CustStates_Calibration_Time_Common_seconds_CompuMethod 0.0 72000. FORMAT "%5.0" /end CHARACTERISTIC
/begin CHARACTERISTIC rba_SyC_Custstates_Degraded_disord_C "Customer States Degraded disord timeout in s" VALUE 0x802402BC DefaultValueRecordLayout_AUTOSAR_Platform_BaseTypes_uint32 72000.0 RB_RBA_rba_SyC_CustStates_BswModuleDescriptions_rba_SyC_CustStates_Calibration_Time_Common_seconds_CompuMethod 0.0 72000. FORMAT "%5.0" /end CHARACTERISTIC
/begin CHARACTERISTIC rba_SyC_Custstates_Degraded_incst_C "Customer States Degraded incst timeout in s" VALUE 0x802402B8 DefaultValueRecordLayout_AUTOSAR_Platform_BaseTypes_uint32 72000.0 RB_RBA_rba_SyC_CustStates_BswModuleDescriptions_rba_SyC_CustStates_Calibration_Time_Common_seconds_CompuMethod 0.0 72000. FORMAT "%5.0" /end CHARACTERISTIC
/begin CHARACTERISTIC rba_SyC_Custstates_InternalPartialCalMax_C "Customer States Internal Partial wakeup Max timeout in s" VALUE 0x802402B4 DefaultValueRecordLayout_AUTOSAR_Platform_BaseTypes_uint32 72000.0 RB_RBA_rba_SyC_CustStates_BswModuleDescriptions_rba_SyC_CustStates_Calibration_Time_Common_seconds_CompuMethod 0.0 72000. FORMAT "%5.0" /end CHARACTERISTIC
/begin CHARACTERISTIC rba_SyC_Custstates_Mintimeout_C "Customer States Min Timeout in s" VALUE 0x802402B0 DefaultValueRecordLayout_AUTOSAR_Platform_BaseTypes_uint32 72000.0 RB_RBA_rba_SyC_CustStates_BswModuleDescriptions_rba_SyC_CustStates_Calibration_Time_Common_seconds_CompuMethod 0.0 72000. FORMAT "%5.0" /end CHARACTERISTIC
/begin CHARACTERISTIC rba_SyC_Custstates_Nominal2Transtimeout_C "Customer States Nominal2Trans timeout in ms" VALUE 0x802402AC DefaultValueRecordLayout_AUTOSAR_Platform_BaseTypes_uint32 60000.0 RB_RBA_rba_SyC_CustStates_BswModuleDescriptions_rba_SyC_CustStates_Calibration_Time_Common_milliseconds_CompuMethod 0.0 60000. FORMAT "%5.0" /end CHARACTERISTIC
/begin CHARACTERISTIC rba_SyC_Custstates_Partial2Nominaltimeout_C "Customer States Partial2Nominal timeout in s" VALUE 0x802402A8 DefaultValueRecordLayout_AUTOSAR_Platform_BaseTypes_uint32 72000.0 RB_RBA_rba_SyC_CustStates_BswModuleDescriptions_rba_SyC_CustStates_Calibration_Time_Common_seconds_CompuMethod 0.0 72000. FORMAT "%5.0" /end CHARACTERISTIC
/begin CHARACTERISTIC rba_SyC_Custstates_PartialMainWkuInvldTimeout_C "Customer States PartialMainWkuInvld Timeout in s" VALUE 0x802402A4 DefaultValueRecordLayout_AUTOSAR_Platform_BaseTypes_uint32 72000.0 RB_RBA_rba_SyC_CustStates_BswModuleDescriptions_rba_SyC_CustStates_Calibration_Time_Common_seconds_CompuMethod 0.0 72000. FORMAT "%5.0" /end CHARACTERISTIC
/begin CHARACTERISTIC rba_SyC_Custstates_Trans2NominalTimeout_C "Customer States Trans2Nominal Timeout in s" VALUE 0x802402A0 DefaultValueRecordLayout_AUTOSAR_Platform_BaseTypes_uint32 72000.0 RB_RBA_rba_SyC_CustStates_BswModuleDescriptions_rba_SyC_CustStates_Calibration_Time_Common_seconds_CompuMethod 0.0 72000. FORMAT "%5.0" /end CHARACTERISTIC
/begin CHARACTERISTIC rba_SyC_Custstates_TransMainWkuInvldTimeout_C "Customer States TransMainWkuInvld Timeout in s" VALUE 0x8024029C DefaultValueRecordLayout_AUTOSAR_Platform_BaseTypes_uint32 72000.0 RB_RBA_rba_SyC_CustStates_BswModuleDescriptions_rba_SyC_CustStates_Calibration_Time_Common_seconds_CompuMethod 0.0 72000. FORMAT "%5.0" /end CHARACTERISTIC
/begin CHARACTERISTIC rba_SyC_Custstates_trans_SetDFC_C "Customer States Transitory DFC timeout in s" VALUE 0x80240298 DefaultValueRecordLayout_AUTOSAR_Platform_BaseTypes_uint32 72000.0 RB_RBA_rba_SyC_CustStates_BswModuleDescriptions_rba_SyC_CustStates_Calibration_Time_Common_seconds_CompuMethod 0.0 72000. FORMAT "%5.0" /end CHARACTERISTIC
/begin CHARACTERISTIC rba_T15_Signal_tiDebHiLo_C "Terminal 15 software debounce time high to low" VALUE 0x80240294 DefaultValueRecordLayout_AUTOSAR_Platform_BaseTypes_uint32 100.0 RB_RBA_rba_T15_BswModuleDescriptions_rba_T15_Signal_Calibration_CompuMethod 0.0 100. FORMAT "%5.0" /end CHARACTERISTIC
/begin CHARACTERISTIC rba_T15_Signal_tiDebLoHi_C "Terminal 15 software debounce time Low to High" VALUE 0x80240290 DefaultValueRecordLayout_AUTOSAR_Platform_BaseTypes_uint32 100.0 RB_RBA_rba_T15_BswModuleDescriptions_rba_T15_Signal_Calibration_CompuMethod 0.0 100. FORMAT "%5.0" /end CHARACTERISTIC
/begin CHARACTERISTIC DFC_CtlMsk2.DFC_rba_MultiStackTrace_Threshold_C "" VALUE 0x802415BF Val_Wu8 255.0 DFES_OneToOne 0.00 255.0 FORMAT "%5.1" /end CHARACTERISTIC
/begin CHARACTERISTIC DFC_CtlMsk2.DFC_rba_MRly_Diag_Stk_Event_C "" VALUE 0x802415C6 Val_Wu8 255.0 DFES_OneToOne 0.00 255.0 FORMAT "%5.1" /end CHARACTERISTIC
/begin CHARACTERISTIC DFC_DisblMsk2.DFC_rba_MultiStackTrace_Threshold_C "" VALUE 0x80249064 Val_Wu16 65535.00 DFES_OneToOne 0.00 65535.00 FORMAT "%8.2" /end CHARACTERISTIC
/begin CHARACTERISTIC DFC_DisblMsk2.DFC_rba_MRly_Diag_Stk_Event_C "" VALUE 0x80249072 Val_Wu16 65535.00 DFES_OneToOne 0.00 65535.00 FORMAT "%8.2" /end CHARACTERISTIC
/begin MEASUREMENT rba_MRly_Ctrl_State_MP "Current control state of Main Relay" UBYTE RB_RBA_rba_MRly_BswModuleDescriptions_rba_MRly_Ctrl_States_CompuMethod 1 100 0.0 1.000 FORMAT "%8.3" ECU_ADDRESS 0x70006C3E
 /begin ANNOTATION ANNOTATION_LABEL "Description (coming from AUTOSAR DESC field)" /begin ANNOTATION_TEXT "Current control state of Main Relay\r\n" /end ANNOTATION_TEXT /end ANNOTATION
/end MEASUREMENT
/begin MEASUREMENT rba_MultiStackTrace_CurrentCycleMaxUsage_CSA0 "Current Cycle Max Usage stack Csa0" UWORD RB_RBA_rba_OsMeasmt_CompuMethods_rba_OsMeasmt_PercConversion 1 100 0.0 655. FORMAT "%5.0" ECU_ADDRESS 0x60022AB4 /end MEASUREMENT
/begin MEASUREMENT rba_MultiStackTrace_CurrentCycleMaxUsage_CSA1 "Current Cycle Max Usage stack Csa1" UWORD RB_RBA_rba_OsMeasmt_CompuMethods_rba_OsMeasmt_PercConversion 1 100 0.0 655. FORMAT "%5.0" ECU_ADDRESS 0x60022AB2 /end MEASUREMENT
/begin MEASUREMENT rba_MultiStackTrace_CurrentCycleMaxUsage_CSA2 "Current Cycle Max Usage stack Csa2" UWORD RB_RBA_rba_OsMeasmt_CompuMethods_rba_OsMeasmt_PercConversion 1 100 0.0 655. FORMAT "%5.0" ECU_ADDRESS 0x60022AB0 /end MEASUREMENT
/begin MEASUREMENT rba_MultiStackTrace_CurrentCycleMaxUsage_User0 "Current Cycle Max Usage stack User0" UWORD RB_RBA_rba_OsMeasmt_CompuMethods_rba_OsMeasmt_PercConversion 1 100 0.0 655. FORMAT "%5.0" ECU_ADDRESS 0x60022ABA /end MEASUREMENT
/begin MEASUREMENT rba_MultiStackTrace_CurrentCycleMaxUsage_User1 "Current Cycle Max Usage stack User1" UWORD RB_RBA_rba_OsMeasmt_CompuMethods_rba_OsMeasmt_PercConversion 1 100 0.0 655. FORMAT "%5.0" ECU_ADDRESS 0x60022AB8 /end MEASUREMENT
/begin MEASUREMENT rba_MultiStackTrace_CurrentCycleMaxUsage_User2 "Current Cycle Max Usage stack User2" UWORD RB_RBA_rba_OsMeasmt_CompuMethods_rba_OsMeasmt_PercConversion 1 100 0.0 655. FORMAT "%5.0" ECU_ADDRESS 0x60022AB6 /end MEASUREMENT
/begin MEASUREMENT rba_MultiStackTrace_LifeTimeMaxUsage_CSA0 "Life Time Max Usage stack CSA0" UWORD RB_RBA_rba_OsMeasmt_CompuMethods_rba_OsMeasmt_PercConversion 1 100 0.0 655. FORMAT "%5.0" ECU_ADDRESS 0x60034090 /end MEASUREMENT
/begin MEASUREMENT rba_MultiStackTrace_LifeTimeMaxUsage_CSA1 "Life Time Max Usage stack CSA1" UWORD RB_RBA_rba_OsMeasmt_CompuMethods_rba_OsMeasmt_PercConversion 1 100 0.0 655. FORMAT "%5.0" ECU_ADDRESS 0x6003408E /end MEASUREMENT
/begin MEASUREMENT rba_MultiStackTrace_LifeTimeMaxUsage_CSA2 "Life Time Max Usage stack CSA2" UWORD RB_RBA_rba_OsMeasmt_CompuMethods_rba_OsMeasmt_PercConversion 1 100 0.0 655. FORMAT "%5.0" ECU_ADDRESS 0x6003408C /end MEASUREMENT
/begin MEASUREMENT rba_MultiStackTrace_LifeTimeMaxUsage_User0 "Life Time Max Usage stack User0" UWORD RB_RBA_rba_OsMeasmt_CompuMethods_rba_OsMeasmt_PercConversion 1 100 0.0 655. FORMAT "%5.0" ECU_ADDRESS 0x60034096 /end MEASUREMENT
/begin MEASUREMENT rba_MultiStackTrace_LifeTimeMaxUsage_User1 "Life Time Max Usage stack User1" UWORD RB_RBA_rba_OsMeasmt_CompuMethods_rba_OsMeasmt_PercConversion 1 100 0.0 655. FORMAT "%5.0" ECU_ADDRESS 0x60034094 /end MEASUREMENT
/begin MEASUREMENT rba_MultiStackTrace_LifeTimeMaxUsage_User2 "Life Time Max Usage stack User2" UWORD RB_RBA_rba_OsMeasmt_CompuMethods_rba_OsMeasmt_PercConversion 1 100 0.0 655. FORMAT "%5.0" ECU_ADDRESS 0x60034092 /end MEASUREMENT
/begin MEASUREMENT rba_MultiStackTrace_ThresholdTable "Threshold table for Configured Limits" UWORD RB_RBA_Common_CentralElements_CompuMethods_Identical 1 100 0.0 65535. FORMAT "%5.0" ECU_ADDRESS 0x70001FDA MATRIX_DIM 6 /end MEASUREMENT
/begin MEASUREMENT rba_OsMeasmt_CoreLoad[0].current "Core load Os measurement for each core[0]/" UWORD RB_RBA_rba_OsMeasmt_CompuMethods_rba_OsMeasmt_PercConversion 1 100 0.0 655.00 FORMAT "%5.2" ECU_ADDRESS 0x70001298 /end MEASUREMENT
/begin MEASUREMENT rba_OsMeasmt_CoreLoad[1].current "Core load Os measurement for each core[1]/" UWORD RB_RBA_rba_OsMeasmt_CompuMethods_rba_OsMeasmt_PercConversion 1 100 0.0 655.00 FORMAT "%5.2" ECU_ADDRESS 0x7000129E /end MEASUREMENT
/begin MEASUREMENT rba_OsMeasmt_CoreLoad[2].current "Core load Os measurement for each core[2]/" UWORD RB_RBA_rba_OsMeasmt_CompuMethods_rba_OsMeasmt_PercConversion 1 100 0.0 655.00 FORMAT "%5.2" ECU_ADDRESS 0x700012A4 /end MEASUREMENT
/begin MEASUREMENT rba_OsMeasmt_CoreLoad[0].curCycleMax "Core load Os measurement for each core[0]/" UWORD RB_RBA_rba_OsMeasmt_CompuMethods_rba_OsMeasmt_PercConversion 1 100 0.0 655.00 FORMAT "%5.2" ECU_ADDRESS 0x7000129A /end MEASUREMENT
/begin MEASUREMENT rba_OsMeasmt_CoreLoad[1].curCycleMax "Core load Os measurement for each core[1]/" UWORD RB_RBA_rba_OsMeasmt_CompuMethods_rba_OsMeasmt_PercConversion 1 100 0.0 655.00 FORMAT "%5.2" ECU_ADDRESS 0x700012A0 /end MEASUREMENT
/begin MEASUREMENT rba_OsMeasmt_CoreLoad[2].curCycleMax "Core load Os measurement for each core[2]/" UWORD RB_RBA_rba_OsMeasmt_CompuMethods_rba_OsMeasmt_PercConversion 1 100 0.0 655.00 FORMAT "%5.2" ECU_ADDRESS 0x700012A6 /end MEASUREMENT
/begin MEASUREMENT rba_OsMeasmt_CoreLoad[0].lifeTimeMax "Core load Os measurement for each core[0]/" UWORD RB_RBA_rba_OsMeasmt_CompuMethods_rba_OsMeasmt_PercConversion 1 100 0.0 655.00 FORMAT "%5.2" ECU_ADDRESS 0x7000129C /end MEASUREMENT
/begin MEASUREMENT rba_OsMeasmt_CoreLoad[1].lifeTimeMax "Core load Os measurement for each core[1]/" UWORD RB_RBA_rba_OsMeasmt_CompuMethods_rba_OsMeasmt_PercConversion 1 100 0.0 655.00 FORMAT "%5.2" ECU_ADDRESS 0x700012A2 /end MEASUREMENT
/begin MEASUREMENT rba_OsMeasmt_CoreLoad[2].lifeTimeMax "Core load Os measurement for each core[2]/" UWORD RB_RBA_rba_OsMeasmt_CompuMethods_rba_OsMeasmt_PercConversion 1 100 0.0 655.00 FORMAT "%5.2" ECU_ADDRESS 0x700012A8 /end MEASUREMENT
/begin MEASUREMENT rba_OsMeasmt_OS_1000ms_Task.RespTimeCurrent "Task response time monitoring for OS_1000ms_Task/" ULONG RB_RBA_rba_OsMeasmt_CompuMethods_rba_OsMeasmt_TaskRespTime_CompuMethod 1 100 0.0 4.294967200E7 FORMAT "%13.9" ECU_ADDRESS 0x60029798 /end MEASUREMENT
/begin MEASUREMENT rba_OsMeasmt_OS_1000ms_Task.RespTimeCycleMax "Task response time monitoring for OS_1000ms_Task/" ULONG RB_RBA_rba_OsMeasmt_CompuMethods_rba_OsMeasmt_TaskRespTime_CompuMethod 1 100 0.0 4.294967200E7 FORMAT "%13.9" ECU_ADDRESS 0x6002979C /end MEASUREMENT
/begin MEASUREMENT rba_OsMeasmt_OS_1000ms_Task.RespTimeLifetimeMax "Task response time monitoring for OS_1000ms_Task/" ULONG RB_RBA_rba_OsMeasmt_CompuMethods_rba_OsMeasmt_TaskRespTime_CompuMethod 1 100 0.0 4.294967200E7 FORMAT "%13.9" ECU_ADDRESS 0x600297A0 /end MEASUREMENT
/begin MEASUREMENT rba_OsMeasmt_OS_1000ms_Task.CETCurrent "Task response time monitoring for OS_1000ms_Task/" ULONG RB_RBA_rba_OsMeasmt_CompuMethods_rba_OsMeasmt_CET_T1_CompuMethod 1 100 0.0 4.294967200E7 FORMAT "%13.9" ECU_ADDRESS 0x600297A4 /end MEASUREMENT
/begin MEASUREMENT rba_OsMeasmt_OS_1000ms_Task.CETCycleMax "Task response time monitoring for OS_1000ms_Task/" ULONG RB_RBA_rba_OsMeasmt_CompuMethods_rba_OsMeasmt_CET_T1_CompuMethod 1 100 0.0 4.294967200E7 FORMAT "%13.9" ECU_ADDRESS 0x600297A8 /end MEASUREMENT
/begin MEASUREMENT rba_OsMeasmt_OS_1000ms_Task.CETCurrentLoad "Task response time monitoring for OS_1000ms_Task/" UWORD RB_RBA_rba_OsMeasmt_CompuMethods_rba_OsMeasmt_T1_PercConversion 1 100 0.0 655.00 FORMAT "%5.2" ECU_ADDRESS 0x600297AC /end MEASUREMENT
/begin MEASUREMENT rba_OsMeasmt_OS_1000ms_Task.CETCurrentLoadMax "Task response time monitoring for OS_1000ms_Task/" UWORD RB_RBA_rba_OsMeasmt_CompuMethods_rba_OsMeasmt_T1_PercConversion 1 100 0.0 655.00 FORMAT "%5.2" ECU_ADDRESS 0x600297AE /end MEASUREMENT
/begin MEASUREMENT rba_OsMeasmt_OS_100ms_Task.RespTimeCurrent "Task response time monitoring for OS_100ms_Task/" ULONG RB_RBA_rba_OsMeasmt_CompuMethods_rba_OsMeasmt_TaskRespTime_CompuMethod 1 100 0.0 4.294967200E7 FORMAT "%13.9" ECU_ADDRESS 0x60029780 /end MEASUREMENT
/begin MEASUREMENT rba_OsMeasmt_OS_100ms_Task.RespTimeCycleMax "Task response time monitoring for OS_100ms_Task/" ULONG RB_RBA_rba_OsMeasmt_CompuMethods_rba_OsMeasmt_TaskRespTime_CompuMethod 1 100 0.0 4.294967200E7 FORMAT "%13.9" ECU_ADDRESS 0x60029784 /end MEASUREMENT
/begin MEASUREMENT rba_OsMeasmt_OS_100ms_Task.RespTimeLifetimeMax "Task response time monitoring for OS_100ms_Task/" ULONG RB_RBA_rba_OsMeasmt_CompuMethods_rba_OsMeasmt_TaskRespTime_CompuMethod 1 100 0.0 4.294967200E7 FORMAT "%13.9" ECU_ADDRESS 0x60029788 /end MEASUREMENT
/begin MEASUREMENT rba_OsMeasmt_OS_100ms_Task.CETCurrent "Task response time monitoring for OS_100ms_Task/" ULONG RB_RBA_rba_OsMeasmt_CompuMethods_rba_OsMeasmt_CET_T1_CompuMethod 1 100 0.0 4.294967200E7 FORMAT "%13.9" ECU_ADDRESS 0x6002978C /end MEASUREMENT
/begin MEASUREMENT rba_OsMeasmt_OS_100ms_Task.CETCycleMax "Task response time monitoring for OS_100ms_Task/" ULONG RB_RBA_rba_OsMeasmt_CompuMethods_rba_OsMeasmt_CET_T1_CompuMethod 1 100 0.0 4.294967200E7 FORMAT "%13.9" ECU_ADDRESS 0x60029790 /end MEASUREMENT
/begin MEASUREMENT rba_OsMeasmt_OS_100ms_Task.CETCurrentLoad "Task response time monitoring for OS_100ms_Task/" UWORD RB_RBA_rba_OsMeasmt_CompuMethods_rba_OsMeasmt_T1_PercConversion 1 100 0.0 655.00 FORMAT "%5.2" ECU_ADDRESS 0x60029794 /end MEASUREMENT
/begin MEASUREMENT rba_OsMeasmt_OS_100ms_Task.CETCurrentLoadMax "Task response time monitoring for OS_100ms_Task/" UWORD RB_RBA_rba_OsMeasmt_CompuMethods_rba_OsMeasmt_T1_PercConversion 1 100 0.0 655.00 FORMAT "%5.2" ECU_ADDRESS 0x60029796 /end MEASUREMENT
/begin MEASUREMENT rba_OsMeasmt_OS_10ms_Task.RespTimeCurrent "Task response time monitoring for OS_10ms_Task/" ULONG RB_RBA_rba_OsMeasmt_CompuMethods_rba_OsMeasmt_TaskRespTime_CompuMethod 1 100 0.0 4.294967200E7 FORMAT "%13.9" ECU_ADDRESS 0x60029768 /end MEASUREMENT
/begin MEASUREMENT rba_OsMeasmt_OS_10ms_Task.RespTimeCycleMax "Task response time monitoring for OS_10ms_Task/" ULONG RB_RBA_rba_OsMeasmt_CompuMethods_rba_OsMeasmt_TaskRespTime_CompuMethod 1 100 0.0 4.294967200E7 FORMAT "%13.9" ECU_ADDRESS 0x6002976C /end MEASUREMENT
/begin MEASUREMENT rba_OsMeasmt_OS_10ms_Task.RespTimeLifetimeMax "Task response time monitoring for OS_10ms_Task/" ULONG RB_RBA_rba_OsMeasmt_CompuMethods_rba_OsMeasmt_TaskRespTime_CompuMethod 1 100 0.0 4.294967200E7 FORMAT "%13.9" ECU_ADDRESS 0x60029770 /end MEASUREMENT
/begin MEASUREMENT rba_OsMeasmt_OS_10ms_Task.CETCurrent "Task response time monitoring for OS_10ms_Task/" ULONG RB_RBA_rba_OsMeasmt_CompuMethods_rba_OsMeasmt_CET_T1_CompuMethod 1 100 0.0 4.294967200E7 FORMAT "%13.9" ECU_ADDRESS 0x60029774 /end MEASUREMENT
/begin MEASUREMENT rba_OsMeasmt_OS_10ms_Task.CETCycleMax "Task response time monitoring for OS_10ms_Task/" ULONG RB_RBA_rba_OsMeasmt_CompuMethods_rba_OsMeasmt_CET_T1_CompuMethod 1 100 0.0 4.294967200E7 FORMAT "%13.9" ECU_ADDRESS 0x60029778 /end MEASUREMENT
/begin MEASUREMENT rba_OsMeasmt_OS_10ms_Task.CETCurrentLoad "Task response time monitoring for OS_10ms_Task/" UWORD RB_RBA_rba_OsMeasmt_CompuMethods_rba_OsMeasmt_T1_PercConversion 1 100 0.0 655.00 FORMAT "%5.2" ECU_ADDRESS 0x6002977C /end MEASUREMENT
/begin MEASUREMENT rba_OsMeasmt_OS_10ms_Task.CETCurrentLoadMax "Task response time monitoring for OS_10ms_Task/" UWORD RB_RBA_rba_OsMeasmt_CompuMethods_rba_OsMeasmt_T1_PercConversion 1 100 0.0 655.00 FORMAT "%5.2" ECU_ADDRESS 0x6002977E /end MEASUREMENT
/begin MEASUREMENT rba_OsMeasmt_OS_1ms_Task.RespTimeCurrent "Task response time monitoring for OS_1ms_Task/" ULONG RB_RBA_rba_OsMeasmt_CompuMethods_rba_OsMeasmt_TaskRespTime_CompuMethod 1 100 0.0 4.294967200E7 FORMAT "%13.9" ECU_ADDRESS 0x50000128 /end MEASUREMENT
/begin MEASUREMENT rba_OsMeasmt_OS_1ms_Task.RespTimeCycleMax "Task response time monitoring for OS_1ms_Task/" ULONG RB_RBA_rba_OsMeasmt_CompuMethods_rba_OsMeasmt_TaskRespTime_CompuMethod 1 100 0.0 4.294967200E7 FORMAT "%13.9" ECU_ADDRESS 0x5000012C /end MEASUREMENT
/begin MEASUREMENT rba_OsMeasmt_OS_1ms_Task.RespTimeLifetimeMax "Task response time monitoring for OS_1ms_Task/" ULONG RB_RBA_rba_OsMeasmt_CompuMethods_rba_OsMeasmt_TaskRespTime_CompuMethod 1 100 0.0 4.294967200E7 FORMAT "%13.9" ECU_ADDRESS 0x50000130 /end MEASUREMENT
/begin MEASUREMENT rba_OsMeasmt_OS_1ms_Task.CETCurrent "Task response time monitoring for OS_1ms_Task/" ULONG RB_RBA_rba_OsMeasmt_CompuMethods_rba_OsMeasmt_CET_T1_CompuMethod 1 100 0.0 4.294967200E7 FORMAT "%13.9" ECU_ADDRESS 0x50000134 /end MEASUREMENT
/begin MEASUREMENT rba_OsMeasmt_OS_1ms_Task.CETCycleMax "Task response time monitoring for OS_1ms_Task/" ULONG RB_RBA_rba_OsMeasmt_CompuMethods_rba_OsMeasmt_CET_T1_CompuMethod 1 100 0.0 4.294967200E7 FORMAT "%13.9" ECU_ADDRESS 0x50000138 /end MEASUREMENT
/begin MEASUREMENT rba_OsMeasmt_OS_1ms_Task.CETCurrentLoad "Task response time monitoring for OS_1ms_Task/" UWORD RB_RBA_rba_OsMeasmt_CompuMethods_rba_OsMeasmt_T1_PercConversion 1 100 0.0 655.00 FORMAT "%5.2" ECU_ADDRESS 0x5000013C /end MEASUREMENT
/begin MEASUREMENT rba_OsMeasmt_OS_1ms_Task.CETCurrentLoadMax "Task response time monitoring for OS_1ms_Task/" UWORD RB_RBA_rba_OsMeasmt_CompuMethods_rba_OsMeasmt_T1_PercConversion 1 100 0.0 655.00 FORMAT "%5.2" ECU_ADDRESS 0x5000013E /end MEASUREMENT
/begin MEASUREMENT rba_OsMeasmt_OS_200ms_Task.RespTimeCurrent "Task response time monitoring for OS_200ms_Task/" ULONG RB_RBA_rba_OsMeasmt_CompuMethods_rba_OsMeasmt_TaskRespTime_CompuMethod 1 100 0.0 4.294967200E7 FORMAT "%13.9" ECU_ADDRESS 0x60029750 /end MEASUREMENT
/begin MEASUREMENT rba_OsMeasmt_OS_200ms_Task.RespTimeCycleMax "Task response time monitoring for OS_200ms_Task/" ULONG RB_RBA_rba_OsMeasmt_CompuMethods_rba_OsMeasmt_TaskRespTime_CompuMethod 1 100 0.0 4.294967200E7 FORMAT "%13.9" ECU_ADDRESS 0x60029754 /end MEASUREMENT
/begin MEASUREMENT rba_OsMeasmt_OS_200ms_Task.RespTimeLifetimeMax "Task response time monitoring for OS_200ms_Task/" ULONG RB_RBA_rba_OsMeasmt_CompuMethods_rba_OsMeasmt_TaskRespTime_CompuMethod 1 100 0.0 4.294967200E7 FORMAT "%13.9" ECU_ADDRESS 0x60029758 /end MEASUREMENT
/begin MEASUREMENT rba_OsMeasmt_OS_200ms_Task.CETCurrent "Task response time monitoring for OS_200ms_Task/" ULONG RB_RBA_rba_OsMeasmt_CompuMethods_rba_OsMeasmt_CET_T1_CompuMethod 1 100 0.0 4.294967200E7 FORMAT "%13.9" ECU_ADDRESS 0x6002975C /end MEASUREMENT
/begin MEASUREMENT rba_OsMeasmt_OS_200ms_Task.CETCycleMax "Task response time monitoring for OS_200ms_Task/" ULONG RB_RBA_rba_OsMeasmt_CompuMethods_rba_OsMeasmt_CET_T1_CompuMethod 1 100 0.0 4.294967200E7 FORMAT "%13.9" ECU_ADDRESS 0x60029760 /end MEASUREMENT
/begin MEASUREMENT rba_OsMeasmt_OS_200ms_Task.CETCurrentLoad "Task response time monitoring for OS_200ms_Task/" UWORD RB_RBA_rba_OsMeasmt_CompuMethods_rba_OsMeasmt_T1_PercConversion 1 100 0.0 655.00 FORMAT "%5.2" ECU_ADDRESS 0x60029764 /end MEASUREMENT
/begin MEASUREMENT rba_OsMeasmt_OS_200ms_Task.CETCurrentLoadMax "Task response time monitoring for OS_200ms_Task/" UWORD RB_RBA_rba_OsMeasmt_CompuMethods_rba_OsMeasmt_T1_PercConversion 1 100 0.0 655.00 FORMAT "%5.2" ECU_ADDRESS 0x60029766 /end MEASUREMENT
/begin MEASUREMENT rba_OsMeasmt_OS_20ms_Task.RespTimeCurrent "Task response time monitoring for OS_20ms_Task/" ULONG RB_RBA_rba_OsMeasmt_CompuMethods_rba_OsMeasmt_TaskRespTime_CompuMethod 1 100 0.0 4.294967200E7 FORMAT "%13.9" ECU_ADDRESS 0x60029738 /end MEASUREMENT
/begin MEASUREMENT rba_OsMeasmt_OS_20ms_Task.RespTimeCycleMax "Task response time monitoring for OS_20ms_Task/" ULONG RB_RBA_rba_OsMeasmt_CompuMethods_rba_OsMeasmt_TaskRespTime_CompuMethod 1 100 0.0 4.294967200E7 FORMAT "%13.9" ECU_ADDRESS 0x6002973C /end MEASUREMENT
/begin MEASUREMENT rba_OsMeasmt_OS_20ms_Task.RespTimeLifetimeMax "Task response time monitoring for OS_20ms_Task/" ULONG RB_RBA_rba_OsMeasmt_CompuMethods_rba_OsMeasmt_TaskRespTime_CompuMethod 1 100 0.0 4.294967200E7 FORMAT "%13.9" ECU_ADDRESS 0x60029740 /end MEASUREMENT
/begin MEASUREMENT rba_OsMeasmt_OS_20ms_Task.CETCurrent "Task response time monitoring for OS_20ms_Task/" ULONG RB_RBA_rba_OsMeasmt_CompuMethods_rba_OsMeasmt_CET_T1_CompuMethod 1 100 0.0 4.294967200E7 FORMAT "%13.9" ECU_ADDRESS 0x60029744 /end MEASUREMENT
/begin MEASUREMENT rba_OsMeasmt_OS_20ms_Task.CETCycleMax "Task response time monitoring for OS_20ms_Task/" ULONG RB_RBA_rba_OsMeasmt_CompuMethods_rba_OsMeasmt_CET_T1_CompuMethod 1 100 0.0 4.294967200E7 FORMAT "%13.9" ECU_ADDRESS 0x60029748 /end MEASUREMENT
/begin MEASUREMENT rba_OsMeasmt_OS_20ms_Task.CETCurrentLoad "Task response time monitoring for OS_20ms_Task/" UWORD RB_RBA_rba_OsMeasmt_CompuMethods_rba_OsMeasmt_T1_PercConversion 1 100 0.0 655.00 FORMAT "%5.2" ECU_ADDRESS 0x6002974C /end MEASUREMENT
/begin MEASUREMENT rba_OsMeasmt_OS_20ms_Task.CETCurrentLoadMax "Task response time monitoring for OS_20ms_Task/" UWORD RB_RBA_rba_OsMeasmt_CompuMethods_rba_OsMeasmt_T1_PercConversion 1 100 0.0 655.00 FORMAT "%5.2" ECU_ADDRESS 0x6002974E /end MEASUREMENT
/begin MEASUREMENT rba_OsMeasmt_OS_2ms_Task.RespTimeCurrent "Task response time monitoring for OS_2ms_Task/" ULONG RB_RBA_rba_OsMeasmt_CompuMethods_rba_OsMeasmt_TaskRespTime_CompuMethod 1 100 0.0 4.294967200E7 FORMAT "%13.9" ECU_ADDRESS 0x50000110 /end MEASUREMENT
/begin MEASUREMENT rba_OsMeasmt_OS_2ms_Task.RespTimeCycleMax "Task response time monitoring for OS_2ms_Task/" ULONG RB_RBA_rba_OsMeasmt_CompuMethods_rba_OsMeasmt_TaskRespTime_CompuMethod 1 100 0.0 4.294967200E7 FORMAT "%13.9" ECU_ADDRESS 0x50000114 /end MEASUREMENT
/begin MEASUREMENT rba_OsMeasmt_OS_2ms_Task.RespTimeLifetimeMax "Task response time monitoring for OS_2ms_Task/" ULONG RB_RBA_rba_OsMeasmt_CompuMethods_rba_OsMeasmt_TaskRespTime_CompuMethod 1 100 0.0 4.294967200E7 FORMAT "%13.9" ECU_ADDRESS 0x50000118 /end MEASUREMENT
/begin MEASUREMENT rba_OsMeasmt_OS_2ms_Task.CETCurrent "Task response time monitoring for OS_2ms_Task/" ULONG RB_RBA_rba_OsMeasmt_CompuMethods_rba_OsMeasmt_CET_T1_CompuMethod 1 100 0.0 4.294967200E7 FORMAT "%13.9" ECU_ADDRESS 0x5000011C /end MEASUREMENT
/begin MEASUREMENT rba_OsMeasmt_OS_2ms_Task.CETCycleMax "Task response time monitoring for OS_2ms_Task/" ULONG RB_RBA_rba_OsMeasmt_CompuMethods_rba_OsMeasmt_CET_T1_CompuMethod 1 100 0.0 4.294967200E7 FORMAT "%13.9" ECU_ADDRESS 0x50000120 /end MEASUREMENT
/begin MEASUREMENT rba_OsMeasmt_OS_2ms_Task.CETCurrentLoad "Task response time monitoring for OS_2ms_Task/" UWORD RB_RBA_rba_OsMeasmt_CompuMethods_rba_OsMeasmt_T1_PercConversion 1 100 0.0 655.00 FORMAT "%5.2" ECU_ADDRESS 0x50000124 /end MEASUREMENT
/begin MEASUREMENT rba_OsMeasmt_OS_2ms_Task.CETCurrentLoadMax "Task response time monitoring for OS_2ms_Task/" UWORD RB_RBA_rba_OsMeasmt_CompuMethods_rba_OsMeasmt_T1_PercConversion 1 100 0.0 655.00 FORMAT "%5.2" ECU_ADDRESS 0x50000126 /end MEASUREMENT
/begin MEASUREMENT rba_OsMeasmt_OS_50ms_Task.RespTimeCurrent "Task response time monitoring for OS_50ms_Task/" ULONG RB_RBA_rba_OsMeasmt_CompuMethods_rba_OsMeasmt_TaskRespTime_CompuMethod 1 100 0.0 4.294967200E7 FORMAT "%13.9" ECU_ADDRESS 0x60029720 /end MEASUREMENT
/begin MEASUREMENT rba_OsMeasmt_OS_50ms_Task.RespTimeCycleMax "Task response time monitoring for OS_50ms_Task/" ULONG RB_RBA_rba_OsMeasmt_CompuMethods_rba_OsMeasmt_TaskRespTime_CompuMethod 1 100 0.0 4.294967200E7 FORMAT "%13.9" ECU_ADDRESS 0x60029724 /end MEASUREMENT
/begin MEASUREMENT rba_OsMeasmt_OS_50ms_Task.RespTimeLifetimeMax "Task response time monitoring for OS_50ms_Task/" ULONG RB_RBA_rba_OsMeasmt_CompuMethods_rba_OsMeasmt_TaskRespTime_CompuMethod 1 100 0.0 4.294967200E7 FORMAT "%13.9" ECU_ADDRESS 0x60029728 /end MEASUREMENT
/begin MEASUREMENT rba_OsMeasmt_OS_50ms_Task.CETCurrent "Task response time monitoring for OS_50ms_Task/" ULONG RB_RBA_rba_OsMeasmt_CompuMethods_rba_OsMeasmt_CET_T1_CompuMethod 1 100 0.0 4.294967200E7 FORMAT "%13.9" ECU_ADDRESS 0x6002972C /end MEASUREMENT
/begin MEASUREMENT rba_OsMeasmt_OS_50ms_Task.CETCycleMax "Task response time monitoring for OS_50ms_Task/" ULONG RB_RBA_rba_OsMeasmt_CompuMethods_rba_OsMeasmt_CET_T1_CompuMethod 1 100 0.0 4.294967200E7 FORMAT "%13.9" ECU_ADDRESS 0x60029730 /end MEASUREMENT
/begin MEASUREMENT rba_OsMeasmt_OS_50ms_Task.CETCurrentLoad "Task response time monitoring for OS_50ms_Task/" UWORD RB_RBA_rba_OsMeasmt_CompuMethods_rba_OsMeasmt_T1_PercConversion 1 100 0.0 655.00 FORMAT "%5.2" ECU_ADDRESS 0x60029734 /end MEASUREMENT
/begin MEASUREMENT rba_OsMeasmt_OS_50ms_Task.CETCurrentLoadMax "Task response time monitoring for OS_50ms_Task/" UWORD RB_RBA_rba_OsMeasmt_CompuMethods_rba_OsMeasmt_T1_PercConversion 1 100 0.0 655.00 FORMAT "%5.2" ECU_ADDRESS 0x60029736 /end MEASUREMENT
/begin MEASUREMENT rba_OsMeasmt_OS_5ms_Task.RespTimeCurrent "Task response time monitoring for OS_5ms_Task/" ULONG RB_RBA_rba_OsMeasmt_CompuMethods_rba_OsMeasmt_TaskRespTime_CompuMethod 1 100 0.0 4.294967200E7 FORMAT "%13.9" ECU_ADDRESS 0x700048BC /end MEASUREMENT
/begin MEASUREMENT rba_OsMeasmt_OS_5ms_Task.RespTimeCycleMax "Task response time monitoring for OS_5ms_Task/" ULONG RB_RBA_rba_OsMeasmt_CompuMethods_rba_OsMeasmt_TaskRespTime_CompuMethod 1 100 0.0 4.294967200E7 FORMAT "%13.9" ECU_ADDRESS 0x700048C0 /end MEASUREMENT
/begin MEASUREMENT rba_OsMeasmt_OS_5ms_Task.RespTimeLifetimeMax "Task response time monitoring for OS_5ms_Task/" ULONG RB_RBA_rba_OsMeasmt_CompuMethods_rba_OsMeasmt_TaskRespTime_CompuMethod 1 100 0.0 4.294967200E7 FORMAT "%13.9" ECU_ADDRESS 0x700048C4 /end MEASUREMENT
/begin MEASUREMENT rba_OsMeasmt_OS_5ms_Task.CETCurrent "Task response time monitoring for OS_5ms_Task/" ULONG RB_RBA_rba_OsMeasmt_CompuMethods_rba_OsMeasmt_CET_T1_CompuMethod 1 100 0.0 4.294967200E7 FORMAT "%13.9" ECU_ADDRESS 0x700048C8 /end MEASUREMENT
/begin MEASUREMENT rba_OsMeasmt_OS_5ms_Task.CETCycleMax "Task response time monitoring for OS_5ms_Task/" ULONG RB_RBA_rba_OsMeasmt_CompuMethods_rba_OsMeasmt_CET_T1_CompuMethod 1 100 0.0 4.294967200E7 FORMAT "%13.9" ECU_ADDRESS 0x700048CC /end MEASUREMENT
/begin MEASUREMENT rba_OsMeasmt_OS_5ms_Task.CETCurrentLoad "Task response time monitoring for OS_5ms_Task/" UWORD RB_RBA_rba_OsMeasmt_CompuMethods_rba_OsMeasmt_T1_PercConversion 1 100 0.0 655.00 FORMAT "%5.2" ECU_ADDRESS 0x700048D0 /end MEASUREMENT
/begin MEASUREMENT rba_OsMeasmt_OS_5ms_Task.CETCurrentLoadMax "Task response time monitoring for OS_5ms_Task/" UWORD RB_RBA_rba_OsMeasmt_CompuMethods_rba_OsMeasmt_T1_PercConversion 1 100 0.0 655.00 FORMAT "%5.2" ECU_ADDRESS 0x700048D2 /end MEASUREMENT
/begin MEASUREMENT rba_OsMeasmt_T1_CoreLoad[0].current "Core load T1 measurement for each core[0]/" UWORD RB_RBA_rba_OsMeasmt_CompuMethods_rba_OsMeasmt_T1_PercConversion 1 100 0.0 655.00 FORMAT "%5.2" ECU_ADDRESS 0x7000128C /end MEASUREMENT
/begin MEASUREMENT rba_OsMeasmt_T1_CoreLoad[1].current "Core load T1 measurement for each core[1]/" UWORD RB_RBA_rba_OsMeasmt_CompuMethods_rba_OsMeasmt_T1_PercConversion 1 100 0.0 655.00 FORMAT "%5.2" ECU_ADDRESS 0x70001290 /end MEASUREMENT
/begin MEASUREMENT rba_OsMeasmt_T1_CoreLoad[2].current "Core load T1 measurement for each core[2]/" UWORD RB_RBA_rba_OsMeasmt_CompuMethods_rba_OsMeasmt_T1_PercConversion 1 100 0.0 655.00 FORMAT "%5.2" ECU_ADDRESS 0x70001294 /end MEASUREMENT
/begin MEASUREMENT rba_OsMeasmt_T1_CoreLoad[0].curCycleMax "Core load T1 measurement for each core[0]/" UWORD RB_RBA_rba_OsMeasmt_CompuMethods_rba_OsMeasmt_T1_PercConversion 1 100 0.0 655.00 FORMAT "%5.2" ECU_ADDRESS 0x7000128E /end MEASUREMENT
/begin MEASUREMENT rba_OsMeasmt_T1_CoreLoad[1].curCycleMax "Core load T1 measurement for each core[1]/" UWORD RB_RBA_rba_OsMeasmt_CompuMethods_rba_OsMeasmt_T1_PercConversion 1 100 0.0 655.00 FORMAT "%5.2" ECU_ADDRESS 0x70001292 /end MEASUREMENT
/begin MEASUREMENT rba_OsMeasmt_T1_CoreLoad[2].curCycleMax "Core load T1 measurement for each core[2]/" UWORD RB_RBA_rba_OsMeasmt_CompuMethods_rba_OsMeasmt_T1_PercConversion 1 100 0.0 655.00 FORMAT "%5.2" ECU_ADDRESS 0x70001296 /end MEASUREMENT
/begin MEASUREMENT rba_Reset_ApplEnv_st.Loc_u32 "reset application environment/" ULONG RB_RBA_Common_CentralElements_CompuMethods_Identical 1 100 0.0 4.E9 FORMAT "%5.0" ECU_ADDRESS 0x600002F0 /end MEASUREMENT
/begin MEASUREMENT rba_Reset_ApplEnv_st.UserValue_u32 "reset application environment/" ULONG RB_RBA_Common_CentralElements_CompuMethods_Identical 1 100 0.0 4.E9 FORMAT "%5.0" ECU_ADDRESS 0x600002F4 /end MEASUREMENT
/begin MEASUREMENT rba_Reset_ApplEnv_st.Id_en "reset application environment/" UWORD RB_RBA_rba_Reset_CompuMethods_rba_Reset_Id_ten 1 100 0.0 65535. FORMAT "%5.0" ECU_ADDRESS 0x600002F8 /end MEASUREMENT
/begin MEASUREMENT rba_Reset_ApplEnv_st.Grp_en "reset application environment/" UBYTE RB_RBA_Common_CentralElements_CompuMethods_Identical 1 100 0.0 255. FORMAT "%5.0" ECU_ADDRESS 0x600002FA /end MEASUREMENT
/begin MEASUREMENT rba_Reset_ApplEnv_st.CntrRst_u8 "reset application environment/" UBYTE RB_RBA_Common_CentralElements_CompuMethods_Identical 1 100 0.0 255. FORMAT "%5.0" ECU_ADDRESS 0x600002FB /end MEASUREMENT
/begin MEASUREMENT rba_Reset_ExtHistBuf_ast[0].ResetId_en "extended Reset history buffer[0]/" UWORD RB_RBA_rba_Reset_CompuMethods_rba_Reset_Id_ten 1 100 0.0 65535. FORMAT "%5.0" ECU_ADDRESS 0x70039AD4 /end MEASUREMENT
/begin MEASUREMENT rba_Reset_ExtHistBuf_ast[1].ResetId_en "extended Reset history buffer[1]/" UWORD RB_RBA_rba_Reset_CompuMethods_rba_Reset_Id_ten 1 100 0.0 65535. FORMAT "%5.0" ECU_ADDRESS 0x70039AE4 /end MEASUREMENT
/begin MEASUREMENT rba_Reset_ExtHistBuf_ast[2].ResetId_en "extended Reset history buffer[2]/" UWORD RB_RBA_rba_Reset_CompuMethods_rba_Reset_Id_ten 1 100 0.0 65535. FORMAT "%5.0" ECU_ADDRESS 0x70039AF4 /end MEASUREMENT
/begin MEASUREMENT rba_Reset_ExtHistBuf_ast[3].ResetId_en "extended Reset history buffer[3]/" UWORD RB_RBA_rba_Reset_CompuMethods_rba_Reset_Id_ten 1 100 0.0 65535. FORMAT "%5.0" ECU_ADDRESS 0x70039B04 /end MEASUREMENT
/begin MEASUREMENT rba_Reset_ExtHistBuf_ast[4].ResetId_en "extended Reset history buffer[4]/" UWORD RB_RBA_rba_Reset_CompuMethods_rba_Reset_Id_ten 1 100 0.0 65535. FORMAT "%5.0" ECU_ADDRESS 0x70039B14 /end MEASUREMENT
/begin MEASUREMENT rba_Reset_ExtHistBuf_ast[5].ResetId_en "extended Reset history buffer[5]/" UWORD RB_RBA_rba_Reset_CompuMethods_rba_Reset_Id_ten 1 100 0.0 65535. FORMAT "%5.0" ECU_ADDRESS 0x70039B24 /end MEASUREMENT
/begin MEASUREMENT rba_Reset_ExtHistBuf_ast[6].ResetId_en "extended Reset history buffer[6]/" UWORD RB_RBA_rba_Reset_CompuMethods_rba_Reset_Id_ten 1 100 0.0 65535. FORMAT "%5.0" ECU_ADDRESS 0x70039B34 /end MEASUREMENT
/begin MEASUREMENT rba_Reset_ExtHistBuf_ast[7].ResetId_en "extended Reset history buffer[7]/" UWORD RB_RBA_rba_Reset_CompuMethods_rba_Reset_Id_ten 1 100 0.0 65535. FORMAT "%5.0" ECU_ADDRESS 0x70039B44 /end MEASUREMENT
/begin MEASUREMENT rba_Reset_ExtHistBuf_ast[8].ResetId_en "extended Reset history buffer[8]/" UWORD RB_RBA_rba_Reset_CompuMethods_rba_Reset_Id_ten 1 100 0.0 65535. FORMAT "%5.0" ECU_ADDRESS 0x70039B54 /end MEASUREMENT
/begin MEASUREMENT rba_Reset_ExtHistBuf_ast[9].ResetId_en "extended Reset history buffer[9]/" UWORD RB_RBA_rba_Reset_CompuMethods_rba_Reset_Id_ten 1 100 0.0 65535. FORMAT "%5.0" ECU_ADDRESS 0x70039B64 /end MEASUREMENT
/begin MEASUREMENT rba_Reset_ExtHistBuf_ast[0].Cntr_u16 "extended Reset history buffer[0]/" UWORD RB_RBA_Common_CentralElements_CompuMethods_Identical 1 100 0.0 65535. FORMAT "%5.0" ECU_ADDRESS 0x70039AD6 /end MEASUREMENT
/begin MEASUREMENT rba_Reset_ExtHistBuf_ast[1].Cntr_u16 "extended Reset history buffer[1]/" UWORD RB_RBA_Common_CentralElements_CompuMethods_Identical 1 100 0.0 65535. FORMAT "%5.0" ECU_ADDRESS 0x70039AE6 /end MEASUREMENT
/begin MEASUREMENT rba_Reset_ExtHistBuf_ast[2].Cntr_u16 "extended Reset history buffer[2]/" UWORD RB_RBA_Common_CentralElements_CompuMethods_Identical 1 100 0.0 65535. FORMAT "%5.0" ECU_ADDRESS 0x70039AF6 /end MEASUREMENT
/begin MEASUREMENT rba_Reset_ExtHistBuf_ast[3].Cntr_u16 "extended Reset history buffer[3]/" UWORD RB_RBA_Common_CentralElements_CompuMethods_Identical 1 100 0.0 65535. FORMAT "%5.0" ECU_ADDRESS 0x70039B06 /end MEASUREMENT
/begin MEASUREMENT rba_Reset_ExtHistBuf_ast[4].Cntr_u16 "extended Reset history buffer[4]/" UWORD RB_RBA_Common_CentralElements_CompuMethods_Identical 1 100 0.0 65535. FORMAT "%5.0" ECU_ADDRESS 0x70039B16 /end MEASUREMENT
/begin MEASUREMENT rba_Reset_ExtHistBuf_ast[5].Cntr_u16 "extended Reset history buffer[5]/" UWORD RB_RBA_Common_CentralElements_CompuMethods_Identical 1 100 0.0 65535. FORMAT "%5.0" ECU_ADDRESS 0x70039B26 /end MEASUREMENT
/begin MEASUREMENT rba_Reset_ExtHistBuf_ast[6].Cntr_u16 "extended Reset history buffer[6]/" UWORD RB_RBA_Common_CentralElements_CompuMethods_Identical 1 100 0.0 65535. FORMAT "%5.0" ECU_ADDRESS 0x70039B36 /end MEASUREMENT
/begin MEASUREMENT rba_Reset_ExtHistBuf_ast[7].Cntr_u16 "extended Reset history buffer[7]/" UWORD RB_RBA_Common_CentralElements_CompuMethods_Identical 1 100 0.0 65535. FORMAT "%5.0" ECU_ADDRESS 0x70039B46 /end MEASUREMENT
/begin MEASUREMENT rba_Reset_ExtHistBuf_ast[8].Cntr_u16 "extended Reset history buffer[8]/" UWORD RB_RBA_Common_CentralElements_CompuMethods_Identical 1 100 0.0 65535. FORMAT "%5.0" ECU_ADDRESS 0x70039B56 /end MEASUREMENT
/begin MEASUREMENT rba_Reset_ExtHistBuf_ast[9].Cntr_u16 "extended Reset history buffer[9]/" UWORD RB_RBA_Common_CentralElements_CompuMethods_Identical 1 100 0.0 65535. FORMAT "%5.0" ECU_ADDRESS 0x70039B66 /end MEASUREMENT
/begin MEASUREMENT rba_Reset_ExtHistBuf_ast[0].Addr_u32 "extended Reset history buffer[0]/" ULONG RB_RBA_Common_CentralElements_CompuMethods_Identical 1 100 0.0 4.E9 FORMAT "%5.0" ECU_ADDRESS 0x70039AD8 /end MEASUREMENT
/begin MEASUREMENT rba_Reset_ExtHistBuf_ast[1].Addr_u32 "extended Reset history buffer[1]/" ULONG RB_RBA_Common_CentralElements_CompuMethods_Identical 1 100 0.0 4.E9 FORMAT "%5.0" ECU_ADDRESS 0x70039AE8 /end MEASUREMENT
/begin MEASUREMENT rba_Reset_ExtHistBuf_ast[2].Addr_u32 "extended Reset history buffer[2]/" ULONG RB_RBA_Common_CentralElements_CompuMethods_Identical 1 100 0.0 4.E9 FORMAT "%5.0" ECU_ADDRESS 0x70039AF8 /end MEASUREMENT
/begin MEASUREMENT rba_Reset_ExtHistBuf_ast[3].Addr_u32 "extended Reset history buffer[3]/" ULONG RB_RBA_Common_CentralElements_CompuMethods_Identical 1 100 0.0 4.E9 FORMAT "%5.0" ECU_ADDRESS 0x70039B08 /end MEASUREMENT
/begin MEASUREMENT rba_Reset_ExtHistBuf_ast[4].Addr_u32 "extended Reset history buffer[4]/" ULONG RB_RBA_Common_CentralElements_CompuMethods_Identical 1 100 0.0 4.E9 FORMAT "%5.0" ECU_ADDRESS 0x70039B18 /end MEASUREMENT
/begin MEASUREMENT rba_Reset_ExtHistBuf_ast[5].Addr_u32 "extended Reset history buffer[5]/" ULONG RB_RBA_Common_CentralElements_CompuMethods_Identical 1 100 0.0 4.E9 FORMAT "%5.0" ECU_ADDRESS 0x70039B28 /end MEASUREMENT
/begin MEASUREMENT rba_Reset_ExtHistBuf_ast[6].Addr_u32 "extended Reset history buffer[6]/" ULONG RB_RBA_Common_CentralElements_CompuMethods_Identical 1 100 0.0 4.E9 FORMAT "%5.0" ECU_ADDRESS 0x70039B38 /end MEASUREMENT
/begin MEASUREMENT rba_Reset_ExtHistBuf_ast[7].Addr_u32 "extended Reset history buffer[7]/" ULONG RB_RBA_Common_CentralElements_CompuMethods_Identical 1 100 0.0 4.E9 FORMAT "%5.0" ECU_ADDRESS 0x70039B48 /end MEASUREMENT
/begin MEASUREMENT rba_Reset_ExtHistBuf_ast[8].Addr_u32 "extended Reset history buffer[8]/" ULONG RB_RBA_Common_CentralElements_CompuMethods_Identical 1 100 0.0 4.E9 FORMAT "%5.0" ECU_ADDRESS 0x70039B58 /end MEASUREMENT
/begin MEASUREMENT rba_Reset_ExtHistBuf_ast[9].Addr_u32 "extended Reset history buffer[9]/" ULONG RB_RBA_Common_CentralElements_CompuMethods_Identical 1 100 0.0 4.E9 FORMAT "%5.0" ECU_ADDRESS 0x70039B68 /end MEASUREMENT
/begin MEASUREMENT rba_Reset_ExtHistBuf_ast[0].SwId_u32_1 "extended Reset history buffer[0]/" ULONG RB_RBA_Common_CentralElements_CompuMethods_Identical 1 100 0.0 4.E9 FORMAT "%5.0" ECU_ADDRESS 0x70039ADC /end MEASUREMENT
/begin MEASUREMENT rba_Reset_ExtHistBuf_ast[1].SwId_u32_1 "extended Reset history buffer[1]/" ULONG RB_RBA_Common_CentralElements_CompuMethods_Identical 1 100 0.0 4.E9 FORMAT "%5.0" ECU_ADDRESS 0x70039AEC /end MEASUREMENT
/begin MEASUREMENT rba_Reset_ExtHistBuf_ast[2].SwId_u32_1 "extended Reset history buffer[2]/" ULONG RB_RBA_Common_CentralElements_CompuMethods_Identical 1 100 0.0 4.E9 FORMAT "%5.0" ECU_ADDRESS 0x70039AFC /end MEASUREMENT
/begin MEASUREMENT rba_Reset_ExtHistBuf_ast[3].SwId_u32_1 "extended Reset history buffer[3]/" ULONG RB_RBA_Common_CentralElements_CompuMethods_Identical 1 100 0.0 4.E9 FORMAT "%5.0" ECU_ADDRESS 0x70039B0C /end MEASUREMENT
/begin MEASUREMENT rba_Reset_ExtHistBuf_ast[4].SwId_u32_1 "extended Reset history buffer[4]/" ULONG RB_RBA_Common_CentralElements_CompuMethods_Identical 1 100 0.0 4.E9 FORMAT "%5.0" ECU_ADDRESS 0x70039B1C /end MEASUREMENT
/begin MEASUREMENT rba_Reset_ExtHistBuf_ast[5].SwId_u32_1 "extended Reset history buffer[5]/" ULONG RB_RBA_Common_CentralElements_CompuMethods_Identical 1 100 0.0 4.E9 FORMAT "%5.0" ECU_ADDRESS 0x70039B2C /end MEASUREMENT
/begin MEASUREMENT rba_Reset_ExtHistBuf_ast[6].SwId_u32_1 "extended Reset history buffer[6]/" ULONG RB_RBA_Common_CentralElements_CompuMethods_Identical 1 100 0.0 4.E9 FORMAT "%5.0" ECU_ADDRESS 0x70039B3C /end MEASUREMENT
/begin MEASUREMENT rba_Reset_ExtHistBuf_ast[7].SwId_u32_1 "extended Reset history buffer[7]/" ULONG RB_RBA_Common_CentralElements_CompuMethods_Identical 1 100 0.0 4.E9 FORMAT "%5.0" ECU_ADDRESS 0x70039B4C /end MEASUREMENT
/begin MEASUREMENT rba_Reset_ExtHistBuf_ast[8].SwId_u32_1 "extended Reset history buffer[8]/" ULONG RB_RBA_Common_CentralElements_CompuMethods_Identical 1 100 0.0 4.E9 FORMAT "%5.0" ECU_ADDRESS 0x70039B5C /end MEASUREMENT
/begin MEASUREMENT rba_Reset_ExtHistBuf_ast[9].SwId_u32_1 "extended Reset history buffer[9]/" ULONG RB_RBA_Common_CentralElements_CompuMethods_Identical 1 100 0.0 4.E9 FORMAT "%5.0" ECU_ADDRESS 0x70039B6C /end MEASUREMENT
/begin MEASUREMENT rba_Reset_ExtHistBuf_ast[0].SwId_u32_2 "extended Reset history buffer[0]/" ULONG RB_RBA_Common_CentralElements_CompuMethods_Identical 1 100 0.0 4.E9 FORMAT "%5.0" ECU_ADDRESS 0x70039AE0 /end MEASUREMENT
/begin MEASUREMENT rba_Reset_ExtHistBuf_ast[1].SwId_u32_2 "extended Reset history buffer[1]/" ULONG RB_RBA_Common_CentralElements_CompuMethods_Identical 1 100 0.0 4.E9 FORMAT "%5.0" ECU_ADDRESS 0x70039AF0 /end MEASUREMENT
/begin MEASUREMENT rba_Reset_ExtHistBuf_ast[2].SwId_u32_2 "extended Reset history buffer[2]/" ULONG RB_RBA_Common_CentralElements_CompuMethods_Identical 1 100 0.0 4.E9 FORMAT "%5.0" ECU_ADDRESS 0x70039B00 /end MEASUREMENT
/begin MEASUREMENT rba_Reset_ExtHistBuf_ast[3].SwId_u32_2 "extended Reset history buffer[3]/" ULONG RB_RBA_Common_CentralElements_CompuMethods_Identical 1 100 0.0 4.E9 FORMAT "%5.0" ECU_ADDRESS 0x70039B10 /end MEASUREMENT
/begin MEASUREMENT rba_Reset_ExtHistBuf_ast[4].SwId_u32_2 "extended Reset history buffer[4]/" ULONG RB_RBA_Common_CentralElements_CompuMethods_Identical 1 100 0.0 4.E9 FORMAT "%5.0" ECU_ADDRESS 0x70039B20 /end MEASUREMENT
/begin MEASUREMENT rba_Reset_ExtHistBuf_ast[5].SwId_u32_2 "extended Reset history buffer[5]/" ULONG RB_RBA_Common_CentralElements_CompuMethods_Identical 1 100 0.0 4.E9 FORMAT "%5.0" ECU_ADDRESS 0x70039B30 /end MEASUREMENT
/begin MEASUREMENT rba_Reset_ExtHistBuf_ast[6].SwId_u32_2 "extended Reset history buffer[6]/" ULONG RB_RBA_Common_CentralElements_CompuMethods_Identical 1 100 0.0 4.E9 FORMAT "%5.0" ECU_ADDRESS 0x70039B40 /end MEASUREMENT
/begin MEASUREMENT rba_Reset_ExtHistBuf_ast[7].SwId_u32_2 "extended Reset history buffer[7]/" ULONG RB_RBA_Common_CentralElements_CompuMethods_Identical 1 100 0.0 4.E9 FORMAT "%5.0" ECU_ADDRESS 0x70039B50 /end MEASUREMENT
/begin MEASUREMENT rba_Reset_ExtHistBuf_ast[8].SwId_u32_2 "extended Reset history buffer[8]/" ULONG RB_RBA_Common_CentralElements_CompuMethods_Identical 1 100 0.0 4.E9 FORMAT "%5.0" ECU_ADDRESS 0x70039B60 /end MEASUREMENT
/begin MEASUREMENT rba_Reset_ExtHistBuf_ast[9].SwId_u32_2 "extended Reset history buffer[9]/" ULONG RB_RBA_Common_CentralElements_CompuMethods_Identical 1 100 0.0 4.E9 FORMAT "%5.0" ECU_ADDRESS 0x70039B70 /end MEASUREMENT
/begin MEASUREMENT rba_Reset_HistBuf_a "reset history buffer" UWORD RB_RBA_rba_Reset_CompuMethods_rba_Reset_Id_ten 1 100 0.0 65535. FORMAT "%5.0" ECU_ADDRESS 0x70039B74 MATRIX_DIM 8 /end MEASUREMENT
/begin MEASUREMENT rba_SvbbEtk_ControlVar[0].Control_u8 "State of configured ServicePoints[0]/" UBYTE RB_RBA_Common_CentralElements_CompuMethods_Identical 1 100 0.0 255. FORMAT "%5.0" ECU_ADDRESS 0x60000280 /end MEASUREMENT
/begin MEASUREMENT rba_SvbbEtk_ControlVar[1].Control_u8 "State of configured ServicePoints[1]/" UBYTE RB_RBA_Common_CentralElements_CompuMethods_Identical 1 100 0.0 255. FORMAT "%5.0" ECU_ADDRESS 0x60000284 /end MEASUREMENT
/begin MEASUREMENT rba_SvbbEtk_ControlVar[2].Control_u8 "State of configured ServicePoints[2]/" UBYTE RB_RBA_Common_CentralElements_CompuMethods_Identical 1 100 0.0 255. FORMAT "%5.0" ECU_ADDRESS 0x60000288 /end MEASUREMENT
/begin MEASUREMENT rba_SvbbEtk_ControlVar[3].Control_u8 "State of configured ServicePoints[3]/" UBYTE RB_RBA_Common_CentralElements_CompuMethods_Identical 1 100 0.0 255. FORMAT "%5.0" ECU_ADDRESS 0x6000028C /end MEASUREMENT
/begin MEASUREMENT rba_SvbbEtk_ControlVar[4].Control_u8 "State of configured ServicePoints[4]/" UBYTE RB_RBA_Common_CentralElements_CompuMethods_Identical 1 100 0.0 255. FORMAT "%5.0" ECU_ADDRESS 0x60000290 /end MEASUREMENT
/begin MEASUREMENT rba_SvbbEtk_ControlVar[5].Control_u8 "State of configured ServicePoints[5]/" UBYTE RB_RBA_Common_CentralElements_CompuMethods_Identical 1 100 0.0 255. FORMAT "%5.0" ECU_ADDRESS 0x60000294 /end MEASUREMENT
/begin MEASUREMENT rba_SvbbEtk_ControlVar[6].Control_u8 "State of configured ServicePoints[6]/" UBYTE RB_RBA_Common_CentralElements_CompuMethods_Identical 1 100 0.0 255. FORMAT "%5.0" ECU_ADDRESS 0x60000298 /end MEASUREMENT
/begin MEASUREMENT rba_SvbbEtk_ControlVar[7].Control_u8 "State of configured ServicePoints[7]/" UBYTE RB_RBA_Common_CentralElements_CompuMethods_Identical 1 100 0.0 255. FORMAT "%5.0" ECU_ADDRESS 0x6000029C /end MEASUREMENT
/begin MEASUREMENT rba_SvbbEtk_ControlVar[8].Control_u8 "State of configured ServicePoints[8]/" UBYTE RB_RBA_Common_CentralElements_CompuMethods_Identical 1 100 0.0 255. FORMAT "%5.0" ECU_ADDRESS 0x600002A0 /end MEASUREMENT
/begin MEASUREMENT rba_SvbbEtk_ControlVar[9].Control_u8 "State of configured ServicePoints[9]/" UBYTE RB_RBA_Common_CentralElements_CompuMethods_Identical 1 100 0.0 255. FORMAT "%5.0" ECU_ADDRESS 0x600002A4 /end MEASUREMENT
/begin MEASUREMENT rba_SvbbEtk_ControlVar[10].Control_u8 "State of configured ServicePoints[10]/" UBYTE RB_RBA_Common_CentralElements_CompuMethods_Identical 1 100 0.0 255. FORMAT "%5.0" ECU_ADDRESS 0x600002A8 /end MEASUREMENT
/begin MEASUREMENT rba_SvbbEtk_ControlVar[11].Control_u8 "State of configured ServicePoints[11]/" UBYTE RB_RBA_Common_CentralElements_CompuMethods_Identical 1 100 0.0 255. FORMAT "%5.0" ECU_ADDRESS 0x600002AC /end MEASUREMENT
/begin MEASUREMENT rba_SvbbEtk_ControlVar[12].Control_u8 "State of configured ServicePoints[12]/" UBYTE RB_RBA_Common_CentralElements_CompuMethods_Identical 1 100 0.0 255. FORMAT "%5.0" ECU_ADDRESS 0x600002B0 /end MEASUREMENT
/begin MEASUREMENT rba_SvbbEtk_ControlVar[13].Control_u8 "State of configured ServicePoints[13]/" UBYTE RB_RBA_Common_CentralElements_CompuMethods_Identical 1 100 0.0 255. FORMAT "%5.0" ECU_ADDRESS 0x600002B4 /end MEASUREMENT
/begin MEASUREMENT rba_SvbbEtk_ControlVar[0].ErrCntPre_u8 "State of configured ServicePoints[0]/" UBYTE RB_RBA_Common_CentralElements_CompuMethods_Identical 1 100 0.0 255. FORMAT "%5.0" ECU_ADDRESS 0x60000281 /end MEASUREMENT
/begin MEASUREMENT rba_SvbbEtk_ControlVar[1].ErrCntPre_u8 "State of configured ServicePoints[1]/" UBYTE RB_RBA_Common_CentralElements_CompuMethods_Identical 1 100 0.0 255. FORMAT "%5.0" ECU_ADDRESS 0x60000285 /end MEASUREMENT
/begin MEASUREMENT rba_SvbbEtk_ControlVar[2].ErrCntPre_u8 "State of configured ServicePoints[2]/" UBYTE RB_RBA_Common_CentralElements_CompuMethods_Identical 1 100 0.0 255. FORMAT "%5.0" ECU_ADDRESS 0x60000289 /end MEASUREMENT
/begin MEASUREMENT rba_SvbbEtk_ControlVar[3].ErrCntPre_u8 "State of configured ServicePoints[3]/" UBYTE RB_RBA_Common_CentralElements_CompuMethods_Identical 1 100 0.0 255. FORMAT "%5.0" ECU_ADDRESS 0x6000028D /end MEASUREMENT
/begin MEASUREMENT rba_SvbbEtk_ControlVar[4].ErrCntPre_u8 "State of configured ServicePoints[4]/" UBYTE RB_RBA_Common_CentralElements_CompuMethods_Identical 1 100 0.0 255. FORMAT "%5.0" ECU_ADDRESS 0x60000291 /end MEASUREMENT
/begin MEASUREMENT rba_SvbbEtk_ControlVar[5].ErrCntPre_u8 "State of configured ServicePoints[5]/" UBYTE RB_RBA_Common_CentralElements_CompuMethods_Identical 1 100 0.0 255. FORMAT "%5.0" ECU_ADDRESS 0x60000295 /end MEASUREMENT
/begin MEASUREMENT rba_SvbbEtk_ControlVar[6].ErrCntPre_u8 "State of configured ServicePoints[6]/" UBYTE RB_RBA_Common_CentralElements_CompuMethods_Identical 1 100 0.0 255. FORMAT "%5.0" ECU_ADDRESS 0x60000299 /end MEASUREMENT
/begin MEASUREMENT rba_SvbbEtk_ControlVar[7].ErrCntPre_u8 "State of configured ServicePoints[7]/" UBYTE RB_RBA_Common_CentralElements_CompuMethods_Identical 1 100 0.0 255. FORMAT "%5.0" ECU_ADDRESS 0x6000029D /end MEASUREMENT
/begin MEASUREMENT rba_SvbbEtk_ControlVar[8].ErrCntPre_u8 "State of configured ServicePoints[8]/" UBYTE RB_RBA_Common_CentralElements_CompuMethods_Identical 1 100 0.0 255. FORMAT "%5.0" ECU_ADDRESS 0x600002A1 /end MEASUREMENT
/begin MEASUREMENT rba_SvbbEtk_ControlVar[9].ErrCntPre_u8 "State of configured ServicePoints[9]/" UBYTE RB_RBA_Common_CentralElements_CompuMethods_Identical 1 100 0.0 255. FORMAT "%5.0" ECU_ADDRESS 0x600002A5 /end MEASUREMENT
/begin MEASUREMENT rba_SvbbEtk_ControlVar[10].ErrCntPre_u8 "State of configured ServicePoints[10]/" UBYTE RB_RBA_Common_CentralElements_CompuMethods_Identical 1 100 0.0 255. FORMAT "%5.0" ECU_ADDRESS 0x600002A9 /end MEASUREMENT
/begin MEASUREMENT rba_SvbbEtk_ControlVar[11].ErrCntPre_u8 "State of configured ServicePoints[11]/" UBYTE RB_RBA_Common_CentralElements_CompuMethods_Identical 1 100 0.0 255. FORMAT "%5.0" ECU_ADDRESS 0x600002AD /end MEASUREMENT
/begin MEASUREMENT rba_SvbbEtk_ControlVar[12].ErrCntPre_u8 "State of configured ServicePoints[12]/" UBYTE RB_RBA_Common_CentralElements_CompuMethods_Identical 1 100 0.0 255. FORMAT "%5.0" ECU_ADDRESS 0x600002B1 /end MEASUREMENT
/begin MEASUREMENT rba_SvbbEtk_ControlVar[13].ErrCntPre_u8 "State of configured ServicePoints[13]/" UBYTE RB_RBA_Common_CentralElements_CompuMethods_Identical 1 100 0.0 255. FORMAT "%5.0" ECU_ADDRESS 0x600002B5 /end MEASUREMENT
/begin MEASUREMENT rba_SvbbEtk_ControlVar[0].ErrCntPost_u8 "State of configured ServicePoints[0]/" UBYTE RB_RBA_Common_CentralElements_CompuMethods_Identical 1 100 0.0 255. FORMAT "%5.0" ECU_ADDRESS 0x60000282 /end MEASUREMENT
/begin MEASUREMENT rba_SvbbEtk_ControlVar[1].ErrCntPost_u8 "State of configured ServicePoints[1]/" UBYTE RB_RBA_Common_CentralElements_CompuMethods_Identical 1 100 0.0 255. FORMAT "%5.0" ECU_ADDRESS 0x60000286 /end MEASUREMENT
/begin MEASUREMENT rba_SvbbEtk_ControlVar[2].ErrCntPost_u8 "State of configured ServicePoints[2]/" UBYTE RB_RBA_Common_CentralElements_CompuMethods_Identical 1 100 0.0 255. FORMAT "%5.0" ECU_ADDRESS 0x6000028A /end MEASUREMENT
/begin MEASUREMENT rba_SvbbEtk_ControlVar[3].ErrCntPost_u8 "State of configured ServicePoints[3]/" UBYTE RB_RBA_Common_CentralElements_CompuMethods_Identical 1 100 0.0 255. FORMAT "%5.0" ECU_ADDRESS 0x6000028E /end MEASUREMENT
/begin MEASUREMENT rba_SvbbEtk_ControlVar[4].ErrCntPost_u8 "State of configured ServicePoints[4]/" UBYTE RB_RBA_Common_CentralElements_CompuMethods_Identical 1 100 0.0 255. FORMAT "%5.0" ECU_ADDRESS 0x60000292 /end MEASUREMENT
/begin MEASUREMENT rba_SvbbEtk_ControlVar[5].ErrCntPost_u8 "State of configured ServicePoints[5]/" UBYTE RB_RBA_Common_CentralElements_CompuMethods_Identical 1 100 0.0 255. FORMAT "%5.0" ECU_ADDRESS 0x60000296 /end MEASUREMENT
/begin MEASUREMENT rba_SvbbEtk_ControlVar[6].ErrCntPost_u8 "State of configured ServicePoints[6]/" UBYTE RB_RBA_Common_CentralElements_CompuMethods_Identical 1 100 0.0 255. FORMAT "%5.0" ECU_ADDRESS 0x6000029A /end MEASUREMENT
/begin MEASUREMENT rba_SvbbEtk_ControlVar[7].ErrCntPost_u8 "State of configured ServicePoints[7]/" UBYTE RB_RBA_Common_CentralElements_CompuMethods_Identical 1 100 0.0 255. FORMAT "%5.0" ECU_ADDRESS 0x6000029E /end MEASUREMENT
/begin MEASUREMENT rba_SvbbEtk_ControlVar[8].ErrCntPost_u8 "State of configured ServicePoints[8]/" UBYTE RB_RBA_Common_CentralElements_CompuMethods_Identical 1 100 0.0 255. FORMAT "%5.0" ECU_ADDRESS 0x600002A2 /end MEASUREMENT
/begin MEASUREMENT rba_SvbbEtk_ControlVar[9].ErrCntPost_u8 "State of configured ServicePoints[9]/" UBYTE RB_RBA_Common_CentralElements_CompuMethods_Identical 1 100 0.0 255. FORMAT "%5.0" ECU_ADDRESS 0x600002A6 /end MEASUREMENT
/begin MEASUREMENT rba_SvbbEtk_ControlVar[10].ErrCntPost_u8 "State of configured ServicePoints[10]/" UBYTE RB_RBA_Common_CentralElements_CompuMethods_Identical 1 100 0.0 255. FORMAT "%5.0" ECU_ADDRESS 0x600002AA /end MEASUREMENT
/begin MEASUREMENT rba_SvbbEtk_ControlVar[11].ErrCntPost_u8 "State of configured ServicePoints[11]/" UBYTE RB_RBA_Common_CentralElements_CompuMethods_Identical 1 100 0.0 255. FORMAT "%5.0" ECU_ADDRESS 0x600002AE /end MEASUREMENT
/begin MEASUREMENT rba_SvbbEtk_ControlVar[12].ErrCntPost_u8 "State of configured ServicePoints[12]/" UBYTE RB_RBA_Common_CentralElements_CompuMethods_Identical 1 100 0.0 255. FORMAT "%5.0" ECU_ADDRESS 0x600002B2 /end MEASUREMENT
/begin MEASUREMENT rba_SvbbEtk_ControlVar[13].ErrCntPost_u8 "State of configured ServicePoints[13]/" UBYTE RB_RBA_Common_CentralElements_CompuMethods_Identical 1 100 0.0 255. FORMAT "%5.0" ECU_ADDRESS 0x600002B6 /end MEASUREMENT
/begin MEASUREMENT rba_SvbbEtk_ControlVar[0].FailedTriggerCounter_u8 "State of configured ServicePoints[0]/" UBYTE RB_RBA_Common_CentralElements_CompuMethods_Identical 1 100 0.0 255. FORMAT "%5.0" ECU_ADDRESS 0x60000283 /end MEASUREMENT
/begin MEASUREMENT rba_SvbbEtk_ControlVar[1].FailedTriggerCounter_u8 "State of configured ServicePoints[1]/" UBYTE RB_RBA_Common_CentralElements_CompuMethods_Identical 1 100 0.0 255. FORMAT "%5.0" ECU_ADDRESS 0x60000287 /end MEASUREMENT
/begin MEASUREMENT rba_SvbbEtk_ControlVar[2].FailedTriggerCounter_u8 "State of configured ServicePoints[2]/" UBYTE RB_RBA_Common_CentralElements_CompuMethods_Identical 1 100 0.0 255. FORMAT "%5.0" ECU_ADDRESS 0x6000028B /end MEASUREMENT
/begin MEASUREMENT rba_SvbbEtk_ControlVar[3].FailedTriggerCounter_u8 "State of configured ServicePoints[3]/" UBYTE RB_RBA_Common_CentralElements_CompuMethods_Identical 1 100 0.0 255. FORMAT "%5.0" ECU_ADDRESS 0x6000028F /end MEASUREMENT
/begin MEASUREMENT rba_SvbbEtk_ControlVar[4].FailedTriggerCounter_u8 "State of configured ServicePoints[4]/" UBYTE RB_RBA_Common_CentralElements_CompuMethods_Identical 1 100 0.0 255. FORMAT "%5.0" ECU_ADDRESS 0x60000293 /end MEASUREMENT
/begin MEASUREMENT rba_SvbbEtk_ControlVar[5].FailedTriggerCounter_u8 "State of configured ServicePoints[5]/" UBYTE RB_RBA_Common_CentralElements_CompuMethods_Identical 1 100 0.0 255. FORMAT "%5.0" ECU_ADDRESS 0x60000297 /end MEASUREMENT
/begin MEASUREMENT rba_SvbbEtk_ControlVar[6].FailedTriggerCounter_u8 "State of configured ServicePoints[6]/" UBYTE RB_RBA_Common_CentralElements_CompuMethods_Identical 1 100 0.0 255. FORMAT "%5.0" ECU_ADDRESS 0x6000029B /end MEASUREMENT
/begin MEASUREMENT rba_SvbbEtk_ControlVar[7].FailedTriggerCounter_u8 "State of configured ServicePoints[7]/" UBYTE RB_RBA_Common_CentralElements_CompuMethods_Identical 1 100 0.0 255. FORMAT "%5.0" ECU_ADDRESS 0x6000029F /end MEASUREMENT
/begin MEASUREMENT rba_SvbbEtk_ControlVar[8].FailedTriggerCounter_u8 "State of configured ServicePoints[8]/" UBYTE RB_RBA_Common_CentralElements_CompuMethods_Identical 1 100 0.0 255. FORMAT "%5.0" ECU_ADDRESS 0x600002A3 /end MEASUREMENT
/begin MEASUREMENT rba_SvbbEtk_ControlVar[9].FailedTriggerCounter_u8 "State of configured ServicePoints[9]/" UBYTE RB_RBA_Common_CentralElements_CompuMethods_Identical 1 100 0.0 255. FORMAT "%5.0" ECU_ADDRESS 0x600002A7 /end MEASUREMENT
/begin MEASUREMENT rba_SvbbEtk_ControlVar[10].FailedTriggerCounter_u8 "State of configured ServicePoints[10]/" UBYTE RB_RBA_Common_CentralElements_CompuMethods_Identical 1 100 0.0 255. FORMAT "%5.0" ECU_ADDRESS 0x600002AB /end MEASUREMENT
/begin MEASUREMENT rba_SvbbEtk_ControlVar[11].FailedTriggerCounter_u8 "State of configured ServicePoints[11]/" UBYTE RB_RBA_Common_CentralElements_CompuMethods_Identical 1 100 0.0 255. FORMAT "%5.0" ECU_ADDRESS 0x600002AF /end MEASUREMENT
/begin MEASUREMENT rba_SvbbEtk_ControlVar[12].FailedTriggerCounter_u8 "State of configured ServicePoints[12]/" UBYTE RB_RBA_Common_CentralElements_CompuMethods_Identical 1 100 0.0 255. FORMAT "%5.0" ECU_ADDRESS 0x600002B3 /end MEASUREMENT
/begin MEASUREMENT rba_SvbbEtk_ControlVar[13].FailedTriggerCounter_u8 "State of configured ServicePoints[13]/" UBYTE RB_RBA_Common_CentralElements_CompuMethods_Identical 1 100 0.0 255. FORMAT "%5.0" ECU_ADDRESS 0x600002B7 /end MEASUREMENT
/begin MEASUREMENT rba_SvbbEtk_DelayedEcuInitialisation "time in ms the ECU initialization was delayed, because it was waiting for download of Bypass configuration" UBYTE RB_RBA_Common_CentralElements_CompuMethods_Identical 1 100 0.0 255.0 FORMAT "%5.1" ECU_ADDRESS 0x60022F3C /end MEASUREMENT
/begin MEASUREMENT rba_SvbbEtk_DummyVar "Dummy variable which can be stimulated at ServicePoint \"rba_Svbb_DummyActivate\" for activation of ServiceBasedBypass" UBYTE RB_RBA_Common_CentralElements_CompuMethods_Identical 1 100 0.0 255.0 FORMAT "%5.1" ECU_ADDRESS 0x60022F3B /end MEASUREMENT
/begin MEASUREMENT rba_SvbbEtk_stEnable "Internal state of Service Based Bypass" UBYTE RB_RBA_rba_SvbbEtk_CompuMethods_rba_SvbbEtk_StateEnable_CM 1 100 0.0 255.0 FORMAT "%5.1" ECU_ADDRESS 0x60022F3A /end MEASUREMENT
/begin MEASUREMENT rba_SyC_CustStates_CurrentState_MP "Customer States" UBYTE RB_RBA_rba_SyC_CustStates_BswModuleDescriptions_rba_SyC_CustStates_States_CompuMethod 1 100 0.0 6.000 FORMAT "%8.3" ECU_ADDRESS 0x70006C3F
 /begin ANNOTATION ANNOTATION_LABEL "Description (coming from AUTOSAR DESC field)" /begin ANNOTATION_TEXT "State values of Customer State Machine\r\n" /end ANNOTATION_TEXT /end ANNOTATION
/end MEASUREMENT
/begin MEASUREMENT rba_T15_Signal_Debounced_MP "Debounced signal status of Terminal 15" UBYTE RB_RBA_rba_T15_BswModuleDescriptions_rba_T15_Signal_Status_CompuMethod 1 100 0.0 1.000 FORMAT "%8.3" ECU_ADDRESS 0x70006C3C
 /begin ANNOTATION ANNOTATION_LABEL "Description (coming from AUTOSAR DESC field)" /begin ANNOTATION_TEXT "Debounced signal status of Terminal 15\r\n" /end ANNOTATION_TEXT /end ANNOTATION
/end MEASUREMENT
/begin MEASUREMENT rba_T15_Signal_Logical_MP "Logical signal status of Terminal 15" UBYTE RB_RBA_rba_T15_BswModuleDescriptions_rba_T15_Signal_Status_CompuMethod 1 100 0.0 1.000 FORMAT "%8.3" ECU_ADDRESS 0x70006C3D
 /begin ANNOTATION ANNOTATION_LABEL "Description (coming from AUTOSAR DESC field)" /begin ANNOTATION_TEXT "Logical signal status of Terminal 15\r\n" /end ANNOTATION_TEXT /end ANNOTATION
/end MEASUREMENT
/begin MEASUREMENT rba_T15_Signal_UndebouncedValid_MP "Validity of undebounced signal status of Terminal 15" UBYTE RB_RBA_rba_T15_BswModuleDescriptions_rba_T15_Signal_StatusValid_CompuMethod 1 100 0.0 1.000 FORMAT "%8.3" ECU_ADDRESS 0x70006C3A
 /begin ANNOTATION ANNOTATION_LABEL "Description (coming from AUTOSAR DESC field)" /begin ANNOTATION_TEXT "Validity of undebounced signal status of Terminal 15\r\n" /end ANNOTATION_TEXT /end ANNOTATION
/end MEASUREMENT
/begin MEASUREMENT rba_T15_Signal_Undebounced_MP "Undebounced signal status of Terminal 15" UBYTE RB_RBA_rba_T15_BswModuleDescriptions_rba_T15_Signal_Status_CompuMethod 1 100 0.0 1.000 FORMAT "%8.3" ECU_ADDRESS 0x70006C3B
 /begin ANNOTATION ANNOTATION_LABEL "Description (coming from AUTOSAR DESC field)" /begin ANNOTATION_TEXT "Undebounced signal status of Terminal 15\r\n" /end ANNOTATION_TEXT /end ANNOTATION
/end MEASUREMENT
/begin MEASUREMENT DDRC_ctArDebLvl.DFC_rba_MultiStackTrace_Threshold "" SWORD DFC_OneToOne 1 100 -32768.00 32767.00 FORMAT "%8.2" ECU_ADDRESS 0x60021F6E /end MEASUREMENT
/begin MEASUREMENT DDRC_stLstRprtEve.DFC_rba_MultiStackTrace_Threshold "" UBYTE DDRC_LstRprtEve_VERB 1 100 0.00 255.000000000 FORMAT "%13.9" ECU_ADDRESS 0x60024975 /end MEASUREMENT
/begin MEASUREMENT DFC_st.DFC_rba_MultiStackTrace_Threshold "" UBYTE DFC_OneToOne 1 100 0.00 255.0 FORMAT "%5.1" ECU_ADDRESS 0x60034CA1 /end MEASUREMENT
/begin MEASUREMENT DFC_st.DFC_rba_MRly_Diag_Stk_Event "" UBYTE DFC_OneToOne 1 100 0.00 255.0 FORMAT "%5.1" ECU_ADDRESS 0x60034CA8 /end MEASUREMENT
/begin FUNCTION rba_BypEtk "McFunction rba_BypEtk Created by MCFunctionUpdater"
 /begin DEF_CHARACTERISTIC rba_BypEtk_Fan1_rDesVal_bypass_CST.Channel_u16 rba_BypEtk_Fan1_rDesVal_bypass_CST.Vector_u16 rba_BypEtk_Fan1_rPs_bypass_CST.Channel_u16 rba_BypEtk_Fan1_rPs_bypass_CST.Vector_u16 rba_BypEtk_IntlckChrgPlg_rPs_bypass_CST.Channel_u16 rba_BypEtk_IntlckChrgPlg_rPs_bypass_CST.Vector_u16 rba_BypEtk_SCtPmp1_rDesVal_bypass_CST.Channel_u16 rba_BypEtk_SCtPmp1_rDesVal_bypass_CST.Vector_u16 rba_BypEtk_SCtPmp1_rPs_bypass_CST.Channel_u16 rba_BypEtk_SCtPmp1_rPs_bypass_CST.Vector_u16 rba_BypEtk_SCtPmpRly_rDesVal_bypass_CST.Channel_u16 rba_BypEtk_SCtPmpRly_rDesVal_bypass_CST.Vector_u16 rba_BypEtk_SCtPmpRly_rPs_bypass_CST.Channel_u16 rba_BypEtk_SCtPmpRly_rPs_bypass_CST.Vector_u16 rba_BypEtk_SpplCooltPmpRly_rDesVal_bypass_CST.Channel_u16 rba_BypEtk_SpplCooltPmpRly_rDesVal_bypass_CST.Vector_u16 rba_BypEtk_SpplCooltPmpRly_rPs_bypass_CST.Channel_u16 rba_BypEtk_SpplCooltPmpRly_rPs_bypass_CST.Vector_u16 /end DEF_CHARACTERISTIC
/end FUNCTION
/begin FUNCTION rba_CalWup "1.45.1  McFunction rba_CalWup Created by MCFunctionUpdater" /begin DEF_CHARACTERISTIC rba_CalWup_Finish_C rba_CalWup_WakeupEnable_C /end DEF_CHARACTERISTIC FUNCTION_VERSION "1.45.1" /end FUNCTION
/begin FUNCTION rba_MRly "1.34.0    Main Relay"
 /begin DEF_CHARACTERISTIC rba_MRly_Diag_Stk_tiOkError_C DFC_CtlMsk2.DFC_rba_MRly_Diag_Stk_Event_C DFC_DisblMsk2.DFC_rba_MRly_Diag_Stk_Event_C /end DEF_CHARACTERISTIC
 /begin OUT_MEASUREMENT DFC_st.DFC_rba_MRly_Diag_Stk_Event /end OUT_MEASUREMENT
 /begin LOC_MEASUREMENT rba_MRly_Ctrl_State_MP /end LOC_MEASUREMENT
 FUNCTION_VERSION "1.34.0" /end FUNCTION
/begin FUNCTION rba_OsMeasmt "1.15.0    Os Runtime Measurement"
 /begin DEF_CHARACTERISTIC rba_MultiStackTrace_ResetMaxValues rba_MultiStackTrace_ThresholdSwitch rba_OsMeasmt_CoreLoadThresholdValue_C rba_OsMeasmt_ResetMaxCoreLoadValues_C rba_OsMeasmt_ResetResponseTimeValues_C rba_OsMeasmt_SwTrace_InitMode_C DFC_CtlMsk2.DFC_rba_MultiStackTrace_Threshold_C DFC_DisblMsk2.DFC_rba_MultiStackTrace_Threshold_C /end DEF_CHARACTERISTIC
 /begin OUT_MEASUREMENT DDRC_ctArDebLvl.DFC_rba_MultiStackTrace_Threshold DDRC_stLstRprtEve.DFC_rba_MultiStackTrace_Threshold DFC_st.DFC_rba_MultiStackTrace_Threshold /end OUT_MEASUREMENT
 /begin LOC_MEASUREMENT rba_MultiStackTrace_CurrentCycleMaxUsage_CSA0 rba_MultiStackTrace_CurrentCycleMaxUsage_CSA1 rba_MultiStackTrace_CurrentCycleMaxUsage_CSA2 rba_MultiStackTrace_CurrentCycleMaxUsage_User0 rba_MultiStackTrace_CurrentCycleMaxUsage_User1 rba_MultiStackTrace_CurrentCycleMaxUsage_User2 rba_MultiStackTrace_LifeTimeMaxUsage_CSA0 rba_MultiStackTrace_LifeTimeMaxUsage_CSA1 rba_MultiStackTrace_LifeTimeMaxUsage_CSA2 rba_MultiStackTrace_LifeTimeMaxUsage_User0 rba_MultiStackTrace_LifeTimeMaxUsage_User1 rba_MultiStackTrace_LifeTimeMaxUsage_User2 rba_MultiStackTrace_ThresholdTable rba_OsMeasmt_CoreLoad[0].curCycleMax rba_OsMeasmt_CoreLoad[0].current rba_OsMeasmt_CoreLoad[0].lifeTimeMax rba_OsMeasmt_CoreLoad[1].curCycleMax rba_OsMeasmt_CoreLoad[1].current rba_OsMeasmt_CoreLoad[1].lifeTimeMax rba_OsMeasmt_CoreLoad[2].curCycleMax rba_OsMeasmt_CoreLoad[2].current rba_OsMeasmt_CoreLoad[2].lifeTimeMax rba_OsMeasmt_OS_1000ms_Task.CETCurrent rba_OsMeasmt_OS_1000ms_Task.CETCurrentLoad rba_OsMeasmt_OS_1000ms_Task.CETCurrentLoadMax rba_OsMeasmt_OS_1000ms_Task.CETCycleMax rba_OsMeasmt_OS_1000ms_Task.RespTimeCurrent rba_OsMeasmt_OS_1000ms_Task.RespTimeCycleMax rba_OsMeasmt_OS_1000ms_Task.RespTimeLifetimeMax rba_OsMeasmt_OS_100ms_Task.CETCurrent rba_OsMeasmt_OS_100ms_Task.CETCurrentLoad rba_OsMeasmt_OS_100ms_Task.CETCurrentLoadMax rba_OsMeasmt_OS_100ms_Task.CETCycleMax rba_OsMeasmt_OS_100ms_Task.RespTimeCurrent rba_OsMeasmt_OS_100ms_Task.RespTimeCycleMax rba_OsMeasmt_OS_100ms_Task.RespTimeLifetimeMax rba_OsMeasmt_OS_10ms_Task.CETCurrent rba_OsMeasmt_OS_10ms_Task.CETCurrentLoad rba_OsMeasmt_OS_10ms_Task.CETCurrentLoadMax rba_OsMeasmt_OS_10ms_Task.CETCycleMax rba_OsMeasmt_OS_10ms_Task.RespTimeCurrent rba_OsMeasmt_OS_10ms_Task.RespTimeCycleMax rba_OsMeasmt_OS_10ms_Task.RespTimeLifetimeMax rba_OsMeasmt_OS_1ms_Task.CETCurrent rba_OsMeasmt_OS_1ms_Task.CETCurrentLoad rba_OsMeasmt_OS_1ms_Task.CETCurrentLoadMax rba_OsMeasmt_OS_1ms_Task.CETCycleMax rba_OsMeasmt_OS_1ms_Task.RespTimeCurrent rba_OsMeasmt_OS_1ms_Task.RespTimeCycleMax rba_OsMeasmt_OS_1ms_Task.RespTimeLifetimeMax rba_OsMeasmt_OS_200ms_Task.CETCurrent rba_OsMeasmt_OS_200ms_Task.CETCurrentLoad rba_OsMeasmt_OS_200ms_Task.CETCurrentLoadMax rba_OsMeasmt_OS_200ms_Task.CETCycleMax rba_OsMeasmt_OS_200ms_Task.RespTimeCurrent rba_OsMeasmt_OS_200ms_Task.RespTimeCycleMax rba_OsMeasmt_OS_200ms_Task.RespTimeLifetimeMax rba_OsMeasmt_OS_20ms_Task.CETCurrent rba_OsMeasmt_OS_20ms_Task.CETCurrentLoad rba_OsMeasmt_OS_20ms_Task.CETCurrentLoadMax rba_OsMeasmt_OS_20ms_Task.CETCycleMax rba_OsMeasmt_OS_20ms_Task.RespTimeCurrent rba_OsMeasmt_OS_20ms_Task.RespTimeCycleMax rba_OsMeasmt_OS_20ms_Task.RespTimeLifetimeMax rba_OsMeasmt_OS_2ms_Task.CETCurrent rba_OsMeasmt_OS_2ms_Task.CETCurrentLoad rba_OsMeasmt_OS_2ms_Task.CETCurrentLoadMax rba_OsMeasmt_OS_2ms_Task.CETCycleMax rba_OsMeasmt_OS_2ms_Task.RespTimeCurrent rba_OsMeasmt_OS_2ms_Task.RespTimeCycleMax rba_OsMeasmt_OS_2ms_Task.RespTimeLifetimeMax rba_OsMeasmt_OS_50ms_Task.CETCurrent rba_OsMeasmt_OS_50ms_Task.CETCurrentLoad rba_OsMeasmt_OS_50ms_Task.CETCurrentLoadMax rba_OsMeasmt_OS_50ms_Task.CETCycleMax rba_OsMeasmt_OS_50ms_Task.RespTimeCurrent rba_OsMeasmt_OS_50ms_Task.RespTimeCycleMax rba_OsMeasmt_OS_50ms_Task.RespTimeLifetimeMax rba_OsMeasmt_OS_5ms_Task.CETCurrent rba_OsMeasmt_OS_5ms_Task.CETCurrentLoad rba_OsMeasmt_OS_5ms_Task.CETCurrentLoadMax rba_OsMeasmt_OS_5ms_Task.CETCycleMax rba_OsMeasmt_OS_5ms_Task.RespTimeCurrent rba_OsMeasmt_OS_5ms_Task.RespTimeCycleMax rba_OsMeasmt_OS_5ms_Task.RespTimeLifetimeMax rba_OsMeasmt_T1_CoreLoad[0].curCycleMax rba_OsMeasmt_T1_CoreLoad[0].current rba_OsMeasmt_T1_CoreLoad[1].curCycleMax rba_OsMeasmt_T1_CoreLoad[1].current rba_OsMeasmt_T1_CoreLoad[2].curCycleMax rba_OsMeasmt_T1_CoreLoad[2].current /end LOC_MEASUREMENT
 FUNCTION_VERSION "1.15.0" /end FUNCTION
/begin FUNCTION rba_Reset "1.43.0  McFunction rba_Reset Created by MCFunctionUpdater"
 /begin DEF_CHARACTERISTIC rba_Reset_rstExtHistBuf_C rba_Reset_rstHistBuf_C rba_Reset_xGrpId_C rba_Reset_xTrgId_C /end DEF_CHARACTERISTIC
 /begin LOC_MEASUREMENT rba_Reset_ApplEnv_st.CntrRst_u8 rba_Reset_ApplEnv_st.Grp_en rba_Reset_ApplEnv_st.Id_en rba_Reset_ApplEnv_st.Loc_u32 rba_Reset_ApplEnv_st.UserValue_u32 rba_Reset_ExtHistBuf_ast[0].Addr_u32 rba_Reset_ExtHistBuf_ast[0].Cntr_u16 rba_Reset_ExtHistBuf_ast[0].ResetId_en rba_Reset_ExtHistBuf_ast[0].SwId_u32_1 rba_Reset_ExtHistBuf_ast[0].SwId_u32_2 rba_Reset_ExtHistBuf_ast[1].Addr_u32 rba_Reset_ExtHistBuf_ast[1].Cntr_u16 rba_Reset_ExtHistBuf_ast[1].ResetId_en rba_Reset_ExtHistBuf_ast[1].SwId_u32_1 rba_Reset_ExtHistBuf_ast[1].SwId_u32_2 rba_Reset_ExtHistBuf_ast[2].Addr_u32 rba_Reset_ExtHistBuf_ast[2].Cntr_u16 rba_Reset_ExtHistBuf_ast[2].ResetId_en rba_Reset_ExtHistBuf_ast[2].SwId_u32_1 rba_Reset_ExtHistBuf_ast[2].SwId_u32_2 rba_Reset_ExtHistBuf_ast[3].Addr_u32 rba_Reset_ExtHistBuf_ast[3].Cntr_u16 rba_Reset_ExtHistBuf_ast[3].ResetId_en rba_Reset_ExtHistBuf_ast[3].SwId_u32_1 rba_Reset_ExtHistBuf_ast[3].SwId_u32_2 rba_Reset_ExtHistBuf_ast[4].Addr_u32 rba_Reset_ExtHistBuf_ast[4].Cntr_u16 rba_Reset_ExtHistBuf_ast[4].ResetId_en rba_Reset_ExtHistBuf_ast[4].SwId_u32_1 rba_Reset_ExtHistBuf_ast[4].SwId_u32_2 rba_Reset_ExtHistBuf_ast[5].Addr_u32 rba_Reset_ExtHistBuf_ast[5].Cntr_u16 rba_Reset_ExtHistBuf_ast[5].ResetId_en rba_Reset_ExtHistBuf_ast[5].SwId_u32_1 rba_Reset_ExtHistBuf_ast[5].SwId_u32_2 rba_Reset_ExtHistBuf_ast[6].Addr_u32 rba_Reset_ExtHistBuf_ast[6].Cntr_u16 rba_Reset_ExtHistBuf_ast[6].ResetId_en rba_Reset_ExtHistBuf_ast[6].SwId_u32_1 rba_Reset_ExtHistBuf_ast[6].SwId_u32_2 rba_Reset_ExtHistBuf_ast[7].Addr_u32 rba_Reset_ExtHistBuf_ast[7].Cntr_u16 rba_Reset_ExtHistBuf_ast[7].ResetId_en rba_Reset_ExtHistBuf_ast[7].SwId_u32_1 rba_Reset_ExtHistBuf_ast[7].SwId_u32_2 rba_Reset_ExtHistBuf_ast[8].Addr_u32 rba_Reset_ExtHistBuf_ast[8].Cntr_u16 rba_Reset_ExtHistBuf_ast[8].ResetId_en rba_Reset_ExtHistBuf_ast[8].SwId_u32_1 rba_Reset_ExtHistBuf_ast[8].SwId_u32_2 rba_Reset_ExtHistBuf_ast[9].Addr_u32 rba_Reset_ExtHistBuf_ast[9].Cntr_u16 rba_Reset_ExtHistBuf_ast[9].ResetId_en rba_Reset_ExtHistBuf_ast[9].SwId_u32_1 rba_Reset_ExtHistBuf_ast[9].SwId_u32_2 rba_Reset_HistBuf_a /end LOC_MEASUREMENT
 FUNCTION_VERSION "1.43.0" /end FUNCTION
/begin FUNCTION rba_SvbbEtk "1.45.0  McFunction rba_SvbbEtk Created by MCFunctionUpdater"
 /begin DEF_CHARACTERISTIC rba_SvbbEtk_Enable_C rba_SvbbEtk_MaxLostRaster_C rba_SvbbEtk_WaitForBypconfigInIni_C /end DEF_CHARACTERISTIC
 /begin LOC_MEASUREMENT rba_SvbbEtk_ControlVar[0].Control_u8 rba_SvbbEtk_ControlVar[0].ErrCntPost_u8 rba_SvbbEtk_ControlVar[0].ErrCntPre_u8 rba_SvbbEtk_ControlVar[0].FailedTriggerCounter_u8 rba_SvbbEtk_ControlVar[10].Control_u8 rba_SvbbEtk_ControlVar[10].ErrCntPost_u8 rba_SvbbEtk_ControlVar[10].ErrCntPre_u8 rba_SvbbEtk_ControlVar[10].FailedTriggerCounter_u8 rba_SvbbEtk_ControlVar[11].Control_u8 rba_SvbbEtk_ControlVar[11].ErrCntPost_u8 rba_SvbbEtk_ControlVar[11].ErrCntPre_u8 rba_SvbbEtk_ControlVar[11].FailedTriggerCounter_u8 rba_SvbbEtk_ControlVar[12].Control_u8 rba_SvbbEtk_ControlVar[12].ErrCntPost_u8 rba_SvbbEtk_ControlVar[12].ErrCntPre_u8 rba_SvbbEtk_ControlVar[12].FailedTriggerCounter_u8 rba_SvbbEtk_ControlVar[13].Control_u8 rba_SvbbEtk_ControlVar[13].ErrCntPost_u8 rba_SvbbEtk_ControlVar[13].ErrCntPre_u8 rba_SvbbEtk_ControlVar[13].FailedTriggerCounter_u8 rba_SvbbEtk_ControlVar[1].Control_u8 rba_SvbbEtk_ControlVar[1].ErrCntPost_u8 rba_SvbbEtk_ControlVar[1].ErrCntPre_u8 rba_SvbbEtk_ControlVar[1].FailedTriggerCounter_u8 rba_SvbbEtk_ControlVar[2].Control_u8 rba_SvbbEtk_ControlVar[2].ErrCntPost_u8 rba_SvbbEtk_ControlVar[2].ErrCntPre_u8 rba_SvbbEtk_ControlVar[2].FailedTriggerCounter_u8 rba_SvbbEtk_ControlVar[3].Control_u8 rba_SvbbEtk_ControlVar[3].ErrCntPost_u8 rba_SvbbEtk_ControlVar[3].ErrCntPre_u8 rba_SvbbEtk_ControlVar[3].FailedTriggerCounter_u8 rba_SvbbEtk_ControlVar[4].Control_u8 rba_SvbbEtk_ControlVar[4].ErrCntPost_u8 rba_SvbbEtk_ControlVar[4].ErrCntPre_u8 rba_SvbbEtk_ControlVar[4].FailedTriggerCounter_u8 rba_SvbbEtk_ControlVar[5].Control_u8 rba_SvbbEtk_ControlVar[5].ErrCntPost_u8 rba_SvbbEtk_ControlVar[5].ErrCntPre_u8 rba_SvbbEtk_ControlVar[5].FailedTriggerCounter_u8 rba_SvbbEtk_ControlVar[6].Control_u8 rba_SvbbEtk_ControlVar[6].ErrCntPost_u8 rba_SvbbEtk_ControlVar[6].ErrCntPre_u8 rba_SvbbEtk_ControlVar[6].FailedTriggerCounter_u8 rba_SvbbEtk_ControlVar[7].Control_u8 rba_SvbbEtk_ControlVar[7].ErrCntPost_u8 rba_SvbbEtk_ControlVar[7].ErrCntPre_u8 rba_SvbbEtk_ControlVar[7].FailedTriggerCounter_u8 rba_SvbbEtk_ControlVar[8].Control_u8 rba_SvbbEtk_ControlVar[8].ErrCntPost_u8 rba_SvbbEtk_ControlVar[8].ErrCntPre_u8 rba_SvbbEtk_ControlVar[8].FailedTriggerCounter_u8 rba_SvbbEtk_ControlVar[9].Control_u8 rba_SvbbEtk_ControlVar[9].ErrCntPost_u8 rba_SvbbEtk_ControlVar[9].ErrCntPre_u8 rba_SvbbEtk_ControlVar[9].FailedTriggerCounter_u8 rba_SvbbEtk_DelayedEcuInitialisation rba_SvbbEtk_DummyVar rba_SvbbEtk_stEnable /end LOC_MEASUREMENT
 FUNCTION_VERSION "1.45.0" /end FUNCTION
/begin FUNCTION rba_SyC_CustStates "2.2.0  McFunction rba_SyC_CustStates Created by MCFunctionUpdater"
 /begin DEF_CHARACTERISTIC rba_SyC_CustStates_VehvRcd_Thrshld_C rba_SyC_Custstates_Degrad2Nominaltimeout_C rba_SyC_Custstates_Degrad2Transtimeout_C rba_SyC_Custstates_Degraded_disord_C rba_SyC_Custstates_Degraded_incst_C rba_SyC_Custstates_InternalPartialCalMax_C rba_SyC_Custstates_Mintimeout_C rba_SyC_Custstates_Nominal2Transtimeout_C rba_SyC_Custstates_Partial2Nominaltimeout_C rba_SyC_Custstates_PartialMainWkuInvldTimeout_C rba_SyC_Custstates_Trans2NominalTimeout_C rba_SyC_Custstates_TransMainWkuInvldTimeout_C rba_SyC_Custstates_trans_SetDFC_C /end DEF_CHARACTERISTIC
 /begin LOC_MEASUREMENT rba_SyC_CustStates_CurrentState_MP /end LOC_MEASUREMENT
 FUNCTION_VERSION "2.2.0" /end FUNCTION
/begin FUNCTION rba_T15 "2.34.0  McFunction rba_T15 Created by MCFunctionUpdater" /begin DEF_CHARACTERISTIC rba_T15_Signal_tiDebHiLo_C rba_T15_Signal_tiDebLoHi_C /end DEF_CHARACTERISTIC
 /begin LOC_MEASUREMENT rba_T15_Signal_Debounced_MP rba_T15_Signal_Logical_MP rba_T15_Signal_UndebouncedValid_MP rba_T15_Signal_Undebounced_MP /end LOC_MEASUREMENT
 FUNCTION_VERSION "2.34.0" /end FUNCTION
/*********** Start of merged COMPU_METHOD blocks ***********/
/begin COMPU_METHOD RB_RBA_Common_CentralElements_CompuMethods_Identical "The internal value and the physical one are identical. No physical unit available" RAT_FUNC "%10.5" "noUnit" COEFFS 0.0 1.0 0.0 0.0 0.0 1.0 REF_UNIT RB_RBA_Common_CentralElements_Units_NoUnit /end COMPU_METHOD
/begin COMPU_METHOD RB_RBA_rba_MRly_BswModuleDescriptions_rba_MRly_Ctrl_States_CompuMethod "CompuMethod for control states of Main Relay" TAB_VERB "%10.5" "nounit" COMPU_TAB_REF RB_RBA_rba_MRly_BswModuleDescriptions_rba_MRly_Ctrl_States_CompuMethod REF_UNIT RB_RBA_rba_MRly_Units_NoUnit /end COMPU_METHOD
/begin COMPU_METHOD RB_RBA_rba_MRly_BswModuleDescriptions_rba_MRly_Calibration_Common_milliseconds_CompuMethod "CompuMethod for calibration in milliseconds of Main Relay" RAT_FUNC "%10.5" "ms" COEFFS 0.0 -1.0 0.0 0.0 0.0 -1.0 REF_UNIT RB_RBA_rba_MRly_Units_ms /end COMPU_METHOD
/begin COMPU_METHOD RB_RBA_rba_OsMeasmt_CompuMethods_rba_OsMeasmt_PercConversion "Os measurement conversion factor for percent" RAT_FUNC "%10.5" "%" COEFFS 0.0 -1.0 0.0 0.0 0.0 -0.01 REF_UNIT RB_RBA_rba_OsMeasmt_Units_Perc /end COMPU_METHOD
/begin COMPU_METHOD RB_RBA_rba_OsMeasmt_CompuMethods_rba_OsMeasmt_TaskRespTime_CompuMethod "Task response time computation method" RAT_FUNC "%10.5" "us" COEFFS 0.0 -1.0 0.0 0.0 0.0 -0.01 REF_UNIT RB_RBA_rba_OsMeasmt_Units_MicroSec /end COMPU_METHOD
/begin COMPU_METHOD RB_RBA_rba_OsMeasmt_CompuMethods_rba_OsMeasmt_CET_T1_CompuMethod "Task CET computation method for T1" RAT_FUNC "%10.5" "us" COEFFS 0.0 -1.0 0.0 0.0 0.0 -0.16 REF_UNIT RB_RBA_rba_OsShell_Units_MicroSec /end COMPU_METHOD
/begin COMPU_METHOD RB_RBA_rba_OsMeasmt_CompuMethods_rba_OsMeasmt_T1_PercConversion "Os measurement conversion factor for T1 percent" RAT_FUNC "%10.5" "%" COEFFS 0.0 -1.0 0.0 0.0 0.0 -1.0 REF_UNIT RB_RBA_rba_OsMeasmt_Units_Perc /end COMPU_METHOD
/begin COMPU_METHOD RB_RBA_rba_OsMeasmt_CompuMethods_rba_OsMeasmt_SwTrace_InitMode_CompuMethod "Enum for different Gliwa Init Modes" TAB_VERB "%10.5" "noUnit" COMPU_TAB_REF RB_RBA_rba_OsMeasmt_CompuMethods_rba_OsMeasmt_SwTrace_InitMode_CompuMethod REF_UNIT RB_RBA_rba_OsMeasmt_Units_NoUnit /end COMPU_METHOD
/begin COMPU_METHOD RB_RBA_rba_Reset_CompuMethods_rba_Reset_Id_ten "CompuMethod for the Reset Ids" TAB_VERB "%10.5" "noUnit" COMPU_TAB_REF RB_RBA_rba_Reset_CompuMethods_rba_Reset_Id_ten REF_UNIT RB_RBA_rba_Reset_Units_NoUnit /end COMPU_METHOD
/begin COMPU_METHOD RB_RBA_rba_SvbbEtk_CompuMethods_rba_SvbbEtk_StateEnable_CM "CompuMethod for SvbbEtk state" TAB_VERB "%10.5" "noUnit" COMPU_TAB_REF RB_RBA_rba_SvbbEtk_CompuMethods_rba_SvbbEtk_StateEnable_CM REF_UNIT RB_RBA_rba_SvbbEtk_Units_NoUnit /end COMPU_METHOD
/begin COMPU_METHOD RB_RBA_rba_SvbbEtk_CompuMethods_rba_SvbbEtk_Enable_CM "CompuMethod for SvbbEtk state" TAB_VERB "%10.5" "noUnit" COMPU_TAB_REF RB_RBA_rba_SvbbEtk_CompuMethods_rba_SvbbEtk_Enable_CM REF_UNIT RB_RBA_rba_SvbbEtk_Units_NoUnit /end COMPU_METHOD
/begin COMPU_METHOD RB_RBA_rba_SyC_CustStates_BswModuleDescriptions_rba_SyC_CustStates_States_CompuMethod "CompuMethod for Customer States" TAB_VERB "%10.5" "nounit" COMPU_TAB_REF RB_RBA_rba_SyC_CustStates_BswModuleDescriptions_rba_SyC_CustStates_States_CompuMethod REF_UNIT RB_RBA_rba_SyC_CustStates_Units_NoUnit /end COMPU_METHOD
/begin COMPU_METHOD RB_RBA_rba_SyC_CustStates_BswModuleDescriptions_rba_SyC_CustStates_Calibration_Velocity_kmph_CompuMethod "CompuMethod for calibration in kmph of rba_SyC_CustStates" RAT_FUNC "%10.5" "km/h" COEFFS 0.0 -100.0 0.0 0.0 0.0 -1.0 REF_UNIT RB_RBA_rba_SyC_CustStates_Units_kmph /end COMPU_METHOD
/begin COMPU_METHOD RB_RBA_rba_SyC_CustStates_BswModuleDescriptions_rba_SyC_CustStates_Calibration_Time_Common_milliseconds_CompuMethod "CompuMethod for calibration in milliseconds of rba_SyC_CustStates" RAT_FUNC "%10.5" "ms" COEFFS 0.0 -1.0 0.0 0.0 0.0 -1.0 REF_UNIT RB_RBA_rba_SyC_CustStates_Units_ms /end COMPU_METHOD
/begin COMPU_METHOD RB_RBA_rba_SyC_CustStates_BswModuleDescriptions_rba_SyC_CustStates_Calibration_Time_Common_seconds_CompuMethod "CompuMethod for calibration in seconds of rba_SyC_CustStates" RAT_FUNC "%10.5" "s" COEFFS 0.0 -1.0 0.0 0.0 0.0 -1.0 REF_UNIT RB_RBA_rba_SyC_CustStates_Units_s /end COMPU_METHOD
/begin COMPU_METHOD RB_RBA_rba_T15_BswModuleDescriptions_rba_T15_Signal_Status_CompuMethod "CompuMethod for signal status of Terminal 15" TAB_VERB "%10.5" "nounit" COMPU_TAB_REF RB_RBA_rba_T15_BswModuleDescriptions_rba_T15_Signal_Status_CompuMethod REF_UNIT RB_RBA_rba_T15_Units_NoUnit /end COMPU_METHOD
/begin COMPU_METHOD RB_RBA_rba_T15_BswModuleDescriptions_rba_T15_Signal_StatusValid_CompuMethod "CompuMethod for signal status validity of Terminal 15" TAB_VERB "%10.5" "nounit" COMPU_TAB_REF RB_RBA_rba_T15_BswModuleDescriptions_rba_T15_Signal_StatusValid_CompuMethod REF_UNIT RB_RBA_rba_T15_Units_NoUnit /end COMPU_METHOD
/begin COMPU_METHOD RB_RBA_rba_T15_BswModuleDescriptions_rba_T15_Signal_Calibration_CompuMethod "CompuMethod for signal calibration of Terminal 15" RAT_FUNC "%10.5" "ms" COEFFS 0.0 -1.0 0.0 0.0 0.0 -10.0 REF_UNIT RB_RBA_rba_T15_Units_ms /end COMPU_METHOD
/begin COMPU_METHOD AccHi "" RAT_FUNC "%7.6" "m/s^2" COEFFS 0 10000 0 0 0 1 /end COMPU_METHOD
/begin COMPU_METHOD ACCHRGNPWRSTGCTRL_TYPAVL_SC_Compu "" TAB_VERB "%6.3" "" COMPU_TAB_REF ACCHRGNPWRSTGCTRL_TYPAVL_SC_Compu /end COMPU_METHOD
/begin COMPU_VTAB RB_RBA_rba_MRly_BswModuleDescriptions_rba_MRly_Ctrl_States_CompuMethod "CompuMethod for control states of Main Relay" TAB_VERB 2 0 "rba_MRly_Ctrl_Open_e" 1 "rba_MRly_Ctrl_Close_e" /end COMPU_VTAB
/begin COMPU_VTAB RB_RBA_rba_OsMeasmt_CompuMethods_rba_OsMeasmt_SwTrace_InitMode_CompuMethod "Enum for different Gliwa Init Modes" TAB_VERB 3 0 "GLIWA_T1_PRODUCTIVE" 1 "GLIWA_T1_DEVELOPMENT" 2 "GLIWA_T1_OFF" /end COMPU_VTAB
/begin COMPU_VTAB RB_RBA_rba_Reset_CompuMethods_rba_Reset_Id_ten "CompuMethod for the Reset Ids" TAB_VERB 1438 0 "RBA_RESET_POWERON_E" 1 "RBA_RESET_POWERON_WARM_E" 2 "RBA_RESET_POWERON_WDT_E" 3 "RBA_RESET_POWERON_KL15_E" 4 "RBA_RESET_ESR0_E" 5 "RBA_RESET_ESR1_E" 6 "RBA_RESET_WDT_E" 7 "RBA_RESET_SMU_E" 8 "RBA_RESET_STM012_E" 9 "RBA_RESET_OCDS_E" 10 "RBA_RESET_CB013_E" 11 "RBA_RESET_SWD_E" 12 "RBA_RESET_HSM_E" 13 "RBA_RESET_TP_E" 14 "RBA_RESET_CANWAK_E" 15 "RBA_RESET_PIN1WAK_E" 16 "RBA_RESET_PIN2WAK_E" 17 "RBA_RESET_PIN3WAK_E" 18 "RBA_RESET_STCWAK_E" 19 "RBA_RESET_HW_E" 4096 "RBA_RESET_POWERON_SIMU_E" 4097 "RBA_RESET_HWRESET_SIMU_E" 4098 "RBA_RESET_RB_PROG_E" 4099 "RBA_RESET_CBPROG_E" 4100 "RBA_RESET_CBCPU_E" 4101 "RBA_RESET_RB_PROG_ILLEGAL_PATH_E" 4102 "RBA_RESET_TSW_EXIT_E" 4103 "RBA_RESET_TSW_MAGICPATTERN_E" 4104 "RBA_RESET_TRAP_IN_SB_E" 4105 "RBA_RESET_SWDESTRST_RAMVALID_E" 4106 "RBA_RESET_SWDESTRST_RAMINVALID_E" 4107 "RBA_RESET_SWDESTRST_REQ_RAMVALID_E" 4108 "RBA_RESET_OBD_SVC11_RESET_E" 4109 "RBA_RESET_PLL_LOSS_OF_LOCK_E" 4110 "RBA_RESET_BCTL_FCCU_ERRABORT_E" 4111 "RBA_RESET_RBA_BOOTCTRL_SB_OVERLAYRAM_INIT_FAILURE" 4112 "RBA_RESET_COMMON_DESTRUCTIVE_E" 4113 "RBA_RESET_DUMMY06_E" 4114 "RBA_RESET_DUMMY07_E" 4115 "RBA_RESET_DUMMY08_E" 4116 "RBA_RESET_POWERON_SIMU_SOFTRST_E" 4117 "RBA_RESET_CBPROG_SOFTRST_E" 12288 "ECUM_E_RESET_CONFIGURATION_DATA_INCONSISTENT" 12289 "ECUM_E_RESET_GENERAL" 12290 "ECUM_E_RESET_INVALID_PTR_RETURNED" 12291 "ECUM_E_RESET_NULL_PTR_RETURNED" 12292 "ECUM_E_RESET_RAM_CHECK_FAILED" 12293 "ECUM_E_RESET_START_CORE_FAILED" 12294 "ECUM_RESET" 12295 "MCU_RB_RESET_BUSERR_SBCU" 12296 "MCU_RB_RESET_DTS_ERROR" 12297 "MCU_RB_RESET_UNKNOWN" 12298 "MCU_RB_RESET_XBAR_DOM0_PROT_ID_SCI01_DMU" 12299 "MCU_RB_RESET_XBAR_DOM0_PROT_ID_SCI02_DAM0" 12300 "MCU_RB_RESET_XBAR_DOM0_PROT_ID_SCI03_CPU0P" 12301 "MCU_RB_RESET_XBAR_DOM0_PROT_ID_SCI04_CPU0S" 12302 "MCU_RB_RESET_XBAR_DOM0_PROT_ID_SCI05_CPU1P" 12303 "MCU_RB_RESET_XBAR_DOM0_PROT_ID_SCI06_CPU1S" 12304 "MCU_RB_RESET_XBAR_DOM0_PROT_ID_SCI08_CPU2S" 12305 "MCU_RB_RESET_XBAR_DOM0_PROT_ID_SCI14_MINI_MCDS" 12306 "MCU_RB_RESET_XBAR_DOM0_PROT_ID_SCI15_DEFAULT_SLAVE" 12307 "MCU_RB_RESET_XBAR_DOM0_TRANS_ID_MCI00_DMA_MIF0" 12308 "MCU_RB_RESET_XBAR_DOM0_TRANS_ID_MCI01_SFI_F2S" 12309 "MCU_RB_RESET_XBAR_DOM0_TRANS_ID_MCI02_CPU0" 12310 "MCU_RB_RESET_XBAR_DOM0_TRANS_ID_MCI03_CPU1" 12311 "MCU_RB_RESET_XBAR_DOM0_TRANS_ID_MCI04_CPU2" 12312 "MCU_RB_RESET_XBAR_DOM0_TRANS_ID_MCI08_HSSL0" 12313 "MCU_RB_RESET_XBAR_DOM0_TRANS_ID_MCI09_GETH" 12314 "MCU_RB_RESET_XBAR_DOM0_TRANS_ID_SCI01_DMU" 12315 "MCU_RB_RESET_XBAR_DOM0_TRANS_ID_SCI02_DAM0" 12316 "MCU_RB_RESET_XBAR_DOM0_TRANS_ID_SCI03_CPU0P" 12317 "MCU_RB_RESET_XBAR_DOM0_TRANS_ID_SCI04_CPU0S" 12318 "MCU_RB_RESET_XBAR_DOM0_TRANS_ID_SCI05_CPU1P" 12319 "MCU_RB_RESET_XBAR_DOM0_TRANS_ID_SCI06_CPU1S" 12320 "MCU_RB_RESET_XBAR_DOM0_TRANS_ID_SCI08_CPU2S" 12321 "MCU_RB_RESET_XBAR_DOM0_TRANS_ID_SCI14_MINI_MCDS" 12322 "MCU_RB_RESET_XBAR_DOM0_TRANS_ID_SCI15_DEFAULT_SLAVE" 12323 "MCU_RESET_ILLEGAL_CALL_OF_MCU_PERFORM_RESET" 12324 "MCU_RESET_UNDEFINED" 12325 "RBA_ADCDS_RESET_UNEXPECTED_FUNCTION_CALL_TO_SETGAIN" 12326 "RBA_EMM_ERRORPIN_SWRESET_CFG_RESET" 12327 "RBA_EMM_EVR13OVCFG_ERROR_RESET" 12328 "RBA_EMM_EVR13UVCFG_ERROR_RESET" 12329 "RBA_EMM_EVR33OVCFG_ERROR_RESET" 12330 "RBA_EMM_EVR33UVCFG_ERROR_RESET" 12331 "RBA_EMM_EVR50OVCFG_ERROR_RESET" 12332 "RBA_EMM_EVR50UVCFG_ERROR_RESET" 12333 "RBA_EMM_INT_TEMP_MON_RESET" 12334 "RBA_EMM_INVALID_STAT_RESET" 12335 "RBA_EMM_UNEXPECTED_LOCK_RESET" 12336 "RBA_EMM_VDDMOVCFG_ERROR_RESET" 12337 "RBA_EMM_VDDMUVCFG_ERROR_RESET" 12338 "RBA_EMM_VDDPDOVCFG_ERROR_RESET" 12339 "RBA_EMM_VDDPDUVCFG_ERROR_RESET" 12340 "RBA_EMM_VEVRSBOVCFG_ERROR_RESET" 12341 "RBA_EMM_VEVRSBUVCFG_ERROR_RESET" 12342 "RBA_MPU_COREMPU_INVALID_ADDRESS_ALIGNMENT_RESET" 12343 "RBA_MPU_COREMPU_INVALID_NUMBER_CODE_REGIONS_RESET" 12344 "RBA_MPU_COREMPU_INVALID_NUMBER_DATA_REGIONS_RESET" 12345 "RBA_MPU_COREMPU_INVALID_NUMBER_REGIONS_RESET" 12346 "RBA_MPU_COREMPU_INVALID_REGION_RESET" 12347 "RBA_MPU_COREMPU_INVALID_SETUP_RESET" 12348 "RBA_MPU_COREMPU_REGION_START_END_ADDRESS_RESET" 12349 "RBA_MPU_COREMPU_UNEQUAL_NUMBER_REGIONS_RESET" 12350 "RBA_MPU_INVALID_ADDRESS_ALIGNMENT_RESET" 12351 "RBA_MPU_INVALID_NUMBER_REGIONS_RESET" 12352 "RBA_MPU_INVALID_NUMBER_SYSRAM_REGIONS_RESET" 12353 "RBA_MPU_INVALID_REGION_ADDRESS_RESET" 12354 "RBA_MPU_INVALID_SYSRAM_REGION_ADDRESS_RESET" 12355 "RBA_MPU_REGION_START_END_ADDRESS_RESET" 12356 "RBA_MPU_SYSRAM_CACHEABLE_REGION_ADDRESS_RESET" 12357 "RBA_MULTISTACKTRACE_UNDEROVERFLOW" 12358 "RBA_RESET_BSW_DEFAULT_E" 12359 "RBA_RESET_CANSOPTEST_FAILED" 12360 "RBA_RESET_FIRST_SWRESET" 12361 "RBA_RESET_FRSOPTEST_FAILED" 12362 "RBA_RESET_INFOBLK_FAULT" 12363 "RBA_RESET_INJSOPTEST_FAILED" 12364 "RBA_RESET_MOCADCNTP_PREICO" 12365 "RBA_RESET_MOCADCTEST_PREICO" 12366 "RBA_RESET_MOCADC_ILLEGAL_PATH" 12367 "RBA_RESET_MOCCOM_WRTEST_FAILED" 12368 "RBA_RESET_MOCEMM_CPLCHK_FAILED" 12369 "RBA_RESET_MOCEMM_INITORDER" 12370 "RBA_RESET_MOCEMM_PLAUSY_FAILED" 12371 "RBA_RESET_MOCEMM_STARTUPTEST_FAILED" 12372 "RBA_RESET_MOCEMM_WTCHK_FAILED" 12373 "RBA_RESET_MOCMEMSTRTUP_ECC_FAILED" 12374 "RBA_RESET_MOCMEMSTRTUP_ININORD" 12375 "RBA_RESET_MOCMEMSTRTUP_RAMCHK_FAILED" 12376 "RBA_RESET_MOCMEMSTRTUP_ROMCHK_FAILED" 12377 "RBA_RESET_MOCMEMSTRTUP_WTCHK_FAILED" 12378 "RBA_RESET_MOCSCC_FAILED" 12379 "RBA_RESET_MOCSOP_INHBBUS_ERROR" 12380 "RBA_RESET_MOCSOP_REPSOPTEST" 12381 "RBA_RESET_MOCSOP_WRGSTATE" 12382 "RBA_RESET_MOCSOP_WRTEST_FAILED" 12383 "RBA_RESET_RBA_BSWSRV_ADDRESS_RANGE_VIOLATION_E" 12384 "RBA_RESET_RBA_BSWSRV_INTSUSP_CORRUPTION" 12385 "RBA_RESET_RBA_BSWSRV_INTSUSP_CTR_VIOLATION_E" 12386 "RBA_RESET_RBA_BSWSRV_LOCK_CTR_VIOLATION_E" 12387 "RBA_RESET_RBA_BSWSRV_LOCK_NESTING_VIOLATION_E" 12388 "RBA_RESET_RBA_BYP_FINISH_E" 12389 "RBA_RESET_RBA_CALWUPFINISH_E" 12390 "RBA_RESET_RBA_MEMLAY_CB_RAM1_SIZE_E" 12391 "RBA_RESET_RBA_MEMLAY_CB_RAM2_SIZE_E" 12392 "RBA_RESET_RBA_MEMLAY_CB_SYS_SIZE_E" 12393 "RBA_RESET_RBA_MEMLAY_PCACHE_TIME_E" 12394 "RBA_RESET_RBA_SVBB_FINISH_E" 12395 "RBA_RESET_SOPTESTTIMEOUT_ERROR" 12396 "RBA_RESET_SOPTEST_FAILED" 12397 "RBA_RESET_SWRST_EEPACTFIRSTINIT_E" 12398 "RBA_RESET_SWRST_EEPDELENVRAM_E" 12399 "RBA_RESET_UDS_SWRESET" 12400 "RBA_SWTRACE_INIT" 12401 "RBA_SYC_RESET_T15" 12402 "RBA_SYC_SHUTDOWNSERVICES_RSTID_T15" 12403 "RESET_SWRESET_CPLCHK_FAILED" 12404 "RESET_SWRESET_ESC_SCHED_RESET_E" 12405 "RESET_SWRESET_ILLEGAL_SW_PATH" 12406 "RESET_SWRESET_MOCCOM_BUS_ERROR" 12407 "RESET_SWRESET_MOCCOM_CPLCHK_FAILED" 12408 "RESET_SWRESET_MOCCOM_OS_TIMEOUT_ERROR" 12409 "RESET_SWRESET_MOCGTM_CHKROM_FAILED" 12410 "RESET_SWRESET_MOCGTM_CLKMON_FAILED" 12411 "RESET_SWRESET_MOCGTM_FAILED" 12412 "RESET_SWRESET_MOCGTM_INI_COMPLEMENT_FAILED" 12413 "RESET_SWRESET_MOCGTM_INI_FAILED" 12414 "RESET_SWRESET_MOCMEM_CHKRAM_FAILED" 12415 "RESET_SWRESET_MOCMEM_CHKROM_FAILED" 12416 "RESET_SWRESET_MOCMEM_CPLCHK_FAILED" 12417 "RESET_SWRESET_MOCMEM_NUMBLKERR_FAILED" 12418 "RESET_SWRESET_MOCMEM_WTRAM_FAILED" 12419 "RESET_SWRESET_MOCMEM_WTROM_FAILED" 12420 "RESET_SWRESET_OCWDA_ABE_ACTV" 12421 "RESET_SWRESET_OCWDA_ERRPIN_ACTV" 12422 "RESET_SWRESET_OCWDA_OVR_VLTG" 12423 "RESET_SWRESET_OCWDA_WDA_MONITOR" 12424 "RESET_SWRESET_TAA_ILLEG_SWPATH" 12425 "SWRESET_MOFVARPOSTBLDSEL_PREICO" 12426 "SWRESET_POWERON_KL15_E" 12427 "SWRESET_UNEXPSYCSTSUB_E" 12428 "SWRST_ASDDCPARSEL_E" 12429 "SWRST_ASDRFPARSEL_E" 12430 "SWRST_ASDRFSTATEMACHINE_E" 12431 "SWRST_HLSDEMPARSELPREDEFTRQ_E" 12432 "SWRST_HLSDEMPARSELREVGEAR_E" 12433 "SWRST_HLSDEMPARSEL_E" 12434 "SWRST_IVADJQNT_E" 12435 "SWRST_MEUNSETCRNT_E" 12436 "SWRST_PCVSETCRNT_E" 12437 "SWRST_RAILCTLLOOP_E" 12438 "SWRST_RAILCTLTYPESWT_E" 12439 "SWRST_RAILMON_E" 12440 "SWRST_RAILPOFSTST_E" 16384 "RBA_SYC_POWERUNDERVOLTAGE_RSTID_UV_DETECTED" 16385 "RBA_SYC_RESET_RESTART" 16386 "RBA_SYC_RESET_WAKEUP" 16387 "RBA_SYC_SHUTDOWNSERVICES_RSTID_WAKEUP" 20480 "RBA_RESET_CPU0_TRAP_MMU_VAF_E" 20481 "RBA_RESET_CPU0_TRAP_MMU_VAP_E" 20482 "RBA_RESET_CPU0_TRAP_TCN0_UNKNOWN_E" 20483 "RBA_RESET_CPU0_TRAP_TCN1_TIN0_E" 20484 "RBA_RESET_CPU0_TRAP_INTPROT_PRIV_E" 20485 "RBA_RESET_CPU0_TRAP_INTPROT_MPR_E" 20486 "RBA_RESET_CPU0_TRAP_INTPROT_MPW_E" 20487 "RBA_RESET_CPU0_TRAP_INTPROT_MPX_E" 20488 "RBA_RESET_CPU0_TRAP_INTPROT_MPP_E" 20489 "RBA_RESET_CPU0_TRAP_INTPROT_MPN_E" 20490 "RBA_RESET_CPU0_TRAP_INTPROT_GRWP_E" 20491 "RBA_RESET_CPU0_TRAP_TCN1_UNKNOWN_E" 20492 "RBA_RESET_CPU0_TRAP_TCN2_TIN0_E" 20493 "RBA_RESET_CPU0_TRAP_INSTRERR_IOPC_E" 20494 "RBA_RESET_CPU0_TRAP_INSTRERR_UOPC_E" 20495 "RBA_RESET_CPU0_TRAP_INSTRERR_OPD_E" 20496 "RBA_RESET_CPU0_TRAP_INSTRERR_ALN_E" 20497 "RBA_RESET_CPU0_TRAP_INSTRERR_MEM_E" 20498 "RBA_RESET_CPU0_TRAP_TCN2_UNKNOWN_E" 20499 "RBA_RESET_CPU0_TRAP_TCN3_TIN0_E" 20500 "RBA_RESET_CPU0_TRAP_CONTMANA_FCD_E" 20501 "RBA_RESET_CPU0_TRAP_CONTMANA_CDO_E" 20502 "RBA_RESET_CPU0_TRAP_CONTMANA_CDU_E" 20503 "RBA_RESET_CPU0_TRAP_CONTMANA_FCU_E" 20504 "RBA_RESET_CPU0_TRAP_CONTMANA_CSU_E" 20505 "RBA_RESET_CPU0_TRAP_CONTMANA_CTYP_E" 20506 "RBA_RESET_CPU0_TRAP_CONTMANA_NEST_E" 20507 "RBA_RESET_CPU0_TRAP_TCN3_UNKNOWN_E" 20508 "RBA_RESET_CPU0_TRAP_TCN4_TIN0_E" 20509 "RBA_RESET_CPU0_TRAP_SYSBUSERR_PSE_E" 20510 "RBA_RESET_CPU0_TRAP_SYSBUSERR_DSE_E" 20511 "RBA_RESET_CPU0_TRAP_SYSBUSERR_DAE_E" 20512 "RBA_RESET_CPU0_TRAP_SYSBUSERR_CAE_E" 20513 "RBA_RESET_CPU0_TRAP_FPU_INEXACT_E" 20514 "RBA_RESET_CPU0_TRAP_FPU_UNRFLW_E" 20515 "RBA_RESET_CPU0_TRAP_FPU_DIVZRO_E" 20516 "RBA_RESET_CPU0_TRAP_FPU_OVRFLW_E" 20517 "RBA_RESET_CPU0_TRAP_FPU_INVOPR_E" 20518 "RBA_RESET_CPU0_TRAP_SYSBUSERR_PIE_UNKNOWN_E" 20519 "RBA_RESET_CPU0_TRAP_SYSBUSERR_PIE_IED_CPU0_DMI_NONESAFE_E" 20520 "RBA_RESET_CPU0_TRAP_SYSBUSERR_PIE_IE_T_CPU0_DMI_NONESAFE_E" 20521 "RBA_RESET_CPU0_TRAP_SYSBUSERR_PIE_IE_C_CPU0_DMI_NONESAFE_E" 20522 "RBA_RESET_CPU0_TRAP_SYSBUSERR_PIE_IE_S_CPU0_DMI_NONESAFE_E" 20523 "RBA_RESET_CPU0_TRAP_SYSBUSERR_PIE_IE_BI_CPU0_DMI_NONESAFE_E" 20524 "RBA_RESET_CPU0_TRAP_SYSBUSERR_PIE_IE_UNC_CPU0_DMI_NONESAFE_E" 20525 "RBA_RESET_CPU0_TRAP_SYSBUSERR_PIE_IE_SP_CPU0_DMI_NONESAFE_E" 20526 "RBA_RESET_CPU0_TRAP_SYSBUSERR_PIE_IE_BS_CPU0_DMI_NONESAFE_E" 20527 "RBA_RESET_CPU0_TRAP_SYSBUSERR_PIE_IED_CPU0_DMI_SAFE_E" 20528 "RBA_RESET_CPU0_TRAP_SYSBUSERR_PIE_IE_T_CPU0_DMI_SAFE_E" 20529 "RBA_RESET_CPU0_TRAP_SYSBUSERR_PIE_IE_C_CPU0_DMI_SAFE_E" 20530 "RBA_RESET_CPU0_TRAP_SYSBUSERR_PIE_IE_S_CPU0_DMI_SAFE_E" 20531 "RBA_RESET_CPU0_TRAP_SYSBUSERR_PIE_IE_BI_CPU0_DMI_SAFE_E" 20532 "RBA_RESET_CPU0_TRAP_SYSBUSERR_PIE_IE_UNC_CPU0_DMI_SAFE_E" 20533 "RBA_RESET_CPU0_TRAP_SYSBUSERR_PIE_IE_SP_CPU0_DMI_SAFE_E" 20534 "RBA_RESET_CPU0_TRAP_SYSBUSERR_PIE_IE_BS_CPU0_DMI_SAFE_E" 20535 "RBA_RESET_CPU0_TRAP_SYSBUSERR_PIE_IED_CPU1_DMI_NONESAFE_E" 20536 "RBA_RESET_CPU0_TRAP_SYSBUSERR_PIE_IE_T_CPU1_DMI_NONESAFE_E" 20537 "RBA_RESET_CPU0_TRAP_SYSBUSERR_PIE_IE_C_CPU1_DMI_NONESAFE_E" 20538 "RBA_RESET_CPU0_TRAP_SYSBUSERR_PIE_IE_S_CPU1_DMI_NONESAFE_E" 20539 "RBA_RESET_CPU0_TRAP_SYSBUSERR_PIE_IE_BI_CPU1_DMI_NONESAFE_E" 20540 "RBA_RESET_CPU0_TRAP_SYSBUSERR_PIE_IE_UNC_CPU1_DMI_NONESAFE_E" 20541 "RBA_RESET_CPU0_TRAP_SYSBUSERR_PIE_IE_SP_CPU1_DMI_NONESAFE_E" 20542 "RBA_RESET_CPU0_TRAP_SYSBUSERR_PIE_IE_BS_CPU1_DMI_NONESAFE_E" 20543 "RBA_RESET_CPU0_TRAP_SYSBUSERR_PIE_IED_CPU1_DMI_SAFE_E" 20544 "RBA_RESET_CPU0_TRAP_SYSBUSERR_PIE_IE_T_CPU1_DMI_SAFE_E" 20545 "RBA_RESET_CPU0_TRAP_SYSBUSERR_PIE_IE_C_CPU1_DMI_SAFE_E" 20546 "RBA_RESET_CPU0_TRAP_SYSBUSERR_PIE_IE_S_CPU1_DMI_SAFE_E" 20547 "RBA_RESET_CPU0_TRAP_SYSBUSERR_PIE_IE_BI_CPU1_DMI_SAFE_E" 20548 "RBA_RESET_CPU0_TRAP_SYSBUSERR_PIE_IE_UNC_CPU1_DMI_SAFE_E" 20549 "RBA_RESET_CPU0_TRAP_SYSBUSERR_PIE_IE_SP_CPU1_DMI_SAFE_E" 20550 "RBA_RESET_CPU0_TRAP_SYSBUSERR_PIE_IE_BS_CPU1_DMI_SAFE_E" 20551 "RBA_RESET_CPU0_TRAP_SYSBUSERR_PIE_IED_CPU2_DMI_NONESAFE_E" 20552 "RBA_RESET_CPU0_TRAP_SYSBUSERR_PIE_IE_T_CPU2_DMI_NONESAFE_E" 20553 "RBA_RESET_CPU0_TRAP_SYSBUSERR_PIE_IE_C_CPU2_DMI_NONESAFE_E" 20554 "RBA_RESET_CPU0_TRAP_SYSBUSERR_PIE_IE_S_CPU2_DMI_NONESAFE_E" 20555 "RBA_RESET_CPU0_TRAP_SYSBUSERR_PIE_IE_BI_CPU2_DMI_NONESAFE_E" 20556 "RBA_RESET_CPU0_TRAP_SYSBUSERR_PIE_IE_UNC_CPU2_DMI_NONESAFE_E" 20557 "RBA_RESET_CPU0_TRAP_SYSBUSERR_PIE_IE_SP_CPU2_DMI_NONESAFE_E" 20558 "RBA_RESET_CPU0_TRAP_SYSBUSERR_PIE_IE_BS_CPU2_DMI_NONESAFE_E" 20559 "RBA_RESET_CPU0_TRAP_SYSBUSERR_PIE_IED_CPU2_DMI_SAFE_E" 20560 "RBA_RESET_CPU0_TRAP_SYSBUSERR_PIE_IE_T_CPU2_DMI_SAFE_E" 20561 "RBA_RESET_CPU0_TRAP_SYSBUSERR_PIE_IE_C_CPU2_DMI_SAFE_E" 20562 "RBA_RESET_CPU0_TRAP_SYSBUSERR_PIE_IE_S_CPU2_DMI_SAFE_E" 20563 "RBA_RESET_CPU0_TRAP_SYSBUSERR_PIE_IE_BI_CPU2_DMI_SAFE_E" 20564 "RBA_RESET_CPU0_TRAP_SYSBUSERR_PIE_IE_UNC_CPU2_DMI_SAFE_E" 20565 "RBA_RESET_CPU0_TRAP_SYSBUSERR_PIE_IE_SP_CPU2_DMI_SAFE_E" 20566 "RBA_RESET_CPU0_TRAP_SYSBUSERR_PIE_IE_BS_CPU2_DMI_SAFE_E" 20567 "RBA_RESET_CPU0_TRAP_SYSBUSERR_PIE_IED_DMA_PARTITION_0_E" 20568 "RBA_RESET_CPU0_TRAP_SYSBUSERR_PIE_IE_T_DMA_PARTITION_0_E" 20569 "RBA_RESET_CPU0_TRAP_SYSBUSERR_PIE_IE_C_DMA_PARTITION_0_E" 20570 "RBA_RESET_CPU0_TRAP_SYSBUSERR_PIE_IE_S_DMA_PARTITION_0_E" 20571 "RBA_RESET_CPU0_TRAP_SYSBUSERR_PIE_IE_BI_DMA_PARTITION_0_E" 20572 "RBA_RESET_CPU0_TRAP_SYSBUSERR_PIE_IE_UNC_DMA_PARTITION_0_E" 20573 "RBA_RESET_CPU0_TRAP_SYSBUSERR_PIE_IE_SP_DMA_PARTITION_0_E" 20574 "RBA_RESET_CPU0_TRAP_SYSBUSERR_PIE_IE_BS_DMA_PARTITION_0_E" 20575 "RBA_RESET_CPU0_TRAP_SYSBUSERR_PIE_IED_DMA_PARTITION_1_E" 20576 "RBA_RESET_CPU0_TRAP_SYSBUSERR_PIE_IE_T_DMA_PARTITION_1_E" 20577 "RBA_RESET_CPU0_TRAP_SYSBUSERR_PIE_IE_C_DMA_PARTITION_1_E" 20578 "RBA_RESET_CPU0_TRAP_SYSBUSERR_PIE_IE_S_DMA_PARTITION_1_E" 20579 "RBA_RESET_CPU0_TRAP_SYSBUSERR_PIE_IE_BI_DMA_PARTITION_1_E" 20580 "RBA_RESET_CPU0_TRAP_SYSBUSERR_PIE_IE_UNC_DMA_PARTITION_1_E" 20581 "RBA_RESET_CPU0_TRAP_SYSBUSERR_PIE_IE_SP_DMA_PARTITION_1_E" 20582 "RBA_RESET_CPU0_TRAP_SYSBUSERR_PIE_IE_BS_DMA_PARTITION_1_E" 20583 "RBA_RESET_CPU0_TRAP_SYSBUSERR_PIE_IED_DMA_PARTITION_2_E" 20584 "RBA_RESET_CPU0_TRAP_SYSBUSERR_PIE_IE_T_DMA_PARTITION_2_E" 20585 "RBA_RESET_CPU0_TRAP_SYSBUSERR_PIE_IE_C_DMA_PARTITION_2_E" 20586 "RBA_RESET_CPU0_TRAP_SYSBUSERR_PIE_IE_S_DMA_PARTITION_2_E" 20587 "RBA_RESET_CPU0_TRAP_SYSBUSERR_PIE_IE_BI_DMA_PARTITION_2_E" 20588 "RBA_RESET_CPU0_TRAP_SYSBUSERR_PIE_IE_UNC_DMA_PARTITION_2_E" 20589 "RBA_RESET_CPU0_TRAP_SYSBUSERR_PIE_IE_SP_DMA_PARTITION_2_E" 20590 "RBA_RESET_CPU0_TRAP_SYSBUSERR_PIE_IE_BS_DMA_PARTITION_2_E" 20591 "RBA_RESET_CPU0_TRAP_SYSBUSERR_PIE_IED_DMA_PARTITION_3_E" 20592 "RBA_RESET_CPU0_TRAP_SYSBUSERR_PIE_IE_T_DMA_PARTITION_3_E" 20593 "RBA_RESET_CPU0_TRAP_SYSBUSERR_PIE_IE_C_DMA_PARTITION_3_E" 20594 "RBA_RESET_CPU0_TRAP_SYSBUSERR_PIE_IE_S_DMA_PARTITION_3_E" 20595 "RBA_RESET_CPU0_TRAP_SYSBUSERR_PIE_IE_BI_DMA_PARTITION_3_E" 20596 "RBA_RESET_CPU0_TRAP_SYSBUSERR_PIE_IE_UNC_DMA_PARTITION_3_E" 20597 "RBA_RESET_CPU0_TRAP_SYSBUSERR_PIE_IE_SP_DMA_PARTITION_3_E" 20598 "RBA_RESET_CPU0_TRAP_SYSBUSERR_PIE_IE_BS_DMA_PARTITION_3_E" 20599 "RBA_RESET_CPU0_TRAP_SYSBUSERR_PIE_IED_DMA_CERBERUS_E" 20600 "RBA_RESET_CPU0_TRAP_SYSBUSERR_PIE_IE_T_DMA_CERBERUS_E" 20601 "RBA_RESET_CPU0_TRAP_SYSBUSERR_PIE_IE_C_DMA_CERBERUS_E" 20602 "RBA_RESET_CPU0_TRAP_SYSBUSERR_PIE_IE_S_DMA_CERBERUS_E" 20603 "RBA_RESET_CPU0_TRAP_SYSBUSERR_PIE_IE_BI_DMA_CERBERUS_E" 20604 "RBA_RESET_CPU0_TRAP_SYSBUSERR_PIE_IE_UNC_DMA_CERBERUS_E" 20605 "RBA_RESET_CPU0_TRAP_SYSBUSERR_PIE_IE_SP_DMA_CERBERUS_E" 20606 "RBA_RESET_CPU0_TRAP_SYSBUSERR_PIE_IE_BS_DMA_CERBERUS_E" 20607 "RBA_RESET_CPU0_TRAP_SYSBUSERR_PIE_IED_HSSL_E" 20608 "RBA_RESET_CPU0_TRAP_SYSBUSERR_PIE_IE_T_HSSL_E" 20609 "RBA_RESET_CPU0_TRAP_SYSBUSERR_PIE_IE_C_HSSL_E" 20610 "RBA_RESET_CPU0_TRAP_SYSBUSERR_PIE_IE_S_HSSL_E" 20611 "RBA_RESET_CPU0_TRAP_SYSBUSERR_PIE_IE_BI_HSSL_E" 20612 "RBA_RESET_CPU0_TRAP_SYSBUSERR_PIE_IE_UNC_HSSL_E" 20613 "RBA_RESET_CPU0_TRAP_SYSBUSERR_PIE_IE_SP_HSSL_E" 20614 "RBA_RESET_CPU0_TRAP_SYSBUSERR_PIE_IE_BS_HSSL_E" 20615 "RBA_RESET_CPU0_TRAP_SYSBUSERR_PIE_IED_ETHERNET_E" 20616 "RBA_RESET_CPU0_TRAP_SYSBUSERR_PIE_IE_T_ETHERNET_E" 20617 "RBA_RESET_CPU0_TRAP_SYSBUSERR_PIE_IE_C_ETHERNET_E" 20618 "RBA_RESET_CPU0_TRAP_SYSBUSERR_PIE_IE_S_ETHERNET_E" 20619 "RBA_RESET_CPU0_TRAP_SYSBUSERR_PIE_IE_BI_ETHERNET_E" 20620 "RBA_RESET_CPU0_TRAP_SYSBUSERR_PIE_IE_UNC_ETHERNET_E" 20621 "RBA_RESET_CPU0_TRAP_SYSBUSERR_PIE_IE_SP_ETHERNET_E" 20622 "RBA_RESET_CPU0_TRAP_SYSBUSERR_PIE_IE_BS_ETHERNET_E" 20623 "RBA_RESET_CPU0_TRAP_SYSBUSERR_PIE_IED_HSM_HSMCMI_E" 20624 "RBA_RESET_CPU0_TRAP_SYSBUSERR_PIE_IE_T_HSM_HSMCMI_E" 20625 "RBA_RESET_CPU0_TRAP_SYSBUSERR_PIE_IE_C_HSM_HSMCMI_E" 20626 "RBA_RESET_CPU0_TRAP_SYSBUSERR_PIE_IE_S_HSM_HSMCMI_E" 20627 "RBA_RESET_CPU0_TRAP_SYSBUSERR_PIE_IE_BI_HSM_HSMCMI_E" 20628 "RBA_RESET_CPU0_TRAP_SYSBUSERR_PIE_IE_UNC_HSM_HSMCMI_E" 20629 "RBA_RESET_CPU0_TRAP_SYSBUSERR_PIE_IE_SP_HSM_HSMCMI_E" 20630 "RBA_RESET_CPU0_TRAP_SYSBUSERR_PIE_IE_BS_HSM_HSMCMI_E" 20631 "RBA_RESET_CPU0_TRAP_SYSBUSERR_PIE_IED_CPU0_PMI_E" 20632 "RBA_RESET_CPU0_TRAP_SYSBUSERR_PIE_IE_T_CPU0_PMI_E" 20633 "RBA_RESET_CPU0_TRAP_SYSBUSERR_PIE_IE_C_CPU0_PMI_E" 20634 "RBA_RESET_CPU0_TRAP_SYSBUSERR_PIE_IE_S_CPU0_PMI_E" 20635 "RBA_RESET_CPU0_TRAP_SYSBUSERR_PIE_IE_BI_CPU0_PMI_E" 20636 "RBA_RESET_CPU0_TRAP_SYSBUSERR_PIE_IE_UNC_CPU0_PMI_E" 20637 "RBA_RESET_CPU0_TRAP_SYSBUSERR_PIE_IE_SP_CPU0_PMI_E" 20638 "RBA_RESET_CPU0_TRAP_SYSBUSERR_PIE_IE_BS_CPU0_PMI_E" 20639 "RBA_RESET_CPU0_TRAP_SYSBUSERR_PIE_IED_CPU1_PMI_E" 20640 "RBA_RESET_CPU0_TRAP_SYSBUSERR_PIE_IE_T_CPU1_PMI_E" 20641 "RBA_RESET_CPU0_TRAP_SYSBUSERR_PIE_IE_C_CPU1_PMI_E" 20642 "RBA_RESET_CPU0_TRAP_SYSBUSERR_PIE_IE_S_CPU1_PMI_E" 20643 "RBA_RESET_CPU0_TRAP_SYSBUSERR_PIE_IE_BI_CPU1_PMI_E" 20644 "RBA_RESET_CPU0_TRAP_SYSBUSERR_PIE_IE_UNC_CPU1_PMI_E" 20645 "RBA_RESET_CPU0_TRAP_SYSBUSERR_PIE_IE_SP_CPU1_PMI_E" 20646 "RBA_RESET_CPU0_TRAP_SYSBUSERR_PIE_IE_BS_CPU1_PMI_E" 20647 "RBA_RESET_CPU0_TRAP_SYSBUSERR_PIE_IED_CPU2_PMI_E" 20648 "RBA_RESET_CPU0_TRAP_SYSBUSERR_PIE_IE_T_CPU2_PMI_E" 20649 "RBA_RESET_CPU0_TRAP_SYSBUSERR_PIE_IE_C_CPU2_PMI_E" 20650 "RBA_RESET_CPU0_TRAP_SYSBUSERR_PIE_IE_S_CPU2_PMI_E" 20651 "RBA_RESET_CPU0_TRAP_SYSBUSERR_PIE_IE_BI_CPU2_PMI_E" 20652 "RBA_RESET_CPU0_TRAP_SYSBUSERR_PIE_IE_UNC_CPU2_PMI_E" 20653 "RBA_RESET_CPU0_TRAP_SYSBUSERR_PIE_IE_SP_CPU2_PMI_E" 20654 "RBA_RESET_CPU0_TRAP_SYSBUSERR_PIE_IE_BS_CPU2_PMI_E" 20655 "RBA_RESET_CPU0_TRAP_SYSBUSERR_PIE_IED_DAM_E" 20656 "RBA_RESET_CPU0_TRAP_SYSBUSERR_PIE_IE_T_DAM_E" 20657 "RBA_RESET_CPU0_TRAP_SYSBUSERR_PIE_IE_C_DAM_E" 20658 "RBA_RESET_CPU0_TRAP_SYSBUSERR_PIE_IE_S_DAM_E" 20659 "RBA_RESET_CPU0_TRAP_SYSBUSERR_PIE_IE_BI_DAM_E" 20660 "RBA_RESET_CPU0_TRAP_SYSBUSERR_PIE_IE_UNC_DAM_E" 20661 "RBA_RESET_CPU0_TRAP_SYSBUSERR_PIE_IE_SP_DAM_E" 20662 "RBA_RESET_CPU0_TRAP_SYSBUSERR_PIE_IE_BS_DAM_E" 20663 "RBA_RESET_CPU0_TRAP_SYSBUSERR_PIE_IED_CERBERUS_BBB_E" 20664 "RBA_RESET_CPU0_TRAP_SYSBUSERR_PIE_IE_T_CERBERUS_BBB_E" 20665 "RBA_RESET_CPU0_TRAP_SYSBUSERR_PIE_IE_C_CERBERUS_BBB_E" 20666 "RBA_RESET_CPU0_TRAP_SYSBUSERR_PIE_IE_S_CERBERUS_BBB_E" 20667 "RBA_RESET_CPU0_TRAP_SYSBUSERR_PIE_IE_BI_CERBERUS_BBB_E" 20668 "RBA_RESET_CPU0_TRAP_SYSBUSERR_PIE_IE_UNC_CERBERUS_BBB_E" 20669 "RBA_RESET_CPU0_TRAP_SYSBUSERR_PIE_IE_SP_CERBERUS_BBB_E" 20670 "RBA_RESET_CPU0_TRAP_SYSBUSERR_PIE_IE_BS_CERBERUS_BBB_E" 20671 "RBA_RESET_CPU0_TRAP_SYSBUSERR_PIE_IED_EMEM_MASTER_BBB_E" 20672 "RBA_RESET_CPU0_TRAP_SYSBUSERR_PIE_IE_T_EMEM_MASTER_BBB_E" 20673 "RBA_RESET_CPU0_TRAP_SYSBUSERR_PIE_IE_C_EMEM_MASTER_BBB_E" 20674 "RBA_RESET_CPU0_TRAP_SYSBUSERR_PIE_IE_S_EMEM_MASTER_BBB_E" 20675 "RBA_RESET_CPU0_TRAP_SYSBUSERR_PIE_IE_BI_EMEM_MASTER_BBB_E" 20676 "RBA_RESET_CPU0_TRAP_SYSBUSERR_PIE_IE_UNC_EMEM_MASTER_BBB_E" 20677 "RBA_RESET_CPU0_TRAP_SYSBUSERR_PIE_IE_SP_EMEM_MASTER_BBB_E" 20678 "RBA_RESET_CPU0_TRAP_SYSBUSERR_PIE_IE_BS_EMEM_MASTER_BBB_E" 20679 "RBA_RESET_CPU0_TRAP_SYSBUSERR_PIE_IED_CIF_MASTER_BBB_E" 20680 "RBA_RESET_CPU0_TRAP_SYSBUSERR_PIE_IE_T_CIF_MASTER_BBB_E" 20681 "RBA_RESET_CPU0_TRAP_SYSBUSERR_PIE_IE_C_CIF_MASTER_BBB_E" 20682 "RBA_RESET_CPU0_TRAP_SYSBUSERR_PIE_IE_S_CIF_MASTER_BBB_E" 20683 "RBA_RESET_CPU0_TRAP_SYSBUSERR_PIE_IE_BI_CIF_MASTER_BBB_E" 20684 "RBA_RESET_CPU0_TRAP_SYSBUSERR_PIE_IE_UNC_CIF_MASTER_BBB_E" 20685 "RBA_RESET_CPU0_TRAP_SYSBUSERR_PIE_IE_SP_CIF_MASTER_BBB_E" 20686 "RBA_RESET_CPU0_TRAP_SYSBUSERR_PIE_IE_BS_CIF_MASTER_BBB_E" 20687 "RBA_RESET_CPU0_TRAP_SYSBUSERR_DIE_UNKNOWN_E" 20688 "RBA_RESET_CPU0_TRAP_SYSBUSERR_DIE_IED_CPU0_DMI_NONESAFE_E" 20689 "RBA_RESET_CPU0_TRAP_SYSBUSERR_DIE_IE_T_CPU0_DMI_NONESAFE_E" 20690 "RBA_RESET_CPU0_TRAP_SYSBUSERR_DIE_IE_C_CPU0_DMI_NONESAFE_E" 20691 "RBA_RESET_CPU0_TRAP_SYSBUSERR_DIE_IE_S_CPU0_DMI_NONESAFE_E" 20692 "RBA_RESET_CPU0_TRAP_SYSBUSERR_DIE_IE_BI_CPU0_DMI_NONESAFE_E" 20693 "RBA_RESET_CPU0_TRAP_SYSBUSERR_DIE_IE_UNC_CPU0_DMI_NONESAFE_E" 20694 "RBA_RESET_CPU0_TRAP_SYSBUSERR_DIE_IE_SP_CPU0_DMI_NONESAFE_E" 20695 "RBA_RESET_CPU0_TRAP_SYSBUSERR_DIE_IE_BS_CPU0_DMI_NONESAFE_E" 20696 "RBA_RESET_CPU0_TRAP_SYSBUSERR_DIE_IED_CPU0_DMI_SAFE_E" 20697 "RBA_RESET_CPU0_TRAP_SYSBUSERR_DIE_IE_T_CPU0_DMI_SAFE_E" 20698 "RBA_RESET_CPU0_TRAP_SYSBUSERR_DIE_IE_C_CPU0_DMI_SAFE_E" 20699 "RBA_RESET_CPU0_TRAP_SYSBUSERR_DIE_IE_S_CPU0_DMI_SAFE_E" 20700 "RBA_RESET_CPU0_TRAP_SYSBUSERR_DIE_IE_BI_CPU0_DMI_SAFE_E" 20701 "RBA_RESET_CPU0_TRAP_SYSBUSERR_DIE_IE_UNC_CPU0_DMI_SAFE_E" 20702 "RBA_RESET_CPU0_TRAP_SYSBUSERR_DIE_IE_SP_CPU0_DMI_SAFE_E" 20703 "RBA_RESET_CPU0_TRAP_SYSBUSERR_DIE_IE_BS_CPU0_DMI_SAFE_E" 20704 "RBA_RESET_CPU0_TRAP_SYSBUSERR_DIE_IED_CPU1_DMI_NONESAFE_E" 20705 "RBA_RESET_CPU0_TRAP_SYSBUSERR_DIE_IE_T_CPU1_DMI_NONESAFE_E" 20706 "RBA_RESET_CPU0_TRAP_SYSBUSERR_DIE_IE_C_CPU1_DMI_NONESAFE_E" 20707 "RBA_RESET_CPU0_TRAP_SYSBUSERR_DIE_IE_S_CPU1_DMI_NONESAFE_E" 20708 "RBA_RESET_CPU0_TRAP_SYSBUSERR_DIE_IE_BI_CPU1_DMI_NONESAFE_E" 20709 "RBA_RESET_CPU0_TRAP_SYSBUSERR_DIE_IE_UNC_CPU1_DMI_NONESAFE_E" 20710 "RBA_RESET_CPU0_TRAP_SYSBUSERR_DIE_IE_SP_CPU1_DMI_NONESAFE_E" 20711 "RBA_RESET_CPU0_TRAP_SYSBUSERR_DIE_IE_BS_CPU1_DMI_NONESAFE_E" 20712 "RBA_RESET_CPU0_TRAP_SYSBUSERR_DIE_IED_CPU1_DMI_SAFE_E" 20713 "RBA_RESET_CPU0_TRAP_SYSBUSERR_DIE_IE_T_CPU1_DMI_SAFE_E" 20714 "RBA_RESET_CPU0_TRAP_SYSBUSERR_DIE_IE_C_CPU1_DMI_SAFE_E" 20715 "RBA_RESET_CPU0_TRAP_SYSBUSERR_DIE_IE_S_CPU1_DMI_SAFE_E" 20716 "RBA_RESET_CPU0_TRAP_SYSBUSERR_DIE_IE_BI_CPU1_DMI_SAFE_E" 20717 "RBA_RESET_CPU0_TRAP_SYSBUSERR_DIE_IE_UNC_CPU1_DMI_SAFE_E" 20718 "RBA_RESET_CPU0_TRAP_SYSBUSERR_DIE_IE_SP_CPU1_DMI_SAFE_E" 20719 "RBA_RESET_CPU0_TRAP_SYSBUSERR_DIE_IE_BS_CPU1_DMI_SAFE_E" 20720 "RBA_RESET_CPU0_TRAP_SYSBUSERR_DIE_IED_CPU2_DMI_NONESAFE_E" 20721 "RBA_RESET_CPU0_TRAP_SYSBUSERR_DIE_IE_T_CPU2_DMI_NONESAFE_E" 20722 "RBA_RESET_CPU0_TRAP_SYSBUSERR_DIE_IE_C_CPU2_DMI_NONESAFE_E" 20723 "RBA_RESET_CPU0_TRAP_SYSBUSERR_DIE_IE_S_CPU2_DMI_NONESAFE_E" 20724 "RBA_RESET_CPU0_TRAP_SYSBUSERR_DIE_IE_BI_CPU2_DMI_NONESAFE_E" 20725 "RBA_RESET_CPU0_TRAP_SYSBUSERR_DIE_IE_UNC_CPU2_DMI_NONESAFE_E" 20726 "RBA_RESET_CPU0_TRAP_SYSBUSERR_DIE_IE_SP_CPU2_DMI_NONESAFE_E" 20727 "RBA_RESET_CPU0_TRAP_SYSBUSERR_DIE_IE_BS_CPU2_DMI_NONESAFE_E" 20728 "RBA_RESET_CPU0_TRAP_SYSBUSERR_DIE_IED_CPU2_DMI_SAFE_E" 20729 "RBA_RESET_CPU0_TRAP_SYSBUSERR_DIE_IE_T_CPU2_DMI_SAFE_E" 20730 "RBA_RESET_CPU0_TRAP_SYSBUSERR_DIE_IE_C_CPU2_DMI_SAFE_E" 20731 "RBA_RESET_CPU0_TRAP_SYSBUSERR_DIE_IE_S_CPU2_DMI_SAFE_E" 20732 "RBA_RESET_CPU0_TRAP_SYSBUSERR_DIE_IE_BI_CPU2_DMI_SAFE_E" 20733 "RBA_RESET_CPU0_TRAP_SYSBUSERR_DIE_IE_UNC_CPU2_DMI_SAFE_E" 20734 "RBA_RESET_CPU0_TRAP_SYSBUSERR_DIE_IE_SP_CPU2_DMI_SAFE_E" 20735 "RBA_RESET_CPU0_TRAP_SYSBUSERR_DIE_IE_BS_CPU2_DMI_SAFE_E" 20736 "RBA_RESET_CPU0_TRAP_SYSBUSERR_DIE_IED_DMA_PARTITION_0_E" 20737 "RBA_RESET_CPU0_TRAP_SYSBUSERR_DIE_IE_T_DMA_PARTITION_0_E" 20738 "RBA_RESET_CPU0_TRAP_SYSBUSERR_DIE_IE_C_DMA_PARTITION_0_E" 20739 "RBA_RESET_CPU0_TRAP_SYSBUSERR_DIE_IE_S_DMA_PARTITION_0_E" 20740 "RBA_RESET_CPU0_TRAP_SYSBUSERR_DIE_IE_BI_DMA_PARTITION_0_E" 20741 "RBA_RESET_CPU0_TRAP_SYSBUSERR_DIE_IE_UNC_DMA_PARTITION_0_E" 20742 "RBA_RESET_CPU0_TRAP_SYSBUSERR_DIE_IE_SP_DMA_PARTITION_0_E" 20743 "RBA_RESET_CPU0_TRAP_SYSBUSERR_DIE_IE_BS_DMA_PARTITION_0_E" 20744 "RBA_RESET_CPU0_TRAP_SYSBUSERR_DIE_IED_DMA_PARTITION_1_E" 20745 "RBA_RESET_CPU0_TRAP_SYSBUSERR_DIE_IE_T_DMA_PARTITION_1_E" 20746 "RBA_RESET_CPU0_TRAP_SYSBUSERR_DIE_IE_C_DMA_PARTITION_1_E" 20747 "RBA_RESET_CPU0_TRAP_SYSBUSERR_DIE_IE_S_DMA_PARTITION_1_E" 20748 "RBA_RESET_CPU0_TRAP_SYSBUSERR_DIE_IE_BI_DMA_PARTITION_1_E" 20749 "RBA_RESET_CPU0_TRAP_SYSBUSERR_DIE_IE_UNC_DMA_PARTITION_1_E" 20750 "RBA_RESET_CPU0_TRAP_SYSBUSERR_DIE_IE_SP_DMA_PARTITION_1_E" 20751 "RBA_RESET_CPU0_TRAP_SYSBUSERR_DIE_IE_BS_DMA_PARTITION_1_E" 20752 "RBA_RESET_CPU0_TRAP_SYSBUSERR_DIE_IED_DMA_PARTITION_2_E" 20753 "RBA_RESET_CPU0_TRAP_SYSBUSERR_DIE_IE_T_DMA_PARTITION_2_E" 20754 "RBA_RESET_CPU0_TRAP_SYSBUSERR_DIE_IE_C_DMA_PARTITION_2_E" 20755 "RBA_RESET_CPU0_TRAP_SYSBUSERR_DIE_IE_S_DMA_PARTITION_2_E" 20756 "RBA_RESET_CPU0_TRAP_SYSBUSERR_DIE_IE_BI_DMA_PARTITION_2_E" 20757 "RBA_RESET_CPU0_TRAP_SYSBUSERR_DIE_IE_UNC_DMA_PARTITION_2_E" 20758 "RBA_RESET_CPU0_TRAP_SYSBUSERR_DIE_IE_SP_DMA_PARTITION_2_E" 20759 "RBA_RESET_CPU0_TRAP_SYSBUSERR_DIE_IE_BS_DMA_PARTITION_2_E" 20760 "RBA_RESET_CPU0_TRAP_SYSBUSERR_DIE_IED_DMA_PARTITION_3_E" 20761 "RBA_RESET_CPU0_TRAP_SYSBUSERR_DIE_IE_T_DMA_PARTITION_3_E" 20762 "RBA_RESET_CPU0_TRAP_SYSBUSERR_DIE_IE_C_DMA_PARTITION_3_E" 20763 "RBA_RESET_CPU0_TRAP_SYSBUSERR_DIE_IE_S_DMA_PARTITION_3_E" 20764 "RBA_RESET_CPU0_TRAP_SYSBUSERR_DIE_IE_BI_DMA_PARTITION_3_E" 20765 "RBA_RESET_CPU0_TRAP_SYSBUSERR_DIE_IE_UNC_DMA_PARTITION_3_E" 20766 "RBA_RESET_CPU0_TRAP_SYSBUSERR_DIE_IE_SP_DMA_PARTITION_3_E" 20767 "RBA_RESET_CPU0_TRAP_SYSBUSERR_DIE_IE_BS_DMA_PARTITION_3_E" 20768 "RBA_RESET_CPU0_TRAP_SYSBUSERR_DIE_IED_DMA_CERBERUS_E" 20769 "RBA_RESET_CPU0_TRAP_SYSBUSERR_DIE_IE_T_DMA_CERBERUS_E" 20770 "RBA_RESET_CPU0_TRAP_SYSBUSERR_DIE_IE_C_DMA_CERBERUS_E" 20771 "RBA_RESET_CPU0_TRAP_SYSBUSERR_DIE_IE_S_DMA_CERBERUS_E" 20772 "RBA_RESET_CPU0_TRAP_SYSBUSERR_DIE_IE_BI_DMA_CERBERUS_E" 20773 "RBA_RESET_CPU0_TRAP_SYSBUSERR_DIE_IE_UNC_DMA_CERBERUS_E" 20774 "RBA_RESET_CPU0_TRAP_SYSBUSERR_DIE_IE_SP_DMA_CERBERUS_E" 20775 "RBA_RESET_CPU0_TRAP_SYSBUSERR_DIE_IE_BS_DMA_CERBERUS_E" 20776 "RBA_RESET_CPU0_TRAP_SYSBUSERR_DIE_IED_HSSL_E" 20777 "RBA_RESET_CPU0_TRAP_SYSBUSERR_DIE_IE_T_HSSL_E" 20778 "RBA_RESET_CPU0_TRAP_SYSBUSERR_DIE_IE_C_HSSL_E" 20779 "RBA_RESET_CPU0_TRAP_SYSBUSERR_DIE_IE_S_HSSL_E" 20780 "RBA_RESET_CPU0_TRAP_SYSBUSERR_DIE_IE_BI_HSSL_E" 20781 "RBA_RESET_CPU0_TRAP_SYSBUSERR_DIE_IE_UNC_HSSL_E" 20782 "RBA_RESET_CPU0_TRAP_SYSBUSERR_DIE_IE_SP_HSSL_E" 20783 "RBA_RESET_CPU0_TRAP_SYSBUSERR_DIE_IE_BS_HSSL_E" 20784 "RBA_RESET_CPU0_TRAP_SYSBUSERR_DIE_IED_ETHERNET_E" 20785 "RBA_RESET_CPU0_TRAP_SYSBUSERR_DIE_IE_T_ETHERNET_E" 20786 "RBA_RESET_CPU0_TRAP_SYSBUSERR_DIE_IE_C_ETHERNET_E" 20787 "RBA_RESET_CPU0_TRAP_SYSBUSERR_DIE_IE_S_ETHERNET_E" 20788 "RBA_RESET_CPU0_TRAP_SYSBUSERR_DIE_IE_BI_ETHERNET_E" 20789 "RBA_RESET_CPU0_TRAP_SYSBUSERR_DIE_IE_UNC_ETHERNET_E" 20790 "RBA_RESET_CPU0_TRAP_SYSBUSERR_DIE_IE_SP_ETHERNET_E" 20791 "RBA_RESET_CPU0_TRAP_SYSBUSERR_DIE_IE_BS_ETHERNET_E" 20792 "RBA_RESET_CPU0_TRAP_SYSBUSERR_DIE_IED_HSM_HSMCMI_E" 20793 "RBA_RESET_CPU0_TRAP_SYSBUSERR_DIE_IE_T_HSM_HSMCMI_E" 20794 "RBA_RESET_CPU0_TRAP_SYSBUSERR_DIE_IE_C_HSM_HSMCMI_E" 20795 "RBA_RESET_CPU0_TRAP_SYSBUSERR_DIE_IE_S_HSM_HSMCMI_E" 20796 "RBA_RESET_CPU0_TRAP_SYSBUSERR_DIE_IE_BI_HSM_HSMCMI_E" 20797 "RBA_RESET_CPU0_TRAP_SYSBUSERR_DIE_IE_UNC_HSM_HSMCMI_E" 20798 "RBA_RESET_CPU0_TRAP_SYSBUSERR_DIE_IE_SP_HSM_HSMCMI_E" 20799 "RBA_RESET_CPU0_TRAP_SYSBUSERR_DIE_IE_BS_HSM_HSMCMI_E" 20800 "RBA_RESET_CPU0_TRAP_SYSBUSERR_DIE_IED_CPU0_PMI_E" 20801 "RBA_RESET_CPU0_TRAP_SYSBUSERR_DIE_IE_T_CPU0_PMI_E" 20802 "RBA_RESET_CPU0_TRAP_SYSBUSERR_DIE_IE_C_CPU0_PMI_E" 20803 "RBA_RESET_CPU0_TRAP_SYSBUSERR_DIE_IE_S_CPU0_PMI_E" 20804 "RBA_RESET_CPU0_TRAP_SYSBUSERR_DIE_IE_BI_CPU0_PMI_E" 20805 "RBA_RESET_CPU0_TRAP_SYSBUSERR_DIE_IE_UNC_CPU0_PMI_E" 20806 "RBA_RESET_CPU0_TRAP_SYSBUSERR_DIE_IE_SP_CPU0_PMI_E" 20807 "RBA_RESET_CPU0_TRAP_SYSBUSERR_DIE_IE_BS_CPU0_PMI_E" 20808 "RBA_RESET_CPU0_TRAP_SYSBUSERR_DIE_IED_CPU1_PMI_E" 20809 "RBA_RESET_CPU0_TRAP_SYSBUSERR_DIE_IE_T_CPU1_PMI_E" 20810 "RBA_RESET_CPU0_TRAP_SYSBUSERR_DIE_IE_C_CPU1_PMI_E" 20811 "RBA_RESET_CPU0_TRAP_SYSBUSERR_DIE_IE_S_CPU1_PMI_E" 20812 "RBA_RESET_CPU0_TRAP_SYSBUSERR_DIE_IE_BI_CPU1_PMI_E" 20813 "RBA_RESET_CPU0_TRAP_SYSBUSERR_DIE_IE_UNC_CPU1_PMI_E" 20814 "RBA_RESET_CPU0_TRAP_SYSBUSERR_DIE_IE_SP_CPU1_PMI_E" 20815 "RBA_RESET_CPU0_TRAP_SYSBUSERR_DIE_IE_BS_CPU1_PMI_E" 20816 "RBA_RESET_CPU0_TRAP_SYSBUSERR_DIE_IED_CPU2_PMI_E" 20817 "RBA_RESET_CPU0_TRAP_SYSBUSERR_DIE_IE_T_CPU2_PMI_E" 20818 "RBA_RESET_CPU0_TRAP_SYSBUSERR_DIE_IE_C_CPU2_PMI_E" 20819 "RBA_RESET_CPU0_TRAP_SYSBUSERR_DIE_IE_S_CPU2_PMI_E" 20820 "RBA_RESET_CPU0_TRAP_SYSBUSERR_DIE_IE_BI_CPU2_PMI_E" 20821 "RBA_RESET_CPU0_TRAP_SYSBUSERR_DIE_IE_UNC_CPU2_PMI_E" 20822 "RBA_RESET_CPU0_TRAP_SYSBUSERR_DIE_IE_SP_CPU2_PMI_E" 20823 "RBA_RESET_CPU0_TRAP_SYSBUSERR_DIE_IE_BS_CPU2_PMI_E" 20824 "RBA_RESET_CPU0_TRAP_SYSBUSERR_DIE_IED_DAM_E" 20825 "RBA_RESET_CPU0_TRAP_SYSBUSERR_DIE_IE_T_DAM_E" 20826 "RBA_RESET_CPU0_TRAP_SYSBUSERR_DIE_IE_C_DAM_E" 20827 "RBA_RESET_CPU0_TRAP_SYSBUSERR_DIE_IE_S_DAM_E" 20828 "RBA_RESET_CPU0_TRAP_SYSBUSERR_DIE_IE_BI_DAM_E" 20829 "RBA_RESET_CPU0_TRAP_SYSBUSERR_DIE_IE_UNC_DAM_E" 20830 "RBA_RESET_CPU0_TRAP_SYSBUSERR_DIE_IE_SP_DAM_E" 20831 "RBA_RESET_CPU0_TRAP_SYSBUSERR_DIE_IE_BS_DAM_E" 20832 "RBA_RESET_CPU0_TRAP_SYSBUSERR_DIE_IED_CERBERUS_BBB_E" 20833 "RBA_RESET_CPU0_TRAP_SYSBUSERR_DIE_IE_T_CERBERUS_BBB_E" 20834 "RBA_RESET_CPU0_TRAP_SYSBUSERR_DIE_IE_C_CERBERUS_BBB_E" 20835 "RBA_RESET_CPU0_TRAP_SYSBUSERR_DIE_IE_S_CERBERUS_BBB_E" 20836 "RBA_RESET_CPU0_TRAP_SYSBUSERR_DIE_IE_BI_CERBERUS_BBB_E" 20837 "RBA_RESET_CPU0_TRAP_SYSBUSERR_DIE_IE_UNC_CERBERUS_BBB_E" 20838 "RBA_RESET_CPU0_TRAP_SYSBUSERR_DIE_IE_SP_CERBERUS_BBB_E" 20839 "RBA_RESET_CPU0_TRAP_SYSBUSERR_DIE_IE_BS_CERBERUS_BBB_E" 20840 "RBA_RESET_CPU0_TRAP_SYSBUSERR_DIE_IED_EMEM_MASTER_BBB_E" 20841 "RBA_RESET_CPU0_TRAP_SYSBUSERR_DIE_IE_T_EMEM_MASTER_BBB_E" 20842 "RBA_RESET_CPU0_TRAP_SYSBUSERR_DIE_IE_C_EMEM_MASTER_BBB_E" 20843 "RBA_RESET_CPU0_TRAP_SYSBUSERR_DIE_IE_S_EMEM_MASTER_BBB_E" 20844 "RBA_RESET_CPU0_TRAP_SYSBUSERR_DIE_IE_BI_EMEM_MASTER_BBB_E" 20845 "RBA_RESET_CPU0_TRAP_SYSBUSERR_DIE_IE_UNC_EMEM_MASTER_BBB_E" 20846 "RBA_RESET_CPU0_TRAP_SYSBUSERR_DIE_IE_SP_EMEM_MASTER_BBB_E" 20847 "RBA_RESET_CPU0_TRAP_SYSBUSERR_DIE_IE_BS_EMEM_MASTER_BBB_E" 20848 "RBA_RESET_CPU0_TRAP_SYSBUSERR_DIE_IED_CIF_MASTER_BBB_E" 20849 "RBA_RESET_CPU0_TRAP_SYSBUSERR_DIE_IE_T_CIF_MASTER_BBB_E" 20850 "RBA_RESET_CPU0_TRAP_SYSBUSERR_DIE_IE_C_CIF_MASTER_BBB_E" 20851 "RBA_RESET_CPU0_TRAP_SYSBUSERR_DIE_IE_S_CIF_MASTER_BBB_E" 20852 "RBA_RESET_CPU0_TRAP_SYSBUSERR_DIE_IE_BI_CIF_MASTER_BBB_E" 20853 "RBA_RESET_CPU0_TRAP_SYSBUSERR_DIE_IE_UNC_CIF_MASTER_BBB_E" 20854 "RBA_RESET_CPU0_TRAP_SYSBUSERR_DIE_IE_SP_CIF_MASTER_BBB_E" 20855 "RBA_RESET_CPU0_TRAP_SYSBUSERR_DIE_IE_BS_CIF_MASTER_BBB_E" 20856 "RBA_RESET_CPU0_TRAP_TCN4_UNKNOWN_E" 20857 "RBA_RESET_CPU0_TRAP_TCN5_TIN0_E" 20858 "RBA_RESET_CPU0_TRAP_ASSTRAP_OVF_E" 20859 "RBA_RESET_CPU0_TRAP_ASSTRAP_SOVF_E" 20860 "RBA_RESET_CPU0_TRAP_TCN5_UNKNOWN_E" 20861 "RBA_RESET_CPU0_TRAP_SYSCALL_SYS_E" 20862 "RBA_RESET_CPU0_TRAP_NMI_UNKNOWN_E" 20863 "RBA_RESET_CPU0_TRAP_NMI_ESR0_E" 20864 "RBA_RESET_CPU0_TRAP_NMI_ESR1_E" 20865 "RBA_RESET_CPU0_TRAP_NMI_SMUT_E" 20866 "RBA_RESET_CPU0_TRAP_NMI_SMU_CPU0_MPU_E" 20867 "RBA_RESET_CPU0_TRAP_NMI_SMU_CPU1_MPU_E" 20868 "RBA_RESET_CPU0_TRAP_NMI_SMU_CPU2_MPU_E" 20869 "RBA_RESET_CPU0_TRAP_NMI_SMU_IR_E" 20870 "RBA_RESET_CPU0_TRAP_NMI_SMU_CGU_WDT_E" 20871 "RBA_RESET_CPU0_TRAP_NMI_SMU_CGU_PLLLOL_E" 20872 "RBA_RESET_CPU0_TRAP_NMI_SMU_CGU_PLLERAYLOL_E" 20873 "RBA_RESET_CPU0_TRAP_NMI_SMU_CGU_STM_E" 20874 "RBA_RESET_CPU0_TRAP_NMI_SMU_CGU_PLLERAY_E" 20875 "RBA_RESET_CPU0_TRAP_NMI_SMU_CGU_PLL_E" 20876 "RBA_RESET_CPU0_TRAP_NMI_SMU_CGU_SRI_E" 20877 "RBA_RESET_CPU0_TRAP_NMI_SMU_CGU_SPB_E" 20878 "RBA_RESET_CPU0_TRAP_NMI_SMU_CGU_CPU0_E" 20879 "RBA_RESET_CPU0_TRAP_NMI_SMU_SCUEVR_12UV_E" 20880 "RBA_RESET_CPU0_TRAP_NMI_SMU_SCUEVR_12OV_E" 20881 "RBA_RESET_CPU0_TRAP_NMI_SMU_SCUEVR_33UV_E" 20882 "RBA_RESET_CPU0_TRAP_NMI_SMU_SCUEVR_33OV_E" 20883 "RBA_RESET_CPU0_TRAP_NMI_SMU_SCUEVR_5UV_E" 20884 "RBA_RESET_CPU0_TRAP_NMI_SMU_SCUEVR_5OV_E" 20885 "RBA_RESET_CPU0_TRAP_NMI_SMU_SWDT_E" 20886 "RBA_RESET_CPU0_TRAP_NMI_SMU_WDT0_E" 20887 "RBA_RESET_CPU0_TRAP_NMI_SMU_WDT1_E" 20888 "RBA_RESET_CPU0_TRAP_NMI_SMU_WDT2_E" 20889 "RBA_RESET_CPU0_TRAP_NMI_SMU_WDT3_E" 20890 "RBA_RESET_CPU0_TRAP_NMI_SMU_WDT4_E" 20891 "RBA_RESET_CPU0_TRAP_NMI_SMU_WDT5_E" 20892 "RBA_RESET_CPU0_TRAP_TCN7_UNKNOWN_E" 24576 "RBA_RESET_CPU1_TRAP_MMU_VAF_E" 24577 "RBA_RESET_CPU1_TRAP_MMU_VAP_E" 24578 "RBA_RESET_CPU1_TRAP_TCN0_UNKNOWN_E" 24579 "RBA_RESET_CPU1_TRAP_TCN1_TIN0_E" 24580 "RBA_RESET_CPU1_TRAP_INTPROT_PRIV_E" 24581 "RBA_RESET_CPU1_TRAP_INTPROT_MPR_E" 24582 "RBA_RESET_CPU1_TRAP_INTPROT_MPW_E" 24583 "RBA_RESET_CPU1_TRAP_INTPROT_MPX_E" 24584 "RBA_RESET_CPU1_TRAP_INTPROT_MPP_E" 24585 "RBA_RESET_CPU1_TRAP_INTPROT_MPN_E" 24586 "RBA_RESET_CPU1_TRAP_INTPROT_GRWP_E" 24587 "RBA_RESET_CPU1_TRAP_TCN1_UNKNOWN_E" 24588 "RBA_RESET_CPU1_TRAP_TCN2_TIN0_E" 24589 "RBA_RESET_CPU1_TRAP_INSTRERR_IOPC_E" 24590 "RBA_RESET_CPU1_TRAP_INSTRERR_UOPC_E" 24591 "RBA_RESET_CPU1_TRAP_INSTRERR_OPD_E" 24592 "RBA_RESET_CPU1_TRAP_INSTRERR_ALN_E" 24593 "RBA_RESET_CPU1_TRAP_INSTRERR_MEM_E" 24594 "RBA_RESET_CPU1_TRAP_TCN2_UNKNOWN_E" 24595 "RBA_RESET_CPU1_TRAP_TCN3_TIN0_E" 24596 "RBA_RESET_CPU1_TRAP_CONTMANA_FCD_E" 24597 "RBA_RESET_CPU1_TRAP_CONTMANA_CDO_E" 24598 "RBA_RESET_CPU1_TRAP_CONTMANA_CDU_E" 24599 "RBA_RESET_CPU1_TRAP_CONTMANA_FCU_E" 24600 "RBA_RESET_CPU1_TRAP_CONTMANA_CSU_E" 24601 "RBA_RESET_CPU1_TRAP_CONTMANA_CTYP_E" 24602 "RBA_RESET_CPU1_TRAP_CONTMANA_NEST_E" 24603 "RBA_RESET_CPU1_TRAP_TCN3_UNKNOWN_E" 24604 "RBA_RESET_CPU1_TRAP_TCN4_TIN0_E" 24605 "RBA_RESET_CPU1_TRAP_SYSBUSERR_PSE_E" 24606 "RBA_RESET_CPU1_TRAP_SYSBUSERR_DSE_E" 24607 "RBA_RESET_CPU1_TRAP_SYSBUSERR_DAE_E" 24608 "RBA_RESET_CPU1_TRAP_SYSBUSERR_CAE_E" 24609 "RBA_RESET_CPU1_TRAP_FPU_INEXACT_E" 24610 "RBA_RESET_CPU1_TRAP_FPU_UNRFLW_E" 24611 "RBA_RESET_CPU1_TRAP_FPU_DIVZRO_E" 24612 "RBA_RESET_CPU1_TRAP_FPU_OVRFLW_E" 24613 "RBA_RESET_CPU1_TRAP_FPU_INVOPR_E" 24614 "RBA_RESET_CPU1_TRAP_SYSBUSERR_PIE_UNKNOWN_E" 24615 "RBA_RESET_CPU1_TRAP_SYSBUSERR_PIE_IED_CPU0_DMI_NONESAFE_E" 24616 "RBA_RESET_CPU1_TRAP_SYSBUSERR_PIE_IE_T_CPU0_DMI_NONESAFE_E" 24617 "RBA_RESET_CPU1_TRAP_SYSBUSERR_PIE_IE_C_CPU0_DMI_NONESAFE_E" 24618 "RBA_RESET_CPU1_TRAP_SYSBUSERR_PIE_IE_S_CPU0_DMI_NONESAFE_E" 24619 "RBA_RESET_CPU1_TRAP_SYSBUSERR_PIE_IE_BI_CPU0_DMI_NONESAFE_E" 24620 "RBA_RESET_CPU1_TRAP_SYSBUSERR_PIE_IE_UNC_CPU0_DMI_NONESAFE_E" 24621 "RBA_RESET_CPU1_TRAP_SYSBUSERR_PIE_IE_SP_CPU0_DMI_NONESAFE_E" 24622 "RBA_RESET_CPU1_TRAP_SYSBUSERR_PIE_IE_BS_CPU0_DMI_NONESAFE_E" 24623 "RBA_RESET_CPU1_TRAP_SYSBUSERR_PIE_IED_CPU0_DMI_SAFE_E" 24624 "RBA_RESET_CPU1_TRAP_SYSBUSERR_PIE_IE_T_CPU0_DMI_SAFE_E" 24625 "RBA_RESET_CPU1_TRAP_SYSBUSERR_PIE_IE_C_CPU0_DMI_SAFE_E" 24626 "RBA_RESET_CPU1_TRAP_SYSBUSERR_PIE_IE_S_CPU0_DMI_SAFE_E" 24627 "RBA_RESET_CPU1_TRAP_SYSBUSERR_PIE_IE_BI_CPU0_DMI_SAFE_E" 24628 "RBA_RESET_CPU1_TRAP_SYSBUSERR_PIE_IE_UNC_CPU0_DMI_SAFE_E" 24629 "RBA_RESET_CPU1_TRAP_SYSBUSERR_PIE_IE_SP_CPU0_DMI_SAFE_E" 24630 "RBA_RESET_CPU1_TRAP_SYSBUSERR_PIE_IE_BS_CPU0_DMI_SAFE_E" 24631 "RBA_RESET_CPU1_TRAP_SYSBUSERR_PIE_IED_CPU1_DMI_NONESAFE_E" 24632 "RBA_RESET_CPU1_TRAP_SYSBUSERR_PIE_IE_T_CPU1_DMI_NONESAFE_E" 24633 "RBA_RESET_CPU1_TRAP_SYSBUSERR_PIE_IE_C_CPU1_DMI_NONESAFE_E" 24634 "RBA_RESET_CPU1_TRAP_SYSBUSERR_PIE_IE_S_CPU1_DMI_NONESAFE_E" 24635 "RBA_RESET_CPU1_TRAP_SYSBUSERR_PIE_IE_BI_CPU1_DMI_NONESAFE_E" 24636 "RBA_RESET_CPU1_TRAP_SYSBUSERR_PIE_IE_UNC_CPU1_DMI_NONESAFE_E" 24637 "RBA_RESET_CPU1_TRAP_SYSBUSERR_PIE_IE_SP_CPU1_DMI_NONESAFE_E" 24638 "RBA_RESET_CPU1_TRAP_SYSBUSERR_PIE_IE_BS_CPU1_DMI_NONESAFE_E" 24639 "RBA_RESET_CPU1_TRAP_SYSBUSERR_PIE_IED_CPU1_DMI_SAFE_E" 24640 "RBA_RESET_CPU1_TRAP_SYSBUSERR_PIE_IE_T_CPU1_DMI_SAFE_E" 24641 "RBA_RESET_CPU1_TRAP_SYSBUSERR_PIE_IE_C_CPU1_DMI_SAFE_E" 24642 "RBA_RESET_CPU1_TRAP_SYSBUSERR_PIE_IE_S_CPU1_DMI_SAFE_E" 24643 "RBA_RESET_CPU1_TRAP_SYSBUSERR_PIE_IE_BI_CPU1_DMI_SAFE_E" 24644 "RBA_RESET_CPU1_TRAP_SYSBUSERR_PIE_IE_UNC_CPU1_DMI_SAFE_E" 24645 "RBA_RESET_CPU1_TRAP_SYSBUSERR_PIE_IE_SP_CPU1_DMI_SAFE_E" 24646 "RBA_RESET_CPU1_TRAP_SYSBUSERR_PIE_IE_BS_CPU1_DMI_SAFE_E" 24647 "RBA_RESET_CPU1_TRAP_SYSBUSERR_PIE_IED_CPU2_DMI_NONESAFE_E" 24648 "RBA_RESET_CPU1_TRAP_SYSBUSERR_PIE_IE_T_CPU2_DMI_NONESAFE_E" 24649 "RBA_RESET_CPU1_TRAP_SYSBUSERR_PIE_IE_C_CPU2_DMI_NONESAFE_E" 24650 "RBA_RESET_CPU1_TRAP_SYSBUSERR_PIE_IE_S_CPU2_DMI_NONESAFE_E" 24651 "RBA_RESET_CPU1_TRAP_SYSBUSERR_PIE_IE_BI_CPU2_DMI_NONESAFE_E" 24652 "RBA_RESET_CPU1_TRAP_SYSBUSERR_PIE_IE_UNC_CPU2_DMI_NONESAFE_E" 24653 "RBA_RESET_CPU1_TRAP_SYSBUSERR_PIE_IE_SP_CPU2_DMI_NONESAFE_E" 24654 "RBA_RESET_CPU1_TRAP_SYSBUSERR_PIE_IE_BS_CPU2_DMI_NONESAFE_E" 24655 "RBA_RESET_CPU1_TRAP_SYSBUSERR_PIE_IED_CPU2_DMI_SAFE_E" 24656 "RBA_RESET_CPU1_TRAP_SYSBUSERR_PIE_IE_T_CPU2_DMI_SAFE_E" 24657 "RBA_RESET_CPU1_TRAP_SYSBUSERR_PIE_IE_C_CPU2_DMI_SAFE_E" 24658 "RBA_RESET_CPU1_TRAP_SYSBUSERR_PIE_IE_S_CPU2_DMI_SAFE_E" 24659 "RBA_RESET_CPU1_TRAP_SYSBUSERR_PIE_IE_BI_CPU2_DMI_SAFE_E" 24660 "RBA_RESET_CPU1_TRAP_SYSBUSERR_PIE_IE_UNC_CPU2_DMI_SAFE_E" 24661 "RBA_RESET_CPU1_TRAP_SYSBUSERR_PIE_IE_SP_CPU2_DMI_SAFE_E" 24662 "RBA_RESET_CPU1_TRAP_SYSBUSERR_PIE_IE_BS_CPU2_DMI_SAFE_E" 24663 "RBA_RESET_CPU1_TRAP_SYSBUSERR_PIE_IED_DMA_PARTITION_0_E" 24664 "RBA_RESET_CPU1_TRAP_SYSBUSERR_PIE_IE_T_DMA_PARTITION_0_E" 24665 "RBA_RESET_CPU1_TRAP_SYSBUSERR_PIE_IE_C_DMA_PARTITION_0_E" 24666 "RBA_RESET_CPU1_TRAP_SYSBUSERR_PIE_IE_S_DMA_PARTITION_0_E" 24667 "RBA_RESET_CPU1_TRAP_SYSBUSERR_PIE_IE_BI_DMA_PARTITION_0_E" 24668 "RBA_RESET_CPU1_TRAP_SYSBUSERR_PIE_IE_UNC_DMA_PARTITION_0_E" 24669 "RBA_RESET_CPU1_TRAP_SYSBUSERR_PIE_IE_SP_DMA_PARTITION_0_E" 24670 "RBA_RESET_CPU1_TRAP_SYSBUSERR_PIE_IE_BS_DMA_PARTITION_0_E" 24671 "RBA_RESET_CPU1_TRAP_SYSBUSERR_PIE_IED_DMA_PARTITION_1_E" 24672 "RBA_RESET_CPU1_TRAP_SYSBUSERR_PIE_IE_T_DMA_PARTITION_1_E" 24673 "RBA_RESET_CPU1_TRAP_SYSBUSERR_PIE_IE_C_DMA_PARTITION_1_E" 24674 "RBA_RESET_CPU1_TRAP_SYSBUSERR_PIE_IE_S_DMA_PARTITION_1_E" 24675 "RBA_RESET_CPU1_TRAP_SYSBUSERR_PIE_IE_BI_DMA_PARTITION_1_E" 24676 "RBA_RESET_CPU1_TRAP_SYSBUSERR_PIE_IE_UNC_DMA_PARTITION_1_E" 24677 "RBA_RESET_CPU1_TRAP_SYSBUSERR_PIE_IE_SP_DMA_PARTITION_1_E" 24678 "RBA_RESET_CPU1_TRAP_SYSBUSERR_PIE_IE_BS_DMA_PARTITION_1_E" 24679 "RBA_RESET_CPU1_TRAP_SYSBUSERR_PIE_IED_DMA_PARTITION_2_E" 24680 "RBA_RESET_CPU1_TRAP_SYSBUSERR_PIE_IE_T_DMA_PARTITION_2_E" 24681 "RBA_RESET_CPU1_TRAP_SYSBUSERR_PIE_IE_C_DMA_PARTITION_2_E" 24682 "RBA_RESET_CPU1_TRAP_SYSBUSERR_PIE_IE_S_DMA_PARTITION_2_E" 24683 "RBA_RESET_CPU1_TRAP_SYSBUSERR_PIE_IE_BI_DMA_PARTITION_2_E" 24684 "RBA_RESET_CPU1_TRAP_SYSBUSERR_PIE_IE_UNC_DMA_PARTITION_2_E" 24685 "RBA_RESET_CPU1_TRAP_SYSBUSERR_PIE_IE_SP_DMA_PARTITION_2_E" 24686 "RBA_RESET_CPU1_TRAP_SYSBUSERR_PIE_IE_BS_DMA_PARTITION_2_E" 24687 "RBA_RESET_CPU1_TRAP_SYSBUSERR_PIE_IED_DMA_PARTITION_3_E" 24688 "RBA_RESET_CPU1_TRAP_SYSBUSERR_PIE_IE_T_DMA_PARTITION_3_E" 24689 "RBA_RESET_CPU1_TRAP_SYSBUSERR_PIE_IE_C_DMA_PARTITION_3_E" 24690 "RBA_RESET_CPU1_TRAP_SYSBUSERR_PIE_IE_S_DMA_PARTITION_3_E" 24691 "RBA_RESET_CPU1_TRAP_SYSBUSERR_PIE_IE_BI_DMA_PARTITION_3_E" 24692 "RBA_RESET_CPU1_TRAP_SYSBUSERR_PIE_IE_UNC_DMA_PARTITION_3_E" 24693 "RBA_RESET_CPU1_TRAP_SYSBUSERR_PIE_IE_SP_DMA_PARTITION_3_E" 24694 "RBA_RESET_CPU1_TRAP_SYSBUSERR_PIE_IE_BS_DMA_PARTITION_3_E" 24695 "RBA_RESET_CPU1_TRAP_SYSBUSERR_PIE_IED_DMA_CERBERUS_E" 24696 "RBA_RESET_CPU1_TRAP_SYSBUSERR_PIE_IE_T_DMA_CERBERUS_E" 24697 "RBA_RESET_CPU1_TRAP_SYSBUSERR_PIE_IE_C_DMA_CERBERUS_E" 24698 "RBA_RESET_CPU1_TRAP_SYSBUSERR_PIE_IE_S_DMA_CERBERUS_E" 24699 "RBA_RESET_CPU1_TRAP_SYSBUSERR_PIE_IE_BI_DMA_CERBERUS_E" 24700 "RBA_RESET_CPU1_TRAP_SYSBUSERR_PIE_IE_UNC_DMA_CERBERUS_E" 24701 "RBA_RESET_CPU1_TRAP_SYSBUSERR_PIE_IE_SP_DMA_CERBERUS_E" 24702 "RBA_RESET_CPU1_TRAP_SYSBUSERR_PIE_IE_BS_DMA_CERBERUS_E" 24703 "RBA_RESET_CPU1_TRAP_SYSBUSERR_PIE_IED_HSSL_E" 24704 "RBA_RESET_CPU1_TRAP_SYSBUSERR_PIE_IE_T_HSSL_E" 24705 "RBA_RESET_CPU1_TRAP_SYSBUSERR_PIE_IE_C_HSSL_E" 24706 "RBA_RESET_CPU1_TRAP_SYSBUSERR_PIE_IE_S_HSSL_E" 24707 "RBA_RESET_CPU1_TRAP_SYSBUSERR_PIE_IE_BI_HSSL_E" 24708 "RBA_RESET_CPU1_TRAP_SYSBUSERR_PIE_IE_UNC_HSSL_E" 24709 "RBA_RESET_CPU1_TRAP_SYSBUSERR_PIE_IE_SP_HSSL_E" 24710 "RBA_RESET_CPU1_TRAP_SYSBUSERR_PIE_IE_BS_HSSL_E" 24711 "RBA_RESET_CPU1_TRAP_SYSBUSERR_PIE_IED_ETHERNET_E" 24712 "RBA_RESET_CPU1_TRAP_SYSBUSERR_PIE_IE_T_ETHERNET_E" 24713 "RBA_RESET_CPU1_TRAP_SYSBUSERR_PIE_IE_C_ETHERNET_E" 24714 "RBA_RESET_CPU1_TRAP_SYSBUSERR_PIE_IE_S_ETHERNET_E" 24715 "RBA_RESET_CPU1_TRAP_SYSBUSERR_PIE_IE_BI_ETHERNET_E" 24716 "RBA_RESET_CPU1_TRAP_SYSBUSERR_PIE_IE_UNC_ETHERNET_E" 24717 "RBA_RESET_CPU1_TRAP_SYSBUSERR_PIE_IE_SP_ETHERNET_E" 24718 "RBA_RESET_CPU1_TRAP_SYSBUSERR_PIE_IE_BS_ETHERNET_E" 24719 "RBA_RESET_CPU1_TRAP_SYSBUSERR_PIE_IED_HSM_HSMCMI_E" 24720 "RBA_RESET_CPU1_TRAP_SYSBUSERR_PIE_IE_T_HSM_HSMCMI_E" 24721 "RBA_RESET_CPU1_TRAP_SYSBUSERR_PIE_IE_C_HSM_HSMCMI_E" 24722 "RBA_RESET_CPU1_TRAP_SYSBUSERR_PIE_IE_S_HSM_HSMCMI_E" 24723 "RBA_RESET_CPU1_TRAP_SYSBUSERR_PIE_IE_BI_HSM_HSMCMI_E" 24724 "RBA_RESET_CPU1_TRAP_SYSBUSERR_PIE_IE_UNC_HSM_HSMCMI_E" 24725 "RBA_RESET_CPU1_TRAP_SYSBUSERR_PIE_IE_SP_HSM_HSMCMI_E" 24726 "RBA_RESET_CPU1_TRAP_SYSBUSERR_PIE_IE_BS_HSM_HSMCMI_E" 24727 "RBA_RESET_CPU1_TRAP_SYSBUSERR_PIE_IED_CPU0_PMI_E" 24728 "RBA_RESET_CPU1_TRAP_SYSBUSERR_PIE_IE_T_CPU0_PMI_E" 24729 "RBA_RESET_CPU1_TRAP_SYSBUSERR_PIE_IE_C_CPU0_PMI_E" 24730 "RBA_RESET_CPU1_TRAP_SYSBUSERR_PIE_IE_S_CPU0_PMI_E" 24731 "RBA_RESET_CPU1_TRAP_SYSBUSERR_PIE_IE_BI_CPU0_PMI_E" 24732 "RBA_RESET_CPU1_TRAP_SYSBUSERR_PIE_IE_UNC_CPU0_PMI_E" 24733 "RBA_RESET_CPU1_TRAP_SYSBUSERR_PIE_IE_SP_CPU0_PMI_E" 24734 "RBA_RESET_CPU1_TRAP_SYSBUSERR_PIE_IE_BS_CPU0_PMI_E" 24735 "RBA_RESET_CPU1_TRAP_SYSBUSERR_PIE_IED_CPU1_PMI_E" 24736 "RBA_RESET_CPU1_TRAP_SYSBUSERR_PIE_IE_T_CPU1_PMI_E" 24737 "RBA_RESET_CPU1_TRAP_SYSBUSERR_PIE_IE_C_CPU1_PMI_E" 24738 "RBA_RESET_CPU1_TRAP_SYSBUSERR_PIE_IE_S_CPU1_PMI_E" 24739 "RBA_RESET_CPU1_TRAP_SYSBUSERR_PIE_IE_BI_CPU1_PMI_E" 24740 "RBA_RESET_CPU1_TRAP_SYSBUSERR_PIE_IE_UNC_CPU1_PMI_E" 24741 "RBA_RESET_CPU1_TRAP_SYSBUSERR_PIE_IE_SP_CPU1_PMI_E" 24742 "RBA_RESET_CPU1_TRAP_SYSBUSERR_PIE_IE_BS_CPU1_PMI_E" 24743 "RBA_RESET_CPU1_TRAP_SYSBUSERR_PIE_IED_CPU2_PMI_E" 24744 "RBA_RESET_CPU1_TRAP_SYSBUSERR_PIE_IE_T_CPU2_PMI_E" 24745 "RBA_RESET_CPU1_TRAP_SYSBUSERR_PIE_IE_C_CPU2_PMI_E" 24746 "RBA_RESET_CPU1_TRAP_SYSBUSERR_PIE_IE_S_CPU2_PMI_E" 24747 "RBA_RESET_CPU1_TRAP_SYSBUSERR_PIE_IE_BI_CPU2_PMI_E" 24748 "RBA_RESET_CPU1_TRAP_SYSBUSERR_PIE_IE_UNC_CPU2_PMI_E" 24749 "RBA_RESET_CPU1_TRAP_SYSBUSERR_PIE_IE_SP_CPU2_PMI_E" 24750 "RBA_RESET_CPU1_TRAP_SYSBUSERR_PIE_IE_BS_CPU2_PMI_E" 24751 "RBA_RESET_CPU1_TRAP_SYSBUSERR_PIE_IED_DAM_E" 24752 "RBA_RESET_CPU1_TRAP_SYSBUSERR_PIE_IE_T_DAM_E" 24753 "RBA_RESET_CPU1_TRAP_SYSBUSERR_PIE_IE_C_DAM_E" 24754 "RBA_RESET_CPU1_TRAP_SYSBUSERR_PIE_IE_S_DAM_E" 24755 "RBA_RESET_CPU1_TRAP_SYSBUSERR_PIE_IE_BI_DAM_E" 24756 "RBA_RESET_CPU1_TRAP_SYSBUSERR_PIE_IE_UNC_DAM_E" 24757 "RBA_RESET_CPU1_TRAP_SYSBUSERR_PIE_IE_SP_DAM_E" 24758 "RBA_RESET_CPU1_TRAP_SYSBUSERR_PIE_IE_BS_DAM_E" 24759 "RBA_RESET_CPU1_TRAP_SYSBUSERR_PIE_IED_CERBERUS_BBB_E" 24760 "RBA_RESET_CPU1_TRAP_SYSBUSERR_PIE_IE_T_CERBERUS_BBB_E" 24761 "RBA_RESET_CPU1_TRAP_SYSBUSERR_PIE_IE_C_CERBERUS_BBB_E" 24762 "RBA_RESET_CPU1_TRAP_SYSBUSERR_PIE_IE_S_CERBERUS_BBB_E" 24763 "RBA_RESET_CPU1_TRAP_SYSBUSERR_PIE_IE_BI_CERBERUS_BBB_E" 24764 "RBA_RESET_CPU1_TRAP_SYSBUSERR_PIE_IE_UNC_CERBERUS_BBB_E" 24765 "RBA_RESET_CPU1_TRAP_SYSBUSERR_PIE_IE_SP_CERBERUS_BBB_E" 24766 "RBA_RESET_CPU1_TRAP_SYSBUSERR_PIE_IE_BS_CERBERUS_BBB_E" 24767 "RBA_RESET_CPU1_TRAP_SYSBUSERR_PIE_IED_EMEM_MASTER_BBB_E" 24768 "RBA_RESET_CPU1_TRAP_SYSBUSERR_PIE_IE_T_EMEM_MASTER_BBB_E" 24769 "RBA_RESET_CPU1_TRAP_SYSBUSERR_PIE_IE_C_EMEM_MASTER_BBB_E" 24770 "RBA_RESET_CPU1_TRAP_SYSBUSERR_PIE_IE_S_EMEM_MASTER_BBB_E" 24771 "RBA_RESET_CPU1_TRAP_SYSBUSERR_PIE_IE_BI_EMEM_MASTER_BBB_E" 24772 "RBA_RESET_CPU1_TRAP_SYSBUSERR_PIE_IE_UNC_EMEM_MASTER_BBB_E" 24773 "RBA_RESET_CPU1_TRAP_SYSBUSERR_PIE_IE_SP_EMEM_MASTER_BBB_E" 24774 "RBA_RESET_CPU1_TRAP_SYSBUSERR_PIE_IE_BS_EMEM_MASTER_BBB_E" 24775 "RBA_RESET_CPU1_TRAP_SYSBUSERR_PIE_IED_CIF_MASTER_BBB_E" 24776 "RBA_RESET_CPU1_TRAP_SYSBUSERR_PIE_IE_T_CIF_MASTER_BBB_E" 24777 "RBA_RESET_CPU1_TRAP_SYSBUSERR_PIE_IE_C_CIF_MASTER_BBB_E" 24778 "RBA_RESET_CPU1_TRAP_SYSBUSERR_PIE_IE_S_CIF_MASTER_BBB_E" 24779 "RBA_RESET_CPU1_TRAP_SYSBUSERR_PIE_IE_BI_CIF_MASTER_BBB_E" 24780 "RBA_RESET_CPU1_TRAP_SYSBUSERR_PIE_IE_UNC_CIF_MASTER_BBB_E" 24781 "RBA_RESET_CPU1_TRAP_SYSBUSERR_PIE_IE_SP_CIF_MASTER_BBB_E" 24782 "RBA_RESET_CPU1_TRAP_SYSBUSERR_PIE_IE_BS_CIF_MASTER_BBB_E" 24783 "RBA_RESET_CPU1_TRAP_SYSBUSERR_DIE_UNKNOWN_E" 24784 "RBA_RESET_CPU1_TRAP_SYSBUSERR_DIE_IED_CPU0_DMI_NONESAFE_E" 24785 "RBA_RESET_CPU1_TRAP_SYSBUSERR_DIE_IE_T_CPU0_DMI_NONESAFE_E" 24786 "RBA_RESET_CPU1_TRAP_SYSBUSERR_DIE_IE_C_CPU0_DMI_NONESAFE_E" 24787 "RBA_RESET_CPU1_TRAP_SYSBUSERR_DIE_IE_S_CPU0_DMI_NONESAFE_E" 24788 "RBA_RESET_CPU1_TRAP_SYSBUSERR_DIE_IE_BI_CPU0_DMI_NONESAFE_E" 24789 "RBA_RESET_CPU1_TRAP_SYSBUSERR_DIE_IE_UNC_CPU0_DMI_NONESAFE_E" 24790 "RBA_RESET_CPU1_TRAP_SYSBUSERR_DIE_IE_SP_CPU0_DMI_NONESAFE_E" 24791 "RBA_RESET_CPU1_TRAP_SYSBUSERR_DIE_IE_BS_CPU0_DMI_NONESAFE_E" 24792 "RBA_RESET_CPU1_TRAP_SYSBUSERR_DIE_IED_CPU0_DMI_SAFE_E" 24793 "RBA_RESET_CPU1_TRAP_SYSBUSERR_DIE_IE_T_CPU0_DMI_SAFE_E" 24794 "RBA_RESET_CPU1_TRAP_SYSBUSERR_DIE_IE_C_CPU0_DMI_SAFE_E" 24795 "RBA_RESET_CPU1_TRAP_SYSBUSERR_DIE_IE_S_CPU0_DMI_SAFE_E" 24796 "RBA_RESET_CPU1_TRAP_SYSBUSERR_DIE_IE_BI_CPU0_DMI_SAFE_E" 24797 "RBA_RESET_CPU1_TRAP_SYSBUSERR_DIE_IE_UNC_CPU0_DMI_SAFE_E" 24798 "RBA_RESET_CPU1_TRAP_SYSBUSERR_DIE_IE_SP_CPU0_DMI_SAFE_E" 24799 "RBA_RESET_CPU1_TRAP_SYSBUSERR_DIE_IE_BS_CPU0_DMI_SAFE_E" 24800 "RBA_RESET_CPU1_TRAP_SYSBUSERR_DIE_IED_CPU1_DMI_NONESAFE_E" 24801 "RBA_RESET_CPU1_TRAP_SYSBUSERR_DIE_IE_T_CPU1_DMI_NONESAFE_E" 24802 "RBA_RESET_CPU1_TRAP_SYSBUSERR_DIE_IE_C_CPU1_DMI_NONESAFE_E" 24803 "RBA_RESET_CPU1_TRAP_SYSBUSERR_DIE_IE_S_CPU1_DMI_NONESAFE_E" 24804 "RBA_RESET_CPU1_TRAP_SYSBUSERR_DIE_IE_BI_CPU1_DMI_NONESAFE_E" 24805 "RBA_RESET_CPU1_TRAP_SYSBUSERR_DIE_IE_UNC_CPU1_DMI_NONESAFE_E" 24806 "RBA_RESET_CPU1_TRAP_SYSBUSERR_DIE_IE_SP_CPU1_DMI_NONESAFE_E" 24807 "RBA_RESET_CPU1_TRAP_SYSBUSERR_DIE_IE_BS_CPU1_DMI_NONESAFE_E" 24808 "RBA_RESET_CPU1_TRAP_SYSBUSERR_DIE_IED_CPU1_DMI_SAFE_E" 24809 "RBA_RESET_CPU1_TRAP_SYSBUSERR_DIE_IE_T_CPU1_DMI_SAFE_E" 24810 "RBA_RESET_CPU1_TRAP_SYSBUSERR_DIE_IE_C_CPU1_DMI_SAFE_E" 24811 "RBA_RESET_CPU1_TRAP_SYSBUSERR_DIE_IE_S_CPU1_DMI_SAFE_E" 24812 "RBA_RESET_CPU1_TRAP_SYSBUSERR_DIE_IE_BI_CPU1_DMI_SAFE_E" 24813 "RBA_RESET_CPU1_TRAP_SYSBUSERR_DIE_IE_UNC_CPU1_DMI_SAFE_E" 24814 "RBA_RESET_CPU1_TRAP_SYSBUSERR_DIE_IE_SP_CPU1_DMI_SAFE_E" 24815 "RBA_RESET_CPU1_TRAP_SYSBUSERR_DIE_IE_BS_CPU1_DMI_SAFE_E" 24816 "RBA_RESET_CPU1_TRAP_SYSBUSERR_DIE_IED_CPU2_DMI_NONESAFE_E" 24817 "RBA_RESET_CPU1_TRAP_SYSBUSERR_DIE_IE_T_CPU2_DMI_NONESAFE_E" 24818 "RBA_RESET_CPU1_TRAP_SYSBUSERR_DIE_IE_C_CPU2_DMI_NONESAFE_E" 24819 "RBA_RESET_CPU1_TRAP_SYSBUSERR_DIE_IE_S_CPU2_DMI_NONESAFE_E" 24820 "RBA_RESET_CPU1_TRAP_SYSBUSERR_DIE_IE_BI_CPU2_DMI_NONESAFE_E" 24821 "RBA_RESET_CPU1_TRAP_SYSBUSERR_DIE_IE_UNC_CPU2_DMI_NONESAFE_E" 24822 "RBA_RESET_CPU1_TRAP_SYSBUSERR_DIE_IE_SP_CPU2_DMI_NONESAFE_E" 24823 "RBA_RESET_CPU1_TRAP_SYSBUSERR_DIE_IE_BS_CPU2_DMI_NONESAFE_E" 24824 "RBA_RESET_CPU1_TRAP_SYSBUSERR_DIE_IED_CPU2_DMI_SAFE_E" 24825 "RBA_RESET_CPU1_TRAP_SYSBUSERR_DIE_IE_T_CPU2_DMI_SAFE_E" 24826 "RBA_RESET_CPU1_TRAP_SYSBUSERR_DIE_IE_C_CPU2_DMI_SAFE_E" 24827 "RBA_RESET_CPU1_TRAP_SYSBUSERR_DIE_IE_S_CPU2_DMI_SAFE_E" 24828 "RBA_RESET_CPU1_TRAP_SYSBUSERR_DIE_IE_BI_CPU2_DMI_SAFE_E" 24829 "RBA_RESET_CPU1_TRAP_SYSBUSERR_DIE_IE_UNC_CPU2_DMI_SAFE_E" 24830 "RBA_RESET_CPU1_TRAP_SYSBUSERR_DIE_IE_SP_CPU2_DMI_SAFE_E" 24831 "RBA_RESET_CPU1_TRAP_SYSBUSERR_DIE_IE_BS_CPU2_DMI_SAFE_E" 24832 "RBA_RESET_CPU1_TRAP_SYSBUSERR_DIE_IED_DMA_PARTITION_0_E" 24833 "RBA_RESET_CPU1_TRAP_SYSBUSERR_DIE_IE_T_DMA_PARTITION_0_E" 24834 "RBA_RESET_CPU1_TRAP_SYSBUSERR_DIE_IE_C_DMA_PARTITION_0_E" 24835 "RBA_RESET_CPU1_TRAP_SYSBUSERR_DIE_IE_S_DMA_PARTITION_0_E" 24836 "RBA_RESET_CPU1_TRAP_SYSBUSERR_DIE_IE_BI_DMA_PARTITION_0_E" 24837 "RBA_RESET_CPU1_TRAP_SYSBUSERR_DIE_IE_UNC_DMA_PARTITION_0_E" 24838 "RBA_RESET_CPU1_TRAP_SYSBUSERR_DIE_IE_SP_DMA_PARTITION_0_E" 24839 "RBA_RESET_CPU1_TRAP_SYSBUSERR_DIE_IE_BS_DMA_PARTITION_0_E" 24840 "RBA_RESET_CPU1_TRAP_SYSBUSERR_DIE_IED_DMA_PARTITION_1_E" 24841 "RBA_RESET_CPU1_TRAP_SYSBUSERR_DIE_IE_T_DMA_PARTITION_1_E" 24842 "RBA_RESET_CPU1_TRAP_SYSBUSERR_DIE_IE_C_DMA_PARTITION_1_E" 24843 "RBA_RESET_CPU1_TRAP_SYSBUSERR_DIE_IE_S_DMA_PARTITION_1_E" 24844 "RBA_RESET_CPU1_TRAP_SYSBUSERR_DIE_IE_BI_DMA_PARTITION_1_E" 24845 "RBA_RESET_CPU1_TRAP_SYSBUSERR_DIE_IE_UNC_DMA_PARTITION_1_E" 24846 "RBA_RESET_CPU1_TRAP_SYSBUSERR_DIE_IE_SP_DMA_PARTITION_1_E" 24847 "RBA_RESET_CPU1_TRAP_SYSBUSERR_DIE_IE_BS_DMA_PARTITION_1_E" 24848 "RBA_RESET_CPU1_TRAP_SYSBUSERR_DIE_IED_DMA_PARTITION_2_E" 24849 "RBA_RESET_CPU1_TRAP_SYSBUSERR_DIE_IE_T_DMA_PARTITION_2_E" 24850 "RBA_RESET_CPU1_TRAP_SYSBUSERR_DIE_IE_C_DMA_PARTITION_2_E" 24851 "RBA_RESET_CPU1_TRAP_SYSBUSERR_DIE_IE_S_DMA_PARTITION_2_E" 24852 "RBA_RESET_CPU1_TRAP_SYSBUSERR_DIE_IE_BI_DMA_PARTITION_2_E" 24853 "RBA_RESET_CPU1_TRAP_SYSBUSERR_DIE_IE_UNC_DMA_PARTITION_2_E" 24854 "RBA_RESET_CPU1_TRAP_SYSBUSERR_DIE_IE_SP_DMA_PARTITION_2_E" 24855 "RBA_RESET_CPU1_TRAP_SYSBUSERR_DIE_IE_BS_DMA_PARTITION_2_E" 24856 "RBA_RESET_CPU1_TRAP_SYSBUSERR_DIE_IED_DMA_PARTITION_3_E" 24857 "RBA_RESET_CPU1_TRAP_SYSBUSERR_DIE_IE_T_DMA_PARTITION_3_E" 24858 "RBA_RESET_CPU1_TRAP_SYSBUSERR_DIE_IE_C_DMA_PARTITION_3_E" 24859 "RBA_RESET_CPU1_TRAP_SYSBUSERR_DIE_IE_S_DMA_PARTITION_3_E" 24860 "RBA_RESET_CPU1_TRAP_SYSBUSERR_DIE_IE_BI_DMA_PARTITION_3_E" 24861 "RBA_RESET_CPU1_TRAP_SYSBUSERR_DIE_IE_UNC_DMA_PARTITION_3_E" 24862 "RBA_RESET_CPU1_TRAP_SYSBUSERR_DIE_IE_SP_DMA_PARTITION_3_E" 24863 "RBA_RESET_CPU1_TRAP_SYSBUSERR_DIE_IE_BS_DMA_PARTITION_3_E" 24864 "RBA_RESET_CPU1_TRAP_SYSBUSERR_DIE_IED_DMA_CERBERUS_E" 24865 "RBA_RESET_CPU1_TRAP_SYSBUSERR_DIE_IE_T_DMA_CERBERUS_E" 24866 "RBA_RESET_CPU1_TRAP_SYSBUSERR_DIE_IE_C_DMA_CERBERUS_E" 24867 "RBA_RESET_CPU1_TRAP_SYSBUSERR_DIE_IE_S_DMA_CERBERUS_E" 24868 "RBA_RESET_CPU1_TRAP_SYSBUSERR_DIE_IE_BI_DMA_CERBERUS_E" 24869 "RBA_RESET_CPU1_TRAP_SYSBUSERR_DIE_IE_UNC_DMA_CERBERUS_E" 24870 "RBA_RESET_CPU1_TRAP_SYSBUSERR_DIE_IE_SP_DMA_CERBERUS_E" 24871 "RBA_RESET_CPU1_TRAP_SYSBUSERR_DIE_IE_BS_DMA_CERBERUS_E" 24872 "RBA_RESET_CPU1_TRAP_SYSBUSERR_DIE_IED_HSSL_E" 24873 "RBA_RESET_CPU1_TRAP_SYSBUSERR_DIE_IE_T_HSSL_E" 24874 "RBA_RESET_CPU1_TRAP_SYSBUSERR_DIE_IE_C_HSSL_E" 24875 "RBA_RESET_CPU1_TRAP_SYSBUSERR_DIE_IE_S_HSSL_E" 24876 "RBA_RESET_CPU1_TRAP_SYSBUSERR_DIE_IE_BI_HSSL_E" 24877 "RBA_RESET_CPU1_TRAP_SYSBUSERR_DIE_IE_UNC_HSSL_E" 24878 "RBA_RESET_CPU1_TRAP_SYSBUSERR_DIE_IE_SP_HSSL_E" 24879 "RBA_RESET_CPU1_TRAP_SYSBUSERR_DIE_IE_BS_HSSL_E" 24880 "RBA_RESET_CPU1_TRAP_SYSBUSERR_DIE_IED_ETHERNET_E" 24881 "RBA_RESET_CPU1_TRAP_SYSBUSERR_DIE_IE_T_ETHERNET_E" 24882 "RBA_RESET_CPU1_TRAP_SYSBUSERR_DIE_IE_C_ETHERNET_E" 24883 "RBA_RESET_CPU1_TRAP_SYSBUSERR_DIE_IE_S_ETHERNET_E" 24884 "RBA_RESET_CPU1_TRAP_SYSBUSERR_DIE_IE_BI_ETHERNET_E" 24885 "RBA_RESET_CPU1_TRAP_SYSBUSERR_DIE_IE_UNC_ETHERNET_E" 24886 "RBA_RESET_CPU1_TRAP_SYSBUSERR_DIE_IE_SP_ETHERNET_E" 24887 "RBA_RESET_CPU1_TRAP_SYSBUSERR_DIE_IE_BS_ETHERNET_E" 24888 "RBA_RESET_CPU1_TRAP_SYSBUSERR_DIE_IED_HSM_HSMCMI_E" 24889 "RBA_RESET_CPU1_TRAP_SYSBUSERR_DIE_IE_T_HSM_HSMCMI_E" 24890 "RBA_RESET_CPU1_TRAP_SYSBUSERR_DIE_IE_C_HSM_HSMCMI_E" 24891 "RBA_RESET_CPU1_TRAP_SYSBUSERR_DIE_IE_S_HSM_HSMCMI_E" 24892 "RBA_RESET_CPU1_TRAP_SYSBUSERR_DIE_IE_BI_HSM_HSMCMI_E" 24893 "RBA_RESET_CPU1_TRAP_SYSBUSERR_DIE_IE_UNC_HSM_HSMCMI_E" 24894 "RBA_RESET_CPU1_TRAP_SYSBUSERR_DIE_IE_SP_HSM_HSMCMI_E" 24895 "RBA_RESET_CPU1_TRAP_SYSBUSERR_DIE_IE_BS_HSM_HSMCMI_E" 24896 "RBA_RESET_CPU1_TRAP_SYSBUSERR_DIE_IED_CPU0_PMI_E" 24897 "RBA_RESET_CPU1_TRAP_SYSBUSERR_DIE_IE_T_CPU0_PMI_E" 24898 "RBA_RESET_CPU1_TRAP_SYSBUSERR_DIE_IE_C_CPU0_PMI_E" 24899 "RBA_RESET_CPU1_TRAP_SYSBUSERR_DIE_IE_S_CPU0_PMI_E" 24900 "RBA_RESET_CPU1_TRAP_SYSBUSERR_DIE_IE_BI_CPU0_PMI_E" 24901 "RBA_RESET_CPU1_TRAP_SYSBUSERR_DIE_IE_UNC_CPU0_PMI_E" 24902 "RBA_RESET_CPU1_TRAP_SYSBUSERR_DIE_IE_SP_CPU0_PMI_E" 24903 "RBA_RESET_CPU1_TRAP_SYSBUSERR_DIE_IE_BS_CPU0_PMI_E" 24904 "RBA_RESET_CPU1_TRAP_SYSBUSERR_DIE_IED_CPU1_PMI_E" 24905 "RBA_RESET_CPU1_TRAP_SYSBUSERR_DIE_IE_T_CPU1_PMI_E" 24906 "RBA_RESET_CPU1_TRAP_SYSBUSERR_DIE_IE_C_CPU1_PMI_E" 24907 "RBA_RESET_CPU1_TRAP_SYSBUSERR_DIE_IE_S_CPU1_PMI_E" 24908 "RBA_RESET_CPU1_TRAP_SYSBUSERR_DIE_IE_BI_CPU1_PMI_E" 24909 "RBA_RESET_CPU1_TRAP_SYSBUSERR_DIE_IE_UNC_CPU1_PMI_E" 24910 "RBA_RESET_CPU1_TRAP_SYSBUSERR_DIE_IE_SP_CPU1_PMI_E" 24911 "RBA_RESET_CPU1_TRAP_SYSBUSERR_DIE_IE_BS_CPU1_PMI_E" 24912 "RBA_RESET_CPU1_TRAP_SYSBUSERR_DIE_IED_CPU2_PMI_E" 24913 "RBA_RESET_CPU1_TRAP_SYSBUSERR_DIE_IE_T_CPU2_PMI_E" 24914 "RBA_RESET_CPU1_TRAP_SYSBUSERR_DIE_IE_C_CPU2_PMI_E" 24915 "RBA_RESET_CPU1_TRAP_SYSBUSERR_DIE_IE_S_CPU2_PMI_E" 24916 "RBA_RESET_CPU1_TRAP_SYSBUSERR_DIE_IE_BI_CPU2_PMI_E" 24917 "RBA_RESET_CPU1_TRAP_SYSBUSERR_DIE_IE_UNC_CPU2_PMI_E" 24918 "RBA_RESET_CPU1_TRAP_SYSBUSERR_DIE_IE_SP_CPU2_PMI_E" 24919 "RBA_RESET_CPU1_TRAP_SYSBUSERR_DIE_IE_BS_CPU2_PMI_E" 24920 "RBA_RESET_CPU1_TRAP_SYSBUSERR_DIE_IED_DAM_E" 24921 "RBA_RESET_CPU1_TRAP_SYSBUSERR_DIE_IE_T_DAM_E" 24922 "RBA_RESET_CPU1_TRAP_SYSBUSERR_DIE_IE_C_DAM_E" 24923 "RBA_RESET_CPU1_TRAP_SYSBUSERR_DIE_IE_S_DAM_E" 24924 "RBA_RESET_CPU1_TRAP_SYSBUSERR_DIE_IE_BI_DAM_E" 24925 "RBA_RESET_CPU1_TRAP_SYSBUSERR_DIE_IE_UNC_DAM_E" 24926 "RBA_RESET_CPU1_TRAP_SYSBUSERR_DIE_IE_SP_DAM_E" 24927 "RBA_RESET_CPU1_TRAP_SYSBUSERR_DIE_IE_BS_DAM_E" 24928 "RBA_RESET_CPU1_TRAP_SYSBUSERR_DIE_IED_CERBERUS_BBB_E" 24929 "RBA_RESET_CPU1_TRAP_SYSBUSERR_DIE_IE_T_CERBERUS_BBB_E" 24930 "RBA_RESET_CPU1_TRAP_SYSBUSERR_DIE_IE_C_CERBERUS_BBB_E" 24931 "RBA_RESET_CPU1_TRAP_SYSBUSERR_DIE_IE_S_CERBERUS_BBB_E" 24932 "RBA_RESET_CPU1_TRAP_SYSBUSERR_DIE_IE_BI_CERBERUS_BBB_E" 24933 "RBA_RESET_CPU1_TRAP_SYSBUSERR_DIE_IE_UNC_CERBERUS_BBB_E" 24934 "RBA_RESET_CPU1_TRAP_SYSBUSERR_DIE_IE_SP_CERBERUS_BBB_E" 24935 "RBA_RESET_CPU1_TRAP_SYSBUSERR_DIE_IE_BS_CERBERUS_BBB_E" 24936 "RBA_RESET_CPU1_TRAP_SYSBUSERR_DIE_IED_EMEM_MASTER_BBB_E" 24937 "RBA_RESET_CPU1_TRAP_SYSBUSERR_DIE_IE_T_EMEM_MASTER_BBB_E" 24938 "RBA_RESET_CPU1_TRAP_SYSBUSERR_DIE_IE_C_EMEM_MASTER_BBB_E" 24939 "RBA_RESET_CPU1_TRAP_SYSBUSERR_DIE_IE_S_EMEM_MASTER_BBB_E" 24940 "RBA_RESET_CPU1_TRAP_SYSBUSERR_DIE_IE_BI_EMEM_MASTER_BBB_E" 24941 "RBA_RESET_CPU1_TRAP_SYSBUSERR_DIE_IE_UNC_EMEM_MASTER_BBB_E" 24942 "RBA_RESET_CPU1_TRAP_SYSBUSERR_DIE_IE_SP_EMEM_MASTER_BBB_E" 24943 "RBA_RESET_CPU1_TRAP_SYSBUSERR_DIE_IE_BS_EMEM_MASTER_BBB_E" 24944 "RBA_RESET_CPU1_TRAP_SYSBUSERR_DIE_IED_CIF_MASTER_BBB_E" 24945 "RBA_RESET_CPU1_TRAP_SYSBUSERR_DIE_IE_T_CIF_MASTER_BBB_E" 24946 "RBA_RESET_CPU1_TRAP_SYSBUSERR_DIE_IE_C_CIF_MASTER_BBB_E" 24947 "RBA_RESET_CPU1_TRAP_SYSBUSERR_DIE_IE_S_CIF_MASTER_BBB_E" 24948 "RBA_RESET_CPU1_TRAP_SYSBUSERR_DIE_IE_BI_CIF_MASTER_BBB_E" 24949 "RBA_RESET_CPU1_TRAP_SYSBUSERR_DIE_IE_UNC_CIF_MASTER_BBB_E" 24950 "RBA_RESET_CPU1_TRAP_SYSBUSERR_DIE_IE_SP_CIF_MASTER_BBB_E" 24951 "RBA_RESET_CPU1_TRAP_SYSBUSERR_DIE_IE_BS_CIF_MASTER_BBB_E" 24952 "RBA_RESET_CPU1_TRAP_TCN4_UNKNOWN_E" 24953 "RBA_RESET_CPU1_TRAP_TCN5_TIN0_E" 24954 "RBA_RESET_CPU1_TRAP_ASSTRAP_OVF_E" 24955 "RBA_RESET_CPU1_TRAP_ASSTRAP_SOVF_E" 24956 "RBA_RESET_CPU1_TRAP_TCN5_UNKNOWN_E" 24957 "RBA_RESET_CPU1_TRAP_SYSCALL_SYS_E" 24958 "RBA_RESET_CPU1_TRAP_NMI_UNKNOWN_E" 24959 "RBA_RESET_CPU1_TRAP_NMI_ESR0_E" 24960 "RBA_RESET_CPU1_TRAP_NMI_ESR1_E" 24961 "RBA_RESET_CPU1_TRAP_NMI_SMUT_E" 24962 "RBA_RESET_CPU1_TRAP_NMI_SMU_CPU0_MPU_E" 24963 "RBA_RESET_CPU1_TRAP_NMI_SMU_CPU1_MPU_E" 24964 "RBA_RESET_CPU1_TRAP_NMI_SMU_CPU2_MPU_E" 24965 "RBA_RESET_CPU1_TRAP_NMI_SMU_IR_E" 24966 "RBA_RESET_CPU1_TRAP_NMI_SMU_CGU_WDT_E" 24967 "RBA_RESET_CPU1_TRAP_NMI_SMU_CGU_PLLLOL_E" 24968 "RBA_RESET_CPU1_TRAP_NMI_SMU_CGU_PLLERAYLOL_E" 24969 "RBA_RESET_CPU1_TRAP_NMI_SMU_CGU_STM_E" 24970 "RBA_RESET_CPU1_TRAP_NMI_SMU_CGU_PLLERAY_E" 24971 "RBA_RESET_CPU1_TRAP_NMI_SMU_CGU_PLL_E" 24972 "RBA_RESET_CPU1_TRAP_NMI_SMU_CGU_SRI_E" 24973 "RBA_RESET_CPU1_TRAP_NMI_SMU_CGU_SPB_E" 24974 "RBA_RESET_CPU1_TRAP_NMI_SMU_CGU_CPU0_E" 24975 "RBA_RESET_CPU1_TRAP_NMI_SMU_SCUEVR_12UV_E" 24976 "RBA_RESET_CPU1_TRAP_NMI_SMU_SCUEVR_12OV_E" 24977 "RBA_RESET_CPU1_TRAP_NMI_SMU_SCUEVR_33UV_E" 24978 "RBA_RESET_CPU1_TRAP_NMI_SMU_SCUEVR_33OV_E" 24979 "RBA_RESET_CPU1_TRAP_NMI_SMU_SCUEVR_5UV_E" 24980 "RBA_RESET_CPU1_TRAP_NMI_SMU_SCUEVR_5OV_E" 24981 "RBA_RESET_CPU1_TRAP_NMI_SMU_SWDT_E" 24982 "RBA_RESET_CPU1_TRAP_NMI_SMU_WDT0_E" 24983 "RBA_RESET_CPU1_TRAP_NMI_SMU_WDT1_E" 24984 "RBA_RESET_CPU1_TRAP_NMI_SMU_WDT2_E" 24985 "RBA_RESET_CPU1_TRAP_NMI_SMU_WDT3_E" 24986 "RBA_RESET_CPU1_TRAP_NMI_SMU_WDT4_E" 24987 "RBA_RESET_CPU1_TRAP_NMI_SMU_WDT5_E" 24988 "RBA_RESET_CPU1_TRAP_TCN7_UNKNOWN_E" 28672 "RBA_RESET_CPU2_TRAP_MMU_VAF_E" 28673 "RBA_RESET_CPU2_TRAP_MMU_VAP_E" 28674 "RBA_RESET_CPU2_TRAP_TCN0_UNKNOWN_E" 28675 "RBA_RESET_CPU2_TRAP_TCN1_TIN0_E" 28676 "RBA_RESET_CPU2_TRAP_INTPROT_PRIV_E" 28677 "RBA_RESET_CPU2_TRAP_INTPROT_MPR_E" 28678 "RBA_RESET_CPU2_TRAP_INTPROT_MPW_E" 28679 "RBA_RESET_CPU2_TRAP_INTPROT_MPX_E" 28680 "RBA_RESET_CPU2_TRAP_INTPROT_MPP_E" 28681 "RBA_RESET_CPU2_TRAP_INTPROT_MPN_E" 28682 "RBA_RESET_CPU2_TRAP_INTPROT_GRWP_E" 28683 "RBA_RESET_CPU2_TRAP_TCN1_UNKNOWN_E" 28684 "RBA_RESET_CPU2_TRAP_TCN2_TIN0_E" 28685 "RBA_RESET_CPU2_TRAP_INSTRERR_IOPC_E" 28686 "RBA_RESET_CPU2_TRAP_INSTRERR_UOPC_E" 28687 "RBA_RESET_CPU2_TRAP_INSTRERR_OPD_E" 28688 "RBA_RESET_CPU2_TRAP_INSTRERR_ALN_E" 28689 "RBA_RESET_CPU2_TRAP_INSTRERR_MEM_E" 28690 "RBA_RESET_CPU2_TRAP_TCN2_UNKNOWN_E" 28691 "RBA_RESET_CPU2_TRAP_TCN3_TIN0_E" 28692 "RBA_RESET_CPU2_TRAP_CONTMANA_FCD_E" 28693 "RBA_RESET_CPU2_TRAP_CONTMANA_CDO_E" 28694 "RBA_RESET_CPU2_TRAP_CONTMANA_CDU_E" 28695 "RBA_RESET_CPU2_TRAP_CONTMANA_FCU_E" 28696 "RBA_RESET_CPU2_TRAP_CONTMANA_CSU_E" 28697 "RBA_RESET_CPU2_TRAP_CONTMANA_CTYP_E" 28698 "RBA_RESET_CPU2_TRAP_CONTMANA_NEST_E" 28699 "RBA_RESET_CPU2_TRAP_TCN3_UNKNOWN_E" 28700 "RBA_RESET_CPU2_TRAP_TCN4_TIN0_E" 28701 "RBA_RESET_CPU2_TRAP_SYSBUSERR_PSE_E" 28702 "RBA_RESET_CPU2_TRAP_SYSBUSERR_DSE_E" 28703 "RBA_RESET_CPU2_TRAP_SYSBUSERR_DAE_E" 28704 "RBA_RESET_CPU2_TRAP_SYSBUSERR_CAE_E" 28705 "RBA_RESET_CPU2_TRAP_FPU_INEXACT_E" 28706 "RBA_RESET_CPU2_TRAP_FPU_UNRFLW_E" 28707 "RBA_RESET_CPU2_TRAP_FPU_DIVZRO_E" 28708 "RBA_RESET_CPU2_TRAP_FPU_OVRFLW_E" 28709 "RBA_RESET_CPU2_TRAP_FPU_INVOPR_E" 28710 "RBA_RESET_CPU2_TRAP_SYSBUSERR_PIE_UNKNOWN_E" 28711 "RBA_RESET_CPU2_TRAP_SYSBUSERR_PIE_IED_CPU0_DMI_NONESAFE_E" 28712 "RBA_RESET_CPU2_TRAP_SYSBUSERR_PIE_IE_T_CPU0_DMI_NONESAFE_E" 28713 "RBA_RESET_CPU2_TRAP_SYSBUSERR_PIE_IE_C_CPU0_DMI_NONESAFE_E" 28714 "RBA_RESET_CPU2_TRAP_SYSBUSERR_PIE_IE_S_CPU0_DMI_NONESAFE_E" 28715 "RBA_RESET_CPU2_TRAP_SYSBUSERR_PIE_IE_BI_CPU0_DMI_NONESAFE_E" 28716 "RBA_RESET_CPU2_TRAP_SYSBUSERR_PIE_IE_UNC_CPU0_DMI_NONESAFE_E" 28717 "RBA_RESET_CPU2_TRAP_SYSBUSERR_PIE_IE_SP_CPU0_DMI_NONESAFE_E" 28718 "RBA_RESET_CPU2_TRAP_SYSBUSERR_PIE_IE_BS_CPU0_DMI_NONESAFE_E" 28719 "RBA_RESET_CPU2_TRAP_SYSBUSERR_PIE_IED_CPU0_DMI_SAFE_E" 28720 "RBA_RESET_CPU2_TRAP_SYSBUSERR_PIE_IE_T_CPU0_DMI_SAFE_E" 28721 "RBA_RESET_CPU2_TRAP_SYSBUSERR_PIE_IE_C_CPU0_DMI_SAFE_E" 28722 "RBA_RESET_CPU2_TRAP_SYSBUSERR_PIE_IE_S_CPU0_DMI_SAFE_E" 28723 "RBA_RESET_CPU2_TRAP_SYSBUSERR_PIE_IE_BI_CPU0_DMI_SAFE_E" 28724 "RBA_RESET_CPU2_TRAP_SYSBUSERR_PIE_IE_UNC_CPU0_DMI_SAFE_E" 28725 "RBA_RESET_CPU2_TRAP_SYSBUSERR_PIE_IE_SP_CPU0_DMI_SAFE_E" 28726 "RBA_RESET_CPU2_TRAP_SYSBUSERR_PIE_IE_BS_CPU0_DMI_SAFE_E" 28727 "RBA_RESET_CPU2_TRAP_SYSBUSERR_PIE_IED_CPU1_DMI_NONESAFE_E" 28728 "RBA_RESET_CPU2_TRAP_SYSBUSERR_PIE_IE_T_CPU1_DMI_NONESAFE_E" 28729 "RBA_RESET_CPU2_TRAP_SYSBUSERR_PIE_IE_C_CPU1_DMI_NONESAFE_E" 28730 "RBA_RESET_CPU2_TRAP_SYSBUSERR_PIE_IE_S_CPU1_DMI_NONESAFE_E" 28731 "RBA_RESET_CPU2_TRAP_SYSBUSERR_PIE_IE_BI_CPU1_DMI_NONESAFE_E" 28732 "RBA_RESET_CPU2_TRAP_SYSBUSERR_PIE_IE_UNC_CPU1_DMI_NONESAFE_E" 28733 "RBA_RESET_CPU2_TRAP_SYSBUSERR_PIE_IE_SP_CPU1_DMI_NONESAFE_E" 28734 "RBA_RESET_CPU2_TRAP_SYSBUSERR_PIE_IE_BS_CPU1_DMI_NONESAFE_E" 28735 "RBA_RESET_CPU2_TRAP_SYSBUSERR_PIE_IED_CPU1_DMI_SAFE_E" 28736 "RBA_RESET_CPU2_TRAP_SYSBUSERR_PIE_IE_T_CPU1_DMI_SAFE_E" 28737 "RBA_RESET_CPU2_TRAP_SYSBUSERR_PIE_IE_C_CPU1_DMI_SAFE_E" 28738 "RBA_RESET_CPU2_TRAP_SYSBUSERR_PIE_IE_S_CPU1_DMI_SAFE_E" 28739 "RBA_RESET_CPU2_TRAP_SYSBUSERR_PIE_IE_BI_CPU1_DMI_SAFE_E" 28740 "RBA_RESET_CPU2_TRAP_SYSBUSERR_PIE_IE_UNC_CPU1_DMI_SAFE_E" 28741 "RBA_RESET_CPU2_TRAP_SYSBUSERR_PIE_IE_SP_CPU1_DMI_SAFE_E" 28742 "RBA_RESET_CPU2_TRAP_SYSBUSERR_PIE_IE_BS_CPU1_DMI_SAFE_E" 28743 "RBA_RESET_CPU2_TRAP_SYSBUSERR_PIE_IED_CPU2_DMI_NONESAFE_E" 28744 "RBA_RESET_CPU2_TRAP_SYSBUSERR_PIE_IE_T_CPU2_DMI_NONESAFE_E" 28745 "RBA_RESET_CPU2_TRAP_SYSBUSERR_PIE_IE_C_CPU2_DMI_NONESAFE_E" 28746 "RBA_RESET_CPU2_TRAP_SYSBUSERR_PIE_IE_S_CPU2_DMI_NONESAFE_E" 28747 "RBA_RESET_CPU2_TRAP_SYSBUSERR_PIE_IE_BI_CPU2_DMI_NONESAFE_E" 28748 "RBA_RESET_CPU2_TRAP_SYSBUSERR_PIE_IE_UNC_CPU2_DMI_NONESAFE_E" 28749 "RBA_RESET_CPU2_TRAP_SYSBUSERR_PIE_IE_SP_CPU2_DMI_NONESAFE_E" 28750 "RBA_RESET_CPU2_TRAP_SYSBUSERR_PIE_IE_BS_CPU2_DMI_NONESAFE_E" 28751 "RBA_RESET_CPU2_TRAP_SYSBUSERR_PIE_IED_CPU2_DMI_SAFE_E" 28752 "RBA_RESET_CPU2_TRAP_SYSBUSERR_PIE_IE_T_CPU2_DMI_SAFE_E" 28753 "RBA_RESET_CPU2_TRAP_SYSBUSERR_PIE_IE_C_CPU2_DMI_SAFE_E" 28754 "RBA_RESET_CPU2_TRAP_SYSBUSERR_PIE_IE_S_CPU2_DMI_SAFE_E" 28755 "RBA_RESET_CPU2_TRAP_SYSBUSERR_PIE_IE_BI_CPU2_DMI_SAFE_E" 28756 "RBA_RESET_CPU2_TRAP_SYSBUSERR_PIE_IE_UNC_CPU2_DMI_SAFE_E" 28757 "RBA_RESET_CPU2_TRAP_SYSBUSERR_PIE_IE_SP_CPU2_DMI_SAFE_E" 28758 "RBA_RESET_CPU2_TRAP_SYSBUSERR_PIE_IE_BS_CPU2_DMI_SAFE_E" 28759 "RBA_RESET_CPU2_TRAP_SYSBUSERR_PIE_IED_DMA_PARTITION_0_E" 28760 "RBA_RESET_CPU2_TRAP_SYSBUSERR_PIE_IE_T_DMA_PARTITION_0_E" 28761 "RBA_RESET_CPU2_TRAP_SYSBUSERR_PIE_IE_C_DMA_PARTITION_0_E" 28762 "RBA_RESET_CPU2_TRAP_SYSBUSERR_PIE_IE_S_DMA_PARTITION_0_E" 28763 "RBA_RESET_CPU2_TRAP_SYSBUSERR_PIE_IE_BI_DMA_PARTITION_0_E" 28764 "RBA_RESET_CPU2_TRAP_SYSBUSERR_PIE_IE_UNC_DMA_PARTITION_0_E" 28765 "RBA_RESET_CPU2_TRAP_SYSBUSERR_PIE_IE_SP_DMA_PARTITION_0_E" 28766 "RBA_RESET_CPU2_TRAP_SYSBUSERR_PIE_IE_BS_DMA_PARTITION_0_E" 28767 "RBA_RESET_CPU2_TRAP_SYSBUSERR_PIE_IED_DMA_PARTITION_1_E" 28768 "RBA_RESET_CPU2_TRAP_SYSBUSERR_PIE_IE_T_DMA_PARTITION_1_E" 28769 "RBA_RESET_CPU2_TRAP_SYSBUSERR_PIE_IE_C_DMA_PARTITION_1_E" 28770 "RBA_RESET_CPU2_TRAP_SYSBUSERR_PIE_IE_S_DMA_PARTITION_1_E" 28771 "RBA_RESET_CPU2_TRAP_SYSBUSERR_PIE_IE_BI_DMA_PARTITION_1_E" 28772 "RBA_RESET_CPU2_TRAP_SYSBUSERR_PIE_IE_UNC_DMA_PARTITION_1_E" 28773 "RBA_RESET_CPU2_TRAP_SYSBUSERR_PIE_IE_SP_DMA_PARTITION_1_E" 28774 "RBA_RESET_CPU2_TRAP_SYSBUSERR_PIE_IE_BS_DMA_PARTITION_1_E" 28775 "RBA_RESET_CPU2_TRAP_SYSBUSERR_PIE_IED_DMA_PARTITION_2_E" 28776 "RBA_RESET_CPU2_TRAP_SYSBUSERR_PIE_IE_T_DMA_PARTITION_2_E" 28777 "RBA_RESET_CPU2_TRAP_SYSBUSERR_PIE_IE_C_DMA_PARTITION_2_E" 28778 "RBA_RESET_CPU2_TRAP_SYSBUSERR_PIE_IE_S_DMA_PARTITION_2_E" 28779 "RBA_RESET_CPU2_TRAP_SYSBUSERR_PIE_IE_BI_DMA_PARTITION_2_E" 28780 "RBA_RESET_CPU2_TRAP_SYSBUSERR_PIE_IE_UNC_DMA_PARTITION_2_E" 28781 "RBA_RESET_CPU2_TRAP_SYSBUSERR_PIE_IE_SP_DMA_PARTITION_2_E" 28782 "RBA_RESET_CPU2_TRAP_SYSBUSERR_PIE_IE_BS_DMA_PARTITION_2_E" 28783 "RBA_RESET_CPU2_TRAP_SYSBUSERR_PIE_IED_DMA_PARTITION_3_E" 28784 "RBA_RESET_CPU2_TRAP_SYSBUSERR_PIE_IE_T_DMA_PARTITION_3_E" 28785 "RBA_RESET_CPU2_TRAP_SYSBUSERR_PIE_IE_C_DMA_PARTITION_3_E" 28786 "RBA_RESET_CPU2_TRAP_SYSBUSERR_PIE_IE_S_DMA_PARTITION_3_E" 28787 "RBA_RESET_CPU2_TRAP_SYSBUSERR_PIE_IE_BI_DMA_PARTITION_3_E" 28788 "RBA_RESET_CPU2_TRAP_SYSBUSERR_PIE_IE_UNC_DMA_PARTITION_3_E" 28789 "RBA_RESET_CPU2_TRAP_SYSBUSERR_PIE_IE_SP_DMA_PARTITION_3_E" 28790 "RBA_RESET_CPU2_TRAP_SYSBUSERR_PIE_IE_BS_DMA_PARTITION_3_E" 28791 "RBA_RESET_CPU2_TRAP_SYSBUSERR_PIE_IED_DMA_CERBERUS_E" 28792 "RBA_RESET_CPU2_TRAP_SYSBUSERR_PIE_IE_T_DMA_CERBERUS_E" 28793 "RBA_RESET_CPU2_TRAP_SYSBUSERR_PIE_IE_C_DMA_CERBERUS_E" 28794 "RBA_RESET_CPU2_TRAP_SYSBUSERR_PIE_IE_S_DMA_CERBERUS_E" 28795 "RBA_RESET_CPU2_TRAP_SYSBUSERR_PIE_IE_BI_DMA_CERBERUS_E" 28796 "RBA_RESET_CPU2_TRAP_SYSBUSERR_PIE_IE_UNC_DMA_CERBERUS_E" 28797 "RBA_RESET_CPU2_TRAP_SYSBUSERR_PIE_IE_SP_DMA_CERBERUS_E" 28798 "RBA_RESET_CPU2_TRAP_SYSBUSERR_PIE_IE_BS_DMA_CERBERUS_E" 28799 "RBA_RESET_CPU2_TRAP_SYSBUSERR_PIE_IED_HSSL_E" 28800 "RBA_RESET_CPU2_TRAP_SYSBUSERR_PIE_IE_T_HSSL_E" 28801 "RBA_RESET_CPU2_TRAP_SYSBUSERR_PIE_IE_C_HSSL_E" 28802 "RBA_RESET_CPU2_TRAP_SYSBUSERR_PIE_IE_S_HSSL_E" 28803 "RBA_RESET_CPU2_TRAP_SYSBUSERR_PIE_IE_BI_HSSL_E" 28804 "RBA_RESET_CPU2_TRAP_SYSBUSERR_PIE_IE_UNC_HSSL_E" 28805 "RBA_RESET_CPU2_TRAP_SYSBUSERR_PIE_IE_SP_HSSL_E" 28806 "RBA_RESET_CPU2_TRAP_SYSBUSERR_PIE_IE_BS_HSSL_E" 28807 "RBA_RESET_CPU2_TRAP_SYSBUSERR_PIE_IED_ETHERNET_E" 28808 "RBA_RESET_CPU2_TRAP_SYSBUSERR_PIE_IE_T_ETHERNET_E" 28809 "RBA_RESET_CPU2_TRAP_SYSBUSERR_PIE_IE_C_ETHERNET_E" 28810 "RBA_RESET_CPU2_TRAP_SYSBUSERR_PIE_IE_S_ETHERNET_E" 28811 "RBA_RESET_CPU2_TRAP_SYSBUSERR_PIE_IE_BI_ETHERNET_E" 28812 "RBA_RESET_CPU2_TRAP_SYSBUSERR_PIE_IE_UNC_ETHERNET_E" 28813 "RBA_RESET_CPU2_TRAP_SYSBUSERR_PIE_IE_SP_ETHERNET_E" 28814 "RBA_RESET_CPU2_TRAP_SYSBUSERR_PIE_IE_BS_ETHERNET_E" 28815 "RBA_RESET_CPU2_TRAP_SYSBUSERR_PIE_IED_HSM_HSMCMI_E" 28816 "RBA_RESET_CPU2_TRAP_SYSBUSERR_PIE_IE_T_HSM_HSMCMI_E" 28817 "RBA_RESET_CPU2_TRAP_SYSBUSERR_PIE_IE_C_HSM_HSMCMI_E" 28818 "RBA_RESET_CPU2_TRAP_SYSBUSERR_PIE_IE_S_HSM_HSMCMI_E" 28819 "RBA_RESET_CPU2_TRAP_SYSBUSERR_PIE_IE_BI_HSM_HSMCMI_E" 28820 "RBA_RESET_CPU2_TRAP_SYSBUSERR_PIE_IE_UNC_HSM_HSMCMI_E" 28821 "RBA_RESET_CPU2_TRAP_SYSBUSERR_PIE_IE_SP_HSM_HSMCMI_E" 28822 "RBA_RESET_CPU2_TRAP_SYSBUSERR_PIE_IE_BS_HSM_HSMCMI_E" 28823 "RBA_RESET_CPU2_TRAP_SYSBUSERR_PIE_IED_CPU0_PMI_E" 28824 "RBA_RESET_CPU2_TRAP_SYSBUSERR_PIE_IE_T_CPU0_PMI_E" 28825 "RBA_RESET_CPU2_TRAP_SYSBUSERR_PIE_IE_C_CPU0_PMI_E" 28826 "RBA_RESET_CPU2_TRAP_SYSBUSERR_PIE_IE_S_CPU0_PMI_E" 28827 "RBA_RESET_CPU2_TRAP_SYSBUSERR_PIE_IE_BI_CPU0_PMI_E" 28828 "RBA_RESET_CPU2_TRAP_SYSBUSERR_PIE_IE_UNC_CPU0_PMI_E" 28829 "RBA_RESET_CPU2_TRAP_SYSBUSERR_PIE_IE_SP_CPU0_PMI_E" 28830 "RBA_RESET_CPU2_TRAP_SYSBUSERR_PIE_IE_BS_CPU0_PMI_E" 28831 "RBA_RESET_CPU2_TRAP_SYSBUSERR_PIE_IED_CPU1_PMI_E" 28832 "RBA_RESET_CPU2_TRAP_SYSBUSERR_PIE_IE_T_CPU1_PMI_E" 28833 "RBA_RESET_CPU2_TRAP_SYSBUSERR_PIE_IE_C_CPU1_PMI_E" 28834 "RBA_RESET_CPU2_TRAP_SYSBUSERR_PIE_IE_S_CPU1_PMI_E" 28835 "RBA_RESET_CPU2_TRAP_SYSBUSERR_PIE_IE_BI_CPU1_PMI_E" 28836 "RBA_RESET_CPU2_TRAP_SYSBUSERR_PIE_IE_UNC_CPU1_PMI_E" 28837 "RBA_RESET_CPU2_TRAP_SYSBUSERR_PIE_IE_SP_CPU1_PMI_E" 28838 "RBA_RESET_CPU2_TRAP_SYSBUSERR_PIE_IE_BS_CPU1_PMI_E" 28839 "RBA_RESET_CPU2_TRAP_SYSBUSERR_PIE_IED_CPU2_PMI_E" 28840 "RBA_RESET_CPU2_TRAP_SYSBUSERR_PIE_IE_T_CPU2_PMI_E" 28841 "RBA_RESET_CPU2_TRAP_SYSBUSERR_PIE_IE_C_CPU2_PMI_E" 28842 "RBA_RESET_CPU2_TRAP_SYSBUSERR_PIE_IE_S_CPU2_PMI_E" 28843 "RBA_RESET_CPU2_TRAP_SYSBUSERR_PIE_IE_BI_CPU2_PMI_E" 28844 "RBA_RESET_CPU2_TRAP_SYSBUSERR_PIE_IE_UNC_CPU2_PMI_E" 28845 "RBA_RESET_CPU2_TRAP_SYSBUSERR_PIE_IE_SP_CPU2_PMI_E" 28846 "RBA_RESET_CPU2_TRAP_SYSBUSERR_PIE_IE_BS_CPU2_PMI_E" 28847 "RBA_RESET_CPU2_TRAP_SYSBUSERR_PIE_IED_DAM_E" 28848 "RBA_RESET_CPU2_TRAP_SYSBUSERR_PIE_IE_T_DAM_E" 28849 "RBA_RESET_CPU2_TRAP_SYSBUSERR_PIE_IE_C_DAM_E" 28850 "RBA_RESET_CPU2_TRAP_SYSBUSERR_PIE_IE_S_DAM_E" 28851 "RBA_RESET_CPU2_TRAP_SYSBUSERR_PIE_IE_BI_DAM_E" 28852 "RBA_RESET_CPU2_TRAP_SYSBUSERR_PIE_IE_UNC_DAM_E" 28853 "RBA_RESET_CPU2_TRAP_SYSBUSERR_PIE_IE_SP_DAM_E" 28854 "RBA_RESET_CPU2_TRAP_SYSBUSERR_PIE_IE_BS_DAM_E" 28855 "RBA_RESET_CPU2_TRAP_SYSBUSERR_PIE_IED_CERBERUS_BBB_E" 28856 "RBA_RESET_CPU2_TRAP_SYSBUSERR_PIE_IE_T_CERBERUS_BBB_E" 28857 "RBA_RESET_CPU2_TRAP_SYSBUSERR_PIE_IE_C_CERBERUS_BBB_E" 28858 "RBA_RESET_CPU2_TRAP_SYSBUSERR_PIE_IE_S_CERBERUS_BBB_E" 28859 "RBA_RESET_CPU2_TRAP_SYSBUSERR_PIE_IE_BI_CERBERUS_BBB_E" 28860 "RBA_RESET_CPU2_TRAP_SYSBUSERR_PIE_IE_UNC_CERBERUS_BBB_E" 28861 "RBA_RESET_CPU2_TRAP_SYSBUSERR_PIE_IE_SP_CERBERUS_BBB_E" 28862 "RBA_RESET_CPU2_TRAP_SYSBUSERR_PIE_IE_BS_CERBERUS_BBB_E" 28863 "RBA_RESET_CPU2_TRAP_SYSBUSERR_PIE_IED_EMEM_MASTER_BBB_E" 28864 "RBA_RESET_CPU2_TRAP_SYSBUSERR_PIE_IE_T_EMEM_MASTER_BBB_E" 28865 "RBA_RESET_CPU2_TRAP_SYSBUSERR_PIE_IE_C_EMEM_MASTER_BBB_E" 28866 "RBA_RESET_CPU2_TRAP_SYSBUSERR_PIE_IE_S_EMEM_MASTER_BBB_E" 28867 "RBA_RESET_CPU2_TRAP_SYSBUSERR_PIE_IE_BI_EMEM_MASTER_BBB_E" 28868 "RBA_RESET_CPU2_TRAP_SYSBUSERR_PIE_IE_UNC_EMEM_MASTER_BBB_E" 28869 "RBA_RESET_CPU2_TRAP_SYSBUSERR_PIE_IE_SP_EMEM_MASTER_BBB_E" 28870 "RBA_RESET_CPU2_TRAP_SYSBUSERR_PIE_IE_BS_EMEM_MASTER_BBB_E" 28871 "RBA_RESET_CPU2_TRAP_SYSBUSERR_PIE_IED_CIF_MASTER_BBB_E" 28872 "RBA_RESET_CPU2_TRAP_SYSBUSERR_PIE_IE_T_CIF_MASTER_BBB_E" 28873 "RBA_RESET_CPU2_TRAP_SYSBUSERR_PIE_IE_C_CIF_MASTER_BBB_E" 28874 "RBA_RESET_CPU2_TRAP_SYSBUSERR_PIE_IE_S_CIF_MASTER_BBB_E" 28875 "RBA_RESET_CPU2_TRAP_SYSBUSERR_PIE_IE_BI_CIF_MASTER_BBB_E" 28876 "RBA_RESET_CPU2_TRAP_SYSBUSERR_PIE_IE_UNC_CIF_MASTER_BBB_E" 28877 "RBA_RESET_CPU2_TRAP_SYSBUSERR_PIE_IE_SP_CIF_MASTER_BBB_E" 28878 "RBA_RESET_CPU2_TRAP_SYSBUSERR_PIE_IE_BS_CIF_MASTER_BBB_E" 28879 "RBA_RESET_CPU2_TRAP_SYSBUSERR_DIE_UNKNOWN_E" 28880 "RBA_RESET_CPU2_TRAP_SYSBUSERR_DIE_IED_CPU0_DMI_NONESAFE_E" 28881 "RBA_RESET_CPU2_TRAP_SYSBUSERR_DIE_IE_T_CPU0_DMI_NONESAFE_E" 28882 "RBA_RESET_CPU2_TRAP_SYSBUSERR_DIE_IE_C_CPU0_DMI_NONESAFE_E" 28883 "RBA_RESET_CPU2_TRAP_SYSBUSERR_DIE_IE_S_CPU0_DMI_NONESAFE_E" 28884 "RBA_RESET_CPU2_TRAP_SYSBUSERR_DIE_IE_BI_CPU0_DMI_NONESAFE_E" 28885 "RBA_RESET_CPU2_TRAP_SYSBUSERR_DIE_IE_UNC_CPU0_DMI_NONESAFE_E" 28886 "RBA_RESET_CPU2_TRAP_SYSBUSERR_DIE_IE_SP_CPU0_DMI_NONESAFE_E" 28887 "RBA_RESET_CPU2_TRAP_SYSBUSERR_DIE_IE_BS_CPU0_DMI_NONESAFE_E" 28888 "RBA_RESET_CPU2_TRAP_SYSBUSERR_DIE_IED_CPU0_DMI_SAFE_E" 28889 "RBA_RESET_CPU2_TRAP_SYSBUSERR_DIE_IE_T_CPU0_DMI_SAFE_E" 28890 "RBA_RESET_CPU2_TRAP_SYSBUSERR_DIE_IE_C_CPU0_DMI_SAFE_E" 28891 "RBA_RESET_CPU2_TRAP_SYSBUSERR_DIE_IE_S_CPU0_DMI_SAFE_E" 28892 "RBA_RESET_CPU2_TRAP_SYSBUSERR_DIE_IE_BI_CPU0_DMI_SAFE_E" 28893 "RBA_RESET_CPU2_TRAP_SYSBUSERR_DIE_IE_UNC_CPU0_DMI_SAFE_E" 28894 "RBA_RESET_CPU2_TRAP_SYSBUSERR_DIE_IE_SP_CPU0_DMI_SAFE_E" 28895 "RBA_RESET_CPU2_TRAP_SYSBUSERR_DIE_IE_BS_CPU0_DMI_SAFE_E" 28896 "RBA_RESET_CPU2_TRAP_SYSBUSERR_DIE_IED_CPU1_DMI_NONESAFE_E" 28897 "RBA_RESET_CPU2_TRAP_SYSBUSERR_DIE_IE_T_CPU1_DMI_NONESAFE_E" 28898 "RBA_RESET_CPU2_TRAP_SYSBUSERR_DIE_IE_C_CPU1_DMI_NONESAFE_E" 28899 "RBA_RESET_CPU2_TRAP_SYSBUSERR_DIE_IE_S_CPU1_DMI_NONESAFE_E" 28900 "RBA_RESET_CPU2_TRAP_SYSBUSERR_DIE_IE_BI_CPU1_DMI_NONESAFE_E" 28901 "RBA_RESET_CPU2_TRAP_SYSBUSERR_DIE_IE_UNC_CPU1_DMI_NONESAFE_E" 28902 "RBA_RESET_CPU2_TRAP_SYSBUSERR_DIE_IE_SP_CPU1_DMI_NONESAFE_E" 28903 "RBA_RESET_CPU2_TRAP_SYSBUSERR_DIE_IE_BS_CPU1_DMI_NONESAFE_E" 28904 "RBA_RESET_CPU2_TRAP_SYSBUSERR_DIE_IED_CPU1_DMI_SAFE_E" 28905 "RBA_RESET_CPU2_TRAP_SYSBUSERR_DIE_IE_T_CPU1_DMI_SAFE_E" 28906 "RBA_RESET_CPU2_TRAP_SYSBUSERR_DIE_IE_C_CPU1_DMI_SAFE_E" 28907 "RBA_RESET_CPU2_TRAP_SYSBUSERR_DIE_IE_S_CPU1_DMI_SAFE_E" 28908 "RBA_RESET_CPU2_TRAP_SYSBUSERR_DIE_IE_BI_CPU1_DMI_SAFE_E" 28909 "RBA_RESET_CPU2_TRAP_SYSBUSERR_DIE_IE_UNC_CPU1_DMI_SAFE_E" 28910 "RBA_RESET_CPU2_TRAP_SYSBUSERR_DIE_IE_SP_CPU1_DMI_SAFE_E" 28911 "RBA_RESET_CPU2_TRAP_SYSBUSERR_DIE_IE_BS_CPU1_DMI_SAFE_E" 28912 "RBA_RESET_CPU2_TRAP_SYSBUSERR_DIE_IED_CPU2_DMI_NONESAFE_E" 28913 "RBA_RESET_CPU2_TRAP_SYSBUSERR_DIE_IE_T_CPU2_DMI_NONESAFE_E" 28914 "RBA_RESET_CPU2_TRAP_SYSBUSERR_DIE_IE_C_CPU2_DMI_NONESAFE_E" 28915 "RBA_RESET_CPU2_TRAP_SYSBUSERR_DIE_IE_S_CPU2_DMI_NONESAFE_E" 28916 "RBA_RESET_CPU2_TRAP_SYSBUSERR_DIE_IE_BI_CPU2_DMI_NONESAFE_E" 28917 "RBA_RESET_CPU2_TRAP_SYSBUSERR_DIE_IE_UNC_CPU2_DMI_NONESAFE_E" 28918 "RBA_RESET_CPU2_TRAP_SYSBUSERR_DIE_IE_SP_CPU2_DMI_NONESAFE_E" 28919 "RBA_RESET_CPU2_TRAP_SYSBUSERR_DIE_IE_BS_CPU2_DMI_NONESAFE_E" 28920 "RBA_RESET_CPU2_TRAP_SYSBUSERR_DIE_IED_CPU2_DMI_SAFE_E" 28921 "RBA_RESET_CPU2_TRAP_SYSBUSERR_DIE_IE_T_CPU2_DMI_SAFE_E" 28922 "RBA_RESET_CPU2_TRAP_SYSBUSERR_DIE_IE_C_CPU2_DMI_SAFE_E" 28923 "RBA_RESET_CPU2_TRAP_SYSBUSERR_DIE_IE_S_CPU2_DMI_SAFE_E" 28924 "RBA_RESET_CPU2_TRAP_SYSBUSERR_DIE_IE_BI_CPU2_DMI_SAFE_E" 28925 "RBA_RESET_CPU2_TRAP_SYSBUSERR_DIE_IE_UNC_CPU2_DMI_SAFE_E" 28926 "RBA_RESET_CPU2_TRAP_SYSBUSERR_DIE_IE_SP_CPU2_DMI_SAFE_E" 28927 "RBA_RESET_CPU2_TRAP_SYSBUSERR_DIE_IE_BS_CPU2_DMI_SAFE_E" 28928 "RBA_RESET_CPU2_TRAP_SYSBUSERR_DIE_IED_DMA_PARTITION_0_E" 28929 "RBA_RESET_CPU2_TRAP_SYSBUSERR_DIE_IE_T_DMA_PARTITION_0_E" 28930 "RBA_RESET_CPU2_TRAP_SYSBUSERR_DIE_IE_C_DMA_PARTITION_0_E" 28931 "RBA_RESET_CPU2_TRAP_SYSBUSERR_DIE_IE_S_DMA_PARTITION_0_E" 28932 "RBA_RESET_CPU2_TRAP_SYSBUSERR_DIE_IE_BI_DMA_PARTITION_0_E" 28933 "RBA_RESET_CPU2_TRAP_SYSBUSERR_DIE_IE_UNC_DMA_PARTITION_0_E" 28934 "RBA_RESET_CPU2_TRAP_SYSBUSERR_DIE_IE_SP_DMA_PARTITION_0_E" 28935 "RBA_RESET_CPU2_TRAP_SYSBUSERR_DIE_IE_BS_DMA_PARTITION_0_E" 28936 "RBA_RESET_CPU2_TRAP_SYSBUSERR_DIE_IED_DMA_PARTITION_1_E" 28937 "RBA_RESET_CPU2_TRAP_SYSBUSERR_DIE_IE_T_DMA_PARTITION_1_E" 28938 "RBA_RESET_CPU2_TRAP_SYSBUSERR_DIE_IE_C_DMA_PARTITION_1_E" 28939 "RBA_RESET_CPU2_TRAP_SYSBUSERR_DIE_IE_S_DMA_PARTITION_1_E" 28940 "RBA_RESET_CPU2_TRAP_SYSBUSERR_DIE_IE_BI_DMA_PARTITION_1_E" 28941 "RBA_RESET_CPU2_TRAP_SYSBUSERR_DIE_IE_UNC_DMA_PARTITION_1_E" 28942 "RBA_RESET_CPU2_TRAP_SYSBUSERR_DIE_IE_SP_DMA_PARTITION_1_E" 28943 "RBA_RESET_CPU2_TRAP_SYSBUSERR_DIE_IE_BS_DMA_PARTITION_1_E" 28944 "RBA_RESET_CPU2_TRAP_SYSBUSERR_DIE_IED_DMA_PARTITION_2_E" 28945 "RBA_RESET_CPU2_TRAP_SYSBUSERR_DIE_IE_T_DMA_PARTITION_2_E" 28946 "RBA_RESET_CPU2_TRAP_SYSBUSERR_DIE_IE_C_DMA_PARTITION_2_E" 28947 "RBA_RESET_CPU2_TRAP_SYSBUSERR_DIE_IE_S_DMA_PARTITION_2_E" 28948 "RBA_RESET_CPU2_TRAP_SYSBUSERR_DIE_IE_BI_DMA_PARTITION_2_E" 28949 "RBA_RESET_CPU2_TRAP_SYSBUSERR_DIE_IE_UNC_DMA_PARTITION_2_E" 28950 "RBA_RESET_CPU2_TRAP_SYSBUSERR_DIE_IE_SP_DMA_PARTITION_2_E" 28951 "RBA_RESET_CPU2_TRAP_SYSBUSERR_DIE_IE_BS_DMA_PARTITION_2_E" 28952 "RBA_RESET_CPU2_TRAP_SYSBUSERR_DIE_IED_DMA_PARTITION_3_E" 28953 "RBA_RESET_CPU2_TRAP_SYSBUSERR_DIE_IE_T_DMA_PARTITION_3_E" 28954 "RBA_RESET_CPU2_TRAP_SYSBUSERR_DIE_IE_C_DMA_PARTITION_3_E" 28955 "RBA_RESET_CPU2_TRAP_SYSBUSERR_DIE_IE_S_DMA_PARTITION_3_E" 28956 "RBA_RESET_CPU2_TRAP_SYSBUSERR_DIE_IE_BI_DMA_PARTITION_3_E" 28957 "RBA_RESET_CPU2_TRAP_SYSBUSERR_DIE_IE_UNC_DMA_PARTITION_3_E" 28958 "RBA_RESET_CPU2_TRAP_SYSBUSERR_DIE_IE_SP_DMA_PARTITION_3_E" 28959 "RBA_RESET_CPU2_TRAP_SYSBUSERR_DIE_IE_BS_DMA_PARTITION_3_E" 28960 "RBA_RESET_CPU2_TRAP_SYSBUSERR_DIE_IED_DMA_CERBERUS_E" 28961 "RBA_RESET_CPU2_TRAP_SYSBUSERR_DIE_IE_T_DMA_CERBERUS_E" 28962 "RBA_RESET_CPU2_TRAP_SYSBUSERR_DIE_IE_C_DMA_CERBERUS_E" 28963 "RBA_RESET_CPU2_TRAP_SYSBUSERR_DIE_IE_S_DMA_CERBERUS_E" 28964 "RBA_RESET_CPU2_TRAP_SYSBUSERR_DIE_IE_BI_DMA_CERBERUS_E" 28965 "RBA_RESET_CPU2_TRAP_SYSBUSERR_DIE_IE_UNC_DMA_CERBERUS_E" 28966 "RBA_RESET_CPU2_TRAP_SYSBUSERR_DIE_IE_SP_DMA_CERBERUS_E" 28967 "RBA_RESET_CPU2_TRAP_SYSBUSERR_DIE_IE_BS_DMA_CERBERUS_E" 28968 "RBA_RESET_CPU2_TRAP_SYSBUSERR_DIE_IED_HSSL_E" 28969 "RBA_RESET_CPU2_TRAP_SYSBUSERR_DIE_IE_T_HSSL_E" 28970 "RBA_RESET_CPU2_TRAP_SYSBUSERR_DIE_IE_C_HSSL_E" 28971 "RBA_RESET_CPU2_TRAP_SYSBUSERR_DIE_IE_S_HSSL_E" 28972 "RBA_RESET_CPU2_TRAP_SYSBUSERR_DIE_IE_BI_HSSL_E" 28973 "RBA_RESET_CPU2_TRAP_SYSBUSERR_DIE_IE_UNC_HSSL_E" 28974 "RBA_RESET_CPU2_TRAP_SYSBUSERR_DIE_IE_SP_HSSL_E" 28975 "RBA_RESET_CPU2_TRAP_SYSBUSERR_DIE_IE_BS_HSSL_E" 28976 "RBA_RESET_CPU2_TRAP_SYSBUSERR_DIE_IED_ETHERNET_E" 28977 "RBA_RESET_CPU2_TRAP_SYSBUSERR_DIE_IE_T_ETHERNET_E" 28978 "RBA_RESET_CPU2_TRAP_SYSBUSERR_DIE_IE_C_ETHERNET_E" 28979 "RBA_RESET_CPU2_TRAP_SYSBUSERR_DIE_IE_S_ETHERNET_E" 28980 "RBA_RESET_CPU2_TRAP_SYSBUSERR_DIE_IE_BI_ETHERNET_E" 28981 "RBA_RESET_CPU2_TRAP_SYSBUSERR_DIE_IE_UNC_ETHERNET_E" 28982 "RBA_RESET_CPU2_TRAP_SYSBUSERR_DIE_IE_SP_ETHERNET_E" 28983 "RBA_RESET_CPU2_TRAP_SYSBUSERR_DIE_IE_BS_ETHERNET_E" 28984 "RBA_RESET_CPU2_TRAP_SYSBUSERR_DIE_IED_HSM_HSMCMI_E" 28985 "RBA_RESET_CPU2_TRAP_SYSBUSERR_DIE_IE_T_HSM_HSMCMI_E" 28986 "RBA_RESET_CPU2_TRAP_SYSBUSERR_DIE_IE_C_HSM_HSMCMI_E" 28987 "RBA_RESET_CPU2_TRAP_SYSBUSERR_DIE_IE_S_HSM_HSMCMI_E" 28988 "RBA_RESET_CPU2_TRAP_SYSBUSERR_DIE_IE_BI_HSM_HSMCMI_E" 28989 "RBA_RESET_CPU2_TRAP_SYSBUSERR_DIE_IE_UNC_HSM_HSMCMI_E" 28990 "RBA_RESET_CPU2_TRAP_SYSBUSERR_DIE_IE_SP_HSM_HSMCMI_E" 28991 "RBA_RESET_CPU2_TRAP_SYSBUSERR_DIE_IE_BS_HSM_HSMCMI_E" 28992 "RBA_RESET_CPU2_TRAP_SYSBUSERR_DIE_IED_CPU0_PMI_E" 28993 "RBA_RESET_CPU2_TRAP_SYSBUSERR_DIE_IE_T_CPU0_PMI_E" 28994 "RBA_RESET_CPU2_TRAP_SYSBUSERR_DIE_IE_C_CPU0_PMI_E" 28995 "RBA_RESET_CPU2_TRAP_SYSBUSERR_DIE_IE_S_CPU0_PMI_E" 28996 "RBA_RESET_CPU2_TRAP_SYSBUSERR_DIE_IE_BI_CPU0_PMI_E" 28997 "RBA_RESET_CPU2_TRAP_SYSBUSERR_DIE_IE_UNC_CPU0_PMI_E" 28998 "RBA_RESET_CPU2_TRAP_SYSBUSERR_DIE_IE_SP_CPU0_PMI_E" 28999 "RBA_RESET_CPU2_TRAP_SYSBUSERR_DIE_IE_BS_CPU0_PMI_E" 29000 "RBA_RESET_CPU2_TRAP_SYSBUSERR_DIE_IED_CPU1_PMI_E" 29001 "RBA_RESET_CPU2_TRAP_SYSBUSERR_DIE_IE_T_CPU1_PMI_E" 29002 "RBA_RESET_CPU2_TRAP_SYSBUSERR_DIE_IE_C_CPU1_PMI_E" 29003 "RBA_RESET_CPU2_TRAP_SYSBUSERR_DIE_IE_S_CPU1_PMI_E" 29004 "RBA_RESET_CPU2_TRAP_SYSBUSERR_DIE_IE_BI_CPU1_PMI_E" 29005 "RBA_RESET_CPU2_TRAP_SYSBUSERR_DIE_IE_UNC_CPU1_PMI_E" 29006 "RBA_RESET_CPU2_TRAP_SYSBUSERR_DIE_IE_SP_CPU1_PMI_E" 29007 "RBA_RESET_CPU2_TRAP_SYSBUSERR_DIE_IE_BS_CPU1_PMI_E" 29008 "RBA_RESET_CPU2_TRAP_SYSBUSERR_DIE_IED_CPU2_PMI_E" 29009 "RBA_RESET_CPU2_TRAP_SYSBUSERR_DIE_IE_T_CPU2_PMI_E" 29010 "RBA_RESET_CPU2_TRAP_SYSBUSERR_DIE_IE_C_CPU2_PMI_E" 29011 "RBA_RESET_CPU2_TRAP_SYSBUSERR_DIE_IE_S_CPU2_PMI_E" 29012 "RBA_RESET_CPU2_TRAP_SYSBUSERR_DIE_IE_BI_CPU2_PMI_E" 29013 "RBA_RESET_CPU2_TRAP_SYSBUSERR_DIE_IE_UNC_CPU2_PMI_E" 29014 "RBA_RESET_CPU2_TRAP_SYSBUSERR_DIE_IE_SP_CPU2_PMI_E" 29015 "RBA_RESET_CPU2_TRAP_SYSBUSERR_DIE_IE_BS_CPU2_PMI_E" 29016 "RBA_RESET_CPU2_TRAP_SYSBUSERR_DIE_IED_DAM_E" 29017 "RBA_RESET_CPU2_TRAP_SYSBUSERR_DIE_IE_T_DAM_E" 29018 "RBA_RESET_CPU2_TRAP_SYSBUSERR_DIE_IE_C_DAM_E" 29019 "RBA_RESET_CPU2_TRAP_SYSBUSERR_DIE_IE_S_DAM_E" 29020 "RBA_RESET_CPU2_TRAP_SYSBUSERR_DIE_IE_BI_DAM_E" 29021 "RBA_RESET_CPU2_TRAP_SYSBUSERR_DIE_IE_UNC_DAM_E" 29022 "RBA_RESET_CPU2_TRAP_SYSBUSERR_DIE_IE_SP_DAM_E" 29023 "RBA_RESET_CPU2_TRAP_SYSBUSERR_DIE_IE_BS_DAM_E" 29024 "RBA_RESET_CPU2_TRAP_SYSBUSERR_DIE_IED_CERBERUS_BBB_E" 29025 "RBA_RESET_CPU2_TRAP_SYSBUSERR_DIE_IE_T_CERBERUS_BBB_E" 29026 "RBA_RESET_CPU2_TRAP_SYSBUSERR_DIE_IE_C_CERBERUS_BBB_E" 29027 "RBA_RESET_CPU2_TRAP_SYSBUSERR_DIE_IE_S_CERBERUS_BBB_E" 29028 "RBA_RESET_CPU2_TRAP_SYSBUSERR_DIE_IE_BI_CERBERUS_BBB_E" 29029 "RBA_RESET_CPU2_TRAP_SYSBUSERR_DIE_IE_UNC_CERBERUS_BBB_E" 29030 "RBA_RESET_CPU2_TRAP_SYSBUSERR_DIE_IE_SP_CERBERUS_BBB_E" 29031 "RBA_RESET_CPU2_TRAP_SYSBUSERR_DIE_IE_BS_CERBERUS_BBB_E" 29032 "RBA_RESET_CPU2_TRAP_SYSBUSERR_DIE_IED_EMEM_MASTER_BBB_E" 29033 "RBA_RESET_CPU2_TRAP_SYSBUSERR_DIE_IE_T_EMEM_MASTER_BBB_E" 29034 "RBA_RESET_CPU2_TRAP_SYSBUSERR_DIE_IE_C_EMEM_MASTER_BBB_E" 29035 "RBA_RESET_CPU2_TRAP_SYSBUSERR_DIE_IE_S_EMEM_MASTER_BBB_E" 29036 "RBA_RESET_CPU2_TRAP_SYSBUSERR_DIE_IE_BI_EMEM_MASTER_BBB_E" 29037 "RBA_RESET_CPU2_TRAP_SYSBUSERR_DIE_IE_UNC_EMEM_MASTER_BBB_E" 29038 "RBA_RESET_CPU2_TRAP_SYSBUSERR_DIE_IE_SP_EMEM_MASTER_BBB_E" 29039 "RBA_RESET_CPU2_TRAP_SYSBUSERR_DIE_IE_BS_EMEM_MASTER_BBB_E" 29040 "RBA_RESET_CPU2_TRAP_SYSBUSERR_DIE_IED_CIF_MASTER_BBB_E" 29041 "RBA_RESET_CPU2_TRAP_SYSBUSERR_DIE_IE_T_CIF_MASTER_BBB_E" 29042 "RBA_RESET_CPU2_TRAP_SYSBUSERR_DIE_IE_C_CIF_MASTER_BBB_E" 29043 "RBA_RESET_CPU2_TRAP_SYSBUSERR_DIE_IE_S_CIF_MASTER_BBB_E" 29044 "RBA_RESET_CPU2_TRAP_SYSBUSERR_DIE_IE_BI_CIF_MASTER_BBB_E" 29045 "RBA_RESET_CPU2_TRAP_SYSBUSERR_DIE_IE_UNC_CIF_MASTER_BBB_E" 29046 "RBA_RESET_CPU2_TRAP_SYSBUSERR_DIE_IE_SP_CIF_MASTER_BBB_E" 29047 "RBA_RESET_CPU2_TRAP_SYSBUSERR_DIE_IE_BS_CIF_MASTER_BBB_E" 29048 "RBA_RESET_CPU2_TRAP_TCN4_UNKNOWN_E" 29049 "RBA_RESET_CPU2_TRAP_TCN5_TIN0_E" 29050 "RBA_RESET_CPU2_TRAP_ASSTRAP_OVF_E" 29051 "RBA_RESET_CPU2_TRAP_ASSTRAP_SOVF_E" 29052 "RBA_RESET_CPU2_TRAP_TCN5_UNKNOWN_E" 29053 "RBA_RESET_CPU2_TRAP_SYSCALL_SYS_E" 29054 "RBA_RESET_CPU2_TRAP_NMI_UNKNOWN_E" 29055 "RBA_RESET_CPU2_TRAP_NMI_ESR0_E" 29056 "RBA_RESET_CPU2_TRAP_NMI_ESR1_E" 29057 "RBA_RESET_CPU2_TRAP_NMI_SMUT_E" 29058 "RBA_RESET_CPU2_TRAP_NMI_SMU_CPU0_MPU_E" 29059 "RBA_RESET_CPU2_TRAP_NMI_SMU_CPU1_MPU_E" 29060 "RBA_RESET_CPU2_TRAP_NMI_SMU_CPU2_MPU_E" 29061 "RBA_RESET_CPU2_TRAP_NMI_SMU_IR_E" 29062 "RBA_RESET_CPU2_TRAP_NMI_SMU_CGU_WDT_E" 29063 "RBA_RESET_CPU2_TRAP_NMI_SMU_CGU_PLLLOL_E" 29064 "RBA_RESET_CPU2_TRAP_NMI_SMU_CGU_PLLERAYLOL_E" 29065 "RBA_RESET_CPU2_TRAP_NMI_SMU_CGU_STM_E" 29066 "RBA_RESET_CPU2_TRAP_NMI_SMU_CGU_PLLERAY_E" 29067 "RBA_RESET_CPU2_TRAP_NMI_SMU_CGU_PLL_E" 29068 "RBA_RESET_CPU2_TRAP_NMI_SMU_CGU_SRI_E" 29069 "RBA_RESET_CPU2_TRAP_NMI_SMU_CGU_SPB_E" 29070 "RBA_RESET_CPU2_TRAP_NMI_SMU_CGU_CPU0_E" 29071 "RBA_RESET_CPU2_TRAP_NMI_SMU_SCUEVR_12UV_E" 29072 "RBA_RESET_CPU2_TRAP_NMI_SMU_SCUEVR_12OV_E" 29073 "RBA_RESET_CPU2_TRAP_NMI_SMU_SCUEVR_33UV_E" 29074 "RBA_RESET_CPU2_TRAP_NMI_SMU_SCUEVR_33OV_E" 29075 "RBA_RESET_CPU2_TRAP_NMI_SMU_SCUEVR_5UV_E" 29076 "RBA_RESET_CPU2_TRAP_NMI_SMU_SCUEVR_5OV_E" 29077 "RBA_RESET_CPU2_TRAP_NMI_SMU_SWDT_E" 29078 "RBA_RESET_CPU2_TRAP_NMI_SMU_WDT0_E" 29079 "RBA_RESET_CPU2_TRAP_NMI_SMU_WDT1_E" 29080 "RBA_RESET_CPU2_TRAP_NMI_SMU_WDT2_E" 29081 "RBA_RESET_CPU2_TRAP_NMI_SMU_WDT3_E" 29082 "RBA_RESET_CPU2_TRAP_NMI_SMU_WDT4_E" 29083 "RBA_RESET_CPU2_TRAP_NMI_SMU_WDT5_E" 29084 "RBA_RESET_CPU2_TRAP_TCN7_UNKNOWN_E" /end COMPU_VTAB
/begin COMPU_VTAB RB_RBA_rba_SvbbEtk_CompuMethods_rba_SvbbEtk_StateEnable_CM "CompuMethod for SvbbEtk state" TAB_VERB 6 0 "Inactive" 1 "Waiting_for_activation" 2 "Waiting_for_setting_of_calibration_label" 3 "Waiting_for_stimulation_data_directly_after_reset" 4 "Waiting_for_stimulation_data" 5 "Stimulivalues_are_used__Processes_can_be_disabled" /end COMPU_VTAB
/begin COMPU_VTAB RB_RBA_rba_SvbbEtk_CompuMethods_rba_SvbbEtk_Enable_CM "CompuMethod for SvbbEtk state" TAB_VERB 4 0 "Disable" 1 "Enable_now" 2 "Enable_always" 3 "Enable_after_reset" /end COMPU_VTAB
/begin COMPU_VTAB RB_RBA_rba_SyC_CustStates_BswModuleDescriptions_rba_SyC_CustStates_States_CompuMethod "CompuMethod for Customer States" TAB_VERB 7 0 "RBA_SYC_CUSTSTATES_UNKNOWN" 1 "RBA_SYC_CUSTSTATES_PARTIAL_WAKEUP" 2 "RBA_SYC_CUSTSTATES_INTERNAL_PARTIAL_WAKEUP" 3 "RBA_SYC_CUSTSTATES_TRANSITORY" 4 "RBA_SYC_CUSTSTATES_NOMINAL_MAIN_WAKEUP" 5 "RBA_SYC_CUSTSTATES_DEGRADED_MAIN_WAKEUP" 6 "RBA_SYC_CUSTSTATES_SHUTDOWN_PREPARATION" /end COMPU_VTAB
/begin COMPU_VTAB RB_RBA_rba_T15_BswModuleDescriptions_rba_T15_Signal_Status_CompuMethod "CompuMethod for signal status of Terminal 15" TAB_VERB 2 0 "rba_T15_Signal_Off_e" 1 "rba_T15_Signal_On_e" /end COMPU_VTAB
/begin COMPU_VTAB RB_RBA_rba_T15_BswModuleDescriptions_rba_T15_Signal_StatusValid_CompuMethod "CompuMethod for signal status validity of Terminal 15" TAB_VERB 2 0 "rba_T15_Signal_InValid_e" 1 "rba_T15_Signal_Valid_e" /end COMPU_VTAB
/*********** End of merged COMPU_VTAB blocks ***********/
/begin COMPU_VTAB ACCHRGNPWRSTGCTRL_TYPAVL_SC_Compu "" TAB_VERB 2 0 "False" 1 "True" /end COMPU_VTAB
/begin COMPU_METHOD ACCHRGRINTKT_TYPAVL_SC_Compu "" TAB_VERB "%6.3" "" COMPU_TAB_REF ACCHRGRINTKT_TYPAVL_SC_Compu /end COMPU_METHOD
/begin COMPU_VTAB ACCHRGRINTKT_TYPAVL_SC_Compu "" TAB_VERB 2 0 "False" 1 "True" /end COMPU_VTAB
/begin COMPU_METHOD ACCLNTP_SENSTYP_SY_Compu "" TAB_VERB "%6.3" "" COMPU_TAB_REF ACCLNTP_SENSTYP_SY_Compu /end COMPU_METHOD
/begin COMPU_VTAB ACCLNTP_SENSTYP_SY_Compu "" TAB_VERB 4 0 "ADCIN" 1 "PWMOUT" 2 "ADCIN_PWMOUT" 3 "CONNECT_NONE" /end COMPU_VTAB
/begin COMPU_METHOD ACC_SY_Compu "" TAB_VERB "%6.3" "" COMPU_TAB_REF ACC_SY_Compu /end COMPU_METHOD
/begin COMPU_VTAB ACC_SY_Compu "" TAB_VERB 2 0 "FALSE" 1 "TRUE" /end COMPU_VTAB
/begin COMPU_METHOD ActAngle "" RAT_FUNC "%6.4" "deg" COEFFS 0 20 0 0 0 1 /end COMPU_METHOD
/begin COMPU_METHOD ACTRLIB_IINITSPEZIAL_SY_Compu "" TAB_VERB "%6.3" "" COMPU_TAB_REF ACTRLIB_IINITSPEZIAL_SY_Compu /end COMPU_METHOD
/begin COMPU_VTAB ACTRLIB_IINITSPEZIAL_SY_Compu "" TAB_VERB 2 0 "FALSE" 1 "TRUE" /end COMPU_VTAB
/begin COMPU_METHOD ACTYP_SY_Compu "" TAB_VERB "%6.3" "" COMPU_TAB_REF ACTYP_SY_Compu /end COMPU_METHOD
/begin COMPU_VTAB ACTYP_SY_Compu "" TAB_VERB 5 0 "NO_AC" 1 "ACTYP_MECH_FIX" 2 "ACTYP_MECH_VAR" 3 "ACTYP_ELEC" 4 "ACTYP_MECHELEC" /end COMPU_VTAB
/begin COMPU_METHOD AC_DEMAND_SY_Compu "" TAB_VERB "%6.3" "" COMPU_TAB_REF AC_DEMAND_SY_Compu /end COMPU_METHOD
/begin COMPU_VTAB AC_DEMAND_SY_Compu "" TAB_VERB 2 0 "False" 1 "True" /end COMPU_VTAB
/begin COMPU_METHOD ADASUSG_PESLONG_SC_Compu "" TAB_VERB "%6.3" "" COMPU_TAB_REF ADASUSG_PESLONG_SC_Compu /end COMPU_METHOD
/begin COMPU_VTAB ADASUSG_PESLONG_SC_Compu "" TAB_VERB 2 0 "False" 1 "True" /end COMPU_VTAB
/begin COMPU_METHOD ADASUSG_PESMED_SC_Compu "" TAB_VERB "%6.3" "" COMPU_TAB_REF ADASUSG_PESMED_SC_Compu /end COMPU_METHOD
/begin COMPU_VTAB ADASUSG_PESMED_SC_Compu "" TAB_VERB 2 0 "False" 1 "True" /end COMPU_VTAB
/begin COMPU_METHOD ADDLEONV_SC_Compu "" TAB_VERB "%6.3" "" COMPU_TAB_REF ADDLEONV_SC_Compu /end COMPU_METHOD
/begin COMPU_VTAB ADDLEONV_SC_Compu "" TAB_VERB 2 0 "False" 1 "True" /end COMPU_VTAB
/begin COMPU_METHOD AFSP_TYPAVL_SC_Compu "" TAB_VERB "%6.3" "" COMPU_TAB_REF AFSP_TYPAVL_SC_Compu /end COMPU_METHOD
/begin COMPU_VTAB AFSP_TYPAVL_SC_Compu "" TAB_VERB 2 0 "False" 1 "True" /end COMPU_VTAB
/begin COMPU_METHOD DDRC_LstRprtEve_VERB "" TAB_VERB "%6.3" "" COMPU_TAB_REF DDRC_LstRprtEve_VERB /end COMPU_METHOD
/begin COMPU_VTAB DDRC_LstRprtEve_VERB "" TAB_VERB 5 0 "PASSED" 1 "FAILED" 2 "PREPASSED" 3 "PREFAILED" 255 "INVALID" /end COMPU_VTAB
/begin COMPU_METHOD DFC_OneToOne "" RAT_FUNC "%6.2" "-" COEFFS 0 1 0 0 0 1 /end COMPU_METHOD
/begin COMPU_METHOD DFES_OneToOne "" RAT_FUNC "%6.2" "-" COEFFS 0 1 0 0 0 1 /end COMPU_METHOD
/begin RECORD_LAYOUT DefaultValueRecordLayout_AUTOSAR_Platform_BaseTypes_uint16 FNC_VALUES 1 UWORD COLUMN_DIR DIRECT STATIC_ADDRESS_OFFSETS /end RECORD_LAYOUT
/begin RECORD_LAYOUT DefaultValueRecordLayout_AUTOSAR_Platform_BaseTypes_uint8 FNC_VALUES 1 UBYTE COLUMN_DIR DIRECT STATIC_ADDRESS_OFFSETS /end RECORD_LAYOUT
/begin RECORD_LAYOUT DefaultValueRecordLayout_AUTOSAR_Platform_BaseTypes_uint32 FNC_VALUES 1 ULONG COLUMN_DIR DIRECT STATIC_ADDRESS_OFFSETS /end RECORD_LAYOUT
/begin RECORD_LAYOUT DefaultValueRecordLayout_AUTOSAR_Platform_BaseTypes_sint32 FNC_VALUES 1 SLONG COLUMN_DIR DIRECT STATIC_ADDRESS_OFFSETS /end RECORD_LAYOUT
/begin RECORD_LAYOUT Val_Wu16 FNC_VALUES 1 UWORD COLUMN_DIR DIRECT /end RECORD_LAYOUT
/begin RECORD_LAYOUT Val_Wu8 FNC_VALUES 1 UBYTE COLUMN_DIR DIRECT /end RECORD_LAYOUT
/*********** Start of merged UNIT blocks ***********/
/begin UNIT RB_RBA_Common_CentralElements_Units_NoUnit "No Unit" "noUnit" EXTENDED_SI SI_EXPONENTS 0 0 0 0 0 0 0 /end UNIT
/begin UNIT RB_RBA_rba_MRly_Units_NoUnit "No Unit" "nounit" EXTENDED_SI SI_EXPONENTS 0 0 0 0 0 0 0 /end UNIT
/begin UNIT RB_RBA_rba_MRly_Units_ms "Millisecond" "ms" EXTENDED_SI SI_EXPONENTS 0 0 1 0 0 0 0 /end UNIT
/begin UNIT RB_RBA_rba_OsMeasmt_Units_Perc "Percent" "%" EXTENDED_SI /end UNIT
/begin UNIT RB_RBA_rba_OsMeasmt_Units_MicroSec "Micro Second" "us" EXTENDED_SI /end UNIT
/begin UNIT RB_RBA_rba_OsShell_Units_MicroSec "Micro Second" "us" EXTENDED_SI /end UNIT
/begin UNIT RB_RBA_rba_OsMeasmt_Units_NoUnit "No Unit" "noUnit" EXTENDED_SI SI_EXPONENTS 0 0 0 0 0 0 0 /end UNIT
/begin UNIT RB_RBA_rba_Reset_Units_NoUnit "No Unit" "noUnit" EXTENDED_SI SI_EXPONENTS 0 0 0 0 0 0 0 /end UNIT
/begin UNIT RB_RBA_rba_SvbbEtk_Units_NoUnit "No Unit" "noUnit" EXTENDED_SI SI_EXPONENTS 0 0 0 0 0 0 0 /end UNIT
/begin UNIT RB_RBA_rba_SyC_CustStates_Units_NoUnit "No Unit" "nounit" EXTENDED_SI SI_EXPONENTS 0 0 0 0 0 0 0 /end UNIT
/begin UNIT RB_RBA_rba_SyC_CustStates_Units_kmph "Kilometer per hour" "km/h" EXTENDED_SI SI_EXPONENTS 1 0 -1 0 0 0 0 /end UNIT
/begin UNIT RB_RBA_rba_SyC_CustStates_Units_ms "Millisecond" "ms" EXTENDED_SI SI_EXPONENTS 0 0 1 0 0 0 0 /end UNIT
/begin UNIT RB_RBA_rba_SyC_CustStates_Units_s "Second" "s" EXTENDED_SI SI_EXPONENTS 0 0 1 0 0 0 0 /end UNIT
/begin UNIT RB_RBA_rba_T15_Units_NoUnit "No Unit" "nounit" EXTENDED_SI SI_EXPONENTS 0 0 0 0 0 0 0 /end UNIT
/begin UNIT RB_RBA_rba_T15_Units_ms "Millisecond" "ms" EXTENDED_SI SI_EXPONENTS 0 0 1 0 0 0 0 /end UNIT
/end MODULE
/end PROJECT

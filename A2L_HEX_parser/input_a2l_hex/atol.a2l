ASAP2_VERSION 1 70
/begin PROJECT MDG1C "VC1CP091_STLA_N_D061I3"
/begin HEADER "" VERSION "VC1CP091_STLA_N_D061I3" PROJECT_NO MDG1C /end HEADER
/begin MODULE DIM ""
/begin MOD_COMMON "" BYTE_ORDER MSB_LAST ALIGNMENT_BYTE 1 ALIGNMENT_WORD 2 ALIGNMENT_LONG 4 ALIGNMENT_INT64 4 ALIGNMENT_FLOAT32_IEEE 4 ALIGNMENT_FLOAT64_IEEE 4 DATA_SIZE 32 /end MOD_COMMON
/begin MEASUREMENT DFC_st.DFC_Com675hAbsent "" UBYTE DFC_OneToOne 1 100 0.00 255.0 FORMAT "%5.1" ECU_ADDRESS 0x60034B02 /end MEASUREMENT
/begin MEASUREMENT DFC_st.DFC_Com675hTooShort "" UBYTE DFC_OneToOne 1 100 0.00 255.0 FORMAT "%5.1" ECU_ADDRESS 0x60034B03 /end MEASUREMENT
/begin MEASUREMENT DFC_st.DFC_ComFrbd_205h_HVBAT_PACK_CURRENT "" UBYTE DFC_OneToOne 1 100 0.00 255.0 FORMAT "%5.1" ECU_ADDRESS 0x60034B04 /end MEASUREMENT
/begin MEASUREMENT DFC_st.DFC_ComFrbd_205h_HVBAT_SOC_DISPLAY "" UBYTE DFC_OneToOne 1 100 0.00 255.0 FORMAT "%5.1" ECU_ADDRESS 0x60034B05 /end MEASUREMENT
/begin MEASUREMENT DFC_st.DFC_ComFrbd_205h_HVBAT_VOLTAGE "" UBYTE DFC_OneToOne 1 100 0.00 255.0 FORMAT "%5.1" ECU_ADDRESS 0x60034B06 /end MEASUREMENT
/begin MEASUREMENT DFC_st.DFC_ComFrbd_217h_INV_DC_BUS_VOLTAGE "" UBYTE DFC_OneToOne 1 100 0.00 255.0 FORMAT "%5.1" ECU_ADDRESS 0x60034B07 /end MEASUREMENT
/begin MEASUREMENT DFC_st.DFC_ComFrbd_217h_INV_MTR_ACTUAL_TRQ "" UBYTE DFC_OneToOne 1 100 0.00 255.0 FORMAT "%5.1" ECU_ADDRESS 0x60034B08 /end MEASUREMENT
/begin MEASUREMENT DFC_st.DFC_ComFrbd_217h_INV_MTR_SPEED "" UBYTE DFC_OneToOne 1 100 0.00 255.0 FORMAT "%5.1" ECU_ADDRESS 0x60034B09 /end MEASUREMENT
/begin MEASUREMENT DFC_st.DFC_ComFrbd_217h_INV_MTR_TRQ "" UBYTE DFC_OneToOne 1 100 0.00 255.0 FORMAT "%5.1" ECU_ADDRESS 0x60034B0A /end MEASUREMENT
/begin MEASUREMENT DFC_st.DFC_ComFrbd_227h_INV_DC_CURRENT "" UBYTE DFC_OneToOne 1 100 0.00 255.0 FORMAT "%5.1" ECU_ADDRESS 0x60034B0B /end MEASUREMENT
/begin MEASUREMENT DFC_st.DFC_ComFrbd_227h_INV_MOTORING_PEAK_TRQ "" UBYTE DFC_OneToOne 1 100 0.00 255.0 FORMAT "%5.1" ECU_ADDRESS 0x60034B0C /end MEASUREMENT
/begin MEASUREMENT DFC_st.DFC_ComFrbd_227h_INV_MTR_INST_INPUT_POWER "" UBYTE DFC_OneToOne 1 100 0.00 255.0 FORMAT "%5.1" ECU_ADDRESS 0x60034B0D /end MEASUREMENT
/begin MEASUREMENT DFC_st.DFC_ComFrbd_227h_INV_REGEN_PEAK_TRQ "" UBYTE DFC_OneToOne 1 100 0.00 255.0 FORMAT "%5.1" ECU_ADDRESS 0x60034B0E /end MEASUREMENT
/begin MEASUREMENT DFC_st.DFC_ComFrbd_237h_INV_ACTIVE_DISCHARGE_STATUS "" UBYTE DFC_OneToOne 1 100 0.00 255.0 FORMAT "%5.1" ECU_ADDRESS 0x60034B0F /end MEASUREMENT
/begin MEASUREMENT DFC_st.DFC_ComFrbd_237h_INV_CTRL_MODE_ACK "" UBYTE DFC_OneToOne 1 100 0.00 255.0 FORMAT "%5.1" ECU_ADDRESS 0x60034B10 /end MEASUREMENT
/begin MEASUREMENT DFC_st.DFC_ComFrbd_237h_INV_EV_WARNING "" UBYTE DFC_OneToOne 1 100 0.00 255.0 FORMAT "%5.1" ECU_ADDRESS 0x60034B11 /end MEASUREMENT
/begin MEASUREMENT DFC_st.DFC_ComFrbd_237h_INV_FAULT_LEVEL "" UBYTE DFC_OneToOne 1 100 0.00 255.0 FORMAT "%5.1" ECU_ADDRESS 0x60034B12 /end MEASUREMENT
/begin MEASUREMENT DFC_st.DFC_ComFrbd_237h_INV_MASTER_STOP "" UBYTE DFC_OneToOne 1 100 0.00 255.0 FORMAT "%5.1" ECU_ADDRESS 0x60034B13 /end MEASUREMENT
/begin MEASUREMENT DFC_st.DFC_ComFrbd_237h_INV_SERVICE_DUE "" UBYTE DFC_OneToOne 1 100 0.00 255.0 FORMAT "%5.1" ECU_ADDRESS 0x60034B14 /end MEASUREMENT
/begin MEASUREMENT DFC_st.DFC_ComFrbd_237h_INV_STAB_MIN_TRQ "" UBYTE DFC_OneToOne 1 100 0.00 255.0 FORMAT "%5.1" ECU_ADDRESS 0x60034B15 /end MEASUREMENT
/begin MEASUREMENT DFC_st.DFC_ComFrbd_259h_TGLM_FAILURE_STATE "" UBYTE DFC_OneToOne 1 100 0.00 255.0 FORMAT "%5.1" ECU_ADDRESS 0x60034B16 /end MEASUREMENT
/begin MEASUREMENT DFC_st.DFC_ComFrbd_259h_TGLM_MODE_PUSH "" UBYTE DFC_OneToOne 1 100 0.00 255.0 FORMAT "%5.1" ECU_ADDRESS 0x60034B17 /end MEASUREMENT
/begin MEASUREMENT DFC_st.DFC_ComFrbd_259h_TOGGLE_MONOSTABLE_POS "" UBYTE DFC_OneToOne 1 100 0.00 255.0 FORMAT "%5.1" ECU_ADDRESS 0x60034B18 /end MEASUREMENT
/begin MEASUREMENT DFC_st.DFC_ComFrbd_273h_OBC_outputpower_capability "" UBYTE DFC_OneToOne 1 100 0.00 255.0 FORMAT "%5.1" ECU_ADDRESS 0x60034B19 /end MEASUREMENT
/begin MEASUREMENT DFC_st.DFC_ComFrbd_275h_HVBAT_DISCHARGE_30S_AVAILABLE_CURRENT "" UBYTE DFC_OneToOne 1 100 0.00 255.0 FORMAT "%5.1" ECU_ADDRESS 0x60034B1A /end MEASUREMENT
/begin MEASUREMENT DFC_st.DFC_ComFrbd_275h_HVBAT_DISCHARGE_30S_AVAILABLE_POWER "" UBYTE DFC_OneToOne 1 100 0.00 255.0 FORMAT "%5.1" ECU_ADDRESS 0x60034B1B /end MEASUREMENT
/begin MEASUREMENT DFC_st.DFC_ComFrbd_283h_DCDC_IN_CURRENT "" UBYTE DFC_OneToOne 1 100 0.00 255.0 FORMAT "%5.1" ECU_ADDRESS 0x60034B1C /end MEASUREMENT
/begin MEASUREMENT DFC_st.DFC_ComFrbd_283h_DCDC_IN_VOLTAGE "" UBYTE DFC_OneToOne 1 100 0.00 255.0 FORMAT "%5.1" ECU_ADDRESS 0x60034B1D /end MEASUREMENT
/begin MEASUREMENT DFC_st.DFC_ComFrbd_283h_DCDC_OUT_CURRENT "" UBYTE DFC_OneToOne 1 100 0.00 255.0 FORMAT "%5.1" ECU_ADDRESS 0x60034B1E /end MEASUREMENT
/begin MEASUREMENT DFC_st.DFC_ComFrbd_283h_DCDC_OUT_VOLTAGE "" UBYTE DFC_OneToOne 1 100 0.00 255.0 FORMAT "%5.1" ECU_ADDRESS 0x60034B1F /end MEASUREMENT
/begin MEASUREMENT DFC_st.DFC_ComFrbd_285h_HVBAT_REGEN_CHG_30S_CURRENT_LIMIT "" UBYTE DFC_OneToOne 1 100 0.00 255.0 FORMAT "%5.1" ECU_ADDRESS 0x60034B20 /end MEASUREMENT
/begin MEASUREMENT DFC_st.DFC_ComFrbd_285h_HVBAT_REGEN_CHRG_30S_POWER_LIMIT "" UBYTE DFC_OneToOne 1 100 0.00 255.0 FORMAT "%5.1" ECU_ADDRESS 0x60034B21 /end MEASUREMENT
/begin MEASUREMENT DFC_st.DFC_ComFrbd_293h_DCDC_outputpower_capability "" UBYTE DFC_OneToOne 1 100 0.00 255.0 FORMAT "%5.1" ECU_ADDRESS 0x60034B22 /end MEASUREMENT
/begin MEASUREMENT DFC_st.DFC_ComFrbd_325h_HVBAT_INSULATION_RESISTANCE "" UBYTE DFC_OneToOne 1 100 0.00 255.0 FORMAT "%5.1" ECU_ADDRESS 0x60034B23 /end MEASUREMENT
/begin MEASUREMENT DFC_st.DFC_ComFrbd_325h_HVBAT_TEMPERATURE "" UBYTE DFC_OneToOne 1 100 0.00 255.0 FORMAT "%5.1" ECU_ADDRESS 0x60034B24 /end MEASUREMENT
/begin MEASUREMENT DFC_st.DFC_ComFrbd_335h_HVBAT_CHRG_CONTINUOUS_CURR_MAX "" UBYTE DFC_OneToOne 1 100 0.00 255.0 FORMAT "%5.1" ECU_ADDRESS 0x60034B25 /end MEASUREMENT
/begin MEASUREMENT DFC_st.DFC_ComFrbd_335h_HVBAT_CHRG_COTINUOUS_CURR_REQ "" UBYTE DFC_OneToOne 1 100 0.00 255.0 FORMAT "%5.1" ECU_ADDRESS 0x60034B26 /end MEASUREMENT
/begin MEASUREMENT DFC_st.DFC_ComFrbd_335h_HVBAT_CHRG_MAX_VOLT "" UBYTE DFC_OneToOne 1 100 0.00 255.0 FORMAT "%5.1" ECU_ADDRESS 0x60034B27 /end MEASUREMENT
/begin MEASUREMENT DFC_st.DFC_ComFrbd_335h_HVBAT_DC_BUS_VOLTAGE "" UBYTE DFC_OneToOne 1 100 0.00 255.0 FORMAT "%5.1" ECU_ADDRESS 0x60034B28 /end MEASUREMENT
/begin MEASUREMENT DFC_st.DFC_ComFrbd_427h_INV_OP_MODE "" UBYTE DFC_OneToOne 1 100 0.00 255.0 FORMAT "%5.1" ECU_ADDRESS 0x60034B29 /end MEASUREMENT
/begin MEASUREMENT DFC_st.DFC_ComFrbd_427h_INV_PERMISIBLE_TORQUE "" UBYTE DFC_OneToOne 1 100 0.00 255.0 FORMAT "%5.1" ECU_ADDRESS 0x60034B2A /end MEASUREMENT
/begin MEASUREMENT DFC_st.DFC_ComFrbd_435h_HVBAT_MAX_CELL_VOLT "" UBYTE DFC_OneToOne 1 100 0.00 255.0 FORMAT "%5.1" ECU_ADDRESS 0x60034B2B /end MEASUREMENT
/begin MEASUREMENT DFC_st.DFC_ComFrbd_435h_HVBAT_MAX_CELL_VOLT_NUM "" UBYTE DFC_OneToOne 1 100 0.00 255.0 FORMAT "%5.1" ECU_ADDRESS 0x60034B2C /end MEASUREMENT
/begin MEASUREMENT DFC_st.DFC_ComFrbd_435h_HVBAT_MAX_SENSOR_TEMP "" UBYTE DFC_OneToOne 1 100 0.00 255.0 FORMAT "%5.1" ECU_ADDRESS 0x60034B2D /end MEASUREMENT
/begin MEASUREMENT DFC_st.DFC_ComFrbd_435h_HVBAT_MIN_CELL_VOLT "" UBYTE DFC_OneToOne 1 100 0.00 255.0 FORMAT "%5.1" ECU_ADDRESS 0x60034B2E /end MEASUREMENT
/begin MEASUREMENT DFC_st.DFC_ComFrbd_435h_HVBAT_MIN_CELL_VOLT_NUM "" UBYTE DFC_OneToOne 1 100 0.00 255.0 FORMAT "%5.1" ECU_ADDRESS 0x60034B2F /end MEASUREMENT
/begin MEASUREMENT DFC_st.DFC_ComFrbd_453h_OBC_IN_CURRENT "" UBYTE DFC_OneToOne 1 100 0.00 255.0 FORMAT "%5.1" ECU_ADDRESS 0x60034B30 /end MEASUREMENT
/begin MEASUREMENT DFC_st.DFC_ComFrbd_453h_OBC_IN_VOLTAGE "" UBYTE DFC_OneToOne 1 100 0.00 255.0 FORMAT "%5.1" ECU_ADDRESS 0x60034B31 /end MEASUREMENT
/begin MEASUREMENT DFC_st.DFC_ComFrbd_453h_OBC_IP_POWER "" UBYTE DFC_OneToOne 1 100 0.00 255.0 FORMAT "%5.1" ECU_ADDRESS 0x60034B32 /end MEASUREMENT
/begin MEASUREMENT DFC_st.DFC_ComFrbd_455h_HVBAT_NOMINAL_VOLTAGE "" UBYTE DFC_OneToOne 1 100 0.00 255.0 FORMAT "%5.1" ECU_ADDRESS 0x60034B33 /end MEASUREMENT
/begin MEASUREMENT DFC_st.DFC_ComFrbd_463h_OBC_OUT_CURRENT "" UBYTE DFC_OneToOne 1 100 0.00 255.0 FORMAT "%5.1" ECU_ADDRESS 0x60034B34 /end MEASUREMENT
/begin MEASUREMENT DFC_st.DFC_ComFrbd_463h_OBC_OUT_VOLTAGE "" UBYTE DFC_OneToOne 1 100 0.00 255.0 FORMAT "%5.1" ECU_ADDRESS 0x60034B35 /end MEASUREMENT
/begin MEASUREMENT DFC_st.DFC_ComFrbd_463h_OBC_TEMPERATURE "" UBYTE DFC_OneToOne 1 100 0.00 255.0 FORMAT "%5.1" ECU_ADDRESS 0x60034B36 /end MEASUREMENT
/begin MEASUREMENT DFC_st.DFC_ComFrbd_473h_DCDC_Coolant_Temperature "" UBYTE DFC_OneToOne 1 100 0.00 255.0 FORMAT "%5.1" ECU_ADDRESS 0x60034B37 /end MEASUREMENT
/begin MEASUREMENT DFC_st.DFC_ComFrbd_473h_DCDC_TEMPERATURE "" UBYTE DFC_OneToOne 1 100 0.00 255.0 FORMAT "%5.1" ECU_ADDRESS 0x60034B38 /end MEASUREMENT
/begin MEASUREMENT DFC_st.DFC_ComFrbd_47Bh_eCOMP_BusBarCurrent "" UBYTE DFC_OneToOne 1 100 0.00 255.0 FORMAT "%5.1" ECU_ADDRESS 0x60034B39 /end MEASUREMENT
/begin MEASUREMENT DFC_st.DFC_ComFrbd_47Bh_eCOMP_BusBarVoltage "" UBYTE DFC_OneToOne 1 100 0.00 255.0 FORMAT "%5.1" ECU_ADDRESS 0x60034B3A /end MEASUREMENT
/begin MEASUREMENT DFC_st.DFC_ComFrbd_47Bh_eCOMP_CompressorSpeed "" UBYTE DFC_OneToOne 1 100 0.00 255.0 FORMAT "%5.1" ECU_ADDRESS 0x60034B3B /end MEASUREMENT
/begin MEASUREMENT DFC_st.DFC_ComFrbd_47Bh_eCOMP_IGBT_Temp "" UBYTE DFC_OneToOne 1 100 0.00 255.0 FORMAT "%5.1" ECU_ADDRESS 0x60034B3C /end MEASUREMENT
/begin MEASUREMENT DFC_st.DFC_ComFrbd_47Bh_eCOMP_PeakPhaCurrent "" UBYTE DFC_OneToOne 1 100 0.00 255.0 FORMAT "%5.1" ECU_ADDRESS 0x60034B3D /end MEASUREMENT
/begin MEASUREMENT DFC_st.DFC_ComFrbd_47Bh_eCOMP_Power_consumption "" UBYTE DFC_OneToOne 1 100 0.00 255.0 FORMAT "%5.1" ECU_ADDRESS 0x60034B3E /end MEASUREMENT
/begin MEASUREMENT DFC_st.DFC_ComFrbd_48Bh_eCOMP_Fault_Level "" UBYTE DFC_OneToOne 1 100 0.00 255.0 FORMAT "%5.1" ECU_ADDRESS 0x60034B3F /end MEASUREMENT
/begin MEASUREMENT DFC_st.DFC_ComFrbd_4F2h_VALEUR_SOC_ETENDUE "" UBYTE DFC_OneToOne 1 100 0.00 255.0 FORMAT "%5.1" ECU_ADDRESS 0x60034B40 /end MEASUREMENT
/begin MEASUREMENT DFC_st.DFC_ComFrbd_535h_HV_BATT_TEMP_AVG "" UBYTE DFC_OneToOne 1 100 0.00 255.0 FORMAT "%5.1" ECU_ADDRESS 0x60034B41 /end MEASUREMENT
/begin MEASUREMENT DFC_st.DFC_ComFrbd_543h_HVBAT_RESTBATTENERGY "" UBYTE DFC_OneToOne 1 100 0.00 255.0 FORMAT "%5.1" ECU_ADDRESS 0x60034B42 /end MEASUREMENT
/begin MEASUREMENT DFC_st.DFC_ComFrbd_543h_HVBAT_SOH "" UBYTE DFC_OneToOne 1 100 0.00 255.0 FORMAT "%5.1" ECU_ADDRESS 0x60034B43 /end MEASUREMENT
/begin MEASUREMENT DFC_st.DFC_ComFrbd_543h_HV_BATT_SOH_RES "" UBYTE DFC_OneToOne 1 100 0.00 255.0 FORMAT "%5.1" ECU_ADDRESS 0x60034B44 /end MEASUREMENT
/begin MEASUREMENT DFC_st.DFC_ComFrbd_592h_IBATT_1 "" UBYTE DFC_OneToOne 1 100 0.00 255.0 FORMAT "%5.1" ECU_ADDRESS 0x60034B45 /end MEASUREMENT
/begin MEASUREMENT DFC_st.DFC_ComFrbd_592h_IBATT_2 "" UBYTE DFC_OneToOne 1 100 0.00 255.0 FORMAT "%5.1" ECU_ADDRESS 0x60034B46 /end MEASUREMENT
/begin MEASUREMENT DFC_st.DFC_ComFrbd_592h_IBATT_3 "" UBYTE DFC_OneToOne 1 100 0.00 255.0 FORMAT "%5.1" ECU_ADDRESS 0x60034B47 /end MEASUREMENT
/begin MEASUREMENT DFC_st.DFC_ComFrbd_592h_TEMP_BATT "" UBYTE DFC_OneToOne 1 100 0.00 255.0 FORMAT "%5.1" ECU_ADDRESS 0x60034B48 /end MEASUREMENT
/begin MEASUREMENT DFC_st.DFC_ComFrbd_592h_U_BATT_BECB "" UBYTE DFC_OneToOne 1 100 0.00 255.0 FORMAT "%5.1" ECU_ADDRESS 0x60034B49 /end MEASUREMENT
/begin MEASUREMENT DFC_st.DFC_ComFrbd_595h_HVBAT_TIME_TO_CHRG_80 "" UBYTE DFC_OneToOne 1 100 0.00 255.0 FORMAT "%5.1" ECU_ADDRESS 0x60034B4A /end MEASUREMENT
/begin MEASUREMENT DFC_st.DFC_ComFrbd_5B2h_TEMP_AIR_EXT "" UBYTE DFC_OneToOne 1 100 0.00 255.0 FORMAT "%5.1" ECU_ADDRESS 0x60034B4B /end MEASUREMENT
/begin MEASUREMENT DFC_st.DFC_ComFrbd_635h_HVBAT_NEG_CONT_COUNT_SEG1 "" UBYTE DFC_OneToOne 1 100 0.00 255.0 FORMAT "%5.1" ECU_ADDRESS 0x60034B4C /end MEASUREMENT
/begin MEASUREMENT DFC_st.DFC_ComFrbd_635h_HVBAT_NEG_CONT_COUNT_SEG3 "" UBYTE DFC_OneToOne 1 100 0.00 255.0 FORMAT "%5.1" ECU_ADDRESS 0x60034B4D /end MEASUREMENT
/begin MEASUREMENT DFC_st.DFC_ComFrbd_635h_HVBAT_NEG_CONT_COUNT_SEG4 "" UBYTE DFC_OneToOne 1 100 0.00 255.0 FORMAT "%5.1" ECU_ADDRESS 0x60034B4E /end MEASUREMENT
/begin MEASUREMENT DFC_st.DFC_ComFrbd_635h_HVBAT_PST_CONT_COUNT_SEG1 "" UBYTE DFC_OneToOne 1 100 0.00 255.0 FORMAT "%5.1" ECU_ADDRESS 0x60034B4F /end MEASUREMENT
/begin MEASUREMENT DFC_st.DFC_ComFrbd_635h_HVBAT_PST_CONT_COUNT_SEG3 "" UBYTE DFC_OneToOne 1 100 0.00 255.0 FORMAT "%5.1" ECU_ADDRESS 0x60034B50 /end MEASUREMENT
/begin MEASUREMENT DFC_st.DFC_ComFrbd_635h_HVBAT_PST_CONT_COUNT_SEG4 "" UBYTE DFC_OneToOne 1 100 0.00 255.0 FORMAT "%5.1" ECU_ADDRESS 0x60034B51 /end MEASUREMENT
/begin MEASUREMENT DFC_st.DFC_ComFrbd_645h_HVBAT_PRECHRGE_CONT_COUNT_SEG1 "" UBYTE DFC_OneToOne 1 100 0.00 255.0 FORMAT "%5.1" ECU_ADDRESS 0x60034B52 /end MEASUREMENT
/begin MEASUREMENT DFC_st.DFC_ComFrbd_645h_HVBAT_PRECHRGE_CONT_COUNT_SEG2 "" UBYTE DFC_OneToOne 1 100 0.00 255.0 FORMAT "%5.1" ECU_ADDRESS 0x60034B53 /end MEASUREMENT
/begin MEASUREMENT DFC_st.DFC_ComFrbd_675h_HVBAT_REMAININGBATTCAPACITY "" UBYTE DFC_OneToOne 1 100 0.00 255.0 FORMAT "%5.1" ECU_ADDRESS 0x60034B54 /end MEASUREMENT
/begin MEASUREMENT DFC_st.DFC_ComInvld_205h_HVBAT_CHARGING_STATUS "" UBYTE DFC_OneToOne 1 100 0.00 255.0 FORMAT "%5.1" ECU_ADDRESS 0x60034B55 /end MEASUREMENT
/begin MEASUREMENT DFC_st.DFC_ComInvld_205h_HVBAT_PACK_CURRENT "" UBYTE DFC_OneToOne 1 100 0.00 255.0 FORMAT "%5.1" ECU_ADDRESS 0x60034B56 /end MEASUREMENT
/begin MEASUREMENT DFC_st.DFC_ComInvld_205h_HVBAT_SOC_DISPLAY "" UBYTE DFC_OneToOne 1 100 0.00 255.0 FORMAT "%5.1" ECU_ADDRESS 0x60034B57 /end MEASUREMENT
/begin MEASUREMENT DFC_st.DFC_ComInvld_205h_HVBAT_VOLTAGE "" UBYTE DFC_OneToOne 1 100 0.00 255.0 FORMAT "%5.1" ECU_ADDRESS 0x60034B58 /end MEASUREMENT
/begin MEASUREMENT DFC_st.DFC_ComInvld_217h_INV_DC_BUS_VOLTAGE "" UBYTE DFC_OneToOne 1 100 0.00 255.0 FORMAT "%5.1" ECU_ADDRESS 0x60034B59 /end MEASUREMENT
/begin MEASUREMENT DFC_st.DFC_ComInvld_217h_INV_MTR_ACTUAL_TRQ "" UBYTE DFC_OneToOne 1 100 0.00 255.0 FORMAT "%5.1" ECU_ADDRESS 0x60034B5A /end MEASUREMENT
/begin MEASUREMENT DFC_st.DFC_ComInvld_217h_INV_MTR_SPEED "" UBYTE DFC_OneToOne 1 100 0.00 255.0 FORMAT "%5.1" ECU_ADDRESS 0x60034B5B /end MEASUREMENT
/begin MEASUREMENT DFC_st.DFC_ComInvld_217h_INV_MTR_TRQ "" UBYTE DFC_OneToOne 1 100 0.00 255.0 FORMAT "%5.1" ECU_ADDRESS 0x60034B5C /end MEASUREMENT
/begin MEASUREMENT DFC_st.DFC_ComInvld_227h_INV_DC_CURRENT "" UBYTE DFC_OneToOne 1 100 0.00 255.0 FORMAT "%5.1" ECU_ADDRESS 0x60034B5D /end MEASUREMENT
/begin MEASUREMENT DFC_st.DFC_ComInvld_227h_INV_MOTORING_PEAK_TRQ "" UBYTE DFC_OneToOne 1 100 0.00 255.0 FORMAT "%5.1" ECU_ADDRESS 0x60034B5E /end MEASUREMENT
/begin MEASUREMENT DFC_st.DFC_ComInvld_227h_INV_MTR_INST_INPUT_POWER "" UBYTE DFC_OneToOne 1 100 0.00 255.0 FORMAT "%5.1" ECU_ADDRESS 0x60034B5F /end MEASUREMENT
/begin MEASUREMENT DFC_st.DFC_ComInvld_227h_INV_REGEN_PEAK_TRQ "" UBYTE DFC_OneToOne 1 100 0.00 255.0 FORMAT "%5.1" ECU_ADDRESS 0x60034B60 /end MEASUREMENT
/begin MEASUREMENT DFC_st.DFC_ComInvld_237h_INV_ACTIVE_DISCHARGE_STATUS "" UBYTE DFC_OneToOne 1 100 0.00 255.0 FORMAT "%5.1" ECU_ADDRESS 0x60034B61 /end MEASUREMENT
/begin MEASUREMENT DFC_st.DFC_ComInvld_237h_INV_FAULT_LEVEL "" UBYTE DFC_OneToOne 1 100 0.00 255.0 FORMAT "%5.1" ECU_ADDRESS 0x60034B62 /end MEASUREMENT
/begin MEASUREMENT DFC_st.DFC_ComInvld_237h_INV_STAB_MIN_TRQ "" UBYTE DFC_OneToOne 1 100 0.00 255.0 FORMAT "%5.1" ECU_ADDRESS 0x60034B63 /end MEASUREMENT
/begin MEASUREMENT DFC_st.DFC_ComInvld_259h_TGLM_MODE_PUSH "" UBYTE DFC_OneToOne 1 100 0.00 255.0 FORMAT "%5.1" ECU_ADDRESS 0x60034B64 /end MEASUREMENT
/begin MEASUREMENT DFC_st.DFC_ComInvld_259h_TOGGLE_MONOSTABLE_POS "" UBYTE DFC_OneToOne 1 100 0.00 255.0 FORMAT "%5.1" ECU_ADDRESS 0x60034B65 /end MEASUREMENT
/begin MEASUREMENT DFC_st.DFC_ComInvld_26h_AC_SWITCH_REQ "" UBYTE DFC_OneToOne 1 100 0.00 255.0 FORMAT "%5.1" ECU_ADDRESS 0x60034B66 /end MEASUREMENT
/begin MEASUREMENT DFC_st.DFC_ComInvld_26h_BLOWER_POSITION "" UBYTE DFC_OneToOne 1 100 0.00 255.0 FORMAT "%5.1" ECU_ADDRESS 0x60034B67 /end MEASUREMENT
/begin MEASUREMENT DFC_st.DFC_ComInvld_26h_EVAP_SENSOR_FAULT "" UBYTE DFC_OneToOne 1 100 0.00 255.0 FORMAT "%5.1" ECU_ADDRESS 0x60034B68 /end MEASUREMENT
/begin MEASUREMENT DFC_st.DFC_ComInvld_26h_EVAP_SENSOR_VALUE "" UBYTE DFC_OneToOne 1 100 0.00 255.0 FORMAT "%5.1" ECU_ADDRESS 0x60034B69 /end MEASUREMENT
/begin MEASUREMENT DFC_st.DFC_ComInvld_26h_POTENTIOMETER_FAULT "" UBYTE DFC_OneToOne 1 100 0.00 255.0 FORMAT "%5.1" ECU_ADDRESS 0x60034B6A /end MEASUREMENT
/begin MEASUREMENT DFC_st.DFC_ComInvld_26h_REAR_DEFOG_REQ "" UBYTE DFC_OneToOne 1 100 0.00 255.0 FORMAT "%5.1" ECU_ADDRESS 0x60034B6B /end MEASUREMENT
/begin MEASUREMENT DFC_st.DFC_ComInvld_26h_TEMP_POSITION "" UBYTE DFC_OneToOne 1 100 0.00 255.0 FORMAT "%5.1" ECU_ADDRESS 0x60034B6C /end MEASUREMENT
/begin MEASUREMENT DFC_st.DFC_ComInvld_273h_OBC_FAULT_LEVEL "" UBYTE DFC_OneToOne 1 100 0.00 255.0 FORMAT "%5.1" ECU_ADDRESS 0x60034B6D /end MEASUREMENT
/begin MEASUREMENT DFC_st.DFC_ComInvld_273h_OBC_outputpower_capability "" UBYTE DFC_OneToOne 1 100 0.00 255.0 FORMAT "%5.1" ECU_ADDRESS 0x60034B6E /end MEASUREMENT
/begin MEASUREMENT DFC_st.DFC_ComInvld_275h_HVBAT_DISCHARGE_30S_AVAILABLE_CURRENT "" UBYTE DFC_OneToOne 1 100 0.00 255.0 FORMAT "%5.1" ECU_ADDRESS 0x60034B6F /end MEASUREMENT
/begin MEASUREMENT DFC_st.DFC_ComInvld_275h_HVBAT_DISCHARGE_30S_AVAILABLE_POWER "" UBYTE DFC_OneToOne 1 100 0.00 255.0 FORMAT "%5.1" ECU_ADDRESS 0x60034B70 /end MEASUREMENT
/begin MEASUREMENT DFC_st.DFC_ComInvld_283h_DCDC_IN_CURRENT "" UBYTE DFC_OneToOne 1 100 0.00 255.0 FORMAT "%5.1" ECU_ADDRESS 0x60034B71 /end MEASUREMENT
/begin MEASUREMENT DFC_st.DFC_ComInvld_283h_DCDC_IN_VOLTAGE "" UBYTE DFC_OneToOne 1 100 0.00 255.0 FORMAT "%5.1" ECU_ADDRESS 0x60034B72 /end MEASUREMENT
/begin MEASUREMENT DFC_st.DFC_ComInvld_283h_DCDC_OUT_CURRENT "" UBYTE DFC_OneToOne 1 100 0.00 255.0 FORMAT "%5.1" ECU_ADDRESS 0x60034B73 /end MEASUREMENT
/begin MEASUREMENT DFC_st.DFC_ComInvld_283h_DCDC_OUT_VOLTAGE "" UBYTE DFC_OneToOne 1 100 0.00 255.0 FORMAT "%5.1" ECU_ADDRESS 0x60034B74 /end MEASUREMENT
/begin MEASUREMENT DFC_st.DFC_ComInvld_285h_HVBAT_REGEN_CHG_30S_CURRENT_LIMIT "" UBYTE DFC_OneToOne 1 100 0.00 255.0 FORMAT "%5.1" ECU_ADDRESS 0x60034B75 /end MEASUREMENT
/begin MEASUREMENT DFC_st.DFC_ComInvld_285h_HVBAT_REGEN_CHRG_30S_POWER_LIMIT "" UBYTE DFC_OneToOne 1 100 0.00 255.0 FORMAT "%5.1" ECU_ADDRESS 0x60034B76 /end MEASUREMENT
/begin MEASUREMENT DFC_st.DFC_ComInvld_293h_DCDC_FAULT_LEVEL "" UBYTE DFC_OneToOne 1 100 0.00 255.0 FORMAT "%5.1" ECU_ADDRESS 0x60034B77 /end MEASUREMENT
/begin MEASUREMENT DFC_st.DFC_ComInvld_293h_DCDC_outputpower_capability "" UBYTE DFC_OneToOne 1 100 0.00 255.0 FORMAT "%5.1" ECU_ADDRESS 0x60034B78 /end MEASUREMENT
/begin MEASUREMENT DFC_st.DFC_ComInvld_325h_HVBAT_EPLUG_STATUS "" UBYTE DFC_OneToOne 1 100 0.00 255.0 FORMAT "%5.1" ECU_ADDRESS 0x60034B79 /end MEASUREMENT
/begin MEASUREMENT DFC_st.DFC_ComInvld_325h_HVBAT_HVIL_STS "" UBYTE DFC_OneToOne 1 100 0.00 255.0 FORMAT "%5.1" ECU_ADDRESS 0x60034B7A /end MEASUREMENT
/begin MEASUREMENT DFC_st.DFC_ComInvld_325h_HVBAT_INSULATION_FAULT "" UBYTE DFC_OneToOne 1 100 0.00 255.0 FORMAT "%5.1" ECU_ADDRESS 0x60034B7B /end MEASUREMENT
/begin MEASUREMENT DFC_st.DFC_ComInvld_325h_HVBAT_INSULATION_RESISTANCE "" UBYTE DFC_OneToOne 1 100 0.00 255.0 FORMAT "%5.1" ECU_ADDRESS 0x60034B7C /end MEASUREMENT
/begin MEASUREMENT DFC_st.DFC_ComInvld_325h_HVBAT_TEMPERATURE "" UBYTE DFC_OneToOne 1 100 0.00 255.0 FORMAT "%5.1" ECU_ADDRESS 0x60034B7D /end MEASUREMENT
/begin MEASUREMENT DFC_st.DFC_ComInvld_335h_HVBAT_CHRG_CONTINUOUS_CURR_MAX "" UBYTE DFC_OneToOne 1 100 0.00 255.0 FORMAT "%5.1" ECU_ADDRESS 0x60034B7E /end MEASUREMENT
/begin MEASUREMENT DFC_st.DFC_ComInvld_335h_HVBAT_CHRG_COTINUOUS_CURR_REQ "" UBYTE DFC_OneToOne 1 100 0.00 255.0 FORMAT "%5.1" ECU_ADDRESS 0x60034B7F /end MEASUREMENT
/begin MEASUREMENT DFC_st.DFC_ComInvld_335h_HVBAT_CHRG_MAX_VOLT "" UBYTE DFC_OneToOne 1 100 0.00 255.0 FORMAT "%5.1" ECU_ADDRESS 0x60034B80 /end MEASUREMENT
/begin MEASUREMENT DFC_st.DFC_ComInvld_335h_HVBAT_DC_BUS_VOLTAGE "" UBYTE DFC_OneToOne 1 100 0.00 255.0 FORMAT "%5.1" ECU_ADDRESS 0x60034B81 /end MEASUREMENT
/begin MEASUREMENT DFC_st.DFC_ComInvld_38Dh_VITESSE_VEHICULE_ROUES "" UBYTE DFC_OneToOne 1 100 0.00 255.0 FORMAT "%5.1" ECU_ADDRESS 0x60034B82 /end MEASUREMENT
/begin MEASUREMENT DFC_st.DFC_ComInvld_38Dh_VVH_INDISP "" UBYTE DFC_OneToOne 1 100 0.00 255.0 FORMAT "%5.1" ECU_ADDRESS 0x60034B83 /end MEASUREMENT
/begin MEASUREMENT DFC_st.DFC_ComInvld_427h_INV_COOLANT_TEMP "" UBYTE DFC_OneToOne 1 100 0.00 255.0 FORMAT "%5.1" ECU_ADDRESS 0x60034B84 /end MEASUREMENT
/begin MEASUREMENT DFC_st.DFC_ComInvld_427h_INV_MOTOR_TEMP "" UBYTE DFC_OneToOne 1 100 0.00 255.0 FORMAT "%5.1" ECU_ADDRESS 0x60034B85 /end MEASUREMENT
/begin MEASUREMENT DFC_st.DFC_ComInvld_427h_INV_OP_MODE "" UBYTE DFC_OneToOne 1 100 0.00 255.0 FORMAT "%5.1" ECU_ADDRESS 0x60034B86 /end MEASUREMENT
/begin MEASUREMENT DFC_st.DFC_ComInvld_427h_INV_PERMISIBLE_TORQUE "" UBYTE DFC_OneToOne 1 100 0.00 255.0 FORMAT "%5.1" ECU_ADDRESS 0x60034B87 /end MEASUREMENT
/begin MEASUREMENT DFC_st.DFC_ComInvld_427h_INV_TEMP "" UBYTE DFC_OneToOne 1 100 0.00 255.0 FORMAT "%5.1" ECU_ADDRESS 0x60034B88 /end MEASUREMENT
/begin MEASUREMENT DFC_st.DFC_ComInvld_432h_REVEIL_PRINCIPAL "" UBYTE DFC_OneToOne 1 100 0.00 255.0 FORMAT "%5.1" ECU_ADDRESS 0x60034B89 /end MEASUREMENT
/begin MEASUREMENT DFC_st.DFC_ComInvld_435h_HVBAT_MAX_CELL_VOLT "" UBYTE DFC_OneToOne 1 100 0.00 255.0 FORMAT "%5.1" ECU_ADDRESS 0x60034B8A /end MEASUREMENT
/begin MEASUREMENT DFC_st.DFC_ComInvld_435h_HVBAT_MAX_CELL_VOLT_NUM "" UBYTE DFC_OneToOne 1 100 0.00 255.0 FORMAT "%5.1" ECU_ADDRESS 0x60034B8B /end MEASUREMENT
/begin MEASUREMENT DFC_st.DFC_ComInvld_435h_HVBAT_MAX_SENSOR_TEMP "" UBYTE DFC_OneToOne 1 100 0.00 255.0 FORMAT "%5.1" ECU_ADDRESS 0x60034B8C /end MEASUREMENT
/begin MEASUREMENT DFC_st.DFC_ComInvld_435h_HVBAT_MIN_CELL_VOLT "" UBYTE DFC_OneToOne 1 100 0.00 255.0 FORMAT "%5.1" ECU_ADDRESS 0x60034B8D /end MEASUREMENT
/begin MEASUREMENT DFC_st.DFC_ComInvld_435h_HVBAT_MIN_CELL_VOLT_NUM "" UBYTE DFC_OneToOne 1 100 0.00 255.0 FORMAT "%5.1" ECU_ADDRESS 0x60034B8E /end MEASUREMENT
/begin MEASUREMENT DFC_st.DFC_ComInvld_442h_BCCM_BLOWER_RELAY_STS "" UBYTE DFC_OneToOne 1 100 0.00 255.0 FORMAT "%5.1" ECU_ADDRESS 0x60034B8F /end MEASUREMENT
/begin MEASUREMENT DFC_st.DFC_ComInvld_453h_OBC_IN_CURRENT "" UBYTE DFC_OneToOne 1 100 0.00 255.0 FORMAT "%5.1" ECU_ADDRESS 0x60034B90 /end MEASUREMENT
/begin MEASUREMENT DFC_st.DFC_ComInvld_453h_OBC_IN_VOLTAGE "" UBYTE DFC_OneToOne 1 100 0.00 255.0 FORMAT "%5.1" ECU_ADDRESS 0x60034B91 /end MEASUREMENT
/begin MEASUREMENT DFC_st.DFC_ComInvld_453h_OBC_IP_POWER "" UBYTE DFC_OneToOne 1 100 0.00 255.0 FORMAT "%5.1" ECU_ADDRESS 0x60034B92 /end MEASUREMENT
/begin MEASUREMENT DFC_st.DFC_ComInvld_455h_HVBAT_NOMINAL_VOLTAGE "" UBYTE DFC_OneToOne 1 100 0.00 255.0 FORMAT "%5.1" ECU_ADDRESS 0x60034B93 /end MEASUREMENT
/begin MEASUREMENT DFC_st.DFC_ComInvld_463h_OBC_OUT_CURRENT "" UBYTE DFC_OneToOne 1 100 0.00 255.0 FORMAT "%5.1" ECU_ADDRESS 0x60034B94 /end MEASUREMENT
/begin MEASUREMENT DFC_st.DFC_ComInvld_463h_OBC_OUT_VOLTAGE "" UBYTE DFC_OneToOne 1 100 0.00 255.0 FORMAT "%5.1" ECU_ADDRESS 0x60034B95 /end MEASUREMENT
/begin MEASUREMENT DFC_st.DFC_ComInvld_463h_OBC_TEMPERATURE "" UBYTE DFC_OneToOne 1 100 0.00 255.0 FORMAT "%5.1" ECU_ADDRESS 0x60034B96 /end MEASUREMENT
/begin MEASUREMENT DFC_st.DFC_ComInvld_473h_DCDC_Coolant_Temperature "" UBYTE DFC_OneToOne 1 100 0.00 255.0 FORMAT "%5.1" ECU_ADDRESS 0x60034B97 /end MEASUREMENT
/begin MEASUREMENT DFC_st.DFC_ComInvld_473h_DCDC_TEMPERATURE "" UBYTE DFC_OneToOne 1 100 0.00 255.0 FORMAT "%5.1" ECU_ADDRESS 0x60034B98 /end MEASUREMENT
/begin MEASUREMENT DFC_st.DFC_ComInvld_47Bh_eCOMP_BusBarCurrent "" UBYTE DFC_OneToOne 1 100 0.00 255.0 FORMAT "%5.1" ECU_ADDRESS 0x60034B99 /end MEASUREMENT
/begin MEASUREMENT DFC_st.DFC_ComInvld_47Bh_eCOMP_BusBarVoltage "" UBYTE DFC_OneToOne 1 100 0.00 255.0 FORMAT "%5.1" ECU_ADDRESS 0x60034B9A /end MEASUREMENT
/begin MEASUREMENT DFC_st.DFC_ComInvld_47Bh_eCOMP_CompressorSpeed "" UBYTE DFC_OneToOne 1 100 0.00 255.0 FORMAT "%5.1" ECU_ADDRESS 0x60034B9B /end MEASUREMENT
/begin MEASUREMENT DFC_st.DFC_ComInvld_47Bh_eCOMP_IGBT_Temp "" UBYTE DFC_OneToOne 1 100 0.00 255.0 FORMAT "%5.1" ECU_ADDRESS 0x60034B9C /end MEASUREMENT
/begin MEASUREMENT DFC_st.DFC_ComInvld_47Bh_eCOMP_PeakPhaCurrent "" UBYTE DFC_OneToOne 1 100 0.00 255.0 FORMAT "%5.1" ECU_ADDRESS 0x60034B9D /end MEASUREMENT
/begin MEASUREMENT DFC_st.DFC_ComInvld_47Bh_eCOMP_Power_consumption "" UBYTE DFC_OneToOne 1 100 0.00 255.0 FORMAT "%5.1" ECU_ADDRESS 0x60034B9E /end MEASUREMENT
/begin MEASUREMENT DFC_st.DFC_ComInvld_4F2h_STATUS_SOC "" UBYTE DFC_OneToOne 1 100 0.00 255.0 FORMAT "%5.1" ECU_ADDRESS 0x60034B9F /end MEASUREMENT
/begin MEASUREMENT DFC_st.DFC_ComInvld_4F2h_TEMP_BATT_STATUS "" UBYTE DFC_OneToOne 1 100 0.00 255.0 FORMAT "%5.1" ECU_ADDRESS 0x60034BA0 /end MEASUREMENT
/begin MEASUREMENT DFC_st.DFC_ComInvld_4F2h_VALEUR_SOC_ETENDUE "" UBYTE DFC_OneToOne 1 100 0.00 255.0 FORMAT "%5.1" ECU_ADDRESS 0x60034BA1 /end MEASUREMENT
/begin MEASUREMENT DFC_st.DFC_ComInvld_535h_HV_BATT_TEMP_AVG "" UBYTE DFC_OneToOne 1 100 0.00 255.0 FORMAT "%5.1" ECU_ADDRESS 0x60034BA2 /end MEASUREMENT
/begin MEASUREMENT DFC_st.DFC_ComInvld_543h_HVBAT_RESTBATTENERGY "" UBYTE DFC_OneToOne 1 100 0.00 255.0 FORMAT "%5.1" ECU_ADDRESS 0x60034BA3 /end MEASUREMENT
/begin MEASUREMENT DFC_st.DFC_ComInvld_543h_HVBAT_SOH "" UBYTE DFC_OneToOne 1 100 0.00 255.0 FORMAT "%5.1" ECU_ADDRESS 0x60034BA4 /end MEASUREMENT
/begin MEASUREMENT DFC_st.DFC_ComInvld_543h_HV_BATT_SOH_RES "" UBYTE DFC_OneToOne 1 100 0.00 255.0 FORMAT "%5.1" ECU_ADDRESS 0x60034BA5 /end MEASUREMENT
/begin MEASUREMENT DFC_st.DFC_ComInvld_552h_CPT_TEMPOREL "" UBYTE DFC_OneToOne 1 100 0.00 255.0 FORMAT "%5.1" ECU_ADDRESS 0x60034BA6 /end MEASUREMENT
/begin MEASUREMENT DFC_st.DFC_ComInvld_552h_KILOMETRAGE "" UBYTE DFC_OneToOne 1 100 0.00 255.0 FORMAT "%5.1" ECU_ADDRESS 0x60034BA7 /end MEASUREMENT
/begin MEASUREMENT DFC_st.DFC_ComInvld_583h_HV_BATT_DISCONT_CSE_OPEN "" UBYTE DFC_OneToOne 1 100 0.00 255.0 FORMAT "%5.1" ECU_ADDRESS 0x60034BA8 /end MEASUREMENT
/begin MEASUREMENT DFC_st.DFC_ComInvld_592h_CALIBRE_IBATT "" UBYTE DFC_OneToOne 1 100 0.00 255.0 FORMAT "%5.1" ECU_ADDRESS 0x60034BA9 /end MEASUREMENT
/begin MEASUREMENT DFC_st.DFC_ComInvld_592h_IBATT_1 "" UBYTE DFC_OneToOne 1 100 0.00 255.0 FORMAT "%5.1" ECU_ADDRESS 0x60034BAA /end MEASUREMENT
/begin MEASUREMENT DFC_st.DFC_ComInvld_592h_IBATT_2 "" UBYTE DFC_OneToOne 1 100 0.00 255.0 FORMAT "%5.1" ECU_ADDRESS 0x60034BAB /end MEASUREMENT
/begin MEASUREMENT DFC_st.DFC_ComInvld_592h_IBATT_3 "" UBYTE DFC_OneToOne 1 100 0.00 255.0 FORMAT "%5.1" ECU_ADDRESS 0x60034BAC /end MEASUREMENT
/begin MEASUREMENT DFC_st.DFC_ComInvld_592h_TEMP_BATT "" UBYTE DFC_OneToOne 1 100 0.00 255.0 FORMAT "%5.1" ECU_ADDRESS 0x60034BAD /end MEASUREMENT
/begin MEASUREMENT DFC_st.DFC_ComInvld_592h_U_BATT_BECB "" UBYTE DFC_OneToOne 1 100 0.00 255.0 FORMAT "%5.1" ECU_ADDRESS 0x60034BAE /end MEASUREMENT
/begin MEASUREMENT DFC_st.DFC_ComInvld_595h_HVBAT_TIME_TO_CHRG_80 "" UBYTE DFC_OneToOne 1 100 0.00 255.0 FORMAT "%5.1" ECU_ADDRESS 0x60034BAF /end MEASUREMENT
/begin MEASUREMENT DFC_st.DFC_ComInvld_5B2h_TEMP_AIR_EXT "" UBYTE DFC_OneToOne 1 100 0.00 255.0 FORMAT "%5.1" ECU_ADDRESS 0x60034BB0 /end MEASUREMENT
/begin MEASUREMENT DFC_st.DFC_ComInvld_5B5h_HVBAT_THERMAL_RUNAWAY "" UBYTE DFC_OneToOne 1 100 0.00 255.0 FORMAT "%5.1" ECU_ADDRESS 0x60034BB1 /end MEASUREMENT
/begin MEASUREMENT DFC_st.DFC_ComInvld_635h_HVBAT_NEG_CONT_COUNT_SEG1 "" UBYTE DFC_OneToOne 1 100 0.00 255.0 FORMAT "%5.1" ECU_ADDRESS 0x60034BB2 /end MEASUREMENT
/begin MEASUREMENT DFC_st.DFC_ComInvld_635h_HVBAT_NEG_CONT_COUNT_SEG3 "" UBYTE DFC_OneToOne 1 100 0.00 255.0 FORMAT "%5.1" ECU_ADDRESS 0x60034BB3 /end MEASUREMENT
/begin MEASUREMENT DFC_st.DFC_ComInvld_635h_HVBAT_NEG_CONT_COUNT_SEG4 "" UBYTE DFC_OneToOne 1 100 0.00 255.0 FORMAT "%5.1" ECU_ADDRESS 0x60034BB4 /end MEASUREMENT
/begin MEASUREMENT DFC_st.DFC_ComInvld_635h_HVBAT_PST_CONT_COUNT_SEG1 "" UBYTE DFC_OneToOne 1 100 0.00 255.0 FORMAT "%5.1" ECU_ADDRESS 0x60034BB5 /end MEASUREMENT
/begin MEASUREMENT DFC_st.DFC_ComInvld_635h_HVBAT_PST_CONT_COUNT_SEG3 "" UBYTE DFC_OneToOne 1 100 0.00 255.0 FORMAT "%5.1" ECU_ADDRESS 0x60034BB6 /end MEASUREMENT
/begin MEASUREMENT DFC_st.DFC_ComInvld_635h_HVBAT_PST_CONT_COUNT_SEG4 "" UBYTE DFC_OneToOne 1 100 0.00 255.0 FORMAT "%5.1" ECU_ADDRESS 0x60034BB7 /end MEASUREMENT
/begin MEASUREMENT DFC_st.DFC_ComInvld_645h_HVBAT_PRECHRGE_CONT_COUNT_SEG1 "" UBYTE DFC_OneToOne 1 100 0.00 255.0 FORMAT "%5.1" ECU_ADDRESS 0x60034BB8 /end MEASUREMENT
/begin MEASUREMENT DFC_st.DFC_ComInvld_645h_HVBAT_PRECHRGE_CONT_COUNT_SEG2 "" UBYTE DFC_OneToOne 1 100 0.00 255.0 FORMAT "%5.1" ECU_ADDRESS 0x60034BB9 /end MEASUREMENT
/begin MEASUREMENT DFC_st.DFC_ComInvld_675h_HVBAT_REMAININGBATTCAPACITY "" UBYTE DFC_OneToOne 1 100 0.00 255.0 FORMAT "%5.1" ECU_ADDRESS 0x60034BBA /end MEASUREMENT
/begin MEASUREMENT DINH_nrActvInhReas.FId_bInhDiag_CLUSTER_5E7 "" UWORD DINH_ct_Compu 1 100 -4095.000 4096.000 BIT_MASK 0x1fff FORMAT "%8.3" ECU_ADDRESS 0x60021612 /end MEASUREMENT
/begin MEASUREMENT DINH_nrActvInhReas.FId_bInhDiag_CONTEXTE_1_5B2 "" UWORD DINH_ct_Compu 1 100 -4095.000 4096.000 BIT_MASK 0x1fff FORMAT "%8.3" ECU_ADDRESS 0x60021614 /end MEASUREMENT
/begin MEASUREMENT DINH_nrActvInhReas.FId_bInhDiag_DAT3_BSI_4F2h "" UWORD DINH_ct_Compu 1 100 -4095.000 4096.000 BIT_MASK 0x1fff FORMAT "%8.3" ECU_ADDRESS 0x60021616 /end MEASUREMENT
/begin MEASUREMENT DINH_nrActvInhReas.FId_bInhDiag_DCDC_283h "" UWORD DINH_ct_Compu 1 100 -4095.000 4096.000 BIT_MASK 0x1fff FORMAT "%8.3" ECU_ADDRESS 0x60021618 /end MEASUREMENT
/begin MEASUREMENT DINH_nrActvInhReas.FId_bInhDiag_DCDC_293h "" UWORD DINH_ct_Compu 1 100 -4095.000 4096.000 BIT_MASK 0x1fff FORMAT "%8.3" ECU_ADDRESS 0x6002161A /end MEASUREMENT
/begin MEASUREMENT DINH_nrActvInhReas.FId_bInhDiag_DCDC_473h "" UWORD DINH_ct_Compu 1 100 -4095.000 4096.000 BIT_MASK 0x1fff FORMAT "%8.3" ECU_ADDRESS 0x6002161C /end MEASUREMENT
/begin MEASUREMENT DINH_nrActvInhReas.FId_bInhDiag_DCDC_663h "" UWORD DINH_ct_Compu 1 100 -4095.000 4096.000 BIT_MASK 0x1fff FORMAT "%8.3" ECU_ADDRESS 0x6002161E /end MEASUREMENT
/begin MEASUREMENT DINH_nrActvInhReas.FId_bInhDiag_HS3_AUTO_GEARBOX_SWITCH_STATUS "" UWORD DINH_ct_Compu 1 100 -4095.000 4096.000 BIT_MASK 0x1fff FORMAT "%8.3" ECU_ADDRESS 0x60021620 /end MEASUREMENT
/begin MEASUREMENT DINH_nrActvInhReas.FId_bInhDiag_HVAC_PANEL_26h "" UWORD DINH_ct_Compu 1 100 -4095.000 4096.000 BIT_MASK 0x1fff FORMAT "%8.3" ECU_ADDRESS 0x60021622 /end MEASUREMENT
/begin MEASUREMENT DINH_nrActvInhReas.FId_bInhDiag_HVBAT_205h "" UWORD DINH_ct_Compu 1 100 -4095.000 4096.000 BIT_MASK 0x1fff FORMAT "%8.3" ECU_ADDRESS 0x60021624 /end MEASUREMENT
/begin MEASUREMENT DINH_nrActvInhReas.FId_bInhDiag_HVBAT_275h "" UWORD DINH_ct_Compu 1 100 -4095.000 4096.000 BIT_MASK 0x1fff FORMAT "%8.3" ECU_ADDRESS 0x60021626 /end MEASUREMENT
/begin MEASUREMENT DINH_nrActvInhReas.FId_bInhDiag_HVBAT_285h "" UWORD DINH_ct_Compu 1 100 -4095.000 4096.000 BIT_MASK 0x1fff FORMAT "%8.3" ECU_ADDRESS 0x60021628 /end MEASUREMENT
/begin MEASUREMENT DINH_nrActvInhReas.FId_bInhDiag_HVBAT_325h "" UWORD DINH_ct_Compu 1 100 -4095.000 4096.000 BIT_MASK 0x1fff FORMAT "%8.3" ECU_ADDRESS 0x6002162A /end MEASUREMENT
/begin MEASUREMENT DINH_nrActvInhReas.FId_bInhDiag_HVBAT_335h "" UWORD DINH_ct_Compu 1 100 -4095.000 4096.000 BIT_MASK 0x1fff FORMAT "%8.3" ECU_ADDRESS 0x6002162C /end MEASUREMENT
/begin MEASUREMENT DINH_nrActvInhReas.FId_bInhDiag_HVBAT_455h "" UWORD DINH_ct_Compu 1 100 -4095.000 4096.000 BIT_MASK 0x1fff FORMAT "%8.3" ECU_ADDRESS 0x6002162E /end MEASUREMENT
/begin MEASUREMENT DINH_nrActvInhReas.FId_bInhDiag_HVBAT_535 "" UWORD DINH_ct_Compu 1 100 -4095.000 4096.000 BIT_MASK 0x1fff FORMAT "%8.3" ECU_ADDRESS 0x60021630 /end MEASUREMENT
/begin MEASUREMENT DINH_nrActvInhReas.FId_bInhDiag_HVBAT_595h "" UWORD DINH_ct_Compu 1 100 -4095.000 4096.000 BIT_MASK 0x1fff FORMAT "%8.3" ECU_ADDRESS 0x60021632 /end MEASUREMENT
/begin MEASUREMENT DINH_nrActvInhReas.FId_bInhDiag_HVBAT_635h "" UWORD DINH_ct_Compu 1 100 -4095.000 4096.000 BIT_MASK 0x1fff FORMAT "%8.3" ECU_ADDRESS 0x60021634 /end MEASUREMENT
/begin MEASUREMENT DINH_nrActvInhReas.FId_bInhDiag_HVBAT_645h "" UWORD DINH_ct_Compu 1 100 -4095.000 4096.000 BIT_MASK 0x1fff FORMAT "%8.3" ECU_ADDRESS 0x60021636 /end MEASUREMENT
/begin MEASUREMENT DINH_nrActvInhReas.FId_bInhDiag_HVBAT_665h "" UWORD DINH_ct_Compu 1 100 -4095.000 4096.000 BIT_MASK 0x1fff FORMAT "%8.3" ECU_ADDRESS 0x60021638 /end MEASUREMENT
/begin MEASUREMENT DINH_nrActvInhReas.FId_bInhDiag_HVBAT_675h "" UWORD DINH_ct_Compu 1 100 -4095.000 4096.000 BIT_MASK 0x1fff FORMAT "%8.3" ECU_ADDRESS 0x6002163A /end MEASUREMENT
/begin MEASUREMENT DINH_nrActvInhReas.FId_bInhDiag_HVBAT_THERMAL_5B5 "" UWORD DINH_ct_Compu 1 100 -4095.000 4096.000 BIT_MASK 0x1fff FORMAT "%8.3" ECU_ADDRESS 0x6002163C /end MEASUREMENT
/begin MEASUREMENT DINH_nrActvInhReas.FId_bInhDiag_HVBAT_VCU_435h "" UWORD DINH_ct_Compu 1 100 -4095.000 4096.000 BIT_MASK 0x1fff FORMAT "%8.3" ECU_ADDRESS 0x6002163E /end MEASUREMENT
/begin MEASUREMENT DINH_nrActvInhReas.FId_bInhDiag_HVBAT_VCU_543 "" UWORD DINH_ct_Compu 1 100 -4095.000 4096.000 BIT_MASK 0x1fff FORMAT "%8.3" ECU_ADDRESS 0x60021640 /end MEASUREMENT
/begin MEASUREMENT DINH_nrActvInhReas.FId_bInhDiag_HVBAT_VCU_583 "" UWORD DINH_ct_Compu 1 100 -4095.000 4096.000 BIT_MASK 0x1fff FORMAT "%8.3" ECU_ADDRESS 0x60021642 /end MEASUREMENT
/begin MEASUREMENT DINH_nrActvInhReas.FId_bInhDiag_INV_217h "" UWORD DINH_ct_Compu 1 100 -4095.000 4096.000 BIT_MASK 0x1fff FORMAT "%8.3" ECU_ADDRESS 0x60021644 /end MEASUREMENT
/begin MEASUREMENT DINH_nrActvInhReas.FId_bInhDiag_INV_227h "" UWORD DINH_ct_Compu 1 100 -4095.000 4096.000 BIT_MASK 0x1fff FORMAT "%8.3" ECU_ADDRESS 0x60021646 /end MEASUREMENT
/begin MEASUREMENT DINH_nrActvInhReas.FId_bInhDiag_INV_237 "" UWORD DINH_ct_Compu 1 100 -4095.000 4096.000 BIT_MASK 0x1fff FORMAT "%8.3" ECU_ADDRESS 0x60021648 /end MEASUREMENT
/begin MEASUREMENT DINH_nrActvInhReas.FId_bInhDiag_INV_427h "" UWORD DINH_ct_Compu 1 100 -4095.000 4096.000 BIT_MASK 0x1fff FORMAT "%8.3" ECU_ADDRESS 0x6002164A /end MEASUREMENT
/begin MEASUREMENT DINH_nrActvInhReas.FId_bInhDiag_INV_497h "" UWORD DINH_ct_Compu 1 100 -4095.000 4096.000 BIT_MASK 0x1fff FORMAT "%8.3" ECU_ADDRESS 0x6002164C /end MEASUREMENT
/begin MEASUREMENT DINH_nrActvInhReas.FId_bInhDiag_INV_IMMO_5C7 "" UWORD DINH_ct_Compu 1 100 -4095.000 4096.000 BIT_MASK 0x1fff FORMAT "%8.3" ECU_ADDRESS 0x6002164E /end MEASUREMENT
/begin MEASUREMENT DINH_nrActvInhReas.FId_bInhDiag_IS_DAT6_BSI_592h "" UWORD DINH_ct_Compu 1 100 -4095.000 4096.000 BIT_MASK 0x1fff FORMAT "%8.3" ECU_ADDRESS 0x60021650 /end MEASUREMENT
/begin MEASUREMENT DINH_nrActvInhReas.FId_bInhDiag_IS_DAT_ABR_50Dh "" UWORD DINH_ct_Compu 1 100 -4095.000 4096.000 BIT_MASK 0x1fff FORMAT "%8.3" ECU_ADDRESS 0x60021652 /end MEASUREMENT
/begin MEASUREMENT DINH_nrActvInhReas.FId_bInhDiag_IS_DAT_BSI_412h "" UWORD DINH_ct_Compu 1 100 -4095.000 4096.000 BIT_MASK 0x1fff FORMAT "%8.3" ECU_ADDRESS 0x60021654 /end MEASUREMENT
/begin MEASUREMENT DINH_nrActvInhReas.FId_bInhDiag_IS_DYN_ABR_38Dh "" UWORD DINH_ct_Compu 1 100 -4095.000 4096.000 BIT_MASK 0x1fff FORMAT "%8.3" ECU_ADDRESS 0x60021656 /end MEASUREMENT
/begin MEASUREMENT DINH_nrActvInhReas.FId_bInhDiag_IS_INTE_ELECTRON_BSI_092h "" UWORD DINH_ct_Compu 1 100 -4095.000 4096.000 BIT_MASK 0x1fff FORMAT "%8.3" ECU_ADDRESS 0x60021658 /end MEASUREMENT
/begin MEASUREMENT DINH_nrActvInhReas.FId_bInhDiag_OBC_273h "" UWORD DINH_ct_Compu 1 100 -4095.000 4096.000 BIT_MASK 0x1fff FORMAT "%8.3" ECU_ADDRESS 0x6002165A /end MEASUREMENT
/begin MEASUREMENT DINH_nrActvInhReas.FId_bInhDiag_OBC_453h "" UWORD DINH_ct_Compu 1 100 -4095.000 4096.000 BIT_MASK 0x1fff FORMAT "%8.3" ECU_ADDRESS 0x6002165C /end MEASUREMENT
/begin MEASUREMENT DINH_nrActvInhReas.FId_bInhDiag_OBC_463h "" UWORD DINH_ct_Compu 1 100 -4095.000 4096.000 BIT_MASK 0x1fff FORMAT "%8.3" ECU_ADDRESS 0x6002165E /end MEASUREMENT
/begin MEASUREMENT DINH_nrActvInhReas.FId_bInhDiag_PDU_BusVoltages_308 "" UWORD DINH_ct_Compu 1 100 -4095.000 4096.000 BIT_MASK 0x1fff FORMAT "%8.3" ECU_ADDRESS 0x60021660 /end MEASUREMENT
/begin MEASUREMENT DINH_nrActvInhReas.FId_bInhDiag_PDU_Current_318 "" UWORD DINH_ct_Compu 1 100 -4095.000 4096.000 BIT_MASK 0x1fff FORMAT "%8.3" ECU_ADDRESS 0x60021662 /end MEASUREMENT
/begin MEASUREMENT DINH_nrActvInhReas.FId_bInhDiag_SC_INFO_BCCM_442h "" UWORD DINH_ct_Compu 1 100 -4095.000 4096.000 BIT_MASK 0x1fff FORMAT "%8.3" ECU_ADDRESS 0x60021664 /end MEASUREMENT
/begin MEASUREMENT DINH_nrActvInhReas.FId_bInhDiag_VCU_AIRBAG_351h "" UWORD DINH_ct_Compu 1 100 -4095.000 4096.000 BIT_MASK 0x1fff FORMAT "%8.3" ECU_ADDRESS 0x60021666 /end MEASUREMENT
/begin MEASUREMENT DINH_nrActvInhReas.FId_bInhDiag_VCU_eBCCM_432h "" UWORD DINH_ct_Compu 1 100 -4095.000 4096.000 BIT_MASK 0x1fff FORMAT "%8.3" ECU_ADDRESS 0x60021668 /end MEASUREMENT
/begin MEASUREMENT DINH_nrActvInhReas.FId_bInhDiag_VCU_eBCCM_552h "" UWORD DINH_ct_Compu 1 100 -4095.000 4096.000 BIT_MASK 0x1fff FORMAT "%8.3" ECU_ADDRESS 0x6002166A /end MEASUREMENT
/begin MEASUREMENT DINH_nrActvInhReas.FId_bInhDiag_eBCCM_082h "" UWORD DINH_ct_Compu 1 100 -4095.000 4096.000 BIT_MASK 0x1fff FORMAT "%8.3" ECU_ADDRESS 0x6002166C /end MEASUREMENT
/begin MEASUREMENT DINH_nrActvInhReas.FId_bInhDiag_eCOMP_Information_47B "" UWORD DINH_ct_Compu 1 100 -4095.000 4096.000 BIT_MASK 0x1fff FORMAT "%8.3" ECU_ADDRESS 0x6002166E /end MEASUREMENT
/begin MEASUREMENT DINH_nrActvInhReas.FId_bInhDiag_eCOMP_Information_48B "" UWORD DINH_ct_Compu 1 100 -4095.000 4096.000 BIT_MASK 0x1fff FORMAT "%8.3" ECU_ADDRESS 0x60021670 /end MEASUREMENT
/begin MEASUREMENT DINH_nrActvInhReas.FId_bInhFrbd_ComChrgr_iAcMax "" UWORD DINH_ct_Compu 1 100 -4095.000 4096.000 BIT_MASK 0x1fff FORMAT "%8.3" ECU_ADDRESS 0x60021672 /end MEASUREMENT
/begin MEASUREMENT DINH_nrActvInhReas.FId_bInhFrbd_ComChrgr_iDcHvAct "" UWORD DINH_ct_Compu 1 100 -4095.000 4096.000 BIT_MASK 0x1fff FORMAT "%8.3" ECU_ADDRESS 0x60021674 /end MEASUREMENT
/begin MEASUREMENT DINH_nrActvInhReas.FId_bInhFrbd_ComChrgr_pwrInAct "" UWORD DINH_ct_Compu 1 100 -4095.000 4096.000 BIT_MASK 0x1fff FORMAT "%8.3" ECU_ADDRESS 0x60021676 /end MEASUREMENT
/begin MEASUREMENT DINH_nrActvInhReas.FId_bInhFrbd_ComChrgr_pwrOutpCpby "" UWORD DINH_ct_Compu 1 100 -4095.000 4096.000 BIT_MASK 0x1fff FORMAT "%8.3" ECU_ADDRESS 0x60021678 /end MEASUREMENT
/begin MEASUREMENT DINH_nrActvInhReas.FId_bInhFrbd_ComChrgr_tChrgrMaxAct "" UWORD DINH_ct_Compu 1 100 -4095.000 4096.000 BIT_MASK 0x1fff FORMAT "%8.3" ECU_ADDRESS 0x6002167A /end MEASUREMENT
/begin MEASUREMENT DINH_nrActvInhReas.FId_bInhFrbd_ComChrgr_uAcActL1 "" UWORD DINH_ct_Compu 1 100 -4095.000 4096.000 BIT_MASK 0x1fff FORMAT "%8.3" ECU_ADDRESS 0x6002167C /end MEASUREMENT
/begin MEASUREMENT DINH_nrActvInhReas.FId_bInhFrbd_ComChrgr_uDcHvAct "" UWORD DINH_ct_Compu 1 100 -4095.000 4096.000 BIT_MASK 0x1fff FORMAT "%8.3" ECU_ADDRESS 0x6002167E /end MEASUREMENT
/begin MEASUREMENT DINH_nrActvInhReas.FId_bInhFrbd_ComEmac_iDcLnk01 "" UWORD DINH_ct_Compu 1 100 -4095.000 4096.000 BIT_MASK 0x1fff FORMAT "%8.3" ECU_ADDRESS 0x60021680 /end MEASUREMENT
/begin MEASUREMENT DINH_nrActvInhReas.FId_bInhFrbd_ComEmac_nAct01 "" UWORD DINH_ct_Compu 1 100 -4095.000 4096.000 BIT_MASK 0x1fff FORMAT "%8.3" ECU_ADDRESS 0x60021682 /end MEASUREMENT
/begin MEASUREMENT DINH_nrActvInhReas.FId_bInhFrbd_ComEmac_pwrInstnsInpRx "" UWORD DINH_ct_Compu 1 100 -4095.000 4096.000 BIT_MASK 0x1fff FORMAT "%8.3" ECU_ADDRESS 0x60021684 /end MEASUREMENT
/begin MEASUREMENT DINH_nrActvInhReas.FId_bInhFrbd_ComEmac_stActvDcha "" UWORD DINH_ct_Compu 1 100 -4095.000 4096.000 BIT_MASK 0x1fff FORMAT "%8.3" ECU_ADDRESS 0x60021686 /end MEASUREMENT
/begin MEASUREMENT DINH_nrActvInhReas.FId_bInhFrbd_ComEmac_stEVLmp "" UWORD DINH_ct_Compu 1 100 -4095.000 4096.000 BIT_MASK 0x1fff FORMAT "%8.3" ECU_ADDRESS 0x60021688 /end MEASUREMENT
/begin MEASUREMENT DINH_nrActvInhReas.FId_bInhFrbd_ComEmac_stIvtrOpMod01 "" UWORD DINH_ct_Compu 1 100 -4095.000 4096.000 BIT_MASK 0x1fff FORMAT "%8.3" ECU_ADDRESS 0x6002168A /end MEASUREMENT
/begin MEASUREMENT DINH_nrActvInhReas.FId_bInhFrbd_ComEmac_stMod01Rx "" UWORD DINH_ct_Compu 1 100 -4095.000 4096.000 BIT_MASK 0x1fff FORMAT "%8.3" ECU_ADDRESS 0x6002168C /end MEASUREMENT
/begin MEASUREMENT DINH_nrActvInhReas.FId_bInhFrbd_ComEmac_stMstWrnLmp "" UWORD DINH_ct_Compu 1 100 -4095.000 4096.000 BIT_MASK 0x1fff FORMAT "%8.3" ECU_ADDRESS 0x6002168E /end MEASUREMENT
/begin MEASUREMENT DINH_nrActvInhReas.FId_bInhFrbd_ComEmac_stSVSLmp "" UWORD DINH_ct_Compu 1 100 -4095.000 4096.000 BIT_MASK 0x1fff FORMAT "%8.3" ECU_ADDRESS 0x60021690 /end MEASUREMENT
/begin MEASUREMENT DINH_nrActvInhReas.FId_bInhFrbd_ComEmac_tqAbsltMax01 "" UWORD DINH_ct_Compu 1 100 -4095.000 4096.000 BIT_MASK 0x1fff FORMAT "%8.3" ECU_ADDRESS 0x60021692 /end MEASUREMENT
/begin MEASUREMENT DINH_nrActvInhReas.FId_bInhFrbd_ComEmac_tqAbsltMaxRx01 "" UWORD DINH_ct_Compu 1 100 -4095.000 4096.000 BIT_MASK 0x1fff FORMAT "%8.3" ECU_ADDRESS 0x60021694 /end MEASUREMENT
/begin MEASUREMENT DINH_nrActvInhReas.FId_bInhFrbd_ComEmac_tqAbsltMin01 "" UWORD DINH_ct_Compu 1 100 -4095.000 4096.000 BIT_MASK 0x1fff FORMAT "%8.3" ECU_ADDRESS 0x60021696 /end MEASUREMENT
/begin MEASUREMENT DINH_nrActvInhReas.FId_bInhFrbd_ComEmac_tqAbsltMinRx01 "" UWORD DINH_ct_Compu 1 100 -4095.000 4096.000 BIT_MASK 0x1fff FORMAT "%8.3" ECU_ADDRESS 0x60021698 /end MEASUREMENT
/begin MEASUREMENT DINH_nrActvInhReas.FId_bInhFrbd_ComEmac_tqAckd01 "" UWORD DINH_ct_Compu 1 100 -4095.000 4096.000 BIT_MASK 0x1fff FORMAT "%8.3" ECU_ADDRESS 0x6002169A /end MEASUREMENT
/begin MEASUREMENT DINH_nrActvInhReas.FId_bInhFrbd_ComEmac_tqAct01 "" UWORD DINH_ct_Compu 1 100 -4095.000 4096.000 BIT_MASK 0x1fff FORMAT "%8.3" ECU_ADDRESS 0x6002169C /end MEASUREMENT
/begin MEASUREMENT DINH_nrActvInhReas.FId_bInhFrbd_ComEmac_tqPtd01 "" UWORD DINH_ct_Compu 1 100 -4095.000 4096.000 BIT_MASK 0x1fff FORMAT "%8.3" ECU_ADDRESS 0x6002169E /end MEASUREMENT
/begin MEASUREMENT DINH_nrActvInhReas.FId_bInhFrbd_ComEmac_tqStabnMin "" UWORD DINH_ct_Compu 1 100 -4095.000 4096.000 BIT_MASK 0x1fff FORMAT "%8.3" ECU_ADDRESS 0x600216A0 /end MEASUREMENT
/begin MEASUREMENT DINH_nrActvInhReas.FId_bInhFrbd_ComEmac_uDcLnk01 "" UWORD DINH_ct_Compu 1 100 -4095.000 4096.000 BIT_MASK 0x1fff FORMAT "%8.3" ECU_ADDRESS 0x600216A2 /end MEASUREMENT
/begin MEASUREMENT DINH_nrActvInhReas.FId_bInhFrbd_Com_HvbMaxSnsrTempRx "" UWORD DINH_ct_Compu 1 100 -4095.000 4096.000 BIT_MASK 0x1fff FORMAT "%8.3" ECU_ADDRESS 0x600216A4 /end MEASUREMENT
/begin MEASUREMENT DINH_nrActvInhReas.FId_bInhFrbd_Com_ctHvbNegCntctrSeg1 "" UWORD DINH_ct_Compu 1 100 -4095.000 4096.000 BIT_MASK 0x1fff FORMAT "%8.3" ECU_ADDRESS 0x600216A6 /end MEASUREMENT
/begin MEASUREMENT DINH_nrActvInhReas.FId_bInhFrbd_Com_ctHvbNegCntctrSeg3 "" UWORD DINH_ct_Compu 1 100 -4095.000 4096.000 BIT_MASK 0x1fff FORMAT "%8.3" ECU_ADDRESS 0x600216A8 /end MEASUREMENT
/begin MEASUREMENT DINH_nrActvInhReas.FId_bInhFrbd_Com_ctHvbNegCntctrSeg4 "" UWORD DINH_ct_Compu 1 100 -4095.000 4096.000 BIT_MASK 0x1fff FORMAT "%8.3" ECU_ADDRESS 0x600216AA /end MEASUREMENT
/begin MEASUREMENT DINH_nrActvInhReas.FId_bInhFrbd_Com_ctHvbPosCntctrSeg1 "" UWORD DINH_ct_Compu 1 100 -4095.000 4096.000 BIT_MASK 0x1fff FORMAT "%8.3" ECU_ADDRESS 0x600216AC /end MEASUREMENT
/begin MEASUREMENT DINH_nrActvInhReas.FId_bInhFrbd_Com_ctHvbPosCntctrSeg3 "" UWORD DINH_ct_Compu 1 100 -4095.000 4096.000 BIT_MASK 0x1fff FORMAT "%8.3" ECU_ADDRESS 0x600216AE /end MEASUREMENT
/begin MEASUREMENT DINH_nrActvInhReas.FId_bInhFrbd_Com_ctHvbPosCntctrSeg4 "" UWORD DINH_ct_Compu 1 100 -4095.000 4096.000 BIT_MASK 0x1fff FORMAT "%8.3" ECU_ADDRESS 0x600216B0 /end MEASUREMENT
/begin MEASUREMENT DINH_nrActvInhReas.FId_bInhFrbd_Com_ctHvbPrecCntctrSeg1 "" UWORD DINH_ct_Compu 1 100 -4095.000 4096.000 BIT_MASK 0x1fff FORMAT "%8.3" ECU_ADDRESS 0x600216B2 /end MEASUREMENT
/begin MEASUREMENT DINH_nrActvInhReas.FId_bInhFrbd_Com_ctHvbPrecCntctrSeg2 "" UWORD DINH_ct_Compu 1 100 -4095.000 4096.000 BIT_MASK 0x1fff FORMAT "%8.3" ECU_ADDRESS 0x600216B4 /end MEASUREMENT
/begin MEASUREMENT DINH_nrActvInhReas.FId_bInhFrbd_Com_egyHvbAvl_fRx "" UWORD DINH_ct_Compu 1 100 -4095.000 4096.000 BIT_MASK 0x1fff FORMAT "%8.3" ECU_ADDRESS 0x600216B6 /end MEASUREMENT
/begin MEASUREMENT DINH_nrActvInhReas.FId_bInhFrbd_Com_flgEcoNormReqRx "" UWORD DINH_ct_Compu 1 100 -4095.000 4096.000 BIT_MASK 0x1fff FORMAT "%8.3" ECU_ADDRESS 0x600216B8 /end MEASUREMENT
/begin MEASUREMENT DINH_nrActvInhReas.FId_bInhFrbd_Com_iBattEBS1Rx "" UWORD DINH_ct_Compu 1 100 -4095.000 4096.000 BIT_MASK 0x1fff FORMAT "%8.3" ECU_ADDRESS 0x600216BA /end MEASUREMENT
/begin MEASUREMENT DINH_nrActvInhReas.FId_bInhFrbd_Com_iBattEBS2Rx "" UWORD DINH_ct_Compu 1 100 -4095.000 4096.000 BIT_MASK 0x1fff FORMAT "%8.3" ECU_ADDRESS 0x600216BC /end MEASUREMENT
/begin MEASUREMENT DINH_nrActvInhReas.FId_bInhFrbd_Com_iBattEBS3Rx "" UWORD DINH_ct_Compu 1 100 -4095.000 4096.000 BIT_MASK 0x1fff FORMAT "%8.3" ECU_ADDRESS 0x600216BE /end MEASUREMENT
/begin MEASUREMENT DINH_nrActvInhReas.FId_bInhFrbd_Com_iDcdcHvActRvsn1 "" UWORD DINH_ct_Compu 1 100 -4095.000 4096.000 BIT_MASK 0x1fff FORMAT "%8.3" ECU_ADDRESS 0x600216C0 /end MEASUREMENT
/begin MEASUREMENT DINH_nrActvInhReas.FId_bInhFrbd_Com_iDcdcLvActRvsn1 "" UWORD DINH_ct_Compu 1 100 -4095.000 4096.000 BIT_MASK 0x1fff FORMAT "%8.3" ECU_ADDRESS 0x600216C2 /end MEASUREMENT
/begin MEASUREMENT DINH_nrActvInhReas.FId_bInhFrbd_Com_iElCmprHvAct "" UWORD DINH_ct_Compu 1 100 -4095.000 4096.000 BIT_MASK 0x1fff FORMAT "%8.3" ECU_ADDRESS 0x600216C4 /end MEASUREMENT
/begin MEASUREMENT DINH_nrActvInhReas.FId_bInhFrbd_Com_iElCmprPeakPha "" UWORD DINH_ct_Compu 1 100 -4095.000 4096.000 BIT_MASK 0x1fff FORMAT "%8.3" ECU_ADDRESS 0x600216C6 /end MEASUREMENT
/begin MEASUREMENT DINH_nrActvInhReas.FId_bInhFrbd_Com_iHvbActRx "" UWORD DINH_ct_Compu 1 100 -4095.000 4096.000 BIT_MASK 0x1fff FORMAT "%8.3" ECU_ADDRESS 0x600216C8 /end MEASUREMENT
/begin MEASUREMENT DINH_nrActvInhReas.FId_bInhFrbd_Com_iHvbChrgMaxSho "" UWORD DINH_ct_Compu 1 100 -4095.000 4096.000 BIT_MASK 0x1fff FORMAT "%8.3" ECU_ADDRESS 0x600216CA /end MEASUREMENT
/begin MEASUREMENT DINH_nrActvInhReas.FId_bInhFrbd_Com_iHvbDchaMaxSho "" UWORD DINH_ct_Compu 1 100 -4095.000 4096.000 BIT_MASK 0x1fff FORMAT "%8.3" ECU_ADDRESS 0x600216CC /end MEASUREMENT
/begin MEASUREMENT DINH_nrActvInhReas.FId_bInhFrbd_Com_iHvbDes "" UWORD DINH_ct_Compu 1 100 -4095.000 4096.000 BIT_MASK 0x1fff FORMAT "%8.3" ECU_ADDRESS 0x600216CE /end MEASUREMENT
/begin MEASUREMENT DINH_nrActvInhReas.FId_bInhFrbd_Com_iHvbNomChrgn "" UWORD DINH_ct_Compu 1 100 -4095.000 4096.000 BIT_MASK 0x1fff FORMAT "%8.3" ECU_ADDRESS 0x600216D0 /end MEASUREMENT
/begin MEASUREMENT DINH_nrActvInhReas.FId_bInhFrbd_Com_nElCmprActl "" UWORD DINH_ct_Compu 1 100 -4095.000 4096.000 BIT_MASK 0x1fff FORMAT "%8.3" ECU_ADDRESS 0x600216D2 /end MEASUREMENT
/begin MEASUREMENT DINH_nrActvInhReas.FId_bInhFrbd_Com_nrSerMaxCell "" UWORD DINH_ct_Compu 1 100 -4095.000 4096.000 BIT_MASK 0x1fff FORMAT "%8.3" ECU_ADDRESS 0x600216D4 /end MEASUREMENT
/begin MEASUREMENT DINH_nrActvInhReas.FId_bInhFrbd_Com_nrSerMinCell "" UWORD DINH_ct_Compu 1 100 -4095.000 4096.000 BIT_MASK 0x1fff FORMAT "%8.3" ECU_ADDRESS 0x600216D6 /end MEASUREMENT
/begin MEASUREMENT DINH_nrActvInhReas.FId_bInhFrbd_Com_pwrDcdcOutpCpby "" UWORD DINH_ct_Compu 1 100 -4095.000 4096.000 BIT_MASK 0x1fff FORMAT "%8.3" ECU_ADDRESS 0x600216D8 /end MEASUREMENT
/begin MEASUREMENT DINH_nrActvInhReas.FId_bInhFrbd_Com_pwrElCmprActl "" UWORD DINH_ct_Compu 1 100 -4095.000 4096.000 BIT_MASK 0x1fff FORMAT "%8.3" ECU_ADDRESS 0x600216DA /end MEASUREMENT
/begin MEASUREMENT DINH_nrActvInhReas.FId_bInhFrbd_Com_pwrMaxChrgSho "" UWORD DINH_ct_Compu 1 100 -4095.000 4096.000 BIT_MASK 0x1fff FORMAT "%8.3" ECU_ADDRESS 0x600216DC /end MEASUREMENT
/begin MEASUREMENT DINH_nrActvInhReas.FId_bInhFrbd_Com_pwrMaxDchaSho "" UWORD DINH_ct_Compu 1 100 -4095.000 4096.000 BIT_MASK 0x1fff FORMAT "%8.3" ECU_ADDRESS 0x600216DE /end MEASUREMENT
/begin MEASUREMENT DINH_nrActvInhReas.FId_bInhFrbd_Com_qHvbTotCpRx "" UWORD DINH_ct_Compu 1 100 -4095.000 4096.000 BIT_MASK 0x1fff FORMAT "%8.3" ECU_ADDRESS 0x600216E0 /end MEASUREMENT
/begin MEASUREMENT DINH_nrActvInhReas.FId_bInhFrbd_Com_rHvbIsoMeasmt "" UWORD DINH_ct_Compu 1 100 -4095.000 4096.000 BIT_MASK 0x1fff FORMAT "%8.3" ECU_ADDRESS 0x600216E2 /end MEASUREMENT
/begin MEASUREMENT DINH_nrActvInhReas.FId_bInhFrbd_Com_ratHvbSoc "" UWORD DINH_ct_Compu 1 100 -4095.000 4096.000 BIT_MASK 0x1fff FORMAT "%8.3" ECU_ADDRESS 0x600216E4 /end MEASUREMENT
/begin MEASUREMENT DINH_nrActvInhReas.FId_bInhFrbd_Com_ratHvbSoh "" UWORD DINH_ct_Compu 1 100 -4095.000 4096.000 BIT_MASK 0x1fff FORMAT "%8.3" ECU_ADDRESS 0x600216E6 /end MEASUREMENT
/begin MEASUREMENT DINH_nrActvInhReas.FId_bInhFrbd_Com_ratRHvbSoh "" UWORD DINH_ct_Compu 1 100 -4095.000 4096.000 BIT_MASK 0x1fff FORMAT "%8.3" ECU_ADDRESS 0x600216E8 /end MEASUREMENT
/begin MEASUREMENT DINH_nrActvInhReas.FId_bInhFrbd_Com_ratSocLvBatt "" UWORD DINH_ct_Compu 1 100 -4095.000 4096.000 BIT_MASK 0x1fff FORMAT "%8.3" ECU_ADDRESS 0x600216EA /end MEASUREMENT
/begin MEASUREMENT DINH_nrActvInhReas.FId_bInhFrbd_Com_stElCmprFltLvl "" UWORD DINH_ct_Compu 1 100 -4095.000 4096.000 BIT_MASK 0x1fff FORMAT "%8.3" ECU_ADDRESS 0x600216EC /end MEASUREMENT
/begin MEASUREMENT DINH_nrActvInhReas.FId_bInhFrbd_Com_stGearLvrPos "" UWORD DINH_ct_Compu 1 100 -4095.000 4096.000 BIT_MASK 0x1fff FORMAT "%8.3" ECU_ADDRESS 0x600216EE /end MEASUREMENT
/begin MEASUREMENT DINH_nrActvInhReas.FId_bInhFrbd_Com_stIIvtrFltLvl01 "" UWORD DINH_ct_Compu 1 100 -4095.000 4096.000 BIT_MASK 0x1fff FORMAT "%8.3" ECU_ADDRESS 0x600216F0 /end MEASUREMENT
/begin MEASUREMENT DINH_nrActvInhReas.FId_bInhFrbd_Com_steTogFailrLvl "" UWORD DINH_ct_Compu 1 100 -4095.000 4096.000 BIT_MASK 0x1fff FORMAT "%8.3" ECU_ADDRESS 0x600216F2 /end MEASUREMENT
/begin MEASUREMENT DINH_nrActvInhReas.FId_bInhFrbd_Com_tDcdcAct "" UWORD DINH_ct_Compu 1 100 -4095.000 4096.000 BIT_MASK 0x1fff FORMAT "%8.3" ECU_ADDRESS 0x600216F4 /end MEASUREMENT
/begin MEASUREMENT DINH_nrActvInhReas.FId_bInhFrbd_Com_tDcdcInltCoolt "" UWORD DINH_ct_Compu 1 100 -4095.000 4096.000 BIT_MASK 0x1fff FORMAT "%8.3" ECU_ADDRESS 0x600216F6 /end MEASUREMENT
/begin MEASUREMENT DINH_nrActvInhReas.FId_bInhFrbd_Com_tElCmprActl "" UWORD DINH_ct_Compu 1 100 -4095.000 4096.000 BIT_MASK 0x1fff FORMAT "%8.3" ECU_ADDRESS 0x600216F8 /end MEASUREMENT
/begin MEASUREMENT DINH_nrActvInhReas.FId_bInhFrbd_Com_tEnvT "" UWORD DINH_ct_Compu 1 100 -4095.000 4096.000 BIT_MASK 0x1fff FORMAT "%8.3" ECU_ADDRESS 0x600216FA /end MEASUREMENT
/begin MEASUREMENT DINH_nrActvInhReas.FId_bInhFrbd_Com_tHvbAct "" UWORD DINH_ct_Compu 1 100 -4095.000 4096.000 BIT_MASK 0x1fff FORMAT "%8.3" ECU_ADDRESS 0x600216FC /end MEASUREMENT
/begin MEASUREMENT DINH_nrActvInhReas.FId_bInhFrbd_Com_tHvbMax "" UWORD DINH_ct_Compu 1 100 -4095.000 4096.000 BIT_MASK 0x1fff FORMAT "%8.3" ECU_ADDRESS 0x600216FE /end MEASUREMENT
/begin MEASUREMENT DINH_nrActvInhReas.FId_bInhFrbd_Com_tLvBatt "" UWORD DINH_ct_Compu 1 100 -4095.000 4096.000 BIT_MASK 0x1fff FORMAT "%8.3" ECU_ADDRESS 0x60021700 /end MEASUREMENT
/begin MEASUREMENT DINH_nrActvInhReas.FId_bInhFrbd_Com_tiHvbChrgnHalfRx "" UWORD DINH_ct_Compu 1 100 -4095.000 4096.000 BIT_MASK 0x1fff FORMAT "%8.3" ECU_ADDRESS 0x60021702 /end MEASUREMENT
/begin MEASUREMENT DINH_nrActvInhReas.FId_bInhFrbd_Com_uBattEBSRx "" UWORD DINH_ct_Compu 1 100 -4095.000 4096.000 BIT_MASK 0x1fff FORMAT "%8.3" ECU_ADDRESS 0x60021704 /end MEASUREMENT
/begin MEASUREMENT DINH_nrActvInhReas.FId_bInhFrbd_Com_uDcdcHvAct "" UWORD DINH_ct_Compu 1 100 -4095.000 4096.000 BIT_MASK 0x1fff FORMAT "%8.3" ECU_ADDRESS 0x60021706 /end MEASUREMENT
/begin MEASUREMENT DINH_nrActvInhReas.FId_bInhFrbd_Com_uDcdcLvAct "" UWORD DINH_ct_Compu 1 100 -4095.000 4096.000 BIT_MASK 0x1fff FORMAT "%8.3" ECU_ADDRESS 0x60021708 /end MEASUREMENT
/begin MEASUREMENT DINH_nrActvInhReas.FId_bInhFrbd_Com_uElCmprHvAct "" UWORD DINH_ct_Compu 1 100 -4095.000 4096.000 BIT_MASK 0x1fff FORMAT "%8.3" ECU_ADDRESS 0x6002170A /end MEASUREMENT
/begin MEASUREMENT DINH_nrActvInhReas.FId_bInhFrbd_Com_uHvbAct "" UWORD DINH_ct_Compu 1 100 -4095.000 4096.000 BIT_MASK 0x1fff FORMAT "%8.3" ECU_ADDRESS 0x6002170C /end MEASUREMENT
/begin MEASUREMENT DINH_nrActvInhReas.FId_bInhFrbd_Com_uHvbDcBus "" UWORD DINH_ct_Compu 1 100 -4095.000 4096.000 BIT_MASK 0x1fff FORMAT "%8.3" ECU_ADDRESS 0x6002170E /end MEASUREMENT
/begin MEASUREMENT DINH_nrActvInhReas.FId_bInhFrbd_Com_uHvbLimHi "" UWORD DINH_ct_Compu 1 100 -4095.000 4096.000 BIT_MASK 0x1fff FORMAT "%8.3" ECU_ADDRESS 0x60021710 /end MEASUREMENT
/begin MEASUREMENT DINH_nrActvInhReas.FId_bInhFrbd_Com_uHvbMaxCell "" UWORD DINH_ct_Compu 1 100 -4095.000 4096.000 BIT_MASK 0x1fff FORMAT "%8.3" ECU_ADDRESS 0x60021712 /end MEASUREMENT
/begin MEASUREMENT DINH_nrActvInhReas.FId_bInhFrbd_Com_uHvbMinCell "" UWORD DINH_ct_Compu 1 100 -4095.000 4096.000 BIT_MASK 0x1fff FORMAT "%8.3" ECU_ADDRESS 0x60021714 /end MEASUREMENT
/begin MEASUREMENT DINH_nrActvInhReas.FId_bInhFrbd_Com_uHvbNomChrgn "" UWORD DINH_ct_Compu 1 100 -4095.000 4096.000 BIT_MASK 0x1fff FORMAT "%8.3" ECU_ADDRESS 0x60021716 /end MEASUREMENT
/begin MEASUREMENT DINH_nrActvInhReas.FId_bInhInvld_ComChrgr_flgChrgrErrLvl "" UWORD DINH_ct_Compu 1 100 -4095.000 4096.000 BIT_MASK 0x1fff FORMAT "%8.3" ECU_ADDRESS 0x60021718 /end MEASUREMENT
/begin MEASUREMENT DINH_nrActvInhReas.FId_bInhInvld_ComChrgr_iAcMax "" UWORD DINH_ct_Compu 1 100 -4095.000 4096.000 BIT_MASK 0x1fff FORMAT "%8.3" ECU_ADDRESS 0x6002171A /end MEASUREMENT
/begin MEASUREMENT DINH_nrActvInhReas.FId_bInhInvld_ComChrgr_iDcHvAct "" UWORD DINH_ct_Compu 1 100 -4095.000 4096.000 BIT_MASK 0x1fff FORMAT "%8.3" ECU_ADDRESS 0x6002171C /end MEASUREMENT
/begin MEASUREMENT DINH_nrActvInhReas.FId_bInhInvld_ComChrgr_pwrInAct "" UWORD DINH_ct_Compu 1 100 -4095.000 4096.000 BIT_MASK 0x1fff FORMAT "%8.3" ECU_ADDRESS 0x6002171E /end MEASUREMENT
/begin MEASUREMENT DINH_nrActvInhReas.FId_bInhInvld_ComChrgr_pwrOutpCpby "" UWORD DINH_ct_Compu 1 100 -4095.000 4096.000 BIT_MASK 0x1fff FORMAT "%8.3" ECU_ADDRESS 0x60021720 /end MEASUREMENT
/begin MEASUREMENT DINH_nrActvInhReas.FId_bInhInvld_ComChrgr_tChrgrMaxAct "" UWORD DINH_ct_Compu 1 100 -4095.000 4096.000 BIT_MASK 0x1fff FORMAT "%8.3" ECU_ADDRESS 0x60021722 /end MEASUREMENT
/begin MEASUREMENT DINH_nrActvInhReas.FId_bInhInvld_ComChrgr_uAcActL1 "" UWORD DINH_ct_Compu 1 100 -4095.000 4096.000 BIT_MASK 0x1fff FORMAT "%8.3" ECU_ADDRESS 0x60021724 /end MEASUREMENT
/begin MEASUREMENT DINH_nrActvInhReas.FId_bInhInvld_ComChrgr_uDcHvAct "" UWORD DINH_ct_Compu 1 100 -4095.000 4096.000 BIT_MASK 0x1fff FORMAT "%8.3" ECU_ADDRESS 0x60021726 /end MEASUREMENT
/begin MEASUREMENT DINH_nrActvInhReas.FId_bInhInvld_ComEmac_iDcLnk01 "" UWORD DINH_ct_Compu 1 100 -4095.000 4096.000 BIT_MASK 0x1fff FORMAT "%8.3" ECU_ADDRESS 0x60021728 /end MEASUREMENT
/begin MEASUREMENT DINH_nrActvInhReas.FId_bInhInvld_ComEmac_nAct01 "" UWORD DINH_ct_Compu 1 100 -4095.000 4096.000 BIT_MASK 0x1fff FORMAT "%8.3" ECU_ADDRESS 0x6002172A /end MEASUREMENT
/begin MEASUREMENT DINH_nrActvInhReas.FId_bInhInvld_ComEmac_pwrInstnsInpRx "" UWORD DINH_ct_Compu 1 100 -4095.000 4096.000 BIT_MASK 0x1fff FORMAT "%8.3" ECU_ADDRESS 0x6002172C /end MEASUREMENT
/begin MEASUREMENT DINH_nrActvInhReas.FId_bInhInvld_ComEmac_stActvDcha "" UWORD DINH_ct_Compu 1 100 -4095.000 4096.000 BIT_MASK 0x1fff FORMAT "%8.3" ECU_ADDRESS 0x6002172E /end MEASUREMENT
/begin MEASUREMENT DINH_nrActvInhReas.FId_bInhInvld_ComEmac_stIvtrOpMod01 "" UWORD DINH_ct_Compu 1 100 -4095.000 4096.000 BIT_MASK 0x1fff FORMAT "%8.3" ECU_ADDRESS 0x60021730 /end MEASUREMENT
/begin MEASUREMENT DINH_nrActvInhReas.FId_bInhInvld_ComEmac_tInvr01 "" UWORD DINH_ct_Compu 1 100 -4095.000 4096.000 BIT_MASK 0x1fff FORMAT "%8.3" ECU_ADDRESS 0x60021732 /end MEASUREMENT
/begin MEASUREMENT DINH_nrActvInhReas.FId_bInhInvld_ComEmac_tIvtrCooltIn01 "" UWORD DINH_ct_Compu 1 100 -4095.000 4096.000 BIT_MASK 0x1fff FORMAT "%8.3" ECU_ADDRESS 0x60021734 /end MEASUREMENT
/begin MEASUREMENT DINH_nrActvInhReas.FId_bInhInvld_ComEmac_tMac01 "" UWORD DINH_ct_Compu 1 100 -4095.000 4096.000 BIT_MASK 0x1fff FORMAT "%8.3" ECU_ADDRESS 0x60021736 /end MEASUREMENT
/begin MEASUREMENT DINH_nrActvInhReas.FId_bInhInvld_ComEmac_tqAbsltMax01 "" UWORD DINH_ct_Compu 1 100 -4095.000 4096.000 BIT_MASK 0x1fff FORMAT "%8.3" ECU_ADDRESS 0x60021738 /end MEASUREMENT
/begin MEASUREMENT DINH_nrActvInhReas.FId_bInhInvld_ComEmac_tqAbsltMaxRx01 "" UWORD DINH_ct_Compu 1 100 -4095.000 4096.000 BIT_MASK 0x1fff FORMAT "%8.3" ECU_ADDRESS 0x6002173A /end MEASUREMENT
/begin MEASUREMENT DINH_nrActvInhReas.FId_bInhInvld_ComEmac_tqAbsltMin01 "" UWORD DINH_ct_Compu 1 100 -4095.000 4096.000 BIT_MASK 0x1fff FORMAT "%8.3" ECU_ADDRESS 0x6002173C /end MEASUREMENT
/begin MEASUREMENT DINH_nrActvInhReas.FId_bInhInvld_ComEmac_tqAbsltMinRx01 "" UWORD DINH_ct_Compu 1 100 -4095.000 4096.000 BIT_MASK 0x1fff FORMAT "%8.3" ECU_ADDRESS 0x6002173E /end MEASUREMENT
/begin MEASUREMENT DINH_nrActvInhReas.FId_bInhInvld_ComEmac_tqAckd01 "" UWORD DINH_ct_Compu 1 100 -4095.000 4096.000 BIT_MASK 0x1fff FORMAT "%8.3" ECU_ADDRESS 0x60021740 /end MEASUREMENT
/begin MEASUREMENT DINH_nrActvInhReas.FId_bInhInvld_ComEmac_tqAct01 "" UWORD DINH_ct_Compu 1 100 -4095.000 4096.000 BIT_MASK 0x1fff FORMAT "%8.3" ECU_ADDRESS 0x60021742 /end MEASUREMENT
/begin MEASUREMENT DINH_nrActvInhReas.FId_bInhInvld_ComEmac_tqPtd01 "" UWORD DINH_ct_Compu 1 100 -4095.000 4096.000 BIT_MASK 0x1fff FORMAT "%8.3" ECU_ADDRESS 0x60021744 /end MEASUREMENT
/begin MEASUREMENT DINH_nrActvInhReas.FId_bInhInvld_ComEmac_tqStabnMin "" UWORD DINH_ct_Compu 1 100 -4095.000 4096.000 BIT_MASK 0x1fff FORMAT "%8.3" ECU_ADDRESS 0x60021746 /end MEASUREMENT
/begin MEASUREMENT DINH_nrActvInhReas.FId_bInhInvld_ComEmac_uDcLnk01 "" UWORD DINH_ct_Compu 1 100 -4095.000 4096.000 BIT_MASK 0x1fff FORMAT "%8.3" ECU_ADDRESS 0x60021748 /end MEASUREMENT
/begin MEASUREMENT DINH_nrActvInhReas.FId_bInhInvld_Com_HvbMaxSnsrTempRx "" UWORD DINH_ct_Compu 1 100 -4095.000 4096.000 BIT_MASK 0x1fff FORMAT "%8.3" ECU_ADDRESS 0x6002174A /end MEASUREMENT
/begin MEASUREMENT DINH_nrActvInhReas.FId_bInhInvld_Com_ctHvbNegCntctrSeg1 "" UWORD DINH_ct_Compu 1 100 -4095.000 4096.000 BIT_MASK 0x1fff FORMAT "%8.3" ECU_ADDRESS 0x6002174C /end MEASUREMENT
/begin MEASUREMENT DINH_nrActvInhReas.FId_bInhInvld_Com_ctHvbNegCntctrSeg3 "" UWORD DINH_ct_Compu 1 100 -4095.000 4096.000 BIT_MASK 0x1fff FORMAT "%8.3" ECU_ADDRESS 0x6002174E /end MEASUREMENT
/begin MEASUREMENT DINH_nrActvInhReas.FId_bInhInvld_Com_ctHvbNegCntctrSeg4 "" UWORD DINH_ct_Compu 1 100 -4095.000 4096.000 BIT_MASK 0x1fff FORMAT "%8.3" ECU_ADDRESS 0x60021750 /end MEASUREMENT
/begin MEASUREMENT DINH_nrActvInhReas.FId_bInhInvld_Com_ctHvbPosCntctrSeg1 "" UWORD DINH_ct_Compu 1 100 -4095.000 4096.000 BIT_MASK 0x1fff FORMAT "%8.3" ECU_ADDRESS 0x60021752 /end MEASUREMENT
/begin MEASUREMENT DINH_nrActvInhReas.FId_bInhInvld_Com_ctHvbPosCntctrSeg3 "" UWORD DINH_ct_Compu 1 100 -4095.000 4096.000 BIT_MASK 0x1fff FORMAT "%8.3" ECU_ADDRESS 0x60021754 /end MEASUREMENT
/begin MEASUREMENT DINH_nrActvInhReas.FId_bInhInvld_Com_ctHvbPosCntctrSeg4 "" UWORD DINH_ct_Compu 1 100 -4095.000 4096.000 BIT_MASK 0x1fff FORMAT "%8.3" ECU_ADDRESS 0x60021756 /end MEASUREMENT
/begin MEASUREMENT DINH_nrActvInhReas.FId_bInhInvld_Com_ctHvbPrecCntctrSeg1 "" UWORD DINH_ct_Compu 1 100 -4095.000 4096.000 BIT_MASK 0x1fff FORMAT "%8.3" ECU_ADDRESS 0x60021758 /end MEASUREMENT
/begin MEASUREMENT DINH_nrActvInhReas.FId_bInhInvld_Com_ctHvbPrecCntctrSeg2 "" UWORD DINH_ct_Compu 1 100 -4095.000 4096.000 BIT_MASK 0x1fff FORMAT "%8.3" ECU_ADDRESS 0x6002175A /end MEASUREMENT
/begin MEASUREMENT DINH_nrActvInhReas.FId_bInhInvld_Com_egyHvbAvl_fRx "" UWORD DINH_ct_Compu 1 100 -4095.000 4096.000 BIT_MASK 0x1fff FORMAT "%8.3" ECU_ADDRESS 0x6002175C /end MEASUREMENT
/begin MEASUREMENT DINH_nrActvInhReas.FId_bInhInvld_Com_flgEcoNormReqRx "" UWORD DINH_ct_Compu 1 100 -4095.000 4096.000 BIT_MASK 0x1fff FORMAT "%8.3" ECU_ADDRESS 0x6002175E /end MEASUREMENT
/begin MEASUREMENT DINH_nrActvInhReas.FId_bInhInvld_Com_flgVehSpdAvl "" UWORD DINH_ct_Compu 1 100 -4095.000 4096.000 BIT_MASK 0x1fff FORMAT "%8.3" ECU_ADDRESS 0x60021760 /end MEASUREMENT
/begin MEASUREMENT DINH_nrActvInhReas.FId_bInhInvld_Com_iBattEBS1Rx "" UWORD DINH_ct_Compu 1 100 -4095.000 4096.000 BIT_MASK 0x1fff FORMAT "%8.3" ECU_ADDRESS 0x60021762 /end MEASUREMENT
/begin MEASUREMENT DINH_nrActvInhReas.FId_bInhInvld_Com_iBattEBS2Rx "" UWORD DINH_ct_Compu 1 100 -4095.000 4096.000 BIT_MASK 0x1fff FORMAT "%8.3" ECU_ADDRESS 0x60021764 /end MEASUREMENT
/begin MEASUREMENT DINH_nrActvInhReas.FId_bInhInvld_Com_iBattEBS3Rx "" UWORD DINH_ct_Compu 1 100 -4095.000 4096.000 BIT_MASK 0x1fff FORMAT "%8.3" ECU_ADDRESS 0x60021766 /end MEASUREMENT
/begin MEASUREMENT DINH_nrActvInhReas.FId_bInhInvld_Com_iDcdcHvActRvsn1 "" UWORD DINH_ct_Compu 1 100 -4095.000 4096.000 BIT_MASK 0x1fff FORMAT "%8.3" ECU_ADDRESS 0x60021768 /end MEASUREMENT
/begin MEASUREMENT DINH_nrActvInhReas.FId_bInhInvld_Com_iDcdcLvActRvsn1 "" UWORD DINH_ct_Compu 1 100 -4095.000 4096.000 BIT_MASK 0x1fff FORMAT "%8.3" ECU_ADDRESS 0x6002176A /end MEASUREMENT
/begin MEASUREMENT DINH_nrActvInhReas.FId_bInhInvld_Com_iElCmprHvAct "" UWORD DINH_ct_Compu 1 100 -4095.000 4096.000 BIT_MASK 0x1fff FORMAT "%8.3" ECU_ADDRESS 0x6002176C /end MEASUREMENT
/begin MEASUREMENT DINH_nrActvInhReas.FId_bInhInvld_Com_iElCmprPeakPha "" UWORD DINH_ct_Compu 1 100 -4095.000 4096.000 BIT_MASK 0x1fff FORMAT "%8.3" ECU_ADDRESS 0x6002176E /end MEASUREMENT
/begin MEASUREMENT DINH_nrActvInhReas.FId_bInhInvld_Com_iHvbActRx "" UWORD DINH_ct_Compu 1 100 -4095.000 4096.000 BIT_MASK 0x1fff FORMAT "%8.3" ECU_ADDRESS 0x60021770 /end MEASUREMENT
/begin MEASUREMENT DINH_nrActvInhReas.FId_bInhInvld_Com_iHvbChrgMaxSho "" UWORD DINH_ct_Compu 1 100 -4095.000 4096.000 BIT_MASK 0x1fff FORMAT "%8.3" ECU_ADDRESS 0x60021772 /end MEASUREMENT
/begin MEASUREMENT DINH_nrActvInhReas.FId_bInhInvld_Com_iHvbDchaMaxSho "" UWORD DINH_ct_Compu 1 100 -4095.000 4096.000 BIT_MASK 0x1fff FORMAT "%8.3" ECU_ADDRESS 0x60021774 /end MEASUREMENT
/begin MEASUREMENT DINH_nrActvInhReas.FId_bInhInvld_Com_iHvbDes "" UWORD DINH_ct_Compu 1 100 -4095.000 4096.000 BIT_MASK 0x1fff FORMAT "%8.3" ECU_ADDRESS 0x60021776 /end MEASUREMENT
/begin MEASUREMENT DINH_nrActvInhReas.FId_bInhInvld_Com_iHvbNomChrgn "" UWORD DINH_ct_Compu 1 100 -4095.000 4096.000 BIT_MASK 0x1fff FORMAT "%8.3" ECU_ADDRESS 0x60021778 /end MEASUREMENT
/begin MEASUREMENT DINH_nrActvInhReas.FId_bInhInvld_Com_lDstGlbDa "" UWORD DINH_ct_Compu 1 100 -4095.000 4096.000 BIT_MASK 0x1fff FORMAT "%8.3" ECU_ADDRESS 0x6002177A /end MEASUREMENT
/begin MEASUREMENT DINH_nrActvInhReas.FId_bInhInvld_Com_lTotOdometer "" UWORD DINH_ct_Compu 1 100 -4095.000 4096.000 BIT_MASK 0x1fff FORMAT "%8.3" ECU_ADDRESS 0x6002177C /end MEASUREMENT
/begin MEASUREMENT DINH_nrActvInhReas.FId_bInhInvld_Com_nElCmprActl "" UWORD DINH_ct_Compu 1 100 -4095.000 4096.000 BIT_MASK 0x1fff FORMAT "%8.3" ECU_ADDRESS 0x6002177E /end MEASUREMENT
/begin MEASUREMENT DINH_nrActvInhReas.FId_bInhInvld_Com_nrSerMaxCell "" UWORD DINH_ct_Compu 1 100 -4095.000 4096.000 BIT_MASK 0x1fff FORMAT "%8.3" ECU_ADDRESS 0x60021780 /end MEASUREMENT
/begin MEASUREMENT DINH_nrActvInhReas.FId_bInhInvld_Com_nrSerMinCell "" UWORD DINH_ct_Compu 1 100 -4095.000 4096.000 BIT_MASK 0x1fff FORMAT "%8.3" ECU_ADDRESS 0x60021782 /end MEASUREMENT
/begin MEASUREMENT DINH_nrActvInhReas.FId_bInhInvld_Com_pwrDcdcOutpCpby "" UWORD DINH_ct_Compu 1 100 -4095.000 4096.000 BIT_MASK 0x1fff FORMAT "%8.3" ECU_ADDRESS 0x60021784 /end MEASUREMENT
/begin MEASUREMENT DINH_nrActvInhReas.FId_bInhInvld_Com_pwrElCmprActl "" UWORD DINH_ct_Compu 1 100 -4095.000 4096.000 BIT_MASK 0x1fff FORMAT "%8.3" ECU_ADDRESS 0x60021786 /end MEASUREMENT
/begin MEASUREMENT DINH_nrActvInhReas.FId_bInhInvld_Com_pwrMaxChrgSho "" UWORD DINH_ct_Compu 1 100 -4095.000 4096.000 BIT_MASK 0x1fff FORMAT "%8.3" ECU_ADDRESS 0x60021788 /end MEASUREMENT
/begin MEASUREMENT DINH_nrActvInhReas.FId_bInhInvld_Com_pwrMaxDchaSho "" UWORD DINH_ct_Compu 1 100 -4095.000 4096.000 BIT_MASK 0x1fff FORMAT "%8.3" ECU_ADDRESS 0x6002178A /end MEASUREMENT
/begin MEASUREMENT DINH_nrActvInhReas.FId_bInhInvld_Com_qHvbTotCpRx "" UWORD DINH_ct_Compu 1 100 -4095.000 4096.000 BIT_MASK 0x1fff FORMAT "%8.3" ECU_ADDRESS 0x6002178C /end MEASUREMENT
/begin MEASUREMENT DINH_nrActvInhReas.FId_bInhInvld_Com_rHvbIsoMeasmt "" UWORD DINH_ct_Compu 1 100 -4095.000 4096.000 BIT_MASK 0x1fff FORMAT "%8.3" ECU_ADDRESS 0x6002178E /end MEASUREMENT
/begin MEASUREMENT DINH_nrActvInhReas.FId_bInhInvld_Com_ratHvbSoc "" UWORD DINH_ct_Compu 1 100 -4095.000 4096.000 BIT_MASK 0x1fff FORMAT "%8.3" ECU_ADDRESS 0x60021790 /end MEASUREMENT
/begin MEASUREMENT DINH_nrActvInhReas.FId_bInhInvld_Com_ratHvbSoh "" UWORD DINH_ct_Compu 1 100 -4095.000 4096.000 BIT_MASK 0x1fff FORMAT "%8.3" ECU_ADDRESS 0x60021792 /end MEASUREMENT
/begin MEASUREMENT DINH_nrActvInhReas.FId_bInhInvld_Com_ratRHvbSoh "" UWORD DINH_ct_Compu 1 100 -4095.000 4096.000 BIT_MASK 0x1fff FORMAT "%8.3" ECU_ADDRESS 0x60021794 /end MEASUREMENT
/begin MEASUREMENT DINH_nrActvInhReas.FId_bInhInvld_Com_ratSocLvBatt "" UWORD DINH_ct_Compu 1 100 -4095.000 4096.000 BIT_MASK 0x1fff FORMAT "%8.3" ECU_ADDRESS 0x60021796 /end MEASUREMENT
/begin MEASUREMENT DINH_nrActvInhReas.FId_bInhInvld_Com_stAC "" UWORD DINH_ct_Compu 1 100 -4095.000 4096.000 BIT_MASK 0x1fff FORMAT "%8.3" ECU_ADDRESS 0x60021798 /end MEASUREMENT
/begin MEASUREMENT DINH_nrActvInhReas.FId_bInhInvld_Com_stAlrtThermRunAwy "" UWORD DINH_ct_Compu 1 100 -4095.000 4096.000 BIT_MASK 0x1fff FORMAT "%8.3" ECU_ADDRESS 0x6002179A /end MEASUREMENT
/begin MEASUREMENT DINH_nrActvInhReas.FId_bInhInvld_Com_stBlowrRly "" UWORD DINH_ct_Compu 1 100 -4095.000 4096.000 BIT_MASK 0x1fff FORMAT "%8.3" ECU_ADDRESS 0x6002179C /end MEASUREMENT
/begin MEASUREMENT DINH_nrActvInhReas.FId_bInhInvld_Com_stDcdcFltLvl "" UWORD DINH_ct_Compu 1 100 -4095.000 4096.000 BIT_MASK 0x1fff FORMAT "%8.3" ECU_ADDRESS 0x6002179E /end MEASUREMENT
/begin MEASUREMENT DINH_nrActvInhReas.FId_bInhInvld_Com_stEvapTFlt "" UWORD DINH_ct_Compu 1 100 -4095.000 4096.000 BIT_MASK 0x1fff FORMAT "%8.3" ECU_ADDRESS 0x600217A0 /end MEASUREMENT
/begin MEASUREMENT DINH_nrActvInhReas.FId_bInhInvld_Com_stGearLvrPos "" UWORD DINH_ct_Compu 1 100 -4095.000 4096.000 BIT_MASK 0x1fff FORMAT "%8.3" ECU_ADDRESS 0x600217A2 /end MEASUREMENT
/begin MEASUREMENT DINH_nrActvInhReas.FId_bInhInvld_Com_stHvacBlwrFront "" UWORD DINH_ct_Compu 1 100 -4095.000 4096.000 BIT_MASK 0x1fff FORMAT "%8.3" ECU_ADDRESS 0x600217A4 /end MEASUREMENT
/begin MEASUREMENT DINH_nrActvInhReas.FId_bInhInvld_Com_stHvacKnobPosn "" UWORD DINH_ct_Compu 1 100 -4095.000 4096.000 BIT_MASK 0x1fff FORMAT "%8.3" ECU_ADDRESS 0x600217A6 /end MEASUREMENT
/begin MEASUREMENT DINH_nrActvInhReas.FId_bInhInvld_Com_stHvacPanPotiFlt "" UWORD DINH_ct_Compu 1 100 -4095.000 4096.000 BIT_MASK 0x1fff FORMAT "%8.3" ECU_ADDRESS 0x600217A8 /end MEASUREMENT
/begin MEASUREMENT DINH_nrActvInhReas.FId_bInhInvld_Com_stHvbChrgn "" UWORD DINH_ct_Compu 1 100 -4095.000 4096.000 BIT_MASK 0x1fff FORMAT "%8.3" ECU_ADDRESS 0x600217AA /end MEASUREMENT
/begin MEASUREMENT DINH_nrActvInhReas.FId_bInhInvld_Com_stHvbDiscnctReas "" UWORD DINH_ct_Compu 1 100 -4095.000 4096.000 BIT_MASK 0x1fff FORMAT "%8.3" ECU_ADDRESS 0x600217AC /end MEASUREMENT
/begin MEASUREMENT DINH_nrActvInhReas.FId_bInhInvld_Com_stHvbIntlckRx "" UWORD DINH_ct_Compu 1 100 -4095.000 4096.000 BIT_MASK 0x1fff FORMAT "%8.3" ECU_ADDRESS 0x600217AE /end MEASUREMENT
/begin MEASUREMENT DINH_nrActvInhReas.FId_bInhInvld_Com_stHvbIsoFltRx "" UWORD DINH_ct_Compu 1 100 -4095.000 4096.000 BIT_MASK 0x1fff FORMAT "%8.3" ECU_ADDRESS 0x600217B0 /end MEASUREMENT
/begin MEASUREMENT DINH_nrActvInhReas.FId_bInhInvld_Com_stHvbSrvPlgRx "" UWORD DINH_ct_Compu 1 100 -4095.000 4096.000 BIT_MASK 0x1fff FORMAT "%8.3" ECU_ADDRESS 0x600217B2 /end MEASUREMENT
/begin MEASUREMENT DINH_nrActvInhReas.FId_bInhInvld_Com_stIBattEBS "" UWORD DINH_ct_Compu 1 100 -4095.000 4096.000 BIT_MASK 0x1fff FORMAT "%8.3" ECU_ADDRESS 0x600217B4 /end MEASUREMENT
/begin MEASUREMENT DINH_nrActvInhReas.FId_bInhInvld_Com_stIIvtrFltLvl01 "" UWORD DINH_ct_Compu 1 100 -4095.000 4096.000 BIT_MASK 0x1fff FORMAT "%8.3" ECU_ADDRESS 0x600217B6 /end MEASUREMENT
/begin MEASUREMENT DINH_nrActvInhReas.FId_bInhInvld_Com_stMainWkuReq "" UWORD DINH_ct_Compu 1 100 -4095.000 4096.000 BIT_MASK 0x1fff FORMAT "%8.3" ECU_ADDRESS 0x600217B8 /end MEASUREMENT
/begin MEASUREMENT DINH_nrActvInhReas.FId_bInhInvld_Com_stReFogReq "" UWORD DINH_ct_Compu 1 100 -4095.000 4096.000 BIT_MASK 0x1fff FORMAT "%8.3" ECU_ADDRESS 0x600217BA /end MEASUREMENT
/begin MEASUREMENT DINH_nrActvInhReas.FId_bInhInvld_Com_stSocRx "" UWORD DINH_ct_Compu 1 100 -4095.000 4096.000 BIT_MASK 0x1fff FORMAT "%8.3" ECU_ADDRESS 0x600217BC /end MEASUREMENT
/begin MEASUREMENT DINH_nrActvInhReas.FId_bInhInvld_Com_stT "" UWORD DINH_ct_Compu 1 100 -4095.000 4096.000 BIT_MASK 0x1fff FORMAT "%8.3" ECU_ADDRESS 0x600217BE /end MEASUREMENT
/begin MEASUREMENT DINH_nrActvInhReas.FId_bInhInvld_Com_tDcdcAct "" UWORD DINH_ct_Compu 1 100 -4095.000 4096.000 BIT_MASK 0x1fff FORMAT "%8.3" ECU_ADDRESS 0x600217C0 /end MEASUREMENT
/begin MEASUREMENT DINH_nrActvInhReas.FId_bInhInvld_Com_tDcdcInltCoolt "" UWORD DINH_ct_Compu 1 100 -4095.000 4096.000 BIT_MASK 0x1fff FORMAT "%8.3" ECU_ADDRESS 0x600217C2 /end MEASUREMENT
/begin MEASUREMENT DINH_nrActvInhReas.FId_bInhInvld_Com_tElCmprActl "" UWORD DINH_ct_Compu 1 100 -4095.000 4096.000 BIT_MASK 0x1fff FORMAT "%8.3" ECU_ADDRESS 0x600217C4 /end MEASUREMENT
/begin MEASUREMENT DINH_nrActvInhReas.FId_bInhInvld_Com_tEnvT "" UWORD DINH_ct_Compu 1 100 -4095.000 4096.000 BIT_MASK 0x1fff FORMAT "%8.3" ECU_ADDRESS 0x600217C6 /end MEASUREMENT
/begin MEASUREMENT DINH_nrActvInhReas.FId_bInhInvld_Com_tEvapT "" UWORD DINH_ct_Compu 1 100 -4095.000 4096.000 BIT_MASK 0x1fff FORMAT "%8.3" ECU_ADDRESS 0x600217C8 /end MEASUREMENT
/begin MEASUREMENT DINH_nrActvInhReas.FId_bInhInvld_Com_tHvbAct "" UWORD DINH_ct_Compu 1 100 -4095.000 4096.000 BIT_MASK 0x1fff FORMAT "%8.3" ECU_ADDRESS 0x600217CA /end MEASUREMENT
/begin MEASUREMENT DINH_nrActvInhReas.FId_bInhInvld_Com_tHvbMax "" UWORD DINH_ct_Compu 1 100 -4095.000 4096.000 BIT_MASK 0x1fff FORMAT "%8.3" ECU_ADDRESS 0x600217CC /end MEASUREMENT
/begin MEASUREMENT DINH_nrActvInhReas.FId_bInhInvld_Com_tLvBatt "" UWORD DINH_ct_Compu 1 100 -4095.000 4096.000 BIT_MASK 0x1fff FORMAT "%8.3" ECU_ADDRESS 0x600217CE /end MEASUREMENT
/begin MEASUREMENT DINH_nrActvInhReas.FId_bInhInvld_Com_tiCurVehTmr "" UWORD DINH_ct_Compu 1 100 -4095.000 4096.000 BIT_MASK 0x1fff FORMAT "%8.3" ECU_ADDRESS 0x600217D0 /end MEASUREMENT
/begin MEASUREMENT DINH_nrActvInhReas.FId_bInhInvld_Com_tiHvbChrgnHalfRx "" UWORD DINH_ct_Compu 1 100 -4095.000 4096.000 BIT_MASK 0x1fff FORMAT "%8.3" ECU_ADDRESS 0x600217D2 /end MEASUREMENT
/begin MEASUREMENT DINH_nrActvInhReas.FId_bInhInvld_Com_uBattEBSRx "" UWORD DINH_ct_Compu 1 100 -4095.000 4096.000 BIT_MASK 0x1fff FORMAT "%8.3" ECU_ADDRESS 0x600217D4 /end MEASUREMENT
/begin MEASUREMENT DINH_nrActvInhReas.FId_bInhInvld_Com_uDcdcHvAct "" UWORD DINH_ct_Compu 1 100 -4095.000 4096.000 BIT_MASK 0x1fff FORMAT "%8.3" ECU_ADDRESS 0x600217D6 /end MEASUREMENT
/begin MEASUREMENT DINH_nrActvInhReas.FId_bInhInvld_Com_uDcdcLvAct "" UWORD DINH_ct_Compu 1 100 -4095.000 4096.000 BIT_MASK 0x1fff FORMAT "%8.3" ECU_ADDRESS 0x600217D8 /end MEASUREMENT
/begin MEASUREMENT DINH_nrActvInhReas.FId_bInhInvld_Com_uElCmprHvAct "" UWORD DINH_ct_Compu 1 100 -4095.000 4096.000 BIT_MASK 0x1fff FORMAT "%8.3" ECU_ADDRESS 0x600217DA /end MEASUREMENT
/begin MEASUREMENT DINH_nrActvInhReas.FId_bInhInvld_Com_uHvbAct "" UWORD DINH_ct_Compu 1 100 -4095.000 4096.000 BIT_MASK 0x1fff FORMAT "%8.3" ECU_ADDRESS 0x600217DC /end MEASUREMENT
/begin MEASUREMENT DINH_nrActvInhReas.FId_bInhInvld_Com_uHvbDcBus "" UWORD DINH_ct_Compu 1 100 -4095.000 4096.000 BIT_MASK 0x1fff FORMAT "%8.3" ECU_ADDRESS 0x600217DE /end MEASUREMENT
/begin MEASUREMENT DINH_nrActvInhReas.FId_bInhInvld_Com_uHvbLimHi "" UWORD DINH_ct_Compu 1 100 -4095.000 4096.000 BIT_MASK 0x1fff FORMAT "%8.3" ECU_ADDRESS 0x600217E0 /end MEASUREMENT
/begin MEASUREMENT DINH_nrActvInhReas.FId_bInhInvld_Com_uHvbMaxCell "" UWORD DINH_ct_Compu 1 100 -4095.000 4096.000 BIT_MASK 0x1fff FORMAT "%8.3" ECU_ADDRESS 0x600217E2 /end MEASUREMENT
/begin MEASUREMENT DINH_nrActvInhReas.FId_bInhInvld_Com_uHvbMinCell "" UWORD DINH_ct_Compu 1 100 -4095.000 4096.000 BIT_MASK 0x1fff FORMAT "%8.3" ECU_ADDRESS 0x600217E4 /end MEASUREMENT
/begin MEASUREMENT DINH_nrActvInhReas.FId_bInhInvld_Com_uHvbNomChrgn "" UWORD DINH_ct_Compu 1 100 -4095.000 4096.000 BIT_MASK 0x1fff FORMAT "%8.3" ECU_ADDRESS 0x600217E6 /end MEASUREMENT
/begin MEASUREMENT DINH_nrActvInhReas.FId_bInhInvld_Com_vVeh "" UWORD DINH_ct_Compu 1 100 -4095.000 4096.000 BIT_MASK 0x1fff FORMAT "%8.3" ECU_ADDRESS 0x600217E8 /end MEASUREMENT
/begin MEASUREMENT DINH_nrActvInhReas.FId_bInh_ACCmpr_pwrLimMax "" UWORD DINH_ct_Compu 1 100 -4095.000 4096.000 BIT_MASK 0x1fff FORMAT "%8.3" ECU_ADDRESS 0x600217EA /end MEASUREMENT
/begin MEASUREMENT DINH_nrActvInhReas.FId_bInh_ACCtl_flgCmprEna "" UWORD DINH_ct_Compu 1 100 -4095.000 4096.000 BIT_MASK 0x1fff FORMAT "%8.3" ECU_ADDRESS 0x600217EC /end MEASUREMENT
/begin MEASUREMENT DINH_nrActvInhReas.FId_bInh_ACCtl_nCmprSpdReq "" UWORD DINH_ct_Compu 1 100 -4095.000 4096.000 BIT_MASK 0x1fff FORMAT "%8.3" ECU_ADDRESS 0x600217EE /end MEASUREMENT
/begin MEASUREMENT DINH_nrActvInhReas.FId_bInh_APP_rInp "" UWORD DINH_ct_Compu 1 100 -4095.000 4096.000 BIT_MASK 0x1fff FORMAT "%8.3" ECU_ADDRESS 0x600217F0 /end MEASUREMENT
/begin MEASUREMENT DINH_nrActvInhReas.FId_bInh_BattId_numOrganNature1 "" UWORD DINH_ct_Compu 1 100 -4095.000 4096.000 BIT_MASK 0x1fff FORMAT "%8.3" ECU_ADDRESS 0x600217F2 /end MEASUREMENT
/begin MEASUREMENT DINH_nrActvInhReas.FId_bInh_BattId_numOrganNature2 "" UWORD DINH_ct_Compu 1 100 -4095.000 4096.000 BIT_MASK 0x1fff FORMAT "%8.3" ECU_ADDRESS 0x600217F4 /end MEASUREMENT
/begin MEASUREMENT DINH_nrActvInhReas.FId_bInh_BattId_numOrganRef1 "" UWORD DINH_ct_Compu 1 100 -4095.000 4096.000 BIT_MASK 0x1fff FORMAT "%8.3" ECU_ADDRESS 0x600217F6 /end MEASUREMENT
/begin MEASUREMENT DINH_nrActvInhReas.FId_bInh_BattId_numOrganRef2 "" UWORD DINH_ct_Compu 1 100 -4095.000 4096.000 BIT_MASK 0x1fff FORMAT "%8.3" ECU_ADDRESS 0x600217F8 /end MEASUREMENT
/begin MEASUREMENT DINH_nrActvInhReas.FId_bInh_BattId_numOrganRef3 "" UWORD DINH_ct_Compu 1 100 -4095.000 4096.000 BIT_MASK 0x1fff FORMAT "%8.3" ECU_ADDRESS 0x600217FA /end MEASUREMENT
/begin MEASUREMENT DINH_nrActvInhReas.FId_bInh_BattId_numOrganRef4 "" UWORD DINH_ct_Compu 1 100 -4095.000 4096.000 BIT_MASK 0x1fff FORMAT "%8.3" ECU_ADDRESS 0x600217FC /end MEASUREMENT
/begin MEASUREMENT DINH_nrActvInhReas.FId_bInh_BattId_numSerl1 "" UWORD DINH_ct_Compu 1 100 -4095.000 4096.000 BIT_MASK 0x1fff FORMAT "%8.3" ECU_ADDRESS 0x600217FE /end MEASUREMENT
/begin MEASUREMENT DINH_nrActvInhReas.FId_bInh_BattId_numSerl2 "" UWORD DINH_ct_Compu 1 100 -4095.000 4096.000 BIT_MASK 0x1fff FORMAT "%8.3" ECU_ADDRESS 0x60021800 /end MEASUREMENT
/begin MEASUREMENT DINH_nrActvInhReas.FId_bInh_BattId_numSerl3 "" UWORD DINH_ct_Compu 1 100 -4095.000 4096.000 BIT_MASK 0x1fff FORMAT "%8.3" ECU_ADDRESS 0x60021802 /end MEASUREMENT
/begin MEASUREMENT DINH_nrActvInhReas.FId_bInh_BattId_numSerl4 "" UWORD DINH_ct_Compu 1 100 -4095.000 4096.000 BIT_MASK 0x1fff FORMAT "%8.3" ECU_ADDRESS 0x60021804 /end MEASUREMENT
/begin MEASUREMENT DINH_nrActvInhReas.FId_bInh_BattId_numSerl5 "" UWORD DINH_ct_Compu 1 100 -4095.000 4096.000 BIT_MASK 0x1fff FORMAT "%8.3" ECU_ADDRESS 0x60021806 /end MEASUREMENT
/begin MEASUREMENT DINH_nrActvInhReas.FId_bInh_BattId_numSerl6 "" UWORD DINH_ct_Compu 1 100 -4095.000 4096.000 BIT_MASK 0x1fff FORMAT "%8.3" ECU_ADDRESS 0x60021808 /end MEASUREMENT
/begin MEASUREMENT DINH_nrActvInhReas.FId_bInh_BattId_numSerl7 "" UWORD DINH_ct_Compu 1 100 -4095.000 4096.000 BIT_MASK 0x1fff FORMAT "%8.3" ECU_ADDRESS 0x6002180A /end MEASUREMENT
/begin MEASUREMENT DINH_nrActvInhReas.FId_bInh_Brk_stRed "" UWORD DINH_ct_Compu 1 100 -4095.000 4096.000 BIT_MASK 0x1fff FORMAT "%8.3" ECU_ADDRESS 0x6002180C /end MEASUREMENT
/begin MEASUREMENT DINH_nrActvInhReas.FId_bInh_CbnHeatgHeatr_cntrRlyLf "" UWORD DINH_ct_Compu 1 100 -4095.000 4096.000 BIT_MASK 0x1fff FORMAT "%8.3" ECU_ADDRESS 0x6002180E /end MEASUREMENT
/begin MEASUREMENT DINH_nrActvInhReas.FId_bInh_ChgrPlug_stPlgLockTx "" UWORD DINH_ct_Compu 1 100 -4095.000 4096.000 BIT_MASK 0x1fff FORMAT "%8.3" ECU_ADDRESS 0x60021810 /end MEASUREMENT
/begin MEASUREMENT DINH_nrActvInhReas.FId_bInh_ChrgCntct_nrNegCntctElpdOper "" UWORD DINH_ct_Compu 1 100 -4095.000 4096.000 BIT_MASK 0x1fff FORMAT "%8.3" ECU_ADDRESS 0x60021812 /end MEASUREMENT
/begin MEASUREMENT DINH_nrActvInhReas.FId_bInh_ChrgCntct_nrPosCntctElpdOper "" UWORD DINH_ct_Compu 1 100 -4095.000 4096.000 BIT_MASK 0x1fff FORMAT "%8.3" ECU_ADDRESS 0x60021814 /end MEASUREMENT
/begin MEASUREMENT DINH_nrActvInhReas.FId_bInh_ChrgrRly_stRlyDes "" UWORD DINH_ct_Compu 1 100 -4095.000 4096.000 BIT_MASK 0x1fff FORMAT "%8.3" ECU_ADDRESS 0x60021816 /end MEASUREMENT
/begin MEASUREMENT DINH_nrActvInhReas.FId_bInh_ChrgrVal_iChrgrDes "" UWORD DINH_ct_Compu 1 100 -4095.000 4096.000 BIT_MASK 0x1fff FORMAT "%8.3" ECU_ADDRESS 0x60021818 /end MEASUREMENT
/begin MEASUREMENT DINH_nrActvInhReas.FId_bInh_ChrgrVal_iGridLimMax "" UWORD DINH_ct_Compu 1 100 -4095.000 4096.000 BIT_MASK 0x1fff FORMAT "%8.3" ECU_ADDRESS 0x6002181A /end MEASUREMENT
/begin MEASUREMENT DINH_nrActvInhReas.FId_bInh_ChrgrVal_uHvMax "" UWORD DINH_ct_Compu 1 100 -4095.000 4096.000 BIT_MASK 0x1fff FORMAT "%8.3" ECU_ADDRESS 0x6002181C /end MEASUREMENT
/begin MEASUREMENT DINH_nrActvInhReas.FId_bInh_CoDrvPITh_stEPSModeReq "" UWORD DINH_ct_Compu 1 100 -4095.000 4096.000 BIT_MASK 0x1fff FORMAT "%8.3" ECU_ADDRESS 0x6002181E /end MEASUREMENT
/begin MEASUREMENT DINH_nrActvInhReas.FId_bInh_CoPtFH_stPwt "" UWORD DINH_ct_Compu 1 100 -4095.000 4096.000 BIT_MASK 0x1fff FORMAT "%8.3" ECU_ADDRESS 0x60021820 /end MEASUREMENT
/begin MEASUREMENT DINH_nrActvInhReas.FId_bInh_ComChrg_stMod "" UWORD DINH_ct_Compu 1 100 -4095.000 4096.000 BIT_MASK 0x1fff FORMAT "%8.3" ECU_ADDRESS 0x60021822 /end MEASUREMENT
/begin MEASUREMENT DINH_nrActvInhReas.FId_bInh_ComChrgr_stChrgnEna "" UWORD DINH_ct_Compu 1 100 -4095.000 4096.000 BIT_MASK 0x1fff FORMAT "%8.3" ECU_ADDRESS 0x60021830 /end MEASUREMENT
/begin MEASUREMENT DINH_nrActvInhReas.FId_bInh_Com_25h_B1b0 "" UWORD DINH_ct_Compu 1 100 -4095.000 4096.000 BIT_MASK 0x1fff FORMAT "%8.3" ECU_ADDRESS 0x6002183E /end MEASUREMENT
/begin MEASUREMENT DINH_nrActvInhReas.FId_bInh_Com_25h_B1b2 "" UWORD DINH_ct_Compu 1 100 -4095.000 4096.000 BIT_MASK 0x1fff FORMAT "%8.3" ECU_ADDRESS 0x60021840 /end MEASUREMENT
/begin MEASUREMENT DINH_nrActvInhReas.FId_bInh_Com_25h_B1b4 "" UWORD DINH_ct_Compu 1 100 -4095.000 4096.000 BIT_MASK 0x1fff FORMAT "%8.3" ECU_ADDRESS 0x60021842 /end MEASUREMENT
/begin MEASUREMENT DINH_nrActvInhReas.FId_bInh_Com_25h_B1b6 "" UWORD DINH_ct_Compu 1 100 -4095.000 4096.000 BIT_MASK 0x1fff FORMAT "%8.3" ECU_ADDRESS 0x60021844 /end MEASUREMENT
/begin MEASUREMENT DINH_nrActvInhReas.FId_bInh_Com_HvbMaxSnsrTempTx "" UWORD DINH_ct_Compu 1 100 -4095.000 4096.000 BIT_MASK 0x1fff FORMAT "%8.3" ECU_ADDRESS 0x60021846 /end MEASUREMENT
/begin MEASUREMENT DINH_nrActvInhReas.FId_bInh_Com_TogLedDrv "" UWORD DINH_ct_Compu 1 100 -4095.000 4096.000 BIT_MASK 0x1fff FORMAT "%8.3" ECU_ADDRESS 0x60021848 /end MEASUREMENT
/begin MEASUREMENT DINH_nrActvInhReas.FId_bInh_Com_TogLedMod "" UWORD DINH_ct_Compu 1 100 -4095.000 4096.000 BIT_MASK 0x1fff FORMAT "%8.3" ECU_ADDRESS 0x6002184A /end MEASUREMENT
/begin MEASUREMENT DINH_nrActvInhReas.FId_bInh_Com_TogLedNeut "" UWORD DINH_ct_Compu 1 100 -4095.000 4096.000 BIT_MASK 0x1fff FORMAT "%8.3" ECU_ADDRESS 0x6002184C /end MEASUREMENT
/begin MEASUREMENT DINH_nrActvInhReas.FId_bInh_Com_TogLedRvs "" UWORD DINH_ct_Compu 1 100 -4095.000 4096.000 BIT_MASK 0x1fff FORMAT "%8.3" ECU_ADDRESS 0x6002184E /end MEASUREMENT
/begin MEASUREMENT DINH_nrActvInhReas.FId_bInh_Com_bAcLedReq "" UWORD DINH_ct_Compu 1 100 -4095.000 4096.000 BIT_MASK 0x1fff FORMAT "%8.3" ECU_ADDRESS 0x60021850 /end MEASUREMENT
/begin MEASUREMENT DINH_nrActvInhReas.FId_bInh_Com_bDiagMuxCAN "" UWORD DINH_ct_Compu 1 100 -4095.000 4096.000 BIT_MASK 0x1fff FORMAT "%8.3" ECU_ADDRESS 0x60021852 /end MEASUREMENT
/begin MEASUREMENT DINH_nrActvInhReas.FId_bInh_Com_bGunCntInfoWkuReq "" UWORD DINH_ct_Compu 1 100 -4095.000 4096.000 BIT_MASK 0x1fff FORMAT "%8.3" ECU_ADDRESS 0x60021854 /end MEASUREMENT
/begin MEASUREMENT DINH_nrActvInhReas.FId_bInh_Com_bHvBattRchrgWkuReq "" UWORD DINH_ct_Compu 1 100 -4095.000 4096.000 BIT_MASK 0x1fff FORMAT "%8.3" ECU_ADDRESS 0x60021856 /end MEASUREMENT
/begin MEASUREMENT DINH_nrActvInhReas.FId_bInh_Com_bPostOperationWkuReq "" UWORD DINH_ct_Compu 1 100 -4095.000 4096.000 BIT_MASK 0x1fff FORMAT "%8.3" ECU_ADDRESS 0x60021858 /end MEASUREMENT
/begin MEASUREMENT DINH_nrActvInhReas.FId_bInh_Com_bReFogRlySt "" UWORD DINH_ct_Compu 1 100 -4095.000 4096.000 BIT_MASK 0x1fff FORMAT "%8.3" ECU_ADDRESS 0x6002185A /end MEASUREMENT
/begin MEASUREMENT DINH_nrActvInhReas.FId_bInh_Com_flgBlowrAuthn "" UWORD DINH_ct_Compu 1 100 -4095.000 4096.000 BIT_MASK 0x1fff FORMAT "%8.3" ECU_ADDRESS 0x6002185C /end MEASUREMENT
/begin MEASUREMENT DINH_nrActvInhReas.FId_bInh_Com_flgBlowrRlyCtrl "" UWORD DINH_ct_Compu 1 100 -4095.000 4096.000 BIT_MASK 0x1fff FORMAT "%8.3" ECU_ADDRESS 0x6002185E /end MEASUREMENT
/begin MEASUREMENT DINH_nrActvInhReas.FId_bInh_Com_flgBrkAlrt "" UWORD DINH_ct_Compu 1 100 -4095.000 4096.000 BIT_MASK 0x1fff FORMAT "%8.3" ECU_ADDRESS 0x60021860 /end MEASUREMENT
/begin MEASUREMENT DINH_nrActvInhReas.FId_bInh_Com_flgDrvAwy "" UWORD DINH_ct_Compu 1 100 -4095.000 4096.000 BIT_MASK 0x1fff FORMAT "%8.3" ECU_ADDRESS 0x60021862 /end MEASUREMENT
/begin MEASUREMENT DINH_nrActvInhReas.FId_bInh_Com_flgVehSpdQly "" UWORD DINH_ct_Compu 1 100 -4095.000 4096.000 BIT_MASK 0x1fff FORMAT "%8.3" ECU_ADDRESS 0x60021864 /end MEASUREMENT
/begin MEASUREMENT DINH_nrActvInhReas.FId_bInh_Com_iHvbActTx "" UWORD DINH_ct_Compu 1 100 -4095.000 4096.000 BIT_MASK 0x1fff FORMAT "%8.3" ECU_ADDRESS 0x6002186C /end MEASUREMENT
/begin MEASUREMENT DINH_nrActvInhReas.FId_bInh_Com_nElCmprActlTx "" UWORD DINH_ct_Compu 1 100 -4095.000 4096.000 BIT_MASK 0x1fff FORMAT "%8.3" ECU_ADDRESS 0x6002186E /end MEASUREMENT
/begin MEASUREMENT DINH_nrActvInhReas.FId_bInh_Com_nIvtrMotAct01 "" UWORD DINH_ct_Compu 1 100 -4095.000 4096.000 BIT_MASK 0x1fff FORMAT "%8.3" ECU_ADDRESS 0x60021870 /end MEASUREMENT
/begin MEASUREMENT DINH_nrActvInhReas.FId_bInh_Com_noEditCal "" UWORD DINH_ct_Compu 1 100 -4095.000 4096.000 BIT_MASK 0x1fff FORMAT "%8.3" ECU_ADDRESS 0x60021872 /end MEASUREMENT
/begin MEASUREMENT DINH_nrActvInhReas.FId_bInh_Com_noEditSw "" UWORD DINH_ct_Compu 1 100 -4095.000 4096.000 BIT_MASK 0x1fff FORMAT "%8.3" ECU_ADDRESS 0x60021874 /end MEASUREMENT
/begin MEASUREMENT DINH_nrActvInhReas.FId_bInh_Com_noVerSysDay "" UWORD DINH_ct_Compu 1 100 -4095.000 4096.000 BIT_MASK 0x1fff FORMAT "%8.3" ECU_ADDRESS 0x60021876 /end MEASUREMENT
/begin MEASUREMENT DINH_nrActvInhReas.FId_bInh_Com_noVersAdp "" UWORD DINH_ct_Compu 1 100 -4095.000 4096.000 BIT_MASK 0x1fff FORMAT "%8.3" ECU_ADDRESS 0x60021878 /end MEASUREMENT
/begin MEASUREMENT DINH_nrActvInhReas.FId_bInh_Com_noVersSw "" UWORD DINH_ct_Compu 1 100 -4095.000 4096.000 BIT_MASK 0x1fff FORMAT "%8.3" ECU_ADDRESS 0x6002187A /end MEASUREMENT
/begin MEASUREMENT DINH_nrActvInhReas.FId_bInh_Com_noVersSys "" UWORD DINH_ct_Compu 1 100 -4095.000 4096.000 BIT_MASK 0x1fff FORMAT "%8.3" ECU_ADDRESS 0x6002187C /end MEASUREMENT
/begin MEASUREMENT DINH_nrActvInhReas.FId_bInh_Com_noVersSysMnth "" UWORD DINH_ct_Compu 1 100 -4095.000 4096.000 BIT_MASK 0x1fff FORMAT "%8.3" ECU_ADDRESS 0x6002187E /end MEASUREMENT
/begin MEASUREMENT DINH_nrActvInhReas.FId_bInh_Com_noVersSysYr "" UWORD DINH_ct_Compu 1 100 -4095.000 4096.000 BIT_MASK 0x1fff FORMAT "%8.3" ECU_ADDRESS 0x60021880 /end MEASUREMENT
/begin MEASUREMENT DINH_nrActvInhReas.FId_bInh_Com_stACTx "" UWORD DINH_ct_Compu 1 100 -4095.000 4096.000 BIT_MASK 0x1fff FORMAT "%8.3" ECU_ADDRESS 0x60021884 /end MEASUREMENT
/begin MEASUREMENT DINH_nrActvInhReas.FId_bInh_Com_stBrk "" UWORD DINH_ct_Compu 1 100 -4095.000 4096.000 BIT_MASK 0x1fff FORMAT "%8.3" ECU_ADDRESS 0x60021886 /end MEASUREMENT
/begin MEASUREMENT DINH_nrActvInhReas.FId_bInh_Com_stBrkBstPFlt "" UWORD DINH_ct_Compu 1 100 -4095.000 4096.000 BIT_MASK 0x1fff FORMAT "%8.3" ECU_ADDRESS 0x60021888 /end MEASUREMENT
/begin MEASUREMENT DINH_nrActvInhReas.FId_bInh_Com_stBrkCntctIndcn "" UWORD DINH_ct_Compu 1 100 -4095.000 4096.000 BIT_MASK 0x1fff FORMAT "%8.3" ECU_ADDRESS 0x6002188A /end MEASUREMENT
/begin MEASUREMENT DINH_nrActvInhReas.FId_bInh_Com_stChrgPlg "" UWORD DINH_ct_Compu 1 100 -4095.000 4096.000 BIT_MASK 0x1fff FORMAT "%8.3" ECU_ADDRESS 0x6002188C /end MEASUREMENT
/begin MEASUREMENT DINH_nrActvInhReas.FId_bInh_Com_stChrgPlgChrgn "" UWORD DINH_ct_Compu 1 100 -4095.000 4096.000 BIT_MASK 0x1fff FORMAT "%8.3" ECU_ADDRESS 0x6002188E /end MEASUREMENT
/begin MEASUREMENT DINH_nrActvInhReas.FId_bInh_Com_stClstrStopIndcn "" UWORD DINH_ct_Compu 1 100 -4095.000 4096.000 BIT_MASK 0x1fff FORMAT "%8.3" ECU_ADDRESS 0x60021890 /end MEASUREMENT
/begin MEASUREMENT DINH_nrActvInhReas.FId_bInh_Com_stCmdHvBattCntctr "" UWORD DINH_ct_Compu 1 100 -4095.000 4096.000 BIT_MASK 0x1fff FORMAT "%8.3" ECU_ADDRESS 0x60021892 /end MEASUREMENT
/begin MEASUREMENT DINH_nrActvInhReas.FId_bInh_Com_stCmdOffsEM01 "" UWORD DINH_ct_Compu 1 100 -4095.000 4096.000 BIT_MASK 0x1fff FORMAT "%8.3" ECU_ADDRESS 0x60021894 /end MEASUREMENT
/begin MEASUREMENT DINH_nrActvInhReas.FId_bInh_Com_stDrvAwyDi "" UWORD DINH_ct_Compu 1 100 -4095.000 4096.000 BIT_MASK 0x1fff FORMAT "%8.3" ECU_ADDRESS 0x60021898 /end MEASUREMENT
/begin MEASUREMENT DINH_nrActvInhReas.FId_bInh_Com_stDrvModPosn "" UWORD DINH_ct_Compu 1 100 -4095.000 4096.000 BIT_MASK 0x1fff FORMAT "%8.3" ECU_ADDRESS 0x6002189A /end MEASUREMENT
/begin MEASUREMENT DINH_nrActvInhReas.FId_bInh_Com_stEVLmp "" UWORD DINH_ct_Compu 1 100 -4095.000 4096.000 BIT_MASK 0x1fff FORMAT "%8.3" ECU_ADDRESS 0x6002189C /end MEASUREMENT
/begin MEASUREMENT DINH_nrActvInhReas.FId_bInh_Com_stElCmprStatTx "" UWORD DINH_ct_Compu 1 100 -4095.000 4096.000 BIT_MASK 0x1fff FORMAT "%8.3" ECU_ADDRESS 0x6002189E /end MEASUREMENT
/begin MEASUREMENT DINH_nrActvInhReas.FId_bInh_Com_stElMDesEem "" UWORD DINH_ct_Compu 1 100 -4095.000 4096.000 BIT_MASK 0x1fff FORMAT "%8.3" ECU_ADDRESS 0x600218A0 /end MEASUREMENT
/begin MEASUREMENT DINH_nrActvInhReas.FId_bInh_Com_stHvBattOperModDes "" UWORD DINH_ct_Compu 1 100 -4095.000 4096.000 BIT_MASK 0x1fff FORMAT "%8.3" ECU_ADDRESS 0x600218A2 /end MEASUREMENT
/begin MEASUREMENT DINH_nrActvInhReas.FId_bInh_Com_stHvacBlwrFront_CAN "" UWORD DINH_ct_Compu 1 100 -4095.000 4096.000 BIT_MASK 0x1fff FORMAT "%8.3" ECU_ADDRESS 0x600218A4 /end MEASUREMENT
/begin MEASUREMENT DINH_nrActvInhReas.FId_bInh_Com_stHvacKnobPosn_CAN "" UWORD DINH_ct_Compu 1 100 -4095.000 4096.000 BIT_MASK 0x1fff FORMAT "%8.3" ECU_ADDRESS 0x600218A6 /end MEASUREMENT
/begin MEASUREMENT DINH_nrActvInhReas.FId_bInh_Com_stMstWrnLmp "" UWORD DINH_ct_Compu 1 100 -4095.000 4096.000 BIT_MASK 0x1fff FORMAT "%8.3" ECU_ADDRESS 0x600218A8 /end MEASUREMENT
/begin MEASUREMENT DINH_nrActvInhReas.FId_bInh_Com_stNwCmdLIN "" UWORD DINH_ct_Compu 1 100 -4095.000 4096.000 BIT_MASK 0x1fff FORMAT "%8.3" ECU_ADDRESS 0x600218AA /end MEASUREMENT
/begin MEASUREMENT DINH_nrActvInhReas.FId_bInh_Com_stPwrLimnLmp "" UWORD DINH_ct_Compu 1 100 -4095.000 4096.000 BIT_MASK 0x1fff FORMAT "%8.3" ECU_ADDRESS 0x600218AC /end MEASUREMENT
/begin MEASUREMENT DINH_nrActvInhReas.FId_bInh_Com_stReFogReq_CAN "" UWORD DINH_ct_Compu 1 100 -4095.000 4096.000 BIT_MASK 0x1fff FORMAT "%8.3" ECU_ADDRESS 0x600218AE /end MEASUREMENT
/begin MEASUREMENT DINH_nrActvInhReas.FId_bInh_Com_stSrvLmp "" UWORD DINH_ct_Compu 1 100 -4095.000 4096.000 BIT_MASK 0x1fff FORMAT "%8.3" ECU_ADDRESS 0x600218B0 /end MEASUREMENT
/begin MEASUREMENT DINH_nrActvInhReas.FId_bInh_Com_stVehCoorn "" UWORD DINH_ct_Compu 1 100 -4095.000 4096.000 BIT_MASK 0x1fff FORMAT "%8.3" ECU_ADDRESS 0x600218B2 /end MEASUREMENT
/begin MEASUREMENT DINH_nrActvInhReas.FId_bInh_Com_tqMotLimMax "" UWORD DINH_ct_Compu 1 100 -4095.000 4096.000 BIT_MASK 0x1fff FORMAT "%8.3" ECU_ADDRESS 0x600218B8 /end MEASUREMENT
/begin MEASUREMENT DINH_nrActvInhReas.FId_bInh_Com_uHvbActTx "" UWORD DINH_ct_Compu 1 100 -4095.000 4096.000 BIT_MASK 0x1fff FORMAT "%8.3" ECU_ADDRESS 0x600218BE /end MEASUREMENT
/begin MEASUREMENT DINH_nrActvInhReas.FId_bInh_Com_valEepOffsEM01 "" UWORD DINH_ct_Compu 1 100 -4095.000 4096.000 BIT_MASK 0x1fff FORMAT "%8.3" ECU_ADDRESS 0x600218C0 /end MEASUREMENT
/begin MEASUREMENT DINH_nrActvInhReas.FId_bInh_DcChrgnRly_ctMaxOperCyc "" UWORD DINH_ct_Compu 1 100 -4095.000 4096.000 BIT_MASK 0x1fff FORMAT "%8.3" ECU_ADDRESS 0x600218C2 /end MEASUREMENT
/begin MEASUREMENT DINH_nrActvInhReas.FId_bInh_Dcdc_flgDesLvGridULim "" UWORD DINH_ct_Compu 1 100 -4095.000 4096.000 BIT_MASK 0x1fff FORMAT "%8.3" ECU_ADDRESS 0x600218C4 /end MEASUREMENT
/begin MEASUREMENT DINH_nrActvInhReas.FId_bInh_Dcdc_iLimLvGrid "" UWORD DINH_ct_Compu 1 100 -4095.000 4096.000 BIT_MASK 0x1fff FORMAT "%8.3" ECU_ADDRESS 0x600218C6 /end MEASUREMENT
/begin MEASUREMENT DINH_nrActvInhReas.FId_bInh_Dcdc_stDesDcdc "" UWORD DINH_ct_Compu 1 100 -4095.000 4096.000 BIT_MASK 0x1fff FORMAT "%8.3" ECU_ADDRESS 0x600218C8 /end MEASUREMENT
/begin MEASUREMENT DINH_nrActvInhReas.FId_bInh_Dcdc_uDesLvGrid "" UWORD DINH_ct_Compu 1 100 -4095.000 4096.000 BIT_MASK 0x1fff FORMAT "%8.3" ECU_ADDRESS 0x600218CA /end MEASUREMENT
/begin MEASUREMENT DINH_nrActvInhReas.FId_bInh_DrvInfo_wTotTripEgy "" UWORD DINH_ct_Compu 1 100 -4095.000 4096.000 BIT_MASK 0x1fff FORMAT "%8.3" ECU_ADDRESS 0x600218CC /end MEASUREMENT
/begin MEASUREMENT DINH_nrActvInhReas.FId_bInh_EChrDv_cntPlin "" UWORD DINH_ct_Compu 1 100 -4095.000 4096.000 BIT_MASK 0x1fff FORMAT "%8.3" ECU_ADDRESS 0x600218CE /end MEASUREMENT
/begin MEASUREMENT DINH_nrActvInhReas.FId_bInh_Eem_flgFstHvShdwn "" UWORD DINH_ct_Compu 1 100 -4095.000 4096.000 BIT_MASK 0x1fff FORMAT "%8.3" ECU_ADDRESS 0x600218D0 /end MEASUREMENT
/begin MEASUREMENT DINH_nrActvInhReas.FId_bInh_ElM_stDesEem01 "" UWORD DINH_ct_Compu 1 100 -4095.000 4096.000 BIT_MASK 0x1fff FORMAT "%8.3" ECU_ADDRESS 0x600218D2 /end MEASUREMENT
/begin MEASUREMENT DINH_nrActvInhReas.FId_bInh_ElTS_egyTotChrgCyc "" UWORD DINH_ct_Compu 1 100 -4095.000 4096.000 BIT_MASK 0x1fff FORMAT "%8.3" ECU_ADDRESS 0x600218D4 /end MEASUREMENT
/begin MEASUREMENT DINH_nrActvInhReas.FId_bInh_ElTS_ratEmPowChrgn "" UWORD DINH_ct_Compu 1 100 -4095.000 4096.000 BIT_MASK 0x1fff FORMAT "%8.3" ECU_ADDRESS 0x600218D6 /end MEASUREMENT
/begin MEASUREMENT DINH_nrActvInhReas.FId_bInh_ElTS_ratEmPowDcha "" UWORD DINH_ct_Compu 1 100 -4095.000 4096.000 BIT_MASK 0x1fff FORMAT "%8.3" ECU_ADDRESS 0x600218D8 /end MEASUREMENT
/begin MEASUREMENT DINH_nrActvInhReas.FId_bInh_ElTS_stChrgCyc "" UWORD DINH_ct_Compu 1 100 -4095.000 4096.000 BIT_MASK 0x1fff FORMAT "%8.3" ECU_ADDRESS 0x600218DA /end MEASUREMENT
/begin MEASUREMENT DINH_nrActvInhReas.FId_bInh_Emac_stIsoMonSwtReq "" UWORD DINH_ct_Compu 1 100 -4095.000 4096.000 BIT_MASK 0x1fff FORMAT "%8.3" ECU_ADDRESS 0x600218DC /end MEASUREMENT
/begin MEASUREMENT DINH_nrActvInhReas.FId_bInh_Emac_tqDesCom01 "" UWORD DINH_ct_Compu 1 100 -4095.000 4096.000 BIT_MASK 0x1fff FORMAT "%8.3" ECU_ADDRESS 0x600218DE /end MEASUREMENT
/begin MEASUREMENT DINH_nrActvInhReas.FId_bInh_Ext_bSyncGPC "" UWORD DINH_ct_Compu 1 100 -4095.000 4096.000 BIT_MASK 0x1fff FORMAT "%8.3" ECU_ADDRESS 0x600218E0 /end MEASUREMENT
/begin MEASUREMENT DINH_nrActvInhReas.FId_bInh_HvBatt_flgIsoMeasmtDiReq "" UWORD DINH_ct_Compu 1 100 -4095.000 4096.000 BIT_MASK 0x1fff FORMAT "%8.3" ECU_ADDRESS 0x600218E2 /end MEASUREMENT
/begin MEASUREMENT DINH_nrActvInhReas.FId_bInh_HvBatt_ratSoc "" UWORD DINH_ct_Compu 1 100 -4095.000 4096.000 BIT_MASK 0x1fff FORMAT "%8.3" ECU_ADDRESS 0x600218E4 /end MEASUREMENT
/begin MEASUREMENT DINH_nrActvInhReas.FId_bInh_HvGrid_pwrMaxDcdc "" UWORD DINH_ct_Compu 1 100 -4095.000 4096.000 BIT_MASK 0x1fff FORMAT "%8.3" ECU_ADDRESS 0x600218E6 /end MEASUREMENT
/begin MEASUREMENT DINH_nrActvInhReas.FId_bInh_HvacPtc_stElHeatr "" UWORD DINH_ct_Compu 1 100 -4095.000 4096.000 BIT_MASK 0x1fff FORMAT "%8.3" ECU_ADDRESS 0x600218E8 /end MEASUREMENT
/begin MEASUREMENT DINH_nrActvInhReas.FId_bInh_Pdu_CLUSTER_5E7_Frz "" UWORD DINH_ct_Compu 1 100 -4095.000 4096.000 BIT_MASK 0x1fff FORMAT "%8.3" ECU_ADDRESS 0x600218EA /end MEASUREMENT
/begin MEASUREMENT DINH_nrActvInhReas.FId_bInh_Pdu_CLUSTER_5E7_Rcf "" UWORD DINH_ct_Compu 1 100 -4095.000 4096.000 BIT_MASK 0x1fff FORMAT "%8.3" ECU_ADDRESS 0x600218EC /end MEASUREMENT
/begin MEASUREMENT DINH_nrActvInhReas.FId_bInh_Pdu_CONTEXTE_1_5B2_Frz "" UWORD DINH_ct_Compu 1 100 -4095.000 4096.000 BIT_MASK 0x1fff FORMAT "%8.3" ECU_ADDRESS 0x600218EE /end MEASUREMENT
/begin MEASUREMENT DINH_nrActvInhReas.FId_bInh_Pdu_CONTEXTE_1_5B2_Rcf "" UWORD DINH_ct_Compu 1 100 -4095.000 4096.000 BIT_MASK 0x1fff FORMAT "%8.3" ECU_ADDRESS 0x600218F0 /end MEASUREMENT
/begin MEASUREMENT DINH_nrActvInhReas.FId_bInh_Pdu_DAT3_BSI_4F2h_Frz "" UWORD DINH_ct_Compu 1 100 -4095.000 4096.000 BIT_MASK 0x1fff FORMAT "%8.3" ECU_ADDRESS 0x600218F6 /end MEASUREMENT
/begin MEASUREMENT DINH_nrActvInhReas.FId_bInh_Pdu_DAT3_BSI_4F2h_Rcf "" UWORD DINH_ct_Compu 1 100 -4095.000 4096.000 BIT_MASK 0x1fff FORMAT "%8.3" ECU_ADDRESS 0x600218F8 /end MEASUREMENT
/begin MEASUREMENT DINH_nrActvInhReas.FId_bInh_Pdu_DCDC_283h_Frz "" UWORD DINH_ct_Compu 1 100 -4095.000 4096.000 BIT_MASK 0x1fff FORMAT "%8.3" ECU_ADDRESS 0x600218FA /end MEASUREMENT
/begin MEASUREMENT DINH_nrActvInhReas.FId_bInh_Pdu_DCDC_283h_Rcf "" UWORD DINH_ct_Compu 1 100 -4095.000 4096.000 BIT_MASK 0x1fff FORMAT "%8.3" ECU_ADDRESS 0x600218FC /end MEASUREMENT
/begin MEASUREMENT DINH_nrActvInhReas.FId_bInh_Pdu_DCDC_293h_Frz "" UWORD DINH_ct_Compu 1 100 -4095.000 4096.000 BIT_MASK 0x1fff FORMAT "%8.3" ECU_ADDRESS 0x600218FE /end MEASUREMENT
/begin MEASUREMENT DINH_nrActvInhReas.FId_bInh_Pdu_DCDC_293h_Rcf "" UWORD DINH_ct_Compu 1 100 -4095.000 4096.000 BIT_MASK 0x1fff FORMAT "%8.3" ECU_ADDRESS 0x60021900 /end MEASUREMENT
/begin MEASUREMENT DINH_nrActvInhReas.FId_bInh_Pdu_DCDC_473h_Frz "" UWORD DINH_ct_Compu 1 100 -4095.000 4096.000 BIT_MASK 0x1fff FORMAT "%8.3" ECU_ADDRESS 0x60021902 /end MEASUREMENT
/begin MEASUREMENT DINH_nrActvInhReas.FId_bInh_Pdu_DCDC_473h_Rcf "" UWORD DINH_ct_Compu 1 100 -4095.000 4096.000 BIT_MASK 0x1fff FORMAT "%8.3" ECU_ADDRESS 0x60021904 /end MEASUREMENT
/begin MEASUREMENT DINH_nrActvInhReas.FId_bInh_Pdu_DCDC_663h_Frz "" UWORD DINH_ct_Compu 1 100 -4095.000 4096.000 BIT_MASK 0x1fff FORMAT "%8.3" ECU_ADDRESS 0x60021906 /end MEASUREMENT
/begin MEASUREMENT DINH_nrActvInhReas.FId_bInh_Pdu_DCDC_663h_Rcf "" UWORD DINH_ct_Compu 1 100 -4095.000 4096.000 BIT_MASK 0x1fff FORMAT "%8.3" ECU_ADDRESS 0x60021908 /end MEASUREMENT
/begin MEASUREMENT DINH_nrActvInhReas.FId_bInh_Pdu_HS3_AUTO_GEARBOX_SWITCH_STATUS_Frz "" UWORD DINH_ct_Compu 1 100 -4095.000 4096.000 BIT_MASK 0x1fff FORMAT "%8.3" ECU_ADDRESS 0x6002190A /end MEASUREMENT
/begin MEASUREMENT DINH_nrActvInhReas.FId_bInh_Pdu_HS3_AUTO_GEARBOX_SWITCH_STATUS_Rcf "" UWORD DINH_ct_Compu 1 100 -4095.000 4096.000 BIT_MASK 0x1fff FORMAT "%8.3" ECU_ADDRESS 0x6002190C /end MEASUREMENT
/begin MEASUREMENT DINH_nrActvInhReas.FId_bInh_Pdu_HVAC_PANEL_26h_Frz "" UWORD DINH_ct_Compu 1 100 -4095.000 4096.000 BIT_MASK 0x1fff FORMAT "%8.3" ECU_ADDRESS 0x6002190E /end MEASUREMENT
/begin MEASUREMENT DINH_nrActvInhReas.FId_bInh_Pdu_HVAC_PANEL_26h_Rcf "" UWORD DINH_ct_Compu 1 100 -4095.000 4096.000 BIT_MASK 0x1fff FORMAT "%8.3" ECU_ADDRESS 0x60021910 /end MEASUREMENT
/begin MEASUREMENT DINH_nrActvInhReas.FId_bInh_Pdu_HVBAT_205h_Frz "" UWORD DINH_ct_Compu 1 100 -4095.000 4096.000 BIT_MASK 0x1fff FORMAT "%8.3" ECU_ADDRESS 0x60021912 /end MEASUREMENT
/begin MEASUREMENT DINH_nrActvInhReas.FId_bInh_Pdu_HVBAT_205h_Rcf "" UWORD DINH_ct_Compu 1 100 -4095.000 4096.000 BIT_MASK 0x1fff FORMAT "%8.3" ECU_ADDRESS 0x60021914 /end MEASUREMENT
/begin MEASUREMENT DINH_nrActvInhReas.FId_bInh_Pdu_HVBAT_275h_Frz "" UWORD DINH_ct_Compu 1 100 -4095.000 4096.000 BIT_MASK 0x1fff FORMAT "%8.3" ECU_ADDRESS 0x60021916 /end MEASUREMENT
/begin MEASUREMENT DINH_nrActvInhReas.FId_bInh_Pdu_HVBAT_275h_Rcf "" UWORD DINH_ct_Compu 1 100 -4095.000 4096.000 BIT_MASK 0x1fff FORMAT "%8.3" ECU_ADDRESS 0x60021918 /end MEASUREMENT
/begin MEASUREMENT DINH_nrActvInhReas.FId_bInh_Pdu_HVBAT_285h_Frz "" UWORD DINH_ct_Compu 1 100 -4095.000 4096.000 BIT_MASK 0x1fff FORMAT "%8.3" ECU_ADDRESS 0x6002191A /end MEASUREMENT
/begin MEASUREMENT DINH_nrActvInhReas.FId_bInh_Pdu_HVBAT_285h_Rcf "" UWORD DINH_ct_Compu 1 100 -4095.000 4096.000 BIT_MASK 0x1fff FORMAT "%8.3" ECU_ADDRESS 0x6002191C /end MEASUREMENT
/begin MEASUREMENT DINH_nrActvInhReas.FId_bInh_Pdu_HVBAT_325h_Frz "" UWORD DINH_ct_Compu 1 100 -4095.000 4096.000 BIT_MASK 0x1fff FORMAT "%8.3" ECU_ADDRESS 0x6002191E /end MEASUREMENT
/begin MEASUREMENT DINH_nrActvInhReas.FId_bInh_Pdu_HVBAT_325h_Rcf "" UWORD DINH_ct_Compu 1 100 -4095.000 4096.000 BIT_MASK 0x1fff FORMAT "%8.3" ECU_ADDRESS 0x60021920 /end MEASUREMENT
/begin MEASUREMENT DINH_nrActvInhReas.FId_bInh_Pdu_HVBAT_335h_Frz "" UWORD DINH_ct_Compu 1 100 -4095.000 4096.000 BIT_MASK 0x1fff FORMAT "%8.3" ECU_ADDRESS 0x60021922 /end MEASUREMENT
/begin MEASUREMENT DINH_nrActvInhReas.FId_bInh_Pdu_HVBAT_335h_Rcf "" UWORD DINH_ct_Compu 1 100 -4095.000 4096.000 BIT_MASK 0x1fff FORMAT "%8.3" ECU_ADDRESS 0x60021924 /end MEASUREMENT
/begin MEASUREMENT DINH_nrActvInhReas.FId_bInh_Pdu_HVBAT_455h_Frz "" UWORD DINH_ct_Compu 1 100 -4095.000 4096.000 BIT_MASK 0x1fff FORMAT "%8.3" ECU_ADDRESS 0x60021926 /end MEASUREMENT
/begin MEASUREMENT DINH_nrActvInhReas.FId_bInh_Pdu_HVBAT_455h_Rcf "" UWORD DINH_ct_Compu 1 100 -4095.000 4096.000 BIT_MASK 0x1fff FORMAT "%8.3" ECU_ADDRESS 0x60021928 /end MEASUREMENT
/begin MEASUREMENT DINH_nrActvInhReas.FId_bInh_Pdu_HVBAT_535_Frz "" UWORD DINH_ct_Compu 1 100 -4095.000 4096.000 BIT_MASK 0x1fff FORMAT "%8.3" ECU_ADDRESS 0x6002192A /end MEASUREMENT
/begin MEASUREMENT DINH_nrActvInhReas.FId_bInh_Pdu_HVBAT_535_Rcf "" UWORD DINH_ct_Compu 1 100 -4095.000 4096.000 BIT_MASK 0x1fff FORMAT "%8.3" ECU_ADDRESS 0x6002192C /end MEASUREMENT
/begin MEASUREMENT DINH_nrActvInhReas.FId_bInh_Pdu_HVBAT_595h_Frz "" UWORD DINH_ct_Compu 1 100 -4095.000 4096.000 BIT_MASK 0x1fff FORMAT "%8.3" ECU_ADDRESS 0x6002192E /end MEASUREMENT
/begin MEASUREMENT DINH_nrActvInhReas.FId_bInh_Pdu_HVBAT_595h_Rcf "" UWORD DINH_ct_Compu 1 100 -4095.000 4096.000 BIT_MASK 0x1fff FORMAT "%8.3" ECU_ADDRESS 0x60021930 /end MEASUREMENT
/begin MEASUREMENT DINH_nrActvInhReas.FId_bInh_Pdu_HVBAT_635h_Frz "" UWORD DINH_ct_Compu 1 100 -4095.000 4096.000 BIT_MASK 0x1fff FORMAT "%8.3" ECU_ADDRESS 0x60021932 /end MEASUREMENT
/begin MEASUREMENT DINH_nrActvInhReas.FId_bInh_Pdu_HVBAT_635h_Rcf "" UWORD DINH_ct_Compu 1 100 -4095.000 4096.000 BIT_MASK 0x1fff FORMAT "%8.3" ECU_ADDRESS 0x60021934 /end MEASUREMENT
/begin MEASUREMENT DINH_nrActvInhReas.FId_bInh_Pdu_HVBAT_645h_Frz "" UWORD DINH_ct_Compu 1 100 -4095.000 4096.000 BIT_MASK 0x1fff FORMAT "%8.3" ECU_ADDRESS 0x60021936 /end MEASUREMENT
/begin MEASUREMENT DINH_nrActvInhReas.FId_bInh_Pdu_HVBAT_645h_Rcf "" UWORD DINH_ct_Compu 1 100 -4095.000 4096.000 BIT_MASK 0x1fff FORMAT "%8.3" ECU_ADDRESS 0x60021938 /end MEASUREMENT
/begin MEASUREMENT DINH_nrActvInhReas.FId_bInh_Pdu_HVBAT_665h_Frz "" UWORD DINH_ct_Compu 1 100 -4095.000 4096.000 BIT_MASK 0x1fff FORMAT "%8.3" ECU_ADDRESS 0x6002193A /end MEASUREMENT
/begin MEASUREMENT DINH_nrActvInhReas.FId_bInh_Pdu_HVBAT_665h_Rcf "" UWORD DINH_ct_Compu 1 100 -4095.000 4096.000 BIT_MASK 0x1fff FORMAT "%8.3" ECU_ADDRESS 0x6002193C /end MEASUREMENT
/begin MEASUREMENT DINH_nrActvInhReas.FId_bInh_Pdu_HVBAT_675h_Frz "" UWORD DINH_ct_Compu 1 100 -4095.000 4096.000 BIT_MASK 0x1fff FORMAT "%8.3" ECU_ADDRESS 0x6002193E /end MEASUREMENT
/begin MEASUREMENT DINH_nrActvInhReas.FId_bInh_Pdu_HVBAT_675h_Rcf "" UWORD DINH_ct_Compu 1 100 -4095.000 4096.000 BIT_MASK 0x1fff FORMAT "%8.3" ECU_ADDRESS 0x60021940 /end MEASUREMENT
/begin MEASUREMENT DINH_nrActvInhReas.FId_bInh_Pdu_HVBAT_THERMAL_5B5_Frz "" UWORD DINH_ct_Compu 1 100 -4095.000 4096.000 BIT_MASK 0x1fff FORMAT "%8.3" ECU_ADDRESS 0x60021942 /end MEASUREMENT
/begin MEASUREMENT DINH_nrActvInhReas.FId_bInh_Pdu_HVBAT_THERMAL_5B5_Rcf "" UWORD DINH_ct_Compu 1 100 -4095.000 4096.000 BIT_MASK 0x1fff FORMAT "%8.3" ECU_ADDRESS 0x60021944 /end MEASUREMENT
/begin MEASUREMENT DINH_nrActvInhReas.FId_bInh_Pdu_HVBAT_VCU_435h_Frz "" UWORD DINH_ct_Compu 1 100 -4095.000 4096.000 BIT_MASK 0x1fff FORMAT "%8.3" ECU_ADDRESS 0x60021946 /end MEASUREMENT
/begin MEASUREMENT DINH_nrActvInhReas.FId_bInh_Pdu_HVBAT_VCU_435h_Rcf "" UWORD DINH_ct_Compu 1 100 -4095.000 4096.000 BIT_MASK 0x1fff FORMAT "%8.3" ECU_ADDRESS 0x60021948 /end MEASUREMENT
/begin MEASUREMENT DINH_nrActvInhReas.FId_bInh_Pdu_HVBAT_VCU_543_Frz "" UWORD DINH_ct_Compu 1 100 -4095.000 4096.000 BIT_MASK 0x1fff FORMAT "%8.3" ECU_ADDRESS 0x6002194A /end MEASUREMENT
/begin MEASUREMENT DINH_nrActvInhReas.FId_bInh_Pdu_HVBAT_VCU_543_Rcf "" UWORD DINH_ct_Compu 1 100 -4095.000 4096.000 BIT_MASK 0x1fff FORMAT "%8.3" ECU_ADDRESS 0x6002194C /end MEASUREMENT
/begin MEASUREMENT DINH_nrActvInhReas.FId_bInh_Pdu_HVBAT_VCU_583_Frz "" UWORD DINH_ct_Compu 1 100 -4095.000 4096.000 BIT_MASK 0x1fff FORMAT "%8.3" ECU_ADDRESS 0x6002194E /end MEASUREMENT
/begin MEASUREMENT DINH_nrActvInhReas.FId_bInh_Pdu_HVBAT_VCU_583_Rcf "" UWORD DINH_ct_Compu 1 100 -4095.000 4096.000 BIT_MASK 0x1fff FORMAT "%8.3" ECU_ADDRESS 0x60021950 /end MEASUREMENT
/begin MEASUREMENT DINH_nrActvInhReas.FId_bInh_Pdu_INV_217h_Frz "" UWORD DINH_ct_Compu 1 100 -4095.000 4096.000 BIT_MASK 0x1fff FORMAT "%8.3" ECU_ADDRESS 0x60021952 /end MEASUREMENT
/begin MEASUREMENT DINH_nrActvInhReas.FId_bInh_Pdu_INV_217h_Rcf "" UWORD DINH_ct_Compu 1 100 -4095.000 4096.000 BIT_MASK 0x1fff FORMAT "%8.3" ECU_ADDRESS 0x60021954 /end MEASUREMENT
/begin MEASUREMENT DINH_nrActvInhReas.FId_bInh_Pdu_INV_227h_Frz "" UWORD DINH_ct_Compu 1 100 -4095.000 4096.000 BIT_MASK 0x1fff FORMAT "%8.3" ECU_ADDRESS 0x60021956 /end MEASUREMENT
/begin MEASUREMENT DINH_nrActvInhReas.FId_bInh_Pdu_INV_227h_Rcf "" UWORD DINH_ct_Compu 1 100 -4095.000 4096.000 BIT_MASK 0x1fff FORMAT "%8.3" ECU_ADDRESS 0x60021958 /end MEASUREMENT
/begin MEASUREMENT DINH_nrActvInhReas.FId_bInh_Pdu_INV_237_Frz "" UWORD DINH_ct_Compu 1 100 -4095.000 4096.000 BIT_MASK 0x1fff FORMAT "%8.3" ECU_ADDRESS 0x6002195A /end MEASUREMENT
/begin MEASUREMENT DINH_nrActvInhReas.FId_bInh_Pdu_INV_237_Rcf "" UWORD DINH_ct_Compu 1 100 -4095.000 4096.000 BIT_MASK 0x1fff FORMAT "%8.3" ECU_ADDRESS 0x6002195C /end MEASUREMENT
/begin MEASUREMENT DINH_nrActvInhReas.FId_bInh_Pdu_INV_427h_Frz "" UWORD DINH_ct_Compu 1 100 -4095.000 4096.000 BIT_MASK 0x1fff FORMAT "%8.3" ECU_ADDRESS 0x6002195E /end MEASUREMENT
/begin MEASUREMENT DINH_nrActvInhReas.FId_bInh_Pdu_INV_427h_Rcf "" UWORD DINH_ct_Compu 1 100 -4095.000 4096.000 BIT_MASK 0x1fff FORMAT "%8.3" ECU_ADDRESS 0x60021960 /end MEASUREMENT
/begin MEASUREMENT DINH_nrActvInhReas.FId_bInh_Pdu_INV_497h_Frz "" UWORD DINH_ct_Compu 1 100 -4095.000 4096.000 BIT_MASK 0x1fff FORMAT "%8.3" ECU_ADDRESS 0x60021962 /end MEASUREMENT
/begin MEASUREMENT DINH_nrActvInhReas.FId_bInh_Pdu_INV_497h_Rcf "" UWORD DINH_ct_Compu 1 100 -4095.000 4096.000 BIT_MASK 0x1fff FORMAT "%8.3" ECU_ADDRESS 0x60021964 /end MEASUREMENT
/begin MEASUREMENT DINH_nrActvInhReas.FId_bInh_Pdu_INV_IMMO_5C7_Frz "" UWORD DINH_ct_Compu 1 100 -4095.000 4096.000 BIT_MASK 0x1fff FORMAT "%8.3" ECU_ADDRESS 0x60021966 /end MEASUREMENT
/begin MEASUREMENT DINH_nrActvInhReas.FId_bInh_Pdu_INV_IMMO_5C7_Rcf "" UWORD DINH_ct_Compu 1 100 -4095.000 4096.000 BIT_MASK 0x1fff FORMAT "%8.3" ECU_ADDRESS 0x60021968 /end MEASUREMENT
/begin MEASUREMENT DINH_nrActvInhReas.FId_bInh_Pdu_IS_DAT6_BSI_592h_Frz "" UWORD DINH_ct_Compu 1 100 -4095.000 4096.000 BIT_MASK 0x1fff FORMAT "%8.3" ECU_ADDRESS 0x6002196A /end MEASUREMENT
/begin MEASUREMENT DINH_nrActvInhReas.FId_bInh_Pdu_IS_DAT6_BSI_592h_Rcf "" UWORD DINH_ct_Compu 1 100 -4095.000 4096.000 BIT_MASK 0x1fff FORMAT "%8.3" ECU_ADDRESS 0x6002196C /end MEASUREMENT
/begin MEASUREMENT DINH_nrActvInhReas.FId_bInh_Pdu_IS_DAT_ABR_50Dh_Frz "" UWORD DINH_ct_Compu 1 100 -4095.000 4096.000 BIT_MASK 0x1fff FORMAT "%8.3" ECU_ADDRESS 0x6002196E /end MEASUREMENT
/begin MEASUREMENT DINH_nrActvInhReas.FId_bInh_Pdu_IS_DAT_ABR_50Dh_Rcf "" UWORD DINH_ct_Compu 1 100 -4095.000 4096.000 BIT_MASK 0x1fff FORMAT "%8.3" ECU_ADDRESS 0x60021970 /end MEASUREMENT
/begin MEASUREMENT DINH_nrActvInhReas.FId_bInh_Pdu_IS_DAT_BSI_412h_Frz "" UWORD DINH_ct_Compu 1 100 -4095.000 4096.000 BIT_MASK 0x1fff FORMAT "%8.3" ECU_ADDRESS 0x60021972 /end MEASUREMENT
/begin MEASUREMENT DINH_nrActvInhReas.FId_bInh_Pdu_IS_DAT_BSI_412h_Rcf "" UWORD DINH_ct_Compu 1 100 -4095.000 4096.000 BIT_MASK 0x1fff FORMAT "%8.3" ECU_ADDRESS 0x60021974 /end MEASUREMENT
/begin MEASUREMENT DINH_nrActvInhReas.FId_bInh_Pdu_IS_DYN_ABR_38Dh_Frz "" UWORD DINH_ct_Compu 1 100 -4095.000 4096.000 BIT_MASK 0x1fff FORMAT "%8.3" ECU_ADDRESS 0x60021976 /end MEASUREMENT
/begin MEASUREMENT DINH_nrActvInhReas.FId_bInh_Pdu_IS_DYN_ABR_38Dh_Rcf "" UWORD DINH_ct_Compu 1 100 -4095.000 4096.000 BIT_MASK 0x1fff FORMAT "%8.3" ECU_ADDRESS 0x60021978 /end MEASUREMENT
/begin MEASUREMENT DINH_nrActvInhReas.FId_bInh_Pdu_IS_INTE_ELECTRON_BSI_092h_Frz "" UWORD DINH_ct_Compu 1 100 -4095.000 4096.000 BIT_MASK 0x1fff FORMAT "%8.3" ECU_ADDRESS 0x6002197A /end MEASUREMENT
/begin MEASUREMENT DINH_nrActvInhReas.FId_bInh_Pdu_IS_INTE_ELECTRON_BSI_092h_Rcf "" UWORD DINH_ct_Compu 1 100 -4095.000 4096.000 BIT_MASK 0x1fff FORMAT "%8.3" ECU_ADDRESS 0x6002197C /end MEASUREMENT
/begin MEASUREMENT DINH_nrActvInhReas.FId_bInh_Pdu_OBC_273h_Frz "" UWORD DINH_ct_Compu 1 100 -4095.000 4096.000 BIT_MASK 0x1fff FORMAT "%8.3" ECU_ADDRESS 0x6002197E /end MEASUREMENT
/begin MEASUREMENT DINH_nrActvInhReas.FId_bInh_Pdu_OBC_273h_Rcf "" UWORD DINH_ct_Compu 1 100 -4095.000 4096.000 BIT_MASK 0x1fff FORMAT "%8.3" ECU_ADDRESS 0x60021980 /end MEASUREMENT
/begin MEASUREMENT DINH_nrActvInhReas.FId_bInh_Pdu_OBC_453h_Frz "" UWORD DINH_ct_Compu 1 100 -4095.000 4096.000 BIT_MASK 0x1fff FORMAT "%8.3" ECU_ADDRESS 0x60021982 /end MEASUREMENT
/begin MEASUREMENT DINH_nrActvInhReas.FId_bInh_Pdu_OBC_453h_Rcf "" UWORD DINH_ct_Compu 1 100 -4095.000 4096.000 BIT_MASK 0x1fff FORMAT "%8.3" ECU_ADDRESS 0x60021984 /end MEASUREMENT
/begin MEASUREMENT DINH_nrActvInhReas.FId_bInh_Pdu_OBC_463h_Frz "" UWORD DINH_ct_Compu 1 100 -4095.000 4096.000 BIT_MASK 0x1fff FORMAT "%8.3" ECU_ADDRESS 0x60021986 /end MEASUREMENT
/begin MEASUREMENT DINH_nrActvInhReas.FId_bInh_Pdu_OBC_463h_Rcf "" UWORD DINH_ct_Compu 1 100 -4095.000 4096.000 BIT_MASK 0x1fff FORMAT "%8.3" ECU_ADDRESS 0x60021988 /end MEASUREMENT
/begin MEASUREMENT DINH_nrActvInhReas.FId_bInh_Pdu_PDU_BusVoltages_308_Frz "" UWORD DINH_ct_Compu 1 100 -4095.000 4096.000 BIT_MASK 0x1fff FORMAT "%8.3" ECU_ADDRESS 0x6002198A /end MEASUREMENT
/begin MEASUREMENT DINH_nrActvInhReas.FId_bInh_Pdu_PDU_BusVoltages_308_Rcf "" UWORD DINH_ct_Compu 1 100 -4095.000 4096.000 BIT_MASK 0x1fff FORMAT "%8.3" ECU_ADDRESS 0x6002198C /end MEASUREMENT
/begin MEASUREMENT DINH_nrActvInhReas.FId_bInh_Pdu_PDU_Current_318_Frz "" UWORD DINH_ct_Compu 1 100 -4095.000 4096.000 BIT_MASK 0x1fff FORMAT "%8.3" ECU_ADDRESS 0x6002198E /end MEASUREMENT
/begin MEASUREMENT DINH_nrActvInhReas.FId_bInh_Pdu_PDU_Current_318_Rcf "" UWORD DINH_ct_Compu 1 100 -4095.000 4096.000 BIT_MASK 0x1fff FORMAT "%8.3" ECU_ADDRESS 0x60021990 /end MEASUREMENT
/begin MEASUREMENT DINH_nrActvInhReas.FId_bInh_Pdu_SC_INFO_BCCM_442h_Frz "" UWORD DINH_ct_Compu 1 100 -4095.000 4096.000 BIT_MASK 0x1fff FORMAT "%8.3" ECU_ADDRESS 0x60021992 /end MEASUREMENT
/begin MEASUREMENT DINH_nrActvInhReas.FId_bInh_Pdu_SC_INFO_BCCM_442h_Rcf "" UWORD DINH_ct_Compu 1 100 -4095.000 4096.000 BIT_MASK 0x1fff FORMAT "%8.3" ECU_ADDRESS 0x60021994 /end MEASUREMENT
/begin MEASUREMENT DINH_nrActvInhReas.FId_bInh_Pdu_VCU_AIRBAG_351h_Frz "" UWORD DINH_ct_Compu 1 100 -4095.000 4096.000 BIT_MASK 0x1fff FORMAT "%8.3" ECU_ADDRESS 0x60021996 /end MEASUREMENT
/begin MEASUREMENT DINH_nrActvInhReas.FId_bInh_Pdu_VCU_AIRBAG_351h_Rcf "" UWORD DINH_ct_Compu 1 100 -4095.000 4096.000 BIT_MASK 0x1fff FORMAT "%8.3" ECU_ADDRESS 0x60021998 /end MEASUREMENT
/begin MEASUREMENT DINH_nrActvInhReas.FId_bInh_Pdu_VCU_eBCCM_432h_Frz "" UWORD DINH_ct_Compu 1 100 -4095.000 4096.000 BIT_MASK 0x1fff FORMAT "%8.3" ECU_ADDRESS 0x6002199C /end MEASUREMENT
/begin MEASUREMENT DINH_nrActvInhReas.FId_bInh_Pdu_VCU_eBCCM_432h_Rcf "" UWORD DINH_ct_Compu 1 100 -4095.000 4096.000 BIT_MASK 0x1fff FORMAT "%8.3" ECU_ADDRESS 0x6002199E /end MEASUREMENT
/begin MEASUREMENT DINH_nrActvInhReas.FId_bInh_Pdu_VCU_eBCCM_552h_Frz "" UWORD DINH_ct_Compu 1 100 -4095.000 4096.000 BIT_MASK 0x1fff FORMAT "%8.3" ECU_ADDRESS 0x600219A0 /end MEASUREMENT
/begin MEASUREMENT DINH_nrActvInhReas.FId_bInh_Pdu_VCU_eBCCM_552h_Rcf "" UWORD DINH_ct_Compu 1 100 -4095.000 4096.000 BIT_MASK 0x1fff FORMAT "%8.3" ECU_ADDRESS 0x600219A2 /end MEASUREMENT
/begin MEASUREMENT DINH_nrActvInhReas.FId_bInh_Pdu_eBCCM_082h_Frz "" UWORD DINH_ct_Compu 1 100 -4095.000 4096.000 BIT_MASK 0x1fff FORMAT "%8.3" ECU_ADDRESS 0x600219A4 /end MEASUREMENT
/begin MEASUREMENT DINH_nrActvInhReas.FId_bInh_Pdu_eBCCM_082h_Rcf "" UWORD DINH_ct_Compu 1 100 -4095.000 4096.000 BIT_MASK 0x1fff FORMAT "%8.3" ECU_ADDRESS 0x600219A6 /end MEASUREMENT
/begin MEASUREMENT DINH_nrActvInhReas.FId_bInh_Pdu_eCOMP_Information_47B_Frz "" UWORD DINH_ct_Compu 1 100 -4095.000 4096.000 BIT_MASK 0x1fff FORMAT "%8.3" ECU_ADDRESS 0x600219A8 /end MEASUREMENT
/begin MEASUREMENT DINH_nrActvInhReas.FId_bInh_Pdu_eCOMP_Information_47B_Rcf "" UWORD DINH_ct_Compu 1 100 -4095.000 4096.000 BIT_MASK 0x1fff FORMAT "%8.3" ECU_ADDRESS 0x600219AA /end MEASUREMENT
/begin MEASUREMENT DINH_nrActvInhReas.FId_bInh_Pdu_eCOMP_Information_48B_Frz "" UWORD DINH_ct_Compu 1 100 -4095.000 4096.000 BIT_MASK 0x1fff FORMAT "%8.3" ECU_ADDRESS 0x600219AC /end MEASUREMENT
/begin MEASUREMENT DINH_nrActvInhReas.FId_bInh_Pdu_eCOMP_Information_48B_Rcf "" UWORD DINH_ct_Compu 1 100 -4095.000 4096.000 BIT_MASK 0x1fff FORMAT "%8.3" ECU_ADDRESS 0x600219AE /end MEASUREMENT
/begin MEASUREMENT DINH_nrActvInhReas.FId_bInh_Sig205h_Com_iHvbActRx_Frz "" UWORD DINH_ct_Compu 1 100 -4095.000 4096.000 BIT_MASK 0x1fff FORMAT "%8.3" ECU_ADDRESS 0x600219B0 /end MEASUREMENT
/begin MEASUREMENT DINH_nrActvInhReas.FId_bInh_Sig205h_Com_iHvbActRx_Rcf "" UWORD DINH_ct_Compu 1 100 -4095.000 4096.000 BIT_MASK 0x1fff FORMAT "%8.3" ECU_ADDRESS 0x600219B2 /end MEASUREMENT
/begin MEASUREMENT DINH_nrActvInhReas.FId_bInh_Sig205h_Com_ratHvbSoc_Frz "" UWORD DINH_ct_Compu 1 100 -4095.000 4096.000 BIT_MASK 0x1fff FORMAT "%8.3" ECU_ADDRESS 0x600219B4 /end MEASUREMENT
/begin MEASUREMENT DINH_nrActvInhReas.FId_bInh_Sig205h_Com_ratHvbSoc_Rcf "" UWORD DINH_ct_Compu 1 100 -4095.000 4096.000 BIT_MASK 0x1fff FORMAT "%8.3" ECU_ADDRESS 0x600219B6 /end MEASUREMENT
/begin MEASUREMENT DINH_nrActvInhReas.FId_bInh_Sig205h_Com_stHvbChrgn_Frz "" UWORD DINH_ct_Compu 1 100 -4095.000 4096.000 BIT_MASK 0x1fff FORMAT "%8.3" ECU_ADDRESS 0x600219B8 /end MEASUREMENT
/begin MEASUREMENT DINH_nrActvInhReas.FId_bInh_Sig205h_Com_stHvbChrgn_Rcf "" UWORD DINH_ct_Compu 1 100 -4095.000 4096.000 BIT_MASK 0x1fff FORMAT "%8.3" ECU_ADDRESS 0x600219BA /end MEASUREMENT
/begin MEASUREMENT DINH_nrActvInhReas.FId_bInh_Sig205h_Com_uHvbAct_Frz "" UWORD DINH_ct_Compu 1 100 -4095.000 4096.000 BIT_MASK 0x1fff FORMAT "%8.3" ECU_ADDRESS 0x600219BC /end MEASUREMENT
/begin MEASUREMENT DINH_nrActvInhReas.FId_bInh_Sig205h_Com_uHvbAct_Rcf "" UWORD DINH_ct_Compu 1 100 -4095.000 4096.000 BIT_MASK 0x1fff FORMAT "%8.3" ECU_ADDRESS 0x600219BE /end MEASUREMENT
/begin MEASUREMENT DINH_nrActvInhReas.FId_bInh_Sig217h_ComEmac_nAct01_Frz "" UWORD DINH_ct_Compu 1 100 -4095.000 4096.000 BIT_MASK 0x1fff FORMAT "%8.3" ECU_ADDRESS 0x600219C0 /end MEASUREMENT
/begin MEASUREMENT DINH_nrActvInhReas.FId_bInh_Sig217h_ComEmac_nAct01_Rcf "" UWORD DINH_ct_Compu 1 100 -4095.000 4096.000 BIT_MASK 0x1fff FORMAT "%8.3" ECU_ADDRESS 0x600219C2 /end MEASUREMENT
/begin MEASUREMENT DINH_nrActvInhReas.FId_bInh_Sig217h_ComEmac_tqAckd01_Frz "" UWORD DINH_ct_Compu 1 100 -4095.000 4096.000 BIT_MASK 0x1fff FORMAT "%8.3" ECU_ADDRESS 0x600219C4 /end MEASUREMENT
/begin MEASUREMENT DINH_nrActvInhReas.FId_bInh_Sig217h_ComEmac_tqAckd01_Rcf "" UWORD DINH_ct_Compu 1 100 -4095.000 4096.000 BIT_MASK 0x1fff FORMAT "%8.3" ECU_ADDRESS 0x600219C6 /end MEASUREMENT
/begin MEASUREMENT DINH_nrActvInhReas.FId_bInh_Sig217h_ComEmac_tqAct01_Frz "" UWORD DINH_ct_Compu 1 100 -4095.000 4096.000 BIT_MASK 0x1fff FORMAT "%8.3" ECU_ADDRESS 0x600219C8 /end MEASUREMENT
/begin MEASUREMENT DINH_nrActvInhReas.FId_bInh_Sig217h_ComEmac_tqAct01_Rcf "" UWORD DINH_ct_Compu 1 100 -4095.000 4096.000 BIT_MASK 0x1fff FORMAT "%8.3" ECU_ADDRESS 0x600219CA /end MEASUREMENT
/begin MEASUREMENT DINH_nrActvInhReas.FId_bInh_Sig217h_ComEmac_uDcLnk01_Frz "" UWORD DINH_ct_Compu 1 100 -4095.000 4096.000 BIT_MASK 0x1fff FORMAT "%8.3" ECU_ADDRESS 0x600219CC /end MEASUREMENT
/begin MEASUREMENT DINH_nrActvInhReas.FId_bInh_Sig217h_ComEmac_uDcLnk01_Rcf "" UWORD DINH_ct_Compu 1 100 -4095.000 4096.000 BIT_MASK 0x1fff FORMAT "%8.3" ECU_ADDRESS 0x600219CE /end MEASUREMENT
/begin MEASUREMENT DINH_nrActvInhReas.FId_bInh_Sig227h_ComEmac_iDcLnk01_Frz "" UWORD DINH_ct_Compu 1 100 -4095.000 4096.000 BIT_MASK 0x1fff FORMAT "%8.3" ECU_ADDRESS 0x600219D0 /end MEASUREMENT
/begin MEASUREMENT DINH_nrActvInhReas.FId_bInh_Sig227h_ComEmac_iDcLnk01_Rcf "" UWORD DINH_ct_Compu 1 100 -4095.000 4096.000 BIT_MASK 0x1fff FORMAT "%8.3" ECU_ADDRESS 0x600219D2 /end MEASUREMENT
/begin MEASUREMENT DINH_nrActvInhReas.FId_bInh_Sig227h_ComEmac_pwrInstnsInpRx_Frz "" UWORD DINH_ct_Compu 1 100 -4095.000 4096.000 BIT_MASK 0x1fff FORMAT "%8.3" ECU_ADDRESS 0x600219D4 /end MEASUREMENT
/begin MEASUREMENT DINH_nrActvInhReas.FId_bInh_Sig227h_ComEmac_pwrInstnsInpRx_Rcf "" UWORD DINH_ct_Compu 1 100 -4095.000 4096.000 BIT_MASK 0x1fff FORMAT "%8.3" ECU_ADDRESS 0x600219D6 /end MEASUREMENT
/begin MEASUREMENT DINH_nrActvInhReas.FId_bInh_Sig227h_ComEmac_tqAbsltMax01_Frz "" UWORD DINH_ct_Compu 1 100 -4095.000 4096.000 BIT_MASK 0x1fff FORMAT "%8.3" ECU_ADDRESS 0x600219D8 /end MEASUREMENT
/begin MEASUREMENT DINH_nrActvInhReas.FId_bInh_Sig227h_ComEmac_tqAbsltMax01_Rcf "" UWORD DINH_ct_Compu 1 100 -4095.000 4096.000 BIT_MASK 0x1fff FORMAT "%8.3" ECU_ADDRESS 0x600219DA /end MEASUREMENT
/begin MEASUREMENT DINH_nrActvInhReas.FId_bInh_Sig227h_ComEmac_tqAbsltMaxRx01_Frz "" UWORD DINH_ct_Compu 1 100 -4095.000 4096.000 BIT_MASK 0x1fff FORMAT "%8.3" ECU_ADDRESS 0x600219DC /end MEASUREMENT
/begin MEASUREMENT DINH_nrActvInhReas.FId_bInh_Sig227h_ComEmac_tqAbsltMaxRx01_Rcf "" UWORD DINH_ct_Compu 1 100 -4095.000 4096.000 BIT_MASK 0x1fff FORMAT "%8.3" ECU_ADDRESS 0x600219DE /end MEASUREMENT
/begin MEASUREMENT DINH_nrActvInhReas.FId_bInh_Sig227h_ComEmac_tqAbsltMin01_Frz "" UWORD DINH_ct_Compu 1 100 -4095.000 4096.000 BIT_MASK 0x1fff FORMAT "%8.3" ECU_ADDRESS 0x600219E0 /end MEASUREMENT
/begin MEASUREMENT DINH_nrActvInhReas.FId_bInh_Sig227h_ComEmac_tqAbsltMin01_Rcf "" UWORD DINH_ct_Compu 1 100 -4095.000 4096.000 BIT_MASK 0x1fff FORMAT "%8.3" ECU_ADDRESS 0x600219E2 /end MEASUREMENT
/begin MEASUREMENT DINH_nrActvInhReas.FId_bInh_Sig227h_ComEmac_tqAbsltMinRx01_Frz "" UWORD DINH_ct_Compu 1 100 -4095.000 4096.000 BIT_MASK 0x1fff FORMAT "%8.3" ECU_ADDRESS 0x600219E4 /end MEASUREMENT
/begin MEASUREMENT DINH_nrActvInhReas.FId_bInh_Sig227h_ComEmac_tqAbsltMinRx01_Rcf "" UWORD DINH_ct_Compu 1 100 -4095.000 4096.000 BIT_MASK 0x1fff FORMAT "%8.3" ECU_ADDRESS 0x600219E6 /end MEASUREMENT
/begin MEASUREMENT DINH_nrActvInhReas.FId_bInh_Sig237h_ComEmac_stActvDcha_Frz "" UWORD DINH_ct_Compu 1 100 -4095.000 4096.000 BIT_MASK 0x1fff FORMAT "%8.3" ECU_ADDRESS 0x600219E8 /end MEASUREMENT
/begin MEASUREMENT DINH_nrActvInhReas.FId_bInh_Sig237h_ComEmac_stActvDcha_Rcf "" UWORD DINH_ct_Compu 1 100 -4095.000 4096.000 BIT_MASK 0x1fff FORMAT "%8.3" ECU_ADDRESS 0x600219EA /end MEASUREMENT
/begin MEASUREMENT DINH_nrActvInhReas.FId_bInh_Sig237h_ComEmac_stEVLmp_Frz "" UWORD DINH_ct_Compu 1 100 -4095.000 4096.000 BIT_MASK 0x1fff FORMAT "%8.3" ECU_ADDRESS 0x600219EC /end MEASUREMENT
/begin MEASUREMENT DINH_nrActvInhReas.FId_bInh_Sig237h_ComEmac_stEVLmp_Rcf "" UWORD DINH_ct_Compu 1 100 -4095.000 4096.000 BIT_MASK 0x1fff FORMAT "%8.3" ECU_ADDRESS 0x600219EE /end MEASUREMENT
/begin MEASUREMENT DINH_nrActvInhReas.FId_bInh_Sig237h_ComEmac_stMod01Rx_Frz "" UWORD DINH_ct_Compu 1 100 -4095.000 4096.000 BIT_MASK 0x1fff FORMAT "%8.3" ECU_ADDRESS 0x600219F0 /end MEASUREMENT
/begin MEASUREMENT DINH_nrActvInhReas.FId_bInh_Sig237h_ComEmac_stMod01Rx_Rcf "" UWORD DINH_ct_Compu 1 100 -4095.000 4096.000 BIT_MASK 0x1fff FORMAT "%8.3" ECU_ADDRESS 0x600219F2 /end MEASUREMENT
/begin MEASUREMENT DINH_nrActvInhReas.FId_bInh_Sig237h_ComEmac_stMstWrnLmp_Frz "" UWORD DINH_ct_Compu 1 100 -4095.000 4096.000 BIT_MASK 0x1fff FORMAT "%8.3" ECU_ADDRESS 0x600219F4 /end MEASUREMENT
/begin MEASUREMENT DINH_nrActvInhReas.FId_bInh_Sig237h_ComEmac_stMstWrnLmp_Rcf "" UWORD DINH_ct_Compu 1 100 -4095.000 4096.000 BIT_MASK 0x1fff FORMAT "%8.3" ECU_ADDRESS 0x600219F6 /end MEASUREMENT
/begin MEASUREMENT DINH_nrActvInhReas.FId_bInh_Sig237h_ComEmac_stSVSLmp_Frz "" UWORD DINH_ct_Compu 1 100 -4095.000 4096.000 BIT_MASK 0x1fff FORMAT "%8.3" ECU_ADDRESS 0x600219F8 /end MEASUREMENT
/begin MEASUREMENT DINH_nrActvInhReas.FId_bInh_Sig237h_ComEmac_stSVSLmp_Rcf "" UWORD DINH_ct_Compu 1 100 -4095.000 4096.000 BIT_MASK 0x1fff FORMAT "%8.3" ECU_ADDRESS 0x600219FA /end MEASUREMENT
/begin MEASUREMENT DINH_nrActvInhReas.FId_bInh_Sig237h_ComEmac_tqStabnMin_Frz "" UWORD DINH_ct_Compu 1 100 -4095.000 4096.000 BIT_MASK 0x1fff FORMAT "%8.3" ECU_ADDRESS 0x600219FC /end MEASUREMENT
/begin MEASUREMENT DINH_nrActvInhReas.FId_bInh_Sig237h_ComEmac_tqStabnMin_Rcf "" UWORD DINH_ct_Compu 1 100 -4095.000 4096.000 BIT_MASK 0x1fff FORMAT "%8.3" ECU_ADDRESS 0x600219FE /end MEASUREMENT
/begin MEASUREMENT DINH_nrActvInhReas.FId_bInh_Sig237h_Com_stIIvtrFltLvl01_Frz "" UWORD DINH_ct_Compu 1 100 -4095.000 4096.000 BIT_MASK 0x1fff FORMAT "%8.3" ECU_ADDRESS 0x60021A00 /end MEASUREMENT
/begin MEASUREMENT DINH_nrActvInhReas.FId_bInh_Sig237h_Com_stIIvtrFltLvl01_Rcf "" UWORD DINH_ct_Compu 1 100 -4095.000 4096.000 BIT_MASK 0x1fff FORMAT "%8.3" ECU_ADDRESS 0x60021A02 /end MEASUREMENT
/begin MEASUREMENT DINH_nrActvInhReas.FId_bInh_Sig259h_Com_flgEcoNormReqRx_Frz "" UWORD DINH_ct_Compu 1 100 -4095.000 4096.000 BIT_MASK 0x1fff FORMAT "%8.3" ECU_ADDRESS 0x60021A06 /end MEASUREMENT
/begin MEASUREMENT DINH_nrActvInhReas.FId_bInh_Sig259h_Com_flgEcoNormReqRx_Rcf "" UWORD DINH_ct_Compu 1 100 -4095.000 4096.000 BIT_MASK 0x1fff FORMAT "%8.3" ECU_ADDRESS 0x60021A08 /end MEASUREMENT
/begin MEASUREMENT DINH_nrActvInhReas.FId_bInh_Sig259h_Com_stGearLvrPos_Frz "" UWORD DINH_ct_Compu 1 100 -4095.000 4096.000 BIT_MASK 0x1fff FORMAT "%8.3" ECU_ADDRESS 0x60021A0A /end MEASUREMENT
/begin MEASUREMENT DINH_nrActvInhReas.FId_bInh_Sig259h_Com_stGearLvrPos_Rcf "" UWORD DINH_ct_Compu 1 100 -4095.000 4096.000 BIT_MASK 0x1fff FORMAT "%8.3" ECU_ADDRESS 0x60021A0C /end MEASUREMENT
/begin MEASUREMENT DINH_nrActvInhReas.FId_bInh_Sig259h_Com_steTogFailrLvl_Frz "" UWORD DINH_ct_Compu 1 100 -4095.000 4096.000 BIT_MASK 0x1fff FORMAT "%8.3" ECU_ADDRESS 0x60021A0E /end MEASUREMENT
/begin MEASUREMENT DINH_nrActvInhReas.FId_bInh_Sig259h_Com_steTogFailrLvl_Rcf "" UWORD DINH_ct_Compu 1 100 -4095.000 4096.000 BIT_MASK 0x1fff FORMAT "%8.3" ECU_ADDRESS 0x60021A10 /end MEASUREMENT
/begin MEASUREMENT DINH_nrActvInhReas.FId_bInh_Sig26h_Com_stAC_Frz "" UWORD DINH_ct_Compu 1 100 -4095.000 4096.000 BIT_MASK 0x1fff FORMAT "%8.3" ECU_ADDRESS 0x60021A12 /end MEASUREMENT
/begin MEASUREMENT DINH_nrActvInhReas.FId_bInh_Sig26h_Com_stAC_Rcf "" UWORD DINH_ct_Compu 1 100 -4095.000 4096.000 BIT_MASK 0x1fff FORMAT "%8.3" ECU_ADDRESS 0x60021A14 /end MEASUREMENT
/begin MEASUREMENT DINH_nrActvInhReas.FId_bInh_Sig26h_Com_stEvapTFlt_Frz "" UWORD DINH_ct_Compu 1 100 -4095.000 4096.000 BIT_MASK 0x1fff FORMAT "%8.3" ECU_ADDRESS 0x60021A16 /end MEASUREMENT
/begin MEASUREMENT DINH_nrActvInhReas.FId_bInh_Sig26h_Com_stEvapTFlt_Rcf "" UWORD DINH_ct_Compu 1 100 -4095.000 4096.000 BIT_MASK 0x1fff FORMAT "%8.3" ECU_ADDRESS 0x60021A18 /end MEASUREMENT
/begin MEASUREMENT DINH_nrActvInhReas.FId_bInh_Sig26h_Com_stHvacBlwrFront_Frz "" UWORD DINH_ct_Compu 1 100 -4095.000 4096.000 BIT_MASK 0x1fff FORMAT "%8.3" ECU_ADDRESS 0x60021A1A /end MEASUREMENT
/begin MEASUREMENT DINH_nrActvInhReas.FId_bInh_Sig26h_Com_stHvacBlwrFront_Rcf "" UWORD DINH_ct_Compu 1 100 -4095.000 4096.000 BIT_MASK 0x1fff FORMAT "%8.3" ECU_ADDRESS 0x60021A1C /end MEASUREMENT
/begin MEASUREMENT DINH_nrActvInhReas.FId_bInh_Sig26h_Com_stHvacKnobPosn_Frz "" UWORD DINH_ct_Compu 1 100 -4095.000 4096.000 BIT_MASK 0x1fff FORMAT "%8.3" ECU_ADDRESS 0x60021A1E /end MEASUREMENT
/begin MEASUREMENT DINH_nrActvInhReas.FId_bInh_Sig26h_Com_stHvacKnobPosn_Rcf "" UWORD DINH_ct_Compu 1 100 -4095.000 4096.000 BIT_MASK 0x1fff FORMAT "%8.3" ECU_ADDRESS 0x60021A20 /end MEASUREMENT
/begin MEASUREMENT DINH_nrActvInhReas.FId_bInh_Sig26h_Com_stHvacPanPotiFlt_Frz "" UWORD DINH_ct_Compu 1 100 -4095.000 4096.000 BIT_MASK 0x1fff FORMAT "%8.3" ECU_ADDRESS 0x60021A22 /end MEASUREMENT
/begin MEASUREMENT DINH_nrActvInhReas.FId_bInh_Sig26h_Com_stHvacPanPotiFlt_Rcf "" UWORD DINH_ct_Compu 1 100 -4095.000 4096.000 BIT_MASK 0x1fff FORMAT "%8.3" ECU_ADDRESS 0x60021A24 /end MEASUREMENT
/begin MEASUREMENT DINH_nrActvInhReas.FId_bInh_Sig26h_Com_stReFogReq_Frz "" UWORD DINH_ct_Compu 1 100 -4095.000 4096.000 BIT_MASK 0x1fff FORMAT "%8.3" ECU_ADDRESS 0x60021A26 /end MEASUREMENT
/begin MEASUREMENT DINH_nrActvInhReas.FId_bInh_Sig26h_Com_stReFogReq_Rcf "" UWORD DINH_ct_Compu 1 100 -4095.000 4096.000 BIT_MASK 0x1fff FORMAT "%8.3" ECU_ADDRESS 0x60021A28 /end MEASUREMENT
/begin MEASUREMENT DINH_nrActvInhReas.FId_bInh_Sig26h_Com_tEvapT_Frz "" UWORD DINH_ct_Compu 1 100 -4095.000 4096.000 BIT_MASK 0x1fff FORMAT "%8.3" ECU_ADDRESS 0x60021A2A /end MEASUREMENT
/begin MEASUREMENT DINH_nrActvInhReas.FId_bInh_Sig26h_Com_tEvapT_Rcf "" UWORD DINH_ct_Compu 1 100 -4095.000 4096.000 BIT_MASK 0x1fff FORMAT "%8.3" ECU_ADDRESS 0x60021A2C /end MEASUREMENT
/begin MEASUREMENT DINH_nrActvInhReas.FId_bInh_Sig273h_ComChrgr_flgChrgrErrLvl_Frz "" UWORD DINH_ct_Compu 1 100 -4095.000 4096.000 BIT_MASK 0x1fff FORMAT "%8.3" ECU_ADDRESS 0x60021A2E /end MEASUREMENT
/begin MEASUREMENT DINH_nrActvInhReas.FId_bInh_Sig273h_ComChrgr_flgChrgrErrLvl_Rcf "" UWORD DINH_ct_Compu 1 100 -4095.000 4096.000 BIT_MASK 0x1fff FORMAT "%8.3" ECU_ADDRESS 0x60021A30 /end MEASUREMENT
/begin MEASUREMENT DINH_nrActvInhReas.FId_bInh_Sig273h_ComChrgr_pwrOutpCpby_Frz "" UWORD DINH_ct_Compu 1 100 -4095.000 4096.000 BIT_MASK 0x1fff FORMAT "%8.3" ECU_ADDRESS 0x60021A32 /end MEASUREMENT
/begin MEASUREMENT DINH_nrActvInhReas.FId_bInh_Sig273h_ComChrgr_pwrOutpCpby_Rcf "" UWORD DINH_ct_Compu 1 100 -4095.000 4096.000 BIT_MASK 0x1fff FORMAT "%8.3" ECU_ADDRESS 0x60021A34 /end MEASUREMENT
/begin MEASUREMENT DINH_nrActvInhReas.FId_bInh_Sig275h_Com_iHvbDchaMaxSho_Frz "" UWORD DINH_ct_Compu 1 100 -4095.000 4096.000 BIT_MASK 0x1fff FORMAT "%8.3" ECU_ADDRESS 0x60021A36 /end MEASUREMENT
/begin MEASUREMENT DINH_nrActvInhReas.FId_bInh_Sig275h_Com_iHvbDchaMaxSho_Rcf "" UWORD DINH_ct_Compu 1 100 -4095.000 4096.000 BIT_MASK 0x1fff FORMAT "%8.3" ECU_ADDRESS 0x60021A38 /end MEASUREMENT
/begin MEASUREMENT DINH_nrActvInhReas.FId_bInh_Sig275h_Com_pwrMaxDchaSho_Frz "" UWORD DINH_ct_Compu 1 100 -4095.000 4096.000 BIT_MASK 0x1fff FORMAT "%8.3" ECU_ADDRESS 0x60021A3A /end MEASUREMENT
/begin MEASUREMENT DINH_nrActvInhReas.FId_bInh_Sig275h_Com_pwrMaxDchaSho_Rcf "" UWORD DINH_ct_Compu 1 100 -4095.000 4096.000 BIT_MASK 0x1fff FORMAT "%8.3" ECU_ADDRESS 0x60021A3C /end MEASUREMENT
/begin MEASUREMENT DINH_nrActvInhReas.FId_bInh_Sig283h_Com_iDcdcHvActRvsn1_Frz "" UWORD DINH_ct_Compu 1 100 -4095.000 4096.000 BIT_MASK 0x1fff FORMAT "%8.3" ECU_ADDRESS 0x60021A3E /end MEASUREMENT
/begin MEASUREMENT DINH_nrActvInhReas.FId_bInh_Sig283h_Com_iDcdcHvActRvsn1_Rcf "" UWORD DINH_ct_Compu 1 100 -4095.000 4096.000 BIT_MASK 0x1fff FORMAT "%8.3" ECU_ADDRESS 0x60021A40 /end MEASUREMENT
/begin MEASUREMENT DINH_nrActvInhReas.FId_bInh_Sig283h_Com_iDcdcLvActRvsn1_Frz "" UWORD DINH_ct_Compu 1 100 -4095.000 4096.000 BIT_MASK 0x1fff FORMAT "%8.3" ECU_ADDRESS 0x60021A42 /end MEASUREMENT
/begin MEASUREMENT DINH_nrActvInhReas.FId_bInh_Sig283h_Com_iDcdcLvActRvsn1_Rcf "" UWORD DINH_ct_Compu 1 100 -4095.000 4096.000 BIT_MASK 0x1fff FORMAT "%8.3" ECU_ADDRESS 0x60021A44 /end MEASUREMENT
/begin MEASUREMENT DINH_nrActvInhReas.FId_bInh_Sig283h_Com_uDcdcHvAct_Frz "" UWORD DINH_ct_Compu 1 100 -4095.000 4096.000 BIT_MASK 0x1fff FORMAT "%8.3" ECU_ADDRESS 0x60021A46 /end MEASUREMENT
/begin MEASUREMENT DINH_nrActvInhReas.FId_bInh_Sig283h_Com_uDcdcHvAct_Rcf "" UWORD DINH_ct_Compu 1 100 -4095.000 4096.000 BIT_MASK 0x1fff FORMAT "%8.3" ECU_ADDRESS 0x60021A48 /end MEASUREMENT
/begin MEASUREMENT DINH_nrActvInhReas.FId_bInh_Sig283h_Com_uDcdcLvAct_Frz "" UWORD DINH_ct_Compu 1 100 -4095.000 4096.000 BIT_MASK 0x1fff FORMAT "%8.3" ECU_ADDRESS 0x60021A4A /end MEASUREMENT
/begin MEASUREMENT DINH_nrActvInhReas.FId_bInh_Sig283h_Com_uDcdcLvAct_Rcf "" UWORD DINH_ct_Compu 1 100 -4095.000 4096.000 BIT_MASK 0x1fff FORMAT "%8.3" ECU_ADDRESS 0x60021A4C /end MEASUREMENT
/begin MEASUREMENT DINH_nrActvInhReas.FId_bInh_Sig285h_Com_iHvbChrgMaxSho_Frz "" UWORD DINH_ct_Compu 1 100 -4095.000 4096.000 BIT_MASK 0x1fff FORMAT "%8.3" ECU_ADDRESS 0x60021A4E /end MEASUREMENT
/begin MEASUREMENT DINH_nrActvInhReas.FId_bInh_Sig285h_Com_iHvbChrgMaxSho_Rcf "" UWORD DINH_ct_Compu 1 100 -4095.000 4096.000 BIT_MASK 0x1fff FORMAT "%8.3" ECU_ADDRESS 0x60021A50 /end MEASUREMENT
/begin MEASUREMENT DINH_nrActvInhReas.FId_bInh_Sig285h_Com_pwrMaxChrgSho_Frz "" UWORD DINH_ct_Compu 1 100 -4095.000 4096.000 BIT_MASK 0x1fff FORMAT "%8.3" ECU_ADDRESS 0x60021A52 /end MEASUREMENT
/begin MEASUREMENT DINH_nrActvInhReas.FId_bInh_Sig285h_Com_pwrMaxChrgSho_Rcf "" UWORD DINH_ct_Compu 1 100 -4095.000 4096.000 BIT_MASK 0x1fff FORMAT "%8.3" ECU_ADDRESS 0x60021A54 /end MEASUREMENT
/begin MEASUREMENT DINH_nrActvInhReas.FId_bInh_Sig293h_Com_pwrDcdcOutpCpby_Frz "" UWORD DINH_ct_Compu 1 100 -4095.000 4096.000 BIT_MASK 0x1fff FORMAT "%8.3" ECU_ADDRESS 0x60021A56 /end MEASUREMENT
/begin MEASUREMENT DINH_nrActvInhReas.FId_bInh_Sig293h_Com_pwrDcdcOutpCpby_Rcf "" UWORD DINH_ct_Compu 1 100 -4095.000 4096.000 BIT_MASK 0x1fff FORMAT "%8.3" ECU_ADDRESS 0x60021A58 /end MEASUREMENT
/begin MEASUREMENT DINH_nrActvInhReas.FId_bInh_Sig293h_Com_stDcdcFltLvl_Frz "" UWORD DINH_ct_Compu 1 100 -4095.000 4096.000 BIT_MASK 0x1fff FORMAT "%8.3" ECU_ADDRESS 0x60021A5A /end MEASUREMENT
/begin MEASUREMENT DINH_nrActvInhReas.FId_bInh_Sig293h_Com_stDcdcFltLvl_Rcf "" UWORD DINH_ct_Compu 1 100 -4095.000 4096.000 BIT_MASK 0x1fff FORMAT "%8.3" ECU_ADDRESS 0x60021A5C /end MEASUREMENT
/begin MEASUREMENT DINH_nrActvInhReas.FId_bInh_Sig325h_Com_rHvbIsoMeasmt_Frz "" UWORD DINH_ct_Compu 1 100 -4095.000 4096.000 BIT_MASK 0x1fff FORMAT "%8.3" ECU_ADDRESS 0x60021A5E /end MEASUREMENT
/begin MEASUREMENT DINH_nrActvInhReas.FId_bInh_Sig325h_Com_rHvbIsoMeasmt_Rcf "" UWORD DINH_ct_Compu 1 100 -4095.000 4096.000 BIT_MASK 0x1fff FORMAT "%8.3" ECU_ADDRESS 0x60021A60 /end MEASUREMENT
/begin MEASUREMENT DINH_nrActvInhReas.FId_bInh_Sig325h_Com_stHvbIntlckRx_Frz "" UWORD DINH_ct_Compu 1 100 -4095.000 4096.000 BIT_MASK 0x1fff FORMAT "%8.3" ECU_ADDRESS 0x60021A62 /end MEASUREMENT
/begin MEASUREMENT DINH_nrActvInhReas.FId_bInh_Sig325h_Com_stHvbIntlckRx_Rcf "" UWORD DINH_ct_Compu 1 100 -4095.000 4096.000 BIT_MASK 0x1fff FORMAT "%8.3" ECU_ADDRESS 0x60021A64 /end MEASUREMENT
/begin MEASUREMENT DINH_nrActvInhReas.FId_bInh_Sig325h_Com_stHvbIsoFltRx_Frz "" UWORD DINH_ct_Compu 1 100 -4095.000 4096.000 BIT_MASK 0x1fff FORMAT "%8.3" ECU_ADDRESS 0x60021A66 /end MEASUREMENT
/begin MEASUREMENT DINH_nrActvInhReas.FId_bInh_Sig325h_Com_stHvbIsoFltRx_Rcf "" UWORD DINH_ct_Compu 1 100 -4095.000 4096.000 BIT_MASK 0x1fff FORMAT "%8.3" ECU_ADDRESS 0x60021A68 /end MEASUREMENT
/begin MEASUREMENT DINH_nrActvInhReas.FId_bInh_Sig325h_Com_stHvbSrvPlgRx_Frz "" UWORD DINH_ct_Compu 1 100 -4095.000 4096.000 BIT_MASK 0x1fff FORMAT "%8.3" ECU_ADDRESS 0x60021A6A /end MEASUREMENT
/begin MEASUREMENT DINH_nrActvInhReas.FId_bInh_Sig325h_Com_stHvbSrvPlgRx_Rcf "" UWORD DINH_ct_Compu 1 100 -4095.000 4096.000 BIT_MASK 0x1fff FORMAT "%8.3" ECU_ADDRESS 0x60021A6C /end MEASUREMENT
/begin MEASUREMENT DINH_nrActvInhReas.FId_bInh_Sig325h_Com_tHvbMax_Frz "" UWORD DINH_ct_Compu 1 100 -4095.000 4096.000 BIT_MASK 0x1fff FORMAT "%8.3" ECU_ADDRESS 0x60021A6E /end MEASUREMENT
/begin MEASUREMENT DINH_nrActvInhReas.FId_bInh_Sig325h_Com_tHvbMax_Rcf "" UWORD DINH_ct_Compu 1 100 -4095.000 4096.000 BIT_MASK 0x1fff FORMAT "%8.3" ECU_ADDRESS 0x60021A70 /end MEASUREMENT
/begin MEASUREMENT DINH_nrActvInhReas.FId_bInh_Sig335h_Com_iHvbDes_Frz "" UWORD DINH_ct_Compu 1 100 -4095.000 4096.000 BIT_MASK 0x1fff FORMAT "%8.3" ECU_ADDRESS 0x60021A72 /end MEASUREMENT
/begin MEASUREMENT DINH_nrActvInhReas.FId_bInh_Sig335h_Com_iHvbDes_Rcf "" UWORD DINH_ct_Compu 1 100 -4095.000 4096.000 BIT_MASK 0x1fff FORMAT "%8.3" ECU_ADDRESS 0x60021A74 /end MEASUREMENT
/begin MEASUREMENT DINH_nrActvInhReas.FId_bInh_Sig335h_Com_iHvbNomChrgn_Frz "" UWORD DINH_ct_Compu 1 100 -4095.000 4096.000 BIT_MASK 0x1fff FORMAT "%8.3" ECU_ADDRESS 0x60021A76 /end MEASUREMENT
/begin MEASUREMENT DINH_nrActvInhReas.FId_bInh_Sig335h_Com_iHvbNomChrgn_Rcf "" UWORD DINH_ct_Compu 1 100 -4095.000 4096.000 BIT_MASK 0x1fff FORMAT "%8.3" ECU_ADDRESS 0x60021A78 /end MEASUREMENT
/begin MEASUREMENT DINH_nrActvInhReas.FId_bInh_Sig335h_Com_uHvbDcBus_Frz "" UWORD DINH_ct_Compu 1 100 -4095.000 4096.000 BIT_MASK 0x1fff FORMAT "%8.3" ECU_ADDRESS 0x60021A7A /end MEASUREMENT
/begin MEASUREMENT DINH_nrActvInhReas.FId_bInh_Sig335h_Com_uHvbDcBus_Rcf "" UWORD DINH_ct_Compu 1 100 -4095.000 4096.000 BIT_MASK 0x1fff FORMAT "%8.3" ECU_ADDRESS 0x60021A7C /end MEASUREMENT
/begin MEASUREMENT DINH_nrActvInhReas.FId_bInh_Sig335h_Com_uHvbLimHi_Frz "" UWORD DINH_ct_Compu 1 100 -4095.000 4096.000 BIT_MASK 0x1fff FORMAT "%8.3" ECU_ADDRESS 0x60021A7E /end MEASUREMENT
/begin MEASUREMENT DINH_nrActvInhReas.FId_bInh_Sig335h_Com_uHvbLimHi_Rcf "" UWORD DINH_ct_Compu 1 100 -4095.000 4096.000 BIT_MASK 0x1fff FORMAT "%8.3" ECU_ADDRESS 0x60021A80 /end MEASUREMENT
/begin MEASUREMENT DINH_nrActvInhReas.FId_bInh_Sig38Dh_Com_flgVehSpdAvl_Frz "" UWORD DINH_ct_Compu 1 100 -4095.000 4096.000 BIT_MASK 0x1fff FORMAT "%8.3" ECU_ADDRESS 0x60021A82 /end MEASUREMENT
/begin MEASUREMENT DINH_nrActvInhReas.FId_bInh_Sig38Dh_Com_flgVehSpdAvl_Rcf "" UWORD DINH_ct_Compu 1 100 -4095.000 4096.000 BIT_MASK 0x1fff FORMAT "%8.3" ECU_ADDRESS 0x60021A84 /end MEASUREMENT
/begin MEASUREMENT DINH_nrActvInhReas.FId_bInh_Sig38Dh_Com_vVeh_Frz "" UWORD DINH_ct_Compu 1 100 -4095.000 4096.000 BIT_MASK 0x1fff FORMAT "%8.3" ECU_ADDRESS 0x60021A86 /end MEASUREMENT
/begin MEASUREMENT DINH_nrActvInhReas.FId_bInh_Sig38Dh_Com_vVeh_Rcf "" UWORD DINH_ct_Compu 1 100 -4095.000 4096.000 BIT_MASK 0x1fff FORMAT "%8.3" ECU_ADDRESS 0x60021A88 /end MEASUREMENT
/begin MEASUREMENT DINH_nrActvInhReas.FId_bInh_Sig427h_ComEmac_stIvtrOpMod01_Frz "" UWORD DINH_ct_Compu 1 100 -4095.000 4096.000 BIT_MASK 0x1fff FORMAT "%8.3" ECU_ADDRESS 0x60021A8A /end MEASUREMENT
/begin MEASUREMENT DINH_nrActvInhReas.FId_bInh_Sig427h_ComEmac_stIvtrOpMod01_Rcf "" UWORD DINH_ct_Compu 1 100 -4095.000 4096.000 BIT_MASK 0x1fff FORMAT "%8.3" ECU_ADDRESS 0x60021A8C /end MEASUREMENT
/begin MEASUREMENT DINH_nrActvInhReas.FId_bInh_Sig427h_ComEmac_tInvr01_Frz "" UWORD DINH_ct_Compu 1 100 -4095.000 4096.000 BIT_MASK 0x1fff FORMAT "%8.3" ECU_ADDRESS 0x60021A8E /end MEASUREMENT
/begin MEASUREMENT DINH_nrActvInhReas.FId_bInh_Sig427h_ComEmac_tInvr01_Rcf "" UWORD DINH_ct_Compu 1 100 -4095.000 4096.000 BIT_MASK 0x1fff FORMAT "%8.3" ECU_ADDRESS 0x60021A90 /end MEASUREMENT
/begin MEASUREMENT DINH_nrActvInhReas.FId_bInh_Sig427h_ComEmac_tIvtrCooltIn01_Frz "" UWORD DINH_ct_Compu 1 100 -4095.000 4096.000 BIT_MASK 0x1fff FORMAT "%8.3" ECU_ADDRESS 0x60021A92 /end MEASUREMENT
/begin MEASUREMENT DINH_nrActvInhReas.FId_bInh_Sig427h_ComEmac_tIvtrCooltIn01_Rcf "" UWORD DINH_ct_Compu 1 100 -4095.000 4096.000 BIT_MASK 0x1fff FORMAT "%8.3" ECU_ADDRESS 0x60021A94 /end MEASUREMENT
/begin MEASUREMENT DINH_nrActvInhReas.FId_bInh_Sig427h_ComEmac_tMac01_Frz "" UWORD DINH_ct_Compu 1 100 -4095.000 4096.000 BIT_MASK 0x1fff FORMAT "%8.3" ECU_ADDRESS 0x60021A96 /end MEASUREMENT
/begin MEASUREMENT DINH_nrActvInhReas.FId_bInh_Sig427h_ComEmac_tMac01_Rcf "" UWORD DINH_ct_Compu 1 100 -4095.000 4096.000 BIT_MASK 0x1fff FORMAT "%8.3" ECU_ADDRESS 0x60021A98 /end MEASUREMENT
/begin MEASUREMENT DINH_nrActvInhReas.FId_bInh_Sig427h_ComEmac_tqPtd01_Frz "" UWORD DINH_ct_Compu 1 100 -4095.000 4096.000 BIT_MASK 0x1fff FORMAT "%8.3" ECU_ADDRESS 0x60021A9A /end MEASUREMENT
/begin MEASUREMENT DINH_nrActvInhReas.FId_bInh_Sig427h_ComEmac_tqPtd01_Rcf "" UWORD DINH_ct_Compu 1 100 -4095.000 4096.000 BIT_MASK 0x1fff FORMAT "%8.3" ECU_ADDRESS 0x60021A9C /end MEASUREMENT
/begin MEASUREMENT DINH_nrActvInhReas.FId_bInh_Sig432h_Com_stMainWkuReq_Frz "" UWORD DINH_ct_Compu 1 100 -4095.000 4096.000 BIT_MASK 0x1fff FORMAT "%8.3" ECU_ADDRESS 0x60021A9E /end MEASUREMENT
/begin MEASUREMENT DINH_nrActvInhReas.FId_bInh_Sig432h_Com_stMainWkuReq_Rcf "" UWORD DINH_ct_Compu 1 100 -4095.000 4096.000 BIT_MASK 0x1fff FORMAT "%8.3" ECU_ADDRESS 0x60021AA0 /end MEASUREMENT
/begin MEASUREMENT DINH_nrActvInhReas.FId_bInh_Sig435h_Com_HvbMaxSnsrTempRx_Frz "" UWORD DINH_ct_Compu 1 100 -4095.000 4096.000 BIT_MASK 0x1fff FORMAT "%8.3" ECU_ADDRESS 0x60021AA2 /end MEASUREMENT
/begin MEASUREMENT DINH_nrActvInhReas.FId_bInh_Sig435h_Com_HvbMaxSnsrTempRx_Rcf "" UWORD DINH_ct_Compu 1 100 -4095.000 4096.000 BIT_MASK 0x1fff FORMAT "%8.3" ECU_ADDRESS 0x60021AA4 /end MEASUREMENT
/begin MEASUREMENT DINH_nrActvInhReas.FId_bInh_Sig435h_Com_nrSerMaxCell_Frz "" UWORD DINH_ct_Compu 1 100 -4095.000 4096.000 BIT_MASK 0x1fff FORMAT "%8.3" ECU_ADDRESS 0x60021AA6 /end MEASUREMENT
/begin MEASUREMENT DINH_nrActvInhReas.FId_bInh_Sig435h_Com_nrSerMaxCell_Rcf "" UWORD DINH_ct_Compu 1 100 -4095.000 4096.000 BIT_MASK 0x1fff FORMAT "%8.3" ECU_ADDRESS 0x60021AA8 /end MEASUREMENT
/begin MEASUREMENT DINH_nrActvInhReas.FId_bInh_Sig435h_Com_nrSerMinCell_Frz "" UWORD DINH_ct_Compu 1 100 -4095.000 4096.000 BIT_MASK 0x1fff FORMAT "%8.3" ECU_ADDRESS 0x60021AAA /end MEASUREMENT
/begin MEASUREMENT DINH_nrActvInhReas.FId_bInh_Sig435h_Com_nrSerMinCell_Rcf "" UWORD DINH_ct_Compu 1 100 -4095.000 4096.000 BIT_MASK 0x1fff FORMAT "%8.3" ECU_ADDRESS 0x60021AAC /end MEASUREMENT
/begin MEASUREMENT DINH_nrActvInhReas.FId_bInh_Sig435h_Com_uHvbMaxCell_Frz "" UWORD DINH_ct_Compu 1 100 -4095.000 4096.000 BIT_MASK 0x1fff FORMAT "%8.3" ECU_ADDRESS 0x60021AAE /end MEASUREMENT
/begin MEASUREMENT DINH_nrActvInhReas.FId_bInh_Sig435h_Com_uHvbMaxCell_Rcf "" UWORD DINH_ct_Compu 1 100 -4095.000 4096.000 BIT_MASK 0x1fff FORMAT "%8.3" ECU_ADDRESS 0x60021AB0 /end MEASUREMENT
/begin MEASUREMENT DINH_nrActvInhReas.FId_bInh_Sig435h_Com_uHvbMinCell_Frz "" UWORD DINH_ct_Compu 1 100 -4095.000 4096.000 BIT_MASK 0x1fff FORMAT "%8.3" ECU_ADDRESS 0x60021AB2 /end MEASUREMENT
/begin MEASUREMENT DINH_nrActvInhReas.FId_bInh_Sig435h_Com_uHvbMinCell_Rcf "" UWORD DINH_ct_Compu 1 100 -4095.000 4096.000 BIT_MASK 0x1fff FORMAT "%8.3" ECU_ADDRESS 0x60021AB4 /end MEASUREMENT
/begin MEASUREMENT DINH_nrActvInhReas.FId_bInh_Sig442h_Com_stBlowrRly_Frz "" UWORD DINH_ct_Compu 1 100 -4095.000 4096.000 BIT_MASK 0x1fff FORMAT "%8.3" ECU_ADDRESS 0x60021AB6 /end MEASUREMENT
/begin MEASUREMENT DINH_nrActvInhReas.FId_bInh_Sig442h_Com_stBlowrRly_Rcf "" UWORD DINH_ct_Compu 1 100 -4095.000 4096.000 BIT_MASK 0x1fff FORMAT "%8.3" ECU_ADDRESS 0x60021AB8 /end MEASUREMENT
/begin MEASUREMENT DINH_nrActvInhReas.FId_bInh_Sig453h_ComChrgr_iAcMax_Frz "" UWORD DINH_ct_Compu 1 100 -4095.000 4096.000 BIT_MASK 0x1fff FORMAT "%8.3" ECU_ADDRESS 0x60021ABA /end MEASUREMENT
/begin MEASUREMENT DINH_nrActvInhReas.FId_bInh_Sig453h_ComChrgr_iAcMax_Rcf "" UWORD DINH_ct_Compu 1 100 -4095.000 4096.000 BIT_MASK 0x1fff FORMAT "%8.3" ECU_ADDRESS 0x60021ABC /end MEASUREMENT
/begin MEASUREMENT DINH_nrActvInhReas.FId_bInh_Sig453h_ComChrgr_pwrInAct_Frz "" UWORD DINH_ct_Compu 1 100 -4095.000 4096.000 BIT_MASK 0x1fff FORMAT "%8.3" ECU_ADDRESS 0x60021ABE /end MEASUREMENT
/begin MEASUREMENT DINH_nrActvInhReas.FId_bInh_Sig453h_ComChrgr_pwrInAct_Rcf "" UWORD DINH_ct_Compu 1 100 -4095.000 4096.000 BIT_MASK 0x1fff FORMAT "%8.3" ECU_ADDRESS 0x60021AC0 /end MEASUREMENT
/begin MEASUREMENT DINH_nrActvInhReas.FId_bInh_Sig453h_ComChrgr_uAcActL1_Frz "" UWORD DINH_ct_Compu 1 100 -4095.000 4096.000 BIT_MASK 0x1fff FORMAT "%8.3" ECU_ADDRESS 0x60021AC2 /end MEASUREMENT
/begin MEASUREMENT DINH_nrActvInhReas.FId_bInh_Sig453h_ComChrgr_uAcActL1_Rcf "" UWORD DINH_ct_Compu 1 100 -4095.000 4096.000 BIT_MASK 0x1fff FORMAT "%8.3" ECU_ADDRESS 0x60021AC4 /end MEASUREMENT
/begin MEASUREMENT DINH_nrActvInhReas.FId_bInh_Sig455h_Com_uHvbNomChrgn_Frz "" UWORD DINH_ct_Compu 1 100 -4095.000 4096.000 BIT_MASK 0x1fff FORMAT "%8.3" ECU_ADDRESS 0x60021AC6 /end MEASUREMENT
/begin MEASUREMENT DINH_nrActvInhReas.FId_bInh_Sig455h_Com_uHvbNomChrgn_Rcf "" UWORD DINH_ct_Compu 1 100 -4095.000 4096.000 BIT_MASK 0x1fff FORMAT "%8.3" ECU_ADDRESS 0x60021AC8 /end MEASUREMENT
/begin MEASUREMENT DINH_nrActvInhReas.FId_bInh_Sig463h_ComChrgr_iDcHvAct_Frz "" UWORD DINH_ct_Compu 1 100 -4095.000 4096.000 BIT_MASK 0x1fff FORMAT "%8.3" ECU_ADDRESS 0x60021ACA /end MEASUREMENT
/begin MEASUREMENT DINH_nrActvInhReas.FId_bInh_Sig463h_ComChrgr_iDcHvAct_Rcf "" UWORD DINH_ct_Compu 1 100 -4095.000 4096.000 BIT_MASK 0x1fff FORMAT "%8.3" ECU_ADDRESS 0x60021ACC /end MEASUREMENT
/begin MEASUREMENT DINH_nrActvInhReas.FId_bInh_Sig463h_ComChrgr_tChrgrMaxAct_Frz "" UWORD DINH_ct_Compu 1 100 -4095.000 4096.000 BIT_MASK 0x1fff FORMAT "%8.3" ECU_ADDRESS 0x60021ACE /end MEASUREMENT
/begin MEASUREMENT DINH_nrActvInhReas.FId_bInh_Sig463h_ComChrgr_tChrgrMaxAct_Rcf "" UWORD DINH_ct_Compu 1 100 -4095.000 4096.000 BIT_MASK 0x1fff FORMAT "%8.3" ECU_ADDRESS 0x60021AD0 /end MEASUREMENT
/begin MEASUREMENT DINH_nrActvInhReas.FId_bInh_Sig463h_ComChrgr_uDcHvAct_Frz "" UWORD DINH_ct_Compu 1 100 -4095.000 4096.000 BIT_MASK 0x1fff FORMAT "%8.3" ECU_ADDRESS 0x60021AD2 /end MEASUREMENT
/begin MEASUREMENT DINH_nrActvInhReas.FId_bInh_Sig463h_ComChrgr_uDcHvAct_Rcf "" UWORD DINH_ct_Compu 1 100 -4095.000 4096.000 BIT_MASK 0x1fff FORMAT "%8.3" ECU_ADDRESS 0x60021AD4 /end MEASUREMENT
/begin MEASUREMENT DINH_nrActvInhReas.FId_bInh_Sig473h_Com_tDcdcAct_Frz "" UWORD DINH_ct_Compu 1 100 -4095.000 4096.000 BIT_MASK 0x1fff FORMAT "%8.3" ECU_ADDRESS 0x60021AD6 /end MEASUREMENT
/begin MEASUREMENT DINH_nrActvInhReas.FId_bInh_Sig473h_Com_tDcdcAct_Rcf "" UWORD DINH_ct_Compu 1 100 -4095.000 4096.000 BIT_MASK 0x1fff FORMAT "%8.3" ECU_ADDRESS 0x60021AD8 /end MEASUREMENT
/begin MEASUREMENT DINH_nrActvInhReas.FId_bInh_Sig473h_Com_tDcdcInltCoolt_Frz "" UWORD DINH_ct_Compu 1 100 -4095.000 4096.000 BIT_MASK 0x1fff FORMAT "%8.3" ECU_ADDRESS 0x60021ADA /end MEASUREMENT
/begin MEASUREMENT DINH_nrActvInhReas.FId_bInh_Sig473h_Com_tDcdcInltCoolt_Rcf "" UWORD DINH_ct_Compu 1 100 -4095.000 4096.000 BIT_MASK 0x1fff FORMAT "%8.3" ECU_ADDRESS 0x60021ADC /end MEASUREMENT
/begin MEASUREMENT DINH_nrActvInhReas.FId_bInh_Sig47Bh_Com_iElCmprHvAct_Frz "" UWORD DINH_ct_Compu 1 100 -4095.000 4096.000 BIT_MASK 0x1fff FORMAT "%8.3" ECU_ADDRESS 0x60021ADE /end MEASUREMENT
/begin MEASUREMENT DINH_nrActvInhReas.FId_bInh_Sig47Bh_Com_iElCmprHvAct_Rcf "" UWORD DINH_ct_Compu 1 100 -4095.000 4096.000 BIT_MASK 0x1fff FORMAT "%8.3" ECU_ADDRESS 0x60021AE0 /end MEASUREMENT
/begin MEASUREMENT DINH_nrActvInhReas.FId_bInh_Sig47Bh_Com_iElCmprPeakPha_Frz "" UWORD DINH_ct_Compu 1 100 -4095.000 4096.000 BIT_MASK 0x1fff FORMAT "%8.3" ECU_ADDRESS 0x60021AE2 /end MEASUREMENT
/begin MEASUREMENT DINH_nrActvInhReas.FId_bInh_Sig47Bh_Com_iElCmprPeakPha_Rcf "" UWORD DINH_ct_Compu 1 100 -4095.000 4096.000 BIT_MASK 0x1fff FORMAT "%8.3" ECU_ADDRESS 0x60021AE4 /end MEASUREMENT
/begin MEASUREMENT DINH_nrActvInhReas.FId_bInh_Sig47Bh_Com_nElCmprActl_Frz "" UWORD DINH_ct_Compu 1 100 -4095.000 4096.000 BIT_MASK 0x1fff FORMAT "%8.3" ECU_ADDRESS 0x60021AE6 /end MEASUREMENT
/begin MEASUREMENT DINH_nrActvInhReas.FId_bInh_Sig47Bh_Com_nElCmprActl_Rcf "" UWORD DINH_ct_Compu 1 100 -4095.000 4096.000 BIT_MASK 0x1fff FORMAT "%8.3" ECU_ADDRESS 0x60021AE8 /end MEASUREMENT
/begin MEASUREMENT DINH_nrActvInhReas.FId_bInh_Sig47Bh_Com_pwrElCmprActl_Frz "" UWORD DINH_ct_Compu 1 100 -4095.000 4096.000 BIT_MASK 0x1fff FORMAT "%8.3" ECU_ADDRESS 0x60021AEA /end MEASUREMENT
/begin MEASUREMENT DINH_nrActvInhReas.FId_bInh_Sig47Bh_Com_pwrElCmprActl_Rcf "" UWORD DINH_ct_Compu 1 100 -4095.000 4096.000 BIT_MASK 0x1fff FORMAT "%8.3" ECU_ADDRESS 0x60021AEC /end MEASUREMENT
/begin MEASUREMENT DINH_nrActvInhReas.FId_bInh_Sig47Bh_Com_tElCmprActl_Frz "" UWORD DINH_ct_Compu 1 100 -4095.000 4096.000 BIT_MASK 0x1fff FORMAT "%8.3" ECU_ADDRESS 0x60021AEE /end MEASUREMENT
/begin MEASUREMENT DINH_nrActvInhReas.FId_bInh_Sig47Bh_Com_tElCmprActl_Rcf "" UWORD DINH_ct_Compu 1 100 -4095.000 4096.000 BIT_MASK 0x1fff FORMAT "%8.3" ECU_ADDRESS 0x60021AF0 /end MEASUREMENT
/begin MEASUREMENT DINH_nrActvInhReas.FId_bInh_Sig47Bh_Com_uElCmprHvAct_Frz "" UWORD DINH_ct_Compu 1 100 -4095.000 4096.000 BIT_MASK 0x1fff FORMAT "%8.3" ECU_ADDRESS 0x60021AF2 /end MEASUREMENT
/begin MEASUREMENT DINH_nrActvInhReas.FId_bInh_Sig47Bh_Com_uElCmprHvAct_Rcf "" UWORD DINH_ct_Compu 1 100 -4095.000 4096.000 BIT_MASK 0x1fff FORMAT "%8.3" ECU_ADDRESS 0x60021AF4 /end MEASUREMENT
/begin MEASUREMENT DINH_nrActvInhReas.FId_bInh_Sig48Bh_Com_stElCmprFltLvl_Frz "" UWORD DINH_ct_Compu 1 100 -4095.000 4096.000 BIT_MASK 0x1fff FORMAT "%8.3" ECU_ADDRESS 0x60021AF6 /end MEASUREMENT
/begin MEASUREMENT DINH_nrActvInhReas.FId_bInh_Sig48Bh_Com_stElCmprFltLvl_Rcf "" UWORD DINH_ct_Compu 1 100 -4095.000 4096.000 BIT_MASK 0x1fff FORMAT "%8.3" ECU_ADDRESS 0x60021AF8 /end MEASUREMENT
/begin MEASUREMENT DINH_nrActvInhReas.FId_bInh_Sig4F2h_Com_ratSocLvBatt_Frz "" UWORD DINH_ct_Compu 1 100 -4095.000 4096.000 BIT_MASK 0x1fff FORMAT "%8.3" ECU_ADDRESS 0x60021AFA /end MEASUREMENT
/begin MEASUREMENT DINH_nrActvInhReas.FId_bInh_Sig4F2h_Com_ratSocLvBatt_Rcf "" UWORD DINH_ct_Compu 1 100 -4095.000 4096.000 BIT_MASK 0x1fff FORMAT "%8.3" ECU_ADDRESS 0x60021AFC /end MEASUREMENT
/begin MEASUREMENT DINH_nrActvInhReas.FId_bInh_Sig4F2h_Com_stSocRx_Frz "" UWORD DINH_ct_Compu 1 100 -4095.000 4096.000 BIT_MASK 0x1fff FORMAT "%8.3" ECU_ADDRESS 0x60021AFE /end MEASUREMENT
/begin MEASUREMENT DINH_nrActvInhReas.FId_bInh_Sig4F2h_Com_stSocRx_Rcf "" UWORD DINH_ct_Compu 1 100 -4095.000 4096.000 BIT_MASK 0x1fff FORMAT "%8.3" ECU_ADDRESS 0x60021B00 /end MEASUREMENT
/begin MEASUREMENT DINH_nrActvInhReas.FId_bInh_Sig4F2h_Com_stT_Frz "" UWORD DINH_ct_Compu 1 100 -4095.000 4096.000 BIT_MASK 0x1fff FORMAT "%8.3" ECU_ADDRESS 0x60021B02 /end MEASUREMENT
/begin MEASUREMENT DINH_nrActvInhReas.FId_bInh_Sig4F2h_Com_stT_Rcf "" UWORD DINH_ct_Compu 1 100 -4095.000 4096.000 BIT_MASK 0x1fff FORMAT "%8.3" ECU_ADDRESS 0x60021B04 /end MEASUREMENT
/begin MEASUREMENT DINH_nrActvInhReas.FId_bInh_Sig535h_Com_tHvbAct_Frz "" UWORD DINH_ct_Compu 1 100 -4095.000 4096.000 BIT_MASK 0x1fff FORMAT "%8.3" ECU_ADDRESS 0x60021B06 /end MEASUREMENT
/begin MEASUREMENT DINH_nrActvInhReas.FId_bInh_Sig535h_Com_tHvbAct_Rcf "" UWORD DINH_ct_Compu 1 100 -4095.000 4096.000 BIT_MASK 0x1fff FORMAT "%8.3" ECU_ADDRESS 0x60021B08 /end MEASUREMENT
/begin MEASUREMENT DINH_nrActvInhReas.FId_bInh_Sig543h_Com_egyHvbAvl_fRx_Frz "" UWORD DINH_ct_Compu 1 100 -4095.000 4096.000 BIT_MASK 0x1fff FORMAT "%8.3" ECU_ADDRESS 0x60021B0A /end MEASUREMENT
/begin MEASUREMENT DINH_nrActvInhReas.FId_bInh_Sig543h_Com_egyHvbAvl_fRx_Rcf "" UWORD DINH_ct_Compu 1 100 -4095.000 4096.000 BIT_MASK 0x1fff FORMAT "%8.3" ECU_ADDRESS 0x60021B0C /end MEASUREMENT
/begin MEASUREMENT DINH_nrActvInhReas.FId_bInh_Sig543h_Com_ratHvbSoh_Frz "" UWORD DINH_ct_Compu 1 100 -4095.000 4096.000 BIT_MASK 0x1fff FORMAT "%8.3" ECU_ADDRESS 0x60021B0E /end MEASUREMENT
/begin MEASUREMENT DINH_nrActvInhReas.FId_bInh_Sig543h_Com_ratHvbSoh_Rcf "" UWORD DINH_ct_Compu 1 100 -4095.000 4096.000 BIT_MASK 0x1fff FORMAT "%8.3" ECU_ADDRESS 0x60021B10 /end MEASUREMENT
/begin MEASUREMENT DINH_nrActvInhReas.FId_bInh_Sig543h_Com_ratRHvbSoh_Frz "" UWORD DINH_ct_Compu 1 100 -4095.000 4096.000 BIT_MASK 0x1fff FORMAT "%8.3" ECU_ADDRESS 0x60021B12 /end MEASUREMENT
/begin MEASUREMENT DINH_nrActvInhReas.FId_bInh_Sig543h_Com_ratRHvbSoh_Rcf "" UWORD DINH_ct_Compu 1 100 -4095.000 4096.000 BIT_MASK 0x1fff FORMAT "%8.3" ECU_ADDRESS 0x60021B14 /end MEASUREMENT
/begin MEASUREMENT DINH_nrActvInhReas.FId_bInh_Sig552h_Com_lDstGlbDa_Frz "" UWORD DINH_ct_Compu 1 100 -4095.000 4096.000 BIT_MASK 0x1fff FORMAT "%8.3" ECU_ADDRESS 0x60021B16 /end MEASUREMENT
/begin MEASUREMENT DINH_nrActvInhReas.FId_bInh_Sig552h_Com_lDstGlbDa_Rcf "" UWORD DINH_ct_Compu 1 100 -4095.000 4096.000 BIT_MASK 0x1fff FORMAT "%8.3" ECU_ADDRESS 0x60021B18 /end MEASUREMENT
/begin MEASUREMENT DINH_nrActvInhReas.FId_bInh_Sig552h_Com_lTotOdometer_Frz "" UWORD DINH_ct_Compu 1 100 -4095.000 4096.000 BIT_MASK 0x1fff FORMAT "%8.3" ECU_ADDRESS 0x60021B1A /end MEASUREMENT
/begin MEASUREMENT DINH_nrActvInhReas.FId_bInh_Sig552h_Com_lTotOdometer_Rcf "" UWORD DINH_ct_Compu 1 100 -4095.000 4096.000 BIT_MASK 0x1fff FORMAT "%8.3" ECU_ADDRESS 0x60021B1C /end MEASUREMENT
/begin MEASUREMENT DINH_nrActvInhReas.FId_bInh_Sig552h_Com_tiCurVehTmr_Frz "" UWORD DINH_ct_Compu 1 100 -4095.000 4096.000 BIT_MASK 0x1fff FORMAT "%8.3" ECU_ADDRESS 0x60021B1E /end MEASUREMENT
/begin MEASUREMENT DINH_nrActvInhReas.FId_bInh_Sig552h_Com_tiCurVehTmr_Rcf "" UWORD DINH_ct_Compu 1 100 -4095.000 4096.000 BIT_MASK 0x1fff FORMAT "%8.3" ECU_ADDRESS 0x60021B20 /end MEASUREMENT
/begin MEASUREMENT DINH_nrActvInhReas.FId_bInh_Sig583h_Com_stHvbDiscnctReas_Frz "" UWORD DINH_ct_Compu 1 100 -4095.000 4096.000 BIT_MASK 0x1fff FORMAT "%8.3" ECU_ADDRESS 0x60021B22 /end MEASUREMENT
/begin MEASUREMENT DINH_nrActvInhReas.FId_bInh_Sig583h_Com_stHvbDiscnctReas_Rcf "" UWORD DINH_ct_Compu 1 100 -4095.000 4096.000 BIT_MASK 0x1fff FORMAT "%8.3" ECU_ADDRESS 0x60021B24 /end MEASUREMENT
/begin MEASUREMENT DINH_nrActvInhReas.FId_bInh_Sig592h_Com_iBattEBS1Rx_Frz "" UWORD DINH_ct_Compu 1 100 -4095.000 4096.000 BIT_MASK 0x1fff FORMAT "%8.3" ECU_ADDRESS 0x60021B26 /end MEASUREMENT
/begin MEASUREMENT DINH_nrActvInhReas.FId_bInh_Sig592h_Com_iBattEBS1Rx_Rcf "" UWORD DINH_ct_Compu 1 100 -4095.000 4096.000 BIT_MASK 0x1fff FORMAT "%8.3" ECU_ADDRESS 0x60021B28 /end MEASUREMENT
/begin MEASUREMENT DINH_nrActvInhReas.FId_bInh_Sig592h_Com_iBattEBS2Rx_Frz "" UWORD DINH_ct_Compu 1 100 -4095.000 4096.000 BIT_MASK 0x1fff FORMAT "%8.3" ECU_ADDRESS 0x60021B2A /end MEASUREMENT
/begin MEASUREMENT DINH_nrActvInhReas.FId_bInh_Sig592h_Com_iBattEBS2Rx_Rcf "" UWORD DINH_ct_Compu 1 100 -4095.000 4096.000 BIT_MASK 0x1fff FORMAT "%8.3" ECU_ADDRESS 0x60021B2C /end MEASUREMENT
/begin MEASUREMENT DINH_nrActvInhReas.FId_bInh_Sig592h_Com_iBattEBS3Rx_Frz "" UWORD DINH_ct_Compu 1 100 -4095.000 4096.000 BIT_MASK 0x1fff FORMAT "%8.3" ECU_ADDRESS 0x60021B2E /end MEASUREMENT
/begin MEASUREMENT DINH_nrActvInhReas.FId_bInh_Sig592h_Com_iBattEBS3Rx_Rcf "" UWORD DINH_ct_Compu 1 100 -4095.000 4096.000 BIT_MASK 0x1fff FORMAT "%8.3" ECU_ADDRESS 0x60021B30 /end MEASUREMENT
/begin MEASUREMENT DINH_nrActvInhReas.FId_bInh_Sig592h_Com_stIBattEBS_Frz "" UWORD DINH_ct_Compu 1 100 -4095.000 4096.000 BIT_MASK 0x1fff FORMAT "%8.3" ECU_ADDRESS 0x60021B32 /end MEASUREMENT
/begin MEASUREMENT DINH_nrActvInhReas.FId_bInh_Sig592h_Com_stIBattEBS_Rcf "" UWORD DINH_ct_Compu 1 100 -4095.000 4096.000 BIT_MASK 0x1fff FORMAT "%8.3" ECU_ADDRESS 0x60021B34 /end MEASUREMENT
/begin MEASUREMENT DINH_nrActvInhReas.FId_bInh_Sig592h_Com_tLvBatt_Frz "" UWORD DINH_ct_Compu 1 100 -4095.000 4096.000 BIT_MASK 0x1fff FORMAT "%8.3" ECU_ADDRESS 0x60021B36 /end MEASUREMENT
/begin MEASUREMENT DINH_nrActvInhReas.FId_bInh_Sig592h_Com_tLvBatt_Rcf "" UWORD DINH_ct_Compu 1 100 -4095.000 4096.000 BIT_MASK 0x1fff FORMAT "%8.3" ECU_ADDRESS 0x60021B38 /end MEASUREMENT
/begin MEASUREMENT DINH_nrActvInhReas.FId_bInh_Sig592h_Com_uBattEBSRx_Frz "" UWORD DINH_ct_Compu 1 100 -4095.000 4096.000 BIT_MASK 0x1fff FORMAT "%8.3" ECU_ADDRESS 0x60021B3A /end MEASUREMENT
/begin MEASUREMENT DINH_nrActvInhReas.FId_bInh_Sig592h_Com_uBattEBSRx_Rcf "" UWORD DINH_ct_Compu 1 100 -4095.000 4096.000 BIT_MASK 0x1fff FORMAT "%8.3" ECU_ADDRESS 0x60021B3C /end MEASUREMENT
/begin MEASUREMENT DINH_nrActvInhReas.FId_bInh_Sig595h_Com_tiHvbChrgnHalfRx_Frz "" UWORD DINH_ct_Compu 1 100 -4095.000 4096.000 BIT_MASK 0x1fff FORMAT "%8.3" ECU_ADDRESS 0x60021B3E /end MEASUREMENT
/begin MEASUREMENT DINH_nrActvInhReas.FId_bInh_Sig595h_Com_tiHvbChrgnHalfRx_Rcf "" UWORD DINH_ct_Compu 1 100 -4095.000 4096.000 BIT_MASK 0x1fff FORMAT "%8.3" ECU_ADDRESS 0x60021B40 /end MEASUREMENT
/begin MEASUREMENT DINH_nrActvInhReas.FId_bInh_Sig5B2h_Com_tEnvT_Frz "" UWORD DINH_ct_Compu 1 100 -4095.000 4096.000 BIT_MASK 0x1fff FORMAT "%8.3" ECU_ADDRESS 0x60021B42 /end MEASUREMENT
/begin MEASUREMENT DINH_nrActvInhReas.FId_bInh_Sig5B2h_Com_tEnvT_Rcf "" UWORD DINH_ct_Compu 1 100 -4095.000 4096.000 BIT_MASK 0x1fff FORMAT "%8.3" ECU_ADDRESS 0x60021B44 /end MEASUREMENT
/begin MEASUREMENT DINH_nrActvInhReas.FId_bInh_Sig5B5h_Com_stAlrtThermRunAwy_Frz "" UWORD DINH_ct_Compu 1 100 -4095.000 4096.000 BIT_MASK 0x1fff FORMAT "%8.3" ECU_ADDRESS 0x60021B46 /end MEASUREMENT
/begin MEASUREMENT DINH_nrActvInhReas.FId_bInh_Sig5B5h_Com_stAlrtThermRunAwy_Rcf "" UWORD DINH_ct_Compu 1 100 -4095.000 4096.000 BIT_MASK 0x1fff FORMAT "%8.3" ECU_ADDRESS 0x60021B48 /end MEASUREMENT
/begin MEASUREMENT DINH_nrActvInhReas.FId_bInh_Sig635h_Com_ctHvbNegCntctrSeg1_Frz "" UWORD DINH_ct_Compu 1 100 -4095.000 4096.000 BIT_MASK 0x1fff FORMAT "%8.3" ECU_ADDRESS 0x60021B4A /end MEASUREMENT
/begin MEASUREMENT DINH_nrActvInhReas.FId_bInh_Sig635h_Com_ctHvbNegCntctrSeg1_Rcf "" UWORD DINH_ct_Compu 1 100 -4095.000 4096.000 BIT_MASK 0x1fff FORMAT "%8.3" ECU_ADDRESS 0x60021B4C /end MEASUREMENT
/begin MEASUREMENT DINH_nrActvInhReas.FId_bInh_Sig635h_Com_ctHvbNegCntctrSeg3_Frz "" UWORD DINH_ct_Compu 1 100 -4095.000 4096.000 BIT_MASK 0x1fff FORMAT "%8.3" ECU_ADDRESS 0x60021B4E /end MEASUREMENT
/begin MEASUREMENT DINH_nrActvInhReas.FId_bInh_Sig635h_Com_ctHvbNegCntctrSeg3_Rcf "" UWORD DINH_ct_Compu 1 100 -4095.000 4096.000 BIT_MASK 0x1fff FORMAT "%8.3" ECU_ADDRESS 0x60021B50 /end MEASUREMENT
/begin MEASUREMENT DINH_nrActvInhReas.FId_bInh_Sig635h_Com_ctHvbNegCntctrSeg4_Frz "" UWORD DINH_ct_Compu 1 100 -4095.000 4096.000 BIT_MASK 0x1fff FORMAT "%8.3" ECU_ADDRESS 0x60021B52 /end MEASUREMENT
/begin MEASUREMENT DINH_nrActvInhReas.FId_bInh_Sig635h_Com_ctHvbNegCntctrSeg4_Rcf "" UWORD DINH_ct_Compu 1 100 -4095.000 4096.000 BIT_MASK 0x1fff FORMAT "%8.3" ECU_ADDRESS 0x60021B54 /end MEASUREMENT
/begin MEASUREMENT DINH_nrActvInhReas.FId_bInh_Sig635h_Com_ctHvbPosCntctrSeg1_Frz "" UWORD DINH_ct_Compu 1 100 -4095.000 4096.000 BIT_MASK 0x1fff FORMAT "%8.3" ECU_ADDRESS 0x60021B56 /end MEASUREMENT
/begin MEASUREMENT DINH_nrActvInhReas.FId_bInh_Sig635h_Com_ctHvbPosCntctrSeg1_Rcf "" UWORD DINH_ct_Compu 1 100 -4095.000 4096.000 BIT_MASK 0x1fff FORMAT "%8.3" ECU_ADDRESS 0x60021B58 /end MEASUREMENT
/begin MEASUREMENT DINH_nrActvInhReas.FId_bInh_Sig635h_Com_ctHvbPosCntctrSeg3_Frz "" UWORD DINH_ct_Compu 1 100 -4095.000 4096.000 BIT_MASK 0x1fff FORMAT "%8.3" ECU_ADDRESS 0x60021B5A /end MEASUREMENT
/begin MEASUREMENT DINH_nrActvInhReas.FId_bInh_Sig635h_Com_ctHvbPosCntctrSeg3_Rcf "" UWORD DINH_ct_Compu 1 100 -4095.000 4096.000 BIT_MASK 0x1fff FORMAT "%8.3" ECU_ADDRESS 0x60021B5C /end MEASUREMENT
/begin MEASUREMENT DINH_nrActvInhReas.FId_bInh_Sig635h_Com_ctHvbPosCntctrSeg4_Frz "" UWORD DINH_ct_Compu 1 100 -4095.000 4096.000 BIT_MASK 0x1fff FORMAT "%8.3" ECU_ADDRESS 0x60021B5E /end MEASUREMENT
/begin MEASUREMENT DINH_nrActvInhReas.FId_bInh_Sig635h_Com_ctHvbPosCntctrSeg4_Rcf "" UWORD DINH_ct_Compu 1 100 -4095.000 4096.000 BIT_MASK 0x1fff FORMAT "%8.3" ECU_ADDRESS 0x60021B60 /end MEASUREMENT
/begin MEASUREMENT DINH_nrActvInhReas.FId_bInh_Sig645h_Com_ctHvbPrecCntctrSeg1_Frz "" UWORD DINH_ct_Compu 1 100 -4095.000 4096.000 BIT_MASK 0x1fff FORMAT "%8.3" ECU_ADDRESS 0x60021B62 /end MEASUREMENT
/begin MEASUREMENT DINH_nrActvInhReas.FId_bInh_Sig645h_Com_ctHvbPrecCntctrSeg1_Rcf "" UWORD DINH_ct_Compu 1 100 -4095.000 4096.000 BIT_MASK 0x1fff FORMAT "%8.3" ECU_ADDRESS 0x60021B64 /end MEASUREMENT
/begin MEASUREMENT DINH_nrActvInhReas.FId_bInh_Sig645h_Com_ctHvbPrecCntctrSeg2_Frz "" UWORD DINH_ct_Compu 1 100 -4095.000 4096.000 BIT_MASK 0x1fff FORMAT "%8.3" ECU_ADDRESS 0x60021B66 /end MEASUREMENT
/begin MEASUREMENT DINH_nrActvInhReas.FId_bInh_Sig645h_Com_ctHvbPrecCntctrSeg2_Rcf "" UWORD DINH_ct_Compu 1 100 -4095.000 4096.000 BIT_MASK 0x1fff FORMAT "%8.3" ECU_ADDRESS 0x60021B68 /end MEASUREMENT
/begin MEASUREMENT DINH_nrActvInhReas.FId_bInh_Sig675h_Com_qHvbTotCpRx_Frz "" UWORD DINH_ct_Compu 1 100 -4095.000 4096.000 BIT_MASK 0x1fff FORMAT "%8.3" ECU_ADDRESS 0x60021B6A /end MEASUREMENT
/begin MEASUREMENT DINH_nrActvInhReas.FId_bInh_Sig675h_Com_qHvbTotCpRx_Rcf "" UWORD DINH_ct_Compu 1 100 -4095.000 4096.000 BIT_MASK 0x1fff FORMAT "%8.3" ECU_ADDRESS 0x60021B6C /end MEASUREMENT
/begin MEASUREMENT DINH_nrActvInhReas.FId_bInh_ThermHvac_stRemPrecndn "" UWORD DINH_ct_Compu 1 100 -4095.000 4096.000 BIT_MASK 0x1fff FORMAT "%8.3" ECU_ADDRESS 0x60021B80 /end MEASUREMENT
/begin MEASUREMENT DINH_nrActvInhReas.FId_bInh_VehCoorn_dstRngPrdcDispTx "" UWORD DINH_ct_Compu 1 100 -4095.000 4096.000 BIT_MASK 0x1fff FORMAT "%8.3" ECU_ADDRESS 0x60021B82 /end MEASUREMENT
/begin MEASUREMENT DINH_nrActvInhReas.FId_bInh_VehCoorn_wCnsTotWghtAvrgEffTripA "" UWORD DINH_ct_Compu 1 100 -4095.000 4096.000 BIT_MASK 0x1fff FORMAT "%8.3" ECU_ADDRESS 0x60021B84 /end MEASUREMENT
/begin MEASUREMENT DINH_nrActvInhReas.FId_bInh_VehCoorn_wCnsTotWghtAvrgEffTripB "" UWORD DINH_ct_Compu 1 100 -4095.000 4096.000 BIT_MASK 0x1fff FORMAT "%8.3" ECU_ADDRESS 0x60021B86 /end MEASUREMENT
/begin MEASUREMENT DINH_nrActvInhReas.FId_bInh_VehCoorn_wCnsTotWghtAvrgEffTx "" UWORD DINH_ct_Compu 1 100 -4095.000 4096.000 BIT_MASK 0x1fff FORMAT "%8.3" ECU_ADDRESS 0x60021B88 /end MEASUREMENT
/begin MEASUREMENT DINH_nrActvInhReas.FId_bInh_VehCoorn_wCnsTotWghtTripAvrgEffTx "" UWORD DINH_ct_Compu 1 100 -4095.000 4096.000 BIT_MASK 0x1fff FORMAT "%8.3" ECU_ADDRESS 0x60021B8A /end MEASUREMENT
/begin MEASUREMENT DINH_nrActvInhReas.FId_bInh_VehCoorn_wCnsWghtAvrgEffTripA "" UWORD DINH_ct_Compu 1 100 -4095.000 4096.000 BIT_MASK 0x1fff FORMAT "%8.3" ECU_ADDRESS 0x60021B8C /end MEASUREMENT
/begin MEASUREMENT DINH_nrActvInhReas.FId_bInh_VehCoorn_wCnsWghtAvrgEffTripB "" UWORD DINH_ct_Compu 1 100 -4095.000 4096.000 BIT_MASK 0x1fff FORMAT "%8.3" ECU_ADDRESS 0x60021B8E /end MEASUREMENT
/begin MEASUREMENT DINH_stFId.FId_bInhDiag_CLUSTER_5E7 "" UWORD DFC_OneToOne 1 100 0.00 65535.00 FORMAT "%8.2" ECU_ADDRESS 0x60021612 /end MEASUREMENT
/begin MEASUREMENT DINH_stFId.FId_bInhDiag_CONTEXTE_1_5B2 "" UWORD DFC_OneToOne 1 100 0.00 65535.00 FORMAT "%8.2" ECU_ADDRESS 0x60021614 /end MEASUREMENT
/begin MEASUREMENT DINH_stFId.FId_bInhDiag_DAT3_BSI_4F2h "" UWORD DFC_OneToOne 1 100 0.00 65535.00 FORMAT "%8.2" ECU_ADDRESS 0x60021616 /end MEASUREMENT
/begin MEASUREMENT DINH_stFId.FId_bInhDiag_DCDC_283h "" UWORD DFC_OneToOne 1 100 0.00 65535.00 FORMAT "%8.2" ECU_ADDRESS 0x60021618 /end MEASUREMENT
/begin MEASUREMENT DINH_stFId.FId_bInhDiag_DCDC_293h "" UWORD DFC_OneToOne 1 100 0.00 65535.00 FORMAT "%8.2" ECU_ADDRESS 0x6002161A /end MEASUREMENT
/begin FUNCTION ComScl_NetMtrx "850.8.0   Configuration of network matrix"
 /begin OUT_MEASUREMENT DFC_st.DFC_Com675hAbsent DFC_st.DFC_Com675hTooShort DFC_st.DFC_ComFrbd_205h_HVBAT_PACK_CURRENT DFC_st.DFC_ComFrbd_205h_HVBAT_SOC_DISPLAY DFC_st.DFC_ComFrbd_205h_HVBAT_VOLTAGE DFC_st.DFC_ComFrbd_217h_INV_DC_BUS_VOLTAGE DFC_st.DFC_ComFrbd_217h_INV_MTR_ACTUAL_TRQ DFC_st.DFC_ComFrbd_217h_INV_MTR_SPEED DFC_st.DFC_ComFrbd_217h_INV_MTR_TRQ DFC_st.DFC_ComFrbd_227h_INV_DC_CURRENT DFC_st.DFC_ComFrbd_227h_INV_MOTORING_PEAK_TRQ DFC_st.DFC_ComFrbd_227h_INV_MTR_INST_INPUT_POWER DFC_st.DFC_ComFrbd_227h_INV_REGEN_PEAK_TRQ DFC_st.DFC_ComFrbd_237h_INV_ACTIVE_DISCHARGE_STATUS DFC_st.DFC_ComFrbd_237h_INV_CTRL_MODE_ACK DFC_st.DFC_ComFrbd_237h_INV_EV_WARNING DFC_st.DFC_ComFrbd_237h_INV_FAULT_LEVEL DFC_st.DFC_ComFrbd_237h_INV_MASTER_STOP DFC_st.DFC_ComFrbd_237h_INV_SERVICE_DUE DFC_st.DFC_ComFrbd_237h_INV_STAB_MIN_TRQ DFC_st.DFC_ComFrbd_259h_TGLM_FAILURE_STATE DFC_st.DFC_ComFrbd_259h_TGLM_MODE_PUSH DFC_st.DFC_ComFrbd_259h_TOGGLE_MONOSTABLE_POS DFC_st.DFC_ComFrbd_273h_OBC_outputpower_capability DFC_st.DFC_ComFrbd_275h_HVBAT_DISCHARGE_30S_AVAILABLE_CURRENT DFC_st.DFC_ComFrbd_275h_HVBAT_DISCHARGE_30S_AVAILABLE_POWER DFC_st.DFC_ComFrbd_283h_DCDC_IN_CURRENT DFC_st.DFC_ComFrbd_283h_DCDC_IN_VOLTAGE DFC_st.DFC_ComFrbd_283h_DCDC_OUT_CURRENT DFC_st.DFC_ComFrbd_283h_DCDC_OUT_VOLTAGE DFC_st.DFC_ComFrbd_285h_HVBAT_REGEN_CHG_30S_CURRENT_LIMIT DFC_st.DFC_ComFrbd_285h_HVBAT_REGEN_CHRG_30S_POWER_LIMIT DFC_st.DFC_ComFrbd_293h_DCDC_outputpower_capability DFC_st.DFC_ComFrbd_325h_HVBAT_INSULATION_RESISTANCE DFC_st.DFC_ComFrbd_325h_HVBAT_TEMPERATURE DFC_st.DFC_ComFrbd_335h_HVBAT_CHRG_CONTINUOUS_CURR_MAX DFC_st.DFC_ComFrbd_335h_HVBAT_CHRG_COTINUOUS_CURR_REQ DFC_st.DFC_ComFrbd_335h_HVBAT_CHRG_MAX_VOLT DFC_st.DFC_ComFrbd_335h_HVBAT_DC_BUS_VOLTAGE DFC_st.DFC_ComFrbd_427h_INV_OP_MODE DFC_st.DFC_ComFrbd_427h_INV_PERMISIBLE_TORQUE DFC_st.DFC_ComFrbd_435h_HVBAT_MAX_CELL_VOLT DFC_st.DFC_ComFrbd_435h_HVBAT_MAX_CELL_VOLT_NUM DFC_st.DFC_ComFrbd_435h_HVBAT_MAX_SENSOR_TEMP DFC_st.DFC_ComFrbd_435h_HVBAT_MIN_CELL_VOLT DFC_st.DFC_ComFrbd_435h_HVBAT_MIN_CELL_VOLT_NUM DFC_st.DFC_ComFrbd_453h_OBC_IN_CURRENT DFC_st.DFC_ComFrbd_453h_OBC_IN_VOLTAGE DFC_st.DFC_ComFrbd_453h_OBC_IP_POWER DFC_st.DFC_ComFrbd_455h_HVBAT_NOMINAL_VOLTAGE DFC_st.DFC_ComFrbd_463h_OBC_OUT_CURRENT DFC_st.DFC_ComFrbd_463h_OBC_OUT_VOLTAGE DFC_st.DFC_ComFrbd_463h_OBC_TEMPERATURE DFC_st.DFC_ComFrbd_473h_DCDC_Coolant_Temperature DFC_st.DFC_ComFrbd_473h_DCDC_TEMPERATURE DFC_st.DFC_ComFrbd_47Bh_eCOMP_BusBarCurrent DFC_st.DFC_ComFrbd_47Bh_eCOMP_BusBarVoltage DFC_st.DFC_ComFrbd_47Bh_eCOMP_CompressorSpeed DFC_st.DFC_ComFrbd_47Bh_eCOMP_IGBT_Temp DFC_st.DFC_ComFrbd_47Bh_eCOMP_PeakPhaCurrent DFC_st.DFC_ComFrbd_47Bh_eCOMP_Power_consumption DFC_st.DFC_ComFrbd_48Bh_eCOMP_Fault_Level DFC_st.DFC_ComFrbd_4F2h_VALEUR_SOC_ETENDUE DFC_st.DFC_ComFrbd_535h_HV_BATT_TEMP_AVG DFC_st.DFC_ComFrbd_543h_HVBAT_RESTBATTENERGY DFC_st.DFC_ComFrbd_543h_HVBAT_SOH DFC_st.DFC_ComFrbd_543h_HV_BATT_SOH_RES DFC_st.DFC_ComFrbd_592h_IBATT_1 DFC_st.DFC_ComFrbd_592h_IBATT_2 DFC_st.DFC_ComFrbd_592h_IBATT_3 DFC_st.DFC_ComFrbd_592h_TEMP_BATT DFC_st.DFC_ComFrbd_592h_U_BATT_BECB DFC_st.DFC_ComFrbd_595h_HVBAT_TIME_TO_CHRG_80 DFC_st.DFC_ComFrbd_5B2h_TEMP_AIR_EXT DFC_st.DFC_ComFrbd_635h_HVBAT_NEG_CONT_COUNT_SEG1 DFC_st.DFC_ComFrbd_635h_HVBAT_NEG_CONT_COUNT_SEG3 DFC_st.DFC_ComFrbd_635h_HVBAT_NEG_CONT_COUNT_SEG4 DFC_st.DFC_ComFrbd_635h_HVBAT_PST_CONT_COUNT_SEG1 DFC_st.DFC_ComFrbd_635h_HVBAT_PST_CONT_COUNT_SEG3 DFC_st.DFC_ComFrbd_635h_HVBAT_PST_CONT_COUNT_SEG4 DFC_st.DFC_ComFrbd_645h_HVBAT_PRECHRGE_CONT_COUNT_SEG1 DFC_st.DFC_ComFrbd_645h_HVBAT_PRECHRGE_CONT_COUNT_SEG2 DFC_st.DFC_ComFrbd_675h_HVBAT_REMAININGBATTCAPACITY DFC_st.DFC_ComInvld_205h_HVBAT_CHARGING_STATUS DFC_st.DFC_ComInvld_205h_HVBAT_PACK_CURRENT DFC_st.DFC_ComInvld_205h_HVBAT_SOC_DISPLAY DFC_st.DFC_ComInvld_205h_HVBAT_VOLTAGE DFC_st.DFC_ComInvld_217h_INV_DC_BUS_VOLTAGE DFC_st.DFC_ComInvld_217h_INV_MTR_ACTUAL_TRQ DFC_st.DFC_ComInvld_217h_INV_MTR_SPEED DFC_st.DFC_ComInvld_217h_INV_MTR_TRQ DFC_st.DFC_ComInvld_227h_INV_DC_CURRENT DFC_st.DFC_ComInvld_227h_INV_MOTORING_PEAK_TRQ DFC_st.DFC_ComInvld_227h_INV_MTR_INST_INPUT_POWER DFC_st.DFC_ComInvld_227h_INV_REGEN_PEAK_TRQ DFC_st.DFC_ComInvld_237h_INV_ACTIVE_DISCHARGE_STATUS DFC_st.DFC_ComInvld_237h_INV_FAULT_LEVEL DFC_st.DFC_ComInvld_237h_INV_STAB_MIN_TRQ DFC_st.DFC_ComInvld_259h_TGLM_MODE_PUSH DFC_st.DFC_ComInvld_259h_TOGGLE_MONOSTABLE_POS DFC_st.DFC_ComInvld_26h_AC_SWITCH_REQ DFC_st.DFC_ComInvld_26h_BLOWER_POSITION DFC_st.DFC_ComInvld_26h_EVAP_SENSOR_FAULT DFC_st.DFC_ComInvld_26h_EVAP_SENSOR_VALUE DFC_st.DFC_ComInvld_26h_POTENTIOMETER_FAULT DFC_st.DFC_ComInvld_26h_REAR_DEFOG_REQ DFC_st.DFC_ComInvld_26h_TEMP_POSITION DFC_st.DFC_ComInvld_273h_OBC_FAULT_LEVEL DFC_st.DFC_ComInvld_273h_OBC_outputpower_capability DFC_st.DFC_ComInvld_275h_HVBAT_DISCHARGE_30S_AVAILABLE_CURRENT DFC_st.DFC_ComInvld_275h_HVBAT_DISCHARGE_30S_AVAILABLE_POWER DFC_st.DFC_ComInvld_283h_DCDC_IN_CURRENT DFC_st.DFC_ComInvld_283h_DCDC_IN_VOLTAGE DFC_st.DFC_ComInvld_283h_DCDC_OUT_CURRENT DFC_st.DFC_ComInvld_283h_DCDC_OUT_VOLTAGE DFC_st.DFC_ComInvld_285h_HVBAT_REGEN_CHG_30S_CURRENT_LIMIT DFC_st.DFC_ComInvld_285h_HVBAT_REGEN_CHRG_30S_POWER_LIMIT DFC_st.DFC_ComInvld_293h_DCDC_FAULT_LEVEL DFC_st.DFC_ComInvld_293h_DCDC_outputpower_capability DFC_st.DFC_ComInvld_325h_HVBAT_EPLUG_STATUS DFC_st.DFC_ComInvld_325h_HVBAT_HVIL_STS DFC_st.DFC_ComInvld_325h_HVBAT_INSULATION_FAULT DFC_st.DFC_ComInvld_325h_HVBAT_INSULATION_RESISTANCE DFC_st.DFC_ComInvld_325h_HVBAT_TEMPERATURE DFC_st.DFC_ComInvld_335h_HVBAT_CHRG_CONTINUOUS_CURR_MAX DFC_st.DFC_ComInvld_335h_HVBAT_CHRG_COTINUOUS_CURR_REQ DFC_st.DFC_ComInvld_335h_HVBAT_CHRG_MAX_VOLT DFC_st.DFC_ComInvld_335h_HVBAT_DC_BUS_VOLTAGE DFC_st.DFC_ComInvld_38Dh_VITESSE_VEHICULE_ROUES DFC_st.DFC_ComInvld_38Dh_VVH_INDISP DFC_st.DFC_ComInvld_427h_INV_COOLANT_TEMP DFC_st.DFC_ComInvld_427h_INV_MOTOR_TEMP DFC_st.DFC_ComInvld_427h_INV_OP_MODE DFC_st.DFC_ComInvld_427h_INV_PERMISIBLE_TORQUE DFC_st.DFC_ComInvld_427h_INV_TEMP DFC_st.DFC_ComInvld_432h_REVEIL_PRINCIPAL DFC_st.DFC_ComInvld_435h_HVBAT_MAX_CELL_VOLT DFC_st.DFC_ComInvld_435h_HVBAT_MAX_CELL_VOLT_NUM DFC_st.DFC_ComInvld_435h_HVBAT_MAX_SENSOR_TEMP DFC_st.DFC_ComInvld_435h_HVBAT_MIN_CELL_VOLT DFC_st.DFC_ComInvld_435h_HVBAT_MIN_CELL_VOLT_NUM DFC_st.DFC_ComInvld_442h_BCCM_BLOWER_RELAY_STS DFC_st.DFC_ComInvld_453h_OBC_IN_CURRENT DFC_st.DFC_ComInvld_453h_OBC_IN_VOLTAGE DFC_st.DFC_ComInvld_453h_OBC_IP_POWER DFC_st.DFC_ComInvld_455h_HVBAT_NOMINAL_VOLTAGE DFC_st.DFC_ComInvld_463h_OBC_OUT_CURRENT DFC_st.DFC_ComInvld_463h_OBC_OUT_VOLTAGE DFC_st.DFC_ComInvld_463h_OBC_TEMPERATURE DFC_st.DFC_ComInvld_473h_DCDC_Coolant_Temperature DFC_st.DFC_ComInvld_473h_DCDC_TEMPERATURE DFC_st.DFC_ComInvld_47Bh_eCOMP_BusBarCurrent DFC_st.DFC_ComInvld_47Bh_eCOMP_BusBarVoltage DFC_st.DFC_ComInvld_47Bh_eCOMP_CompressorSpeed DFC_st.DFC_ComInvld_47Bh_eCOMP_IGBT_Temp DFC_st.DFC_ComInvld_47Bh_eCOMP_PeakPhaCurrent DFC_st.DFC_ComInvld_47Bh_eCOMP_Power_consumption DFC_st.DFC_ComInvld_4F2h_STATUS_SOC DFC_st.DFC_ComInvld_4F2h_TEMP_BATT_STATUS DFC_st.DFC_ComInvld_4F2h_VALEUR_SOC_ETENDUE DFC_st.DFC_ComInvld_535h_HV_BATT_TEMP_AVG DFC_st.DFC_ComInvld_543h_HVBAT_RESTBATTENERGY DFC_st.DFC_ComInvld_543h_HVBAT_SOH DFC_st.DFC_ComInvld_543h_HV_BATT_SOH_RES DFC_st.DFC_ComInvld_552h_CPT_TEMPOREL DFC_st.DFC_ComInvld_552h_KILOMETRAGE DFC_st.DFC_ComInvld_583h_HV_BATT_DISCONT_CSE_OPEN DFC_st.DFC_ComInvld_592h_CALIBRE_IBATT DFC_st.DFC_ComInvld_592h_IBATT_1 DFC_st.DFC_ComInvld_592h_IBATT_2 DFC_st.DFC_ComInvld_592h_IBATT_3 DFC_st.DFC_ComInvld_592h_TEMP_BATT DFC_st.DFC_ComInvld_592h_U_BATT_BECB DFC_st.DFC_ComInvld_595h_HVBAT_TIME_TO_CHRG_80 DFC_st.DFC_ComInvld_5B2h_TEMP_AIR_EXT DFC_st.DFC_ComInvld_5B5h_HVBAT_THERMAL_RUNAWAY DFC_st.DFC_ComInvld_635h_HVBAT_NEG_CONT_COUNT_SEG1 DFC_st.DFC_ComInvld_635h_HVBAT_NEG_CONT_COUNT_SEG3 DFC_st.DFC_ComInvld_635h_HVBAT_NEG_CONT_COUNT_SEG4 DFC_st.DFC_ComInvld_635h_HVBAT_PST_CONT_COUNT_SEG1 DFC_st.DFC_ComInvld_635h_HVBAT_PST_CONT_COUNT_SEG3 DFC_st.DFC_ComInvld_635h_HVBAT_PST_CONT_COUNT_SEG4 DFC_st.DFC_ComInvld_645h_HVBAT_PRECHRGE_CONT_COUNT_SEG1 DFC_st.DFC_ComInvld_645h_HVBAT_PRECHRGE_CONT_COUNT_SEG2 DFC_st.DFC_ComInvld_675h_HVBAT_REMAININGBATTCAPACITY DINH_nrActvInhReas.FId_bInhDiag_CLUSTER_5E7 DINH_nrActvInhReas.FId_bInhDiag_CONTEXTE_1_5B2 DINH_nrActvInhReas.FId_bInhDiag_DAT3_BSI_4F2h DINH_nrActvInhReas.FId_bInhDiag_DCDC_283h DINH_nrActvInhReas.FId_bInhDiag_DCDC_293h DINH_nrActvInhReas.FId_bInhDiag_DCDC_473h DINH_nrActvInhReas.FId_bInhDiag_DCDC_663h DINH_nrActvInhReas.FId_bInhDiag_HS3_AUTO_GEARBOX_SWITCH_STATUS DINH_nrActvInhReas.FId_bInhDiag_HVAC_PANEL_26h DINH_nrActvInhReas.FId_bInhDiag_HVBAT_205h DINH_nrActvInhReas.FId_bInhDiag_HVBAT_275h DINH_nrActvInhReas.FId_bInhDiag_HVBAT_285h DINH_nrActvInhReas.FId_bInhDiag_HVBAT_325h DINH_nrActvInhReas.FId_bInhDiag_HVBAT_335h DINH_nrActvInhReas.FId_bInhDiag_HVBAT_455h DINH_nrActvInhReas.FId_bInhDiag_HVBAT_535 DINH_nrActvInhReas.FId_bInhDiag_HVBAT_595h DINH_nrActvInhReas.FId_bInhDiag_HVBAT_635h DINH_nrActvInhReas.FId_bInhDiag_HVBAT_645h DINH_nrActvInhReas.FId_bInhDiag_HVBAT_665h DINH_nrActvInhReas.FId_bInhDiag_HVBAT_675h DINH_nrActvInhReas.FId_bInhDiag_HVBAT_THERMAL_5B5 DINH_nrActvInhReas.FId_bInhDiag_HVBAT_VCU_435h DINH_nrActvInhReas.FId_bInhDiag_HVBAT_VCU_543 DINH_nrActvInhReas.FId_bInhDiag_HVBAT_VCU_583 DINH_nrActvInhReas.FId_bInhDiag_INV_217h DINH_nrActvInhReas.FId_bInhDiag_INV_227h DINH_nrActvInhReas.FId_bInhDiag_INV_237 DINH_nrActvInhReas.FId_bInhDiag_INV_427h DINH_nrActvInhReas.FId_bInhDiag_INV_497h DINH_nrActvInhReas.FId_bInhDiag_INV_IMMO_5C7 DINH_nrActvInhReas.FId_bInhDiag_IS_DAT6_BSI_592h DINH_nrActvInhReas.FId_bInhDiag_IS_DAT_ABR_50Dh DINH_nrActvInhReas.FId_bInhDiag_IS_DAT_BSI_412h DINH_nrActvInhReas.FId_bInhDiag_IS_DYN_ABR_38Dh DINH_nrActvInhReas.FId_bInhDiag_IS_INTE_ELECTRON_BSI_092h DINH_nrActvInhReas.FId_bInhDiag_OBC_273h DINH_nrActvInhReas.FId_bInhDiag_OBC_453h DINH_nrActvInhReas.FId_bInhDiag_OBC_463h DINH_nrActvInhReas.FId_bInhDiag_PDU_BusVoltages_308 DINH_nrActvInhReas.FId_bInhDiag_PDU_Current_318 DINH_nrActvInhReas.FId_bInhDiag_SC_INFO_BCCM_442h DINH_nrActvInhReas.FId_bInhDiag_VCU_AIRBAG_351h DINH_nrActvInhReas.FId_bInhDiag_VCU_eBCCM_432h DINH_nrActvInhReas.FId_bInhDiag_VCU_eBCCM_552h DINH_nrActvInhReas.FId_bInhDiag_eBCCM_082h DINH_nrActvInhReas.FId_bInhDiag_eCOMP_Information_47B DINH_nrActvInhReas.FId_bInhDiag_eCOMP_Information_48B DINH_nrActvInhReas.FId_bInhFrbd_ComChrgr_iAcMax DINH_nrActvInhReas.FId_bInhFrbd_ComChrgr_iDcHvAct DINH_nrActvInhReas.FId_bInhFrbd_ComChrgr_pwrInAct DINH_nrActvInhReas.FId_bInhFrbd_ComChrgr_pwrOutpCpby DINH_nrActvInhReas.FId_bInhFrbd_ComChrgr_tChrgrMaxAct DINH_nrActvInhReas.FId_bInhFrbd_ComChrgr_uAcActL1 DINH_nrActvInhReas.FId_bInhFrbd_ComChrgr_uDcHvAct DINH_nrActvInhReas.FId_bInhFrbd_ComEmac_iDcLnk01 DINH_nrActvInhReas.FId_bInhFrbd_ComEmac_nAct01 DINH_nrActvInhReas.FId_bInhFrbd_ComEmac_pwrInstnsInpRx DINH_nrActvInhReas.FId_bInhFrbd_ComEmac_stActvDcha DINH_nrActvInhReas.FId_bInhFrbd_ComEmac_stEVLmp DINH_nrActvInhReas.FId_bInhFrbd_ComEmac_stIvtrOpMod01 DINH_nrActvInhReas.FId_bInhFrbd_ComEmac_stMod01Rx DINH_nrActvInhReas.FId_bInhFrbd_ComEmac_stMstWrnLmp DINH_nrActvInhReas.FId_bInhFrbd_ComEmac_stSVSLmp DINH_nrActvInhReas.FId_bInhFrbd_ComEmac_tqAbsltMax01 DINH_nrActvInhReas.FId_bInhFrbd_ComEmac_tqAbsltMaxRx01 DINH_nrActvInhReas.FId_bInhFrbd_ComEmac_tqAbsltMin01 DINH_nrActvInhReas.FId_bInhFrbd_ComEmac_tqAbsltMinRx01 DINH_nrActvInhReas.FId_bInhFrbd_ComEmac_tqAckd01 DINH_nrActvInhReas.FId_bInhFrbd_ComEmac_tqAct01 DINH_nrActvInhReas.FId_bInhFrbd_ComEmac_tqPtd01 DINH_nrActvInhReas.FId_bInhFrbd_ComEmac_tqStabnMin DINH_nrActvInhReas.FId_bInhFrbd_ComEmac_uDcLnk01 DINH_nrActvInhReas.FId_bInhFrbd_Com_HvbMaxSnsrTempRx DINH_nrActvInhReas.FId_bInhFrbd_Com_ctHvbNegCntctrSeg1 DINH_nrActvInhReas.FId_bInhFrbd_Com_ctHvbNegCntctrSeg3 DINH_nrActvInhReas.FId_bInhFrbd_Com_ctHvbNegCntctrSeg4 DINH_nrActvInhReas.FId_bInhFrbd_Com_ctHvbPosCntctrSeg1 DINH_nrActvInhReas.FId_bInhFrbd_Com_ctHvbPosCntctrSeg3 DINH_nrActvInhReas.FId_bInhFrbd_Com_ctHvbPosCntctrSeg4 DINH_nrActvInhReas.FId_bInhFrbd_Com_ctHvbPrecCntctrSeg1 DINH_nrActvInhReas.FId_bInhFrbd_Com_ctHvbPrecCntctrSeg2 DINH_nrActvInhReas.FId_bInhFrbd_Com_egyHvbAvl_fRx DINH_nrActvInhReas.FId_bInhFrbd_Com_flgEcoNormReqRx DINH_nrActvInhReas.FId_bInhFrbd_Com_iBattEBS1Rx DINH_nrActvInhReas.FId_bInhFrbd_Com_iBattEBS2Rx DINH_nrActvInhReas.FId_bInhFrbd_Com_iBattEBS3Rx DINH_nrActvInhReas.FId_bInhFrbd_Com_iDcdcHvActRvsn1 DINH_nrActvInhReas.FId_bInhFrbd_Com_iDcdcLvActRvsn1 DINH_nrActvInhReas.FId_bInhFrbd_Com_iElCmprHvAct DINH_nrActvInhReas.FId_bInhFrbd_Com_iElCmprPeakPha DINH_nrActvInhReas.FId_bInhFrbd_Com_iHvbActRx DINH_nrActvInhReas.FId_bInhFrbd_Com_iHvbChrgMaxSho DINH_nrActvInhReas.FId_bInhFrbd_Com_iHvbDchaMaxSho DINH_nrActvInhReas.FId_bInhFrbd_Com_iHvbDes DINH_nrActvInhReas.FId_bInhFrbd_Com_iHvbNomChrgn DINH_nrActvInhReas.FId_bInhFrbd_Com_nElCmprActl DINH_nrActvInhReas.FId_bInhFrbd_Com_nrSerMaxCell DINH_nrActvInhReas.FId_bInhFrbd_Com_nrSerMinCell DINH_nrActvInhReas.FId_bInhFrbd_Com_pwrDcdcOutpCpby DINH_nrActvInhReas.FId_bInhFrbd_Com_pwrElCmprActl DINH_nrActvInhReas.FId_bInhFrbd_Com_pwrMaxChrgSho DINH_nrActvInhReas.FId_bInhFrbd_Com_pwrMaxDchaSho DINH_nrActvInhReas.FId_bInhFrbd_Com_qHvbTotCpRx DINH_nrActvInhReas.FId_bInhFrbd_Com_rHvbIsoMeasmt DINH_nrActvInhReas.FId_bInhFrbd_Com_ratHvbSoc DINH_nrActvInhReas.FId_bInhFrbd_Com_ratHvbSoh DINH_nrActvInhReas.FId_bInhFrbd_Com_ratRHvbSoh DINH_nrActvInhReas.FId_bInhFrbd_Com_ratSocLvBatt DINH_nrActvInhReas.FId_bInhFrbd_Com_stElCmprFltLvl DINH_nrActvInhReas.FId_bInhFrbd_Com_stGearLvrPos DINH_nrActvInhReas.FId_bInhFrbd_Com_stIIvtrFltLvl01 DINH_nrActvInhReas.FId_bInhFrbd_Com_steTogFailrLvl DINH_nrActvInhReas.FId_bInhFrbd_Com_tDcdcAct DINH_nrActvInhReas.FId_bInhFrbd_Com_tDcdcInltCoolt DINH_nrActvInhReas.FId_bInhFrbd_Com_tElCmprActl DINH_nrActvInhReas.FId_bInhFrbd_Com_tEnvT DINH_nrActvInhReas.FId_bInhFrbd_Com_tHvbAct DINH_nrActvInhReas.FId_bInhFrbd_Com_tHvbMax DINH_nrActvInhReas.FId_bInhFrbd_Com_tLvBatt DINH_nrActvInhReas.FId_bInhFrbd_Com_tiHvbChrgnHalfRx DINH_nrActvInhReas.FId_bInhFrbd_Com_uBattEBSRx DINH_nrActvInhReas.FId_bInhFrbd_Com_uDcdcHvAct DINH_nrActvInhReas.FId_bInhFrbd_Com_uDcdcLvAct DINH_nrActvInhReas.FId_bInhFrbd_Com_uElCmprHvAct DINH_nrActvInhReas.FId_bInhFrbd_Com_uHvbAct DINH_nrActvInhReas.FId_bInhFrbd_Com_uHvbDcBus DINH_nrActvInhReas.FId_bInhFrbd_Com_uHvbLimHi DINH_nrActvInhReas.FId_bInhFrbd_Com_uHvbMaxCell DINH_nrActvInhReas.FId_bInhFrbd_Com_uHvbMinCell DINH_nrActvInhReas.FId_bInhFrbd_Com_uHvbNomChrgn DINH_nrActvInhReas.FId_bInhInvld_ComChrgr_flgChrgrErrLvl DINH_nrActvInhReas.FId_bInhInvld_ComChrgr_iAcMax DINH_nrActvInhReas.FId_bInhInvld_ComChrgr_iDcHvAct DINH_nrActvInhReas.FId_bInhInvld_ComChrgr_pwrInAct DINH_nrActvInhReas.FId_bInhInvld_ComChrgr_pwrOutpCpby DINH_nrActvInhReas.FId_bInhInvld_ComChrgr_tChrgrMaxAct DINH_nrActvInhReas.FId_bInhInvld_ComChrgr_uAcActL1 DINH_nrActvInhReas.FId_bInhInvld_ComChrgr_uDcHvAct DINH_nrActvInhReas.FId_bInhInvld_ComEmac_iDcLnk01 DINH_nrActvInhReas.FId_bInhInvld_ComEmac_nAct01 DINH_nrActvInhReas.FId_bInhInvld_ComEmac_pwrInstnsInpRx DINH_nrActvInhReas.FId_bInhInvld_ComEmac_stActvDcha DINH_nrActvInhReas.FId_bInhInvld_ComEmac_stIvtrOpMod01 DINH_nrActvInhReas.FId_bInhInvld_ComEmac_tInvr01 DINH_nrActvInhReas.FId_bInhInvld_ComEmac_tIvtrCooltIn01 DINH_nrActvInhReas.FId_bInhInvld_ComEmac_tMac01 DINH_nrActvInhReas.FId_bInhInvld_ComEmac_tqAbsltMax01 DINH_nrActvInhReas.FId_bInhInvld_ComEmac_tqAbsltMaxRx01 DINH_nrActvInhReas.FId_bInhInvld_ComEmac_tqAbsltMin01 DINH_nrActvInhReas.FId_bInhInvld_ComEmac_tqAbsltMinRx01 DINH_nrActvInhReas.FId_bInhInvld_ComEmac_tqAckd01 DINH_nrActvInhReas.FId_bInhInvld_ComEmac_tqAct01 DINH_nrActvInhReas.FId_bInhInvld_ComEmac_tqPtd01 DINH_nrActvInhReas.FId_bInhInvld_ComEmac_tqStabnMin DINH_nrActvInhReas.FId_bInhInvld_ComEmac_uDcLnk01 DINH_nrActvInhReas.FId_bInhInvld_Com_HvbMaxSnsrTempRx DINH_nrActvInhReas.FId_bInhInvld_Com_ctHvbNegCntctrSeg1 DINH_nrActvInhReas.FId_bInhInvld_Com_ctHvbNegCntctrSeg3 DINH_nrActvInhReas.FId_bInhInvld_Com_ctHvbNegCntctrSeg4 DINH_nrActvInhReas.FId_bInhInvld_Com_ctHvbPosCntctrSeg1 DINH_nrActvInhReas.FId_bInhInvld_Com_ctHvbPosCntctrSeg3 DINH_nrActvInhReas.FId_bInhInvld_Com_ctHvbPosCntctrSeg4 DINH_nrActvInhReas.FId_bInhInvld_Com_ctHvbPrecCntctrSeg1 DINH_nrActvInhReas.FId_bInhInvld_Com_ctHvbPrecCntctrSeg2 DINH_nrActvInhReas.FId_bInhInvld_Com_egyHvbAvl_fRx DINH_nrActvInhReas.FId_bInhInvld_Com_flgEcoNormReqRx DINH_nrActvInhReas.FId_bInhInvld_Com_flgVehSpdAvl DINH_nrActvInhReas.FId_bInhInvld_Com_iBattEBS1Rx DINH_nrActvInhReas.FId_bInhInvld_Com_iBattEBS2Rx DINH_nrActvInhReas.FId_bInhInvld_Com_iBattEBS3Rx DINH_nrActvInhReas.FId_bInhInvld_Com_iDcdcHvActRvsn1 DINH_nrActvInhReas.FId_bInhInvld_Com_iDcdcLvActRvsn1 DINH_nrActvInhReas.FId_bInhInvld_Com_iElCmprHvAct DINH_nrActvInhReas.FId_bInhInvld_Com_iElCmprPeakPha DINH_nrActvInhReas.FId_bInhInvld_Com_iHvbActRx DINH_nrActvInhReas.FId_bInhInvld_Com_iHvbChrgMaxSho DINH_nrActvInhReas.FId_bInhInvld_Com_iHvbDchaMaxSho DINH_nrActvInhReas.FId_bInhInvld_Com_iHvbDes DINH_nrActvInhReas.FId_bInhInvld_Com_iHvbNomChrgn DINH_nrActvInhReas.FId_bInhInvld_Com_lDstGlbDa DINH_nrActvInhReas.FId_bInhInvld_Com_lTotOdometer DINH_nrActvInhReas.FId_bInhInvld_Com_nElCmprActl DINH_nrActvInhReas.FId_bInhInvld_Com_nrSerMaxCell DINH_nrActvInhReas.FId_bInhInvld_Com_nrSerMinCell DINH_nrActvInhReas.FId_bInhInvld_Com_pwrDcdcOutpCpby DINH_nrActvInhReas.FId_bInhInvld_Com_pwrElCmprActl DINH_nrActvInhReas.FId_bInhInvld_Com_pwrMaxChrgSho DINH_nrActvInhReas.FId_bInhInvld_Com_pwrMaxDchaSho DINH_nrActvInhReas.FId_bInhInvld_Com_qHvbTotCpRx DINH_nrActvInhReas.FId_bInhInvld_Com_rHvbIsoMeasmt DINH_nrActvInhReas.FId_bInhInvld_Com_ratHvbSoc DINH_nrActvInhReas.FId_bInhInvld_Com_ratHvbSoh DINH_nrActvInhReas.FId_bInhInvld_Com_ratRHvbSoh DINH_nrActvInhReas.FId_bInhInvld_Com_ratSocLvBatt DINH_nrActvInhReas.FId_bInhInvld_Com_stAC DINH_nrActvInhReas.FId_bInhInvld_Com_stAlrtThermRunAwy DINH_nrActvInhReas.FId_bInhInvld_Com_stBlowrRly DINH_nrActvInhReas.FId_bInhInvld_Com_stDcdcFltLvl DINH_nrActvInhReas.FId_bInhInvld_Com_stEvapTFlt DINH_nrActvInhReas.FId_bInhInvld_Com_stGearLvrPos DINH_nrActvInhReas.FId_bInhInvld_Com_stHvacBlwrFront DINH_nrActvInhReas.FId_bInhInvld_Com_stHvacKnobPosn DINH_nrActvInhReas.FId_bInhInvld_Com_stHvacPanPotiFlt DINH_nrActvInhReas.FId_bInhInvld_Com_stHvbChrgn DINH_nrActvInhReas.FId_bInhInvld_Com_stHvbDiscnctReas DINH_nrActvInhReas.FId_bInhInvld_Com_stHvbIntlckRx DINH_nrActvInhReas.FId_bInhInvld_Com_stHvbIsoFltRx DINH_nrActvInhReas.FId_bInhInvld_Com_stHvbSrvPlgRx DINH_nrActvInhReas.FId_bInhInvld_Com_stIBattEBS DINH_nrActvInhReas.FId_bInhInvld_Com_stIIvtrFltLvl01 DINH_nrActvInhReas.FId_bInhInvld_Com_stMainWkuReq DINH_nrActvInhReas.FId_bInhInvld_Com_stReFogReq DINH_nrActvInhReas.FId_bInhInvld_Com_stSocRx DINH_nrActvInhReas.FId_bInhInvld_Com_stT DINH_nrActvInhReas.FId_bInhInvld_Com_tDcdcAct DINH_nrActvInhReas.FId_bInhInvld_Com_tDcdcInltCoolt DINH_nrActvInhReas.FId_bInhInvld_Com_tElCmprActl DINH_nrActvInhReas.FId_bInhInvld_Com_tEnvT DINH_nrActvInhReas.FId_bInhInvld_Com_tEvapT DINH_nrActvInhReas.FId_bInhInvld_Com_tHvbAct DINH_nrActvInhReas.FId_bInhInvld_Com_tHvbMax DINH_nrActvInhReas.FId_bInhInvld_Com_tLvBatt DINH_nrActvInhReas.FId_bInhInvld_Com_tiCurVehTmr DINH_nrActvInhReas.FId_bInhInvld_Com_tiHvbChrgnHalfRx DINH_nrActvInhReas.FId_bInhInvld_Com_uBattEBSRx DINH_nrActvInhReas.FId_bInhInvld_Com_uDcdcHvAct DINH_nrActvInhReas.FId_bInhInvld_Com_uDcdcLvAct DINH_nrActvInhReas.FId_bInhInvld_Com_uElCmprHvAct DINH_nrActvInhReas.FId_bInhInvld_Com_uHvbAct DINH_nrActvInhReas.FId_bInhInvld_Com_uHvbDcBus DINH_nrActvInhReas.FId_bInhInvld_Com_uHvbLimHi DINH_nrActvInhReas.FId_bInhInvld_Com_uHvbMaxCell DINH_nrActvInhReas.FId_bInhInvld_Com_uHvbMinCell DINH_nrActvInhReas.FId_bInhInvld_Com_uHvbNomChrgn DINH_nrActvInhReas.FId_bInhInvld_Com_vVeh DINH_nrActvInhReas.FId_bInh_ACCmpr_pwrLimMax DINH_nrActvInhReas.FId_bInh_ACCtl_flgCmprEna DINH_nrActvInhReas.FId_bInh_ACCtl_nCmprSpdReq DINH_nrActvInhReas.FId_bInh_APP_rInp DINH_nrActvInhReas.FId_bInh_BattId_numOrganNature1 DINH_nrActvInhReas.FId_bInh_BattId_numOrganNature2 DINH_nrActvInhReas.FId_bInh_BattId_numOrganRef1 DINH_nrActvInhReas.FId_bInh_BattId_numOrganRef2 DINH_nrActvInhReas.FId_bInh_BattId_numOrganRef3 DINH_nrActvInhReas.FId_bInh_BattId_numOrganRef4 DINH_nrActvInhReas.FId_bInh_BattId_numSerl1 DINH_nrActvInhReas.FId_bInh_BattId_numSerl2 DINH_nrActvInhReas.FId_bInh_BattId_numSerl3 DINH_nrActvInhReas.FId_bInh_BattId_numSerl4 DINH_nrActvInhReas.FId_bInh_BattId_numSerl5 DINH_nrActvInhReas.FId_bInh_BattId_numSerl6 DINH_nrActvInhReas.FId_bInh_BattId_numSerl7 DINH_nrActvInhReas.FId_bInh_Brk_stRed DINH_nrActvInhReas.FId_bInh_CbnHeatgHeatr_cntrRlyLf DINH_nrActvInhReas.FId_bInh_ChgrPlug_stPlgLockTx DINH_nrActvInhReas.FId_bInh_ChrgCntct_nrNegCntctElpdOper DINH_nrActvInhReas.FId_bInh_ChrgCntct_nrPosCntctElpdOper DINH_nrActvInhReas.FId_bInh_ChrgrRly_stRlyDes DINH_nrActvInhReas.FId_bInh_ChrgrVal_iChrgrDes DINH_nrActvInhReas.FId_bInh_ChrgrVal_iGridLimMax DINH_nrActvInhReas.FId_bInh_ChrgrVal_uHvMax DINH_nrActvInhReas.FId_bInh_CoDrvPITh_stEPSModeReq DINH_nrActvInhReas.FId_bInh_CoPtFH_stPwt DINH_nrActvInhReas.FId_bInh_ComChrg_stMod DINH_nrActvInhReas.FId_bInh_ComChrgr_stChrgnEna DINH_nrActvInhReas.FId_bInh_Com_25h_B1b0 DINH_nrActvInhReas.FId_bInh_Com_25h_B1b2 DINH_nrActvInhReas.FId_bInh_Com_25h_B1b4 DINH_nrActvInhReas.FId_bInh_Com_25h_B1b6 DINH_nrActvInhReas.FId_bInh_Com_HvbMaxSnsrTempTx DINH_nrActvInhReas.FId_bInh_Com_TogLedDrv DINH_nrActvInhReas.FId_bInh_Com_TogLedMod DINH_nrActvInhReas.FId_bInh_Com_TogLedNeut DINH_nrActvInhReas.FId_bInh_Com_TogLedRvs DINH_nrActvInhReas.FId_bInh_Com_bAcLedReq DINH_nrActvInhReas.FId_bInh_Com_bDiagMuxCAN DINH_nrActvInhReas.FId_bInh_Com_bGunCntInfoWkuReq DINH_nrActvInhReas.FId_bInh_Com_bHvBattRchrgWkuReq DINH_nrActvInhReas.FId_bInh_Com_bPostOperationWkuReq DINH_nrActvInhReas.FId_bInh_Com_bReFogRlySt DINH_nrActvInhReas.FId_bInh_Com_flgBlowrAuthn DINH_nrActvInhReas.FId_bInh_Com_flgBlowrRlyCtrl DINH_nrActvInhReas.FId_bInh_Com_flgBrkAlrt DINH_nrActvInhReas.FId_bInh_Com_flgDrvAwy DINH_nrActvInhReas.FId_bInh_Com_flgVehSpdQly DINH_nrActvInhReas.FId_bInh_Com_iHvbActTx DINH_nrActvInhReas.FId_bInh_Com_nElCmprActlTx DINH_nrActvInhReas.FId_bInh_Com_nIvtrMotAct01 DINH_nrActvInhReas.FId_bInh_Com_noEditCal DINH_nrActvInhReas.FId_bInh_Com_noEditSw DINH_nrActvInhReas.FId_bInh_Com_noVerSysDay DINH_nrActvInhReas.FId_bInh_Com_noVersAdp DINH_nrActvInhReas.FId_bInh_Com_noVersSw DINH_nrActvInhReas.FId_bInh_Com_noVersSys DINH_nrActvInhReas.FId_bInh_Com_noVersSysMnth DINH_nrActvInhReas.FId_bInh_Com_noVersSysYr DINH_nrActvInhReas.FId_bInh_Com_stACTx DINH_nrActvInhReas.FId_bInh_Com_stBrk DINH_nrActvInhReas.FId_bInh_Com_stBrkBstPFlt DINH_nrActvInhReas.FId_bInh_Com_stBrkCntctIndcn DINH_nrActvInhReas.FId_bInh_Com_stChrgPlg DINH_nrActvInhReas.FId_bInh_Com_stChrgPlgChrgn DINH_nrActvInhReas.FId_bInh_Com_stClstrStopIndcn DINH_nrActvInhReas.FId_bInh_Com_stCmdHvBattCntctr DINH_nrActvInhReas.FId_bInh_Com_stCmdOffsEM01 DINH_nrActvInhReas.FId_bInh_Com_stDrvAwyDi DINH_nrActvInhReas.FId_bInh_Com_stDrvModPosn DINH_nrActvInhReas.FId_bInh_Com_stEVLmp DINH_nrActvInhReas.FId_bInh_Com_stElCmprStatTx DINH_nrActvInhReas.FId_bInh_Com_stElMDesEem DINH_nrActvInhReas.FId_bInh_Com_stHvBattOperModDes DINH_nrActvInhReas.FId_bInh_Com_stHvacBlwrFront_CAN DINH_nrActvInhReas.FId_bInh_Com_stHvacKnobPosn_CAN DINH_nrActvInhReas.FId_bInh_Com_stMstWrnLmp DINH_nrActvInhReas.FId_bInh_Com_stNwCmdLIN DINH_nrActvInhReas.FId_bInh_Com_stPwrLimnLmp DINH_nrActvInhReas.FId_bInh_Com_stReFogReq_CAN DINH_nrActvInhReas.FId_bInh_Com_stSrvLmp DINH_nrActvInhReas.FId_bInh_Com_stVehCoorn DINH_nrActvInhReas.FId_bInh_Com_tqMotLimMax DINH_nrActvInhReas.FId_bInh_Com_uHvbActTx DINH_nrActvInhReas.FId_bInh_Com_valEepOffsEM01 DINH_nrActvInhReas.FId_bInh_DcChrgnRly_ctMaxOperCyc DINH_nrActvInhReas.FId_bInh_Dcdc_flgDesLvGridULim DINH_nrActvInhReas.FId_bInh_Dcdc_iLimLvGrid DINH_nrActvInhReas.FId_bInh_Dcdc_stDesDcdc DINH_nrActvInhReas.FId_bInh_Dcdc_uDesLvGrid DINH_nrActvInhReas.FId_bInh_DrvInfo_wTotTripEgy DINH_nrActvInhReas.FId_bInh_EChrDv_cntPlin DINH_nrActvInhReas.FId_bInh_Eem_flgFstHvShdwn DINH_nrActvInhReas.FId_bInh_ElM_stDesEem01 DINH_nrActvInhReas.FId_bInh_ElTS_egyTotChrgCyc DINH_nrActvInhReas.FId_bInh_ElTS_ratEmPowChrgn DINH_nrActvInhReas.FId_bInh_ElTS_ratEmPowDcha DINH_nrActvInhReas.FId_bInh_ElTS_stChrgCyc DINH_nrActvInhReas.FId_bInh_Emac_stIsoMonSwtReq DINH_nrActvInhReas.FId_bInh_Emac_tqDesCom01 DINH_nrActvInhReas.FId_bInh_Ext_bSyncGPC DINH_nrActvInhReas.FId_bInh_HvBatt_flgIsoMeasmtDiReq DINH_nrActvInhReas.FId_bInh_HvBatt_ratSoc DINH_nrActvInhReas.FId_bInh_HvGrid_pwrMaxDcdc DINH_nrActvInhReas.FId_bInh_HvacPtc_stElHeatr DINH_nrActvInhReas.FId_bInh_Pdu_CLUSTER_5E7_Frz DINH_nrActvInhReas.FId_bInh_Pdu_CLUSTER_5E7_Rcf DINH_nrActvInhReas.FId_bInh_Pdu_CONTEXTE_1_5B2_Frz DINH_nrActvInhReas.FId_bInh_Pdu_CONTEXTE_1_5B2_Rcf DINH_nrActvInhReas.FId_bInh_Pdu_DAT3_BSI_4F2h_Frz DINH_nrActvInhReas.FId_bInh_Pdu_DAT3_BSI_4F2h_Rcf DINH_nrActvInhReas.FId_bInh_Pdu_DCDC_283h_Frz DINH_nrActvInhReas.FId_bInh_Pdu_DCDC_283h_Rcf DINH_nrActvInhReas.FId_bInh_Pdu_DCDC_293h_Frz DINH_nrActvInhReas.FId_bInh_Pdu_DCDC_293h_Rcf DINH_nrActvInhReas.FId_bInh_Pdu_DCDC_473h_Frz DINH_nrActvInhReas.FId_bInh_Pdu_DCDC_473h_Rcf DINH_nrActvInhReas.FId_bInh_Pdu_DCDC_663h_Frz DINH_nrActvInhReas.FId_bInh_Pdu_DCDC_663h_Rcf DINH_nrActvInhReas.FId_bInh_Pdu_HS3_AUTO_GEARBOX_SWITCH_STATUS_Frz DINH_nrActvInhReas.FId_bInh_Pdu_HS3_AUTO_GEARBOX_SWITCH_STATUS_Rcf DINH_nrActvInhReas.FId_bInh_Pdu_HVAC_PANEL_26h_Frz DINH_nrActvInhReas.FId_bInh_Pdu_HVAC_PANEL_26h_Rcf DINH_nrActvInhReas.FId_bInh_Pdu_HVBAT_205h_Frz DINH_nrActvInhReas.FId_bInh_Pdu_HVBAT_205h_Rcf DINH_nrActvInhReas.FId_bInh_Pdu_HVBAT_275h_Frz DINH_nrActvInhReas.FId_bInh_Pdu_HVBAT_275h_Rcf DINH_nrActvInhReas.FId_bInh_Pdu_HVBAT_285h_Frz DINH_nrActvInhReas.FId_bInh_Pdu_HVBAT_285h_Rcf DINH_nrActvInhReas.FId_bInh_Pdu_HVBAT_325h_Frz DINH_nrActvInhReas.FId_bInh_Pdu_HVBAT_325h_Rcf DINH_nrActvInhReas.FId_bInh_Pdu_HVBAT_335h_Frz DINH_nrActvInhReas.FId_bInh_Pdu_HVBAT_335h_Rcf DINH_nrActvInhReas.FId_bInh_Pdu_HVBAT_455h_Frz DINH_nrActvInhReas.FId_bInh_Pdu_HVBAT_455h_Rcf DINH_nrActvInhReas.FId_bInh_Pdu_HVBAT_535_Frz DINH_nrActvInhReas.FId_bInh_Pdu_HVBAT_535_Rcf DINH_nrActvInhReas.FId_bInh_Pdu_HVBAT_595h_Frz DINH_nrActvInhReas.FId_bInh_Pdu_HVBAT_595h_Rcf DINH_nrActvInhReas.FId_bInh_Pdu_HVBAT_635h_Frz DINH_nrActvInhReas.FId_bInh_Pdu_HVBAT_635h_Rcf DINH_nrActvInhReas.FId_bInh_Pdu_HVBAT_645h_Frz DINH_nrActvInhReas.FId_bInh_Pdu_HVBAT_645h_Rcf DINH_nrActvInhReas.FId_bInh_Pdu_HVBAT_665h_Frz DINH_nrActvInhReas.FId_bInh_Pdu_HVBAT_665h_Rcf DINH_nrActvInhReas.FId_bInh_Pdu_HVBAT_675h_Frz DINH_nrActvInhReas.FId_bInh_Pdu_HVBAT_675h_Rcf DINH_nrActvInhReas.FId_bInh_Pdu_HVBAT_THERMAL_5B5_Frz DINH_nrActvInhReas.FId_bInh_Pdu_HVBAT_THERMAL_5B5_Rcf DINH_nrActvInhReas.FId_bInh_Pdu_HVBAT_VCU_435h_Frz DINH_nrActvInhReas.FId_bInh_Pdu_HVBAT_VCU_435h_Rcf DINH_nrActvInhReas.FId_bInh_Pdu_HVBAT_VCU_543_Frz DINH_nrActvInhReas.FId_bInh_Pdu_HVBAT_VCU_543_Rcf DINH_nrActvInhReas.FId_bInh_Pdu_HVBAT_VCU_583_Frz DINH_nrActvInhReas.FId_bInh_Pdu_HVBAT_VCU_583_Rcf DINH_nrActvInhReas.FId_bInh_Pdu_INV_217h_Frz DINH_nrActvInhReas.FId_bInh_Pdu_INV_217h_Rcf DINH_nrActvInhReas.FId_bInh_Pdu_INV_227h_Frz DINH_nrActvInhReas.FId_bInh_Pdu_INV_227h_Rcf DINH_nrActvInhReas.FId_bInh_Pdu_INV_237_Frz DINH_nrActvInhReas.FId_bInh_Pdu_INV_237_Rcf DINH_nrActvInhReas.FId_bInh_Pdu_INV_427h_Frz DINH_nrActvInhReas.FId_bInh_Pdu_INV_427h_Rcf DINH_nrActvInhReas.FId_bInh_Pdu_INV_497h_Frz DINH_nrActvInhReas.FId_bInh_Pdu_INV_497h_Rcf DINH_nrActvInhReas.FId_bInh_Pdu_INV_IMMO_5C7_Frz DINH_nrActvInhReas.FId_bInh_Pdu_INV_IMMO_5C7_Rcf DINH_nrActvInhReas.FId_bInh_Pdu_IS_DAT6_BSI_592h_Frz DINH_nrActvInhReas.FId_bInh_Pdu_IS_DAT6_BSI_592h_Rcf DINH_nrActvInhReas.FId_bInh_Pdu_IS_DAT_ABR_50Dh_Frz DINH_nrActvInhReas.FId_bInh_Pdu_IS_DAT_ABR_50Dh_Rcf DINH_nrActvInhReas.FId_bInh_Pdu_IS_DAT_BSI_412h_Frz DINH_nrActvInhReas.FId_bInh_Pdu_IS_DAT_BSI_412h_Rcf DINH_nrActvInhReas.FId_bInh_Pdu_IS_DYN_ABR_38Dh_Frz DINH_nrActvInhReas.FId_bInh_Pdu_IS_DYN_ABR_38Dh_Rcf DINH_nrActvInhReas.FId_bInh_Pdu_IS_INTE_ELECTRON_BSI_092h_Frz DINH_nrActvInhReas.FId_bInh_Pdu_IS_INTE_ELECTRON_BSI_092h_Rcf DINH_nrActvInhReas.FId_bInh_Pdu_OBC_273h_Frz DINH_nrActvInhReas.FId_bInh_Pdu_OBC_273h_Rcf DINH_nrActvInhReas.FId_bInh_Pdu_OBC_453h_Frz DINH_nrActvInhReas.FId_bInh_Pdu_OBC_453h_Rcf DINH_nrActvInhReas.FId_bInh_Pdu_OBC_463h_Frz DINH_nrActvInhReas.FId_bInh_Pdu_OBC_463h_Rcf DINH_nrActvInhReas.FId_bInh_Pdu_PDU_BusVoltages_308_Frz DINH_nrActvInhReas.FId_bInh_Pdu_PDU_BusVoltages_308_Rcf DINH_nrActvInhReas.FId_bInh_Pdu_PDU_Current_318_Frz DINH_nrActvInhReas.FId_bInh_Pdu_PDU_Current_318_Rcf DINH_nrActvInhReas.FId_bInh_Pdu_SC_INFO_BCCM_442h_Frz DINH_nrActvInhReas.FId_bInh_Pdu_SC_INFO_BCCM_442h_Rcf DINH_nrActvInhReas.FId_bInh_Pdu_VCU_AIRBAG_351h_Frz DINH_nrActvInhReas.FId_bInh_Pdu_VCU_AIRBAG_351h_Rcf DINH_nrActvInhReas.FId_bInh_Pdu_VCU_eBCCM_432h_Frz DINH_nrActvInhReas.FId_bInh_Pdu_VCU_eBCCM_432h_Rcf DINH_nrActvInhReas.FId_bInh_Pdu_VCU_eBCCM_552h_Frz DINH_nrActvInhReas.FId_bInh_Pdu_VCU_eBCCM_552h_Rcf DINH_nrActvInhReas.FId_bInh_Pdu_eBCCM_082h_Frz DINH_nrActvInhReas.FId_bInh_Pdu_eBCCM_082h_Rcf DINH_nrActvInhReas.FId_bInh_Pdu_eCOMP_Information_47B_Frz DINH_nrActvInhReas.FId_bInh_Pdu_eCOMP_Information_47B_Rcf DINH_nrActvInhReas.FId_bInh_Pdu_eCOMP_Information_48B_Frz DINH_nrActvInhReas.FId_bInh_Pdu_eCOMP_Information_48B_Rcf DINH_nrActvInhReas.FId_bInh_Sig205h_Com_iHvbActRx_Frz DINH_nrActvInhReas.FId_bInh_Sig205h_Com_iHvbActRx_Rcf DINH_nrActvInhReas.FId_bInh_Sig205h_Com_ratHvbSoc_Frz DINH_nrActvInhReas.FId_bInh_Sig205h_Com_ratHvbSoc_Rcf DINH_nrActvInhReas.FId_bInh_Sig205h_Com_stHvbChrgn_Frz DINH_nrActvInhReas.FId_bInh_Sig205h_Com_stHvbChrgn_Rcf DINH_nrActvInhReas.FId_bInh_Sig205h_Com_uHvbAct_Frz DINH_nrActvInhReas.FId_bInh_Sig205h_Com_uHvbAct_Rcf DINH_nrActvInhReas.FId_bInh_Sig217h_ComEmac_nAct01_Frz DINH_nrActvInhReas.FId_bInh_Sig217h_ComEmac_nAct01_Rcf DINH_nrActvInhReas.FId_bInh_Sig217h_ComEmac_tqAckd01_Frz DINH_nrActvInhReas.FId_bInh_Sig217h_ComEmac_tqAckd01_Rcf DINH_nrActvInhReas.FId_bInh_Sig217h_ComEmac_tqAct01_Frz DINH_nrActvInhReas.FId_bInh_Sig217h_ComEmac_tqAct01_Rcf DINH_nrActvInhReas.FId_bInh_Sig217h_ComEmac_uDcLnk01_Frz DINH_nrActvInhReas.FId_bInh_Sig217h_ComEmac_uDcLnk01_Rcf DINH_nrActvInhReas.FId_bInh_Sig227h_ComEmac_iDcLnk01_Frz DINH_nrActvInhReas.FId_bInh_Sig227h_ComEmac_iDcLnk01_Rcf DINH_nrActvInhReas.FId_bInh_Sig227h_ComEmac_pwrInstnsInpRx_Frz DINH_nrActvInhReas.FId_bInh_Sig227h_ComEmac_pwrInstnsInpRx_Rcf DINH_nrActvInhReas.FId_bInh_Sig227h_ComEmac_tqAbsltMax01_Frz DINH_nrActvInhReas.FId_bInh_Sig227h_ComEmac_tqAbsltMax01_Rcf DINH_nrActvInhReas.FId_bInh_Sig227h_ComEmac_tqAbsltMaxRx01_Frz DINH_nrActvInhReas.FId_bInh_Sig227h_ComEmac_tqAbsltMaxRx01_Rcf DINH_nrActvInhReas.FId_bInh_Sig227h_ComEmac_tqAbsltMin01_Frz DINH_nrActvInhReas.FId_bInh_Sig227h_ComEmac_tqAbsltMin01_Rcf DINH_nrActvInhReas.FId_bInh_Sig227h_ComEmac_tqAbsltMinRx01_Frz DINH_nrActvInhReas.FId_bInh_Sig227h_ComEmac_tqAbsltMinRx01_Rcf DINH_nrActvInhReas.FId_bInh_Sig237h_ComEmac_stActvDcha_Frz DINH_nrActvInhReas.FId_bInh_Sig237h_ComEmac_stActvDcha_Rcf DINH_nrActvInhReas.FId_bInh_Sig237h_ComEmac_stEVLmp_Frz DINH_nrActvInhReas.FId_bInh_Sig237h_ComEmac_stEVLmp_Rcf DINH_nrActvInhReas.FId_bInh_Sig237h_ComEmac_stMod01Rx_Frz DINH_nrActvInhReas.FId_bInh_Sig237h_ComEmac_stMod01Rx_Rcf DINH_nrActvInhReas.FId_bInh_Sig237h_ComEmac_stMstWrnLmp_Frz DINH_nrActvInhReas.FId_bInh_Sig237h_ComEmac_stMstWrnLmp_Rcf DINH_nrActvInhReas.FId_bInh_Sig237h_ComEmac_stSVSLmp_Frz DINH_nrActvInhReas.FId_bInh_Sig237h_ComEmac_stSVSLmp_Rcf DINH_nrActvInhReas.FId_bInh_Sig237h_ComEmac_tqStabnMin_Frz DINH_nrActvInhReas.FId_bInh_Sig237h_ComEmac_tqStabnMin_Rcf DINH_nrActvInhReas.FId_bInh_Sig237h_Com_stIIvtrFltLvl01_Frz DINH_nrActvInhReas.FId_bInh_Sig237h_Com_stIIvtrFltLvl01_Rcf DINH_nrActvInhReas.FId_bInh_Sig259h_Com_flgEcoNormReqRx_Frz DINH_nrActvInhReas.FId_bInh_Sig259h_Com_flgEcoNormReqRx_Rcf DINH_nrActvInhReas.FId_bInh_Sig259h_Com_stGearLvrPos_Frz DINH_nrActvInhReas.FId_bInh_Sig259h_Com_stGearLvrPos_Rcf DINH_nrActvInhReas.FId_bInh_Sig259h_Com_steTogFailrLvl_Frz DINH_nrActvInhReas.FId_bInh_Sig259h_Com_steTogFailrLvl_Rcf DINH_nrActvInhReas.FId_bInh_Sig26h_Com_stAC_Frz DINH_nrActvInhReas.FId_bInh_Sig26h_Com_stAC_Rcf DINH_nrActvInhReas.FId_bInh_Sig26h_Com_stEvapTFlt_Frz DINH_nrActvInhReas.FId_bInh_Sig26h_Com_stEvapTFlt_Rcf DINH_nrActvInhReas.FId_bInh_Sig26h_Com_stHvacBlwrFront_Frz DINH_nrActvInhReas.FId_bInh_Sig26h_Com_stHvacBlwrFront_Rcf DINH_nrActvInhReas.FId_bInh_Sig26h_Com_stHvacKnobPosn_Frz DINH_nrActvInhReas.FId_bInh_Sig26h_Com_stHvacKnobPosn_Rcf DINH_nrActvInhReas.FId_bInh_Sig26h_Com_stHvacPanPotiFlt_Frz DINH_nrActvInhReas.FId_bInh_Sig26h_Com_stHvacPanPotiFlt_Rcf DINH_nrActvInhReas.FId_bInh_Sig26h_Com_stReFogReq_Frz DINH_nrActvInhReas.FId_bInh_Sig26h_Com_stReFogReq_Rcf DINH_nrActvInhReas.FId_bInh_Sig26h_Com_tEvapT_Frz DINH_nrActvInhReas.FId_bInh_Sig26h_Com_tEvapT_Rcf DINH_nrActvInhReas.FId_bInh_Sig273h_ComChrgr_flgChrgrErrLvl_Frz DINH_nrActvInhReas.FId_bInh_Sig273h_ComChrgr_flgChrgrErrLvl_Rcf DINH_nrActvInhReas.FId_bInh_Sig273h_ComChrgr_pwrOutpCpby_Frz DINH_nrActvInhReas.FId_bInh_Sig273h_ComChrgr_pwrOutpCpby_Rcf DINH_nrActvInhReas.FId_bInh_Sig275h_Com_iHvbDchaMaxSho_Frz DINH_nrActvInhReas.FId_bInh_Sig275h_Com_iHvbDchaMaxSho_Rcf DINH_nrActvInhReas.FId_bInh_Sig275h_Com_pwrMaxDchaSho_Frz DINH_nrActvInhReas.FId_bInh_Sig275h_Com_pwrMaxDchaSho_Rcf DINH_nrActvInhReas.FId_bInh_Sig283h_Com_iDcdcHvActRvsn1_Frz DINH_nrActvInhReas.FId_bInh_Sig283h_Com_iDcdcHvActRvsn1_Rcf DINH_nrActvInhReas.FId_bInh_Sig283h_Com_iDcdcLvActRvsn1_Frz DINH_nrActvInhReas.FId_bInh_Sig283h_Com_iDcdcLvActRvsn1_Rcf DINH_nrActvInhReas.FId_bInh_Sig283h_Com_uDcdcHvAct_Frz DINH_nrActvInhReas.FId_bInh_Sig283h_Com_uDcdcHvAct_Rcf DINH_nrActvInhReas.FId_bInh_Sig283h_Com_uDcdcLvAct_Frz DINH_nrActvInhReas.FId_bInh_Sig283h_Com_uDcdcLvAct_Rcf DINH_nrActvInhReas.FId_bInh_Sig285h_Com_iHvbChrgMaxSho_Frz DINH_nrActvInhReas.FId_bInh_Sig285h_Com_iHvbChrgMaxSho_Rcf DINH_nrActvInhReas.FId_bInh_Sig285h_Com_pwrMaxChrgSho_Frz DINH_nrActvInhReas.FId_bInh_Sig285h_Com_pwrMaxChrgSho_Rcf DINH_nrActvInhReas.FId_bInh_Sig293h_Com_pwrDcdcOutpCpby_Frz DINH_nrActvInhReas.FId_bInh_Sig293h_Com_pwrDcdcOutpCpby_Rcf DINH_nrActvInhReas.FId_bInh_Sig293h_Com_stDcdcFltLvl_Frz DINH_nrActvInhReas.FId_bInh_Sig293h_Com_stDcdcFltLvl_Rcf DINH_nrActvInhReas.FId_bInh_Sig325h_Com_rHvbIsoMeasmt_Frz DINH_nrActvInhReas.FId_bInh_Sig325h_Com_rHvbIsoMeasmt_Rcf DINH_nrActvInhReas.FId_bInh_Sig325h_Com_stHvbIntlckRx_Frz DINH_nrActvInhReas.FId_bInh_Sig325h_Com_stHvbIntlckRx_Rcf DINH_nrActvInhReas.FId_bInh_Sig325h_Com_stHvbIsoFltRx_Frz DINH_nrActvInhReas.FId_bInh_Sig325h_Com_stHvbIsoFltRx_Rcf DINH_nrActvInhReas.FId_bInh_Sig325h_Com_stHvbSrvPlgRx_Frz DINH_nrActvInhReas.FId_bInh_Sig325h_Com_stHvbSrvPlgRx_Rcf DINH_nrActvInhReas.FId_bInh_Sig325h_Com_tHvbMax_Frz DINH_nrActvInhReas.FId_bInh_Sig325h_Com_tHvbMax_Rcf DINH_nrActvInhReas.FId_bInh_Sig335h_Com_iHvbDes_Frz DINH_nrActvInhReas.FId_bInh_Sig335h_Com_iHvbDes_Rcf DINH_nrActvInhReas.FId_bInh_Sig335h_Com_iHvbNomChrgn_Frz DINH_nrActvInhReas.FId_bInh_Sig335h_Com_iHvbNomChrgn_Rcf DINH_nrActvInhReas.FId_bInh_Sig335h_Com_uHvbDcBus_Frz DINH_nrActvInhReas.FId_bInh_Sig335h_Com_uHvbDcBus_Rcf DINH_nrActvInhReas.FId_bInh_Sig335h_Com_uHvbLimHi_Frz DINH_nrActvInhReas.FId_bInh_Sig335h_Com_uHvbLimHi_Rcf DINH_nrActvInhReas.FId_bInh_Sig38Dh_Com_flgVehSpdAvl_Frz DINH_nrActvInhReas.FId_bInh_Sig38Dh_Com_flgVehSpdAvl_Rcf DINH_nrActvInhReas.FId_bInh_Sig38Dh_Com_vVeh_Frz DINH_nrActvInhReas.FId_bInh_Sig38Dh_Com_vVeh_Rcf DINH_nrActvInhReas.FId_bInh_Sig427h_ComEmac_stIvtrOpMod01_Frz DINH_nrActvInhReas.FId_bInh_Sig427h_ComEmac_stIvtrOpMod01_Rcf DINH_nrActvInhReas.FId_bInh_Sig427h_ComEmac_tInvr01_Frz DINH_nrActvInhReas.FId_bInh_Sig427h_ComEmac_tInvr01_Rcf DINH_nrActvInhReas.FId_bInh_Sig427h_ComEmac_tIvtrCooltIn01_Frz DINH_nrActvInhReas.FId_bInh_Sig427h_ComEmac_tIvtrCooltIn01_Rcf DINH_nrActvInhReas.FId_bInh_Sig427h_ComEmac_tMac01_Frz DINH_nrActvInhReas.FId_bInh_Sig427h_ComEmac_tMac01_Rcf DINH_nrActvInhReas.FId_bInh_Sig427h_ComEmac_tqPtd01_Frz DINH_nrActvInhReas.FId_bInh_Sig427h_ComEmac_tqPtd01_Rcf DINH_nrActvInhReas.FId_bInh_Sig432h_Com_stMainWkuReq_Frz DINH_nrActvInhReas.FId_bInh_Sig432h_Com_stMainWkuReq_Rcf DINH_nrActvInhReas.FId_bInh_Sig435h_Com_HvbMaxSnsrTempRx_Frz DINH_nrActvInhReas.FId_bInh_Sig435h_Com_HvbMaxSnsrTempRx_Rcf DINH_nrActvInhReas.FId_bInh_Sig435h_Com_nrSerMaxCell_Frz DINH_nrActvInhReas.FId_bInh_Sig435h_Com_nrSerMaxCell_Rcf DINH_nrActvInhReas.FId_bInh_Sig435h_Com_nrSerMinCell_Frz DINH_nrActvInhReas.FId_bInh_Sig435h_Com_nrSerMinCell_Rcf DINH_nrActvInhReas.FId_bInh_Sig435h_Com_uHvbMaxCell_Frz DINH_nrActvInhReas.FId_bInh_Sig435h_Com_uHvbMaxCell_Rcf DINH_nrActvInhReas.FId_bInh_Sig435h_Com_uHvbMinCell_Frz DINH_nrActvInhReas.FId_bInh_Sig435h_Com_uHvbMinCell_Rcf DINH_nrActvInhReas.FId_bInh_Sig442h_Com_stBlowrRly_Frz DINH_nrActvInhReas.FId_bInh_Sig442h_Com_stBlowrRly_Rcf DINH_nrActvInhReas.FId_bInh_Sig453h_ComChrgr_iAcMax_Frz DINH_nrActvInhReas.FId_bInh_Sig453h_ComChrgr_iAcMax_Rcf DINH_nrActvInhReas.FId_bInh_Sig453h_ComChrgr_pwrInAct_Frz DINH_nrActvInhReas.FId_bInh_Sig453h_ComChrgr_pwrInAct_Rcf DINH_nrActvInhReas.FId_bInh_Sig453h_ComChrgr_uAcActL1_Frz DINH_nrActvInhReas.FId_bInh_Sig453h_ComChrgr_uAcActL1_Rcf DINH_nrActvInhReas.FId_bInh_Sig455h_Com_uHvbNomChrgn_Frz DINH_nrActvInhReas.FId_bInh_Sig455h_Com_uHvbNomChrgn_Rcf DINH_nrActvInhReas.FId_bInh_Sig463h_ComChrgr_iDcHvAct_Frz DINH_nrActvInhReas.FId_bInh_Sig463h_ComChrgr_iDcHvAct_Rcf DINH_nrActvInhReas.FId_bInh_Sig463h_ComChrgr_tChrgrMaxAct_Frz DINH_nrActvInhReas.FId_bInh_Sig463h_ComChrgr_tChrgrMaxAct_Rcf DINH_nrActvInhReas.FId_bInh_Sig463h_ComChrgr_uDcHvAct_Frz DINH_nrActvInhReas.FId_bInh_Sig463h_ComChrgr_uDcHvAct_Rcf DINH_nrActvInhReas.FId_bInh_Sig473h_Com_tDcdcAct_Frz DINH_nrActvInhReas.FId_bInh_Sig473h_Com_tDcdcAct_Rcf DINH_nrActvInhReas.FId_bInh_Sig473h_Com_tDcdcInltCoolt_Frz DINH_nrActvInhReas.FId_bInh_Sig473h_Com_tDcdcInltCoolt_Rcf DINH_nrActvInhReas.FId_bInh_Sig47Bh_Com_iElCmprHvAct_Frz DINH_nrActvInhReas.FId_bInh_Sig47Bh_Com_iElCmprHvAct_Rcf DINH_nrActvInhReas.FId_bInh_Sig47Bh_Com_iElCmprPeakPha_Frz DINH_nrActvInhReas.FId_bInh_Sig47Bh_Com_iElCmprPeakPha_Rcf DINH_nrActvInhReas.FId_bInh_Sig47Bh_Com_nElCmprActl_Frz DINH_nrActvInhReas.FId_bInh_Sig47Bh_Com_nElCmprActl_Rcf DINH_nrActvInhReas.FId_bInh_Sig47Bh_Com_pwrElCmprActl_Frz DINH_nrActvInhReas.FId_bInh_Sig47Bh_Com_pwrElCmprActl_Rcf DINH_nrActvInhReas.FId_bInh_Sig47Bh_Com_tElCmprActl_Frz DINH_nrActvInhReas.FId_bInh_Sig47Bh_Com_tElCmprActl_Rcf DINH_nrActvInhReas.FId_bInh_Sig47Bh_Com_uElCmprHvAct_Frz DINH_nrActvInhReas.FId_bInh_Sig47Bh_Com_uElCmprHvAct_Rcf DINH_nrActvInhReas.FId_bInh_Sig48Bh_Com_stElCmprFltLvl_Frz DINH_nrActvInhReas.FId_bInh_Sig48Bh_Com_stElCmprFltLvl_Rcf DINH_nrActvInhReas.FId_bInh_Sig4F2h_Com_ratSocLvBatt_Frz DINH_nrActvInhReas.FId_bInh_Sig4F2h_Com_ratSocLvBatt_Rcf DINH_nrActvInhReas.FId_bInh_Sig4F2h_Com_stSocRx_Frz DINH_nrActvInhReas.FId_bInh_Sig4F2h_Com_stSocRx_Rcf DINH_nrActvInhReas.FId_bInh_Sig4F2h_Com_stT_Frz DINH_nrActvInhReas.FId_bInh_Sig4F2h_Com_stT_Rcf DINH_nrActvInhReas.FId_bInh_Sig535h_Com_tHvbAct_Frz DINH_nrActvInhReas.FId_bInh_Sig535h_Com_tHvbAct_Rcf DINH_nrActvInhReas.FId_bInh_Sig543h_Com_egyHvbAvl_fRx_Frz DINH_nrActvInhReas.FId_bInh_Sig543h_Com_egyHvbAvl_fRx_Rcf DINH_nrActvInhReas.FId_bInh_Sig543h_Com_ratHvbSoh_Frz DINH_nrActvInhReas.FId_bInh_Sig543h_Com_ratHvbSoh_Rcf DINH_nrActvInhReas.FId_bInh_Sig543h_Com_ratRHvbSoh_Frz DINH_nrActvInhReas.FId_bInh_Sig543h_Com_ratRHvbSoh_Rcf DINH_nrActvInhReas.FId_bInh_Sig552h_Com_lDstGlbDa_Frz DINH_nrActvInhReas.FId_bInh_Sig552h_Com_lDstGlbDa_Rcf DINH_nrActvInhReas.FId_bInh_Sig552h_Com_lTotOdometer_Frz DINH_nrActvInhReas.FId_bInh_Sig552h_Com_lTotOdometer_Rcf DINH_nrActvInhReas.FId_bInh_Sig552h_Com_tiCurVehTmr_Frz DINH_nrActvInhReas.FId_bInh_Sig552h_Com_tiCurVehTmr_Rcf DINH_nrActvInhReas.FId_bInh_Sig583h_Com_stHvbDiscnctReas_Frz DINH_nrActvInhReas.FId_bInh_Sig583h_Com_stHvbDiscnctReas_Rcf DINH_nrActvInhReas.FId_bInh_Sig592h_Com_iBattEBS1Rx_Frz DINH_nrActvInhReas.FId_bInh_Sig592h_Com_iBattEBS1Rx_Rcf DINH_nrActvInhReas.FId_bInh_Sig592h_Com_iBattEBS2Rx_Frz DINH_nrActvInhReas.FId_bInh_Sig592h_Com_iBattEBS2Rx_Rcf DINH_nrActvInhReas.FId_bInh_Sig592h_Com_iBattEBS3Rx_Frz DINH_nrActvInhReas.FId_bInh_Sig592h_Com_iBattEBS3Rx_Rcf DINH_nrActvInhReas.FId_bInh_Sig592h_Com_stIBattEBS_Frz DINH_nrActvInhReas.FId_bInh_Sig592h_Com_stIBattEBS_Rcf DINH_nrActvInhReas.FId_bInh_Sig592h_Com_tLvBatt_Frz DINH_nrActvInhReas.FId_bInh_Sig592h_Com_tLvBatt_Rcf DINH_nrActvInhReas.FId_bInh_Sig592h_Com_uBattEBSRx_Frz DINH_nrActvInhReas.FId_bInh_Sig592h_Com_uBattEBSRx_Rcf DINH_nrActvInhReas.FId_bInh_Sig595h_Com_tiHvbChrgnHalfRx_Frz DINH_nrActvInhReas.FId_bInh_Sig595h_Com_tiHvbChrgnHalfRx_Rcf DINH_nrActvInhReas.FId_bInh_Sig5B2h_Com_tEnvT_Frz DINH_nrActvInhReas.FId_bInh_Sig5B2h_Com_tEnvT_Rcf DINH_nrActvInhReas.FId_bInh_Sig5B5h_Com_stAlrtThermRunAwy_Frz DINH_nrActvInhReas.FId_bInh_Sig5B5h_Com_stAlrtThermRunAwy_Rcf DINH_nrActvInhReas.FId_bInh_Sig635h_Com_ctHvbNegCntctrSeg1_Frz DINH_nrActvInhReas.FId_bInh_Sig635h_Com_ctHvbNegCntctrSeg1_Rcf DINH_nrActvInhReas.FId_bInh_Sig635h_Com_ctHvbNegCntctrSeg3_Frz DINH_nrActvInhReas.FId_bInh_Sig635h_Com_ctHvbNegCntctrSeg3_Rcf DINH_nrActvInhReas.FId_bInh_Sig635h_Com_ctHvbNegCntctrSeg4_Frz DINH_nrActvInhReas.FId_bInh_Sig635h_Com_ctHvbNegCntctrSeg4_Rcf DINH_nrActvInhReas.FId_bInh_Sig635h_Com_ctHvbPosCntctrSeg1_Frz DINH_nrActvInhReas.FId_bInh_Sig635h_Com_ctHvbPosCntctrSeg1_Rcf DINH_nrActvInhReas.FId_bInh_Sig635h_Com_ctHvbPosCntctrSeg3_Frz DINH_nrActvInhReas.FId_bInh_Sig635h_Com_ctHvbPosCntctrSeg3_Rcf DINH_nrActvInhReas.FId_bInh_Sig635h_Com_ctHvbPosCntctrSeg4_Frz DINH_nrActvInhReas.FId_bInh_Sig635h_Com_ctHvbPosCntctrSeg4_Rcf DINH_nrActvInhReas.FId_bInh_Sig645h_Com_ctHvbPrecCntctrSeg1_Frz DINH_nrActvInhReas.FId_bInh_Sig645h_Com_ctHvbPrecCntctrSeg1_Rcf DINH_nrActvInhReas.FId_bInh_Sig645h_Com_ctHvbPrecCntctrSeg2_Frz DINH_nrActvInhReas.FId_bInh_Sig645h_Com_ctHvbPrecCntctrSeg2_Rcf DINH_nrActvInhReas.FId_bInh_Sig675h_Com_qHvbTotCpRx_Frz DINH_nrActvInhReas.FId_bInh_Sig675h_Com_qHvbTotCpRx_Rcf DINH_nrActvInhReas.FId_bInh_ThermHvac_stRemPrecndn DINH_nrActvInhReas.FId_bInh_VehCoorn_dstRngPrdcDispTx DINH_nrActvInhReas.FId_bInh_VehCoorn_wCnsTotWghtAvrgEffTripA DINH_nrActvInhReas.FId_bInh_VehCoorn_wCnsTotWghtAvrgEffTripB DINH_nrActvInhReas.FId_bInh_VehCoorn_wCnsTotWghtAvrgEffTx DINH_nrActvInhReas.FId_bInh_VehCoorn_wCnsTotWghtTripAvrgEffTx DINH_nrActvInhReas.FId_bInh_VehCoorn_wCnsWghtAvrgEffTripA DINH_nrActvInhReas.FId_bInh_VehCoorn_wCnsWghtAvrgEffTripB DINH_stFId.FId_bInhDiag_CLUSTER_5E7 DINH_stFId.FId_bInhDiag_CONTEXTE_1_5B2 DINH_stFId.FId_bInhDiag_DAT3_BSI_4F2h DINH_stFId.FId_bInhDiag_DCDC_283h DINH_stFId.FId_bInhDiag_DCDC_293h /end OUT_MEASUREMENT
 FUNCTION_VERSION "850.8.0" /end FUNCTION
/begin COMPU_METHOD DFC_OneToOne "" RAT_FUNC "%6.2" "-" COEFFS 0 1 0 0 0 1 /end COMPU_METHOD
/begin COMPU_METHOD DINH_ct_Compu "" RAT_FUNC "%6.0" "" COEFFS 0 -1 4096 0 0 1 /end COMPU_METHOD
/end MODULE
/end PROJECT

ASAP2_VERSION 1 70
/begin PROJECT MDG1C "VC1CP091_STLA_N_D061I3"
/begin HEADER "" VERSION "VC1CP091_STLA_N_D061I3" PROJECT_NO MDG1C /end HEADER
/begin MODULE DIM ""
/begin MOD_COMMON "" BYTE_ORDER MSB_LAST ALIGNMENT_BYTE 1 ALIGNMENT_WORD 2 ALIGNMENT_LONG 4 ALIGNMENT_INT64 4 ALIGNMENT_FLOAT32_IEEE 4 ALIGNMENT_FLOAT64_IEEE 4 DATA_SIZE 32 /end MOD_COMMON
/begin CHARACTERISTIC ACCtl_nCmprReq_C "Minimum compressor speed for turning on the compressor power" VALUE 0x80251F68 RB_Val_Wu16 65535.00 q1_DIV_min 0.00 65535.00 FORMAT "%8.2" /end CHARACTERISTIC
/begin CHARACTERISTIC Com_ACTPduCtrlByps_C "bypass calibration to test ACT requirement" VALUE 0x8024E708 Val_Wu8 255.0 OneToOne 0.00 255.0 FORMAT "%5.1" /end CHARACTERISTIC
/begin CHARACTERISTIC Com_GlbDaPduCtrlByps_C "calibrationused for testing purpose" VALUE 0x8024E709 Val_Wu8 255.0 OneToOne 0.00 255.0 FORMAT "%5.1" /end CHARACTERISTIC
/begin CHARACTERISTIC Com_swVerFrmByps_C "calibration used to test version frame" VALUE 0x8024E70A Val_Wu8 255.0 OneToOne 0.00 255.0 FORMAT "%5.1" /end CHARACTERISTIC
/begin CHARACTERISTIC DDRC_DurDeb.UCtP_tiSRCMinDebOk_C "" VALUE 0x802409BC Val_Wu16 655350.0 DDRCTime_ms 0.00 655350.0 FORMAT "%8.1" /end CHARACTERISTIC
/begin CHARACTERISTIC DDRC_DurDeb.UCtP_tiSRCMinDebDef_C "" VALUE 0x802409BE Val_Wu16 655350.0 DDRCTime_ms 0.00 655350.0 FORMAT "%8.1" /end CHARACTERISTIC
/begin CHARACTERISTIC DDRC_DurDeb.UPxP1_tiSRCMinDebOk_C "" VALUE 0x802409C0 Val_Wu16 655350.0 DDRCTime_ms 0.00 655350.0 FORMAT "%8.1" /end CHARACTERISTIC
/begin CHARACTERISTIC DDRC_DurDeb.UPxP1_tiSRCMinDebDef_C "" VALUE 0x802409C2 Val_Wu16 655350.0 DDRCTime_ms 0.00 655350.0 FORMAT "%8.1" /end CHARACTERISTIC
/begin CHARACTERISTIC DDRC_DurDeb.UCtP_tiPhysRngHiDebOk_C "" VALUE 0x80240AA8 Val_Wu16 655350.0 DDRCTime_ms 0.00 655350.0 FORMAT "%8.1" /end CHARACTERISTIC
/begin CHARACTERISTIC DDRC_DurDeb.UCtP_tiPhysRngHiDebDef_C "" VALUE 0x80240AAA Val_Wu16 655350.0 DDRCTime_ms 0.00 655350.0 FORMAT "%8.1" /end CHARACTERISTIC
/begin CHARACTERISTIC DDRC_DurDeb.UCtP_tiPhysRngLoDebOk_C "" VALUE 0x80240AAC Val_Wu16 655350.0 DDRCTime_ms 0.00 655350.0 FORMAT "%8.1" /end CHARACTERISTIC
/begin CHARACTERISTIC DDRC_DurDeb.UCtP_tiPhysRngLoDebDef_C "" VALUE 0x80240AAE Val_Wu16 655350.0 DDRCTime_ms 0.00 655350.0 FORMAT "%8.1" /end CHARACTERISTIC
/begin CHARACTERISTIC DDRC_DurDeb.UCtP_tiSRCOpnDebOk_C "" VALUE 0x80240AB0 Val_Wu16 655350.0 DDRCTime_ms 0.00 655350.0 FORMAT "%8.1" /end CHARACTERISTIC
/begin CHARACTERISTIC DDRC_DurDeb.UCtP_tiSRCOpnDebDef_C "" VALUE 0x80240AB2 Val_Wu16 655350.0 DDRCTime_ms 0.00 655350.0 FORMAT "%8.1" /end CHARACTERISTIC
/begin CHARACTERISTIC DDRC_DurDeb.UPxP1_tiPhysRngHiDebOk_C "" VALUE 0x80240AB4 Val_Wu16 655350.0 DDRCTime_ms 0.00 655350.0 FORMAT "%8.1" /end CHARACTERISTIC
/begin CHARACTERISTIC DDRC_DurDeb.UPxP1_tiPhysRngHiDebDef_C "" VALUE 0x80240AB6 Val_Wu16 655350.0 DDRCTime_ms 0.00 655350.0 FORMAT "%8.1" /end CHARACTERISTIC
/begin CHARACTERISTIC DDRC_DurDeb.UPxP1_tiPhysRngLoDebOk_C "" VALUE 0x80240AB8 Val_Wu16 655350.0 DDRCTime_ms 0.00 655350.0 FORMAT "%8.1" /end CHARACTERISTIC
/begin CHARACTERISTIC DDRC_DurDeb.UPxP1_tiPhysRngLoDebDef_C "" VALUE 0x80240ABA Val_Wu16 655350.0 DDRCTime_ms 0.00 655350.0 FORMAT "%8.1" /end CHARACTERISTIC
/begin CHARACTERISTIC DDRC_DurDeb.UPxP1_tiSRCOpnDebOk_C "" VALUE 0x80240ABC Val_Wu16 655350.0 DDRCTime_ms 0.00 655350.0 FORMAT "%8.1" /end CHARACTERISTIC
/begin CHARACTERISTIC DDRC_DurDeb.UPxP1_tiSRCOpnDebDef_C "" VALUE 0x80240ABE Val_Wu16 655350.0 DDRCTime_ms 0.00 655350.0 FORMAT "%8.1" /end CHARACTERISTIC
/begin CHARACTERISTIC DDRC_RatDeb.UCtP_tiSRCMinUDRat_C "" VALUE 0x80248A73 Val_Wu8 3.00000000000 DDRC_Ratio 1.00000000000 4.00000000000 FORMAT "%13.11" /end CHARACTERISTIC
/begin CHARACTERISTIC DDRC_RatDeb.UPxP1_tiSRCMinUDRat_C "" VALUE 0x80248A74 Val_Wu8 3.00000000000 DDRC_Ratio 1.00000000000 4.00000000000 FORMAT "%13.11" /end CHARACTERISTIC
/begin CHARACTERISTIC DDRC_RatDeb.UCtP_tiPhysRngHiUDRat_C "" VALUE 0x80248AAE Val_Wu8 3.00000000000 DDRC_Ratio 1.00000000000 4.00000000000 FORMAT "%13.11" /end CHARACTERISTIC
/begin CHARACTERISTIC DDRC_RatDeb.UCtP_tiPhysRngLoUDRat_C "" VALUE 0x80248AAF Val_Wu8 3.00000000000 DDRC_Ratio 1.00000000000 4.00000000000 FORMAT "%13.11" /end CHARACTERISTIC
/begin CHARACTERISTIC DDRC_RatDeb.UCtP_tiSRCOpnUDRat_C "" VALUE 0x80248AB0 Val_Wu8 3.00000000000 DDRC_Ratio 1.00000000000 4.00000000000 FORMAT "%13.11" /end CHARACTERISTIC
/begin CHARACTERISTIC DDRC_RatDeb.UPxP1_tiPhysRngHiUDRat_C "" VALUE 0x80248AB1 Val_Wu8 3.00000000000 DDRC_Ratio 1.00000000000 4.00000000000 FORMAT "%13.11" /end CHARACTERISTIC
/begin CHARACTERISTIC DDRC_RatDeb.UPxP1_tiPhysRngLoUDRat_C "" VALUE 0x80248AB2 Val_Wu8 3.00000000000 DDRC_Ratio 1.00000000000 4.00000000000 FORMAT "%13.11" /end CHARACTERISTIC
/begin CHARACTERISTIC DDRC_RatDeb.UPxP1_tiSRCOpnUDRat_C "" VALUE 0x80248AB3 Val_Wu8 3.00000000000 DDRC_Ratio 1.00000000000 4.00000000000 FORMAT "%13.11" /end CHARACTERISTIC
/begin CHARACTERISTIC DFC_CtlMsk2.DFC_UCtPSRCMin_C "" VALUE 0x8024152C Val_Wu8 255.0 DFES_OneToOne 0.00 255.0 FORMAT "%5.1" /end CHARACTERISTIC
/begin CHARACTERISTIC DFC_CtlMsk2.DFC_UPxP1SRCMin_C "" VALUE 0x8024152D Val_Wu8 255.0 DFES_OneToOne 0.00 255.0 FORMAT "%5.1" /end CHARACTERISTIC
/begin CHARACTERISTIC DFC_CtlMsk2.DFC_UCtPPhysRngHi_C "" VALUE 0x80241567 Val_Wu8 255.0 DFES_OneToOne 0.00 255.0 FORMAT "%5.1" /end CHARACTERISTIC
/begin CHARACTERISTIC DFC_CtlMsk2.DFC_UCtPPhysRngLo_C "" VALUE 0x80241568 Val_Wu8 255.0 DFES_OneToOne 0.00 255.0 FORMAT "%5.1" /end CHARACTERISTIC
/begin CHARACTERISTIC DFC_CtlMsk2.DFC_UCtPSRCOpn_C "" VALUE 0x80241569 Val_Wu8 255.0 DFES_OneToOne 0.00 255.0 FORMAT "%5.1" /end CHARACTERISTIC
/begin CHARACTERISTIC DFC_CtlMsk2.DFC_UPxP1PhysRngHi_C "" VALUE 0x8024156A Val_Wu8 255.0 DFES_OneToOne 0.00 255.0 FORMAT "%5.1" /end CHARACTERISTIC
/begin CHARACTERISTIC DFC_CtlMsk2.DFC_UPxP1PhysRngLo_C "" VALUE 0x8024156B Val_Wu8 255.0 DFES_OneToOne 0.00 255.0 FORMAT "%5.1" /end CHARACTERISTIC
/begin CHARACTERISTIC DFC_CtlMsk2.DFC_UPxP1SRCOpn_C "" VALUE 0x8024156C Val_Wu8 255.0 DFES_OneToOne 0.00 255.0 FORMAT "%5.1" /end CHARACTERISTIC
/begin CHARACTERISTIC DFC_CtlMsk2.DFC_UCtPSRCMax_C "" VALUE 0x802416AC Val_Wu8 255.0 DFES_OneToOne 0.00 255.0 FORMAT "%5.1" /end CHARACTERISTIC
/begin CHARACTERISTIC DFC_CtlMsk2.DFC_UCtPTmpErr_C "" VALUE 0x802416AD Val_Wu8 255.0 DFES_OneToOne 0.00 255.0 FORMAT "%5.1" /end CHARACTERISTIC
/begin CHARACTERISTIC DFC_CtlMsk2.DFC_UPxP1SRCMax_C "" VALUE 0x802416AE Val_Wu8 255.0 DFES_OneToOne 0.00 255.0 FORMAT "%5.1" /end CHARACTERISTIC
/begin CHARACTERISTIC DFC_CtlMsk2.DFC_UPxP1TmpErr_C "" VALUE 0x802416AF Val_Wu8 255.0 DFES_OneToOne 0.00 255.0 FORMAT "%5.1" /end CHARACTERISTIC
/begin CHARACTERISTIC DFC_DisblMsk2.DFC_UCtPSRCMin_C "" VALUE 0x80248F3E Val_Wu16 65535.00 DFES_OneToOne 0.00 65535.00 FORMAT "%8.2" /end CHARACTERISTIC
/begin CHARACTERISTIC DFC_DisblMsk2.DFC_UPxP1SRCMin_C "" VALUE 0x80248F40 Val_Wu16 65535.00 DFES_OneToOne 0.00 65535.00 FORMAT "%8.2" /end CHARACTERISTIC
/begin CHARACTERISTIC DFC_DisblMsk2.DFC_UCtPPhysRngHi_C "" VALUE 0x80248FB4 Val_Wu16 65535.00 DFES_OneToOne 0.00 65535.00 FORMAT "%8.2" /end CHARACTERISTIC
/begin CHARACTERISTIC DFC_DisblMsk2.DFC_UCtPPhysRngLo_C "" VALUE 0x80248FB6 Val_Wu16 65535.00 DFES_OneToOne 0.00 65535.00 FORMAT "%8.2" /end CHARACTERISTIC
/begin CHARACTERISTIC DFC_DisblMsk2.DFC_UCtPSRCOpn_C "" VALUE 0x80248FB8 Val_Wu16 65535.00 DFES_OneToOne 0.00 65535.00 FORMAT "%8.2" /end CHARACTERISTIC
/begin CHARACTERISTIC DFC_DisblMsk2.DFC_UPxP1PhysRngHi_C "" VALUE 0x80248FBA Val_Wu16 65535.00 DFES_OneToOne 0.00 65535.00 FORMAT "%8.2" /end CHARACTERISTIC
/begin CHARACTERISTIC DFC_DisblMsk2.DFC_UPxP1PhysRngLo_C "" VALUE 0x80248FBC Val_Wu16 65535.00 DFES_OneToOne 0.00 65535.00 FORMAT "%8.2" /end CHARACTERISTIC
/begin CHARACTERISTIC DFC_DisblMsk2.DFC_UPxP1SRCOpn_C "" VALUE 0x80248FBE Val_Wu16 65535.00 DFES_OneToOne 0.00 65535.00 FORMAT "%8.2" /end CHARACTERISTIC
/begin CHARACTERISTIC DFC_DisblMsk2.DFC_UCtPSRCMax_C "" VALUE 0x8024923E Val_Wu16 65535.00 DFES_OneToOne 0.00 65535.00 FORMAT "%8.2" /end CHARACTERISTIC
/begin CHARACTERISTIC DFC_DisblMsk2.DFC_UCtPTmpErr_C "" VALUE 0x80249240 Val_Wu16 65535.00 DFES_OneToOne 0.00 65535.00 FORMAT "%8.2" /end CHARACTERISTIC
/begin CHARACTERISTIC DFC_DisblMsk2.DFC_UPxP1SRCMax_C "" VALUE 0x80249242 Val_Wu16 65535.00 DFES_OneToOne 0.00 65535.00 FORMAT "%8.2" /end CHARACTERISTIC
/begin CHARACTERISTIC DFC_DisblMsk2.DFC_UPxP1TmpErr_C "" VALUE 0x80249244 Val_Wu16 65535.00 DFES_OneToOne 0.00 65535.00 FORMAT "%8.2" /end CHARACTERISTIC
/begin CHARACTERISTIC ThermMod_ratSocFild_C "Minimum LV battery SOC level that request after run completion" VALUE 0x802520A4 RB_Val_Wu8 255.0 rel_q1 0.00 255.0 FORMAT "%5.1" /end CHARACTERISTIC
/begin CHARACTERISTIC ThermMod_tiAftRunMax_C "Maximum duration of EV-cooling afterrun" VALUE 0x802520A8 RB_Val_Ws32 42949672.9500 Time_s -21474836.4800 21474836.4700 FORMAT "%13.4" /end CHARACTERISTIC
/begin CHARACTERISTIC ThermMod_tiARTurnOffProlg_C "Prolong time after afterrun is complete (for shut down of the components)" VALUE 0x802520AC RB_Val_Ws16 655.3500 Time_s -327.6800 327.6700 FORMAT "%8.4" /end CHARACTERISTIC
/begin CHARACTERISTIC ThermMod_tiHvShdwnDly_C "Maximum time to cool componentd after HV disconnect" VALUE 0x802520AE RB_Val_Ws16 655.3500 Time_s -327.6800 327.6700 FORMAT "%8.4" /end CHARACTERISTIC
/begin CHARACTERISTIC ThermMod_tiStrtDly_C "Delay time for start of thermal contol after VCU start-up" VALUE 0x802520B0 RB_Val_Ws16 655.3500 Time_s -327.6800 327.6700 FORMAT "%8.4" /end CHARACTERISTIC
/begin CHARACTERISTIC ThermMod_uBattFild_C "Minimum LV battery voltage level that request after run completion" VALUE 0x802520B2 RB_Val_Ws16 63999.02 U_mV_q0p9765625_COMPU -32000.00 31999.02 FORMAT "%8.2" /end CHARACTERISTIC
/begin CHARACTERISTIC ThermMod_uBattMeasd_C "Measured battery voltage level that request after run completion" VALUE 0x802520B4 RB_Val_Ws16 1310700. Volt_Batt -655360.0 655340.0 FORMAT "%8.1" /end CHARACTERISTIC
/begin CHARACTERISTIC ThermPlinChrgr_flgAftRunEnad_C "Flag to activate afterrun prolongation" VALUE 0x802520B8 RB_Val_Wu8 1.00000000000 B_TRUE 0.00 1.00000000000 FORMAT "%13.11" /end CHARACTERISTIC
/begin CHARACTERISTIC ThermPlinChrgr_pwrChrgrInit_C "Charger power filter initialization value" VALUE 0x802520BA RB_Val_Ws16 1638375. RBPtCel_pwr_25p0_1 -819200.0 819175.0 FORMAT "%8.1" /end CHARACTERISTIC
/begin CHARACTERISTIC ThermPlinChrgr_pwrOutMax_C "Charger power above which the module requests additional cooling flow" VALUE 0x802520BC RB_Val_Ws16 1638375. RBPtCel_pwr_25p0_1 -819200.0 819175.0 FORMAT "%8.1" /end CHARACTERISTIC
/begin CHARACTERISTIC ThermPlinChrgr_ratMinReq_C "Additional cooling flow request if the charger power is greater than a threshold" VALUE 0x802520BE RB_Val_Ws8 255.0 RBPtCel_Perc_1p0_1 -128.0 127.0 FORMAT "%5.1" /end CHARACTERISTIC
/begin CHARACTERISTIC ThermPlinChrgr_ratPmpTReq_T "Curve to detection pump ratio based on charger temperature" CURVE 0x802520C0 RB_Curve_S16_S8_sao 255.0 RBPtCel_Perc_1p0_1 -128.0 127.0 FORMAT "%5.1"
 /begin AXIS_DESCR STD_AXIS ChrgrVal_tFild RBPtCel_t_0p02_1 5 -655.3600 655.3400 FORMAT "%8.4" DEPOSIT ABSOLUTE /end AXIS_DESCR
/end CHARACTERISTIC
/begin CHARACTERISTIC ThermPlinChrgr_tAftRunReq_C "Minimum temperature required to request afterun prolongation" VALUE 0x802520D2 RB_Val_Ws16 1310.700 RBPtCel_t_0p02_1 -655.3600 655.3400 FORMAT "%8.4" /end CHARACTERISTIC
/begin CHARACTERISTIC ThermPlinChrgr_tChrgrInit_C "Charger temperature filter initialization value" VALUE 0x802520D4 RB_Val_Ws16 1310.700 RBPtCel_t_0p02_1 -655.3600 655.3400 FORMAT "%8.4" /end CHARACTERISTIC
/begin CHARACTERISTIC ThermPlinChrgr_tiChrgrPwr_C "Timer constant for charger power filter" VALUE 0x802520D8 RB_Val_Wu32 4294.96729500 RBPtCel_ti_1p0em6_1 0.00 4294.96729500 FORMAT "%13.8" /end CHARACTERISTIC
/begin CHARACTERISTIC ThermPlinChrgr_tiChrgrT_C "Time constant for charger temperature filter" VALUE 0x802520DC RB_Val_Wu32 4294.96729500 RBPtCel_ti_1p0em6_1 0.00 4294.96729500 FORMAT "%13.8" /end CHARACTERISTIC
/begin CHARACTERISTIC ThermTracBatt_tBattMax_C "Calibration Constant Describing the Battery Temperature above which cooling the battery is neccesary" VALUE 0x802520E0 RB_Val_Ws16 6553.500 Temp_Cels -3549.940 3003.560 FORMAT "%8.3" /end CHARACTERISTIC
/begin CHARACTERISTIC ThermTracBatt_tBattMin_C "Calibration Constant Describing the Battery Temperature below which heating the battery is neccesary" VALUE 0x802520E2 RB_Val_Ws16 6553.500 Temp_Cels -3549.940 3003.560 FORMAT "%8.3" /end CHARACTERISTIC
/begin CHARACTERISTIC ThS_pCmprFldMax_C "Maximum limit of compressor pressure" VALUE 0x80251F6C RB_Val_Wr32 2.0000E+037 RBPtCel_p_1p0_1 -1.0000E+037 1.0000E+037 FORMAT "%10.4" EXTENDED_LIMITS -3.4028E+038 3.4028E+038 /end CHARACTERISTIC
/begin CHARACTERISTIC ThS_pCmprFldMin_C "Minimum limit of compressor pressure" VALUE 0x80251F70 RB_Val_Wr32 2.0000E+037 RBPtCel_p_1p0_1 -1.0000E+037 1.0000E+037 FORMAT "%10.4" EXTENDED_LIMITS -3.4028E+038 3.4028E+038 /end CHARACTERISTIC
/begin CHARACTERISTIC ThS_tDcdcHeatTrfDelta_C "Default correction value for invertor coolant temperature" VALUE 0x80251F74 RB_Val_Ws16 6553.500 TempDiff_Kelv -3276.800 3276.700 FORMAT "%8.3" /end CHARACTERISTIC
/begin CHARACTERISTIC ThS_tDcdcHeatTrfDelta_T "Correction for invertor coolant temperature with DC DC temperature" CURVE 0x80251F76 RB_Curve_S16_S16 6553.500 Temp_Cels -3549.940 3003.560 FORMAT "%8.3"
 /begin AXIS_DESCR STD_AXIS Dcdc_tAct Temp_Cels 4 -3549.940 3003.560 FORMAT "%8.3" DEPOSIT ABSOLUTE /end AXIS_DESCR
/end CHARACTERISTIC
/begin CHARACTERISTIC ThS_tMedCooltT1Dft_C "Default MT coolant temperature in case of error" VALUE 0x80251F88 RB_Val_Ws16 6553.500 Temp_Cels -3549.940 3003.560 FORMAT "%8.3" /end CHARACTERISTIC
/begin CHARACTERISTIC TrsmEmac_ratTqPrimAxle_C "Ratio from transmission between e-machine and wheels on primary axle." VALUE 0x8025210E RB_Val_Wu16 655.3500 TransR 0.00 655.3500 FORMAT "%8.4" /end CHARACTERISTIC
/begin CHARACTERISTIC TrsmEmac_tqProtn01_T "Calibration parameter for EM01 protection torque" CURVE 0x802520E4 RB_Curve_S16_S16 3276.700 Trq 0.00 3276.700 FORMAT "%8.3" EXTENDED_LIMITS -3276.800 3276.700
 /begin AXIS_DESCR STD_AXIS Emac_nActPhy01 nmot_q1 10 -32768.00 32767.00 FORMAT "%8.2" DEPOSIT ABSOLUTE /end AXIS_DESCR
/end CHARACTERISTIC
/begin CHARACTERISTIC UCtP_ADCCal.numSRCTempSel_C "Calibration structure for ADC and SENT / Selection of temperature for signal range check" VALUE 0x80252110 RB_Val_Wu8 255.000000000 DELIB_ALLTEMP_VERB_COMPU 0.00 255.000000000 FORMAT "%13.9" /end CHARACTERISTIC
/begin CHARACTERISTIC UCtP_ADCCal.tiSRCMaxDebOK_C "Calibration structure for ADC and SENT / Error healing deounce time" VALUE 0x80252114 RB_Val_Ws32 42949672950.0 Time_ms -21474836480.0 21474836470.0 FORMAT "%13.1" /end CHARACTERISTIC
/begin CHARACTERISTIC UCtP_ADCCal.uSRCMax_C "Calibration structure for ADC and SENT / Maximum threshold voltage for SRC" VALUE 0x80252118 RB_Val_Ws16 13107.00 Volt -6553.600 6553.400 FORMAT "%8.3" /end CHARACTERISTIC
/begin CHARACTERISTIC UCtP_ADCCal.uSRCMin_C "Calibration structure for ADC and SENT / Minimum threshold voltage for SRC" VALUE 0x8025211A RB_Val_Ws16 13107.00 Volt -6553.600 6553.400 FORMAT "%8.3" /end CHARACTERISTIC
/begin CHARACTERISTIC UCtP_ADCCal.uSRCOpn_C "Calibration structure for ADC and SENT / Maximum threshold for open SRC connection error." VALUE 0x8025211C RB_Val_Ws16 13107.00 Volt -6553.600 6553.400 FORMAT "%8.3" /end CHARACTERISTIC
/begin CHARACTERISTIC UCtP_ADCSensTransf_f_CUR "" CURVE 0x802699E4 RB_Curve_R32_R32_sao 2.00000000E+037 RBPtCel_u_1p0_1 -1.00000000E+037 1.00000000E+037 FORMAT "%13.3" EXTENDED_LIMITS -3.40282347E+038 3.40282347E+038
 /begin AXIS_DESCR STD_AXIS UCtP_uRaw_f RBPtCel_u_1p0_2 25 -1.00000000E+037 1.00000000E+037 FORMAT "%13.3" EXTENDED_LIMITS -3.40282347E+038 3.40282347E+038 DEPOSIT ABSOLUTE /end AXIS_DESCR
/end CHARACTERISTIC
/begin CHARACTERISTIC UCtP_DigSensCal.tiDebPos_C " / debounce time of rising edge" VALUE 0x80269B74 Val_Ws16 655350.0 Time_ms -327680.0 327670.0 FORMAT "%8.1" /end CHARACTERISTIC
/begin CHARACTERISTIC UCtP_DigSensCal.tiDebNeg_C " / debounce time of falling edge" VALUE 0x80269B76 Val_Ws16 655350.0 Time_ms -327680.0 327670.0 FORMAT "%8.1" /end CHARACTERISTIC
/begin CHARACTERISTIC UCtP_duGradLim_f_C "" VALUE 0x80269B78 Val_Wr32 2.00000000E+037 RBPtCel_du_1p0_1 -1.00000000E+037 1.00000000E+037 FORMAT "%13.3" EXTENDED_LIMITS -3.40282347E+038 3.40282347E+038 /end CHARACTERISTIC
/begin CHARACTERISTIC UCtP_facFIR_CA "" VAL_BLK 0x80269AB0 ValA_Wu8 255.0 OneToOne 0.00 255.0 FORMAT "%5.1" MATRIX_DIM 9 /end CHARACTERISTIC
/begin CHARACTERISTIC UCtP_Fir_Cal.facCumAvrg_C "Calibration structure for filtering function / Factor for cumulative FIR" VALUE 0x8024E700 Val_Wu8 255.0 OneToOne 0.00 255.0 FORMAT "%5.1" /end CHARACTERISTIC
/begin CHARACTERISTIC UCtP_Fir_Cal.nAvrgSelThres0_C "Calibration structure for filtering function / Lower engine speed threshold for the change from standard FIR filter and engine speed depending FIR filter" VALUE 0x8024E702 Val_Ws16 32767.50 EngN1 -16384.00 16383.50 FORMAT "%8.2" /end CHARACTERISTIC
/begin CHARACTERISTIC UCtP_Fir_Cal.nAvrgSelThres1_C "Calibration structure for filtering function / Upper engine speed threshold for the change from standard FIR filter and engine speed depending FIR filter" VALUE 0x8024E704 Val_Ws16 32767.50 EngN1 -16384.00 16383.50 FORMAT "%8.2" /end CHARACTERISTIC
/begin CHARACTERISTIC UCtP_Fir_Cal.numSelMedian_C "Calibration structure for filtering function / Number of values at the left right side of the median, which will be taken into account when calculating the mean value" VALUE 0x8024E706 Val_Wu8 255.0 OneToOne 0.00 255.0 FORMAT "%5.1" /end CHARACTERISTIC
/begin CHARACTERISTIC UCtP_Fir_Cal.swtConf_C "Calibration structure for filtering function / e_:main switch for FIR:_e;d_:Hauptschalter für FIR:_d" VALUE 0x8024E707 Val_Wu8 255.0 OneToOne 0.00 255.0 FORMAT "%5.1" /end CHARACTERISTIC
/begin CHARACTERISTIC UCtP_numStdSens_C "" VALUE 0x80269B9C Val_Wu32 4294967295.00 OneToOne 0.00 4294967295.00 FORMAT "%13.2" /end CHARACTERISTIC
/begin CHARACTERISTIC UCtP_numTempErrDef_C "" VALUE 0x80269BA0 Val_Wu8 255.0 OneToOne 0.00 255.0 FORMAT "%5.1" /end CHARACTERISTIC
/begin CHARACTERISTIC UCtP_numtSel_C "" VALUE 0x80269BA2 Val_Wu16 255.000000000 DELIB_ALLTEMP_VERB_COMPU 0.00 255.000000000 FORMAT "%13.9" /end CHARACTERISTIC
/begin CHARACTERISTIC UCtP_RmpSlp_f.Pos_C " / Positive ramp slope dy/dt" VALUE 0x80269B7C Kw_Wr32 2.00000000E+038 RBPtCel_du_1p0_1 -1.00000000E+038 1.00000000E+038 FORMAT "%13.3" EXTENDED_LIMITS -3.40282347E+038 3.40282347E+038 /end CHARACTERISTIC
/begin CHARACTERISTIC UCtP_RmpSlp_f.Neg_C " / Negative ramp slope dy/dt" VALUE 0x80269B80 Kw_Wr32 2.00000000E+038 RBPtCel_du_1p0_1 -1.00000000E+038 1.00000000E+038 FORMAT "%13.3" EXTENDED_LIMITS -3.40282347E+038 3.40282347E+038 /end CHARACTERISTIC
/begin CHARACTERISTIC UCtP_stEnhPhysSRCRls_MAP "" MAP 0x80269BA4 RB_Map_S16S16_U8_sao 255.0 OneToOne 0.00 255.0 FORMAT "%5.1"
 /begin AXIS_DESCR STD_AXIS Epm_nEng EngN 25 -16384.00 16383.50 FORMAT "%8.2" DEPOSIT ABSOLUTE /end AXIS_DESCR
 /begin AXIS_DESCR STD_AXIS InjCtl_qSetUnBal InjMass 25 -327.6800 327.6700 FORMAT "%8.4" DEPOSIT ABSOLUTE /end AXIS_DESCR
/end CHARACTERISTIC
/begin CHARACTERISTIC UCtP_swtConfStdSens2_C "" VALUE 0x80269B60 Val_Wu32 4294967295.00 OneToOne 0.00 4294967295.00 FORMAT "%13.2" /end CHARACTERISTIC
/begin CHARACTERISTIC UCtP_swtConfStdSensSwVers162_C "" VALUE 0x80269B64 Val_Wu32 4294967295.00 OneToOne 0.00 4294967295.00 FORMAT "%13.2" /end CHARACTERISTIC
/begin CHARACTERISTIC UCtP_swtConfStdSens_C "" VALUE 0x80269B68 Val_Wu32 4294967295.00 OneToOne 0.00 4294967295.00 FORMAT "%13.2" /end CHARACTERISTIC
/begin CHARACTERISTIC UCtP_tiEngOnMin_C "" VALUE 0x80269E80 Val_Wu32 42949672950.0 Time_ms 0.00 42949672950.0 FORMAT "%13.1" /end CHARACTERISTIC
/begin CHARACTERISTIC UCtP_tiPT1Fil_C "" VALUE 0x80269B54 Val_Ws32 4294.9672940000000 TimeDelay_s 0.0000020000000 4294.9672959999998 FORMAT "%19.14" EXTENDED_LIMITS 0.000002000000001 4294.9672959999998 /end CHARACTERISTIC
/begin CHARACTERISTIC UCtP_tiPT1_f_C "" VALUE 0x80269B84 Val_Wr32 2.00000000E+037 RBPtCel_ti_1p0_2 -1.00000000E+037 1.00000000E+037 FORMAT "%13.3" EXTENDED_LIMITS -3.40282347E+038 3.40282347E+038 /end CHARACTERISTIC
/begin CHARACTERISTIC UCtP_tiSRCMaxDefDeb_CUR "" CURVE 0x80269ABC RB_Curve_S16_S32_sao 42949672950.0 Time_ms -21474836480.0 21474836470.0 FORMAT "%13.1"
 /begin AXIS_DESCR STD_AXIS UCtP_tRefSnsr_mp Temp_Cels 25 -3549.940 3003.560 FORMAT "%8.3" DEPOSIT ABSOLUTE /end AXIS_DESCR
/end CHARACTERISTIC
/begin CHARACTERISTIC UCtP_tiTempErrOk_C "" VALUE 0x80269E84 Val_Ws16 655350.0 Time_ms -327680.0 327670.0 FORMAT "%8.1" /end CHARACTERISTIC
/begin CHARACTERISTIC UCtP_TransStg_f.Dfl_r32_C " / This is SW-CALPRM-PROTOTYPE" VALUE 0x80269B88 Kw_Wr32 2.00000000E+037 RBPtCel_u_1p0_1 -1.00000000E+037 1.00000000E+037 FORMAT "%13.3" EXTENDED_LIMITS -3.40282347E+038 3.40282347E+038 /end CHARACTERISTIC
/begin CHARACTERISTIC UCtP_TransStg_f.stSensId_C " / This is SW-CALPRM-PROTOTYPE" VALUE 0x80269B8C Kw_Wu8 255.0 OneToOne 0.00 255.0 FORMAT "%5.1" /end CHARACTERISTIC
/begin CHARACTERISTIC UCtP_tSnsrMax_f_C "" VALUE 0x80269E88 Val_Wr32 2.00000000E+037 RBPtCel_t_1p0_3 -1.00000000E+037 1.00000000E+037 FORMAT "%13.3" EXTENDED_LIMITS -3.40282347E+038 3.40282347E+038 /end CHARACTERISTIC
/begin CHARACTERISTIC UCtP_tSnsrMin_f_C "" VALUE 0x80269E8C Val_Wr32 2.00000000E+037 RBPtCel_t_1p0_3 -1.00000000E+037 1.00000000E+037 FORMAT "%13.3" EXTENDED_LIMITS -3.40282347E+038 3.40282347E+038 /end CHARACTERISTIC
/begin CHARACTERISTIC UCtP_uDflVal_f_C "" VALUE 0x80269B90 Val_Wr32 2.00000000E+037 RBPtCel_u_1p0_1 -1.00000000E+037 1.00000000E+037 FORMAT "%13.3" EXTENDED_LIMITS -3.40282347E+038 3.40282347E+038 /end CHARACTERISTIC
/begin CHARACTERISTIC UCtP_uEnhPhysSRCMax_f_MAP "" MAP 0x80269E90 RB_Map_S16S16_R32_sao 2.00000000E+037 RBPtCel_u_1p0_1 -1.00000000E+037 1.00000000E+037 FORMAT "%13.3" EXTENDED_LIMITS -3.40282347E+038 3.40282347E+038
 /begin AXIS_DESCR STD_AXIS Epm_nEng EngN 25 -16384.00 16383.50 FORMAT "%8.2" DEPOSIT ABSOLUTE /end AXIS_DESCR
 /begin AXIS_DESCR STD_AXIS InjCtl_qSetUnBal InjMass 25 -327.6800 327.6700 FORMAT "%8.4" DEPOSIT ABSOLUTE /end AXIS_DESCR
/end CHARACTERISTIC
/begin CHARACTERISTIC UCtP_uEnhPhysSRCMin_f_MAP "" MAP 0x8026A8BC RB_Map_S16S16_R32_sao 2.00000000E+037 RBPtCel_u_1p0_1 -1.00000000E+037 1.00000000E+037 FORMAT "%13.3" EXTENDED_LIMITS -3.40282347E+038 3.40282347E+038
 /begin AXIS_DESCR STD_AXIS Epm_nEng EngN 25 -16384.00 16383.50 FORMAT "%8.2" DEPOSIT ABSOLUTE /end AXIS_DESCR
 /begin AXIS_DESCR STD_AXIS InjCtl_qSetUnBal InjMass 25 -327.6800 327.6700 FORMAT "%8.4" DEPOSIT ABSOLUTE /end AXIS_DESCR
/end CHARACTERISTIC
/begin CHARACTERISTIC UCtP_uHiLimit_f_C "" VALUE 0x80269B94 Val_Wr32 2.00000000E+037 RBPtCel_u_1p0_1 -1.00000000E+037 1.00000000E+037 FORMAT "%13.3" EXTENDED_LIMITS -3.40282347E+038 3.40282347E+038 /end CHARACTERISTIC
/begin CHARACTERISTIC UCtP_uLoLimit_f_C "" VALUE 0x80269B98 Val_Wr32 2.00000000E+037 RBPtCel_u_1p0_1 -1.00000000E+037 1.00000000E+037 FORMAT "%13.3" EXTENDED_LIMITS -3.40282347E+038 3.40282347E+038 /end CHARACTERISTIC
/begin CHARACTERISTIC UPxP1_ADCCal.numSRCTempSel_C "Calibration structure for ADC and SENT / Selection of temperature for signal range check" VALUE 0x80252120 RB_Val_Wu8 255.000000000 DELIB_ALLTEMP_VERB_COMPU 0.00 255.000000000 FORMAT "%13.9" /end CHARACTERISTIC
/begin CHARACTERISTIC UPxP1_ADCCal.tiSRCMaxDebOK_C "Calibration structure for ADC and SENT / Error healing deounce time" VALUE 0x80252124 RB_Val_Ws32 42949672950.0 Time_ms -21474836480.0 21474836470.0 FORMAT "%13.1" /end CHARACTERISTIC
/begin CHARACTERISTIC UPxP1_ADCCal.uSRCMax_C "Calibration structure for ADC and SENT / Maximum threshold voltage for SRC" VALUE 0x80252128 RB_Val_Ws16 13107.00 Volt -6553.600 6553.400 FORMAT "%8.3" /end CHARACTERISTIC
/begin CHARACTERISTIC UPxP1_ADCCal.uSRCMin_C "Calibration structure for ADC and SENT / Minimum threshold voltage for SRC" VALUE 0x8025212A RB_Val_Ws16 13107.00 Volt -6553.600 6553.400 FORMAT "%8.3" /end CHARACTERISTIC
/begin CHARACTERISTIC UPxP1_ADCCal.uSRCOpn_C "Calibration structure for ADC and SENT / Maximum threshold for open SRC connection error." VALUE 0x8025212C RB_Val_Ws16 13107.00 Volt -6553.600 6553.400 FORMAT "%8.3" /end CHARACTERISTIC
/begin CHARACTERISTIC UPxP1_ADCSensTransf_f_CUR "" CURVE 0x8026B2E8 RB_Curve_R32_R32_sao 2.00000000E+037 RBPtCel_u_1p0_1 -1.00000000E+037 1.00000000E+037 FORMAT "%13.3" EXTENDED_LIMITS -3.40282347E+038 3.40282347E+038
 /begin AXIS_DESCR STD_AXIS UPxP1_uRaw_f RBPtCel_u_1p0_2 25 -1.00000000E+037 1.00000000E+037 FORMAT "%13.3" EXTENDED_LIMITS -3.40282347E+038 3.40282347E+038 DEPOSIT ABSOLUTE /end AXIS_DESCR
/end CHARACTERISTIC
/begin CHARACTERISTIC UPxP1_DigSensCal.tiDebPos_C " / debounce time of rising edge" VALUE 0x8026B46C Val_Ws16 655350.0 Time_ms -327680.0 327670.0 FORMAT "%8.1" /end CHARACTERISTIC
/begin CHARACTERISTIC UPxP1_DigSensCal.tiDebNeg_C " / debounce time of falling edge" VALUE 0x8026B46E Val_Ws16 655350.0 Time_ms -327680.0 327670.0 FORMAT "%8.1" /end CHARACTERISTIC
/begin CHARACTERISTIC UPxP1_duGradLim_f_C "" VALUE 0x8026B470 Val_Wr32 2.00000000E+037 RBPtCel_du_1p0_1 -1.00000000E+037 1.00000000E+037 FORMAT "%13.3" EXTENDED_LIMITS -3.40282347E+038 3.40282347E+038 /end CHARACTERISTIC
/begin CHARACTERISTIC UPxP1_numStdSens_C "" VALUE 0x8026B494 Val_Wu32 4294967295.00 OneToOne 0.00 4294967295.00 FORMAT "%13.2" /end CHARACTERISTIC
/begin CHARACTERISTIC UPxP1_numTempErrDef_C "" VALUE 0x8026B498 Val_Wu8 255.0 OneToOne 0.00 255.0 FORMAT "%5.1" /end CHARACTERISTIC
/begin CHARACTERISTIC UPxP1_numtSel_C "" VALUE 0x8026B49A Val_Wu16 255.000000000 DELIB_ALLTEMP_VERB_COMPU 0.00 255.000000000 FORMAT "%13.9" /end CHARACTERISTIC
/begin CHARACTERISTIC UPxP1_RmpSlp_f.Pos_C " / Positive ramp slope dy/dt" VALUE 0x8026B474 Kw_Wr32 2.00000000E+038 RBPtCel_du_1p0_1 -1.00000000E+038 1.00000000E+038 FORMAT "%13.3" EXTENDED_LIMITS -3.40282347E+038 3.40282347E+038 /end CHARACTERISTIC
/begin CHARACTERISTIC UPxP1_RmpSlp_f.Neg_C " / Negative ramp slope dy/dt" VALUE 0x8026B478 Kw_Wr32 2.00000000E+038 RBPtCel_du_1p0_1 -1.00000000E+038 1.00000000E+038 FORMAT "%13.3" EXTENDED_LIMITS -3.40282347E+038 3.40282347E+038 /end CHARACTERISTIC
/begin CHARACTERISTIC UPxP1_stEnhPhysSRCRls_MAP "" MAP 0x8026B49C RB_Map_S16S16_U8_sao 255.0 OneToOne 0.00 255.0 FORMAT "%5.1"
 /begin AXIS_DESCR STD_AXIS Epm_nEng EngN 25 -16384.00 16383.50 FORMAT "%8.2" DEPOSIT ABSOLUTE /end AXIS_DESCR
 /begin AXIS_DESCR STD_AXIS InjCtl_qSetUnBal InjMass 25 -327.6800 327.6700 FORMAT "%8.4" DEPOSIT ABSOLUTE /end AXIS_DESCR
/end CHARACTERISTIC
/begin CHARACTERISTIC UPxP1_swtConfStdSens2_C "" VALUE 0x8026B458 Val_Wu32 4294967295.00 OneToOne 0.00 4294967295.00 FORMAT "%13.2" /end CHARACTERISTIC
/begin CHARACTERISTIC UPxP1_swtConfStdSensSwVers162_C "" VALUE 0x8026B45C Val_Wu32 4294967295.00 OneToOne 0.00 4294967295.00 FORMAT "%13.2" /end CHARACTERISTIC
/begin CHARACTERISTIC UPxP1_swtConfStdSens_C "" VALUE 0x8026B460 Val_Wu32 4294967295.00 OneToOne 0.00 4294967295.00 FORMAT "%13.2" /end CHARACTERISTIC
/begin CHARACTERISTIC UPxP1_tiEngOnMin_C "" VALUE 0x8026B778 Val_Wu32 42949672950.0 Time_ms 0.00 42949672950.0 FORMAT "%13.1" /end CHARACTERISTIC
/begin CHARACTERISTIC UPxP1_tiPT1Fil_C "" VALUE 0x8026B44C Val_Ws32 4294.9672940000000 TimeDelay_s 0.0000020000000 4294.9672959999998 FORMAT "%19.14" EXTENDED_LIMITS 0.000002000000001 4294.9672959999998 /end CHARACTERISTIC
/begin CHARACTERISTIC UPxP1_tiPT1_f_C "" VALUE 0x8026B47C Val_Wr32 2.00000000E+037 RBPtCel_ti_1p0_2 -1.00000000E+037 1.00000000E+037 FORMAT "%13.3" EXTENDED_LIMITS -3.40282347E+038 3.40282347E+038 /end CHARACTERISTIC
/begin CHARACTERISTIC UPxP1_tiSRCMaxDefDeb_CUR "" CURVE 0x8026B3B4 RB_Curve_S16_S32_sao 42949672950.0 Time_ms -21474836480.0 21474836470.0 FORMAT "%13.1"
 /begin AXIS_DESCR STD_AXIS UPxP1_tRefSnsr_mp Temp_Cels 25 -3549.940 3003.560 FORMAT "%8.3" DEPOSIT ABSOLUTE /end AXIS_DESCR
/end CHARACTERISTIC
/begin CHARACTERISTIC UPxP1_tiTempErrOk_C "" VALUE 0x8026B77C Val_Ws16 655350.0 Time_ms -327680.0 327670.0 FORMAT "%8.1" /end CHARACTERISTIC
/begin CHARACTERISTIC UPxP1_TransStg_f.Dfl_r32_C " / This is SW-CALPRM-PROTOTYPE" VALUE 0x8026B480 Kw_Wr32 2.00000000E+037 RBPtCel_u_1p0_1 -1.00000000E+037 1.00000000E+037 FORMAT "%13.3" EXTENDED_LIMITS -3.40282347E+038 3.40282347E+038 /end CHARACTERISTIC
/begin CHARACTERISTIC UPxP1_TransStg_f.stSensId_C " / This is SW-CALPRM-PROTOTYPE" VALUE 0x8026B484 Kw_Wu8 255.0 OneToOne 0.00 255.0 FORMAT "%5.1" /end CHARACTERISTIC
/begin CHARACTERISTIC UPxP1_tSnsrMax_f_C "" VALUE 0x8026B780 Val_Wr32 2.00000000E+037 RBPtCel_t_1p0_3 -1.00000000E+037 1.00000000E+037 FORMAT "%13.3" EXTENDED_LIMITS -3.40282347E+038 3.40282347E+038 /end CHARACTERISTIC
/begin CHARACTERISTIC UPxP1_tSnsrMin_f_C "" VALUE 0x8026B784 Val_Wr32 2.00000000E+037 RBPtCel_t_1p0_3 -1.00000000E+037 1.00000000E+037 FORMAT "%13.3" EXTENDED_LIMITS -3.40282347E+038 3.40282347E+038 /end CHARACTERISTIC
/begin CHARACTERISTIC UPxP1_uDflVal_f_C "" VALUE 0x8026B488 Val_Wr32 2.00000000E+037 RBPtCel_u_1p0_1 -1.00000000E+037 1.00000000E+037 FORMAT "%13.3" EXTENDED_LIMITS -3.40282347E+038 3.40282347E+038 /end CHARACTERISTIC
/begin CHARACTERISTIC UPxP1_uEnhPhysSRCMax_f_MAP "" MAP 0x8026B788 RB_Map_S16S16_R32_sao 2.00000000E+037 RBPtCel_u_1p0_1 -1.00000000E+037 1.00000000E+037 FORMAT "%13.3" EXTENDED_LIMITS -3.40282347E+038 3.40282347E+038
 /begin AXIS_DESCR STD_AXIS Epm_nEng EngN 25 -16384.00 16383.50 FORMAT "%8.2" DEPOSIT ABSOLUTE /end AXIS_DESCR
 /begin AXIS_DESCR STD_AXIS InjCtl_qSetUnBal InjMass 25 -327.6800 327.6700 FORMAT "%8.4" DEPOSIT ABSOLUTE /end AXIS_DESCR
/end CHARACTERISTIC
/begin CHARACTERISTIC UPxP1_uEnhPhysSRCMin_f_MAP "" MAP 0x8026C1B4 RB_Map_S16S16_R32_sao 2.00000000E+037 RBPtCel_u_1p0_1 -1.00000000E+037 1.00000000E+037 FORMAT "%13.3" EXTENDED_LIMITS -3.40282347E+038 3.40282347E+038
 /begin AXIS_DESCR STD_AXIS Epm_nEng EngN 25 -16384.00 16383.50 FORMAT "%8.2" DEPOSIT ABSOLUTE /end AXIS_DESCR
 /begin AXIS_DESCR STD_AXIS InjCtl_qSetUnBal InjMass 25 -327.6800 327.6700 FORMAT "%8.4" DEPOSIT ABSOLUTE /end AXIS_DESCR
/end CHARACTERISTIC
/begin CHARACTERISTIC UPxP1_uHiLimit_f_C "" VALUE 0x8026B48C Val_Wr32 2.00000000E+037 RBPtCel_u_1p0_1 -1.00000000E+037 1.00000000E+037 FORMAT "%13.3" EXTENDED_LIMITS -3.40282347E+038 3.40282347E+038 /end CHARACTERISTIC
/begin CHARACTERISTIC UPxP1_uLoLimit_f_C "" VALUE 0x8026B490 Val_Wr32 2.00000000E+037 RBPtCel_u_1p0_1 -1.00000000E+037 1.00000000E+037 FORMAT "%13.3" EXTENDED_LIMITS -3.40282347E+038 3.40282347E+038 /end CHARACTERISTIC
/begin CHARACTERISTIC VehCoorn_dstCnsPrpDrvMod_C "distance for calculation of driving mode dependent average energy consumption" VALUE 0x802523F4 RB_Val_Ws32 4294967295.00 RBPtCel_dst_1p0_1 -2147483648.00 2147483647.00 FORMAT "%13.2" /end CHARACTERISTIC
/begin CHARACTERISTIC VehCoorn_dstCnsPrpLong_C "Long term update distance for calculation of average electric consumption for propulsion" VALUE 0x802523F8 RB_Val_Ws32 4294967295.00 RBPtCel_dst_1p0_1 -2147483648.00 2147483647.00 FORMAT "%13.2" /end CHARACTERISTIC
/begin CHARACTERISTIC VehCoorn_dstCnsPrpSho_C "Short term update distance for calculation of average electric consumption for propulsion" VALUE 0x802523FC RB_Val_Ws32 4294967295.00 RBPtCel_dst_1p0_1 -2147483648.00 2147483647.00 FORMAT "%13.2" /end CHARACTERISTIC
/begin CHARACTERISTIC VehCoorn_dstRateLimnMin_C "minimum change rate for signal shaping of predicted range" VALUE 0x8025242C RB_Val_Ws16 65535.00 RBPtCel_dst_1p0_1 -32768.00 32767.00 FORMAT "%8.2" /end CHARACTERISTIC
/begin CHARACTERISTIC VehCoorn_dstRngPrdcDispDft_C "Default value for remaining driving range (display)" VALUE 0x80252524 RB_Val_Ws32 4294967295.0000 RBPtCel_dst_1p0_1 -2147483648.0000 2147483647.0000 FORMAT "%10.4" /end CHARACTERISTIC
/begin CHARACTERISTIC VehCoorn_dstRngPrdcDispHi_M "Map to indicated the higher distance range prediction for display" MAP 0x80252528 RB_Map_R32R32_R32_sao 2.0000E+037 RBPtCel_dst_1p0_1 -1.0000E+037 1.0000E+037 FORMAT "%10.4" EXTENDED_LIMITS -3.4028E+038 3.4028E+038
 /begin AXIS_DESCR STD_AXIS NO_INPUT_QUANTITY TempC_float 4 -1.00000000E+037 1.00000000E+037 FORMAT "%13.3" EXTENDED_LIMITS -3.40282347E+038 3.40282347E+038 DEPOSIT ABSOLUTE /end AXIS_DESCR
 /begin AXIS_DESCR STD_AXIS HvBatt_egyAvl_f RBPtCel_pwr_1p0_4 4 -1.00000000E+037 1.00000000E+037 FORMAT "%13.3" EXTENDED_LIMITS -3.40282347E+038 3.40282347E+038 DEPOSIT ABSOLUTE /end AXIS_DESCR
/end CHARACTERISTIC
/begin CHARACTERISTIC VehCoorn_dstRngPrdcDispMed_M "Map to indicates the medium distance range prediction for display" MAP 0x80252590 RB_Map_R32R32_R32_sao 2.0000E+037 RBPtCel_dst_1p0_1 -1.0000E+037 1.0000E+037 FORMAT "%10.4" EXTENDED_LIMITS -3.4028E+038 3.4028E+038
 /begin AXIS_DESCR STD_AXIS NO_INPUT_QUANTITY OneToOne 4 -1.00000000E+037 1.00000000E+037 FORMAT "%13.3" EXTENDED_LIMITS -3.40282347E+038 3.40282347E+038 DEPOSIT ABSOLUTE /end AXIS_DESCR
 /begin AXIS_DESCR STD_AXIS HvBatt_egyAvl_f RBPtCel_pwr_1p0_4 4 -1.00000000E+037 1.00000000E+037 FORMAT "%13.3" EXTENDED_LIMITS -3.40282347E+038 3.40282347E+038 DEPOSIT ABSOLUTE /end AXIS_DESCR
/end CHARACTERISTIC
/begin CHARACTERISTIC VehCoorn_dstRngPrdcStepNeg_C "Positive slope value for predictive range display" VALUE 0x802525F8 RB_Val_Ws32 4294967295.00 RBPtCel_dst_1p0_1 -2147483648.00 2147483647.00 FORMAT "%13.2" /end CHARACTERISTIC
/begin CHARACTERISTIC VehCoorn_dstRngPrdcStepPos_C "Negative slope value for predictive range display" VALUE 0x802525FC RB_Val_Ws32 4294967295.00 RBPtCel_dst_1p0_1 -2147483648.00 2147483647.00 FORMAT "%13.2" /end CHARACTERISTIC
/begin CHARACTERISTIC VehCoorn_dstRngPredErr_C "remaining driving range (default value)" VALUE 0x80252430 RB_Val_Ws32 4294967295.00 RBPtCel_dst_1p0_1 -2147483648.00 2147483647.00 FORMAT "%13.2" /end CHARACTERISTIC
/begin CHARACTERISTIC VehCoorn_dstRngPredIni_C "remaining driving range (default value)" VALUE 0x80252434 RB_Val_Ws32 4294967295.00 RBPtCel_dst_1p0_1 -2147483648.00 2147483647.00 FORMAT "%13.2" /end CHARACTERISTIC
/begin CHARACTERISTIC VehCoorn_dstRngPredMax_C "Maximum remaining driving range" VALUE 0x80252438 RB_Val_Wr32 2.0000E+037 RBPtCel_dst_1p0_1 -1.0000E+037 1.0000E+037 FORMAT "%10.4" EXTENDED_LIMITS -3.4028E+038 3.4028E+038 /end CHARACTERISTIC
/begin CHARACTERISTIC VehCoorn_dstRngPredResv_C "distance reserve for remaining distance" VALUE 0x8025243C RB_Val_Wr32 2.0000E+037 RBPtCel_dst_1p0_1 -1.0000E+037 1.0000E+037 FORMAT "%10.4" EXTENDED_LIMITS -3.4028E+038 3.4028E+038 /end CHARACTERISTIC
/begin CHARACTERISTIC VehCoorn_egyBattResv_C "energy reserve for HV-battery for calculation of remaining distance" VALUE 0x80252440 RB_Val_Wr32 2.0000E+037 RBPtCel_pwr_1p0_4 -1.0000E+037 1.0000E+037 FORMAT "%10.4" EXTENDED_LIMITS -3.4028E+038 3.4028E+038 /end CHARACTERISTIC
/begin CHARACTERISTIC VehCoorn_egyDeltaHvbThd_C "minimum Hv Battery engery delta to enable efficiency calculation" VALUE 0x80252444 RB_Val_Wr32 2.0000E+037 RBPtCel_egy_1p0_2 -1.0000E+037 1.0000E+037 FORMAT "%10.4" EXTENDED_LIMITS -3.4028E+038 3.4028E+038 /end CHARACTERISTIC
/begin CHARACTERISTIC VehCoorn_egyPerDeltaKElecCnsAuxTraMax_C "maximum energy required to heat or cool a degree kelvin of the HvBatt resp. Cabin" VALUE 0x80252140 RB_Val_Wr32 2.0000E+037 RBPtCel_pwr_1p0_4 -1.0000E+037 1.0000E+037 FORMAT "%10.4" EXTENDED_LIMITS -3.4028E+038 3.4028E+038 /end CHARACTERISTIC
/begin CHARACTERISTIC VehCoorn_egyPerDeltaKElecCnsAuxTraMin_C "minimum energy required to heat or cool a degree kelvin of the HvBatt resp. Cabin" VALUE 0x80252144 RB_Val_Wr32 2.0000E+037 RBPtCel_pwr_1p0_4 -1.0000E+037 1.0000E+037 FORMAT "%10.4" EXTENDED_LIMITS -3.4028E+038 3.4028E+038 /end CHARACTERISTIC
/begin CHARACTERISTIC VehCoorn_egyPerDeltaKElecCnsAuxTra_CA "Initial value of the energy required per degree Kelvin to heat or cool the hv battery and cabin in the transient phase." VAL_BLK 0x80252148 RB_ValA_Wr32 2.0000E+037 RBPtCel_pwr_1p0_4 -1.0000E+037 1.0000E+037 FORMAT "%10.4" EXTENDED_LIMITS -3.4028E+038 3.4028E+038 MATRIX_DIM 15 /end CHARACTERISTIC
/begin CHARACTERISTIC VehCoorn_egyTraElecCnsAuxMax_C "maximum remaining energy required for initialization and transient phase" VALUE 0x80252184 RB_Val_Wr32 2.0000E+037 RBPtCel_pwr_1p0_4 -1.0000E+037 1.0000E+037 FORMAT "%10.4" EXTENDED_LIMITS -3.4028E+038 3.4028E+038 /end CHARACTERISTIC
/begin CHARACTERISTIC VehCoorn_facCnsWght_T "weighting factor between short term and long term average electric consumption based total energy" CURVE 0x80252448 RB_Curve_R32_R32_sao 2.0000E+037 RBPtCel_fac_1p0_1 -1.0000E+037 1.0000E+037 FORMAT "%10.4" EXTENDED_LIMITS -3.4028E+038 3.4028E+038
 /begin AXIS_DESCR STD_AXIS VehCoorn_egyMeclTot RBPtCel_egy_1p0_2 3 -1.0000E+037 1.0000E+037 FORMAT "%10.4" EXTENDED_LIMITS -3.4028E+038 3.4028E+038 DEPOSIT ABSOLUTE /end AXIS_DESCR
/end CHARACTERISTIC
/begin CHARACTERISTIC VehCoorn_facEgyEffMax_C "max. value for energy efficiency factor" VALUE 0x80252464 RB_Val_Wu16 65.53500 RBPtCel_fac_0p001_1 0.00 65.53500 FORMAT "%8.5" /end CHARACTERISTIC
/begin CHARACTERISTIC VehCoorn_facEgyEffMin_C "min. value for energy efficiency factor" VALUE 0x80252466 RB_Val_Wu16 65.53500 RBPtCel_fac_0p001_1 0.00 65.53500 FORMAT "%8.5" /end CHARACTERISTIC
/begin CHARACTERISTIC VehCoorn_facEgyElecCnsAuxWght_T "Weighting factor between short term and long term average electric consumption based on SOC" CURVE 0x80252468 RB_Curve_R32_R32_sao 2.0000E+037 RBPtCel_fac_1p0_1 -1.0000E+037 1.0000E+037 FORMAT "%10.4" EXTENDED_LIMITS -3.4028E+038 3.4028E+038
 /begin AXIS_DESCR STD_AXIS NO_INPUT_QUANTITY RBPtCel_egy_1p0_2 3 -1.0000E+037 1.0000E+037 FORMAT "%10.4" EXTENDED_LIMITS -3.4028E+038 3.4028E+038 DEPOSIT ABSOLUTE /end AXIS_DESCR
/end CHARACTERISTIC
/begin CHARACTERISTIC VehCoorn_facRateLimnMax_T "factor for maximum rate limiter for signal shaping of remaining driving range based on SOC" CURVE 0x80252484 RB_Curve_R32_R32_sao 2.0000E+037 OneToOne -1.0000E+037 1.0000E+037 FORMAT "%10.4" EXTENDED_LIMITS -3.4028E+038 3.4028E+038
 /begin AXIS_DESCR STD_AXIS VehCoorn_egyMeclTot RBPtCel_egy_1p0_2 3 -1.0000E+037 1.0000E+037 FORMAT "%10.4" EXTENDED_LIMITS -3.4028E+038 3.4028E+038 DEPOSIT ABSOLUTE /end AXIS_DESCR
/end CHARACTERISTIC
/begin CHARACTERISTIC VehCoorn_facRateLimnMin_T "factor for minimum rate limiter for signal shaping of remaining driving range based on SOC" CURVE 0x802524A0 RB_Curve_R32_R32_sao 2.0000E+037 OneToOne -1.0000E+037 1.0000E+037 FORMAT "%10.4" EXTENDED_LIMITS -3.4028E+038 3.4028E+038
 /begin AXIS_DESCR STD_AXIS VehCoorn_egyMeclTot RBPtCel_egy_1p0_2 3 -1.0000E+037 1.0000E+037 FORMAT "%10.4" EXTENDED_LIMITS -3.4028E+038 3.4028E+038 DEPOSIT ABSOLUTE /end AXIS_DESCR
/end CHARACTERISTIC
/begin CHARACTERISTIC VehCoorn_facRngPredRawFiltg_T "filtering factor for signal shaping of remaining driving range based on SOC" CURVE 0x802524BC RB_Curve_R32_R32_sao 2.0000E+037 OneToOne -1.0000E+037 1.0000E+037 FORMAT "%10.4" EXTENDED_LIMITS -3.4028E+038 3.4028E+038
 /begin AXIS_DESCR STD_AXIS VehCoorn_egyMeclTot RBPtCel_egy_1p0_2 3 -1.0000E+037 1.0000E+037 FORMAT "%10.4" EXTENDED_LIMITS -3.4028E+038 3.4028E+038 DEPOSIT ABSOLUTE /end AXIS_DESCR
/end CHARACTERISTIC
/begin CHARACTERISTIC VehCoorn_facTDeltaCbn_C "factor used to weight the cabin temperatur to the hv-battery temperature in terms of energy consumption for heating and cooling" VALUE 0x80252188 RB_Val_Wu16 6553.5000 RBPtCel_fac_0p1_1 0.0000 6553.5000 FORMAT "%10.4" /end CHARACTERISTIC
/begin CHARACTERISTIC VehCoorn_facTolrHvBatt_C "Toleranze factor to avoid implausible results of the square root." VALUE 0x80252298 RB_Val_Wr32 2.0000E+037 RBPtCel_fac_1p0_1 -1.0000E+037 1.0000E+037 FORMAT "%10.4" EXTENDED_LIMITS -3.4028E+038 3.4028E+038 /end CHARACTERISTIC
/begin CHARACTERISTIC VehCoorn_flgDrvModDpd_C "Switch to activate calculation of average consumption for propulsion based on drive mode" VALUE 0x80252400 RB_Val_Wu8 1.00000000000 B_TRUE 0.00 1.00000000000 FORMAT "%13.11" /end CHARACTERISTIC
/begin CHARACTERISTIC VehCoorn_flgECURst_C "Calibration flag to control ECU reset" VALUE 0x80252610 RB_Val_Wu8 1.00000000000 B_TRUE 0.00 1.00000000000 FORMAT "%13.11" /end CHARACTERISTIC
/begin CHARACTERISTIC VehCoorn_flgRstToIniDi_C "Disable reset of range prediction to initial value at shutdown" VALUE 0x802524D8 RB_Val_Wu8 1.00000000000 B_TRUE 0.00 1.00000000000 FORMAT "%13.11" /end CHARACTERISTIC
/begin CHARACTERISTIC VehCoorn_idxDeltaTCbn_T "Mapping of cabin temperature difference to learn matrix index" CURVE 0x8025218A RB_Curve_S16_U8_sao 255.0 OneToOne 0.00 255.0 FORMAT "%5.1"
 /begin AXIS_DESCR STD_AXIS NO_INPUT_QUANTITY TempDiff_Kelv 5 -3276.800 3276.700 FORMAT "%8.3" DEPOSIT ABSOLUTE /end AXIS_DESCR
/end CHARACTERISTIC
/begin CHARACTERISTIC VehCoorn_idxT_T "Mapping of environment temperature difference to scaling vector index" CURVE 0x8025219C RB_Curve_S16_U8_sao 255.0 OneToOne 0.00 255.0 FORMAT "%5.1"
 /begin AXIS_DESCR STD_AXIS NO_INPUT_QUANTITY Temp_Cels 5 -3549.940 3003.560 FORMAT "%8.3" DEPOSIT ABSOLUTE /end AXIS_DESCR
/end CHARACTERISTIC
/begin CHARACTERISTIC VehCoorn_jMPwrTrn_C "Inertia of propulsion system" VALUE 0x8025229C RB_Val_Wr32 2.0000E+037 RBPtCel_j_1p0_1 -1.0000E+037 1.0000E+037 FORMAT "%10.4" EXTENDED_LIMITS -3.4028E+038 3.4028E+038 /end CHARACTERISTIC
/begin CHARACTERISTIC VehCoorn_maskEIMPwrAct01VldySq_C "Calibratable mask to determine the signal quality of Actual Emachine power 01" VALUE 0x80252600 RB_Val_Wu16 65535.00 OneToOne 0.00 65535.00 FORMAT "%8.2" /end CHARACTERISTIC
/begin CHARACTERISTIC VehCoorn_maskEmPwrAct01VldySq_C "Calibration mask to determine Emachine 1 actual power validity" VALUE 0x80252402 RB_Val_Wu16 65535.00 OneToOne 0.00 65535.00 FORMAT "%8.2" /end CHARACTERISTIC
/begin CHARACTERISTIC VehCoorn_maskEnvTSq_C "Calibration mask to determine EnvT validity" VALUE 0x802521AE RB_Val_Wu16 65535.00 OneToOne 0.00 65535.00 FORMAT "%8.2" /end CHARACTERISTIC
/begin CHARACTERISTIC VehCoorn_maskHvBattEgyAvlDispVldySq_C "Calibration mask to detect signal valdity of Hv battery enery avilable for display" VALUE 0x80252602 RB_Val_Wu16 65535.0000 OneToOne 0.0000 65535.0000 FORMAT "%10.4" /end CHARACTERISTIC
/begin CHARACTERISTIC VehCoorn_maskHvBattEgyAvlVldySq_C "Calibration mask to determine validity of HV battery energy availability" VALUE 0x802524DA RB_Val_Wu16 65535.00 OneToOne 0.00 65535.00 FORMAT "%8.2" /end CHARACTERISTIC
/begin CHARACTERISTIC VehCoorn_maskHvBattRatSocDispVldySq_C "Calibration mask to detect signal valdity of Hv battery SoC ratio for display" VALUE 0x80252604 RB_Val_Wu16 65535.0000 OneToOne 0.0000 65535.0000 FORMAT "%10.4" /end CHARACTERISTIC
/begin CHARACTERISTIC VehCoorn_maskHvBattRatSocVldySq_C "Calibration mask to determine the validity of state of charge(SOC) of HV battery" VALUE 0x802524DC RB_Val_Wu16 65535.00 OneToOne 0.00 65535.00 FORMAT "%8.2" /end CHARACTERISTIC
/begin CHARACTERISTIC VehCoorn_maskHvBattRatSohDispVldySq_C "Calibration mask to detect signal valdity of Hv battery SoH ratio for display" VALUE 0x80252606 RB_Val_Wu16 65535.0000 OneToOne 0.0000 65535.0000 FORMAT "%10.4" /end CHARACTERISTIC
/begin CHARACTERISTIC VehCoorn_maskHvBattRatSohVldySq_C "Calibratable mask to determine the Signal quality of Hv Battery State of health" VALUE 0x802524DE RB_Val_Wu16 65535.00 OneToOne 0.00 65535.00 FORMAT "%8.2" /end CHARACTERISTIC
/begin CHARACTERISTIC VehCoorn_maskHvBattTActMeasdAvrgEffVldySq_C "Calibratable mask to determine the Signal quality of Hv Battery Actual temperature efficiency" VALUE 0x802524E0 RB_Val_Wu16 65535.00 OneToOne 0.00 65535.00 FORMAT "%8.2" /end CHARACTERISTIC
/begin CHARACTERISTIC VehCoorn_maskHvBattTActMeasdDispVldySq_C "Calibration mask to detect signal valdity of Hv battery actual measured temperature for display" VALUE 0x80252608 RB_Val_Wu16 65535.0000 OneToOne 0.0000 65535.0000 FORMAT "%10.4" /end CHARACTERISTIC
/begin CHARACTERISTIC VehCoorn_maskHvBattTActMeasdVldySq_C "Calibration mask to determine HV battery Measured validity" VALUE 0x802521B0 RB_Val_Wu16 65535.00 OneToOne 0.00 65535.00 FORMAT "%8.2" /end CHARACTERISTIC
/begin CHARACTERISTIC VehCoorn_maskSpdVehVVldySq_C "Calibration mask to determine vehicle speed validity" VALUE 0x802521B2 RB_Val_Wu16 65535.00 OneToOne 0.00 65535.00 FORMAT "%8.2" /end CHARACTERISTIC
/begin CHARACTERISTIC VehCoorn_maskVehSpdVldySq_C "Calibration mask to detect the quality of vehicle speed" VALUE 0x80252612 RB_Val_Wu16 65535.00 OneToOne 0.00 65535.00 FORMAT "%8.2" /end CHARACTERISTIC
/begin CHARACTERISTIC VehCoorn_maskVehVRngPrdnVldySq_C "Calibratable mask to determine the signal quality of vehicle velocity" VALUE 0x8025260A RB_Val_Wu16 65535.00 OneToOne 0.00 65535.00 FORMAT "%8.2" /end CHARACTERISTIC
/begin CHARACTERISTIC VehCoorn_maskVehVSpdVldySq_C "Calibration mask to determine vehicle speed validity" VALUE 0x80252404 RB_Val_Wu16 65535.00 OneToOne 0.00 65535.00 FORMAT "%8.2" /end CHARACTERISTIC
/begin AXIS_PTS VehCoorn_omEm_AX "Axis for angular speed for tables to calculated maximum and minimum torque" 0x802522A0 NO_INPUT_QUANTITY RB_Axis_R32 2.00000000E+037 q1_DIV_s 4 -1.00000000E+037 1.00000000E+037 FORMAT "%13.3" EXTENDED_LIMITS -3.40282347E+038 3.40282347E+038 DEPOSIT ABSOLUTE /end AXIS_PTS
/begin CHARACTERISTIC VehCoorn_pwrElecCnsAuxLongMax_C "maximum average electric consumption for auxilary consumers long term" VALUE 0x802521B4 RB_Val_Wr32 2.0000E+037 RBPtCel_pwr_1p0_1 -1.0000E+037 1.0000E+037 FORMAT "%10.4" EXTENDED_LIMITS -3.4028E+038 3.4028E+038 /end CHARACTERISTIC
/begin CHARACTERISTIC VehCoorn_pwrElecCnsAuxLongMin_C "minimum average electric consumption for auxilary consumers long term" VALUE 0x802521B8 RB_Val_Wr32 2.0000E+037 RBPtCel_pwr_1p0_1 -1.0000E+037 1.0000E+037 FORMAT "%10.4" EXTENDED_LIMITS -3.4028E+038 3.4028E+038 /end CHARACTERISTIC
/begin CHARACTERISTIC VehCoorn_pwrElecEgyCnsIni_C "Init value for VehCoorn_PwrElecWhlFPT1_I and VehCoorn_ElecEgyCnsFPT1_I" VALUE 0x802524E4 RB_Val_Wr32 2.0000E+037 RBPtCel_pwr_1p0_1 -1.0000E+037 1.0000E+037 FORMAT "%10.4" EXTENDED_LIMITS -3.4028E+038 3.4028E+038 /end CHARACTERISTIC
/begin CHARACTERISTIC VehCoorn_pwrElecMinThd_C "minimum electrical power to enable efficiency calculation" VALUE 0x802524E8 RB_Val_Wr32 2.0000E+037 RBPtCel_pwr_1p0_4 -1.0000E+037 1.0000E+037 FORMAT "%10.4" EXTENDED_LIMITS -3.4028E+038 3.4028E+038 /end CHARACTERISTIC
/begin CHARACTERISTIC VehCoorn_PwrEm_M "Table to calculate power of e-machine based on torque and angular speed" MAP 0x802522B4 RB_Map_R32R32_R32_sao 2.0000E+037 RBPtCel_pwr_1p0_1 -1.0000E+037 1.0000E+037 FORMAT "%10.4" EXTENDED_LIMITS -3.4028E+038 3.4028E+038
 /begin AXIS_DESCR STD_AXIS NO_INPUT_QUANTITY q1_DIV_s 5 -1.0000E+037 1.0000E+037 FORMAT "%10.4" EXTENDED_LIMITS -3.4028E+038 3.4028E+038 DEPOSIT ABSOLUTE /end AXIS_DESCR
 /begin AXIS_DESCR STD_AXIS NO_INPUT_QUANTITY RBPtCel_tq_1p0_1 3 -1.0000E+037 1.0000E+037 FORMAT "%10.4" EXTENDED_LIMITS -3.4028E+038 3.4028E+038 DEPOSIT ABSOLUTE /end AXIS_DESCR
/end CHARACTERISTIC
/begin CHARACTERISTIC VehCoorn_pwrIniPha_T "Curve determining the electrical power required per second in the initial phase, depending on the hv-battery temperature difference." CURVE 0x802521BC RB_Curve_R32_R32_sao 2.0000E+037 RBPtCel_pwr_1p0_1 -1.0000E+037 1.0000E+037 FORMAT "%10.4" EXTENDED_LIMITS -3.4028E+038 3.4028E+038
 /begin AXIS_DESCR STD_AXIS NO_INPUT_QUANTITY OneToOne 4 -1.00000000E+037 1.00000000E+037 FORMAT "%13.3" EXTENDED_LIMITS -3.40282347E+038 3.40282347E+038 DEPOSIT ABSOLUTE /end AXIS_DESCR
/end CHARACTERISTIC
/begin CHARACTERISTIC VehCoorn_ratCnsPrpEcoMin_C "min. energy consumption ratio for driving mode Economic" VALUE 0x80252406 RB_Val_Ws16 65.53500 RBPtCel_fac_0p001_1 -32.76800 32.76700 FORMAT "%8.5" /end CHARACTERISTIC
/begin CHARACTERISTIC VehCoorn_ratCnsPrpEcoSptOffs_C "min. offset of energy consumption ratio between driving mode Economic and Sport" VALUE 0x80252408 RB_Val_Ws16 65.53500 RBPtCel_fac_0p001_1 -32.76800 32.76700 FORMAT "%8.5" /end CHARACTERISTIC
/begin CHARACTERISTIC VehCoorn_ratCnsPrpNormEcoOffs_C "min. offset of energy consumption ratio between driving mode Normal and Economic" VALUE 0x8025240A RB_Val_Ws16 65.53500 RBPtCel_fac_0p001_1 -32.76800 32.76700 FORMAT "%8.5" /end CHARACTERISTIC
/begin CHARACTERISTIC VehCoorn_ratCnsPrpNormSptOffs_C "min. offset of energy consumption ratio between driving mode Normal and Sport" VALUE 0x8025240C RB_Val_Ws16 65.53500 RBPtCel_fac_0p001_1 -32.76800 32.76700 FORMAT "%8.5" /end CHARACTERISTIC
/begin CHARACTERISTIC VehCoorn_ratSocRngPrdcDispHi_C "Parameter value HV-Battery SOC high threshold for post processing predictive range for HMI display" VALUE 0x8025260C RB_Val_Ws16 799.9878 Prc -400.0000 399.9878 FORMAT "%10.4" /end CHARACTERISTIC
/begin CHARACTERISTIC VehCoorn_ratSocRngPrdcDispLo_C "Paramter value HV-Battery SOC low threshold for post processing predictive range for HMI display" VALUE 0x8025260E RB_Val_Ws16 799.9878 Prc -400.0000 399.9878 FORMAT "%10.4" /end CHARACTERISTIC
/begin AXIS_PTS VehCoorn_ratSoc_AX "Axis for state of charge (SOC) for calculation of inner resistance and open circuit voltage" 0x80252318 NO_INPUT_QUANTITY RB_Axis_R32 2.00000000E+037 RBPtCel_Perc_1p0_1 5 -1.00000000E+037 1.00000000E+037 FORMAT "%13.3" EXTENDED_LIMITS -3.40282347E+038 3.40282347E+038 DEPOSIT ABSOLUTE /end AXIS_PTS
/begin CHARACTERISTIC VehCoorn_ratTrms_C "Transmission ration between E-machine and wheel" VALUE 0x80252330 RB_Val_Wr32 2.0000E+037 RBPtCel_fac_1p0_1 -1.0000E+037 1.0000E+037 FORMAT "%10.4" EXTENDED_LIMITS -3.4028E+038 3.4028E+038 /end CHARACTERISTIC
/begin CHARACTERISTIC VehCoorn_rInnrChrg_T "Table to determine inner resistance during discharging of HV battery based on state of charge (SOC)" CURVE 0x80252334 RB_CurveGroup_R32 2.0000E+037 RBPtCel_r_1p0_1 -1.0000E+037 1.0000E+037 FORMAT "%10.4" EXTENDED_LIMITS -3.4028E+038 3.4028E+038
 /begin AXIS_DESCR COM_AXIS NO_INPUT_QUANTITY RBPtCel_Perc_1p0_1 5 -1.00000000E+037 1.00000000E+037 FORMAT "%13.3" EXTENDED_LIMITS -3.40282347E+038 3.40282347E+038 AXIS_PTS_REF VehCoorn_ratSoc_AX /end AXIS_DESCR
/end CHARACTERISTIC
/begin CHARACTERISTIC VehCoorn_rInnrDcha_T "Table to determine inner resistance during charging of HV battery based on state of charge (SOC)" CURVE 0x80252348 RB_CurveGroup_R32 2.0000E+037 RBPtCel_r_1p0_1 -1.0000E+037 1.0000E+037 FORMAT "%10.4" EXTENDED_LIMITS -3.4028E+038 3.4028E+038
 /begin AXIS_DESCR COM_AXIS NO_INPUT_QUANTITY RBPtCel_Perc_1p0_1 5 -1.00000000E+037 1.00000000E+037 FORMAT "%13.3" EXTENDED_LIMITS -3.40282347E+038 3.40282347E+038 AXIS_PTS_REF VehCoorn_ratSoc_AX /end AXIS_DESCR
/end CHARACTERISTIC
/begin CHARACTERISTIC VehCoorn_tDeltaCbnMax_C "maximum temperature difference of the cabin" VALUE 0x802521E0 RB_Val_Ws16 6553.500 TempDiff_Kelv -3276.800 3276.700 FORMAT "%8.3" /end CHARACTERISTIC
/begin CHARACTERISTIC VehCoorn_tEgyPerDeltaKElecCnsAux_C "temperature span over which to calculate the energy required to heat or cool a degree kelvin of hvbattery and cabin" VALUE 0x802521E4 RB_Val_Wr32 2.0000E+037 RBPtCel_t_1p0_1 -1.0000E+037 1.0000E+037 FORMAT "%10.4" EXTENDED_LIMITS -3.4028E+038 3.4028E+038 /end CHARACTERISTIC
/begin CHARACTERISTIC VehCoorn_tiCdngMax_C "The maximum time the conditioning of the cabin and HV-Battery are allowed to take" VALUE 0x802521E8 RB_Val_Wu16 65535.0000 Time_1s 0.0000 65535.0000 FORMAT "%10.4" /end CHARACTERISTIC
/begin CHARACTERISTIC VehCoorn_tiCnsAvrgSampleTmr_C "Calibratable timing value for sample average consumption" VALUE 0x802524EC RB_Val_Wu8 255.0 Time_sec_q1_COMPU 0.00 255.0 FORMAT "%5.1" /end CHARACTERISTIC
/begin CHARACTERISTIC VehCoorn_tiCnsTripAvrgSampleTmr_C "Calibratable timing value for sample trip average consumption" VALUE 0x802524ED RB_Val_Wu8 255.0 Time_sec_q1_COMPU 0.00 255.0 FORMAT "%5.1" /end CHARACTERISTIC
/begin CHARACTERISTIC VehCoorn_tiElecCnsAuxDistLong_C "Update time for calculation of average electric consumption over distance for auxilary consumers long term" VALUE 0x802521EC RB_Val_Wr32 2.0000E+037 RBPtCel_ti_1p0_2 -1.0000E+037 1.0000E+037 FORMAT "%10.4" EXTENDED_LIMITS -3.4028E+038 3.4028E+038 /end CHARACTERISTIC
/begin CHARACTERISTIC VehCoorn_tiElecCnsAuxDistSho_C "Update time for calculation of average electric consumption over distance for auxilary consumers short term" VALUE 0x802521F0 RB_Val_Wr32 2.0000E+037 RBPtCel_ti_1p0_2 -1.0000E+037 1.0000E+037 FORMAT "%10.4" EXTENDED_LIMITS -3.4028E+038 3.4028E+038 /end CHARACTERISTIC
/begin CHARACTERISTIC VehCoorn_tiElecCnsAuxT_C "Time-sensitivity of the temperature based weighting of the auxiliary consumption." VALUE 0x802521F4 RB_Val_Wr32 2.0000E+037 RBPtCel_ti_1p0_2 -1.0000E+037 1.0000E+037 FORMAT "%10.4" EXTENDED_LIMITS -3.4028E+038 3.4028E+038 /end CHARACTERISTIC
/begin CHARACTERISTIC VehCoorn_tiIniPhaDur_T "Parameterization of the duration of the initial phase" CURVE 0x802521F8 RB_Curve_S16_U16_sao 65535.0000 RBPtCel_ti_1p0_2 0.0000 65535.0000 FORMAT "%10.4"
 /begin AXIS_DESCR STD_AXIS VehCoorn_tDeltaHvBatt TempDiff_Kelv 5 -3276.800 3276.700 FORMAT "%8.3" DEPOSIT ABSOLUTE /end AXIS_DESCR
/end CHARACTERISTIC
/begin CHARACTERISTIC VehCoorn_tiPerDeltaKElecCnsAuxTraMax_C "Maximum time to heat or cool a degree Kelvin of the HVB." VALUE 0x80252210 RB_Val_Wr32 2.0000E+037 RBPtCel_ti_1p0_2 -1.0000E+037 1.0000E+037 FORMAT "%10.4" EXTENDED_LIMITS -3.4028E+038 3.4028E+038 /end CHARACTERISTIC
/begin CHARACTERISTIC VehCoorn_tiPerDeltaKElecCnsAuxTraMin_C "Minimum time to heat or cool a degree Kelvin of the HVB." VALUE 0x80252214 RB_Val_Wr32 2.0000E+037 RBPtCel_ti_1p0_2 -1.0000E+037 1.0000E+037 FORMAT "%10.4" EXTENDED_LIMITS -3.4028E+038 3.4028E+038 /end CHARACTERISTIC
/begin CHARACTERISTIC VehCoorn_tiPerDeltaKElecCnsAuxTra_CA "Initial-values for the time required to heat or cool a degree kelvin of the HvBatt resp. Cabin" VAL_BLK 0x80252218 RB_ValA_Wr32 2.0000E+037 RBPtCel_ti_1p0_2 -1.0000E+037 1.0000E+037 FORMAT "%10.4" EXTENDED_LIMITS -3.4028E+038 3.4028E+038 MATRIX_DIM 15 /end CHARACTERISTIC
/begin CHARACTERISTIC VehCoorn_tiPrmsCalcnHld_C "Time for which average consumptions are still considered up-to-date" VALUE 0x802524EE RB_Val_Ws16 65535.00 Time_1s -32768.00 32767.00 FORMAT "%8.2" /end CHARACTERISTIC
/begin CHARACTERISTIC VehCoorn_tiPt1EffElec_C "filter time for electritc efficiency" VALUE 0x802524F0 RB_Val_Wr32 2.0000E+037 RBPtCel_ti_1p0_2 -1.0000E+037 1.0000E+037 FORMAT "%10.4" EXTENDED_LIMITS -3.4028E+038 3.4028E+038 /end CHARACTERISTIC
/begin CHARACTERISTIC VehCoorn_tiVElecCnsAuxLong_C "Update time for calculation of average velocity long term" VALUE 0x80252254 RB_Val_Wr32 2.0000E+037 RBPtCel_ti_1p0_2 -1.0000E+037 1.0000E+037 FORMAT "%10.4" EXTENDED_LIMITS -3.4028E+038 3.4028E+038 /end CHARACTERISTIC
/begin CHARACTERISTIC VehCoorn_tiVElecCnsAuxSho_C "Update time for calculation of average velocity short term" VALUE 0x80252258 RB_Val_Wr32 2.0000E+037 RBPtCel_ti_1p0_2 -1.0000E+037 1.0000E+037 FORMAT "%10.4" EXTENDED_LIMITS -3.4028E+038 3.4028E+038 /end CHARACTERISTIC
/begin CHARACTERISTIC VehCoorn_tiVElecCnsAuxT_C "Time-sensitivity for vehicle speed for the temperature based weighting of the auxiliary consumption." VALUE 0x8025225C RB_Val_Wr32 2.0000E+037 RBPtCel_ti_1p0_2 -1.0000E+037 1.0000E+037 FORMAT "%10.4" EXTENDED_LIMITS -3.4028E+038 3.4028E+038 /end CHARACTERISTIC
/begin CHARACTERISTIC VehCoorn_tNoHeatg_C "minimum refernece temperature with running engine" VALUE 0x80252260 RB_Val_Ws16 6553.5000 Temp_Cels -3549.9400 3003.5600 FORMAT "%10.4" /end CHARACTERISTIC
/begin CHARACTERISTIC VehCoorn_tqEmMax_T "Table to calculated maximum e-machine torque" CURVE 0x8025235C RB_CurveGroup_R32 2.0000E+037 RBPtCel_tq_1p0_1 -1.0000E+037 1.0000E+037 FORMAT "%10.4" EXTENDED_LIMITS -3.4028E+038 3.4028E+038
 /begin AXIS_DESCR COM_AXIS NO_INPUT_QUANTITY q1_DIV_s 4 -1.00000000E+037 1.00000000E+037 FORMAT "%13.3" EXTENDED_LIMITS -3.40282347E+038 3.40282347E+038 AXIS_PTS_REF VehCoorn_omEm_AX /end AXIS_DESCR
/end CHARACTERISTIC
/begin CHARACTERISTIC VehCoorn_tqEmMin_T "Table to calculated minimum e-machine torque" CURVE 0x8025236C RB_CurveGroup_R32 2.0000E+037 RBPtCel_tq_1p0_1 -1.0000E+037 1.0000E+037 FORMAT "%10.4" EXTENDED_LIMITS -3.4028E+038 3.4028E+038
 /begin AXIS_DESCR COM_AXIS NO_INPUT_QUANTITY q1_DIV_s 4 -1.00000000E+037 1.00000000E+037 FORMAT "%13.3" EXTENDED_LIMITS -3.40282347E+038 3.40282347E+038 AXIS_PTS_REF VehCoorn_omEm_AX /end AXIS_DESCR
/end CHARACTERISTIC
/begin CHARACTERISTIC VehCoorn_tqLossGbx_M "Table to calculate torques loss of gearbox based on torque and angular speed" MAP 0x8025237C RB_Map_R32R32_R32_sao 2.0000E+037 RBPtCel_tq_1p0_1 -1.0000E+037 1.0000E+037 FORMAT "%10.4" EXTENDED_LIMITS -3.4028E+038 3.4028E+038
 /begin AXIS_DESCR STD_AXIS NO_INPUT_QUANTITY q1_DIV_s 5 -1.0000E+037 1.0000E+037 FORMAT "%10.4" EXTENDED_LIMITS -3.4028E+038 3.4028E+038 DEPOSIT ABSOLUTE /end AXIS_DESCR
 /begin AXIS_DESCR STD_AXIS NO_INPUT_QUANTITY RBPtCel_tq_1p0_1 3 -1.0000E+037 1.0000E+037 FORMAT "%10.4" EXTENDED_LIMITS -3.4028E+038 3.4028E+038 DEPOSIT ABSOLUTE /end AXIS_DESCR
/end CHARACTERISTIC
/begin CHARACTERISTIC VehCoorn_tTiPerDeltaKElecCnsAuxTra_C "Filter constant for time to heat or cool a degree Kelvin of the HVB." VALUE 0x80252264 RB_Val_Wr32 2.0000E+037 RBPtCel_t_1p0_1 -1.0000E+037 1.0000E+037 FORMAT "%10.4" EXTENDED_LIMITS -3.4028E+038 3.4028E+038 /end CHARACTERISTIC
/begin CHARACTERISTIC VehCoorn_uOcv_T "Table to determine open circuit voltage of HV battery based on state of charge (SOC)" CURVE 0x802523E0 RB_CurveGroup_R32 2.0000E+037 RBPtCel_u_1p0_1 -1.0000E+037 1.0000E+037 FORMAT "%10.4" EXTENDED_LIMITS -3.4028E+038 3.4028E+038
 /begin AXIS_DESCR COM_AXIS NO_INPUT_QUANTITY RBPtCel_Perc_1p0_1 5 -1.00000000E+037 1.00000000E+037 FORMAT "%13.3" EXTENDED_LIMITS -3.40282347E+038 3.40282347E+038 AXIS_PTS_REF VehCoorn_ratSoc_AX /end AXIS_DESCR
/end CHARACTERISTIC
/begin CHARACTERISTIC VehCoorn_vElecCnsAuxAvrg_C "Initialization value for average vehcicle speed for calculating electric consumption for auxilary consumers" VALUE 0x80252268 RB_Val_Wr32 2.0000E+037 q1p0_m_DIV_s -1.0000E+037 1.0000E+037 FORMAT "%10.4" EXTENDED_LIMITS -3.4028E+038 3.4028E+038 /end CHARACTERISTIC
/begin CHARACTERISTIC VehCoorn_vElecCnsAvrgAuxMax_C "maximum average vehicle speed forclaculation of average electric consumption for auxilary consumers" VALUE 0x8025226C RB_Val_Wr32 2.0000E+037 q1p0_m_DIV_s -1.0000E+037 1.0000E+037 FORMAT "%10.4" EXTENDED_LIMITS -3.4028E+038 3.4028E+038 /end CHARACTERISTIC
/begin CHARACTERISTIC VehCoorn_vElecCnsAvrgAuxMin_C "minimum average vehicle speed forclaculation of average electric consumption for auxilary consumers" VALUE 0x80252270 RB_Val_Wr32 2.0000E+037 q1p0_m_DIV_s -1.0000E+037 1.0000E+037 FORMAT "%10.4" EXTENDED_LIMITS -3.4028E+038 3.4028E+038 /end CHARACTERISTIC
/begin CHARACTERISTIC VehCoorn_vElecCnsAvrgAuxTMax_C "maximum long-term average speed for temperature conditioning dependent auxiliary consumption calculation" VALUE 0x80252274 RB_Val_Wr32 2.0000E+037 q1p0_m_DIV_s -1.0000E+037 1.0000E+037 FORMAT "%10.4" EXTENDED_LIMITS -3.4028E+038 3.4028E+038 /end CHARACTERISTIC
/begin CHARACTERISTIC VehCoorn_vElecCnsAvrgAuxTMin_C "minimum long-term average speed for temperature conditioning dependent auxiliary consumption calculation" VALUE 0x80252278 RB_Val_Wr32 2.0000E+037 q1p0_m_DIV_s -1.0000E+037 1.0000E+037 FORMAT "%10.4" EXTENDED_LIMITS -3.4028E+038 3.4028E+038 /end CHARACTERISTIC
/begin CHARACTERISTIC VehCoorn_vMaxExclDrv_C "Threshold for maximum vehicle speed for systemt failures not triggered during drive" VALUE 0x80252614 RB_Val_Ws16 655.3500 Vel -327.6800 327.6700 FORMAT "%8.4" /end CHARACTERISTIC
/begin CHARACTERISTIC VehCoorn_wCnsPrpAvrg_C "Initialization value for average electric consumption for propulsion" VALUE 0x80252410 RB_Val_Wr32 2.0000E+037 q1_W_s_DIV_m -1.0000E+037 1.0000E+037 FORMAT "%10.4" EXTENDED_LIMITS -3.4028E+038 3.4028E+038 /end CHARACTERISTIC
/begin CHARACTERISTIC VehCoorn_wCnsPrpLongMax_C "maximum average electric consumption for propulsion long term" VALUE 0x80252414 RB_Val_Wr32 2.0000E+037 q1_W_s_DIV_m -1.0000E+037 1.0000E+037 FORMAT "%10.4" EXTENDED_LIMITS -3.4028E+038 3.4028E+038 /end CHARACTERISTIC
/begin CHARACTERISTIC VehCoorn_wCnsPrpLongMin_C "minimum average electric consumption for propulsion long term" VALUE 0x80252418 RB_Val_Wr32 2.0000E+037 q1_W_s_DIV_m -1.0000E+037 1.0000E+037 FORMAT "%10.4" EXTENDED_LIMITS -3.4028E+038 3.4028E+038 /end CHARACTERISTIC
/begin CHARACTERISTIC VehCoorn_wCnsPrpShoMax_C "maximum average consumption for propulsion long term" VALUE 0x8025241C RB_Val_Wr32 2.0000E+037 q1_W_s_DIV_m -1.0000E+037 1.0000E+037 FORMAT "%10.4" EXTENDED_LIMITS -3.4028E+038 3.4028E+038 /end CHARACTERISTIC
/begin CHARACTERISTIC VehCoorn_wCnsPrpShoMin_C "minimum average consumption for propulsion short term" VALUE 0x80252420 RB_Val_Wr32 2.0000E+037 q1_W_s_DIV_m -1.0000E+037 1.0000E+037 FORMAT "%10.4" EXTENDED_LIMITS -3.4028E+038 3.4028E+038 /end CHARACTERISTIC
/begin CHARACTERISTIC VehCoorn_wCnsPrpShoRngMax_C "maximum Range for average consumption for propulsion short term (around long term value)" VALUE 0x80252424 RB_Val_Wr32 2.0000E+037 q1_W_s_DIV_m -1.0000E+037 1.0000E+037 FORMAT "%10.4" EXTENDED_LIMITS -3.4028E+038 3.4028E+038 /end CHARACTERISTIC
/begin CHARACTERISTIC VehCoorn_wCnsPrpShoRngMin_C "minimum Range for average consumption for propulsion short term (around long term value)" VALUE 0x80252428 RB_Val_Wr32 2.0000E+037 q1_W_s_DIV_m -1.0000E+037 1.0000E+037 FORMAT "%10.4" EXTENDED_LIMITS -3.4028E+038 3.4028E+038 /end CHARACTERISTIC
/begin CHARACTERISTIC VehCoorn_wCnsTotWghtAvrgDft_C "Calibration for default total weighted average consumption" VALUE 0x802524F4 RB_Val_Wr32 2.0000E+037 q1_W_s_DIV_m -1.0000E+037 1.0000E+037 FORMAT "%10.4" EXTENDED_LIMITS -3.4028E+038 3.4028E+038 /end CHARACTERISTIC
/begin CHARACTERISTIC VehCoorn_wCnsTotWghtAvrgRstVal_M "Map to indicate the total consumption average weight reset value" MAP 0x802524F8 RB_Map_S16S16_R32_sao 2.0000E+037 q1_W_s_DIV_m -1.0000E+037 1.0000E+037 FORMAT "%10.4" EXTENDED_LIMITS -3.4028E+038 3.4028E+038
 /begin AXIS_DESCR STD_AXIS HvBatt_tActMeasd Temp_Cels 3 -3549.9400 3003.5600 FORMAT "%10.4" DEPOSIT ABSOLUTE /end AXIS_DESCR
 /begin AXIS_DESCR STD_AXIS HvBatt_ratSoh Prc 2 -400.0000 399.9878 FORMAT "%10.4" DEPOSIT ABSOLUTE /end AXIS_DESCR
/end CHARACTERISTIC
/begin CHARACTERISTIC VehCoorn_wCnsTotWghtTripAvrgDft_C "Calibration for default total trip weighted average consumption" VALUE 0x80252520 RB_Val_Wr32 2.0000E+037 q1_W_s_DIV_m -1.0000E+037 1.0000E+037 FORMAT "%10.4" EXTENDED_LIMITS -3.4028E+038 3.4028E+038 /end CHARACTERISTIC
/begin CHARACTERISTIC VehCoorn_wElecCnsAuxDistAvrg_C "Initialization value for average electric consumption for auxilary consumers" VALUE 0x8025227C RB_Val_Wr32 2.0000E+037 q1_W_s_DIV_m -1.0000E+037 1.0000E+037 FORMAT "%10.4" EXTENDED_LIMITS -3.4028E+038 3.4028E+038 /end CHARACTERISTIC
/begin CHARACTERISTIC VehCoorn_wElecCnsAuxDistLongMax_C "maximum average electric consumption for auxilary consumers long term" VALUE 0x80252280 RB_Val_Wr32 2.0000E+037 q1_W_s_DIV_m -1.0000E+037 1.0000E+037 FORMAT "%10.4" EXTENDED_LIMITS -3.4028E+038 3.4028E+038 /end CHARACTERISTIC
/begin CHARACTERISTIC VehCoorn_wElecCnsAuxDistLongMin_C "minimum average electric consumption for auxilary consumers long term" VALUE 0x80252284 RB_Val_Wr32 2.0000E+037 q1_W_s_DIV_m -1.0000E+037 1.0000E+037 FORMAT "%10.4" EXTENDED_LIMITS -3.4028E+038 3.4028E+038 /end CHARACTERISTIC
/begin CHARACTERISTIC VehCoorn_wElecCnsAuxDistShoMax_C "maximum average electric consumption for auxilary consumers short term" VALUE 0x80252288 RB_Val_Wr32 2.0000E+037 q1_W_s_DIV_m -1.0000E+037 1.0000E+037 FORMAT "%10.4" EXTENDED_LIMITS -3.4028E+038 3.4028E+038 /end CHARACTERISTIC
/begin CHARACTERISTIC VehCoorn_wElecCnsAuxDistShoMin_C "minimum average electric consumption for auxilary consumers short term" VALUE 0x8025228C RB_Val_Wr32 2.0000E+037 q1_W_s_DIV_m -1.0000E+037 1.0000E+037 FORMAT "%10.4" EXTENDED_LIMITS -3.4028E+038 3.4028E+038 /end CHARACTERISTIC
/begin CHARACTERISTIC VehCoorn_wElecCnsAuxTMax_C "Maximum power average of the temperature based weighting of the auxiliary consumption" VALUE 0x80252290 RB_Val_Wr32 2.0000E+037 q1_W_s_DIV_m -1.0000E+037 1.0000E+037 FORMAT "%10.4" EXTENDED_LIMITS -3.4028E+038 3.4028E+038 /end CHARACTERISTIC
/begin CHARACTERISTIC VehCoorn_wElecCnsAuxTMin_C "Minimum power average of the temperature based weighting of the auxiliary consumption" VALUE 0x80252294 RB_Val_Wr32 2.0000E+037 q1_W_s_DIV_m -1.0000E+037 1.0000E+037 FORMAT "%10.4" EXTENDED_LIMITS -3.4028E+038 3.4028E+038 /end CHARACTERISTIC
/begin MEASUREMENT ACCmpr_pwrLoadMngtMaxPred "Maximum power load management prediction of AC compressor" SWORD RBPtCel_pwr_25p0_1 1 100 -819200.0 819175.0 FORMAT "%8.1" ECU_ADDRESS 0x6001FA14
 /begin IF_DATA XCPplus 0x0102
  /begin DAQ_EVENT VARIABLE /end DAQ_EVENT
 /end IF_DATA
/end MEASUREMENT
/begin MEASUREMENT ACCtl_flgCmprEna "Air condition compressor enable" UBYTE B_TRUE 1 100 0.00 1.00000000000 BIT_MASK 0x1 FORMAT "%13.11" ECU_ADDRESS 0x70000298
 /begin IF_DATA XCPplus 0x0102
  /begin DAQ_EVENT VARIABLE /end DAQ_EVENT
 /end IF_DATA
/end MEASUREMENT
/begin MEASUREMENT ACCtl_nCmprSpdReq "Air condition compressor speed request" UBYTE RBPtCel_n_50p0_1 1 100 0.00 12750. FORMAT "%5.0" ECU_ADDRESS 0x6002346D
 /begin IF_DATA XCPplus 0x0102
  /begin DAQ_EVENT VARIABLE /end DAQ_EVENT
 /end IF_DATA
/end MEASUREMENT
/begin MEASUREMENT CbnAirT_tEvapAct "cabin air evaporator temperature actual" SWORD q0p1_K 1 100 -3276.800 3276.700 FORMAT "%8.3" ECU_ADDRESS 0x6001FA02
 /begin IF_DATA XCPplus 0x0102
  /begin DAQ_EVENT VARIABLE /end DAQ_EVENT
 /end IF_DATA
/end MEASUREMENT
/begin MEASUREMENT CbnAirT_tEvapDes "cabin air evaporator temperature desired" SWORD q0p1_K 1 100 -3276.800 3276.700 FORMAT "%8.3" ECU_ADDRESS 0x6001FA00
 /begin IF_DATA XCPplus 0x0102
  /begin DAQ_EVENT VARIABLE /end DAQ_EVENT
 /end IF_DATA
/end MEASUREMENT
/begin MEASUREMENT CbnHeatgHeatr_cntrRlyLf_old "hold previous state of FAST_CHRG_NEG_CONT_COUNT signal value" SLONG OneToOne 1 100 -2147483648.00 2147483647.00 FORMAT "%13.2" ECU_ADDRESS 0x60000E08
 /begin IF_DATA XCPplus 0x0102
  /begin DAQ_EVENT VARIABLE /end DAQ_EVENT
 /end IF_DATA
/end MEASUREMENT
/begin MEASUREMENT ChrgCntct_nrNegCntctElpdOper_old "hold previous state of FAST_CHRG_NEG_CONT_COUNT signal value" ULONG OneToOne 1 100 0.00 4294967295.00 FORMAT "%13.2" ECU_ADDRESS 0x60000F0C
 /begin IF_DATA XCPplus 0x0102
  /begin DAQ_EVENT VARIABLE /end DAQ_EVENT
 /end IF_DATA
/end MEASUREMENT
/begin MEASUREMENT ChrgCntct_nrPosCntctElpdOper_old "hold previous state of FAST_CHRG_POS_CONT_COUNT signal value" ULONG OneToOne 1 100 0.00 4294967295.00 FORMAT "%13.2" ECU_ADDRESS 0x60000F00
 /begin IF_DATA XCPplus 0x0102
  /begin DAQ_EVENT VARIABLE /end DAQ_EVENT
 /end IF_DATA
/end MEASUREMENT
/begin MEASUREMENT ChrgrVal_pwrOutFild "Filtered charger power" SWORD RBPtCel_pwr_25p0_1 1 100 -819200.0 819175.0 FORMAT "%8.1" ECU_ADDRESS 0x6001F3DA
 /begin IF_DATA XCPplus 0x0102
  /begin DAQ_EVENT VARIABLE /end DAQ_EVENT
 /end IF_DATA
/end MEASUREMENT
/begin MEASUREMENT ChrgrVal_tFild "Filtered charger temperature" SWORD RBPtCel_t_0p02_1 1 100 -655.3600 655.3400 FORMAT "%8.4" ECU_ADDRESS 0x6001F3D8
 /begin IF_DATA XCPplus 0x0102
  /begin DAQ_EVENT VARIABLE /end DAQ_EVENT
 /end IF_DATA
/end MEASUREMENT
/begin MEASUREMENT CmprDsFldP_p_f "AC compressor outlet pressure value" FLOAT32_IEEE RBPtCel_p_1p0_1 1 100 -1.0000E+037 1.0000E+037 FORMAT "%10.4" ECU_ADDRESS 0x60000EAC
 /begin IF_DATA XCPplus 0x0102
  /begin DAQ_EVENT VARIABLE /end DAQ_EVENT
 /end IF_DATA
/end MEASUREMENT
/begin MEASUREMENT Com_bACTPduCtrl "interface to indicate if we want to disable 208 and 211 frame" UBYTE B_TRUE 1 100 0.00 1.00000000000 BIT_MASK 0x1 FORMAT "%13.11" ECU_ADDRESS 0x700014A2
 /begin IF_DATA XCPplus 0x0102
  /begin DAQ_EVENT VARIABLE /end DAQ_EVENT
 /end IF_DATA
/end MEASUREMENT
/begin MEASUREMENT Com_bfPtlWkuReq_old "Interface to store the previous value of Com_bfPtlWkuReq" UWORD OneToOne 1 100 0.00 65535.00 FORMAT "%8.2" ECU_ADDRESS 0x70001512
 /begin IF_DATA XCPplus 0x0102
  /begin DAQ_EVENT VARIABLE /end DAQ_EVENT
 /end IF_DATA
/end MEASUREMENT
/begin MEASUREMENT Com_bGlbDaPduCtrl "interface to indicate applicability for glbda condition" UBYTE B_TRUE 1 100 0.00 1.00000000000 BIT_MASK 0x1 FORMAT "%13.11" ECU_ADDRESS 0x700014A0
 /begin IF_DATA XCPplus 0x0102
  /begin DAQ_EVENT VARIABLE /end DAQ_EVENT
 /end IF_DATA
/end MEASUREMENT
/begin MEASUREMENT Com_BINStgyNumEvtDetc "Event has been detected" UBYTE OneToOne 1 100 0.00 255.0 FORMAT "%5.1" ECU_ADDRESS 0x700014ED
 /begin IF_DATA XCPplus 0x0102
  /begin DAQ_EVENT VARIABLE /end DAQ_EVENT
 /end IF_DATA
/end MEASUREMENT
/begin MEASUREMENT Com_BINStgyTxTmr "Reset the timer" UWORD OneToOne 1 100 0.00 65535.00 FORMAT "%8.2" ECU_ADDRESS 0x70001514
 /begin IF_DATA XCPplus 0x0102
  /begin DAQ_EVENT VARIABLE /end DAQ_EVENT
 /end IF_DATA
/end MEASUREMENT
/begin MEASUREMENT Com_BINStgyTxTmr_Sts "Timer Reset" UBYTE BINStgyTxTmrSts_VERB 1 100 0.00 3.00000000000 FORMAT "%13.11" ECU_ADDRESS 0x700014EC
 /begin IF_DATA XCPplus 0x0102
  /begin DAQ_EVENT VARIABLE /end DAQ_EVENT
 /end IF_DATA
/end MEASUREMENT
/begin MEASUREMENT Com_Evt468Detc "Event has been detected" UBYTE OneToOne 1 100 0.00 255.0 FORMAT "%5.1" ECU_ADDRESS 0x700014E9
 /begin IF_DATA XCPplus 0x0102
  /begin DAQ_EVENT VARIABLE /end DAQ_EVENT
 /end IF_DATA
/end MEASUREMENT
/begin MEASUREMENT Com_Evt481Detc "Event has been detected" UBYTE OneToOne 1 100 0.00 255.0 FORMAT "%5.1" ECU_ADDRESS 0x700014E8
 /begin IF_DATA XCPplus 0x0102
  /begin DAQ_EVENT VARIABLE /end DAQ_EVENT
 /end IF_DATA
/end MEASUREMENT
/begin MEASUREMENT Com_Evt481TxTmr "Reset the timer" UBYTE OneToOne 1 100 0.00 255.0 FORMAT "%5.1" ECU_ADDRESS 0x700014E7
 /begin IF_DATA XCPplus 0x0102
  /begin DAQ_EVENT VARIABLE /end DAQ_EVENT
 /end IF_DATA
/end MEASUREMENT
/begin MEASUREMENT Com_Evt481TxTmr_Sts "Timer Reset" UBYTE BINStgyTxTmrSts_VERB 1 100 0.00 3.00000000000 FORMAT "%13.11" ECU_ADDRESS 0x700014E6
 /begin IF_DATA XCPplus 0x0102
  /begin DAQ_EVENT VARIABLE /end DAQ_EVENT
 /end IF_DATA
/end MEASUREMENT
/begin MEASUREMENT Com_Evt4A2Detc "Event has been detected" UBYTE OneToOne 1 100 0.00 255.0 FORMAT "%5.1" ECU_ADDRESS 0x700014E5
 /begin IF_DATA XCPplus 0x0102
  /begin DAQ_EVENT VARIABLE /end DAQ_EVENT
 /end IF_DATA
/end MEASUREMENT
/begin MEASUREMENT Com_Evt501Detc "Event has been detected" UBYTE OneToOne 1 100 0.00 255.0 FORMAT "%5.1" ECU_ADDRESS 0x700014E4
 /begin IF_DATA XCPplus 0x0102
  /begin DAQ_EVENT VARIABLE /end DAQ_EVENT
 /end IF_DATA
/end MEASUREMENT
/begin MEASUREMENT Com_Evt501TxTmr "Reset the timer" UBYTE OneToOne 1 100 0.00 255.0 FORMAT "%5.1" ECU_ADDRESS 0x700014E3
 /begin IF_DATA XCPplus 0x0102
  /begin DAQ_EVENT VARIABLE /end DAQ_EVENT
 /end IF_DATA
/end MEASUREMENT
/begin MEASUREMENT Com_Evt501TxTmr_Sts "Timer Reset" UBYTE BINStgyTxTmrSts_VERB 1 100 0.00 3.00000000000 FORMAT "%13.11" ECU_ADDRESS 0x700014E2
 /begin IF_DATA XCPplus 0x0102
  /begin DAQ_EVENT VARIABLE /end DAQ_EVENT
 /end IF_DATA
/end MEASUREMENT
/begin MEASUREMENT Com_noEditCal "Definiton fro Com_noEditCal" UBYTE OneToOne 1 100 0.00 255.0 FORMAT "%5.1" ECU_ADDRESS 0x60023844 /end MEASUREMENT
/begin MEASUREMENT Com_noEditSw "Definition for Com_noEditSw" UBYTE OneToOne 1 100 0.00 255.0 FORMAT "%5.1" ECU_ADDRESS 0x60023843 /end MEASUREMENT
/begin MEASUREMENT Com_noVersAdp "Supplier application" UBYTE OneToOne 1 100 0.00 255.0 FORMAT "%5.1" ECU_ADDRESS 0x60023841 /end MEASUREMENT
/begin MEASUREMENT Com_noVersSw "Software version" UBYTE OneToOne 1 100 0.00 255.0 FORMAT "%5.1" ECU_ADDRESS 0x60023840 /end MEASUREMENT
/begin MEASUREMENT Com_noVersSys "System version" UBYTE OneToOne 1 100 0.00 255.0 FORMAT "%5.1" ECU_ADDRESS 0x6002383F /end MEASUREMENT
/begin MEASUREMENT Com_noVersSysMnth "Date : month of the version" UBYTE OneToOne 1 100 0.00 255.0 FORMAT "%5.1" ECU_ADDRESS 0x6002383E /end MEASUREMENT
/begin MEASUREMENT Com_noVersSysYr "Date : year of the version" UBYTE OneToOne 1 100 0.00 255.0 FORMAT "%5.1" ECU_ADDRESS 0x6002383D /end MEASUREMENT
/begin MEASUREMENT Com_noVerSysDay "Date : day of the version" UBYTE OneToOne 1 100 0.00 255.0 FORMAT "%5.1" ECU_ADDRESS 0x60023842 /end MEASUREMENT
/begin MEASUREMENT Com_stBrkCntctIndcn_old "hold previous state of PTC_POS_CONT_COUNT signal" UBYTE B_TRUE 1 100 0.00 1.00000000000 BIT_MASK 0x1 FORMAT "%13.11" ECU_ADDRESS 0x600234B0
 /begin IF_DATA XCPplus 0x0102
  /begin DAQ_EVENT VARIABLE /end DAQ_EVENT
 /end IF_DATA
/end MEASUREMENT
/begin MEASUREMENT Com_stChrgPlg_old "hold previous state of PTC_POS_CONT_COUNT signal" UBYTE OneToOne 1 100 0.00 255.0 FORMAT "%5.1" ECU_ADDRESS 0x60023831
 /begin IF_DATA XCPplus 0x0102
  /begin DAQ_EVENT VARIABLE /end DAQ_EVENT
 /end IF_DATA
/end MEASUREMENT
/begin MEASUREMENT DDRC_St.DFC_UCtPSRCMin "" ULONG DFC_OneToOne 1 100 0.00 536870911.000 BIT_MASK 0x1fffffff FORMAT "%13.3" ECU_ADDRESS 0x6001CAAC /end MEASUREMENT
/begin MEASUREMENT DDRC_St.DFC_UPxP1SRCMin "" ULONG DFC_OneToOne 1 100 0.00 536870911.000 BIT_MASK 0x1fffffff FORMAT "%13.3" ECU_ADDRESS 0x6001CAB0 /end MEASUREMENT
/begin MEASUREMENT DDRC_St.DFC_UCtPPhysRngHi "" UWORD DFC_OneToOne 1 100 0.00 8191.000 BIT_MASK 0x1fff FORMAT "%8.3" ECU_ADDRESS 0x60021FE4 /end MEASUREMENT
/begin MEASUREMENT DDRC_St.DFC_UCtPPhysRngLo "" UWORD DFC_OneToOne 1 100 0.00 8191.000 BIT_MASK 0x1fff FORMAT "%8.3" ECU_ADDRESS 0x60021FE6 /end MEASUREMENT
/begin MEASUREMENT DDRC_St.DFC_UCtPSRCOpn "" UWORD DFC_OneToOne 1 100 0.00 8191.000 BIT_MASK 0x1fff FORMAT "%8.3" ECU_ADDRESS 0x60021FE8 /end MEASUREMENT
/begin MEASUREMENT DDRC_St.DFC_UPxP1PhysRngHi "" UWORD DFC_OneToOne 1 100 0.00 8191.000 BIT_MASK 0x1fff FORMAT "%8.3" ECU_ADDRESS 0x60021FEA /end MEASUREMENT
/begin MEASUREMENT DDRC_St.DFC_UPxP1PhysRngLo "" UWORD DFC_OneToOne 1 100 0.00 8191.000 BIT_MASK 0x1fff FORMAT "%8.3" ECU_ADDRESS 0x60021FEC /end MEASUREMENT
/begin MEASUREMENT DDRC_St.DFC_UPxP1SRCOpn "" UWORD DFC_OneToOne 1 100 0.00 8191.000 BIT_MASK 0x1fff FORMAT "%8.3" ECU_ADDRESS 0x60021FEE /end MEASUREMENT
/begin MEASUREMENT DFC_st.DFC_UCtPSRCMin "" UBYTE DFC_OneToOne 1 100 0.00 255.0 FORMAT "%5.1" ECU_ADDRESS 0x60034C0E /end MEASUREMENT
/begin MEASUREMENT DFC_st.DFC_UPxP1SRCMin "" UBYTE DFC_OneToOne 1 100 0.00 255.0 FORMAT "%5.1" ECU_ADDRESS 0x60034C0F /end MEASUREMENT
/begin MEASUREMENT DFC_st.DFC_UCtPPhysRngHi "" UBYTE DFC_OneToOne 1 100 0.00 255.0 FORMAT "%5.1" ECU_ADDRESS 0x60034C49 /end MEASUREMENT
/begin MEASUREMENT DFC_st.DFC_UCtPPhysRngLo "" UBYTE DFC_OneToOne 1 100 0.00 255.0 FORMAT "%5.1" ECU_ADDRESS 0x60034C4A /end MEASUREMENT
/begin MEASUREMENT DFC_st.DFC_UCtPSRCOpn "" UBYTE DFC_OneToOne 1 100 0.00 255.0 FORMAT "%5.1" ECU_ADDRESS 0x60034C4B /end MEASUREMENT
/begin MEASUREMENT DFC_st.DFC_UPxP1PhysRngHi "" UBYTE DFC_OneToOne 1 100 0.00 255.0 FORMAT "%5.1" ECU_ADDRESS 0x60034C4C /end MEASUREMENT
/begin MEASUREMENT DFC_st.DFC_UPxP1PhysRngLo "" UBYTE DFC_OneToOne 1 100 0.00 255.0 FORMAT "%5.1" ECU_ADDRESS 0x60034C4D /end MEASUREMENT
/begin MEASUREMENT DFC_st.DFC_UPxP1SRCOpn "" UBYTE DFC_OneToOne 1 100 0.00 255.0 FORMAT "%5.1" ECU_ADDRESS 0x60034C4E /end MEASUREMENT
/begin MEASUREMENT DFC_st.DFC_UCtPSRCMax "" UBYTE DFC_OneToOne 1 100 0.00 255.0 FORMAT "%5.1" ECU_ADDRESS 0x60034D8E /end MEASUREMENT
/begin MEASUREMENT DFC_st.DFC_UCtPTmpErr "" UBYTE DFC_OneToOne 1 100 0.00 255.0 FORMAT "%5.1" ECU_ADDRESS 0x60034D8F /end MEASUREMENT
/begin MEASUREMENT DFC_st.DFC_UPxP1SRCMax "" UBYTE DFC_OneToOne 1 100 0.00 255.0 FORMAT "%5.1" ECU_ADDRESS 0x60034D90 /end MEASUREMENT
/begin MEASUREMENT DFC_st.DFC_UPxP1TmpErr "" UBYTE DFC_OneToOne 1 100 0.00 255.0 FORMAT "%5.1" ECU_ADDRESS 0x60034D91 /end MEASUREMENT
/begin MEASUREMENT DINH_nrActvInhReas.FId_ThermModCritErr "" UWORD DINH_ct_Compu 1 100 -4095.000 4096.000 BIT_MASK 0x1fff FORMAT "%8.3" ECU_ADDRESS 0x6002156A /end MEASUREMENT
/begin MEASUREMENT DINH_nrActvInhReas.FId_UCtPEnhdSRCMax "" UWORD DINH_ct_Compu 1 100 -4095.000 4096.000 BIT_MASK 0x1fff FORMAT "%8.3" ECU_ADDRESS 0x6002156C /end MEASUREMENT
/begin MEASUREMENT DINH_nrActvInhReas.FId_UCtPFrzVal "" UWORD DINH_ct_Compu 1 100 -4095.000 4096.000 BIT_MASK 0x1fff FORMAT "%8.3" ECU_ADDRESS 0x6002156E /end MEASUREMENT
/begin MEASUREMENT DINH_nrActvInhReas.FId_UCtPPhysRng "" UWORD DINH_ct_Compu 1 100 -4095.000 4096.000 BIT_MASK 0x1fff FORMAT "%8.3" ECU_ADDRESS 0x60021570 /end MEASUREMENT
/begin MEASUREMENT DINH_nrActvInhReas.FId_UCtPRplVal "" UWORD DINH_ct_Compu 1 100 -4095.000 4096.000 BIT_MASK 0x1fff FORMAT "%8.3" ECU_ADDRESS 0x60021572 /end MEASUREMENT
/begin MEASUREMENT DINH_nrActvInhReas.FId_UCtPSSpMon "" UWORD DINH_ct_Compu 1 100 -4095.000 4096.000 BIT_MASK 0x1fff FORMAT "%8.3" ECU_ADDRESS 0x60021574 /end MEASUREMENT
/begin MEASUREMENT DINH_nrActvInhReas.FId_UCtPTmpErrCnt "" UWORD DINH_ct_Compu 1 100 -4095.000 4096.000 BIT_MASK 0x1fff FORMAT "%8.3" ECU_ADDRESS 0x60021576 /end MEASUREMENT
/begin MEASUREMENT DINH_nrActvInhReas.FId_UPxP1EnhdSRCMax "" UWORD DINH_ct_Compu 1 100 -4095.000 4096.000 BIT_MASK 0x1fff FORMAT "%8.3" ECU_ADDRESS 0x60021578 /end MEASUREMENT
/begin MEASUREMENT DINH_nrActvInhReas.FId_UPxP1FrzVal "" UWORD DINH_ct_Compu 1 100 -4095.000 4096.000 BIT_MASK 0x1fff FORMAT "%8.3" ECU_ADDRESS 0x6002157A /end MEASUREMENT
/begin MEASUREMENT DINH_nrActvInhReas.FId_UPxP1PhysRng "" UWORD DINH_ct_Compu 1 100 -4095.000 4096.000 BIT_MASK 0x1fff FORMAT "%8.3" ECU_ADDRESS 0x6002157C /end MEASUREMENT
/begin MEASUREMENT DINH_nrActvInhReas.FId_UPxP1RplVal "" UWORD DINH_ct_Compu 1 100 -4095.000 4096.000 BIT_MASK 0x1fff FORMAT "%8.3" ECU_ADDRESS 0x6002157E /end MEASUREMENT
/begin MEASUREMENT DINH_nrActvInhReas.FId_UPxP1SSpMon "" UWORD DINH_ct_Compu 1 100 -4095.000 4096.000 BIT_MASK 0x1fff FORMAT "%8.3" ECU_ADDRESS 0x60021580 /end MEASUREMENT
/begin MEASUREMENT DINH_nrActvInhReas.FId_UPxP1TmpErrCnt "" UWORD DINH_ct_Compu 1 100 -4095.000 4096.000 BIT_MASK 0x1fff FORMAT "%8.3" ECU_ADDRESS 0x60021582 /end MEASUREMENT
/begin MEASUREMENT DINH_nrActvInhReas.FId_VehCoornAuxAvrgEnvT "" UWORD DINH_ct_Compu 1 100 -4095.000 4096.000 BIT_MASK 0x1fff FORMAT "%8.3" ECU_ADDRESS 0x60021594 /end MEASUREMENT
/begin MEASUREMENT DINH_nrActvInhReas.FId_VehCoornAuxAvrgPwr "" UWORD DINH_ct_Compu 1 100 -4095.000 4096.000 BIT_MASK 0x1fff FORMAT "%8.3" ECU_ADDRESS 0x60021596 /end MEASUREMENT
/begin MEASUREMENT DINH_nrActvInhReas.FId_VehCoornAuxAvrgT "" UWORD DINH_ct_Compu 1 100 -4095.000 4096.000 BIT_MASK 0x1fff FORMAT "%8.3" ECU_ADDRESS 0x60021598 /end MEASUREMENT
/begin MEASUREMENT DINH_nrActvInhReas.FId_VehCoornAuxAvrgVehV "" UWORD DINH_ct_Compu 1 100 -4095.000 4096.000 BIT_MASK 0x1fff FORMAT "%8.3" ECU_ADDRESS 0x6002159A /end MEASUREMENT
/begin MEASUREMENT DINH_nrActvInhReas.FId_VehCoornDstRngPrdcDispDft "" UWORD DINH_ct_Compu 1 100 -4095.000 4096.000 BIT_MASK 0x1fff FORMAT "%8.3" ECU_ADDRESS 0x6002159C /end MEASUREMENT
/begin MEASUREMENT DINH_nrActvInhReas.FId_VehCoornEgyRmn "" UWORD DINH_ct_Compu 1 100 -4095.000 4096.000 BIT_MASK 0x1fff FORMAT "%8.3" ECU_ADDRESS 0x6002159E /end MEASUREMENT
/begin MEASUREMENT DINH_nrActvInhReas.FId_VehCoornErrExclChrg "" UWORD DINH_ct_Compu 1 100 -4095.000 4096.000 BIT_MASK 0x1fff FORMAT "%8.3" ECU_ADDRESS 0x600215A0 /end MEASUREMENT
/begin MEASUREMENT DINH_nrActvInhReas.FId_VehCoornErrExclDrv "" UWORD DINH_ct_Compu 1 100 -4095.000 4096.000 BIT_MASK 0x1fff FORMAT "%8.3" ECU_ADDRESS 0x600215A2 /end MEASUREMENT
/begin MEASUREMENT DINH_nrActvInhReas.FId_VehCoornHVErr "" UWORD DINH_ct_Compu 1 100 -4095.000 4096.000 BIT_MASK 0x1fff FORMAT "%8.3" ECU_ADDRESS 0x600215A4 /end MEASUREMENT
/begin MEASUREMENT DINH_nrActvInhReas.FId_VehCoornPrpAvrg "" UWORD DINH_ct_Compu 1 100 -4095.000 4096.000 BIT_MASK 0x1fff FORMAT "%8.3" ECU_ADDRESS 0x600215AA /end MEASUREMENT
/begin MEASUREMENT DINH_nrActvInhReas.FId_VehCoornRngPrdcAuxPwr "" UWORD DINH_ct_Compu 1 100 -4095.000 4096.000 BIT_MASK 0x1fff FORMAT "%8.3" ECU_ADDRESS 0x600215AC /end MEASUREMENT
/begin MEASUREMENT DINH_nrActvInhReas.FId_VehCoornSigQualVehV "" UWORD DINH_ct_Compu 1 100 -4095.000 4096.000 BIT_MASK 0x1fff FORMAT "%8.3" ECU_ADDRESS 0x600215AE /end MEASUREMENT
/begin MEASUREMENT DINH_stFId.FId_ThermModCritErr "" UWORD DFC_OneToOne 1 100 0.00 65535.00 FORMAT "%8.2" ECU_ADDRESS 0x6002156A /end MEASUREMENT
/begin MEASUREMENT DINH_stFId.FId_UCtPEnhdSRCMax "" UWORD DFC_OneToOne 1 100 0.00 65535.00 FORMAT "%8.2" ECU_ADDRESS 0x6002156C /end MEASUREMENT
/begin MEASUREMENT DINH_stFId.FId_UCtPFrzVal "" UWORD DFC_OneToOne 1 100 0.00 65535.00 FORMAT "%8.2" ECU_ADDRESS 0x6002156E /end MEASUREMENT
/begin MEASUREMENT DINH_stFId.FId_UCtPPhysRng "" UWORD DFC_OneToOne 1 100 0.00 65535.00 FORMAT "%8.2" ECU_ADDRESS 0x60021570 /end MEASUREMENT
/begin MEASUREMENT DINH_stFId.FId_UCtPRplVal "" UWORD DFC_OneToOne 1 100 0.00 65535.00 FORMAT "%8.2" ECU_ADDRESS 0x60021572 /end MEASUREMENT
/begin MEASUREMENT DINH_stFId.FId_UCtPSSpMon "" UWORD DFC_OneToOne 1 100 0.00 65535.00 FORMAT "%8.2" ECU_ADDRESS 0x60021574 /end MEASUREMENT
/begin MEASUREMENT DINH_stFId.FId_UCtPTmpErrCnt "" UWORD DFC_OneToOne 1 100 0.00 65535.00 FORMAT "%8.2" ECU_ADDRESS 0x60021576 /end MEASUREMENT
/begin MEASUREMENT DINH_stFId.FId_UPxP1EnhdSRCMax "" UWORD DFC_OneToOne 1 100 0.00 65535.00 FORMAT "%8.2" ECU_ADDRESS 0x60021578 /end MEASUREMENT
/begin MEASUREMENT DINH_stFId.FId_UPxP1FrzVal "" UWORD DFC_OneToOne 1 100 0.00 65535.00 FORMAT "%8.2" ECU_ADDRESS 0x6002157A /end MEASUREMENT
/begin MEASUREMENT DINH_stFId.FId_UPxP1PhysRng "" UWORD DFC_OneToOne 1 100 0.00 65535.00 FORMAT "%8.2" ECU_ADDRESS 0x6002157C /end MEASUREMENT
/begin MEASUREMENT DINH_stFId.FId_UPxP1RplVal "" UWORD DFC_OneToOne 1 100 0.00 65535.00 FORMAT "%8.2" ECU_ADDRESS 0x6002157E /end MEASUREMENT
/begin MEASUREMENT DINH_stFId.FId_UPxP1SSpMon "" UWORD DFC_OneToOne 1 100 0.00 65535.00 FORMAT "%8.2" ECU_ADDRESS 0x60021580 /end MEASUREMENT
/begin MEASUREMENT DINH_stFId.FId_UPxP1TmpErrCnt "" UWORD DFC_OneToOne 1 100 0.00 65535.00 FORMAT "%8.2" ECU_ADDRESS 0x60021582 /end MEASUREMENT
/begin MEASUREMENT DINH_stFId.FId_VehCoornAuxAvrgEnvT "" UWORD DFC_OneToOne 1 100 0.00 65535.00 FORMAT "%8.2" ECU_ADDRESS 0x60021594 /end MEASUREMENT
/begin MEASUREMENT DINH_stFId.FId_VehCoornAuxAvrgPwr "" UWORD DFC_OneToOne 1 100 0.00 65535.00 FORMAT "%8.2" ECU_ADDRESS 0x60021596 /end MEASUREMENT
/begin MEASUREMENT DINH_stFId.FId_VehCoornAuxAvrgT "" UWORD DFC_OneToOne 1 100 0.00 65535.00 FORMAT "%8.2" ECU_ADDRESS 0x60021598 /end MEASUREMENT
/begin MEASUREMENT DINH_stFId.FId_VehCoornAuxAvrgVehV "" UWORD DFC_OneToOne 1 100 0.00 65535.00 FORMAT "%8.2" ECU_ADDRESS 0x6002159A /end MEASUREMENT
/begin MEASUREMENT DINH_stFId.FId_VehCoornDstRngPrdcDispDft "" UWORD DFC_OneToOne 1 100 0.00 65535.00 FORMAT "%8.2" ECU_ADDRESS 0x6002159C /end MEASUREMENT
/begin MEASUREMENT DINH_stFId.FId_VehCoornEgyRmn "" UWORD DFC_OneToOne 1 100 0.00 65535.00 FORMAT "%8.2" ECU_ADDRESS 0x6002159E /end MEASUREMENT
/begin MEASUREMENT DINH_stFId.FId_VehCoornErrExclChrg "" UWORD DFC_OneToOne 1 100 0.00 65535.00 FORMAT "%8.2" ECU_ADDRESS 0x600215A0 /end MEASUREMENT
/begin MEASUREMENT DINH_stFId.FId_VehCoornErrExclDrv "" UWORD DFC_OneToOne 1 100 0.00 65535.00 FORMAT "%8.2" ECU_ADDRESS 0x600215A2 /end MEASUREMENT
/begin MEASUREMENT DINH_stFId.FId_VehCoornHVErr "" UWORD DFC_OneToOne 1 100 0.00 65535.00 FORMAT "%8.2" ECU_ADDRESS 0x600215A4 /end MEASUREMENT
/begin MEASUREMENT DINH_stFId.FId_VehCoornPrpAvrg "" UWORD DFC_OneToOne 1 100 0.00 65535.00 FORMAT "%8.2" ECU_ADDRESS 0x600215AA /end MEASUREMENT
/begin MEASUREMENT DINH_stFId.FId_VehCoornRngPrdcAuxPwr "" UWORD DFC_OneToOne 1 100 0.00 65535.00 FORMAT "%8.2" ECU_ADDRESS 0x600215AC /end MEASUREMENT
/begin MEASUREMENT DINH_stFId.FId_VehCoornSigQualVehV "" UWORD DFC_OneToOne 1 100 0.00 65535.00 FORMAT "%8.2" ECU_ADDRESS 0x600215AE /end MEASUREMENT
/begin MEASUREMENT EChrDv_cntPlin_old "hold previous state of OBC_PLUG_STATE signal" UWORD OneToOne 1 100 0.00 65535.00 FORMAT "%8.2" ECU_ADDRESS 0x6001FA36
 /begin IF_DATA XCPplus 0x0102
  /begin DAQ_EVENT VARIABLE /end DAQ_EVENT
 /end IF_DATA
/end MEASUREMENT
/begin MEASUREMENT MedCooltT1_t_f "temperature of medium coolant temperatur circuit" FLOAT32_IEEE RBPtCel_t_1p0_3 1 100 -1.00E+037 1.00E+037 FORMAT "%8.2" ECU_ADDRESS 0x60000EA8
 /begin IF_DATA XCPplus 0x0102
  /begin DAQ_EVENT VARIABLE /end DAQ_EVENT
 /end IF_DATA
/end MEASUREMENT
/begin MEASUREMENT rba_SyC_bWkuMain_old "hold previous state of mainwakeup" UBYTE B_TRUE 1 100 0.00 1.00000000000 BIT_MASK 0x1 FORMAT "%13.11" ECU_ADDRESS 0x7000020C
 /begin IF_DATA XCPplus 0x0102
  /begin DAQ_EVENT VARIABLE /end DAQ_EVENT
 /end IF_DATA
/end MEASUREMENT
/begin MEASUREMENT RefgntChillrVlv_stCtrlr "controller status from chiller valve" UBYTE q1 1 100 0.00 255.0 FORMAT "%5.1" ECU_ADDRESS 0x60023442
 /begin IF_DATA XCPplus 0x0102
  /begin DAQ_EVENT VARIABLE /end DAQ_EVENT
 /end IF_DATA
/end MEASUREMENT
/begin MEASUREMENT RefgntP_pChillrDs "refrigerant pressure after chiller" SWORD PresAC_hPa 1 100 -65536.0000 65534.0000 FORMAT "%10.4" ECU_ADDRESS 0x6001F9D8
 /begin IF_DATA XCPplus 0x0102
  /begin DAQ_EVENT VARIABLE /end DAQ_EVENT
 /end IF_DATA
/end MEASUREMENT
/begin MEASUREMENT ThermLoTChillr_pwrRefgntDes "desired refrigerant power" SWORD RBPtCel_pwr_25p0_1 1 100 -819200.0 819175.0 FORMAT "%8.1" ECU_ADDRESS 0x6001F9D2
 /begin IF_DATA XCPplus 0x0102
  /begin DAQ_EVENT VARIABLE /end DAQ_EVENT
 /end IF_DATA
/end MEASUREMENT
/begin MEASUREMENT ThermLoTChillr_stReq "status chiller request" UBYTE q1 1 100 0.00 255.0 FORMAT "%5.1" ECU_ADDRESS 0x60023433
 /begin IF_DATA XCPplus 0x0102
  /begin DAQ_EVENT VARIABLE /end DAQ_EVENT
 /end IF_DATA
/end MEASUREMENT
/begin MEASUREMENT ThermMod_flgAftRunCmpl "flag afterrun complete" UBYTE B_TRUE 1 100 0.00 1.00000000000 BIT_MASK 0x1 FORMAT "%13.11" ECU_ADDRESS 0x70000104
 /begin IF_DATA XCPplus 0x0102
  /begin DAQ_EVENT VARIABLE /end DAQ_EVENT
 /end IF_DATA
/end MEASUREMENT
/begin MEASUREMENT ThermMod_flgLoBatt "Low LV battery state" UBYTE B_TRUE 1 100 0.00 1.00000000000 BIT_MASK 0x1 FORMAT "%13.11" ECU_ADDRESS 0x70000103
 /begin IF_DATA XCPplus 0x0102
  /begin DAQ_EVENT VARIABLE /end DAQ_EVENT
 /end IF_DATA
/end MEASUREMENT
/begin MEASUREMENT ThermMod_flgProlg "Flag for syc drive prolongation from thermal system" UBYTE B_TRUE 1 100 0.00 1.00000000000 BIT_MASK 0x1 FORMAT "%13.11" ECU_ADDRESS 0x70000102
 /begin IF_DATA XCPplus 0x0102
  /begin DAQ_EVENT VARIABLE /end DAQ_EVENT
 /end IF_DATA
/end MEASUREMENT
/begin MEASUREMENT ThermMod_stOpMod "Vehicle operation mode for thermal control" UBYTE q1 1 100 0.00 255.0 FORMAT "%5.1" ECU_ADDRESS 0x60023431
 /begin IF_DATA XCPplus 0x0102
  /begin DAQ_EVENT VARIABLE /end DAQ_EVENT
 /end IF_DATA
/end MEASUREMENT
/begin MEASUREMENT ThermMod_tiOpMod "Time elapsed in operation mode" SLONG Time_s 1 100 -21474836.4800 21474836.4700 FORMAT "%13.4" ECU_ADDRESS 0x60000570
 /begin IF_DATA XCPplus 0x0102
  /begin DAQ_EVENT VARIABLE /end DAQ_EVENT
 /end IF_DATA
/end MEASUREMENT
/begin MEASUREMENT ThermMod_XPostDrive "PostDrive prolongation active" UBYTE B_TRUE 1 100 0.00 1.00000000000 BIT_MASK 0x1 FORMAT "%13.11" ECU_ADDRESS 0x70000101
 /begin IF_DATA XCPplus 0x0102
  /begin DAQ_EVENT VARIABLE /end DAQ_EVENT
 /end IF_DATA
/end MEASUREMENT
/begin MEASUREMENT ThermMod_XWait "PreDrive prolongation active" UBYTE B_TRUE 1 100 0.00 1.00000000000 BIT_MASK 0x1 FORMAT "%13.11" ECU_ADDRESS 0x70000100
 /begin IF_DATA XCPplus 0x0102
  /begin DAQ_EVENT VARIABLE /end DAQ_EVENT
 /end IF_DATA
/end MEASUREMENT
/begin MEASUREMENT ThermPlinChrgr_ChgrTPT1_I.X1 "PT1 filter for the temperature / Input value at one time step before" SLONG OneToOne 1 100 -2147483648.00 2147483647.00 FORMAT "%13.2" ECU_ADDRESS 0x60000560 /end MEASUREMENT
/begin MEASUREMENT ThermPlinChrgr_ChgrTPT1_I.Y1 "PT1 filter for the temperature / Output value at one time step before" SLONG OneToOne 1 100 -2147483648.00 2147483647.00 FORMAT "%13.2" ECU_ADDRESS 0x60000564 /end MEASUREMENT
/begin MEASUREMENT ThermPlinChrgr_ChrgrPwrPT1_I.X1 "Class instance for charger power / Input value at one time step before" SLONG OneToOne 1 100 -2147483648.00 2147483647.00 FORMAT "%13.2" ECU_ADDRESS 0x60000558 /end MEASUREMENT
/begin MEASUREMENT ThermPlinChrgr_ChrgrPwrPT1_I.Y1 "Class instance for charger power / Output value at one time step before" SLONG OneToOne 1 100 -2147483648.00 2147483647.00 FORMAT "%13.2" ECU_ADDRESS 0x6000055C /end MEASUREMENT
/begin MEASUREMENT ThermPlinChrgr_flgAftRunReq "Afterrun extension request due to higher fan request from Charger module" UBYTE B_TRUE 1 100 0.00 1.00000000000 BIT_MASK 0x1 FORMAT "%13.11" ECU_ADDRESS 0x7000026F
 /begin IF_DATA XCPplus 0x0102
  /begin DAQ_EVENT VARIABLE /end DAQ_EVENT
 /end IF_DATA
/end MEASUREMENT
/begin MEASUREMENT ThermPlinChrgr_ratAddlPmpReq "Additional cooling flow request based on charger power" SBYTE RBPtCel_Perc_1p0_1 1 100 -128.0 127.0 FORMAT "%5.1" ECU_ADDRESS 0x60022F81
 /begin IF_DATA XCPplus 0x0102
  /begin DAQ_EVENT VARIABLE /end DAQ_EVENT
 /end IF_DATA
/end MEASUREMENT
/begin MEASUREMENT ThermPlinChrgr_ratPmpReq "Cooling flow request of the Charger" SBYTE RBPtCel_Perc_1p0_1 1 100 -128.0 127.0 FORMAT "%5.1" ECU_ADDRESS 0x6002346F
 /begin IF_DATA XCPplus 0x0102
  /begin DAQ_EVENT VARIABLE /end DAQ_EVENT
 /end IF_DATA
/end MEASUREMENT
/begin MEASUREMENT ThermPlinChrgr_ratTempPmpReq "Cooling flow request based on the charger temperature" SBYTE RBPtCel_Perc_1p0_1 1 100 -128.0 127.0 FORMAT "%5.1" ECU_ADDRESS 0x60022F80
 /begin IF_DATA XCPplus 0x0102
  /begin DAQ_EVENT VARIABLE /end DAQ_EVENT
 /end IF_DATA
/end MEASUREMENT
/begin MEASUREMENT ThermSys_pwrHvacPtcMax "maximum power for Hvac heater" SWORD RBPtCel_pwr_25p0_1 1 100 -819200.0 819175.0 FORMAT "%8.1" ECU_ADDRESS 0x6001F9CA
 /begin IF_DATA XCPplus 0x0102
  /begin DAQ_EVENT VARIABLE /end DAQ_EVENT
 /end IF_DATA
/end MEASUREMENT
/begin MEASUREMENT ThermSys_pwrLoTChillrMax "maximum power for battery cooling" SWORD RBPtCel_pwr_25p0_1 1 100 -819200.0 819175.0 FORMAT "%8.1" ECU_ADDRESS 0x6001F9C8
 /begin IF_DATA XCPplus 0x0102
  /begin DAQ_EVENT VARIABLE /end DAQ_EVENT
 /end IF_DATA
/end MEASUREMENT
/begin MEASUREMENT ThermTracBatt_tBattMax "higher-bound of the ideal hv battery temperature(threshold to activte active cooling via chiller)" SWORD Temp_Cels 1 100 -3549.940 3003.560 FORMAT "%8.3" ECU_ADDRESS 0x6001F9C6
 /begin IF_DATA XCPplus 0x0102
  /begin DAQ_EVENT VARIABLE /end DAQ_EVENT
 /end IF_DATA
/end MEASUREMENT
/begin MEASUREMENT ThermTracBatt_tBattMin "Lower-bound of the ideal hv battery temperature(threshold to activte active heating)" SWORD Temp_Cels 1 100 -3549.940 3003.560 FORMAT "%8.3" ECU_ADDRESS 0x6001F9C4
 /begin IF_DATA XCPplus 0x0102
  /begin DAQ_EVENT VARIABLE /end DAQ_EVENT
 /end IF_DATA
/end MEASUREMENT
/begin MEASUREMENT TrsmEmac_ratTqPrimAxle "torque ratio of the primary axle" UWORD TransR 1 100 0.00 655.3500 FORMAT "%8.4" ECU_ADDRESS 0x6001FA1C
 /begin IF_DATA XCPplus 0x0102
  /begin DAQ_EVENT VARIABLE /end DAQ_EVENT
 /end IF_DATA
/end MEASUREMENT
/begin MEASUREMENT TrsmEmac_tqLoss01 "loss torque of e-machine 1" SWORD Trq 1 100 -3276.800 3276.700 FORMAT "%8.3" ECU_ADDRESS 0x6001FA70
 /begin IF_DATA XCPplus 0x0102
  /begin DAQ_EVENT VARIABLE /end DAQ_EVENT
 /end IF_DATA
/end MEASUREMENT
/begin MEASUREMENT TrsmEmac_tqProtnMax01 "Maximum transmission protection torque at e-machine 1" SWORD Trq 1 100 -3276.800 3276.700 FORMAT "%8.3" ECU_ADDRESS 0x6001FA6E
 /begin IF_DATA XCPplus 0x0102
  /begin DAQ_EVENT VARIABLE /end DAQ_EVENT
 /end IF_DATA
/end MEASUREMENT
/begin MEASUREMENT TrsmEmac_tqProtnMin01 "Minimal transmission protection torque at e-machine 1" SWORD Trq 1 100 -3276.800 3276.700 FORMAT "%8.3" ECU_ADDRESS 0x6001FA6C
 /begin IF_DATA XCPplus 0x0102
  /begin DAQ_EVENT VARIABLE /end DAQ_EVENT
 /end IF_DATA
/end MEASUREMENT
/begin MEASUREMENT UCtP_DDstSnsrState_mp "" UBYTE OneToOne 1 100 0.00 255.0 FORMAT "%5.1" ECU_ADDRESS 0x70006B55 /end MEASUREMENT
/begin MEASUREMENT UCtP_FirCalc.cntrAvrgZr " / Counter for 0-division in FIR (indicates failure)" UBYTE OneToOne 1 100 0.00 255.0 FORMAT "%5.1" ECU_ADDRESS 0x6001F3D2 /end MEASUREMENT
/begin MEASUREMENT UCtP_FirCalc.flgRdDne " / FIR: reading from uRaw-sum done" UBYTE OneToOne 1 100 0.00 1.000 BIT_MASK 0x1 FORMAT "%5.3" ECU_ADDRESS 0x6001F3D3 /end MEASUREMENT
/begin MEASUREMENT UCtP_FirCalc.uRawAvrg " / FIR: simple average calculated uRaw" SWORD Volt 1 100 -6553.600 6553.400 FORMAT "%8.3" ECU_ADDRESS 0x6001F3D4 /end MEASUREMENT
/begin MEASUREMENT UCtP_FirCalc.uRawFir " / FIR: Calculated uRaw" SWORD Volt 1 100 -6553.600 6553.400 FORMAT "%8.3" ECU_ADDRESS 0x6001F3D6 /end MEASUREMENT
/begin MEASUREMENT UCtP_FirRead.cntr " / Counter for simple average FIR" UBYTE OneToOne 1 100 0.00 255.0 FORMAT "%5.1" ECU_ADDRESS 0x6000054C /end MEASUREMENT
/begin MEASUREMENT UCtP_FirRead.flgFirstRun " / FIR: 1st run after init" UBYTE OneToOne 1 100 0.00 1.000 BIT_MASK 0x1 FORMAT "%5.3" ECU_ADDRESS 0x6000054D /end MEASUREMENT
/begin MEASUREMENT UCtP_FirRead.idxArr " / FIR ringbuffer: actual index" UBYTE OneToOne 1 100 0.00 255.0 FORMAT "%5.1" ECU_ADDRESS 0x6000054E /end MEASUREMENT
/begin MEASUREMENT UCtP_FirRead.uSum " / Simple average FIR: sum of uRaws" SLONG Volt 1 100 -429496729.600 429496729.400 FORMAT "%13.3" ECU_ADDRESS 0x60000550 /end MEASUREMENT
/begin MEASUREMENT UCtP_stMonStdSens "" ULONG OneToOne 1 100 0.00 4294967295.00 FORMAT "%13.2" ECU_ADDRESS 0x60000FDC
 /begin IF_DATA XCPplus 0x0102
  /begin DAQ_EVENT VARIABLE /end DAQ_EVENT
 /end IF_DATA
/end MEASUREMENT
/begin MEASUREMENT UCtP_stSnsrActv "" UBYTE OneToOne 1 100 0.00 255.0 BIT_MASK 0x1 FORMAT "%5.1" ECU_ADDRESS 0x6002369D
 /begin IF_DATA XCPplus 0x0102
  /begin DAQ_EVENT VARIABLE /end DAQ_EVENT
 /end IF_DATA
/end MEASUREMENT
/begin MEASUREMENT UCtP_stSnsrDdCalc "" UBYTE OneToOne 1 100 0.00 255.0 BIT_MASK 0x1 FORMAT "%5.1" ECU_ADDRESS 0x6002369C
 /begin IF_DATA XCPplus 0x0102
  /begin DAQ_EVENT VARIABLE /end DAQ_EVENT
 /end IF_DATA
/end MEASUREMENT
/begin MEASUREMENT UCtP_stSnsrDdReadCalc "" UBYTE OneToOne 1 100 0.00 255.0 BIT_MASK 0x1 FORMAT "%5.1" ECU_ADDRESS 0x6002369B
 /begin IF_DATA XCPplus 0x0102
  /begin DAQ_EVENT VARIABLE /end DAQ_EVENT
 /end IF_DATA
/end MEASUREMENT
/begin MEASUREMENT UCtP_swtConfStdSens2C "" ULONG OneToOne 1 100 0.00 4294967295.00 FORMAT "%13.2" ECU_ADDRESS 0x60000548 /end MEASUREMENT
/begin MEASUREMENT UCtP_swtConfStdSensC "" ULONG OneToOne 1 100 0.00 4294967295.00 FORMAT "%13.2" ECU_ADDRESS 0x60000544 /end MEASUREMENT
/begin MEASUREMENT UCtP_swtConfStdSensSwVersC "" ULONG OneToOne 1 100 0.00 4294967295.00 FORMAT "%13.2" ECU_ADDRESS 0x60000540 /end MEASUREMENT
/begin MEASUREMENT UCtP_swtSensMode "" UBYTE OneToOne 1 100 0.00 255.0 FORMAT "%5.1" ECU_ADDRESS 0x60023767 /end MEASUREMENT
/begin MEASUREMENT UCtP_swtSensPres "" UBYTE OneToOne 1 100 0.00 255.0 FORMAT "%5.1" ECU_ADDRESS 0x60023766
 /begin IF_DATA XCPplus 0x0102
  /begin DAQ_EVENT VARIABLE /end DAQ_EVENT
 /end IF_DATA
/end MEASUREMENT
/begin MEASUREMENT UCtP_tiSRCMaxDefDeb "" SLONG Time_ms 1 100 -21474836480.0 21474836470.0 FORMAT "%13.1" ECU_ADDRESS 0x6000109C
 /begin IF_DATA XCPplus 0x0102
  /begin DAQ_EVENT VARIABLE /end DAQ_EVENT
 /end IF_DATA
/end MEASUREMENT
/begin MEASUREMENT UCtP_tRefSnsr_mp "" SWORD Temp_Cels 1 100 -3549.940 3003.560 FORMAT "%8.3" ECU_ADDRESS 0x7000693E /end MEASUREMENT
/begin MEASUREMENT UCtP_tSensPT1Fltd_mp "" SWORD RBPtCel_u_1p0_1 1 100 -32768.00 32767.00 FORMAT "%8.2" ECU_ADDRESS 0x7000693C /end MEASUREMENT
/begin MEASUREMENT UCtP_uDynThresPhysRngHi_f_mp "" FLOAT32_IEEE RBPtCel_u_1p0_1 1 100 -1.00000000E+037 1.00000000E+037 FORMAT "%13.3" ECU_ADDRESS 0x70006810 /end MEASUREMENT
/begin MEASUREMENT UCtP_uDynThresPhysRngLo_f_mp "" FLOAT32_IEEE RBPtCel_u_1p0_1 1 100 -1.00000000E+037 1.00000000E+037 FORMAT "%13.3" ECU_ADDRESS 0x7000680C /end MEASUREMENT
/begin MEASUREMENT UCtP_uRaw "" SWORD Volt 1 100 -6553.600 6553.400 FORMAT "%8.3" ECU_ADDRESS 0x6001FD50
 /begin IF_DATA XCPplus 0x0102
  /begin DAQ_EVENT VARIABLE /end DAQ_EVENT
 /end IF_DATA
/end MEASUREMENT
/begin MEASUREMENT UCtP_uRawAryTmp "" SWORD Volt 1 100 -6553.600 6553.400 FORMAT "%8.3" MATRIX_DIM 9 ECU_ADDRESS 0x6001FD3E
 /begin IF_DATA XCPplus 0x0102
  /begin DAQ_EVENT VARIABLE /end DAQ_EVENT
 /end IF_DATA
/end MEASUREMENT
/begin MEASUREMENT UCtP_uRawFilAry "" SWORD Volt 1 100 -6553.600 6553.400 FORMAT "%8.3" MATRIX_DIM 9 ECU_ADDRESS 0x6001FED6
 /begin IF_DATA XCPplus 0x0102
  /begin DAQ_EVENT VARIABLE /end DAQ_EVENT
 /end IF_DATA
/end MEASUREMENT
/begin MEASUREMENT UCtP_uRawPT1Fltd "" SWORD Volt 1 100 -6553.600 6553.400 FORMAT "%8.3" ECU_ADDRESS 0x6001FD3C
 /begin IF_DATA XCPplus 0x0102
  /begin DAQ_EVENT VARIABLE /end DAQ_EVENT
 /end IF_DATA
/end MEASUREMENT
/begin MEASUREMENT UCtP_uRawPT1FltdSens "" SWORD Volt 1 100 -6553.600 6553.400 FORMAT "%8.3" ECU_ADDRESS 0x6001FD3A
 /begin IF_DATA XCPplus 0x0102
  /begin DAQ_EVENT VARIABLE /end DAQ_EVENT
 /end IF_DATA
/end MEASUREMENT
/begin MEASUREMENT UCtP_uRawUnFltd "" SWORD Volt 1 100 -6553.600 6553.400 FORMAT "%8.3" ECU_ADDRESS 0x6001FD38
 /begin IF_DATA XCPplus 0x0102
  /begin DAQ_EVENT VARIABLE /end DAQ_EVENT
 /end IF_DATA
/end MEASUREMENT
/begin MEASUREMENT UCtP_uRaw_f "" FLOAT32_IEEE RBPtCel_u_1p0_2 1 100 -1.00000000E+037 1.00000000E+037 FORMAT "%13.3" ECU_ADDRESS 0x60001100
 /begin IF_DATA XCPplus 0x0102
  /begin DAQ_EVENT VARIABLE /end DAQ_EVENT
 /end IF_DATA
/end MEASUREMENT
/begin MEASUREMENT UCtP_uSensCpl "" SWORD OneToOne 1 100 -32768.00 32767.00 FORMAT "%8.2" ECU_ADDRESS 0x6001FD36
 /begin IF_DATA XCPplus 0x0102
  /begin DAQ_EVENT VARIABLE /end DAQ_EVENT
 /end IF_DATA
/end MEASUREMENT
/begin MEASUREMENT UCtP_uSensGradLim_f_mp "" FLOAT32_IEEE RBPtCel_u_1p0_1 1 100 -1.00000000E+037 1.00000000E+037 FORMAT "%13.3" ECU_ADDRESS 0x70006814
 /begin IF_DATA XCPplus 0x0102
  /begin DAQ_EVENT VARIABLE /end DAQ_EVENT
 /end IF_DATA
/end MEASUREMENT
/begin MEASUREMENT UCtP_uSensOffsCorrd_f "" FLOAT32_IEEE RBPtCel_u_1p0_1 1 100 -1.00000000E+037 1.00000000E+037 FORMAT "%13.3" ECU_ADDRESS 0x600010FC
 /begin IF_DATA XCPplus 0x0102
  /begin DAQ_EVENT VARIABLE /end DAQ_EVENT
 /end IF_DATA
/end MEASUREMENT
/begin MEASUREMENT UCtP_uSensUnFltd "" SWORD RBPtCel_u_1p0_1 1 100 -32768.00 32767.00 FORMAT "%8.2" ECU_ADDRESS 0x6001FD34
 /begin IF_DATA XCPplus 0x0102
  /begin DAQ_EVENT VARIABLE /end DAQ_EVENT
 /end IF_DATA
/end MEASUREMENT
/begin MEASUREMENT UCtP_uSens_f "Raw physical value" FLOAT32_IEEE RBPtCel_u_1p0_1 1 100 -1.00000000E+037 1.00000000E+037 FORMAT "%13.3" ECU_ADDRESS 0x600010F8
 /begin IF_DATA XCPplus 0x0102
  /begin DAQ_EVENT VARIABLE /end DAQ_EVENT
 /end IF_DATA
/end MEASUREMENT
/begin MEASUREMENT UCtP_uUnFlt_f "" FLOAT32_IEEE RBPtCel_u_1p0_1 1 100 -1.00000000E+037 1.00000000E+037 FORMAT "%13.3" ECU_ADDRESS 0x600010F4
 /begin IF_DATA XCPplus 0x0102
  /begin DAQ_EVENT VARIABLE /end DAQ_EVENT
 /end IF_DATA
/end MEASUREMENT
/begin MEASUREMENT UCtP_u_f "" FLOAT32_IEEE RBPtCel_u_1p0_1 1 100 -1.00000000E+037 1.00000000E+037 FORMAT "%13.3" ECU_ADDRESS 0x600010F0
 /begin IF_DATA XCPplus 0x0102
  /begin DAQ_EVENT VARIABLE /end DAQ_EVENT
 /end IF_DATA
/end MEASUREMENT
/begin MEASUREMENT UCtP_u_f_Sq "" UBYTE SigQly_COMPU_VERB 1 100 0.00 15.0000000000 FORMAT "%13.10" ECU_ADDRESS 0x60023765
 /begin IF_DATA XCPplus 0x0102
  /begin DAQ_EVENT VARIABLE /end DAQ_EVENT
 /end IF_DATA
/end MEASUREMENT
/begin MEASUREMENT UPxP1_DDstSnsrState_mp "" UBYTE OneToOne 1 100 0.00 255.0 FORMAT "%5.1" ECU_ADDRESS 0x70006B54 /end MEASUREMENT
/begin MEASUREMENT UPxP1_FirCalc.cntrAvrgZr " / Counter for 0-division in FIR (indicates failure)" UBYTE OneToOne 1 100 0.00 255.0 FORMAT "%5.1" ECU_ADDRESS 0x6001F3CC /end MEASUREMENT
/begin MEASUREMENT UPxP1_FirCalc.flgRdDne " / FIR: reading from uRaw-sum done" UBYTE OneToOne 1 100 0.00 1.000 BIT_MASK 0x1 FORMAT "%5.3" ECU_ADDRESS 0x6001F3CD /end MEASUREMENT
/begin MEASUREMENT UPxP1_FirCalc.uRawAvrg " / FIR: simple average calculated uRaw" SWORD Volt 1 100 -6553.600 6553.400 FORMAT "%8.3" ECU_ADDRESS 0x6001F3CE /end MEASUREMENT
/begin MEASUREMENT UPxP1_FirCalc.uRawFir " / FIR: Calculated uRaw" SWORD Volt 1 100 -6553.600 6553.400 FORMAT "%8.3" ECU_ADDRESS 0x6001F3D0 /end MEASUREMENT
/begin MEASUREMENT UPxP1_FirRead.cntr " / Counter for simple average FIR" UBYTE OneToOne 1 100 0.00 255.0 FORMAT "%5.1" ECU_ADDRESS 0x60000534 /end MEASUREMENT
/begin MEASUREMENT UPxP1_FirRead.flgFirstRun " / FIR: 1st run after init" UBYTE OneToOne 1 100 0.00 1.000 BIT_MASK 0x1 FORMAT "%5.3" ECU_ADDRESS 0x60000535 /end MEASUREMENT
/begin MEASUREMENT UPxP1_FirRead.idxArr " / FIR ringbuffer: actual index" UBYTE OneToOne 1 100 0.00 255.0 FORMAT "%5.1" ECU_ADDRESS 0x60000536 /end MEASUREMENT
/begin MEASUREMENT UPxP1_FirRead.uSum " / Simple average FIR: sum of uRaws" SLONG Volt 1 100 -429496729.600 429496729.400 FORMAT "%13.3" ECU_ADDRESS 0x60000538 /end MEASUREMENT
/begin MEASUREMENT UPxP1_stMonStdSens "" ULONG OneToOne 1 100 0.00 4294967295.00 FORMAT "%13.2" ECU_ADDRESS 0x60000FD8
 /begin IF_DATA XCPplus 0x0102
  /begin DAQ_EVENT VARIABLE /end DAQ_EVENT
 /end IF_DATA
/end MEASUREMENT
/begin MEASUREMENT UPxP1_stSnsrActv "" UBYTE OneToOne 1 100 0.00 255.0 BIT_MASK 0x1 FORMAT "%5.1" ECU_ADDRESS 0x6002369A
 /begin IF_DATA XCPplus 0x0102
  /begin DAQ_EVENT VARIABLE /end DAQ_EVENT
 /end IF_DATA
/end MEASUREMENT
/begin MEASUREMENT UPxP1_stSnsrDdCalc "" UBYTE OneToOne 1 100 0.00 255.0 BIT_MASK 0x1 FORMAT "%5.1" ECU_ADDRESS 0x60023699
 /begin IF_DATA XCPplus 0x0102
  /begin DAQ_EVENT VARIABLE /end DAQ_EVENT
 /end IF_DATA
/end MEASUREMENT
/begin MEASUREMENT UPxP1_stSnsrDdReadCalc "" UBYTE OneToOne 1 100 0.00 255.0 BIT_MASK 0x1 FORMAT "%5.1" ECU_ADDRESS 0x60023698
 /begin IF_DATA XCPplus 0x0102
  /begin DAQ_EVENT VARIABLE /end DAQ_EVENT
 /end IF_DATA
/end MEASUREMENT
/begin MEASUREMENT UPxP1_swtConfStdSens2C "" ULONG OneToOne 1 100 0.00 4294967295.00 FORMAT "%13.2" ECU_ADDRESS 0x60000530 /end MEASUREMENT
/begin MEASUREMENT UPxP1_swtConfStdSensC "" ULONG OneToOne 1 100 0.00 4294967295.00 FORMAT "%13.2" ECU_ADDRESS 0x6000052C /end MEASUREMENT
/begin MEASUREMENT UPxP1_swtConfStdSensSwVersC "" ULONG OneToOne 1 100 0.00 4294967295.00 FORMAT "%13.2" ECU_ADDRESS 0x60000528 /end MEASUREMENT
/begin MEASUREMENT UPxP1_swtSensMode "" UBYTE OneToOne 1 100 0.00 255.0 FORMAT "%5.1" ECU_ADDRESS 0x60023764 /end MEASUREMENT
/begin MEASUREMENT UPxP1_swtSensPres "" UBYTE OneToOne 1 100 0.00 255.0 FORMAT "%5.1" ECU_ADDRESS 0x60023763
 /begin IF_DATA XCPplus 0x0102
  /begin DAQ_EVENT VARIABLE /end DAQ_EVENT
 /end IF_DATA
/end MEASUREMENT
/begin MEASUREMENT UPxP1_tiSRCMaxDefDeb "" SLONG Time_ms 1 100 -21474836480.0 21474836470.0 FORMAT "%13.1" ECU_ADDRESS 0x60001098
 /begin IF_DATA XCPplus 0x0102
  /begin DAQ_EVENT VARIABLE /end DAQ_EVENT
 /end IF_DATA
/end MEASUREMENT
/begin MEASUREMENT UPxP1_tRefSnsr_mp "" SWORD Temp_Cels 1 100 -3549.940 3003.560 FORMAT "%8.3" ECU_ADDRESS 0x7000693A /end MEASUREMENT
/begin MEASUREMENT UPxP1_tSensPT1Fltd_mp "" SWORD RBPtCel_u_1p0_1 1 100 -32768.00 32767.00 FORMAT "%8.2" ECU_ADDRESS 0x70006938 /end MEASUREMENT
/begin MEASUREMENT UPxP1_uDynThresPhysRngHi_f_mp "" FLOAT32_IEEE RBPtCel_u_1p0_1 1 100 -1.00000000E+037 1.00000000E+037 FORMAT "%13.3" ECU_ADDRESS 0x70006804 /end MEASUREMENT
/begin MEASUREMENT UPxP1_uDynThresPhysRngLo_f_mp "" FLOAT32_IEEE RBPtCel_u_1p0_1 1 100 -1.00000000E+037 1.00000000E+037 FORMAT "%13.3" ECU_ADDRESS 0x70006800 /end MEASUREMENT
/begin MEASUREMENT UPxP1_uRaw "" SWORD Volt 1 100 -6553.600 6553.400 FORMAT "%8.3" ECU_ADDRESS 0x6001FD30
 /begin IF_DATA XCPplus 0x0102
  /begin DAQ_EVENT VARIABLE /end DAQ_EVENT
 /end IF_DATA
/end MEASUREMENT
/begin MEASUREMENT UPxP1_uRawPT1Fltd "" SWORD Volt 1 100 -6553.600 6553.400 FORMAT "%8.3" ECU_ADDRESS 0x6001FD2E
 /begin IF_DATA XCPplus 0x0102
  /begin DAQ_EVENT VARIABLE /end DAQ_EVENT
 /end IF_DATA
/end MEASUREMENT
/begin MEASUREMENT UPxP1_uRawPT1FltdSens "" SWORD Volt 1 100 -6553.600 6553.400 FORMAT "%8.3" ECU_ADDRESS 0x6001FD2C
 /begin IF_DATA XCPplus 0x0102
  /begin DAQ_EVENT VARIABLE /end DAQ_EVENT
 /end IF_DATA
/end MEASUREMENT
/begin MEASUREMENT UPxP1_uRawUnFltd "" SWORD Volt 1 100 -6553.600 6553.400 FORMAT "%8.3" ECU_ADDRESS 0x6001FD2A
 /begin IF_DATA XCPplus 0x0102
  /begin DAQ_EVENT VARIABLE /end DAQ_EVENT
 /end IF_DATA
/end MEASUREMENT
/begin MEASUREMENT UPxP1_uRaw_f "" FLOAT32_IEEE RBPtCel_u_1p0_2 1 100 -1.00000000E+037 1.00000000E+037 FORMAT "%13.3" ECU_ADDRESS 0x600010DC
 /begin IF_DATA XCPplus 0x0102
  /begin DAQ_EVENT VARIABLE /end DAQ_EVENT
 /end IF_DATA
/end MEASUREMENT
/begin MEASUREMENT UPxP1_uSensCpl "" SWORD OneToOne 1 100 -32768.00 32767.00 FORMAT "%8.2" ECU_ADDRESS 0x6001FD28
 /begin IF_DATA XCPplus 0x0102
  /begin DAQ_EVENT VARIABLE /end DAQ_EVENT
 /end IF_DATA
/end MEASUREMENT
/begin MEASUREMENT UPxP1_uSensGradLim_f_mp "" FLOAT32_IEEE RBPtCel_u_1p0_1 1 100 -1.00000000E+037 1.00000000E+037 FORMAT "%13.3" ECU_ADDRESS 0x70006808
 /begin IF_DATA XCPplus 0x0102
  /begin DAQ_EVENT VARIABLE /end DAQ_EVENT
 /end IF_DATA
/end MEASUREMENT
/begin MEASUREMENT UPxP1_uSensOffsCorrd_f "" FLOAT32_IEEE RBPtCel_u_1p0_1 1 100 -1.00000000E+037 1.00000000E+037 FORMAT "%13.3" ECU_ADDRESS 0x600010D8
 /begin IF_DATA XCPplus 0x0102
  /begin DAQ_EVENT VARIABLE /end DAQ_EVENT
 /end IF_DATA
/end MEASUREMENT
/begin MEASUREMENT UPxP1_uSensUnFltd "" SWORD RBPtCel_u_1p0_1 1 100 -32768.00 32767.00 FORMAT "%8.2" ECU_ADDRESS 0x6001FD26
 /begin IF_DATA XCPplus 0x0102
  /begin DAQ_EVENT VARIABLE /end DAQ_EVENT
 /end IF_DATA
/end MEASUREMENT
/begin MEASUREMENT UPxP1_uSens_f "" FLOAT32_IEEE RBPtCel_u_1p0_1 1 100 -1.00000000E+037 1.00000000E+037 FORMAT "%13.3" ECU_ADDRESS 0x600010D4
 /begin IF_DATA XCPplus 0x0102
  /begin DAQ_EVENT VARIABLE /end DAQ_EVENT
 /end IF_DATA
/end MEASUREMENT
/begin MEASUREMENT UPxP1_uUnFlt_f "" FLOAT32_IEEE RBPtCel_u_1p0_1 1 100 -1.00000000E+037 1.00000000E+037 FORMAT "%13.3" ECU_ADDRESS 0x600010D0
 /begin IF_DATA XCPplus 0x0102
  /begin DAQ_EVENT VARIABLE /end DAQ_EVENT
 /end IF_DATA
/end MEASUREMENT
/begin MEASUREMENT UPxP1_u_f "Actual physical value" FLOAT32_IEEE RBPtCel_u_1p0_1 1 100 -1.00000000E+037 1.00000000E+037 FORMAT "%13.3" ECU_ADDRESS 0x600010CC
 /begin IF_DATA XCPplus 0x0102
  /begin DAQ_EVENT VARIABLE /end DAQ_EVENT
 /end IF_DATA
/end MEASUREMENT
/begin MEASUREMENT UPxP1_u_f_Sq "" UBYTE SigQly_COMPU_VERB 1 100 0.00 15.0000000000 FORMAT "%13.10" ECU_ADDRESS 0x60023762
 /begin IF_DATA XCPplus 0x0102
  /begin DAQ_EVENT VARIABLE /end DAQ_EVENT
 /end IF_DATA
/end MEASUREMENT
/begin MEASUREMENT VehCoorn_dstHiSohRngPrdcDisp "Predictive range for display based on high state of health" SLONG RBPtCel_dst_1p0_1 1 100 -2147483648.00 2147483647.00 FORMAT "%13.2" ECU_ADDRESS 0x600003E4
 /begin IF_DATA XCPplus 0x0102
  /begin DAQ_EVENT VARIABLE /end DAQ_EVENT
 /end IF_DATA
/end MEASUREMENT
/begin MEASUREMENT VehCoorn_dstMedSohRngPrdcDisp "Predictive range for display based on medium state of health" SLONG RBPtCel_dst_1p0_1 1 100 -2147483648.00 2147483647.00 FORMAT "%13.2" ECU_ADDRESS 0x600003E0
 /begin IF_DATA XCPplus 0x0102
  /begin DAQ_EVENT VARIABLE /end DAQ_EVENT
 /end IF_DATA
/end MEASUREMENT
/begin MEASUREMENT VehCoorn_dstRampActRngPrdcDisp "Calculated Predictive range for display after ramping" SLONG RBPtCel_dst_1p0_1 1 100 -2147483648.00 2147483647.00 FORMAT "%13.2" ECU_ADDRESS 0x600003DC
 /begin IF_DATA XCPplus 0x0102
  /begin DAQ_EVENT VARIABLE /end DAQ_EVENT
 /end IF_DATA
/end MEASUREMENT
/begin MEASUREMENT VehCoorn_dstRateLimMax "maximum change rate for signal shaping of predicted range" ULONG RBPtCel_dst_1p0_1 1 100 0.00 4294967295.00 FORMAT "%13.2" ECU_ADDRESS 0x6000045C
 /begin IF_DATA XCPplus 0x0102
  /begin DAQ_EVENT VARIABLE /end DAQ_EVENT
 /end IF_DATA
/end MEASUREMENT
/begin MEASUREMENT VehCoorn_dstRateLimMin "minimum change rate for signal shaping of predicted range" ULONG RBPtCel_dst_1p0_1 1 100 0.00 4294967295.00 FORMAT "%13.2" ECU_ADDRESS 0x60000458
 /begin IF_DATA XCPplus 0x0102
  /begin DAQ_EVENT VARIABLE /end DAQ_EVENT
 /end IF_DATA
/end MEASUREMENT
/begin MEASUREMENT VehCoorn_dstRngPrdcDisp "remaining driving range (display)" SLONG RBPtCel_dst_1p0_1 1 100 -2147483648.00 2147483647.00 FORMAT "%13.2" ECU_ADDRESS 0x6003600C
 /begin IF_DATA XCPplus 0x0102
  /begin DAQ_EVENT VARIABLE /end DAQ_EVENT
 /end IF_DATA
/end MEASUREMENT
/begin MEASUREMENT VehCoorn_dstRngPrdcDispDft "Default predictive range for HMI display" SLONG RBPtCel_dst_1p0_1 1 100 -2147483648.00 2147483647.00 FORMAT "%13.2" ECU_ADDRESS 0x600003D8
 /begin IF_DATA XCPplus 0x0102
  /begin DAQ_EVENT VARIABLE /end DAQ_EVENT
 /end IF_DATA
/end MEASUREMENT
/begin MEASUREMENT VehCoorn_dstRngPrdcDispHi "Calculated high predictive range for HMI display" SLONG RBPtCel_dst_1p0_1 1 100 -2147483648.00 2147483647.00 FORMAT "%13.2" ECU_ADDRESS 0x600003D4
 /begin IF_DATA XCPplus 0x0102
  /begin DAQ_EVENT VARIABLE /end DAQ_EVENT
 /end IF_DATA
/end MEASUREMENT
/begin MEASUREMENT VehCoorn_dstRngPrdcDispMed "Medium distance range prediction for HMI display" SLONG RBPtCel_dst_1p0_1 1 100 -2147483648.00 2147483647.00 FORMAT "%13.2" ECU_ADDRESS 0x600003D0
 /begin IF_DATA XCPplus 0x0102
  /begin DAQ_EVENT VARIABLE /end DAQ_EVENT
 /end IF_DATA
/end MEASUREMENT
/begin MEASUREMENT VehCoorn_dstRngPrdcIntrpnDisp "Calculated predictive range display after interpolation" SLONG RBPtCel_dst_1p0_1 1 100 -2147483648.00 2147483647.00 FORMAT "%13.2" ECU_ADDRESS 0x600003CC
 /begin IF_DATA XCPplus 0x0102
  /begin DAQ_EVENT VARIABLE /end DAQ_EVENT
 /end IF_DATA
/end MEASUREMENT
/begin MEASUREMENT VehCoorn_dstRngPred "remaining driving range" SLONG RBPtCel_dst_1p0_1 1 100 -2147483648.00 2147483647.00 FORMAT "%13.2" ECU_ADDRESS 0x60036008
 /begin IF_DATA XCPplus 0x0102
  /begin DAQ_EVENT VARIABLE /end DAQ_EVENT
 /end IF_DATA
/end MEASUREMENT
/begin MEASUREMENT VehCoorn_dstRngPredFild "remaining driving range (filtered value)" FLOAT32_IEEE RBPtCel_dst_1p0_1 1 100 -1.0000E+037 1.0000E+037 FORMAT "%10.4" ECU_ADDRESS 0x60000454
 /begin IF_DATA XCPplus 0x0102
  /begin DAQ_EVENT VARIABLE /end DAQ_EVENT
 /end IF_DATA
/end MEASUREMENT
/begin MEASUREMENT VehCoorn_dstRngPredFildOld "remaining driving range (filtered value) from previous calculation step" FLOAT32_IEEE RBPtCel_dst_1p0_1 1 100 -1.0000E+037 1.0000E+037 FORMAT "%10.4" ECU_ADDRESS 0x60000450
 /begin IF_DATA XCPplus 0x0102
  /begin DAQ_EVENT VARIABLE /end DAQ_EVENT
 /end IF_DATA
/end MEASUREMENT
/begin MEASUREMENT VehCoorn_dstRngPredLim "remaining driving range (rate limited value)" SLONG RBPtCel_dst_1p0_1 1 100 -2147483648.0000 2147483647.0000 FORMAT "%10.4" ECU_ADDRESS 0x6000044C
 /begin IF_DATA XCPplus 0x0102
  /begin DAQ_EVENT VARIABLE /end DAQ_EVENT
 /end IF_DATA
/end MEASUREMENT
/begin MEASUREMENT VehCoorn_dstRngPredMax "remaining range maximum limit" FLOAT32_IEEE RBPtCel_dst_1p0_1 1 100 -1.0000E+037 1.0000E+037 FORMAT "%10.4" ECU_ADDRESS 0x60000448
 /begin IF_DATA XCPplus 0x0102
  /begin DAQ_EVENT VARIABLE /end DAQ_EVENT
 /end IF_DATA
/end MEASUREMENT
/begin MEASUREMENT VehCoorn_dstRngPredMedIntrpn "Calculated Predictive range display in medium interpolation" SLONG RBPtCel_dst_1p0_1 1 100 -2147483648.00 2147483647.00 FORMAT "%13.2" ECU_ADDRESS 0x600003C8
 /begin IF_DATA XCPplus 0x0102
  /begin DAQ_EVENT VARIABLE /end DAQ_EVENT
 /end IF_DATA
/end MEASUREMENT
/begin MEASUREMENT VehCoorn_dstRngPredMin "remaining range minimum limit" FLOAT32_IEEE RBPtCel_dst_1p0_1 1 100 -1.0000E+037 1.0000E+037 FORMAT "%10.4" ECU_ADDRESS 0x60000444
 /begin IF_DATA XCPplus 0x0102
  /begin DAQ_EVENT VARIABLE /end DAQ_EVENT
 /end IF_DATA
/end MEASUREMENT
/begin MEASUREMENT VehCoorn_dstRngPredRaw "remaining driving range (raw value)" FLOAT32_IEEE RBPtCel_dst_1p0_1 1 100 -1.0000E+037 1.0000E+037 FORMAT "%10.4" ECU_ADDRESS 0x60000440
 /begin IF_DATA XCPplus 0x0102
  /begin DAQ_EVENT VARIABLE /end DAQ_EVENT
 /end IF_DATA
/end MEASUREMENT
/begin MEASUREMENT VehCoorn_dstRngPredRawOld "raw value of remaining predicted range from previous calculation step" FLOAT32_IEEE RBPtCel_dst_1p0_1 1 100 -1.0000E+037 1.0000E+037 FORMAT "%10.4" ECU_ADDRESS 0x60035EB0
 /begin IF_DATA XCPplus 0x0102
  /begin DAQ_EVENT VARIABLE /end DAQ_EVENT
 /end IF_DATA
/end MEASUREMENT
/begin MEASUREMENT VehCoorn_dstRngRLIM_I "Rate Limiter for predicted range" SLONG OneToOne 1 100 -2147483648.00 2147483647.00 FORMAT "%13.2" ECU_ADDRESS 0x6000043C
 /begin IF_DATA XCPplus 0x0102
  /begin DAQ_EVENT VARIABLE /end DAQ_EVENT
 /end IF_DATA
/end MEASUREMENT
/begin MEASUREMENT VehCoorn_dstRstVal "reset value rate limiter" FLOAT32_IEEE RBPtCel_dst_1p0_1 1 100 -1.0000E+037 1.0000E+037 FORMAT "%10.4" ECU_ADDRESS 0x60000438
 /begin IF_DATA XCPplus 0x0102
  /begin DAQ_EVENT VARIABLE /end DAQ_EVENT
 /end IF_DATA
/end MEASUREMENT
/begin MEASUREMENT VehCoorn_egyHvb "Energy stored in HV battery" FLOAT32_IEEE RBPtCel_egy_1p0_2 1 100 -1.0000E+037 1.0000E+037 FORMAT "%10.4" ECU_ADDRESS 0x6003604C
 /begin IF_DATA XCPplus 0x0102
  /begin DAQ_EVENT VARIABLE /end DAQ_EVENT
 /end IF_DATA
/end MEASUREMENT
/begin MEASUREMENT VehCoorn_egyIniPha "Energy in the remaining initial phase" FLOAT32_IEEE RBPtCel_pwr_1p0_1 1 100 -1.0000E+037 1.0000E+037 FORMAT "%10.4" ECU_ADDRESS 0x60000524
 /begin IF_DATA XCPplus 0x0102
  /begin DAQ_EVENT VARIABLE /end DAQ_EVENT
 /end IF_DATA
/end MEASUREMENT
/begin MEASUREMENT VehCoorn_egyMeclTot "total mechanical energy" FLOAT32_IEEE RBPtCel_egy_1p0_2 1 100 -1.00E+037 1.00E+037 FORMAT "%14.2" ECU_ADDRESS 0x60000434
 /begin IF_DATA XCPplus 0x0102
  /begin DAQ_EVENT VARIABLE /end DAQ_EVENT
 /end IF_DATA
/end MEASUREMENT
/begin MEASUREMENT VehCoorn_egyPerDeltaKElecCnsAuxTra "Energy required per degree Kelvin to heat or cool the hv battery and cabin in the transient phase." FLOAT32_IEEE RBPtCel_pwr_1p0_4 1 100 -1.0000E+037 1.0000E+037 FORMAT "%10.4" MATRIX_DIM 15 ECU_ADDRESS 0x60036010
 /begin IF_DATA XCPplus 0x0102
  /begin DAQ_EVENT VARIABLE /end DAQ_EVENT
 /end IF_DATA
/end MEASUREMENT
/begin MEASUREMENT VehCoorn_egyPerDeltaKElecCnsAuxTraDly "energy required to heat or cool a degree kelvin of the HvBatt resp. Cabin (unit delay)" FLOAT32_IEEE RBPtCel_pwr_1p0_4 1 100 -1.0000E+037 1.0000E+037 FORMAT "%10.4" MATRIX_DIM 15 ECU_ADDRESS 0x60035F40
 /begin IF_DATA XCPplus 0x0102
  /begin DAQ_EVENT VARIABLE /end DAQ_EVENT
 /end IF_DATA
/end MEASUREMENT
/begin MEASUREMENT VehCoorn_egyTracElecCnsAuxMax "Current maximal allow transient energy" FLOAT32_IEEE RBPtCel_pwr_1p0_4 1 100 -1.0000E+037 1.0000E+037 FORMAT "%10.4" ECU_ADDRESS 0x60000520
 /begin IF_DATA XCPplus 0x0102
  /begin DAQ_EVENT VARIABLE /end DAQ_EVENT
 /end IF_DATA
/end MEASUREMENT
/begin MEASUREMENT VehCoorn_egyTraElecCnsAux "remaining energy required for initialization and transient phase" FLOAT32_IEEE RBPtCel_pwr_1p0_4 1 100 -1.0000E+037 1.0000E+037 FORMAT "%10.4" ECU_ADDRESS 0x60000EA4
 /begin IF_DATA XCPplus 0x0102
  /begin DAQ_EVENT VARIABLE /end DAQ_EVENT
 /end IF_DATA
/end MEASUREMENT
/begin MEASUREMENT VehCoorn_egyTraElecCnsAuxWght "Remaining transient energy weighted by SOC" FLOAT32_IEEE RBPtCel_egy_1p0_2 1 100 -1.00E+037 1.00E+037 FORMAT "%14.2" ECU_ADDRESS 0x60000430
 /begin IF_DATA XCPplus 0x0102
  /begin DAQ_EVENT VARIABLE /end DAQ_EVENT
 /end IF_DATA
/end MEASUREMENT
/begin MEASUREMENT VehCoorn_ElecEgyCnsFPT1_I.X1 "PT1 filter for electrical power consumed form HV battery / Input value at one time step before" FLOAT32_IEEE OneToOne 1 100 -1.00000000E+037 1.00000000E+037 FORMAT "%13.3" ECU_ADDRESS 0x60035E88 /end MEASUREMENT
/begin MEASUREMENT VehCoorn_ElecEgyCnsFPT1_I.Y1 "PT1 filter for electrical power consumed form HV battery / Output value at one time step before" FLOAT32_IEEE OneToOne 1 100 -1.00000000E+037 1.00000000E+037 FORMAT "%13.3" ECU_ADDRESS 0x60035E8C /end MEASUREMENT
/begin MEASUREMENT VehCoorn_facElecCnsWght "SOC based factor for intermix of short-term and long-term averages" FLOAT32_IEEE RBPtCel_fac_1p0_1 1 100 -1.0000E+037 1.0000E+037 FORMAT "%10.4" ECU_ADDRESS 0x6000042C
 /begin IF_DATA XCPplus 0x0102
  /begin DAQ_EVENT VARIABLE /end DAQ_EVENT
 /end IF_DATA
/end MEASUREMENT
/begin MEASUREMENT VehCoorn_facElecEgyEff "energy efficiency factor" FLOAT32_IEEE RBPtCel_fac_1p0_1 1 100 -1.0000E+037 1.0000E+037 FORMAT "%10.4" ECU_ADDRESS 0x60000428
 /begin IF_DATA XCPplus 0x0102
  /begin DAQ_EVENT VARIABLE /end DAQ_EVENT
 /end IF_DATA
/end MEASUREMENT
/begin MEASUREMENT VehCoorn_flgAuxCnsChg "Flag signalling that the electric consumption averages of the auxiliaries has changed" UBYTE B_TRUE 1 100 0.00 1.00000000000 BIT_MASK 0x1 FORMAT "%13.11" ECU_ADDRESS 0x7000026E
 /begin IF_DATA XCPplus 0x0102
  /begin DAQ_EVENT VARIABLE /end DAQ_EVENT
 /end IF_DATA
/end MEASUREMENT
/begin MEASUREMENT VehCoorn_flgDrvModChg "Drive Mode changed" UBYTE B_TRUE 1 100 0.00 1.00000000000 BIT_MASK 0x1 FORMAT "%13.11" ECU_ADDRESS 0x7000026B
 /begin IF_DATA XCPplus 0x0102
  /begin DAQ_EVENT VARIABLE /end DAQ_EVENT
 /end IF_DATA
/end MEASUREMENT
/begin MEASUREMENT VehCoorn_flgHiSocRngPrdcDisp "Flag to indicate the High SoC in the system for predictive range calculation" UBYTE B_TRUE 1 100 0.00 1.00000000000 BIT_MASK 0x1 FORMAT "%13.11" ECU_ADDRESS 0x700000EE
 /begin IF_DATA XCPplus 0x0102
  /begin DAQ_EVENT VARIABLE /end DAQ_EVENT
 /end IF_DATA
/end MEASUREMENT
/begin MEASUREMENT VehCoorn_flgInIniPha "hv battery and cabin conditioning in the initial phase" UBYTE B_TRUE 1 100 0.00 1.00000000000 BIT_MASK 0x1 FORMAT "%13.11" ECU_ADDRESS 0x700000FE
 /begin IF_DATA XCPplus 0x0102
  /begin DAQ_EVENT VARIABLE /end DAQ_EVENT
 /end IF_DATA
/end MEASUREMENT
/begin MEASUREMENT VehCoorn_flgInStatPha "hv battery and cabin are assumed to be conditioned" UBYTE B_TRUE 1 100 0.00 1.00000000000 BIT_MASK 0x1 FORMAT "%13.11" ECU_ADDRESS 0x700000FD
 /begin IF_DATA XCPplus 0x0102
  /begin DAQ_EVENT VARIABLE /end DAQ_EVENT
 /end IF_DATA
/end MEASUREMENT
/begin MEASUREMENT VehCoorn_flgInTraPha "hv battery and cabin conditioning in the transient phase" UBYTE B_TRUE 1 100 0.00 1.00000000000 BIT_MASK 0x1 FORMAT "%13.11" ECU_ADDRESS 0x700000FC
 /begin IF_DATA XCPplus 0x0102
  /begin DAQ_EVENT VARIABLE /end DAQ_EVENT
 /end IF_DATA
/end MEASUREMENT
/begin MEASUREMENT VehCoorn_flgInvldAux "Average auxiliary consumptions are invalid" UBYTE B_TRUE 1 100 0.0000 1.0000 BIT_MASK 0x1 FORMAT "%10.4" ECU_ADDRESS 0x70000267
 /begin IF_DATA XCPplus 0x0102
  /begin DAQ_EVENT VARIABLE /end DAQ_EVENT
 /end IF_DATA
/end MEASUREMENT
/begin MEASUREMENT VehCoorn_flgLoSocRngPrdcDisp "Flag to indicate the low SoC in the system for predictive range calculation" UBYTE B_TRUE 1 100 0.00 1.00000000000 BIT_MASK 0x1 FORMAT "%13.11" ECU_ADDRESS 0x700000ED
 /begin IF_DATA XCPplus 0x0102
  /begin DAQ_EVENT VARIABLE /end DAQ_EVENT
 /end IF_DATA
/end MEASUREMENT
/begin MEASUREMENT VehCoorn_flgPrmsAux "average electric consumption for auxiliaries are being updated" UBYTE B_TRUE 1 100 0.0000 1.0000 BIT_MASK 0x1 FORMAT "%10.4" ECU_ADDRESS 0x70000266
 /begin IF_DATA XCPplus 0x0102
  /begin DAQ_EVENT VARIABLE /end DAQ_EVENT
 /end IF_DATA
/end MEASUREMENT
/begin MEASUREMENT VehCoorn_flgPrmsEgyEff "permisson for update of average consumtions" UBYTE B_TRUE 1 100 0.00 1.00000000000 BIT_MASK 0x1 FORMAT "%13.11" ECU_ADDRESS 0x700000F9
 /begin IF_DATA XCPplus 0x0102
  /begin DAQ_EVENT VARIABLE /end DAQ_EVENT
 /end IF_DATA
/end MEASUREMENT
/begin MEASUREMENT VehCoorn_flgPrmsPrp "Actual power, e-machine 01" UBYTE B_TRUE 1 100 0.00 1.00000000000 BIT_MASK 0x1 FORMAT "%13.11" ECU_ADDRESS 0x70000265
 /begin IF_DATA XCPplus 0x0102
  /begin DAQ_EVENT VARIABLE /end DAQ_EVENT
 /end IF_DATA
/end MEASUREMENT
/begin MEASUREMENT VehCoorn_flgRngActv "permisson for update of average consumtions" UBYTE B_TRUE 1 100 0.00 1.00000000000 BIT_MASK 0x1 FORMAT "%13.11" ECU_ADDRESS 0x700000F8
 /begin IF_DATA XCPplus 0x0102
  /begin DAQ_EVENT VARIABLE /end DAQ_EVENT
 /end IF_DATA
/end MEASUREMENT
/begin MEASUREMENT VehCoorn_flgRngFault "range fault (default value is shown on remaining distance)" UBYTE B_TRUE 1 100 0.00 1.00000000000 BIT_MASK 0x1 FORMAT "%13.11" ECU_ADDRESS 0x700000F7
 /begin IF_DATA XCPplus 0x0102
  /begin DAQ_EVENT VARIABLE /end DAQ_EVENT
 /end IF_DATA
/end MEASUREMENT
/begin MEASUREMENT VehCoorn_flgRstRng "reset rate limiter" UBYTE B_TRUE 1 100 0.00 1.00000000000 BIT_MASK 0x1 FORMAT "%13.11" ECU_ADDRESS 0x700000F6
 /begin IF_DATA XCPplus 0x0102
  /begin DAQ_EVENT VARIABLE /end DAQ_EVENT
 /end IF_DATA
/end MEASUREMENT
/begin MEASUREMENT VehCoorn_flgRstSgnShp "range fault (default value is shown on remaining distance)" UBYTE B_TRUE 1 100 0.00 1.00000000000 BIT_MASK 0x1 FORMAT "%13.11" ECU_ADDRESS 0x700000F5
 /begin IF_DATA XCPplus 0x0102
  /begin DAQ_EVENT VARIABLE /end DAQ_EVENT
 /end IF_DATA
/end MEASUREMENT
/begin MEASUREMENT VehCoorn_flgSigQlyRngPrdcDisp "Flag to indicate the signal quality of range prediction for display" UBYTE B_TRUE 1 100 0.00 1.00000000000 BIT_MASK 0x1 FORMAT "%13.11" ECU_ADDRESS 0x700000EC
 /begin IF_DATA XCPplus 0x0102
  /begin DAQ_EVENT VARIABLE /end DAQ_EVENT
 /end IF_DATA
/end MEASUREMENT
/begin MEASUREMENT VehCoorn_idxCbn "Heating or Cooling index of the cabin" UBYTE OneToOne 1 100 0.00 255.0 FORMAT "%5.1" ECU_ADDRESS 0x60022F7F
 /begin IF_DATA XCPplus 0x0102
  /begin DAQ_EVENT VARIABLE /end DAQ_EVENT
 /end IF_DATA
/end MEASUREMENT
/begin MEASUREMENT VehCoorn_idxHvBatt "Heating or Cooling index of the hv battery" UBYTE OneToOne 1 100 0.00 255.0 FORMAT "%5.1" ECU_ADDRESS 0x60022F7E
 /begin IF_DATA XCPplus 0x0102
  /begin DAQ_EVENT VARIABLE /end DAQ_EVENT
 /end IF_DATA
/end MEASUREMENT
/begin MEASUREMENT VehCoorn_lTotDstOld "Unit delay of GlbDa_lTotDst" SLONG Length 1 100 -2147483648.00 2147483647.00 FORMAT "%13.2" ECU_ADDRESS 0x60000424
 /begin IF_DATA XCPplus 0x0102
  /begin DAQ_EVENT VARIABLE /end DAQ_EVENT
 /end IF_DATA
/end MEASUREMENT
/begin MEASUREMENT VehCoorn_nrCntCnsTotWghtAvrg "Number of Continuous consumption total weighted average" SLONG OneToOne 1 100 -2147483648.00 2147483647.00 FORMAT "%13.2" ECU_ADDRESS 0x60035EAC
 /begin IF_DATA XCPplus 0x0102
  /begin DAQ_EVENT VARIABLE /end DAQ_EVENT
 /end IF_DATA
/end MEASUREMENT
/begin MEASUREMENT VehCoorn_nrCntCnsTotWghtAvrgDly "Number of Continuous consumption total weighted average delay" SLONG OneToOne 1 100 -2147483648.00 2147483647.00 FORMAT "%13.2" ECU_ADDRESS 0x60000420
 /begin IF_DATA XCPplus 0x0102
  /begin DAQ_EVENT VARIABLE /end DAQ_EVENT
 /end IF_DATA
/end MEASUREMENT
/begin MEASUREMENT VehCoorn_nrCntCnsTotWghtTripAvrg "Number of Continuous consumption total weighted trip average" SLONG OneToOne 1 100 -2147483648.00 2147483647.00 FORMAT "%13.2" ECU_ADDRESS 0x60035EA8
 /begin IF_DATA XCPplus 0x0102
  /begin DAQ_EVENT VARIABLE /end DAQ_EVENT
 /end IF_DATA
/end MEASUREMENT
/begin MEASUREMENT VehCoorn_nrCntCnsTotWghtTripAvrgDly "Number of Continuous consumption total weighted trip average delay" SLONG OneToOne 1 100 -2147483648.00 2147483647.00 FORMAT "%13.2" ECU_ADDRESS 0x6000041C
 /begin IF_DATA XCPplus 0x0102
  /begin DAQ_EVENT VARIABLE /end DAQ_EVENT
 /end IF_DATA
/end MEASUREMENT
/begin MEASUREMENT VehCoorn_nrCntWghtAvrgTripA "Number of Continuous consumption weighted average of Trip A" SLONG OneToOne 1 100 -2147483648.00 2147483647.00 FORMAT "%13.2" ECU_ADDRESS 0x60035EA4
 /begin IF_DATA XCPplus 0x0102
  /begin DAQ_EVENT VARIABLE /end DAQ_EVENT
 /end IF_DATA
/end MEASUREMENT
/begin MEASUREMENT VehCoorn_nrCntWghtAvrgTripB "Number of Continuous consumption weighted average of Trip B" SLONG OneToOne 1 100 -2147483648.00 2147483647.00 FORMAT "%13.2" ECU_ADDRESS 0x60035EA0
 /begin IF_DATA XCPplus 0x0102
  /begin DAQ_EVENT VARIABLE /end DAQ_EVENT
 /end IF_DATA
/end MEASUREMENT
/begin MEASUREMENT VehCoorn_nrWghtAvrgTripADly "Number of Continuous consumption weighted average of Trip A delay" SLONG OneToOne 1 100 -2147483648.00 2147483647.00 FORMAT "%13.2" ECU_ADDRESS 0x60000418
 /begin IF_DATA XCPplus 0x0102
  /begin DAQ_EVENT VARIABLE /end DAQ_EVENT
 /end IF_DATA
/end MEASUREMENT
/begin MEASUREMENT VehCoorn_nrWghtAvrgTripBDly "Number of Continuous consumption weighted average of Trip B delay" SLONG OneToOne 1 100 -2147483648.00 2147483647.00 FORMAT "%13.2" ECU_ADDRESS 0x60000414
 /begin IF_DATA XCPplus 0x0102
  /begin DAQ_EVENT VARIABLE /end DAQ_EVENT
 /end IF_DATA
/end MEASUREMENT
/begin MEASUREMENT VehCoorn_prmsCalcnHld "Average consumption are still usable for range prediciton" UBYTE B_TRUE 1 100 0.00 1.00000000000 BIT_MASK 0x1 FORMAT "%13.11" ECU_ADDRESS 0x700000F4
 /begin IF_DATA XCPplus 0x0102
  /begin DAQ_EVENT VARIABLE /end DAQ_EVENT
 /end IF_DATA
/end MEASUREMENT
/begin MEASUREMENT VehCoorn_pwrActCnsPrp "power for propulsion at wheel level" FLOAT32_IEEE RBPtCel_pwr_1p0_1 1 100 -1.00E+037 1.00E+037 FORMAT "%12.2" ECU_ADDRESS 0x60000480
 /begin IF_DATA XCPplus 0x0102
  /begin DAQ_EVENT VARIABLE /end DAQ_EVENT
 /end IF_DATA
/end MEASUREMENT
/begin MEASUREMENT VehCoorn_pwrActElecWhl "power for electrical engine at wheel level" FLOAT32_IEEE RBPtCel_pwr_1p0_1 1 100 -1.00E+037 1.00E+037 FORMAT "%12.2" ECU_ADDRESS 0x60000EA0
 /begin IF_DATA XCPplus 0x0102
  /begin DAQ_EVENT VARIABLE /end DAQ_EVENT
 /end IF_DATA
/end MEASUREMENT
/begin MEASUREMENT VehCoorn_pwrElecCnsAuxLongAvrg "power consumption of the auxiliary consumption" FLOAT32_IEEE RBPtCel_pwr_1p0_1 1 100 -1.0000E+037 1.0000E+037 FORMAT "%10.4" ECU_ADDRESS 0x6000051C
 /begin IF_DATA XCPplus 0x0102
  /begin DAQ_EVENT VARIABLE /end DAQ_EVENT
 /end IF_DATA
/end MEASUREMENT
/begin MEASUREMENT VehCoorn_pwrElecCnsAuxLongAvrgWghtT "temperature weighted power consumption of the auxiliary consumption" FLOAT32_IEEE q1_W_s_DIV_m 1 100 -1.0000E+037 1.0000E+037 FORMAT "%10.4" MATRIX_DIM 10 ECU_ADDRESS 0x60000E78
 /begin IF_DATA XCPplus 0x0102
  /begin DAQ_EVENT VARIABLE /end DAQ_EVENT
 /end IF_DATA
/end MEASUREMENT
/begin MEASUREMENT VehCoorn_PwrElecWhlFPT1_I.X1 "PT1 filter for electrical engine power at wheel level / Input value at one time step before" FLOAT32_IEEE OneToOne 1 100 -1.00000000E+037 1.00000000E+037 FORMAT "%13.3" ECU_ADDRESS 0x60035E80 /end MEASUREMENT
/begin MEASUREMENT VehCoorn_PwrElecWhlFPT1_I.Y1 "PT1 filter for electrical engine power at wheel level / Output value at one time step before" FLOAT32_IEEE OneToOne 1 100 -1.00000000E+037 1.00000000E+037 FORMAT "%13.3" ECU_ADDRESS 0x60035E84 /end MEASUREMENT
/begin MEASUREMENT VehCoorn_ratCnsPrpDrvMod "energy consumption ratio of propulsion regarding different driving modes" FLOAT32_IEEE RBPtCel_fac_1p0_1 1 100 -1.0000E+037 1.0000E+037 FORMAT "%10.4" ECU_ADDRESS 0x6000047C
 /begin IF_DATA XCPplus 0x0102
  /begin DAQ_EVENT VARIABLE /end DAQ_EVENT
 /end IF_DATA
/end MEASUREMENT
/begin MEASUREMENT VehCoorn_ratCnsPrpEco "energy consumption ratio of propulsion regarding driving mode Eco" FLOAT32_IEEE RBPtCel_fac_1p0_1 1 100 -1.0000E+037 1.0000E+037 FORMAT "%10.4" ECU_ADDRESS 0x60000478
 /begin IF_DATA XCPplus 0x0102
  /begin DAQ_EVENT VARIABLE /end DAQ_EVENT
 /end IF_DATA
/end MEASUREMENT
/begin MEASUREMENT VehCoorn_ratCnsPrpNorm "energy consumption ratio of propulsion regarding driving mode Normal" FLOAT32_IEEE RBPtCel_fac_1p0_1 1 100 -1.0000E+037 1.0000E+037 FORMAT "%10.4" ECU_ADDRESS 0x60000474
 /begin IF_DATA XCPplus 0x0102
  /begin DAQ_EVENT VARIABLE /end DAQ_EVENT
 /end IF_DATA
/end MEASUREMENT
/begin MEASUREMENT VehCoorn_ratDstRstVal "actual energy consumption ratio of propulsion regarding driving mode" FLOAT32_IEEE RBPtCel_fac_1p0_1 1 100 -1.0000E+037 1.0000E+037 FORMAT "%10.4" ECU_ADDRESS 0x60000410
 /begin IF_DATA XCPplus 0x0102
  /begin DAQ_EVENT VARIABLE /end DAQ_EVENT
 /end IF_DATA
/end MEASUREMENT
/begin MEASUREMENT VehCoorn_ratElecCnsAuxT "factor weighting the currenct auxiliary consumption depending on the environment temperature" FLOAT32_IEEE RBPtCel_fac_1p0_1 1 100 -1.0000E+037 1.0000E+037 FORMAT "%10.4" ECU_ADDRESS 0x60000518
 /begin IF_DATA XCPplus 0x0102
  /begin DAQ_EVENT VARIABLE /end DAQ_EVENT
 /end IF_DATA
/end MEASUREMENT
/begin MEASUREMENT VehCoorn_st "Common Vehicle State" UBYTE VehCoorn_st_VERB 1 100 0.00 6.00000000000 FORMAT "%13.11" ECU_ADDRESS 0x600234FE
 /begin IF_DATA XCPplus 0x0102
  /begin DAQ_EVENT VARIABLE /end DAQ_EVENT
 /end IF_DATA
/end MEASUREMENT
/begin MEASUREMENT VehCoorn_stProtddlyd "Variable to hold the previous vehicle state" UBYTE OneToOne 1 100 0.00 255.0 FORMAT "%5.1" ECU_ADDRESS 0x600347A5
 /begin IF_DATA XCPplus 0x0102
  /begin DAQ_EVENT VARIABLE /end DAQ_EVENT
 /end IF_DATA
/end MEASUREMENT
/begin MEASUREMENT VehCoorn_stProtdLoc "Local variable for vehcoorn state protected" UBYTE OneToOne 1 100 0.00 255.0 FORMAT "%5.1" ECU_ADDRESS 0x600347A4
 /begin IF_DATA XCPplus 0x0102
  /begin DAQ_EVENT VARIABLE /end DAQ_EVENT
 /end IF_DATA
/end MEASUREMENT
/begin MEASUREMENT VehCoorn_tChgT "The combined temperature change towards the desired temperature of cabin and HV-battery in the computation step" SWORD TempDiff_Kelv 1 100 -3276.800 3276.700 FORMAT "%8.3" ECU_ADDRESS 0x6001F3C8
 /begin IF_DATA XCPplus 0x0102
  /begin DAQ_EVENT VARIABLE /end DAQ_EVENT
 /end IF_DATA
/end MEASUREMENT
/begin MEASUREMENT VehCoorn_tDeltaCbn "temperature difference of the cabin" SWORD TempDiff_Kelv 1 100 -3276.8000 3276.7000 FORMAT "%10.4" ECU_ADDRESS 0x6001F3C6
 /begin IF_DATA XCPplus 0x0102
  /begin DAQ_EVENT VARIABLE /end DAQ_EVENT
 /end IF_DATA
/end MEASUREMENT
/begin MEASUREMENT VehCoorn_tDeltaHvBatt "temperature difference of the hv-battery" SWORD TempDiff_Kelv 1 100 -3276.8000 3276.7000 FORMAT "%10.4" ECU_ADDRESS 0x6001F3C2
 /begin IF_DATA XCPplus 0x0102
  /begin DAQ_EVENT VARIABLE /end DAQ_EVENT
 /end IF_DATA
/end MEASUREMENT
/begin MEASUREMENT VehCoorn_tiCdngDur "Timer of the conditioning phase" UWORD Time_1s 1 100 0.0000 65535.0000 FORMAT "%10.4" ECU_ADDRESS 0x6001F3BE
 /begin IF_DATA XCPplus 0x0102
  /begin DAQ_EVENT VARIABLE /end DAQ_EVENT
 /end IF_DATA
/end MEASUREMENT
/begin MEASUREMENT VehCoorn_tiIniPhaRmn "Remaining time in the initial phase" UWORD Time_1s 1 100 0.0000 65535.0000 FORMAT "%10.4" ECU_ADDRESS 0x6001F3BC
 /begin IF_DATA XCPplus 0x0102
  /begin DAQ_EVENT VARIABLE /end DAQ_EVENT
 /end IF_DATA
/end MEASUREMENT
/begin MEASUREMENT VehCoorn_tiPerDeltaKElecCnsAuxTra "time required to heat or cool a degree kelvin of the HvBatt resp. Cabin" FLOAT32_IEEE RBPtCel_ti_1p0_2 1 100 -1.0000E+037 1.0000E+037 FORMAT "%10.4" MATRIX_DIM 15 ECU_ADDRESS 0x60000E3C
 /begin IF_DATA XCPplus 0x0102
  /begin DAQ_EVENT VARIABLE /end DAQ_EVENT
 /end IF_DATA
/end MEASUREMENT
/begin MEASUREMENT VehCoorn_tiPerDeltaKElecCnsAuxTraDly "Delayed Time to heat or cool a degree Kelvin of the HVB." FLOAT32_IEEE RBPtCel_ti_1p0_2 1 100 -1.0000E+037 1.0000E+037 FORMAT "%10.4" MATRIX_DIM 15 ECU_ADDRESS 0x600004DC
 /begin IF_DATA XCPplus 0x0102
  /begin DAQ_EVENT VARIABLE /end DAQ_EVENT
 /end IF_DATA
/end MEASUREMENT
/begin MEASUREMENT VehCoorn_tiPerDeltaKElecCnsAuxTraOld "Time to heat or cool a degree Kelvin of the HVB." FLOAT32_IEEE RBPtCel_ti_1p0_2 1 100 -1.0000E+037 1.0000E+037 FORMAT "%10.4" MATRIX_DIM 15 ECU_ADDRESS 0x60035F04
 /begin IF_DATA XCPplus 0x0102
  /begin DAQ_EVENT VARIABLE /end DAQ_EVENT
 /end IF_DATA
/end MEASUREMENT
/begin MEASUREMENT VehCoorn_tiTraElecCnsAux "remaining time required for initialization and transient phase" FLOAT32_IEEE RBPtCel_ti_1p0_2 1 100 -1.0000E+037 1.0000E+037 FORMAT "%10.4" ECU_ADDRESS 0x60000E38
 /begin IF_DATA XCPplus 0x0102
  /begin DAQ_EVENT VARIABLE /end DAQ_EVENT
 /end IF_DATA
/end MEASUREMENT
/begin MEASUREMENT VehCoorn_vElecCnsAuxLongAvrg "average vehicle speed for calculation of average electric consumption for auxilary consumers long term" FLOAT32_IEEE q1p0_m_DIV_s 1 100 -1.0000E+037 1.0000E+037 FORMAT "%10.4" ECU_ADDRESS 0x600004D8
 /begin IF_DATA XCPplus 0x0102
  /begin DAQ_EVENT VARIABLE /end DAQ_EVENT
 /end IF_DATA
/end MEASUREMENT
/begin MEASUREMENT VehCoorn_vElecCnsAuxLongAvrgCur "current average vehicle speed fpor calculation of long term average electrical consumtion of auxilary consumers" FLOAT32_IEEE q1p0_m_DIV_s 1 100 -1.0000E+037 1.0000E+037 FORMAT "%10.4" ECU_ADDRESS 0x600004D4
 /begin IF_DATA XCPplus 0x0102
  /begin DAQ_EVENT VARIABLE /end DAQ_EVENT
 /end IF_DATA
/end MEASUREMENT
/begin MEASUREMENT VehCoorn_vElecCnsAuxLongAvrgDly "long-term average vehicle speed (unit delay)" FLOAT32_IEEE q1p0_m_DIV_s 1 100 -1.0000E+037 1.0000E+037 FORMAT "%10.4" ECU_ADDRESS 0x600004D0
 /begin IF_DATA XCPplus 0x0102
  /begin DAQ_EVENT VARIABLE /end DAQ_EVENT
 /end IF_DATA
/end MEASUREMENT
/begin MEASUREMENT VehCoorn_vElecCnsAuxLongAvrgOld "stored value of average vehicle speed for calculation of average electric consumption for auxilary consumers long term" FLOAT32_IEEE q1p0_m_DIV_s 1 100 -1.0000E+037 1.0000E+037 FORMAT "%10.4" ECU_ADDRESS 0x60035F00
 /begin IF_DATA XCPplus 0x0102
  /begin DAQ_EVENT VARIABLE /end DAQ_EVENT
 /end IF_DATA
/end MEASUREMENT
/begin MEASUREMENT VehCoorn_vElecCnsAuxLongAvrgTCur "long-term average speed for temperature conditioning dependent auxiliary consumption calculation" FLOAT32_IEEE q1p0_m_DIV_s 1 100 -1.0000E+037 1.0000E+037 FORMAT "%10.4" ECU_ADDRESS 0x600004CC
 /begin IF_DATA XCPplus 0x0102
  /begin DAQ_EVENT VARIABLE /end DAQ_EVENT
 /end IF_DATA
/end MEASUREMENT
/begin MEASUREMENT VehCoorn_vElecCnsAuxLongAvrgTDly "delayed long-term average speed for temperature conditioning dependent auxiliary consumption calculation" FLOAT32_IEEE q1p0_m_DIV_s 1 100 -1.0000E+037 1.0000E+037 FORMAT "%10.4" ECU_ADDRESS 0x600004C8
 /begin IF_DATA XCPplus 0x0102
  /begin DAQ_EVENT VARIABLE /end DAQ_EVENT
 /end IF_DATA
/end MEASUREMENT
/begin MEASUREMENT VehCoorn_vElecCnsAuxLongAvrgTOld "long-term average vehicle speed from previous calculation step" FLOAT32_IEEE q1p0_m_DIV_s 1 100 -1.0000E+037 1.0000E+037 FORMAT "%10.4" ECU_ADDRESS 0x60035EFC
 /begin IF_DATA XCPplus 0x0102
  /begin DAQ_EVENT VARIABLE /end DAQ_EVENT
 /end IF_DATA
/end MEASUREMENT
/begin MEASUREMENT VehCoorn_vElecCnsAuxShoAvrg "average vehicle speed for calculation of average electric consumption for auxilary consumers short term" FLOAT32_IEEE q1p0_m_DIV_s 1 100 -1.0000E+037 1.0000E+037 FORMAT "%10.4" ECU_ADDRESS 0x600004C4
 /begin IF_DATA XCPplus 0x0102
  /begin DAQ_EVENT VARIABLE /end DAQ_EVENT
 /end IF_DATA
/end MEASUREMENT
/begin MEASUREMENT VehCoorn_vElecCnsAuxShoAvrgCur "Average Vehicle speed fpor calculation of short term average electrical consumtion of auxilary consumers" FLOAT32_IEEE q1p0_m_DIV_s 1 100 -1.0000E+037 1.0000E+037 FORMAT "%10.4" ECU_ADDRESS 0x600004C0
 /begin IF_DATA XCPplus 0x0102
  /begin DAQ_EVENT VARIABLE /end DAQ_EVENT
 /end IF_DATA
/end MEASUREMENT
/begin MEASUREMENT VehCoorn_vElecCnsAuxShoAvrgDly "short-term average vehicle speed (unit delay)" FLOAT32_IEEE q1p0_m_DIV_s 1 100 -1.0000E+037 1.0000E+037 FORMAT "%10.4" ECU_ADDRESS 0x600004BC
 /begin IF_DATA XCPplus 0x0102
  /begin DAQ_EVENT VARIABLE /end DAQ_EVENT
 /end IF_DATA
/end MEASUREMENT
/begin MEASUREMENT VehCoorn_vElecCnsAuxShoAvrgOld "stored value of average vehicle speed for calculation of average electric consumption for auxilary consumers short term" FLOAT32_IEEE q1p0_m_DIV_s 1 100 -1.0000E+037 1.0000E+037 FORMAT "%10.4" ECU_ADDRESS 0x60035EF8
 /begin IF_DATA XCPplus 0x0102
  /begin DAQ_EVENT VARIABLE /end DAQ_EVENT
 /end IF_DATA
/end MEASUREMENT
/begin MEASUREMENT VehCoorn_vElecCnsAuxTAvrg "average vehicle speed used for the temperature based weighting of the auxiliary consumption" FLOAT32_IEEE q1_W_s_DIV_m 1 100 -1.0000E+037 1.0000E+037 FORMAT "%10.4" ECU_ADDRESS 0x600004B8
 /begin IF_DATA XCPplus 0x0102
  /begin DAQ_EVENT VARIABLE /end DAQ_EVENT
 /end IF_DATA
/end MEASUREMENT
/begin MEASUREMENT VehCoorn_wCnsLongAvrg "average consumption long time" FLOAT32_IEEE q1_W_s_DIV_m 1 100 -1.0000E+037 1.0000E+037 FORMAT "%10.4" ECU_ADDRESS 0x60000E34
 /begin IF_DATA XCPplus 0x0102
  /begin DAQ_EVENT VARIABLE /end DAQ_EVENT
 /end IF_DATA
/end MEASUREMENT
/begin MEASUREMENT VehCoorn_wCnsLongPwrAvrg "Long Average Power consumption" FLOAT32_IEEE q1_W_s_DIV_m 1 100 -1.0000E+037 1.0000E+037 FORMAT "%10.4" ECU_ADDRESS 0x6000040C
 /begin IF_DATA XCPplus 0x0102
  /begin DAQ_EVENT VARIABLE /end DAQ_EVENT
 /end IF_DATA
/end MEASUREMENT
/begin MEASUREMENT VehCoorn_wCnsPrpDrvModDly "drive mode dependent average consumption for propulsion (unit delay)" FLOAT32_IEEE q1_W_s_DIV_m 1 100 -1.0000E+037 1.0000E+037 FORMAT "%10.4" MATRIX_DIM 3 ECU_ADDRESS 0x60000468
 /begin IF_DATA XCPplus 0x0102
  /begin DAQ_EVENT VARIABLE /end DAQ_EVENT
 /end IF_DATA
/end MEASUREMENT
/begin MEASUREMENT VehCoorn_wCnsPrpDrvModOld "drive mode dependent average consumption for propulsion from previous calculation step" FLOAT32_IEEE q1_W_s_DIV_m 1 100 -1.0000E+037 1.0000E+037 FORMAT "%10.4" MATRIX_DIM 3 ECU_ADDRESS 0x60035EBC
 /begin IF_DATA XCPplus 0x0102
  /begin DAQ_EVENT VARIABLE /end DAQ_EVENT
 /end IF_DATA
/end MEASUREMENT
/begin MEASUREMENT VehCoorn_wCnsPrpLongAvrg "average electric consumption for propulsion long term" FLOAT32_IEEE q1_W_s_DIV_m 1 100 -1.0000E+037 1.0000E+037 FORMAT "%10.4" ECU_ADDRESS 0x60000E30
 /begin IF_DATA XCPplus 0x0102
  /begin DAQ_EVENT VARIABLE /end DAQ_EVENT
 /end IF_DATA
/end MEASUREMENT
/begin MEASUREMENT VehCoorn_wCnsPrpLongAvrgDly "long-term average consumption for propulsion (unit delay)" FLOAT32_IEEE q1_W_s_DIV_m 1 100 -1.0000E+037 1.0000E+037 FORMAT "%10.4" ECU_ADDRESS 0x60000464
 /begin IF_DATA XCPplus 0x0102
  /begin DAQ_EVENT VARIABLE /end DAQ_EVENT
 /end IF_DATA
/end MEASUREMENT
/begin MEASUREMENT VehCoorn_wCnsPrpLongAvrgOld "long-term average consumption for propulsion from previous calculation step" FLOAT32_IEEE q1_W_s_DIV_m 1 100 -1.0000E+037 1.0000E+037 FORMAT "%10.4" ECU_ADDRESS 0x60035EB8
 /begin IF_DATA XCPplus 0x0102
  /begin DAQ_EVENT VARIABLE /end DAQ_EVENT
 /end IF_DATA
/end MEASUREMENT
/begin MEASUREMENT VehCoorn_wCnsPrpShoAvrg "average electric consumption for propulsion short term" FLOAT32_IEEE q1_W_s_DIV_m 1 100 -1.0000E+037 1.0000E+037 FORMAT "%10.4" ECU_ADDRESS 0x60000E2C
 /begin IF_DATA XCPplus 0x0102
  /begin DAQ_EVENT VARIABLE /end DAQ_EVENT
 /end IF_DATA
/end MEASUREMENT
/begin MEASUREMENT VehCoorn_wCnsPrpShoAvrgDly "short-term average consumption for propulsion (unit delay)" FLOAT32_IEEE q1_W_s_DIV_m 1 100 -1.0000E+037 1.0000E+037 FORMAT "%10.4" ECU_ADDRESS 0x60000460
 /begin IF_DATA XCPplus 0x0102
  /begin DAQ_EVENT VARIABLE /end DAQ_EVENT
 /end IF_DATA
/end MEASUREMENT
/begin MEASUREMENT VehCoorn_wCnsPrpShoAvrgOld "long-term average consumption for propulsion from previous calculation step" FLOAT32_IEEE q1_W_s_DIV_m 1 100 -1.0000E+037 1.0000E+037 FORMAT "%10.4" ECU_ADDRESS 0x60035EB4
 /begin IF_DATA XCPplus 0x0102
  /begin DAQ_EVENT VARIABLE /end DAQ_EVENT
 /end IF_DATA
/end MEASUREMENT
/begin MEASUREMENT VehCoorn_wCnsShoAvrg "average consumption short time" FLOAT32_IEEE q1_W_s_DIV_m 1 100 -1.0000E+037 1.0000E+037 FORMAT "%10.4" ECU_ADDRESS 0x60000E28
 /begin IF_DATA XCPplus 0x0102
  /begin DAQ_EVENT VARIABLE /end DAQ_EVENT
 /end IF_DATA
/end MEASUREMENT
/begin MEASUREMENT VehCoorn_wCnsShoPwrAvrg "Short Average Power consumption" FLOAT32_IEEE q1_W_s_DIV_m 1 100 -1.0000E+037 1.0000E+037 FORMAT "%10.4" ECU_ADDRESS 0x60000408
 /begin IF_DATA XCPplus 0x0102
  /begin DAQ_EVENT VARIABLE /end DAQ_EVENT
 /end IF_DATA
/end MEASUREMENT
/begin MEASUREMENT VehCoorn_wCnsTotWght "total average consumption weighted" FLOAT32_IEEE q1_W_s_DIV_m 1 100 -1.0000E+037 1.0000E+037 FORMAT "%10.4" ECU_ADDRESS 0x60000E24
 /begin IF_DATA XCPplus 0x0102
  /begin DAQ_EVENT VARIABLE /end DAQ_EVENT
 /end IF_DATA
/end MEASUREMENT
/begin MEASUREMENT VehCoorn_wCnsTotWghtAvrgDly "Consumption work of total weighted average delay" FLOAT32_IEEE q1_W_s_DIV_m 1 100 -1.0000E+037 1.0000E+037 FORMAT "%10.4" ECU_ADDRESS 0x60000404
 /begin IF_DATA XCPplus 0x0102
  /begin DAQ_EVENT VARIABLE /end DAQ_EVENT
 /end IF_DATA
/end MEASUREMENT
/begin MEASUREMENT VehCoorn_wCnsTotWghtAvrgEff "Consumption work of total weighted average efficiency" FLOAT32_IEEE q1_W_s_DIV_m 1 100 -1.0000E+037 1.0000E+037 FORMAT "%10.4" ECU_ADDRESS 0x60000E20
 /begin IF_DATA XCPplus 0x0102
  /begin DAQ_EVENT VARIABLE /end DAQ_EVENT
 /end IF_DATA
/end MEASUREMENT
/begin MEASUREMENT VehCoorn_wCnsTotWghtAvrgOld "Consumption work of total weighted average old value" FLOAT32_IEEE q1_W_s_DIV_m 1 100 -1.0000E+037 1.0000E+037 FORMAT "%10.4" ECU_ADDRESS 0x60035E9C
 /begin IF_DATA XCPplus 0x0102
  /begin DAQ_EVENT VARIABLE /end DAQ_EVENT
 /end IF_DATA
/end MEASUREMENT
/begin MEASUREMENT VehCoorn_wCnsTotWghtTripAvrgDly "Consumption work of total trip weighted average delay" FLOAT32_IEEE q1_W_s_DIV_m 1 100 -1.0000E+037 1.0000E+037 FORMAT "%10.4" ECU_ADDRESS 0x60000400
 /begin IF_DATA XCPplus 0x0102
  /begin DAQ_EVENT VARIABLE /end DAQ_EVENT
 /end IF_DATA
/end MEASUREMENT
/begin MEASUREMENT VehCoorn_wCnsTotWghtTripAvrgEff "Consumption work of total trip weighted average efficiency" FLOAT32_IEEE q1_W_s_DIV_m 1 100 -1.0000E+037 1.0000E+037 FORMAT "%10.4" ECU_ADDRESS 0x60000E1C
 /begin IF_DATA XCPplus 0x0102
  /begin DAQ_EVENT VARIABLE /end DAQ_EVENT
 /end IF_DATA
/end MEASUREMENT
/begin MEASUREMENT VehCoorn_wCnsTotWghtTripAvrgOld "Consumption work of total trip weighted average old value" FLOAT32_IEEE q1_W_s_DIV_m 1 100 -1.0000E+037 1.0000E+037 FORMAT "%10.4" ECU_ADDRESS 0x60035E98
 /begin IF_DATA XCPplus 0x0102
  /begin DAQ_EVENT VARIABLE /end DAQ_EVENT
 /end IF_DATA
/end MEASUREMENT
/begin MEASUREMENT VehCoorn_wCnsWghtAvrgEffTripA "consumption of total weighted average energy efficiency of trip A" UWORD q1_Wh_DIV_km 1 100 0.0000 65535.0000 FORMAT "%10.4" ECU_ADDRESS 0x6001F9A6
 /begin IF_DATA XCPplus 0x0102
  /begin DAQ_EVENT VARIABLE /end DAQ_EVENT
 /end IF_DATA
/end MEASUREMENT
/begin MEASUREMENT VehCoorn_wCnsWghtAvrgEffTripB "consumption of total weighted average energy efficiency of trip B" UWORD q1_Wh_DIV_km 1 100 0.0000 65535.0000 FORMAT "%10.4" ECU_ADDRESS 0x6001F9A4
 /begin IF_DATA XCPplus 0x0102
  /begin DAQ_EVENT VARIABLE /end DAQ_EVENT
 /end IF_DATA
/end MEASUREMENT
/begin MEASUREMENT VehCoorn_wCnsWghtAvrgTripADly "Consumption work of weighted average delay of trip A" FLOAT32_IEEE q1_W_s_DIV_m 1 100 -1.0000E+037 1.0000E+037 FORMAT "%10.4" ECU_ADDRESS 0x600003FC
 /begin IF_DATA XCPplus 0x0102
  /begin DAQ_EVENT VARIABLE /end DAQ_EVENT
 /end IF_DATA
/end MEASUREMENT
/begin MEASUREMENT VehCoorn_wCnsWghtAvrgTripAOld "previous value of weighted average consumption of trip A" FLOAT32_IEEE q1_W_s_DIV_m 1 100 -1.0000E+037 1.0000E+037 FORMAT "%10.4" ECU_ADDRESS 0x60035E94
 /begin IF_DATA XCPplus 0x0102
  /begin DAQ_EVENT VARIABLE /end DAQ_EVENT
 /end IF_DATA
/end MEASUREMENT
/begin MEASUREMENT VehCoorn_wCnsWghtAvrgTripBDly "Consumption work of weighted average delay of trip B" FLOAT32_IEEE q1_W_s_DIV_m 1 100 -1.0000E+037 1.0000E+037 FORMAT "%10.4" ECU_ADDRESS 0x600003F8
 /begin IF_DATA XCPplus 0x0102
  /begin DAQ_EVENT VARIABLE /end DAQ_EVENT
 /end IF_DATA
/end MEASUREMENT
/begin MEASUREMENT VehCoorn_wCnsWghtAvrgTripBOld "previous value of weighted average consumption of trip B" FLOAT32_IEEE q1_W_s_DIV_m 1 100 -1.0000E+037 1.0000E+037 FORMAT "%10.4" ECU_ADDRESS 0x60035E90
 /begin IF_DATA XCPplus 0x0102
  /begin DAQ_EVENT VARIABLE /end DAQ_EVENT
 /end IF_DATA
/end MEASUREMENT
/begin MEASUREMENT VehCoorn_wElecCnsAuxAvrgTDly "long-term average consumption of auxiliary consumers (unit delay)" FLOAT32_IEEE q1_W_s_DIV_m 1 100 -1.0000E+037 1.0000E+037 FORMAT "%10.4" MATRIX_DIM 10 ECU_ADDRESS 0x60000490
 /begin IF_DATA XCPplus 0x0102
  /begin DAQ_EVENT VARIABLE /end DAQ_EVENT
 /end IF_DATA
/end MEASUREMENT
/begin MEASUREMENT VehCoorn_wElecCnsAuxAvrgTOld "long-term average consumption of auxiliary consumers from previous calculation step" FLOAT32_IEEE q1_W_s_DIV_m 1 100 -1.0000E+037 1.0000E+037 FORMAT "%10.4" MATRIX_DIM 10 ECU_ADDRESS 0x60035ED0
 /begin IF_DATA XCPplus 0x0102
  /begin DAQ_EVENT VARIABLE /end DAQ_EVENT
 /end IF_DATA
/end MEASUREMENT
/begin MEASUREMENT VehCoorn_wElecCnsAuxLongAvrgDstWght "average electric consumption for auxilary consumers long term" FLOAT32_IEEE q1_W_s_DIV_m 1 100 -1.0000E+037 1.0000E+037 FORMAT "%10.4" ECU_ADDRESS 0x60000E18
 /begin IF_DATA XCPplus 0x0102
  /begin DAQ_EVENT VARIABLE /end DAQ_EVENT
 /end IF_DATA
/end MEASUREMENT
/begin MEASUREMENT VehCoorn_wElecCnsAuxLongDistAvrgDly "delayed long-term average energy for temperature conditioning dependent auxiliary consumption calculation" FLOAT32_IEEE q1_W_s_DIV_m 1 100 -1.0000E+037 1.0000E+037 FORMAT "%10.4" ECU_ADDRESS 0x6000048C
 /begin IF_DATA XCPplus 0x0102
  /begin DAQ_EVENT VARIABLE /end DAQ_EVENT
 /end IF_DATA
/end MEASUREMENT
/begin MEASUREMENT VehCoorn_wElecCnsAuxLongDistAvrgOld "old long-term average energy for temperature conditioning dependent auxiliary consumption calculation" FLOAT32_IEEE q1_W_s_DIV_m 1 100 -1.0000E+037 1.0000E+037 FORMAT "%10.4" ECU_ADDRESS 0x60035ECC
 /begin IF_DATA XCPplus 0x0102
  /begin DAQ_EVENT VARIABLE /end DAQ_EVENT
 /end IF_DATA
/end MEASUREMENT
/begin MEASUREMENT VehCoorn_wElecCnsAuxShoAvrgDstWght "average electric consumption for auxilary consumers short term" FLOAT32_IEEE q1_W_s_DIV_m 1 100 -1.0000E+037 1.0000E+037 FORMAT "%10.4" ECU_ADDRESS 0x60000E14
 /begin IF_DATA XCPplus 0x0102
  /begin DAQ_EVENT VARIABLE /end DAQ_EVENT
 /end IF_DATA
/end MEASUREMENT
/begin MEASUREMENT VehCoorn_wElecCnsAuxShoDistAvrgDly "delayed short-term average energy for temperature conditioning dependent auxiliary consumption calculation" FLOAT32_IEEE q1_W_s_DIV_m 1 100 -1.0000E+037 1.0000E+037 FORMAT "%10.4" ECU_ADDRESS 0x60000488
 /begin IF_DATA XCPplus 0x0102
  /begin DAQ_EVENT VARIABLE /end DAQ_EVENT
 /end IF_DATA
/end MEASUREMENT
/begin MEASUREMENT VehCoorn_wElecCnsAuxShoDistAvrgOld "old short-term average energy for temperature conditioning dependent auxiliary consumption calculation" FLOAT32_IEEE q1_W_s_DIV_m 1 100 -1.0000E+037 1.0000E+037 FORMAT "%10.4" ECU_ADDRESS 0x60035EC8
 /begin IF_DATA XCPplus 0x0102
  /begin DAQ_EVENT VARIABLE /end DAQ_EVENT
 /end IF_DATA
/end MEASUREMENT
/begin MEASUREMENT VehCoorn_wWghtAvrgEffTripALoc "consumption of total weighted average energy efficiency of trip A" FLOAT32_IEEE q1_W_s_DIV_m 1 100 -1.0000E+037 1.0000E+037 FORMAT "%10.4" ECU_ADDRESS 0x600003F4
 /begin IF_DATA XCPplus 0x0102
  /begin DAQ_EVENT VARIABLE /end DAQ_EVENT
 /end IF_DATA
/end MEASUREMENT
/begin MEASUREMENT VehCoorn_wWghtAvrgEffTripBLoc "consumption of total weighted average energy efficiency of trip B" FLOAT32_IEEE q1_W_s_DIV_m 1 100 -1.0000E+037 1.0000E+037 FORMAT "%10.4" ECU_ADDRESS 0x600003F0
 /begin IF_DATA XCPplus 0x0102
  /begin DAQ_EVENT VARIABLE /end DAQ_EVENT
 /end IF_DATA
/end MEASUREMENT
/begin FUNCTION ThermMod_OperMod "8.4.0     Determination of the vehicle operation mode for thermal control"
 /begin DEF_CHARACTERISTIC ThermMod_ratSocFild_C ThermMod_tiAftRunMax_C ThermMod_tiARTurnOffProlg_C ThermMod_tiHvShdwnDly_C ThermMod_tiStrtDly_C ThermMod_uBattFild_C ThermMod_uBattMeasd_C /end DEF_CHARACTERISTIC
 /begin IN_MEASUREMENT BattU_u BattU_u_Sq Ebs_ratSocFild Ebs_ratSocFild_Sq Ebs_uBattFild Ebs_uBattFild_Sq Eem_flgFstHvShdwn HvBatt_stMaiSwtAct SyC_stSub ThermMod_st VehCoorn_st /end IN_MEASUREMENT
 /begin OUT_MEASUREMENT DINH_nrActvInhReas.FId_ThermModCritErr DINH_stFId.FId_ThermModCritErr ThermMod_stOpMod /end OUT_MEASUREMENT
 /begin LOC_MEASUREMENT ThermMod_flgAftRunCmpl ThermMod_flgLoBatt ThermMod_flgProlg ThermMod_tiOpMod ThermMod_XPostDrive ThermMod_XWait /end LOC_MEASUREMENT
 FUNCTION_VERSION "8.4.0" /end FUNCTION
/begin FUNCTION ThermPlinChrgr_Req "2.1.0     Thermal request from the plugin charger to the thermal system"
 /begin DEF_CHARACTERISTIC ThermPlinChrgr_flgAftRunEnad_C ThermPlinChrgr_pwrChrgrInit_C ThermPlinChrgr_pwrOutMax_C ThermPlinChrgr_ratMinReq_C ThermPlinChrgr_ratPmpTReq_T ThermPlinChrgr_tAftRunReq_C ThermPlinChrgr_tChrgrInit_C ThermPlinChrgr_tiChrgrPwr_C ThermPlinChrgr_tiChrgrT_C /end DEF_CHARACTERISTIC
 /begin IN_MEASUREMENT ChrgrVal_iOut ChrgrVal_t ChrgrVal_uOut /end IN_MEASUREMENT
 /begin OUT_MEASUREMENT ThermPlinChrgr_flgAftRunReq ThermPlinChrgr_ratPmpReq /end OUT_MEASUREMENT
 /begin LOC_MEASUREMENT ChrgrVal_pwrOutFild ChrgrVal_tFild ThermPlinChrgr_ChgrTPT1_I.X1 ThermPlinChrgr_ChgrTPT1_I.Y1 ThermPlinChrgr_ChrgrPwrPT1_I.X1 ThermPlinChrgr_ChrgrPwrPT1_I.Y1 ThermPlinChrgr_ratAddlPmpReq ThermPlinChrgr_ratTempPmpReq /end LOC_MEASUREMENT
 FUNCTION_VERSION "2.1.0" /end FUNCTION
/begin FUNCTION ThermTracBatt_Req "4.0.0     Thermal request from the traction battery (high voltage battery) to the thermal system" /begin DEF_CHARACTERISTIC ThermTracBatt_tBattMax_C ThermTracBatt_tBattMin_C /end DEF_CHARACTERISTIC /begin OUT_MEASUREMENT ThermTracBatt_tBattMax ThermTracBatt_tBattMin /end OUT_MEASUREMENT FUNCTION_VERSION "4.0.0" /end FUNCTION
/begin FUNCTION ThS_AdpLcy "1400.4.0  Supply of Interfaces from the Thermal System"
 /begin DEF_CHARACTERISTIC ACCtl_nCmprReq_C ThS_pCmprFldMax_C ThS_pCmprFldMin_C ThS_tDcdcHeatTrfDelta_C ThS_tDcdcHeatTrfDelta_T ThS_tMedCooltT1Dft_C /end DEF_CHARACTERISTIC
 /begin IN_MEASUREMENT ACCmpr_pwrLimMax ACCtl_nCmprReq ACCtl_pwrChillrReqEem Dcdc_tAct Dcdc_tAct_Sq Dcdc_tInCoolt Dcdc_tInCoolt_Sq ElM_tIvtrCoolt01 ElM_tIvtrCoolt01_Sq FreonP_p_f HvGrid_pwrMaxPtc RefgntCirc_tEvaprAct ThermHvac_tEvaprSpMin /end IN_MEASUREMENT
 /begin OUT_MEASUREMENT ACCmpr_pwrLoadMngtMaxPred ACCtl_flgCmprEna ACCtl_nCmprSpdReq CbnAirT_tEvapAct CbnAirT_tEvapDes CmprDsFldP_p_f MedCooltT1_t_f RefgntChillrVlv_stCtrlr RefgntP_pChillrDs ThermLoTChillr_pwrRefgntDes ThermLoTChillr_stReq ThermSys_pwrHvacPtcMax ThermSys_pwrLoTChillrMax /end OUT_MEASUREMENT
 FUNCTION_VERSION "1400.4.0" /end FUNCTION
/begin FUNCTION TrsmEmac_Protn "160.4.0   Gearbox Protection Electrical Machine" /begin DEF_CHARACTERISTIC TrsmEmac_tqProtn01_T /end DEF_CHARACTERISTIC /begin IN_MEASUREMENT Emac_nActPhy01 /end IN_MEASUREMENT /begin OUT_MEASUREMENT TrsmEmac_tqProtnMax01 TrsmEmac_tqProtnMin01 /end OUT_MEASUREMENT FUNCTION_VERSION "160.4.0" /end FUNCTION
/begin FUNCTION TrsmEmac_SpdTqRatCalcn "160.3.0   Calculation of speeds, ratios and loss torques for the electrical powertrain" /begin DEF_CHARACTERISTIC TrsmEmac_ratTqPrimAxle_C /end DEF_CHARACTERISTIC /begin OUT_MEASUREMENT TrsmEmac_ratTqPrimAxle TrsmEmac_tqLoss01 /end OUT_MEASUREMENT FUNCTION_VERSION "160.3.0" /end FUNCTION
/begin FUNCTION UCtP_DELib_StdSensDd "10.2.0"
 /begin DEF_CHARACTERISTIC DDRC_DurDeb.UCtP_tiSRCMinDebOk_C DDRC_DurDeb.UCtP_tiSRCMinDebDef_C DDRC_DurDeb.UCtP_tiSRCOpnDebOk_C DDRC_DurDeb.UCtP_tiSRCOpnDebDef_C DDRC_RatDeb.UCtP_tiSRCMinUDRat_C DDRC_RatDeb.UCtP_tiSRCOpnUDRat_C DFC_CtlMsk2.DFC_UCtPSRCMin_C DFC_CtlMsk2.DFC_UCtPSRCOpn_C DFC_CtlMsk2.DFC_UCtPSRCMax_C DFC_DisblMsk2.DFC_UCtPSRCMin_C DFC_DisblMsk2.DFC_UCtPSRCOpn_C DFC_DisblMsk2.DFC_UCtPSRCMax_C UCtP_ADCCal.numSRCTempSel_C UCtP_ADCCal.tiSRCMaxDebOK_C UCtP_ADCCal.uSRCMax_C UCtP_ADCCal.uSRCMin_C UCtP_ADCCal.uSRCOpn_C UCtP_ADCSensTransf_f_CUR UCtP_facFIR_CA UCtP_Fir_Cal.facCumAvrg_C UCtP_Fir_Cal.nAvrgSelThres0_C UCtP_Fir_Cal.nAvrgSelThres1_C UCtP_Fir_Cal.numSelMedian_C UCtP_Fir_Cal.swtConf_C UCtP_tiSRCMaxDefDeb_CUR /end DEF_CHARACTERISTIC
 /begin REF_CHARACTERISTIC UCtP_tiPT1Fil_C UCtP_TransStg_f.Dfl_r32_C UCtP_TransStg_f.stSensId_C /end REF_CHARACTERISTIC
 /begin IN_MEASUREMENT DELib_idxArrSnsr DELib_xArrSnsr Epm_nEng UCtP_FirRead.cntr UCtP_FirRead.flgFirstRun UCtP_FirRead.idxArr UCtP_FirRead.uSum UCtP_stSnsrDdReadCalc UCtP_swtConfStdSens2C UCtP_swtConfStdSensC UCtP_swtConfStdSensSwVersC UCtP_uRawFilAry UCtP_uRawPT1FltdSens UCtP_uRawUnFltd /end IN_MEASUREMENT
 /begin OUT_MEASUREMENT DDRC_St.DFC_UCtPSRCMin DDRC_St.DFC_UCtPSRCOpn DFC_st.DFC_UCtPSRCMin DFC_st.DFC_UCtPSRCOpn DFC_st.DFC_UCtPSRCMax DINH_nrActvInhReas.FId_UCtPEnhdSRCMax DINH_nrActvInhReas.FId_UCtPSSpMon DINH_stFId.FId_UCtPEnhdSRCMax DINH_stFId.FId_UCtPSSpMon UCtP_FirCalc.cntrAvrgZr UCtP_FirCalc.flgRdDne UCtP_FirCalc.uRawAvrg UCtP_FirCalc.uRawFir UCtP_stSnsrDdCalc UCtP_swtSensPres UCtP_tiSRCMaxDefDeb UCtP_uRaw UCtP_uRawAryTmp UCtP_uRaw_f UCtP_uSensCpl UCtP_uSensUnFltd UCtP_uSens_f /end OUT_MEASUREMENT
 /begin LOC_MEASUREMENT UCtP_DDstSnsrState_mp UCtP_tRefSnsr_mp UCtP_tSensPT1Fltd_mp /end LOC_MEASUREMENT
 FUNCTION_VERSION "10.2.0" /end FUNCTION
/begin FUNCTION UCtP_DELib_StdSensDdRead "10.4.0" /begin DEF_CHARACTERISTIC UCtP_tiPT1Fil_C /end DEF_CHARACTERISTIC
 /begin REF_CHARACTERISTIC UCtP_facFIR_CA UCtP_Fir_Cal.facCumAvrg_C UCtP_Fir_Cal.nAvrgSelThres0_C UCtP_Fir_Cal.nAvrgSelThres1_C UCtP_Fir_Cal.numSelMedian_C UCtP_Fir_Cal.swtConf_C /end REF_CHARACTERISTIC
 /begin IN_MEASUREMENT Epm_nEng UCtP_FirCalc.cntrAvrgZr UCtP_FirCalc.flgRdDne UCtP_FirCalc.uRawAvrg UCtP_FirCalc.uRawFir UCtP_swtConfStdSens2C UCtP_swtConfStdSensC /end IN_MEASUREMENT
 /begin OUT_MEASUREMENT UCtP_FirRead.cntr UCtP_FirRead.flgFirstRun UCtP_FirRead.idxArr UCtP_FirRead.uSum UCtP_stSnsrDdReadCalc UCtP_uRawFilAry UCtP_uRawPT1Fltd UCtP_uRawPT1FltdSens UCtP_uRawUnFltd /end OUT_MEASUREMENT
 FUNCTION_VERSION "10.4.0" /end FUNCTION
/begin FUNCTION UCtP_DELib_StdSensDdSENTSlowRead "3.2.0"
 /begin IN_MEASUREMENT Epm_nEng UCtP_swtConfStdSens2C UCtP_swtConfStdSensC UCtP_swtConfStdSensSwVersC /end IN_MEASUREMENT
 FUNCTION_VERSION "3.2.0" /end FUNCTION
/begin FUNCTION UCtP_DELib_StdSensExtDiag "8.1.0"
 /begin IN_MEASUREMENT DELib_idxArrSnsr DELib_xArrSnsr DSM_TripChgFinshd SyC_stSub UCtP_swtConfStdSensC UCtP_swtConfStdSensSwVersC /end IN_MEASUREMENT
 FUNCTION_VERSION "8.1.0" /end FUNCTION
/begin FUNCTION UCtP_DELib_StdSensInin "8.2.0"
 /begin DEF_CHARACTERISTIC UCtP_swtConfStdSens2_C UCtP_swtConfStdSensSwVers162_C UCtP_swtConfStdSens_C /end DEF_CHARACTERISTIC
 /begin REF_CHARACTERISTIC UCtP_tiPT1Fil_C /end REF_CHARACTERISTIC
 /begin OUT_MEASUREMENT UCtP_swtConfStdSens2C UCtP_swtConfStdSensC UCtP_swtConfStdSensSwVersC UCtP_swtSensMode /end OUT_MEASUREMENT
 FUNCTION_VERSION "8.2.0" /end FUNCTION
/begin FUNCTION UCtP_DELib_StdSensVd "11.0.0"
 /begin DEF_CHARACTERISTIC UCtP_DigSensCal.tiDebPos_C UCtP_DigSensCal.tiDebNeg_C UCtP_duGradLim_f_C UCtP_RmpSlp_f.Pos_C UCtP_RmpSlp_f.Neg_C UCtP_tiPT1_f_C UCtP_TransStg_f.Dfl_r32_C UCtP_TransStg_f.stSensId_C UCtP_uDflVal_f_C UCtP_uHiLimit_f_C UCtP_uLoLimit_f_C /end DEF_CHARACTERISTIC
 /begin IN_MEASUREMENT UCtP_stSnsrDdCalc UCtP_swtConfStdSensC UCtP_swtConfStdSensSwVersC UCtP_uSens_f /end IN_MEASUREMENT
 /begin OUT_MEASUREMENT DINH_nrActvInhReas.FId_UCtPFrzVal DINH_nrActvInhReas.FId_UCtPRplVal DINH_stFId.FId_UCtPFrzVal DINH_stFId.FId_UCtPRplVal UCtP_uSensOffsCorrd_f UCtP_uUnFlt_f UCtP_u_f UCtP_u_f_Sq /end OUT_MEASUREMENT
 /begin LOC_MEASUREMENT UCtP_uSensGradLim_f_mp /end LOC_MEASUREMENT
 FUNCTION_VERSION "11.0.0" /end FUNCTION
/begin FUNCTION UCtP_DELib_StdSensVdMon "9.2.0"
 /begin DEF_CHARACTERISTIC DDRC_DurDeb.UCtP_tiPhysRngHiDebOk_C DDRC_DurDeb.UCtP_tiPhysRngHiDebDef_C DDRC_DurDeb.UCtP_tiPhysRngLoDebOk_C DDRC_DurDeb.UCtP_tiPhysRngLoDebDef_C DDRC_RatDeb.UCtP_tiPhysRngHiUDRat_C DDRC_RatDeb.UCtP_tiPhysRngLoUDRat_C DFC_CtlMsk2.DFC_UCtPPhysRngHi_C DFC_CtlMsk2.DFC_UCtPPhysRngLo_C DFC_CtlMsk2.DFC_UCtPTmpErr_C DFC_DisblMsk2.DFC_UCtPPhysRngHi_C DFC_DisblMsk2.DFC_UCtPPhysRngLo_C DFC_DisblMsk2.DFC_UCtPTmpErr_C UCtP_numStdSens_C UCtP_numTempErrDef_C UCtP_numtSel_C UCtP_stEnhPhysSRCRls_MAP UCtP_tiEngOnMin_C UCtP_tiTempErrOk_C UCtP_tSnsrMax_f_C UCtP_tSnsrMin_f_C UCtP_uEnhPhysSRCMax_f_MAP UCtP_uEnhPhysSRCMin_f_MAP /end DEF_CHARACTERISTIC
 /begin IN_MEASUREMENT CoEng_tiNormal DELib_idxArrSnsr DELib_xArrSnsr DSM_TripChgFinshd Epm_nEng InjCtl_qSetUnBal UCtP_stSnsrDdCalc UCtP_swtConfStdSensC UCtP_swtConfStdSensSwVersC UCtP_uSens_f /end IN_MEASUREMENT
 /begin OUT_MEASUREMENT DDRC_St.DFC_UCtPPhysRngHi DDRC_St.DFC_UCtPPhysRngLo DFC_st.DFC_UCtPPhysRngHi DFC_st.DFC_UCtPPhysRngLo DFC_st.DFC_UCtPTmpErr DINH_nrActvInhReas.FId_UCtPPhysRng DINH_nrActvInhReas.FId_UCtPTmpErrCnt DINH_stFId.FId_UCtPPhysRng DINH_stFId.FId_UCtPTmpErrCnt UCtP_stSnsrActv /end OUT_MEASUREMENT
 /begin LOC_MEASUREMENT UCtP_stMonStdSens UCtP_uDynThresPhysRngHi_f_mp UCtP_uDynThresPhysRngLo_f_mp /end LOC_MEASUREMENT
 FUNCTION_VERSION "9.2.0" /end FUNCTION
/begin FUNCTION UPxP1_DELib_StdSensDd "10.2.0"
 /begin DEF_CHARACTERISTIC DDRC_DurDeb.UPxP1_tiSRCMinDebOk_C DDRC_DurDeb.UPxP1_tiSRCMinDebDef_C DDRC_DurDeb.UPxP1_tiSRCOpnDebOk_C DDRC_DurDeb.UPxP1_tiSRCOpnDebDef_C DDRC_RatDeb.UPxP1_tiSRCMinUDRat_C DDRC_RatDeb.UPxP1_tiSRCOpnUDRat_C DFC_CtlMsk2.DFC_UPxP1SRCMin_C DFC_CtlMsk2.DFC_UPxP1SRCOpn_C DFC_CtlMsk2.DFC_UPxP1SRCMax_C DFC_DisblMsk2.DFC_UPxP1SRCMin_C DFC_DisblMsk2.DFC_UPxP1SRCOpn_C DFC_DisblMsk2.DFC_UPxP1SRCMax_C UPxP1_ADCCal.numSRCTempSel_C UPxP1_ADCCal.tiSRCMaxDebOK_C UPxP1_ADCCal.uSRCMax_C UPxP1_ADCCal.uSRCMin_C UPxP1_ADCCal.uSRCOpn_C UPxP1_ADCSensTransf_f_CUR UPxP1_tiSRCMaxDefDeb_CUR /end DEF_CHARACTERISTIC
 /begin REF_CHARACTERISTIC UPxP1_tiPT1Fil_C UPxP1_TransStg_f.Dfl_r32_C UPxP1_TransStg_f.stSensId_C /end REF_CHARACTERISTIC
 /begin IN_MEASUREMENT DELib_idxArrSnsr DELib_xArrSnsr UPxP1_FirRead.cntr UPxP1_FirRead.flgFirstRun UPxP1_FirRead.idxArr UPxP1_FirRead.uSum UPxP1_stSnsrDdReadCalc UPxP1_swtConfStdSens2C UPxP1_swtConfStdSensC UPxP1_swtConfStdSensSwVersC UPxP1_uRawPT1FltdSens UPxP1_uRawUnFltd /end IN_MEASUREMENT
 /begin OUT_MEASUREMENT DDRC_St.DFC_UPxP1SRCMin DDRC_St.DFC_UPxP1SRCOpn DFC_st.DFC_UPxP1SRCMin DFC_st.DFC_UPxP1SRCOpn DFC_st.DFC_UPxP1SRCMax DINH_nrActvInhReas.FId_UPxP1EnhdSRCMax DINH_nrActvInhReas.FId_UPxP1SSpMon DINH_stFId.FId_UPxP1EnhdSRCMax DINH_stFId.FId_UPxP1SSpMon UPxP1_FirCalc.cntrAvrgZr UPxP1_FirCalc.flgRdDne UPxP1_FirCalc.uRawAvrg UPxP1_FirCalc.uRawFir UPxP1_stSnsrDdCalc UPxP1_swtSensPres UPxP1_tiSRCMaxDefDeb UPxP1_uRaw UPxP1_uRaw_f UPxP1_uSensCpl UPxP1_uSensUnFltd UPxP1_uSens_f /end OUT_MEASUREMENT
 /begin LOC_MEASUREMENT UPxP1_DDstSnsrState_mp UPxP1_tRefSnsr_mp UPxP1_tSensPT1Fltd_mp /end LOC_MEASUREMENT
 FUNCTION_VERSION "10.2.0" /end FUNCTION
/begin FUNCTION UPxP1_DELib_StdSensDdRead "10.4.0" /begin DEF_CHARACTERISTIC UPxP1_tiPT1Fil_C /end DEF_CHARACTERISTIC
 /begin IN_MEASUREMENT UPxP1_FirCalc.cntrAvrgZr UPxP1_FirCalc.flgRdDne UPxP1_FirCalc.uRawAvrg UPxP1_FirCalc.uRawFir UPxP1_swtConfStdSens2C UPxP1_swtConfStdSensC /end IN_MEASUREMENT
 /begin OUT_MEASUREMENT UPxP1_FirRead.cntr UPxP1_FirRead.flgFirstRun UPxP1_FirRead.idxArr UPxP1_FirRead.uSum UPxP1_stSnsrDdReadCalc UPxP1_uRawPT1Fltd UPxP1_uRawPT1FltdSens UPxP1_uRawUnFltd /end OUT_MEASUREMENT
 FUNCTION_VERSION "10.4.0" /end FUNCTION
/begin FUNCTION UPxP1_DELib_StdSensDdSENTSlowRead "3.2.0"
 /begin IN_MEASUREMENT UPxP1_swtConfStdSens2C UPxP1_swtConfStdSensC UPxP1_swtConfStdSensSwVersC /end IN_MEASUREMENT
 FUNCTION_VERSION "3.2.0" /end FUNCTION
/begin FUNCTION UPxP1_DELib_StdSensExtDiag "8.1.0"
 /begin IN_MEASUREMENT DELib_idxArrSnsr DELib_xArrSnsr DSM_TripChgFinshd SyC_stSub UPxP1_swtConfStdSensC UPxP1_swtConfStdSensSwVersC /end IN_MEASUREMENT
 FUNCTION_VERSION "8.1.0" /end FUNCTION
/begin FUNCTION UPxP1_DELib_StdSensInin "8.2.0"
 /begin DEF_CHARACTERISTIC UPxP1_swtConfStdSens2_C UPxP1_swtConfStdSensSwVers162_C UPxP1_swtConfStdSens_C /end DEF_CHARACTERISTIC
 /begin REF_CHARACTERISTIC UPxP1_tiPT1Fil_C /end REF_CHARACTERISTIC
 /begin OUT_MEASUREMENT UPxP1_swtConfStdSens2C UPxP1_swtConfStdSensC UPxP1_swtConfStdSensSwVersC UPxP1_swtSensMode /end OUT_MEASUREMENT
 FUNCTION_VERSION "8.2.0" /end FUNCTION
/begin FUNCTION UPxP1_DELib_StdSensVd "11.0.0"
 /begin DEF_CHARACTERISTIC UPxP1_DigSensCal.tiDebPos_C UPxP1_DigSensCal.tiDebNeg_C UPxP1_duGradLim_f_C UPxP1_RmpSlp_f.Pos_C UPxP1_RmpSlp_f.Neg_C UPxP1_tiPT1_f_C UPxP1_TransStg_f.Dfl_r32_C UPxP1_TransStg_f.stSensId_C UPxP1_uDflVal_f_C UPxP1_uHiLimit_f_C UPxP1_uLoLimit_f_C /end DEF_CHARACTERISTIC
 /begin IN_MEASUREMENT UPxP1_stSnsrDdCalc UPxP1_swtConfStdSensC UPxP1_swtConfStdSensSwVersC UPxP1_uSens_f /end IN_MEASUREMENT
 /begin OUT_MEASUREMENT DINH_nrActvInhReas.FId_UPxP1FrzVal DINH_nrActvInhReas.FId_UPxP1RplVal DINH_stFId.FId_UPxP1FrzVal DINH_stFId.FId_UPxP1RplVal UPxP1_uSensOffsCorrd_f UPxP1_uUnFlt_f UPxP1_u_f UPxP1_u_f_Sq /end OUT_MEASUREMENT
 /begin LOC_MEASUREMENT UPxP1_uSensGradLim_f_mp /end LOC_MEASUREMENT
 FUNCTION_VERSION "11.0.0" /end FUNCTION
/begin FUNCTION UPxP1_DELib_StdSensVdMon "9.2.0"
 /begin DEF_CHARACTERISTIC DDRC_DurDeb.UPxP1_tiPhysRngHiDebOk_C DDRC_DurDeb.UPxP1_tiPhysRngHiDebDef_C DDRC_DurDeb.UPxP1_tiPhysRngLoDebOk_C DDRC_DurDeb.UPxP1_tiPhysRngLoDebDef_C DDRC_RatDeb.UPxP1_tiPhysRngHiUDRat_C DDRC_RatDeb.UPxP1_tiPhysRngLoUDRat_C DFC_CtlMsk2.DFC_UPxP1PhysRngHi_C DFC_CtlMsk2.DFC_UPxP1PhysRngLo_C DFC_CtlMsk2.DFC_UPxP1TmpErr_C DFC_DisblMsk2.DFC_UPxP1PhysRngHi_C DFC_DisblMsk2.DFC_UPxP1PhysRngLo_C DFC_DisblMsk2.DFC_UPxP1TmpErr_C UPxP1_numStdSens_C UPxP1_numTempErrDef_C UPxP1_numtSel_C UPxP1_stEnhPhysSRCRls_MAP UPxP1_tiEngOnMin_C UPxP1_tiTempErrOk_C UPxP1_tSnsrMax_f_C UPxP1_tSnsrMin_f_C UPxP1_uEnhPhysSRCMax_f_MAP UPxP1_uEnhPhysSRCMin_f_MAP /end DEF_CHARACTERISTIC
 /begin IN_MEASUREMENT CoEng_tiNormal DELib_idxArrSnsr DELib_xArrSnsr DSM_TripChgFinshd Epm_nEng InjCtl_qSetUnBal UPxP1_stSnsrDdCalc UPxP1_swtConfStdSensC UPxP1_swtConfStdSensSwVersC UPxP1_uSens_f /end IN_MEASUREMENT
 /begin OUT_MEASUREMENT DDRC_St.DFC_UPxP1PhysRngHi DDRC_St.DFC_UPxP1PhysRngLo DFC_st.DFC_UPxP1PhysRngHi DFC_st.DFC_UPxP1PhysRngLo DFC_st.DFC_UPxP1TmpErr DINH_nrActvInhReas.FId_UPxP1PhysRng DINH_nrActvInhReas.FId_UPxP1TmpErrCnt DINH_stFId.FId_UPxP1PhysRng DINH_stFId.FId_UPxP1TmpErrCnt UPxP1_stSnsrActv /end OUT_MEASUREMENT
 /begin LOC_MEASUREMENT UPxP1_stMonStdSens UPxP1_uDynThresPhysRngHi_f_mp UPxP1_uDynThresPhysRngLo_f_mp /end LOC_MEASUREMENT
 FUNCTION_VERSION "9.2.0" /end FUNCTION
/begin FUNCTION VCUECU_VCU1 "850.3.0   Reception process of frame VCU1"
 /begin DEF_CHARACTERISTIC Com_ACTPduCtrlByps_C Com_GlbDaPduCtrlByps_C Com_swVerFrmByps_C /end DEF_CHARACTERISTIC
 /begin IN_MEASUREMENT CbnHeatgHeatr_cntrRlyLf ChrgCntct_nrNegCntctElpdOper ChrgCntct_nrPosCntctElpdOper ComM_stComModeCANHSN1 ComM_stComModeCANHSN3 Com_bfPtlWkuReq Com_stBrkCntctIndcn Com_stChrgPlg ct_Ary_flg1 EChrDv_cntPlin GlbDa_bChrgnSockCfg /end IN_MEASUREMENT
 /begin OUT_MEASUREMENT CbnHeatgHeatr_cntrRlyLf_old ChrgCntct_nrNegCntctElpdOper_old ChrgCntct_nrPosCntctElpdOper_old Com_bACTPduCtrl Com_bfPtlWkuReq_old Com_bGlbDaPduCtrl Com_BINStgyNumEvtDetc Com_BINStgyTxTmr Com_BINStgyTxTmr_Sts Com_Evt468Detc Com_Evt481Detc Com_Evt481TxTmr Com_Evt481TxTmr_Sts Com_Evt4A2Detc Com_Evt501Detc Com_Evt501TxTmr Com_Evt501TxTmr_Sts Com_noEditCal Com_noEditSw Com_noVersAdp Com_noVersSw Com_noVersSys Com_noVersSysMnth Com_noVersSysYr Com_noVerSysDay Com_stBrkCntctIndcn_old Com_stChrgPlg_old EChrDv_cntPlin_old rba_SyC_bWkuMain_old /end OUT_MEASUREMENT
 FUNCTION_VERSION "850.3.0" /end FUNCTION
/begin FUNCTION VehCoorn_AuxAvrg "1.4.1     Range Prediction Auxiliary Average"
 /begin DEF_CHARACTERISTIC VehCoorn_egyPerDeltaKElecCnsAuxTraMax_C VehCoorn_egyPerDeltaKElecCnsAuxTraMin_C VehCoorn_egyPerDeltaKElecCnsAuxTra_CA VehCoorn_egyTraElecCnsAuxMax_C VehCoorn_facTDeltaCbn_C VehCoorn_idxDeltaTCbn_T VehCoorn_idxT_T VehCoorn_maskEnvTSq_C VehCoorn_maskHvBattTActMeasdVldySq_C VehCoorn_maskSpdVehVVldySq_C VehCoorn_pwrElecCnsAuxLongMax_C VehCoorn_pwrElecCnsAuxLongMin_C VehCoorn_pwrIniPha_T VehCoorn_tDeltaCbnMax_C VehCoorn_tEgyPerDeltaKElecCnsAux_C VehCoorn_tiCdngMax_C VehCoorn_tiElecCnsAuxDistLong_C VehCoorn_tiElecCnsAuxDistSho_C VehCoorn_tiElecCnsAuxT_C VehCoorn_tiIniPhaDur_T VehCoorn_tiPerDeltaKElecCnsAuxTraMax_C VehCoorn_tiPerDeltaKElecCnsAuxTraMin_C VehCoorn_tiPerDeltaKElecCnsAuxTra_CA VehCoorn_tiVElecCnsAuxLong_C VehCoorn_tiVElecCnsAuxSho_C VehCoorn_tiVElecCnsAuxT_C VehCoorn_tNoHeatg_C VehCoorn_tTiPerDeltaKElecCnsAuxTra_C VehCoorn_vElecCnsAuxAvrg_C VehCoorn_vElecCnsAvrgAuxMax_C VehCoorn_vElecCnsAvrgAuxMin_C VehCoorn_vElecCnsAvrgAuxTMax_C VehCoorn_vElecCnsAvrgAuxTMin_C VehCoorn_wElecCnsAuxDistAvrg_C VehCoorn_wElecCnsAuxDistLongMax_C VehCoorn_wElecCnsAuxDistLongMin_C VehCoorn_wElecCnsAuxDistShoMax_C VehCoorn_wElecCnsAuxDistShoMin_C VehCoorn_wElecCnsAuxTMax_C VehCoorn_wElecCnsAuxTMin_C /end DEF_CHARACTERISTIC
 /begin IN_MEASUREMENT ACSwt_stSwt ACSwt_tCbnSp Eem_pwrAuxUnitLoadLo EnvT_t EnvT_t_Sq Epm_nEng HvBatt_tActMeasd HvBatt_tActMeasd_Sq ThermTracBatt_tBattMax ThermTracBatt_tBattMin ThS_tCbnAct VehCoorn_st VehV_v VehV_v_Sq /end IN_MEASUREMENT
 /begin OUT_MEASUREMENT DINH_nrActvInhReas.FId_VehCoornAuxAvrgEnvT DINH_nrActvInhReas.FId_VehCoornAuxAvrgPwr DINH_nrActvInhReas.FId_VehCoornAuxAvrgT DINH_nrActvInhReas.FId_VehCoornAuxAvrgVehV DINH_stFId.FId_VehCoornAuxAvrgEnvT DINH_stFId.FId_VehCoornAuxAvrgPwr DINH_stFId.FId_VehCoornAuxAvrgT DINH_stFId.FId_VehCoornAuxAvrgVehV VehCoorn_egyPerDeltaKElecCnsAuxTra VehCoorn_egyTraElecCnsAux VehCoorn_flgAuxCnsChg VehCoorn_flgInvldAux VehCoorn_flgPrmsAux VehCoorn_pwrElecCnsAuxLongAvrgWghtT VehCoorn_tiPerDeltaKElecCnsAuxTra VehCoorn_tiTraElecCnsAux VehCoorn_wElecCnsAuxLongAvrgDstWght VehCoorn_wElecCnsAuxShoAvrgDstWght /end OUT_MEASUREMENT
 /begin LOC_MEASUREMENT VehCoorn_egyIniPha VehCoorn_egyPerDeltaKElecCnsAuxTraDly VehCoorn_egyTracElecCnsAuxMax VehCoorn_flgInIniPha VehCoorn_flgInStatPha VehCoorn_flgInTraPha VehCoorn_idxCbn VehCoorn_idxHvBatt VehCoorn_pwrElecCnsAuxLongAvrg VehCoorn_ratElecCnsAuxT VehCoorn_tChgT VehCoorn_tDeltaCbn VehCoorn_tDeltaHvBatt VehCoorn_tiCdngDur VehCoorn_tiIniPhaRmn VehCoorn_tiPerDeltaKElecCnsAuxTraDly VehCoorn_tiPerDeltaKElecCnsAuxTraOld VehCoorn_vElecCnsAuxLongAvrg VehCoorn_vElecCnsAuxLongAvrgCur VehCoorn_vElecCnsAuxLongAvrgDly VehCoorn_vElecCnsAuxLongAvrgOld VehCoorn_vElecCnsAuxLongAvrgTCur VehCoorn_vElecCnsAuxLongAvrgTDly VehCoorn_vElecCnsAuxLongAvrgTOld VehCoorn_vElecCnsAuxShoAvrg VehCoorn_vElecCnsAuxShoAvrgCur VehCoorn_vElecCnsAuxShoAvrgDly VehCoorn_vElecCnsAuxShoAvrgOld VehCoorn_vElecCnsAuxTAvrg VehCoorn_wElecCnsAuxAvrgTDly VehCoorn_wElecCnsAuxAvrgTOld VehCoorn_wElecCnsAuxLongDistAvrgDly VehCoorn_wElecCnsAuxLongDistAvrgOld VehCoorn_wElecCnsAuxShoDistAvrgDly VehCoorn_wElecCnsAuxShoDistAvrgOld /end LOC_MEASUREMENT
 FUNCTION_VERSION "1.4.1" /end FUNCTION
/begin FUNCTION VehCoorn_MdlLib "1.0.0     Library for Vehicle Models"
 /begin DEF_CHARACTERISTIC VehCoorn_facTolrHvBatt_C VehCoorn_jMPwrTrn_C VehCoorn_omEm_AX VehCoorn_PwrEm_M VehCoorn_ratSoc_AX VehCoorn_ratTrms_C VehCoorn_rInnrChrg_T VehCoorn_rInnrDcha_T VehCoorn_tqEmMax_T VehCoorn_tqEmMin_T VehCoorn_tqLossGbx_M VehCoorn_uOcv_T /end DEF_CHARACTERISTIC
 FUNCTION_VERSION "1.0.0" /end FUNCTION
/begin FUNCTION VehCoorn_PrpAvrg "1.2.0     Range Prediction Propulsion Average"
 /begin DEF_CHARACTERISTIC VehCoorn_dstCnsPrpDrvMod_C VehCoorn_dstCnsPrpLong_C VehCoorn_dstCnsPrpSho_C VehCoorn_flgDrvModDpd_C VehCoorn_maskEmPwrAct01VldySq_C VehCoorn_maskVehVSpdVldySq_C VehCoorn_ratCnsPrpEcoMin_C VehCoorn_ratCnsPrpEcoSptOffs_C VehCoorn_ratCnsPrpNormEcoOffs_C VehCoorn_ratCnsPrpNormSptOffs_C VehCoorn_wCnsPrpAvrg_C VehCoorn_wCnsPrpLongMax_C VehCoorn_wCnsPrpLongMin_C VehCoorn_wCnsPrpShoMax_C VehCoorn_wCnsPrpShoMin_C VehCoorn_wCnsPrpShoRngMax_C VehCoorn_wCnsPrpShoRngMin_C /end DEF_CHARACTERISTIC
 /begin IN_MEASUREMENT DrvPrgSwt_stReq Emac_pwrAct01_Sq GlbDa_lTotDst GlbDa_rdWhl PT_tqWhlAct VehCoorn_st VehV_v VehV_v_Sq /end IN_MEASUREMENT
 /begin OUT_MEASUREMENT DINH_nrActvInhReas.FId_VehCoornPrpAvrg DINH_stFId.FId_VehCoornPrpAvrg VehCoorn_flgDrvModChg VehCoorn_flgPrmsPrp VehCoorn_pwrActElecWhl VehCoorn_wCnsPrpLongAvrg VehCoorn_wCnsPrpShoAvrg /end OUT_MEASUREMENT
 /begin LOC_MEASUREMENT VehCoorn_pwrActCnsPrp VehCoorn_ratCnsPrpDrvMod VehCoorn_ratCnsPrpEco VehCoorn_ratCnsPrpNorm VehCoorn_wCnsPrpDrvModDly VehCoorn_wCnsPrpDrvModOld VehCoorn_wCnsPrpLongAvrgDly VehCoorn_wCnsPrpLongAvrgOld VehCoorn_wCnsPrpShoAvrgDly VehCoorn_wCnsPrpShoAvrgOld /end LOC_MEASUREMENT
 FUNCTION_VERSION "1.2.0" /end FUNCTION
/begin FUNCTION VehCoorn_RngPrdc "1400.2.0  Range Prediction for the Traction Battery"
 /begin DEF_CHARACTERISTIC VehCoorn_dstRateLimnMin_C VehCoorn_dstRngPredErr_C VehCoorn_dstRngPredIni_C VehCoorn_dstRngPredMax_C VehCoorn_dstRngPredResv_C VehCoorn_egyBattResv_C VehCoorn_egyDeltaHvbThd_C VehCoorn_facCnsWght_T VehCoorn_facEgyEffMax_C VehCoorn_facEgyEffMin_C VehCoorn_facEgyElecCnsAuxWght_T VehCoorn_facRateLimnMax_T VehCoorn_facRateLimnMin_T VehCoorn_facRngPredRawFiltg_T VehCoorn_flgRstToIniDi_C VehCoorn_maskHvBattEgyAvlVldySq_C VehCoorn_maskHvBattRatSocVldySq_C VehCoorn_maskHvBattRatSohVldySq_C VehCoorn_maskHvBattTActMeasdAvrgEffVldySq_C VehCoorn_pwrElecEgyCnsIni_C VehCoorn_pwrElecMinThd_C VehCoorn_tiCnsAvrgSampleTmr_C VehCoorn_tiCnsTripAvrgSampleTmr_C VehCoorn_tiPrmsCalcnHld_C VehCoorn_tiPt1EffElec_C VehCoorn_wCnsTotWghtAvrgDft_C VehCoorn_wCnsTotWghtAvrgRstVal_M VehCoorn_wCnsTotWghtTripAvrgDft_C /end DEF_CHARACTERISTIC
 /begin REF_CHARACTERISTIC VehCoorn_wCnsPrpLongMax_C VehCoorn_wCnsPrpLongMin_C VehCoorn_wElecCnsAuxDistLongMax_C VehCoorn_wElecCnsAuxDistLongMin_C /end REF_CHARACTERISTIC
 /begin IN_MEASUREMENT Com_flgRstTripAEE Com_flgRstTripAEE_A Com_flgRstTripAEE_B Eem_pwrAuxUnitLoadLo GlbDa_lTotDst HvBatt_egyAvl_f HvBatt_egyAvl_Sq HvBatt_ratSoc HvBatt_ratSoc_Sq HvBatt_ratSoh HvBatt_ratSoh_Sq HvBatt_tActMeasd HvBatt_tActMeasd_Sq VehCoorn_egyTraElecCnsAux VehCoorn_flgAuxCnsChg VehCoorn_flgDrvModChg VehCoorn_flgInvldAux VehCoorn_flgPrmsAux VehCoorn_flgPrmsPrp VehCoorn_pwrActElecWhl VehCoorn_st VehCoorn_wCnsPrpLongAvrg VehCoorn_wCnsPrpShoAvrg VehCoorn_wElecCnsAuxLongAvrgDstWght VehCoorn_wElecCnsAuxShoAvrgDstWght /end IN_MEASUREMENT
 /begin OUT_MEASUREMENT DINH_nrActvInhReas.FId_VehCoornEgyRmn DINH_nrActvInhReas.FId_VehCoornRngPrdcAuxPwr DINH_stFId.FId_VehCoornEgyRmn DINH_stFId.FId_VehCoornRngPrdcAuxPwr VehCoorn_dstRngPred VehCoorn_egyHvb VehCoorn_wCnsLongAvrg VehCoorn_wCnsShoAvrg VehCoorn_wCnsTotWght VehCoorn_wCnsTotWghtAvrgEff VehCoorn_wCnsTotWghtTripAvrgEff VehCoorn_wCnsWghtAvrgEffTripA VehCoorn_wCnsWghtAvrgEffTripB /end OUT_MEASUREMENT
 /begin LOC_MEASUREMENT VehCoorn_dstRateLimMax VehCoorn_dstRateLimMin VehCoorn_dstRngPredFild VehCoorn_dstRngPredFildOld VehCoorn_dstRngPredLim VehCoorn_dstRngPredMax VehCoorn_dstRngPredMin VehCoorn_dstRngPredRaw VehCoorn_dstRngPredRawOld VehCoorn_dstRngRLIM_I VehCoorn_dstRstVal VehCoorn_egyMeclTot VehCoorn_egyTraElecCnsAuxWght VehCoorn_ElecEgyCnsFPT1_I.X1 VehCoorn_ElecEgyCnsFPT1_I.Y1 VehCoorn_facElecCnsWght VehCoorn_facElecEgyEff VehCoorn_flgPrmsEgyEff VehCoorn_flgRngActv VehCoorn_flgRngFault VehCoorn_flgRstRng VehCoorn_flgRstSgnShp VehCoorn_lTotDstOld VehCoorn_nrCntCnsTotWghtAvrg VehCoorn_nrCntCnsTotWghtAvrgDly VehCoorn_nrCntCnsTotWghtTripAvrg VehCoorn_nrCntCnsTotWghtTripAvrgDly VehCoorn_nrCntWghtAvrgTripA VehCoorn_nrCntWghtAvrgTripB VehCoorn_nrWghtAvrgTripADly VehCoorn_nrWghtAvrgTripBDly VehCoorn_prmsCalcnHld VehCoorn_PwrElecWhlFPT1_I.X1 VehCoorn_PwrElecWhlFPT1_I.Y1 VehCoorn_ratDstRstVal VehCoorn_wCnsLongPwrAvrg VehCoorn_wCnsShoPwrAvrg VehCoorn_wCnsTotWghtAvrgDly VehCoorn_wCnsTotWghtAvrgOld VehCoorn_wCnsTotWghtTripAvrgDly VehCoorn_wCnsTotWghtTripAvrgOld VehCoorn_wCnsWghtAvrgTripADly VehCoorn_wCnsWghtAvrgTripAOld VehCoorn_wCnsWghtAvrgTripBDly VehCoorn_wCnsWghtAvrgTripBOld VehCoorn_wWghtAvrgEffTripALoc VehCoorn_wWghtAvrgEffTripBLoc /end LOC_MEASUREMENT
 FUNCTION_VERSION "1400.2.0" /end FUNCTION
/begin FUNCTION VehCoorn_RngPrdcDisp "1400.0.1  Postprocessing of predictied range for HMI Display"
 /begin DEF_CHARACTERISTIC VehCoorn_dstRngPrdcDispDft_C VehCoorn_dstRngPrdcDispHi_M VehCoorn_dstRngPrdcDispMed_M VehCoorn_dstRngPrdcStepNeg_C VehCoorn_dstRngPrdcStepPos_C VehCoorn_maskEIMPwrAct01VldySq_C VehCoorn_maskHvBattEgyAvlDispVldySq_C VehCoorn_maskHvBattRatSocDispVldySq_C VehCoorn_maskHvBattRatSohDispVldySq_C VehCoorn_maskHvBattTActMeasdDispVldySq_C VehCoorn_maskVehVRngPrdnVldySq_C VehCoorn_ratSocRngPrdcDispHi_C VehCoorn_ratSocRngPrdcDispLo_C /end DEF_CHARACTERISTIC
 /begin IN_MEASUREMENT Emac_pwrAct01_Sq HvBatt_egyAvl_f HvBatt_egyAvl_Sq HvBatt_ratSoc HvBatt_ratSoc_Sq HvBatt_ratSoh HvBatt_ratSoh_Sq HvBatt_tActMeasd HvBatt_tActMeasd_Sq VehCoorn_dstRngPred VehV_v_Sq /end IN_MEASUREMENT
 /begin OUT_MEASUREMENT DINH_nrActvInhReas.FId_VehCoornDstRngPrdcDispDft DINH_stFId.FId_VehCoornDstRngPrdcDispDft VehCoorn_dstRngPrdcDisp /end OUT_MEASUREMENT
 /begin LOC_MEASUREMENT VehCoorn_dstHiSohRngPrdcDisp VehCoorn_dstMedSohRngPrdcDisp VehCoorn_dstRampActRngPrdcDisp VehCoorn_dstRngPrdcDispDft VehCoorn_dstRngPrdcDispHi VehCoorn_dstRngPrdcDispMed VehCoorn_dstRngPrdcIntrpnDisp VehCoorn_dstRngPredMedIntrpn VehCoorn_flgHiSocRngPrdcDisp VehCoorn_flgLoSocRngPrdcDisp VehCoorn_flgSigQlyRngPrdcDisp /end LOC_MEASUREMENT
 FUNCTION_VERSION "1400.0.1" /end FUNCTION
/begin FUNCTION VehCoorn_StMac "1400.0.0  State Machine to determine common Vehicle State"
 /begin DEF_CHARACTERISTIC VehCoorn_flgECURst_C VehCoorn_maskVehSpdVldySq_C VehCoorn_vMaxExclDrv_C /end DEF_CHARACTERISTIC
 /begin IN_MEASUREMENT Eem_flgHvShdwnFlt Eem_stHv Reset_flgECURstOcc ThermCoorn_flgHVReq VehCoorn_flgChrgReq VehCoorn_flgDrvInhb VehCoorn_flgDrvReq VehCoorn_flgHVReq VehCoorn_stEngIdleShtDwn VehV_v VehV_v_Sq /end IN_MEASUREMENT
 /begin OUT_MEASUREMENT DINH_nrActvInhReas.FId_VehCoornErrExclChrg DINH_nrActvInhReas.FId_VehCoornErrExclDrv DINH_nrActvInhReas.FId_VehCoornHVErr DINH_nrActvInhReas.FId_VehCoornSigQualVehV DINH_stFId.FId_VehCoornErrExclChrg DINH_stFId.FId_VehCoornErrExclDrv DINH_stFId.FId_VehCoornHVErr DINH_stFId.FId_VehCoornSigQualVehV VehCoorn_st /end OUT_MEASUREMENT
 /begin LOC_MEASUREMENT VehCoorn_stProtddlyd VehCoorn_stProtdLoc /end LOC_MEASUREMENT
 FUNCTION_VERSION "1400.0.0" /end FUNCTION
/begin COMPU_METHOD BINStgyTxTmrSts_VERB "" TAB_VERB "%6.3" "" COMPU_TAB_REF BINStgyTxTmrSts_VERB /end COMPU_METHOD
/begin COMPU_VTAB BINStgyTxTmrSts_VERB "" TAB_VERB 4 0 "TIMER_NOT_STARTED" 1 "TIMER_RESET" 2 "TIMER_RUNNING" 3 "TIMER_ELAPSED" /end COMPU_VTAB
/begin COMPU_METHOD B_TRUE "" TAB_VERB "%6.3" "" COMPU_TAB_REF B_TRUE /end COMPU_METHOD
/begin COMPU_VTAB B_TRUE "" TAB_VERB 2 0 "FALSE" 1 "TRUE" /end COMPU_VTAB
/begin COMPU_METHOD DDRCTime_ms "" RAT_FUNC "%6.1" "ms" COEFFS 0 1 0 0 0 10 /end COMPU_METHOD
/begin COMPU_METHOD DDRC_Ratio "" TAB_VERB "%6.3" "-" COMPU_TAB_REF DDRC_Ratio /end COMPU_METHOD
/begin COMPU_VTAB DDRC_Ratio "" TAB_VERB 4 1 "Ratio1" 2 "Ratio2" 3 "Ratio3" 4 "Ratio4" /end COMPU_VTAB
/begin COMPU_METHOD DELIB_ALLTEMP_VERB_COMPU "" TAB_VERB "%6.3" "" COMPU_TAB_REF DELIB_ALLTEMP_VERB_COMPU /end COMPU_METHOD
/begin COMPU_VTAB DELIB_ALLTEMP_VERB_COMPU "" TAB_VERB 6 85 "ACCHRGRINTKT" 86 "DCCHRGRINTKT" 0 "ENVT" 89 "HEATRCORET" 254 "DFLTEMP" 255 "NOTEMP" /end COMPU_VTAB
/begin COMPU_METHOD DFC_OneToOne "" RAT_FUNC "%6.2" "-" COEFFS 0 1 0 0 0 1 /end COMPU_METHOD
/begin COMPU_METHOD DFES_OneToOne "" RAT_FUNC "%6.2" "-" COEFFS 0 1 0 0 0 1 /end COMPU_METHOD
/begin COMPU_METHOD DINH_ct_Compu "" RAT_FUNC "%6.0" "" COEFFS 0 -1 4096 0 0 1 /end COMPU_METHOD
/begin COMPU_METHOD EngN "" RAT_FUNC "%6.3" "rpm" COEFFS 0 2 0 0 0 1 /end COMPU_METHOD
/begin COMPU_METHOD EngN1 "" RAT_FUNC "%6.3" "rpm" COEFFS 0 2 0 0 0 1 /end COMPU_METHOD
/begin COMPU_METHOD InjMass "" RAT_FUNC "%6.4" "mg/hub" COEFFS 0 100 0 0 0 1 /end COMPU_METHOD
/begin COMPU_METHOD Length "" RAT_FUNC "%6.2" "m" COEFFS 0 1 0 0 0 1 /end COMPU_METHOD
/begin COMPU_METHOD nmot_q1 "" RAT_FUNC "%6.2" "1/min" COEFFS 0 1 0 0 0 1 /end COMPU_METHOD
/begin COMPU_METHOD OneToOne "" RAT_FUNC "%6.2" "-" COEFFS 0 1 0 0 0 1 /end COMPU_METHOD
/begin COMPU_METHOD Prc "" RAT_FUNC "%6.4" "%" COEFFS 0 81.92 0 0 0 1 /end COMPU_METHOD
/begin COMPU_METHOD PresAC_hPa "" RAT_FUNC "%6.2" "hPa" COEFFS 0 0.5 0 0 0 1 /end COMPU_METHOD
/begin COMPU_METHOD q0p1_K "" RAT_FUNC "%6.3" "K" COEFFS 0 100 0 0 0 10 /end COMPU_METHOD
/begin COMPU_METHOD q1 "" RAT_FUNC "%6.2" "-" COEFFS 0 1 0 0 0 1 /end COMPU_METHOD
/begin COMPU_METHOD q1p0_m_DIV_s "" RAT_FUNC "%6.2" "m/s" COEFFS 0 1 0 0 0 1 /end COMPU_METHOD
/begin COMPU_METHOD q1_DIV_min "" RAT_FUNC "%6.2" "1/min" COEFFS 0 1 0 0 0 1 /end COMPU_METHOD
/begin COMPU_METHOD q1_DIV_s "" RAT_FUNC "%6.2" "1/s" COEFFS 0 1 0 0 0 1 /end COMPU_METHOD
/begin COMPU_METHOD q1_Wh_DIV_km "" RAT_FUNC "%6.2" "Wh/km" COEFFS 0 1 0 0 0 1 /end COMPU_METHOD
/begin COMPU_METHOD q1_W_s_DIV_m "" RAT_FUNC "%6.2" "Ws/m" COEFFS 0 1 0 0 0 1 /end COMPU_METHOD
/begin COMPU_METHOD RBPtCel_dst_1p0_1 "" RAT_FUNC "%6.2" "m" COEFFS 0 1 0 0 0 1 /end COMPU_METHOD
/begin COMPU_METHOD RBPtCel_du_1p0_1 "" RAT_FUNC "%6.2" "V/s" COEFFS 0 1 0 0 0 1 /end COMPU_METHOD
/begin COMPU_METHOD RBPtCel_egy_1p0_2 "" RAT_FUNC "%6.2" "J" COEFFS 0 1 0 0 0 1 /end COMPU_METHOD
/begin COMPU_METHOD RBPtCel_fac_0p001_1 "" RAT_FUNC "%6.5" "-" COEFFS 0 1000 0 0 0 1 /end COMPU_METHOD
/begin COMPU_METHOD RBPtCel_fac_0p1_1 "" RAT_FUNC "%6.3" "-" COEFFS 0 10 0 0 0 1 /end COMPU_METHOD
/begin COMPU_METHOD RBPtCel_fac_1p0_1 "" RAT_FUNC "%6.2" "-" COEFFS 0 1 0 0 0 1 /end COMPU_METHOD
/begin COMPU_METHOD RBPtCel_j_1p0_1 "" RAT_FUNC "%6.2" "kgm^2" COEFFS 0 1 0 0 0 1 /end COMPU_METHOD
/begin COMPU_METHOD RBPtCel_n_50p0_1 "" RAT_FUNC "%6.1" "rpm" COEFFS 0 1 0 0 0 50 /end COMPU_METHOD
/begin COMPU_METHOD RBPtCel_Perc_1p0_1 "" RAT_FUNC "%6.2" "%" COEFFS 0 1 0 0 0 1 /end COMPU_METHOD
/begin COMPU_METHOD RBPtCel_pwr_1p0_1 "" RAT_FUNC "%6.2" "W" COEFFS 0 1 0 0 0 1 /end COMPU_METHOD
/begin COMPU_METHOD RBPtCel_pwr_1p0_4 "" RAT_FUNC "%6.2" "Ws" COEFFS 0 1 0 0 0 1 /end COMPU_METHOD
/begin COMPU_METHOD RBPtCel_pwr_25p0_1 "" RAT_FUNC "%6.1" "W" COEFFS 0 1 0 0 0 25 /end COMPU_METHOD
/begin COMPU_METHOD RBPtCel_p_1p0_1 "" RAT_FUNC "%6.2" "hPa" COEFFS 0 1 0 0 0 1 /end COMPU_METHOD
/begin COMPU_METHOD RBPtCel_r_1p0_1 "" RAT_FUNC "%6.2" "Ohm" COEFFS 0 1 0 0 0 1 /end COMPU_METHOD
/begin COMPU_METHOD RBPtCel_ti_1p0em6_1 "" RAT_FUNC "%9.8" "s" COEFFS 0 1000000 0 0 0 1 /end COMPU_METHOD
/begin COMPU_METHOD RBPtCel_ti_1p0_2 "" RAT_FUNC "%6.2" "s" COEFFS 0 1 0 0 0 1 /end COMPU_METHOD
/begin COMPU_METHOD RBPtCel_tq_1p0_1 "" RAT_FUNC "%6.2" "Nm" COEFFS 0 1 0 0 0 1 /end COMPU_METHOD
/begin COMPU_METHOD RBPtCel_t_0p02_1 "" RAT_FUNC "%6.4" "Deg C" COEFFS 0 50 0 0 0 1 /end COMPU_METHOD
/begin COMPU_METHOD RBPtCel_t_1p0_1 "" RAT_FUNC "%6.2" "K" COEFFS 0 1 0 0 0 1 /end COMPU_METHOD
/begin COMPU_METHOD RBPtCel_t_1p0_3 "" RAT_FUNC "%6.2" "Deg C" COEFFS 0 1 0 0 0 1 /end COMPU_METHOD
/begin COMPU_METHOD RBPtCel_u_1p0_1 "" RAT_FUNC "%6.2" "V" COEFFS 0 1 0 0 0 1 /end COMPU_METHOD
/begin COMPU_METHOD RBPtCel_u_1p0_2 "" RAT_FUNC "%6.2" "mV" COEFFS 0 1 0 0 0 1 /end COMPU_METHOD
/begin COMPU_METHOD rel_q1 "" RAT_FUNC "%6.2" "%" COEFFS 0 1 0 0 0 1 /end COMPU_METHOD
/begin COMPU_METHOD SigQly_COMPU_VERB "" TAB_VERB "%6.3" "" COMPU_TAB_REF SigQly_COMPU_VERB /end COMPU_METHOD
/begin COMPU_VTAB SigQly_COMPU_VERB "" TAB_VERB 16 0 "SIGQLY_NOTCALC" 1 "SIGQLY_INIT" 2 "SIGQLY_OK" 3 "SIGQLY_MODEL" 4 "SIGQLY_REPLACEMENT" 5 "SIGQLY_FROZEN" 6 "SIGQLY_INVALID" 7 "SIGQLY_RESERVED_7" 8 "SIGQLY_RESERVED_8" 9 "SIGQLY_RESERVED_9" 10 "SIGQLY_RESERVED_10" 11 "SIGQLY_RESERVED_11" 12 "SIGQLY_RESERVED_12" 13 "SIGQLY_RESERVED_13" 14 "SIGQLY_RESERVED_14" 15 "SIGQLY_RESERVED_15" /end COMPU_VTAB
/begin COMPU_METHOD TempC_float "" RAT_FUNC "%6.1" "deg C" COEFFS 0 1 273.14 0 0 1 /end COMPU_METHOD
/begin COMPU_METHOD TempDiff_Kelv "" RAT_FUNC "%6.3" "K" COEFFS 0 10 0 0 0 1 /end COMPU_METHOD
/begin COMPU_METHOD Temp_Cels "" RAT_FUNC "%6.1" "deg C" COEFFS 0 10 2731.4 0 0 1 /end COMPU_METHOD
/begin COMPU_METHOD TimeDelay_s "" RAT_FUNC "%6.1" "s" COEFFS 0 0 1 0 0.00023283064365387 0 /end COMPU_METHOD
/begin COMPU_METHOD Time_1s "" RAT_FUNC "%6.2" "s" COEFFS 0 1 0 0 0 1 /end COMPU_METHOD
/begin COMPU_METHOD Time_ms "" RAT_FUNC "%6.1" "ms" COEFFS 0 0.1 0 0 0 1 /end COMPU_METHOD
/begin COMPU_METHOD Time_s "" RAT_FUNC "%6.4" "s" COEFFS 0 100 0 0 0 1 /end COMPU_METHOD
/begin COMPU_METHOD Time_sec_q1_COMPU "" RAT_FUNC "%6.2" "s" COEFFS 0 1 0 0 0 1 /end COMPU_METHOD
/begin COMPU_METHOD TransR "" RAT_FUNC "%6.4" "-" COEFFS 0 100 0 0 0 1 /end COMPU_METHOD
/begin COMPU_METHOD Trq "" RAT_FUNC "%6.3" "Nm" COEFFS 0 10 0 0 0 1 /end COMPU_METHOD
/begin COMPU_METHOD U_mV_q0p9765625_COMPU "" RAT_FUNC "%6.2" "mV" COEFFS 0 1.024 0 0 0 1 /end COMPU_METHOD
/begin COMPU_METHOD VehCoorn_st_VERB "" TAB_VERB "%6.3" "" COMPU_TAB_REF VehCoorn_st_VERB /end COMPU_METHOD
/begin COMPU_VTAB VehCoorn_st_VERB "" TAB_VERB 6 0 "VEHCOORN_ENUM_STBY" 1 "VEHCOORN_ENUM_STRTUP" 2 "VEHCOORN_ENUM_HVREADY" 3 "VEHCOORN_ENUM_DRV" 5 "VEHCOORN_ENUM_CHRG" 6 "VEHCOORN_ENUM_SHTDWN" /end COMPU_VTAB
/begin COMPU_METHOD VEHDEV_DSQACTV_SC_Compu "" TAB_VERB "%6.3" "" COMPU_TAB_REF VEHDEV_DSQACTV_SC_Compu /end COMPU_METHOD
/begin COMPU_VTAB VEHDEV_DSQACTV_SC_Compu "" TAB_VERB 2 0 "Inactive" 1 "Active" /end COMPU_VTAB
/begin COMPU_METHOD VEHDEV_HNDBRKENA_SC_Compu "" TAB_VERB "%6.3" "" COMPU_TAB_REF VEHDEV_HNDBRKENA_SC_Compu /end COMPU_METHOD
/begin COMPU_VTAB VEHDEV_HNDBRKENA_SC_Compu "" TAB_VERB 2 0 "False" 1 "True" /end COMPU_VTAB
/begin COMPU_METHOD VEHDEV_VAR_SY_Compu "" TAB_VERB "%6.3" "" COMPU_TAB_REF VEHDEV_VAR_SY_Compu /end COMPU_METHOD
/begin COMPU_VTAB VEHDEV_VAR_SY_Compu "" TAB_VERB 48 1 "DAI" 3 "VWW" 4 "POR" 5 "AUD" 6 "OPE" 9 "FIA" 11 "BMW" 14 "PSA" 15 "REN" 17 "ALF" 18 "SAB" 19 "VOL" 20 "NIS" 21 "GMU" 22 "FOR" 26 "IMJ" 36 "MAN" 51 "SEA" 53 "CHR" 54 "JAG" 55 "ROL" 69 "FER" 72 "TOY" 123 "MIT" 147 "HYU" 159 "HON" 160 "MAZ" 183 "CU" 190 "LRG" 204 "VVW" 214 "AVT" 226 "YUCHAI_OHW" 242 "Iveco" 243 "DMC" 248 "SUZ" 267 "SSANGYONG" 270 "KEF" 289 "AMG" 308 "TAT" 319 "MVM" 385 "UAES" 425 "POL" 590 "Scania" 828 "RBCD" 973 "YANMAR" 999 "ALL" 2887 "Nonox" 9454 "Fuso" /end COMPU_VTAB
/begin COMPU_METHOD VEHTYPSELN_SC_Compu "" TAB_VERB "%6.3" "" COMPU_TAB_REF VEHTYPSELN_SC_Compu /end COMPU_METHOD
/begin COMPU_VTAB VEHTYPSELN_SC_Compu "" TAB_VERB 5 0 "PV" 1 "CV" 2 "OHW" 3 "LCV" 5 "2WHEEL" /end COMPU_VTAB
/begin COMPU_METHOD VEHTYP_SC_Compu "" TAB_VERB "%6.3" "" COMPU_TAB_REF VEHTYP_SC_Compu /end COMPU_METHOD
/begin COMPU_VTAB VEHTYP_SC_Compu "" TAB_VERB 2 1 "Two_Wheeler" 2 "Four_Wheeler" /end COMPU_VTAB
/begin COMPU_METHOD VEHVPWMOUT_SC_Compu "" TAB_VERB "%6.3" "" COMPU_TAB_REF VEHVPWMOUT_SC_Compu /end COMPU_METHOD
/begin COMPU_VTAB VEHVPWMOUT_SC_Compu "" TAB_VERB 2 0 "False" 1 "True" /end COMPU_VTAB
/begin COMPU_METHOD VEHV_CANSAFE_SC_Compu "" TAB_VERB "%6.3" "" COMPU_TAB_REF VEHV_CANSAFE_SC_Compu /end COMPU_METHOD
/begin COMPU_VTAB VEHV_CANSAFE_SC_Compu "" TAB_VERB 4 0 "0" 1 "1" 2 "2" 3 "3" /end COMPU_VTAB
/begin COMPU_METHOD VEHV_CAN_SC_Compu "" TAB_VERB "%6.3" "" COMPU_TAB_REF VEHV_CAN_SC_Compu /end COMPU_METHOD
/begin COMPU_VTAB VEHV_CAN_SC_Compu "" TAB_VERB 4 0 "No_CAN" 1 "CONSOLIDATED_CAN" 2 "SINGLEWHEELSPEED_CAN" 3 "CONSOLIDATED_SINGLEWHEELSPEED" /end COMPU_VTAB
/begin COMPU_METHOD VEHV_DUALCANSRCACTV_SC_Compu "" TAB_VERB "%6.3" "" COMPU_TAB_REF VEHV_DUALCANSRCACTV_SC_Compu /end COMPU_METHOD
/begin COMPU_VTAB VEHV_DUALCANSRCACTV_SC_Compu "" TAB_VERB 2 0 "NOT_ACTIVE" 1 "ACTIVE" /end COMPU_VTAB
/begin COMPU_METHOD VEHV_DUALSIG_SC_Compu "" TAB_VERB "%6.3" "" COMPU_TAB_REF VEHV_DUALSIG_SC_Compu /end COMPU_METHOD
/begin COMPU_VTAB VEHV_DUALSIG_SC_Compu "" TAB_VERB 2 0 "False" 1 "True" /end COMPU_VTAB
/begin COMPU_METHOD VEHV_PWMVLDYCHK_SC_Compu "" TAB_VERB "%6.3" "" COMPU_TAB_REF VEHV_PWMVLDYCHK_SC_Compu /end COMPU_METHOD
/begin COMPU_VTAB VEHV_PWMVLDYCHK_SC_Compu "" TAB_VERB 2 0 "deactivated" 1 "activated" /end COMPU_VTAB
/begin COMPU_METHOD VEHV_PWM_SC_Compu "" TAB_VERB "%6.3" "" COMPU_TAB_REF VEHV_PWM_SC_Compu /end COMPU_METHOD
/begin COMPU_VTAB VEHV_PWM_SC_Compu "" TAB_VERB 4 0 "No PWM" 1 "Pwm_InXt" 2 "Pwm_InPer" 3 "Pwm_In" /end COMPU_VTAB
/begin COMPU_METHOD VEHV_SGLWHLDIAG_SY_Compu "" TAB_VERB "%6.3" "" COMPU_TAB_REF VEHV_SGLWHLDIAG_SY_Compu /end COMPU_METHOD
/begin COMPU_VTAB VEHV_SGLWHLDIAG_SY_Compu "" TAB_VERB 3 0 "0" 1 "1" 2 "2" /end COMPU_VTAB
/begin COMPU_METHOD VEHV_SHAFTSPD_SC_Compu "" TAB_VERB "%6.3" "" COMPU_TAB_REF VEHV_SHAFTSPD_SC_Compu /end COMPU_METHOD
/begin COMPU_VTAB VEHV_SHAFTSPD_SC_Compu "" TAB_VERB 2 0 "False" 1 "True" /end COMPU_VTAB
/begin COMPU_METHOD VEHV_SWTASRC_SC_Compu "" TAB_VERB "%6.3" "" COMPU_TAB_REF VEHV_SWTASRC_SC_Compu /end COMPU_METHOD
/begin COMPU_VTAB VEHV_SWTASRC_SC_Compu "" TAB_VERB 2 1 "A_VEHV" 2 "A_CAN" /end COMPU_VTAB
/begin COMPU_METHOD VEHV_SWTPLAUSFCO_SC_Compu "" TAB_VERB "%6.3" "" COMPU_TAB_REF VEHV_SWTPLAUSFCO_SC_Compu /end COMPU_METHOD
/begin COMPU_VTAB VEHV_SWTPLAUSFCO_SC_Compu "" TAB_VERB 2 0 "False" 1 "True" /end COMPU_VTAB
/begin COMPU_METHOD VEHV_SWTPLAUSPWR_SC_Compu "" TAB_VERB "%6.3" "" COMPU_TAB_REF VEHV_SWTPLAUSPWR_SC_Compu /end COMPU_METHOD
/begin COMPU_VTAB VEHV_SWTPLAUSPWR_SC_Compu "" TAB_VERB 2 0 "False" 1 "True" /end COMPU_VTAB
/begin COMPU_METHOD VEHV_SWTPLAUSREF_SC_Compu "" TAB_VERB "%6.3" "" COMPU_TAB_REF VEHV_SWTPLAUSREF_SC_Compu /end COMPU_METHOD
/begin COMPU_VTAB VEHV_SWTPLAUSREF_SC_Compu "" TAB_VERB 2 0 "False" 1 "True" /end COMPU_VTAB
/begin COMPU_METHOD VEHV_SWTPLAUSV2N_SC_Compu "" TAB_VERB "%6.3" "" COMPU_TAB_REF VEHV_SWTPLAUSV2N_SC_Compu /end COMPU_METHOD
/begin COMPU_VTAB VEHV_SWTPLAUSV2N_SC_Compu "" TAB_VERB 2 0 "False" 1 "True" /end COMPU_VTAB
/begin COMPU_METHOD Vel "" RAT_FUNC "%6.4" "km/h" COEFFS 0 100 0 0 0 1 /end COMPU_METHOD
/begin COMPU_METHOD Velocity "" RAT_FUNC "%6.4" "m/s" COEFFS 0 178.571428571429 0 0 0 1 /end COMPU_METHOD
/begin COMPU_METHOD VelToN "" RAT_FUNC "%8.7" "(km/h)/rpm" COEFFS 0 100000 0 0 0 1 /end COMPU_METHOD
/begin COMPU_METHOD Vel_SI "" RAT_FUNC "%6.4" "m/s" COEFFS 0 360 0 0 0 1 /end COMPU_METHOD
/begin COMPU_METHOD VIRTETH_SC_Compu "" TAB_VERB "%6.3" "" COMPU_TAB_REF VIRTETH_SC_Compu /end COMPU_METHOD
/begin COMPU_VTAB VIRTETH_SC_Compu "" TAB_VERB 2 0 "NO_VIRTETH" 1 "VIRTETH_USED" /end COMPU_VTAB
/begin COMPU_METHOD VLVLFTI_TYPAVL_SC_Compu "" TAB_VERB "%6.3" "" COMPU_TAB_REF VLVLFTI_TYPAVL_SC_Compu /end COMPU_METHOD
/begin COMPU_VTAB VLVLFTI_TYPAVL_SC_Compu "" TAB_VERB 2 0 "False" 1 "True" /end COMPU_VTAB
/begin COMPU_METHOD VlvVel "" RAT_FUNC "%6.3" "%/s" COEFFS 0 8.192 0 0 0 1 /end COMPU_METHOD
/begin COMPU_METHOD VNQ6040_SC_Compu "" TAB_VERB "%6.3" "" COMPU_TAB_REF VNQ6040_SC_Compu /end COMPU_METHOD
/begin COMPU_VTAB VNQ6040_SC_Compu "" TAB_VERB 11 0 "NoneASIC" 1 "OneASIC" 2 "TwoASICs" 3 "ThreeASICs" 4 "FourASICs" 5 "FiveASICs" 6 "SixASICs" 7 "SevenASICs" 8 "EightASICs" 9 "NineASICs" 10 "TenASICs" /end COMPU_VTAB
/begin COMPU_METHOD Vol "" RAT_FUNC "%6.4" "l" COEFFS 0 100 0 0 0 1 /end COMPU_METHOD
/begin COMPU_METHOD Vol1 "" RAT_FUNC "%9.8" "l" COEFFS 0 3600000 0 0 0 1 /end COMPU_METHOD
/begin COMPU_METHOD volAdd_ml "" RAT_FUNC "%6.3" "ml" COEFFS 0 10 0 0 0 1 /end COMPU_METHOD
/begin COMPU_METHOD volAdd_ml_fine "" RAT_FUNC "%6.5" "ml" COEFFS 0 1000 0 0 0 1 /end COMPU_METHOD
/begin COMPU_METHOD VolEngCap_COMPU "" RAT_FUNC "%9.8" "m^3" COEFFS 0 1000000 0 0 0 1 /end COMPU_METHOD
/begin COMPU_METHOD volFilgLvl_ml "" RAT_FUNC "%6.2" "ml" COEFFS 0 1 0 0 0 1 /end COMPU_METHOD
/begin COMPU_METHOD VolFine "" RAT_FUNC "%7.6" "m^3" COEFFS 0 10000 0 0 0 1 /end COMPU_METHOD
/begin COMPU_METHOD Volt "" RAT_FUNC "%6.3" "mV" COEFFS 0 5 0 0 0 1 /end COMPU_METHOD
/begin COMPU_METHOD VoltPres "" RAT_FUNC "%6.3" "mV*hPa" COEFFS 0 10 0 0 0 1 /end COMPU_METHOD
/begin COMPU_METHOD VoltPres_HiRes "" RAT_FUNC "%6.4" "mV*hPa" COEFFS 0 100 0 0 0 1 /end COMPU_METHOD
/begin COMPU_METHOD Volt_Batt "" RAT_FUNC "%6.1" "mV" COEFFS 0 0.05 0 0 0 1 /end COMPU_METHOD
/begin COMPU_METHOD Volt_FnReso1 "" RAT_FUNC "%6.3" "mV" COEFFS 0 10 0 0 0 1 /end COMPU_METHOD
/begin COMPU_METHOD Volt_FnReso2 "" RAT_FUNC "%6.5" "mV" COEFFS 0 1000 0 0 0 1 /end COMPU_METHOD
/begin COMPU_METHOD Volt_per_Pres "" RAT_FUNC "%6.5" "mV/hPa" COEFFS 0 1000 0 0 0 1 /end COMPU_METHOD
/begin COMPU_METHOD Volt_q0p002_COMPU "" RAT_FUNC "%6.4" "V" COEFFS 0 500 0 0 0 1 /end COMPU_METHOD
/begin COMPU_METHOD Volt_Sq_HiRes "" RAT_FUNC "%6.3" "mV*mV" COEFFS 0 10 0 0 0 1 /end COMPU_METHOD
/begin COMPU_METHOD Vol_NSC "" RAT_FUNC "%7.6" "L" COEFFS 0 10000 0 0 0 1 /end COMPU_METHOD
/begin COMPU_METHOD VSWVLVI_TYPAVL_SC_Compu "" TAB_VERB "%6.3" "" COMPU_TAB_REF VSWVLVI_TYPAVL_SC_Compu /end COMPU_METHOD
/begin COMPU_VTAB VSWVLVI_TYPAVL_SC_Compu "" TAB_VERB 2 0 "False" 1 "True" /end COMPU_VTAB
/begin COMPU_METHOD WaterMsPrHr "" RAT_FUNC "%6.5" "Kg/h" COEFFS 0 1000 0 0 0 1 /end COMPU_METHOD
/begin COMPU_METHOD WDGS_CFGADPR_SC_Compu "" TAB_VERB "%6.3" "" COMPU_TAB_REF WDGS_CFGADPR_SC_Compu /end COMPU_METHOD
/begin COMPU_VTAB WDGS_CFGADPR_SC_Compu "" TAB_VERB 2 0 "False" 1 "True" /end COMPU_VTAB
/begin RECORD_LAYOUT Kw_Wr32 FNC_VALUES 1 FLOAT32_IEEE COLUMN_DIR DIRECT /end RECORD_LAYOUT
/begin RECORD_LAYOUT Kw_Wu8 FNC_VALUES 1 UBYTE COLUMN_DIR DIRECT /end RECORD_LAYOUT
/begin RECORD_LAYOUT RB_Axis_R32 NO_AXIS_PTS_X 1 ULONG AXIS_PTS_X 2 FLOAT32_IEEE INDEX_INCR DIRECT /end RECORD_LAYOUT
/begin RECORD_LAYOUT RB_CurveGroup_R32 FNC_VALUES 1 FLOAT32_IEEE COLUMN_DIR DIRECT /end RECORD_LAYOUT
/begin RECORD_LAYOUT RB_Curve_R32_R32_sao NO_AXIS_PTS_X 1 ULONG AXIS_PTS_X 2 FLOAT32_IEEE INDEX_INCR DIRECT FNC_VALUES 3 FLOAT32_IEEE COLUMN_DIR DIRECT STATIC_ADDRESS_OFFSETS /end RECORD_LAYOUT
/begin RECORD_LAYOUT RB_Curve_S16_S16 NO_AXIS_PTS_X 1 SWORD AXIS_PTS_X 2 SWORD INDEX_INCR DIRECT FNC_VALUES 3 SWORD COLUMN_DIR DIRECT /end RECORD_LAYOUT
/begin RECORD_LAYOUT RB_Curve_S16_S32_sao NO_AXIS_PTS_X 1 SWORD AXIS_PTS_X 2 SWORD INDEX_INCR DIRECT FNC_VALUES 3 SLONG COLUMN_DIR DIRECT STATIC_ADDRESS_OFFSETS /end RECORD_LAYOUT
/begin RECORD_LAYOUT RB_Curve_S16_S8_sao NO_AXIS_PTS_X 1 SWORD AXIS_PTS_X 2 SWORD INDEX_INCR DIRECT FNC_VALUES 3 SBYTE COLUMN_DIR DIRECT STATIC_ADDRESS_OFFSETS /end RECORD_LAYOUT
/begin RECORD_LAYOUT RB_Curve_S16_U16_sao NO_AXIS_PTS_X 1 SWORD AXIS_PTS_X 2 SWORD INDEX_INCR DIRECT FNC_VALUES 3 UWORD COLUMN_DIR DIRECT STATIC_ADDRESS_OFFSETS /end RECORD_LAYOUT
/begin RECORD_LAYOUT RB_Curve_S16_U8_sao NO_AXIS_PTS_X 1 SWORD AXIS_PTS_X 2 SWORD INDEX_INCR DIRECT FNC_VALUES 3 UBYTE COLUMN_DIR DIRECT STATIC_ADDRESS_OFFSETS /end RECORD_LAYOUT
/begin RECORD_LAYOUT RB_Map_R32R32_R32_sao NO_AXIS_PTS_X 1 ULONG NO_AXIS_PTS_Y 2 ULONG AXIS_PTS_X 3 FLOAT32_IEEE INDEX_INCR DIRECT AXIS_PTS_Y 4 FLOAT32_IEEE INDEX_INCR DIRECT FNC_VALUES 5 FLOAT32_IEEE COLUMN_DIR DIRECT STATIC_ADDRESS_OFFSETS /end RECORD_LAYOUT
/begin RECORD_LAYOUT RB_Map_S16S16_R32_sao NO_AXIS_PTS_X 1 SWORD NO_AXIS_PTS_Y 2 SWORD AXIS_PTS_X 3 SWORD INDEX_INCR DIRECT AXIS_PTS_Y 4 SWORD INDEX_INCR DIRECT FNC_VALUES 5 FLOAT32_IEEE COLUMN_DIR DIRECT STATIC_ADDRESS_OFFSETS /end RECORD_LAYOUT
/begin RECORD_LAYOUT RB_Map_S16S16_U8_sao NO_AXIS_PTS_X 1 SWORD NO_AXIS_PTS_Y 2 SWORD AXIS_PTS_X 3 SWORD INDEX_INCR DIRECT AXIS_PTS_Y 4 SWORD INDEX_INCR DIRECT FNC_VALUES 5 UBYTE COLUMN_DIR DIRECT STATIC_ADDRESS_OFFSETS /end RECORD_LAYOUT
/begin RECORD_LAYOUT RB_ValA_Wr32 FNC_VALUES 1 FLOAT32_IEEE COLUMN_DIR DIRECT /end RECORD_LAYOUT
/begin RECORD_LAYOUT RB_Val_Wr32 FNC_VALUES 1 FLOAT32_IEEE COLUMN_DIR DIRECT /end RECORD_LAYOUT
/begin RECORD_LAYOUT RB_Val_Ws16 FNC_VALUES 1 SWORD COLUMN_DIR DIRECT /end RECORD_LAYOUT
/begin RECORD_LAYOUT RB_Val_Ws32 FNC_VALUES 1 SLONG COLUMN_DIR DIRECT /end RECORD_LAYOUT
/begin RECORD_LAYOUT RB_Val_Ws8 FNC_VALUES 1 SBYTE COLUMN_DIR DIRECT /end RECORD_LAYOUT
/begin RECORD_LAYOUT RB_Val_Wu16 FNC_VALUES 1 UWORD COLUMN_DIR DIRECT /end RECORD_LAYOUT
/begin RECORD_LAYOUT RB_Val_Wu32 FNC_VALUES 1 ULONG COLUMN_DIR DIRECT /end RECORD_LAYOUT
/begin RECORD_LAYOUT RB_Val_Wu8 FNC_VALUES 1 UBYTE COLUMN_DIR DIRECT /end RECORD_LAYOUT
/begin RECORD_LAYOUT ValA_Wu8 FNC_VALUES 1 UBYTE COLUMN_DIR DIRECT /end RECORD_LAYOUT
/begin RECORD_LAYOUT Val_Wr32 FNC_VALUES 1 FLOAT32_IEEE COLUMN_DIR DIRECT /end RECORD_LAYOUT
/begin RECORD_LAYOUT Val_Ws16 FNC_VALUES 1 SWORD COLUMN_DIR DIRECT /end RECORD_LAYOUT
/begin RECORD_LAYOUT Val_Ws32 FNC_VALUES 1 SLONG COLUMN_DIR DIRECT /end RECORD_LAYOUT
/begin RECORD_LAYOUT Val_Wu16 FNC_VALUES 1 UWORD COLUMN_DIR DIRECT /end RECORD_LAYOUT
/begin RECORD_LAYOUT Val_Wu32 FNC_VALUES 1 ULONG COLUMN_DIR DIRECT /end RECORD_LAYOUT
/begin RECORD_LAYOUT Val_Wu8 FNC_VALUES 1 UBYTE COLUMN_DIR DIRECT /end RECORD_LAYOUT
/end MODULE
/end PROJECT

ASAP2_VERSION 1 70
/begin PROJECT MDG1C "VC1CP091_STLA_N_D061I3"
/begin HEADER "" VERSION "VC1CP091_STLA_N_D061I3" PROJECT_NO MDG1C /end HEADER
/begin MODULE DIM ""
/begin MOD_COMMON "" BYTE_ORDER MSB_LAST ALIGNMENT_BYTE 1 ALIGNMENT_WORD 2 ALIGNMENT_LONG 4 ALIGNMENT_INT64 4 ALIGNMENT_FLOAT32_IEEE 4 ALIGNMENT_FLOAT64_IEEE 4 DATA_SIZE 32 /end MOD_COMMON
/begin CHARACTERISTIC CoVMEv_dtqSysErrLimnMaxNeg01_C "Negative ramp slope to control the Maximum Torque Limit at Primary Axle as System Error_01 heals" VALUE 0x8024FF94 RB_Val_Ws32 6553599.99847 RmpTrqPrpHigh -3276800.00000 3276799.99847 FORMAT "%13.5" /end CHARACTERISTIC
/begin CHARACTERISTIC CoVMEv_dtqSysErrLimnMaxPos01_C "Positive ramp slope to control the Maximum Torque Limit at Primary Axle as System Error_01 heals" VALUE 0x8024FF98 RB_Val_Ws32 6553599.99847 RmpTrqPrpHigh -3276800.00000 3276799.99847 FORMAT "%13.5" /end CHARACTERISTIC
/begin CHARACTERISTIC CoVMEv_dtqSysErrLimnMinNeg01_C "Negative ramp slope to control the Minimum Torque Limit at Primary Axle as System Error_01 heals" VALUE 0x8024FF9C RB_Val_Ws32 6553599.99847 RmpTrqPrpHigh -3276800.00000 3276799.99847 FORMAT "%13.5" /end CHARACTERISTIC
/begin CHARACTERISTIC CoVMEv_dtqSysErrLimnMinPos01_C "Positive ramp slope to control the Minimum Torque Limit at Primary Axle as System Error_01 heals" VALUE 0x8024FFA0 RB_Val_Ws32 6553599.99847 RmpTrqPrpHigh -3276800.00000 3276799.99847 FORMAT "%13.5" /end CHARACTERISTIC
/begin CHARACTERISTIC CoVMEv_tqSysErrLimnMaxErr01_T "Maximum torque limit at primary axle during system error_01 (vehicle velocity dependent)" CURVE 0x8024FFA4 RB_Curve_S16_S16 104856.0 TrqPrp -52428.80 52427.20 FORMAT "%8.2"
 /begin AXIS_DESCR STD_AXIS VehV_v Vel 6 -327.6800 327.6700 FORMAT "%8.4" DEPOSIT ABSOLUTE /end AXIS_DESCR
/end CHARACTERISTIC
/begin CHARACTERISTIC CoVMEv_tqSysErrLimnMaxErr02_T "Maximum torque limit at primary axle during system error_02 (vehicle velocity dependent)" CURVE 0x8024FFBE RB_Curve_S16_S16 104856.0 TrqPrp -52428.80 52427.20 FORMAT "%8.2"
 /begin AXIS_DESCR STD_AXIS VehV_v Vel 6 -327.6800 327.6700 FORMAT "%8.4" DEPOSIT ABSOLUTE /end AXIS_DESCR
/end CHARACTERISTIC
/begin CHARACTERISTIC CoVMEv_tqSysErrLimnMaxErr03_T "Maximum torque limit at primary axle during system error_03 (vehicle velocity dependent)" CURVE 0x8024FFD8 RB_Curve_S16_S16 104856.0 TrqPrp -52428.80 52427.20 FORMAT "%8.2"
 /begin AXIS_DESCR STD_AXIS VehV_v Vel 6 -327.6800 327.6700 FORMAT "%8.4" DEPOSIT ABSOLUTE /end AXIS_DESCR
/end CHARACTERISTIC
/begin CHARACTERISTIC CoVMEv_tqSysErrLimnMaxErr04_T "Maximum torque limit at primary axle during system error_04 (vehicle velocity dependent)" CURVE 0x8024FFF2 RB_Curve_S16_S16 104856.0 TrqPrp -52428.80 52427.20 FORMAT "%8.2"
 /begin AXIS_DESCR STD_AXIS VehV_v Vel 6 -327.6800 327.6700 FORMAT "%8.4" DEPOSIT ABSOLUTE /end AXIS_DESCR
/end CHARACTERISTIC
/begin CHARACTERISTIC CoVMEv_tqSysErrLimnMaxErr05_T "Maximum torque limit at primary axle during system error_05 (vehicle velocity dependent)" CURVE 0x8025000C RB_Curve_S16_S16 104856.0 TrqPrp -52428.80 52427.20 FORMAT "%8.2"
 /begin AXIS_DESCR STD_AXIS VehV_v Vel 6 -327.6800 327.6700 FORMAT "%8.4" DEPOSIT ABSOLUTE /end AXIS_DESCR
/end CHARACTERISTIC
/begin CHARACTERISTIC CoVMEv_tqSysErrLimnMinErr01_T "Minimum torque limit at primary axle during system error_01 (vehicle velocity dependent)" CURVE 0x80250026 RB_Curve_S16_S16 104856.0 TrqPrp -52428.80 52427.20 FORMAT "%8.2"
 /begin AXIS_DESCR STD_AXIS VehV_v Vel 6 -327.6800 327.6700 FORMAT "%8.4" DEPOSIT ABSOLUTE /end AXIS_DESCR
/end CHARACTERISTIC
/begin CHARACTERISTIC CoVMEv_tqSysErrLimnMinErr02_T "Minimum torque limit at primary axle during system error_02 (vehicle velocity dependent)" CURVE 0x80250040 RB_Curve_S16_S16 104856.0 TrqPrp -52428.80 52427.20 FORMAT "%8.2"
 /begin AXIS_DESCR STD_AXIS VehV_v Vel 6 -327.6800 327.6700 FORMAT "%8.4" DEPOSIT ABSOLUTE /end AXIS_DESCR
/end CHARACTERISTIC
/begin CHARACTERISTIC CoVMEv_tqSysErrLimnMinErr03_T "Minimum torque limit at primary axle during system error_03 (vehicle velocity dependent)" CURVE 0x8025005A RB_Curve_S16_S16 104856.0 TrqPrp -52428.80 52427.20 FORMAT "%8.2"
 /begin AXIS_DESCR STD_AXIS VehV_v Vel 6 -327.6800 327.6700 FORMAT "%8.4" DEPOSIT ABSOLUTE /end AXIS_DESCR
/end CHARACTERISTIC
/begin CHARACTERISTIC CoVMEv_tqSysErrPrimLimnMax01_C "Maximum torque limit at primary axle during system error_01 (when vehicle velocity is invalid)" VALUE 0x80250074 RB_Val_Ws32 429496729.500 TrqPrpHigh -214748364.800 214748364.700 FORMAT "%13.3" /end CHARACTERISTIC
/begin CHARACTERISTIC CoVMEv_tqSysErrPrimLimnMax02_C "Maximum torque limit at primary axle during system error_02 (when vehicle velocity is invalid)" VALUE 0x80250078 RB_Val_Ws32 429496729.500 TrqPrpHigh -214748364.800 214748364.700 FORMAT "%13.3" /end CHARACTERISTIC
/begin CHARACTERISTIC CoVMEv_tqSysErrPrimLimnMax03_C "Maximum torque limit at primary axle during system error_03 (when vehicle velocity is invalid)" VALUE 0x8025007C RB_Val_Ws32 429496729.500 TrqPrpHigh -214748364.800 214748364.700 FORMAT "%13.3" /end CHARACTERISTIC
/begin CHARACTERISTIC CoVMEv_tqSysErrPrimLimnMax04_C "Maximum torque limit at primary axle during system error_04 (when vehicle velocity is invalid)" VALUE 0x80250080 RB_Val_Ws32 429496729.500 TrqPrpHigh -214748364.800 214748364.700 FORMAT "%13.3" /end CHARACTERISTIC
/begin CHARACTERISTIC CoVMEv_tqSysErrPrimLimnMax05_C "Maximum torque limit at primary axle during system error_05 (when vehicle velocity is invalid)" VALUE 0x80250084 RB_Val_Ws32 429496729.500 TrqPrpHigh -214748364.800 214748364.700 FORMAT "%13.3" /end CHARACTERISTIC
/begin CHARACTERISTIC CoVMEv_tqSysErrPrimLimnMin01_C "Minimum torque limit at primary axle during system error_01 (when vehicle velocity is invalid)" VALUE 0x80250088 RB_Val_Ws32 429496729.500 TrqPrpHigh -214748364.800 214748364.700 FORMAT "%13.3" /end CHARACTERISTIC
/begin CHARACTERISTIC CoVMEv_tqSysErrPrimLimnMin02_C "Minimum torque limit at primary axle during system error_02 (when vehicle velocity is invalid)" VALUE 0x8025008C RB_Val_Ws32 429496729.500 TrqPrpHigh -214748364.800 214748364.700 FORMAT "%13.3" /end CHARACTERISTIC
/begin CHARACTERISTIC CoVMEv_tqSysErrPrimLimnMin03_C "Minimum torque limit at primary axle during system error_03 (when vehicle velocity is invalid)" VALUE 0x80250090 RB_Val_Ws32 429496729.500 TrqPrpHigh -214748364.800 214748364.700 FORMAT "%13.3" /end CHARACTERISTIC
/begin CHARACTERISTIC CtpCarrFrq_drActGradLim_f_C "" VALUE 0x8025A39C Val_Wr32 2.00000000E+037 RBPtCel_fac_1p0_8 -1.00000000E+037 1.00000000E+037 FORMAT "%13.3" EXTENDED_LIMITS -3.40282347E+038 3.40282347E+038 /end CHARACTERISTIC
/begin CHARACTERISTIC CtpCarrFrq_numStdSens_C "" VALUE 0x8025A3C0 Val_Wu32 4294967295.00 OneToOne 0.00 4294967295.00 FORMAT "%13.2" /end CHARACTERISTIC
/begin CHARACTERISTIC CtpCarrFrq_numTempErrDef_C "" VALUE 0x8025A3C4 Val_Wu8 255.0 OneToOne 0.00 255.0 FORMAT "%5.1" /end CHARACTERISTIC
/begin CHARACTERISTIC CtpCarrFrq_numtSel_C "" VALUE 0x8025A3C6 Val_Wu16 255.000000000 DELIB_ALLTEMP_VERB_COMPU 0.00 255.000000000 FORMAT "%13.9" /end CHARACTERISTIC
/begin CHARACTERISTIC CtpCarrFrq_PWMCal.rSRCMax_C "Structure for sensor signal diagnosis / Maximum duty cycle for a valid PWM-transmission" VALUE 0x80250158 RB_Val_Ws16 655.3500 DtyCyc -327.6800 327.6700 FORMAT "%8.4" /end CHARACTERISTIC
/begin CHARACTERISTIC CtpCarrFrq_PWMCal.rSRCMin_C "Structure for sensor signal diagnosis / Minimum duty cycle for a valid PWM-transmission" VALUE 0x8025015A RB_Val_Ws16 655.3500 DtyCyc -327.6800 327.6700 FORMAT "%8.4" /end CHARACTERISTIC
/begin CHARACTERISTIC CtpCarrFrq_PWMCal.tiSRCMax_C "Structure for sensor signal diagnosis / Maximum frequency for a valid PWM-transmission" VALUE 0x8025015C RB_Val_Ws16 65535.00 Time_msec_q1_COMPU -32768.00 32767.00 FORMAT "%8.2" /end CHARACTERISTIC
/begin CHARACTERISTIC CtpCarrFrq_PWMCal.tiSRCMin_C "Structure for sensor signal diagnosis / Minimum frequency for a valid PWM-transmission" VALUE 0x8025015E RB_Val_Ws16 65535.00 Time_msec_q1_COMPU -32768.00 32767.00 FORMAT "%8.2" /end CHARACTERISTIC
/begin CHARACTERISTIC CtpCarrFrq_PWMSensTransf_f_MAP "" MAP 0x802598E8 RB_Map_R32R32_R32_sao 2.00000000E+037 RBPtCel_Perc_1p0_1 -1.00000000E+037 1.00000000E+037 FORMAT "%13.3" EXTENDED_LIMITS -3.40282347E+038 3.40282347E+038
 /begin AXIS_DESCR STD_AXIS CtpCarrFrq_rDtyCycRaw_f RBPtCel_Perc_1p0_1 25 -1.00000000E+037 1.00000000E+037 FORMAT "%13.3" EXTENDED_LIMITS -3.40282347E+038 3.40282347E+038 DEPOSIT ABSOLUTE /end AXIS_DESCR
 /begin AXIS_DESCR STD_AXIS CtpCarrFrq_tiPerRaw_f Time_usec_q1_COMPU 25 -1.00000000E+037 1.00000000E+037 FORMAT "%13.3" EXTENDED_LIMITS -3.40282347E+038 3.40282347E+038 DEPOSIT ABSOLUTE /end AXIS_DESCR
/end CHARACTERISTIC
/begin CHARACTERISTIC CtpCarrFrq_rActDflVal_f_C "" VALUE 0x8025A3A0 Val_Wr32 2.00000000E+037 RBPtCel_Perc_1p0_1 -1.00000000E+037 1.00000000E+037 FORMAT "%13.3" EXTENDED_LIMITS -3.40282347E+038 3.40282347E+038 /end CHARACTERISTIC
/begin CHARACTERISTIC CtpCarrFrq_rActEnhPhysSRCMax_f_MAP "" MAP 0x8025A3C8 RB_Map_S16S16_R32_sao 2.00000000E+037 RBPtCel_Perc_1p0_1 -1.00000000E+037 1.00000000E+037 FORMAT "%13.3" EXTENDED_LIMITS -3.40282347E+038 3.40282347E+038
 /begin AXIS_DESCR STD_AXIS Epm_nEng EngN 25 -16384.00 16383.50 FORMAT "%8.2" DEPOSIT ABSOLUTE /end AXIS_DESCR
 /begin AXIS_DESCR STD_AXIS InjCtl_qSetUnBal InjMass 25 -327.6800 327.6700 FORMAT "%8.4" DEPOSIT ABSOLUTE /end AXIS_DESCR
/end CHARACTERISTIC
/begin CHARACTERISTIC CtpCarrFrq_rActEnhPhysSRCMin_f_MAP "" MAP 0x8025ADF4 RB_Map_S16S16_R32_sao 2.00000000E+037 RBPtCel_Perc_1p0_1 -1.00000000E+037 1.00000000E+037 FORMAT "%13.3" EXTENDED_LIMITS -3.40282347E+038 3.40282347E+038
 /begin AXIS_DESCR STD_AXIS Epm_nEng EngN 25 -16384.00 16383.50 FORMAT "%8.2" DEPOSIT ABSOLUTE /end AXIS_DESCR
 /begin AXIS_DESCR STD_AXIS InjCtl_qSetUnBal InjMass 25 -327.6800 327.6700 FORMAT "%8.4" DEPOSIT ABSOLUTE /end AXIS_DESCR
/end CHARACTERISTIC
/begin CHARACTERISTIC CtpCarrFrq_rActHiLimit_f_C "" VALUE 0x8025A3A4 Val_Wr32 2.00000000E+037 RBPtCel_Perc_1p0_1 -1.00000000E+037 1.00000000E+037 FORMAT "%13.3" EXTENDED_LIMITS -3.40282347E+038 3.40282347E+038 /end CHARACTERISTIC
/begin CHARACTERISTIC CtpCarrFrq_rActLoLimit_f_C "" VALUE 0x8025A3A8 Val_Wr32 2.00000000E+037 RBPtCel_Perc_1p0_1 -1.00000000E+037 1.00000000E+037 FORMAT "%13.3" EXTENDED_LIMITS -3.40282347E+038 3.40282347E+038 /end CHARACTERISTIC
/begin CHARACTERISTIC CtpCarrFrq_RmpSlp_f.Pos_C " / Positive ramp slope dy/dt" VALUE 0x8025A3AC Kw_Wr32 2.00000000E+038 RBPtCel_fac_1p0_8 -1.00000000E+038 1.00000000E+038 FORMAT "%13.3" EXTENDED_LIMITS -3.40282347E+038 3.40282347E+038 /end CHARACTERISTIC
/begin CHARACTERISTIC CtpCarrFrq_RmpSlp_f.Neg_C " / Negative ramp slope dy/dt" VALUE 0x8025A3B0 Kw_Wr32 2.00000000E+038 RBPtCel_fac_1p0_8 -1.00000000E+038 1.00000000E+038 FORMAT "%13.3" EXTENDED_LIMITS -3.40282347E+038 3.40282347E+038 /end CHARACTERISTIC
/begin CHARACTERISTIC CtpCarrFrq_stEnhPhysSRCRls_MAP "" MAP 0x8025B820 RB_Map_S16S16_U8_sao 255.0 OneToOne 0.00 255.0 FORMAT "%5.1"
 /begin AXIS_DESCR STD_AXIS Epm_nEng EngN 25 -16384.00 16383.50 FORMAT "%8.2" DEPOSIT ABSOLUTE /end AXIS_DESCR
 /begin AXIS_DESCR STD_AXIS InjCtl_qSetUnBal InjMass 25 -327.6800 327.6700 FORMAT "%8.4" DEPOSIT ABSOLUTE /end AXIS_DESCR
/end CHARACTERISTIC
/begin CHARACTERISTIC CtpCarrFrq_swtConfStdSens2_C "" VALUE 0x8025A388 Val_Wu32 4294967295.00 OneToOne 0.00 4294967295.00 FORMAT "%13.2" /end CHARACTERISTIC
/begin CHARACTERISTIC CtpCarrFrq_swtConfStdSensSwVers162_C "" VALUE 0x8025A38C Val_Wu32 4294967295.00 OneToOne 0.00 4294967295.00 FORMAT "%13.2" /end CHARACTERISTIC
/begin CHARACTERISTIC CtpCarrFrq_swtConfStdSens_C "" VALUE 0x8025A390 Val_Wu32 4294967295.00 OneToOne 0.00 4294967295.00 FORMAT "%13.2" /end CHARACTERISTIC
/begin CHARACTERISTIC CtpCarrFrq_tiEngOnMin_C "" VALUE 0x8025BAFC Val_Wu32 42949672950.0 Time_ms 0.00 42949672950.0 FORMAT "%13.1" /end CHARACTERISTIC
/begin CHARACTERISTIC CtpCarrFrq_tiPT1Fil_C "" VALUE 0x8025A37C Val_Ws32 4294.9672940000000 TimeDelay_s 0.0000020000000 4294.9672959999998 FORMAT "%19.14" EXTENDED_LIMITS 0.000002000000001 4294.9672959999998 /end CHARACTERISTIC
/begin CHARACTERISTIC CtpCarrFrq_tiPT1_f_C "" VALUE 0x8025A3B4 Val_Wr32 2.00000000E+037 RBPtCel_ti_1p0_2 -1.00000000E+037 1.00000000E+037 FORMAT "%13.3" EXTENDED_LIMITS -3.40282347E+038 3.40282347E+038 /end CHARACTERISTIC
/begin CHARACTERISTIC CtpCarrFrq_tiTempErrOk_C "" VALUE 0x8025BB00 Val_Ws16 655350.0 Time_ms -327680.0 327670.0 FORMAT "%8.1" /end CHARACTERISTIC
/begin CHARACTERISTIC CtpCarrFrq_TransStg_f.Dfl_r32_C " / This is SW-CALPRM-PROTOTYPE" VALUE 0x8025A3B8 Kw_Wr32 2.00000000E+037 RBPtCel_Perc_1p0_1 -1.00000000E+037 1.00000000E+037 FORMAT "%13.3" EXTENDED_LIMITS -3.40282347E+038 3.40282347E+038 /end CHARACTERISTIC
/begin CHARACTERISTIC CtpCarrFrq_TransStg_f.stSensId_C " / This is SW-CALPRM-PROTOTYPE" VALUE 0x8025A3BC Kw_Wu8 255.0 OneToOne 0.00 255.0 FORMAT "%5.1" /end CHARACTERISTIC
/begin CHARACTERISTIC CtpCarrFrq_tSnsrMax_f_C "" VALUE 0x8025BB04 Val_Wr32 2.00000000E+037 RBPtCel_t_1p0_3 -1.00000000E+037 1.00000000E+037 FORMAT "%13.3" EXTENDED_LIMITS -3.40282347E+038 3.40282347E+038 /end CHARACTERISTIC
/begin CHARACTERISTIC CtpCarrFrq_tSnsrMin_f_C "" VALUE 0x8025BB08 Val_Wr32 2.00000000E+037 RBPtCel_t_1p0_3 -1.00000000E+037 1.00000000E+037 FORMAT "%13.3" EXTENDED_LIMITS -3.40282347E+038 3.40282347E+038 /end CHARACTERISTIC
/begin CHARACTERISTIC CtPSwtActr_psDiagDigOut.nrTstPls_C " / Maximum number of test impulses possible in one driving cycle." VALUE 0x80257FE8 Kw_Wu32 4294967295.00 OneToOne 0.00 4294967295.00 FORMAT "%13.2" /end CHARACTERISTIC
/begin CHARACTERISTIC CtPSwtActr_psDiagDigOut.tiBtwElecFlt_C " / Time between test in case a short circuit or open load is detected." VALUE 0x80257FEC Kw_Ws16 655350.0 Time_ms -327680.0 327670.0 FORMAT "%8.1" /end CHARACTERISTIC
/begin CHARACTERISTIC CtPSwtActr_psDiagDigOut.tiBtwOTFlt_C " / Time between test when an over temperature error is detected." VALUE 0x80257FEE Kw_Ws16 655.3500 Time_s -327.6800 327.6700 FORMAT "%8.4" /end CHARACTERISTIC
/begin CHARACTERISTIC CtPSwtActr_rCnv_CUR "" CURVE 0x802500D4 RB_Curve_S16_S16 799.9878 Prc -400.0000 399.9878 FORMAT "%8.4"
 /begin AXIS_DESCR STD_AXIS CtPSwtActr_rActr Prc 25 -400.0000 399.9878 FORMAT "%8.4" DEPOSIT ABSOLUTE /end AXIS_DESCR
/end CHARACTERISTIC
/begin CHARACTERISTIC CtPSwtActr_stActrDis_C "" VALUE 0x802500D0 RB_Val_Wu16 65535.00 OneToOne 0.00 65535.00 FORMAT "%8.2" /end CHARACTERISTIC
/begin CHARACTERISTIC CtPSwtActr_stPwrStgDiaDis_C "" VALUE 0x8025013E RB_Val_Wu16 65535.00 OneToOne 0.00 65535.00 FORMAT "%8.2" /end CHARACTERISTIC
/begin CHARACTERISTIC CtPSwtActr_stPwrStgDis_C "" VALUE 0x8025013A RB_Val_Wu16 65535.00 OneToOne 0.00 65535.00 FORMAT "%8.2" /end CHARACTERISTIC
/begin CHARACTERISTIC CtPSwtActr_swtConfActrCoorrSimple_C "" VALUE 0x802500D2 RB_Val_Wu8 255.0 OneToOne 0.00 255.0 FORMAT "%5.1" /end CHARACTERISTIC
/begin CHARACTERISTIC CtPSwtActr_swtConfActrElecDrvrSimple_C "" VALUE 0x8025013C RB_Val_Wu8 255.0 OneToOne 0.00 255.0 FORMAT "%5.1" /end CHARACTERISTIC
/begin CHARACTERISTIC CtPSwtActr_swtConfActrElecMonSimple_C "" VALUE 0x80250140 RB_Val_Wu8 255.0 OneToOne 0.00 255.0 FORMAT "%5.1" /end CHARACTERISTIC
/begin CHARACTERISTIC CtPSwtActr_swtConfActrPsDrvrSimple_C "" VALUE 0x80250142 RB_Val_Wu8 255.0 OneToOne 0.00 255.0 FORMAT "%5.1" /end CHARACTERISTIC
/begin CHARACTERISTIC CtPSwtActr_tiPt1Mdl_C "" VALUE 0x80250144 RB_Val_Ws32 4294.9672940000000 TimeDelay_s 0.0000020000000 4294.9672959999998 FORMAT "%19.14" EXTENDED_LIMITS 0.000002000000001 4294.9672959999998 /end CHARACTERISTIC
/begin CHARACTERISTIC CtPSwtDiag_ADCCal.numSRCTempSel_C "Calibration structure for ADC and SENT / Selection of temperature for signal range check" VALUE 0x80250148 RB_Val_Wu8 255.000000000 DELIB_ALLTEMP_VERB_COMPU 0.00 255.000000000 FORMAT "%13.9" /end CHARACTERISTIC
/begin CHARACTERISTIC CtPSwtDiag_ADCCal.tiSRCMaxDebOK_C "Calibration structure for ADC and SENT / Error healing deounce time" VALUE 0x8025014C RB_Val_Ws32 42949672950.0 Time_ms -21474836480.0 21474836470.0 FORMAT "%13.1" /end CHARACTERISTIC
/begin CHARACTERISTIC CtPSwtDiag_ADCCal.uSRCMax_C "Calibration structure for ADC and SENT / Maximum threshold voltage for SRC" VALUE 0x80250150 RB_Val_Ws16 13107.00 Volt -6553.600 6553.400 FORMAT "%8.3" /end CHARACTERISTIC
/begin CHARACTERISTIC CtPSwtDiag_ADCCal.uSRCMin_C "Calibration structure for ADC and SENT / Minimum threshold voltage for SRC" VALUE 0x80250152 RB_Val_Ws16 13107.00 Volt -6553.600 6553.400 FORMAT "%8.3" /end CHARACTERISTIC
/begin CHARACTERISTIC CtPSwtDiag_ADCCal.uSRCOpn_C "Calibration structure for ADC and SENT / Maximum threshold for open SRC connection error." VALUE 0x80250154 RB_Val_Ws16 13107.00 Volt -6553.600 6553.400 FORMAT "%8.3" /end CHARACTERISTIC
/begin CHARACTERISTIC CtPSwtDiag_ADCSensTransf_f_CUR "" CURVE 0x80257FF0 RB_Curve_R32_R32_sao 2.00000000E+037 RBPtCel_u_1p0_1 -1.00000000E+037 1.00000000E+037 FORMAT "%13.3" EXTENDED_LIMITS -3.40282347E+038 3.40282347E+038
 /begin AXIS_DESCR STD_AXIS CtPSwtDiag_uRaw_f RBPtCel_u_1p0_2 25 -1.00000000E+037 1.00000000E+037 FORMAT "%13.3" EXTENDED_LIMITS -3.40282347E+038 3.40282347E+038 DEPOSIT ABSOLUTE /end AXIS_DESCR
/end CHARACTERISTIC
/begin CHARACTERISTIC CtPSwtDiag_DigSensCal.tiDebPos_C " / debounce time of rising edge" VALUE 0x80258174 Val_Ws16 655350.0 Time_ms -327680.0 327670.0 FORMAT "%8.1" /end CHARACTERISTIC
/begin CHARACTERISTIC CtPSwtDiag_DigSensCal.tiDebNeg_C " / debounce time of falling edge" VALUE 0x80258176 Val_Ws16 655350.0 Time_ms -327680.0 327670.0 FORMAT "%8.1" /end CHARACTERISTIC
/begin CHARACTERISTIC CtPSwtDiag_duGradLim_f_C "" VALUE 0x80258178 Val_Wr32 2.00000000E+037 RBPtCel_du_1p0_1 -1.00000000E+037 1.00000000E+037 FORMAT "%13.3" EXTENDED_LIMITS -3.40282347E+038 3.40282347E+038 /end CHARACTERISTIC
/begin CHARACTERISTIC CtPSwtDiag_numStdSens_C "" VALUE 0x8025819C Val_Wu32 4294967295.00 OneToOne 0.00 4294967295.00 FORMAT "%13.2" /end CHARACTERISTIC
/begin CHARACTERISTIC CtPSwtDiag_numTempErrDef_C "" VALUE 0x802581A0 Val_Wu8 255.0 OneToOne 0.00 255.0 FORMAT "%5.1" /end CHARACTERISTIC
/begin CHARACTERISTIC CtPSwtDiag_numtSel_C "" VALUE 0x802581A2 Val_Wu16 255.000000000 DELIB_ALLTEMP_VERB_COMPU 0.00 255.000000000 FORMAT "%13.9" /end CHARACTERISTIC
/begin CHARACTERISTIC CtPSwtDiag_RmpSlp_f.Pos_C " / Positive ramp slope dy/dt" VALUE 0x8025817C Kw_Wr32 2.00000000E+038 RBPtCel_du_1p0_1 -1.00000000E+038 1.00000000E+038 FORMAT "%13.3" EXTENDED_LIMITS -3.40282347E+038 3.40282347E+038 /end CHARACTERISTIC
/begin CHARACTERISTIC CtPSwtDiag_RmpSlp_f.Neg_C " / Negative ramp slope dy/dt" VALUE 0x80258180 Kw_Wr32 2.00000000E+038 RBPtCel_du_1p0_1 -1.00000000E+038 1.00000000E+038 FORMAT "%13.3" EXTENDED_LIMITS -3.40282347E+038 3.40282347E+038 /end CHARACTERISTIC
/begin CHARACTERISTIC CtPSwtDiag_stEnhPhysSRCRls_MAP "" MAP 0x802581A4 RB_Map_S16S16_U8_sao 255.0 OneToOne 0.00 255.0 FORMAT "%5.1"
 /begin AXIS_DESCR STD_AXIS Epm_nEng EngN 25 -16384.00 16383.50 FORMAT "%8.2" DEPOSIT ABSOLUTE /end AXIS_DESCR
 /begin AXIS_DESCR STD_AXIS InjCtl_qSetUnBal InjMass 25 -327.6800 327.6700 FORMAT "%8.4" DEPOSIT ABSOLUTE /end AXIS_DESCR
/end CHARACTERISTIC
/begin CHARACTERISTIC CtPSwtDiag_swtConfStdSens2_C "" VALUE 0x80258160 Val_Wu32 4294967295.00 OneToOne 0.00 4294967295.00 FORMAT "%13.2" /end CHARACTERISTIC
/begin CHARACTERISTIC CtPSwtDiag_swtConfStdSensSwVers162_C "" VALUE 0x80258164 Val_Wu32 4294967295.00 OneToOne 0.00 4294967295.00 FORMAT "%13.2" /end CHARACTERISTIC
/begin CHARACTERISTIC CtPSwtDiag_swtConfStdSens_C "" VALUE 0x80258168 Val_Wu32 4294967295.00 OneToOne 0.00 4294967295.00 FORMAT "%13.2" /end CHARACTERISTIC
/begin CHARACTERISTIC CtPSwtDiag_tiEngOnMin_C "" VALUE 0x80258480 Val_Wu32 42949672950.0 Time_ms 0.00 42949672950.0 FORMAT "%13.1" /end CHARACTERISTIC
/begin CHARACTERISTIC CtPSwtDiag_tiPT1Fil_C "" VALUE 0x80258154 Val_Ws32 4294.9672940000000 TimeDelay_s 0.0000020000000 4294.9672959999998 FORMAT "%19.14" EXTENDED_LIMITS 0.000002000000001 4294.9672959999998 /end CHARACTERISTIC
/begin CHARACTERISTIC CtPSwtDiag_tiPT1_f_C "" VALUE 0x80258184 Val_Wr32 2.00000000E+037 RBPtCel_ti_1p0_2 -1.00000000E+037 1.00000000E+037 FORMAT "%13.3" EXTENDED_LIMITS -3.40282347E+038 3.40282347E+038 /end CHARACTERISTIC
/begin CHARACTERISTIC CtPSwtDiag_tiSRCMaxDefDeb_CUR "" CURVE 0x802580BC RB_Curve_S16_S32_sao 42949672950.0 Time_ms -21474836480.0 21474836470.0 FORMAT "%13.1"
 /begin AXIS_DESCR STD_AXIS CtPSwtDiag_tRefSnsr_mp Temp_Cels 25 -3549.940 3003.560 FORMAT "%8.3" DEPOSIT ABSOLUTE /end AXIS_DESCR
/end CHARACTERISTIC
/begin CHARACTERISTIC CtPSwtDiag_tiTempErrOk_C "" VALUE 0x80258484 Val_Ws16 655350.0 Time_ms -327680.0 327670.0 FORMAT "%8.1" /end CHARACTERISTIC
/begin CHARACTERISTIC CtPSwtDiag_TransStg_f.Dfl_r32_C " / This is SW-CALPRM-PROTOTYPE" VALUE 0x80258188 Kw_Wr32 2.00000000E+037 RBPtCel_u_1p0_1 -1.00000000E+037 1.00000000E+037 FORMAT "%13.3" EXTENDED_LIMITS -3.40282347E+038 3.40282347E+038 /end CHARACTERISTIC
/begin CHARACTERISTIC CtPSwtDiag_TransStg_f.stSensId_C " / This is SW-CALPRM-PROTOTYPE" VALUE 0x8025818C Kw_Wu8 255.0 OneToOne 0.00 255.0 FORMAT "%5.1" /end CHARACTERISTIC
/begin CHARACTERISTIC CtPSwtDiag_tSnsrMax_f_C "" VALUE 0x80258488 Val_Wr32 2.00000000E+037 RBPtCel_t_1p0_3 -1.00000000E+037 1.00000000E+037 FORMAT "%13.3" EXTENDED_LIMITS -3.40282347E+038 3.40282347E+038 /end CHARACTERISTIC
/begin CHARACTERISTIC CtPSwtDiag_tSnsrMin_f_C "" VALUE 0x8025848C Val_Wr32 2.00000000E+037 RBPtCel_t_1p0_3 -1.00000000E+037 1.00000000E+037 FORMAT "%13.3" EXTENDED_LIMITS -3.40282347E+038 3.40282347E+038 /end CHARACTERISTIC
/begin CHARACTERISTIC CtPSwtDiag_uDflVal_f_C "" VALUE 0x80258190 Val_Wr32 2.00000000E+037 RBPtCel_u_1p0_1 -1.00000000E+037 1.00000000E+037 FORMAT "%13.3" EXTENDED_LIMITS -3.40282347E+038 3.40282347E+038 /end CHARACTERISTIC
/begin CHARACTERISTIC CtPSwtDiag_uEnhPhysSRCMax_f_MAP "" MAP 0x80258490 RB_Map_S16S16_R32_sao 2.00000000E+037 RBPtCel_u_1p0_1 -1.00000000E+037 1.00000000E+037 FORMAT "%13.3" EXTENDED_LIMITS -3.40282347E+038 3.40282347E+038
 /begin AXIS_DESCR STD_AXIS Epm_nEng EngN 25 -16384.00 16383.50 FORMAT "%8.2" DEPOSIT ABSOLUTE /end AXIS_DESCR
 /begin AXIS_DESCR STD_AXIS InjCtl_qSetUnBal InjMass 25 -327.6800 327.6700 FORMAT "%8.4" DEPOSIT ABSOLUTE /end AXIS_DESCR
/end CHARACTERISTIC
/begin CHARACTERISTIC CtPSwtDiag_uEnhPhysSRCMin_f_MAP "" MAP 0x80258EBC RB_Map_S16S16_R32_sao 2.00000000E+037 RBPtCel_u_1p0_1 -1.00000000E+037 1.00000000E+037 FORMAT "%13.3" EXTENDED_LIMITS -3.40282347E+038 3.40282347E+038
 /begin AXIS_DESCR STD_AXIS Epm_nEng EngN 25 -16384.00 16383.50 FORMAT "%8.2" DEPOSIT ABSOLUTE /end AXIS_DESCR
 /begin AXIS_DESCR STD_AXIS InjCtl_qSetUnBal InjMass 25 -327.6800 327.6700 FORMAT "%8.4" DEPOSIT ABSOLUTE /end AXIS_DESCR
/end CHARACTERISTIC
/begin CHARACTERISTIC CtPSwtDiag_uHiLimit_f_C "" VALUE 0x80258194 Val_Wr32 2.00000000E+037 RBPtCel_u_1p0_1 -1.00000000E+037 1.00000000E+037 FORMAT "%13.3" EXTENDED_LIMITS -3.40282347E+038 3.40282347E+038 /end CHARACTERISTIC
/begin CHARACTERISTIC CtPSwtDiag_uLoLimit_f_C "" VALUE 0x80258198 Val_Wr32 2.00000000E+037 RBPtCel_u_1p0_1 -1.00000000E+037 1.00000000E+037 FORMAT "%13.3" EXTENDED_LIMITS -3.40282347E+038 3.40282347E+038 /end CHARACTERISTIC
/begin CHARACTERISTIC DcChrgnCtrl_iChrgnCntctOpenThd_C "Charging current threshold to open charging contactors" VALUE 0x802501F2 RB_Val_Ws16 2047.969 RBPtCel_i_0p03125_1 -1024.000 1023.969 FORMAT "%8.3" /end CHARACTERISTIC
/begin CHARACTERISTIC DcChrgnCtrl_iPrec_C "Max. precharge current" VALUE 0x802501F4 RB_Val_Ws16 2047.969 RBPtCel_i_0p03125_1 -1024.000 1023.969 FORMAT "%8.3" /end CHARACTERISTIC
/begin CHARACTERISTIC DcChrgnCtrl_stIsoMeasmtDisad_C "Isolation measurement disabled state" VALUE 0x802501F6 RB_Val_Wu8 255.0 OneToOne 0.00 255.0 FORMAT "%5.1" /end CHARACTERISTIC
/begin CHARACTERISTIC DcChrgnCtrl_tiChrgnCntctOpenEmgyMax_C "Maximum time until charging contactors are opened due to critical error" VALUE 0x802501F8 RB_Val_Wu16 655.3500 RBPtCel_ti_0p01_1 0.00 655.3500 FORMAT "%8.4" /end CHARACTERISTIC
/begin CHARACTERISTIC DcChrgnCtrl_tiChrgnCntctOpenMax_C "Maximum time until charging contactors are opened due to minor error" VALUE 0x802501FA RB_Val_Wu16 655.3500 RBPtCel_ti_0p01_1 0.00 655.3500 FORMAT "%8.4" /end CHARACTERISTIC
/begin CHARACTERISTIC DcChrgnCtrl_tiCtrlPltSwtDiMax_C "Maximum time to open S2 switch after response is received from EVSE" VALUE 0x802501FC RB_Val_Ws16 655.3500 RBPtCel_ti_0p01_1 -327.6800 327.6700 FORMAT "%8.4" /end CHARACTERISTIC
/begin CHARACTERISTIC DcChrgnCtrl_tiCtrlPltSwtDiMin_C "Minimum time to open S2 switch after response is received from EVSE" VALUE 0x802501FE RB_Val_Ws16 655.3500 RBPtCel_ti_0p01_1 -327.6800 327.6700 FORMAT "%8.4" /end CHARACTERISTIC
/begin CHARACTERISTIC DcChrgnCtrl_tiDlyRestrt_C "Restart delay time" VALUE 0x80250200 RB_Val_Wu16 655.3500 RBPtCel_ti_0p01_1 0.00 655.3500 FORMAT "%8.4" /end CHARACTERISTIC
/begin CHARACTERISTIC DcChrgnCtrl_tiEvRdyDlyMax_C "Maximum time delay until EV should be ready for charging" VALUE 0x80250202 RB_Val_Wu16 655.3500 RBPtCel_ti_0p01_1 0.00 655.3500 FORMAT "%8.4" /end CHARACTERISTIC
/begin CHARACTERISTIC DcChrgnCtrl_tiExCritErr_C "Time delay to exit critical error state" VALUE 0x80250204 RB_Val_Wu16 655.3500 RBPtCel_ti_0p01_1 0.00 655.3500 FORMAT "%8.4" /end CHARACTERISTIC
/begin CHARACTERISTIC DcChrgnCtrl_tiRespTiOut_C "Timeout for response from charging components" VALUE 0x80250206 RB_Val_Wu16 655.3500 RBPtCel_ti_0p01_1 0.00 655.3500 FORMAT "%8.4" /end CHARACTERISTIC
/begin CHARACTERISTIC DcChrgnCtrl_tiV2GDiReq_C "Delay time to set V2G communication disable request" VALUE 0x80250208 RB_Val_Wu16 655.3500 RBPtCel_ti_0p01_1 0.00 655.3500 FORMAT "%8.4" /end CHARACTERISTIC
/begin CHARACTERISTIC DcChrgnCtrl_tiZrIDmdMin_C "Delay time so that the current demand will be set to zero" VALUE 0x8025020A RB_Val_Wu16 655.3500 RBPtCel_ti_0p01_1 0.00 655.3500 FORMAT "%8.4" /end CHARACTERISTIC
/begin CHARACTERISTIC DcChrgnRlyNegPosn_SwtGDD_I.flgIvt_C "class for digital input acquisition / flag for inverting the status" VALUE 0x80250210 RB_Val_Wu8 255.0 boolean 0.00 255.0 FORMAT "%5.1" /end CHARACTERISTIC
/begin CHARACTERISTIC DcChrgnRlyNegPosn_SwtGDD_I.tiDebHiLo_C "class for digital input acquisition / debounce time for high to low transitions" VALUE 0x80250212 RB_Val_Ws16 655350.0 RBPtCel_ti_10p0_1 -327680.0 327670.0 FORMAT "%8.1" /end CHARACTERISTIC
/begin CHARACTERISTIC DcChrgnRlyNegPosn_SwtGDD_I.tiDebLoHi_C "class for digital input acquisition / debounce time for low to high transitions" VALUE 0x80250214 RB_Val_Ws16 655350.0 RBPtCel_ti_10p0_1 -327680.0 327670.0 FORMAT "%8.1" /end CHARACTERISTIC
/begin CHARACTERISTIC DcChrgnRlyPosPosn_SwtGDD_I.flgIvt_C "class for digital input acquisition / flag for inverting the status" VALUE 0x8025021C RB_Val_Wu8 255.0 boolean 0.00 255.0 FORMAT "%5.1" /end CHARACTERISTIC
/begin CHARACTERISTIC DcChrgnRlyPosPosn_SwtGDD_I.tiDebHiLo_C "class for digital input acquisition / debounce time for high to low transitions" VALUE 0x8025021E RB_Val_Ws16 655350.0 RBPtCel_ti_10p0_1 -327680.0 327670.0 FORMAT "%8.1" /end CHARACTERISTIC
/begin CHARACTERISTIC DcChrgnRlyPosPosn_SwtGDD_I.tiDebLoHi_C "class for digital input acquisition / debounce time for low to high transitions" VALUE 0x80250220 RB_Val_Ws16 655350.0 RBPtCel_ti_10p0_1 -327680.0 327670.0 FORMAT "%8.1" /end CHARACTERISTIC
/begin CHARACTERISTIC DcChrgrIntkT2_ADCCal.numSRCTempSel_C "Calibration structure for ADC and SENT / Selection of temperature for signal range check" VALUE 0x80250224 RB_Val_Wu8 255.000000000 DELIB_ALLTEMP_VERB_COMPU 0.00 255.000000000 FORMAT "%13.9" /end CHARACTERISTIC
/begin CHARACTERISTIC DcChrgrIntkT2_ADCCal.tiSRCMaxDebOK_C "Calibration structure for ADC and SENT / Error healing deounce time" VALUE 0x80250228 RB_Val_Ws32 42949672950.0 Time_ms -21474836480.0 21474836470.0 FORMAT "%13.1" /end CHARACTERISTIC
/begin CHARACTERISTIC DcChrgrIntkT2_ADCCal.uSRCMax_C "Calibration structure for ADC and SENT / Maximum threshold voltage for SRC" VALUE 0x8025022C RB_Val_Ws16 13107.00 Volt -6553.600 6553.400 FORMAT "%8.3" /end CHARACTERISTIC
/begin CHARACTERISTIC DcChrgrIntkT2_ADCCal.uSRCMin_C "Calibration structure for ADC and SENT / Minimum threshold voltage for SRC" VALUE 0x8025022E RB_Val_Ws16 13107.00 Volt -6553.600 6553.400 FORMAT "%8.3" /end CHARACTERISTIC
/begin CHARACTERISTIC DcChrgrIntkT2_ADCCal.uSRCOpn_C "Calibration structure for ADC and SENT / Maximum threshold for open SRC connection error." VALUE 0x80250230 RB_Val_Ws16 13107.00 Volt -6553.600 6553.400 FORMAT "%8.3" /end CHARACTERISTIC
/begin CHARACTERISTIC DcChrgrIntkT2_ADCSensTransf_f_CUR "" CURVE 0x8025BB3C RB_Curve_R32_R32_sao 2.00000000E+037 RBPtCel_t_1p0_3 -1.00000000E+037 1.00000000E+037 FORMAT "%13.3" EXTENDED_LIMITS -3.40282347E+038 3.40282347E+038
 /begin AXIS_DESCR STD_AXIS DcChrgrIntkT2_uRaw_f RBPtCel_u_1p0_2 25 -1.00000000E+037 1.00000000E+037 FORMAT "%13.3" EXTENDED_LIMITS -3.40282347E+038 3.40282347E+038 DEPOSIT ABSOLUTE /end AXIS_DESCR
/end CHARACTERISTIC
/begin CHARACTERISTIC DcChrgrIntkT2_DigSensCal.tiDebPos_C " / debounce time of rising edge" VALUE 0x8025BCC0 Val_Ws16 655350.0 Time_ms -327680.0 327670.0 FORMAT "%8.1" /end CHARACTERISTIC
/begin CHARACTERISTIC DcChrgrIntkT2_DigSensCal.tiDebNeg_C " / debounce time of falling edge" VALUE 0x8025BCC2 Val_Ws16 655350.0 Time_ms -327680.0 327670.0 FORMAT "%8.1" /end CHARACTERISTIC
/begin CHARACTERISTIC DcChrgrIntkT2_dtGradLim_f_C "" VALUE 0x8025BCC4 Val_Wr32 2.00000000E+037 RBPtCel_dt_1p0_1 -1.00000000E+037 1.00000000E+037 FORMAT "%13.3" EXTENDED_LIMITS -3.40282347E+038 3.40282347E+038 /end CHARACTERISTIC
/begin CHARACTERISTIC DcChrgrIntkT2_numStdSens_C "" VALUE 0x8025BCE8 Val_Wu32 4294967295.00 OneToOne 0.00 4294967295.00 FORMAT "%13.2" /end CHARACTERISTIC
/begin CHARACTERISTIC DcChrgrIntkT2_numTempErrDef_C "" VALUE 0x8025BCEC Val_Wu8 255.0 OneToOne 0.00 255.0 FORMAT "%5.1" /end CHARACTERISTIC
/begin CHARACTERISTIC DcChrgrIntkT2_numtSel_C "" VALUE 0x8025BCEE Val_Wu16 255.000000000 DELIB_ALLTEMP_VERB_COMPU 0.00 255.000000000 FORMAT "%13.9" /end CHARACTERISTIC
/begin CHARACTERISTIC DcChrgrIntkT2_RmpSlp_f.Pos_C " / Positive ramp slope dy/dt" VALUE 0x8025BCC8 Kw_Wr32 2.00000000E+038 RBPtCel_dt_1p0_1 -1.00000000E+038 1.00000000E+038 FORMAT "%13.3" EXTENDED_LIMITS -3.40282347E+038 3.40282347E+038 /end CHARACTERISTIC
/begin CHARACTERISTIC DcChrgrIntkT2_RmpSlp_f.Neg_C " / Negative ramp slope dy/dt" VALUE 0x8025BCCC Kw_Wr32 2.00000000E+038 RBPtCel_dt_1p0_1 -1.00000000E+038 1.00000000E+038 FORMAT "%13.3" EXTENDED_LIMITS -3.40282347E+038 3.40282347E+038 /end CHARACTERISTIC
/begin CHARACTERISTIC DcChrgrIntkT2_stEnhPhysSRCRls_MAP "" MAP 0x8025BCF0 RB_Map_S16S16_U8_sao 255.0 OneToOne 0.00 255.0 FORMAT "%5.1"
 /begin AXIS_DESCR STD_AXIS Epm_nEng EngN 25 -16384.00 16383.50 FORMAT "%8.2" DEPOSIT ABSOLUTE /end AXIS_DESCR
 /begin AXIS_DESCR STD_AXIS InjCtl_qSetUnBal InjMass 25 -327.6800 327.6700 FORMAT "%8.4" DEPOSIT ABSOLUTE /end AXIS_DESCR
/end CHARACTERISTIC
/begin CHARACTERISTIC DcChrgrIntkT2_swtConfStdSens2_C "" VALUE 0x8025BCAC Val_Wu32 4294967295.00 OneToOne 0.00 4294967295.00 FORMAT "%13.2" /end CHARACTERISTIC
/begin CHARACTERISTIC DcChrgrIntkT2_swtConfStdSensSwVers162_C "" VALUE 0x8025BCB0 Val_Wu32 4294967295.00 OneToOne 0.00 4294967295.00 FORMAT "%13.2" /end CHARACTERISTIC
/begin CHARACTERISTIC DcChrgrIntkT2_swtConfStdSens_C "" VALUE 0x8025BCB4 Val_Wu32 4294967295.00 OneToOne 0.00 4294967295.00 FORMAT "%13.2" /end CHARACTERISTIC
/begin CHARACTERISTIC DcChrgrIntkT2_tDflVal_f_C "" VALUE 0x8025BCD0 Val_Wr32 2.00000000E+037 RBPtCel_t_1p0_3 -1.00000000E+037 1.00000000E+037 FORMAT "%13.3" EXTENDED_LIMITS -3.40282347E+038 3.40282347E+038 /end CHARACTERISTIC
/begin CHARACTERISTIC DcChrgrIntkT2_tEnhPhysSRCMax_f_MAP "" MAP 0x8025BFCC RB_Map_S16S16_R32_sao 2.00000000E+037 RBPtCel_t_1p0_3 -1.00000000E+037 1.00000000E+037 FORMAT "%13.3" EXTENDED_LIMITS -3.40282347E+038 3.40282347E+038
 /begin AXIS_DESCR STD_AXIS Epm_nEng EngN 25 -16384.00 16383.50 FORMAT "%8.2" DEPOSIT ABSOLUTE /end AXIS_DESCR
 /begin AXIS_DESCR STD_AXIS InjCtl_qSetUnBal InjMass 25 -327.6800 327.6700 FORMAT "%8.4" DEPOSIT ABSOLUTE /end AXIS_DESCR
/end CHARACTERISTIC
/begin CHARACTERISTIC DcChrgrIntkT2_tEnhPhysSRCMin_f_MAP "" MAP 0x8025C9F8 RB_Map_S16S16_R32_sao 2.00000000E+037 RBPtCel_t_1p0_3 -1.00000000E+037 1.00000000E+037 FORMAT "%13.3" EXTENDED_LIMITS -3.40282347E+038 3.40282347E+038
 /begin AXIS_DESCR STD_AXIS Epm_nEng EngN 25 -16384.00 16383.50 FORMAT "%8.2" DEPOSIT ABSOLUTE /end AXIS_DESCR
 /begin AXIS_DESCR STD_AXIS InjCtl_qSetUnBal InjMass 25 -327.6800 327.6700 FORMAT "%8.4" DEPOSIT ABSOLUTE /end AXIS_DESCR
/end CHARACTERISTIC
/begin CHARACTERISTIC DcChrgrIntkT2_tHiLimit_f_C "" VALUE 0x8025BCD4 Val_Wr32 2.00000000E+037 RBPtCel_t_1p0_3 -1.00000000E+037 1.00000000E+037 FORMAT "%13.3" EXTENDED_LIMITS -3.40282347E+038 3.40282347E+038 /end CHARACTERISTIC
/begin CHARACTERISTIC DcChrgrIntkT2_tiEngOnMin_C "" VALUE 0x8025D424 Val_Wu32 42949672950.0 Time_ms 0.00 42949672950.0 FORMAT "%13.1" /end CHARACTERISTIC
/begin CHARACTERISTIC DcChrgrIntkT2_tiPT1Fil_C "" VALUE 0x8025BCA0 Val_Ws32 4294.9672940000000 TimeDelay_s 0.0000020000000 4294.9672959999998 FORMAT "%19.14" EXTENDED_LIMITS 0.000002000000001 4294.9672959999998 /end CHARACTERISTIC
/begin CHARACTERISTIC DcChrgrIntkT2_tiPT1_f_C "" VALUE 0x8025BCD8 Val_Wr32 2.00000000E+037 RBPtCel_ti_1p0_2 -1.00000000E+037 1.00000000E+037 FORMAT "%13.3" EXTENDED_LIMITS -3.40282347E+038 3.40282347E+038 /end CHARACTERISTIC
/begin CHARACTERISTIC DcChrgrIntkT2_tiSRCMaxDefDeb_CUR "" CURVE 0x8025BC08 RB_Curve_S16_S32_sao 42949672950.0 Time_ms -21474836480.0 21474836470.0 FORMAT "%13.1"
 /begin AXIS_DESCR STD_AXIS DcChrgrIntkT2_tRefSnsr_mp Temp_Cels 25 -3549.940 3003.560 FORMAT "%8.3" DEPOSIT ABSOLUTE /end AXIS_DESCR
/end CHARACTERISTIC
/begin CHARACTERISTIC DcChrgrIntkT2_tiTempErrOk_C "" VALUE 0x8025D428 Val_Ws16 655350.0 Time_ms -327680.0 327670.0 FORMAT "%8.1" /end CHARACTERISTIC
/begin CHARACTERISTIC DcChrgrIntkT2_tLoLimit_f_C "" VALUE 0x8025BCDC Val_Wr32 2.00000000E+037 RBPtCel_t_1p0_3 -1.00000000E+037 1.00000000E+037 FORMAT "%13.3" EXTENDED_LIMITS -3.40282347E+038 3.40282347E+038 /end CHARACTERISTIC
/begin CHARACTERISTIC DcChrgrIntkT2_TransStg_f.Dfl_r32_C " / This is SW-CALPRM-PROTOTYPE" VALUE 0x8025BCE0 Kw_Wr32 2.00000000E+037 RBPtCel_t_1p0_3 -1.00000000E+037 1.00000000E+037 FORMAT "%13.3" EXTENDED_LIMITS -3.40282347E+038 3.40282347E+038 /end CHARACTERISTIC
/begin CHARACTERISTIC DcChrgrIntkT2_TransStg_f.stSensId_C " / This is SW-CALPRM-PROTOTYPE" VALUE 0x8025BCE4 Kw_Wu8 255.0 OneToOne 0.00 255.0 FORMAT "%5.1" /end CHARACTERISTIC
/begin CHARACTERISTIC DcChrgrIntkT2_tSnsrMax_f_C "" VALUE 0x8025D42C Val_Wr32 2.00000000E+037 RBPtCel_t_1p0_3 -1.00000000E+037 1.00000000E+037 FORMAT "%13.3" EXTENDED_LIMITS -3.40282347E+038 3.40282347E+038 /end CHARACTERISTIC
/begin CHARACTERISTIC DcChrgrIntkT2_tSnsrMin_f_C "" VALUE 0x8025D430 Val_Wr32 2.00000000E+037 RBPtCel_t_1p0_3 -1.00000000E+037 1.00000000E+037 FORMAT "%13.3" EXTENDED_LIMITS -3.40282347E+038 3.40282347E+038 /end CHARACTERISTIC
/begin CHARACTERISTIC DcChrgrIntkT_ADCCal.numSRCTempSel_C "Calibration structure for ADC and SENT / Selection of temperature for signal range check" VALUE 0x80250234 RB_Val_Wu8 255.000000000 DELIB_ALLTEMP_VERB_COMPU 0.00 255.000000000 FORMAT "%13.9" /end CHARACTERISTIC
/begin CHARACTERISTIC DcChrgrIntkT_ADCCal.tiSRCMaxDebOK_C "Calibration structure for ADC and SENT / Error healing deounce time" VALUE 0x80250238 RB_Val_Ws32 42949672950.0 Time_ms -21474836480.0 21474836470.0 FORMAT "%13.1" /end CHARACTERISTIC
/begin CHARACTERISTIC DcChrgrIntkT_ADCCal.uSRCMax_C "Calibration structure for ADC and SENT / Maximum threshold voltage for SRC" VALUE 0x8025023C RB_Val_Ws16 13107.00 Volt -6553.600 6553.400 FORMAT "%8.3" /end CHARACTERISTIC
/begin CHARACTERISTIC DcChrgrIntkT_ADCCal.uSRCMin_C "Calibration structure for ADC and SENT / Minimum threshold voltage for SRC" VALUE 0x8025023E RB_Val_Ws16 13107.00 Volt -6553.600 6553.400 FORMAT "%8.3" /end CHARACTERISTIC
/begin CHARACTERISTIC DcChrgrIntkT_ADCCal.uSRCOpn_C "Calibration structure for ADC and SENT / Maximum threshold for open SRC connection error." VALUE 0x80250240 RB_Val_Ws16 13107.00 Volt -6553.600 6553.400 FORMAT "%8.3" /end CHARACTERISTIC
/begin CHARACTERISTIC DcChrgrIntkT_ADCSensTransf_f_CUR "" CURVE 0x8025D434 RB_Curve_R32_R32_sao 2.00000000E+037 RBPtCel_t_1p0_3 -1.00000000E+037 1.00000000E+037 FORMAT "%13.3" EXTENDED_LIMITS -3.40282347E+038 3.40282347E+038
 /begin AXIS_DESCR STD_AXIS DcChrgrIntkT_uRaw_f RBPtCel_u_1p0_2 25 -1.00000000E+037 1.00000000E+037 FORMAT "%13.3" EXTENDED_LIMITS -3.40282347E+038 3.40282347E+038 DEPOSIT ABSOLUTE /end AXIS_DESCR
/end CHARACTERISTIC
/begin CHARACTERISTIC DcChrgrIntkT_DigSensCal.tiDebPos_C " / debounce time of rising edge" VALUE 0x8025D5B8 Val_Ws16 655350.0 Time_ms -327680.0 327670.0 FORMAT "%8.1" /end CHARACTERISTIC
/begin CHARACTERISTIC DcChrgrIntkT_DigSensCal.tiDebNeg_C " / debounce time of falling edge" VALUE 0x8025D5BA Val_Ws16 655350.0 Time_ms -327680.0 327670.0 FORMAT "%8.1" /end CHARACTERISTIC
/begin CHARACTERISTIC DcChrgrIntkT_dtGradLim_f_C "" VALUE 0x8025D5BC Val_Wr32 2.00000000E+037 RBPtCel_dt_1p0_1 -1.00000000E+037 1.00000000E+037 FORMAT "%13.3" EXTENDED_LIMITS -3.40282347E+038 3.40282347E+038 /end CHARACTERISTIC
/begin CHARACTERISTIC DcChrgrIntkT_numStdSens_C "" VALUE 0x8025D5E0 Val_Wu32 4294967295.00 OneToOne 0.00 4294967295.00 FORMAT "%13.2" /end CHARACTERISTIC
/begin CHARACTERISTIC DcChrgrIntkT_numTempErrDef_C "" VALUE 0x8025D5E4 Val_Wu8 255.0 OneToOne 0.00 255.0 FORMAT "%5.1" /end CHARACTERISTIC
/begin CHARACTERISTIC DcChrgrIntkT_numtSel_C "" VALUE 0x8025D5E6 Val_Wu16 255.000000000 DELIB_ALLTEMP_VERB_COMPU 0.00 255.000000000 FORMAT "%13.9" /end CHARACTERISTIC
/begin CHARACTERISTIC DcChrgrIntkT_RmpSlp_f.Pos_C " / Positive ramp slope dy/dt" VALUE 0x8025D5C0 Kw_Wr32 2.00000000E+038 RBPtCel_dt_1p0_1 -1.00000000E+038 1.00000000E+038 FORMAT "%13.3" EXTENDED_LIMITS -3.40282347E+038 3.40282347E+038 /end CHARACTERISTIC
/begin CHARACTERISTIC DcChrgrIntkT_RmpSlp_f.Neg_C " / Negative ramp slope dy/dt" VALUE 0x8025D5C4 Kw_Wr32 2.00000000E+038 RBPtCel_dt_1p0_1 -1.00000000E+038 1.00000000E+038 FORMAT "%13.3" EXTENDED_LIMITS -3.40282347E+038 3.40282347E+038 /end CHARACTERISTIC
/begin CHARACTERISTIC DcChrgrIntkT_stEnhPhysSRCRls_MAP "" MAP 0x8025D5E8 RB_Map_S16S16_U8_sao 255.0 OneToOne 0.00 255.0 FORMAT "%5.1"
 /begin AXIS_DESCR STD_AXIS Epm_nEng EngN 25 -16384.00 16383.50 FORMAT "%8.2" DEPOSIT ABSOLUTE /end AXIS_DESCR
 /begin AXIS_DESCR STD_AXIS InjCtl_qSetUnBal InjMass 25 -327.6800 327.6700 FORMAT "%8.4" DEPOSIT ABSOLUTE /end AXIS_DESCR
/end CHARACTERISTIC
/begin CHARACTERISTIC DcChrgrIntkT_swtConfStdSens2_C "" VALUE 0x8025D5A4 Val_Wu32 4294967295.00 OneToOne 0.00 4294967295.00 FORMAT "%13.2" /end CHARACTERISTIC
/begin CHARACTERISTIC DcChrgrIntkT_swtConfStdSensSwVers162_C "" VALUE 0x8025D5A8 Val_Wu32 4294967295.00 OneToOne 0.00 4294967295.00 FORMAT "%13.2" /end CHARACTERISTIC
/begin CHARACTERISTIC DcChrgrIntkT_swtConfStdSens_C "" VALUE 0x8025D5AC Val_Wu32 4294967295.00 OneToOne 0.00 4294967295.00 FORMAT "%13.2" /end CHARACTERISTIC
/begin CHARACTERISTIC DcChrgrIntkT_tDflVal_f_C "" VALUE 0x8025D5C8 Val_Wr32 2.00000000E+037 RBPtCel_t_1p0_3 -1.00000000E+037 1.00000000E+037 FORMAT "%13.3" EXTENDED_LIMITS -3.40282347E+038 3.40282347E+038 /end CHARACTERISTIC
/begin CHARACTERISTIC DcChrgrIntkT_tEnhPhysSRCMax_f_MAP "" MAP 0x8025D8C4 RB_Map_S16S16_R32_sao 2.00000000E+037 RBPtCel_t_1p0_3 -1.00000000E+037 1.00000000E+037 FORMAT "%13.3" EXTENDED_LIMITS -3.40282347E+038 3.40282347E+038
 /begin AXIS_DESCR STD_AXIS Epm_nEng EngN 25 -16384.00 16383.50 FORMAT "%8.2" DEPOSIT ABSOLUTE /end AXIS_DESCR
 /begin AXIS_DESCR STD_AXIS InjCtl_qSetUnBal InjMass 25 -327.6800 327.6700 FORMAT "%8.4" DEPOSIT ABSOLUTE /end AXIS_DESCR
/end CHARACTERISTIC
/begin CHARACTERISTIC DcChrgrIntkT_tEnhPhysSRCMin_f_MAP "" MAP 0x8025E2F0 RB_Map_S16S16_R32_sao 2.00000000E+037 RBPtCel_t_1p0_3 -1.00000000E+037 1.00000000E+037 FORMAT "%13.3" EXTENDED_LIMITS -3.40282347E+038 3.40282347E+038
 /begin AXIS_DESCR STD_AXIS Epm_nEng EngN 25 -16384.00 16383.50 FORMAT "%8.2" DEPOSIT ABSOLUTE /end AXIS_DESCR
 /begin AXIS_DESCR STD_AXIS InjCtl_qSetUnBal InjMass 25 -327.6800 327.6700 FORMAT "%8.4" DEPOSIT ABSOLUTE /end AXIS_DESCR
/end CHARACTERISTIC
/begin CHARACTERISTIC DcChrgrIntkT_tHiLimit_f_C "" VALUE 0x8025D5CC Val_Wr32 2.00000000E+037 RBPtCel_t_1p0_3 -1.00000000E+037 1.00000000E+037 FORMAT "%13.3" EXTENDED_LIMITS -3.40282347E+038 3.40282347E+038 /end CHARACTERISTIC
/begin CHARACTERISTIC DcChrgrIntkT_tiEngOnMin_C "" VALUE 0x8025ED1C Val_Wu32 42949672950.0 Time_ms 0.00 42949672950.0 FORMAT "%13.1" /end CHARACTERISTIC
/begin CHARACTERISTIC DcChrgrIntkT_tiPT1Fil_C "" VALUE 0x8025D598 Val_Ws32 4294.9672940000000 TimeDelay_s 0.0000020000000 4294.9672959999998 FORMAT "%19.14" EXTENDED_LIMITS 0.000002000000001 4294.9672959999998 /end CHARACTERISTIC
/begin CHARACTERISTIC DcChrgrIntkT_tiPT1_f_C "" VALUE 0x8025D5D0 Val_Wr32 2.00000000E+037 RBPtCel_ti_1p0_2 -1.00000000E+037 1.00000000E+037 FORMAT "%13.3" EXTENDED_LIMITS -3.40282347E+038 3.40282347E+038 /end CHARACTERISTIC
/begin CHARACTERISTIC DcChrgrIntkT_tiSRCMaxDefDeb_CUR "" CURVE 0x8025D500 RB_Curve_S16_S32_sao 42949672950.0 Time_ms -21474836480.0 21474836470.0 FORMAT "%13.1"
 /begin AXIS_DESCR STD_AXIS DcChrgrIntkT_tRefSnsr_mp Temp_Cels 25 -3549.940 3003.560 FORMAT "%8.3" DEPOSIT ABSOLUTE /end AXIS_DESCR
/end CHARACTERISTIC
/begin CHARACTERISTIC DcChrgrIntkT_tiTempErrOk_C "" VALUE 0x8025ED20 Val_Ws16 655350.0 Time_ms -327680.0 327670.0 FORMAT "%8.1" /end CHARACTERISTIC
/begin CHARACTERISTIC DcChrgrIntkT_tLoLimit_f_C "" VALUE 0x8025D5D4 Val_Wr32 2.00000000E+037 RBPtCel_t_1p0_3 -1.00000000E+037 1.00000000E+037 FORMAT "%13.3" EXTENDED_LIMITS -3.40282347E+038 3.40282347E+038 /end CHARACTERISTIC
/begin CHARACTERISTIC DcChrgrIntkT_TransStg_f.Dfl_r32_C " / This is SW-CALPRM-PROTOTYPE" VALUE 0x8025D5D8 Kw_Wr32 2.00000000E+037 RBPtCel_t_1p0_3 -1.00000000E+037 1.00000000E+037 FORMAT "%13.3" EXTENDED_LIMITS -3.40282347E+038 3.40282347E+038 /end CHARACTERISTIC
/begin CHARACTERISTIC DcChrgrIntkT_TransStg_f.stSensId_C " / This is SW-CALPRM-PROTOTYPE" VALUE 0x8025D5DC Kw_Wu8 255.0 OneToOne 0.00 255.0 FORMAT "%5.1" /end CHARACTERISTIC
/begin CHARACTERISTIC DcChrgrIntkT_tSnsrMax_f_C "" VALUE 0x8025ED24 Val_Wr32 2.00000000E+037 RBPtCel_t_1p0_3 -1.00000000E+037 1.00000000E+037 FORMAT "%13.3" EXTENDED_LIMITS -3.40282347E+038 3.40282347E+038 /end CHARACTERISTIC
/begin CHARACTERISTIC DcChrgrIntkT_tSnsrMin_f_C "" VALUE 0x8025ED28 Val_Wr32 2.00000000E+037 RBPtCel_t_1p0_3 -1.00000000E+037 1.00000000E+037 FORMAT "%13.3" EXTENDED_LIMITS -3.40282347E+038 3.40282347E+038 /end CHARACTERISTIC
/begin CHARACTERISTIC Dcdc_facEffDcDc_T "Efficency table for DcDc" CURVE 0x8025025C RB_Curve_S16_S16 2.000031 PSC_Fact -1.000031 1.000000 FORMAT "%8.6"
 /begin AXIS_DESCR STD_AXIS NO_INPUT_QUANTITY RBPtCel_pwr_25p0_1 7 -819200.0 819175.0 FORMAT "%8.1" DEPOSIT ABSOLUTE /end AXIS_DESCR
/end CHARACTERISTIC
/begin CHARACTERISTIC Dcdc_maskCanInputSq_C "Bitmask defining signal quality states for which a signal is considered valid" VALUE 0x80250258 RB_Val_Wu16 65535.00 OneToOne 0.00 65535.00 FORMAT "%8.2" /end CHARACTERISTIC
/begin CHARACTERISTIC Dcdc_pwrActPred_T "Ramp rate from actual to predicted power" CURVE 0x80250244 RB_Curve_S16_S16 1638375. RBPtCel_pwr_25p0_1 -819200.0 819175.0 FORMAT "%8.1"
 /begin AXIS_DESCR STD_AXIS Dcdc_pwrHvAct RBPtCel_pwr_25p0_1 4 -819200.0 819175.0 FORMAT "%8.1" DEPOSIT ABSOLUTE /end AXIS_DESCR
/end CHARACTERISTIC
/begin CHARACTERISTIC Dcdc_pwrLoadMngtFltPred_C "Predicted value for maximum power in case of disabled calculation" VALUE 0x80250256 RB_Val_Ws16 1638375. RBPtCel_pwr_25p0_1 -819200.0 819175.0 FORMAT "%8.1" /end CHARACTERISTIC
/begin CHARACTERISTIC Dcdc_SwtSrcPwrHvAct_C "Calibration for selecting Hv inputs for power calculation" VALUE 0x8025027A RB_Val_Wu8 1.00000000000 B_TRUE 0.00 1.00000000000 FORMAT "%13.11" /end CHARACTERISTIC
/begin CHARACTERISTIC Dcdc_uLvDiffTolrThd_C "Allowed tolerance for diagnosis of desired LV voltage and actual LV voltage." VALUE 0x8025025A RB_Val_Ws16 255.9961 spg_q0p0039 -128.0000 127.9961 FORMAT "%8.4" /end CHARACTERISTIC
/begin CHARACTERISTIC DDRC_DurDeb.CtPSwtActr_tiMonDFCDebOk_C "" VALUE 0x8024094C Val_Wu16 655350.0 DDRCTime_ms 0.00 655350.0 FORMAT "%8.1" /end CHARACTERISTIC
/begin CHARACTERISTIC DDRC_DurDeb.CtPSwtActr_tiMonDFCDebDef_C "" VALUE 0x8024094E Val_Wu16 655350.0 DDRCTime_ms 0.00 655350.0 FORMAT "%8.1" /end CHARACTERISTIC
/begin CHARACTERISTIC DDRC_DurDeb.CtPSwtDiag_tiSRCMinDebOk_C "" VALUE 0x80240950 Val_Wu16 655350.0 DDRCTime_ms 0.00 655350.0 FORMAT "%8.1" /end CHARACTERISTIC
/begin CHARACTERISTIC DDRC_DurDeb.CtPSwtDiag_tiSRCMinDebDef_C "" VALUE 0x80240952 Val_Wu16 655350.0 DDRCTime_ms 0.00 655350.0 FORMAT "%8.1" /end CHARACTERISTIC
/begin CHARACTERISTIC DDRC_DurDeb.CtpCarrFrq_tiSRCMinDebOk_C "" VALUE 0x80240954 Val_Wu16 655350.0 DDRCTime_ms 0.00 655350.0 FORMAT "%8.1" /end CHARACTERISTIC
/begin CHARACTERISTIC DDRC_DurDeb.CtpCarrFrq_tiSRCMinDebDef_C "" VALUE 0x80240956 Val_Wu16 655350.0 DDRCTime_ms 0.00 655350.0 FORMAT "%8.1" /end CHARACTERISTIC
/begin CHARACTERISTIC DDRC_DurDeb.DcChrgrIntkT2_tiSRCMinDebOk_C "" VALUE 0x80240958 Val_Wu16 655350.0 DDRCTime_ms 0.00 655350.0 FORMAT "%8.1" /end CHARACTERISTIC
/begin CHARACTERISTIC DDRC_DurDeb.DcChrgrIntkT2_tiSRCMinDebDef_C "" VALUE 0x8024095A Val_Wu16 655350.0 DDRCTime_ms 0.00 655350.0 FORMAT "%8.1" /end CHARACTERISTIC
/begin CHARACTERISTIC DDRC_DurDeb.DcChrgrIntkT_tiSRCMinDebOk_C "" VALUE 0x8024095C Val_Wu16 655350.0 DDRCTime_ms 0.00 655350.0 FORMAT "%8.1" /end CHARACTERISTIC
/begin CHARACTERISTIC DDRC_DurDeb.DcChrgrIntkT_tiSRCMinDebDef_C "" VALUE 0x8024095E Val_Wu16 655350.0 DDRCTime_ms 0.00 655350.0 FORMAT "%8.1" /end CHARACTERISTIC
/begin CHARACTERISTIC DDRC_DurDeb.CtPSwtDiag_tiPhysRngHiDebOk_C "" VALUE 0x802409F0 Val_Wu16 655350.0 DDRCTime_ms 0.00 655350.0 FORMAT "%8.1" /end CHARACTERISTIC
/begin CHARACTERISTIC DDRC_DurDeb.CtPSwtDiag_tiPhysRngHiDebDef_C "" VALUE 0x802409F2 Val_Wu16 655350.0 DDRCTime_ms 0.00 655350.0 FORMAT "%8.1" /end CHARACTERISTIC
/begin CHARACTERISTIC DDRC_DurDeb.CtPSwtDiag_tiPhysRngLoDebOk_C "" VALUE 0x802409F4 Val_Wu16 655350.0 DDRCTime_ms 0.00 655350.0 FORMAT "%8.1" /end CHARACTERISTIC
/begin CHARACTERISTIC DDRC_DurDeb.CtPSwtDiag_tiPhysRngLoDebDef_C "" VALUE 0x802409F6 Val_Wu16 655350.0 DDRCTime_ms 0.00 655350.0 FORMAT "%8.1" /end CHARACTERISTIC
/begin CHARACTERISTIC DDRC_DurDeb.CtPSwtDiag_tiSRCOpnDebOk_C "" VALUE 0x802409F8 Val_Wu16 655350.0 DDRCTime_ms 0.00 655350.0 FORMAT "%8.1" /end CHARACTERISTIC
/begin CHARACTERISTIC DDRC_DurDeb.CtPSwtDiag_tiSRCOpnDebDef_C "" VALUE 0x802409FA Val_Wu16 655350.0 DDRCTime_ms 0.00 655350.0 FORMAT "%8.1" /end CHARACTERISTIC
/begin CHARACTERISTIC DDRC_DurDeb.CtpCarrFrq_tiPhysRngHiDebOk_C "" VALUE 0x802409FC Val_Wu16 655350.0 DDRCTime_ms 0.00 655350.0 FORMAT "%8.1" /end CHARACTERISTIC
/begin CHARACTERISTIC DDRC_DurDeb.CtpCarrFrq_tiPhysRngHiDebDef_C "" VALUE 0x802409FE Val_Wu16 655350.0 DDRCTime_ms 0.00 655350.0 FORMAT "%8.1" /end CHARACTERISTIC
/begin CHARACTERISTIC DDRC_DurDeb.CtpCarrFrq_tiPhysRngLoDebOk_C "" VALUE 0x80240A00 Val_Wu16 655350.0 DDRCTime_ms 0.00 655350.0 FORMAT "%8.1" /end CHARACTERISTIC
/begin CHARACTERISTIC DDRC_DurDeb.CtpCarrFrq_tiPhysRngLoDebDef_C "" VALUE 0x80240A02 Val_Wu16 655350.0 DDRCTime_ms 0.00 655350.0 FORMAT "%8.1" /end CHARACTERISTIC
/begin CHARACTERISTIC DDRC_DurDeb.CtpCarrFrq_tiSRCMaxDebOk_C "" VALUE 0x80240A04 Val_Wu16 655350.0 DDRCTime_ms 0.00 655350.0 FORMAT "%8.1" /end CHARACTERISTIC
/begin CHARACTERISTIC DDRC_DurDeb.CtpCarrFrq_tiSRCMaxDebDef_C "" VALUE 0x80240A06 Val_Wu16 655350.0 DDRCTime_ms 0.00 655350.0 FORMAT "%8.1" /end CHARACTERISTIC
/begin CHARACTERISTIC DDRC_DurDeb.DcChrgrIntkT2_tiPhysRngHiDebOk_C "" VALUE 0x80240A08 Val_Wu16 655350.0 DDRCTime_ms 0.00 655350.0 FORMAT "%8.1" /end CHARACTERISTIC
/begin CHARACTERISTIC DDRC_DurDeb.DcChrgrIntkT2_tiPhysRngHiDebDef_C "" VALUE 0x80240A0A Val_Wu16 655350.0 DDRCTime_ms 0.00 655350.0 FORMAT "%8.1" /end CHARACTERISTIC
/begin CHARACTERISTIC DDRC_DurDeb.DcChrgrIntkT2_tiPhysRngLoDebOk_C "" VALUE 0x80240A0C Val_Wu16 655350.0 DDRCTime_ms 0.00 655350.0 FORMAT "%8.1" /end CHARACTERISTIC
/begin CHARACTERISTIC DDRC_DurDeb.DcChrgrIntkT2_tiPhysRngLoDebDef_C "" VALUE 0x80240A0E Val_Wu16 655350.0 DDRCTime_ms 0.00 655350.0 FORMAT "%8.1" /end CHARACTERISTIC
/begin CHARACTERISTIC DDRC_DurDeb.DcChrgrIntkT2_tiSRCOpnDebOk_C "" VALUE 0x80240A10 Val_Wu16 655350.0 DDRCTime_ms 0.00 655350.0 FORMAT "%8.1" /end CHARACTERISTIC
/begin CHARACTERISTIC DDRC_DurDeb.DcChrgrIntkT2_tiSRCOpnDebDef_C "" VALUE 0x80240A12 Val_Wu16 655350.0 DDRCTime_ms 0.00 655350.0 FORMAT "%8.1" /end CHARACTERISTIC
/begin CHARACTERISTIC DDRC_DurDeb.DcChrgrIntkT_tiPhysRngHiDebOk_C "" VALUE 0x80240A14 Val_Wu16 655350.0 DDRCTime_ms 0.00 655350.0 FORMAT "%8.1" /end CHARACTERISTIC
/begin CHARACTERISTIC DDRC_DurDeb.DcChrgrIntkT_tiPhysRngHiDebDef_C "" VALUE 0x80240A16 Val_Wu16 655350.0 DDRCTime_ms 0.00 655350.0 FORMAT "%8.1" /end CHARACTERISTIC
/begin CHARACTERISTIC DDRC_DurDeb.DcChrgrIntkT_tiPhysRngLoDebOk_C "" VALUE 0x80240A18 Val_Wu16 655350.0 DDRCTime_ms 0.00 655350.0 FORMAT "%8.1" /end CHARACTERISTIC
/begin CHARACTERISTIC DDRC_DurDeb.DcChrgrIntkT_tiPhysRngLoDebDef_C "" VALUE 0x80240A1A Val_Wu16 655350.0 DDRCTime_ms 0.00 655350.0 FORMAT "%8.1" /end CHARACTERISTIC
/begin CHARACTERISTIC DDRC_DurDeb.DcChrgrIntkT_tiSRCOpnDebOk_C "" VALUE 0x80240A1C Val_Wu16 655350.0 DDRCTime_ms 0.00 655350.0 FORMAT "%8.1" /end CHARACTERISTIC
/begin CHARACTERISTIC DDRC_DurDeb.DcChrgrIntkT_tiSRCOpnDebDef_C "" VALUE 0x80240A1E Val_Wu16 655350.0 DDRCTime_ms 0.00 655350.0 FORMAT "%8.1" /end CHARACTERISTIC
/begin CHARACTERISTIC DDRC_DurDeb.Dcdc_tiLvUDifMaxFltDebOk_C "" VALUE 0x80240CDC Val_Wu16 655350.0 DDRCTime_ms 0.00 655350.0 FORMAT "%8.1" /end CHARACTERISTIC
/begin CHARACTERISTIC DDRC_DurDeb.Dcdc_tiLvUDifMaxFltDebDef_C "" VALUE 0x80240CDE Val_Wu16 655350.0 DDRCTime_ms 0.00 655350.0 FORMAT "%8.1" /end CHARACTERISTIC
/begin CHARACTERISTIC DDRC_RatDeb.CtPSwtActr_tiMonDFCUDRat_C "" VALUE 0x80248A57 Val_Wu8 3.00000000000 DDRC_Ratio 1.00000000000 4.00000000000 FORMAT "%13.11" /end CHARACTERISTIC
/begin CHARACTERISTIC DDRC_RatDeb.CtPSwtDiag_tiSRCMinUDRat_C "" VALUE 0x80248A58 Val_Wu8 3.00000000000 DDRC_Ratio 1.00000000000 4.00000000000 FORMAT "%13.11" /end CHARACTERISTIC
/begin CHARACTERISTIC DDRC_RatDeb.CtpCarrFrq_tiSRCMinUDRat_C "" VALUE 0x80248A59 Val_Wu8 3.00000000000 DDRC_Ratio 1.00000000000 4.00000000000 FORMAT "%13.11" /end CHARACTERISTIC
/begin CHARACTERISTIC DDRC_RatDeb.DcChrgrIntkT2_tiSRCMinUDRat_C "" VALUE 0x80248A5A Val_Wu8 3.00000000000 DDRC_Ratio 1.00000000000 4.00000000000 FORMAT "%13.11" /end CHARACTERISTIC
/begin CHARACTERISTIC DDRC_RatDeb.DcChrgrIntkT_tiSRCMinUDRat_C "" VALUE 0x80248A5B Val_Wu8 3.00000000000 DDRC_Ratio 1.00000000000 4.00000000000 FORMAT "%13.11" /end CHARACTERISTIC
/begin CHARACTERISTIC DDRC_RatDeb.CtPSwtDiag_tiPhysRngHiUDRat_C "" VALUE 0x80248A80 Val_Wu8 3.00000000000 DDRC_Ratio 1.00000000000 4.00000000000 FORMAT "%13.11" /end CHARACTERISTIC
/begin CHARACTERISTIC DDRC_RatDeb.CtPSwtDiag_tiPhysRngLoUDRat_C "" VALUE 0x80248A81 Val_Wu8 3.00000000000 DDRC_Ratio 1.00000000000 4.00000000000 FORMAT "%13.11" /end CHARACTERISTIC
/begin CHARACTERISTIC DDRC_RatDeb.CtPSwtDiag_tiSRCOpnUDRat_C "" VALUE 0x80248A82 Val_Wu8 3.00000000000 DDRC_Ratio 1.00000000000 4.00000000000 FORMAT "%13.11" /end CHARACTERISTIC
/begin CHARACTERISTIC DDRC_RatDeb.CtpCarrFrq_tiPhysRngHiUDRat_C "" VALUE 0x80248A83 Val_Wu8 3.00000000000 DDRC_Ratio 1.00000000000 4.00000000000 FORMAT "%13.11" /end CHARACTERISTIC
/begin CHARACTERISTIC DDRC_RatDeb.CtpCarrFrq_tiPhysRngLoUDRat_C "" VALUE 0x80248A84 Val_Wu8 3.00000000000 DDRC_Ratio 1.00000000000 4.00000000000 FORMAT "%13.11" /end CHARACTERISTIC
/begin CHARACTERISTIC DDRC_RatDeb.CtpCarrFrq_tiSRCMaxUDRat_C "" VALUE 0x80248A85 Val_Wu8 3.00000000000 DDRC_Ratio 1.00000000000 4.00000000000 FORMAT "%13.11" /end CHARACTERISTIC
/begin CHARACTERISTIC DDRC_RatDeb.DcChrgrIntkT2_tiPhysRngHiUDRat_C "" VALUE 0x80248A86 Val_Wu8 3.00000000000 DDRC_Ratio 1.00000000000 4.00000000000 FORMAT "%13.11" /end CHARACTERISTIC
/begin CHARACTERISTIC DDRC_RatDeb.DcChrgrIntkT2_tiPhysRngLoUDRat_C "" VALUE 0x80248A87 Val_Wu8 3.00000000000 DDRC_Ratio 1.00000000000 4.00000000000 FORMAT "%13.11" /end CHARACTERISTIC
/begin CHARACTERISTIC DDRC_RatDeb.DcChrgrIntkT2_tiSRCOpnUDRat_C "" VALUE 0x80248A88 Val_Wu8 3.00000000000 DDRC_Ratio 1.00000000000 4.00000000000 FORMAT "%13.11" /end CHARACTERISTIC
/begin CHARACTERISTIC DDRC_RatDeb.DcChrgrIntkT_tiPhysRngHiUDRat_C "" VALUE 0x80248A89 Val_Wu8 3.00000000000 DDRC_Ratio 1.00000000000 4.00000000000 FORMAT "%13.11" /end CHARACTERISTIC
/begin CHARACTERISTIC DDRC_RatDeb.DcChrgrIntkT_tiPhysRngLoUDRat_C "" VALUE 0x80248A8A Val_Wu8 3.00000000000 DDRC_Ratio 1.00000000000 4.00000000000 FORMAT "%13.11" /end CHARACTERISTIC
/begin CHARACTERISTIC DDRC_RatDeb.DcChrgrIntkT_tiSRCOpnUDRat_C "" VALUE 0x80248A8B Val_Wu8 3.00000000000 DDRC_Ratio 1.00000000000 4.00000000000 FORMAT "%13.11" /end CHARACTERISTIC
/begin CHARACTERISTIC DFC_CtlMsk2.DFC_DcdcLvUDifMaxFlt_C "" VALUE 0x8024135A Val_Wu8 255.0 DFES_OneToOne 0.00 255.0 FORMAT "%5.1" /end CHARACTERISTIC
/begin CHARACTERISTIC DFC_CtlMsk2.DFC_CtPSwtActrOL_C "" VALUE 0x8024150A Val_Wu8 255.0 DFES_OneToOne 0.00 255.0 FORMAT "%5.1" /end CHARACTERISTIC
/begin CHARACTERISTIC DFC_CtlMsk2.DFC_CtPSwtActrOvrTemp_C "" VALUE 0x8024150B Val_Wu8 255.0 DFES_OneToOne 0.00 255.0 FORMAT "%5.1" /end CHARACTERISTIC
/begin CHARACTERISTIC DFC_CtlMsk2.DFC_CtPSwtActrSCB_C "" VALUE 0x8024150C Val_Wu8 255.0 DFES_OneToOne 0.00 255.0 FORMAT "%5.1" /end CHARACTERISTIC
/begin CHARACTERISTIC DFC_CtlMsk2.DFC_CtPSwtActrSCG_C "" VALUE 0x8024150D Val_Wu8 255.0 DFES_OneToOne 0.00 255.0 FORMAT "%5.1" /end CHARACTERISTIC
/begin CHARACTERISTIC DFC_CtlMsk2.DFC_CtPSwtDiagSRCMin_C "" VALUE 0x8024150E Val_Wu8 255.0 DFES_OneToOne 0.00 255.0 FORMAT "%5.1" /end CHARACTERISTIC
/begin CHARACTERISTIC DFC_CtlMsk2.DFC_CtpCarrFrqSRCMin_C "" VALUE 0x8024150F Val_Wu8 255.0 DFES_OneToOne 0.00 255.0 FORMAT "%5.1" /end CHARACTERISTIC
/begin CHARACTERISTIC DFC_CtlMsk2.DFC_DcChrgrIntkT2SRCMin_C "" VALUE 0x80241510 Val_Wu8 255.0 DFES_OneToOne 0.00 255.0 FORMAT "%5.1" /end CHARACTERISTIC
/begin CHARACTERISTIC DFC_CtlMsk2.DFC_DcChrgrIntkTSRCMin_C "" VALUE 0x80241511 Val_Wu8 255.0 DFES_OneToOne 0.00 255.0 FORMAT "%5.1" /end CHARACTERISTIC
/begin CHARACTERISTIC DFC_CtlMsk2.DFC_CtPSwtDiagPhysRngHi_C "" VALUE 0x80241539 Val_Wu8 255.0 DFES_OneToOne 0.00 255.0 FORMAT "%5.1" /end CHARACTERISTIC
/begin CHARACTERISTIC DFC_CtlMsk2.DFC_CtPSwtDiagPhysRngLo_C "" VALUE 0x8024153A Val_Wu8 255.0 DFES_OneToOne 0.00 255.0 FORMAT "%5.1" /end CHARACTERISTIC
/begin CHARACTERISTIC DFC_CtlMsk2.DFC_CtPSwtDiagSRCOpn_C "" VALUE 0x8024153B Val_Wu8 255.0 DFES_OneToOne 0.00 255.0 FORMAT "%5.1" /end CHARACTERISTIC
/begin CHARACTERISTIC DFC_CtlMsk2.DFC_CtpCarrFrqPhysRngHi_C "" VALUE 0x8024153C Val_Wu8 255.0 DFES_OneToOne 0.00 255.0 FORMAT "%5.1" /end CHARACTERISTIC
/begin CHARACTERISTIC DFC_CtlMsk2.DFC_CtpCarrFrqPhysRngLo_C "" VALUE 0x8024153D Val_Wu8 255.0 DFES_OneToOne 0.00 255.0 FORMAT "%5.1" /end CHARACTERISTIC
/begin CHARACTERISTIC DFC_CtlMsk2.DFC_CtpCarrFrqSRCMax_C "" VALUE 0x8024153E Val_Wu8 255.0 DFES_OneToOne 0.00 255.0 FORMAT "%5.1" /end CHARACTERISTIC
/begin CHARACTERISTIC DFC_CtlMsk2.DFC_DcChrgrIntkT2PhysRngHi_C "" VALUE 0x8024153F Val_Wu8 255.0 DFES_OneToOne 0.00 255.0 FORMAT "%5.1" /end CHARACTERISTIC
/begin CHARACTERISTIC DFC_CtlMsk2.DFC_DcChrgrIntkT2PhysRngLo_C "" VALUE 0x80241540 Val_Wu8 255.0 DFES_OneToOne 0.00 255.0 FORMAT "%5.1" /end CHARACTERISTIC
/begin CHARACTERISTIC DFC_CtlMsk2.DFC_DcChrgrIntkT2SRCOpn_C "" VALUE 0x80241541 Val_Wu8 255.0 DFES_OneToOne 0.00 255.0 FORMAT "%5.1" /end CHARACTERISTIC
/begin CHARACTERISTIC DFC_CtlMsk2.DFC_DcChrgrIntkTPhysRngHi_C "" VALUE 0x80241542 Val_Wu8 255.0 DFES_OneToOne 0.00 255.0 FORMAT "%5.1" /end CHARACTERISTIC
/begin CHARACTERISTIC DFC_CtlMsk2.DFC_DcChrgrIntkTPhysRngLo_C "" VALUE 0x80241543 Val_Wu8 255.0 DFES_OneToOne 0.00 255.0 FORMAT "%5.1" /end CHARACTERISTIC
/begin CHARACTERISTIC DFC_CtlMsk2.DFC_DcChrgrIntkTSRCOpn_C "" VALUE 0x80241544 Val_Wu8 255.0 DFES_OneToOne 0.00 255.0 FORMAT "%5.1" /end CHARACTERISTIC
/begin CHARACTERISTIC DFC_CtlMsk2.DFC_CtPSwtDiagSRCMax_C "" VALUE 0x802415E7 Val_Wu8 255.0 DFES_OneToOne 0.00 255.0 FORMAT "%5.1" /end CHARACTERISTIC
/begin CHARACTERISTIC DFC_CtlMsk2.DFC_CtPSwtDiagTmpErr_C "" VALUE 0x802415E8 Val_Wu8 255.0 DFES_OneToOne 0.00 255.0 FORMAT "%5.1" /end CHARACTERISTIC
/begin CHARACTERISTIC DFC_CtlMsk2.DFC_CtpCarrFrqTmpErr_C "" VALUE 0x802415E9 Val_Wu8 255.0 DFES_OneToOne 0.00 255.0 FORMAT "%5.1" /end CHARACTERISTIC
/begin CHARACTERISTIC DFC_CtlMsk2.DFC_DcChrgrIntkT2SRCMax_C "" VALUE 0x802415EA Val_Wu8 255.0 DFES_OneToOne 0.00 255.0 FORMAT "%5.1" /end CHARACTERISTIC
/begin CHARACTERISTIC DFC_CtlMsk2.DFC_DcChrgrIntkT2TmpErr_C "" VALUE 0x802415EB Val_Wu8 255.0 DFES_OneToOne 0.00 255.0 FORMAT "%5.1" /end CHARACTERISTIC
/begin CHARACTERISTIC DFC_CtlMsk2.DFC_DcChrgrIntkTSRCMax_C "" VALUE 0x802415EC Val_Wu8 255.0 DFES_OneToOne 0.00 255.0 FORMAT "%5.1" /end CHARACTERISTIC
/begin CHARACTERISTIC DFC_CtlMsk2.DFC_DcChrgrIntkTTmpErr_C "" VALUE 0x802415ED Val_Wu8 255.0 DFES_OneToOne 0.00 255.0 FORMAT "%5.1" /end CHARACTERISTIC
/begin CHARACTERISTIC DFC_DisblMsk2.DFC_DcdcLvUDifMaxFlt_C "" VALUE 0x80248B9A Val_Wu16 65535.00 DFES_OneToOne 0.00 65535.00 FORMAT "%8.2" /end CHARACTERISTIC
/begin CHARACTERISTIC DFC_DisblMsk2.DFC_CtPSwtActrOL_C "" VALUE 0x80248EFA Val_Wu16 65535.00 DFES_OneToOne 0.00 65535.00 FORMAT "%8.2" /end CHARACTERISTIC
/begin CHARACTERISTIC DFC_DisblMsk2.DFC_CtPSwtActrOvrTemp_C "" VALUE 0x80248EFC Val_Wu16 65535.00 DFES_OneToOne 0.00 65535.00 FORMAT "%8.2" /end CHARACTERISTIC
/begin CHARACTERISTIC DFC_DisblMsk2.DFC_CtPSwtActrSCB_C "" VALUE 0x80248EFE Val_Wu16 65535.00 DFES_OneToOne 0.00 65535.00 FORMAT "%8.2" /end CHARACTERISTIC
/begin CHARACTERISTIC DFC_DisblMsk2.DFC_CtPSwtActrSCG_C "" VALUE 0x80248F00 Val_Wu16 65535.00 DFES_OneToOne 0.00 65535.00 FORMAT "%8.2" /end CHARACTERISTIC
/begin CHARACTERISTIC DFC_DisblMsk2.DFC_CtPSwtDiagSRCMin_C "" VALUE 0x80248F02 Val_Wu16 65535.00 DFES_OneToOne 0.00 65535.00 FORMAT "%8.2" /end CHARACTERISTIC
/begin CHARACTERISTIC DFC_DisblMsk2.DFC_CtpCarrFrqSRCMin_C "" VALUE 0x80248F04 Val_Wu16 65535.00 DFES_OneToOne 0.00 65535.00 FORMAT "%8.2" /end CHARACTERISTIC
/begin CHARACTERISTIC DFC_DisblMsk2.DFC_DcChrgrIntkT2SRCMin_C "" VALUE 0x80248F06 Val_Wu16 65535.00 DFES_OneToOne 0.00 65535.00 FORMAT "%8.2" /end CHARACTERISTIC
/begin CHARACTERISTIC DFC_DisblMsk2.DFC_DcChrgrIntkTSRCMin_C "" VALUE 0x80248F08 Val_Wu16 65535.00 DFES_OneToOne 0.00 65535.00 FORMAT "%8.2" /end CHARACTERISTIC
/begin CHARACTERISTIC DFC_DisblMsk2.DFC_CtPSwtDiagPhysRngHi_C "" VALUE 0x80248F58 Val_Wu16 65535.00 DFES_OneToOne 0.00 65535.00 FORMAT "%8.2" /end CHARACTERISTIC
/begin CHARACTERISTIC DFC_DisblMsk2.DFC_CtPSwtDiagPhysRngLo_C "" VALUE 0x80248F5A Val_Wu16 65535.00 DFES_OneToOne 0.00 65535.00 FORMAT "%8.2" /end CHARACTERISTIC
/begin CHARACTERISTIC DFC_DisblMsk2.DFC_CtPSwtDiagSRCOpn_C "" VALUE 0x80248F5C Val_Wu16 65535.00 DFES_OneToOne 0.00 65535.00 FORMAT "%8.2" /end CHARACTERISTIC
/begin CHARACTERISTIC DFC_DisblMsk2.DFC_CtpCarrFrqPhysRngHi_C "" VALUE 0x80248F5E Val_Wu16 65535.00 DFES_OneToOne 0.00 65535.00 FORMAT "%8.2" /end CHARACTERISTIC
/begin CHARACTERISTIC DFC_DisblMsk2.DFC_CtpCarrFrqPhysRngLo_C "" VALUE 0x80248F60 Val_Wu16 65535.00 DFES_OneToOne 0.00 65535.00 FORMAT "%8.2" /end CHARACTERISTIC
/begin CHARACTERISTIC DFC_DisblMsk2.DFC_CtpCarrFrqSRCMax_C "" VALUE 0x80248F62 Val_Wu16 65535.00 DFES_OneToOne 0.00 65535.00 FORMAT "%8.2" /end CHARACTERISTIC
/begin CHARACTERISTIC DFC_DisblMsk2.DFC_DcChrgrIntkT2PhysRngHi_C "" VALUE 0x80248F64 Val_Wu16 65535.00 DFES_OneToOne 0.00 65535.00 FORMAT "%8.2" /end CHARACTERISTIC
/begin CHARACTERISTIC DFC_DisblMsk2.DFC_DcChrgrIntkT2PhysRngLo_C "" VALUE 0x80248F66 Val_Wu16 65535.00 DFES_OneToOne 0.00 65535.00 FORMAT "%8.2" /end CHARACTERISTIC
/begin CHARACTERISTIC DFC_DisblMsk2.DFC_DcChrgrIntkT2SRCOpn_C "" VALUE 0x80248F68 Val_Wu16 65535.00 DFES_OneToOne 0.00 65535.00 FORMAT "%8.2" /end CHARACTERISTIC
/begin CHARACTERISTIC DFC_DisblMsk2.DFC_DcChrgrIntkTPhysRngHi_C "" VALUE 0x80248F6A Val_Wu16 65535.00 DFES_OneToOne 0.00 65535.00 FORMAT "%8.2" /end CHARACTERISTIC
/begin CHARACTERISTIC DFC_DisblMsk2.DFC_DcChrgrIntkTPhysRngLo_C "" VALUE 0x80248F6C Val_Wu16 65535.00 DFES_OneToOne 0.00 65535.00 FORMAT "%8.2" /end CHARACTERISTIC
/begin CHARACTERISTIC DFC_DisblMsk2.DFC_DcChrgrIntkTSRCOpn_C "" VALUE 0x80248F6E Val_Wu16 65535.00 DFES_OneToOne 0.00 65535.00 FORMAT "%8.2" /end CHARACTERISTIC
/begin CHARACTERISTIC DFC_DisblMsk2.DFC_CtPSwtDiagSRCMax_C "" VALUE 0x802490B4 Val_Wu16 65535.00 DFES_OneToOne 0.00 65535.00 FORMAT "%8.2" /end CHARACTERISTIC
/begin CHARACTERISTIC DFC_DisblMsk2.DFC_CtPSwtDiagTmpErr_C "" VALUE 0x802490B6 Val_Wu16 65535.00 DFES_OneToOne 0.00 65535.00 FORMAT "%8.2" /end CHARACTERISTIC
/begin CHARACTERISTIC DFC_DisblMsk2.DFC_CtpCarrFrqTmpErr_C "" VALUE 0x802490B8 Val_Wu16 65535.00 DFES_OneToOne 0.00 65535.00 FORMAT "%8.2" /end CHARACTERISTIC
/begin CHARACTERISTIC DFC_DisblMsk2.DFC_DcChrgrIntkT2SRCMax_C "" VALUE 0x802490BA Val_Wu16 65535.00 DFES_OneToOne 0.00 65535.00 FORMAT "%8.2" /end CHARACTERISTIC
/begin CHARACTERISTIC DFC_DisblMsk2.DFC_DcChrgrIntkT2TmpErr_C "" VALUE 0x802490BC Val_Wu16 65535.00 DFES_OneToOne 0.00 65535.00 FORMAT "%8.2" /end CHARACTERISTIC
/begin CHARACTERISTIC DFC_DisblMsk2.DFC_DcChrgrIntkTSRCMax_C "" VALUE 0x802490BE Val_Wu16 65535.00 DFES_OneToOne 0.00 65535.00 FORMAT "%8.2" /end CHARACTERISTIC
/begin CHARACTERISTIC DFC_DisblMsk2.DFC_DcChrgrIntkTTmpErr_C "" VALUE 0x802490C0 Val_Wu16 65535.00 DFES_OneToOne 0.00 65535.00 FORMAT "%8.2" /end CHARACTERISTIC
/begin MEASUREMENT CoVMEv_flgEvSysCptMaxErrPrim "Flag for predicting the maximum primaryaxle system error" UBYTE B_TRUE 1 100 0.00 1.00000000000 BIT_MASK 0x1 FORMAT "%13.11" ECU_ADDRESS 0x6002316D
 /begin IF_DATA XCPplus 0x0102
  /begin DAQ_EVENT VARIABLE /end DAQ_EVENT
 /end IF_DATA
/end MEASUREMENT
/begin MEASUREMENT CoVMEv_flgEvSysCptMinErrPrim "Flag for predicting the minimum primaryaxle system error" UBYTE B_TRUE 1 100 0.00 1.00000000000 BIT_MASK 0x1 FORMAT "%13.11" ECU_ADDRESS 0x6002316C
 /begin IF_DATA XCPplus 0x0102
  /begin DAQ_EVENT VARIABLE /end DAQ_EVENT
 /end IF_DATA
/end MEASUREMENT
/begin MEASUREMENT CoVMEv_flgSysErrLimnMax "Maximum system error limitation" UBYTE B_TRUE 1 100 0.00 1.00000000000 BIT_MASK 0x1 FORMAT "%13.11" ECU_ADDRESS 0x6002316B
 /begin IF_DATA XCPplus 0x0102
  /begin DAQ_EVENT VARIABLE /end DAQ_EVENT
 /end IF_DATA
/end MEASUREMENT
/begin MEASUREMENT CoVMEv_flgSysErrLimnMin "Minimum system error limitation" UBYTE B_TRUE 1 100 0.00 1.00000000000 BIT_MASK 0x1 FORMAT "%13.11" ECU_ADDRESS 0x6002316A
 /begin IF_DATA XCPplus 0x0102
  /begin DAQ_EVENT VARIABLE /end DAQ_EVENT
 /end IF_DATA
/end MEASUREMENT
/begin MEASUREMENT CoVMEv_tqDes01 "desired wheel torque of e-machine 1 with ESP interventions" SLONG TrqPrpHigh 1 100 -214748364.800 214748364.700 FORMAT "%13.3" ECU_ADDRESS 0x60000F80
 /begin IF_DATA XCPplus 0x0102
  /begin DAQ_EVENT VARIABLE /end DAQ_EVENT
 /end IF_DATA
/end MEASUREMENT
/begin MEASUREMENT CoVMEv_tqDesIn01 "desired wheel torque of e-machine 1 befor ESP interventions" SLONG TrqPrpHigh 1 100 -214748364.800 214748364.700 FORMAT "%13.3" ECU_ADDRESS 0x60000A90
 /begin IF_DATA XCPplus 0x0102
  /begin DAQ_EVENT VARIABLE /end DAQ_EVENT
 /end IF_DATA
/end MEASUREMENT
/begin MEASUREMENT CoVMEv_tqSysErrLimn01MaxPrimAxle "Maximum limitation torque for system limitation at primary axle" SLONG TrqPrpHigh 1 100 -214748364.800 214748364.700 FORMAT "%13.3" ECU_ADDRESS 0x60000A8C
 /begin IF_DATA XCPplus 0x0102
  /begin DAQ_EVENT VARIABLE /end DAQ_EVENT
 /end IF_DATA
/end MEASUREMENT
/begin MEASUREMENT CoVMEv_tqSysErrLimn01MinPrimAxle "Minimum limitation torque for system limitation at primary axle" SLONG TrqPrpHigh 1 100 -214748364.800 214748364.700 FORMAT "%13.3" ECU_ADDRESS 0x60000A88
 /begin IF_DATA XCPplus 0x0102
  /begin DAQ_EVENT VARIABLE /end DAQ_EVENT
 /end IF_DATA
/end MEASUREMENT
/begin MEASUREMENT CoVMEv_tqSysErrLimn02MaxPrimAxle "Maximum limitation torque for system limitation at primary axle" SLONG TrqPrpHigh 1 100 -214748364.800 214748364.700 FORMAT "%13.3" ECU_ADDRESS 0x60000A84
 /begin IF_DATA XCPplus 0x0102
  /begin DAQ_EVENT VARIABLE /end DAQ_EVENT
 /end IF_DATA
/end MEASUREMENT
/begin MEASUREMENT CoVMEv_tqSysErrLimn02MinPrimAxle "Minimum limitation torque for system limitation at primary axle" SLONG TrqPrpHigh 1 100 -214748364.800 214748364.700 FORMAT "%13.3" ECU_ADDRESS 0x60000A80
 /begin IF_DATA XCPplus 0x0102
  /begin DAQ_EVENT VARIABLE /end DAQ_EVENT
 /end IF_DATA
/end MEASUREMENT
/begin MEASUREMENT CoVMEv_tqSysErrLimn03MaxPrimAxle "Maximum limitation torque for system limitation at primary axle" SLONG TrqPrpHigh 1 100 -214748364.800 214748364.700 FORMAT "%13.3" ECU_ADDRESS 0x60000A7C
 /begin IF_DATA XCPplus 0x0102
  /begin DAQ_EVENT VARIABLE /end DAQ_EVENT
 /end IF_DATA
/end MEASUREMENT
/begin MEASUREMENT CoVMEv_tqSysErrLimn03MinPrimAxle "Minimum limitation torque for system limitation at primary axle" SLONG TrqPrpHigh 1 100 -214748364.800 214748364.700 FORMAT "%13.3" ECU_ADDRESS 0x60000A78
 /begin IF_DATA XCPplus 0x0102
  /begin DAQ_EVENT VARIABLE /end DAQ_EVENT
 /end IF_DATA
/end MEASUREMENT
/begin MEASUREMENT CoVMEv_tqSysErrLimn04MaxPrimAxle "Maximum limitation torque for system limitation at primary axle" SLONG TrqPrpHigh 1 100 -214748364.800 214748364.700 FORMAT "%13.3" ECU_ADDRESS 0x60000A74
 /begin IF_DATA XCPplus 0x0102
  /begin DAQ_EVENT VARIABLE /end DAQ_EVENT
 /end IF_DATA
/end MEASUREMENT
/begin MEASUREMENT CoVMEv_tqSysErrLimn05MaxPrimAxle "Maximum limitation torque for system limitation at primary axle" SLONG TrqPrpHigh 1 100 -214748364.800 214748364.700 FORMAT "%13.3" ECU_ADDRESS 0x60000A70
 /begin IF_DATA XCPplus 0x0102
  /begin DAQ_EVENT VARIABLE /end DAQ_EVENT
 /end IF_DATA
/end MEASUREMENT
/begin MEASUREMENT CoVMEv_tqSysErrLimnMaxPrimAxle "Maximum limitation torque for system limitation" SLONG TrqPrpHigh 1 100 -214748364.800 214748364.700 FORMAT "%13.3" ECU_ADDRESS 0x60000F7C
 /begin IF_DATA XCPplus 0x0102
  /begin DAQ_EVENT VARIABLE /end DAQ_EVENT
 /end IF_DATA
/end MEASUREMENT
/begin MEASUREMENT CoVMEv_tqSysErrLimnMinPrimAxle "Minimum limitation torque for system limitation" SLONG TrqPrpHigh 1 100 -214748364.800 214748364.700 FORMAT "%13.3" ECU_ADDRESS 0x60000F78
 /begin IF_DATA XCPplus 0x0102
  /begin DAQ_EVENT VARIABLE /end DAQ_EVENT
 /end IF_DATA
/end MEASUREMENT
/begin MEASUREMENT CoVMEv_tqSysLimnMaxPrimAxle "Flag for predicting the maximum primaryaxle system limitation" SLONG TrqPrpHigh 1 100 -214748364.800 214748364.700 FORMAT "%13.3" ECU_ADDRESS 0x60000A6C
 /begin IF_DATA XCPplus 0x0102
  /begin DAQ_EVENT VARIABLE /end DAQ_EVENT
 /end IF_DATA
/end MEASUREMENT
/begin MEASUREMENT CoVMEv_tqSysLimnMinPrimAxle "Flag for predicting the minimum primaryaxle system limitation" SLONG TrqPrpHigh 1 100 -214748364.800 214748364.700 FORMAT "%13.3" ECU_ADDRESS 0x60000A68
 /begin IF_DATA XCPplus 0x0102
  /begin DAQ_EVENT VARIABLE /end DAQ_EVENT
 /end IF_DATA
/end MEASUREMENT
/begin MEASUREMENT CtpCarrFrq_DDstSnsrState_mp "" UBYTE OneToOne 1 100 0.00 255.0 FORMAT "%5.1" ECU_ADDRESS 0x70006C25 /end MEASUREMENT
/begin MEASUREMENT CtpCarrFrq_FirCalc.cntrAvrgZr " / Counter for 0-division in FIR (indicates failure)" UBYTE OneToOne 1 100 0.00 255.0 FORMAT "%5.1" ECU_ADDRESS 0x6001F508 /end MEASUREMENT
/begin MEASUREMENT CtpCarrFrq_FirCalc.flgRdDne " / FIR: reading from uRaw-sum done" UBYTE OneToOne 1 100 0.00 1.000 BIT_MASK 0x1 FORMAT "%5.3" ECU_ADDRESS 0x6001F509 /end MEASUREMENT
/begin MEASUREMENT CtpCarrFrq_FirCalc.uRawAvrg " / FIR: simple average calculated uRaw" SWORD Volt 1 100 -6553.600 6553.400 FORMAT "%8.3" ECU_ADDRESS 0x6001F50A /end MEASUREMENT
/begin MEASUREMENT CtpCarrFrq_FirCalc.uRawFir " / FIR: Calculated uRaw" SWORD Volt 1 100 -6553.600 6553.400 FORMAT "%8.3" ECU_ADDRESS 0x6001F50C /end MEASUREMENT
/begin MEASUREMENT CtpCarrFrq_FirRead.cntr " / Counter for simple average FIR" UBYTE OneToOne 1 100 0.00 255.0 FORMAT "%5.1" ECU_ADDRESS 0x60000A5C /end MEASUREMENT
/begin MEASUREMENT CtpCarrFrq_FirRead.flgFirstRun " / FIR: 1st run after init" UBYTE OneToOne 1 100 0.00 1.000 BIT_MASK 0x1 FORMAT "%5.3" ECU_ADDRESS 0x60000A5D /end MEASUREMENT
/begin MEASUREMENT CtpCarrFrq_FirRead.idxArr " / FIR ringbuffer: actual index" UBYTE OneToOne 1 100 0.00 255.0 FORMAT "%5.1" ECU_ADDRESS 0x60000A5E /end MEASUREMENT
/begin MEASUREMENT CtpCarrFrq_FirRead.uSum " / Simple average FIR: sum of uRaws" SLONG Volt 1 100 -429496729.600 429496729.400 FORMAT "%13.3" ECU_ADDRESS 0x60000A60 /end MEASUREMENT
/begin MEASUREMENT CtpCarrFrq_rActDynThresPhysRngHi_f_mp "" FLOAT32_IEEE RBPtCel_Perc_1p0_1 1 100 -1.00000000E+037 1.00000000E+037 FORMAT "%13.3" ECU_ADDRESS 0x70006908 /end MEASUREMENT
/begin MEASUREMENT CtpCarrFrq_rActDynThresPhysRngLo_f_mp "" FLOAT32_IEEE RBPtCel_Perc_1p0_1 1 100 -1.00000000E+037 1.00000000E+037 FORMAT "%13.3" ECU_ADDRESS 0x70006904 /end MEASUREMENT
/begin MEASUREMENT CtpCarrFrq_rActSensCpl "" SWORD OneToOne 1 100 -32768.00 32767.00 FORMAT "%8.2" ECU_ADDRESS 0x6001FE20
 /begin IF_DATA XCPplus 0x0102
  /begin DAQ_EVENT VARIABLE /end DAQ_EVENT
 /end IF_DATA
/end MEASUREMENT
/begin MEASUREMENT CtpCarrFrq_rActSensGradLim_f_mp "" FLOAT32_IEEE RBPtCel_Perc_1p0_1 1 100 -1.00000000E+037 1.00000000E+037 FORMAT "%13.3" ECU_ADDRESS 0x7000690C
 /begin IF_DATA XCPplus 0x0102
  /begin DAQ_EVENT VARIABLE /end DAQ_EVENT
 /end IF_DATA
/end MEASUREMENT
/begin MEASUREMENT CtpCarrFrq_rActSensOffsCorrd_f "" FLOAT32_IEEE RBPtCel_Perc_1p0_1 1 100 -1.00000000E+037 1.00000000E+037 FORMAT "%13.3" ECU_ADDRESS 0x60001258
 /begin IF_DATA XCPplus 0x0102
  /begin DAQ_EVENT VARIABLE /end DAQ_EVENT
 /end IF_DATA
/end MEASUREMENT
/begin MEASUREMENT CtpCarrFrq_rActSensUnFltd "" SWORD RBPtCel_Perc_1p0_1 1 100 -32768.00 32767.00 FORMAT "%8.2" ECU_ADDRESS 0x6001FE1E
 /begin IF_DATA XCPplus 0x0102
  /begin DAQ_EVENT VARIABLE /end DAQ_EVENT
 /end IF_DATA
/end MEASUREMENT
/begin MEASUREMENT CtpCarrFrq_rActSens_f "" FLOAT32_IEEE RBPtCel_Perc_1p0_1 1 100 -1.00000000E+037 1.00000000E+037 FORMAT "%13.3" ECU_ADDRESS 0x60001254
 /begin IF_DATA XCPplus 0x0102
  /begin DAQ_EVENT VARIABLE /end DAQ_EVENT
 /end IF_DATA
/end MEASUREMENT
/begin MEASUREMENT CtpCarrFrq_rActUnFlt_f "" FLOAT32_IEEE RBPtCel_Perc_1p0_1 1 100 -1.00000000E+037 1.00000000E+037 FORMAT "%13.3" ECU_ADDRESS 0x60001250
 /begin IF_DATA XCPplus 0x0102
  /begin DAQ_EVENT VARIABLE /end DAQ_EVENT
 /end IF_DATA
/end MEASUREMENT
/begin MEASUREMENT CtpCarrFrq_rAct_f "Actual physical value" FLOAT32_IEEE RBPtCel_Perc_1p0_1 1 100 -1.00000000E+037 1.00000000E+037 FORMAT "%13.3" ECU_ADDRESS 0x6000124C
 /begin IF_DATA XCPplus 0x0102
  /begin DAQ_EVENT VARIABLE /end DAQ_EVENT
 /end IF_DATA
/end MEASUREMENT
/begin MEASUREMENT CtpCarrFrq_rAct_f_Sq "" UBYTE SigQly_COMPU_VERB 1 100 0.00 15.0000000000 FORMAT "%13.10" ECU_ADDRESS 0x60023803
 /begin IF_DATA XCPplus 0x0102
  /begin DAQ_EVENT VARIABLE /end DAQ_EVENT
 /end IF_DATA
/end MEASUREMENT
/begin MEASUREMENT CtpCarrFrq_rDtyCycRaw "" SWORD DtyCyc 1 100 -327.6800 327.6700 FORMAT "%8.4" ECU_ADDRESS 0x6001FE1C
 /begin IF_DATA XCPplus 0x0102
  /begin DAQ_EVENT VARIABLE /end DAQ_EVENT
 /end IF_DATA
/end MEASUREMENT
/begin MEASUREMENT CtpCarrFrq_rDtyCycRaw_f "" FLOAT32_IEEE RBPtCel_Perc_1p0_1 1 100 -1.00000000E+037 1.00000000E+037 FORMAT "%13.3" ECU_ADDRESS 0x60001248
 /begin IF_DATA XCPplus 0x0102
  /begin DAQ_EVENT VARIABLE /end DAQ_EVENT
 /end IF_DATA
/end MEASUREMENT
/begin MEASUREMENT CtpCarrFrq_stMonStdSens "" ULONG OneToOne 1 100 0.00 4294967295.00 FORMAT "%13.2" ECU_ADDRESS 0x60001068
 /begin IF_DATA XCPplus 0x0102
  /begin DAQ_EVENT VARIABLE /end DAQ_EVENT
 /end IF_DATA
/end MEASUREMENT
/begin MEASUREMENT CtpCarrFrq_stSnsrActv "" UBYTE OneToOne 1 100 0.00 255.0 BIT_MASK 0x1 FORMAT "%5.1" ECU_ADDRESS 0x600236D9
 /begin IF_DATA XCPplus 0x0102
  /begin DAQ_EVENT VARIABLE /end DAQ_EVENT
 /end IF_DATA
/end MEASUREMENT
/begin MEASUREMENT CtpCarrFrq_stSnsrDdCalc "" UBYTE OneToOne 1 100 0.00 255.0 BIT_MASK 0x1 FORMAT "%5.1" ECU_ADDRESS 0x600236D8
 /begin IF_DATA XCPplus 0x0102
  /begin DAQ_EVENT VARIABLE /end DAQ_EVENT
 /end IF_DATA
/end MEASUREMENT
/begin MEASUREMENT CtpCarrFrq_stSnsrDdReadCalc "" UBYTE OneToOne 1 100 0.00 255.0 BIT_MASK 0x1 FORMAT "%5.1" ECU_ADDRESS 0x600236D7
 /begin IF_DATA XCPplus 0x0102
  /begin DAQ_EVENT VARIABLE /end DAQ_EVENT
 /end IF_DATA
/end MEASUREMENT
/begin MEASUREMENT CtpCarrFrq_swtConfStdSens2C "" ULONG OneToOne 1 100 0.00 4294967295.00 FORMAT "%13.2" ECU_ADDRESS 0x60000A58 /end MEASUREMENT
/begin MEASUREMENT CtpCarrFrq_swtConfStdSensC "" ULONG OneToOne 1 100 0.00 4294967295.00 FORMAT "%13.2" ECU_ADDRESS 0x60000A54 /end MEASUREMENT
/begin MEASUREMENT CtpCarrFrq_swtConfStdSensSwVersC "" ULONG OneToOne 1 100 0.00 4294967295.00 FORMAT "%13.2" ECU_ADDRESS 0x60000A50 /end MEASUREMENT
/begin MEASUREMENT CtpCarrFrq_swtSensMode "" UBYTE OneToOne 1 100 0.00 255.0 FORMAT "%5.1" ECU_ADDRESS 0x60023802 /end MEASUREMENT
/begin MEASUREMENT CtpCarrFrq_swtSensPres "" UBYTE OneToOne 1 100 0.00 255.0 FORMAT "%5.1" ECU_ADDRESS 0x60023801
 /begin IF_DATA XCPplus 0x0102
  /begin DAQ_EVENT VARIABLE /end DAQ_EVENT
 /end IF_DATA
/end MEASUREMENT
/begin MEASUREMENT CtpCarrFrq_tiPerRaw "" SWORD Time_usec_q1_COMPU 1 100 -32768.00 32767.00 FORMAT "%8.2" ECU_ADDRESS 0x6001FE18
 /begin IF_DATA XCPplus 0x0102
  /begin DAQ_EVENT VARIABLE /end DAQ_EVENT
 /end IF_DATA
/end MEASUREMENT
/begin MEASUREMENT CtpCarrFrq_tiPerRaw_f "" FLOAT32_IEEE Time_usec_q1_COMPU 1 100 -1.00000000E+037 1.00000000E+037 FORMAT "%13.3" ECU_ADDRESS 0x60001244
 /begin IF_DATA XCPplus 0x0102
  /begin DAQ_EVENT VARIABLE /end DAQ_EVENT
 /end IF_DATA
/end MEASUREMENT
/begin MEASUREMENT CtpCarrFrq_tSensPT1Fltd_mp "" SWORD RBPtCel_Perc_1p0_1 1 100 -32768.00 32767.00 FORMAT "%8.2" ECU_ADDRESS 0x70006B44 /end MEASUREMENT
/begin MEASUREMENT CtpCarrFrq_uRaw "" SWORD Volt 1 100 -6553.600 6553.400 FORMAT "%8.3" ECU_ADDRESS 0x6001FE16
 /begin IF_DATA XCPplus 0x0102
  /begin DAQ_EVENT VARIABLE /end DAQ_EVENT
 /end IF_DATA
/end MEASUREMENT
/begin MEASUREMENT CtpCarrFrq_uRawPT1Fltd "" SWORD Volt 1 100 -6553.600 6553.400 FORMAT "%8.3" ECU_ADDRESS 0x6001FE14
 /begin IF_DATA XCPplus 0x0102
  /begin DAQ_EVENT VARIABLE /end DAQ_EVENT
 /end IF_DATA
/end MEASUREMENT
/begin MEASUREMENT CtpCarrFrq_uRawPT1FltdSens "" SWORD Volt 1 100 -6553.600 6553.400 FORMAT "%8.3" ECU_ADDRESS 0x6001FE12
 /begin IF_DATA XCPplus 0x0102
  /begin DAQ_EVENT VARIABLE /end DAQ_EVENT
 /end IF_DATA
/end MEASUREMENT
/begin MEASUREMENT CtpCarrFrq_uRawUnFltd "" SWORD Volt 1 100 -6553.600 6553.400 FORMAT "%8.3" ECU_ADDRESS 0x6001FE10
 /begin IF_DATA XCPplus 0x0102
  /begin DAQ_EVENT VARIABLE /end DAQ_EVENT
 /end IF_DATA
/end MEASUREMENT
/begin MEASUREMENT CtPSwtActr_r "Control Pilot Switch S2 actuator CCS charging" SWORD Prc 1 100 -400.0000 399.9878 FORMAT "%8.4" ECU_ADDRESS 0x6001FBBC
 /begin IF_DATA XCPplus 0x0102
  /begin DAQ_EVENT VARIABLE /end DAQ_EVENT
 /end IF_DATA
/end MEASUREMENT
/begin MEASUREMENT CtPSwtActr_rAct "" SWORD Prc 1 100 -400.0000 399.9878 FORMAT "%8.4" ECU_ADDRESS 0x6001FBBA
 /begin IF_DATA XCPplus 0x0102
  /begin DAQ_EVENT VARIABLE /end DAQ_EVENT
 /end IF_DATA
/end MEASUREMENT
/begin MEASUREMENT CtPSwtActr_rActr "" SWORD Prc 1 100 -400.0000 399.9878 FORMAT "%8.4" ECU_ADDRESS 0x6001FBB8
 /begin IF_DATA XCPplus 0x0102
  /begin DAQ_EVENT VARIABLE /end DAQ_EVENT
 /end IF_DATA
/end MEASUREMENT
/begin MEASUREMENT CtPSwtActr_rAct_Sq "" UBYTE SigQly_COMPU_VERB 1 100 0.00 15.0000000000 FORMAT "%13.10" ECU_ADDRESS 0x600235D3
 /begin IF_DATA XCPplus 0x0102
  /begin DAQ_EVENT VARIABLE /end DAQ_EVENT
 /end IF_DATA
/end MEASUREMENT
/begin MEASUREMENT CtPSwtActr_rDesVal "" SWORD Prc 1 100 -400.0000 399.9878 FORMAT "%8.4" ECU_ADDRESS 0x6001FBB6
 /begin IF_DATA XCPplus 0x0102
  /begin DAQ_EVENT VARIABLE /end DAQ_EVENT
 /end IF_DATA
/end MEASUREMENT
/begin MEASUREMENT CtPSwtActr_rDtyCyc "" SWORD Prc 1 100 -400.0000 399.9878 FORMAT "%8.4" ECU_ADDRESS 0x6001FBB4
 /begin IF_DATA XCPplus 0x0102
  /begin DAQ_EVENT VARIABLE /end DAQ_EVENT
 /end IF_DATA
/end MEASUREMENT
/begin MEASUREMENT CtPSwtActr_rPs "" SWORD DtyCyc 1 100 -327.6800 327.6700 FORMAT "%8.4" ECU_ADDRESS 0x6001FBB2
 /begin IF_DATA XCPplus 0x0102
  /begin DAQ_EVENT VARIABLE /end DAQ_EVENT
 /end IF_DATA
/end MEASUREMENT
/begin MEASUREMENT CtPSwtActr_stMonActrCoorrSimple "" UBYTE OneToOne 1 100 0.00 255.0 FORMAT "%5.1" ECU_ADDRESS 0x600235D2
 /begin IF_DATA XCPplus 0x0102
  /begin DAQ_EVENT VARIABLE /end DAQ_EVENT
 /end IF_DATA
/end MEASUREMENT
/begin MEASUREMENT CtPSwtActr_stMonActrElecDrvrSimple "" UBYTE OneToOne 1 100 0.00 255.0 FORMAT "%5.1" ECU_ADDRESS 0x600235D1
 /begin IF_DATA XCPplus 0x0102
  /begin DAQ_EVENT VARIABLE /end DAQ_EVENT
 /end IF_DATA
/end MEASUREMENT
/begin MEASUREMENT CtPSwtActr_swtConfActrCoorrSimpleC "" UBYTE OneToOne 1 100 0.00 255.0 FORMAT "%5.1" ECU_ADDRESS 0x600235D0 /end MEASUREMENT
/begin MEASUREMENT CtPSwtActr_swtConfActrElecDrvrSimpleC "" UBYTE OneToOne 1 100 0.00 255.0 FORMAT "%5.1" ECU_ADDRESS 0x600235CF /end MEASUREMENT
/begin MEASUREMENT CtPSwtActr_swtConfActrElecMonSimpleC "" UBYTE OneToOne 1 100 0.00 255.0 FORMAT "%5.1" ECU_ADDRESS 0x600235CE /end MEASUREMENT
/begin MEASUREMENT CtPSwtActr_swtConfActrPsDrvrSimpleC "" UBYTE OneToOne 1 100 0.00 255.0 FORMAT "%5.1" ECU_ADDRESS 0x600235CD /end MEASUREMENT
/begin MEASUREMENT CtPSwtDiag_DDstSnsrState_mp "" UBYTE OneToOne 1 100 0.00 255.0 FORMAT "%5.1" ECU_ADDRESS 0x70006C24 /end MEASUREMENT
/begin MEASUREMENT CtPSwtDiag_FirCalc.cntrAvrgZr " / Counter for 0-division in FIR (indicates failure)" UBYTE OneToOne 1 100 0.00 255.0 FORMAT "%5.1" ECU_ADDRESS 0x6001F502 /end MEASUREMENT
/begin MEASUREMENT CtPSwtDiag_FirCalc.flgRdDne " / FIR: reading from uRaw-sum done" UBYTE OneToOne 1 100 0.00 1.000 BIT_MASK 0x1 FORMAT "%5.3" ECU_ADDRESS 0x6001F503 /end MEASUREMENT
/begin MEASUREMENT CtPSwtDiag_FirCalc.uRawAvrg " / FIR: simple average calculated uRaw" SWORD Volt 1 100 -6553.600 6553.400 FORMAT "%8.3" ECU_ADDRESS 0x6001F504 /end MEASUREMENT
/begin MEASUREMENT CtPSwtDiag_FirCalc.uRawFir " / FIR: Calculated uRaw" SWORD Volt 1 100 -6553.600 6553.400 FORMAT "%8.3" ECU_ADDRESS 0x6001F506 /end MEASUREMENT
/begin MEASUREMENT CtPSwtDiag_FirRead.cntr " / Counter for simple average FIR" UBYTE OneToOne 1 100 0.00 255.0 FORMAT "%5.1" ECU_ADDRESS 0x60000A44 /end MEASUREMENT
/begin MEASUREMENT CtPSwtDiag_FirRead.flgFirstRun " / FIR: 1st run after init" UBYTE OneToOne 1 100 0.00 1.000 BIT_MASK 0x1 FORMAT "%5.3" ECU_ADDRESS 0x60000A45 /end MEASUREMENT
/begin MEASUREMENT CtPSwtDiag_FirRead.idxArr " / FIR ringbuffer: actual index" UBYTE OneToOne 1 100 0.00 255.0 FORMAT "%5.1" ECU_ADDRESS 0x60000A46 /end MEASUREMENT
/begin MEASUREMENT CtPSwtDiag_FirRead.uSum " / Simple average FIR: sum of uRaws" SLONG Volt 1 100 -429496729.600 429496729.400 FORMAT "%13.3" ECU_ADDRESS 0x60000A48 /end MEASUREMENT
/begin MEASUREMENT CtPSwtDiag_stMonStdSens "" ULONG OneToOne 1 100 0.00 4294967295.00 FORMAT "%13.2" ECU_ADDRESS 0x6000106C
 /begin IF_DATA XCPplus 0x0102
  /begin DAQ_EVENT VARIABLE /end DAQ_EVENT
 /end IF_DATA
/end MEASUREMENT
/begin MEASUREMENT CtPSwtDiag_stSnsrActv "" UBYTE OneToOne 1 100 0.00 255.0 BIT_MASK 0x1 FORMAT "%5.1" ECU_ADDRESS 0x600236DC
 /begin IF_DATA XCPplus 0x0102
  /begin DAQ_EVENT VARIABLE /end DAQ_EVENT
 /end IF_DATA
/end MEASUREMENT
/begin MEASUREMENT CtPSwtDiag_stSnsrDdCalc "" UBYTE OneToOne 1 100 0.00 255.0 BIT_MASK 0x1 FORMAT "%5.1" ECU_ADDRESS 0x600236DB
 /begin IF_DATA XCPplus 0x0102
  /begin DAQ_EVENT VARIABLE /end DAQ_EVENT
 /end IF_DATA
/end MEASUREMENT
/begin MEASUREMENT CtPSwtDiag_stSnsrDdReadCalc "" UBYTE OneToOne 1 100 0.00 255.0 BIT_MASK 0x1 FORMAT "%5.1" ECU_ADDRESS 0x600236DA
 /begin IF_DATA XCPplus 0x0102
  /begin DAQ_EVENT VARIABLE /end DAQ_EVENT
 /end IF_DATA
/end MEASUREMENT
/begin MEASUREMENT CtPSwtDiag_swtConfStdSens2C "" ULONG OneToOne 1 100 0.00 4294967295.00 FORMAT "%13.2" ECU_ADDRESS 0x60000A40 /end MEASUREMENT
/begin MEASUREMENT CtPSwtDiag_swtConfStdSensC "" ULONG OneToOne 1 100 0.00 4294967295.00 FORMAT "%13.2" ECU_ADDRESS 0x60000A3C /end MEASUREMENT
/begin MEASUREMENT CtPSwtDiag_swtConfStdSensSwVersC "" ULONG OneToOne 1 100 0.00 4294967295.00 FORMAT "%13.2" ECU_ADDRESS 0x60000A38 /end MEASUREMENT
/begin MEASUREMENT CtPSwtDiag_swtSensMode "" UBYTE OneToOne 1 100 0.00 255.0 FORMAT "%5.1" ECU_ADDRESS 0x60023806 /end MEASUREMENT
/begin MEASUREMENT CtPSwtDiag_swtSensPres "" UBYTE OneToOne 1 100 0.00 255.0 FORMAT "%5.1" ECU_ADDRESS 0x60023805
 /begin IF_DATA XCPplus 0x0102
  /begin DAQ_EVENT VARIABLE /end DAQ_EVENT
 /end IF_DATA
/end MEASUREMENT
/begin MEASUREMENT CtPSwtDiag_tiSRCMaxDefDeb "" SLONG Time_ms 1 100 -21474836480.0 21474836470.0 FORMAT "%13.1" ECU_ADDRESS 0x600010BC
 /begin IF_DATA XCPplus 0x0102
  /begin DAQ_EVENT VARIABLE /end DAQ_EVENT
 /end IF_DATA
/end MEASUREMENT
/begin MEASUREMENT CtPSwtDiag_tRefSnsr_mp "" SWORD Temp_Cels 1 100 -3549.940 3003.560 FORMAT "%8.3" ECU_ADDRESS 0x70006B42 /end MEASUREMENT
/begin MEASUREMENT CtPSwtDiag_tSensPT1Fltd_mp "" SWORD RBPtCel_u_1p0_1 1 100 -32768.00 32767.00 FORMAT "%8.2" ECU_ADDRESS 0x70006B40 /end MEASUREMENT
/begin MEASUREMENT CtPSwtDiag_uDynThresPhysRngHi_f_mp "" FLOAT32_IEEE RBPtCel_u_1p0_1 1 100 -1.00000000E+037 1.00000000E+037 FORMAT "%13.3" ECU_ADDRESS 0x700068FC /end MEASUREMENT
/begin MEASUREMENT CtPSwtDiag_uDynThresPhysRngLo_f_mp "" FLOAT32_IEEE RBPtCel_u_1p0_1 1 100 -1.00000000E+037 1.00000000E+037 FORMAT "%13.3" ECU_ADDRESS 0x700068F8 /end MEASUREMENT
/begin MEASUREMENT CtPSwtDiag_uRaw "" SWORD Volt 1 100 -6553.600 6553.400 FORMAT "%8.3" ECU_ADDRESS 0x6001FE2C
 /begin IF_DATA XCPplus 0x0102
  /begin DAQ_EVENT VARIABLE /end DAQ_EVENT
 /end IF_DATA
/end MEASUREMENT
/begin MEASUREMENT CtPSwtDiag_uRawPT1Fltd "" SWORD Volt 1 100 -6553.600 6553.400 FORMAT "%8.3" ECU_ADDRESS 0x6001FE2A
 /begin IF_DATA XCPplus 0x0102
  /begin DAQ_EVENT VARIABLE /end DAQ_EVENT
 /end IF_DATA
/end MEASUREMENT
/begin MEASUREMENT CtPSwtDiag_uRawPT1FltdSens "" SWORD Volt 1 100 -6553.600 6553.400 FORMAT "%8.3" ECU_ADDRESS 0x6001FE28
 /begin IF_DATA XCPplus 0x0102
  /begin DAQ_EVENT VARIABLE /end DAQ_EVENT
 /end IF_DATA
/end MEASUREMENT
/begin MEASUREMENT CtPSwtDiag_uRawUnFltd "" SWORD Volt 1 100 -6553.600 6553.400 FORMAT "%8.3" ECU_ADDRESS 0x6001FE26
 /begin IF_DATA XCPplus 0x0102
  /begin DAQ_EVENT VARIABLE /end DAQ_EVENT
 /end IF_DATA
/end MEASUREMENT
/begin MEASUREMENT CtPSwtDiag_uRaw_f "" FLOAT32_IEEE RBPtCel_u_1p0_2 1 100 -1.00000000E+037 1.00000000E+037 FORMAT "%13.3" ECU_ADDRESS 0x6000126C
 /begin IF_DATA XCPplus 0x0102
  /begin DAQ_EVENT VARIABLE /end DAQ_EVENT
 /end IF_DATA
/end MEASUREMENT
/begin MEASUREMENT CtPSwtDiag_uSensCpl "" SWORD OneToOne 1 100 -32768.00 32767.00 FORMAT "%8.2" ECU_ADDRESS 0x6001FE24
 /begin IF_DATA XCPplus 0x0102
  /begin DAQ_EVENT VARIABLE /end DAQ_EVENT
 /end IF_DATA
/end MEASUREMENT
/begin MEASUREMENT CtPSwtDiag_uSensGradLim_f_mp "" FLOAT32_IEEE RBPtCel_u_1p0_1 1 100 -1.00000000E+037 1.00000000E+037 FORMAT "%13.3" ECU_ADDRESS 0x70006900
 /begin IF_DATA XCPplus 0x0102
  /begin DAQ_EVENT VARIABLE /end DAQ_EVENT
 /end IF_DATA
/end MEASUREMENT
/begin MEASUREMENT CtPSwtDiag_uSensOffsCorrd_f "" FLOAT32_IEEE RBPtCel_u_1p0_1 1 100 -1.00000000E+037 1.00000000E+037 FORMAT "%13.3" ECU_ADDRESS 0x60001268
 /begin IF_DATA XCPplus 0x0102
  /begin DAQ_EVENT VARIABLE /end DAQ_EVENT
 /end IF_DATA
/end MEASUREMENT
/begin MEASUREMENT CtPSwtDiag_uSensUnFltd "" SWORD RBPtCel_u_1p0_1 1 100 -32768.00 32767.00 FORMAT "%8.2" ECU_ADDRESS 0x6001FE22
 /begin IF_DATA XCPplus 0x0102
  /begin DAQ_EVENT VARIABLE /end DAQ_EVENT
 /end IF_DATA
/end MEASUREMENT
/begin MEASUREMENT CtPSwtDiag_uSens_f "Raw physical value" FLOAT32_IEEE RBPtCel_u_1p0_1 1 100 -1.00000000E+037 1.00000000E+037 FORMAT "%13.3" ECU_ADDRESS 0x60001264
 /begin IF_DATA XCPplus 0x0102
  /begin DAQ_EVENT VARIABLE /end DAQ_EVENT
 /end IF_DATA
/end MEASUREMENT
/begin MEASUREMENT CtPSwtDiag_uUnFlt_f "" FLOAT32_IEEE RBPtCel_u_1p0_1 1 100 -1.00000000E+037 1.00000000E+037 FORMAT "%13.3" ECU_ADDRESS 0x60001260
 /begin IF_DATA XCPplus 0x0102
  /begin DAQ_EVENT VARIABLE /end DAQ_EVENT
 /end IF_DATA
/end MEASUREMENT
/begin MEASUREMENT CtPSwtDiag_u_f "" FLOAT32_IEEE RBPtCel_u_1p0_1 1 100 -1.00000000E+037 1.00000000E+037 FORMAT "%13.3" ECU_ADDRESS 0x6000125C
 /begin IF_DATA XCPplus 0x0102
  /begin DAQ_EVENT VARIABLE /end DAQ_EVENT
 /end IF_DATA
/end MEASUREMENT
/begin MEASUREMENT CtPSwtDiag_u_f_Sq "" UBYTE SigQly_COMPU_VERB 1 100 0.00 15.0000000000 FORMAT "%13.10" ECU_ADDRESS 0x60023804
 /begin IF_DATA XCPplus 0x0102
  /begin DAQ_EVENT VARIABLE /end DAQ_EVENT
 /end IF_DATA
/end MEASUREMENT
/begin MEASUREMENT DcChrgnCtrl_flgChrgnRdy "EV charging readiness" UBYTE B_TRUE 1 100 0.00 1.00000000000 BIT_MASK 0x1 FORMAT "%13.11" ECU_ADDRESS 0x70000288
 /begin IF_DATA XCPplus 0x0102
  /begin DAQ_EVENT VARIABLE /end DAQ_EVENT
 /end IF_DATA
/end MEASUREMENT
/begin MEASUREMENT DcChrgnCtrl_flgChrgnRetry "Charging will be resumed" UBYTE B_TRUE 1 100 0.00 1.00000000000 BIT_MASK 0x1 FORMAT "%13.11" ECU_ADDRESS 0x70000287
 /begin IF_DATA XCPplus 0x0102
  /begin DAQ_EVENT VARIABLE /end DAQ_EVENT
 /end IF_DATA
/end MEASUREMENT
/begin MEASUREMENT DcChrgnCtrl_flgChrgPrmExchReld "Charge parameter exchange is released" UBYTE B_TRUE 1 100 0.00 1.00000000000 BIT_MASK 0x1 FORMAT "%13.11" ECU_ADDRESS 0x700001A0
 /begin IF_DATA XCPplus 0x0102
  /begin DAQ_EVENT VARIABLE /end DAQ_EVENT
 /end IF_DATA
/end MEASUREMENT
/begin MEASUREMENT DcChrgnCtrl_flgDigComRqrdOld "Previous state of digital communication required" UBYTE B_TRUE 1 100 0.00 1.00000000000 BIT_MASK 0x1 FORMAT "%13.11" ECU_ADDRESS 0x7000019F
 /begin IF_DATA XCPplus 0x0102
  /begin DAQ_EVENT VARIABLE /end DAQ_EVENT
 /end IF_DATA
/end MEASUREMENT
/begin MEASUREMENT DcChrgnCtrl_flgInhb "Inhibit charging until plug is unplugged due to critical error" UBYTE B_TRUE 1 100 0.00 1.00000000000 BIT_MASK 0x1 FORMAT "%13.11" ECU_ADDRESS 0x7000019E
 /begin IF_DATA XCPplus 0x0102
  /begin DAQ_EVENT VARIABLE /end DAQ_EVENT
 /end IF_DATA
/end MEASUREMENT
/begin MEASUREMENT DcChrgnCtrl_flgIsoMeasmtDiReq "Insulation measurement disable request" UBYTE B_TRUE 1 100 0.00 1.00000000000 BIT_MASK 0x1 FORMAT "%13.11" ECU_ADDRESS 0x70000286
 /begin IF_DATA XCPplus 0x0102
  /begin DAQ_EVENT VARIABLE /end DAQ_EVENT
 /end IF_DATA
/end MEASUREMENT
/begin MEASUREMENT DcChrgnCtrl_flgStopReq "Charging stop request present" UBYTE B_TRUE 1 100 0.00 1.00000000000 BIT_MASK 0x1 FORMAT "%13.11" ECU_ADDRESS 0x7000019D
 /begin IF_DATA XCPplus 0x0102
  /begin DAQ_EVENT VARIABLE /end DAQ_EVENT
 /end IF_DATA
/end MEASUREMENT
/begin MEASUREMENT DcChrgnCtrl_flgV2GDiReq "V2G communication disable request (Terminate TCP)" UBYTE B_TRUE 1 100 0.00 1.00000000000 BIT_MASK 0x1 FORMAT "%13.11" ECU_ADDRESS 0x70000285
 /begin IF_DATA XCPplus 0x0102
  /begin DAQ_EVENT VARIABLE /end DAQ_EVENT
 /end IF_DATA
/end MEASUREMENT
/begin MEASUREMENT DcChrgnCtrl_flgWldChkReq "Welding check request" UBYTE B_TRUE 1 100 0.00 1.00000000000 BIT_MASK 0x1 FORMAT "%13.11" ECU_ADDRESS 0x70000284
 /begin IF_DATA XCPplus 0x0102
  /begin DAQ_EVENT VARIABLE /end DAQ_EVENT
 /end IF_DATA
/end MEASUREMENT
/begin MEASUREMENT DcChrgnCtrl_iChrgnMaxAvl "Maximum available charging current (excl. HV battery limit)" SWORD RBPtCel_i_0p03125_1 1 100 -1024.000 1023.969 FORMAT "%8.3" ECU_ADDRESS 0x6001FBB0
 /begin IF_DATA XCPplus 0x0102
  /begin DAQ_EVENT VARIABLE /end DAQ_EVENT
 /end IF_DATA
/end MEASUREMENT
/begin MEASUREMENT DcChrgnCtrl_iChrgnReq "target current request" SWORD RBPtCel_i_0p03125_1 1 100 -1024.000 1023.969 FORMAT "%8.3" ECU_ADDRESS 0x6001FBAE
 /begin IF_DATA XCPplus 0x0102
  /begin DAQ_EVENT VARIABLE /end DAQ_EVENT
 /end IF_DATA
/end MEASUREMENT
/begin MEASUREMENT DcChrgnCtrl_pwrChrgnOut "Actual output charging power" SWORD RBPtCel_pwr_25p0_1 1 100 -819200.0 819175.0 FORMAT "%8.1" ECU_ADDRESS 0x6001FBAC
 /begin IF_DATA XCPplus 0x0102
  /begin DAQ_EVENT VARIABLE /end DAQ_EVENT
 /end IF_DATA
/end MEASUREMENT
/begin MEASUREMENT DcChrgnCtrl_ratSocChrgnStop "Target SOC to stop charging" SWORD Prc 1 100 -400.0000 399.9878 FORMAT "%8.4" ECU_ADDRESS 0x6001FBAA
 /begin IF_DATA XCPplus 0x0102
  /begin DAQ_EVENT VARIABLE /end DAQ_EVENT
 /end IF_DATA
/end MEASUREMENT
/begin MEASUREMENT DcChrgnCtrl_stChrgn "Active charging state" UBYTE ChrgCtrl_stChrgn_VERB 1 100 0.00 6.00000000000 FORMAT "%13.11" ECU_ADDRESS 0x600235CB
 /begin IF_DATA XCPplus 0x0102
  /begin DAQ_EVENT VARIABLE /end DAQ_EVENT
 /end IF_DATA
/end MEASUREMENT
/begin MEASUREMENT DcChrgnCtrl_stChrgnCntctReq "Charging contactors request" UBYTE ChrgCtrl_stChrgnCntctReq_VERB 1 100 0.00 2.00000000000 FORMAT "%13.11" ECU_ADDRESS 0x600235CA
 /begin IF_DATA XCPplus 0x0102
  /begin DAQ_EVENT VARIABLE /end DAQ_EVENT
 /end IF_DATA
/end MEASUREMENT
/begin MEASUREMENT DcChrgnCtrl_stChrgnReq "Requested charging state" UBYTE ChrgCtrl_stChrgn_VERB 1 100 0.00 6.00000000000 FORMAT "%13.11" ECU_ADDRESS 0x600235C9
 /begin IF_DATA XCPplus 0x0102
  /begin DAQ_EVENT VARIABLE /end DAQ_EVENT
 /end IF_DATA
/end MEASUREMENT
/begin MEASUREMENT DcChrgnCtrl_stChrgnSub "Active sub charging state" UBYTE ChrgCtrl_stChrgnSub_VERB 1 100 0.00 11.0000000000 FORMAT "%13.10" ECU_ADDRESS 0x600235C8
 /begin IF_DATA XCPplus 0x0102
  /begin DAQ_EVENT VARIABLE /end DAQ_EVENT
 /end IF_DATA
/end MEASUREMENT
/begin MEASUREMENT DcChrgnCtrl_stCntct "Overall contactors state" UBYTE ChrgCntct_st_VERB 1 100 0.00 6.00000000000 FORMAT "%13.11" ECU_ADDRESS 0x60023169
 /begin IF_DATA XCPplus 0x0102
  /begin DAQ_EVENT VARIABLE /end DAQ_EVENT
 /end IF_DATA
/end MEASUREMENT
/begin MEASUREMENT DcChrgnCtrl_tiEvRdy "Elapsed time until EV is ready" UWORD RBPtCel_ti_0p01_1 1 100 0.00 655.3500 FORMAT "%8.4" ECU_ADDRESS 0x6001F500
 /begin IF_DATA XCPplus 0x0102
  /begin DAQ_EVENT VARIABLE /end DAQ_EVENT
 /end IF_DATA
/end MEASUREMENT
/begin MEASUREMENT DcChrgnCtrl_tiGpt "General purpose timer" UWORD RBPtCel_ti_0p01_1 1 100 0.00 655.3500 FORMAT "%8.4" ECU_ADDRESS 0x6001F4FE
 /begin IF_DATA XCPplus 0x0102
  /begin DAQ_EVENT VARIABLE /end DAQ_EVENT
 /end IF_DATA
/end MEASUREMENT
/begin MEASUREMENT DcChrgnCtrl_tiV2GTmr "Timer for V2G disable request" UWORD RBPtCel_ti_0p01_1 1 100 0.00 655.3500 FORMAT "%8.4" ECU_ADDRESS 0x6001F4FC
 /begin IF_DATA XCPplus 0x0102
  /begin DAQ_EVENT VARIABLE /end DAQ_EVENT
 /end IF_DATA
/end MEASUREMENT
/begin MEASUREMENT DcChrgnCtrl_uChrgnReq "Requested max. charging current" SWORD RBPtCel_u_0p1_1 1 100 -3276.800 3276.700 FORMAT "%8.3" ECU_ADDRESS 0x6001FBA8
 /begin IF_DATA XCPplus 0x0102
  /begin DAQ_EVENT VARIABLE /end DAQ_EVENT
 /end IF_DATA
/end MEASUREMENT
/begin MEASUREMENT DcChrgnRlyNegPosn_st "Debounced switch status" UBYTE B_TRUE 1 100 0.00 1.00000000000 BIT_MASK 0x1 FORMAT "%13.11" ECU_ADDRESS 0x70000259
 /begin IF_DATA XCPplus 0x0102
  /begin DAQ_EVENT VARIABLE /end DAQ_EVENT
 /end IF_DATA
/end MEASUREMENT
/begin MEASUREMENT DcChrgnRlyNegPosn_stRaw "" UBYTE B_TRUE 1 100 0.00 1.00000000000 BIT_MASK 0x1 FORMAT "%13.11" ECU_ADDRESS 0x70000258
 /begin IF_DATA XCPplus 0x0102
  /begin DAQ_EVENT VARIABLE /end DAQ_EVENT
 /end IF_DATA
/end MEASUREMENT
/begin MEASUREMENT DcChrgnRlyNegPosn_st_Sq "" UBYTE SigQly_COMPU_VERB 1 100 0.00 15.0000000000 FORMAT "%13.10" ECU_ADDRESS 0x700014C1
 /begin IF_DATA XCPplus 0x0102
  /begin DAQ_EVENT VARIABLE /end DAQ_EVENT
 /end IF_DATA
/end MEASUREMENT
/begin MEASUREMENT DcChrgnRlyPosPosn_st "Debounced switch status" UBYTE B_TRUE 1 100 0.00 1.00000000000 BIT_MASK 0x1 FORMAT "%13.11" ECU_ADDRESS 0x70000257
 /begin IF_DATA XCPplus 0x0102
  /begin DAQ_EVENT VARIABLE /end DAQ_EVENT
 /end IF_DATA
/end MEASUREMENT
/begin MEASUREMENT DcChrgnRlyPosPosn_stRaw "" UBYTE B_TRUE 1 100 0.00 1.00000000000 BIT_MASK 0x1 FORMAT "%13.11" ECU_ADDRESS 0x70000256
 /begin IF_DATA XCPplus 0x0102
  /begin DAQ_EVENT VARIABLE /end DAQ_EVENT
 /end IF_DATA
/end MEASUREMENT
/begin MEASUREMENT DcChrgnRlyPosPosn_st_Sq "" UBYTE SigQly_COMPU_VERB 1 100 0.00 15.0000000000 FORMAT "%13.10" ECU_ADDRESS 0x700014C0
 /begin IF_DATA XCPplus 0x0102
  /begin DAQ_EVENT VARIABLE /end DAQ_EVENT
 /end IF_DATA
/end MEASUREMENT
/begin MEASUREMENT DcChrgrIntkT2_DDstSnsrState_mp "" UBYTE OneToOne 1 100 0.00 255.0 FORMAT "%5.1" ECU_ADDRESS 0x70006C23 /end MEASUREMENT
/begin MEASUREMENT DcChrgrIntkT2_FirCalc.cntrAvrgZr " / Counter for 0-division in FIR (indicates failure)" UBYTE OneToOne 1 100 0.00 255.0 FORMAT "%5.1" ECU_ADDRESS 0x6001F4F6 /end MEASUREMENT
/begin MEASUREMENT DcChrgrIntkT2_FirCalc.flgRdDne " / FIR: reading from uRaw-sum done" UBYTE OneToOne 1 100 0.00 1.000 BIT_MASK 0x1 FORMAT "%5.3" ECU_ADDRESS 0x6001F4F7 /end MEASUREMENT
/begin MEASUREMENT DcChrgrIntkT2_FirCalc.uRawAvrg " / FIR: simple average calculated uRaw" SWORD Volt 1 100 -6553.600 6553.400 FORMAT "%8.3" ECU_ADDRESS 0x6001F4F8 /end MEASUREMENT
/begin MEASUREMENT DcChrgrIntkT2_FirCalc.uRawFir " / FIR: Calculated uRaw" SWORD Volt 1 100 -6553.600 6553.400 FORMAT "%8.3" ECU_ADDRESS 0x6001F4FA /end MEASUREMENT
/begin MEASUREMENT DcChrgrIntkT2_FirRead.cntr " / Counter for simple average FIR" UBYTE OneToOne 1 100 0.00 255.0 FORMAT "%5.1" ECU_ADDRESS 0x60000A2C /end MEASUREMENT
/begin MEASUREMENT DcChrgrIntkT2_FirRead.flgFirstRun " / FIR: 1st run after init" UBYTE OneToOne 1 100 0.00 1.000 BIT_MASK 0x1 FORMAT "%5.3" ECU_ADDRESS 0x60000A2D /end MEASUREMENT
/begin MEASUREMENT DcChrgrIntkT2_FirRead.idxArr " / FIR ringbuffer: actual index" UBYTE OneToOne 1 100 0.00 255.0 FORMAT "%5.1" ECU_ADDRESS 0x60000A2E /end MEASUREMENT
/begin MEASUREMENT DcChrgrIntkT2_FirRead.uSum " / Simple average FIR: sum of uRaws" SLONG Volt 1 100 -429496729.600 429496729.400 FORMAT "%13.3" ECU_ADDRESS 0x60000A30 /end MEASUREMENT
/begin MEASUREMENT DcChrgrIntkT2_stMonStdSens "" ULONG OneToOne 1 100 0.00 4294967295.00 FORMAT "%13.2" ECU_ADDRESS 0x60001064
 /begin IF_DATA XCPplus 0x0102
  /begin DAQ_EVENT VARIABLE /end DAQ_EVENT
 /end IF_DATA
/end MEASUREMENT
/begin MEASUREMENT DcChrgrIntkT2_stSnsrActv "" UBYTE OneToOne 1 100 0.00 255.0 BIT_MASK 0x1 FORMAT "%5.1" ECU_ADDRESS 0x600236D5
 /begin IF_DATA XCPplus 0x0102
  /begin DAQ_EVENT VARIABLE /end DAQ_EVENT
 /end IF_DATA
/end MEASUREMENT
/begin MEASUREMENT DcChrgrIntkT2_stSnsrDdCalc "" UBYTE OneToOne 1 100 0.00 255.0 BIT_MASK 0x1 FORMAT "%5.1" ECU_ADDRESS 0x600236D4
 /begin IF_DATA XCPplus 0x0102
  /begin DAQ_EVENT VARIABLE /end DAQ_EVENT
 /end IF_DATA
/end MEASUREMENT
/begin MEASUREMENT DcChrgrIntkT2_stSnsrDdReadCalc "" UBYTE OneToOne 1 100 0.00 255.0 BIT_MASK 0x1 FORMAT "%5.1" ECU_ADDRESS 0x600236D3
 /begin IF_DATA XCPplus 0x0102
  /begin DAQ_EVENT VARIABLE /end DAQ_EVENT
 /end IF_DATA
/end MEASUREMENT
/begin MEASUREMENT DcChrgrIntkT2_swtConfStdSens2C "" ULONG OneToOne 1 100 0.00 4294967295.00 FORMAT "%13.2" ECU_ADDRESS 0x60000A28 /end MEASUREMENT
/begin MEASUREMENT DcChrgrIntkT2_swtConfStdSensC "" ULONG OneToOne 1 100 0.00 4294967295.00 FORMAT "%13.2" ECU_ADDRESS 0x60000A24 /end MEASUREMENT
/begin MEASUREMENT DcChrgrIntkT2_swtConfStdSensSwVersC "" ULONG OneToOne 1 100 0.00 4294967295.00 FORMAT "%13.2" ECU_ADDRESS 0x60000A20 /end MEASUREMENT
/begin MEASUREMENT DcChrgrIntkT2_swtSensMode "" UBYTE OneToOne 1 100 0.00 255.0 FORMAT "%5.1" ECU_ADDRESS 0x600237F5 /end MEASUREMENT
/begin MEASUREMENT DcChrgrIntkT2_swtSensPres "" UBYTE OneToOne 1 100 0.00 255.0 FORMAT "%5.1" ECU_ADDRESS 0x600237F4
 /begin IF_DATA XCPplus 0x0102
  /begin DAQ_EVENT VARIABLE /end DAQ_EVENT
 /end IF_DATA
/end MEASUREMENT
/begin MEASUREMENT DcChrgrIntkT2_tDynThresPhysRngHi_f_mp "" FLOAT32_IEEE RBPtCel_t_1p0_3 1 100 -1.00000000E+037 1.00000000E+037 FORMAT "%13.3" ECU_ADDRESS 0x700068F0 /end MEASUREMENT
/begin MEASUREMENT DcChrgrIntkT2_tDynThresPhysRngLo_f_mp "" FLOAT32_IEEE RBPtCel_t_1p0_3 1 100 -1.00000000E+037 1.00000000E+037 FORMAT "%13.3" ECU_ADDRESS 0x700068EC /end MEASUREMENT
/begin MEASUREMENT DcChrgrIntkT2_tiSRCMaxDefDeb "" SLONG Time_ms 1 100 -21474836480.0 21474836470.0 FORMAT "%13.1" ECU_ADDRESS 0x600010B8
 /begin IF_DATA XCPplus 0x0102
  /begin DAQ_EVENT VARIABLE /end DAQ_EVENT
 /end IF_DATA
/end MEASUREMENT
/begin MEASUREMENT DcChrgrIntkT2_tRefSnsr_mp "" SWORD Temp_Cels 1 100 -3549.940 3003.560 FORMAT "%8.3" ECU_ADDRESS 0x70006B3E /end MEASUREMENT
/begin MEASUREMENT DcChrgrIntkT2_tSensCpl "" SWORD OneToOne 1 100 -32768.00 32767.00 FORMAT "%8.2" ECU_ADDRESS 0x6001FE0E
 /begin IF_DATA XCPplus 0x0102
  /begin DAQ_EVENT VARIABLE /end DAQ_EVENT
 /end IF_DATA
/end MEASUREMENT
/begin MEASUREMENT DcChrgrIntkT2_tSensGradLim_f_mp "" FLOAT32_IEEE RBPtCel_t_1p0_3 1 100 -1.00000000E+037 1.00000000E+037 FORMAT "%13.3" ECU_ADDRESS 0x700068F4
 /begin IF_DATA XCPplus 0x0102
  /begin DAQ_EVENT VARIABLE /end DAQ_EVENT
 /end IF_DATA
/end MEASUREMENT
/begin MEASUREMENT DcChrgrIntkT2_tSensOffsCorrd_f "" FLOAT32_IEEE RBPtCel_t_1p0_3 1 100 -1.00000000E+037 1.00000000E+037 FORMAT "%13.3" ECU_ADDRESS 0x600011F8
 /begin IF_DATA XCPplus 0x0102
  /begin DAQ_EVENT VARIABLE /end DAQ_EVENT
 /end IF_DATA
/end MEASUREMENT
/begin MEASUREMENT DcChrgrIntkT2_tSensPT1Fltd_mp "" SWORD RBPtCel_t_1p0_3 1 100 -32768.00 32767.00 FORMAT "%8.2" ECU_ADDRESS 0x70006B3C /end MEASUREMENT
/begin MEASUREMENT DcChrgrIntkT2_tSensUnFltd "" SWORD RBPtCel_t_1p0_3 1 100 -32768.00 32767.00 FORMAT "%8.2" ECU_ADDRESS 0x6001FE0A
 /begin IF_DATA XCPplus 0x0102
  /begin DAQ_EVENT VARIABLE /end DAQ_EVENT
 /end IF_DATA
/end MEASUREMENT
/begin MEASUREMENT DcChrgrIntkT2_tSens_f "" FLOAT32_IEEE RBPtCel_t_1p0_3 1 100 -1.00000000E+037 1.00000000E+037 FORMAT "%13.3" ECU_ADDRESS 0x600011F4
 /begin IF_DATA XCPplus 0x0102
  /begin DAQ_EVENT VARIABLE /end DAQ_EVENT
 /end IF_DATA
/end MEASUREMENT
/begin MEASUREMENT DcChrgrIntkT2_tUnFlt_f "" FLOAT32_IEEE RBPtCel_t_1p0_3 1 100 -1.00000000E+037 1.00000000E+037 FORMAT "%13.3" ECU_ADDRESS 0x600011F0
 /begin IF_DATA XCPplus 0x0102
  /begin DAQ_EVENT VARIABLE /end DAQ_EVENT
 /end IF_DATA
/end MEASUREMENT
/begin MEASUREMENT DcChrgrIntkT2_t_f "Actual physical value" FLOAT32_IEEE RBPtCel_t_1p0_3 1 100 -1.00000000E+037 1.00000000E+037 FORMAT "%13.3" ECU_ADDRESS 0x600011EC
 /begin IF_DATA XCPplus 0x0102
  /begin DAQ_EVENT VARIABLE /end DAQ_EVENT
 /end IF_DATA
/end MEASUREMENT
/begin MEASUREMENT DcChrgrIntkT2_t_f_Sq "" UBYTE SigQly_COMPU_VERB 1 100 0.00 15.0000000000 FORMAT "%13.10" ECU_ADDRESS 0x600237F3
 /begin IF_DATA XCPplus 0x0102
  /begin DAQ_EVENT VARIABLE /end DAQ_EVENT
 /end IF_DATA
/end MEASUREMENT
/begin MEASUREMENT DcChrgrIntkT2_uRaw "" SWORD Volt 1 100 -6553.600 6553.400 FORMAT "%8.3" ECU_ADDRESS 0x6001FE08
 /begin IF_DATA XCPplus 0x0102
  /begin DAQ_EVENT VARIABLE /end DAQ_EVENT
 /end IF_DATA
/end MEASUREMENT
/begin MEASUREMENT DcChrgrIntkT2_uRawPT1Fltd "" SWORD Volt 1 100 -6553.600 6553.400 FORMAT "%8.3" ECU_ADDRESS 0x6001FE06
 /begin IF_DATA XCPplus 0x0102
  /begin DAQ_EVENT VARIABLE /end DAQ_EVENT
 /end IF_DATA
/end MEASUREMENT
/begin MEASUREMENT DcChrgrIntkT2_uRawPT1FltdSens "" SWORD Volt 1 100 -6553.600 6553.400 FORMAT "%8.3" ECU_ADDRESS 0x6001FE04
 /begin IF_DATA XCPplus 0x0102
  /begin DAQ_EVENT VARIABLE /end DAQ_EVENT
 /end IF_DATA
/end MEASUREMENT
/begin MEASUREMENT DcChrgrIntkT2_uRawUnFltd "" SWORD Volt 1 100 -6553.600 6553.400 FORMAT "%8.3" ECU_ADDRESS 0x6001FE02
 /begin IF_DATA XCPplus 0x0102
  /begin DAQ_EVENT VARIABLE /end DAQ_EVENT
 /end IF_DATA
/end MEASUREMENT
/begin MEASUREMENT DcChrgrIntkT2_uRaw_f "" FLOAT32_IEEE RBPtCel_u_1p0_2 1 100 -1.00000000E+037 1.00000000E+037 FORMAT "%13.3" ECU_ADDRESS 0x600011E8
 /begin IF_DATA XCPplus 0x0102
  /begin DAQ_EVENT VARIABLE /end DAQ_EVENT
 /end IF_DATA
/end MEASUREMENT
/begin MEASUREMENT DcChrgrIntkT_DDstSnsrState_mp "" UBYTE OneToOne 1 100 0.00 255.0 FORMAT "%5.1" ECU_ADDRESS 0x70006C22 /end MEASUREMENT
/begin MEASUREMENT DcChrgrIntkT_FirCalc.cntrAvrgZr " / Counter for 0-division in FIR (indicates failure)" UBYTE OneToOne 1 100 0.00 255.0 FORMAT "%5.1" ECU_ADDRESS 0x6001F4F0 /end MEASUREMENT
/begin MEASUREMENT DcChrgrIntkT_FirCalc.flgRdDne " / FIR: reading from uRaw-sum done" UBYTE OneToOne 1 100 0.00 1.000 BIT_MASK 0x1 FORMAT "%5.3" ECU_ADDRESS 0x6001F4F1 /end MEASUREMENT
/begin MEASUREMENT DcChrgrIntkT_FirCalc.uRawAvrg " / FIR: simple average calculated uRaw" SWORD Volt 1 100 -6553.600 6553.400 FORMAT "%8.3" ECU_ADDRESS 0x6001F4F2 /end MEASUREMENT
/begin MEASUREMENT DcChrgrIntkT_FirCalc.uRawFir " / FIR: Calculated uRaw" SWORD Volt 1 100 -6553.600 6553.400 FORMAT "%8.3" ECU_ADDRESS 0x6001F4F4 /end MEASUREMENT
/begin MEASUREMENT DcChrgrIntkT_FirRead.cntr " / Counter for simple average FIR" UBYTE OneToOne 1 100 0.00 255.0 FORMAT "%5.1" ECU_ADDRESS 0x60000A14 /end MEASUREMENT
/begin MEASUREMENT DcChrgrIntkT_FirRead.flgFirstRun " / FIR: 1st run after init" UBYTE OneToOne 1 100 0.00 1.000 BIT_MASK 0x1 FORMAT "%5.3" ECU_ADDRESS 0x60000A15 /end MEASUREMENT
/begin MEASUREMENT DcChrgrIntkT_FirRead.idxArr " / FIR ringbuffer: actual index" UBYTE OneToOne 1 100 0.00 255.0 FORMAT "%5.1" ECU_ADDRESS 0x60000A16 /end MEASUREMENT
/begin MEASUREMENT DcChrgrIntkT_FirRead.uSum " / Simple average FIR: sum of uRaws" SLONG Volt 1 100 -429496729.600 429496729.400 FORMAT "%13.3" ECU_ADDRESS 0x60000A18 /end MEASUREMENT
/begin MEASUREMENT DcChrgrIntkT_stMonStdSens "" ULONG OneToOne 1 100 0.00 4294967295.00 FORMAT "%13.2" ECU_ADDRESS 0x60001060
 /begin IF_DATA XCPplus 0x0102
  /begin DAQ_EVENT VARIABLE /end DAQ_EVENT
 /end IF_DATA
/end MEASUREMENT
/begin MEASUREMENT DcChrgrIntkT_stSnsrActv "" UBYTE OneToOne 1 100 0.00 255.0 BIT_MASK 0x1 FORMAT "%5.1" ECU_ADDRESS 0x600236D2
 /begin IF_DATA XCPplus 0x0102
  /begin DAQ_EVENT VARIABLE /end DAQ_EVENT
 /end IF_DATA
/end MEASUREMENT
/begin MEASUREMENT DcChrgrIntkT_stSnsrDdCalc "" UBYTE OneToOne 1 100 0.00 255.0 BIT_MASK 0x1 FORMAT "%5.1" ECU_ADDRESS 0x600236D1
 /begin IF_DATA XCPplus 0x0102
  /begin DAQ_EVENT VARIABLE /end DAQ_EVENT
 /end IF_DATA
/end MEASUREMENT
/begin MEASUREMENT DcChrgrIntkT_stSnsrDdReadCalc "" UBYTE OneToOne 1 100 0.00 255.0 BIT_MASK 0x1 FORMAT "%5.1" ECU_ADDRESS 0x600236D0
 /begin IF_DATA XCPplus 0x0102
  /begin DAQ_EVENT VARIABLE /end DAQ_EVENT
 /end IF_DATA
/end MEASUREMENT
/begin MEASUREMENT DcChrgrIntkT_swtConfStdSens2C "" ULONG OneToOne 1 100 0.00 4294967295.00 FORMAT "%13.2" ECU_ADDRESS 0x60000A10 /end MEASUREMENT
/begin MEASUREMENT DcChrgrIntkT_swtConfStdSensC "" ULONG OneToOne 1 100 0.00 4294967295.00 FORMAT "%13.2" ECU_ADDRESS 0x60000A0C /end MEASUREMENT
/begin MEASUREMENT DcChrgrIntkT_swtConfStdSensSwVersC "" ULONG OneToOne 1 100 0.00 4294967295.00 FORMAT "%13.2" ECU_ADDRESS 0x60000A08 /end MEASUREMENT
/begin MEASUREMENT DcChrgrIntkT_swtSensMode "" UBYTE OneToOne 1 100 0.00 255.0 FORMAT "%5.1" ECU_ADDRESS 0x600237F2 /end MEASUREMENT
/begin MEASUREMENT DcChrgrIntkT_swtSensPres "" UBYTE OneToOne 1 100 0.00 255.0 FORMAT "%5.1" ECU_ADDRESS 0x600237F1
 /begin IF_DATA XCPplus 0x0102
  /begin DAQ_EVENT VARIABLE /end DAQ_EVENT
 /end IF_DATA
/end MEASUREMENT
/begin MEASUREMENT DcChrgrIntkT_tDynThresPhysRngHi_f_mp "" FLOAT32_IEEE RBPtCel_t_1p0_3 1 100 -1.00000000E+037 1.00000000E+037 FORMAT "%13.3" ECU_ADDRESS 0x700068E4 /end MEASUREMENT
/begin MEASUREMENT DcChrgrIntkT_tDynThresPhysRngLo_f_mp "" FLOAT32_IEEE RBPtCel_t_1p0_3 1 100 -1.00000000E+037 1.00000000E+037 FORMAT "%13.3" ECU_ADDRESS 0x700068E0 /end MEASUREMENT
/begin MEASUREMENT DcChrgrIntkT_tiSRCMaxDefDeb "" SLONG Time_ms 1 100 -21474836480.0 21474836470.0 FORMAT "%13.1" ECU_ADDRESS 0x600010B4
 /begin IF_DATA XCPplus 0x0102
  /begin DAQ_EVENT VARIABLE /end DAQ_EVENT
 /end IF_DATA
/end MEASUREMENT
/begin MEASUREMENT DcChrgrIntkT_tRefSnsr_mp "" SWORD Temp_Cels 1 100 -3549.940 3003.560 FORMAT "%8.3" ECU_ADDRESS 0x70006B3A /end MEASUREMENT
/begin MEASUREMENT DcChrgrIntkT_tSensCpl "" SWORD OneToOne 1 100 -32768.00 32767.00 FORMAT "%8.2" ECU_ADDRESS 0x6001FE00
 /begin IF_DATA XCPplus 0x0102
  /begin DAQ_EVENT VARIABLE /end DAQ_EVENT
 /end IF_DATA
/end MEASUREMENT
/begin MEASUREMENT DcChrgrIntkT_tSensGradLim_f_mp "" FLOAT32_IEEE RBPtCel_t_1p0_3 1 100 -1.00000000E+037 1.00000000E+037 FORMAT "%13.3" ECU_ADDRESS 0x700068E8
 /begin IF_DATA XCPplus 0x0102
  /begin DAQ_EVENT VARIABLE /end DAQ_EVENT
 /end IF_DATA
/end MEASUREMENT
/begin MEASUREMENT DcChrgrIntkT_tSensOffsCorrd_f "" FLOAT32_IEEE RBPtCel_t_1p0_3 1 100 -1.00000000E+037 1.00000000E+037 FORMAT "%13.3" ECU_ADDRESS 0x600011E4
 /begin IF_DATA XCPplus 0x0102
  /begin DAQ_EVENT VARIABLE /end DAQ_EVENT
 /end IF_DATA
/end MEASUREMENT
/begin MEASUREMENT DcChrgrIntkT_tSensPT1Fltd_mp "" SWORD RBPtCel_t_1p0_3 1 100 -32768.00 32767.00 FORMAT "%8.2" ECU_ADDRESS 0x70006B38 /end MEASUREMENT
/begin MEASUREMENT DcChrgrIntkT_tSensUnFltd "" SWORD RBPtCel_t_1p0_3 1 100 -32768.00 32767.00 FORMAT "%8.2" ECU_ADDRESS 0x6001FDFC
 /begin IF_DATA XCPplus 0x0102
  /begin DAQ_EVENT VARIABLE /end DAQ_EVENT
 /end IF_DATA
/end MEASUREMENT
/begin MEASUREMENT DcChrgrIntkT_tSens_f "" FLOAT32_IEEE RBPtCel_t_1p0_3 1 100 -1.00000000E+037 1.00000000E+037 FORMAT "%13.3" ECU_ADDRESS 0x600011E0
 /begin IF_DATA XCPplus 0x0102
  /begin DAQ_EVENT VARIABLE /end DAQ_EVENT
 /end IF_DATA
/end MEASUREMENT
/begin MEASUREMENT DcChrgrIntkT_tUnFlt_f "" FLOAT32_IEEE RBPtCel_t_1p0_3 1 100 -1.00000000E+037 1.00000000E+037 FORMAT "%13.3" ECU_ADDRESS 0x600011DC
 /begin IF_DATA XCPplus 0x0102
  /begin DAQ_EVENT VARIABLE /end DAQ_EVENT
 /end IF_DATA
/end MEASUREMENT
/begin MEASUREMENT DcChrgrIntkT_t_f "Actual physical value" FLOAT32_IEEE RBPtCel_t_1p0_3 1 100 -1.00000000E+037 1.00000000E+037 FORMAT "%13.3" ECU_ADDRESS 0x600011D8
 /begin IF_DATA XCPplus 0x0102
  /begin DAQ_EVENT VARIABLE /end DAQ_EVENT
 /end IF_DATA
/end MEASUREMENT
/begin MEASUREMENT DcChrgrIntkT_t_f_Sq "" UBYTE SigQly_COMPU_VERB 1 100 0.00 15.0000000000 FORMAT "%13.10" ECU_ADDRESS 0x600237F0
 /begin IF_DATA XCPplus 0x0102
  /begin DAQ_EVENT VARIABLE /end DAQ_EVENT
 /end IF_DATA
/end MEASUREMENT
/begin MEASUREMENT DcChrgrIntkT_uRaw "" SWORD Volt 1 100 -6553.600 6553.400 FORMAT "%8.3" ECU_ADDRESS 0x6001FDFA
 /begin IF_DATA XCPplus 0x0102
  /begin DAQ_EVENT VARIABLE /end DAQ_EVENT
 /end IF_DATA
/end MEASUREMENT
/begin MEASUREMENT DcChrgrIntkT_uRawPT1Fltd "" SWORD Volt 1 100 -6553.600 6553.400 FORMAT "%8.3" ECU_ADDRESS 0x6001FDF8
 /begin IF_DATA XCPplus 0x0102
  /begin DAQ_EVENT VARIABLE /end DAQ_EVENT
 /end IF_DATA
/end MEASUREMENT
/begin MEASUREMENT DcChrgrIntkT_uRawPT1FltdSens "" SWORD Volt 1 100 -6553.600 6553.400 FORMAT "%8.3" ECU_ADDRESS 0x6001FDF6
 /begin IF_DATA XCPplus 0x0102
  /begin DAQ_EVENT VARIABLE /end DAQ_EVENT
 /end IF_DATA
/end MEASUREMENT
/begin MEASUREMENT DcChrgrIntkT_uRawUnFltd "" SWORD Volt 1 100 -6553.600 6553.400 FORMAT "%8.3" ECU_ADDRESS 0x6001FDF4
 /begin IF_DATA XCPplus 0x0102
  /begin DAQ_EVENT VARIABLE /end DAQ_EVENT
 /end IF_DATA
/end MEASUREMENT
/begin MEASUREMENT DcChrgrIntkT_uRaw_f "" FLOAT32_IEEE RBPtCel_u_1p0_2 1 100 -1.00000000E+037 1.00000000E+037 FORMAT "%13.3" ECU_ADDRESS 0x600011D4
 /begin IF_DATA XCPplus 0x0102
  /begin DAQ_EVENT VARIABLE /end DAQ_EVENT
 /end IF_DATA
/end MEASUREMENT
/begin MEASUREMENT Dcdc_iHvAct "Actual HV current of Dcdc-Converter" SWORD Curr_A_q0p03125_COMPU 1 100 -1024.000 1023.969 FORMAT "%8.3" ECU_ADDRESS 0x6001FBA2
 /begin IF_DATA XCPplus 0x0102
  /begin DAQ_EVENT VARIABLE /end DAQ_EVENT
 /end IF_DATA
/end MEASUREMENT
/begin MEASUREMENT Dcdc_iHvAct_Sq "Signal qualifier of Actual HV current of DCDC convertor" UBYTE SigQly_COMPU_VERB 1 100 0.00 15.0000000000 FORMAT "%13.10" ECU_ADDRESS 0x600235C7
 /begin IF_DATA XCPplus 0x0102
  /begin DAQ_EVENT VARIABLE /end DAQ_EVENT
 /end IF_DATA
/end MEASUREMENT
/begin MEASUREMENT Dcdc_iLvAct "DCDC converter current low voltage side" SWORD Curr_A_q0p03125_COMPU 1 100 -1024.000 1023.969 FORMAT "%8.3" ECU_ADDRESS 0x6001FB9C
 /begin IF_DATA XCPplus 0x0102
  /begin DAQ_EVENT VARIABLE /end DAQ_EVENT
 /end IF_DATA
/end MEASUREMENT
/begin MEASUREMENT Dcdc_iLvAct_Sq "Signal qualifier of Actual LV current of DCDC convertor" UBYTE SigQly_COMPU_VERB 1 100 0.00 15.0000000000 FORMAT "%13.10" ECU_ADDRESS 0x600235C6
 /begin IF_DATA XCPplus 0x0102
  /begin DAQ_EVENT VARIABLE /end DAQ_EVENT
 /end IF_DATA
/end MEASUREMENT
/begin MEASUREMENT Dcdc_pwrHvAct "Actual HV power of Dcdc-Converter" SWORD RBPtCel_pwr_25p0_1 1 100 -819200.0 819175.0 FORMAT "%8.1" ECU_ADDRESS 0x6001FB9A
 /begin IF_DATA XCPplus 0x0102
  /begin DAQ_EVENT VARIABLE /end DAQ_EVENT
 /end IF_DATA
/end MEASUREMENT
/begin MEASUREMENT Dcdc_pwrHvAct_Sq "Signal qualifier of Actual HV power of DCDC convertor" UBYTE SigQly_COMPU_VERB 1 100 0.00 15.0000000000 FORMAT "%13.10" ECU_ADDRESS 0x600235C5
 /begin IF_DATA XCPplus 0x0102
  /begin DAQ_EVENT VARIABLE /end DAQ_EVENT
 /end IF_DATA
/end MEASUREMENT
/begin MEASUREMENT Dcdc_pwrLoadMngtMaxPred "Maximum predicted load management power" SWORD RBPtCel_pwr_25p0_1 1 100 -819200.0 819175.0 FORMAT "%8.1" ECU_ADDRESS 0x6001FB98
 /begin IF_DATA XCPplus 0x0102
  /begin DAQ_EVENT VARIABLE /end DAQ_EVENT
 /end IF_DATA
/end MEASUREMENT
/begin MEASUREMENT Dcdc_uHvAct "Actual HV voltage of Dcdc-Converter" SWORD Volt_V_q0p03125_COMPU 1 100 -1024.000 1023.969 FORMAT "%8.3" ECU_ADDRESS 0x6001FB8E
 /begin IF_DATA XCPplus 0x0102
  /begin DAQ_EVENT VARIABLE /end DAQ_EVENT
 /end IF_DATA
/end MEASUREMENT
/begin MEASUREMENT Dcdc_uHvAct_Sq "Signal qualifier of Actual HV voltage of DCDC convertor" UBYTE SigQly_COMPU_VERB 1 100 0.00 15.0000000000 FORMAT "%13.10" ECU_ADDRESS 0x600235BE
 /begin IF_DATA XCPplus 0x0102
  /begin DAQ_EVENT VARIABLE /end DAQ_EVENT
 /end IF_DATA
/end MEASUREMENT
/begin MEASUREMENT Dcdc_uLvAct "DCDC converter voltage low voltage side" SWORD spg_q0p0039 1 100 -128.0000 127.9961 FORMAT "%8.4" ECU_ADDRESS 0x6001FB8C
 /begin IF_DATA XCPplus 0x0102
  /begin DAQ_EVENT VARIABLE /end DAQ_EVENT
 /end IF_DATA
/end MEASUREMENT
/begin MEASUREMENT Dcdc_uLvAct_Sq "Signal qualifier of Actual LV voltage of DCDC convertor" UBYTE SigQly_COMPU_VERB 1 100 0.00 15.0000000000 FORMAT "%13.10" ECU_ADDRESS 0x600235BD
 /begin IF_DATA XCPplus 0x0102
  /begin DAQ_EVENT VARIABLE /end DAQ_EVENT
 /end IF_DATA
/end MEASUREMENT
/begin MEASUREMENT DDRC_St.DFC_DcdcLvUDifMaxFlt "" ULONG DFC_OneToOne 1 100 0.00 536870911.000 BIT_MASK 0x1fffffff FORMAT "%13.3" ECU_ADDRESS 0x6001C364 /end MEASUREMENT
/begin MEASUREMENT DDRC_St.DFC_CtPSwtActrOL "" ULONG DFC_OneToOne 1 100 0.00 536870911.000 BIT_MASK 0x1fffffff FORMAT "%13.3" ECU_ADDRESS 0x6001CA24 /end MEASUREMENT
/begin MEASUREMENT DDRC_St.DFC_CtPSwtActrOvrTemp "" ULONG DFC_OneToOne 1 100 0.00 536870911.000 BIT_MASK 0x1fffffff FORMAT "%13.3" ECU_ADDRESS 0x6001CA28 /end MEASUREMENT
/begin MEASUREMENT DDRC_St.DFC_CtPSwtActrSCB "" ULONG DFC_OneToOne 1 100 0.00 536870911.000 BIT_MASK 0x1fffffff FORMAT "%13.3" ECU_ADDRESS 0x6001CA2C /end MEASUREMENT
/begin MEASUREMENT DDRC_St.DFC_CtPSwtActrSCG "" ULONG DFC_OneToOne 1 100 0.00 536870911.000 BIT_MASK 0x1fffffff FORMAT "%13.3" ECU_ADDRESS 0x6001CA30 /end MEASUREMENT
/begin MEASUREMENT DDRC_St.DFC_CtPSwtDiagSRCMin "" ULONG DFC_OneToOne 1 100 0.00 536870911.000 BIT_MASK 0x1fffffff FORMAT "%13.3" ECU_ADDRESS 0x6001CA34 /end MEASUREMENT
/begin MEASUREMENT DDRC_St.DFC_CtpCarrFrqSRCMin "" ULONG DFC_OneToOne 1 100 0.00 536870911.000 BIT_MASK 0x1fffffff FORMAT "%13.3" ECU_ADDRESS 0x6001CA38 /end MEASUREMENT
/begin MEASUREMENT DDRC_St.DFC_DcChrgrIntkT2SRCMin "" ULONG DFC_OneToOne 1 100 0.00 536870911.000 BIT_MASK 0x1fffffff FORMAT "%13.3" ECU_ADDRESS 0x6001CA3C /end MEASUREMENT
/begin MEASUREMENT DDRC_St.DFC_DcChrgrIntkTSRCMin "" ULONG DFC_OneToOne 1 100 0.00 536870911.000 BIT_MASK 0x1fffffff FORMAT "%13.3" ECU_ADDRESS 0x6001CA40 /end MEASUREMENT
/begin MEASUREMENT DDRC_St.DFC_CtPSwtDiagPhysRngHi "" UWORD DFC_OneToOne 1 100 0.00 8191.000 BIT_MASK 0x1fff FORMAT "%8.3" ECU_ADDRESS 0x60021F88 /end MEASUREMENT
/begin MEASUREMENT DDRC_St.DFC_CtPSwtDiagPhysRngLo "" UWORD DFC_OneToOne 1 100 0.00 8191.000 BIT_MASK 0x1fff FORMAT "%8.3" ECU_ADDRESS 0x60021F8A /end MEASUREMENT
/begin MEASUREMENT DDRC_St.DFC_CtPSwtDiagSRCOpn "" UWORD DFC_OneToOne 1 100 0.00 8191.000 BIT_MASK 0x1fff FORMAT "%8.3" ECU_ADDRESS 0x60021F8C /end MEASUREMENT
/begin MEASUREMENT DDRC_St.DFC_CtpCarrFrqPhysRngHi "" UWORD DFC_OneToOne 1 100 0.00 8191.000 BIT_MASK 0x1fff FORMAT "%8.3" ECU_ADDRESS 0x60021F8E /end MEASUREMENT
/begin MEASUREMENT DDRC_St.DFC_CtpCarrFrqPhysRngLo "" UWORD DFC_OneToOne 1 100 0.00 8191.000 BIT_MASK 0x1fff FORMAT "%8.3" ECU_ADDRESS 0x60021F90 /end MEASUREMENT
/begin MEASUREMENT DDRC_St.DFC_CtpCarrFrqSRCMax "" UWORD DFC_OneToOne 1 100 0.00 8191.000 BIT_MASK 0x1fff FORMAT "%8.3" ECU_ADDRESS 0x60021F92 /end MEASUREMENT
/begin MEASUREMENT DDRC_St.DFC_DcChrgrIntkT2PhysRngHi "" UWORD DFC_OneToOne 1 100 0.00 8191.000 BIT_MASK 0x1fff FORMAT "%8.3" ECU_ADDRESS 0x60021F94 /end MEASUREMENT
/begin MEASUREMENT DDRC_St.DFC_DcChrgrIntkT2PhysRngLo "" UWORD DFC_OneToOne 1 100 0.00 8191.000 BIT_MASK 0x1fff FORMAT "%8.3" ECU_ADDRESS 0x60021F96 /end MEASUREMENT
/begin MEASUREMENT DDRC_St.DFC_DcChrgrIntkT2SRCOpn "" UWORD DFC_OneToOne 1 100 0.00 8191.000 BIT_MASK 0x1fff FORMAT "%8.3" ECU_ADDRESS 0x60021F98 /end MEASUREMENT
/begin MEASUREMENT DDRC_St.DFC_DcChrgrIntkTPhysRngHi "" UWORD DFC_OneToOne 1 100 0.00 8191.000 BIT_MASK 0x1fff FORMAT "%8.3" ECU_ADDRESS 0x60021F9A /end MEASUREMENT
/begin MEASUREMENT DDRC_St.DFC_DcChrgrIntkTPhysRngLo "" UWORD DFC_OneToOne 1 100 0.00 8191.000 BIT_MASK 0x1fff FORMAT "%8.3" ECU_ADDRESS 0x60021F9C /end MEASUREMENT
/begin MEASUREMENT DDRC_St.DFC_DcChrgrIntkTSRCOpn "" UWORD DFC_OneToOne 1 100 0.00 8191.000 BIT_MASK 0x1fff FORMAT "%8.3" ECU_ADDRESS 0x60021F9E /end MEASUREMENT
/begin MEASUREMENT DFC_st.DFC_DcdcLvUDifMaxFlt "" UBYTE DFC_OneToOne 1 100 0.00 255.0 FORMAT "%5.1" ECU_ADDRESS 0x60034A3C /end MEASUREMENT
/begin MEASUREMENT DFC_st.DFC_CtPSwtActrOL "" UBYTE DFC_OneToOne 1 100 0.00 255.0 FORMAT "%5.1" ECU_ADDRESS 0x60034BEC /end MEASUREMENT
/begin MEASUREMENT DFC_st.DFC_CtPSwtActrOvrTemp "" UBYTE DFC_OneToOne 1 100 0.00 255.0 FORMAT "%5.1" ECU_ADDRESS 0x60034BED /end MEASUREMENT
/begin MEASUREMENT DFC_st.DFC_CtPSwtActrSCB "" UBYTE DFC_OneToOne 1 100 0.00 255.0 FORMAT "%5.1" ECU_ADDRESS 0x60034BEE /end MEASUREMENT
/begin MEASUREMENT DFC_st.DFC_CtPSwtActrSCG "" UBYTE DFC_OneToOne 1 100 0.00 255.0 FORMAT "%5.1" ECU_ADDRESS 0x60034BEF /end MEASUREMENT
/begin MEASUREMENT DFC_st.DFC_CtPSwtDiagSRCMin "" UBYTE DFC_OneToOne 1 100 0.00 255.0 FORMAT "%5.1" ECU_ADDRESS 0x60034BF0 /end MEASUREMENT
/begin MEASUREMENT DFC_st.DFC_CtpCarrFrqSRCMin "" UBYTE DFC_OneToOne 1 100 0.00 255.0 FORMAT "%5.1" ECU_ADDRESS 0x60034BF1 /end MEASUREMENT
/begin MEASUREMENT DFC_st.DFC_DcChrgrIntkT2SRCMin "" UBYTE DFC_OneToOne 1 100 0.00 255.0 FORMAT "%5.1" ECU_ADDRESS 0x60034BF2 /end MEASUREMENT
/begin MEASUREMENT DFC_st.DFC_DcChrgrIntkTSRCMin "" UBYTE DFC_OneToOne 1 100 0.00 255.0 FORMAT "%5.1" ECU_ADDRESS 0x60034BF3 /end MEASUREMENT
/begin MEASUREMENT DFC_st.DFC_CtPSwtDiagPhysRngHi "" UBYTE DFC_OneToOne 1 100 0.00 255.0 FORMAT "%5.1" ECU_ADDRESS 0x60034C1B /end MEASUREMENT
/begin MEASUREMENT DFC_st.DFC_CtPSwtDiagPhysRngLo "" UBYTE DFC_OneToOne 1 100 0.00 255.0 FORMAT "%5.1" ECU_ADDRESS 0x60034C1C /end MEASUREMENT
/begin MEASUREMENT DFC_st.DFC_CtPSwtDiagSRCOpn "" UBYTE DFC_OneToOne 1 100 0.00 255.0 FORMAT "%5.1" ECU_ADDRESS 0x60034C1D /end MEASUREMENT
/begin MEASUREMENT DFC_st.DFC_CtpCarrFrqPhysRngHi "" UBYTE DFC_OneToOne 1 100 0.00 255.0 FORMAT "%5.1" ECU_ADDRESS 0x60034C1E /end MEASUREMENT
/begin MEASUREMENT DFC_st.DFC_CtpCarrFrqPhysRngLo "" UBYTE DFC_OneToOne 1 100 0.00 255.0 FORMAT "%5.1" ECU_ADDRESS 0x60034C1F /end MEASUREMENT
/begin MEASUREMENT DFC_st.DFC_CtpCarrFrqSRCMax "" UBYTE DFC_OneToOne 1 100 0.00 255.0 FORMAT "%5.1" ECU_ADDRESS 0x60034C20 /end MEASUREMENT
/begin MEASUREMENT DFC_st.DFC_DcChrgrIntkT2PhysRngHi "" UBYTE DFC_OneToOne 1 100 0.00 255.0 FORMAT "%5.1" ECU_ADDRESS 0x60034C21 /end MEASUREMENT
/begin MEASUREMENT DFC_st.DFC_DcChrgrIntkT2PhysRngLo "" UBYTE DFC_OneToOne 1 100 0.00 255.0 FORMAT "%5.1" ECU_ADDRESS 0x60034C22 /end MEASUREMENT
/begin MEASUREMENT DFC_st.DFC_DcChrgrIntkT2SRCOpn "" UBYTE DFC_OneToOne 1 100 0.00 255.0 FORMAT "%5.1" ECU_ADDRESS 0x60034C23 /end MEASUREMENT
/begin MEASUREMENT DFC_st.DFC_DcChrgrIntkTPhysRngHi "" UBYTE DFC_OneToOne 1 100 0.00 255.0 FORMAT "%5.1" ECU_ADDRESS 0x60034C24 /end MEASUREMENT
/begin MEASUREMENT DFC_st.DFC_DcChrgrIntkTPhysRngLo "" UBYTE DFC_OneToOne 1 100 0.00 255.0 FORMAT "%5.1" ECU_ADDRESS 0x60034C25 /end MEASUREMENT
/begin MEASUREMENT DFC_st.DFC_DcChrgrIntkTSRCOpn "" UBYTE DFC_OneToOne 1 100 0.00 255.0 FORMAT "%5.1" ECU_ADDRESS 0x60034C26 /end MEASUREMENT
/begin MEASUREMENT DFC_st.DFC_CtPSwtDiagSRCMax "" UBYTE DFC_OneToOne 1 100 0.00 255.0 FORMAT "%5.1" ECU_ADDRESS 0x60034CC9 /end MEASUREMENT
/begin MEASUREMENT DFC_st.DFC_CtPSwtDiagTmpErr "" UBYTE DFC_OneToOne 1 100 0.00 255.0 FORMAT "%5.1" ECU_ADDRESS 0x60034CCA /end MEASUREMENT
/begin MEASUREMENT DFC_st.DFC_CtpCarrFrqTmpErr "" UBYTE DFC_OneToOne 1 100 0.00 255.0 FORMAT "%5.1" ECU_ADDRESS 0x60034CCB /end MEASUREMENT
/begin MEASUREMENT DFC_st.DFC_DcChrgrIntkT2SRCMax "" UBYTE DFC_OneToOne 1 100 0.00 255.0 FORMAT "%5.1" ECU_ADDRESS 0x60034CCC /end MEASUREMENT
/begin MEASUREMENT DFC_st.DFC_DcChrgrIntkT2TmpErr "" UBYTE DFC_OneToOne 1 100 0.00 255.0 FORMAT "%5.1" ECU_ADDRESS 0x60034CCD /end MEASUREMENT
/begin MEASUREMENT DFC_st.DFC_DcChrgrIntkTSRCMax "" UBYTE DFC_OneToOne 1 100 0.00 255.0 FORMAT "%5.1" ECU_ADDRESS 0x60034CCE /end MEASUREMENT
/begin MEASUREMENT DFC_st.DFC_DcChrgrIntkTTmpErr "" UBYTE DFC_OneToOne 1 100 0.00 255.0 FORMAT "%5.1" ECU_ADDRESS 0x60034CCF /end MEASUREMENT
/begin MEASUREMENT DINH_nrActvInhReas.FId_CoVMEvSysCptMaxErrPrim01 "" UWORD DINH_ct_Compu 1 100 -4095.000 4096.000 BIT_MASK 0x1fff FORMAT "%8.3" ECU_ADDRESS 0x600213CA /end MEASUREMENT
/begin MEASUREMENT DINH_nrActvInhReas.FId_CoVMEvSysCptMaxErrPrim02 "" UWORD DINH_ct_Compu 1 100 -4095.000 4096.000 BIT_MASK 0x1fff FORMAT "%8.3" ECU_ADDRESS 0x600213CC /end MEASUREMENT
/begin MEASUREMENT DINH_nrActvInhReas.FId_CoVMEvSysCptMaxErrPrim03 "" UWORD DINH_ct_Compu 1 100 -4095.000 4096.000 BIT_MASK 0x1fff FORMAT "%8.3" ECU_ADDRESS 0x600213CE /end MEASUREMENT
/begin MEASUREMENT DINH_nrActvInhReas.FId_CoVMEvSysCptMaxErrPrim04 "" UWORD DINH_ct_Compu 1 100 -4095.000 4096.000 BIT_MASK 0x1fff FORMAT "%8.3" ECU_ADDRESS 0x600213D0 /end MEASUREMENT
/begin MEASUREMENT DINH_nrActvInhReas.FId_CoVMEvSysCptMaxErrPrim05 "" UWORD DINH_ct_Compu 1 100 -4095.000 4096.000 BIT_MASK 0x1fff FORMAT "%8.3" ECU_ADDRESS 0x600213D2 /end MEASUREMENT
/begin MEASUREMENT DINH_nrActvInhReas.FId_CoVMEvSysCptMinErrPrim01 "" UWORD DINH_ct_Compu 1 100 -4095.000 4096.000 BIT_MASK 0x1fff FORMAT "%8.3" ECU_ADDRESS 0x600213D4 /end MEASUREMENT
/begin MEASUREMENT DINH_nrActvInhReas.FId_CoVMEvSysCptMinErrPrim02 "" UWORD DINH_ct_Compu 1 100 -4095.000 4096.000 BIT_MASK 0x1fff FORMAT "%8.3" ECU_ADDRESS 0x600213D6 /end MEASUREMENT
/begin MEASUREMENT DINH_nrActvInhReas.FId_CoVMEvSysCptMinErrPrim03 "" UWORD DINH_ct_Compu 1 100 -4095.000 4096.000 BIT_MASK 0x1fff FORMAT "%8.3" ECU_ADDRESS 0x600213D8 /end MEASUREMENT
/begin MEASUREMENT DINH_nrActvInhReas.FId_CoVMEvVehVVld "" UWORD DINH_ct_Compu 1 100 -4095.000 4096.000 BIT_MASK 0x1fff FORMAT "%8.3" ECU_ADDRESS 0x600213DA /end MEASUREMENT
/begin MEASUREMENT DINH_nrActvInhReas.FId_CtPSwtActrMonOff "" UWORD DINH_ct_Compu 1 100 -4095.000 4096.000 BIT_MASK 0x1fff FORMAT "%8.3" ECU_ADDRESS 0x600213E0 /end MEASUREMENT
/begin MEASUREMENT DINH_nrActvInhReas.FId_CtPSwtActrOff "" UWORD DINH_ct_Compu 1 100 -4095.000 4096.000 BIT_MASK 0x1fff FORMAT "%8.3" ECU_ADDRESS 0x600213E2 /end MEASUREMENT
/begin MEASUREMENT DINH_nrActvInhReas.FId_CtPSwtActrPsOff "" UWORD DINH_ct_Compu 1 100 -4095.000 4096.000 BIT_MASK 0x1fff FORMAT "%8.3" ECU_ADDRESS 0x600213E4 /end MEASUREMENT
/begin MEASUREMENT DINH_nrActvInhReas.FId_CtPSwtActrSnsr "" UWORD DINH_ct_Compu 1 100 -4095.000 4096.000 BIT_MASK 0x1fff FORMAT "%8.3" ECU_ADDRESS 0x600213E6 /end MEASUREMENT
/begin MEASUREMENT DINH_nrActvInhReas.FId_CtPSwtDiagEnhdSRCMax "" UWORD DINH_ct_Compu 1 100 -4095.000 4096.000 BIT_MASK 0x1fff FORMAT "%8.3" ECU_ADDRESS 0x600213E8 /end MEASUREMENT
/begin MEASUREMENT DINH_nrActvInhReas.FId_CtPSwtDiagFrzVal "" UWORD DINH_ct_Compu 1 100 -4095.000 4096.000 BIT_MASK 0x1fff FORMAT "%8.3" ECU_ADDRESS 0x600213EA /end MEASUREMENT
/begin MEASUREMENT DINH_nrActvInhReas.FId_CtPSwtDiagPhysRng "" UWORD DINH_ct_Compu 1 100 -4095.000 4096.000 BIT_MASK 0x1fff FORMAT "%8.3" ECU_ADDRESS 0x600213EC /end MEASUREMENT
/begin MEASUREMENT DINH_nrActvInhReas.FId_CtPSwtDiagRplVal "" UWORD DINH_ct_Compu 1 100 -4095.000 4096.000 BIT_MASK 0x1fff FORMAT "%8.3" ECU_ADDRESS 0x600213EE /end MEASUREMENT
/begin MEASUREMENT DINH_nrActvInhReas.FId_CtPSwtDiagSSpMon "" UWORD DINH_ct_Compu 1 100 -4095.000 4096.000 BIT_MASK 0x1fff FORMAT "%8.3" ECU_ADDRESS 0x600213F0 /end MEASUREMENT
/begin MEASUREMENT DINH_nrActvInhReas.FId_CtPSwtDiagTmpErrCnt "" UWORD DINH_ct_Compu 1 100 -4095.000 4096.000 BIT_MASK 0x1fff FORMAT "%8.3" ECU_ADDRESS 0x600213F2 /end MEASUREMENT
/begin MEASUREMENT DINH_nrActvInhReas.FId_CtpCarrFrqFrzVal "" UWORD DINH_ct_Compu 1 100 -4095.000 4096.000 BIT_MASK 0x1fff FORMAT "%8.3" ECU_ADDRESS 0x600213F4 /end MEASUREMENT
/begin MEASUREMENT DINH_nrActvInhReas.FId_CtpCarrFrqPhysRng "" UWORD DINH_ct_Compu 1 100 -4095.000 4096.000 BIT_MASK 0x1fff FORMAT "%8.3" ECU_ADDRESS 0x600213F6 /end MEASUREMENT
/begin MEASUREMENT DINH_nrActvInhReas.FId_CtpCarrFrqRplVal "" UWORD DINH_ct_Compu 1 100 -4095.000 4096.000 BIT_MASK 0x1fff FORMAT "%8.3" ECU_ADDRESS 0x600213F8 /end MEASUREMENT
/begin MEASUREMENT DINH_nrActvInhReas.FId_CtpCarrFrqSSpMon "" UWORD DINH_ct_Compu 1 100 -4095.000 4096.000 BIT_MASK 0x1fff FORMAT "%8.3" ECU_ADDRESS 0x600213FA /end MEASUREMENT
/begin MEASUREMENT DINH_nrActvInhReas.FId_CtpCarrFrqTmpErrCnt "" UWORD DINH_ct_Compu 1 100 -4095.000 4096.000 BIT_MASK 0x1fff FORMAT "%8.3" ECU_ADDRESS 0x600213FC /end MEASUREMENT
/begin MEASUREMENT DINH_nrActvInhReas.FId_DcChrgnCtrlChrgPrmExch "" UWORD DINH_ct_Compu 1 100 -4095.000 4096.000 BIT_MASK 0x1fff FORMAT "%8.3" ECU_ADDRESS 0x6002140A /end MEASUREMENT
/begin MEASUREMENT DINH_nrActvInhReas.FId_DcChrgrIntkT2EnhdSRCMax "" UWORD DINH_ct_Compu 1 100 -4095.000 4096.000 BIT_MASK 0x1fff FORMAT "%8.3" ECU_ADDRESS 0x6002140C /end MEASUREMENT
/begin MEASUREMENT DINH_nrActvInhReas.FId_DcChrgrIntkT2FrzVal "" UWORD DINH_ct_Compu 1 100 -4095.000 4096.000 BIT_MASK 0x1fff FORMAT "%8.3" ECU_ADDRESS 0x6002140E /end MEASUREMENT
/begin MEASUREMENT DINH_nrActvInhReas.FId_DcChrgrIntkT2PhysRng "" UWORD DINH_ct_Compu 1 100 -4095.000 4096.000 BIT_MASK 0x1fff FORMAT "%8.3" ECU_ADDRESS 0x60021410 /end MEASUREMENT
/begin MEASUREMENT DINH_nrActvInhReas.FId_DcChrgrIntkT2RplVal "" UWORD DINH_ct_Compu 1 100 -4095.000 4096.000 BIT_MASK 0x1fff FORMAT "%8.3" ECU_ADDRESS 0x60021412 /end MEASUREMENT
/begin MEASUREMENT DINH_nrActvInhReas.FId_DcChrgrIntkT2SSpMon "" UWORD DINH_ct_Compu 1 100 -4095.000 4096.000 BIT_MASK 0x1fff FORMAT "%8.3" ECU_ADDRESS 0x60021414 /end MEASUREMENT
/begin MEASUREMENT DINH_nrActvInhReas.FId_DcChrgrIntkT2TmpErrCnt "" UWORD DINH_ct_Compu 1 100 -4095.000 4096.000 BIT_MASK 0x1fff FORMAT "%8.3" ECU_ADDRESS 0x60021416 /end MEASUREMENT
/begin MEASUREMENT DINH_nrActvInhReas.FId_DcChrgrIntkTEnhdSRCMax "" UWORD DINH_ct_Compu 1 100 -4095.000 4096.000 BIT_MASK 0x1fff FORMAT "%8.3" ECU_ADDRESS 0x60021418 /end MEASUREMENT
/begin MEASUREMENT DINH_nrActvInhReas.FId_DcChrgrIntkTFrzVal "" UWORD DINH_ct_Compu 1 100 -4095.000 4096.000 BIT_MASK 0x1fff FORMAT "%8.3" ECU_ADDRESS 0x6002141A /end MEASUREMENT
/begin MEASUREMENT DINH_nrActvInhReas.FId_DcChrgrIntkTPhysRng "" UWORD DINH_ct_Compu 1 100 -4095.000 4096.000 BIT_MASK 0x1fff FORMAT "%8.3" ECU_ADDRESS 0x6002141C /end MEASUREMENT
/begin MEASUREMENT DINH_nrActvInhReas.FId_DcChrgrIntkTRplVal "" UWORD DINH_ct_Compu 1 100 -4095.000 4096.000 BIT_MASK 0x1fff FORMAT "%8.3" ECU_ADDRESS 0x6002141E /end MEASUREMENT
/begin MEASUREMENT DINH_nrActvInhReas.FId_DcChrgrIntkTSSpMon "" UWORD DINH_ct_Compu 1 100 -4095.000 4096.000 BIT_MASK 0x1fff FORMAT "%8.3" ECU_ADDRESS 0x60021420 /end MEASUREMENT
/begin MEASUREMENT DINH_nrActvInhReas.FId_DcChrgrIntkTTmpErrCnt "" UWORD DINH_ct_Compu 1 100 -4095.000 4096.000 BIT_MASK 0x1fff FORMAT "%8.3" ECU_ADDRESS 0x60021422 /end MEASUREMENT
/begin MEASUREMENT DINH_nrActvInhReas.FId_DcdcPwrLoadMngtMaxPred "" UWORD DINH_ct_Compu 1 100 -4095.000 4096.000 BIT_MASK 0x1fff FORMAT "%8.3" ECU_ADDRESS 0x60021426 /end MEASUREMENT
/begin MEASUREMENT DINH_stFId.FId_CoVMEvSysCptMaxErrPrim01 "" UWORD DFC_OneToOne 1 100 0.00 65535.00 FORMAT "%8.2" ECU_ADDRESS 0x600213CA /end MEASUREMENT
/begin MEASUREMENT DINH_stFId.FId_CoVMEvSysCptMaxErrPrim02 "" UWORD DFC_OneToOne 1 100 0.00 65535.00 FORMAT "%8.2" ECU_ADDRESS 0x600213CC /end MEASUREMENT
/begin MEASUREMENT DINH_stFId.FId_CoVMEvSysCptMaxErrPrim03 "" UWORD DFC_OneToOne 1 100 0.00 65535.00 FORMAT "%8.2" ECU_ADDRESS 0x600213CE /end MEASUREMENT
/begin MEASUREMENT DINH_stFId.FId_CoVMEvSysCptMaxErrPrim04 "" UWORD DFC_OneToOne 1 100 0.00 65535.00 FORMAT "%8.2" ECU_ADDRESS 0x600213D0 /end MEASUREMENT
/begin MEASUREMENT DINH_stFId.FId_CoVMEvSysCptMaxErrPrim05 "" UWORD DFC_OneToOne 1 100 0.00 65535.00 FORMAT "%8.2" ECU_ADDRESS 0x600213D2 /end MEASUREMENT
/begin MEASUREMENT DINH_stFId.FId_CoVMEvSysCptMinErrPrim01 "" UWORD DFC_OneToOne 1 100 0.00 65535.00 FORMAT "%8.2" ECU_ADDRESS 0x600213D4 /end MEASUREMENT
/begin MEASUREMENT DINH_stFId.FId_CoVMEvSysCptMinErrPrim02 "" UWORD DFC_OneToOne 1 100 0.00 65535.00 FORMAT "%8.2" ECU_ADDRESS 0x600213D6 /end MEASUREMENT
/begin MEASUREMENT DINH_stFId.FId_CoVMEvSysCptMinErrPrim03 "" UWORD DFC_OneToOne 1 100 0.00 65535.00 FORMAT "%8.2" ECU_ADDRESS 0x600213D8 /end MEASUREMENT
/begin MEASUREMENT DINH_stFId.FId_CoVMEvVehVVld "" UWORD DFC_OneToOne 1 100 0.00 65535.00 FORMAT "%8.2" ECU_ADDRESS 0x600213DA /end MEASUREMENT
/begin MEASUREMENT DINH_stFId.FId_CtPSwtActrMonOff "" UWORD DFC_OneToOne 1 100 0.00 65535.00 FORMAT "%8.2" ECU_ADDRESS 0x600213E0 /end MEASUREMENT
/begin MEASUREMENT DINH_stFId.FId_CtPSwtActrOff "" UWORD DFC_OneToOne 1 100 0.00 65535.00 FORMAT "%8.2" ECU_ADDRESS 0x600213E2 /end MEASUREMENT
/begin MEASUREMENT DINH_stFId.FId_CtPSwtActrPsOff "" UWORD DFC_OneToOne 1 100 0.00 65535.00 FORMAT "%8.2" ECU_ADDRESS 0x600213E4 /end MEASUREMENT
/begin MEASUREMENT DINH_stFId.FId_CtPSwtActrSnsr "" UWORD DFC_OneToOne 1 100 0.00 65535.00 FORMAT "%8.2" ECU_ADDRESS 0x600213E6 /end MEASUREMENT
/begin MEASUREMENT DINH_stFId.FId_CtPSwtDiagEnhdSRCMax "" UWORD DFC_OneToOne 1 100 0.00 65535.00 FORMAT "%8.2" ECU_ADDRESS 0x600213E8 /end MEASUREMENT
/begin MEASUREMENT DINH_stFId.FId_CtPSwtDiagFrzVal "" UWORD DFC_OneToOne 1 100 0.00 65535.00 FORMAT "%8.2" ECU_ADDRESS 0x600213EA /end MEASUREMENT
/begin MEASUREMENT DINH_stFId.FId_CtPSwtDiagPhysRng "" UWORD DFC_OneToOne 1 100 0.00 65535.00 FORMAT "%8.2" ECU_ADDRESS 0x600213EC /end MEASUREMENT
/begin MEASUREMENT DINH_stFId.FId_CtPSwtDiagRplVal "" UWORD DFC_OneToOne 1 100 0.00 65535.00 FORMAT "%8.2" ECU_ADDRESS 0x600213EE /end MEASUREMENT
/begin MEASUREMENT DINH_stFId.FId_CtPSwtDiagSSpMon "" UWORD DFC_OneToOne 1 100 0.00 65535.00 FORMAT "%8.2" ECU_ADDRESS 0x600213F0 /end MEASUREMENT
/begin MEASUREMENT DINH_stFId.FId_CtPSwtDiagTmpErrCnt "" UWORD DFC_OneToOne 1 100 0.00 65535.00 FORMAT "%8.2" ECU_ADDRESS 0x600213F2 /end MEASUREMENT
/begin MEASUREMENT DINH_stFId.FId_CtpCarrFrqFrzVal "" UWORD DFC_OneToOne 1 100 0.00 65535.00 FORMAT "%8.2" ECU_ADDRESS 0x600213F4 /end MEASUREMENT
/begin MEASUREMENT DINH_stFId.FId_CtpCarrFrqPhysRng "" UWORD DFC_OneToOne 1 100 0.00 65535.00 FORMAT "%8.2" ECU_ADDRESS 0x600213F6 /end MEASUREMENT
/begin MEASUREMENT DINH_stFId.FId_CtpCarrFrqRplVal "" UWORD DFC_OneToOne 1 100 0.00 65535.00 FORMAT "%8.2" ECU_ADDRESS 0x600213F8 /end MEASUREMENT
/begin MEASUREMENT DINH_stFId.FId_CtpCarrFrqSSpMon "" UWORD DFC_OneToOne 1 100 0.00 65535.00 FORMAT "%8.2" ECU_ADDRESS 0x600213FA /end MEASUREMENT
/begin MEASUREMENT DINH_stFId.FId_CtpCarrFrqTmpErrCnt "" UWORD DFC_OneToOne 1 100 0.00 65535.00 FORMAT "%8.2" ECU_ADDRESS 0x600213FC /end MEASUREMENT
/begin MEASUREMENT DINH_stFId.FId_DcChrgnCtrlChrgPrmExch "" UWORD DFC_OneToOne 1 100 0.00 65535.00 FORMAT "%8.2" ECU_ADDRESS 0x6002140A /end MEASUREMENT
/begin MEASUREMENT DINH_stFId.FId_DcChrgrIntkT2EnhdSRCMax "" UWORD DFC_OneToOne 1 100 0.00 65535.00 FORMAT "%8.2" ECU_ADDRESS 0x6002140C /end MEASUREMENT
/begin MEASUREMENT DINH_stFId.FId_DcChrgrIntkT2FrzVal "" UWORD DFC_OneToOne 1 100 0.00 65535.00 FORMAT "%8.2" ECU_ADDRESS 0x6002140E /end MEASUREMENT
/begin MEASUREMENT DINH_stFId.FId_DcChrgrIntkT2PhysRng "" UWORD DFC_OneToOne 1 100 0.00 65535.00 FORMAT "%8.2" ECU_ADDRESS 0x60021410 /end MEASUREMENT
/begin MEASUREMENT DINH_stFId.FId_DcChrgrIntkT2RplVal "" UWORD DFC_OneToOne 1 100 0.00 65535.00 FORMAT "%8.2" ECU_ADDRESS 0x60021412 /end MEASUREMENT
/begin MEASUREMENT DINH_stFId.FId_DcChrgrIntkT2SSpMon "" UWORD DFC_OneToOne 1 100 0.00 65535.00 FORMAT "%8.2" ECU_ADDRESS 0x60021414 /end MEASUREMENT
/begin MEASUREMENT DINH_stFId.FId_DcChrgrIntkT2TmpErrCnt "" UWORD DFC_OneToOne 1 100 0.00 65535.00 FORMAT "%8.2" ECU_ADDRESS 0x60021416 /end MEASUREMENT
/begin MEASUREMENT DINH_stFId.FId_DcChrgrIntkTEnhdSRCMax "" UWORD DFC_OneToOne 1 100 0.00 65535.00 FORMAT "%8.2" ECU_ADDRESS 0x60021418 /end MEASUREMENT
/begin MEASUREMENT DINH_stFId.FId_DcChrgrIntkTFrzVal "" UWORD DFC_OneToOne 1 100 0.00 65535.00 FORMAT "%8.2" ECU_ADDRESS 0x6002141A /end MEASUREMENT
/begin MEASUREMENT DINH_stFId.FId_DcChrgrIntkTPhysRng "" UWORD DFC_OneToOne 1 100 0.00 65535.00 FORMAT "%8.2" ECU_ADDRESS 0x6002141C /end MEASUREMENT
/begin MEASUREMENT DINH_stFId.FId_DcChrgrIntkTRplVal "" UWORD DFC_OneToOne 1 100 0.00 65535.00 FORMAT "%8.2" ECU_ADDRESS 0x6002141E /end MEASUREMENT
/begin MEASUREMENT DINH_stFId.FId_DcChrgrIntkTSSpMon "" UWORD DFC_OneToOne 1 100 0.00 65535.00 FORMAT "%8.2" ECU_ADDRESS 0x60021420 /end MEASUREMENT
/begin MEASUREMENT DINH_stFId.FId_DcChrgrIntkTTmpErrCnt "" UWORD DFC_OneToOne 1 100 0.00 65535.00 FORMAT "%8.2" ECU_ADDRESS 0x60021422 /end MEASUREMENT
/begin MEASUREMENT DINH_stFId.FId_DcdcPwrLoadMngtMaxPred "" UWORD DFC_OneToOne 1 100 0.00 65535.00 FORMAT "%8.2" ECU_ADDRESS 0x60021426 /end MEASUREMENT
/begin FUNCTION CoVMEv_TqCoorr "1400.0.0  Electric vehicle Motion Coordinator"
 /begin DEF_CHARACTERISTIC CoVMEv_dtqSysErrLimnMaxNeg01_C CoVMEv_dtqSysErrLimnMaxPos01_C CoVMEv_dtqSysErrLimnMinNeg01_C CoVMEv_dtqSysErrLimnMinPos01_C CoVMEv_tqSysErrLimnMaxErr01_T CoVMEv_tqSysErrLimnMaxErr02_T CoVMEv_tqSysErrLimnMaxErr03_T CoVMEv_tqSysErrLimnMaxErr04_T CoVMEv_tqSysErrLimnMaxErr05_T CoVMEv_tqSysErrLimnMinErr01_T CoVMEv_tqSysErrLimnMinErr02_T CoVMEv_tqSysErrLimnMinErr03_T CoVMEv_tqSysErrPrimLimnMax01_C CoVMEv_tqSysErrPrimLimnMax02_C CoVMEv_tqSysErrPrimLimnMax03_C CoVMEv_tqSysErrPrimLimnMax04_C CoVMEv_tqSysErrPrimLimnMax05_C CoVMEv_tqSysErrPrimLimnMin01_C CoVMEv_tqSysErrPrimLimnMin02_C CoVMEv_tqSysErrPrimLimnMin03_C /end DEF_CHARACTERISTIC
 /begin IN_MEASUREMENT VehDrvEv_tqPrimAxleDes VehV_v /end IN_MEASUREMENT
 /begin OUT_MEASUREMENT CoVMEv_tqDes01 CoVMEv_tqSysErrLimnMaxPrimAxle CoVMEv_tqSysErrLimnMinPrimAxle DINH_nrActvInhReas.FId_CoVMEvSysCptMaxErrPrim01 DINH_nrActvInhReas.FId_CoVMEvSysCptMaxErrPrim02 DINH_nrActvInhReas.FId_CoVMEvSysCptMaxErrPrim03 DINH_nrActvInhReas.FId_CoVMEvSysCptMaxErrPrim04 DINH_nrActvInhReas.FId_CoVMEvSysCptMaxErrPrim05 DINH_nrActvInhReas.FId_CoVMEvSysCptMinErrPrim01 DINH_nrActvInhReas.FId_CoVMEvSysCptMinErrPrim02 DINH_nrActvInhReas.FId_CoVMEvSysCptMinErrPrim03 DINH_nrActvInhReas.FId_CoVMEvVehVVld DINH_stFId.FId_CoVMEvSysCptMaxErrPrim01 DINH_stFId.FId_CoVMEvSysCptMaxErrPrim02 DINH_stFId.FId_CoVMEvSysCptMaxErrPrim03 DINH_stFId.FId_CoVMEvSysCptMaxErrPrim04 DINH_stFId.FId_CoVMEvSysCptMaxErrPrim05 DINH_stFId.FId_CoVMEvSysCptMinErrPrim01 DINH_stFId.FId_CoVMEvSysCptMinErrPrim02 DINH_stFId.FId_CoVMEvSysCptMinErrPrim03 DINH_stFId.FId_CoVMEvVehVVld /end OUT_MEASUREMENT
 /begin LOC_MEASUREMENT CoVMEv_flgEvSysCptMaxErrPrim CoVMEv_flgEvSysCptMinErrPrim CoVMEv_flgSysErrLimnMax CoVMEv_flgSysErrLimnMin CoVMEv_tqDesIn01 CoVMEv_tqSysErrLimn01MaxPrimAxle CoVMEv_tqSysErrLimn01MinPrimAxle CoVMEv_tqSysErrLimn02MaxPrimAxle CoVMEv_tqSysErrLimn02MinPrimAxle CoVMEv_tqSysErrLimn03MaxPrimAxle CoVMEv_tqSysErrLimn03MinPrimAxle CoVMEv_tqSysErrLimn04MaxPrimAxle CoVMEv_tqSysErrLimn05MaxPrimAxle CoVMEv_tqSysLimnMaxPrimAxle CoVMEv_tqSysLimnMinPrimAxle /end LOC_MEASUREMENT
 FUNCTION_VERSION "1400.0.0" /end FUNCTION
/begin FUNCTION CtpCarrFrq_DELib_StdSensDd "10.2.0"
 /begin DEF_CHARACTERISTIC CtpCarrFrq_PWMCal.rSRCMax_C CtpCarrFrq_PWMCal.rSRCMin_C CtpCarrFrq_PWMCal.tiSRCMax_C CtpCarrFrq_PWMCal.tiSRCMin_C CtpCarrFrq_PWMSensTransf_f_MAP DDRC_DurDeb.CtpCarrFrq_tiSRCMinDebOk_C DDRC_DurDeb.CtpCarrFrq_tiSRCMinDebDef_C DDRC_DurDeb.CtpCarrFrq_tiSRCMaxDebOk_C DDRC_DurDeb.CtpCarrFrq_tiSRCMaxDebDef_C DDRC_RatDeb.CtpCarrFrq_tiSRCMinUDRat_C DDRC_RatDeb.CtpCarrFrq_tiSRCMaxUDRat_C DFC_CtlMsk2.DFC_CtpCarrFrqSRCMin_C DFC_CtlMsk2.DFC_CtpCarrFrqSRCMax_C DFC_DisblMsk2.DFC_CtpCarrFrqSRCMin_C DFC_DisblMsk2.DFC_CtpCarrFrqSRCMax_C /end DEF_CHARACTERISTIC
 /begin REF_CHARACTERISTIC CtpCarrFrq_tiPT1Fil_C CtpCarrFrq_TransStg_f.Dfl_r32_C CtpCarrFrq_TransStg_f.stSensId_C /end REF_CHARACTERISTIC
 /begin IN_MEASUREMENT CtpCarrFrq_FirRead.cntr CtpCarrFrq_FirRead.flgFirstRun CtpCarrFrq_FirRead.idxArr CtpCarrFrq_FirRead.uSum CtpCarrFrq_stSnsrDdReadCalc CtpCarrFrq_swtConfStdSens2C CtpCarrFrq_swtConfStdSensC CtpCarrFrq_swtConfStdSensSwVersC CtpCarrFrq_uRawPT1FltdSens CtpCarrFrq_uRawUnFltd DELib_idxArrSnsr DELib_xArrSnsr /end IN_MEASUREMENT
 /begin OUT_MEASUREMENT CtpCarrFrq_FirCalc.cntrAvrgZr CtpCarrFrq_FirCalc.flgRdDne CtpCarrFrq_FirCalc.uRawAvrg CtpCarrFrq_FirCalc.uRawFir CtpCarrFrq_rActSensCpl CtpCarrFrq_rActSensUnFltd CtpCarrFrq_rActSens_f CtpCarrFrq_rDtyCycRaw CtpCarrFrq_rDtyCycRaw_f CtpCarrFrq_stSnsrDdCalc CtpCarrFrq_swtSensPres CtpCarrFrq_tiPerRaw CtpCarrFrq_tiPerRaw_f CtpCarrFrq_uRaw DDRC_St.DFC_CtpCarrFrqSRCMin DDRC_St.DFC_CtpCarrFrqSRCMax DFC_st.DFC_CtpCarrFrqSRCMin DFC_st.DFC_CtpCarrFrqSRCMax DINH_nrActvInhReas.FId_CtpCarrFrqSSpMon DINH_stFId.FId_CtpCarrFrqSSpMon /end OUT_MEASUREMENT
 /begin LOC_MEASUREMENT CtpCarrFrq_DDstSnsrState_mp CtpCarrFrq_tSensPT1Fltd_mp /end LOC_MEASUREMENT
 FUNCTION_VERSION "10.2.0" /end FUNCTION
/begin FUNCTION CtpCarrFrq_DELib_StdSensDdRead "10.4.0" /begin DEF_CHARACTERISTIC CtpCarrFrq_tiPT1Fil_C /end DEF_CHARACTERISTIC
 /begin IN_MEASUREMENT CtpCarrFrq_FirCalc.cntrAvrgZr CtpCarrFrq_FirCalc.flgRdDne CtpCarrFrq_FirCalc.uRawAvrg CtpCarrFrq_FirCalc.uRawFir CtpCarrFrq_swtConfStdSens2C CtpCarrFrq_swtConfStdSensC /end IN_MEASUREMENT
 /begin OUT_MEASUREMENT CtpCarrFrq_FirRead.cntr CtpCarrFrq_FirRead.flgFirstRun CtpCarrFrq_FirRead.idxArr CtpCarrFrq_FirRead.uSum CtpCarrFrq_stSnsrDdReadCalc CtpCarrFrq_uRawPT1Fltd CtpCarrFrq_uRawPT1FltdSens CtpCarrFrq_uRawUnFltd /end OUT_MEASUREMENT
 FUNCTION_VERSION "10.4.0" /end FUNCTION
/begin FUNCTION CtpCarrFrq_DELib_StdSensDdSENTSlowRead "3.2.0"
 /begin IN_MEASUREMENT CtpCarrFrq_swtConfStdSens2C CtpCarrFrq_swtConfStdSensC CtpCarrFrq_swtConfStdSensSwVersC /end IN_MEASUREMENT
 FUNCTION_VERSION "3.2.0" /end FUNCTION
/begin FUNCTION CtpCarrFrq_DELib_StdSensExtDiag "8.1.0"
 /begin IN_MEASUREMENT CtpCarrFrq_swtConfStdSensC CtpCarrFrq_swtConfStdSensSwVersC DELib_idxArrSnsr DELib_xArrSnsr DSM_TripChgFinshd SyC_stSub /end IN_MEASUREMENT
 FUNCTION_VERSION "8.1.0" /end FUNCTION
/begin FUNCTION CtpCarrFrq_DELib_StdSensInin "8.2.0"
 /begin DEF_CHARACTERISTIC CtpCarrFrq_swtConfStdSens2_C CtpCarrFrq_swtConfStdSensSwVers162_C CtpCarrFrq_swtConfStdSens_C /end DEF_CHARACTERISTIC
 /begin REF_CHARACTERISTIC CtpCarrFrq_tiPT1Fil_C /end REF_CHARACTERISTIC
 /begin OUT_MEASUREMENT CtpCarrFrq_swtConfStdSens2C CtpCarrFrq_swtConfStdSensC CtpCarrFrq_swtConfStdSensSwVersC CtpCarrFrq_swtSensMode /end OUT_MEASUREMENT
 FUNCTION_VERSION "8.2.0" /end FUNCTION
/begin FUNCTION CtpCarrFrq_DELib_StdSensVd "11.0.0"
 /begin DEF_CHARACTERISTIC CtpCarrFrq_drActGradLim_f_C CtpCarrFrq_rActDflVal_f_C CtpCarrFrq_rActHiLimit_f_C CtpCarrFrq_rActLoLimit_f_C CtpCarrFrq_RmpSlp_f.Pos_C CtpCarrFrq_RmpSlp_f.Neg_C CtpCarrFrq_tiPT1_f_C CtpCarrFrq_TransStg_f.Dfl_r32_C CtpCarrFrq_TransStg_f.stSensId_C /end DEF_CHARACTERISTIC
 /begin IN_MEASUREMENT CtpCarrFrq_rActSens_f CtpCarrFrq_stSnsrDdCalc CtpCarrFrq_swtConfStdSensC CtpCarrFrq_swtConfStdSensSwVersC /end IN_MEASUREMENT
 /begin OUT_MEASUREMENT CtpCarrFrq_rActSensOffsCorrd_f CtpCarrFrq_rActUnFlt_f CtpCarrFrq_rAct_f CtpCarrFrq_rAct_f_Sq DINH_nrActvInhReas.FId_CtpCarrFrqFrzVal DINH_nrActvInhReas.FId_CtpCarrFrqRplVal DINH_stFId.FId_CtpCarrFrqFrzVal DINH_stFId.FId_CtpCarrFrqRplVal /end OUT_MEASUREMENT
 /begin LOC_MEASUREMENT CtpCarrFrq_rActSensGradLim_f_mp /end LOC_MEASUREMENT
 FUNCTION_VERSION "11.0.0" /end FUNCTION
/begin FUNCTION CtpCarrFrq_DELib_StdSensVdMon "9.2.0"
 /begin DEF_CHARACTERISTIC CtpCarrFrq_numStdSens_C CtpCarrFrq_numTempErrDef_C CtpCarrFrq_numtSel_C CtpCarrFrq_rActEnhPhysSRCMax_f_MAP CtpCarrFrq_rActEnhPhysSRCMin_f_MAP CtpCarrFrq_stEnhPhysSRCRls_MAP CtpCarrFrq_tiEngOnMin_C CtpCarrFrq_tiTempErrOk_C CtpCarrFrq_tSnsrMax_f_C CtpCarrFrq_tSnsrMin_f_C DDRC_DurDeb.CtpCarrFrq_tiPhysRngHiDebOk_C DDRC_DurDeb.CtpCarrFrq_tiPhysRngHiDebDef_C DDRC_DurDeb.CtpCarrFrq_tiPhysRngLoDebOk_C DDRC_DurDeb.CtpCarrFrq_tiPhysRngLoDebDef_C DDRC_RatDeb.CtpCarrFrq_tiPhysRngHiUDRat_C DDRC_RatDeb.CtpCarrFrq_tiPhysRngLoUDRat_C DFC_CtlMsk2.DFC_CtpCarrFrqPhysRngHi_C DFC_CtlMsk2.DFC_CtpCarrFrqPhysRngLo_C DFC_CtlMsk2.DFC_CtpCarrFrqTmpErr_C DFC_DisblMsk2.DFC_CtpCarrFrqPhysRngHi_C DFC_DisblMsk2.DFC_CtpCarrFrqPhysRngLo_C DFC_DisblMsk2.DFC_CtpCarrFrqTmpErr_C /end DEF_CHARACTERISTIC
 /begin IN_MEASUREMENT CoEng_tiNormal CtpCarrFrq_rActSens_f CtpCarrFrq_stSnsrDdCalc CtpCarrFrq_swtConfStdSensC CtpCarrFrq_swtConfStdSensSwVersC DELib_idxArrSnsr DELib_xArrSnsr DSM_TripChgFinshd Epm_nEng InjCtl_qSetUnBal /end IN_MEASUREMENT
 /begin OUT_MEASUREMENT CtpCarrFrq_stSnsrActv DDRC_St.DFC_CtpCarrFrqPhysRngHi DDRC_St.DFC_CtpCarrFrqPhysRngLo DFC_st.DFC_CtpCarrFrqPhysRngHi DFC_st.DFC_CtpCarrFrqPhysRngLo DFC_st.DFC_CtpCarrFrqTmpErr DINH_nrActvInhReas.FId_CtpCarrFrqPhysRng DINH_nrActvInhReas.FId_CtpCarrFrqTmpErrCnt DINH_stFId.FId_CtpCarrFrqPhysRng DINH_stFId.FId_CtpCarrFrqTmpErrCnt /end OUT_MEASUREMENT
 /begin LOC_MEASUREMENT CtpCarrFrq_rActDynThresPhysRngHi_f_mp CtpCarrFrq_rActDynThresPhysRngLo_f_mp CtpCarrFrq_stMonStdSens /end LOC_MEASUREMENT
 FUNCTION_VERSION "9.2.0" /end FUNCTION
/begin FUNCTION CtPSwtActr_DELib_ActrCoorrSimple "1.3.0" /begin DEF_CHARACTERISTIC CtPSwtActr_stActrDis_C CtPSwtActr_swtConfActrCoorrSimple_C /end DEF_CHARACTERISTIC
 /begin IN_MEASUREMENT CtPSwtActr_rDesVal CtPSwtActr_stMonActrElecDrvrSimple DevLib_stPwrStgEnaCond /end IN_MEASUREMENT
 /begin OUT_MEASUREMENT CtPSwtActr_r CtPSwtActr_stMonActrCoorrSimple DINH_nrActvInhReas.FId_CtPSwtActrOff DINH_stFId.FId_CtPSwtActrOff /end OUT_MEASUREMENT
 /begin LOC_MEASUREMENT CtPSwtActr_swtConfActrCoorrSimpleC /end LOC_MEASUREMENT
 FUNCTION_VERSION "1.3.0" /end FUNCTION
/begin FUNCTION CtPSwtActr_DELib_ActrDevDrvrSimple "1.1.0" /begin IN_MEASUREMENT CtPSwtActr_rActr /end IN_MEASUREMENT /begin OUT_MEASUREMENT CtPSwtActr_rDesVal /end OUT_MEASUREMENT FUNCTION_VERSION "1.1.0" /end FUNCTION
/begin FUNCTION CtPSwtActr_DELib_ActrElecDrvrSimple "1.4.0"
 /begin DEF_CHARACTERISTIC CtPSwtActr_rCnv_CUR CtPSwtActr_stPwrStgDis_C CtPSwtActr_swtConfActrElecDrvrSimple_C /end DEF_CHARACTERISTIC
 /begin IN_MEASUREMENT CtPSwtActr_rDtyCyc CtPSwtActr_stMonActrCoorrSimple DevLib_stPwrStgEnaCond /end IN_MEASUREMENT
 /begin OUT_MEASUREMENT CtPSwtActr_rActr CtPSwtActr_stMonActrElecDrvrSimple DINH_nrActvInhReas.FId_CtPSwtActrPsOff DINH_stFId.FId_CtPSwtActrPsOff /end OUT_MEASUREMENT
 /begin LOC_MEASUREMENT CtPSwtActr_swtConfActrElecDrvrSimpleC /end LOC_MEASUREMENT
 FUNCTION_VERSION "1.4.0" /end FUNCTION
/begin FUNCTION CtPSwtActr_DELib_ActrElecMonSimple "1.4.0"
 /begin DEF_CHARACTERISTIC CtPSwtActr_psDiagDigOut.nrTstPls_C CtPSwtActr_psDiagDigOut.tiBtwElecFlt_C CtPSwtActr_psDiagDigOut.tiBtwOTFlt_C CtPSwtActr_stPwrStgDiaDis_C CtPSwtActr_swtConfActrElecMonSimple_C DDRC_DurDeb.CtPSwtActr_tiMonDFCDebOk_C DDRC_DurDeb.CtPSwtActr_tiMonDFCDebDef_C DDRC_RatDeb.CtPSwtActr_tiMonDFCUDRat_C DFC_CtlMsk2.DFC_CtPSwtActrOL_C DFC_CtlMsk2.DFC_CtPSwtActrOvrTemp_C DFC_CtlMsk2.DFC_CtPSwtActrSCB_C DFC_CtlMsk2.DFC_CtPSwtActrSCG_C DFC_DisblMsk2.DFC_CtPSwtActrOL_C DFC_DisblMsk2.DFC_CtPSwtActrOvrTemp_C DFC_DisblMsk2.DFC_CtPSwtActrSCB_C DFC_DisblMsk2.DFC_CtPSwtActrSCG_C /end DEF_CHARACTERISTIC
 /begin IN_MEASUREMENT CtPSwtActr_stMonActrCoorrSimple DevLib_stPwrStgEnaCond /end IN_MEASUREMENT
 /begin OUT_MEASUREMENT DDRC_St.DFC_CtPSwtActrOL DDRC_St.DFC_CtPSwtActrOvrTemp DDRC_St.DFC_CtPSwtActrSCB DDRC_St.DFC_CtPSwtActrSCG DFC_st.DFC_CtPSwtActrOL DFC_st.DFC_CtPSwtActrOvrTemp DFC_st.DFC_CtPSwtActrSCB DFC_st.DFC_CtPSwtActrSCG DINH_nrActvInhReas.FId_CtPSwtActrMonOff DINH_stFId.FId_CtPSwtActrMonOff /end OUT_MEASUREMENT
 /begin LOC_MEASUREMENT CtPSwtActr_swtConfActrElecMonSimpleC /end LOC_MEASUREMENT
 FUNCTION_VERSION "1.4.0" /end FUNCTION
/begin FUNCTION CtPSwtActr_DELib_ActrHldILimnSimple "1.3.0" FUNCTION_VERSION "1.3.0" /end FUNCTION
/begin FUNCTION CtPSwtActr_DELib_ActrPsDrvrSimple "1.5.0" /begin DEF_CHARACTERISTIC CtPSwtActr_swtConfActrPsDrvrSimple_C /end DEF_CHARACTERISTIC /begin IN_MEASUREMENT CtPSwtActr_stMonActrElecDrvrSimple /end IN_MEASUREMENT /begin OUT_MEASUREMENT CtPSwtActr_rDtyCyc CtPSwtActr_rPs /end OUT_MEASUREMENT /begin LOC_MEASUREMENT CtPSwtActr_swtConfActrPsDrvrSimpleC /end LOC_MEASUREMENT FUNCTION_VERSION "1.5.0" /end FUNCTION
/begin FUNCTION CtPSwtActr_DELib_ActrSnsrSimple "1.4.0" /begin DEF_CHARACTERISTIC CtPSwtActr_tiPt1Mdl_C /end DEF_CHARACTERISTIC /begin IN_MEASUREMENT CtPSwtActr_rDesVal CtPSwtActr_stMonActrElecDrvrSimple /end IN_MEASUREMENT
 /begin OUT_MEASUREMENT CtPSwtActr_rAct CtPSwtActr_rAct_Sq DINH_nrActvInhReas.FId_CtPSwtActrSnsr DINH_stFId.FId_CtPSwtActrSnsr /end OUT_MEASUREMENT
 FUNCTION_VERSION "1.4.0" /end FUNCTION
/begin FUNCTION CtPSwtActr_DELib_SimpleActr "5.8.0" FUNCTION_VERSION "5.8.0" /end FUNCTION
/begin FUNCTION CtPSwtActr_DELib_VrntCodSimple "1.3.0" FUNCTION_VERSION "1.3.0" /end FUNCTION
/begin FUNCTION CtPSwtDiag_DELib_StdSensDd "10.2.0"
 /begin DEF_CHARACTERISTIC CtPSwtDiag_ADCCal.numSRCTempSel_C CtPSwtDiag_ADCCal.tiSRCMaxDebOK_C CtPSwtDiag_ADCCal.uSRCMax_C CtPSwtDiag_ADCCal.uSRCMin_C CtPSwtDiag_ADCCal.uSRCOpn_C CtPSwtDiag_ADCSensTransf_f_CUR CtPSwtDiag_tiSRCMaxDefDeb_CUR DDRC_DurDeb.CtPSwtDiag_tiSRCMinDebOk_C DDRC_DurDeb.CtPSwtDiag_tiSRCMinDebDef_C DDRC_DurDeb.CtPSwtDiag_tiSRCOpnDebOk_C DDRC_DurDeb.CtPSwtDiag_tiSRCOpnDebDef_C DDRC_RatDeb.CtPSwtDiag_tiSRCMinUDRat_C DDRC_RatDeb.CtPSwtDiag_tiSRCOpnUDRat_C DFC_CtlMsk2.DFC_CtPSwtDiagSRCMin_C DFC_CtlMsk2.DFC_CtPSwtDiagSRCOpn_C DFC_CtlMsk2.DFC_CtPSwtDiagSRCMax_C DFC_DisblMsk2.DFC_CtPSwtDiagSRCMin_C DFC_DisblMsk2.DFC_CtPSwtDiagSRCOpn_C DFC_DisblMsk2.DFC_CtPSwtDiagSRCMax_C /end DEF_CHARACTERISTIC
 /begin REF_CHARACTERISTIC CtPSwtDiag_tiPT1Fil_C CtPSwtDiag_TransStg_f.Dfl_r32_C CtPSwtDiag_TransStg_f.stSensId_C /end REF_CHARACTERISTIC
 /begin IN_MEASUREMENT CtPSwtDiag_FirRead.cntr CtPSwtDiag_FirRead.flgFirstRun CtPSwtDiag_FirRead.idxArr CtPSwtDiag_FirRead.uSum CtPSwtDiag_stSnsrDdReadCalc CtPSwtDiag_swtConfStdSens2C CtPSwtDiag_swtConfStdSensC CtPSwtDiag_swtConfStdSensSwVersC CtPSwtDiag_uRawPT1FltdSens CtPSwtDiag_uRawUnFltd DELib_idxArrSnsr DELib_xArrSnsr /end IN_MEASUREMENT
 /begin OUT_MEASUREMENT CtPSwtDiag_FirCalc.cntrAvrgZr CtPSwtDiag_FirCalc.flgRdDne CtPSwtDiag_FirCalc.uRawAvrg CtPSwtDiag_FirCalc.uRawFir CtPSwtDiag_stSnsrDdCalc CtPSwtDiag_swtSensPres CtPSwtDiag_tiSRCMaxDefDeb CtPSwtDiag_uRaw CtPSwtDiag_uRaw_f CtPSwtDiag_uSensCpl CtPSwtDiag_uSensUnFltd CtPSwtDiag_uSens_f DDRC_St.DFC_CtPSwtDiagSRCMin DDRC_St.DFC_CtPSwtDiagSRCOpn DFC_st.DFC_CtPSwtDiagSRCMin DFC_st.DFC_CtPSwtDiagSRCOpn DFC_st.DFC_CtPSwtDiagSRCMax DINH_nrActvInhReas.FId_CtPSwtDiagEnhdSRCMax DINH_nrActvInhReas.FId_CtPSwtDiagSSpMon DINH_stFId.FId_CtPSwtDiagEnhdSRCMax DINH_stFId.FId_CtPSwtDiagSSpMon /end OUT_MEASUREMENT
 /begin LOC_MEASUREMENT CtPSwtDiag_DDstSnsrState_mp CtPSwtDiag_tRefSnsr_mp CtPSwtDiag_tSensPT1Fltd_mp /end LOC_MEASUREMENT
 FUNCTION_VERSION "10.2.0" /end FUNCTION
/begin FUNCTION CtPSwtDiag_DELib_StdSensDdRead "10.4.0" /begin DEF_CHARACTERISTIC CtPSwtDiag_tiPT1Fil_C /end DEF_CHARACTERISTIC
 /begin IN_MEASUREMENT CtPSwtDiag_FirCalc.cntrAvrgZr CtPSwtDiag_FirCalc.flgRdDne CtPSwtDiag_FirCalc.uRawAvrg CtPSwtDiag_FirCalc.uRawFir CtPSwtDiag_swtConfStdSens2C CtPSwtDiag_swtConfStdSensC /end IN_MEASUREMENT
 /begin OUT_MEASUREMENT CtPSwtDiag_FirRead.cntr CtPSwtDiag_FirRead.flgFirstRun CtPSwtDiag_FirRead.idxArr CtPSwtDiag_FirRead.uSum CtPSwtDiag_stSnsrDdReadCalc CtPSwtDiag_uRawPT1Fltd CtPSwtDiag_uRawPT1FltdSens CtPSwtDiag_uRawUnFltd /end OUT_MEASUREMENT
 FUNCTION_VERSION "10.4.0" /end FUNCTION
/begin FUNCTION CtPSwtDiag_DELib_StdSensDdSENTSlowRead "3.2.0"
 /begin IN_MEASUREMENT CtPSwtDiag_swtConfStdSens2C CtPSwtDiag_swtConfStdSensC CtPSwtDiag_swtConfStdSensSwVersC /end IN_MEASUREMENT
 FUNCTION_VERSION "3.2.0" /end FUNCTION
/begin FUNCTION CtPSwtDiag_DELib_StdSensExtDiag "8.1.0"
 /begin IN_MEASUREMENT CtPSwtDiag_swtConfStdSensC CtPSwtDiag_swtConfStdSensSwVersC DELib_idxArrSnsr DELib_xArrSnsr DSM_TripChgFinshd SyC_stSub /end IN_MEASUREMENT
 FUNCTION_VERSION "8.1.0" /end FUNCTION
/begin FUNCTION CtPSwtDiag_DELib_StdSensInin "8.2.0"
 /begin DEF_CHARACTERISTIC CtPSwtDiag_swtConfStdSens2_C CtPSwtDiag_swtConfStdSensSwVers162_C CtPSwtDiag_swtConfStdSens_C /end DEF_CHARACTERISTIC
 /begin REF_CHARACTERISTIC CtPSwtDiag_tiPT1Fil_C /end REF_CHARACTERISTIC
 /begin OUT_MEASUREMENT CtPSwtDiag_swtConfStdSens2C CtPSwtDiag_swtConfStdSensC CtPSwtDiag_swtConfStdSensSwVersC CtPSwtDiag_swtSensMode /end OUT_MEASUREMENT
 FUNCTION_VERSION "8.2.0" /end FUNCTION
/begin FUNCTION CtPSwtDiag_DELib_StdSensVd "11.0.0"
 /begin DEF_CHARACTERISTIC CtPSwtDiag_DigSensCal.tiDebPos_C CtPSwtDiag_DigSensCal.tiDebNeg_C CtPSwtDiag_duGradLim_f_C CtPSwtDiag_RmpSlp_f.Pos_C CtPSwtDiag_RmpSlp_f.Neg_C CtPSwtDiag_tiPT1_f_C CtPSwtDiag_TransStg_f.Dfl_r32_C CtPSwtDiag_TransStg_f.stSensId_C CtPSwtDiag_uDflVal_f_C CtPSwtDiag_uHiLimit_f_C CtPSwtDiag_uLoLimit_f_C /end DEF_CHARACTERISTIC
 /begin IN_MEASUREMENT CtPSwtDiag_stSnsrDdCalc CtPSwtDiag_swtConfStdSensC CtPSwtDiag_swtConfStdSensSwVersC CtPSwtDiag_uSens_f /end IN_MEASUREMENT
 /begin OUT_MEASUREMENT CtPSwtDiag_uSensOffsCorrd_f CtPSwtDiag_uUnFlt_f CtPSwtDiag_u_f CtPSwtDiag_u_f_Sq DINH_nrActvInhReas.FId_CtPSwtDiagFrzVal DINH_nrActvInhReas.FId_CtPSwtDiagRplVal DINH_stFId.FId_CtPSwtDiagFrzVal DINH_stFId.FId_CtPSwtDiagRplVal /end OUT_MEASUREMENT
 /begin LOC_MEASUREMENT CtPSwtDiag_uSensGradLim_f_mp /end LOC_MEASUREMENT
 FUNCTION_VERSION "11.0.0" /end FUNCTION
/begin FUNCTION CtPSwtDiag_DELib_StdSensVdMon "9.2.0"
 /begin DEF_CHARACTERISTIC CtPSwtDiag_numStdSens_C CtPSwtDiag_numTempErrDef_C CtPSwtDiag_numtSel_C CtPSwtDiag_stEnhPhysSRCRls_MAP CtPSwtDiag_tiEngOnMin_C CtPSwtDiag_tiTempErrOk_C CtPSwtDiag_tSnsrMax_f_C CtPSwtDiag_tSnsrMin_f_C CtPSwtDiag_uEnhPhysSRCMax_f_MAP CtPSwtDiag_uEnhPhysSRCMin_f_MAP DDRC_DurDeb.CtPSwtDiag_tiPhysRngHiDebOk_C DDRC_DurDeb.CtPSwtDiag_tiPhysRngHiDebDef_C DDRC_DurDeb.CtPSwtDiag_tiPhysRngLoDebOk_C DDRC_DurDeb.CtPSwtDiag_tiPhysRngLoDebDef_C DDRC_RatDeb.CtPSwtDiag_tiPhysRngHiUDRat_C DDRC_RatDeb.CtPSwtDiag_tiPhysRngLoUDRat_C DFC_CtlMsk2.DFC_CtPSwtDiagPhysRngHi_C DFC_CtlMsk2.DFC_CtPSwtDiagPhysRngLo_C DFC_CtlMsk2.DFC_CtPSwtDiagTmpErr_C DFC_DisblMsk2.DFC_CtPSwtDiagPhysRngHi_C DFC_DisblMsk2.DFC_CtPSwtDiagPhysRngLo_C DFC_DisblMsk2.DFC_CtPSwtDiagTmpErr_C /end DEF_CHARACTERISTIC
 /begin IN_MEASUREMENT CoEng_tiNormal CtPSwtDiag_stSnsrDdCalc CtPSwtDiag_swtConfStdSensC CtPSwtDiag_swtConfStdSensSwVersC CtPSwtDiag_uSens_f DELib_idxArrSnsr DELib_xArrSnsr DSM_TripChgFinshd Epm_nEng InjCtl_qSetUnBal /end IN_MEASUREMENT
 /begin OUT_MEASUREMENT CtPSwtDiag_stSnsrActv DDRC_St.DFC_CtPSwtDiagPhysRngHi DDRC_St.DFC_CtPSwtDiagPhysRngLo DFC_st.DFC_CtPSwtDiagPhysRngHi DFC_st.DFC_CtPSwtDiagPhysRngLo DFC_st.DFC_CtPSwtDiagTmpErr DINH_nrActvInhReas.FId_CtPSwtDiagPhysRng DINH_nrActvInhReas.FId_CtPSwtDiagTmpErrCnt DINH_stFId.FId_CtPSwtDiagPhysRng DINH_stFId.FId_CtPSwtDiagTmpErrCnt /end OUT_MEASUREMENT
 /begin LOC_MEASUREMENT CtPSwtDiag_stMonStdSens CtPSwtDiag_uDynThresPhysRngHi_f_mp CtPSwtDiag_uDynThresPhysRngLo_f_mp /end LOC_MEASUREMENT
 FUNCTION_VERSION "9.2.0" /end FUNCTION
/begin FUNCTION DASrvLib_AdpvPosnCtrl "1.0.1     This FC provides an adaptive position controller to control an electrical actuator via h-bridge." FUNCTION_VERSION "1.0.1" /end FUNCTION
/begin FUNCTION DASrvLib_ClnVrfy "1.0.0     Clean and Verify Function" FUNCTION_VERSION "1.0.0" /end FUNCTION
/begin FUNCTION DASrvLib_DblDioEvln "1.0.0     Evaluation of two DIO inputs with error handling" FUNCTION_VERSION "1.0.0" /end FUNCTION
/begin FUNCTION DASrvLib_DiagRngChk "1.1.0     Diagnosis range check on input signal" FUNCTION_VERSION "1.1.0" /end FUNCTION
/begin FUNCTION DASrvLib_GetAdcSrc "1.0.0     Analogue input port reading with signal range check" FUNCTION_VERSION "1.0.0" /end FUNCTION
/begin FUNCTION DASrvLib_GetAdcSrcQly "1.0.0     analogue input port reading with signal range check and quality status" FUNCTION_VERSION "1.0.0" /end FUNCTION
/begin FUNCTION DASrvLib_GetAdcSwt "1.0.0     ADC reading and provison of logical switch state" FUNCTION_VERSION "1.0.0" /end FUNCTION
/begin FUNCTION DASrvLib_GetAdcSwtDiag "1.0.0     Analogue input reading, provison of logical switch state and signal diagnosis" FUNCTION_VERSION "1.0.0" /end FUNCTION
/begin FUNCTION DASrvLib_GetDioDeb "1.0.0     DIO reading and debouncing" FUNCTION_VERSION "1.0.0" /end FUNCTION
/begin FUNCTION DASrvLib_GovDvtMon "1.0.0     Governor deviation monitoring" FUNCTION_VERSION "1.0.0" /end FUNCTION
/begin FUNCTION DASrvLib_OffsDetrmLimn "1.0.1     Offset Determination" FUNCTION_VERSION "1.0.1" /end FUNCTION
/begin FUNCTION DASrvLib_OffsDetrmRefZero "1.0.0     class for calculating offset with reference to zero" FUNCTION_VERSION "1.0.0" /end FUNCTION
/begin FUNCTION DASrvLib_OffsFadeIn "1.0.0     Fade in of offset for the input signal" FUNCTION_VERSION "1.0.0" /end FUNCTION
/begin FUNCTION DASrvLib_PosnChgCntr "1.0.0     Actuator position change counter" FUNCTION_VERSION "1.0.0" /end FUNCTION
/begin FUNCTION DASrvLib_SegEndPrdn "1.0.0     Prediction of input signal to the end of segment" FUNCTION_VERSION "1.0.0" /end FUNCTION
/begin FUNCTION DASrvLib_StuckInRngChk "1.0.0     class for stuck in range check" FUNCTION_VERSION "1.0.0" /end FUNCTION
/begin FUNCTION DASrvLib_TransHndlgSwt "1.0.1     Ramp for the transition between two inputs" FUNCTION_VERSION "1.0.1" /end FUNCTION
/begin FUNCTION DcChrgnCtrl_Ccs "5610.1.0  CCS DC Charging Control"
 /begin DEF_CHARACTERISTIC DcChrgnCtrl_iChrgnCntctOpenThd_C DcChrgnCtrl_iPrec_C DcChrgnCtrl_stIsoMeasmtDisad_C DcChrgnCtrl_tiChrgnCntctOpenEmgyMax_C DcChrgnCtrl_tiChrgnCntctOpenMax_C DcChrgnCtrl_tiCtrlPltSwtDiMax_C DcChrgnCtrl_tiCtrlPltSwtDiMin_C DcChrgnCtrl_tiDlyRestrt_C DcChrgnCtrl_tiEvRdyDlyMax_C DcChrgnCtrl_tiExCritErr_C DcChrgnCtrl_tiRespTiOut_C DcChrgnCtrl_tiV2GDiReq_C DcChrgnCtrl_tiZrIDmdMin_C /end DEF_CHARACTERISTIC
 /begin IN_MEASUREMENT ChgrPlug_flgDigComRqrd ChrgCntct_st ChrgMod_flgUnplRqrd ChrgMod_stMod ChrgPlg_stChrgn CmbdChrgnSys_flgCritErrCcsDc CmbdChrgnSys_flgMnrErrCcsDc CmbdChrgnSys_flgPrecFinshdCcsDc CmbdChrgnSys_flgStopReqCcsDc CmbdChrgnSys_flgStrtPndCcsDc CmbdChrgnSys_iDmdCcsDc CmbdChrgnSys_iMaxAvlCcsDc CmbdChrgnSys_pwrOutCcsDc CmbdChrgnSys_ratSocTarCcsDc CmbdChrgnSys_uTarCcsDc HLCCcs_iEvseDcPrsnt HLCCcs_st HLCCcs_stApplPtcol HLCCcs_stEvseCmpblty HLCCcs_stV2GMsg HvBatt_iActMeasd HvBatt_stIsoMeasmtActv HvBatt_uActMeasd /end IN_MEASUREMENT
 /begin OUT_MEASUREMENT DcChrgnCtrl_flgChrgnRdy DcChrgnCtrl_flgChrgnRetry DcChrgnCtrl_flgIsoMeasmtDiReq DcChrgnCtrl_flgV2GDiReq DcChrgnCtrl_flgWldChkReq DcChrgnCtrl_iChrgnMaxAvl DcChrgnCtrl_iChrgnReq DcChrgnCtrl_pwrChrgnOut DcChrgnCtrl_ratSocChrgnStop DcChrgnCtrl_stChrgn DcChrgnCtrl_stChrgnCntctReq DcChrgnCtrl_stChrgnReq DcChrgnCtrl_stChrgnSub DcChrgnCtrl_uChrgnReq DINH_nrActvInhReas.FId_DcChrgnCtrlChrgPrmExch DINH_stFId.FId_DcChrgnCtrlChrgPrmExch /end OUT_MEASUREMENT
 /begin LOC_MEASUREMENT DcChrgnCtrl_flgChrgPrmExchReld DcChrgnCtrl_flgDigComRqrdOld DcChrgnCtrl_flgInhb DcChrgnCtrl_flgStopReq DcChrgnCtrl_stCntct DcChrgnCtrl_tiEvRdy DcChrgnCtrl_tiGpt DcChrgnCtrl_tiV2GTmr /end LOC_MEASUREMENT
 FUNCTION_VERSION "5610.1.0" /end FUNCTION
/begin FUNCTION DcChrgnRlyNegPosn_DELib_SimpleSwt "4.6.0"
 /begin DEF_CHARACTERISTIC DcChrgnRlyNegPosn_SwtGDD_I.flgIvt_C DcChrgnRlyNegPosn_SwtGDD_I.tiDebHiLo_C DcChrgnRlyNegPosn_SwtGDD_I.tiDebLoHi_C /end DEF_CHARACTERISTIC
 /begin OUT_MEASUREMENT DcChrgnRlyNegPosn_st DcChrgnRlyNegPosn_stRaw DcChrgnRlyNegPosn_st_Sq /end OUT_MEASUREMENT
 FUNCTION_VERSION "4.6.0" /end FUNCTION
/begin FUNCTION DcChrgnRlyPosPosn_DELib_SimpleSwt "4.6.0"
 /begin DEF_CHARACTERISTIC DcChrgnRlyPosPosn_SwtGDD_I.flgIvt_C DcChrgnRlyPosPosn_SwtGDD_I.tiDebHiLo_C DcChrgnRlyPosPosn_SwtGDD_I.tiDebLoHi_C /end DEF_CHARACTERISTIC
 /begin OUT_MEASUREMENT DcChrgnRlyPosPosn_st DcChrgnRlyPosPosn_stRaw DcChrgnRlyPosPosn_st_Sq /end OUT_MEASUREMENT
 FUNCTION_VERSION "4.6.0" /end FUNCTION
/begin FUNCTION DcChrgrIntkT2_DELib_StdSensDd "10.2.0"
 /begin DEF_CHARACTERISTIC DcChrgrIntkT2_ADCCal.numSRCTempSel_C DcChrgrIntkT2_ADCCal.tiSRCMaxDebOK_C DcChrgrIntkT2_ADCCal.uSRCMax_C DcChrgrIntkT2_ADCCal.uSRCMin_C DcChrgrIntkT2_ADCCal.uSRCOpn_C DcChrgrIntkT2_ADCSensTransf_f_CUR DcChrgrIntkT2_tiSRCMaxDefDeb_CUR DDRC_DurDeb.DcChrgrIntkT2_tiSRCMinDebOk_C DDRC_DurDeb.DcChrgrIntkT2_tiSRCMinDebDef_C DDRC_DurDeb.DcChrgrIntkT2_tiSRCOpnDebOk_C DDRC_DurDeb.DcChrgrIntkT2_tiSRCOpnDebDef_C DDRC_RatDeb.DcChrgrIntkT2_tiSRCMinUDRat_C DDRC_RatDeb.DcChrgrIntkT2_tiSRCOpnUDRat_C DFC_CtlMsk2.DFC_DcChrgrIntkT2SRCMin_C DFC_CtlMsk2.DFC_DcChrgrIntkT2SRCOpn_C DFC_CtlMsk2.DFC_DcChrgrIntkT2SRCMax_C DFC_DisblMsk2.DFC_DcChrgrIntkT2SRCMin_C DFC_DisblMsk2.DFC_DcChrgrIntkT2SRCOpn_C DFC_DisblMsk2.DFC_DcChrgrIntkT2SRCMax_C /end DEF_CHARACTERISTIC
 /begin REF_CHARACTERISTIC DcChrgrIntkT2_tiPT1Fil_C DcChrgrIntkT2_TransStg_f.Dfl_r32_C DcChrgrIntkT2_TransStg_f.stSensId_C /end REF_CHARACTERISTIC
 /begin IN_MEASUREMENT DcChrgrIntkT2_FirRead.cntr DcChrgrIntkT2_FirRead.flgFirstRun DcChrgrIntkT2_FirRead.idxArr DcChrgrIntkT2_FirRead.uSum DcChrgrIntkT2_stSnsrDdReadCalc DcChrgrIntkT2_swtConfStdSens2C DcChrgrIntkT2_swtConfStdSensC DcChrgrIntkT2_swtConfStdSensSwVersC DcChrgrIntkT2_uRawPT1FltdSens DcChrgrIntkT2_uRawUnFltd DELib_idxArrSnsr DELib_xArrSnsr /end IN_MEASUREMENT
 /begin OUT_MEASUREMENT DcChrgrIntkT2_FirCalc.cntrAvrgZr DcChrgrIntkT2_FirCalc.flgRdDne DcChrgrIntkT2_FirCalc.uRawAvrg DcChrgrIntkT2_FirCalc.uRawFir DcChrgrIntkT2_stSnsrDdCalc DcChrgrIntkT2_swtSensPres DcChrgrIntkT2_tiSRCMaxDefDeb DcChrgrIntkT2_tSensCpl DcChrgrIntkT2_tSensUnFltd DcChrgrIntkT2_tSens_f DcChrgrIntkT2_uRaw DcChrgrIntkT2_uRaw_f DDRC_St.DFC_DcChrgrIntkT2SRCMin DDRC_St.DFC_DcChrgrIntkT2SRCOpn DFC_st.DFC_DcChrgrIntkT2SRCMin DFC_st.DFC_DcChrgrIntkT2SRCOpn DFC_st.DFC_DcChrgrIntkT2SRCMax DINH_nrActvInhReas.FId_DcChrgrIntkT2EnhdSRCMax DINH_nrActvInhReas.FId_DcChrgrIntkT2SSpMon DINH_stFId.FId_DcChrgrIntkT2EnhdSRCMax DINH_stFId.FId_DcChrgrIntkT2SSpMon /end OUT_MEASUREMENT
 /begin LOC_MEASUREMENT DcChrgrIntkT2_DDstSnsrState_mp DcChrgrIntkT2_tRefSnsr_mp DcChrgrIntkT2_tSensPT1Fltd_mp /end LOC_MEASUREMENT
 FUNCTION_VERSION "10.2.0" /end FUNCTION
/begin FUNCTION DcChrgrIntkT2_DELib_StdSensDdRead "10.4.0" /begin DEF_CHARACTERISTIC DcChrgrIntkT2_tiPT1Fil_C /end DEF_CHARACTERISTIC
 /begin IN_MEASUREMENT DcChrgrIntkT2_FirCalc.cntrAvrgZr DcChrgrIntkT2_FirCalc.flgRdDne DcChrgrIntkT2_FirCalc.uRawAvrg DcChrgrIntkT2_FirCalc.uRawFir DcChrgrIntkT2_swtConfStdSens2C DcChrgrIntkT2_swtConfStdSensC /end IN_MEASUREMENT
 /begin OUT_MEASUREMENT DcChrgrIntkT2_FirRead.cntr DcChrgrIntkT2_FirRead.flgFirstRun DcChrgrIntkT2_FirRead.idxArr DcChrgrIntkT2_FirRead.uSum DcChrgrIntkT2_stSnsrDdReadCalc DcChrgrIntkT2_uRawPT1Fltd DcChrgrIntkT2_uRawPT1FltdSens DcChrgrIntkT2_uRawUnFltd /end OUT_MEASUREMENT
 FUNCTION_VERSION "10.4.0" /end FUNCTION
/begin FUNCTION DcChrgrIntkT2_DELib_StdSensDdSENTSlowRead "3.2.0"
 /begin IN_MEASUREMENT DcChrgrIntkT2_swtConfStdSens2C DcChrgrIntkT2_swtConfStdSensC DcChrgrIntkT2_swtConfStdSensSwVersC /end IN_MEASUREMENT
 FUNCTION_VERSION "3.2.0" /end FUNCTION
/begin FUNCTION DcChrgrIntkT2_DELib_StdSensExtDiag "8.1.0"
 /begin IN_MEASUREMENT DcChrgrIntkT2_swtConfStdSensC DcChrgrIntkT2_swtConfStdSensSwVersC DELib_idxArrSnsr DELib_xArrSnsr DSM_TripChgFinshd SyC_stSub /end IN_MEASUREMENT
 FUNCTION_VERSION "8.1.0" /end FUNCTION
/begin FUNCTION DcChrgrIntkT2_DELib_StdSensInin "8.2.0"
 /begin DEF_CHARACTERISTIC DcChrgrIntkT2_swtConfStdSens2_C DcChrgrIntkT2_swtConfStdSensSwVers162_C DcChrgrIntkT2_swtConfStdSens_C /end DEF_CHARACTERISTIC
 /begin REF_CHARACTERISTIC DcChrgrIntkT2_tiPT1Fil_C /end REF_CHARACTERISTIC
 /begin OUT_MEASUREMENT DcChrgrIntkT2_swtConfStdSens2C DcChrgrIntkT2_swtConfStdSensC DcChrgrIntkT2_swtConfStdSensSwVersC DcChrgrIntkT2_swtSensMode /end OUT_MEASUREMENT
 FUNCTION_VERSION "8.2.0" /end FUNCTION
/begin FUNCTION DcChrgrIntkT2_DELib_StdSensVd "11.0.0"
 /begin DEF_CHARACTERISTIC DcChrgrIntkT2_DigSensCal.tiDebPos_C DcChrgrIntkT2_DigSensCal.tiDebNeg_C DcChrgrIntkT2_dtGradLim_f_C DcChrgrIntkT2_RmpSlp_f.Pos_C DcChrgrIntkT2_RmpSlp_f.Neg_C DcChrgrIntkT2_tDflVal_f_C DcChrgrIntkT2_tHiLimit_f_C DcChrgrIntkT2_tiPT1_f_C DcChrgrIntkT2_tLoLimit_f_C DcChrgrIntkT2_TransStg_f.Dfl_r32_C DcChrgrIntkT2_TransStg_f.stSensId_C /end DEF_CHARACTERISTIC
 /begin IN_MEASUREMENT DcChrgrIntkT2_stSnsrDdCalc DcChrgrIntkT2_swtConfStdSensC DcChrgrIntkT2_swtConfStdSensSwVersC DcChrgrIntkT2_tSens_f /end IN_MEASUREMENT
 /begin OUT_MEASUREMENT DcChrgrIntkT2_tSensOffsCorrd_f DcChrgrIntkT2_tUnFlt_f DcChrgrIntkT2_t_f DcChrgrIntkT2_t_f_Sq DINH_nrActvInhReas.FId_DcChrgrIntkT2FrzVal DINH_nrActvInhReas.FId_DcChrgrIntkT2RplVal DINH_stFId.FId_DcChrgrIntkT2FrzVal DINH_stFId.FId_DcChrgrIntkT2RplVal /end OUT_MEASUREMENT
 /begin LOC_MEASUREMENT DcChrgrIntkT2_tSensGradLim_f_mp /end LOC_MEASUREMENT
 FUNCTION_VERSION "11.0.0" /end FUNCTION
/begin FUNCTION DcChrgrIntkT2_DELib_StdSensVdMon "9.2.0"
 /begin DEF_CHARACTERISTIC DcChrgrIntkT2_numStdSens_C DcChrgrIntkT2_numTempErrDef_C DcChrgrIntkT2_numtSel_C DcChrgrIntkT2_stEnhPhysSRCRls_MAP DcChrgrIntkT2_tEnhPhysSRCMax_f_MAP DcChrgrIntkT2_tEnhPhysSRCMin_f_MAP DcChrgrIntkT2_tiEngOnMin_C DcChrgrIntkT2_tiTempErrOk_C DcChrgrIntkT2_tSnsrMax_f_C DcChrgrIntkT2_tSnsrMin_f_C DDRC_DurDeb.DcChrgrIntkT2_tiPhysRngHiDebOk_C DDRC_DurDeb.DcChrgrIntkT2_tiPhysRngHiDebDef_C DDRC_DurDeb.DcChrgrIntkT2_tiPhysRngLoDebOk_C DDRC_DurDeb.DcChrgrIntkT2_tiPhysRngLoDebDef_C DDRC_RatDeb.DcChrgrIntkT2_tiPhysRngHiUDRat_C DDRC_RatDeb.DcChrgrIntkT2_tiPhysRngLoUDRat_C DFC_CtlMsk2.DFC_DcChrgrIntkT2PhysRngHi_C DFC_CtlMsk2.DFC_DcChrgrIntkT2PhysRngLo_C DFC_CtlMsk2.DFC_DcChrgrIntkT2TmpErr_C DFC_DisblMsk2.DFC_DcChrgrIntkT2PhysRngHi_C DFC_DisblMsk2.DFC_DcChrgrIntkT2PhysRngLo_C DFC_DisblMsk2.DFC_DcChrgrIntkT2TmpErr_C /end DEF_CHARACTERISTIC
 /begin IN_MEASUREMENT CoEng_tiNormal DcChrgrIntkT2_stSnsrDdCalc DcChrgrIntkT2_swtConfStdSensC DcChrgrIntkT2_swtConfStdSensSwVersC DcChrgrIntkT2_tSens_f DELib_idxArrSnsr DELib_xArrSnsr DSM_TripChgFinshd Epm_nEng InjCtl_qSetUnBal /end IN_MEASUREMENT
 /begin OUT_MEASUREMENT DcChrgrIntkT2_stSnsrActv DDRC_St.DFC_DcChrgrIntkT2PhysRngHi DDRC_St.DFC_DcChrgrIntkT2PhysRngLo DFC_st.DFC_DcChrgrIntkT2PhysRngHi DFC_st.DFC_DcChrgrIntkT2PhysRngLo DFC_st.DFC_DcChrgrIntkT2TmpErr DINH_nrActvInhReas.FId_DcChrgrIntkT2PhysRng DINH_nrActvInhReas.FId_DcChrgrIntkT2TmpErrCnt DINH_stFId.FId_DcChrgrIntkT2PhysRng DINH_stFId.FId_DcChrgrIntkT2TmpErrCnt /end OUT_MEASUREMENT
 /begin LOC_MEASUREMENT DcChrgrIntkT2_stMonStdSens DcChrgrIntkT2_tDynThresPhysRngHi_f_mp DcChrgrIntkT2_tDynThresPhysRngLo_f_mp /end LOC_MEASUREMENT
 FUNCTION_VERSION "9.2.0" /end FUNCTION
/begin FUNCTION DcChrgrIntkT_DELib_StdSensDd "10.2.0"
 /begin DEF_CHARACTERISTIC DcChrgrIntkT_ADCCal.numSRCTempSel_C DcChrgrIntkT_ADCCal.tiSRCMaxDebOK_C DcChrgrIntkT_ADCCal.uSRCMax_C DcChrgrIntkT_ADCCal.uSRCMin_C DcChrgrIntkT_ADCCal.uSRCOpn_C DcChrgrIntkT_ADCSensTransf_f_CUR DcChrgrIntkT_tiSRCMaxDefDeb_CUR DDRC_DurDeb.DcChrgrIntkT_tiSRCMinDebOk_C DDRC_DurDeb.DcChrgrIntkT_tiSRCMinDebDef_C DDRC_DurDeb.DcChrgrIntkT_tiSRCOpnDebOk_C DDRC_DurDeb.DcChrgrIntkT_tiSRCOpnDebDef_C DDRC_RatDeb.DcChrgrIntkT_tiSRCMinUDRat_C DDRC_RatDeb.DcChrgrIntkT_tiSRCOpnUDRat_C DFC_CtlMsk2.DFC_DcChrgrIntkTSRCMin_C DFC_CtlMsk2.DFC_DcChrgrIntkTSRCOpn_C DFC_CtlMsk2.DFC_DcChrgrIntkTSRCMax_C DFC_DisblMsk2.DFC_DcChrgrIntkTSRCMin_C DFC_DisblMsk2.DFC_DcChrgrIntkTSRCOpn_C DFC_DisblMsk2.DFC_DcChrgrIntkTSRCMax_C /end DEF_CHARACTERISTIC
 /begin REF_CHARACTERISTIC DcChrgrIntkT_tiPT1Fil_C DcChrgrIntkT_TransStg_f.Dfl_r32_C DcChrgrIntkT_TransStg_f.stSensId_C /end REF_CHARACTERISTIC
 /begin IN_MEASUREMENT DcChrgrIntkT_FirRead.cntr DcChrgrIntkT_FirRead.flgFirstRun DcChrgrIntkT_FirRead.idxArr DcChrgrIntkT_FirRead.uSum DcChrgrIntkT_stSnsrDdReadCalc DcChrgrIntkT_swtConfStdSens2C DcChrgrIntkT_swtConfStdSensC DcChrgrIntkT_swtConfStdSensSwVersC DcChrgrIntkT_uRawPT1FltdSens DcChrgrIntkT_uRawUnFltd DELib_idxArrSnsr DELib_xArrSnsr /end IN_MEASUREMENT
 /begin OUT_MEASUREMENT DcChrgrIntkT_FirCalc.cntrAvrgZr DcChrgrIntkT_FirCalc.flgRdDne DcChrgrIntkT_FirCalc.uRawAvrg DcChrgrIntkT_FirCalc.uRawFir DcChrgrIntkT_stSnsrDdCalc DcChrgrIntkT_swtSensPres DcChrgrIntkT_tiSRCMaxDefDeb DcChrgrIntkT_tSensCpl DcChrgrIntkT_tSensUnFltd DcChrgrIntkT_tSens_f DcChrgrIntkT_uRaw DcChrgrIntkT_uRaw_f DDRC_St.DFC_DcChrgrIntkTSRCMin DDRC_St.DFC_DcChrgrIntkTSRCOpn DFC_st.DFC_DcChrgrIntkTSRCMin DFC_st.DFC_DcChrgrIntkTSRCOpn DFC_st.DFC_DcChrgrIntkTSRCMax DINH_nrActvInhReas.FId_DcChrgrIntkTEnhdSRCMax DINH_nrActvInhReas.FId_DcChrgrIntkTSSpMon DINH_stFId.FId_DcChrgrIntkTEnhdSRCMax DINH_stFId.FId_DcChrgrIntkTSSpMon /end OUT_MEASUREMENT
 /begin LOC_MEASUREMENT DcChrgrIntkT_DDstSnsrState_mp DcChrgrIntkT_tRefSnsr_mp DcChrgrIntkT_tSensPT1Fltd_mp /end LOC_MEASUREMENT
 FUNCTION_VERSION "10.2.0" /end FUNCTION
/begin FUNCTION DcChrgrIntkT_DELib_StdSensDdRead "10.4.0" /begin DEF_CHARACTERISTIC DcChrgrIntkT_tiPT1Fil_C /end DEF_CHARACTERISTIC
 /begin IN_MEASUREMENT DcChrgrIntkT_FirCalc.cntrAvrgZr DcChrgrIntkT_FirCalc.flgRdDne DcChrgrIntkT_FirCalc.uRawAvrg DcChrgrIntkT_FirCalc.uRawFir DcChrgrIntkT_swtConfStdSens2C DcChrgrIntkT_swtConfStdSensC /end IN_MEASUREMENT
 /begin OUT_MEASUREMENT DcChrgrIntkT_FirRead.cntr DcChrgrIntkT_FirRead.flgFirstRun DcChrgrIntkT_FirRead.idxArr DcChrgrIntkT_FirRead.uSum DcChrgrIntkT_stSnsrDdReadCalc DcChrgrIntkT_uRawPT1Fltd DcChrgrIntkT_uRawPT1FltdSens DcChrgrIntkT_uRawUnFltd /end OUT_MEASUREMENT
 FUNCTION_VERSION "10.4.0" /end FUNCTION
/begin FUNCTION DcChrgrIntkT_DELib_StdSensDdSENTSlowRead "3.2.0"
 /begin IN_MEASUREMENT DcChrgrIntkT_swtConfStdSens2C DcChrgrIntkT_swtConfStdSensC DcChrgrIntkT_swtConfStdSensSwVersC /end IN_MEASUREMENT
 FUNCTION_VERSION "3.2.0" /end FUNCTION
/begin FUNCTION DcChrgrIntkT_DELib_StdSensExtDiag "8.1.0"
 /begin IN_MEASUREMENT DcChrgrIntkT_swtConfStdSensC DcChrgrIntkT_swtConfStdSensSwVersC DELib_idxArrSnsr DELib_xArrSnsr DSM_TripChgFinshd SyC_stSub /end IN_MEASUREMENT
 FUNCTION_VERSION "8.1.0" /end FUNCTION
/begin FUNCTION DcChrgrIntkT_DELib_StdSensInin "8.2.0"
 /begin DEF_CHARACTERISTIC DcChrgrIntkT_swtConfStdSens2_C DcChrgrIntkT_swtConfStdSensSwVers162_C DcChrgrIntkT_swtConfStdSens_C /end DEF_CHARACTERISTIC
 /begin REF_CHARACTERISTIC DcChrgrIntkT_tiPT1Fil_C /end REF_CHARACTERISTIC
 /begin OUT_MEASUREMENT DcChrgrIntkT_swtConfStdSens2C DcChrgrIntkT_swtConfStdSensC DcChrgrIntkT_swtConfStdSensSwVersC DcChrgrIntkT_swtSensMode /end OUT_MEASUREMENT
 FUNCTION_VERSION "8.2.0" /end FUNCTION
/begin FUNCTION DcChrgrIntkT_DELib_StdSensVd "11.0.0"
 /begin DEF_CHARACTERISTIC DcChrgrIntkT_DigSensCal.tiDebPos_C DcChrgrIntkT_DigSensCal.tiDebNeg_C DcChrgrIntkT_dtGradLim_f_C DcChrgrIntkT_RmpSlp_f.Pos_C DcChrgrIntkT_RmpSlp_f.Neg_C DcChrgrIntkT_tDflVal_f_C DcChrgrIntkT_tHiLimit_f_C DcChrgrIntkT_tiPT1_f_C DcChrgrIntkT_tLoLimit_f_C DcChrgrIntkT_TransStg_f.Dfl_r32_C DcChrgrIntkT_TransStg_f.stSensId_C /end DEF_CHARACTERISTIC
 /begin IN_MEASUREMENT DcChrgrIntkT_stSnsrDdCalc DcChrgrIntkT_swtConfStdSensC DcChrgrIntkT_swtConfStdSensSwVersC DcChrgrIntkT_tSens_f /end IN_MEASUREMENT
 /begin OUT_MEASUREMENT DcChrgrIntkT_tSensOffsCorrd_f DcChrgrIntkT_tUnFlt_f DcChrgrIntkT_t_f DcChrgrIntkT_t_f_Sq DINH_nrActvInhReas.FId_DcChrgrIntkTFrzVal DINH_nrActvInhReas.FId_DcChrgrIntkTRplVal DINH_stFId.FId_DcChrgrIntkTFrzVal DINH_stFId.FId_DcChrgrIntkTRplVal /end OUT_MEASUREMENT
 /begin LOC_MEASUREMENT DcChrgrIntkT_tSensGradLim_f_mp /end LOC_MEASUREMENT
 FUNCTION_VERSION "11.0.0" /end FUNCTION
/begin FUNCTION DcChrgrIntkT_DELib_StdSensVdMon "9.2.0"
 /begin DEF_CHARACTERISTIC DcChrgrIntkT_numStdSens_C DcChrgrIntkT_numTempErrDef_C DcChrgrIntkT_numtSel_C DcChrgrIntkT_stEnhPhysSRCRls_MAP DcChrgrIntkT_tEnhPhysSRCMax_f_MAP DcChrgrIntkT_tEnhPhysSRCMin_f_MAP DcChrgrIntkT_tiEngOnMin_C DcChrgrIntkT_tiTempErrOk_C DcChrgrIntkT_tSnsrMax_f_C DcChrgrIntkT_tSnsrMin_f_C DDRC_DurDeb.DcChrgrIntkT_tiPhysRngHiDebOk_C DDRC_DurDeb.DcChrgrIntkT_tiPhysRngHiDebDef_C DDRC_DurDeb.DcChrgrIntkT_tiPhysRngLoDebOk_C DDRC_DurDeb.DcChrgrIntkT_tiPhysRngLoDebDef_C DDRC_RatDeb.DcChrgrIntkT_tiPhysRngHiUDRat_C DDRC_RatDeb.DcChrgrIntkT_tiPhysRngLoUDRat_C DFC_CtlMsk2.DFC_DcChrgrIntkTPhysRngHi_C DFC_CtlMsk2.DFC_DcChrgrIntkTPhysRngLo_C DFC_CtlMsk2.DFC_DcChrgrIntkTTmpErr_C DFC_DisblMsk2.DFC_DcChrgrIntkTPhysRngHi_C DFC_DisblMsk2.DFC_DcChrgrIntkTPhysRngLo_C DFC_DisblMsk2.DFC_DcChrgrIntkTTmpErr_C /end DEF_CHARACTERISTIC
 /begin IN_MEASUREMENT CoEng_tiNormal DcChrgrIntkT_stSnsrDdCalc DcChrgrIntkT_swtConfStdSensC DcChrgrIntkT_swtConfStdSensSwVersC DcChrgrIntkT_tSens_f DELib_idxArrSnsr DELib_xArrSnsr DSM_TripChgFinshd Epm_nEng InjCtl_qSetUnBal /end IN_MEASUREMENT
 /begin OUT_MEASUREMENT DcChrgrIntkT_stSnsrActv DDRC_St.DFC_DcChrgrIntkTPhysRngHi DDRC_St.DFC_DcChrgrIntkTPhysRngLo DFC_st.DFC_DcChrgrIntkTPhysRngHi DFC_st.DFC_DcChrgrIntkTPhysRngLo DFC_st.DFC_DcChrgrIntkTTmpErr DINH_nrActvInhReas.FId_DcChrgrIntkTPhysRng DINH_nrActvInhReas.FId_DcChrgrIntkTTmpErrCnt DINH_stFId.FId_DcChrgrIntkTPhysRng DINH_stFId.FId_DcChrgrIntkTTmpErrCnt /end OUT_MEASUREMENT
 /begin LOC_MEASUREMENT DcChrgrIntkT_stMonStdSens DcChrgrIntkT_tDynThresPhysRngHi_f_mp DcChrgrIntkT_tDynThresPhysRngLo_f_mp /end LOC_MEASUREMENT
 FUNCTION_VERSION "9.2.0" /end FUNCTION
/begin FUNCTION Dcdc_Coorn "1.2.0     Coordination for DCDC Converter" /begin DEF_CHARACTERISTIC Dcdc_pwrActPred_T Dcdc_pwrLoadMngtFltPred_C /end DEF_CHARACTERISTIC /begin IN_MEASUREMENT Dcdc_pwrHvAct /end IN_MEASUREMENT
 /begin OUT_MEASUREMENT Dcdc_pwrLoadMngtMaxPred DINH_nrActvInhReas.FId_DcdcPwrLoadMngtMaxPred DINH_stFId.FId_DcdcPwrLoadMngtMaxPred /end OUT_MEASUREMENT
 FUNCTION_VERSION "1.2.0" /end FUNCTION
/begin FUNCTION Dcdc_ElecDiag "1400.2.0  Electrical diagnosis for the DCDC01 and DCDC02"
 /begin DEF_CHARACTERISTIC Dcdc_maskCanInputSq_C Dcdc_uLvDiffTolrThd_C DDRC_DurDeb.Dcdc_tiLvUDifMaxFltDebOk_C DDRC_DurDeb.Dcdc_tiLvUDifMaxFltDebDef_C DFC_CtlMsk2.DFC_DcdcLvUDifMaxFlt_C DFC_DisblMsk2.DFC_DcdcLvUDifMaxFlt_C /end DEF_CHARACTERISTIC
 /begin IN_MEASUREMENT Dcdc_stOperModAct Dcdc_uDesLvGrid Dcdc_uLvAct Dcdc_uLvAct_Sq /end IN_MEASUREMENT
 /begin OUT_MEASUREMENT DDRC_St.DFC_DcdcLvUDifMaxFlt DFC_st.DFC_DcdcLvUDifMaxFlt /end OUT_MEASUREMENT
 FUNCTION_VERSION "1400.2.0" /end FUNCTION
/begin FUNCTION Dcdc_ElecVd "1400.0.0  DCDC Converter Virtual Device Electric System" /begin DEF_CHARACTERISTIC Dcdc_facEffDcDc_T Dcdc_SwtSrcPwrHvAct_C /end DEF_CHARACTERISTIC
 /begin IN_MEASUREMENT Com_iDcdcHvActRvsn1 Com_iDcdcHvActRvsn1_Sq Com_iDcdcLvActRvsn1 Com_iDcdcLvActRvsn1_Sq Com_uDcdcHvAct Com_uDcdcHvAct_Sq Com_uDcdcLvAct Com_uDcdcLvAct_Sq /end IN_MEASUREMENT
 /begin OUT_MEASUREMENT Dcdc_iHvAct Dcdc_iHvAct_Sq Dcdc_iLvAct Dcdc_iLvAct_Sq Dcdc_pwrHvAct Dcdc_pwrHvAct_Sq Dcdc_uHvAct Dcdc_uHvAct_Sq Dcdc_uLvAct Dcdc_uLvAct_Sq /end OUT_MEASUREMENT
 FUNCTION_VERSION "1400.0.0" /end FUNCTION
/begin COMPU_METHOD boolean "" RAT_FUNC "%6.2" "-" COEFFS 0 1 0 0 0 1 /end COMPU_METHOD
/begin COMPU_METHOD B_TRUE "" TAB_VERB "%6.3" "" COMPU_TAB_REF B_TRUE /end COMPU_METHOD
/begin COMPU_VTAB B_TRUE "" TAB_VERB 2 0 "FALSE" 1 "TRUE" /end COMPU_VTAB
/begin COMPU_METHOD ChrgCntct_st_VERB "" TAB_VERB "%6.3" "" COMPU_TAB_REF ChrgCntct_st_VERB /end COMPU_METHOD
/begin COMPU_VTAB ChrgCntct_st_VERB "" TAB_VERB 7 0 "CHRGCNTCT_OPEND" 1 "CHRGCNTCT_CLSD" 2 "CHRGCNTCT_WLDCHK" 3 "CHRGCNTCT_WLDD" 4 "CHRGCNTCT_PTLWLDD" 5 "CHRGCNTCT_ERR" 6 "CHRGCNTCT_INI" /end COMPU_VTAB
/begin COMPU_METHOD ChrgCtrl_stChrgnCntctReq_VERB "" TAB_VERB "%6.3" "" COMPU_TAB_REF ChrgCtrl_stChrgnCntctReq_VERB /end COMPU_METHOD
/begin COMPU_VTAB ChrgCtrl_stChrgnCntctReq_VERB "" TAB_VERB 3 0 "CHRGCTRL_OPEN" 1 "CHRGCTRL_EMGYOPEN" 2 "CHRGCTRL_CLOSE" /end COMPU_VTAB
/begin COMPU_METHOD ChrgCtrl_stChrgnSub_VERB "" TAB_VERB "%6.3" "" COMPU_TAB_REF ChrgCtrl_stChrgnSub_VERB /end COMPU_METHOD
/begin COMPU_VTAB ChrgCtrl_stChrgnSub_VERB "" TAB_VERB 12 0 "CHRGCTRL_SUB_INI" 1 "CHRGCTRL_SUB_SELD" 2 "CHRGCTRL_SUB_CHRGPRMEXCH" 3 "CHRGCTRL_SUB_EVRDY" 4 "CHRGCTRL_SUB_ISODISAD" 5 "CHRGCTRL_SUB_PREC" 6 "CHRGCTRL_SUB_PRECFINSH" 7 "CHRGCTRL_SUB_CHRGNLOOP" 8 "CHRGCTRL_SUB_STOP" 9 "CHRGCTRL_SUB_WLDCHK" 10 "CHRGCTRL_SUB_FINSH" 11 "CHRGCTRL_SUB_RENEGT" /end COMPU_VTAB
/begin COMPU_METHOD ChrgCtrl_stChrgn_VERB "" TAB_VERB "%6.3" "" COMPU_TAB_REF ChrgCtrl_stChrgn_VERB /end COMPU_METHOD
/begin COMPU_VTAB ChrgCtrl_stChrgn_VERB "" TAB_VERB 7 0 "CHRGCTRL_INI" 1 "CHRGCTRL_PREP" 2 "CHRGCTRL_CHRGN" 3 "CHRGCTRL_STOP" 4 "CHRGCTRL_FINSH" 5 "CHRGCTRL_CRITERR" 6 "CHRGCTRL_MNRERR" /end COMPU_VTAB
/begin COMPU_METHOD Curr_A_q0p03125_COMPU "" RAT_FUNC "%6.4" "A" COEFFS 0 32 0 0 0 1 /end COMPU_METHOD
/begin COMPU_METHOD DDRCTime_ms "" RAT_FUNC "%6.1" "ms" COEFFS 0 1 0 0 0 10 /end COMPU_METHOD
/begin COMPU_METHOD DDRC_Ratio "" TAB_VERB "%6.3" "-" COMPU_TAB_REF DDRC_Ratio /end COMPU_METHOD
/begin COMPU_VTAB DDRC_Ratio "" TAB_VERB 4 1 "Ratio1" 2 "Ratio2" 3 "Ratio3" 4 "Ratio4" /end COMPU_VTAB
/begin COMPU_METHOD DELIB_ALLTEMP_VERB_COMPU "" TAB_VERB "%6.3" "" COMPU_TAB_REF DELIB_ALLTEMP_VERB_COMPU /end COMPU_METHOD
/begin COMPU_VTAB DELIB_ALLTEMP_VERB_COMPU "" TAB_VERB 6 85 "ACCHRGRINTKT" 86 "DCCHRGRINTKT" 0 "ENVT" 89 "HEATRCORET" 254 "DFLTEMP" 255 "NOTEMP" /end COMPU_VTAB
/begin COMPU_METHOD DELIB_RACTRLIM2SIZECUR_SC_Compu "" RAT_FUNC "%6.2" "" COEFFS 0 1 0 0 0 1 /end COMPU_METHOD
/begin COMPU_METHOD DELIB_RDIAVALMINSIZECUR_SC_Compu "" RAT_FUNC "%6.2" "" COEFFS 0 1 0 0 0 1 /end COMPU_METHOD
/begin COMPU_METHOD DELIB_RPRECTLDWNMAINMAPSIZEX_SC_Compu "" RAT_FUNC "%6.2" "" COEFFS 0 1 0 0 0 1 /end COMPU_METHOD
/begin COMPU_METHOD DELIB_RPRECTLDWNMAINMAPSIZEY_SC_Compu "" RAT_FUNC "%6.2" "" COEFFS 0 1 0 0 0 1 /end COMPU_METHOD
/begin COMPU_METHOD DELIB_RPRECTLDWNMAPSIZEX_SC_Compu "" RAT_FUNC "%6.2" "" COEFFS 0 1 0 0 0 1 /end COMPU_METHOD
/begin COMPU_METHOD DELIB_RPRECTLDWNMAPSIZEY_SC_Compu "" RAT_FUNC "%6.2" "" COEFFS 0 1 0 0 0 1 /end COMPU_METHOD
/begin COMPU_METHOD DELIB_RPRECTLUPMAINMAPSIZEX_SC_Compu "" RAT_FUNC "%6.2" "" COEFFS 0 1 0 0 0 1 /end COMPU_METHOD
/begin COMPU_METHOD DELIB_RPRECTLUPMAINMAPSIZEY_SC_Compu "" RAT_FUNC "%6.2" "" COEFFS 0 1 0 0 0 1 /end COMPU_METHOD
/begin COMPU_METHOD DELIB_RPRECTLUPMAPSIZEX_SC_Compu "" RAT_FUNC "%6.2" "" COEFFS 0 1 0 0 0 1 /end COMPU_METHOD
/begin COMPU_METHOD DELIB_RPRECTLUPMAPSIZEY_SC_Compu "" RAT_FUNC "%6.2" "" COEFFS 0 1 0 0 0 1 /end COMPU_METHOD
/begin COMPU_METHOD DELIB_RPSMAXMAPSIZEX_SC_Compu "" RAT_FUNC "%6.2" "" COEFFS 0 1 0 0 0 1 /end COMPU_METHOD
/begin COMPU_METHOD DELIB_RPSMAXMAPSIZEY_SC_Compu "" RAT_FUNC "%6.2" "" COEFFS 0 1 0 0 0 1 /end COMPU_METHOD
/begin COMPU_METHOD DELIB_RQONE02051207_SC_Compu "" TAB_VERB "%6.3" "" COMPU_TAB_REF DELIB_RQONE02051207_SC_Compu /end COMPU_METHOD
/begin COMPU_VTAB DELIB_RQONE02051207_SC_Compu "" TAB_VERB 2 0 "False" 1 "True" /end COMPU_VTAB
/begin COMPU_METHOD DELIB_RQONE02093116_SC_Compu "" TAB_VERB "%6.3" "" COMPU_TAB_REF DELIB_RQONE02093116_SC_Compu /end COMPU_METHOD
/begin COMPU_VTAB DELIB_RQONE02093116_SC_Compu "" TAB_VERB 2 0 "False" 1 "True" /end COMPU_VTAB
/begin COMPU_METHOD DELIB_SENTCALULINSIZECUR_SC_Compu "" RAT_FUNC "%6.2" "" COEFFS 0 1 0 0 0 1 /end COMPU_METHOD
/begin COMPU_METHOD DELIB_SIMPLESWTAVL_SC_Compu "" TAB_VERB "%6.3" "" COMPU_TAB_REF DELIB_SIMPLESWTAVL_SC_Compu /end COMPU_METHOD
/begin COMPU_VTAB DELIB_SIMPLESWTAVL_SC_Compu "" TAB_VERB 2 0 "deactivated" 1 "activated" /end COMPU_VTAB
/begin COMPU_METHOD DELIB_STDACTRTYPAVL_SC_Compu "" TAB_VERB "%6.3" "" COMPU_TAB_REF DELIB_STDACTRTYPAVL_SC_Compu /end COMPU_METHOD
/begin COMPU_VTAB DELIB_STDACTRTYPAVL_SC_Compu "" TAB_VERB 2 0 "False" 1 "True" /end COMPU_VTAB
/begin COMPU_METHOD DELIB_STDSENSTYPAVL_SC_Compu "" TAB_VERB "%6.3" "" COMPU_TAB_REF DELIB_STDSENSTYPAVL_SC_Compu /end COMPU_METHOD
/begin COMPU_VTAB DELIB_STDSENSTYPAVL_SC_Compu "" TAB_VERB 2 0 "False" 1 "True" /end COMPU_VTAB
/begin COMPU_METHOD DELIB_TIDIAGDISSIZECUR_SC_Compu "" RAT_FUNC "%6.2" "" COEFFS 0 1 0 0 0 1 /end COMPU_METHOD
/begin COMPU_METHOD DELIB_UTOFFSADJCLSDSIZECRV_SC_Compu "" RAT_FUNC "%6.2" "" COEFFS 0 1 0 0 0 1 /end COMPU_METHOD
/begin COMPU_METHOD DELIB_UTOFFSADJOPENDSIZECRV_SC_Compu "" RAT_FUNC "%6.2" "" COEFFS 0 1 0 0 0 1 /end COMPU_METHOD
/begin COMPU_METHOD Dens "" RAT_FUNC "%6.3" "Kg/m^3" COEFFS 0 10 0 0 0 1 /end COMPU_METHOD
/begin COMPU_METHOD DensFine "" RAT_FUNC "%6.4" "Kg/m^3" COEFFS 0 500 0 0 0 1 /end COMPU_METHOD
/begin COMPU_METHOD DerPresRl_COMPU "" RAT_FUNC "%6.0" "hPa/s" COEFFS 0 0.01 0 0 0 1 /end COMPU_METHOD
/begin COMPU_METHOD DEVLIB_4WINDIACMPNENA_SY_Compu "" TAB_VERB "%6.3" "" COMPU_TAB_REF DEVLIB_4WINDIACMPNENA_SY_Compu /end COMPU_METHOD
/begin COMPU_VTAB DEVLIB_4WINDIACMPNENA_SY_Compu "" TAB_VERB 2 0 "False" 1 "True" /end COMPU_VTAB
/begin COMPU_METHOD DEVLIB_ACTRPRTCMPNENA_SY_Compu "" TAB_VERB "%6.3" "" COMPU_TAB_REF DEVLIB_ACTRPRTCMPNENA_SY_Compu /end COMPU_METHOD
/begin COMPU_VTAB DEVLIB_ACTRPRTCMPNENA_SY_Compu "" TAB_VERB 2 0 "False" 1 "True" /end COMPU_VTAB
/begin COMPU_METHOD DEVLIB_DBG_SY_Compu "" TAB_VERB "%6.3" "" COMPU_TAB_REF DEVLIB_DBG_SY_Compu /end COMPU_METHOD
/begin COMPU_VTAB DEVLIB_DBG_SY_Compu "" TAB_VERB 2 0 "False" 1 "True" /end COMPU_VTAB
/begin COMPU_METHOD DEVLIB_DIACTLLINECMPNENA_SY_Compu "" TAB_VERB "%6.3" "" COMPU_TAB_REF DEVLIB_DIACTLLINECMPNENA_SY_Compu /end COMPU_METHOD
/begin COMPU_VTAB DEVLIB_DIACTLLINECMPNENA_SY_Compu "" TAB_VERB 2 0 "False" 1 "True" /end COMPU_VTAB
/begin COMPU_METHOD DEVLIB_HBRGENA_SY_Compu "" TAB_VERB "%6.3" "" COMPU_TAB_REF DEVLIB_HBRGENA_SY_Compu /end COMPU_METHOD
/begin COMPU_VTAB DEVLIB_HBRGENA_SY_Compu "" TAB_VERB 2 0 "0" 1 "1" /end COMPU_VTAB
/begin COMPU_METHOD DEVLIB_PHYSRNGCHK_SY_Compu "" TAB_VERB "%6.3" "" COMPU_TAB_REF DEVLIB_PHYSRNGCHK_SY_Compu /end COMPU_METHOD
/begin COMPU_VTAB DEVLIB_PHYSRNGCHK_SY_Compu "" TAB_VERB 2 0 "FALSE" 1 "TRUE" /end COMPU_VTAB
/begin COMPU_METHOD DEVLIB_PSOFFOPNLD_SY_Compu "" TAB_VERB "%6.3" "" COMPU_TAB_REF DEVLIB_PSOFFOPNLD_SY_Compu /end COMPU_METHOD
/begin COMPU_VTAB DEVLIB_PSOFFOPNLD_SY_Compu "" TAB_VERB 2 0 "FALSE" 1 "TRUE" /end COMPU_VTAB
/begin COMPU_METHOD DEVLIB_PSSTATEMOCSOPINI_SY_Compu "" TAB_VERB "%6.3" "" COMPU_TAB_REF DEVLIB_PSSTATEMOCSOPINI_SY_Compu /end COMPU_METHOD
/begin COMPU_VTAB DEVLIB_PSSTATEMOCSOPINI_SY_Compu "" TAB_VERB 2 0 "False" 1 "True" /end COMPU_VTAB
/begin COMPU_METHOD DEVLIB_PWRSTGSTATEMOCSOPCHK_SY_Compu "" TAB_VERB "%6.3" "" COMPU_TAB_REF DEVLIB_PWRSTGSTATEMOCSOPCHK_SY_Compu /end COMPU_METHOD
/begin COMPU_VTAB DEVLIB_PWRSTGSTATEMOCSOPCHK_SY_Compu "" TAB_VERB 2 0 "False" 1 "True" /end COMPU_VTAB
/begin COMPU_METHOD DFC_CALPRMSTATDISBLMSK_SC_Compu "" TAB_VERB "%6.3" "" COMPU_TAB_REF DFC_CALPRMSTATDISBLMSK_SC_Compu /end COMPU_METHOD
/begin COMPU_VTAB DFC_CALPRMSTATDISBLMSK_SC_Compu "" TAB_VERB 2 0 "Disabled" 1 "Enabled" /end COMPU_VTAB
/begin COMPU_METHOD DFC_CTLDISBLLAYOUT_SY_Compu "" RAT_FUNC "%6.2" "" COEFFS 0 1 0 0 0 1 /end COMPU_METHOD
/begin COMPU_METHOD DFC_CTLMSKBYTES_SY_Compu "" TAB_VERB "%6.3" "" COMPU_TAB_REF DFC_CTLMSKBYTES_SY_Compu /end COMPU_METHOD
/begin COMPU_VTAB DFC_CTLMSKBYTES_SY_Compu "" TAB_VERB 2 1 "SIZE_1_BYTE" 2 "SIZE_2_BYTES" /end COMPU_VTAB
/begin COMPU_METHOD DFC_DISBLMSKBYTES_SY_Compu "" TAB_VERB "%6.3" "" COMPU_TAB_REF DFC_DISBLMSKBYTES_SY_Compu /end COMPU_METHOD
/begin COMPU_VTAB DFC_DISBLMSKBYTES_SY_Compu "" TAB_VERB 3 1 "SIZE_1_BYTE" 2 "SIZE_2_BYTES" 4 "SIZE_4_BYTES" /end COMPU_VTAB
/begin COMPU_METHOD DFC_OneToOne "" RAT_FUNC "%6.2" "-" COEFFS 0 1 0 0 0 1 /end COMPU_METHOD
/begin COMPU_METHOD DFC_SETSTATDITHOAPI_SC_Compu "" TAB_VERB "%6.3" "" COMPU_TAB_REF DFC_SETSTATDITHOAPI_SC_Compu /end COMPU_METHOD
/begin COMPU_VTAB DFC_SETSTATDITHOAPI_SC_Compu "" TAB_VERB 2 0 "False" 1 "True" /end COMPU_VTAB
/begin COMPU_METHOD DFESOBSVR_BSIMIRRSIZE_SC_Compu "" RAT_FUNC "%6.2" "" COEFFS 0 1 0 0 0 1 /end COMPU_METHOD
/begin COMPU_METHOD DFES_ACTVENHMTSIMCONDPID9F_SC_Compu "" TAB_VERB "%6.3" "" COMPU_TAB_REF DFES_ACTVENHMTSIMCONDPID9F_SC_Compu /end COMPU_METHOD
/begin COMPU_VTAB DFES_ACTVENHMTSIMCONDPID9F_SC_Compu "" TAB_VERB 2 0 "False" 1 "True" /end COMPU_VTAB
/begin COMPU_METHOD DFES_ACTVSIMRCDNPID03_SC_Compu "" TAB_VERB "%6.3" "" COMPU_TAB_REF DFES_ACTVSIMRCDNPID03_SC_Compu /end COMPU_METHOD
/begin COMPU_VTAB DFES_ACTVSIMRCDNPID03_SC_Compu "" TAB_VERB 2 0 "False" 1 "True" /end COMPU_VTAB
/begin COMPU_METHOD DFES_ADDLMILMOD_SC_Compu "" TAB_VERB "%6.3" "" COMPU_TAB_REF DFES_ADDLMILMOD_SC_Compu /end COMPU_METHOD
/begin COMPU_VTAB DFES_ADDLMILMOD_SC_Compu "" TAB_VERB 2 0 "NO_ADDLMILMOD" 1 "ADDLMILMOD_SET1" /end COMPU_VTAB
/begin COMPU_METHOD DFES_BLKENTRY_SY_Compu "" TAB_VERB "%6.3" "" COMPU_TAB_REF DFES_BLKENTRY_SY_Compu /end COMPU_METHOD
/begin COMPU_VTAB DFES_BLKENTRY_SY_Compu "" TAB_VERB 2 0 "False" 1 "True" /end COMPU_VTAB
/begin COMPU_METHOD DFES_COMMILDEB_SY_Compu "" TAB_VERB "%6.3" "" COMPU_TAB_REF DFES_COMMILDEB_SY_Compu /end COMPU_METHOD
/begin COMPU_VTAB DFES_COMMILDEB_SY_Compu "" TAB_VERB 2 0 "DISABLED" 1 "ENABLED" /end COMPU_VTAB
/begin COMPU_METHOD DFES_DTC_TSTFAIL_SY_Compu "" TAB_VERB "%6.3" "" COMPU_TAB_REF DFES_DTC_TSTFAIL_SY_Compu /end COMPU_METHOD
/begin COMPU_VTAB DFES_DTC_TSTFAIL_SY_Compu "" TAB_VERB 2 0 "0" 1 "1" /end COMPU_VTAB
/begin COMPU_METHOD DFES_EOLCLR_SY_Compu "" TAB_VERB "%6.3" "" COMPU_TAB_REF DFES_EOLCLR_SY_Compu /end COMPU_METHOD
/begin COMPU_VTAB DFES_EOLCLR_SY_Compu "" TAB_VERB 2 0 "False" 1 "True" /end COMPU_VTAB
/begin COMPU_METHOD DFES_EXTDFLT_SY_Compu "" TAB_VERB "%6.3" "" COMPU_TAB_REF DFES_EXTDFLT_SY_Compu /end COMPU_METHOD
/begin COMPU_VTAB DFES_EXTDFLT_SY_Compu "" TAB_VERB 2 0 "DISABLED" 1 "ENABLED" /end COMPU_VTAB
/begin COMPU_METHOD DFES_IMDTNVSTORG_SC_Compu "" TAB_VERB "%6.3" "" COMPU_TAB_REF DFES_IMDTNVSTORG_SC_Compu /end COMPU_METHOD
/begin COMPU_VTAB DFES_IMDTNVSTORG_SC_Compu "" TAB_VERB 2 0 "False" 1 "True" /end COMPU_VTAB
/begin COMPU_METHOD DFES_IRV_SY_Compu "" TAB_VERB "%6.3" "" COMPU_TAB_REF DFES_IRV_SY_Compu /end COMPU_METHOD
/begin COMPU_VTAB DFES_IRV_SY_Compu "" TAB_VERB 2 0 "DFES_IRV_DISBL" 1 "DFES_IRV_ENA" /end COMPU_VTAB
/begin COMPU_METHOD DFES_OneToOne "" RAT_FUNC "%6.2" "-" COEFFS 0 1 0 0 0 1 /end COMPU_METHOD
/begin COMPU_METHOD DFES_PDTC_SY_Compu "" TAB_VERB "%6.3" "" COMPU_TAB_REF DFES_PDTC_SY_Compu /end COMPU_METHOD
/begin COMPU_VTAB DFES_PDTC_SY_Compu "" TAB_VERB 2 0 "False" 1 "True" /end COMPU_VTAB
/begin COMPU_METHOD DFES_VIS_BUF_SY_Compu "" TAB_VERB "%6.3" "" COMPU_TAB_REF DFES_VIS_BUF_SY_Compu /end COMPU_METHOD
/begin COMPU_VTAB DFES_VIS_BUF_SY_Compu "" TAB_VERB 2 0 "0" 1 "1" /end COMPU_VTAB
/begin COMPU_METHOD dFlConsum "" RAT_FUNC "%6.4" "l/h/s" COEFFS 0 100 0 0 0 1 /end COMPU_METHOD
/begin COMPU_METHOD DIAACTR_ELECCTRLLINEDIAGCPTENA_SC_Compu "" TAB_VERB "%6.3" "" COMPU_TAB_REF DIAACTR_ELECCTRLLINEDIAGCPTENA_SC_Compu /end COMPU_METHOD
/begin COMPU_VTAB DIAACTR_ELECCTRLLINEDIAGCPTENA_SC_Compu "" TAB_VERB 2 0 "False" 1 "True" /end COMPU_VTAB
/begin COMPU_METHOD DIAACTR_ELECHBRDGDIAGENA_SC_Compu "" TAB_VERB "%6.3" "" COMPU_TAB_REF DIAACTR_ELECHBRDGDIAGENA_SC_Compu /end COMPU_METHOD
/begin COMPU_VTAB DIAACTR_ELECHBRDGDIAGENA_SC_Compu "" TAB_VERB 2 0 "False" 1 "True" /end COMPU_VTAB
/begin COMPU_METHOD DIAACTR_ELECPSDIAGCMPNENA_SC_Compu "" TAB_VERB "%6.3" "" COMPU_TAB_REF DIAACTR_ELECPSDIAGCMPNENA_SC_Compu /end COMPU_METHOD
/begin COMPU_VTAB DIAACTR_ELECPSDIAGCMPNENA_SC_Compu "" TAB_VERB 2 0 "False" 1 "True" /end COMPU_VTAB
/begin COMPU_METHOD DIAACTR_ELECPSDIAGERRINFO_SC_Compu "" TAB_VERB "%6.3" "" COMPU_TAB_REF DIAACTR_ELECPSDIAGERRINFO_SC_Compu /end COMPU_METHOD
/begin COMPU_VTAB DIAACTR_ELECPSDIAGERRINFO_SC_Compu "" TAB_VERB 2 0 "LSTRAWINFO" 1 "LSTTESTRSLT" /end COMPU_VTAB
/begin COMPU_METHOD DIABAS_ATSLRGIDSUPRT_SC_Compu "" TAB_VERB "%6.3" "" COMPU_TAB_REF DIABAS_ATSLRGIDSUPRT_SC_Compu /end COMPU_METHOD
/begin COMPU_VTAB DIABAS_ATSLRGIDSUPRT_SC_Compu "" TAB_VERB 2 0 "DISABLE" 1 "ENABLE" /end COMPU_VTAB
/begin COMPU_METHOD DIABAS_ATSSUSP_SC_Compu "" TAB_VERB "%6.3" "" COMPU_TAB_REF DIABAS_ATSSUSP_SC_Compu /end COMPU_METHOD
/begin COMPU_VTAB DIABAS_ATSSUSP_SC_Compu "" TAB_VERB 2 1 "Temporary" 2 "Permanent" /end COMPU_VTAB
/begin COMPU_METHOD DIABAS_ATS_SC_Compu "" TAB_VERB "%6.3" "" COMPU_TAB_REF DIABAS_ATS_SC_Compu /end COMPU_METHOD
/begin COMPU_VTAB DIABAS_ATS_SC_Compu "" TAB_VERB 2 0 "ATS inactive" 1 "ATS active" /end COMPU_VTAB
/begin COMPU_METHOD DIABAS_AVS_SY_Compu "" TAB_VERB "%6.3" "" COMPU_TAB_REF DIABAS_AVS_SY_Compu /end COMPU_METHOD
/begin COMPU_VTAB DIABAS_AVS_SY_Compu "" TAB_VERB 2 0 "False" 1 "True" /end COMPU_VTAB
/begin COMPU_METHOD DIABAS_BSWVERS_SC_Compu "" TAB_VERB "%6.3" "" COMPU_TAB_REF DIABAS_BSWVERS_SC_Compu /end COMPU_METHOD
/begin COMPU_VTAB DIABAS_BSWVERS_SC_Compu "" TAB_VERB 20 10 "BSW_1703" 11 "BSW_1706" 12 "BSW_1709" 13 "BSW_1712" 20 "BSW_1803" 21 "BSW_1806" 22 "BSW_1809" 23 "BSW_1812" 30 "BSW_1903" 31 "BSW_1906" 32 "BSW_1909" 33 "BSW_1912" 40 "BSW_2003" 41 "BSW_2006" 42 "BSW_2009" 43 "BSW_2012" 50 "BSW_2103" 51 "BSW_2106" 52 "BSW_2109" 53 "BSW_2112" /end COMPU_VTAB
/begin COMPU_METHOD DIABAS_CALIDCVNCTRL_SC_Compu "" TAB_VERB "%6.3" "" COMPU_TAB_REF DIABAS_CALIDCVNCTRL_SC_Compu /end COMPU_METHOD
/begin COMPU_VTAB DIABAS_CALIDCVNCTRL_SC_Compu "" TAB_VERB 3 0 "CALIDCVN_LEG" 1 "CALIDCVN_MIX" 2 "CALIDCVN_AUTO" /end COMPU_VTAB
/begin COMPU_METHOD DIABAS_CALIDCVNLENSEQ_SC_Compu "" RAT_FUNC "%6.2" "" COEFFS 0 1 0 0 0 1 /end COMPU_METHOD
/begin COMPU_METHOD DIABAS_CRCTAB_SY_Compu "" TAB_VERB "%6.3" "" COMPU_TAB_REF DIABAS_CRCTAB_SY_Compu /end COMPU_METHOD
/begin COMPU_VTAB DIABAS_CRCTAB_SY_Compu "" TAB_VERB 2 0 "False" 1 "True" /end COMPU_VTAB
/begin COMPU_METHOD DIABAS_ETCINTSTATE_SC_Compu "" TAB_VERB "%6.3" "" COMPU_TAB_REF DIABAS_ETCINTSTATE_SC_Compu /end COMPU_METHOD
/begin COMPU_VTAB DIABAS_ETCINTSTATE_SC_Compu "" TAB_VERB 2 0 "False" 1 "True" /end COMPU_VTAB
/begin COMPU_METHOD DIABAS_IFFLOATSIG_SC_Compu "" TAB_VERB "%6.3" "" COMPU_TAB_REF DIABAS_IFFLOATSIG_SC_Compu /end COMPU_METHOD
/begin COMPU_VTAB DIABAS_IFFLOATSIG_SC_Compu "" TAB_VERB 2 0 "False" 1 "True" /end COMPU_VTAB
/begin COMPU_METHOD DIABAS_PNDRPRTMOD2_SC_Compu "" TAB_VERB "%6.3" "" COMPU_TAB_REF DIABAS_PNDRPRTMOD2_SC_Compu /end COMPU_METHOD
/begin COMPU_VTAB DIABAS_PNDRPRTMOD2_SC_Compu "" TAB_VERB 2 0 "False" 1 "True" /end COMPU_VTAB
/begin COMPU_METHOD DIABAS_PRMIDAUTVIEW_SC_Compu "" TAB_VERB "%6.3" "" COMPU_TAB_REF DIABAS_PRMIDAUTVIEW_SC_Compu /end COMPU_METHOD
/begin COMPU_VTAB DIABAS_PRMIDAUTVIEW_SC_Compu "" TAB_VERB 2 0 "False" 1 "True" /end COMPU_VTAB
/begin COMPU_METHOD DIABAS_SCRCTL_RCNT_RESET_SY_Compu "" TAB_VERB "%6.3" "" COMPU_TAB_REF DIABAS_SCRCTL_RCNT_RESET_SY_Compu /end COMPU_METHOD
/begin COMPU_VTAB DIABAS_SCRCTL_RCNT_RESET_SY_Compu "" TAB_VERB 2 0 "False" 1 "True" /end COMPU_VTAB
/begin COMPU_METHOD DIABAS_SRV8_SC_Compu "" RAT_FUNC "%6.2" "" COEFFS 0 1 0 0 0 1 /end COMPU_METHOD
/begin COMPU_METHOD DIAGADAPT_SC_Compu "" TAB_VERB "%6.3" "" COMPU_TAB_REF DIAGADAPT_SC_Compu /end COMPU_METHOD
/begin COMPU_VTAB DIAGADAPT_SC_Compu "" TAB_VERB 2 0 "False" 1 "True" /end COMPU_VTAB
/begin COMPU_METHOD DIAGCOM_CALCAN_SC_Compu "" TAB_VERB "%6.3" "" COMPU_TAB_REF DIAGCOM_CALCAN_SC_Compu /end COMPU_METHOD
/begin COMPU_VTAB DIAGCOM_CALCAN_SC_Compu "" TAB_VERB 2 0 "False" 1 "True" /end COMPU_VTAB
/begin COMPU_METHOD DifCoef_COMPU "" RAT_FUNC "%6.2" "J/m/K/s" COEFFS 0 1 0 0 0 1 /end COMPU_METHOD
/begin COMPU_METHOD DifCoef_q0p0001_COMPU "" RAT_FUNC "%7.6" "J/m/K/s" COEFFS 0 10000 0 0 0 1 /end COMPU_METHOD
/begin COMPU_METHOD DINH_ct_Compu "" RAT_FUNC "%6.0" "" COEFFS 0 -1 4096 0 0 1 /end COMPU_METHOD
/begin COMPU_METHOD DINH_DEF25DEB0DI_SC_Compu "" TAB_VERB "%6.3" "" COMPU_TAB_REF DINH_DEF25DEB0DI_SC_Compu /end COMPU_METHOD
/begin COMPU_VTAB DINH_DEF25DEB0DI_SC_Compu "" TAB_VERB 2 0 "False" 1 "True" /end COMPU_VTAB
/begin COMPU_METHOD DINH_FID_VIEW_SC_Compu "" TAB_VERB "%6.3" "" COMPU_TAB_REF DINH_FID_VIEW_SC_Compu /end COMPU_METHOD
/begin COMPU_VTAB DINH_FID_VIEW_SC_Compu "" TAB_VERB 2 0 "False" 1 "True" /end COMPU_VTAB
/begin COMPU_METHOD DINH_NEWTRIPWITHFCMCLR_SC_Compu "" TAB_VERB "%6.3" "" COMPU_TAB_REF DINH_NEWTRIPWITHFCMCLR_SC_Compu /end COMPU_METHOD
/begin COMPU_VTAB DINH_NEWTRIPWITHFCMCLR_SC_Compu "" TAB_VERB 2 0 "False" 1 "True" /end COMPU_VTAB
/begin COMPU_METHOD DIPO_SY_Compu "" TAB_VERB "%6.3" "" COMPU_TAB_REF DIPO_SY_Compu /end COMPU_METHOD
/begin COMPU_VTAB DIPO_SY_Compu "" TAB_VERB 2 0 "0" 1 "1" /end COMPU_VTAB
/begin COMPU_METHOD DISTAB_SY_Compu "" TAB_VERB "%6.3" "" COMPU_TAB_REF DISTAB_SY_Compu /end COMPU_METHOD
/begin COMPU_VTAB DISTAB_SY_Compu "" TAB_VERB 2 0 "No Distab" 1 "Distab" /end COMPU_VTAB
/begin COMPU_METHOD DIUMPR_500MD_SY_Compu "" TAB_VERB "%6.3" "" COMPU_TAB_REF DIUMPR_500MD_SY_Compu /end COMPU_METHOD
/begin COMPU_VTAB DIUMPR_500MD_SY_Compu "" TAB_VERB 2 0 "0" 1 "1" /end COMPU_VTAB
/begin COMPU_METHOD DIUMPR_COLDSTARTDEN_SC_Compu "" TAB_VERB "%6.3" "" COMPU_TAB_REF DIUMPR_COLDSTARTDEN_SC_Compu /end COMPU_METHOD
/begin COMPU_VTAB DIUMPR_COLDSTARTDEN_SC_Compu "" TAB_VERB 2 0 "False" 1 "True" /end COMPU_VTAB
/begin COMPU_METHOD DIUMPR_DATAFROMCAN_SC_Compu "" TAB_VERB "%6.3" "" COMPU_TAB_REF DIUMPR_DATAFROMCAN_SC_Compu /end COMPU_METHOD
/begin COMPU_VTAB DIUMPR_DATAFROMCAN_SC_Compu "" TAB_VERB 2 0 "False" 1 "True" /end COMPU_VTAB
/begin COMPU_METHOD DIUMPR_DSTTRVLDSNCERST_SC_Compu "" TAB_VERB "%6.3" "" COMPU_TAB_REF DIUMPR_DSTTRVLDSNCERST_SC_Compu /end COMPU_METHOD
/begin COMPU_VTAB DIUMPR_DSTTRVLDSNCERST_SC_Compu "" TAB_VERB 2 0 "False" 1 "True" /end COMPU_VTAB
/begin COMPU_METHOD DIUMPR_EVAPDENOMTIPRPSYSOFF_SC_Compu "" TAB_VERB "%6.3" "" COMPU_TAB_REF DIUMPR_EVAPDENOMTIPRPSYSOFF_SC_Compu /end COMPU_METHOD
/begin COMPU_VTAB DIUMPR_EVAPDENOMTIPRPSYSOFF_SC_Compu "" TAB_VERB 2 0 "False" 1 "True" /end COMPU_VTAB
/begin COMPU_METHOD DIUMPR_EVAPDEN_SY_Compu "" TAB_VERB "%6.3" "" COMPU_TAB_REF DIUMPR_EVAPDEN_SY_Compu /end COMPU_METHOD
/begin COMPU_VTAB DIUMPR_EVAPDEN_SY_Compu "" TAB_VERB 2 0 "False" 1 "True" /end COMPU_VTAB
/begin COMPU_METHOD DIUMPR_FUENGOPERTI_SC_Compu "" TAB_VERB "%6.3" "" COMPU_TAB_REF DIUMPR_FUENGOPERTI_SC_Compu /end COMPU_METHOD
/begin COMPU_VTAB DIUMPR_FUENGOPERTI_SC_Compu "" TAB_VERB 2 0 "False" 1 "True" /end COMPU_VTAB
/begin COMPU_METHOD DIUMPR_IGNCYCTMR_SC_Compu "" TAB_VERB "%6.3" "" COMPU_TAB_REF DIUMPR_IGNCYCTMR_SC_Compu /end COMPU_METHOD
/begin COMPU_VTAB DIUMPR_IGNCYCTMR_SC_Compu "" TAB_VERB 2 0 "False" 1 "True" /end COMPU_VTAB
/begin COMPU_METHOD DIUMPR_NUMDENOMIDXGRP_SY_Compu "" TAB_VERB "%6.3" "" COMPU_TAB_REF DIUMPR_NUMDENOMIDXGRP_SY_Compu /end COMPU_METHOD
/begin COMPU_VTAB DIUMPR_NUMDENOMIDXGRP_SY_Compu "" TAB_VERB 2 0 "False" 1 "True" /end COMPU_VTAB
/begin COMPU_METHOD dmNOx_mg_p_s "" RAT_FUNC "%6.3" "mg/s" COEFFS 0 6.66666666666667 0 0 0 1 /end COMPU_METHOD
/begin COMPU_METHOD dmOilAsh_mg_p_s "" RAT_FUNC "%6.4" "mg/s" COEFFS 0 100 0 0 0 1 /end COMPU_METHOD
/begin COMPU_METHOD dmSoot_g_p_s "" RAT_FUNC "%7.6" "g/s" COEFFS 0 10000 0 0 0 1 /end COMPU_METHOD
/begin COMPU_METHOD dmSoot_mg_p_s "" RAT_FUNC "%6.4" "mg/s" COEFFS 0 100 0 0 0 1 /end COMPU_METHOD
/begin COMPU_METHOD DOIP_SC_Compu "" TAB_VERB "%6.3" "" COMPU_TAB_REF DOIP_SC_Compu /end COMPU_METHOD
/begin COMPU_VTAB DOIP_SC_Compu "" TAB_VERB 2 0 "INACTIVE" 1 "ACTIVE" /end COMPU_VTAB
/begin COMPU_METHOD dPres_hPa_p_s "" RAT_FUNC "%6.2" "hPa/s" COEFFS 0 1 0 0 0 1 /end COMPU_METHOD
/begin COMPU_METHOD DREQSWT_CLRSWTSIG_SY_Compu "" TAB_VERB "%6.3" "" COMPU_TAB_REF DREQSWT_CLRSWTSIG_SY_Compu /end COMPU_METHOD
/begin COMPU_VTAB DREQSWT_CLRSWTSIG_SY_Compu "" TAB_VERB 3 0 "NOT_CONFIGURED" 1 "CONNECT_DIO" 2 "CONNECT_CAN" /end COMPU_VTAB
/begin COMPU_METHOD drLamRec_Persec "" RAT_FUNC "%6.4" "1/s" COEFFS 0 100 0 0 0 1 /end COMPU_METHOD
/begin COMPU_METHOD DRVPRGSWT_ECOSWT_SC_Compu "" TAB_VERB "%6.3" "" COMPU_TAB_REF DRVPRGSWT_ECOSWT_SC_Compu /end COMPU_METHOD
/begin COMPU_VTAB DRVPRGSWT_ECOSWT_SC_Compu "" TAB_VERB 4 0 "ECO_mode_not_available" 1 "ECO_mode_available_via_ADC" 2 "ECO_mode_available_via_DIO" 3 "ECO_mode_available_via_CAN" /end COMPU_VTAB
/begin COMPU_METHOD DRVPRGSWT_NRRCPTSTG_SC_Compu "" RAT_FUNC "%6.2" "" COEFFS 0 1 0 0 0 1 /end COMPU_METHOD
/begin COMPU_METHOD DRVPRGSWT_NUMSPRT_Compu "" RAT_FUNC "%6.2" "" COEFFS 0 1 0 0 0 1 /end COMPU_METHOD
/begin COMPU_METHOD DRVPRGSWT_NUMWNTR_Compu "" RAT_FUNC "%6.2" "" COEFFS 0 1 0 0 0 1 /end COMPU_METHOD
/begin COMPU_METHOD DtyCyc "" RAT_FUNC "%6.4" "%" COEFFS 0 100 0 0 0 1 /end COMPU_METHOD
/begin COMPU_METHOD EngN "" RAT_FUNC "%6.3" "rpm" COEFFS 0 2 0 0 0 1 /end COMPU_METHOD
/begin COMPU_METHOD InjMass "" RAT_FUNC "%6.4" "mg/hub" COEFFS 0 100 0 0 0 1 /end COMPU_METHOD
/begin COMPU_METHOD OneToOne "" RAT_FUNC "%6.2" "-" COEFFS 0 1 0 0 0 1 /end COMPU_METHOD
/begin COMPU_METHOD Prc "" RAT_FUNC "%6.4" "%" COEFFS 0 81.92 0 0 0 1 /end COMPU_METHOD
/begin COMPU_METHOD PSC_Fact "" RAT_FUNC "%7.6" "-" COEFFS 0 32767 0 0 0 1 /end COMPU_METHOD
/begin COMPU_METHOD RBPtCel_dt_1p0_1 "" RAT_FUNC "%6.2" "K/s" COEFFS 0 1 0 0 0 1 /end COMPU_METHOD
/begin COMPU_METHOD RBPtCel_du_1p0_1 "" RAT_FUNC "%6.2" "V/s" COEFFS 0 1 0 0 0 1 /end COMPU_METHOD
/begin COMPU_METHOD RBPtCel_fac_1p0_8 "" RAT_FUNC "%6.2" "%/s" COEFFS 0 1 0 0 0 1 /end COMPU_METHOD
/begin COMPU_METHOD RBPtCel_i_0p03125_1 "" RAT_FUNC "%6.4" "A" COEFFS 0 32 0 0 0 1 /end COMPU_METHOD
/begin COMPU_METHOD RBPtCel_Perc_1p0_1 "" RAT_FUNC "%6.2" "%" COEFFS 0 1 0 0 0 1 /end COMPU_METHOD
/begin COMPU_METHOD RBPtCel_pwr_25p0_1 "" RAT_FUNC "%6.1" "W" COEFFS 0 1 0 0 0 25 /end COMPU_METHOD
/begin COMPU_METHOD RBPtCel_ti_0p01_1 "" RAT_FUNC "%6.4" "s" COEFFS 0 100 0 0 0 1 /end COMPU_METHOD
/begin COMPU_METHOD RBPtCel_ti_10p0_1 "" RAT_FUNC "%6.1" "ms" COEFFS 0 1 0 0 0 10 /end COMPU_METHOD
/begin COMPU_METHOD RBPtCel_ti_1p0_2 "" RAT_FUNC "%6.2" "s" COEFFS 0 1 0 0 0 1 /end COMPU_METHOD
/begin COMPU_METHOD RBPtCel_t_1p0_3 "" RAT_FUNC "%6.2" "Deg C" COEFFS 0 1 0 0 0 1 /end COMPU_METHOD
/begin COMPU_METHOD RBPtCel_u_0p1_1 "" RAT_FUNC "%6.3" "V" COEFFS 0 10 0 0 0 1 /end COMPU_METHOD
/begin COMPU_METHOD RBPtCel_u_1p0_1 "" RAT_FUNC "%6.2" "V" COEFFS 0 1 0 0 0 1 /end COMPU_METHOD
/begin COMPU_METHOD RBPtCel_u_1p0_2 "" RAT_FUNC "%6.2" "mV" COEFFS 0 1 0 0 0 1 /end COMPU_METHOD
/begin COMPU_METHOD RmpTrqPrpHigh "" RAT_FUNC "%6.4" "Nm/s" COEFFS 0 655.36 0 0 0 1 /end COMPU_METHOD
/begin COMPU_METHOD SigQly_COMPU_VERB "" TAB_VERB "%6.3" "" COMPU_TAB_REF SigQly_COMPU_VERB /end COMPU_METHOD
/begin COMPU_VTAB SigQly_COMPU_VERB "" TAB_VERB 16 0 "SIGQLY_NOTCALC" 1 "SIGQLY_INIT" 2 "SIGQLY_OK" 3 "SIGQLY_MODEL" 4 "SIGQLY_REPLACEMENT" 5 "SIGQLY_FROZEN" 6 "SIGQLY_INVALID" 7 "SIGQLY_RESERVED_7" 8 "SIGQLY_RESERVED_8" 9 "SIGQLY_RESERVED_9" 10 "SIGQLY_RESERVED_10" 11 "SIGQLY_RESERVED_11" 12 "SIGQLY_RESERVED_12" 13 "SIGQLY_RESERVED_13" 14 "SIGQLY_RESERVED_14" 15 "SIGQLY_RESERVED_15" /end COMPU_VTAB
/begin COMPU_METHOD spg_q0p0039 "" RAT_FUNC "%6.4" "V" COEFFS 0 256 0 0 0 1 /end COMPU_METHOD
/begin COMPU_METHOD Temp_Cels "" RAT_FUNC "%6.1" "deg C" COEFFS 0 10 2731.4 0 0 1 /end COMPU_METHOD
/begin COMPU_METHOD TimeDelay_s "" RAT_FUNC "%6.1" "s" COEFFS 0 0 1 0 0.00023283064365387 0 /end COMPU_METHOD
/begin COMPU_METHOD Time_ms "" RAT_FUNC "%6.1" "ms" COEFFS 0 0.1 0 0 0 1 /end COMPU_METHOD
/begin COMPU_METHOD Time_msec_q1_COMPU "" RAT_FUNC "%6.2" "ms" COEFFS 0 1 0 0 0 1 /end COMPU_METHOD
/begin COMPU_METHOD Time_s "" RAT_FUNC "%6.4" "s" COEFFS 0 100 0 0 0 1 /end COMPU_METHOD
/begin COMPU_METHOD Time_usec_q1_COMPU "" RAT_FUNC "%6.2" "us" COEFFS 0 1 0 0 0 1 /end COMPU_METHOD
/begin COMPU_METHOD TrqPrp "" RAT_FUNC "%6.2" "Nm" COEFFS 0 0.625 0 0 0 1 /end COMPU_METHOD
/begin COMPU_METHOD TrqPrpHigh "" RAT_FUNC "%6.3" "Nm" COEFFS 0 10 0 0 0 1 /end COMPU_METHOD
/begin COMPU_METHOD Vel "" RAT_FUNC "%6.4" "km/h" COEFFS 0 100 0 0 0 1 /end COMPU_METHOD
/begin COMPU_METHOD Volt "" RAT_FUNC "%6.3" "mV" COEFFS 0 5 0 0 0 1 /end COMPU_METHOD
/begin COMPU_METHOD Volt_V_q0p03125_COMPU "" RAT_FUNC "%6.4" "V" COEFFS 0 32 0 0 0 1 /end COMPU_METHOD
/begin RECORD_LAYOUT Kw_Wr32 FNC_VALUES 1 FLOAT32_IEEE COLUMN_DIR DIRECT /end RECORD_LAYOUT
/begin RECORD_LAYOUT Kw_Ws16 FNC_VALUES 1 SWORD COLUMN_DIR DIRECT /end RECORD_LAYOUT
/begin RECORD_LAYOUT Kw_Wu32 FNC_VALUES 1 ULONG COLUMN_DIR DIRECT /end RECORD_LAYOUT
/begin RECORD_LAYOUT Kw_Wu8 FNC_VALUES 1 UBYTE COLUMN_DIR DIRECT /end RECORD_LAYOUT
/begin RECORD_LAYOUT RB_Curve_R32_R32_sao NO_AXIS_PTS_X 1 ULONG AXIS_PTS_X 2 FLOAT32_IEEE INDEX_INCR DIRECT FNC_VALUES 3 FLOAT32_IEEE COLUMN_DIR DIRECT STATIC_ADDRESS_OFFSETS /end RECORD_LAYOUT
/begin RECORD_LAYOUT RB_Curve_S16_S16 NO_AXIS_PTS_X 1 SWORD AXIS_PTS_X 2 SWORD INDEX_INCR DIRECT FNC_VALUES 3 SWORD COLUMN_DIR DIRECT /end RECORD_LAYOUT
/begin RECORD_LAYOUT RB_Curve_S16_S32_sao NO_AXIS_PTS_X 1 SWORD AXIS_PTS_X 2 SWORD INDEX_INCR DIRECT FNC_VALUES 3 SLONG COLUMN_DIR DIRECT STATIC_ADDRESS_OFFSETS /end RECORD_LAYOUT
/begin RECORD_LAYOUT RB_Map_R32R32_R32_sao NO_AXIS_PTS_X 1 ULONG NO_AXIS_PTS_Y 2 ULONG AXIS_PTS_X 3 FLOAT32_IEEE INDEX_INCR DIRECT AXIS_PTS_Y 4 FLOAT32_IEEE INDEX_INCR DIRECT FNC_VALUES 5 FLOAT32_IEEE COLUMN_DIR DIRECT STATIC_ADDRESS_OFFSETS /end RECORD_LAYOUT
/begin RECORD_LAYOUT RB_Map_S16S16_R32_sao NO_AXIS_PTS_X 1 SWORD NO_AXIS_PTS_Y 2 SWORD AXIS_PTS_X 3 SWORD INDEX_INCR DIRECT AXIS_PTS_Y 4 SWORD INDEX_INCR DIRECT FNC_VALUES 5 FLOAT32_IEEE COLUMN_DIR DIRECT STATIC_ADDRESS_OFFSETS /end RECORD_LAYOUT
/begin RECORD_LAYOUT RB_Map_S16S16_U8_sao NO_AXIS_PTS_X 1 SWORD NO_AXIS_PTS_Y 2 SWORD AXIS_PTS_X 3 SWORD INDEX_INCR DIRECT AXIS_PTS_Y 4 SWORD INDEX_INCR DIRECT FNC_VALUES 5 UBYTE COLUMN_DIR DIRECT STATIC_ADDRESS_OFFSETS /end RECORD_LAYOUT
/begin RECORD_LAYOUT RB_Val_Ws16 FNC_VALUES 1 SWORD COLUMN_DIR DIRECT /end RECORD_LAYOUT
/begin RECORD_LAYOUT RB_Val_Ws32 FNC_VALUES 1 SLONG COLUMN_DIR DIRECT /end RECORD_LAYOUT
/begin RECORD_LAYOUT RB_Val_Wu16 FNC_VALUES 1 UWORD COLUMN_DIR DIRECT /end RECORD_LAYOUT
/begin RECORD_LAYOUT RB_Val_Wu8 FNC_VALUES 1 UBYTE COLUMN_DIR DIRECT /end RECORD_LAYOUT
/begin RECORD_LAYOUT Val_Wr32 FNC_VALUES 1 FLOAT32_IEEE COLUMN_DIR DIRECT /end RECORD_LAYOUT
/begin RECORD_LAYOUT Val_Ws16 FNC_VALUES 1 SWORD COLUMN_DIR DIRECT /end RECORD_LAYOUT
/begin RECORD_LAYOUT Val_Ws32 FNC_VALUES 1 SLONG COLUMN_DIR DIRECT /end RECORD_LAYOUT
/begin RECORD_LAYOUT Val_Wu16 FNC_VALUES 1 UWORD COLUMN_DIR DIRECT /end RECORD_LAYOUT
/begin RECORD_LAYOUT Val_Wu32 FNC_VALUES 1 ULONG COLUMN_DIR DIRECT /end RECORD_LAYOUT
/begin RECORD_LAYOUT Val_Wu8 FNC_VALUES 1 UBYTE COLUMN_DIR DIRECT /end RECORD_LAYOUT
/end MODULE
/end PROJECT

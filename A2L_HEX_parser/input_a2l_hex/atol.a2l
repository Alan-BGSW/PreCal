ASAP2_VERSION 1 70
/begin PROJECT MDG1C "VC1CP091_STLA_N_D061I3"
/begin HEADER "" VERSION "VC1CP091_STLA_N_D061I3" PROJECT_NO MDG1C /end HEADER
/begin MODULE DIM ""
/begin MOD_COMMON "" BYTE_ORDER MSB_LAST ALIGNMENT_BYTE 1 ALIGNMENT_WORD 2 ALIGNMENT_LONG 4 ALIGNMENT_INT64 4 ALIGNMENT_FLOAT32_IEEE 4 ALIGNMENT_FLOAT64_IEEE 4 DATA_SIZE 32 /end MOD_COMMON
/begin CHARACTERISTIC Com_flgVehSpdAvl_38DhInvld_C "" VALUE 0x80257DAD Val_Wu8 3.000 OneToOne 0.00 3.000 FORMAT "%5.3" EXTENDED_LIMITS 0.00 255.0 /end CHARACTERISTIC
/begin CHARACTERISTIC Com_flgVehSpdAvl_38DhRcf_C "" VALUE 0x80257DAE Val_Wu8 3.000 OneToOne 0.00 3.000 FORMAT "%5.3" EXTENDED_LIMITS 0.00 255.0 /end CHARACTERISTIC
/begin CHARACTERISTIC Com_flgVehSpdQly_241hIni_C "" VALUE 0x80257DAF Val_Wu8 3.000 OneToOne 0.00 3.000 FORMAT "%5.3" EXTENDED_LIMITS 0.00 255.0 /end CHARACTERISTIC
/begin CHARACTERISTIC Com_flgVehSpdQly_241hInvld_C "" VALUE 0x80257DB0 Val_Wu8 3.000 OneToOne 0.00 3.000 FORMAT "%5.3" EXTENDED_LIMITS 0.00 255.0 /end CHARACTERISTIC
/begin CHARACTERISTIC Com_flgVoltMeasmtErr_308hIni_C "" VALUE 0x80257DB1 Val_Wu8 1.00000000000 B_TRUE 0.00 1.00000000000 FORMAT "%13.11" /end CHARACTERISTIC
/begin CHARACTERISTIC Com_flgVoltMeasmtErr_308hRcf_C "" VALUE 0x80257DB2 Val_Wu8 1.00000000000 B_TRUE 0.00 1.00000000000 FORMAT "%13.11" /end CHARACTERISTIC
/begin CHARACTERISTIC Com_flgVoltMeasmtSysErr_308hIni_C "" VALUE 0x80257DB3 Val_Wu8 1.00000000000 B_TRUE 0.00 1.00000000000 FORMAT "%13.11" /end CHARACTERISTIC
/begin CHARACTERISTIC Com_flgVoltMeasmtSysErr_308hRcf_C "" VALUE 0x80257DB4 Val_Wu8 1.00000000000 B_TRUE 0.00 1.00000000000 FORMAT "%13.11" /end CHARACTERISTIC
/begin CHARACTERISTIC Com_flgVoltMeasmtVld_308hIni_C "" VALUE 0x80257DB5 Val_Wu8 1.00000000000 B_TRUE 0.00 1.00000000000 FORMAT "%13.11" /end CHARACTERISTIC
/begin CHARACTERISTIC Com_flgVoltMeasmtVld_308hRcf_C "" VALUE 0x80257DB6 Val_Wu8 1.00000000000 B_TRUE 0.00 1.00000000000 FORMAT "%13.11" /end CHARACTERISTIC
/begin CHARACTERISTIC Com_flgVoltRngErr_308hIni_C "" VALUE 0x80257DB7 Val_Wu8 1.00000000000 B_TRUE 0.00 1.00000000000 FORMAT "%13.11" /end CHARACTERISTIC
/begin CHARACTERISTIC Com_flgVoltRngErr_308hRcf_C "" VALUE 0x80257DB8 Val_Wu8 1.00000000000 B_TRUE 0.00 1.00000000000 FORMAT "%13.11" /end CHARACTERISTIC
/begin CHARACTERISTIC Com_HS3_AUTO_GEARBOX_SWITCH_REQ_Tx_EIMode_C "" VALUE 0x80250099 RB_Val_Wboolean 1.00000000000 B_TRUE 0.00 1.00000000000 FORMAT "%13.11" /end CHARACTERISTIC
/begin CHARACTERISTIC Com_HvbMaxSnsrTempRx_435hIni_C "" VALUE 0x80257DBA Val_Ws16 165.0000 RBPtCel_t_1p0_om40_1 -40.0000 125.0000 FORMAT "%8.4" EXTENDED_LIMITS -32808.00 32727.00 /end CHARACTERISTIC
/begin CHARACTERISTIC Com_HvbMaxSnsrTempRx_435hInvld_C "" VALUE 0x80257DBC Val_Wu8 255.0 OneToOne 0.00 255.0 FORMAT "%5.1" /end CHARACTERISTIC
/begin CHARACTERISTIC Com_HvbMaxSnsrTempRx_435hRcf_C "" VALUE 0x80257DBE Val_Ws16 165.0000 RBPtCel_t_1p0_om40_1 -40.0000 125.0000 FORMAT "%8.4" EXTENDED_LIMITS -32808.00 32727.00 /end CHARACTERISTIC
/begin CHARACTERISTIC Com_HvbMaxSnsrTempTx_5A2hIni_C "" VALUE 0x80257DC0 Val_Wu8 255.0 OneToOne 0.00 255.0 FORMAT "%5.1" /end CHARACTERISTIC
/begin CHARACTERISTIC Com_HvbMaxSnsrTempTx_5A2hInvld_C "" VALUE 0x80257DC1 Val_Wu8 255.0 OneToOne 0.00 255.0 FORMAT "%5.1" /end CHARACTERISTIC
/begin CHARACTERISTIC Com_iBattEBS1Rx_592hIni_C "" VALUE 0x80257DC2 Val_Wu16 2.000000 q1Em3_om1_A -1.000000 1.000000 FORMAT "%8.6" EXTENDED_LIMITS -1.000000 64.53500 /end CHARACTERISTIC
/begin CHARACTERISTIC Com_iBattEBS1Rx_592hInvld_C "" VALUE 0x80257DC4 Val_Wu16 65535.00 OneToOne 0.00 65535.00 FORMAT "%8.2" /end CHARACTERISTIC
/begin CHARACTERISTIC Com_iBattEBS1Rx_592hRcf_C "" VALUE 0x80257DC6 Val_Wu16 2.000000 q1Em3_om1_A -1.000000 1.000000 FORMAT "%8.6" EXTENDED_LIMITS -1.000000 64.53500 /end CHARACTERISTIC
/begin CHARACTERISTIC Com_iBattEBS2Rx_592hIni_C "" VALUE 0x80257DC8 Val_Wu16 400.0000 q0p01_om200_A -200.0000 200.0000 FORMAT "%8.4" EXTENDED_LIMITS -200.0000 455.3500 /end CHARACTERISTIC
/begin CHARACTERISTIC Com_iBattEBS2Rx_592hInvld_C "" VALUE 0x80257DCA Val_Wu16 65535.00 OneToOne 0.00 65535.00 FORMAT "%8.2" /end CHARACTERISTIC
/begin CHARACTERISTIC Com_iBattEBS2Rx_592hRcf_C "" VALUE 0x80257DCC Val_Wu16 400.0000 q0p01_om200_A -200.0000 200.0000 FORMAT "%8.4" EXTENDED_LIMITS -200.0000 455.3500 /end CHARACTERISTIC
/begin CHARACTERISTIC Com_iBattEBS3Rx_592hIni_C "" VALUE 0x80257DCE Val_Wu16 3000.000 q0p1_om1500_A -1500.000 1500.000 FORMAT "%8.3" EXTENDED_LIMITS -1500.000 5053.500 /end CHARACTERISTIC
/begin CHARACTERISTIC Com_iBattEBS3Rx_592hInvld_C "" VALUE 0x80257DD0 Val_Wu16 65535.00 OneToOne 0.00 65535.00 FORMAT "%8.2" /end CHARACTERISTIC
/begin CHARACTERISTIC Com_iBattEBS3Rx_592hRcf_C "" VALUE 0x80257DD2 Val_Wu16 3000.000 q0p1_om1500_A -1500.000 1500.000 FORMAT "%8.3" EXTENDED_LIMITS -1500.000 5053.500 /end CHARACTERISTIC
/begin CHARACTERISTIC Com_iDcdcHvActRvsn1_283hIni_C "" VALUE 0x80257DD4 Val_Ws16 2047.969 Curr_A_q0p03125_COMPU -1024.000 1023.969 FORMAT "%8.3" /end CHARACTERISTIC
/begin CHARACTERISTIC Com_iDcdcHvActRvsn1_283hInvld_C "" VALUE 0x80257DD6 Val_Wu8 255.0 OneToOne 0.00 255.0 FORMAT "%5.1" /end CHARACTERISTIC
/begin CHARACTERISTIC Com_iDcdcHvActRvsn1_283hRcf_C "" VALUE 0x80257DD8 Val_Ws16 2047.969 Curr_A_q0p03125_COMPU -1024.000 1023.969 FORMAT "%8.3" /end CHARACTERISTIC
/begin CHARACTERISTIC Com_iDcdcLvActRvsn1_283hIni_C "" VALUE 0x80257DDA Val_Ws16 65535.00 OneToOne -32768.00 32767.00 FORMAT "%8.2" /end CHARACTERISTIC
/begin CHARACTERISTIC Com_iDcdcLvActRvsn1_283hInvld_C "" VALUE 0x80257DDC Val_Wu8 255.0 OneToOne 0.00 255.0 FORMAT "%5.1" /end CHARACTERISTIC
/begin CHARACTERISTIC Com_iDcdcLvActRvsn1_283hRcf_C "" VALUE 0x80257DDE Val_Ws16 65535.00 OneToOne -32768.00 32767.00 FORMAT "%8.2" /end CHARACTERISTIC
/begin CHARACTERISTIC Com_iElCmprHvAct_47BhIni_C "" VALUE 0x80257DE0 Val_Wu8 25.00 q0p1_A 0.00 25.00 FORMAT "%5.2" EXTENDED_LIMITS 0.00 25.50 /end CHARACTERISTIC
/begin CHARACTERISTIC Com_iElCmprHvAct_47BhInvld_C "" VALUE 0x80257DE1 Val_Wu8 255.0 OneToOne 0.00 255.0 FORMAT "%5.1" /end CHARACTERISTIC
/begin CHARACTERISTIC Com_iElCmprHvAct_47BhRcf_C "" VALUE 0x80257DE2 Val_Wu8 25.00 q0p1_A 0.00 25.00 FORMAT "%5.2" EXTENDED_LIMITS 0.00 25.50 /end CHARACTERISTIC
/begin CHARACTERISTIC Com_iElCmprPeakPha_47BhIni_C "" VALUE 0x80257DE3 Val_Wu8 12.75 q0p05_A 0.00 12.75 FORMAT "%5.2" /end CHARACTERISTIC
/begin CHARACTERISTIC Com_iElCmprPeakPha_47BhInvld_C "" VALUE 0x80257DE4 Val_Wu8 255.0 OneToOne 0.00 255.0 FORMAT "%5.1" /end CHARACTERISTIC
/begin CHARACTERISTIC Com_iElCmprPeakPha_47BhRcf_C "" VALUE 0x80257DE5 Val_Wu8 12.75 q0p05_A 0.00 12.75 FORMAT "%5.2" /end CHARACTERISTIC
/begin CHARACTERISTIC Com_iHvbActRx_205hIni_C "" VALUE 0x80257DE6 Val_Ws16 6553.500 q0p1_A -3276.800 3276.700 FORMAT "%8.3" /end CHARACTERISTIC
/begin CHARACTERISTIC Com_iHvbActRx_205hInvld_C "" VALUE 0x80257DE8 Val_Ws16 8191.000 OneToOne -4096.000 4095.000 FORMAT "%8.3" EXTENDED_LIMITS -32768.00 32767.00 /end CHARACTERISTIC
/begin CHARACTERISTIC Com_iHvbActRx_205hRcf_C "" VALUE 0x80257DEA Val_Ws16 6553.500 q0p1_A -3276.800 3276.700 FORMAT "%8.3" /end CHARACTERISTIC
/begin CHARACTERISTIC Com_iHvbActTx_5C3hIni_C "" VALUE 0x80257DEC Val_Ws16 2047.000 OneToOne -1024.000 1023.000 FORMAT "%8.3" EXTENDED_LIMITS -32768.00 32767.00 /end CHARACTERISTIC
/begin CHARACTERISTIC Com_iHvbActTx_5C3hInvld_C "" VALUE 0x80257DEE Val_Ws16 2047.000 OneToOne -1024.000 1023.000 FORMAT "%8.3" EXTENDED_LIMITS -32768.00 32767.00 /end CHARACTERISTIC
/begin CHARACTERISTIC Com_iHvbChrgMaxSho_285hIni_C "" VALUE 0x80257DF0 Val_Ws16 2047.969 Curr_A_q0p03125_COMPU -1024.000 1023.969 FORMAT "%8.3" /end CHARACTERISTIC
/begin CHARACTERISTIC Com_iHvbChrgMaxSho_285hInvld_C "" VALUE 0x80257DF2 Val_Wu16 4095.000 OneToOne 0.00 4095.000 FORMAT "%8.3" EXTENDED_LIMITS 0.00 65535.00 /end CHARACTERISTIC
/begin CHARACTERISTIC Com_iHvbChrgMaxSho_285hRcf_C "" VALUE 0x80257DF4 Val_Ws16 2047.969 Curr_A_q0p03125_COMPU -1024.000 1023.969 FORMAT "%8.3" /end CHARACTERISTIC
/begin CHARACTERISTIC Com_iHvbDchaMaxSho_275hIni_C "" VALUE 0x80257DF6 Val_Ws16 2047.969 Curr_A_q0p03125_COMPU -1024.000 1023.969 FORMAT "%8.3" /end CHARACTERISTIC
/begin CHARACTERISTIC Com_iHvbDchaMaxSho_275hInvld_C "" VALUE 0x80257DF8 Val_Wu16 4095.000 OneToOne 0.00 4095.000 FORMAT "%8.3" EXTENDED_LIMITS 0.00 65535.00 /end CHARACTERISTIC
/begin CHARACTERISTIC Com_iHvbDchaMaxSho_275hRcf_C "" VALUE 0x80257DFA Val_Ws16 2047.969 Curr_A_q0p03125_COMPU -1024.000 1023.969 FORMAT "%8.3" /end CHARACTERISTIC
/begin CHARACTERISTIC Com_iHvbDes_335hIni_C "" VALUE 0x80257DFC Val_Ws16 2047.969 Curr_A_q0p03125_COMPU -1024.000 1023.969 FORMAT "%8.3" /end CHARACTERISTIC
/begin CHARACTERISTIC Com_iHvbDes_335hInvld_C "" VALUE 0x80257DFE Val_Wu16 2047.000 OneToOne 0.00 2047.000 FORMAT "%8.3" EXTENDED_LIMITS 0.00 65535.00 /end CHARACTERISTIC
/begin CHARACTERISTIC Com_iHvbDes_335hRcf_C "" VALUE 0x80257E00 Val_Ws16 2047.969 Curr_A_q0p03125_COMPU -1024.000 1023.969 FORMAT "%8.3" /end CHARACTERISTIC
/begin CHARACTERISTIC Com_iHvbNomChrgn_335hIni_C "" VALUE 0x80257E02 Val_Ws16 2047.969 Curr_A_q0p03125_COMPU -1024.000 1023.969 FORMAT "%8.3" /end CHARACTERISTIC
/begin CHARACTERISTIC Com_iHvbNomChrgn_335hInvld_C "" VALUE 0x80257E04 Val_Wu16 2047.000 OneToOne 0.00 2047.000 FORMAT "%8.3" EXTENDED_LIMITS 0.00 65535.00 /end CHARACTERISTIC
/begin CHARACTERISTIC Com_iHvbNomChrgn_335hRcf_C "" VALUE 0x80257E06 Val_Ws16 2047.969 Curr_A_q0p03125_COMPU -1024.000 1023.969 FORMAT "%8.3" /end CHARACTERISTIC
/begin CHARACTERISTIC Com_IS_DYN3_CMM_468h_Tx_EIMode_C "" VALUE 0x8025009A RB_Val_Wboolean 1.00000000000 B_TRUE 0.00 1.00000000000 FORMAT "%13.11" /end CHARACTERISTIC
/begin CHARACTERISTIC Com_IS_DYN_VCU_208h_Tx_EIMode_C "" VALUE 0x8025009B RB_Val_Wboolean 1.00000000000 B_TRUE 0.00 1.00000000000 FORMAT "%13.11" /end CHARACTERISTIC
/begin CHARACTERISTIC Com_lTotOdometer_552hIni_C "" VALUE 0x80257E08 Val_Wu32 4294967295.00 Length_km 0.00 4294967295.00 FORMAT "%13.2" /end CHARACTERISTIC
/begin CHARACTERISTIC Com_lTotOdometer_552hInvld_C "" VALUE 0x80257E0C Val_Wu32 16777215.0000 OneToOne 0.00 16777215.0000 FORMAT "%13.4" EXTENDED_LIMITS 0.00 4294967295.00 /end CHARACTERISTIC
/begin CHARACTERISTIC Com_lTotOdometer_552hRcf_C "" VALUE 0x80257E10 Val_Wu32 4294967295.00 Length_km 0.00 4294967295.00 FORMAT "%13.2" /end CHARACTERISTIC
/begin CHARACTERISTIC Com_nElCmprActlTx_231hIni_C "" VALUE 0x80257E14 Val_Wu16 8191.000 OneToOne 0.00 8191.000 FORMAT "%8.3" EXTENDED_LIMITS 0.00 65535.00 /end CHARACTERISTIC
/begin CHARACTERISTIC Com_nElCmprActlTx_231hInvld_C "" VALUE 0x80257E16 Val_Wu16 8191.000 OneToOne 0.00 8191.000 FORMAT "%8.3" EXTENDED_LIMITS 0.00 65535.00 /end CHARACTERISTIC
/begin CHARACTERISTIC Com_nElCmprActl_47BhIni_C "" VALUE 0x80257E18 Val_Ws16 65540.00 RBPtCel_n_10p0_1 -32770.00 32770.00 FORMAT "%8.2" EXTENDED_LIMITS -327680.0 327670.0 /end CHARACTERISTIC
/begin CHARACTERISTIC Com_nElCmprActl_47BhInvld_C "" VALUE 0x80257E1A Val_Wu16 511.0000 OneToOne 0.00 511.0000 FORMAT "%8.4" EXTENDED_LIMITS 0.00 65535.00 /end CHARACTERISTIC
/begin CHARACTERISTIC Com_nElCmprActl_47BhRcf_C "" VALUE 0x80257E1C Val_Ws16 65540.00 RBPtCel_n_10p0_1 -32770.00 32770.00 FORMAT "%8.2" EXTENDED_LIMITS -327680.0 327670.0 /end CHARACTERISTIC
/begin CHARACTERISTIC Com_nIvtrMotAct01_522hIni_C "" VALUE 0x80257E1E Val_Ws16 4095.000 OneToOne -2048.000 2047.000 FORMAT "%8.3" EXTENDED_LIMITS -32768.00 32767.00 /end CHARACTERISTIC
/begin CHARACTERISTIC Com_nIvtrMotAct01_522hInvld_C "" VALUE 0x80257E20 Val_Ws16 4095.000 OneToOne -2048.000 2047.000 FORMAT "%8.3" EXTENDED_LIMITS -32768.00 32767.00 /end CHARACTERISTIC
/begin CHARACTERISTIC Com_noCks201Ini_C "" VALUE 0x8025009C Val_Wu8 15.00 OneToOne 0.00 15.00 FORMAT "%5.2" EXTENDED_LIMITS 0.00 255.0 /end CHARACTERISTIC
/begin CHARACTERISTIC Com_noCks205Ini_C "" VALUE 0x8025009D Val_Wu8 15.00 OneToOne 0.00 15.00 FORMAT "%5.2" EXTENDED_LIMITS 0.00 255.0 /end CHARACTERISTIC
/begin CHARACTERISTIC Com_noCks208Ini_C "" VALUE 0x8025009E Val_Wu8 15.00 OneToOne 0.00 15.00 FORMAT "%5.2" EXTENDED_LIMITS 0.00 255.0 /end CHARACTERISTIC
/begin CHARACTERISTIC Com_noCks211Ini_C "" VALUE 0x8025009F Val_Wu8 15.00 OneToOne 0.00 15.00 FORMAT "%5.2" EXTENDED_LIMITS 0.00 255.0 /end CHARACTERISTIC
/begin CHARACTERISTIC Com_noCks217Ini_C "" VALUE 0x802500A0 Val_Wu8 15.00 OneToOne 0.00 15.00 FORMAT "%5.2" EXTENDED_LIMITS 0.00 255.0 /end CHARACTERISTIC
/begin CHARACTERISTIC Com_noCks219Ini_C "" VALUE 0x802500A1 Val_Wu8 15.00 OneToOne 0.00 15.00 FORMAT "%5.2" EXTENDED_LIMITS 0.00 255.0 /end CHARACTERISTIC
/begin CHARACTERISTIC Com_noCks221Ini_C "" VALUE 0x802500A2 Val_Wu8 15.00 OneToOne 0.00 15.00 FORMAT "%5.2" EXTENDED_LIMITS 0.00 255.0 /end CHARACTERISTIC
/begin CHARACTERISTIC Com_noCks237Ini_C "" VALUE 0x802500A3 Val_Wu8 15.00 OneToOne 0.00 15.00 FORMAT "%5.2" EXTENDED_LIMITS 0.00 255.0 /end CHARACTERISTIC
/begin CHARACTERISTIC Com_noCks241Ini_C "" VALUE 0x802500A4 Val_Wu8 15.00 OneToOne 0.00 15.00 FORMAT "%5.2" EXTENDED_LIMITS 0.00 255.0 /end CHARACTERISTIC
/begin CHARACTERISTIC Com_noCks259Ini_C "" VALUE 0x802500A5 Val_Wu8 15.00 OneToOne 0.00 15.00 FORMAT "%5.2" EXTENDED_LIMITS 0.00 255.0 /end CHARACTERISTIC
/begin CHARACTERISTIC Com_noCks273Ini_C "" VALUE 0x802500A6 Val_Wu8 15.00 OneToOne 0.00 15.00 FORMAT "%5.2" EXTENDED_LIMITS 0.00 255.0 /end CHARACTERISTIC
/begin CHARACTERISTIC Com_noCks275Ini_C "" VALUE 0x802500A7 Val_Wu8 15.00 OneToOne 0.00 15.00 FORMAT "%5.2" EXTENDED_LIMITS 0.00 255.0 /end CHARACTERISTIC
/begin CHARACTERISTIC Com_noCks281Ini_C "" VALUE 0x802500A8 Val_Wu8 15.00 OneToOne 0.00 15.00 FORMAT "%5.2" EXTENDED_LIMITS 0.00 255.0 /end CHARACTERISTIC
/begin CHARACTERISTIC Com_noCks285Ini_C "" VALUE 0x802500A9 Val_Wu8 15.00 OneToOne 0.00 15.00 FORMAT "%5.2" EXTENDED_LIMITS 0.00 255.0 /end CHARACTERISTIC
/begin CHARACTERISTIC Com_noCks293Ini_C "" VALUE 0x802500AA Val_Wu8 15.00 OneToOne 0.00 15.00 FORMAT "%5.2" EXTENDED_LIMITS 0.00 255.0 /end CHARACTERISTIC
/begin CHARACTERISTIC Com_noCks308Ini_C "" VALUE 0x802500AB Val_Wu8 15.00 OneToOne 0.00 15.00 FORMAT "%5.2" EXTENDED_LIMITS 0.00 255.0 /end CHARACTERISTIC
/begin CHARACTERISTIC Com_noCks318Ini_C "" VALUE 0x802500AC Val_Wu8 15.00 OneToOne 0.00 15.00 FORMAT "%5.2" EXTENDED_LIMITS 0.00 255.0 /end CHARACTERISTIC
/begin CHARACTERISTIC Com_noCks325Ini_C "" VALUE 0x802500AD Val_Wu8 15.00 OneToOne 0.00 15.00 FORMAT "%5.2" EXTENDED_LIMITS 0.00 255.0 /end CHARACTERISTIC
/begin CHARACTERISTIC Com_noCks335Ini_C "" VALUE 0x802500AE Val_Wu8 15.00 OneToOne 0.00 15.00 FORMAT "%5.2" EXTENDED_LIMITS 0.00 255.0 /end CHARACTERISTIC
/begin CHARACTERISTIC Com_noCks38DIni_C "" VALUE 0x802500AF Val_Wu8 15.00 OneToOne 0.00 15.00 FORMAT "%5.2" EXTENDED_LIMITS 0.00 255.0 /end CHARACTERISTIC
/begin CHARACTERISTIC Com_noCks412Ini_C "" VALUE 0x802500B0 Val_Wu8 15.00 OneToOne 0.00 15.00 FORMAT "%5.2" EXTENDED_LIMITS 0.00 255.0 /end CHARACTERISTIC
/begin CHARACTERISTIC Com_noCks432Ini_C "" VALUE 0x802500B1 Val_Wu8 15.00 OneToOne 0.00 15.00 FORMAT "%5.2" EXTENDED_LIMITS 0.00 255.0 /end CHARACTERISTIC
/begin CHARACTERISTIC Com_noCks4F2Ini_C "" VALUE 0x802500B2 Val_Wu8 15.00 OneToOne 0.00 15.00 FORMAT "%5.2" EXTENDED_LIMITS 0.00 255.0 /end CHARACTERISTIC
/begin CHARACTERISTIC Com_noCks592Ini_C "" VALUE 0x802500B3 Val_Wu8 15.00 OneToOne 0.00 15.00 FORMAT "%5.2" EXTENDED_LIMITS 0.00 255.0 /end CHARACTERISTIC
/begin CHARACTERISTIC Com_noCks595Ini_C "" VALUE 0x802500B4 Val_Wu8 15.00 OneToOne 0.00 15.00 FORMAT "%5.2" EXTENDED_LIMITS 0.00 255.0 /end CHARACTERISTIC
/begin CHARACTERISTIC Com_noCks5B5Ini_C "" VALUE 0x802500B5 Val_Wu8 15.00 OneToOne 0.00 15.00 FORMAT "%5.2" EXTENDED_LIMITS 0.00 255.0 /end CHARACTERISTIC
/begin CHARACTERISTIC Com_noEditCal_111hIni_C "" VALUE 0x80257E22 Val_Wu8 255.0 OneToOne 0.00 255.0 FORMAT "%5.1" /end CHARACTERISTIC
/begin CHARACTERISTIC Com_noEditSw_111hIni_C "" VALUE 0x80257E23 Val_Wu8 255.0 OneToOne 0.00 255.0 FORMAT "%5.1" /end CHARACTERISTIC
/begin CHARACTERISTIC Com_noVersAdp_111hIni_C "" VALUE 0x80257E24 Val_Wu8 255.0 OneToOne 0.00 255.0 FORMAT "%5.1" /end CHARACTERISTIC
/begin CHARACTERISTIC Com_noVersSw_111hIni_C "" VALUE 0x80257E25 Val_Wu8 255.0 OneToOne 0.00 255.0 FORMAT "%5.1" /end CHARACTERISTIC
/begin CHARACTERISTIC Com_noVersSysMnth_111hIni_C "" VALUE 0x80257E26 Val_Wu8 255.0 OneToOne 0.00 255.0 FORMAT "%5.1" /end CHARACTERISTIC
/begin CHARACTERISTIC Com_noVersSysYr_111hIni_C "" VALUE 0x80257E27 Val_Wu8 255.0 OneToOne 0.00 255.0 FORMAT "%5.1" /end CHARACTERISTIC
/begin CHARACTERISTIC Com_noVersSys_111hIni_C "" VALUE 0x80257E28 Val_Wu8 255.0 OneToOne 0.00 255.0 FORMAT "%5.1" /end CHARACTERISTIC
/begin CHARACTERISTIC Com_noVerSysDay_111hIni_C "" VALUE 0x80257E29 Val_Wu8 255.0 OneToOne 0.00 255.0 FORMAT "%5.1" /end CHARACTERISTIC
/begin CHARACTERISTIC Com_nrSerMaxCell_435hIni_C "" VALUE 0x80257E2A Val_Wu8 249.0 OneToOne 1.0 250.0 FORMAT "%5.1" EXTENDED_LIMITS 0.00 255.0 /end CHARACTERISTIC
/begin CHARACTERISTIC Com_nrSerMaxCell_435hInvld_C "" VALUE 0x80257E2B Val_Wu8 255.0 OneToOne 0.00 255.0 FORMAT "%5.1" /end CHARACTERISTIC
/begin CHARACTERISTIC Com_nrSerMaxCell_435hRcf_C "" VALUE 0x80257E2C Val_Wu8 249.0 OneToOne 1.0 250.0 FORMAT "%5.1" EXTENDED_LIMITS 0.00 255.0 /end CHARACTERISTIC
/begin CHARACTERISTIC Com_nrSerMinCell_435hIni_C "" VALUE 0x80257E2D Val_Wu8 249.0 OneToOne 1.0 250.0 FORMAT "%5.1" EXTENDED_LIMITS 0.00 255.0 /end CHARACTERISTIC
/begin CHARACTERISTIC Com_nrSerMinCell_435hInvld_C "" VALUE 0x80257E2E Val_Wu8 255.0 OneToOne 0.00 255.0 FORMAT "%5.1" /end CHARACTERISTIC
/begin CHARACTERISTIC Com_nrSerMinCell_435hRcf_C "" VALUE 0x80257E2F Val_Wu8 249.0 OneToOne 1.0 250.0 FORMAT "%5.1" EXTENDED_LIMITS 0.00 255.0 /end CHARACTERISTIC
/begin CHARACTERISTIC Com_pwrDcdcOutpCpby_293hIni_C "" VALUE 0x80257E30 Val_Wu16 3000.000 RBPtCel_pwr_1p0_1 0.00 3000.000 FORMAT "%8.3" EXTENDED_LIMITS 0.00 65535.00 /end CHARACTERISTIC
/begin CHARACTERISTIC Com_pwrDcdcOutpCpby_293hInvld_C "" VALUE 0x80257E32 Val_Wu16 511.0000 OneToOne 0.00 511.0000 FORMAT "%8.4" EXTENDED_LIMITS 0.00 65535.00 /end CHARACTERISTIC
/begin CHARACTERISTIC Com_pwrDcdcOutpCpby_293hRcf_C "" VALUE 0x80257E34 Val_Wu16 3000.000 RBPtCel_pwr_1p0_1 0.00 3000.000 FORMAT "%8.3" EXTENDED_LIMITS 0.00 65535.00 /end CHARACTERISTIC
/begin CHARACTERISTIC Com_pwrElCmprActl_47BhIni_C "" VALUE 0x80257E36 Val_Wu16 8000.000 q10_W 0.00 8000.000 FORMAT "%8.3" EXTENDED_LIMITS 0.00 655350.0 /end CHARACTERISTIC
/begin CHARACTERISTIC Com_pwrElCmprActl_47BhInvld_C "" VALUE 0x80257E38 Val_Wu16 511.0000 OneToOne 0.00 511.0000 FORMAT "%8.4" EXTENDED_LIMITS 0.00 65535.00 /end CHARACTERISTIC
/begin CHARACTERISTIC Com_pwrElCmprActl_47BhRcf_C "" VALUE 0x80257E3A Val_Wu16 8000.000 q10_W 0.00 8000.000 FORMAT "%8.3" EXTENDED_LIMITS 0.00 655350.0 /end CHARACTERISTIC
/begin CHARACTERISTIC Com_pwrMaxChrgSho_285hIni_C "" VALUE 0x80257E3C Val_Wu16 160.0000 q0p1_kW 0.00 160.0000 FORMAT "%8.4" EXTENDED_LIMITS 0.00 6553.500 /end CHARACTERISTIC
/begin CHARACTERISTIC Com_pwrMaxChrgSho_285hInvld_C "" VALUE 0x80257E3E Val_Wu16 2047.000 OneToOne 0.00 2047.000 FORMAT "%8.3" EXTENDED_LIMITS 0.00 65535.00 /end CHARACTERISTIC
/begin CHARACTERISTIC Com_pwrMaxChrgSho_285hRcf_C "" VALUE 0x80257E40 Val_Wu16 160.0000 q0p1_kW 0.00 160.0000 FORMAT "%8.4" EXTENDED_LIMITS 0.00 6553.500 /end CHARACTERISTIC
/begin CHARACTERISTIC Com_pwrMaxDchaSho_275hIni_C "" VALUE 0x80257E42 Val_Wu16 160.0000 q0p1_kW 0.00 160.0000 FORMAT "%8.4" EXTENDED_LIMITS 0.00 6553.500 /end CHARACTERISTIC
/begin CHARACTERISTIC Com_pwrMaxDchaSho_275hInvld_C "" VALUE 0x80257E44 Val_Wu16 2047.000 OneToOne 0.00 2047.000 FORMAT "%8.3" EXTENDED_LIMITS 0.00 65535.00 /end CHARACTERISTIC
/begin CHARACTERISTIC Com_pwrMaxDchaSho_275hRcf_C "" VALUE 0x80257E46 Val_Wu16 160.0000 q0p1_kW 0.00 160.0000 FORMAT "%8.4" EXTENDED_LIMITS 0.00 6553.500 /end CHARACTERISTIC
/begin CHARACTERISTIC Com_qHvbTotCpRx_675hIni_C "" VALUE 0x80257E48 Val_Ws16 8191.875 RBPtCel_q_0p125_1 -4096.000 4095.875 FORMAT "%8.3" /end CHARACTERISTIC
/begin CHARACTERISTIC Com_qHvbTotCpRx_675hInvld_C "" VALUE 0x80257E4C Val_Wu32 1048575.00000 OneToOne 0.00 1048575.00000 FORMAT "%13.5" EXTENDED_LIMITS 0.00 4294967295.00 /end CHARACTERISTIC
/begin CHARACTERISTIC Com_qHvbTotCpRx_675hRcf_C "" VALUE 0x80257E50 Val_Ws16 8191.875 RBPtCel_q_0p125_1 -4096.000 4095.875 FORMAT "%8.3" /end CHARACTERISTIC
/begin CHARACTERISTIC Com_ratHvbSoc_205hIni_C "" VALUE 0x80257E52 Val_Ws16 799.9878 Prc -400.0000 399.9878 FORMAT "%8.4" /end CHARACTERISTIC
/begin CHARACTERISTIC Com_ratHvbSoc_205hInvld_C "" VALUE 0x80257E54 Val_Wu16 1023.000 OneToOne 0.00 1023.000 FORMAT "%8.3" EXTENDED_LIMITS 0.00 65535.00 /end CHARACTERISTIC
/begin CHARACTERISTIC Com_ratHvbSoc_205hRcf_C "" VALUE 0x80257E56 Val_Ws16 799.9878 Prc -400.0000 399.9878 FORMAT "%8.4" /end CHARACTERISTIC
/begin CHARACTERISTIC Com_ratHvbSoh_543hIni_C "" VALUE 0x80257E58 Val_Wu8 100.0 RBPtCel_Perc_1p0_1 0.00 100.0 FORMAT "%5.1" EXTENDED_LIMITS 0.00 255.0 /end CHARACTERISTIC
/begin CHARACTERISTIC Com_ratHvbSoh_543hInvld_C "" VALUE 0x80257E59 Val_Wu8 127.0 OneToOne 0.00 127.0 FORMAT "%5.1" EXTENDED_LIMITS 0.00 255.0 /end CHARACTERISTIC
/begin CHARACTERISTIC Com_ratHvbSoh_543hRcf_C "" VALUE 0x80257E5A Val_Wu8 100.0 RBPtCel_Perc_1p0_1 0.00 100.0 FORMAT "%5.1" EXTENDED_LIMITS 0.00 255.0 /end CHARACTERISTIC
/begin CHARACTERISTIC Com_ratRHvbSoh_543hIni_C "" VALUE 0x80257E5B Val_Wu8 100.0 RBPtCel_Perc_1p0_1 0.00 100.0 FORMAT "%5.1" EXTENDED_LIMITS 0.00 255.0 /end CHARACTERISTIC
/begin CHARACTERISTIC Com_ratRHvbSoh_543hInvld_C "" VALUE 0x80257E5C Val_Wu8 127.0 OneToOne 0.00 127.0 FORMAT "%5.1" EXTENDED_LIMITS 0.00 255.0 /end CHARACTERISTIC
/begin CHARACTERISTIC Com_ratRHvbSoh_543hRcf_C "" VALUE 0x80257E5D Val_Wu8 100.0 RBPtCel_Perc_1p0_1 0.00 100.0 FORMAT "%5.1" EXTENDED_LIMITS 0.00 255.0 /end CHARACTERISTIC
/begin CHARACTERISTIC Com_ratSocLvBatt_4F2hIni_C "" VALUE 0x80257E5E Val_Wu8 255.0 RBPtCel_Perc_1p0_1 0.00 255.0 FORMAT "%5.1" /end CHARACTERISTIC
/begin CHARACTERISTIC Com_ratSocLvBatt_4F2hInvld_C "" VALUE 0x80257E60 Val_Wu16 1023.000 OneToOne 0.00 1023.000 FORMAT "%8.3" EXTENDED_LIMITS 0.00 65535.00 /end CHARACTERISTIC
/begin CHARACTERISTIC Com_ratSocLvBatt_4F2hRcf_C "" VALUE 0x80257E62 Val_Wu8 255.0 RBPtCel_Perc_1p0_1 0.00 255.0 FORMAT "%5.1" /end CHARACTERISTIC
/begin CHARACTERISTIC Com_rHvbIsoMeasmt_325hIni_C "" VALUE 0x80257E64 Val_Wu16 60000.00 q1_kOhm 0.00 60000.00 FORMAT "%8.2" EXTENDED_LIMITS 0.00 65535.00 /end CHARACTERISTIC
/begin CHARACTERISTIC Com_rHvbIsoMeasmt_325hInvld_C "" VALUE 0x80257E66 Val_Wu16 65535.00 OneToOne 0.00 65535.00 FORMAT "%8.2" /end CHARACTERISTIC
/begin CHARACTERISTIC Com_rHvbIsoMeasmt_325hRcf_C "" VALUE 0x80257E68 Val_Wu16 60000.00 q1_kOhm 0.00 60000.00 FORMAT "%8.2" EXTENDED_LIMITS 0.00 65535.00 /end CHARACTERISTIC
/begin CHARACTERISTIC Com_RMS1_VCU_5C1_Tx_EIMode_C "" VALUE 0x802500B6 RB_Val_Wboolean 1.00000000000 B_TRUE 0.00 1.00000000000 FORMAT "%13.11" /end CHARACTERISTIC
/begin CHARACTERISTIC Com_RMS2_VCU_5C3_Tx_EIMode_C "" VALUE 0x802500B7 RB_Val_Wboolean 1.00000000000 B_TRUE 0.00 1.00000000000 FORMAT "%13.11" /end CHARACTERISTIC
/begin CHARACTERISTIC Com_RMS3_TBMU_5A3_Tx_EIMode_C "" VALUE 0x802500B8 RB_Val_Wboolean 1.00000000000 B_TRUE 0.00 1.00000000000 FORMAT "%13.11" /end CHARACTERISTIC
/begin CHARACTERISTIC Com_RMS5_VCU_563_Tx_EIMode_C "" VALUE 0x802500B9 RB_Val_Wboolean 1.00000000000 B_TRUE 0.00 1.00000000000 FORMAT "%13.11" /end CHARACTERISTIC
/begin CHARACTERISTIC Com_stABSActv_50DhIni_C "" VALUE 0x80257E6A Val_Wu8 1.00000000000 B_TRUE 0.00 1.00000000000 FORMAT "%13.11" /end CHARACTERISTIC
/begin CHARACTERISTIC Com_stABSActv_50DhRcf_C "" VALUE 0x80257E6B Val_Wu8 1.00000000000 B_TRUE 0.00 1.00000000000 FORMAT "%13.11" /end CHARACTERISTIC
/begin CHARACTERISTIC Com_stACTx_231hIni_C "" VALUE 0x80257E6C Val_Wu8 1.000 OneToOne 0.00 1.000 FORMAT "%5.3" EXTENDED_LIMITS 0.00 255.0 /end CHARACTERISTIC
/begin CHARACTERISTIC Com_stAC_26hIni_C "" VALUE 0x80257E6D Val_Wu8 3.000 OneToOne 0.00 3.000 FORMAT "%5.3" EXTENDED_LIMITS 0.00 255.0 /end CHARACTERISTIC
/begin CHARACTERISTIC Com_stAC_26hInvld_C "" VALUE 0x80257E6E Val_Wu8 3.000 OneToOne 0.00 3.000 FORMAT "%5.3" EXTENDED_LIMITS 0.00 255.0 /end CHARACTERISTIC
/begin CHARACTERISTIC Com_stAC_26hRcf_C "" VALUE 0x80257E6F Val_Wu8 3.000 OneToOne 0.00 3.000 FORMAT "%5.3" EXTENDED_LIMITS 0.00 255.0 /end CHARACTERISTIC
/begin CHARACTERISTIC Com_stAirbCrashSevCpl_351hIni_C "" VALUE 0x80257E70 Val_Wu8 7.000 OneToOne 0.00 7.000 FORMAT "%5.3" EXTENDED_LIMITS 0.00 255.0 /end CHARACTERISTIC
/begin CHARACTERISTIC Com_stAirbCrashSevCpl_351hRcf_C "" VALUE 0x80257E71 Val_Wu8 7.000 OneToOne 0.00 7.000 FORMAT "%5.3" EXTENDED_LIMITS 0.00 255.0 /end CHARACTERISTIC
/begin CHARACTERISTIC Com_stAirbCrashSev_351hIni_C "" VALUE 0x80257E72 Val_Wu8 7.000 OneToOne 0.00 7.000 FORMAT "%5.3" EXTENDED_LIMITS 0.00 255.0 /end CHARACTERISTIC
/begin CHARACTERISTIC Com_stAirbCrashSev_351hRcf_C "" VALUE 0x80257E73 Val_Wu8 7.000 OneToOne 0.00 7.000 FORMAT "%5.3" EXTENDED_LIMITS 0.00 255.0 /end CHARACTERISTIC
/begin CHARACTERISTIC Com_stAlrtThermRunAwy_5B5hIni_C "" VALUE 0x80257E74 Val_Wu8 3.000 OneToOne 0.00 3.000 FORMAT "%5.3" EXTENDED_LIMITS 0.00 255.0 /end CHARACTERISTIC
/begin CHARACTERISTIC Com_stAlrtThermRunAwy_5B5hInvld_C "" VALUE 0x80257E75 Val_Wu8 3.000 OneToOne 0.00 3.000 FORMAT "%5.3" EXTENDED_LIMITS 0.00 255.0 /end CHARACTERISTIC
/begin CHARACTERISTIC Com_stAlrtThermRunAwy_5B5hRcf_C "" VALUE 0x80257E76 Val_Wu8 3.000 OneToOne 0.00 3.000 FORMAT "%5.3" EXTENDED_LIMITS 0.00 255.0 /end CHARACTERISTIC
/begin CHARACTERISTIC Com_stBlowrRly_442hIni_C "" VALUE 0x80257E77 Val_Wu8 3.000 OneToOne 0.00 3.000 FORMAT "%5.3" EXTENDED_LIMITS 0.00 255.0 /end CHARACTERISTIC
/begin CHARACTERISTIC Com_stBlowrRly_442hInvld_C "" VALUE 0x80257E78 Val_Wu8 3.000 OneToOne 0.00 3.000 FORMAT "%5.3" EXTENDED_LIMITS 0.00 255.0 /end CHARACTERISTIC
/begin CHARACTERISTIC Com_stBlowrRly_442hRcf_C "" VALUE 0x80257E79 Val_Wu8 3.000 OneToOne 0.00 3.000 FORMAT "%5.3" EXTENDED_LIMITS 0.00 255.0 /end CHARACTERISTIC
/begin CHARACTERISTIC Com_stBrkBstPFlt_221hIni_C "" VALUE 0x80257E7A Val_Wu8 3.000 OneToOne 0.00 3.000 FORMAT "%5.3" EXTENDED_LIMITS 0.00 255.0 /end CHARACTERISTIC
/begin CHARACTERISTIC Com_stBrkBstPFlt_221hInvld_C "" VALUE 0x80257E7B Val_Wu8 3.000 OneToOne 0.00 3.000 FORMAT "%5.3" EXTENDED_LIMITS 0.00 255.0 /end CHARACTERISTIC
/begin CHARACTERISTIC Com_stBrkCntctIndcn_468hIni_C "" VALUE 0x80257E7C Val_Wu8 1.000 OneToOne 0.00 1.000 FORMAT "%5.3" EXTENDED_LIMITS 0.00 255.0 /end CHARACTERISTIC
/begin CHARACTERISTIC Com_stBrk_208hIni_C "" VALUE 0x80257E7D Val_Wu8 3.000 OneToOne 0.00 3.000 FORMAT "%5.3" EXTENDED_LIMITS 0.00 255.0 /end CHARACTERISTIC
/begin CHARACTERISTIC Com_stChrgnSpstReq_432hIni_C "" VALUE 0x80257E7E Val_Wu8 3.000 OneToOne 0.00 3.000 FORMAT "%5.3" EXTENDED_LIMITS 0.00 255.0 /end CHARACTERISTIC
/begin CHARACTERISTIC Com_stChrgnSpstReq_432hRcf_C "" VALUE 0x80257E7F Val_Wu8 3.000 OneToOne 0.00 3.000 FORMAT "%5.3" EXTENDED_LIMITS 0.00 255.0 /end CHARACTERISTIC
/begin CHARACTERISTIC Com_stChrgPlgChrgn_201hIni_C "" VALUE 0x80257E80 Val_Wu8 3.000 OneToOne 0.00 3.000 FORMAT "%5.3" EXTENDED_LIMITS 0.00 255.0 /end CHARACTERISTIC
/begin CHARACTERISTIC Com_stChrgPlg_4A2hIni_C "" VALUE 0x80257E81 Val_Wu8 3.000 OneToOne 0.00 3.000 FORMAT "%5.3" EXTENDED_LIMITS 0.00 255.0 /end CHARACTERISTIC
/begin CHARACTERISTIC Com_stClstrStopIndcn_221hIni_C "" VALUE 0x80257E82 Val_Wu8 3.000 OneToOne 0.00 3.000 FORMAT "%5.3" EXTENDED_LIMITS 0.00 255.0 /end CHARACTERISTIC
/begin CHARACTERISTIC Com_stClstrStopIndcn_221hInvld_C "" VALUE 0x80257E83 Val_Wu8 3.000 OneToOne 0.00 3.000 FORMAT "%5.3" EXTENDED_LIMITS 0.00 255.0 /end CHARACTERISTIC
/begin CHARACTERISTIC Com_stCmdHvBattCntctr_211hIni_C "" VALUE 0x80257E84 Val_Wu8 1.000 OneToOne 0.00 1.000 FORMAT "%5.3" EXTENDED_LIMITS 0.00 255.0 /end CHARACTERISTIC
/begin CHARACTERISTIC Com_stCmdOffsEM01_491hIni_C "" VALUE 0x80257E85 Val_Wu8 1.000 OneToOne 0.00 1.000 FORMAT "%5.3" EXTENDED_LIMITS 0.00 255.0 /end CHARACTERISTIC
/begin CHARACTERISTIC Com_stDayNight_442hIni_C "" VALUE 0x80257E86 Val_Wu8 1.000 OneToOne 0.00 1.000 FORMAT "%5.3" EXTENDED_LIMITS 0.00 255.0 /end CHARACTERISTIC
/begin CHARACTERISTIC Com_stDayNight_442hRcf_C "" VALUE 0x80257E87 Val_Wu8 1.000 OneToOne 0.00 1.000 FORMAT "%5.3" EXTENDED_LIMITS 0.00 255.0 /end CHARACTERISTIC
/begin CHARACTERISTIC Com_stDcdcEVLmp_473hIni_C "" VALUE 0x80257E88 Val_Wu8 3.000 OneToOne 0.00 3.000 FORMAT "%5.3" EXTENDED_LIMITS 0.00 255.0 /end CHARACTERISTIC
/begin CHARACTERISTIC Com_stDcdcEVLmp_473hRcf_C "" VALUE 0x80257E89 Val_Wu8 3.000 OneToOne 0.00 3.000 FORMAT "%5.3" EXTENDED_LIMITS 0.00 255.0 /end CHARACTERISTIC
/begin CHARACTERISTIC Com_stDcdcFltLvl_293hIni_C "" VALUE 0x80257E8A Val_Wu8 7.000 OneToOne 0.00 7.000 FORMAT "%5.3" EXTENDED_LIMITS 0.00 255.0 /end CHARACTERISTIC
/begin CHARACTERISTIC Com_stDcdcFltLvl_293hInvld_C "" VALUE 0x80257E8B Val_Wu8 7.000 OneToOne 0.00 7.000 FORMAT "%5.3" EXTENDED_LIMITS 0.00 255.0 /end CHARACTERISTIC
/begin CHARACTERISTIC Com_stDcdcFltLvl_293hRcf_C "" VALUE 0x80257E8C Val_Wu8 7.000 OneToOne 0.00 7.000 FORMAT "%5.3" EXTENDED_LIMITS 0.00 255.0 /end CHARACTERISTIC
/begin CHARACTERISTIC Com_stDcdcMstWrnLmp_473hIni_C "" VALUE 0x80257E8D Val_Wu8 3.000 OneToOne 0.00 3.000 FORMAT "%5.3" EXTENDED_LIMITS 0.00 255.0 /end CHARACTERISTIC
/begin CHARACTERISTIC Com_stDcdcMstWrnLmp_473hRcf_C "" VALUE 0x80257E8E Val_Wu8 3.000 OneToOne 0.00 3.000 FORMAT "%5.3" EXTENDED_LIMITS 0.00 255.0 /end CHARACTERISTIC
/begin CHARACTERISTIC Com_stDcdcOperModActRx_293hIni_C "" VALUE 0x80257E8F Val_Wu8 8.000 OneToOne 0.00 8.000 FORMAT "%5.3" EXTENDED_LIMITS 0.00 255.0 /end CHARACTERISTIC
/begin CHARACTERISTIC Com_stDcdcOperModActRx_293hRcf_C "" VALUE 0x80257E90 Val_Wu8 8.000 OneToOne 0.00 8.000 FORMAT "%5.3" EXTENDED_LIMITS 0.00 255.0 /end CHARACTERISTIC
/begin CHARACTERISTIC Com_stDcdcPerfLimnActv_663hIni_C "" VALUE 0x80257E91 Val_Wu8 3.000 OneToOne 0.00 3.000 FORMAT "%5.3" EXTENDED_LIMITS 0.00 255.0 /end CHARACTERISTIC
/begin CHARACTERISTIC Com_stDcdcPerfLimnActv_663hRcf_C "" VALUE 0x80257E92 Val_Wu8 3.000 OneToOne 0.00 3.000 FORMAT "%5.3" EXTENDED_LIMITS 0.00 255.0 /end CHARACTERISTIC
/begin CHARACTERISTIC Com_stDcdcSVSLmp_473hIni_C "" VALUE 0x80257E93 Val_Wu8 3.000 OneToOne 0.00 3.000 FORMAT "%5.3" EXTENDED_LIMITS 0.00 255.0 /end CHARACTERISTIC
/begin CHARACTERISTIC Com_stDcdcSVSLmp_473hRcf_C "" VALUE 0x80257E94 Val_Wu8 3.000 OneToOne 0.00 3.000 FORMAT "%5.3" EXTENDED_LIMITS 0.00 255.0 /end CHARACTERISTIC
/begin CHARACTERISTIC Com_stDcdcULimReq_412hIni_C "" VALUE 0x80257E95 Val_Wu8 3.000 OneToOne 0.00 3.000 FORMAT "%5.3" EXTENDED_LIMITS 0.00 255.0 /end CHARACTERISTIC
/begin CHARACTERISTIC Com_stDcdcULimReq_412hRcf_C "" VALUE 0x80257E96 Val_Wu8 3.000 OneToOne 0.00 3.000 FORMAT "%5.3" EXTENDED_LIMITS 0.00 255.0 /end CHARACTERISTIC
/begin CHARACTERISTIC Com_stDoor1_412hIni_C "" VALUE 0x80257E97 Val_Wu8 1.00000000000 B_TRUE 0.00 1.00000000000 FORMAT "%13.11" /end CHARACTERISTIC
/begin CHARACTERISTIC Com_stDoor1_412hRcf_C "" VALUE 0x80257E98 Val_Wu8 1.00000000000 B_TRUE 0.00 1.00000000000 FORMAT "%13.11" /end CHARACTERISTIC
/begin CHARACTERISTIC Com_stDoor2_412hIni_C "" VALUE 0x80257E99 Val_Wu8 1.00000000000 B_TRUE 0.00 1.00000000000 FORMAT "%13.11" /end CHARACTERISTIC
/begin CHARACTERISTIC Com_stDoor2_412hRcf_C "" VALUE 0x80257E9A Val_Wu8 1.00000000000 B_TRUE 0.00 1.00000000000 FORMAT "%13.11" /end CHARACTERISTIC
/begin CHARACTERISTIC Com_stDoor3_412hIni_C "" VALUE 0x80257E9B Val_Wu8 1.00000000000 B_TRUE 0.00 1.00000000000 FORMAT "%13.11" /end CHARACTERISTIC
/begin CHARACTERISTIC Com_stDoor3_412hRcf_C "" VALUE 0x80257E9C Val_Wu8 1.00000000000 B_TRUE 0.00 1.00000000000 FORMAT "%13.11" /end CHARACTERISTIC
/begin CHARACTERISTIC Com_stDoor4_412hIni_C "" VALUE 0x80257E9D Val_Wu8 1.00000000000 B_TRUE 0.00 1.00000000000 FORMAT "%13.11" /end CHARACTERISTIC
/begin CHARACTERISTIC Com_stDoor4_412hRcf_C "" VALUE 0x80257E9E Val_Wu8 1.00000000000 B_TRUE 0.00 1.00000000000 FORMAT "%13.11" /end CHARACTERISTIC
/begin CHARACTERISTIC Com_stDrvAwyDi_331hIni_C "" VALUE 0x80257E9F Val_Wu8 3.000 OneToOne 0.00 3.000 FORMAT "%5.3" EXTENDED_LIMITS 0.00 255.0 /end CHARACTERISTIC
/begin CHARACTERISTIC Com_stDrvModPosn_201hIni_C "" VALUE 0x80257EA0 Val_Wu8 7.000 OneToOne 0.00 7.000 FORMAT "%5.3" EXTENDED_LIMITS 0.00 255.0 /end CHARACTERISTIC
/begin CHARACTERISTIC Com_stDrvModPosn_201hInvld_C "" VALUE 0x80257EA1 Val_Wu8 7.000 OneToOne 0.00 7.000 FORMAT "%5.3" EXTENDED_LIMITS 0.00 255.0 /end CHARACTERISTIC
/begin CHARACTERISTIC Com_stDrvStBltRx_351hIni_C "" VALUE 0x80257EA2 Val_Wu8 3.000 OneToOne 0.00 3.000 FORMAT "%5.3" EXTENDED_LIMITS 0.00 255.0 /end CHARACTERISTIC
/begin CHARACTERISTIC Com_stDrvStBltRx_351hRcf_C "" VALUE 0x80257EA3 Val_Wu8 3.000 OneToOne 0.00 3.000 FORMAT "%5.3" EXTENDED_LIMITS 0.00 255.0 /end CHARACTERISTIC
/begin CHARACTERISTIC Com_stElCmprFltLvl_48BhIni_C "" VALUE 0x80257EA4 Val_Wu8 7.000 OneToOne 0.00 7.000 FORMAT "%5.3" EXTENDED_LIMITS 0.00 255.0 /end CHARACTERISTIC
/begin CHARACTERISTIC Com_stElCmprFltLvl_48BhRcf_C "" VALUE 0x80257EA5 Val_Wu8 7.000 OneToOne 0.00 7.000 FORMAT "%5.3" EXTENDED_LIMITS 0.00 255.0 /end CHARACTERISTIC
/begin CHARACTERISTIC Com_stElCmprStatTx_231hIni_C "" VALUE 0x80257EA6 Val_Wu8 1.000 OneToOne 0.00 1.000 FORMAT "%5.3" EXTENDED_LIMITS 0.00 255.0 /end CHARACTERISTIC
/begin CHARACTERISTIC Com_stElCmprStat_48BhIni_C "" VALUE 0x80257EA7 Val_Wu8 3.000 OneToOne 0.00 3.000 FORMAT "%5.3" EXTENDED_LIMITS 0.00 255.0 /end CHARACTERISTIC
/begin CHARACTERISTIC Com_stElCmprStat_48BhRcf_C "" VALUE 0x80257EA8 Val_Wu8 3.000 OneToOne 0.00 3.000 FORMAT "%5.3" EXTENDED_LIMITS 0.00 255.0 /end CHARACTERISTIC
/begin CHARACTERISTIC Com_stElMDesEem_208hIni_C "" VALUE 0x80257EA9 Val_Wu8 3.000 OneToOne 0.00 3.000 FORMAT "%5.3" EXTENDED_LIMITS 0.00 255.0 /end CHARACTERISTIC
/begin CHARACTERISTIC Com_steTogFailrLvl_259hIni_C "" VALUE 0x80257EAA Val_Wu8 3.000 OneToOne 0.00 3.000 FORMAT "%5.3" EXTENDED_LIMITS 0.00 255.0 /end CHARACTERISTIC
/begin CHARACTERISTIC Com_steTogFailrLvl_259hRcf_C "" VALUE 0x80257EAB Val_Wu8 3.000 OneToOne 0.00 3.000 FORMAT "%5.3" EXTENDED_LIMITS 0.00 255.0 /end CHARACTERISTIC
/begin CHARACTERISTIC Com_stEvapTFlt_26hIni_C "" VALUE 0x80257EAC Val_Wu8 3.000 OneToOne 0.00 3.000 FORMAT "%5.3" EXTENDED_LIMITS 0.00 255.0 /end CHARACTERISTIC
/begin CHARACTERISTIC Com_stEvapTFlt_26hInvld_C "" VALUE 0x80257EAD Val_Wu8 3.000 OneToOne 0.00 3.000 FORMAT "%5.3" EXTENDED_LIMITS 0.00 255.0 /end CHARACTERISTIC
/begin CHARACTERISTIC Com_stEvapTFlt_26hRcf_C "" VALUE 0x80257EAE Val_Wu8 3.000 OneToOne 0.00 3.000 FORMAT "%5.3" EXTENDED_LIMITS 0.00 255.0 /end CHARACTERISTIC
/begin CHARACTERISTIC Com_stEVLmp_221hIni_C "" VALUE 0x80257EAF Val_Wu8 7.000 OneToOne 0.00 7.000 FORMAT "%5.3" EXTENDED_LIMITS 0.00 255.0 /end CHARACTERISTIC
/begin CHARACTERISTIC Com_stGearLvrPos_259hIni_C "" VALUE 0x80257EB0 Val_Wu8 63.00 OneToOne 0.00 63.00 FORMAT "%5.2" EXTENDED_LIMITS 0.00 255.0 /end CHARACTERISTIC
/begin CHARACTERISTIC Com_stGearLvrPos_259hInvld_C "" VALUE 0x80257EB1 Val_Wu8 63.00 OneToOne 0.00 63.00 FORMAT "%5.2" EXTENDED_LIMITS 0.00 255.0 /end CHARACTERISTIC
/begin CHARACTERISTIC Com_stGearLvrPos_259hRcf_C "" VALUE 0x80257EB2 Val_Wu8 63.00 OneToOne 0.00 63.00 FORMAT "%5.2" EXTENDED_LIMITS 0.00 255.0 /end CHARACTERISTIC
/begin CHARACTERISTIC Com_stHvacBlwrFront_26hIni_C "" VALUE 0x80257EB3 Val_Wu8 7.000 OneToOne 0.00 7.000 FORMAT "%5.3" EXTENDED_LIMITS 0.00 255.0 /end CHARACTERISTIC
/begin CHARACTERISTIC Com_stHvacBlwrFront_26hInvld_C "" VALUE 0x80257EB4 Val_Wu8 7.000 OneToOne 0.00 7.000 FORMAT "%5.3" EXTENDED_LIMITS 0.00 255.0 /end CHARACTERISTIC
/begin CHARACTERISTIC Com_stHvacBlwrFront_26hRcf_C "" VALUE 0x80257EB5 Val_Wu8 7.000 OneToOne 0.00 7.000 FORMAT "%5.3" EXTENDED_LIMITS 0.00 255.0 /end CHARACTERISTIC
/begin CHARACTERISTIC Com_stHvacBlwrFront_CAN_231hIni_C "" VALUE 0x80257EB6 Val_Wu8 7.000 OneToOne 0.00 7.000 FORMAT "%5.3" EXTENDED_LIMITS 0.00 255.0 /end CHARACTERISTIC
/begin CHARACTERISTIC Com_stHvacKnobPosn_26hIni_C "" VALUE 0x80257EB7 Val_Wu8 15.00 OneToOne 0.00 15.00 FORMAT "%5.2" EXTENDED_LIMITS 0.00 255.0 /end CHARACTERISTIC
/begin CHARACTERISTIC Com_stHvacKnobPosn_26hInvld_C "" VALUE 0x80257EB8 Val_Wu8 15.00 OneToOne 0.00 15.00 FORMAT "%5.2" EXTENDED_LIMITS 0.00 255.0 /end CHARACTERISTIC
/begin CHARACTERISTIC Com_stHvacKnobPosn_26hRcf_C "" VALUE 0x80257EB9 Val_Wu8 15.00 OneToOne 0.00 15.00 FORMAT "%5.2" EXTENDED_LIMITS 0.00 255.0 /end CHARACTERISTIC
/begin CHARACTERISTIC Com_stHvacKnobPosn_CAN_231hIni_C "" VALUE 0x80257EBA Val_Wu8 15.00 OneToOne 0.00 15.00 FORMAT "%5.2" EXTENDED_LIMITS 0.00 255.0 /end CHARACTERISTIC
/begin CHARACTERISTIC Com_stHvacPanComFlt_26hIni_C "" VALUE 0x80257EBB Val_Wu8 1.00000000000 B_TRUE 0.00 1.00000000000 FORMAT "%13.11" /end CHARACTERISTIC
/begin CHARACTERISTIC Com_stHvacPanComFlt_26hRcf_C "" VALUE 0x80257EBC Val_Wu8 1.00000000000 B_TRUE 0.00 1.00000000000 FORMAT "%13.11" /end CHARACTERISTIC
/begin CHARACTERISTIC Com_stHvacPanHwFlt_26hIni_C "" VALUE 0x80257EBD Val_Wu8 1.00000000000 B_TRUE 0.00 1.00000000000 FORMAT "%13.11" /end CHARACTERISTIC
/begin CHARACTERISTIC Com_stHvacPanHwFlt_26hRcf_C "" VALUE 0x80257EBE Val_Wu8 1.00000000000 B_TRUE 0.00 1.00000000000 FORMAT "%13.11" /end CHARACTERISTIC
/begin CHARACTERISTIC Com_stHvacPanOverUFlt_26hIni_C "" VALUE 0x80257EBF Val_Wu8 1.00000000000 B_TRUE 0.00 1.00000000000 FORMAT "%13.11" /end CHARACTERISTIC
/begin CHARACTERISTIC Com_stHvacPanOverUFlt_26hRcf_C "" VALUE 0x80257EC0 Val_Wu8 1.00000000000 B_TRUE 0.00 1.00000000000 FORMAT "%13.11" /end CHARACTERISTIC
/begin CHARACTERISTIC Com_stHvacPanPotiFlt_26hIni_C "" VALUE 0x80257EC1 Val_Wu8 3.000 OneToOne 0.00 3.000 FORMAT "%5.3" EXTENDED_LIMITS 0.00 255.0 /end CHARACTERISTIC
/begin CHARACTERISTIC Com_stHvacPanPotiFlt_26hInvld_C "" VALUE 0x80257EC2 Val_Wu8 3.000 OneToOne 0.00 3.000 FORMAT "%5.3" EXTENDED_LIMITS 0.00 255.0 /end CHARACTERISTIC
/begin CHARACTERISTIC Com_stHvacPanPotiFlt_26hRcf_C "" VALUE 0x80257EC3 Val_Wu8 3.000 OneToOne 0.00 3.000 FORMAT "%5.3" EXTENDED_LIMITS 0.00 255.0 /end CHARACTERISTIC
/begin CHARACTERISTIC Com_stHvacPanUnderUFlt_26hIni_C "" VALUE 0x80257EC4 Val_Wu8 1.00000000000 B_TRUE 0.00 1.00000000000 FORMAT "%13.11" /end CHARACTERISTIC
/begin CHARACTERISTIC Com_stHvacPanUnderUFlt_26hRcf_C "" VALUE 0x80257EC5 Val_Wu8 1.00000000000 B_TRUE 0.00 1.00000000000 FORMAT "%13.11" /end CHARACTERISTIC
/begin CHARACTERISTIC Com_stHvBatHiTempWrn_583hIni_C "" VALUE 0x80257EC6 Val_Wu8 1.00000000000 B_TRUE 0.00 1.00000000000 FORMAT "%13.11" /end CHARACTERISTIC
/begin CHARACTERISTIC Com_stHvBatHiTempWrn_583hRcf_C "" VALUE 0x80257EC7 Val_Wu8 1.00000000000 B_TRUE 0.00 1.00000000000 FORMAT "%13.11" /end CHARACTERISTIC
/begin CHARACTERISTIC Com_stHvBattOperModDes_211hIni_C "" VALUE 0x80257EC8 Val_Wu8 7.000 OneToOne 0.00 7.000 FORMAT "%5.3" EXTENDED_LIMITS 0.00 255.0 /end CHARACTERISTIC
/begin CHARACTERISTIC Com_stHvBattOperModDes_211hInvld_C "" VALUE 0x80257EC9 Val_Wu8 7.000 OneToOne 0.00 7.000 FORMAT "%5.3" EXTENDED_LIMITS 0.00 255.0 /end CHARACTERISTIC
/begin CHARACTERISTIC Com_stHvbChrgFltRx_325hIni_C "" VALUE 0x80257ECA Val_Wu8 63.00 OneToOne 0.00 63.00 FORMAT "%5.2" EXTENDED_LIMITS 0.00 255.0 /end CHARACTERISTIC
/begin CHARACTERISTIC Com_stHvbChrgFltRx_325hRcf_C "" VALUE 0x80257ECB Val_Wu8 63.00 OneToOne 0.00 63.00 FORMAT "%5.2" EXTENDED_LIMITS 0.00 255.0 /end CHARACTERISTIC
/begin CHARACTERISTIC Com_stHvbChrgn_205hIni_C "" VALUE 0x80257ECC Val_Wu8 7.000 OneToOne 0.00 7.000 FORMAT "%5.3" EXTENDED_LIMITS 0.00 255.0 /end CHARACTERISTIC
/begin CHARACTERISTIC Com_stHvbChrgn_205hInvld_C "" VALUE 0x80257ECD Val_Wu8 7.000 OneToOne 0.00 7.000 FORMAT "%5.3" EXTENDED_LIMITS 0.00 255.0 /end CHARACTERISTIC
/begin CHARACTERISTIC Com_stHvbChrgn_205hRcf_C "" VALUE 0x80257ECE Val_Wu8 7.000 OneToOne 0.00 7.000 FORMAT "%5.3" EXTENDED_LIMITS 0.00 255.0 /end CHARACTERISTIC
/begin CHARACTERISTIC Com_stHvbCnctn_205hIni_C "" VALUE 0x80257ECF Val_Wu8 3.000 OneToOne 0.00 3.000 FORMAT "%5.3" EXTENDED_LIMITS 0.00 255.0 /end CHARACTERISTIC
/begin CHARACTERISTIC Com_stHvbCnctn_205hRcf_C "" VALUE 0x80257ED0 Val_Wu8 3.000 OneToOne 0.00 3.000 FORMAT "%5.3" EXTENDED_LIMITS 0.00 255.0 /end CHARACTERISTIC
/begin CHARACTERISTIC Com_stHvbDiscnctReas_583hIni_C "" VALUE 0x80257ED1 Val_Wu8 7.000 OneToOne 0.00 7.000 FORMAT "%5.3" EXTENDED_LIMITS 0.00 255.0 /end CHARACTERISTIC
/begin CHARACTERISTIC Com_stHvbDiscnctReas_583hInvld_C "" VALUE 0x80257ED2 Val_Wu8 7.000 OneToOne 0.00 7.000 FORMAT "%5.3" EXTENDED_LIMITS 0.00 255.0 /end CHARACTERISTIC
/begin CHARACTERISTIC Com_stHvbDiscnctReas_583hRcf_C "" VALUE 0x80257ED3 Val_Wu8 7.000 OneToOne 0.00 7.000 FORMAT "%5.3" EXTENDED_LIMITS 0.00 255.0 /end CHARACTERISTIC
/begin CHARACTERISTIC Com_stHvbEVLmp_325hIni_C "" VALUE 0x80257ED4 Val_Wu8 3.000 OneToOne 0.00 3.000 FORMAT "%5.3" EXTENDED_LIMITS 0.00 255.0 /end CHARACTERISTIC
/begin CHARACTERISTIC Com_stHvbEVLmp_325hRcf_C "" VALUE 0x80257ED5 Val_Wu8 3.000 OneToOne 0.00 3.000 FORMAT "%5.3" EXTENDED_LIMITS 0.00 255.0 /end CHARACTERISTIC
/begin CHARACTERISTIC Com_stHvbFltLvl_205hIni_C "" VALUE 0x80257ED6 Val_Wu8 255.0 OneToOne 0.00 255.0 FORMAT "%5.1" /end CHARACTERISTIC
/begin CHARACTERISTIC Com_stHvbFltLvl_205hRcf_C "" VALUE 0x80257ED7 Val_Wu8 255.0 OneToOne 0.00 255.0 FORMAT "%5.1" /end CHARACTERISTIC
/begin CHARACTERISTIC Com_stHvbIntlckRx_325hIni_C "" VALUE 0x80257ED8 Val_Wu8 3.000 OneToOne 0.00 3.000 FORMAT "%5.3" EXTENDED_LIMITS 0.00 255.0 /end CHARACTERISTIC
/begin CHARACTERISTIC Com_stHvbIntlckRx_325hInvld_C "" VALUE 0x80257ED9 Val_Wu8 3.000 OneToOne 0.00 3.000 FORMAT "%5.3" EXTENDED_LIMITS 0.00 255.0 /end CHARACTERISTIC
/begin CHARACTERISTIC Com_stHvbIntlckRx_325hRcf_C "" VALUE 0x80257EDA Val_Wu8 3.000 OneToOne 0.00 3.000 FORMAT "%5.3" EXTENDED_LIMITS 0.00 255.0 /end CHARACTERISTIC
/begin CHARACTERISTIC Com_stHvbIsoFltRx_325hIni_C "" VALUE 0x80257EDB Val_Wu8 7.000 OneToOne 0.00 7.000 FORMAT "%5.3" EXTENDED_LIMITS 0.00 255.0 /end CHARACTERISTIC
/begin CHARACTERISTIC Com_stHvbIsoFltRx_325hInvld_C "" VALUE 0x80257EDC Val_Wu8 7.000 OneToOne 0.00 7.000 FORMAT "%5.3" EXTENDED_LIMITS 0.00 255.0 /end CHARACTERISTIC
/begin CHARACTERISTIC Com_stHvbIsoFltRx_325hRcf_C "" VALUE 0x80257EDD Val_Wu8 7.000 OneToOne 0.00 7.000 FORMAT "%5.3" EXTENDED_LIMITS 0.00 255.0 /end CHARACTERISTIC
/begin CHARACTERISTIC Com_stHvbIsoMeasmtActv_325hIni_C "" VALUE 0x80257EDE Val_Wu8 255.0 OneToOne 0.00 255.0 FORMAT "%5.1" /end CHARACTERISTIC
/begin CHARACTERISTIC Com_stHvbIsoMeasmtActv_325hRcf_C "" VALUE 0x80257EDF Val_Wu8 255.0 OneToOne 0.00 255.0 FORMAT "%5.1" /end CHARACTERISTIC
/begin CHARACTERISTIC Com_stHvbModRx_205hIni_C "" VALUE 0x80257EE0 Val_Wu8 15.00 OneToOne 0.00 15.00 FORMAT "%5.2" EXTENDED_LIMITS 0.00 255.0 /end CHARACTERISTIC
/begin CHARACTERISTIC Com_stHvbModRx_205hRcf_C "" VALUE 0x80257EE1 Val_Wu8 15.00 OneToOne 0.00 15.00 FORMAT "%5.2" EXTENDED_LIMITS 0.00 255.0 /end CHARACTERISTIC
/begin CHARACTERISTIC Com_stHvbMstWrnLmp_325hIni_C "" VALUE 0x80257EE2 Val_Wu8 3.000 OneToOne 0.00 3.000 FORMAT "%5.3" EXTENDED_LIMITS 0.00 255.0 /end CHARACTERISTIC
/begin CHARACTERISTIC Com_stHvbMstWrnLmp_325hRcf_C "" VALUE 0x80257EE3 Val_Wu8 3.000 OneToOne 0.00 3.000 FORMAT "%5.3" EXTENDED_LIMITS 0.00 255.0 /end CHARACTERISTIC
/begin CHARACTERISTIC Com_stHvbNegCntct_205hIni_C "" VALUE 0x80257EE4 Val_Wu8 3.000 OneToOne 0.00 3.000 FORMAT "%5.3" EXTENDED_LIMITS 0.00 255.0 /end CHARACTERISTIC
/begin CHARACTERISTIC Com_stHvbNegCntct_205hRcf_C "" VALUE 0x80257EE5 Val_Wu8 3.000 OneToOne 0.00 3.000 FORMAT "%5.3" EXTENDED_LIMITS 0.00 255.0 /end CHARACTERISTIC
/begin CHARACTERISTIC Com_stHvbPosCntct_205hIni_C "" VALUE 0x80257EE6 Val_Wu8 3.000 OneToOne 0.00 3.000 FORMAT "%5.3" EXTENDED_LIMITS 0.00 255.0 /end CHARACTERISTIC
/begin CHARACTERISTIC Com_stHvbPosCntct_205hRcf_C "" VALUE 0x80257EE7 Val_Wu8 3.000 OneToOne 0.00 3.000 FORMAT "%5.3" EXTENDED_LIMITS 0.00 255.0 /end CHARACTERISTIC
/begin CHARACTERISTIC Com_stHvbPrecCntct_205hIni_C "" VALUE 0x80257EE8 Val_Wu8 1.00000000000 B_TRUE 0.00 1.00000000000 FORMAT "%13.11" /end CHARACTERISTIC
/begin CHARACTERISTIC Com_stHvbPrecCntct_205hRcf_C "" VALUE 0x80257EE9 Val_Wu8 1.00000000000 B_TRUE 0.00 1.00000000000 FORMAT "%13.11" /end CHARACTERISTIC
/begin CHARACTERISTIC Com_stHvbSrvPlgRx_325hIni_C "" VALUE 0x80257EEA Val_Wu8 3.000 OneToOne 0.00 3.000 FORMAT "%5.3" EXTENDED_LIMITS 0.00 255.0 /end CHARACTERISTIC
/begin CHARACTERISTIC Com_stHvbSrvPlgRx_325hInvld_C "" VALUE 0x80257EEB Val_Wu8 3.000 OneToOne 0.00 3.000 FORMAT "%5.3" EXTENDED_LIMITS 0.00 255.0 /end CHARACTERISTIC
/begin CHARACTERISTIC Com_stHvbSrvPlgRx_325hRcf_C "" VALUE 0x80257EEC Val_Wu8 3.000 OneToOne 0.00 3.000 FORMAT "%5.3" EXTENDED_LIMITS 0.00 255.0 /end CHARACTERISTIC
/begin CHARACTERISTIC Com_stHvbSVSLmp_325hIni_C "" VALUE 0x80257EED Val_Wu8 3.000 OneToOne 0.00 3.000 FORMAT "%5.3" EXTENDED_LIMITS 0.00 255.0 /end CHARACTERISTIC
/begin CHARACTERISTIC Com_stHvbSVSLmp_325hRcf_C "" VALUE 0x80257EEE Val_Wu8 3.000 OneToOne 0.00 3.000 FORMAT "%5.3" EXTENDED_LIMITS 0.00 255.0 /end CHARACTERISTIC
/begin CHARACTERISTIC Com_stIBattEBS_592hIni_C "" VALUE 0x80257EEF Val_Wu8 3.000 OneToOne 0.00 3.000 FORMAT "%5.3" EXTENDED_LIMITS 0.00 255.0 /end CHARACTERISTIC
/begin CHARACTERISTIC Com_stIBattEBS_592hInvld_C "" VALUE 0x80257EF0 Val_Wu8 3.000 OneToOne 0.00 3.000 FORMAT "%5.3" EXTENDED_LIMITS 0.00 255.0 /end CHARACTERISTIC
/begin CHARACTERISTIC Com_stIBattEBS_592hRcf_C "" VALUE 0x80257EF1 Val_Wu8 3.000 OneToOne 0.00 3.000 FORMAT "%5.3" EXTENDED_LIMITS 0.00 255.0 /end CHARACTERISTIC
/begin CHARACTERISTIC Com_stIgnkeyPos_442hIni_C "" VALUE 0x80257EF2 Val_Wu8 3.000 OneToOne 0.00 3.000 FORMAT "%5.3" EXTENDED_LIMITS 0.00 255.0 /end CHARACTERISTIC
/begin CHARACTERISTIC Com_stIgnkeyPos_442hRcf_C "" VALUE 0x80257EF3 Val_Wu8 3.000 OneToOne 0.00 3.000 FORMAT "%5.3" EXTENDED_LIMITS 0.00 255.0 /end CHARACTERISTIC
/begin CHARACTERISTIC Com_stIIvtrFltLvl01_237hIni_C "" VALUE 0x80257EF4 Val_Wu8 7.000 OneToOne 0.00 7.000 FORMAT "%5.3" EXTENDED_LIMITS 0.00 255.0 /end CHARACTERISTIC
/begin CHARACTERISTIC Com_stIIvtrFltLvl01_237hInvld_C "" VALUE 0x80257EF5 Val_Wu8 7.000 OneToOne 0.00 7.000 FORMAT "%5.3" EXTENDED_LIMITS 0.00 255.0 /end CHARACTERISTIC
/begin CHARACTERISTIC Com_stIIvtrFltLvl01_237hRcf_C "" VALUE 0x80257EF6 Val_Wu8 7.000 OneToOne 0.00 7.000 FORMAT "%5.3" EXTENDED_LIMITS 0.00 255.0 /end CHARACTERISTIC
/begin CHARACTERISTIC Com_stMainWkuReq_432hIni_C "" VALUE 0x80257EF7 Val_Wu8 3.000 OneToOne 0.00 3.000 FORMAT "%5.3" EXTENDED_LIMITS 0.00 255.0 /end CHARACTERISTIC
/begin CHARACTERISTIC Com_stMainWkuReq_432hInvld_C "" VALUE 0x80257EF8 Val_Wu8 3.000 OneToOne 0.00 3.000 FORMAT "%5.3" EXTENDED_LIMITS 0.00 255.0 /end CHARACTERISTIC
/begin CHARACTERISTIC Com_stMainWkuReq_432hRcf_C "" VALUE 0x80257EF9 Val_Wu8 3.000 OneToOne 0.00 3.000 FORMAT "%5.3" EXTENDED_LIMITS 0.00 255.0 /end CHARACTERISTIC
/begin CHARACTERISTIC Com_stMstWrnLmp_221hIni_C "" VALUE 0x80257EFA Val_Wu8 7.000 OneToOne 0.00 7.000 FORMAT "%5.3" EXTENDED_LIMITS 0.00 255.0 /end CHARACTERISTIC
/begin CHARACTERISTIC Com_stNwCmdLINIni_C "" VALUE 0x80257EFB Val_Wu8 255.000000000 Ext_stNwCmdLIN_VERB 0.00 255.000000000 FORMAT "%13.9" /end CHARACTERISTIC
/begin CHARACTERISTIC Com_stNwCmdLINInvld_C "" VALUE 0x80257EFC Val_Wu8 255.0 OneToOne 0.00 255.0 FORMAT "%5.1" /end CHARACTERISTIC
/begin CHARACTERISTIC Com_stOffsEm01_497hIni_C "" VALUE 0x80257EFD Val_Wu8 1.00000000000 B_TRUE 0.00 1.00000000000 FORMAT "%13.11" /end CHARACTERISTIC
/begin CHARACTERISTIC Com_stOffsEm01_497hRcf_C "" VALUE 0x80257EFE Val_Wu8 1.00000000000 B_TRUE 0.00 1.00000000000 FORMAT "%13.11" /end CHARACTERISTIC
/begin CHARACTERISTIC Com_stPrkBrkRx_412hIni_C "" VALUE 0x80257EFF Val_Wu8 3.000 OneToOne 0.00 3.000 FORMAT "%5.3" EXTENDED_LIMITS 0.00 255.0 /end CHARACTERISTIC
/begin CHARACTERISTIC Com_stPrkBrkRx_412hRcf_C "" VALUE 0x80257F00 Val_Wu8 3.000 OneToOne 0.00 3.000 FORMAT "%5.3" EXTENDED_LIMITS 0.00 255.0 /end CHARACTERISTIC
/begin CHARACTERISTIC Com_stPwrLimnLmp_221hIni_C "" VALUE 0x80257F01 Val_Wu8 7.000 OneToOne 0.00 7.000 FORMAT "%5.3" EXTENDED_LIMITS 0.00 255.0 /end CHARACTERISTIC
/begin CHARACTERISTIC Com_stPwrLimnLmp_221hInvld_C "" VALUE 0x80257F02 Val_Wu8 7.000 OneToOne 0.00 7.000 FORMAT "%5.3" EXTENDED_LIMITS 0.00 255.0 /end CHARACTERISTIC
/begin CHARACTERISTIC Com_stReFogReq_26hIni_C "" VALUE 0x80257F03 Val_Wu8 255.0 q1 0.00 255.0 FORMAT "%5.1" /end CHARACTERISTIC
/begin CHARACTERISTIC Com_stReFogReq_26hInvld_C "" VALUE 0x80257F04 Val_Wu8 3.000 OneToOne 0.00 3.000 FORMAT "%5.3" EXTENDED_LIMITS 0.00 255.0 /end CHARACTERISTIC
/begin CHARACTERISTIC Com_stReFogReq_26hRcf_C "" VALUE 0x80257F05 Val_Wu8 255.0 q1 0.00 255.0 FORMAT "%5.1" /end CHARACTERISTIC
/begin CHARACTERISTIC Com_stReFogReq_CAN_231hIni_C "" VALUE 0x80257F06 Val_Wu8 3.000 OneToOne 0.00 3.000 FORMAT "%5.3" EXTENDED_LIMITS 0.00 255.0 /end CHARACTERISTIC
/begin CHARACTERISTIC Com_stSocRx_4F2hIni_C "" VALUE 0x80257F07 Val_Wu8 3.000 OneToOne 0.00 3.000 FORMAT "%5.3" EXTENDED_LIMITS 0.00 255.0 /end CHARACTERISTIC
/begin CHARACTERISTIC Com_stSocRx_4F2hInvld_C "" VALUE 0x80257F08 Val_Wu8 3.000 OneToOne 0.00 3.000 FORMAT "%5.3" EXTENDED_LIMITS 0.00 255.0 /end CHARACTERISTIC
/begin CHARACTERISTIC Com_stSocRx_4F2hRcf_C "" VALUE 0x80257F09 Val_Wu8 3.000 OneToOne 0.00 3.000 FORMAT "%5.3" EXTENDED_LIMITS 0.00 255.0 /end CHARACTERISTIC
/begin CHARACTERISTIC Com_stSrvLmp_221hIni_C "" VALUE 0x80257F0A Val_Wu8 3.000 OneToOne 0.00 3.000 FORMAT "%5.3" EXTENDED_LIMITS 0.00 255.0 /end CHARACTERISTIC
/begin CHARACTERISTIC Com_stSrvLmp_221hInvld_C "" VALUE 0x80257F0B Val_Wu8 3.000 OneToOne 0.00 3.000 FORMAT "%5.3" EXTENDED_LIMITS 0.00 255.0 /end CHARACTERISTIC
/begin CHARACTERISTIC Com_stT50_432hIni_C "" VALUE 0x80257F0C Val_Wu8 3.000 OneToOne 0.00 3.000 FORMAT "%5.3" EXTENDED_LIMITS 0.00 255.0 /end CHARACTERISTIC
/begin CHARACTERISTIC Com_stT50_432hRcf_C "" VALUE 0x80257F0D Val_Wu8 3.000 OneToOne 0.00 3.000 FORMAT "%5.3" EXTENDED_LIMITS 0.00 255.0 /end CHARACTERISTIC
/begin CHARACTERISTIC Com_stT_4F2hIni_C "" VALUE 0x80257F0E Val_Wu8 255.0 OneToOne 0.00 255.0 FORMAT "%5.1" /end CHARACTERISTIC
/begin CHARACTERISTIC Com_stT_4F2hInvld_C "" VALUE 0x80257F0F Val_Wu8 3.000 OneToOne 0.00 3.000 FORMAT "%5.3" EXTENDED_LIMITS 0.00 255.0 /end CHARACTERISTIC
/begin CHARACTERISTIC Com_stT_4F2hRcf_C "" VALUE 0x80257F10 Val_Wu8 255.0 OneToOne 0.00 255.0 FORMAT "%5.1" /end CHARACTERISTIC
/begin CHARACTERISTIC Com_stVehCoorn_201hIni_C "" VALUE 0x80257F11 Val_Wu8 3.000 OneToOne 0.00 3.000 FORMAT "%5.3" EXTENDED_LIMITS 0.00 255.0 /end CHARACTERISTIC
/begin CHARACTERISTIC Com_tDcdcAct_473hIni_C "" VALUE 0x80257F12 Val_Ws16 65535.00 RBPtCel_t_1p0_om40_1 -32808.00 32727.00 FORMAT "%8.2" /end CHARACTERISTIC
/begin CHARACTERISTIC Com_tDcdcAct_473hInvld_C "" VALUE 0x80257F14 Val_Wu8 255.0 OneToOne 0.00 255.0 FORMAT "%5.1" /end CHARACTERISTIC
/begin CHARACTERISTIC Com_tDcdcAct_473hRcf_C "" VALUE 0x80257F16 Val_Ws16 65535.00 RBPtCel_t_1p0_om40_1 -32808.00 32727.00 FORMAT "%8.2" /end CHARACTERISTIC
/begin CHARACTERISTIC Com_tDcdcInltCoolt_473hIni_C "" VALUE 0x80257F18 Val_Ws16 190.0000 q0p5_DegCgrd -40.0000 150.0000 FORMAT "%8.4" EXTENDED_LIMITS -16384.00 16383.50 /end CHARACTERISTIC
/begin CHARACTERISTIC Com_tDcdcInltCoolt_473hInvld_C "" VALUE 0x80257F1A Val_Wu8 255.0 OneToOne 0.00 255.0 FORMAT "%5.1" /end CHARACTERISTIC
/begin CHARACTERISTIC Com_tDcdcInltCoolt_473hRcf_C "" VALUE 0x80257F1C Val_Ws16 190.0000 q0p5_DegCgrd -40.0000 150.0000 FORMAT "%8.4" EXTENDED_LIMITS -16384.00 16383.50 /end CHARACTERISTIC
/begin CHARACTERISTIC Com_tElCmprActl_47BhIni_C "" VALUE 0x80257F1E Val_Ws16 180.0000 Temp_Cels_c126 -40.0000 140.0000 FORMAT "%8.4" EXTENDED_LIMITS -32768.00 32767.00 /end CHARACTERISTIC
/begin CHARACTERISTIC Com_tElCmprActl_47BhInvld_C "" VALUE 0x80257F20 Val_Wu8 255.0 OneToOne 0.00 255.0 FORMAT "%5.1" /end CHARACTERISTIC
/begin CHARACTERISTIC Com_tElCmprActl_47BhRcf_C "" VALUE 0x80257F22 Val_Ws16 180.0000 Temp_Cels_c126 -40.0000 140.0000 FORMAT "%8.4" EXTENDED_LIMITS -32768.00 32767.00 /end CHARACTERISTIC
/begin CHARACTERISTIC Com_tEnvT_5B2hIni_C "" VALUE 0x80257F24 Val_Ws16 6553.500 Temp_Cels -3549.940 3003.560 FORMAT "%8.3" /end CHARACTERISTIC
/begin CHARACTERISTIC Com_tEnvT_5B2hInvld_C "" VALUE 0x80257F26 Val_Wu8 255.0 OneToOne 0.00 255.0 FORMAT "%5.1" /end CHARACTERISTIC
/begin CHARACTERISTIC Com_tEnvT_5B2hRcf_C "" VALUE 0x80257F28 Val_Ws16 6553.500 Temp_Cels -3549.940 3003.560 FORMAT "%8.3" /end CHARACTERISTIC
/begin CHARACTERISTIC Com_tEvapT_26hIni_C "" VALUE 0x80257F2A Val_Ws16 3276.700 Temp_Cels -273.140 3003.560 FORMAT "%8.3" EXTENDED_LIMITS -3549.940 3003.560 /end CHARACTERISTIC
/begin CHARACTERISTIC Com_tEvapT_26hInvld_C "" VALUE 0x80257F2C Val_Wu8 255.0 OneToOne 0.00 255.0 FORMAT "%5.1" /end CHARACTERISTIC
/begin CHARACTERISTIC Com_tEvapT_26hRcf_C "" VALUE 0x80257F2E Val_Ws16 3276.700 Temp_Cels -273.140 3003.560 FORMAT "%8.3" EXTENDED_LIMITS -3549.940 3003.560 /end CHARACTERISTIC
/begin CHARACTERISTIC Com_tHvbAct_535hIni_C "" VALUE 0x80257F30 Val_Ws16 6553.500 Temp_Cels -3549.940 3003.560 FORMAT "%8.3" /end CHARACTERISTIC
/begin CHARACTERISTIC Com_tHvbAct_535hInvld_C "" VALUE 0x80257F32 Val_Wu8 255.0 OneToOne 0.00 255.0 FORMAT "%5.1" /end CHARACTERISTIC
/begin CHARACTERISTIC Com_tHvbAct_535hRcf_C "" VALUE 0x80257F34 Val_Ws16 6553.500 Temp_Cels -3549.940 3003.560 FORMAT "%8.3" /end CHARACTERISTIC
/begin CHARACTERISTIC Com_tHvbMax_325hIni_C "" VALUE 0x80257F36 Val_Ws16 6553.500 Temp_Cels -3549.940 3003.560 FORMAT "%8.3" /end CHARACTERISTIC
/begin CHARACTERISTIC Com_tHvbMax_325hInvld_C "" VALUE 0x80257F38 Val_Wu16 511.0000 OneToOne 0.00 511.0000 FORMAT "%8.4" EXTENDED_LIMITS 0.00 65535.00 /end CHARACTERISTIC
/begin CHARACTERISTIC Com_tHvbMax_325hRcf_C "" VALUE 0x80257F3A Val_Ws16 6553.500 Temp_Cels -3549.940 3003.560 FORMAT "%8.3" /end CHARACTERISTIC
/begin CHARACTERISTIC Com_tiCurVehTmr_552hIni_C "" VALUE 0x80257F3C Val_Wu32 429496729.300 Time_sec_1 0.00 429496729.300 FORMAT "%13.3" EXTENDED_LIMITS 0.00 429496729.500 /end CHARACTERISTIC
/begin CHARACTERISTIC Com_tiCurVehTmr_552hInvld_C "" VALUE 0x80257F40 Val_Wu32 4294967295.00 OneToOne 0.00 4294967295.00 FORMAT "%13.2" /end CHARACTERISTIC
/begin CHARACTERISTIC Com_tiCurVehTmr_552hRcf_C "" VALUE 0x80257F44 Val_Wu32 429496729.300 Time_sec_1 0.00 429496729.300 FORMAT "%13.3" EXTENDED_LIMITS 0.00 429496729.500 /end CHARACTERISTIC
/begin CHARACTERISTIC Com_tiHvbChrgnHalfRx_595hIni_C "" VALUE 0x80257F48 Val_Wu16 65535.00 RBPtCel_ti_1p0_4 0.00 65535.00 FORMAT "%8.2" /end CHARACTERISTIC
/begin CHARACTERISTIC Com_tiHvbChrgnHalfRx_595hInvld_C "" VALUE 0x80257F4A Val_Wu16 2047.000 OneToOne 0.00 2047.000 FORMAT "%8.3" EXTENDED_LIMITS 0.00 65535.00 /end CHARACTERISTIC
/begin CHARACTERISTIC Com_tiHvbChrgnHalfRx_595hRcf_C "" VALUE 0x80257F4C Val_Wu16 65535.00 RBPtCel_ti_1p0_4 0.00 65535.00 FORMAT "%8.2" /end CHARACTERISTIC
/begin CHARACTERISTIC Com_tLvBatt_592hIni_C "" VALUE 0x80257F4E Val_Ws16 65535.00 RBPtCel_t_1p0om40_1 -32808.00 32727.00 FORMAT "%8.2" /end CHARACTERISTIC
/begin CHARACTERISTIC Com_tLvBatt_592hInvld_C "" VALUE 0x80257F50 Val_Wu8 255.0 OneToOne 0.00 255.0 FORMAT "%5.1" /end CHARACTERISTIC
/begin CHARACTERISTIC Com_tLvBatt_592hRcf_C "" VALUE 0x80257F52 Val_Ws16 65535.00 RBPtCel_t_1p0om40_1 -32808.00 32727.00 FORMAT "%8.2" /end CHARACTERISTIC
/begin CHARACTERISTIC Com_TogLedDrv_219hIni_C "" VALUE 0x80257F54 Val_Wu8 7.000 OneToOne 0.00 7.000 FORMAT "%5.3" EXTENDED_LIMITS 0.00 255.0 /end CHARACTERISTIC
/begin CHARACTERISTIC Com_TogLedMod_219hIni_C "" VALUE 0x80257F55 Val_Wu8 7.000 OneToOne 0.00 7.000 FORMAT "%5.3" EXTENDED_LIMITS 0.00 255.0 /end CHARACTERISTIC
/begin CHARACTERISTIC Com_TogLedNeut_219hIni_C "" VALUE 0x80257F56 Val_Wu8 7.000 OneToOne 0.00 7.000 FORMAT "%5.3" EXTENDED_LIMITS 0.00 255.0 /end CHARACTERISTIC
/begin CHARACTERISTIC Com_TogLedRvs_219hIni_C "" VALUE 0x80257F57 Val_Wu8 7.000 OneToOne 0.00 7.000 FORMAT "%5.3" EXTENDED_LIMITS 0.00 255.0 /end CHARACTERISTIC
/begin CHARACTERISTIC Com_tqMotLimMax_208hIni_C "" VALUE 0x80257F58 Val_Wu8 255.0 OneToOne 0.00 255.0 FORMAT "%5.1" /end CHARACTERISTIC
/begin CHARACTERISTIC Com_tqMotLimMax_208hInvld_C "" VALUE 0x80257F59 Val_Wu8 255.0 OneToOne 0.00 255.0 FORMAT "%5.1" /end CHARACTERISTIC
/begin CHARACTERISTIC Com_uBattEBSRx_592hIni_C "" VALUE 0x80257F5A Val_Wu16 13.00000 q0p01_o5_V 5.00000 18.00000 FORMAT "%8.5" EXTENDED_LIMITS 5.000000 660.3500 /end CHARACTERISTIC
/begin CHARACTERISTIC Com_uBattEBSRx_592hInvld_C "" VALUE 0x80257F5C Val_Wu16 16383.00 OneToOne 0.00 16383.00 FORMAT "%8.2" EXTENDED_LIMITS 0.00 65535.00 /end CHARACTERISTIC
/begin CHARACTERISTIC Com_uBattEBSRx_592hRcf_C "" VALUE 0x80257F5E Val_Wu16 13.00000 q0p01_o5_V 5.00000 18.00000 FORMAT "%8.5" EXTENDED_LIMITS 5.000000 660.3500 /end CHARACTERISTIC
/begin CHARACTERISTIC Com_uDcdcHvAct_283hIni_C "" VALUE 0x80257F60 Val_Wu16 3276.700 RBPtCel_u_0p1_1 0.00 3276.700 FORMAT "%8.3" EXTENDED_LIMITS 0.00 6553.500 /end CHARACTERISTIC
/begin CHARACTERISTIC Com_uDcdcHvAct_283hInvld_C "" VALUE 0x80257F62 Val_Wu16 1023.000 OneToOne 0.00 1023.000 FORMAT "%8.3" EXTENDED_LIMITS 0.00 65535.00 /end CHARACTERISTIC
/begin CHARACTERISTIC Com_uDcdcHvAct_283hRcf_C "" VALUE 0x80257F64 Val_Wu16 3276.700 RBPtCel_u_0p1_1 0.00 3276.700 FORMAT "%8.3" EXTENDED_LIMITS 0.00 6553.500 /end CHARACTERISTIC
/begin CHARACTERISTIC Com_uDcdcLvAct_283hIni_C "" VALUE 0x80257F66 Val_Wu16 3276.700 RBPtCel_u_0p1_1 0.00 3276.700 FORMAT "%8.3" EXTENDED_LIMITS 0.00 6553.500 /end CHARACTERISTIC
/begin CHARACTERISTIC Com_uDcdcLvAct_283hInvld_C "" VALUE 0x80257F68 Val_Wu16 4095.000 OneToOne 0.00 4095.000 FORMAT "%8.3" EXTENDED_LIMITS 0.00 65535.00 /end CHARACTERISTIC
/begin CHARACTERISTIC Com_uDcdcLvAct_283hRcf_C "" VALUE 0x80257F6A Val_Wu16 3276.700 RBPtCel_u_0p1_1 0.00 3276.700 FORMAT "%8.3" EXTENDED_LIMITS 0.00 6553.500 /end CHARACTERISTIC
/begin CHARACTERISTIC Com_uElCmprHvAct_47BhIni_C "" VALUE 0x80257F6C Val_Ws16 65535.00 q1_V -32768.00 32767.00 FORMAT "%8.2" /end CHARACTERISTIC
/begin CHARACTERISTIC Com_uElCmprHvAct_47BhInvld_C "" VALUE 0x80257F6E Val_Wu16 1023.000 OneToOne 0.00 1023.000 FORMAT "%8.3" EXTENDED_LIMITS 0.00 65535.00 /end CHARACTERISTIC
/begin CHARACTERISTIC Com_uElCmprHvAct_47BhRcf_C "" VALUE 0x80257F70 Val_Ws16 65535.00 q1_V -32768.00 32767.00 FORMAT "%8.2" /end CHARACTERISTIC
/begin CHARACTERISTIC Com_uHvbActTx_5C3hIni_C "" VALUE 0x80257F72 Val_Wu16 2047.000 OneToOne 0.00 2047.000 FORMAT "%8.3" EXTENDED_LIMITS 0.00 65535.00 /end CHARACTERISTIC
/begin CHARACTERISTIC Com_uHvbActTx_5C3hInvld_C "" VALUE 0x80257F74 Val_Wu16 2047.000 OneToOne 0.00 2047.000 FORMAT "%8.3" EXTENDED_LIMITS 0.00 65535.00 /end CHARACTERISTIC
/begin CHARACTERISTIC Com_uHvbAct_205hIni_C "" VALUE 0x80257F76 Val_Ws16 2047.969 Volt_V_q0p03125_COMPU -1024.000 1023.969 FORMAT "%8.3" /end CHARACTERISTIC
/begin CHARACTERISTIC Com_uHvbAct_205hInvld_C "" VALUE 0x80257F78 Val_Wu16 8191.000 OneToOne 0.00 8191.000 FORMAT "%8.3" EXTENDED_LIMITS 0.00 65535.00 /end CHARACTERISTIC
/begin CHARACTERISTIC Com_uHvbAct_205hRcf_C "" VALUE 0x80257F7A Val_Ws16 2047.969 Volt_V_q0p03125_COMPU -1024.000 1023.969 FORMAT "%8.3" /end CHARACTERISTIC
/begin CHARACTERISTIC Com_uHvbDcBus_335hIni_C "" VALUE 0x80257F7C Val_Ws16 500.0000 Volt_V_q0p03125_COMPU 0.00 500.0000 FORMAT "%8.4" EXTENDED_LIMITS -1024.000 1023.969 /end CHARACTERISTIC
/begin CHARACTERISTIC Com_uHvbDcBus_335hInvld_C "" VALUE 0x80257F7E Val_Wu16 8191.000 OneToOne 0.00 8191.000 FORMAT "%8.3" EXTENDED_LIMITS 0.00 65535.00 /end CHARACTERISTIC
/begin CHARACTERISTIC Com_uHvbDcBus_335hRcf_C "" VALUE 0x80257F80 Val_Ws16 500.0000 Volt_V_q0p03125_COMPU 0.00 500.0000 FORMAT "%8.4" EXTENDED_LIMITS -1024.000 1023.969 /end CHARACTERISTIC
/begin CHARACTERISTIC Com_uHvbLimHi_335hIni_C "" VALUE 0x80257F82 Val_Ws16 2047.969 Volt_V_q0p03125_COMPU -1024.000 1023.969 FORMAT "%8.3" /end CHARACTERISTIC
/begin CHARACTERISTIC Com_uHvbLimHi_335hInvld_C "" VALUE 0x80257F84 Val_Wu16 8191.000 OneToOne 0.00 8191.000 FORMAT "%8.3" EXTENDED_LIMITS 0.00 65535.00 /end CHARACTERISTIC
/begin CHARACTERISTIC Com_uHvbLimHi_335hRcf_C "" VALUE 0x80257F86 Val_Ws16 2047.969 Volt_V_q0p03125_COMPU -1024.000 1023.969 FORMAT "%8.3" /end CHARACTERISTIC
/begin CHARACTERISTIC Com_uHvbMaxCell_435hIni_C "" VALUE 0x80257F88 Val_Wu16 15.00000 q1Em3_V 0.00 15.00000 FORMAT "%8.5" EXTENDED_LIMITS 0.00 65.53500 /end CHARACTERISTIC
/begin CHARACTERISTIC Com_uHvbMaxCell_435hInvld_C "" VALUE 0x80257F8A Val_Wu16 16383.00 OneToOne 0.00 16383.00 FORMAT "%8.2" EXTENDED_LIMITS 0.00 65535.00 /end CHARACTERISTIC
/begin CHARACTERISTIC Com_uHvbMaxCell_435hRcf_C "" VALUE 0x80257F8C Val_Wu16 15.00000 q1Em3_V 0.00 15.00000 FORMAT "%8.5" EXTENDED_LIMITS 0.00 65.53500 /end CHARACTERISTIC
/begin CHARACTERISTIC Com_uHvbMinCell_435hIni_C "" VALUE 0x80257F8E Val_Wu16 15.00000 q1Em3_V 0.00 15.00000 FORMAT "%8.5" EXTENDED_LIMITS 0.00 65.53500 /end CHARACTERISTIC
/begin CHARACTERISTIC Com_uHvbMinCell_435hInvld_C "" VALUE 0x80257F90 Val_Wu16 16383.00 OneToOne 0.00 16383.00 FORMAT "%8.2" EXTENDED_LIMITS 0.00 65535.00 /end CHARACTERISTIC
/begin CHARACTERISTIC Com_uHvbMinCell_435hRcf_C "" VALUE 0x80257F92 Val_Wu16 15.00000 q1Em3_V 0.00 15.00000 FORMAT "%8.5" EXTENDED_LIMITS 0.00 65.53500 /end CHARACTERISTIC
/begin CHARACTERISTIC Com_uHvbNomChrgn_455hIni_C "" VALUE 0x80257F94 Val_Ws16 2047.969 Volt_V_q0p03125_COMPU -1024.000 1023.969 FORMAT "%8.3" /end CHARACTERISTIC
/begin CHARACTERISTIC Com_uHvbNomChrgn_455hInvld_C "" VALUE 0x80257F96 Val_Wu16 8191.000 OneToOne 0.00 8191.000 FORMAT "%8.3" EXTENDED_LIMITS 0.00 65535.00 /end CHARACTERISTIC
/begin CHARACTERISTIC Com_uHvbNomChrgn_455hRcf_C "" VALUE 0x80257F98 Val_Ws16 2047.969 Volt_V_q0p03125_COMPU -1024.000 1023.969 FORMAT "%8.3" /end CHARACTERISTIC
/begin CHARACTERISTIC Com_valEepOffsEM01_491hIni_C "" VALUE 0x80257F9A Val_Wu16 65535.00 OneToOne 0.00 65535.00 FORMAT "%8.2" /end CHARACTERISTIC
/begin CHARACTERISTIC Com_valOffsEm01_497hIni_C "" VALUE 0x80257F9C Val_Wu16 65535.00 OneToOne 0.00 65535.00 FORMAT "%8.2" /end CHARACTERISTIC
/begin CHARACTERISTIC Com_valOffsEm01_497hRcf_C "" VALUE 0x80257F9E Val_Wu16 65535.00 OneToOne 0.00 65535.00 FORMAT "%8.2" /end CHARACTERISTIC
/begin CHARACTERISTIC Com_VCU_0x50F_Tx_EIMode_C "" VALUE 0x802500BA RB_Val_Wboolean 1.00000000000 B_TRUE 0.00 1.00000000000 FORMAT "%13.11" /end CHARACTERISTIC
/begin CHARACTERISTIC Com_VCU_211h_Tx_EIMode_C "" VALUE 0x802500BB RB_Val_Wboolean 1.00000000000 B_TRUE 0.00 1.00000000000 FORMAT "%13.11" /end CHARACTERISTIC
/begin CHARACTERISTIC Com_VCU_221h_Tx_EIMode_C "" VALUE 0x802500BC RB_Val_Wboolean 1.00000000000 B_TRUE 0.00 1.00000000000 FORMAT "%13.11" /end CHARACTERISTIC
/begin CHARACTERISTIC Com_VCU_241h_Tx_EIMode_C "" VALUE 0x802500BD RB_Val_Wboolean 1.00000000000 B_TRUE 0.00 1.00000000000 FORMAT "%13.11" /end CHARACTERISTIC
/begin CHARACTERISTIC Com_VCU_25h_Tx_EIMode_C "" VALUE 0x802500BE RB_Val_Wboolean 1.00000000000 B_TRUE 0.00 1.00000000000 FORMAT "%13.11" /end CHARACTERISTIC
/begin CHARACTERISTIC Com_VCU_262_Tx_EIMode_C "" VALUE 0x802500BF RB_Val_Wboolean 1.00000000000 B_TRUE 0.00 1.00000000000 FORMAT "%13.11" /end CHARACTERISTIC
/begin CHARACTERISTIC Com_VCU_281h_Tx_EIMode_C "" VALUE 0x802500C0 RB_Val_Wboolean 1.00000000000 B_TRUE 0.00 1.00000000000 FORMAT "%13.11" /end CHARACTERISTIC
/begin CHARACTERISTIC Com_VCU_321h_Tx_EIMode_C "" VALUE 0x802500C1 RB_Val_Wboolean 1.00000000000 B_TRUE 0.00 1.00000000000 FORMAT "%13.11" /end CHARACTERISTIC
/begin CHARACTERISTIC Com_VCU_331h_Tx_EIMode_C "" VALUE 0x802500C2 RB_Val_Wboolean 1.00000000000 B_TRUE 0.00 1.00000000000 FORMAT "%13.11" /end CHARACTERISTIC
/begin CHARACTERISTIC Com_VCU_421h_Tx_EIMode_C "" VALUE 0x802500C3 RB_Val_Wboolean 1.00000000000 B_TRUE 0.00 1.00000000000 FORMAT "%13.11" /end CHARACTERISTIC
/begin CHARACTERISTIC Com_VCU_481h_Tx_EIMode_C "" VALUE 0x802500C4 RB_Val_Wboolean 1.00000000000 B_TRUE 0.00 1.00000000000 FORMAT "%13.11" /end CHARACTERISTIC
/begin CHARACTERISTIC Com_VCU_4A2_Tx_EIMode_C "" VALUE 0x802500C5 RB_Val_Wboolean 1.00000000000 B_TRUE 0.00 1.00000000000 FORMAT "%13.11" /end CHARACTERISTIC
/begin CHARACTERISTIC Com_VCU_501h_Tx_EIMode_C "" VALUE 0x802500C6 RB_Val_Wboolean 1.00000000000 B_TRUE 0.00 1.00000000000 FORMAT "%13.11" /end CHARACTERISTIC
/begin CHARACTERISTIC Com_VCU_5A2_Tx_EIMode_C "" VALUE 0x802500C7 RB_Val_Wboolean 1.00000000000 B_TRUE 0.00 1.00000000000 FORMAT "%13.11" /end CHARACTERISTIC
/begin CHARACTERISTIC Com_VCU_5D1h_Tx_EIMode_C "" VALUE 0x802500C8 RB_Val_Wboolean 1.00000000000 B_TRUE 0.00 1.00000000000 FORMAT "%13.11" /end CHARACTERISTIC
/begin CHARACTERISTIC Com_VCU_5F1h_Tx_EIMode_C "" VALUE 0x802500C9 RB_Val_Wboolean 1.00000000000 B_TRUE 0.00 1.00000000000 FORMAT "%13.11" /end CHARACTERISTIC
/begin CHARACTERISTIC Com_VCU_CTRL_INPUT_201h_Tx_EIMode_C "" VALUE 0x802500CA RB_Val_Wboolean 1.00000000000 B_TRUE 0.00 1.00000000000 FORMAT "%13.11" /end CHARACTERISTIC
/begin CHARACTERISTIC Com_VCU_eCOMP_CONTROL_341_Tx_EIMode_C "" VALUE 0x802500CB RB_Val_Wboolean 1.00000000000 B_TRUE 0.00 1.00000000000 FORMAT "%13.11" /end CHARACTERISTIC
/begin CHARACTERISTIC Com_VCU_HVAC_231h_Tx_EIMode_C "" VALUE 0x802500CC RB_Val_Wboolean 1.00000000000 B_TRUE 0.00 1.00000000000 FORMAT "%13.11" /end CHARACTERISTIC
/begin CHARACTERISTIC Com_VCU_INV_491h_Tx_EIMode_C "" VALUE 0x802500CD RB_Val_Wboolean 1.00000000000 B_TRUE 0.00 1.00000000000 FORMAT "%13.11" /end CHARACTERISTIC
/begin CHARACTERISTIC Com_VCU_VERS_111h_Tx_EIMode_C "" VALUE 0x802500CE RB_Val_Wboolean 1.00000000000 B_TRUE 0.00 1.00000000000 FORMAT "%13.11" /end CHARACTERISTIC
/begin CHARACTERISTIC Com_vVeh_38DhIni_C "" VALUE 0x80257FA0 Val_Ws16 655.3500 Vel -327.6800 327.6700 FORMAT "%8.4" /end CHARACTERISTIC
/begin CHARACTERISTIC Com_vVeh_38DhInvld_C "" VALUE 0x80257FA2 Val_Wu16 65535.00 OneToOne 0.00 65535.00 FORMAT "%8.2" /end CHARACTERISTIC
/begin CHARACTERISTIC Com_vVeh_38DhRcf_C "" VALUE 0x80257FA4 Val_Ws16 655.3500 Vel -327.6800 327.6700 FORMAT "%8.4" /end CHARACTERISTIC
/begin CHARACTERISTIC CoPtFH_stPwt_262hIni_C "" VALUE 0x80257FA6 Val_Wu8 15.00 OneToOne 0.00 15.00 FORMAT "%5.2" EXTENDED_LIMITS 0.00 255.0 /end CHARACTERISTIC
/begin CHARACTERISTIC DcChrgnRly_ctMaxOperCyc_454hIni_C "" VALUE 0x80257FA8 Val_Wu16 1023.000 OneToOne 0.00 1023.000 FORMAT "%8.3" EXTENDED_LIMITS 0.00 65535.00 /end CHARACTERISTIC
/begin CHARACTERISTIC DcChrgnRly_ctMaxOperCyc_454hInvld_C "" VALUE 0x80257FAA Val_Wu16 1023.000 OneToOne 0.00 1023.000 FORMAT "%8.3" EXTENDED_LIMITS 0.00 65535.00 /end CHARACTERISTIC
/begin CHARACTERISTIC Dcdc_flgDesLvGridULim_421hIni_C "" VALUE 0x80257FAC Val_Wu8 1.000 OneToOne 0.00 1.000 FORMAT "%5.3" EXTENDED_LIMITS 0.00 255.0 /end CHARACTERISTIC
/begin CHARACTERISTIC Dcdc_iLimLvGrid_281hIni_C "" VALUE 0x80257FAD Val_Wu8 255.0 OneToOne 0.00 255.0 FORMAT "%5.1" /end CHARACTERISTIC
/begin CHARACTERISTIC Dcdc_iLimLvGrid_281hInvld_C "" VALUE 0x80257FAE Val_Wu8 255.0 OneToOne 0.00 255.0 FORMAT "%5.1" /end CHARACTERISTIC
/begin CHARACTERISTIC Dcdc_stDesDcdc_281hIni_C "" VALUE 0x80257FAF Val_Wu8 3.000 OneToOne 0.00 3.000 FORMAT "%5.3" EXTENDED_LIMITS 0.00 255.0 /end CHARACTERISTIC
/begin CHARACTERISTIC Dcdc_uDesLvGrid_321hIni_C "" VALUE 0x80257FB0 Val_Wu16 2047.000 OneToOne 0.00 2047.000 FORMAT "%8.3" EXTENDED_LIMITS 0.00 65535.00 /end CHARACTERISTIC
/begin CHARACTERISTIC Dcdc_uDesLvGrid_321hInvld_C "" VALUE 0x80257FB2 Val_Wu16 2047.000 OneToOne 0.00 2047.000 FORMAT "%8.3" EXTENDED_LIMITS 0.00 65535.00 /end CHARACTERISTIC
/begin CHARACTERISTIC DDRC_DurDeb.Com_numCom082hTooShortDebOk_C "" VALUE 0x80240DB4 Val_Wu16 65535.00 OneToOne 0.00 65535.00 FORMAT "%8.2" /end CHARACTERISTIC
/begin CHARACTERISTIC DDRC_DurDeb.Com_numCom082hTooShortDebDef_C "" VALUE 0x80240DB6 Val_Wu16 65535.00 OneToOne 0.00 65535.00 FORMAT "%8.2" /end CHARACTERISTIC
/begin CHARACTERISTIC DDRC_DurDeb.Com_numCom092hTooShortDebOk_C "" VALUE 0x80240DB8 Val_Wu16 65535.00 OneToOne 0.00 65535.00 FORMAT "%8.2" /end CHARACTERISTIC
/begin CHARACTERISTIC DDRC_DurDeb.Com_numCom092hTooShortDebDef_C "" VALUE 0x80240DBA Val_Wu16 65535.00 OneToOne 0.00 65535.00 FORMAT "%8.2" /end CHARACTERISTIC
/begin CHARACTERISTIC DDRC_DurDeb.Com_numCom205hAbsentDebOk_C "" VALUE 0x80240DBC Val_Wu16 65535.00 OneToOne 0.00 65535.00 FORMAT "%8.2" /end CHARACTERISTIC
/begin CHARACTERISTIC DDRC_DurDeb.Com_numCom205hAbsentDebDef_C "" VALUE 0x80240DBE Val_Wu16 65535.00 OneToOne 0.00 65535.00 FORMAT "%8.2" /end CHARACTERISTIC
/begin CHARACTERISTIC DDRC_DurDeb.Com_numCom205hChecksumDebOk_C "" VALUE 0x80240DC0 Val_Wu16 65535.00 OneToOne 0.00 65535.00 FORMAT "%8.2" /end CHARACTERISTIC
/begin CHARACTERISTIC DDRC_DurDeb.Com_numCom205hChecksumDebDef_C "" VALUE 0x80240DC2 Val_Wu16 65535.00 OneToOne 0.00 65535.00 FORMAT "%8.2" /end CHARACTERISTIC
/begin CHARACTERISTIC DDRC_DurDeb.Com_numCom205hCounterDebOk_C "" VALUE 0x80240DC4 Val_Wu16 65535.00 OneToOne 0.00 65535.00 FORMAT "%8.2" /end CHARACTERISTIC
/begin CHARACTERISTIC DDRC_DurDeb.Com_numCom205hCounterDebDef_C "" VALUE 0x80240DC6 Val_Wu16 65535.00 OneToOne 0.00 65535.00 FORMAT "%8.2" /end CHARACTERISTIC
/begin CHARACTERISTIC DDRC_DurDeb.Com_numCom205hTooShortDebOk_C "" VALUE 0x80240DC8 Val_Wu16 65535.00 OneToOne 0.00 65535.00 FORMAT "%8.2" /end CHARACTERISTIC
/begin CHARACTERISTIC DDRC_DurDeb.Com_numCom205hTooShortDebDef_C "" VALUE 0x80240DCA Val_Wu16 65535.00 OneToOne 0.00 65535.00 FORMAT "%8.2" /end CHARACTERISTIC
/begin CHARACTERISTIC DDRC_DurDeb.Com_numCom217hAbsentDebOk_C "" VALUE 0x80240DCC Val_Wu16 65535.00 OneToOne 0.00 65535.00 FORMAT "%8.2" /end CHARACTERISTIC
/begin CHARACTERISTIC DDRC_DurDeb.Com_numCom217hAbsentDebDef_C "" VALUE 0x80240DCE Val_Wu16 65535.00 OneToOne 0.00 65535.00 FORMAT "%8.2" /end CHARACTERISTIC
/begin CHARACTERISTIC DDRC_DurDeb.Com_numCom217hChecksumDebOk_C "" VALUE 0x80240DD0 Val_Wu16 65535.00 OneToOne 0.00 65535.00 FORMAT "%8.2" /end CHARACTERISTIC
/begin CHARACTERISTIC DDRC_DurDeb.Com_numCom217hChecksumDebDef_C "" VALUE 0x80240DD2 Val_Wu16 65535.00 OneToOne 0.00 65535.00 FORMAT "%8.2" /end CHARACTERISTIC
/begin CHARACTERISTIC DDRC_DurDeb.Com_numCom217hCounterDebOk_C "" VALUE 0x80240DD4 Val_Wu16 65535.00 OneToOne 0.00 65535.00 FORMAT "%8.2" /end CHARACTERISTIC
/begin CHARACTERISTIC DDRC_DurDeb.Com_numCom217hCounterDebDef_C "" VALUE 0x80240DD6 Val_Wu16 65535.00 OneToOne 0.00 65535.00 FORMAT "%8.2" /end CHARACTERISTIC
/begin CHARACTERISTIC DDRC_DurDeb.Com_numCom217hTooShortDebOk_C "" VALUE 0x80240DD8 Val_Wu16 65535.00 OneToOne 0.00 65535.00 FORMAT "%8.2" /end CHARACTERISTIC
/begin CHARACTERISTIC DDRC_DurDeb.Com_numCom217hTooShortDebDef_C "" VALUE 0x80240DDA Val_Wu16 65535.00 OneToOne 0.00 65535.00 FORMAT "%8.2" /end CHARACTERISTIC
/begin CHARACTERISTIC DDRC_DurDeb.Com_numCom227hAbsentDebOk_C "" VALUE 0x80240DDC Val_Wu16 65535.00 OneToOne 0.00 65535.00 FORMAT "%8.2" /end CHARACTERISTIC
/begin CHARACTERISTIC DDRC_DurDeb.Com_numCom227hAbsentDebDef_C "" VALUE 0x80240DDE Val_Wu16 65535.00 OneToOne 0.00 65535.00 FORMAT "%8.2" /end CHARACTERISTIC
/begin CHARACTERISTIC DDRC_DurDeb.Com_numCom227hTooShortDebOk_C "" VALUE 0x80240DE0 Val_Wu16 65535.00 OneToOne 0.00 65535.00 FORMAT "%8.2" /end CHARACTERISTIC
/begin CHARACTERISTIC DDRC_DurDeb.Com_numCom227hTooShortDebDef_C "" VALUE 0x80240DE2 Val_Wu16 65535.00 OneToOne 0.00 65535.00 FORMAT "%8.2" /end CHARACTERISTIC
/begin CHARACTERISTIC DDRC_DurDeb.Com_numCom237hAbsentDebOk_C "" VALUE 0x80240DE4 Val_Wu16 65535.00 OneToOne 0.00 65535.00 FORMAT "%8.2" /end CHARACTERISTIC
/begin CHARACTERISTIC DDRC_DurDeb.Com_numCom237hAbsentDebDef_C "" VALUE 0x80240DE6 Val_Wu16 65535.00 OneToOne 0.00 65535.00 FORMAT "%8.2" /end CHARACTERISTIC
/begin CHARACTERISTIC DDRC_DurDeb.Com_numCom237hChecksumDebOk_C "" VALUE 0x80240DE8 Val_Wu16 65535.00 OneToOne 0.00 65535.00 FORMAT "%8.2" /end CHARACTERISTIC
/begin CHARACTERISTIC DDRC_DurDeb.Com_numCom237hChecksumDebDef_C "" VALUE 0x80240DEA Val_Wu16 65535.00 OneToOne 0.00 65535.00 FORMAT "%8.2" /end CHARACTERISTIC
/begin CHARACTERISTIC DDRC_DurDeb.Com_numCom237hCounterDebOk_C "" VALUE 0x80240DEC Val_Wu16 65535.00 OneToOne 0.00 65535.00 FORMAT "%8.2" /end CHARACTERISTIC
/begin CHARACTERISTIC DDRC_DurDeb.Com_numCom237hCounterDebDef_C "" VALUE 0x80240DEE Val_Wu16 65535.00 OneToOne 0.00 65535.00 FORMAT "%8.2" /end CHARACTERISTIC
/begin CHARACTERISTIC DDRC_DurDeb.Com_numCom237hTooShortDebOk_C "" VALUE 0x80240DF0 Val_Wu16 65535.00 OneToOne 0.00 65535.00 FORMAT "%8.2" /end CHARACTERISTIC
/begin CHARACTERISTIC DDRC_DurDeb.Com_numCom237hTooShortDebDef_C "" VALUE 0x80240DF2 Val_Wu16 65535.00 OneToOne 0.00 65535.00 FORMAT "%8.2" /end CHARACTERISTIC
/begin CHARACTERISTIC DDRC_DurDeb.Com_numCom259hAbsentDebOk_C "" VALUE 0x80240DF4 Val_Wu16 65535.00 OneToOne 0.00 65535.00 FORMAT "%8.2" /end CHARACTERISTIC
/begin CHARACTERISTIC DDRC_DurDeb.Com_numCom259hAbsentDebDef_C "" VALUE 0x80240DF6 Val_Wu16 65535.00 OneToOne 0.00 65535.00 FORMAT "%8.2" /end CHARACTERISTIC
/begin CHARACTERISTIC DDRC_DurDeb.Com_numCom259hChecksumDebOk_C "" VALUE 0x80240DF8 Val_Wu16 65535.00 OneToOne 0.00 65535.00 FORMAT "%8.2" /end CHARACTERISTIC
/begin CHARACTERISTIC DDRC_DurDeb.Com_numCom259hChecksumDebDef_C "" VALUE 0x80240DFA Val_Wu16 65535.00 OneToOne 0.00 65535.00 FORMAT "%8.2" /end CHARACTERISTIC
/begin CHARACTERISTIC DDRC_DurDeb.Com_numCom259hCounterDebOk_C "" VALUE 0x80240DFC Val_Wu16 65535.00 OneToOne 0.00 65535.00 FORMAT "%8.2" /end CHARACTERISTIC
/begin CHARACTERISTIC DDRC_DurDeb.Com_numCom259hCounterDebDef_C "" VALUE 0x80240DFE Val_Wu16 65535.00 OneToOne 0.00 65535.00 FORMAT "%8.2" /end CHARACTERISTIC
/begin CHARACTERISTIC DDRC_DurDeb.Com_numCom259hTooShortDebOk_C "" VALUE 0x80240E00 Val_Wu16 65535.00 OneToOne 0.00 65535.00 FORMAT "%8.2" /end CHARACTERISTIC
/begin CHARACTERISTIC DDRC_DurDeb.Com_numCom259hTooShortDebDef_C "" VALUE 0x80240E02 Val_Wu16 65535.00 OneToOne 0.00 65535.00 FORMAT "%8.2" /end CHARACTERISTIC
/begin CHARACTERISTIC DDRC_DurDeb.Com_numCom273hAbsentDebOk_C "" VALUE 0x80240E04 Val_Wu16 65535.00 OneToOne 0.00 65535.00 FORMAT "%8.2" /end CHARACTERISTIC
/begin CHARACTERISTIC DDRC_DurDeb.Com_numCom273hAbsentDebDef_C "" VALUE 0x80240E06 Val_Wu16 65535.00 OneToOne 0.00 65535.00 FORMAT "%8.2" /end CHARACTERISTIC
/begin CHARACTERISTIC DDRC_DurDeb.Com_numCom273hChecksumDebOk_C "" VALUE 0x80240E08 Val_Wu16 65535.00 OneToOne 0.00 65535.00 FORMAT "%8.2" /end CHARACTERISTIC
/begin CHARACTERISTIC DDRC_DurDeb.Com_numCom273hChecksumDebDef_C "" VALUE 0x80240E0A Val_Wu16 65535.00 OneToOne 0.00 65535.00 FORMAT "%8.2" /end CHARACTERISTIC
/begin CHARACTERISTIC DDRC_DurDeb.Com_numCom273hCounterDebOk_C "" VALUE 0x80240E0C Val_Wu16 65535.00 OneToOne 0.00 65535.00 FORMAT "%8.2" /end CHARACTERISTIC
/begin CHARACTERISTIC DDRC_DurDeb.Com_numCom273hCounterDebDef_C "" VALUE 0x80240E0E Val_Wu16 65535.00 OneToOne 0.00 65535.00 FORMAT "%8.2" /end CHARACTERISTIC
/begin CHARACTERISTIC DDRC_DurDeb.Com_numCom273hTooShortDebOk_C "" VALUE 0x80240E10 Val_Wu16 65535.00 OneToOne 0.00 65535.00 FORMAT "%8.2" /end CHARACTERISTIC
/begin CHARACTERISTIC DDRC_DurDeb.Com_numCom273hTooShortDebDef_C "" VALUE 0x80240E12 Val_Wu16 65535.00 OneToOne 0.00 65535.00 FORMAT "%8.2" /end CHARACTERISTIC
/begin CHARACTERISTIC DDRC_DurDeb.Com_numCom275hAbsentDebOk_C "" VALUE 0x80240E14 Val_Wu16 65535.00 OneToOne 0.00 65535.00 FORMAT "%8.2" /end CHARACTERISTIC
/begin CHARACTERISTIC DDRC_DurDeb.Com_numCom275hAbsentDebDef_C "" VALUE 0x80240E16 Val_Wu16 65535.00 OneToOne 0.00 65535.00 FORMAT "%8.2" /end CHARACTERISTIC
/begin CHARACTERISTIC DDRC_DurDeb.Com_numCom275hChecksumDebOk_C "" VALUE 0x80240E18 Val_Wu16 65535.00 OneToOne 0.00 65535.00 FORMAT "%8.2" /end CHARACTERISTIC
/begin CHARACTERISTIC DDRC_DurDeb.Com_numCom275hChecksumDebDef_C "" VALUE 0x80240E1A Val_Wu16 65535.00 OneToOne 0.00 65535.00 FORMAT "%8.2" /end CHARACTERISTIC
/begin CHARACTERISTIC DDRC_DurDeb.Com_numCom275hCounterDebOk_C "" VALUE 0x80240E1C Val_Wu16 65535.00 OneToOne 0.00 65535.00 FORMAT "%8.2" /end CHARACTERISTIC
/begin CHARACTERISTIC DDRC_DurDeb.Com_numCom275hCounterDebDef_C "" VALUE 0x80240E1E Val_Wu16 65535.00 OneToOne 0.00 65535.00 FORMAT "%8.2" /end CHARACTERISTIC
/begin CHARACTERISTIC DDRC_DurDeb.Com_numCom275hTooShortDebOk_C "" VALUE 0x80240E20 Val_Wu16 65535.00 OneToOne 0.00 65535.00 FORMAT "%8.2" /end CHARACTERISTIC
/begin CHARACTERISTIC DDRC_DurDeb.Com_numCom275hTooShortDebDef_C "" VALUE 0x80240E22 Val_Wu16 65535.00 OneToOne 0.00 65535.00 FORMAT "%8.2" /end CHARACTERISTIC
/begin CHARACTERISTIC DDRC_DurDeb.Com_numCom283hAbsentDebOk_C "" VALUE 0x80240E24 Val_Wu16 65535.00 OneToOne 0.00 65535.00 FORMAT "%8.2" /end CHARACTERISTIC
/begin CHARACTERISTIC DDRC_DurDeb.Com_numCom283hAbsentDebDef_C "" VALUE 0x80240E26 Val_Wu16 65535.00 OneToOne 0.00 65535.00 FORMAT "%8.2" /end CHARACTERISTIC
/begin CHARACTERISTIC DDRC_DurDeb.Com_numCom283hTooShortDebOk_C "" VALUE 0x80240E28 Val_Wu16 65535.00 OneToOne 0.00 65535.00 FORMAT "%8.2" /end CHARACTERISTIC
/begin CHARACTERISTIC DDRC_DurDeb.Com_numCom283hTooShortDebDef_C "" VALUE 0x80240E2A Val_Wu16 65535.00 OneToOne 0.00 65535.00 FORMAT "%8.2" /end CHARACTERISTIC
/begin CHARACTERISTIC DDRC_DurDeb.Com_numCom285hAbsentDebOk_C "" VALUE 0x80240E2C Val_Wu16 65535.00 OneToOne 0.00 65535.00 FORMAT "%8.2" /end CHARACTERISTIC
/begin CHARACTERISTIC DDRC_DurDeb.Com_numCom285hAbsentDebDef_C "" VALUE 0x80240E2E Val_Wu16 65535.00 OneToOne 0.00 65535.00 FORMAT "%8.2" /end CHARACTERISTIC
/begin CHARACTERISTIC DDRC_DurDeb.Com_numCom285hChecksumDebOk_C "" VALUE 0x80240E30 Val_Wu16 65535.00 OneToOne 0.00 65535.00 FORMAT "%8.2" /end CHARACTERISTIC
/begin CHARACTERISTIC DDRC_DurDeb.Com_numCom285hChecksumDebDef_C "" VALUE 0x80240E32 Val_Wu16 65535.00 OneToOne 0.00 65535.00 FORMAT "%8.2" /end CHARACTERISTIC
/begin CHARACTERISTIC DDRC_DurDeb.Com_numCom285hCounterDebOk_C "" VALUE 0x80240E34 Val_Wu16 65535.00 OneToOne 0.00 65535.00 FORMAT "%8.2" /end CHARACTERISTIC
/begin CHARACTERISTIC DDRC_DurDeb.Com_numCom285hCounterDebDef_C "" VALUE 0x80240E36 Val_Wu16 65535.00 OneToOne 0.00 65535.00 FORMAT "%8.2" /end CHARACTERISTIC
/begin CHARACTERISTIC DDRC_DurDeb.Com_numCom285hTooShortDebOk_C "" VALUE 0x80240E38 Val_Wu16 65535.00 OneToOne 0.00 65535.00 FORMAT "%8.2" /end CHARACTERISTIC
/begin CHARACTERISTIC DDRC_DurDeb.Com_numCom285hTooShortDebDef_C "" VALUE 0x80240E3A Val_Wu16 65535.00 OneToOne 0.00 65535.00 FORMAT "%8.2" /end CHARACTERISTIC
/begin CHARACTERISTIC DDRC_DurDeb.Com_numCom293hAbsentDebOk_C "" VALUE 0x80240E3C Val_Wu16 65535.00 OneToOne 0.00 65535.00 FORMAT "%8.2" /end CHARACTERISTIC
/begin CHARACTERISTIC DDRC_DurDeb.Com_numCom293hAbsentDebDef_C "" VALUE 0x80240E3E Val_Wu16 65535.00 OneToOne 0.00 65535.00 FORMAT "%8.2" /end CHARACTERISTIC
/begin CHARACTERISTIC DDRC_DurDeb.Com_numCom293hChecksumDebOk_C "" VALUE 0x80240E40 Val_Wu16 65535.00 OneToOne 0.00 65535.00 FORMAT "%8.2" /end CHARACTERISTIC
/begin CHARACTERISTIC DDRC_DurDeb.Com_numCom293hChecksumDebDef_C "" VALUE 0x80240E42 Val_Wu16 65535.00 OneToOne 0.00 65535.00 FORMAT "%8.2" /end CHARACTERISTIC
/begin CHARACTERISTIC DDRC_DurDeb.Com_numCom293hCounterDebOk_C "" VALUE 0x80240E44 Val_Wu16 65535.00 OneToOne 0.00 65535.00 FORMAT "%8.2" /end CHARACTERISTIC
/begin CHARACTERISTIC DDRC_DurDeb.Com_numCom293hCounterDebDef_C "" VALUE 0x80240E46 Val_Wu16 65535.00 OneToOne 0.00 65535.00 FORMAT "%8.2" /end CHARACTERISTIC
/begin CHARACTERISTIC DDRC_DurDeb.Com_numCom293hTooShortDebOk_C "" VALUE 0x80240E48 Val_Wu16 65535.00 OneToOne 0.00 65535.00 FORMAT "%8.2" /end CHARACTERISTIC
/begin CHARACTERISTIC DDRC_DurDeb.Com_numCom293hTooShortDebDef_C "" VALUE 0x80240E4A Val_Wu16 65535.00 OneToOne 0.00 65535.00 FORMAT "%8.2" /end CHARACTERISTIC
/begin CHARACTERISTIC DDRC_DurDeb.Com_numCom308hAbsentDebOk_C "" VALUE 0x80240E4C Val_Wu16 65535.00 OneToOne 0.00 65535.00 FORMAT "%8.2" /end CHARACTERISTIC
/begin CHARACTERISTIC DDRC_DurDeb.Com_numCom308hAbsentDebDef_C "" VALUE 0x80240E4E Val_Wu16 65535.00 OneToOne 0.00 65535.00 FORMAT "%8.2" /end CHARACTERISTIC
/begin CHARACTERISTIC DDRC_DurDeb.Com_numCom308hChecksumDebOk_C "" VALUE 0x80240E50 Val_Wu16 65535.00 OneToOne 0.00 65535.00 FORMAT "%8.2" /end CHARACTERISTIC
/begin CHARACTERISTIC DDRC_DurDeb.Com_numCom308hChecksumDebDef_C "" VALUE 0x80240E52 Val_Wu16 65535.00 OneToOne 0.00 65535.00 FORMAT "%8.2" /end CHARACTERISTIC
/begin CHARACTERISTIC DDRC_DurDeb.Com_numCom308hCounterDebOk_C "" VALUE 0x80240E54 Val_Wu16 65535.00 OneToOne 0.00 65535.00 FORMAT "%8.2" /end CHARACTERISTIC
/begin CHARACTERISTIC DDRC_DurDeb.Com_numCom308hCounterDebDef_C "" VALUE 0x80240E56 Val_Wu16 65535.00 OneToOne 0.00 65535.00 FORMAT "%8.2" /end CHARACTERISTIC
/begin CHARACTERISTIC DDRC_DurDeb.Com_numCom308hTooShortDebOk_C "" VALUE 0x80240E58 Val_Wu16 65535.00 OneToOne 0.00 65535.00 FORMAT "%8.2" /end CHARACTERISTIC
/begin CHARACTERISTIC DDRC_DurDeb.Com_numCom308hTooShortDebDef_C "" VALUE 0x80240E5A Val_Wu16 65535.00 OneToOne 0.00 65535.00 FORMAT "%8.2" /end CHARACTERISTIC
/begin CHARACTERISTIC DDRC_DurDeb.Com_numCom318hAbsentDebOk_C "" VALUE 0x80240E5C Val_Wu16 65535.00 OneToOne 0.00 65535.00 FORMAT "%8.2" /end CHARACTERISTIC
/begin CHARACTERISTIC DDRC_DurDeb.Com_numCom318hAbsentDebDef_C "" VALUE 0x80240E5E Val_Wu16 65535.00 OneToOne 0.00 65535.00 FORMAT "%8.2" /end CHARACTERISTIC
/begin CHARACTERISTIC DDRC_DurDeb.Com_numCom318hChecksumDebOk_C "" VALUE 0x80240E60 Val_Wu16 65535.00 OneToOne 0.00 65535.00 FORMAT "%8.2" /end CHARACTERISTIC
/begin CHARACTERISTIC DDRC_DurDeb.Com_numCom318hChecksumDebDef_C "" VALUE 0x80240E62 Val_Wu16 65535.00 OneToOne 0.00 65535.00 FORMAT "%8.2" /end CHARACTERISTIC
/begin CHARACTERISTIC DDRC_DurDeb.Com_numCom318hCounterDebOk_C "" VALUE 0x80240E64 Val_Wu16 65535.00 OneToOne 0.00 65535.00 FORMAT "%8.2" /end CHARACTERISTIC
/begin CHARACTERISTIC DDRC_DurDeb.Com_numCom318hCounterDebDef_C "" VALUE 0x80240E66 Val_Wu16 65535.00 OneToOne 0.00 65535.00 FORMAT "%8.2" /end CHARACTERISTIC
/begin CHARACTERISTIC DDRC_DurDeb.Com_numCom318hTooShortDebOk_C "" VALUE 0x80240E68 Val_Wu16 65535.00 OneToOne 0.00 65535.00 FORMAT "%8.2" /end CHARACTERISTIC
/begin CHARACTERISTIC DDRC_DurDeb.Com_numCom318hTooShortDebDef_C "" VALUE 0x80240E6A Val_Wu16 65535.00 OneToOne 0.00 65535.00 FORMAT "%8.2" /end CHARACTERISTIC
/begin CHARACTERISTIC DDRC_DurDeb.Com_numCom325hAbsentDebOk_C "" VALUE 0x80240E6C Val_Wu16 65535.00 OneToOne 0.00 65535.00 FORMAT "%8.2" /end CHARACTERISTIC
/begin CHARACTERISTIC DDRC_DurDeb.Com_numCom325hAbsentDebDef_C "" VALUE 0x80240E6E Val_Wu16 65535.00 OneToOne 0.00 65535.00 FORMAT "%8.2" /end CHARACTERISTIC
/begin CHARACTERISTIC DDRC_DurDeb.Com_numCom325hChecksumDebOk_C "" VALUE 0x80240E70 Val_Wu16 65535.00 OneToOne 0.00 65535.00 FORMAT "%8.2" /end CHARACTERISTIC
/begin CHARACTERISTIC DDRC_DurDeb.Com_numCom325hChecksumDebDef_C "" VALUE 0x80240E72 Val_Wu16 65535.00 OneToOne 0.00 65535.00 FORMAT "%8.2" /end CHARACTERISTIC
/begin CHARACTERISTIC DDRC_DurDeb.Com_numCom325hCounterDebOk_C "" VALUE 0x80240E74 Val_Wu16 65535.00 OneToOne 0.00 65535.00 FORMAT "%8.2" /end CHARACTERISTIC
/begin CHARACTERISTIC DDRC_DurDeb.Com_numCom325hCounterDebDef_C "" VALUE 0x80240E76 Val_Wu16 65535.00 OneToOne 0.00 65535.00 FORMAT "%8.2" /end CHARACTERISTIC
/begin CHARACTERISTIC DDRC_DurDeb.Com_numCom325hTooShortDebOk_C "" VALUE 0x80240E78 Val_Wu16 65535.00 OneToOne 0.00 65535.00 FORMAT "%8.2" /end CHARACTERISTIC
/begin CHARACTERISTIC DDRC_DurDeb.Com_numCom325hTooShortDebDef_C "" VALUE 0x80240E7A Val_Wu16 65535.00 OneToOne 0.00 65535.00 FORMAT "%8.2" /end CHARACTERISTIC
/begin CHARACTERISTIC DDRC_DurDeb.Com_numCom335hAbsentDebOk_C "" VALUE 0x80240E7C Val_Wu16 65535.00 OneToOne 0.00 65535.00 FORMAT "%8.2" /end CHARACTERISTIC
/begin CHARACTERISTIC DDRC_DurDeb.Com_numCom335hAbsentDebDef_C "" VALUE 0x80240E7E Val_Wu16 65535.00 OneToOne 0.00 65535.00 FORMAT "%8.2" /end CHARACTERISTIC
/begin CHARACTERISTIC DDRC_DurDeb.Com_numCom335hChecksumDebOk_C "" VALUE 0x80240E80 Val_Wu16 65535.00 OneToOne 0.00 65535.00 FORMAT "%8.2" /end CHARACTERISTIC
/begin CHARACTERISTIC DDRC_DurDeb.Com_numCom335hChecksumDebDef_C "" VALUE 0x80240E82 Val_Wu16 65535.00 OneToOne 0.00 65535.00 FORMAT "%8.2" /end CHARACTERISTIC
/begin CHARACTERISTIC DDRC_DurDeb.Com_numCom335hCounterDebOk_C "" VALUE 0x80240E84 Val_Wu16 65535.00 OneToOne 0.00 65535.00 FORMAT "%8.2" /end CHARACTERISTIC
/begin CHARACTERISTIC DDRC_DurDeb.Com_numCom335hCounterDebDef_C "" VALUE 0x80240E86 Val_Wu16 65535.00 OneToOne 0.00 65535.00 FORMAT "%8.2" /end CHARACTERISTIC
/begin CHARACTERISTIC DDRC_DurDeb.Com_numCom335hTooShortDebOk_C "" VALUE 0x80240E88 Val_Wu16 65535.00 OneToOne 0.00 65535.00 FORMAT "%8.2" /end CHARACTERISTIC
/begin CHARACTERISTIC DDRC_DurDeb.Com_numCom335hTooShortDebDef_C "" VALUE 0x80240E8A Val_Wu16 65535.00 OneToOne 0.00 65535.00 FORMAT "%8.2" /end CHARACTERISTIC
/begin CHARACTERISTIC DDRC_DurDeb.Com_numCom351hAbsentDebOk_C "" VALUE 0x80240E8C Val_Wu16 65535.00 OneToOne 0.00 65535.00 FORMAT "%8.2" /end CHARACTERISTIC
/begin CHARACTERISTIC DDRC_DurDeb.Com_numCom351hAbsentDebDef_C "" VALUE 0x80240E8E Val_Wu16 65535.00 OneToOne 0.00 65535.00 FORMAT "%8.2" /end CHARACTERISTIC
/begin CHARACTERISTIC DDRC_DurDeb.Com_numCom351hTooShortDebOk_C "" VALUE 0x80240E90 Val_Wu16 65535.00 OneToOne 0.00 65535.00 FORMAT "%8.2" /end CHARACTERISTIC
/begin CHARACTERISTIC DDRC_DurDeb.Com_numCom351hTooShortDebDef_C "" VALUE 0x80240E92 Val_Wu16 65535.00 OneToOne 0.00 65535.00 FORMAT "%8.2" /end CHARACTERISTIC
/begin CHARACTERISTIC DDRC_DurDeb.Com_numCom38DhAbsentDebOk_C "" VALUE 0x80240E94 Val_Wu16 65535.00 OneToOne 0.00 65535.00 FORMAT "%8.2" /end CHARACTERISTIC
/begin CHARACTERISTIC DDRC_DurDeb.Com_numCom38DhAbsentDebDef_C "" VALUE 0x80240E96 Val_Wu16 65535.00 OneToOne 0.00 65535.00 FORMAT "%8.2" /end CHARACTERISTIC
/begin CHARACTERISTIC DDRC_DurDeb.Com_numCom38DhChecksumDebOk_C "" VALUE 0x80240E98 Val_Wu16 65535.00 OneToOne 0.00 65535.00 FORMAT "%8.2" /end CHARACTERISTIC
/begin CHARACTERISTIC DDRC_DurDeb.Com_numCom38DhChecksumDebDef_C "" VALUE 0x80240E9A Val_Wu16 65535.00 OneToOne 0.00 65535.00 FORMAT "%8.2" /end CHARACTERISTIC
/begin CHARACTERISTIC DDRC_DurDeb.Com_numCom38DhCounterDebOk_C "" VALUE 0x80240E9C Val_Wu16 65535.00 OneToOne 0.00 65535.00 FORMAT "%8.2" /end CHARACTERISTIC
/begin CHARACTERISTIC DDRC_DurDeb.Com_numCom38DhCounterDebDef_C "" VALUE 0x80240E9E Val_Wu16 65535.00 OneToOne 0.00 65535.00 FORMAT "%8.2" /end CHARACTERISTIC
/begin CHARACTERISTIC DDRC_DurDeb.Com_numCom38DhTooShortDebOk_C "" VALUE 0x80240EA0 Val_Wu16 65535.00 OneToOne 0.00 65535.00 FORMAT "%8.2" /end CHARACTERISTIC
/begin CHARACTERISTIC DDRC_DurDeb.Com_numCom38DhTooShortDebDef_C "" VALUE 0x80240EA2 Val_Wu16 65535.00 OneToOne 0.00 65535.00 FORMAT "%8.2" /end CHARACTERISTIC
/begin CHARACTERISTIC DDRC_DurDeb.Com_numCom412hAbsentDebOk_C "" VALUE 0x80240EA4 Val_Wu16 65535.00 OneToOne 0.00 65535.00 FORMAT "%8.2" /end CHARACTERISTIC
/begin CHARACTERISTIC DDRC_DurDeb.Com_numCom412hAbsentDebDef_C "" VALUE 0x80240EA6 Val_Wu16 65535.00 OneToOne 0.00 65535.00 FORMAT "%8.2" /end CHARACTERISTIC
/begin CHARACTERISTIC DDRC_DurDeb.Com_numCom412hChecksumDebOk_C "" VALUE 0x80240EA8 Val_Wu16 65535.00 OneToOne 0.00 65535.00 FORMAT "%8.2" /end CHARACTERISTIC
/begin CHARACTERISTIC DDRC_DurDeb.Com_numCom412hChecksumDebDef_C "" VALUE 0x80240EAA Val_Wu16 65535.00 OneToOne 0.00 65535.00 FORMAT "%8.2" /end CHARACTERISTIC
/begin CHARACTERISTIC DDRC_DurDeb.Com_numCom412hCounterDebOk_C "" VALUE 0x80240EAC Val_Wu16 65535.00 OneToOne 0.00 65535.00 FORMAT "%8.2" /end CHARACTERISTIC
/begin CHARACTERISTIC DDRC_DurDeb.Com_numCom412hCounterDebDef_C "" VALUE 0x80240EAE Val_Wu16 65535.00 OneToOne 0.00 65535.00 FORMAT "%8.2" /end CHARACTERISTIC
/begin CHARACTERISTIC DDRC_DurDeb.Com_numCom412hTooShortDebOk_C "" VALUE 0x80240EB0 Val_Wu16 65535.00 OneToOne 0.00 65535.00 FORMAT "%8.2" /end CHARACTERISTIC
/begin CHARACTERISTIC DDRC_DurDeb.Com_numCom412hTooShortDebDef_C "" VALUE 0x80240EB2 Val_Wu16 65535.00 OneToOne 0.00 65535.00 FORMAT "%8.2" /end CHARACTERISTIC
/begin CHARACTERISTIC DDRC_DurDeb.Com_numCom427hAbsentDebOk_C "" VALUE 0x80240EB4 Val_Wu16 65535.00 OneToOne 0.00 65535.00 FORMAT "%8.2" /end CHARACTERISTIC
/begin CHARACTERISTIC DDRC_DurDeb.Com_numCom427hAbsentDebDef_C "" VALUE 0x80240EB6 Val_Wu16 65535.00 OneToOne 0.00 65535.00 FORMAT "%8.2" /end CHARACTERISTIC
/begin CHARACTERISTIC DDRC_DurDeb.Com_numCom427hTooShortDebOk_C "" VALUE 0x80240EB8 Val_Wu16 65535.00 OneToOne 0.00 65535.00 FORMAT "%8.2" /end CHARACTERISTIC
/begin CHARACTERISTIC DDRC_DurDeb.Com_numCom427hTooShortDebDef_C "" VALUE 0x80240EBA Val_Wu16 65535.00 OneToOne 0.00 65535.00 FORMAT "%8.2" /end CHARACTERISTIC
/begin CHARACTERISTIC DDRC_DurDeb.Com_numCom432hAbsentDebOk_C "" VALUE 0x80240EBC Val_Wu16 65535.00 OneToOne 0.00 65535.00 FORMAT "%8.2" /end CHARACTERISTIC
/begin CHARACTERISTIC DDRC_DurDeb.Com_numCom432hAbsentDebDef_C "" VALUE 0x80240EBE Val_Wu16 65535.00 OneToOne 0.00 65535.00 FORMAT "%8.2" /end CHARACTERISTIC
/begin CHARACTERISTIC DDRC_DurDeb.Com_numCom432hChecksumDebOk_C "" VALUE 0x80240EC0 Val_Wu16 65535.00 OneToOne 0.00 65535.00 FORMAT "%8.2" /end CHARACTERISTIC
/begin CHARACTERISTIC DDRC_DurDeb.Com_numCom432hChecksumDebDef_C "" VALUE 0x80240EC2 Val_Wu16 65535.00 OneToOne 0.00 65535.00 FORMAT "%8.2" /end CHARACTERISTIC
/begin CHARACTERISTIC DDRC_DurDeb.Com_numCom432hCounterDebOk_C "" VALUE 0x80240EC4 Val_Wu16 65535.00 OneToOne 0.00 65535.00 FORMAT "%8.2" /end CHARACTERISTIC
/begin CHARACTERISTIC DDRC_DurDeb.Com_numCom432hCounterDebDef_C "" VALUE 0x80240EC6 Val_Wu16 65535.00 OneToOne 0.00 65535.00 FORMAT "%8.2" /end CHARACTERISTIC
/begin CHARACTERISTIC DDRC_DurDeb.Com_numCom432hTooShortDebOk_C "" VALUE 0x80240EC8 Val_Wu16 65535.00 OneToOne 0.00 65535.00 FORMAT "%8.2" /end CHARACTERISTIC
/begin CHARACTERISTIC DDRC_DurDeb.Com_numCom432hTooShortDebDef_C "" VALUE 0x80240ECA Val_Wu16 65535.00 OneToOne 0.00 65535.00 FORMAT "%8.2" /end CHARACTERISTIC
/begin CHARACTERISTIC DDRC_DurDeb.Com_numCom435hAbsentDebOk_C "" VALUE 0x80240ECC Val_Wu16 65535.00 OneToOne 0.00 65535.00 FORMAT "%8.2" /end CHARACTERISTIC
/begin CHARACTERISTIC DDRC_DurDeb.Com_numCom435hAbsentDebDef_C "" VALUE 0x80240ECE Val_Wu16 65535.00 OneToOne 0.00 65535.00 FORMAT "%8.2" /end CHARACTERISTIC
/begin CHARACTERISTIC DDRC_DurDeb.Com_numCom435hTooShortDebOk_C "" VALUE 0x80240ED0 Val_Wu16 65535.00 OneToOne 0.00 65535.00 FORMAT "%8.2" /end CHARACTERISTIC
/begin CHARACTERISTIC DDRC_DurDeb.Com_numCom435hTooShortDebDef_C "" VALUE 0x80240ED2 Val_Wu16 65535.00 OneToOne 0.00 65535.00 FORMAT "%8.2" /end CHARACTERISTIC
/begin CHARACTERISTIC DDRC_DurDeb.Com_numCom442hAbsentDebOk_C "" VALUE 0x80240ED4 Val_Wu16 65535.00 OneToOne 0.00 65535.00 FORMAT "%8.2" /end CHARACTERISTIC
/begin CHARACTERISTIC DDRC_DurDeb.Com_numCom442hAbsentDebDef_C "" VALUE 0x80240ED6 Val_Wu16 65535.00 OneToOne 0.00 65535.00 FORMAT "%8.2" /end CHARACTERISTIC
/begin CHARACTERISTIC DDRC_DurDeb.Com_numCom442hTooShortDebOk_C "" VALUE 0x80240ED8 Val_Wu16 65535.00 OneToOne 0.00 65535.00 FORMAT "%8.2" /end CHARACTERISTIC
/begin CHARACTERISTIC DDRC_DurDeb.Com_numCom442hTooShortDebDef_C "" VALUE 0x80240EDA Val_Wu16 65535.00 OneToOne 0.00 65535.00 FORMAT "%8.2" /end CHARACTERISTIC
/begin CHARACTERISTIC DDRC_DurDeb.Com_numCom453hAbsentDebOk_C "" VALUE 0x80240EDC Val_Wu16 65535.00 OneToOne 0.00 65535.00 FORMAT "%8.2" /end CHARACTERISTIC
/begin CHARACTERISTIC DDRC_DurDeb.Com_numCom453hAbsentDebDef_C "" VALUE 0x80240EDE Val_Wu16 65535.00 OneToOne 0.00 65535.00 FORMAT "%8.2" /end CHARACTERISTIC
/begin CHARACTERISTIC DDRC_DurDeb.Com_numCom453hTooShortDebOk_C "" VALUE 0x80240EE0 Val_Wu16 65535.00 OneToOne 0.00 65535.00 FORMAT "%8.2" /end CHARACTERISTIC
/begin CHARACTERISTIC DDRC_DurDeb.Com_numCom453hTooShortDebDef_C "" VALUE 0x80240EE2 Val_Wu16 65535.00 OneToOne 0.00 65535.00 FORMAT "%8.2" /end CHARACTERISTIC
/begin CHARACTERISTIC DDRC_DurDeb.Com_numCom455hAbsentDebOk_C "" VALUE 0x80240EE4 Val_Wu16 65535.00 OneToOne 0.00 65535.00 FORMAT "%8.2" /end CHARACTERISTIC
/begin CHARACTERISTIC DDRC_DurDeb.Com_numCom455hAbsentDebDef_C "" VALUE 0x80240EE6 Val_Wu16 65535.00 OneToOne 0.00 65535.00 FORMAT "%8.2" /end CHARACTERISTIC
/begin CHARACTERISTIC DDRC_DurDeb.Com_numCom455hTooShortDebOk_C "" VALUE 0x80240EE8 Val_Wu16 65535.00 OneToOne 0.00 65535.00 FORMAT "%8.2" /end CHARACTERISTIC
/begin CHARACTERISTIC DDRC_DurDeb.Com_numCom455hTooShortDebDef_C "" VALUE 0x80240EEA Val_Wu16 65535.00 OneToOne 0.00 65535.00 FORMAT "%8.2" /end CHARACTERISTIC
/begin CHARACTERISTIC DDRC_DurDeb.Com_numCom463hAbsentDebOk_C "" VALUE 0x80240EEC Val_Wu16 65535.00 OneToOne 0.00 65535.00 FORMAT "%8.2" /end CHARACTERISTIC
/begin CHARACTERISTIC DDRC_DurDeb.Com_numCom463hAbsentDebDef_C "" VALUE 0x80240EEE Val_Wu16 65535.00 OneToOne 0.00 65535.00 FORMAT "%8.2" /end CHARACTERISTIC
/begin CHARACTERISTIC DDRC_DurDeb.Com_numCom463hTooShortDebOk_C "" VALUE 0x80240EF0 Val_Wu16 65535.00 OneToOne 0.00 65535.00 FORMAT "%8.2" /end CHARACTERISTIC
/begin CHARACTERISTIC DDRC_DurDeb.Com_numCom463hTooShortDebDef_C "" VALUE 0x80240EF2 Val_Wu16 65535.00 OneToOne 0.00 65535.00 FORMAT "%8.2" /end CHARACTERISTIC
/begin CHARACTERISTIC DDRC_DurDeb.Com_numCom473hAbsentDebOk_C "" VALUE 0x80240EF4 Val_Wu16 65535.00 OneToOne 0.00 65535.00 FORMAT "%8.2" /end CHARACTERISTIC
/begin CHARACTERISTIC DDRC_DurDeb.Com_numCom473hAbsentDebDef_C "" VALUE 0x80240EF6 Val_Wu16 65535.00 OneToOne 0.00 65535.00 FORMAT "%8.2" /end CHARACTERISTIC
/begin CHARACTERISTIC DDRC_DurDeb.Com_numCom473hTooShortDebOk_C "" VALUE 0x80240EF8 Val_Wu16 65535.00 OneToOne 0.00 65535.00 FORMAT "%8.2" /end CHARACTERISTIC
/begin CHARACTERISTIC DDRC_DurDeb.Com_numCom473hTooShortDebDef_C "" VALUE 0x80240EFA Val_Wu16 65535.00 OneToOne 0.00 65535.00 FORMAT "%8.2" /end CHARACTERISTIC
/begin CHARACTERISTIC DDRC_DurDeb.Com_numCom47BhAbsentDebOk_C "" VALUE 0x80240EFC Val_Wu16 65535.00 OneToOne 0.00 65535.00 FORMAT "%8.2" /end CHARACTERISTIC
/begin CHARACTERISTIC DDRC_DurDeb.Com_numCom47BhAbsentDebDef_C "" VALUE 0x80240EFE Val_Wu16 65535.00 OneToOne 0.00 65535.00 FORMAT "%8.2" /end CHARACTERISTIC
/begin CHARACTERISTIC DDRC_DurDeb.Com_numCom47BhTooShortDebOk_C "" VALUE 0x80240F00 Val_Wu16 65535.00 OneToOne 0.00 65535.00 FORMAT "%8.2" /end CHARACTERISTIC
/begin CHARACTERISTIC DDRC_DurDeb.Com_numCom47BhTooShortDebDef_C "" VALUE 0x80240F02 Val_Wu16 65535.00 OneToOne 0.00 65535.00 FORMAT "%8.2" /end CHARACTERISTIC
/begin CHARACTERISTIC DDRC_DurDeb.Com_numCom48BhAbsentDebOk_C "" VALUE 0x80240F04 Val_Wu16 65535.00 OneToOne 0.00 65535.00 FORMAT "%8.2" /end CHARACTERISTIC
/begin CHARACTERISTIC DDRC_DurDeb.Com_numCom48BhAbsentDebDef_C "" VALUE 0x80240F06 Val_Wu16 65535.00 OneToOne 0.00 65535.00 FORMAT "%8.2" /end CHARACTERISTIC
/begin CHARACTERISTIC DDRC_DurDeb.Com_numCom48BhTooShortDebOk_C "" VALUE 0x80240F08 Val_Wu16 65535.00 OneToOne 0.00 65535.00 FORMAT "%8.2" /end CHARACTERISTIC
/begin CHARACTERISTIC DDRC_DurDeb.Com_numCom48BhTooShortDebDef_C "" VALUE 0x80240F0A Val_Wu16 65535.00 OneToOne 0.00 65535.00 FORMAT "%8.2" /end CHARACTERISTIC
/begin CHARACTERISTIC DDRC_DurDeb.Com_numCom497hTooShortDebOk_C "" VALUE 0x80240F0C Val_Wu16 65535.00 OneToOne 0.00 65535.00 FORMAT "%8.2" /end CHARACTERISTIC
/begin CHARACTERISTIC DDRC_DurDeb.Com_numCom497hTooShortDebDef_C "" VALUE 0x80240F0E Val_Wu16 65535.00 OneToOne 0.00 65535.00 FORMAT "%8.2" /end CHARACTERISTIC
/begin CHARACTERISTIC DDRC_DurDeb.Com_numCom4F2hAbsentDebOk_C "" VALUE 0x80240F10 Val_Wu16 65535.00 OneToOne 0.00 65535.00 FORMAT "%8.2" /end CHARACTERISTIC
/begin CHARACTERISTIC DDRC_DurDeb.Com_numCom4F2hAbsentDebDef_C "" VALUE 0x80240F12 Val_Wu16 65535.00 OneToOne 0.00 65535.00 FORMAT "%8.2" /end CHARACTERISTIC
/begin CHARACTERISTIC DDRC_DurDeb.Com_numCom4F2hChecksumDebOk_C "" VALUE 0x80240F14 Val_Wu16 65535.00 OneToOne 0.00 65535.00 FORMAT "%8.2" /end CHARACTERISTIC
/begin CHARACTERISTIC DDRC_DurDeb.Com_numCom4F2hChecksumDebDef_C "" VALUE 0x80240F16 Val_Wu16 65535.00 OneToOne 0.00 65535.00 FORMAT "%8.2" /end CHARACTERISTIC
/begin CHARACTERISTIC DDRC_DurDeb.Com_numCom4F2hCounterDebOk_C "" VALUE 0x80240F18 Val_Wu16 65535.00 OneToOne 0.00 65535.00 FORMAT "%8.2" /end CHARACTERISTIC
/begin CHARACTERISTIC DDRC_DurDeb.Com_numCom4F2hCounterDebDef_C "" VALUE 0x80240F1A Val_Wu16 65535.00 OneToOne 0.00 65535.00 FORMAT "%8.2" /end CHARACTERISTIC
/begin CHARACTERISTIC DDRC_DurDeb.Com_numCom4F2hTooShortDebOk_C "" VALUE 0x80240F1C Val_Wu16 65535.00 OneToOne 0.00 65535.00 FORMAT "%8.2" /end CHARACTERISTIC
/begin CHARACTERISTIC DDRC_DurDeb.Com_numCom4F2hTooShortDebDef_C "" VALUE 0x80240F1E Val_Wu16 65535.00 OneToOne 0.00 65535.00 FORMAT "%8.2" /end CHARACTERISTIC
/begin CHARACTERISTIC DDRC_DurDeb.Com_numCom50DhAbsentDebOk_C "" VALUE 0x80240F20 Val_Wu16 65535.00 OneToOne 0.00 65535.00 FORMAT "%8.2" /end CHARACTERISTIC
/begin CHARACTERISTIC DDRC_DurDeb.Com_numCom50DhAbsentDebDef_C "" VALUE 0x80240F22 Val_Wu16 65535.00 OneToOne 0.00 65535.00 FORMAT "%8.2" /end CHARACTERISTIC
/begin CHARACTERISTIC DDRC_DurDeb.Com_numCom50DhTooShortDebOk_C "" VALUE 0x80240F24 Val_Wu16 65535.00 OneToOne 0.00 65535.00 FORMAT "%8.2" /end CHARACTERISTIC
/begin CHARACTERISTIC DDRC_DurDeb.Com_numCom50DhTooShortDebDef_C "" VALUE 0x80240F26 Val_Wu16 65535.00 OneToOne 0.00 65535.00 FORMAT "%8.2" /end CHARACTERISTIC
/begin CHARACTERISTIC DDRC_DurDeb.Com_numCom535hAbsentDebOk_C "" VALUE 0x80240F28 Val_Wu16 65535.00 OneToOne 0.00 65535.00 FORMAT "%8.2" /end CHARACTERISTIC
/begin CHARACTERISTIC DDRC_DurDeb.Com_numCom535hAbsentDebDef_C "" VALUE 0x80240F2A Val_Wu16 65535.00 OneToOne 0.00 65535.00 FORMAT "%8.2" /end CHARACTERISTIC
/begin CHARACTERISTIC DDRC_DurDeb.Com_numCom535hTooShortDebOk_C "" VALUE 0x80240F2C Val_Wu16 65535.00 OneToOne 0.00 65535.00 FORMAT "%8.2" /end CHARACTERISTIC
/begin CHARACTERISTIC DDRC_DurDeb.Com_numCom535hTooShortDebDef_C "" VALUE 0x80240F2E Val_Wu16 65535.00 OneToOne 0.00 65535.00 FORMAT "%8.2" /end CHARACTERISTIC
/begin CHARACTERISTIC DDRC_DurDeb.Com_numCom543hAbsentDebOk_C "" VALUE 0x80240F30 Val_Wu16 65535.00 OneToOne 0.00 65535.00 FORMAT "%8.2" /end CHARACTERISTIC
/begin CHARACTERISTIC DDRC_DurDeb.Com_numCom543hAbsentDebDef_C "" VALUE 0x80240F32 Val_Wu16 65535.00 OneToOne 0.00 65535.00 FORMAT "%8.2" /end CHARACTERISTIC
/begin CHARACTERISTIC DDRC_DurDeb.Com_numCom543hTooShortDebOk_C "" VALUE 0x80240F34 Val_Wu16 65535.00 OneToOne 0.00 65535.00 FORMAT "%8.2" /end CHARACTERISTIC
/begin CHARACTERISTIC DDRC_DurDeb.Com_numCom543hTooShortDebDef_C "" VALUE 0x80240F36 Val_Wu16 65535.00 OneToOne 0.00 65535.00 FORMAT "%8.2" /end CHARACTERISTIC
/begin CHARACTERISTIC DDRC_DurDeb.Com_numCom552hAbsentDebOk_C "" VALUE 0x80240F38 Val_Wu16 65535.00 OneToOne 0.00 65535.00 FORMAT "%8.2" /end CHARACTERISTIC
/begin CHARACTERISTIC DDRC_DurDeb.Com_numCom552hAbsentDebDef_C "" VALUE 0x80240F3A Val_Wu16 65535.00 OneToOne 0.00 65535.00 FORMAT "%8.2" /end CHARACTERISTIC
/begin CHARACTERISTIC DDRC_DurDeb.Com_numCom552hTooShortDebOk_C "" VALUE 0x80240F3C Val_Wu16 65535.00 OneToOne 0.00 65535.00 FORMAT "%8.2" /end CHARACTERISTIC
/begin CHARACTERISTIC DDRC_DurDeb.Com_numCom552hTooShortDebDef_C "" VALUE 0x80240F3E Val_Wu16 65535.00 OneToOne 0.00 65535.00 FORMAT "%8.2" /end CHARACTERISTIC
/begin CHARACTERISTIC DDRC_DurDeb.Com_numCom583hAbsentDebOk_C "" VALUE 0x80240F40 Val_Wu16 65535.00 OneToOne 0.00 65535.00 FORMAT "%8.2" /end CHARACTERISTIC
/begin CHARACTERISTIC DDRC_DurDeb.Com_numCom583hAbsentDebDef_C "" VALUE 0x80240F42 Val_Wu16 65535.00 OneToOne 0.00 65535.00 FORMAT "%8.2" /end CHARACTERISTIC
/begin CHARACTERISTIC DDRC_DurDeb.Com_numCom583hTooShortDebOk_C "" VALUE 0x80240F44 Val_Wu16 65535.00 OneToOne 0.00 65535.00 FORMAT "%8.2" /end CHARACTERISTIC
/begin CHARACTERISTIC DDRC_DurDeb.Com_numCom583hTooShortDebDef_C "" VALUE 0x80240F46 Val_Wu16 65535.00 OneToOne 0.00 65535.00 FORMAT "%8.2" /end CHARACTERISTIC
/begin CHARACTERISTIC DDRC_DurDeb.Com_numCom592hAbsentDebOk_C "" VALUE 0x80240F48 Val_Wu16 65535.00 OneToOne 0.00 65535.00 FORMAT "%8.2" /end CHARACTERISTIC
/begin CHARACTERISTIC DDRC_DurDeb.Com_numCom592hAbsentDebDef_C "" VALUE 0x80240F4A Val_Wu16 65535.00 OneToOne 0.00 65535.00 FORMAT "%8.2" /end CHARACTERISTIC
/begin CHARACTERISTIC DDRC_DurDeb.Com_numCom592hChecksumDebOk_C "" VALUE 0x80240F4C Val_Wu16 65535.00 OneToOne 0.00 65535.00 FORMAT "%8.2" /end CHARACTERISTIC
/begin CHARACTERISTIC DDRC_DurDeb.Com_numCom592hChecksumDebDef_C "" VALUE 0x80240F4E Val_Wu16 65535.00 OneToOne 0.00 65535.00 FORMAT "%8.2" /end CHARACTERISTIC
/begin CHARACTERISTIC DDRC_DurDeb.Com_numCom592hCounterDebOk_C "" VALUE 0x80240F50 Val_Wu16 65535.00 OneToOne 0.00 65535.00 FORMAT "%8.2" /end CHARACTERISTIC
/begin CHARACTERISTIC DDRC_DurDeb.Com_numCom592hCounterDebDef_C "" VALUE 0x80240F52 Val_Wu16 65535.00 OneToOne 0.00 65535.00 FORMAT "%8.2" /end CHARACTERISTIC
/begin CHARACTERISTIC DDRC_DurDeb.Com_numCom592hTooShortDebOk_C "" VALUE 0x80240F54 Val_Wu16 65535.00 OneToOne 0.00 65535.00 FORMAT "%8.2" /end CHARACTERISTIC
/begin CHARACTERISTIC DDRC_DurDeb.Com_numCom592hTooShortDebDef_C "" VALUE 0x80240F56 Val_Wu16 65535.00 OneToOne 0.00 65535.00 FORMAT "%8.2" /end CHARACTERISTIC
/begin CHARACTERISTIC DDRC_DurDeb.Com_numCom595hAbsentDebOk_C "" VALUE 0x80240F58 Val_Wu16 65535.00 OneToOne 0.00 65535.00 FORMAT "%8.2" /end CHARACTERISTIC
/begin CHARACTERISTIC DDRC_DurDeb.Com_numCom595hAbsentDebDef_C "" VALUE 0x80240F5A Val_Wu16 65535.00 OneToOne 0.00 65535.00 FORMAT "%8.2" /end CHARACTERISTIC
/begin CHARACTERISTIC DDRC_DurDeb.Com_numCom595hChecksumDebOk_C "" VALUE 0x80240F5C Val_Wu16 65535.00 OneToOne 0.00 65535.00 FORMAT "%8.2" /end CHARACTERISTIC
/begin CHARACTERISTIC DDRC_DurDeb.Com_numCom595hChecksumDebDef_C "" VALUE 0x80240F5E Val_Wu16 65535.00 OneToOne 0.00 65535.00 FORMAT "%8.2" /end CHARACTERISTIC
/begin CHARACTERISTIC DDRC_DurDeb.Com_numCom595hCounterDebOk_C "" VALUE 0x80240F60 Val_Wu16 65535.00 OneToOne 0.00 65535.00 FORMAT "%8.2" /end CHARACTERISTIC
/begin CHARACTERISTIC DDRC_DurDeb.Com_numCom595hCounterDebDef_C "" VALUE 0x80240F62 Val_Wu16 65535.00 OneToOne 0.00 65535.00 FORMAT "%8.2" /end CHARACTERISTIC
/begin CHARACTERISTIC DDRC_DurDeb.Com_numCom595hTooShortDebOk_C "" VALUE 0x80240F64 Val_Wu16 65535.00 OneToOne 0.00 65535.00 FORMAT "%8.2" /end CHARACTERISTIC
/begin CHARACTERISTIC DDRC_DurDeb.Com_numCom595hTooShortDebDef_C "" VALUE 0x80240F66 Val_Wu16 65535.00 OneToOne 0.00 65535.00 FORMAT "%8.2" /end CHARACTERISTIC
/begin CHARACTERISTIC DDRC_DurDeb.Com_numCom5B2hTooShortDebOk_C "" VALUE 0x80240F68 Val_Wu16 65535.00 OneToOne 0.00 65535.00 FORMAT "%8.2" /end CHARACTERISTIC
/begin CHARACTERISTIC DDRC_DurDeb.Com_numCom5B2hTooShortDebDef_C "" VALUE 0x80240F6A Val_Wu16 65535.00 OneToOne 0.00 65535.00 FORMAT "%8.2" /end CHARACTERISTIC
/begin CHARACTERISTIC DDRC_DurDeb.Com_numCom5B5hAbsentDebOk_C "" VALUE 0x80240F6C Val_Wu16 65535.00 OneToOne 0.00 65535.00 FORMAT "%8.2" /end CHARACTERISTIC
/begin CHARACTERISTIC DDRC_DurDeb.Com_numCom5B5hAbsentDebDef_C "" VALUE 0x80240F6E Val_Wu16 65535.00 OneToOne 0.00 65535.00 FORMAT "%8.2" /end CHARACTERISTIC
/begin CHARACTERISTIC DDRC_DurDeb.Com_numCom5B5hChecksumDebOk_C "" VALUE 0x80240F70 Val_Wu16 65535.00 OneToOne 0.00 65535.00 FORMAT "%8.2" /end CHARACTERISTIC
/begin CHARACTERISTIC DDRC_DurDeb.Com_numCom5B5hChecksumDebDef_C "" VALUE 0x80240F72 Val_Wu16 65535.00 OneToOne 0.00 65535.00 FORMAT "%8.2" /end CHARACTERISTIC
/begin CHARACTERISTIC DDRC_DurDeb.Com_numCom5B5hCounterDebOk_C "" VALUE 0x80240F74 Val_Wu16 65535.00 OneToOne 0.00 65535.00 FORMAT "%8.2" /end CHARACTERISTIC
/begin CHARACTERISTIC DDRC_DurDeb.Com_numCom5B5hCounterDebDef_C "" VALUE 0x80240F76 Val_Wu16 65535.00 OneToOne 0.00 65535.00 FORMAT "%8.2" /end CHARACTERISTIC
/begin CHARACTERISTIC DDRC_DurDeb.Com_numCom5B5hTooShortDebOk_C "" VALUE 0x80240F78 Val_Wu16 65535.00 OneToOne 0.00 65535.00 FORMAT "%8.2" /end CHARACTERISTIC
/begin CHARACTERISTIC DDRC_DurDeb.Com_numCom5B5hTooShortDebDef_C "" VALUE 0x80240F7A Val_Wu16 65535.00 OneToOne 0.00 65535.00 FORMAT "%8.2" /end CHARACTERISTIC
/begin CHARACTERISTIC DDRC_DurDeb.Com_numCom5C7hTooShortDebOk_C "" VALUE 0x80240F7C Val_Wu16 65535.00 OneToOne 0.00 65535.00 FORMAT "%8.2" /end CHARACTERISTIC
/begin CHARACTERISTIC DDRC_DurDeb.Com_numCom5C7hTooShortDebDef_C "" VALUE 0x80240F7E Val_Wu16 65535.00 OneToOne 0.00 65535.00 FORMAT "%8.2" /end CHARACTERISTIC
/begin CHARACTERISTIC DDRC_DurDeb.Com_numCom5E7hAbsentDebOk_C "" VALUE 0x80240F80 Val_Wu16 65535.00 OneToOne 0.00 65535.00 FORMAT "%8.2" /end CHARACTERISTIC
/begin CHARACTERISTIC DDRC_DurDeb.Com_numCom5E7hAbsentDebDef_C "" VALUE 0x80240F82 Val_Wu16 65535.00 OneToOne 0.00 65535.00 FORMAT "%8.2" /end CHARACTERISTIC
/begin CHARACTERISTIC DDRC_DurDeb.Com_numCom5E7hTooShortDebOk_C "" VALUE 0x80240F84 Val_Wu16 65535.00 OneToOne 0.00 65535.00 FORMAT "%8.2" /end CHARACTERISTIC
/begin CHARACTERISTIC DDRC_DurDeb.Com_numCom5E7hTooShortDebDef_C "" VALUE 0x80240F86 Val_Wu16 65535.00 OneToOne 0.00 65535.00 FORMAT "%8.2" /end CHARACTERISTIC
/begin CHARACTERISTIC DDRC_DurDeb.Com_numCom635hTooShortDebOk_C "" VALUE 0x80240F88 Val_Wu16 65535.00 OneToOne 0.00 65535.00 FORMAT "%8.2" /end CHARACTERISTIC
/begin CHARACTERISTIC DDRC_DurDeb.Com_numCom635hTooShortDebDef_C "" VALUE 0x80240F8A Val_Wu16 65535.00 OneToOne 0.00 65535.00 FORMAT "%8.2" /end CHARACTERISTIC
/begin CHARACTERISTIC DDRC_DurDeb.Com_numCom645hTooShortDebOk_C "" VALUE 0x80240F8C Val_Wu16 65535.00 OneToOne 0.00 65535.00 FORMAT "%8.2" /end CHARACTERISTIC
/begin CHARACTERISTIC DDRC_DurDeb.Com_numCom645hTooShortDebDef_C "" VALUE 0x80240F8E Val_Wu16 65535.00 OneToOne 0.00 65535.00 FORMAT "%8.2" /end CHARACTERISTIC
/begin CHARACTERISTIC DDRC_DurDeb.Com_numCom663hAbsentDebOk_C "" VALUE 0x80240F90 Val_Wu16 65535.00 OneToOne 0.00 65535.00 FORMAT "%8.2" /end CHARACTERISTIC
/begin CHARACTERISTIC DDRC_DurDeb.Com_numCom663hAbsentDebDef_C "" VALUE 0x80240F92 Val_Wu16 65535.00 OneToOne 0.00 65535.00 FORMAT "%8.2" /end CHARACTERISTIC
/begin CHARACTERISTIC DDRC_DurDeb.Com_numCom663hTooShortDebOk_C "" VALUE 0x80240F94 Val_Wu16 65535.00 OneToOne 0.00 65535.00 FORMAT "%8.2" /end CHARACTERISTIC
/begin CHARACTERISTIC DDRC_DurDeb.Com_numCom663hTooShortDebDef_C "" VALUE 0x80240F96 Val_Wu16 65535.00 OneToOne 0.00 65535.00 FORMAT "%8.2" /end CHARACTERISTIC
/begin CHARACTERISTIC DDRC_DurDeb.Com_numCom665hAbsentDebOk_C "" VALUE 0x80240F98 Val_Wu16 65535.00 OneToOne 0.00 65535.00 FORMAT "%8.2" /end CHARACTERISTIC
/begin CHARACTERISTIC DDRC_DurDeb.Com_numCom665hAbsentDebDef_C "" VALUE 0x80240F9A Val_Wu16 65535.00 OneToOne 0.00 65535.00 FORMAT "%8.2" /end CHARACTERISTIC
/begin CHARACTERISTIC DDRC_DurDeb.Com_numCom665hTooShortDebOk_C "" VALUE 0x80240F9C Val_Wu16 65535.00 OneToOne 0.00 65535.00 FORMAT "%8.2" /end CHARACTERISTIC
/begin CHARACTERISTIC DDRC_DurDeb.Com_numCom665hTooShortDebDef_C "" VALUE 0x80240F9E Val_Wu16 65535.00 OneToOne 0.00 65535.00 FORMAT "%8.2" /end CHARACTERISTIC
/begin CHARACTERISTIC DDRC_DurDeb.Com_numCom675hAbsentDebOk_C "" VALUE 0x80240FA0 Val_Wu16 65535.00 OneToOne 0.00 65535.00 FORMAT "%8.2" /end CHARACTERISTIC
/begin CHARACTERISTIC DDRC_DurDeb.Com_numCom675hAbsentDebDef_C "" VALUE 0x80240FA2 Val_Wu16 65535.00 OneToOne 0.00 65535.00 FORMAT "%8.2" /end CHARACTERISTIC
/begin CHARACTERISTIC DDRC_DurDeb.Com_numCom675hTooShortDebOk_C "" VALUE 0x80240FA4 Val_Wu16 65535.00 OneToOne 0.00 65535.00 FORMAT "%8.2" /end CHARACTERISTIC
/begin CHARACTERISTIC DDRC_DurDeb.Com_numCom675hTooShortDebDef_C "" VALUE 0x80240FA6 Val_Wu16 65535.00 OneToOne 0.00 65535.00 FORMAT "%8.2" /end CHARACTERISTIC
/begin CHARACTERISTIC DDRC_DurDeb.Com_numComFrbd_205h_HVBAT_PACK_CURRENTDebOk_C "" VALUE 0x80240FA8 Val_Wu16 65535.00 OneToOne 0.00 65535.00 FORMAT "%8.2" /end CHARACTERISTIC
/begin CHARACTERISTIC DDRC_DurDeb.Com_numComFrbd_205h_HVBAT_PACK_CURRENTDebDef_C "" VALUE 0x80240FAA Val_Wu16 65535.00 OneToOne 0.00 65535.00 FORMAT "%8.2" /end CHARACTERISTIC
/begin CHARACTERISTIC DDRC_DurDeb.Com_numComFrbd_205h_HVBAT_SOC_DISPLAYDebOk_C "" VALUE 0x80240FAC Val_Wu16 65535.00 OneToOne 0.00 65535.00 FORMAT "%8.2" /end CHARACTERISTIC
/begin CHARACTERISTIC DDRC_DurDeb.Com_numComFrbd_205h_HVBAT_SOC_DISPLAYDebDef_C "" VALUE 0x80240FAE Val_Wu16 65535.00 OneToOne 0.00 65535.00 FORMAT "%8.2" /end CHARACTERISTIC
/begin CHARACTERISTIC DDRC_DurDeb.Com_numComFrbd_205h_HVBAT_VOLTAGEDebOk_C "" VALUE 0x80240FB0 Val_Wu16 65535.00 OneToOne 0.00 65535.00 FORMAT "%8.2" /end CHARACTERISTIC
/begin CHARACTERISTIC DDRC_DurDeb.Com_numComFrbd_205h_HVBAT_VOLTAGEDebDef_C "" VALUE 0x80240FB2 Val_Wu16 65535.00 OneToOne 0.00 65535.00 FORMAT "%8.2" /end CHARACTERISTIC
/begin CHARACTERISTIC DDRC_DurDeb.Com_numComFrbd_217h_INV_DC_BUS_VOLTAGEDebOk_C "" VALUE 0x80240FB4 Val_Wu16 65535.00 OneToOne 0.00 65535.00 FORMAT "%8.2" /end CHARACTERISTIC
/begin CHARACTERISTIC DDRC_DurDeb.Com_numComFrbd_217h_INV_DC_BUS_VOLTAGEDebDef_C "" VALUE 0x80240FB6 Val_Wu16 65535.00 OneToOne 0.00 65535.00 FORMAT "%8.2" /end CHARACTERISTIC
/begin CHARACTERISTIC DDRC_DurDeb.Com_numComFrbd_217h_INV_MTR_ACTUAL_TRQDebOk_C "" VALUE 0x80240FB8 Val_Wu16 65535.00 OneToOne 0.00 65535.00 FORMAT "%8.2" /end CHARACTERISTIC
/begin CHARACTERISTIC DDRC_DurDeb.Com_numComFrbd_217h_INV_MTR_ACTUAL_TRQDebDef_C "" VALUE 0x80240FBA Val_Wu16 65535.00 OneToOne 0.00 65535.00 FORMAT "%8.2" /end CHARACTERISTIC
/begin CHARACTERISTIC DDRC_DurDeb.Com_numComFrbd_217h_INV_MTR_SPEEDDebOk_C "" VALUE 0x80240FBC Val_Wu16 65535.00 OneToOne 0.00 65535.00 FORMAT "%8.2" /end CHARACTERISTIC
/begin CHARACTERISTIC DDRC_DurDeb.Com_numComFrbd_217h_INV_MTR_SPEEDDebDef_C "" VALUE 0x80240FBE Val_Wu16 65535.00 OneToOne 0.00 65535.00 FORMAT "%8.2" /end CHARACTERISTIC
/begin CHARACTERISTIC DDRC_DurDeb.Com_numComFrbd_217h_INV_MTR_TRQDebOk_C "" VALUE 0x80240FC0 Val_Wu16 65535.00 OneToOne 0.00 65535.00 FORMAT "%8.2" /end CHARACTERISTIC
/begin CHARACTERISTIC DDRC_DurDeb.Com_numComFrbd_217h_INV_MTR_TRQDebDef_C "" VALUE 0x80240FC2 Val_Wu16 65535.00 OneToOne 0.00 65535.00 FORMAT "%8.2" /end CHARACTERISTIC
/begin CHARACTERISTIC DDRC_DurDeb.Com_numComFrbd_227h_INV_DC_CURRENTDebOk_C "" VALUE 0x80240FC4 Val_Wu16 65535.00 OneToOne 0.00 65535.00 FORMAT "%8.2" /end CHARACTERISTIC
/begin CHARACTERISTIC DDRC_DurDeb.Com_numComFrbd_227h_INV_DC_CURRENTDebDef_C "" VALUE 0x80240FC6 Val_Wu16 65535.00 OneToOne 0.00 65535.00 FORMAT "%8.2" /end CHARACTERISTIC
/begin CHARACTERISTIC DDRC_DurDeb.Com_numComFrbd_227h_INV_MOTORING_PEAK_TRQDebOk_C "" VALUE 0x80240FC8 Val_Wu16 65535.00 OneToOne 0.00 65535.00 FORMAT "%8.2" /end CHARACTERISTIC
/begin CHARACTERISTIC DDRC_DurDeb.Com_numComFrbd_227h_INV_MOTORING_PEAK_TRQDebDef_C "" VALUE 0x80240FCA Val_Wu16 65535.00 OneToOne 0.00 65535.00 FORMAT "%8.2" /end CHARACTERISTIC
/begin CHARACTERISTIC DDRC_DurDeb.Com_numComFrbd_227h_INV_MTR_INST_INPUT_POWERDebOk_C "" VALUE 0x80240FCC Val_Wu16 65535.00 OneToOne 0.00 65535.00 FORMAT "%8.2" /end CHARACTERISTIC
/begin CHARACTERISTIC DDRC_DurDeb.Com_numComFrbd_227h_INV_MTR_INST_INPUT_POWERDebDef_C "" VALUE 0x80240FCE Val_Wu16 65535.00 OneToOne 0.00 65535.00 FORMAT "%8.2" /end CHARACTERISTIC
/begin CHARACTERISTIC DDRC_DurDeb.Com_numComFrbd_227h_INV_REGEN_PEAK_TRQDebOk_C "" VALUE 0x80240FD0 Val_Wu16 65535.00 OneToOne 0.00 65535.00 FORMAT "%8.2" /end CHARACTERISTIC
/begin CHARACTERISTIC DDRC_DurDeb.Com_numComFrbd_227h_INV_REGEN_PEAK_TRQDebDef_C "" VALUE 0x80240FD2 Val_Wu16 65535.00 OneToOne 0.00 65535.00 FORMAT "%8.2" /end CHARACTERISTIC
/begin CHARACTERISTIC DDRC_DurDeb.Com_numComFrbd_237h_INV_ACTIVE_DISCHARGE_STATUSDebOk_C "" VALUE 0x80240FD4 Val_Wu16 65535.00 OneToOne 0.00 65535.00 FORMAT "%8.2" /end CHARACTERISTIC
/begin CHARACTERISTIC DDRC_DurDeb.Com_numComFrbd_237h_INV_ACTIVE_DISCHARGE_STATUSDebDef_C "" VALUE 0x80240FD6 Val_Wu16 65535.00 OneToOne 0.00 65535.00 FORMAT "%8.2" /end CHARACTERISTIC
/begin CHARACTERISTIC DDRC_DurDeb.Com_numComFrbd_237h_INV_CTRL_MODE_ACKDebOk_C "" VALUE 0x80240FD8 Val_Wu16 65535.00 OneToOne 0.00 65535.00 FORMAT "%8.2" /end CHARACTERISTIC
/begin CHARACTERISTIC DDRC_DurDeb.Com_numComFrbd_237h_INV_CTRL_MODE_ACKDebDef_C "" VALUE 0x80240FDA Val_Wu16 65535.00 OneToOne 0.00 65535.00 FORMAT "%8.2" /end CHARACTERISTIC
/begin CHARACTERISTIC DDRC_DurDeb.Com_numComFrbd_237h_INV_EV_WARNINGDebOk_C "" VALUE 0x80240FDC Val_Wu16 65535.00 OneToOne 0.00 65535.00 FORMAT "%8.2" /end CHARACTERISTIC
/begin CHARACTERISTIC DDRC_DurDeb.Com_numComFrbd_237h_INV_EV_WARNINGDebDef_C "" VALUE 0x80240FDE Val_Wu16 65535.00 OneToOne 0.00 65535.00 FORMAT "%8.2" /end CHARACTERISTIC
/begin CHARACTERISTIC DDRC_DurDeb.Com_numComFrbd_237h_INV_FAULT_LEVELDebOk_C "" VALUE 0x80240FE0 Val_Wu16 65535.00 OneToOne 0.00 65535.00 FORMAT "%8.2" /end CHARACTERISTIC
/begin CHARACTERISTIC DDRC_DurDeb.Com_numComFrbd_237h_INV_FAULT_LEVELDebDef_C "" VALUE 0x80240FE2 Val_Wu16 65535.00 OneToOne 0.00 65535.00 FORMAT "%8.2" /end CHARACTERISTIC
/begin CHARACTERISTIC DDRC_DurDeb.Com_numComFrbd_237h_INV_MASTER_STOPDebOk_C "" VALUE 0x80240FE4 Val_Wu16 65535.00 OneToOne 0.00 65535.00 FORMAT "%8.2" /end CHARACTERISTIC
/begin CHARACTERISTIC DDRC_DurDeb.Com_numComFrbd_237h_INV_MASTER_STOPDebDef_C "" VALUE 0x80240FE6 Val_Wu16 65535.00 OneToOne 0.00 65535.00 FORMAT "%8.2" /end CHARACTERISTIC
/begin CHARACTERISTIC DDRC_DurDeb.Com_numComFrbd_237h_INV_SERVICE_DUEDebOk_C "" VALUE 0x80240FE8 Val_Wu16 65535.00 OneToOne 0.00 65535.00 FORMAT "%8.2" /end CHARACTERISTIC
/begin CHARACTERISTIC DDRC_DurDeb.Com_numComFrbd_237h_INV_SERVICE_DUEDebDef_C "" VALUE 0x80240FEA Val_Wu16 65535.00 OneToOne 0.00 65535.00 FORMAT "%8.2" /end CHARACTERISTIC
/begin CHARACTERISTIC DDRC_DurDeb.Com_numComFrbd_237h_INV_STAB_MIN_TRQDebOk_C "" VALUE 0x80240FEC Val_Wu16 65535.00 OneToOne 0.00 65535.00 FORMAT "%8.2" /end CHARACTERISTIC
/begin CHARACTERISTIC DDRC_DurDeb.Com_numComFrbd_237h_INV_STAB_MIN_TRQDebDef_C "" VALUE 0x80240FEE Val_Wu16 65535.00 OneToOne 0.00 65535.00 FORMAT "%8.2" /end CHARACTERISTIC
/begin CHARACTERISTIC DDRC_DurDeb.Com_numComFrbd_259h_TGLM_FAILURE_STATEDebOk_C "" VALUE 0x80240FF0 Val_Wu16 65535.00 OneToOne 0.00 65535.00 FORMAT "%8.2" /end CHARACTERISTIC
/begin CHARACTERISTIC DDRC_DurDeb.Com_numComFrbd_259h_TGLM_FAILURE_STATEDebDef_C "" VALUE 0x80240FF2 Val_Wu16 65535.00 OneToOne 0.00 65535.00 FORMAT "%8.2" /end CHARACTERISTIC
/begin CHARACTERISTIC DDRC_DurDeb.Com_numComFrbd_259h_TGLM_MODE_PUSHDebOk_C "" VALUE 0x80240FF4 Val_Wu16 65535.00 OneToOne 0.00 65535.00 FORMAT "%8.2" /end CHARACTERISTIC
/begin CHARACTERISTIC DDRC_DurDeb.Com_numComFrbd_259h_TGLM_MODE_PUSHDebDef_C "" VALUE 0x80240FF6 Val_Wu16 65535.00 OneToOne 0.00 65535.00 FORMAT "%8.2" /end CHARACTERISTIC
/begin CHARACTERISTIC DDRC_DurDeb.Com_numComFrbd_259h_TOGGLE_MONOSTABLE_POSDebOk_C "" VALUE 0x80240FF8 Val_Wu16 65535.00 OneToOne 0.00 65535.00 FORMAT "%8.2" /end CHARACTERISTIC
/begin CHARACTERISTIC DDRC_DurDeb.Com_numComFrbd_259h_TOGGLE_MONOSTABLE_POSDebDef_C "" VALUE 0x80240FFA Val_Wu16 65535.00 OneToOne 0.00 65535.00 FORMAT "%8.2" /end CHARACTERISTIC
/begin CHARACTERISTIC DDRC_DurDeb.Com_numComFrbd_273h_OBC_outputpower_capabilityDebOk_C "" VALUE 0x80240FFC Val_Wu16 65535.00 OneToOne 0.00 65535.00 FORMAT "%8.2" /end CHARACTERISTIC
/begin CHARACTERISTIC DDRC_DurDeb.Com_numComFrbd_273h_OBC_outputpower_capabilityDebDef_C "" VALUE 0x80240FFE Val_Wu16 65535.00 OneToOne 0.00 65535.00 FORMAT "%8.2" /end CHARACTERISTIC
/begin CHARACTERISTIC DDRC_DurDeb.Com_numComFrbd_275h_HVBAT_DISCHARGE_30S_AVAILABLE_CURRENTDebOk_C "" VALUE 0x80241000 Val_Wu16 65535.00 OneToOne 0.00 65535.00 FORMAT "%8.2" /end CHARACTERISTIC
/begin CHARACTERISTIC DDRC_DurDeb.Com_numComFrbd_275h_HVBAT_DISCHARGE_30S_AVAILABLE_CURRENTDebDef_C "" VALUE 0x80241002 Val_Wu16 65535.00 OneToOne 0.00 65535.00 FORMAT "%8.2" /end CHARACTERISTIC
/begin CHARACTERISTIC DDRC_DurDeb.Com_numComFrbd_275h_HVBAT_DISCHARGE_30S_AVAILABLE_POWERDebOk_C "" VALUE 0x80241004 Val_Wu16 65535.00 OneToOne 0.00 65535.00 FORMAT "%8.2" /end CHARACTERISTIC
/begin CHARACTERISTIC DDRC_DurDeb.Com_numComFrbd_275h_HVBAT_DISCHARGE_30S_AVAILABLE_POWERDebDef_C "" VALUE 0x80241006 Val_Wu16 65535.00 OneToOne 0.00 65535.00 FORMAT "%8.2" /end CHARACTERISTIC
/begin CHARACTERISTIC DDRC_DurDeb.Com_numComFrbd_283h_DCDC_IN_CURRENTDebOk_C "" VALUE 0x80241008 Val_Wu16 65535.00 OneToOne 0.00 65535.00 FORMAT "%8.2" /end CHARACTERISTIC
/begin CHARACTERISTIC DDRC_DurDeb.Com_numComFrbd_283h_DCDC_IN_CURRENTDebDef_C "" VALUE 0x8024100A Val_Wu16 65535.00 OneToOne 0.00 65535.00 FORMAT "%8.2" /end CHARACTERISTIC
/begin CHARACTERISTIC DDRC_DurDeb.Com_numComFrbd_283h_DCDC_IN_VOLTAGEDebOk_C "" VALUE 0x8024100C Val_Wu16 65535.00 OneToOne 0.00 65535.00 FORMAT "%8.2" /end CHARACTERISTIC
/begin CHARACTERISTIC DDRC_DurDeb.Com_numComFrbd_283h_DCDC_IN_VOLTAGEDebDef_C "" VALUE 0x8024100E Val_Wu16 65535.00 OneToOne 0.00 65535.00 FORMAT "%8.2" /end CHARACTERISTIC
/begin CHARACTERISTIC DDRC_DurDeb.Com_numComFrbd_283h_DCDC_OUT_CURRENTDebOk_C "" VALUE 0x80241010 Val_Wu16 65535.00 OneToOne 0.00 65535.00 FORMAT "%8.2" /end CHARACTERISTIC
/begin CHARACTERISTIC DDRC_DurDeb.Com_numComFrbd_283h_DCDC_OUT_CURRENTDebDef_C "" VALUE 0x80241012 Val_Wu16 65535.00 OneToOne 0.00 65535.00 FORMAT "%8.2" /end CHARACTERISTIC
/begin CHARACTERISTIC DDRC_DurDeb.Com_numComFrbd_283h_DCDC_OUT_VOLTAGEDebOk_C "" VALUE 0x80241014 Val_Wu16 65535.00 OneToOne 0.00 65535.00 FORMAT "%8.2" /end CHARACTERISTIC
/begin CHARACTERISTIC DDRC_DurDeb.Com_numComFrbd_283h_DCDC_OUT_VOLTAGEDebDef_C "" VALUE 0x80241016 Val_Wu16 65535.00 OneToOne 0.00 65535.00 FORMAT "%8.2" /end CHARACTERISTIC
/begin CHARACTERISTIC DDRC_DurDeb.Com_numComFrbd_285h_HVBAT_REGEN_CHG_30S_CURRENT_LIMITDebOk_C "" VALUE 0x80241018 Val_Wu16 65535.00 OneToOne 0.00 65535.00 FORMAT "%8.2" /end CHARACTERISTIC
/begin CHARACTERISTIC DDRC_DurDeb.Com_numComFrbd_285h_HVBAT_REGEN_CHG_30S_CURRENT_LIMITDebDef_C "" VALUE 0x8024101A Val_Wu16 65535.00 OneToOne 0.00 65535.00 FORMAT "%8.2" /end CHARACTERISTIC
/begin CHARACTERISTIC DDRC_DurDeb.Com_numComFrbd_285h_HVBAT_REGEN_CHRG_30S_POWER_LIMITDebOk_C "" VALUE 0x8024101C Val_Wu16 65535.00 OneToOne 0.00 65535.00 FORMAT "%8.2" /end CHARACTERISTIC
/begin CHARACTERISTIC DDRC_DurDeb.Com_numComFrbd_285h_HVBAT_REGEN_CHRG_30S_POWER_LIMITDebDef_C "" VALUE 0x8024101E Val_Wu16 65535.00 OneToOne 0.00 65535.00 FORMAT "%8.2" /end CHARACTERISTIC
/begin CHARACTERISTIC DDRC_DurDeb.Com_numComFrbd_293h_DCDC_outputpower_capabilityDebOk_C "" VALUE 0x80241020 Val_Wu16 65535.00 OneToOne 0.00 65535.00 FORMAT "%8.2" /end CHARACTERISTIC
/begin CHARACTERISTIC DDRC_DurDeb.Com_numComFrbd_293h_DCDC_outputpower_capabilityDebDef_C "" VALUE 0x80241022 Val_Wu16 65535.00 OneToOne 0.00 65535.00 FORMAT "%8.2" /end CHARACTERISTIC
/begin CHARACTERISTIC DDRC_DurDeb.Com_numComFrbd_325h_HVBAT_INSULATION_RESISTANCEDebOk_C "" VALUE 0x80241024 Val_Wu16 65535.00 OneToOne 0.00 65535.00 FORMAT "%8.2" /end CHARACTERISTIC
/begin CHARACTERISTIC DDRC_DurDeb.Com_numComFrbd_325h_HVBAT_INSULATION_RESISTANCEDebDef_C "" VALUE 0x80241026 Val_Wu16 65535.00 OneToOne 0.00 65535.00 FORMAT "%8.2" /end CHARACTERISTIC
/begin CHARACTERISTIC DDRC_DurDeb.Com_numComFrbd_325h_HVBAT_TEMPERATUREDebOk_C "" VALUE 0x80241028 Val_Wu16 65535.00 OneToOne 0.00 65535.00 FORMAT "%8.2" /end CHARACTERISTIC
/begin CHARACTERISTIC DDRC_DurDeb.Com_numComFrbd_325h_HVBAT_TEMPERATUREDebDef_C "" VALUE 0x8024102A Val_Wu16 65535.00 OneToOne 0.00 65535.00 FORMAT "%8.2" /end CHARACTERISTIC
/begin CHARACTERISTIC DDRC_DurDeb.Com_numComFrbd_335h_HVBAT_CHRG_CONTINUOUS_CURR_MAXDebOk_C "" VALUE 0x8024102C Val_Wu16 65535.00 OneToOne 0.00 65535.00 FORMAT "%8.2" /end CHARACTERISTIC
/begin CHARACTERISTIC DDRC_DurDeb.Com_numComFrbd_335h_HVBAT_CHRG_CONTINUOUS_CURR_MAXDebDef_C "" VALUE 0x8024102E Val_Wu16 65535.00 OneToOne 0.00 65535.00 FORMAT "%8.2" /end CHARACTERISTIC
/begin CHARACTERISTIC DDRC_DurDeb.Com_numComFrbd_335h_HVBAT_CHRG_COTINUOUS_CURR_REQDebOk_C "" VALUE 0x80241030 Val_Wu16 65535.00 OneToOne 0.00 65535.00 FORMAT "%8.2" /end CHARACTERISTIC
/begin CHARACTERISTIC DDRC_DurDeb.Com_numComFrbd_335h_HVBAT_CHRG_COTINUOUS_CURR_REQDebDef_C "" VALUE 0x80241032 Val_Wu16 65535.00 OneToOne 0.00 65535.00 FORMAT "%8.2" /end CHARACTERISTIC
/begin CHARACTERISTIC DDRC_DurDeb.Com_numComFrbd_335h_HVBAT_CHRG_MAX_VOLTDebOk_C "" VALUE 0x80241034 Val_Wu16 65535.00 OneToOne 0.00 65535.00 FORMAT "%8.2" /end CHARACTERISTIC
/begin CHARACTERISTIC DDRC_DurDeb.Com_numComFrbd_335h_HVBAT_CHRG_MAX_VOLTDebDef_C "" VALUE 0x80241036 Val_Wu16 65535.00 OneToOne 0.00 65535.00 FORMAT "%8.2" /end CHARACTERISTIC
/begin CHARACTERISTIC DDRC_DurDeb.Com_numComFrbd_335h_HVBAT_DC_BUS_VOLTAGEDebOk_C "" VALUE 0x80241038 Val_Wu16 65535.00 OneToOne 0.00 65535.00 FORMAT "%8.2" /end CHARACTERISTIC
/begin CHARACTERISTIC DDRC_DurDeb.Com_numComFrbd_335h_HVBAT_DC_BUS_VOLTAGEDebDef_C "" VALUE 0x8024103A Val_Wu16 65535.00 OneToOne 0.00 65535.00 FORMAT "%8.2" /end CHARACTERISTIC
/begin CHARACTERISTIC DDRC_DurDeb.Com_numComFrbd_427h_INV_OP_MODEDebOk_C "" VALUE 0x8024103C Val_Wu16 65535.00 OneToOne 0.00 65535.00 FORMAT "%8.2" /end CHARACTERISTIC
/begin CHARACTERISTIC DDRC_DurDeb.Com_numComFrbd_427h_INV_OP_MODEDebDef_C "" VALUE 0x8024103E Val_Wu16 65535.00 OneToOne 0.00 65535.00 FORMAT "%8.2" /end CHARACTERISTIC
/begin CHARACTERISTIC DDRC_DurDeb.Com_numComFrbd_427h_INV_PERMISIBLE_TORQUEDebOk_C "" VALUE 0x80241040 Val_Wu16 65535.00 OneToOne 0.00 65535.00 FORMAT "%8.2" /end CHARACTERISTIC
/begin CHARACTERISTIC DDRC_DurDeb.Com_numComFrbd_427h_INV_PERMISIBLE_TORQUEDebDef_C "" VALUE 0x80241042 Val_Wu16 65535.00 OneToOne 0.00 65535.00 FORMAT "%8.2" /end CHARACTERISTIC
/begin CHARACTERISTIC DDRC_DurDeb.Com_numComFrbd_435h_HVBAT_MAX_CELL_VOLTDebOk_C "" VALUE 0x80241044 Val_Wu16 65535.00 OneToOne 0.00 65535.00 FORMAT "%8.2" /end CHARACTERISTIC
/begin CHARACTERISTIC DDRC_DurDeb.Com_numComFrbd_435h_HVBAT_MAX_CELL_VOLTDebDef_C "" VALUE 0x80241046 Val_Wu16 65535.00 OneToOne 0.00 65535.00 FORMAT "%8.2" /end CHARACTERISTIC
/begin CHARACTERISTIC DDRC_DurDeb.Com_numComFrbd_435h_HVBAT_MAX_CELL_VOLT_NUMDebOk_C "" VALUE 0x80241048 Val_Wu16 65535.00 OneToOne 0.00 65535.00 FORMAT "%8.2" /end CHARACTERISTIC
/begin CHARACTERISTIC DDRC_DurDeb.Com_numComFrbd_435h_HVBAT_MAX_CELL_VOLT_NUMDebDef_C "" VALUE 0x8024104A Val_Wu16 65535.00 OneToOne 0.00 65535.00 FORMAT "%8.2" /end CHARACTERISTIC
/begin CHARACTERISTIC DDRC_DurDeb.Com_numComFrbd_435h_HVBAT_MAX_SENSOR_TEMPDebOk_C "" VALUE 0x8024104C Val_Wu16 65535.00 OneToOne 0.00 65535.00 FORMAT "%8.2" /end CHARACTERISTIC
/begin CHARACTERISTIC DDRC_DurDeb.Com_numComFrbd_435h_HVBAT_MAX_SENSOR_TEMPDebDef_C "" VALUE 0x8024104E Val_Wu16 65535.00 OneToOne 0.00 65535.00 FORMAT "%8.2" /end CHARACTERISTIC
/begin CHARACTERISTIC DDRC_DurDeb.Com_numComFrbd_435h_HVBAT_MIN_CELL_VOLTDebOk_C "" VALUE 0x80241050 Val_Wu16 65535.00 OneToOne 0.00 65535.00 FORMAT "%8.2" /end CHARACTERISTIC
/begin CHARACTERISTIC DDRC_DurDeb.Com_numComFrbd_435h_HVBAT_MIN_CELL_VOLTDebDef_C "" VALUE 0x80241052 Val_Wu16 65535.00 OneToOne 0.00 65535.00 FORMAT "%8.2" /end CHARACTERISTIC
/begin CHARACTERISTIC DDRC_DurDeb.Com_numComFrbd_435h_HVBAT_MIN_CELL_VOLT_NUMDebOk_C "" VALUE 0x80241054 Val_Wu16 65535.00 OneToOne 0.00 65535.00 FORMAT "%8.2" /end CHARACTERISTIC
/begin CHARACTERISTIC DDRC_DurDeb.Com_numComFrbd_435h_HVBAT_MIN_CELL_VOLT_NUMDebDef_C "" VALUE 0x80241056 Val_Wu16 65535.00 OneToOne 0.00 65535.00 FORMAT "%8.2" /end CHARACTERISTIC
/begin CHARACTERISTIC DDRC_DurDeb.Com_numComFrbd_453h_OBC_IN_CURRENTDebOk_C "" VALUE 0x80241058 Val_Wu16 65535.00 OneToOne 0.00 65535.00 FORMAT "%8.2" /end CHARACTERISTIC
/begin CHARACTERISTIC DDRC_DurDeb.Com_numComFrbd_453h_OBC_IN_CURRENTDebDef_C "" VALUE 0x8024105A Val_Wu16 65535.00 OneToOne 0.00 65535.00 FORMAT "%8.2" /end CHARACTERISTIC
/begin CHARACTERISTIC DDRC_DurDeb.Com_numComFrbd_453h_OBC_IN_VOLTAGEDebOk_C "" VALUE 0x8024105C Val_Wu16 65535.00 OneToOne 0.00 65535.00 FORMAT "%8.2" /end CHARACTERISTIC
/begin CHARACTERISTIC DDRC_DurDeb.Com_numComFrbd_453h_OBC_IN_VOLTAGEDebDef_C "" VALUE 0x8024105E Val_Wu16 65535.00 OneToOne 0.00 65535.00 FORMAT "%8.2" /end CHARACTERISTIC
/begin CHARACTERISTIC DDRC_DurDeb.Com_numComFrbd_453h_OBC_IP_POWERDebOk_C "" VALUE 0x80241060 Val_Wu16 65535.00 OneToOne 0.00 65535.00 FORMAT "%8.2" /end CHARACTERISTIC
/begin CHARACTERISTIC DDRC_DurDeb.Com_numComFrbd_453h_OBC_IP_POWERDebDef_C "" VALUE 0x80241062 Val_Wu16 65535.00 OneToOne 0.00 65535.00 FORMAT "%8.2" /end CHARACTERISTIC
/begin CHARACTERISTIC DDRC_DurDeb.Com_numComFrbd_455h_HVBAT_NOMINAL_VOLTAGEDebOk_C "" VALUE 0x80241064 Val_Wu16 65535.00 OneToOne 0.00 65535.00 FORMAT "%8.2" /end CHARACTERISTIC
/begin CHARACTERISTIC DDRC_DurDeb.Com_numComFrbd_455h_HVBAT_NOMINAL_VOLTAGEDebDef_C "" VALUE 0x80241066 Val_Wu16 65535.00 OneToOne 0.00 65535.00 FORMAT "%8.2" /end CHARACTERISTIC
/begin CHARACTERISTIC DDRC_DurDeb.Com_numComFrbd_463h_OBC_OUT_CURRENTDebOk_C "" VALUE 0x80241068 Val_Wu16 65535.00 OneToOne 0.00 65535.00 FORMAT "%8.2" /end CHARACTERISTIC
/begin CHARACTERISTIC DDRC_DurDeb.Com_numComFrbd_463h_OBC_OUT_CURRENTDebDef_C "" VALUE 0x8024106A Val_Wu16 65535.00 OneToOne 0.00 65535.00 FORMAT "%8.2" /end CHARACTERISTIC
/begin CHARACTERISTIC DDRC_DurDeb.Com_numComFrbd_463h_OBC_OUT_VOLTAGEDebOk_C "" VALUE 0x8024106C Val_Wu16 65535.00 OneToOne 0.00 65535.00 FORMAT "%8.2" /end CHARACTERISTIC
/begin CHARACTERISTIC DDRC_DurDeb.Com_numComFrbd_463h_OBC_OUT_VOLTAGEDebDef_C "" VALUE 0x8024106E Val_Wu16 65535.00 OneToOne 0.00 65535.00 FORMAT "%8.2" /end CHARACTERISTIC
/begin CHARACTERISTIC DDRC_DurDeb.Com_numComFrbd_463h_OBC_TEMPERATUREDebOk_C "" VALUE 0x80241070 Val_Wu16 65535.00 OneToOne 0.00 65535.00 FORMAT "%8.2" /end CHARACTERISTIC
/begin CHARACTERISTIC DDRC_DurDeb.Com_numComFrbd_463h_OBC_TEMPERATUREDebDef_C "" VALUE 0x80241072 Val_Wu16 65535.00 OneToOne 0.00 65535.00 FORMAT "%8.2" /end CHARACTERISTIC
/begin CHARACTERISTIC DDRC_DurDeb.Com_numComFrbd_473h_DCDC_Coolant_TemperatureDebOk_C "" VALUE 0x80241074 Val_Wu16 65535.00 OneToOne 0.00 65535.00 FORMAT "%8.2" /end CHARACTERISTIC
/begin CHARACTERISTIC DDRC_DurDeb.Com_numComFrbd_473h_DCDC_Coolant_TemperatureDebDef_C "" VALUE 0x80241076 Val_Wu16 65535.00 OneToOne 0.00 65535.00 FORMAT "%8.2" /end CHARACTERISTIC
/begin CHARACTERISTIC DDRC_DurDeb.Com_numComFrbd_473h_DCDC_TEMPERATUREDebOk_C "" VALUE 0x80241078 Val_Wu16 65535.00 OneToOne 0.00 65535.00 FORMAT "%8.2" /end CHARACTERISTIC
/begin CHARACTERISTIC DDRC_DurDeb.Com_numComFrbd_473h_DCDC_TEMPERATUREDebDef_C "" VALUE 0x8024107A Val_Wu16 65535.00 OneToOne 0.00 65535.00 FORMAT "%8.2" /end CHARACTERISTIC
/begin CHARACTERISTIC DDRC_DurDeb.Com_numComFrbd_47Bh_eCOMP_BusBarCurrentDebOk_C "" VALUE 0x8024107C Val_Wu16 65535.00 OneToOne 0.00 65535.00 FORMAT "%8.2" /end CHARACTERISTIC
/begin CHARACTERISTIC DDRC_DurDeb.Com_numComFrbd_47Bh_eCOMP_BusBarCurrentDebDef_C "" VALUE 0x8024107E Val_Wu16 65535.00 OneToOne 0.00 65535.00 FORMAT "%8.2" /end CHARACTERISTIC
/begin CHARACTERISTIC DDRC_DurDeb.Com_numComFrbd_47Bh_eCOMP_BusBarVoltageDebOk_C "" VALUE 0x80241080 Val_Wu16 65535.00 OneToOne 0.00 65535.00 FORMAT "%8.2" /end CHARACTERISTIC
/begin CHARACTERISTIC DDRC_DurDeb.Com_numComFrbd_47Bh_eCOMP_BusBarVoltageDebDef_C "" VALUE 0x80241082 Val_Wu16 65535.00 OneToOne 0.00 65535.00 FORMAT "%8.2" /end CHARACTERISTIC
/begin CHARACTERISTIC DDRC_DurDeb.Com_numComFrbd_47Bh_eCOMP_CompressorSpeedDebOk_C "" VALUE 0x80241084 Val_Wu16 65535.00 OneToOne 0.00 65535.00 FORMAT "%8.2" /end CHARACTERISTIC
/begin CHARACTERISTIC DDRC_DurDeb.Com_numComFrbd_47Bh_eCOMP_CompressorSpeedDebDef_C "" VALUE 0x80241086 Val_Wu16 65535.00 OneToOne 0.00 65535.00 FORMAT "%8.2" /end CHARACTERISTIC
/begin CHARACTERISTIC DDRC_DurDeb.Com_numComFrbd_47Bh_eCOMP_IGBT_TempDebOk_C "" VALUE 0x80241088 Val_Wu16 65535.00 OneToOne 0.00 65535.00 FORMAT "%8.2" /end CHARACTERISTIC
/begin CHARACTERISTIC DDRC_DurDeb.Com_numComFrbd_47Bh_eCOMP_IGBT_TempDebDef_C "" VALUE 0x8024108A Val_Wu16 65535.00 OneToOne 0.00 65535.00 FORMAT "%8.2" /end CHARACTERISTIC
/begin CHARACTERISTIC DDRC_DurDeb.Com_numComFrbd_47Bh_eCOMP_PeakPhaCurrentDebOk_C "" VALUE 0x8024108C Val_Wu16 65535.00 OneToOne 0.00 65535.00 FORMAT "%8.2" /end CHARACTERISTIC
/begin CHARACTERISTIC DDRC_DurDeb.Com_numComFrbd_47Bh_eCOMP_PeakPhaCurrentDebDef_C "" VALUE 0x8024108E Val_Wu16 65535.00 OneToOne 0.00 65535.00 FORMAT "%8.2" /end CHARACTERISTIC
/begin CHARACTERISTIC DDRC_DurDeb.Com_numComFrbd_47Bh_eCOMP_Power_consumptionDebOk_C "" VALUE 0x80241090 Val_Wu16 65535.00 OneToOne 0.00 65535.00 FORMAT "%8.2" /end CHARACTERISTIC
/begin CHARACTERISTIC DDRC_DurDeb.Com_numComFrbd_47Bh_eCOMP_Power_consumptionDebDef_C "" VALUE 0x80241092 Val_Wu16 65535.00 OneToOne 0.00 65535.00 FORMAT "%8.2" /end CHARACTERISTIC
/begin CHARACTERISTIC DDRC_DurDeb.Com_numComFrbd_48Bh_eCOMP_Fault_LevelDebOk_C "" VALUE 0x80241094 Val_Wu16 65535.00 OneToOne 0.00 65535.00 FORMAT "%8.2" /end CHARACTERISTIC
/begin CHARACTERISTIC DDRC_DurDeb.Com_numComFrbd_48Bh_eCOMP_Fault_LevelDebDef_C "" VALUE 0x80241096 Val_Wu16 65535.00 OneToOne 0.00 65535.00 FORMAT "%8.2" /end CHARACTERISTIC
/begin CHARACTERISTIC DDRC_DurDeb.Com_numComFrbd_4F2h_VALEUR_SOC_ETENDUEDebOk_C "" VALUE 0x80241098 Val_Wu16 65535.00 OneToOne 0.00 65535.00 FORMAT "%8.2" /end CHARACTERISTIC
/begin CHARACTERISTIC DDRC_DurDeb.Com_numComFrbd_4F2h_VALEUR_SOC_ETENDUEDebDef_C "" VALUE 0x8024109A Val_Wu16 65535.00 OneToOne 0.00 65535.00 FORMAT "%8.2" /end CHARACTERISTIC
/begin CHARACTERISTIC DDRC_DurDeb.Com_numComFrbd_535h_HV_BATT_TEMP_AVGDebOk_C "" VALUE 0x8024109C Val_Wu16 65535.00 OneToOne 0.00 65535.00 FORMAT "%8.2" /end CHARACTERISTIC
/begin CHARACTERISTIC DDRC_DurDeb.Com_numComFrbd_535h_HV_BATT_TEMP_AVGDebDef_C "" VALUE 0x8024109E Val_Wu16 65535.00 OneToOne 0.00 65535.00 FORMAT "%8.2" /end CHARACTERISTIC
/begin CHARACTERISTIC DDRC_DurDeb.Com_numComFrbd_543h_HVBAT_RESTBATTENERGYDebOk_C "" VALUE 0x802410A0 Val_Wu16 65535.00 OneToOne 0.00 65535.00 FORMAT "%8.2" /end CHARACTERISTIC
/begin CHARACTERISTIC DDRC_DurDeb.Com_numComFrbd_543h_HVBAT_RESTBATTENERGYDebDef_C "" VALUE 0x802410A2 Val_Wu16 65535.00 OneToOne 0.00 65535.00 FORMAT "%8.2" /end CHARACTERISTIC
/begin CHARACTERISTIC DDRC_DurDeb.Com_numComFrbd_543h_HVBAT_SOHDebOk_C "" VALUE 0x802410A4 Val_Wu16 65535.00 OneToOne 0.00 65535.00 FORMAT "%8.2" /end CHARACTERISTIC
/begin CHARACTERISTIC DDRC_DurDeb.Com_numComFrbd_543h_HVBAT_SOHDebDef_C "" VALUE 0x802410A6 Val_Wu16 65535.00 OneToOne 0.00 65535.00 FORMAT "%8.2" /end CHARACTERISTIC
/begin CHARACTERISTIC DDRC_DurDeb.Com_numComFrbd_543h_HV_BATT_SOH_RESDebOk_C "" VALUE 0x802410A8 Val_Wu16 65535.00 OneToOne 0.00 65535.00 FORMAT "%8.2" /end CHARACTERISTIC
/begin CHARACTERISTIC DDRC_DurDeb.Com_numComFrbd_543h_HV_BATT_SOH_RESDebDef_C "" VALUE 0x802410AA Val_Wu16 65535.00 OneToOne 0.00 65535.00 FORMAT "%8.2" /end CHARACTERISTIC
/begin CHARACTERISTIC DDRC_DurDeb.Com_numComFrbd_592h_IBATT_1DebOk_C "" VALUE 0x802410AC Val_Wu16 65535.00 OneToOne 0.00 65535.00 FORMAT "%8.2" /end CHARACTERISTIC
/begin CHARACTERISTIC DDRC_DurDeb.Com_numComFrbd_592h_IBATT_1DebDef_C "" VALUE 0x802410AE Val_Wu16 65535.00 OneToOne 0.00 65535.00 FORMAT "%8.2" /end CHARACTERISTIC
/begin CHARACTERISTIC DDRC_DurDeb.Com_numComFrbd_592h_IBATT_2DebOk_C "" VALUE 0x802410B0 Val_Wu16 65535.00 OneToOne 0.00 65535.00 FORMAT "%8.2" /end CHARACTERISTIC
/begin CHARACTERISTIC DDRC_DurDeb.Com_numComFrbd_592h_IBATT_2DebDef_C "" VALUE 0x802410B2 Val_Wu16 65535.00 OneToOne 0.00 65535.00 FORMAT "%8.2" /end CHARACTERISTIC
/begin CHARACTERISTIC DDRC_DurDeb.Com_numComFrbd_592h_IBATT_3DebOk_C "" VALUE 0x802410B4 Val_Wu16 65535.00 OneToOne 0.00 65535.00 FORMAT "%8.2" /end CHARACTERISTIC
/begin CHARACTERISTIC DDRC_DurDeb.Com_numComFrbd_592h_IBATT_3DebDef_C "" VALUE 0x802410B6 Val_Wu16 65535.00 OneToOne 0.00 65535.00 FORMAT "%8.2" /end CHARACTERISTIC
/begin CHARACTERISTIC DDRC_DurDeb.Com_numComFrbd_592h_TEMP_BATTDebOk_C "" VALUE 0x802410B8 Val_Wu16 65535.00 OneToOne 0.00 65535.00 FORMAT "%8.2" /end CHARACTERISTIC
/begin CHARACTERISTIC DDRC_DurDeb.Com_numComFrbd_592h_TEMP_BATTDebDef_C "" VALUE 0x802410BA Val_Wu16 65535.00 OneToOne 0.00 65535.00 FORMAT "%8.2" /end CHARACTERISTIC
/begin CHARACTERISTIC DDRC_DurDeb.Com_numComFrbd_592h_U_BATT_BECBDebOk_C "" VALUE 0x802410BC Val_Wu16 65535.00 OneToOne 0.00 65535.00 FORMAT "%8.2" /end CHARACTERISTIC
/begin CHARACTERISTIC DDRC_DurDeb.Com_numComFrbd_592h_U_BATT_BECBDebDef_C "" VALUE 0x802410BE Val_Wu16 65535.00 OneToOne 0.00 65535.00 FORMAT "%8.2" /end CHARACTERISTIC
/begin CHARACTERISTIC DDRC_DurDeb.Com_numComFrbd_595h_HVBAT_TIME_TO_CHRG_80DebOk_C "" VALUE 0x802410C0 Val_Wu16 65535.00 OneToOne 0.00 65535.00 FORMAT "%8.2" /end CHARACTERISTIC
/begin CHARACTERISTIC DDRC_DurDeb.Com_numComFrbd_595h_HVBAT_TIME_TO_CHRG_80DebDef_C "" VALUE 0x802410C2 Val_Wu16 65535.00 OneToOne 0.00 65535.00 FORMAT "%8.2" /end CHARACTERISTIC
/begin CHARACTERISTIC DDRC_DurDeb.Com_numComFrbd_5B2h_TEMP_AIR_EXTDebOk_C "" VALUE 0x802410C4 Val_Wu16 65535.00 OneToOne 0.00 65535.00 FORMAT "%8.2" /end CHARACTERISTIC
/begin CHARACTERISTIC DDRC_DurDeb.Com_numComFrbd_5B2h_TEMP_AIR_EXTDebDef_C "" VALUE 0x802410C6 Val_Wu16 65535.00 OneToOne 0.00 65535.00 FORMAT "%8.2" /end CHARACTERISTIC
/begin CHARACTERISTIC DDRC_DurDeb.Com_numComFrbd_635h_HVBAT_NEG_CONT_COUNT_SEG1DebOk_C "" VALUE 0x802410C8 Val_Wu16 65535.00 OneToOne 0.00 65535.00 FORMAT "%8.2" /end CHARACTERISTIC
/begin CHARACTERISTIC DDRC_DurDeb.Com_numComFrbd_635h_HVBAT_NEG_CONT_COUNT_SEG1DebDef_C "" VALUE 0x802410CA Val_Wu16 65535.00 OneToOne 0.00 65535.00 FORMAT "%8.2" /end CHARACTERISTIC
/begin CHARACTERISTIC DDRC_DurDeb.Com_numComFrbd_635h_HVBAT_NEG_CONT_COUNT_SEG3DebOk_C "" VALUE 0x802410CC Val_Wu16 65535.00 OneToOne 0.00 65535.00 FORMAT "%8.2" /end CHARACTERISTIC
/begin CHARACTERISTIC DDRC_DurDeb.Com_numComFrbd_635h_HVBAT_NEG_CONT_COUNT_SEG3DebDef_C "" VALUE 0x802410CE Val_Wu16 65535.00 OneToOne 0.00 65535.00 FORMAT "%8.2" /end CHARACTERISTIC
/begin CHARACTERISTIC DDRC_DurDeb.Com_numComFrbd_635h_HVBAT_NEG_CONT_COUNT_SEG4DebOk_C "" VALUE 0x802410D0 Val_Wu16 65535.00 OneToOne 0.00 65535.00 FORMAT "%8.2" /end CHARACTERISTIC
/begin CHARACTERISTIC DDRC_DurDeb.Com_numComFrbd_635h_HVBAT_NEG_CONT_COUNT_SEG4DebDef_C "" VALUE 0x802410D2 Val_Wu16 65535.00 OneToOne 0.00 65535.00 FORMAT "%8.2" /end CHARACTERISTIC
/begin CHARACTERISTIC DDRC_DurDeb.Com_numComFrbd_635h_HVBAT_PST_CONT_COUNT_SEG1DebOk_C "" VALUE 0x802410D4 Val_Wu16 65535.00 OneToOne 0.00 65535.00 FORMAT "%8.2" /end CHARACTERISTIC
/begin CHARACTERISTIC DDRC_DurDeb.Com_numComFrbd_635h_HVBAT_PST_CONT_COUNT_SEG1DebDef_C "" VALUE 0x802410D6 Val_Wu16 65535.00 OneToOne 0.00 65535.00 FORMAT "%8.2" /end CHARACTERISTIC
/begin CHARACTERISTIC DDRC_DurDeb.Com_numComFrbd_635h_HVBAT_PST_CONT_COUNT_SEG3DebOk_C "" VALUE 0x802410D8 Val_Wu16 65535.00 OneToOne 0.00 65535.00 FORMAT "%8.2" /end CHARACTERISTIC
/begin CHARACTERISTIC DDRC_DurDeb.Com_numComFrbd_635h_HVBAT_PST_CONT_COUNT_SEG3DebDef_C "" VALUE 0x802410DA Val_Wu16 65535.00 OneToOne 0.00 65535.00 FORMAT "%8.2" /end CHARACTERISTIC
/begin CHARACTERISTIC DDRC_DurDeb.Com_numComFrbd_635h_HVBAT_PST_CONT_COUNT_SEG4DebOk_C "" VALUE 0x802410DC Val_Wu16 65535.00 OneToOne 0.00 65535.00 FORMAT "%8.2" /end CHARACTERISTIC
/begin CHARACTERISTIC DDRC_DurDeb.Com_numComFrbd_635h_HVBAT_PST_CONT_COUNT_SEG4DebDef_C "" VALUE 0x802410DE Val_Wu16 65535.00 OneToOne 0.00 65535.00 FORMAT "%8.2" /end CHARACTERISTIC
/begin CHARACTERISTIC DDRC_DurDeb.Com_numComFrbd_645h_HVBAT_PRECHRGE_CONT_COUNT_SEG1DebOk_C "" VALUE 0x802410E0 Val_Wu16 65535.00 OneToOne 0.00 65535.00 FORMAT "%8.2" /end CHARACTERISTIC
/begin CHARACTERISTIC DDRC_DurDeb.Com_numComFrbd_645h_HVBAT_PRECHRGE_CONT_COUNT_SEG1DebDef_C "" VALUE 0x802410E2 Val_Wu16 65535.00 OneToOne 0.00 65535.00 FORMAT "%8.2" /end CHARACTERISTIC
/begin CHARACTERISTIC DDRC_DurDeb.Com_numComFrbd_645h_HVBAT_PRECHRGE_CONT_COUNT_SEG2DebOk_C "" VALUE 0x802410E4 Val_Wu16 65535.00 OneToOne 0.00 65535.00 FORMAT "%8.2" /end CHARACTERISTIC
/begin CHARACTERISTIC DDRC_DurDeb.Com_numComFrbd_645h_HVBAT_PRECHRGE_CONT_COUNT_SEG2DebDef_C "" VALUE 0x802410E6 Val_Wu16 65535.00 OneToOne 0.00 65535.00 FORMAT "%8.2" /end CHARACTERISTIC
/begin CHARACTERISTIC DDRC_DurDeb.Com_numComFrbd_675h_HVBAT_REMAININGBATTCAPACITYDebOk_C "" VALUE 0x802410E8 Val_Wu16 65535.00 OneToOne 0.00 65535.00 FORMAT "%8.2" /end CHARACTERISTIC
/begin CHARACTERISTIC DDRC_DurDeb.Com_numComFrbd_675h_HVBAT_REMAININGBATTCAPACITYDebDef_C "" VALUE 0x802410EA Val_Wu16 65535.00 OneToOne 0.00 65535.00 FORMAT "%8.2" /end CHARACTERISTIC
/begin CHARACTERISTIC DDRC_DurDeb.Com_numComInvld_205h_HVBAT_CHARGING_STATUSDebOk_C "" VALUE 0x802410EC Val_Wu16 65535.00 OneToOne 0.00 65535.00 FORMAT "%8.2" /end CHARACTERISTIC
/begin CHARACTERISTIC DDRC_DurDeb.Com_numComInvld_205h_HVBAT_CHARGING_STATUSDebDef_C "" VALUE 0x802410EE Val_Wu16 65535.00 OneToOne 0.00 65535.00 FORMAT "%8.2" /end CHARACTERISTIC
/begin CHARACTERISTIC DDRC_DurDeb.Com_numComInvld_205h_HVBAT_PACK_CURRENTDebOk_C "" VALUE 0x802410F0 Val_Wu16 65535.00 OneToOne 0.00 65535.00 FORMAT "%8.2" /end CHARACTERISTIC
/begin CHARACTERISTIC DDRC_DurDeb.Com_numComInvld_205h_HVBAT_PACK_CURRENTDebDef_C "" VALUE 0x802410F2 Val_Wu16 65535.00 OneToOne 0.00 65535.00 FORMAT "%8.2" /end CHARACTERISTIC
/begin CHARACTERISTIC DDRC_DurDeb.Com_numComInvld_205h_HVBAT_SOC_DISPLAYDebOk_C "" VALUE 0x802410F4 Val_Wu16 65535.00 OneToOne 0.00 65535.00 FORMAT "%8.2" /end CHARACTERISTIC
/begin CHARACTERISTIC DDRC_DurDeb.Com_numComInvld_205h_HVBAT_SOC_DISPLAYDebDef_C "" VALUE 0x802410F6 Val_Wu16 65535.00 OneToOne 0.00 65535.00 FORMAT "%8.2" /end CHARACTERISTIC
/begin CHARACTERISTIC DDRC_DurDeb.Com_numComInvld_205h_HVBAT_VOLTAGEDebOk_C "" VALUE 0x802410F8 Val_Wu16 65535.00 OneToOne 0.00 65535.00 FORMAT "%8.2" /end CHARACTERISTIC
/begin CHARACTERISTIC DDRC_DurDeb.Com_numComInvld_205h_HVBAT_VOLTAGEDebDef_C "" VALUE 0x802410FA Val_Wu16 65535.00 OneToOne 0.00 65535.00 FORMAT "%8.2" /end CHARACTERISTIC
/begin CHARACTERISTIC DDRC_DurDeb.Com_numComInvld_217h_INV_DC_BUS_VOLTAGEDebOk_C "" VALUE 0x802410FC Val_Wu16 65535.00 OneToOne 0.00 65535.00 FORMAT "%8.2" /end CHARACTERISTIC
/begin CHARACTERISTIC DDRC_DurDeb.Com_numComInvld_217h_INV_DC_BUS_VOLTAGEDebDef_C "" VALUE 0x802410FE Val_Wu16 65535.00 OneToOne 0.00 65535.00 FORMAT "%8.2" /end CHARACTERISTIC
/begin CHARACTERISTIC DDRC_DurDeb.Com_numComInvld_217h_INV_MTR_ACTUAL_TRQDebOk_C "" VALUE 0x80241100 Val_Wu16 65535.00 OneToOne 0.00 65535.00 FORMAT "%8.2" /end CHARACTERISTIC
/begin CHARACTERISTIC DDRC_DurDeb.Com_numComInvld_217h_INV_MTR_ACTUAL_TRQDebDef_C "" VALUE 0x80241102 Val_Wu16 65535.00 OneToOne 0.00 65535.00 FORMAT "%8.2" /end CHARACTERISTIC
/begin CHARACTERISTIC DDRC_DurDeb.Com_numComInvld_217h_INV_MTR_SPEEDDebOk_C "" VALUE 0x80241104 Val_Wu16 65535.00 OneToOne 0.00 65535.00 FORMAT "%8.2" /end CHARACTERISTIC
/begin CHARACTERISTIC DDRC_DurDeb.Com_numComInvld_217h_INV_MTR_SPEEDDebDef_C "" VALUE 0x80241106 Val_Wu16 65535.00 OneToOne 0.00 65535.00 FORMAT "%8.2" /end CHARACTERISTIC
/begin CHARACTERISTIC DDRC_DurDeb.Com_numComInvld_217h_INV_MTR_TRQDebOk_C "" VALUE 0x80241108 Val_Wu16 65535.00 OneToOne 0.00 65535.00 FORMAT "%8.2" /end CHARACTERISTIC
/begin CHARACTERISTIC DDRC_DurDeb.Com_numComInvld_217h_INV_MTR_TRQDebDef_C "" VALUE 0x8024110A Val_Wu16 65535.00 OneToOne 0.00 65535.00 FORMAT "%8.2" /end CHARACTERISTIC
/begin CHARACTERISTIC DDRC_DurDeb.Com_numComInvld_227h_INV_DC_CURRENTDebOk_C "" VALUE 0x8024110C Val_Wu16 65535.00 OneToOne 0.00 65535.00 FORMAT "%8.2" /end CHARACTERISTIC
/begin CHARACTERISTIC DDRC_DurDeb.Com_numComInvld_227h_INV_DC_CURRENTDebDef_C "" VALUE 0x8024110E Val_Wu16 65535.00 OneToOne 0.00 65535.00 FORMAT "%8.2" /end CHARACTERISTIC
/begin CHARACTERISTIC DDRC_DurDeb.Com_numComInvld_227h_INV_MOTORING_PEAK_TRQDebOk_C "" VALUE 0x80241110 Val_Wu16 65535.00 OneToOne 0.00 65535.00 FORMAT "%8.2" /end CHARACTERISTIC
/begin CHARACTERISTIC DDRC_DurDeb.Com_numComInvld_227h_INV_MOTORING_PEAK_TRQDebDef_C "" VALUE 0x80241112 Val_Wu16 65535.00 OneToOne 0.00 65535.00 FORMAT "%8.2" /end CHARACTERISTIC
/begin CHARACTERISTIC DDRC_DurDeb.Com_numComInvld_227h_INV_MTR_INST_INPUT_POWERDebOk_C "" VALUE 0x80241114 Val_Wu16 65535.00 OneToOne 0.00 65535.00 FORMAT "%8.2" /end CHARACTERISTIC
/begin CHARACTERISTIC DDRC_DurDeb.Com_numComInvld_227h_INV_MTR_INST_INPUT_POWERDebDef_C "" VALUE 0x80241116 Val_Wu16 65535.00 OneToOne 0.00 65535.00 FORMAT "%8.2" /end CHARACTERISTIC
/begin CHARACTERISTIC DDRC_DurDeb.Com_numComInvld_227h_INV_REGEN_PEAK_TRQDebOk_C "" VALUE 0x80241118 Val_Wu16 65535.00 OneToOne 0.00 65535.00 FORMAT "%8.2" /end CHARACTERISTIC
/begin CHARACTERISTIC DDRC_DurDeb.Com_numComInvld_227h_INV_REGEN_PEAK_TRQDebDef_C "" VALUE 0x8024111A Val_Wu16 65535.00 OneToOne 0.00 65535.00 FORMAT "%8.2" /end CHARACTERISTIC
/begin CHARACTERISTIC DDRC_DurDeb.Com_numComInvld_237h_INV_ACTIVE_DISCHARGE_STATUSDebOk_C "" VALUE 0x8024111C Val_Wu16 65535.00 OneToOne 0.00 65535.00 FORMAT "%8.2" /end CHARACTERISTIC
/begin CHARACTERISTIC DDRC_DurDeb.Com_numComInvld_237h_INV_ACTIVE_DISCHARGE_STATUSDebDef_C "" VALUE 0x8024111E Val_Wu16 65535.00 OneToOne 0.00 65535.00 FORMAT "%8.2" /end CHARACTERISTIC
/begin CHARACTERISTIC DDRC_DurDeb.Com_numComInvld_237h_INV_FAULT_LEVELDebOk_C "" VALUE 0x80241120 Val_Wu16 65535.00 OneToOne 0.00 65535.00 FORMAT "%8.2" /end CHARACTERISTIC
/begin CHARACTERISTIC DDRC_DurDeb.Com_numComInvld_237h_INV_FAULT_LEVELDebDef_C "" VALUE 0x80241122 Val_Wu16 65535.00 OneToOne 0.00 65535.00 FORMAT "%8.2" /end CHARACTERISTIC
/begin CHARACTERISTIC DDRC_DurDeb.Com_numComInvld_237h_INV_STAB_MIN_TRQDebOk_C "" VALUE 0x80241124 Val_Wu16 65535.00 OneToOne 0.00 65535.00 FORMAT "%8.2" /end CHARACTERISTIC
/begin CHARACTERISTIC DDRC_DurDeb.Com_numComInvld_237h_INV_STAB_MIN_TRQDebDef_C "" VALUE 0x80241126 Val_Wu16 65535.00 OneToOne 0.00 65535.00 FORMAT "%8.2" /end CHARACTERISTIC
/begin CHARACTERISTIC DDRC_DurDeb.Com_numComInvld_259h_TGLM_MODE_PUSHDebOk_C "" VALUE 0x80241128 Val_Wu16 65535.00 OneToOne 0.00 65535.00 FORMAT "%8.2" /end CHARACTERISTIC
/begin CHARACTERISTIC DDRC_DurDeb.Com_numComInvld_259h_TGLM_MODE_PUSHDebDef_C "" VALUE 0x8024112A Val_Wu16 65535.00 OneToOne 0.00 65535.00 FORMAT "%8.2" /end CHARACTERISTIC
/begin CHARACTERISTIC DDRC_DurDeb.Com_numComInvld_259h_TOGGLE_MONOSTABLE_POSDebOk_C "" VALUE 0x8024112C Val_Wu16 65535.00 OneToOne 0.00 65535.00 FORMAT "%8.2" /end CHARACTERISTIC
/begin CHARACTERISTIC DDRC_DurDeb.Com_numComInvld_259h_TOGGLE_MONOSTABLE_POSDebDef_C "" VALUE 0x8024112E Val_Wu16 65535.00 OneToOne 0.00 65535.00 FORMAT "%8.2" /end CHARACTERISTIC
/begin CHARACTERISTIC DDRC_DurDeb.Com_numComInvld_273h_OBC_FAULT_LEVELDebOk_C "" VALUE 0x80241130 Val_Wu16 65535.00 OneToOne 0.00 65535.00 FORMAT "%8.2" /end CHARACTERISTIC
/begin CHARACTERISTIC DDRC_DurDeb.Com_numComInvld_273h_OBC_FAULT_LEVELDebDef_C "" VALUE 0x80241132 Val_Wu16 65535.00 OneToOne 0.00 65535.00 FORMAT "%8.2" /end CHARACTERISTIC
/begin CHARACTERISTIC DDRC_DurDeb.Com_numComInvld_273h_OBC_outputpower_capabilityDebOk_C "" VALUE 0x80241134 Val_Wu16 65535.00 OneToOne 0.00 65535.00 FORMAT "%8.2" /end CHARACTERISTIC
/begin CHARACTERISTIC DDRC_DurDeb.Com_numComInvld_273h_OBC_outputpower_capabilityDebDef_C "" VALUE 0x80241136 Val_Wu16 65535.00 OneToOne 0.00 65535.00 FORMAT "%8.2" /end CHARACTERISTIC
/begin CHARACTERISTIC DDRC_DurDeb.Com_numComInvld_275h_HVBAT_DISCHARGE_30S_AVAILABLE_CURRENTDebOk_C "" VALUE 0x80241138 Val_Wu16 65535.00 OneToOne 0.00 65535.00 FORMAT "%8.2" /end CHARACTERISTIC
/begin CHARACTERISTIC DDRC_DurDeb.Com_numComInvld_275h_HVBAT_DISCHARGE_30S_AVAILABLE_CURRENTDebDef_C "" VALUE 0x8024113A Val_Wu16 65535.00 OneToOne 0.00 65535.00 FORMAT "%8.2" /end CHARACTERISTIC
/begin CHARACTERISTIC DDRC_DurDeb.Com_numComInvld_275h_HVBAT_DISCHARGE_30S_AVAILABLE_POWERDebOk_C "" VALUE 0x8024113C Val_Wu16 65535.00 OneToOne 0.00 65535.00 FORMAT "%8.2" /end CHARACTERISTIC
/begin CHARACTERISTIC DDRC_DurDeb.Com_numComInvld_275h_HVBAT_DISCHARGE_30S_AVAILABLE_POWERDebDef_C "" VALUE 0x8024113E Val_Wu16 65535.00 OneToOne 0.00 65535.00 FORMAT "%8.2" /end CHARACTERISTIC
/begin CHARACTERISTIC DDRC_DurDeb.Com_numComInvld_283h_DCDC_IN_CURRENTDebOk_C "" VALUE 0x80241140 Val_Wu16 65535.00 OneToOne 0.00 65535.00 FORMAT "%8.2" /end CHARACTERISTIC
/begin CHARACTERISTIC DDRC_DurDeb.Com_numComInvld_283h_DCDC_IN_CURRENTDebDef_C "" VALUE 0x80241142 Val_Wu16 65535.00 OneToOne 0.00 65535.00 FORMAT "%8.2" /end CHARACTERISTIC
/begin CHARACTERISTIC DDRC_DurDeb.Com_numComInvld_283h_DCDC_IN_VOLTAGEDebOk_C "" VALUE 0x80241144 Val_Wu16 65535.00 OneToOne 0.00 65535.00 FORMAT "%8.2" /end CHARACTERISTIC
/begin CHARACTERISTIC DDRC_DurDeb.Com_numComInvld_283h_DCDC_IN_VOLTAGEDebDef_C "" VALUE 0x80241146 Val_Wu16 65535.00 OneToOne 0.00 65535.00 FORMAT "%8.2" /end CHARACTERISTIC
/begin CHARACTERISTIC DDRC_DurDeb.Com_numComInvld_283h_DCDC_OUT_CURRENTDebOk_C "" VALUE 0x80241148 Val_Wu16 65535.00 OneToOne 0.00 65535.00 FORMAT "%8.2" /end CHARACTERISTIC
/begin CHARACTERISTIC DDRC_DurDeb.Com_numComInvld_283h_DCDC_OUT_CURRENTDebDef_C "" VALUE 0x8024114A Val_Wu16 65535.00 OneToOne 0.00 65535.00 FORMAT "%8.2" /end CHARACTERISTIC
/begin CHARACTERISTIC DDRC_DurDeb.Com_numComInvld_283h_DCDC_OUT_VOLTAGEDebOk_C "" VALUE 0x8024114C Val_Wu16 65535.00 OneToOne 0.00 65535.00 FORMAT "%8.2" /end CHARACTERISTIC
/begin CHARACTERISTIC DDRC_DurDeb.Com_numComInvld_283h_DCDC_OUT_VOLTAGEDebDef_C "" VALUE 0x8024114E Val_Wu16 65535.00 OneToOne 0.00 65535.00 FORMAT "%8.2" /end CHARACTERISTIC
/begin CHARACTERISTIC DDRC_DurDeb.Com_numComInvld_285h_HVBAT_REGEN_CHG_30S_CURRENT_LIMITDebOk_C "" VALUE 0x80241150 Val_Wu16 65535.00 OneToOne 0.00 65535.00 FORMAT "%8.2" /end CHARACTERISTIC
/begin CHARACTERISTIC DDRC_DurDeb.Com_numComInvld_285h_HVBAT_REGEN_CHG_30S_CURRENT_LIMITDebDef_C "" VALUE 0x80241152 Val_Wu16 65535.00 OneToOne 0.00 65535.00 FORMAT "%8.2" /end CHARACTERISTIC
/begin CHARACTERISTIC DDRC_DurDeb.Com_numComInvld_285h_HVBAT_REGEN_CHRG_30S_POWER_LIMITDebOk_C "" VALUE 0x80241154 Val_Wu16 65535.00 OneToOne 0.00 65535.00 FORMAT "%8.2" /end CHARACTERISTIC
/begin CHARACTERISTIC DDRC_DurDeb.Com_numComInvld_285h_HVBAT_REGEN_CHRG_30S_POWER_LIMITDebDef_C "" VALUE 0x80241156 Val_Wu16 65535.00 OneToOne 0.00 65535.00 FORMAT "%8.2" /end CHARACTERISTIC
/begin CHARACTERISTIC DDRC_DurDeb.Com_numComInvld_293h_DCDC_FAULT_LEVELDebOk_C "" VALUE 0x80241158 Val_Wu16 65535.00 OneToOne 0.00 65535.00 FORMAT "%8.2" /end CHARACTERISTIC
/begin CHARACTERISTIC DDRC_DurDeb.Com_numComInvld_293h_DCDC_FAULT_LEVELDebDef_C "" VALUE 0x8024115A Val_Wu16 65535.00 OneToOne 0.00 65535.00 FORMAT "%8.2" /end CHARACTERISTIC
/begin CHARACTERISTIC DDRC_DurDeb.Com_numComInvld_293h_DCDC_outputpower_capabilityDebOk_C "" VALUE 0x8024115C Val_Wu16 65535.00 OneToOne 0.00 65535.00 FORMAT "%8.2" /end CHARACTERISTIC
/begin CHARACTERISTIC DDRC_DurDeb.Com_numComInvld_293h_DCDC_outputpower_capabilityDebDef_C "" VALUE 0x8024115E Val_Wu16 65535.00 OneToOne 0.00 65535.00 FORMAT "%8.2" /end CHARACTERISTIC
/begin CHARACTERISTIC DDRC_DurDeb.Com_numComInvld_325h_HVBAT_EPLUG_STATUSDebOk_C "" VALUE 0x80241160 Val_Wu16 65535.00 OneToOne 0.00 65535.00 FORMAT "%8.2" /end CHARACTERISTIC
/begin CHARACTERISTIC DDRC_DurDeb.Com_numComInvld_325h_HVBAT_EPLUG_STATUSDebDef_C "" VALUE 0x80241162 Val_Wu16 65535.00 OneToOne 0.00 65535.00 FORMAT "%8.2" /end CHARACTERISTIC
/begin CHARACTERISTIC DDRC_DurDeb.Com_numComInvld_325h_HVBAT_HVIL_STSDebOk_C "" VALUE 0x80241164 Val_Wu16 65535.00 OneToOne 0.00 65535.00 FORMAT "%8.2" /end CHARACTERISTIC
/begin CHARACTERISTIC DDRC_DurDeb.Com_numComInvld_325h_HVBAT_HVIL_STSDebDef_C "" VALUE 0x80241166 Val_Wu16 65535.00 OneToOne 0.00 65535.00 FORMAT "%8.2" /end CHARACTERISTIC
/begin CHARACTERISTIC DDRC_DurDeb.Com_numComInvld_325h_HVBAT_INSULATION_FAULTDebOk_C "" VALUE 0x80241168 Val_Wu16 65535.00 OneToOne 0.00 65535.00 FORMAT "%8.2" /end CHARACTERISTIC
/begin CHARACTERISTIC DDRC_DurDeb.Com_numComInvld_325h_HVBAT_INSULATION_FAULTDebDef_C "" VALUE 0x8024116A Val_Wu16 65535.00 OneToOne 0.00 65535.00 FORMAT "%8.2" /end CHARACTERISTIC
/begin CHARACTERISTIC DDRC_DurDeb.Com_numComInvld_325h_HVBAT_INSULATION_RESISTANCEDebOk_C "" VALUE 0x8024116C Val_Wu16 65535.00 OneToOne 0.00 65535.00 FORMAT "%8.2" /end CHARACTERISTIC
/begin CHARACTERISTIC DDRC_DurDeb.Com_numComInvld_325h_HVBAT_INSULATION_RESISTANCEDebDef_C "" VALUE 0x8024116E Val_Wu16 65535.00 OneToOne 0.00 65535.00 FORMAT "%8.2" /end CHARACTERISTIC
/begin CHARACTERISTIC DDRC_DurDeb.Com_numComInvld_325h_HVBAT_TEMPERATUREDebOk_C "" VALUE 0x80241170 Val_Wu16 65535.00 OneToOne 0.00 65535.00 FORMAT "%8.2" /end CHARACTERISTIC
/begin CHARACTERISTIC DDRC_DurDeb.Com_numComInvld_325h_HVBAT_TEMPERATUREDebDef_C "" VALUE 0x80241172 Val_Wu16 65535.00 OneToOne 0.00 65535.00 FORMAT "%8.2" /end CHARACTERISTIC
/begin CHARACTERISTIC DDRC_DurDeb.Com_numComInvld_335h_HVBAT_CHRG_CONTINUOUS_CURR_MAXDebOk_C "" VALUE 0x80241174 Val_Wu16 65535.00 OneToOne 0.00 65535.00 FORMAT "%8.2" /end CHARACTERISTIC
/begin CHARACTERISTIC DDRC_DurDeb.Com_numComInvld_335h_HVBAT_CHRG_CONTINUOUS_CURR_MAXDebDef_C "" VALUE 0x80241176 Val_Wu16 65535.00 OneToOne 0.00 65535.00 FORMAT "%8.2" /end CHARACTERISTIC
/begin CHARACTERISTIC DDRC_DurDeb.Com_numComInvld_335h_HVBAT_CHRG_COTINUOUS_CURR_REQDebOk_C "" VALUE 0x80241178 Val_Wu16 65535.00 OneToOne 0.00 65535.00 FORMAT "%8.2" /end CHARACTERISTIC
/begin CHARACTERISTIC DDRC_DurDeb.Com_numComInvld_335h_HVBAT_CHRG_COTINUOUS_CURR_REQDebDef_C "" VALUE 0x8024117A Val_Wu16 65535.00 OneToOne 0.00 65535.00 FORMAT "%8.2" /end CHARACTERISTIC
/begin CHARACTERISTIC DDRC_DurDeb.Com_numComInvld_335h_HVBAT_CHRG_MAX_VOLTDebOk_C "" VALUE 0x8024117C Val_Wu16 65535.00 OneToOne 0.00 65535.00 FORMAT "%8.2" /end CHARACTERISTIC
/begin CHARACTERISTIC DDRC_DurDeb.Com_numComInvld_335h_HVBAT_CHRG_MAX_VOLTDebDef_C "" VALUE 0x8024117E Val_Wu16 65535.00 OneToOne 0.00 65535.00 FORMAT "%8.2" /end CHARACTERISTIC
/begin CHARACTERISTIC DDRC_DurDeb.Com_numComInvld_335h_HVBAT_DC_BUS_VOLTAGEDebOk_C "" VALUE 0x80241180 Val_Wu16 65535.00 OneToOne 0.00 65535.00 FORMAT "%8.2" /end CHARACTERISTIC
/begin CHARACTERISTIC DDRC_DurDeb.Com_numComInvld_335h_HVBAT_DC_BUS_VOLTAGEDebDef_C "" VALUE 0x80241182 Val_Wu16 65535.00 OneToOne 0.00 65535.00 FORMAT "%8.2" /end CHARACTERISTIC
/begin CHARACTERISTIC DDRC_DurDeb.Com_numComInvld_38Dh_VITESSE_VEHICULE_ROUESDebOk_C "" VALUE 0x80241184 Val_Wu16 65535.00 OneToOne 0.00 65535.00 FORMAT "%8.2" /end CHARACTERISTIC
/begin CHARACTERISTIC DDRC_DurDeb.Com_numComInvld_38Dh_VITESSE_VEHICULE_ROUESDebDef_C "" VALUE 0x80241186 Val_Wu16 65535.00 OneToOne 0.00 65535.00 FORMAT "%8.2" /end CHARACTERISTIC
/begin CHARACTERISTIC DDRC_DurDeb.Com_numComInvld_38Dh_VVH_INDISPDebOk_C "" VALUE 0x80241188 Val_Wu16 65535.00 OneToOne 0.00 65535.00 FORMAT "%8.2" /end CHARACTERISTIC
/begin CHARACTERISTIC DDRC_DurDeb.Com_numComInvld_38Dh_VVH_INDISPDebDef_C "" VALUE 0x8024118A Val_Wu16 65535.00 OneToOne 0.00 65535.00 FORMAT "%8.2" /end CHARACTERISTIC
/begin CHARACTERISTIC DDRC_DurDeb.Com_numComInvld_427h_INV_COOLANT_TEMPDebOk_C "" VALUE 0x8024118C Val_Wu16 65535.00 OneToOne 0.00 65535.00 FORMAT "%8.2" /end CHARACTERISTIC
/begin CHARACTERISTIC DDRC_DurDeb.Com_numComInvld_427h_INV_COOLANT_TEMPDebDef_C "" VALUE 0x8024118E Val_Wu16 65535.00 OneToOne 0.00 65535.00 FORMAT "%8.2" /end CHARACTERISTIC
/begin CHARACTERISTIC DDRC_DurDeb.Com_numComInvld_427h_INV_MOTOR_TEMPDebOk_C "" VALUE 0x80241190 Val_Wu16 65535.00 OneToOne 0.00 65535.00 FORMAT "%8.2" /end CHARACTERISTIC
/begin CHARACTERISTIC DDRC_DurDeb.Com_numComInvld_427h_INV_MOTOR_TEMPDebDef_C "" VALUE 0x80241192 Val_Wu16 65535.00 OneToOne 0.00 65535.00 FORMAT "%8.2" /end CHARACTERISTIC
/begin CHARACTERISTIC DDRC_DurDeb.Com_numComInvld_427h_INV_OP_MODEDebOk_C "" VALUE 0x80241194 Val_Wu16 65535.00 OneToOne 0.00 65535.00 FORMAT "%8.2" /end CHARACTERISTIC
/begin CHARACTERISTIC DDRC_DurDeb.Com_numComInvld_427h_INV_OP_MODEDebDef_C "" VALUE 0x80241196 Val_Wu16 65535.00 OneToOne 0.00 65535.00 FORMAT "%8.2" /end CHARACTERISTIC
/begin CHARACTERISTIC DDRC_DurDeb.Com_numComInvld_427h_INV_PERMISIBLE_TORQUEDebOk_C "" VALUE 0x80241198 Val_Wu16 65535.00 OneToOne 0.00 65535.00 FORMAT "%8.2" /end CHARACTERISTIC
/begin CHARACTERISTIC DDRC_DurDeb.Com_numComInvld_427h_INV_PERMISIBLE_TORQUEDebDef_C "" VALUE 0x8024119A Val_Wu16 65535.00 OneToOne 0.00 65535.00 FORMAT "%8.2" /end CHARACTERISTIC
/begin CHARACTERISTIC DDRC_DurDeb.Com_numComInvld_427h_INV_TEMPDebOk_C "" VALUE 0x8024119C Val_Wu16 65535.00 OneToOne 0.00 65535.00 FORMAT "%8.2" /end CHARACTERISTIC
/begin CHARACTERISTIC DDRC_DurDeb.Com_numComInvld_427h_INV_TEMPDebDef_C "" VALUE 0x8024119E Val_Wu16 65535.00 OneToOne 0.00 65535.00 FORMAT "%8.2" /end CHARACTERISTIC
/begin CHARACTERISTIC DDRC_DurDeb.Com_numComInvld_432h_REVEIL_PRINCIPALDebOk_C "" VALUE 0x802411A0 Val_Wu16 65535.00 OneToOne 0.00 65535.00 FORMAT "%8.2" /end CHARACTERISTIC
/begin CHARACTERISTIC DDRC_DurDeb.Com_numComInvld_432h_REVEIL_PRINCIPALDebDef_C "" VALUE 0x802411A2 Val_Wu16 65535.00 OneToOne 0.00 65535.00 FORMAT "%8.2" /end CHARACTERISTIC
/begin CHARACTERISTIC DDRC_DurDeb.Com_numComInvld_435h_HVBAT_MAX_CELL_VOLTDebOk_C "" VALUE 0x802411A4 Val_Wu16 65535.00 OneToOne 0.00 65535.00 FORMAT "%8.2" /end CHARACTERISTIC
/begin CHARACTERISTIC DDRC_DurDeb.Com_numComInvld_435h_HVBAT_MAX_CELL_VOLTDebDef_C "" VALUE 0x802411A6 Val_Wu16 65535.00 OneToOne 0.00 65535.00 FORMAT "%8.2" /end CHARACTERISTIC
/begin CHARACTERISTIC DDRC_DurDeb.Com_numComInvld_435h_HVBAT_MAX_CELL_VOLT_NUMDebOk_C "" VALUE 0x802411A8 Val_Wu16 65535.00 OneToOne 0.00 65535.00 FORMAT "%8.2" /end CHARACTERISTIC
/begin CHARACTERISTIC DDRC_DurDeb.Com_numComInvld_435h_HVBAT_MAX_CELL_VOLT_NUMDebDef_C "" VALUE 0x802411AA Val_Wu16 65535.00 OneToOne 0.00 65535.00 FORMAT "%8.2" /end CHARACTERISTIC
/begin CHARACTERISTIC DDRC_DurDeb.Com_numComInvld_435h_HVBAT_MAX_SENSOR_TEMPDebOk_C "" VALUE 0x802411AC Val_Wu16 65535.00 OneToOne 0.00 65535.00 FORMAT "%8.2" /end CHARACTERISTIC
/begin CHARACTERISTIC DDRC_DurDeb.Com_numComInvld_435h_HVBAT_MAX_SENSOR_TEMPDebDef_C "" VALUE 0x802411AE Val_Wu16 65535.00 OneToOne 0.00 65535.00 FORMAT "%8.2" /end CHARACTERISTIC
/begin CHARACTERISTIC DDRC_DurDeb.Com_numComInvld_435h_HVBAT_MIN_CELL_VOLTDebOk_C "" VALUE 0x802411B0 Val_Wu16 65535.00 OneToOne 0.00 65535.00 FORMAT "%8.2" /end CHARACTERISTIC
/begin CHARACTERISTIC DDRC_DurDeb.Com_numComInvld_435h_HVBAT_MIN_CELL_VOLTDebDef_C "" VALUE 0x802411B2 Val_Wu16 65535.00 OneToOne 0.00 65535.00 FORMAT "%8.2" /end CHARACTERISTIC
/begin CHARACTERISTIC DDRC_DurDeb.Com_numComInvld_435h_HVBAT_MIN_CELL_VOLT_NUMDebOk_C "" VALUE 0x802411B4 Val_Wu16 65535.00 OneToOne 0.00 65535.00 FORMAT "%8.2" /end CHARACTERISTIC
/begin CHARACTERISTIC DDRC_DurDeb.Com_numComInvld_435h_HVBAT_MIN_CELL_VOLT_NUMDebDef_C "" VALUE 0x802411B6 Val_Wu16 65535.00 OneToOne 0.00 65535.00 FORMAT "%8.2" /end CHARACTERISTIC
/begin CHARACTERISTIC DDRC_DurDeb.Com_numComInvld_442h_BCCM_BLOWER_RELAY_STSDebOk_C "" VALUE 0x802411B8 Val_Wu16 65535.00 OneToOne 0.00 65535.00 FORMAT "%8.2" /end CHARACTERISTIC
/begin CHARACTERISTIC DDRC_DurDeb.Com_numComInvld_442h_BCCM_BLOWER_RELAY_STSDebDef_C "" VALUE 0x802411BA Val_Wu16 65535.00 OneToOne 0.00 65535.00 FORMAT "%8.2" /end CHARACTERISTIC
/begin CHARACTERISTIC DDRC_DurDeb.Com_numComInvld_453h_OBC_IN_CURRENTDebOk_C "" VALUE 0x802411BC Val_Wu16 65535.00 OneToOne 0.00 65535.00 FORMAT "%8.2" /end CHARACTERISTIC
/begin CHARACTERISTIC DDRC_DurDeb.Com_numComInvld_453h_OBC_IN_CURRENTDebDef_C "" VALUE 0x802411BE Val_Wu16 65535.00 OneToOne 0.00 65535.00 FORMAT "%8.2" /end CHARACTERISTIC
/begin CHARACTERISTIC DDRC_DurDeb.Com_numComInvld_453h_OBC_IN_VOLTAGEDebOk_C "" VALUE 0x802411C0 Val_Wu16 65535.00 OneToOne 0.00 65535.00 FORMAT "%8.2" /end CHARACTERISTIC
/begin CHARACTERISTIC DDRC_DurDeb.Com_numComInvld_453h_OBC_IN_VOLTAGEDebDef_C "" VALUE 0x802411C2 Val_Wu16 65535.00 OneToOne 0.00 65535.00 FORMAT "%8.2" /end CHARACTERISTIC
/begin CHARACTERISTIC DDRC_DurDeb.Com_numComInvld_453h_OBC_IP_POWERDebOk_C "" VALUE 0x802411C4 Val_Wu16 65535.00 OneToOne 0.00 65535.00 FORMAT "%8.2" /end CHARACTERISTIC
/begin CHARACTERISTIC DDRC_DurDeb.Com_numComInvld_453h_OBC_IP_POWERDebDef_C "" VALUE 0x802411C6 Val_Wu16 65535.00 OneToOne 0.00 65535.00 FORMAT "%8.2" /end CHARACTERISTIC
/begin CHARACTERISTIC DDRC_DurDeb.Com_numComInvld_455h_HVBAT_NOMINAL_VOLTAGEDebOk_C "" VALUE 0x802411C8 Val_Wu16 65535.00 OneToOne 0.00 65535.00 FORMAT "%8.2" /end CHARACTERISTIC
/begin CHARACTERISTIC DDRC_DurDeb.Com_numComInvld_455h_HVBAT_NOMINAL_VOLTAGEDebDef_C "" VALUE 0x802411CA Val_Wu16 65535.00 OneToOne 0.00 65535.00 FORMAT "%8.2" /end CHARACTERISTIC
/begin CHARACTERISTIC DDRC_DurDeb.Com_numComInvld_463h_OBC_OUT_CURRENTDebOk_C "" VALUE 0x802411CC Val_Wu16 65535.00 OneToOne 0.00 65535.00 FORMAT "%8.2" /end CHARACTERISTIC
/begin CHARACTERISTIC DDRC_DurDeb.Com_numComInvld_463h_OBC_OUT_CURRENTDebDef_C "" VALUE 0x802411CE Val_Wu16 65535.00 OneToOne 0.00 65535.00 FORMAT "%8.2" /end CHARACTERISTIC
/begin CHARACTERISTIC DDRC_DurDeb.Com_numComInvld_463h_OBC_OUT_VOLTAGEDebOk_C "" VALUE 0x802411D0 Val_Wu16 65535.00 OneToOne 0.00 65535.00 FORMAT "%8.2" /end CHARACTERISTIC
/begin CHARACTERISTIC DDRC_DurDeb.Com_numComInvld_463h_OBC_OUT_VOLTAGEDebDef_C "" VALUE 0x802411D2 Val_Wu16 65535.00 OneToOne 0.00 65535.00 FORMAT "%8.2" /end CHARACTERISTIC
/begin CHARACTERISTIC DDRC_DurDeb.Com_numComInvld_463h_OBC_TEMPERATUREDebOk_C "" VALUE 0x802411D4 Val_Wu16 65535.00 OneToOne 0.00 65535.00 FORMAT "%8.2" /end CHARACTERISTIC
/begin CHARACTERISTIC DDRC_DurDeb.Com_numComInvld_463h_OBC_TEMPERATUREDebDef_C "" VALUE 0x802411D6 Val_Wu16 65535.00 OneToOne 0.00 65535.00 FORMAT "%8.2" /end CHARACTERISTIC
/begin CHARACTERISTIC DDRC_DurDeb.Com_numComInvld_473h_DCDC_Coolant_TemperatureDebOk_C "" VALUE 0x802411D8 Val_Wu16 65535.00 OneToOne 0.00 65535.00 FORMAT "%8.2" /end CHARACTERISTIC
/begin CHARACTERISTIC DDRC_DurDeb.Com_numComInvld_473h_DCDC_Coolant_TemperatureDebDef_C "" VALUE 0x802411DA Val_Wu16 65535.00 OneToOne 0.00 65535.00 FORMAT "%8.2" /end CHARACTERISTIC
/begin FUNCTION ComScl_NetMtrx "850.8.0   Configuration of network matrix"
 /begin DEF_CHARACTERISTIC Com_flgVehSpdAvl_38DhInvld_C Com_flgVehSpdAvl_38DhRcf_C Com_flgVehSpdQly_241hIni_C Com_flgVehSpdQly_241hInvld_C Com_flgVoltMeasmtErr_308hIni_C Com_flgVoltMeasmtErr_308hRcf_C Com_flgVoltMeasmtSysErr_308hIni_C Com_flgVoltMeasmtSysErr_308hRcf_C Com_flgVoltMeasmtVld_308hIni_C Com_flgVoltMeasmtVld_308hRcf_C Com_flgVoltRngErr_308hIni_C Com_flgVoltRngErr_308hRcf_C Com_HS3_AUTO_GEARBOX_SWITCH_REQ_Tx_EIMode_C Com_HvbMaxSnsrTempRx_435hIni_C Com_HvbMaxSnsrTempRx_435hInvld_C Com_HvbMaxSnsrTempRx_435hRcf_C Com_HvbMaxSnsrTempTx_5A2hIni_C Com_HvbMaxSnsrTempTx_5A2hInvld_C Com_iBattEBS1Rx_592hIni_C Com_iBattEBS1Rx_592hInvld_C Com_iBattEBS1Rx_592hRcf_C Com_iBattEBS2Rx_592hIni_C Com_iBattEBS2Rx_592hInvld_C Com_iBattEBS2Rx_592hRcf_C Com_iBattEBS3Rx_592hIni_C Com_iBattEBS3Rx_592hInvld_C Com_iBattEBS3Rx_592hRcf_C Com_iDcdcHvActRvsn1_283hIni_C Com_iDcdcHvActRvsn1_283hInvld_C Com_iDcdcHvActRvsn1_283hRcf_C Com_iDcdcLvActRvsn1_283hIni_C Com_iDcdcLvActRvsn1_283hInvld_C Com_iDcdcLvActRvsn1_283hRcf_C Com_iElCmprHvAct_47BhIni_C Com_iElCmprHvAct_47BhInvld_C Com_iElCmprHvAct_47BhRcf_C Com_iElCmprPeakPha_47BhIni_C Com_iElCmprPeakPha_47BhInvld_C Com_iElCmprPeakPha_47BhRcf_C Com_iHvbActRx_205hIni_C Com_iHvbActRx_205hInvld_C Com_iHvbActRx_205hRcf_C Com_iHvbActTx_5C3hIni_C Com_iHvbActTx_5C3hInvld_C Com_iHvbChrgMaxSho_285hIni_C Com_iHvbChrgMaxSho_285hInvld_C Com_iHvbChrgMaxSho_285hRcf_C Com_iHvbDchaMaxSho_275hIni_C Com_iHvbDchaMaxSho_275hInvld_C Com_iHvbDchaMaxSho_275hRcf_C Com_iHvbDes_335hIni_C Com_iHvbDes_335hInvld_C Com_iHvbDes_335hRcf_C Com_iHvbNomChrgn_335hIni_C Com_iHvbNomChrgn_335hInvld_C Com_iHvbNomChrgn_335hRcf_C Com_IS_DYN3_CMM_468h_Tx_EIMode_C Com_IS_DYN_VCU_208h_Tx_EIMode_C Com_lTotOdometer_552hIni_C Com_lTotOdometer_552hInvld_C Com_lTotOdometer_552hRcf_C Com_nElCmprActlTx_231hIni_C Com_nElCmprActlTx_231hInvld_C Com_nElCmprActl_47BhIni_C Com_nElCmprActl_47BhInvld_C Com_nElCmprActl_47BhRcf_C Com_nIvtrMotAct01_522hIni_C Com_nIvtrMotAct01_522hInvld_C Com_noCks201Ini_C Com_noCks205Ini_C Com_noCks208Ini_C Com_noCks211Ini_C Com_noCks217Ini_C Com_noCks219Ini_C Com_noCks221Ini_C Com_noCks237Ini_C Com_noCks241Ini_C Com_noCks259Ini_C Com_noCks273Ini_C Com_noCks275Ini_C Com_noCks281Ini_C Com_noCks285Ini_C Com_noCks293Ini_C Com_noCks308Ini_C Com_noCks318Ini_C Com_noCks325Ini_C Com_noCks335Ini_C Com_noCks38DIni_C Com_noCks412Ini_C Com_noCks432Ini_C Com_noCks4F2Ini_C Com_noCks592Ini_C Com_noCks595Ini_C Com_noCks5B5Ini_C Com_noEditCal_111hIni_C Com_noEditSw_111hIni_C Com_noVersAdp_111hIni_C Com_noVersSw_111hIni_C Com_noVersSysMnth_111hIni_C Com_noVersSysYr_111hIni_C Com_noVersSys_111hIni_C Com_noVerSysDay_111hIni_C Com_nrSerMaxCell_435hIni_C Com_nrSerMaxCell_435hInvld_C Com_nrSerMaxCell_435hRcf_C Com_nrSerMinCell_435hIni_C Com_nrSerMinCell_435hInvld_C Com_nrSerMinCell_435hRcf_C Com_pwrDcdcOutpCpby_293hIni_C Com_pwrDcdcOutpCpby_293hInvld_C Com_pwrDcdcOutpCpby_293hRcf_C Com_pwrElCmprActl_47BhIni_C Com_pwrElCmprActl_47BhInvld_C Com_pwrElCmprActl_47BhRcf_C Com_pwrMaxChrgSho_285hIni_C Com_pwrMaxChrgSho_285hInvld_C Com_pwrMaxChrgSho_285hRcf_C Com_pwrMaxDchaSho_275hIni_C Com_pwrMaxDchaSho_275hInvld_C Com_pwrMaxDchaSho_275hRcf_C Com_qHvbTotCpRx_675hIni_C Com_qHvbTotCpRx_675hInvld_C Com_qHvbTotCpRx_675hRcf_C Com_ratHvbSoc_205hIni_C Com_ratHvbSoc_205hInvld_C Com_ratHvbSoc_205hRcf_C Com_ratHvbSoh_543hIni_C Com_ratHvbSoh_543hInvld_C Com_ratHvbSoh_543hRcf_C Com_ratRHvbSoh_543hIni_C Com_ratRHvbSoh_543hInvld_C Com_ratRHvbSoh_543hRcf_C Com_ratSocLvBatt_4F2hIni_C Com_ratSocLvBatt_4F2hInvld_C Com_ratSocLvBatt_4F2hRcf_C Com_rHvbIsoMeasmt_325hIni_C Com_rHvbIsoMeasmt_325hInvld_C Com_rHvbIsoMeasmt_325hRcf_C Com_RMS1_VCU_5C1_Tx_EIMode_C Com_RMS2_VCU_5C3_Tx_EIMode_C Com_RMS3_TBMU_5A3_Tx_EIMode_C Com_RMS5_VCU_563_Tx_EIMode_C Com_stABSActv_50DhIni_C Com_stABSActv_50DhRcf_C Com_stACTx_231hIni_C Com_stAC_26hIni_C Com_stAC_26hInvld_C Com_stAC_26hRcf_C Com_stAirbCrashSevCpl_351hIni_C Com_stAirbCrashSevCpl_351hRcf_C Com_stAirbCrashSev_351hIni_C Com_stAirbCrashSev_351hRcf_C Com_stAlrtThermRunAwy_5B5hIni_C Com_stAlrtThermRunAwy_5B5hInvld_C Com_stAlrtThermRunAwy_5B5hRcf_C Com_stBlowrRly_442hIni_C Com_stBlowrRly_442hInvld_C Com_stBlowrRly_442hRcf_C Com_stBrkBstPFlt_221hIni_C Com_stBrkBstPFlt_221hInvld_C Com_stBrkCntctIndcn_468hIni_C Com_stBrk_208hIni_C Com_stChrgnSpstReq_432hIni_C Com_stChrgnSpstReq_432hRcf_C Com_stChrgPlgChrgn_201hIni_C Com_stChrgPlg_4A2hIni_C Com_stClstrStopIndcn_221hIni_C Com_stClstrStopIndcn_221hInvld_C Com_stCmdHvBattCntctr_211hIni_C Com_stCmdOffsEM01_491hIni_C Com_stDayNight_442hIni_C Com_stDayNight_442hRcf_C Com_stDcdcEVLmp_473hIni_C Com_stDcdcEVLmp_473hRcf_C Com_stDcdcFltLvl_293hIni_C Com_stDcdcFltLvl_293hInvld_C Com_stDcdcFltLvl_293hRcf_C Com_stDcdcMstWrnLmp_473hIni_C Com_stDcdcMstWrnLmp_473hRcf_C Com_stDcdcOperModActRx_293hIni_C Com_stDcdcOperModActRx_293hRcf_C Com_stDcdcPerfLimnActv_663hIni_C Com_stDcdcPerfLimnActv_663hRcf_C Com_stDcdcSVSLmp_473hIni_C Com_stDcdcSVSLmp_473hRcf_C Com_stDcdcULimReq_412hIni_C Com_stDcdcULimReq_412hRcf_C Com_stDoor1_412hIni_C Com_stDoor1_412hRcf_C Com_stDoor2_412hIni_C Com_stDoor2_412hRcf_C Com_stDoor3_412hIni_C Com_stDoor3_412hRcf_C Com_stDoor4_412hIni_C Com_stDoor4_412hRcf_C Com_stDrvAwyDi_331hIni_C Com_stDrvModPosn_201hIni_C Com_stDrvModPosn_201hInvld_C Com_stDrvStBltRx_351hIni_C Com_stDrvStBltRx_351hRcf_C Com_stElCmprFltLvl_48BhIni_C Com_stElCmprFltLvl_48BhRcf_C Com_stElCmprStatTx_231hIni_C Com_stElCmprStat_48BhIni_C Com_stElCmprStat_48BhRcf_C Com_stElMDesEem_208hIni_C Com_steTogFailrLvl_259hIni_C Com_steTogFailrLvl_259hRcf_C Com_stEvapTFlt_26hIni_C Com_stEvapTFlt_26hInvld_C Com_stEvapTFlt_26hRcf_C Com_stEVLmp_221hIni_C Com_stGearLvrPos_259hIni_C Com_stGearLvrPos_259hInvld_C Com_stGearLvrPos_259hRcf_C Com_stHvacBlwrFront_26hIni_C Com_stHvacBlwrFront_26hInvld_C Com_stHvacBlwrFront_26hRcf_C Com_stHvacBlwrFront_CAN_231hIni_C Com_stHvacKnobPosn_26hIni_C Com_stHvacKnobPosn_26hInvld_C Com_stHvacKnobPosn_26hRcf_C Com_stHvacKnobPosn_CAN_231hIni_C Com_stHvacPanComFlt_26hIni_C Com_stHvacPanComFlt_26hRcf_C Com_stHvacPanHwFlt_26hIni_C Com_stHvacPanHwFlt_26hRcf_C Com_stHvacPanOverUFlt_26hIni_C Com_stHvacPanOverUFlt_26hRcf_C Com_stHvacPanPotiFlt_26hIni_C Com_stHvacPanPotiFlt_26hInvld_C Com_stHvacPanPotiFlt_26hRcf_C Com_stHvacPanUnderUFlt_26hIni_C Com_stHvacPanUnderUFlt_26hRcf_C Com_stHvBatHiTempWrn_583hIni_C Com_stHvBatHiTempWrn_583hRcf_C Com_stHvBattOperModDes_211hIni_C Com_stHvBattOperModDes_211hInvld_C Com_stHvbChrgFltRx_325hIni_C Com_stHvbChrgFltRx_325hRcf_C Com_stHvbChrgn_205hIni_C Com_stHvbChrgn_205hInvld_C Com_stHvbChrgn_205hRcf_C Com_stHvbCnctn_205hIni_C Com_stHvbCnctn_205hRcf_C Com_stHvbDiscnctReas_583hIni_C Com_stHvbDiscnctReas_583hInvld_C Com_stHvbDiscnctReas_583hRcf_C Com_stHvbEVLmp_325hIni_C Com_stHvbEVLmp_325hRcf_C Com_stHvbFltLvl_205hIni_C Com_stHvbFltLvl_205hRcf_C Com_stHvbIntlckRx_325hIni_C Com_stHvbIntlckRx_325hInvld_C Com_stHvbIntlckRx_325hRcf_C Com_stHvbIsoFltRx_325hIni_C Com_stHvbIsoFltRx_325hInvld_C Com_stHvbIsoFltRx_325hRcf_C Com_stHvbIsoMeasmtActv_325hIni_C Com_stHvbIsoMeasmtActv_325hRcf_C Com_stHvbModRx_205hIni_C Com_stHvbModRx_205hRcf_C Com_stHvbMstWrnLmp_325hIni_C Com_stHvbMstWrnLmp_325hRcf_C Com_stHvbNegCntct_205hIni_C Com_stHvbNegCntct_205hRcf_C Com_stHvbPosCntct_205hIni_C Com_stHvbPosCntct_205hRcf_C Com_stHvbPrecCntct_205hIni_C Com_stHvbPrecCntct_205hRcf_C Com_stHvbSrvPlgRx_325hIni_C Com_stHvbSrvPlgRx_325hInvld_C Com_stHvbSrvPlgRx_325hRcf_C Com_stHvbSVSLmp_325hIni_C Com_stHvbSVSLmp_325hRcf_C Com_stIBattEBS_592hIni_C Com_stIBattEBS_592hInvld_C Com_stIBattEBS_592hRcf_C Com_stIgnkeyPos_442hIni_C Com_stIgnkeyPos_442hRcf_C Com_stIIvtrFltLvl01_237hIni_C Com_stIIvtrFltLvl01_237hInvld_C Com_stIIvtrFltLvl01_237hRcf_C Com_stMainWkuReq_432hIni_C Com_stMainWkuReq_432hInvld_C Com_stMainWkuReq_432hRcf_C Com_stMstWrnLmp_221hIni_C Com_stNwCmdLINIni_C Com_stNwCmdLINInvld_C Com_stOffsEm01_497hIni_C Com_stOffsEm01_497hRcf_C Com_stPrkBrkRx_412hIni_C Com_stPrkBrkRx_412hRcf_C Com_stPwrLimnLmp_221hIni_C Com_stPwrLimnLmp_221hInvld_C Com_stReFogReq_26hIni_C Com_stReFogReq_26hInvld_C Com_stReFogReq_26hRcf_C Com_stReFogReq_CAN_231hIni_C Com_stSocRx_4F2hIni_C Com_stSocRx_4F2hInvld_C Com_stSocRx_4F2hRcf_C Com_stSrvLmp_221hIni_C Com_stSrvLmp_221hInvld_C Com_stT50_432hIni_C Com_stT50_432hRcf_C Com_stT_4F2hIni_C Com_stT_4F2hInvld_C Com_stT_4F2hRcf_C Com_stVehCoorn_201hIni_C Com_tDcdcAct_473hIni_C Com_tDcdcAct_473hInvld_C Com_tDcdcAct_473hRcf_C Com_tDcdcInltCoolt_473hIni_C Com_tDcdcInltCoolt_473hInvld_C Com_tDcdcInltCoolt_473hRcf_C Com_tElCmprActl_47BhIni_C Com_tElCmprActl_47BhInvld_C Com_tElCmprActl_47BhRcf_C Com_tEnvT_5B2hIni_C Com_tEnvT_5B2hInvld_C Com_tEnvT_5B2hRcf_C Com_tEvapT_26hIni_C Com_tEvapT_26hInvld_C Com_tEvapT_26hRcf_C Com_tHvbAct_535hIni_C Com_tHvbAct_535hInvld_C Com_tHvbAct_535hRcf_C Com_tHvbMax_325hIni_C Com_tHvbMax_325hInvld_C Com_tHvbMax_325hRcf_C Com_tiCurVehTmr_552hIni_C Com_tiCurVehTmr_552hInvld_C Com_tiCurVehTmr_552hRcf_C Com_tiHvbChrgnHalfRx_595hIni_C Com_tiHvbChrgnHalfRx_595hInvld_C Com_tiHvbChrgnHalfRx_595hRcf_C Com_tLvBatt_592hIni_C Com_tLvBatt_592hInvld_C Com_tLvBatt_592hRcf_C Com_TogLedDrv_219hIni_C Com_TogLedMod_219hIni_C Com_TogLedNeut_219hIni_C Com_TogLedRvs_219hIni_C Com_tqMotLimMax_208hIni_C Com_tqMotLimMax_208hInvld_C Com_uBattEBSRx_592hIni_C Com_uBattEBSRx_592hInvld_C Com_uBattEBSRx_592hRcf_C Com_uDcdcHvAct_283hIni_C Com_uDcdcHvAct_283hInvld_C Com_uDcdcHvAct_283hRcf_C Com_uDcdcLvAct_283hIni_C Com_uDcdcLvAct_283hInvld_C Com_uDcdcLvAct_283hRcf_C Com_uElCmprHvAct_47BhIni_C Com_uElCmprHvAct_47BhInvld_C Com_uElCmprHvAct_47BhRcf_C Com_uHvbActTx_5C3hIni_C Com_uHvbActTx_5C3hInvld_C Com_uHvbAct_205hIni_C Com_uHvbAct_205hInvld_C Com_uHvbAct_205hRcf_C Com_uHvbDcBus_335hIni_C Com_uHvbDcBus_335hInvld_C Com_uHvbDcBus_335hRcf_C Com_uHvbLimHi_335hIni_C Com_uHvbLimHi_335hInvld_C Com_uHvbLimHi_335hRcf_C Com_uHvbMaxCell_435hIni_C Com_uHvbMaxCell_435hInvld_C Com_uHvbMaxCell_435hRcf_C Com_uHvbMinCell_435hIni_C Com_uHvbMinCell_435hInvld_C Com_uHvbMinCell_435hRcf_C Com_uHvbNomChrgn_455hIni_C Com_uHvbNomChrgn_455hInvld_C Com_uHvbNomChrgn_455hRcf_C Com_valEepOffsEM01_491hIni_C Com_valOffsEm01_497hIni_C Com_valOffsEm01_497hRcf_C Com_VCU_0x50F_Tx_EIMode_C Com_VCU_211h_Tx_EIMode_C Com_VCU_221h_Tx_EIMode_C Com_VCU_241h_Tx_EIMode_C Com_VCU_25h_Tx_EIMode_C Com_VCU_262_Tx_EIMode_C Com_VCU_281h_Tx_EIMode_C Com_VCU_321h_Tx_EIMode_C Com_VCU_331h_Tx_EIMode_C Com_VCU_421h_Tx_EIMode_C Com_VCU_481h_Tx_EIMode_C Com_VCU_4A2_Tx_EIMode_C Com_VCU_501h_Tx_EIMode_C Com_VCU_5A2_Tx_EIMode_C Com_VCU_5D1h_Tx_EIMode_C Com_VCU_5F1h_Tx_EIMode_C Com_VCU_CTRL_INPUT_201h_Tx_EIMode_C Com_VCU_eCOMP_CONTROL_341_Tx_EIMode_C Com_VCU_HVAC_231h_Tx_EIMode_C Com_VCU_INV_491h_Tx_EIMode_C Com_VCU_VERS_111h_Tx_EIMode_C Com_vVeh_38DhIni_C Com_vVeh_38DhInvld_C Com_vVeh_38DhRcf_C CoPtFH_stPwt_262hIni_C DcChrgnRly_ctMaxOperCyc_454hIni_C DcChrgnRly_ctMaxOperCyc_454hInvld_C Dcdc_flgDesLvGridULim_421hIni_C Dcdc_iLimLvGrid_281hIni_C Dcdc_iLimLvGrid_281hInvld_C Dcdc_stDesDcdc_281hIni_C Dcdc_uDesLvGrid_321hIni_C Dcdc_uDesLvGrid_321hInvld_C DDRC_DurDeb.Com_numCom082hTooShortDebOk_C DDRC_DurDeb.Com_numCom082hTooShortDebDef_C DDRC_DurDeb.Com_numCom092hTooShortDebOk_C DDRC_DurDeb.Com_numCom092hTooShortDebDef_C DDRC_DurDeb.Com_numCom205hAbsentDebOk_C DDRC_DurDeb.Com_numCom205hAbsentDebDef_C DDRC_DurDeb.Com_numCom205hChecksumDebOk_C DDRC_DurDeb.Com_numCom205hChecksumDebDef_C DDRC_DurDeb.Com_numCom205hCounterDebOk_C DDRC_DurDeb.Com_numCom205hCounterDebDef_C DDRC_DurDeb.Com_numCom205hTooShortDebOk_C DDRC_DurDeb.Com_numCom205hTooShortDebDef_C DDRC_DurDeb.Com_numCom217hAbsentDebOk_C DDRC_DurDeb.Com_numCom217hAbsentDebDef_C DDRC_DurDeb.Com_numCom217hChecksumDebOk_C DDRC_DurDeb.Com_numCom217hChecksumDebDef_C DDRC_DurDeb.Com_numCom217hCounterDebOk_C DDRC_DurDeb.Com_numCom217hCounterDebDef_C DDRC_DurDeb.Com_numCom217hTooShortDebOk_C DDRC_DurDeb.Com_numCom217hTooShortDebDef_C DDRC_DurDeb.Com_numCom227hAbsentDebOk_C DDRC_DurDeb.Com_numCom227hAbsentDebDef_C DDRC_DurDeb.Com_numCom227hTooShortDebOk_C DDRC_DurDeb.Com_numCom227hTooShortDebDef_C DDRC_DurDeb.Com_numCom237hAbsentDebOk_C DDRC_DurDeb.Com_numCom237hAbsentDebDef_C DDRC_DurDeb.Com_numCom237hChecksumDebOk_C DDRC_DurDeb.Com_numCom237hChecksumDebDef_C DDRC_DurDeb.Com_numCom237hCounterDebOk_C DDRC_DurDeb.Com_numCom237hCounterDebDef_C DDRC_DurDeb.Com_numCom237hTooShortDebOk_C DDRC_DurDeb.Com_numCom237hTooShortDebDef_C DDRC_DurDeb.Com_numCom259hAbsentDebOk_C DDRC_DurDeb.Com_numCom259hAbsentDebDef_C DDRC_DurDeb.Com_numCom259hChecksumDebOk_C DDRC_DurDeb.Com_numCom259hChecksumDebDef_C DDRC_DurDeb.Com_numCom259hCounterDebOk_C DDRC_DurDeb.Com_numCom259hCounterDebDef_C DDRC_DurDeb.Com_numCom259hTooShortDebOk_C DDRC_DurDeb.Com_numCom259hTooShortDebDef_C DDRC_DurDeb.Com_numCom273hAbsentDebOk_C DDRC_DurDeb.Com_numCom273hAbsentDebDef_C DDRC_DurDeb.Com_numCom273hChecksumDebOk_C DDRC_DurDeb.Com_numCom273hChecksumDebDef_C DDRC_DurDeb.Com_numCom273hCounterDebOk_C DDRC_DurDeb.Com_numCom273hCounterDebDef_C DDRC_DurDeb.Com_numCom273hTooShortDebOk_C DDRC_DurDeb.Com_numCom273hTooShortDebDef_C DDRC_DurDeb.Com_numCom275hAbsentDebOk_C DDRC_DurDeb.Com_numCom275hAbsentDebDef_C DDRC_DurDeb.Com_numCom275hChecksumDebOk_C DDRC_DurDeb.Com_numCom275hChecksumDebDef_C DDRC_DurDeb.Com_numCom275hCounterDebOk_C DDRC_DurDeb.Com_numCom275hCounterDebDef_C DDRC_DurDeb.Com_numCom275hTooShortDebOk_C DDRC_DurDeb.Com_numCom275hTooShortDebDef_C DDRC_DurDeb.Com_numCom283hAbsentDebOk_C DDRC_DurDeb.Com_numCom283hAbsentDebDef_C DDRC_DurDeb.Com_numCom283hTooShortDebOk_C DDRC_DurDeb.Com_numCom283hTooShortDebDef_C DDRC_DurDeb.Com_numCom285hAbsentDebOk_C DDRC_DurDeb.Com_numCom285hAbsentDebDef_C DDRC_DurDeb.Com_numCom285hChecksumDebOk_C DDRC_DurDeb.Com_numCom285hChecksumDebDef_C DDRC_DurDeb.Com_numCom285hCounterDebOk_C DDRC_DurDeb.Com_numCom285hCounterDebDef_C DDRC_DurDeb.Com_numCom285hTooShortDebOk_C DDRC_DurDeb.Com_numCom285hTooShortDebDef_C DDRC_DurDeb.Com_numCom293hAbsentDebOk_C DDRC_DurDeb.Com_numCom293hAbsentDebDef_C DDRC_DurDeb.Com_numCom293hChecksumDebOk_C DDRC_DurDeb.Com_numCom293hChecksumDebDef_C DDRC_DurDeb.Com_numCom293hCounterDebOk_C DDRC_DurDeb.Com_numCom293hCounterDebDef_C DDRC_DurDeb.Com_numCom293hTooShortDebOk_C DDRC_DurDeb.Com_numCom293hTooShortDebDef_C DDRC_DurDeb.Com_numCom308hAbsentDebOk_C DDRC_DurDeb.Com_numCom308hAbsentDebDef_C DDRC_DurDeb.Com_numCom308hChecksumDebOk_C DDRC_DurDeb.Com_numCom308hChecksumDebDef_C DDRC_DurDeb.Com_numCom308hCounterDebOk_C DDRC_DurDeb.Com_numCom308hCounterDebDef_C DDRC_DurDeb.Com_numCom308hTooShortDebOk_C DDRC_DurDeb.Com_numCom308hTooShortDebDef_C DDRC_DurDeb.Com_numCom318hAbsentDebOk_C DDRC_DurDeb.Com_numCom318hAbsentDebDef_C DDRC_DurDeb.Com_numCom318hChecksumDebOk_C DDRC_DurDeb.Com_numCom318hChecksumDebDef_C DDRC_DurDeb.Com_numCom318hCounterDebOk_C DDRC_DurDeb.Com_numCom318hCounterDebDef_C DDRC_DurDeb.Com_numCom318hTooShortDebOk_C DDRC_DurDeb.Com_numCom318hTooShortDebDef_C DDRC_DurDeb.Com_numCom325hAbsentDebOk_C DDRC_DurDeb.Com_numCom325hAbsentDebDef_C DDRC_DurDeb.Com_numCom325hChecksumDebOk_C DDRC_DurDeb.Com_numCom325hChecksumDebDef_C DDRC_DurDeb.Com_numCom325hCounterDebOk_C DDRC_DurDeb.Com_numCom325hCounterDebDef_C DDRC_DurDeb.Com_numCom325hTooShortDebOk_C DDRC_DurDeb.Com_numCom325hTooShortDebDef_C DDRC_DurDeb.Com_numCom335hAbsentDebOk_C DDRC_DurDeb.Com_numCom335hAbsentDebDef_C DDRC_DurDeb.Com_numCom335hChecksumDebOk_C DDRC_DurDeb.Com_numCom335hChecksumDebDef_C DDRC_DurDeb.Com_numCom335hCounterDebOk_C DDRC_DurDeb.Com_numCom335hCounterDebDef_C DDRC_DurDeb.Com_numCom335hTooShortDebOk_C DDRC_DurDeb.Com_numCom335hTooShortDebDef_C DDRC_DurDeb.Com_numCom351hAbsentDebOk_C DDRC_DurDeb.Com_numCom351hAbsentDebDef_C DDRC_DurDeb.Com_numCom351hTooShortDebOk_C DDRC_DurDeb.Com_numCom351hTooShortDebDef_C DDRC_DurDeb.Com_numCom38DhAbsentDebOk_C DDRC_DurDeb.Com_numCom38DhAbsentDebDef_C DDRC_DurDeb.Com_numCom38DhChecksumDebOk_C DDRC_DurDeb.Com_numCom38DhChecksumDebDef_C DDRC_DurDeb.Com_numCom38DhCounterDebOk_C DDRC_DurDeb.Com_numCom38DhCounterDebDef_C DDRC_DurDeb.Com_numCom38DhTooShortDebOk_C DDRC_DurDeb.Com_numCom38DhTooShortDebDef_C DDRC_DurDeb.Com_numCom412hAbsentDebOk_C DDRC_DurDeb.Com_numCom412hAbsentDebDef_C DDRC_DurDeb.Com_numCom412hChecksumDebOk_C DDRC_DurDeb.Com_numCom412hChecksumDebDef_C DDRC_DurDeb.Com_numCom412hCounterDebOk_C DDRC_DurDeb.Com_numCom412hCounterDebDef_C DDRC_DurDeb.Com_numCom412hTooShortDebOk_C DDRC_DurDeb.Com_numCom412hTooShortDebDef_C DDRC_DurDeb.Com_numCom427hAbsentDebOk_C DDRC_DurDeb.Com_numCom427hAbsentDebDef_C DDRC_DurDeb.Com_numCom427hTooShortDebOk_C DDRC_DurDeb.Com_numCom427hTooShortDebDef_C DDRC_DurDeb.Com_numCom432hAbsentDebOk_C DDRC_DurDeb.Com_numCom432hAbsentDebDef_C DDRC_DurDeb.Com_numCom432hChecksumDebOk_C DDRC_DurDeb.Com_numCom432hChecksumDebDef_C DDRC_DurDeb.Com_numCom432hCounterDebOk_C DDRC_DurDeb.Com_numCom432hCounterDebDef_C DDRC_DurDeb.Com_numCom432hTooShortDebOk_C DDRC_DurDeb.Com_numCom432hTooShortDebDef_C DDRC_DurDeb.Com_numCom435hAbsentDebOk_C DDRC_DurDeb.Com_numCom435hAbsentDebDef_C DDRC_DurDeb.Com_numCom435hTooShortDebOk_C DDRC_DurDeb.Com_numCom435hTooShortDebDef_C DDRC_DurDeb.Com_numCom442hAbsentDebOk_C DDRC_DurDeb.Com_numCom442hAbsentDebDef_C DDRC_DurDeb.Com_numCom442hTooShortDebOk_C DDRC_DurDeb.Com_numCom442hTooShortDebDef_C DDRC_DurDeb.Com_numCom453hAbsentDebOk_C DDRC_DurDeb.Com_numCom453hAbsentDebDef_C DDRC_DurDeb.Com_numCom453hTooShortDebOk_C DDRC_DurDeb.Com_numCom453hTooShortDebDef_C DDRC_DurDeb.Com_numCom455hAbsentDebOk_C DDRC_DurDeb.Com_numCom455hAbsentDebDef_C DDRC_DurDeb.Com_numCom455hTooShortDebOk_C DDRC_DurDeb.Com_numCom455hTooShortDebDef_C DDRC_DurDeb.Com_numCom463hAbsentDebOk_C DDRC_DurDeb.Com_numCom463hAbsentDebDef_C DDRC_DurDeb.Com_numCom463hTooShortDebOk_C DDRC_DurDeb.Com_numCom463hTooShortDebDef_C DDRC_DurDeb.Com_numCom473hAbsentDebOk_C DDRC_DurDeb.Com_numCom473hAbsentDebDef_C DDRC_DurDeb.Com_numCom473hTooShortDebOk_C DDRC_DurDeb.Com_numCom473hTooShortDebDef_C DDRC_DurDeb.Com_numCom47BhAbsentDebOk_C DDRC_DurDeb.Com_numCom47BhAbsentDebDef_C DDRC_DurDeb.Com_numCom47BhTooShortDebOk_C DDRC_DurDeb.Com_numCom47BhTooShortDebDef_C DDRC_DurDeb.Com_numCom48BhAbsentDebOk_C DDRC_DurDeb.Com_numCom48BhAbsentDebDef_C DDRC_DurDeb.Com_numCom48BhTooShortDebOk_C DDRC_DurDeb.Com_numCom48BhTooShortDebDef_C DDRC_DurDeb.Com_numCom497hTooShortDebOk_C DDRC_DurDeb.Com_numCom497hTooShortDebDef_C DDRC_DurDeb.Com_numCom4F2hAbsentDebOk_C DDRC_DurDeb.Com_numCom4F2hAbsentDebDef_C DDRC_DurDeb.Com_numCom4F2hChecksumDebOk_C DDRC_DurDeb.Com_numCom4F2hChecksumDebDef_C DDRC_DurDeb.Com_numCom4F2hCounterDebOk_C DDRC_DurDeb.Com_numCom4F2hCounterDebDef_C DDRC_DurDeb.Com_numCom4F2hTooShortDebOk_C DDRC_DurDeb.Com_numCom4F2hTooShortDebDef_C DDRC_DurDeb.Com_numCom50DhAbsentDebOk_C DDRC_DurDeb.Com_numCom50DhAbsentDebDef_C DDRC_DurDeb.Com_numCom50DhTooShortDebOk_C DDRC_DurDeb.Com_numCom50DhTooShortDebDef_C DDRC_DurDeb.Com_numCom535hAbsentDebOk_C DDRC_DurDeb.Com_numCom535hAbsentDebDef_C DDRC_DurDeb.Com_numCom535hTooShortDebOk_C DDRC_DurDeb.Com_numCom535hTooShortDebDef_C DDRC_DurDeb.Com_numCom543hAbsentDebOk_C DDRC_DurDeb.Com_numCom543hAbsentDebDef_C DDRC_DurDeb.Com_numCom543hTooShortDebOk_C DDRC_DurDeb.Com_numCom543hTooShortDebDef_C DDRC_DurDeb.Com_numCom552hAbsentDebOk_C DDRC_DurDeb.Com_numCom552hAbsentDebDef_C DDRC_DurDeb.Com_numCom552hTooShortDebOk_C DDRC_DurDeb.Com_numCom552hTooShortDebDef_C DDRC_DurDeb.Com_numCom583hAbsentDebOk_C DDRC_DurDeb.Com_numCom583hAbsentDebDef_C DDRC_DurDeb.Com_numCom583hTooShortDebOk_C DDRC_DurDeb.Com_numCom583hTooShortDebDef_C DDRC_DurDeb.Com_numCom592hAbsentDebOk_C DDRC_DurDeb.Com_numCom592hAbsentDebDef_C DDRC_DurDeb.Com_numCom592hChecksumDebOk_C DDRC_DurDeb.Com_numCom592hChecksumDebDef_C DDRC_DurDeb.Com_numCom592hCounterDebOk_C DDRC_DurDeb.Com_numCom592hCounterDebDef_C DDRC_DurDeb.Com_numCom592hTooShortDebOk_C DDRC_DurDeb.Com_numCom592hTooShortDebDef_C DDRC_DurDeb.Com_numCom595hAbsentDebOk_C DDRC_DurDeb.Com_numCom595hAbsentDebDef_C DDRC_DurDeb.Com_numCom595hChecksumDebOk_C DDRC_DurDeb.Com_numCom595hChecksumDebDef_C DDRC_DurDeb.Com_numCom595hCounterDebOk_C DDRC_DurDeb.Com_numCom595hCounterDebDef_C DDRC_DurDeb.Com_numCom595hTooShortDebOk_C DDRC_DurDeb.Com_numCom595hTooShortDebDef_C DDRC_DurDeb.Com_numCom5B2hTooShortDebOk_C DDRC_DurDeb.Com_numCom5B2hTooShortDebDef_C DDRC_DurDeb.Com_numCom5B5hAbsentDebOk_C DDRC_DurDeb.Com_numCom5B5hAbsentDebDef_C DDRC_DurDeb.Com_numCom5B5hChecksumDebOk_C DDRC_DurDeb.Com_numCom5B5hChecksumDebDef_C DDRC_DurDeb.Com_numCom5B5hCounterDebOk_C DDRC_DurDeb.Com_numCom5B5hCounterDebDef_C DDRC_DurDeb.Com_numCom5B5hTooShortDebOk_C DDRC_DurDeb.Com_numCom5B5hTooShortDebDef_C DDRC_DurDeb.Com_numCom5C7hTooShortDebOk_C DDRC_DurDeb.Com_numCom5C7hTooShortDebDef_C DDRC_DurDeb.Com_numCom5E7hAbsentDebOk_C DDRC_DurDeb.Com_numCom5E7hAbsentDebDef_C DDRC_DurDeb.Com_numCom5E7hTooShortDebOk_C DDRC_DurDeb.Com_numCom5E7hTooShortDebDef_C DDRC_DurDeb.Com_numCom635hTooShortDebOk_C DDRC_DurDeb.Com_numCom635hTooShortDebDef_C DDRC_DurDeb.Com_numCom645hTooShortDebOk_C DDRC_DurDeb.Com_numCom645hTooShortDebDef_C DDRC_DurDeb.Com_numCom663hAbsentDebOk_C DDRC_DurDeb.Com_numCom663hAbsentDebDef_C DDRC_DurDeb.Com_numCom663hTooShortDebOk_C DDRC_DurDeb.Com_numCom663hTooShortDebDef_C DDRC_DurDeb.Com_numCom665hAbsentDebOk_C DDRC_DurDeb.Com_numCom665hAbsentDebDef_C DDRC_DurDeb.Com_numCom665hTooShortDebOk_C DDRC_DurDeb.Com_numCom665hTooShortDebDef_C DDRC_DurDeb.Com_numCom675hAbsentDebOk_C DDRC_DurDeb.Com_numCom675hAbsentDebDef_C DDRC_DurDeb.Com_numCom675hTooShortDebOk_C DDRC_DurDeb.Com_numCom675hTooShortDebDef_C DDRC_DurDeb.Com_numComFrbd_205h_HVBAT_PACK_CURRENTDebOk_C DDRC_DurDeb.Com_numComFrbd_205h_HVBAT_PACK_CURRENTDebDef_C DDRC_DurDeb.Com_numComFrbd_205h_HVBAT_SOC_DISPLAYDebOk_C DDRC_DurDeb.Com_numComFrbd_205h_HVBAT_SOC_DISPLAYDebDef_C DDRC_DurDeb.Com_numComFrbd_205h_HVBAT_VOLTAGEDebOk_C DDRC_DurDeb.Com_numComFrbd_205h_HVBAT_VOLTAGEDebDef_C DDRC_DurDeb.Com_numComFrbd_217h_INV_DC_BUS_VOLTAGEDebOk_C DDRC_DurDeb.Com_numComFrbd_217h_INV_DC_BUS_VOLTAGEDebDef_C DDRC_DurDeb.Com_numComFrbd_217h_INV_MTR_ACTUAL_TRQDebOk_C DDRC_DurDeb.Com_numComFrbd_217h_INV_MTR_ACTUAL_TRQDebDef_C DDRC_DurDeb.Com_numComFrbd_217h_INV_MTR_SPEEDDebOk_C DDRC_DurDeb.Com_numComFrbd_217h_INV_MTR_SPEEDDebDef_C DDRC_DurDeb.Com_numComFrbd_217h_INV_MTR_TRQDebOk_C DDRC_DurDeb.Com_numComFrbd_217h_INV_MTR_TRQDebDef_C DDRC_DurDeb.Com_numComFrbd_227h_INV_DC_CURRENTDebOk_C DDRC_DurDeb.Com_numComFrbd_227h_INV_DC_CURRENTDebDef_C DDRC_DurDeb.Com_numComFrbd_227h_INV_MOTORING_PEAK_TRQDebOk_C DDRC_DurDeb.Com_numComFrbd_227h_INV_MOTORING_PEAK_TRQDebDef_C DDRC_DurDeb.Com_numComFrbd_227h_INV_MTR_INST_INPUT_POWERDebOk_C DDRC_DurDeb.Com_numComFrbd_227h_INV_MTR_INST_INPUT_POWERDebDef_C DDRC_DurDeb.Com_numComFrbd_227h_INV_REGEN_PEAK_TRQDebOk_C DDRC_DurDeb.Com_numComFrbd_227h_INV_REGEN_PEAK_TRQDebDef_C DDRC_DurDeb.Com_numComFrbd_237h_INV_ACTIVE_DISCHARGE_STATUSDebOk_C DDRC_DurDeb.Com_numComFrbd_237h_INV_ACTIVE_DISCHARGE_STATUSDebDef_C DDRC_DurDeb.Com_numComFrbd_237h_INV_CTRL_MODE_ACKDebOk_C DDRC_DurDeb.Com_numComFrbd_237h_INV_CTRL_MODE_ACKDebDef_C DDRC_DurDeb.Com_numComFrbd_237h_INV_EV_WARNINGDebOk_C DDRC_DurDeb.Com_numComFrbd_237h_INV_EV_WARNINGDebDef_C DDRC_DurDeb.Com_numComFrbd_237h_INV_FAULT_LEVELDebOk_C DDRC_DurDeb.Com_numComFrbd_237h_INV_FAULT_LEVELDebDef_C DDRC_DurDeb.Com_numComFrbd_237h_INV_MASTER_STOPDebOk_C DDRC_DurDeb.Com_numComFrbd_237h_INV_MASTER_STOPDebDef_C DDRC_DurDeb.Com_numComFrbd_237h_INV_SERVICE_DUEDebOk_C DDRC_DurDeb.Com_numComFrbd_237h_INV_SERVICE_DUEDebDef_C DDRC_DurDeb.Com_numComFrbd_237h_INV_STAB_MIN_TRQDebOk_C DDRC_DurDeb.Com_numComFrbd_237h_INV_STAB_MIN_TRQDebDef_C DDRC_DurDeb.Com_numComFrbd_259h_TGLM_FAILURE_STATEDebOk_C DDRC_DurDeb.Com_numComFrbd_259h_TGLM_FAILURE_STATEDebDef_C DDRC_DurDeb.Com_numComFrbd_259h_TGLM_MODE_PUSHDebOk_C DDRC_DurDeb.Com_numComFrbd_259h_TGLM_MODE_PUSHDebDef_C DDRC_DurDeb.Com_numComFrbd_259h_TOGGLE_MONOSTABLE_POSDebOk_C DDRC_DurDeb.Com_numComFrbd_259h_TOGGLE_MONOSTABLE_POSDebDef_C DDRC_DurDeb.Com_numComFrbd_273h_OBC_outputpower_capabilityDebOk_C DDRC_DurDeb.Com_numComFrbd_273h_OBC_outputpower_capabilityDebDef_C DDRC_DurDeb.Com_numComFrbd_275h_HVBAT_DISCHARGE_30S_AVAILABLE_CURRENTDebOk_C DDRC_DurDeb.Com_numComFrbd_275h_HVBAT_DISCHARGE_30S_AVAILABLE_CURRENTDebDef_C DDRC_DurDeb.Com_numComFrbd_275h_HVBAT_DISCHARGE_30S_AVAILABLE_POWERDebOk_C DDRC_DurDeb.Com_numComFrbd_275h_HVBAT_DISCHARGE_30S_AVAILABLE_POWERDebDef_C DDRC_DurDeb.Com_numComFrbd_283h_DCDC_IN_CURRENTDebOk_C DDRC_DurDeb.Com_numComFrbd_283h_DCDC_IN_CURRENTDebDef_C DDRC_DurDeb.Com_numComFrbd_283h_DCDC_IN_VOLTAGEDebOk_C DDRC_DurDeb.Com_numComFrbd_283h_DCDC_IN_VOLTAGEDebDef_C DDRC_DurDeb.Com_numComFrbd_283h_DCDC_OUT_CURRENTDebOk_C DDRC_DurDeb.Com_numComFrbd_283h_DCDC_OUT_CURRENTDebDef_C DDRC_DurDeb.Com_numComFrbd_283h_DCDC_OUT_VOLTAGEDebOk_C DDRC_DurDeb.Com_numComFrbd_283h_DCDC_OUT_VOLTAGEDebDef_C DDRC_DurDeb.Com_numComFrbd_285h_HVBAT_REGEN_CHG_30S_CURRENT_LIMITDebOk_C DDRC_DurDeb.Com_numComFrbd_285h_HVBAT_REGEN_CHG_30S_CURRENT_LIMITDebDef_C DDRC_DurDeb.Com_numComFrbd_285h_HVBAT_REGEN_CHRG_30S_POWER_LIMITDebOk_C DDRC_DurDeb.Com_numComFrbd_285h_HVBAT_REGEN_CHRG_30S_POWER_LIMITDebDef_C DDRC_DurDeb.Com_numComFrbd_293h_DCDC_outputpower_capabilityDebOk_C DDRC_DurDeb.Com_numComFrbd_293h_DCDC_outputpower_capabilityDebDef_C DDRC_DurDeb.Com_numComFrbd_325h_HVBAT_INSULATION_RESISTANCEDebOk_C DDRC_DurDeb.Com_numComFrbd_325h_HVBAT_INSULATION_RESISTANCEDebDef_C DDRC_DurDeb.Com_numComFrbd_325h_HVBAT_TEMPERATUREDebOk_C DDRC_DurDeb.Com_numComFrbd_325h_HVBAT_TEMPERATUREDebDef_C DDRC_DurDeb.Com_numComFrbd_335h_HVBAT_CHRG_CONTINUOUS_CURR_MAXDebOk_C DDRC_DurDeb.Com_numComFrbd_335h_HVBAT_CHRG_CONTINUOUS_CURR_MAXDebDef_C DDRC_DurDeb.Com_numComFrbd_335h_HVBAT_CHRG_COTINUOUS_CURR_REQDebOk_C DDRC_DurDeb.Com_numComFrbd_335h_HVBAT_CHRG_COTINUOUS_CURR_REQDebDef_C DDRC_DurDeb.Com_numComFrbd_335h_HVBAT_CHRG_MAX_VOLTDebOk_C DDRC_DurDeb.Com_numComFrbd_335h_HVBAT_CHRG_MAX_VOLTDebDef_C DDRC_DurDeb.Com_numComFrbd_335h_HVBAT_DC_BUS_VOLTAGEDebOk_C DDRC_DurDeb.Com_numComFrbd_335h_HVBAT_DC_BUS_VOLTAGEDebDef_C DDRC_DurDeb.Com_numComFrbd_427h_INV_OP_MODEDebOk_C DDRC_DurDeb.Com_numComFrbd_427h_INV_OP_MODEDebDef_C DDRC_DurDeb.Com_numComFrbd_427h_INV_PERMISIBLE_TORQUEDebOk_C DDRC_DurDeb.Com_numComFrbd_427h_INV_PERMISIBLE_TORQUEDebDef_C DDRC_DurDeb.Com_numComFrbd_435h_HVBAT_MAX_CELL_VOLTDebOk_C DDRC_DurDeb.Com_numComFrbd_435h_HVBAT_MAX_CELL_VOLTDebDef_C DDRC_DurDeb.Com_numComFrbd_435h_HVBAT_MAX_CELL_VOLT_NUMDebOk_C DDRC_DurDeb.Com_numComFrbd_435h_HVBAT_MAX_CELL_VOLT_NUMDebDef_C DDRC_DurDeb.Com_numComFrbd_435h_HVBAT_MAX_SENSOR_TEMPDebOk_C DDRC_DurDeb.Com_numComFrbd_435h_HVBAT_MAX_SENSOR_TEMPDebDef_C DDRC_DurDeb.Com_numComFrbd_435h_HVBAT_MIN_CELL_VOLTDebOk_C DDRC_DurDeb.Com_numComFrbd_435h_HVBAT_MIN_CELL_VOLTDebDef_C DDRC_DurDeb.Com_numComFrbd_435h_HVBAT_MIN_CELL_VOLT_NUMDebOk_C DDRC_DurDeb.Com_numComFrbd_435h_HVBAT_MIN_CELL_VOLT_NUMDebDef_C DDRC_DurDeb.Com_numComFrbd_453h_OBC_IN_CURRENTDebOk_C DDRC_DurDeb.Com_numComFrbd_453h_OBC_IN_CURRENTDebDef_C DDRC_DurDeb.Com_numComFrbd_453h_OBC_IN_VOLTAGEDebOk_C DDRC_DurDeb.Com_numComFrbd_453h_OBC_IN_VOLTAGEDebDef_C DDRC_DurDeb.Com_numComFrbd_453h_OBC_IP_POWERDebOk_C DDRC_DurDeb.Com_numComFrbd_453h_OBC_IP_POWERDebDef_C DDRC_DurDeb.Com_numComFrbd_455h_HVBAT_NOMINAL_VOLTAGEDebOk_C DDRC_DurDeb.Com_numComFrbd_455h_HVBAT_NOMINAL_VOLTAGEDebDef_C DDRC_DurDeb.Com_numComFrbd_463h_OBC_OUT_CURRENTDebOk_C DDRC_DurDeb.Com_numComFrbd_463h_OBC_OUT_CURRENTDebDef_C DDRC_DurDeb.Com_numComFrbd_463h_OBC_OUT_VOLTAGEDebOk_C DDRC_DurDeb.Com_numComFrbd_463h_OBC_OUT_VOLTAGEDebDef_C DDRC_DurDeb.Com_numComFrbd_463h_OBC_TEMPERATUREDebOk_C DDRC_DurDeb.Com_numComFrbd_463h_OBC_TEMPERATUREDebDef_C DDRC_DurDeb.Com_numComFrbd_473h_DCDC_Coolant_TemperatureDebOk_C DDRC_DurDeb.Com_numComFrbd_473h_DCDC_Coolant_TemperatureDebDef_C DDRC_DurDeb.Com_numComFrbd_473h_DCDC_TEMPERATUREDebOk_C DDRC_DurDeb.Com_numComFrbd_473h_DCDC_TEMPERATUREDebDef_C DDRC_DurDeb.Com_numComFrbd_47Bh_eCOMP_BusBarCurrentDebOk_C DDRC_DurDeb.Com_numComFrbd_47Bh_eCOMP_BusBarCurrentDebDef_C DDRC_DurDeb.Com_numComFrbd_47Bh_eCOMP_BusBarVoltageDebOk_C DDRC_DurDeb.Com_numComFrbd_47Bh_eCOMP_BusBarVoltageDebDef_C DDRC_DurDeb.Com_numComFrbd_47Bh_eCOMP_CompressorSpeedDebOk_C DDRC_DurDeb.Com_numComFrbd_47Bh_eCOMP_CompressorSpeedDebDef_C DDRC_DurDeb.Com_numComFrbd_47Bh_eCOMP_IGBT_TempDebOk_C DDRC_DurDeb.Com_numComFrbd_47Bh_eCOMP_IGBT_TempDebDef_C DDRC_DurDeb.Com_numComFrbd_47Bh_eCOMP_PeakPhaCurrentDebOk_C DDRC_DurDeb.Com_numComFrbd_47Bh_eCOMP_PeakPhaCurrentDebDef_C DDRC_DurDeb.Com_numComFrbd_47Bh_eCOMP_Power_consumptionDebOk_C DDRC_DurDeb.Com_numComFrbd_47Bh_eCOMP_Power_consumptionDebDef_C DDRC_DurDeb.Com_numComFrbd_48Bh_eCOMP_Fault_LevelDebOk_C DDRC_DurDeb.Com_numComFrbd_48Bh_eCOMP_Fault_LevelDebDef_C DDRC_DurDeb.Com_numComFrbd_4F2h_VALEUR_SOC_ETENDUEDebOk_C DDRC_DurDeb.Com_numComFrbd_4F2h_VALEUR_SOC_ETENDUEDebDef_C DDRC_DurDeb.Com_numComFrbd_535h_HV_BATT_TEMP_AVGDebOk_C DDRC_DurDeb.Com_numComFrbd_535h_HV_BATT_TEMP_AVGDebDef_C DDRC_DurDeb.Com_numComFrbd_543h_HVBAT_RESTBATTENERGYDebOk_C DDRC_DurDeb.Com_numComFrbd_543h_HVBAT_RESTBATTENERGYDebDef_C DDRC_DurDeb.Com_numComFrbd_543h_HVBAT_SOHDebOk_C DDRC_DurDeb.Com_numComFrbd_543h_HVBAT_SOHDebDef_C DDRC_DurDeb.Com_numComFrbd_543h_HV_BATT_SOH_RESDebOk_C DDRC_DurDeb.Com_numComFrbd_543h_HV_BATT_SOH_RESDebDef_C DDRC_DurDeb.Com_numComFrbd_592h_IBATT_1DebOk_C DDRC_DurDeb.Com_numComFrbd_592h_IBATT_1DebDef_C DDRC_DurDeb.Com_numComFrbd_592h_IBATT_2DebOk_C DDRC_DurDeb.Com_numComFrbd_592h_IBATT_2DebDef_C DDRC_DurDeb.Com_numComFrbd_592h_IBATT_3DebOk_C DDRC_DurDeb.Com_numComFrbd_592h_IBATT_3DebDef_C DDRC_DurDeb.Com_numComFrbd_592h_TEMP_BATTDebOk_C DDRC_DurDeb.Com_numComFrbd_592h_TEMP_BATTDebDef_C DDRC_DurDeb.Com_numComFrbd_592h_U_BATT_BECBDebOk_C DDRC_DurDeb.Com_numComFrbd_592h_U_BATT_BECBDebDef_C DDRC_DurDeb.Com_numComFrbd_595h_HVBAT_TIME_TO_CHRG_80DebOk_C DDRC_DurDeb.Com_numComFrbd_595h_HVBAT_TIME_TO_CHRG_80DebDef_C DDRC_DurDeb.Com_numComFrbd_5B2h_TEMP_AIR_EXTDebOk_C DDRC_DurDeb.Com_numComFrbd_5B2h_TEMP_AIR_EXTDebDef_C DDRC_DurDeb.Com_numComFrbd_635h_HVBAT_NEG_CONT_COUNT_SEG1DebOk_C DDRC_DurDeb.Com_numComFrbd_635h_HVBAT_NEG_CONT_COUNT_SEG1DebDef_C DDRC_DurDeb.Com_numComFrbd_635h_HVBAT_NEG_CONT_COUNT_SEG3DebOk_C DDRC_DurDeb.Com_numComFrbd_635h_HVBAT_NEG_CONT_COUNT_SEG3DebDef_C DDRC_DurDeb.Com_numComFrbd_635h_HVBAT_NEG_CONT_COUNT_SEG4DebOk_C DDRC_DurDeb.Com_numComFrbd_635h_HVBAT_NEG_CONT_COUNT_SEG4DebDef_C DDRC_DurDeb.Com_numComFrbd_635h_HVBAT_PST_CONT_COUNT_SEG1DebOk_C DDRC_DurDeb.Com_numComFrbd_635h_HVBAT_PST_CONT_COUNT_SEG1DebDef_C DDRC_DurDeb.Com_numComFrbd_635h_HVBAT_PST_CONT_COUNT_SEG3DebOk_C DDRC_DurDeb.Com_numComFrbd_635h_HVBAT_PST_CONT_COUNT_SEG3DebDef_C DDRC_DurDeb.Com_numComFrbd_635h_HVBAT_PST_CONT_COUNT_SEG4DebOk_C DDRC_DurDeb.Com_numComFrbd_635h_HVBAT_PST_CONT_COUNT_SEG4DebDef_C DDRC_DurDeb.Com_numComFrbd_645h_HVBAT_PRECHRGE_CONT_COUNT_SEG1DebOk_C DDRC_DurDeb.Com_numComFrbd_645h_HVBAT_PRECHRGE_CONT_COUNT_SEG1DebDef_C DDRC_DurDeb.Com_numComFrbd_645h_HVBAT_PRECHRGE_CONT_COUNT_SEG2DebOk_C DDRC_DurDeb.Com_numComFrbd_645h_HVBAT_PRECHRGE_CONT_COUNT_SEG2DebDef_C DDRC_DurDeb.Com_numComFrbd_675h_HVBAT_REMAININGBATTCAPACITYDebOk_C DDRC_DurDeb.Com_numComFrbd_675h_HVBAT_REMAININGBATTCAPACITYDebDef_C DDRC_DurDeb.Com_numComInvld_205h_HVBAT_CHARGING_STATUSDebOk_C DDRC_DurDeb.Com_numComInvld_205h_HVBAT_CHARGING_STATUSDebDef_C DDRC_DurDeb.Com_numComInvld_205h_HVBAT_PACK_CURRENTDebOk_C DDRC_DurDeb.Com_numComInvld_205h_HVBAT_PACK_CURRENTDebDef_C DDRC_DurDeb.Com_numComInvld_205h_HVBAT_SOC_DISPLAYDebOk_C DDRC_DurDeb.Com_numComInvld_205h_HVBAT_SOC_DISPLAYDebDef_C DDRC_DurDeb.Com_numComInvld_205h_HVBAT_VOLTAGEDebOk_C DDRC_DurDeb.Com_numComInvld_205h_HVBAT_VOLTAGEDebDef_C DDRC_DurDeb.Com_numComInvld_217h_INV_DC_BUS_VOLTAGEDebOk_C DDRC_DurDeb.Com_numComInvld_217h_INV_DC_BUS_VOLTAGEDebDef_C DDRC_DurDeb.Com_numComInvld_217h_INV_MTR_ACTUAL_TRQDebOk_C DDRC_DurDeb.Com_numComInvld_217h_INV_MTR_ACTUAL_TRQDebDef_C DDRC_DurDeb.Com_numComInvld_217h_INV_MTR_SPEEDDebOk_C DDRC_DurDeb.Com_numComInvld_217h_INV_MTR_SPEEDDebDef_C DDRC_DurDeb.Com_numComInvld_217h_INV_MTR_TRQDebOk_C DDRC_DurDeb.Com_numComInvld_217h_INV_MTR_TRQDebDef_C DDRC_DurDeb.Com_numComInvld_227h_INV_DC_CURRENTDebOk_C DDRC_DurDeb.Com_numComInvld_227h_INV_DC_CURRENTDebDef_C DDRC_DurDeb.Com_numComInvld_227h_INV_MOTORING_PEAK_TRQDebOk_C DDRC_DurDeb.Com_numComInvld_227h_INV_MOTORING_PEAK_TRQDebDef_C DDRC_DurDeb.Com_numComInvld_227h_INV_MTR_INST_INPUT_POWERDebOk_C DDRC_DurDeb.Com_numComInvld_227h_INV_MTR_INST_INPUT_POWERDebDef_C DDRC_DurDeb.Com_numComInvld_227h_INV_REGEN_PEAK_TRQDebOk_C DDRC_DurDeb.Com_numComInvld_227h_INV_REGEN_PEAK_TRQDebDef_C DDRC_DurDeb.Com_numComInvld_237h_INV_ACTIVE_DISCHARGE_STATUSDebOk_C DDRC_DurDeb.Com_numComInvld_237h_INV_ACTIVE_DISCHARGE_STATUSDebDef_C DDRC_DurDeb.Com_numComInvld_237h_INV_FAULT_LEVELDebOk_C DDRC_DurDeb.Com_numComInvld_237h_INV_FAULT_LEVELDebDef_C DDRC_DurDeb.Com_numComInvld_237h_INV_STAB_MIN_TRQDebOk_C DDRC_DurDeb.Com_numComInvld_237h_INV_STAB_MIN_TRQDebDef_C DDRC_DurDeb.Com_numComInvld_259h_TGLM_MODE_PUSHDebOk_C DDRC_DurDeb.Com_numComInvld_259h_TGLM_MODE_PUSHDebDef_C DDRC_DurDeb.Com_numComInvld_259h_TOGGLE_MONOSTABLE_POSDebOk_C DDRC_DurDeb.Com_numComInvld_259h_TOGGLE_MONOSTABLE_POSDebDef_C DDRC_DurDeb.Com_numComInvld_273h_OBC_FAULT_LEVELDebOk_C DDRC_DurDeb.Com_numComInvld_273h_OBC_FAULT_LEVELDebDef_C DDRC_DurDeb.Com_numComInvld_273h_OBC_outputpower_capabilityDebOk_C DDRC_DurDeb.Com_numComInvld_273h_OBC_outputpower_capabilityDebDef_C DDRC_DurDeb.Com_numComInvld_275h_HVBAT_DISCHARGE_30S_AVAILABLE_CURRENTDebOk_C DDRC_DurDeb.Com_numComInvld_275h_HVBAT_DISCHARGE_30S_AVAILABLE_CURRENTDebDef_C DDRC_DurDeb.Com_numComInvld_275h_HVBAT_DISCHARGE_30S_AVAILABLE_POWERDebOk_C DDRC_DurDeb.Com_numComInvld_275h_HVBAT_DISCHARGE_30S_AVAILABLE_POWERDebDef_C DDRC_DurDeb.Com_numComInvld_283h_DCDC_IN_CURRENTDebOk_C DDRC_DurDeb.Com_numComInvld_283h_DCDC_IN_CURRENTDebDef_C DDRC_DurDeb.Com_numComInvld_283h_DCDC_IN_VOLTAGEDebOk_C DDRC_DurDeb.Com_numComInvld_283h_DCDC_IN_VOLTAGEDebDef_C DDRC_DurDeb.Com_numComInvld_283h_DCDC_OUT_CURRENTDebOk_C DDRC_DurDeb.Com_numComInvld_283h_DCDC_OUT_CURRENTDebDef_C DDRC_DurDeb.Com_numComInvld_283h_DCDC_OUT_VOLTAGEDebOk_C DDRC_DurDeb.Com_numComInvld_283h_DCDC_OUT_VOLTAGEDebDef_C DDRC_DurDeb.Com_numComInvld_285h_HVBAT_REGEN_CHG_30S_CURRENT_LIMITDebOk_C DDRC_DurDeb.Com_numComInvld_285h_HVBAT_REGEN_CHG_30S_CURRENT_LIMITDebDef_C DDRC_DurDeb.Com_numComInvld_285h_HVBAT_REGEN_CHRG_30S_POWER_LIMITDebOk_C DDRC_DurDeb.Com_numComInvld_285h_HVBAT_REGEN_CHRG_30S_POWER_LIMITDebDef_C DDRC_DurDeb.Com_numComInvld_293h_DCDC_FAULT_LEVELDebOk_C DDRC_DurDeb.Com_numComInvld_293h_DCDC_FAULT_LEVELDebDef_C DDRC_DurDeb.Com_numComInvld_293h_DCDC_outputpower_capabilityDebOk_C DDRC_DurDeb.Com_numComInvld_293h_DCDC_outputpower_capabilityDebDef_C DDRC_DurDeb.Com_numComInvld_325h_HVBAT_EPLUG_STATUSDebOk_C DDRC_DurDeb.Com_numComInvld_325h_HVBAT_EPLUG_STATUSDebDef_C DDRC_DurDeb.Com_numComInvld_325h_HVBAT_HVIL_STSDebOk_C DDRC_DurDeb.Com_numComInvld_325h_HVBAT_HVIL_STSDebDef_C DDRC_DurDeb.Com_numComInvld_325h_HVBAT_INSULATION_FAULTDebOk_C DDRC_DurDeb.Com_numComInvld_325h_HVBAT_INSULATION_FAULTDebDef_C DDRC_DurDeb.Com_numComInvld_325h_HVBAT_INSULATION_RESISTANCEDebOk_C DDRC_DurDeb.Com_numComInvld_325h_HVBAT_INSULATION_RESISTANCEDebDef_C DDRC_DurDeb.Com_numComInvld_325h_HVBAT_TEMPERATUREDebOk_C DDRC_DurDeb.Com_numComInvld_325h_HVBAT_TEMPERATUREDebDef_C DDRC_DurDeb.Com_numComInvld_335h_HVBAT_CHRG_CONTINUOUS_CURR_MAXDebOk_C DDRC_DurDeb.Com_numComInvld_335h_HVBAT_CHRG_CONTINUOUS_CURR_MAXDebDef_C DDRC_DurDeb.Com_numComInvld_335h_HVBAT_CHRG_COTINUOUS_CURR_REQDebOk_C DDRC_DurDeb.Com_numComInvld_335h_HVBAT_CHRG_COTINUOUS_CURR_REQDebDef_C DDRC_DurDeb.Com_numComInvld_335h_HVBAT_CHRG_MAX_VOLTDebOk_C DDRC_DurDeb.Com_numComInvld_335h_HVBAT_CHRG_MAX_VOLTDebDef_C DDRC_DurDeb.Com_numComInvld_335h_HVBAT_DC_BUS_VOLTAGEDebOk_C DDRC_DurDeb.Com_numComInvld_335h_HVBAT_DC_BUS_VOLTAGEDebDef_C DDRC_DurDeb.Com_numComInvld_38Dh_VITESSE_VEHICULE_ROUESDebOk_C DDRC_DurDeb.Com_numComInvld_38Dh_VITESSE_VEHICULE_ROUESDebDef_C DDRC_DurDeb.Com_numComInvld_38Dh_VVH_INDISPDebOk_C DDRC_DurDeb.Com_numComInvld_38Dh_VVH_INDISPDebDef_C DDRC_DurDeb.Com_numComInvld_427h_INV_COOLANT_TEMPDebOk_C DDRC_DurDeb.Com_numComInvld_427h_INV_COOLANT_TEMPDebDef_C DDRC_DurDeb.Com_numComInvld_427h_INV_MOTOR_TEMPDebOk_C DDRC_DurDeb.Com_numComInvld_427h_INV_MOTOR_TEMPDebDef_C DDRC_DurDeb.Com_numComInvld_427h_INV_OP_MODEDebOk_C DDRC_DurDeb.Com_numComInvld_427h_INV_OP_MODEDebDef_C DDRC_DurDeb.Com_numComInvld_427h_INV_PERMISIBLE_TORQUEDebOk_C DDRC_DurDeb.Com_numComInvld_427h_INV_PERMISIBLE_TORQUEDebDef_C DDRC_DurDeb.Com_numComInvld_427h_INV_TEMPDebOk_C DDRC_DurDeb.Com_numComInvld_427h_INV_TEMPDebDef_C DDRC_DurDeb.Com_numComInvld_432h_REVEIL_PRINCIPALDebOk_C DDRC_DurDeb.Com_numComInvld_432h_REVEIL_PRINCIPALDebDef_C DDRC_DurDeb.Com_numComInvld_435h_HVBAT_MAX_CELL_VOLTDebOk_C DDRC_DurDeb.Com_numComInvld_435h_HVBAT_MAX_CELL_VOLTDebDef_C DDRC_DurDeb.Com_numComInvld_435h_HVBAT_MAX_CELL_VOLT_NUMDebOk_C DDRC_DurDeb.Com_numComInvld_435h_HVBAT_MAX_CELL_VOLT_NUMDebDef_C DDRC_DurDeb.Com_numComInvld_435h_HVBAT_MAX_SENSOR_TEMPDebOk_C DDRC_DurDeb.Com_numComInvld_435h_HVBAT_MAX_SENSOR_TEMPDebDef_C DDRC_DurDeb.Com_numComInvld_435h_HVBAT_MIN_CELL_VOLTDebOk_C DDRC_DurDeb.Com_numComInvld_435h_HVBAT_MIN_CELL_VOLTDebDef_C DDRC_DurDeb.Com_numComInvld_435h_HVBAT_MIN_CELL_VOLT_NUMDebOk_C DDRC_DurDeb.Com_numComInvld_435h_HVBAT_MIN_CELL_VOLT_NUMDebDef_C DDRC_DurDeb.Com_numComInvld_442h_BCCM_BLOWER_RELAY_STSDebOk_C DDRC_DurDeb.Com_numComInvld_442h_BCCM_BLOWER_RELAY_STSDebDef_C DDRC_DurDeb.Com_numComInvld_453h_OBC_IN_CURRENTDebOk_C DDRC_DurDeb.Com_numComInvld_453h_OBC_IN_CURRENTDebDef_C DDRC_DurDeb.Com_numComInvld_453h_OBC_IN_VOLTAGEDebOk_C DDRC_DurDeb.Com_numComInvld_453h_OBC_IN_VOLTAGEDebDef_C DDRC_DurDeb.Com_numComInvld_453h_OBC_IP_POWERDebOk_C DDRC_DurDeb.Com_numComInvld_453h_OBC_IP_POWERDebDef_C DDRC_DurDeb.Com_numComInvld_455h_HVBAT_NOMINAL_VOLTAGEDebOk_C DDRC_DurDeb.Com_numComInvld_455h_HVBAT_NOMINAL_VOLTAGEDebDef_C DDRC_DurDeb.Com_numComInvld_463h_OBC_OUT_CURRENTDebOk_C DDRC_DurDeb.Com_numComInvld_463h_OBC_OUT_CURRENTDebDef_C DDRC_DurDeb.Com_numComInvld_463h_OBC_OUT_VOLTAGEDebOk_C DDRC_DurDeb.Com_numComInvld_463h_OBC_OUT_VOLTAGEDebDef_C DDRC_DurDeb.Com_numComInvld_463h_OBC_TEMPERATUREDebOk_C DDRC_DurDeb.Com_numComInvld_463h_OBC_TEMPERATUREDebDef_C DDRC_DurDeb.Com_numComInvld_473h_DCDC_Coolant_TemperatureDebOk_C DDRC_DurDeb.Com_numComInvld_473h_DCDC_Coolant_TemperatureDebDef_C /end DEF_CHARACTERISTIC
 FUNCTION_VERSION "850.8.0" /end FUNCTION
/begin COMPU_METHOD B_TRUE "" TAB_VERB "%6.3" "" COMPU_TAB_REF B_TRUE /end COMPU_METHOD
/begin COMPU_VTAB B_TRUE "" TAB_VERB 2 0 "FALSE" 1 "TRUE" /end COMPU_VTAB
/begin COMPU_METHOD Curr_A_q0p03125_COMPU "" RAT_FUNC "%6.4" "A" COEFFS 0 32 0 0 0 1 /end COMPU_METHOD
/begin COMPU_METHOD Ext_stNwCmdLIN_VERB "" TAB_VERB "%6.3" "" COMPU_TAB_REF Ext_stNwCmdLIN_VERB /end COMPU_METHOD
/begin COMPU_VTAB Ext_stNwCmdLIN_VERB "" TAB_VERB 3 0 "Preparation_a_la_mise_en_veille" 1 "Autorisation_du_reveil" 255 "Invalide" /end COMPU_VTAB
/begin COMPU_METHOD Length_km "" RAT_FUNC "%6.2" "km" COEFFS 0 1 0 0 0 1 /end COMPU_METHOD
/begin COMPU_METHOD OneToOne "" RAT_FUNC "%6.2" "-" COEFFS 0 1 0 0 0 1 /end COMPU_METHOD
/begin COMPU_METHOD Prc "" RAT_FUNC "%6.4" "%" COEFFS 0 81.92 0 0 0 1 /end COMPU_METHOD
/begin COMPU_METHOD q0p01_o5_V "" RAT_FUNC "%6.3" "V" COEFFS 0 100 -500 0 0 1 /end COMPU_METHOD
/begin COMPU_METHOD q0p01_om200_A "" RAT_FUNC "%6.1" "A" COEFFS 0 100 20000 0 0 1 /end COMPU_METHOD
/begin COMPU_METHOD q0p05_A "" RAT_FUNC "%6.4" "A" COEFFS 0 20 0 0 0 1 /end COMPU_METHOD
/begin COMPU_METHOD q0p1_A "" RAT_FUNC "%6.3" "A" COEFFS 0 10 0 0 0 1 /end COMPU_METHOD
/begin COMPU_METHOD q0p1_kW "" RAT_FUNC "%6.3" "kW" COEFFS 0 10 0 0 0 1 /end COMPU_METHOD
/begin COMPU_METHOD q0p1_om1500_A "" RAT_FUNC "%6.0" "A" COEFFS 0 10 15000 0 0 1 /end COMPU_METHOD
/begin COMPU_METHOD q0p5_DegCgrd "" RAT_FUNC "%6.3" "Deg C" COEFFS 0 10 0 0 0 5 /end COMPU_METHOD
/begin COMPU_METHOD q1 "" RAT_FUNC "%6.2" "-" COEFFS 0 1 0 0 0 1 /end COMPU_METHOD
/begin COMPU_METHOD q10_W "" RAT_FUNC "%6.1" "W" COEFFS 0 1 0 0 0 10 /end COMPU_METHOD
/begin COMPU_METHOD q1Em3_om1_A "" RAT_FUNC "%6.3" "A" COEFFS 0 1000 1000 0 0 1 /end COMPU_METHOD
/begin COMPU_METHOD q1Em3_V "" RAT_FUNC "%6.5" "V" COEFFS 0 1000 0 0 0 1 /end COMPU_METHOD
/begin COMPU_METHOD q1_kOhm "" RAT_FUNC "%6.2" "kOhm" COEFFS 0 1 0 0 0 1 /end COMPU_METHOD
/begin COMPU_METHOD q1_V "" RAT_FUNC "%6.2" "V" COEFFS 0 1 0 0 0 1 /end COMPU_METHOD
/begin COMPU_METHOD RBPtCel_n_10p0_1 "" RAT_FUNC "%6.1" "rpm" COEFFS 0 1 0 0 0 10 /end COMPU_METHOD
/begin COMPU_METHOD RBPtCel_Perc_1p0_1 "" RAT_FUNC "%6.2" "%" COEFFS 0 1 0 0 0 1 /end COMPU_METHOD
/begin COMPU_METHOD RBPtCel_pwr_1p0_1 "" RAT_FUNC "%6.2" "W" COEFFS 0 1 0 0 0 1 /end COMPU_METHOD
/begin COMPU_METHOD RBPtCel_q_0p125_1 "" RAT_FUNC "%6.3" "Ah" COEFFS 0 8 0 0 0 1 /end COMPU_METHOD
/begin COMPU_METHOD RBPtCel_ti_1p0_4 "" RAT_FUNC "%6.2" "min" COEFFS 0 1 0 0 0 1 /end COMPU_METHOD
/begin COMPU_METHOD RBPtCel_t_1p0om40_1 "" RAT_FUNC "%6.2" "Deg C" COEFFS 0 1 40 0 0 1 /end COMPU_METHOD
/begin COMPU_METHOD RBPtCel_t_1p0_om40_1 "" RAT_FUNC "%6.2" "Deg C" COEFFS 0 1 40 0 0 1 /end COMPU_METHOD
/begin COMPU_METHOD RBPtCel_u_0p1_1 "" RAT_FUNC "%6.3" "V" COEFFS 0 10 0 0 0 1 /end COMPU_METHOD
/begin COMPU_METHOD Temp_Cels "" RAT_FUNC "%6.1" "deg C" COEFFS 0 10 2731.4 0 0 1 /end COMPU_METHOD
/begin COMPU_METHOD Temp_Cels_c126 "" RAT_FUNC "%6.2" "deg C" COEFFS 0 1 0 0 0 1 /end COMPU_METHOD
/begin COMPU_METHOD Time_sec_1 "" RAT_FUNC "%6.3" "s" COEFFS 0 10 0 0 0 1 /end COMPU_METHOD
/begin COMPU_METHOD Vel "" RAT_FUNC "%6.4" "km/h" COEFFS 0 100 0 0 0 1 /end COMPU_METHOD
/begin COMPU_METHOD Volt_V_q0p03125_COMPU "" RAT_FUNC "%6.4" "V" COEFFS 0 32 0 0 0 1 /end COMPU_METHOD
/begin RECORD_LAYOUT RB_Val_Wboolean FNC_VALUES 1 UBYTE COLUMN_DIR DIRECT /end RECORD_LAYOUT
/begin RECORD_LAYOUT Val_Ws16 FNC_VALUES 1 SWORD COLUMN_DIR DIRECT /end RECORD_LAYOUT
/begin RECORD_LAYOUT Val_Wu16 FNC_VALUES 1 UWORD COLUMN_DIR DIRECT /end RECORD_LAYOUT
/begin RECORD_LAYOUT Val_Wu32 FNC_VALUES 1 ULONG COLUMN_DIR DIRECT /end RECORD_LAYOUT
/begin RECORD_LAYOUT Val_Wu8 FNC_VALUES 1 UBYTE COLUMN_DIR DIRECT /end RECORD_LAYOUT
/end MODULE
/end PROJECT

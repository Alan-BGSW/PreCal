ASAP2_VERSION 1 70
/begin PROJECT MDG1C "VC1CP091_STLA_N_D061I3"
/begin HEADER "" VERSION "VC1CP091_STLA_N_D061I3" PROJECT_NO MDG1C /end HEADER
/begin MODULE DIM ""
/begin MOD_COMMON "" BYTE_ORDER MSB_LAST ALIGNMENT_BYTE 1 ALIGNMENT_WORD 2 ALIGNMENT_LONG 4 ALIGNMENT_INT64 4 ALIGNMENT_FLOAT32_IEEE 4 ALIGNMENT_FLOAT64_IEEE 4 DATA_SIZE 32 /end MOD_COMMON
/begin CHARACTERISTIC DDRC_DurDeb.DFC_tiDrvModPosnDfctDebOk_C "" VALUE 0x80240CD4 Val_Wu16 655350.0 DDRCTime_ms 0.00 655350.0 FORMAT "%8.1" /end CHARACTERISTIC
/begin CHARACTERISTIC DDRC_DurDeb.DFC_tiDrvModPosnDfctDebDef_C "" VALUE 0x80240CD6 Val_Wu16 655350.0 DDRCTime_ms 0.00 655350.0 FORMAT "%8.1" /end CHARACTERISTIC
/begin CHARACTERISTIC DDRC_DurDeb.DrvDoor_tiOpnDebOk_C "" VALUE 0x80240CEC Val_Wu16 655350.0 DDRCTime_ms 0.00 655350.0 FORMAT "%8.1" /end CHARACTERISTIC
/begin CHARACTERISTIC DDRC_DurDeb.DrvDoor_tiOpnDebDef_C "" VALUE 0x80240CEE Val_Wu16 655350.0 DDRCTime_ms 0.00 655350.0 FORMAT "%8.1" /end CHARACTERISTIC
/begin CHARACTERISTIC DFC_CtlMsk2.DFC_DrvDoorOpn_C "" VALUE 0x8024135E Val_Wu8 255.0 DFES_OneToOne 0.00 255.0 FORMAT "%5.1" /end CHARACTERISTIC
/begin CHARACTERISTIC DFC_CtlMsk2.DFC_DrvModPosnDfct_C "" VALUE 0x8024135F Val_Wu8 255.0 DFES_OneToOne 0.00 255.0 FORMAT "%5.1" /end CHARACTERISTIC
/begin CHARACTERISTIC DFC_DisblMsk2.DFC_DrvDoorOpn_C "" VALUE 0x80248BA2 Val_Wu16 65535.00 DFES_OneToOne 0.00 65535.00 FORMAT "%8.2" /end CHARACTERISTIC
/begin CHARACTERISTIC DFC_DisblMsk2.DFC_DrvModPosnDfct_C "" VALUE 0x80248BA4 Val_Wu16 65535.00 DFES_OneToOne 0.00 65535.00 FORMAT "%8.2" /end CHARACTERISTIC
/begin CHARACTERISTIC DINH_Lim.DFC_ComInvld_435h_HVBAT_MAX_CELL_VOLT_NUM_CA "" VAL_BLK 0x8024B3EC ValA_Wu8 17.0000000000 DINH_LimDFCVerb 0.00 17.0000000000 FORMAT "%13.10" MATRIX_DIM 15 /end CHARACTERISTIC
/begin CHARACTERISTIC DINH_Lim.DFC_ComInvld_435h_HVBAT_MAX_SENSOR_TEMP_CA "" VAL_BLK 0x8024B3FB ValA_Wu8 17.0000000000 DINH_LimDFCVerb 0.00 17.0000000000 FORMAT "%13.10" MATRIX_DIM 15 /end CHARACTERISTIC
/begin CHARACTERISTIC DINH_Lim.DFC_ComInvld_435h_HVBAT_MIN_CELL_VOLT_CA "" VAL_BLK 0x8024B40A ValA_Wu8 17.0000000000 DINH_LimDFCVerb 0.00 17.0000000000 FORMAT "%13.10" MATRIX_DIM 15 /end CHARACTERISTIC
/begin CHARACTERISTIC DINH_Lim.DFC_ComInvld_435h_HVBAT_MIN_CELL_VOLT_NUM_CA "" VAL_BLK 0x8024B419 ValA_Wu8 17.0000000000 DINH_LimDFCVerb 0.00 17.0000000000 FORMAT "%13.10" MATRIX_DIM 15 /end CHARACTERISTIC
/begin CHARACTERISTIC DINH_Lim.DFC_ComInvld_442h_BCCM_BLOWER_RELAY_STS_CA "" VAL_BLK 0x8024B428 ValA_Wu8 17.0000000000 DINH_LimDFCVerb 0.00 17.0000000000 FORMAT "%13.10" MATRIX_DIM 15 /end CHARACTERISTIC
/begin CHARACTERISTIC DINH_Lim.DFC_ComInvld_453h_OBC_IN_CURRENT_CA "" VAL_BLK 0x8024B437 ValA_Wu8 17.0000000000 DINH_LimDFCVerb 0.00 17.0000000000 FORMAT "%13.10" MATRIX_DIM 16 /end CHARACTERISTIC
/begin CHARACTERISTIC DINH_Lim.DFC_ComInvld_453h_OBC_IN_VOLTAGE_CA "" VAL_BLK 0x8024B447 ValA_Wu8 17.0000000000 DINH_LimDFCVerb 0.00 17.0000000000 FORMAT "%13.10" MATRIX_DIM 15 /end CHARACTERISTIC
/begin CHARACTERISTIC DINH_Lim.DFC_ComInvld_453h_OBC_IP_POWER_CA "" VAL_BLK 0x8024B456 ValA_Wu8 17.0000000000 DINH_LimDFCVerb 0.00 17.0000000000 FORMAT "%13.10" MATRIX_DIM 15 /end CHARACTERISTIC
/begin CHARACTERISTIC DINH_Lim.DFC_ComInvld_455h_HVBAT_NOMINAL_VOLTAGE_CA "" VAL_BLK 0x8024B465 ValA_Wu8 17.0000000000 DINH_LimDFCVerb 0.00 17.0000000000 FORMAT "%13.10" MATRIX_DIM 18 /end CHARACTERISTIC
/begin CHARACTERISTIC DINH_Lim.DFC_ComInvld_463h_OBC_OUT_CURRENT_CA "" VAL_BLK 0x8024B477 ValA_Wu8 17.0000000000 DINH_LimDFCVerb 0.00 17.0000000000 FORMAT "%13.10" MATRIX_DIM 16 /end CHARACTERISTIC
/begin CHARACTERISTIC DINH_Lim.DFC_ComInvld_463h_OBC_OUT_VOLTAGE_CA "" VAL_BLK 0x8024B487 ValA_Wu8 17.0000000000 DINH_LimDFCVerb 0.00 17.0000000000 FORMAT "%13.10" MATRIX_DIM 16 /end CHARACTERISTIC
/begin CHARACTERISTIC DINH_Lim.DFC_ComInvld_463h_OBC_TEMPERATURE_CA "" VAL_BLK 0x8024B497 ValA_Wu8 17.0000000000 DINH_LimDFCVerb 0.00 17.0000000000 FORMAT "%13.10" MATRIX_DIM 16 /end CHARACTERISTIC
/begin CHARACTERISTIC DINH_Lim.DFC_ComInvld_473h_DCDC_Coolant_Temperature_CA "" VAL_BLK 0x8024B4A7 ValA_Wu8 17.0000000000 DINH_LimDFCVerb 0.00 17.0000000000 FORMAT "%13.10" MATRIX_DIM 15 /end CHARACTERISTIC
/begin CHARACTERISTIC DINH_Lim.DFC_ComInvld_473h_DCDC_TEMPERATURE_CA "" VAL_BLK 0x8024B4B6 ValA_Wu8 17.0000000000 DINH_LimDFCVerb 0.00 17.0000000000 FORMAT "%13.10" MATRIX_DIM 17 /end CHARACTERISTIC
/begin CHARACTERISTIC DINH_Lim.DFC_ComInvld_47Bh_eCOMP_BusBarCurrent_CA "" VAL_BLK 0x8024B4C7 ValA_Wu8 17.0000000000 DINH_LimDFCVerb 0.00 17.0000000000 FORMAT "%13.10" MATRIX_DIM 16 /end CHARACTERISTIC
/begin CHARACTERISTIC DINH_Lim.DFC_ComInvld_47Bh_eCOMP_BusBarVoltage_CA "" VAL_BLK 0x8024B4D7 ValA_Wu8 17.0000000000 DINH_LimDFCVerb 0.00 17.0000000000 FORMAT "%13.10" MATRIX_DIM 15 /end CHARACTERISTIC
/begin CHARACTERISTIC DINH_Lim.DFC_ComInvld_47Bh_eCOMP_CompressorSpeed_CA "" VAL_BLK 0x8024B4E6 ValA_Wu8 17.0000000000 DINH_LimDFCVerb 0.00 17.0000000000 FORMAT "%13.10" MATRIX_DIM 15 /end CHARACTERISTIC
/begin CHARACTERISTIC DINH_Lim.DFC_ComInvld_47Bh_eCOMP_IGBT_Temp_CA "" VAL_BLK 0x8024B4F5 ValA_Wu8 17.0000000000 DINH_LimDFCVerb 0.00 17.0000000000 FORMAT "%13.10" MATRIX_DIM 15 /end CHARACTERISTIC
/begin CHARACTERISTIC DINH_Lim.DFC_ComInvld_47Bh_eCOMP_PeakPhaCurrent_CA "" VAL_BLK 0x8024B504 ValA_Wu8 17.0000000000 DINH_LimDFCVerb 0.00 17.0000000000 FORMAT "%13.10" MATRIX_DIM 15 /end CHARACTERISTIC
/begin CHARACTERISTIC DINH_Lim.DFC_ComInvld_47Bh_eCOMP_Power_consumption_CA "" VAL_BLK 0x8024B513 ValA_Wu8 17.0000000000 DINH_LimDFCVerb 0.00 17.0000000000 FORMAT "%13.10" MATRIX_DIM 15 /end CHARACTERISTIC
/begin CHARACTERISTIC DINH_Lim.DFC_ComInvld_4F2h_STATUS_SOC_CA "" VAL_BLK 0x8024B522 ValA_Wu8 17.0000000000 DINH_LimDFCVerb 0.00 17.0000000000 FORMAT "%13.10" MATRIX_DIM 15 /end CHARACTERISTIC
/begin CHARACTERISTIC DINH_Lim.DFC_ComInvld_4F2h_TEMP_BATT_STATUS_CA "" VAL_BLK 0x8024B531 ValA_Wu8 17.0000000000 DINH_LimDFCVerb 0.00 17.0000000000 FORMAT "%13.10" MATRIX_DIM 15 /end CHARACTERISTIC
/begin CHARACTERISTIC DINH_Lim.DFC_ComInvld_4F2h_VALEUR_SOC_ETENDUE_CA "" VAL_BLK 0x8024B540 ValA_Wu8 17.0000000000 DINH_LimDFCVerb 0.00 17.0000000000 FORMAT "%13.10" MATRIX_DIM 15 /end CHARACTERISTIC
/begin CHARACTERISTIC DINH_Lim.DFC_ComInvld_535h_HV_BATT_TEMP_AVG_CA "" VAL_BLK 0x8024B54F ValA_Wu8 17.0000000000 DINH_LimDFCVerb 0.00 17.0000000000 FORMAT "%13.10" MATRIX_DIM 17 /end CHARACTERISTIC
/begin CHARACTERISTIC DINH_Lim.DFC_ComInvld_543h_HVBAT_RESTBATTENERGY_CA "" VAL_BLK 0x8024B560 ValA_Wu8 17.0000000000 DINH_LimDFCVerb 0.00 17.0000000000 FORMAT "%13.10" MATRIX_DIM 16 /end CHARACTERISTIC
/begin CHARACTERISTIC DINH_Lim.DFC_ComInvld_543h_HVBAT_SOH_CA "" VAL_BLK 0x8024B570 ValA_Wu8 17.0000000000 DINH_LimDFCVerb 0.00 17.0000000000 FORMAT "%13.10" MATRIX_DIM 15 /end CHARACTERISTIC
/begin CHARACTERISTIC DINH_Lim.DFC_ComInvld_543h_HV_BATT_SOH_RES_CA "" VAL_BLK 0x8024B57F ValA_Wu8 17.0000000000 DINH_LimDFCVerb 0.00 17.0000000000 FORMAT "%13.10" MATRIX_DIM 16 /end CHARACTERISTIC
/begin CHARACTERISTIC DINH_Lim.DFC_ComInvld_552h_CPT_TEMPOREL_CA "" VAL_BLK 0x8024B58F ValA_Wu8 17.0000000000 DINH_LimDFCVerb 0.00 17.0000000000 FORMAT "%13.10" MATRIX_DIM 15 /end CHARACTERISTIC
/begin CHARACTERISTIC DINH_Lim.DFC_ComInvld_552h_KILOMETRAGE_CA "" VAL_BLK 0x8024B59E ValA_Wu8 17.0000000000 DINH_LimDFCVerb 0.00 17.0000000000 FORMAT "%13.10" MATRIX_DIM 17 /end CHARACTERISTIC
/begin CHARACTERISTIC DINH_Lim.DFC_ComInvld_583h_HV_BATT_DISCONT_CSE_OPEN_CA "" VAL_BLK 0x8024B5AF ValA_Wu8 17.0000000000 DINH_LimDFCVerb 0.00 17.0000000000 FORMAT "%13.10" MATRIX_DIM 15 /end CHARACTERISTIC
/begin CHARACTERISTIC DINH_Lim.DFC_ComInvld_592h_CALIBRE_IBATT_CA "" VAL_BLK 0x8024B5BE ValA_Wu8 17.0000000000 DINH_LimDFCVerb 0.00 17.0000000000 FORMAT "%13.10" MATRIX_DIM 15 /end CHARACTERISTIC
/begin CHARACTERISTIC DINH_Lim.DFC_ComInvld_592h_IBATT_1_CA "" VAL_BLK 0x8024B5CD ValA_Wu8 17.0000000000 DINH_LimDFCVerb 0.00 17.0000000000 FORMAT "%13.10" MATRIX_DIM 15 /end CHARACTERISTIC
/begin CHARACTERISTIC DINH_Lim.DFC_ComInvld_592h_IBATT_2_CA "" VAL_BLK 0x8024B5DC ValA_Wu8 17.0000000000 DINH_LimDFCVerb 0.00 17.0000000000 FORMAT "%13.10" MATRIX_DIM 15 /end CHARACTERISTIC
/begin CHARACTERISTIC DINH_Lim.DFC_ComInvld_592h_IBATT_3_CA "" VAL_BLK 0x8024B5EB ValA_Wu8 17.0000000000 DINH_LimDFCVerb 0.00 17.0000000000 FORMAT "%13.10" MATRIX_DIM 15 /end CHARACTERISTIC
/begin CHARACTERISTIC DINH_Lim.DFC_ComInvld_592h_TEMP_BATT_CA "" VAL_BLK 0x8024B5FA ValA_Wu8 17.0000000000 DINH_LimDFCVerb 0.00 17.0000000000 FORMAT "%13.10" MATRIX_DIM 15 /end CHARACTERISTIC
/begin CHARACTERISTIC DINH_Lim.DFC_ComInvld_592h_U_BATT_BECB_CA "" VAL_BLK 0x8024B609 ValA_Wu8 17.0000000000 DINH_LimDFCVerb 0.00 17.0000000000 FORMAT "%13.10" MATRIX_DIM 15 /end CHARACTERISTIC
/begin CHARACTERISTIC DINH_Lim.DFC_ComInvld_595h_HVBAT_TIME_TO_CHRG_80_CA "" VAL_BLK 0x8024B618 ValA_Wu8 17.0000000000 DINH_LimDFCVerb 0.00 17.0000000000 FORMAT "%13.10" MATRIX_DIM 15 /end CHARACTERISTIC
/begin CHARACTERISTIC DINH_Lim.DFC_ComInvld_5B2h_TEMP_AIR_EXT_CA "" VAL_BLK 0x8024B627 ValA_Wu8 17.0000000000 DINH_LimDFCVerb 0.00 17.0000000000 FORMAT "%13.10" MATRIX_DIM 15 /end CHARACTERISTIC
/begin CHARACTERISTIC DINH_Lim.DFC_ComInvld_5B5h_HVBAT_THERMAL_RUNAWAY_CA "" VAL_BLK 0x8024B636 ValA_Wu8 17.0000000000 DINH_LimDFCVerb 0.00 17.0000000000 FORMAT "%13.10" MATRIX_DIM 15 /end CHARACTERISTIC
/begin CHARACTERISTIC DINH_Lim.DFC_ComInvld_635h_HVBAT_NEG_CONT_COUNT_SEG1_CA "" VAL_BLK 0x8024B645 ValA_Wu8 17.0000000000 DINH_LimDFCVerb 0.00 17.0000000000 FORMAT "%13.10" MATRIX_DIM 15 /end CHARACTERISTIC
/begin CHARACTERISTIC DINH_Lim.DFC_ComInvld_635h_HVBAT_NEG_CONT_COUNT_SEG3_CA "" VAL_BLK 0x8024B654 ValA_Wu8 17.0000000000 DINH_LimDFCVerb 0.00 17.0000000000 FORMAT "%13.10" MATRIX_DIM 15 /end CHARACTERISTIC
/begin CHARACTERISTIC DINH_Lim.DFC_ComInvld_635h_HVBAT_NEG_CONT_COUNT_SEG4_CA "" VAL_BLK 0x8024B663 ValA_Wu8 17.0000000000 DINH_LimDFCVerb 0.00 17.0000000000 FORMAT "%13.10" MATRIX_DIM 15 /end CHARACTERISTIC
/begin CHARACTERISTIC DINH_Lim.DFC_ComInvld_635h_HVBAT_PST_CONT_COUNT_SEG1_CA "" VAL_BLK 0x8024B672 ValA_Wu8 17.0000000000 DINH_LimDFCVerb 0.00 17.0000000000 FORMAT "%13.10" MATRIX_DIM 15 /end CHARACTERISTIC
/begin CHARACTERISTIC DINH_Lim.DFC_ComInvld_635h_HVBAT_PST_CONT_COUNT_SEG3_CA "" VAL_BLK 0x8024B681 ValA_Wu8 17.0000000000 DINH_LimDFCVerb 0.00 17.0000000000 FORMAT "%13.10" MATRIX_DIM 15 /end CHARACTERISTIC
/begin CHARACTERISTIC DINH_Lim.DFC_ComInvld_635h_HVBAT_PST_CONT_COUNT_SEG4_CA "" VAL_BLK 0x8024B690 ValA_Wu8 17.0000000000 DINH_LimDFCVerb 0.00 17.0000000000 FORMAT "%13.10" MATRIX_DIM 15 /end CHARACTERISTIC
/begin CHARACTERISTIC DINH_Lim.DFC_ComInvld_645h_HVBAT_PRECHRGE_CONT_COUNT_SEG1_CA "" VAL_BLK 0x8024B69F ValA_Wu8 17.0000000000 DINH_LimDFCVerb 0.00 17.0000000000 FORMAT "%13.10" MATRIX_DIM 15 /end CHARACTERISTIC
/begin CHARACTERISTIC DINH_Lim.DFC_ComInvld_645h_HVBAT_PRECHRGE_CONT_COUNT_SEG2_CA "" VAL_BLK 0x8024B6AE ValA_Wu8 17.0000000000 DINH_LimDFCVerb 0.00 17.0000000000 FORMAT "%13.10" MATRIX_DIM 15 /end CHARACTERISTIC
/begin CHARACTERISTIC DINH_Lim.DFC_ComInvld_675h_HVBAT_REMAININGBATTCAPACITY_CA "" VAL_BLK 0x8024B6BD ValA_Wu8 17.0000000000 DINH_LimDFCVerb 0.00 17.0000000000 FORMAT "%13.10" MATRIX_DIM 15 /end CHARACTERISTIC
/begin CHARACTERISTIC DINH_Lim.DFC_ACCmprFltLvl1_CA "" VAL_BLK 0x8024B6CC ValA_Wu8 17.0000000000 DINH_LimDFCVerb 0.00 17.0000000000 FORMAT "%13.10" MATRIX_DIM 14 /end CHARACTERISTIC
/begin CHARACTERISTIC DINH_Lim.DFC_ACCmprFltLvl2_CA "" VAL_BLK 0x8024B6DA ValA_Wu8 17.0000000000 DINH_LimDFCVerb 0.00 17.0000000000 FORMAT "%13.10" MATRIX_DIM 14 /end CHARACTERISTIC
/begin CHARACTERISTIC DINH_Lim.DFC_ACCmprFltLvl3_CA "" VAL_BLK 0x8024B6E8 ValA_Wu8 17.0000000000 DINH_LimDFCVerb 0.00 17.0000000000 FORMAT "%13.10" MATRIX_DIM 14 /end CHARACTERISTIC
/begin CHARACTERISTIC DINH_Lim.DFC_ACCmprFltLvl4_CA "" VAL_BLK 0x8024B6F6 ValA_Wu8 17.0000000000 DINH_LimDFCVerb 0.00 17.0000000000 FORMAT "%13.10" MATRIX_DIM 14 /end CHARACTERISTIC
/begin CHARACTERISTIC DINH_Lim.DFC_ACCmprHiPFlt_CA "" VAL_BLK 0x8024B704 ValA_Wu8 17.0000000000 DINH_LimDFCVerb 0.00 17.0000000000 FORMAT "%13.10" MATRIX_DIM 14 /end CHARACTERISTIC
/begin CHARACTERISTIC DINH_Lim.DFC_ACCmprInvldCmprSt_CA "" VAL_BLK 0x8024B712 ValA_Wu8 17.0000000000 DINH_LimDFCVerb 0.00 17.0000000000 FORMAT "%13.10" MATRIX_DIM 14 /end CHARACTERISTIC
/begin CHARACTERISTIC DINH_Lim.DFC_ACCmprInvldElecActPwr_CA "" VAL_BLK 0x8024B720 ValA_Wu8 17.0000000000 DINH_LimDFCVerb 0.00 17.0000000000 FORMAT "%13.10" MATRIX_DIM 14 /end CHARACTERISTIC
/begin CHARACTERISTIC DINH_Lim.DFC_ACCmprLoPFlt_CA "" VAL_BLK 0x8024B72E ValA_Wu8 17.0000000000 DINH_LimDFCVerb 0.00 17.0000000000 FORMAT "%13.10" MATRIX_DIM 14 /end CHARACTERISTIC
/begin CHARACTERISTIC DINH_Lim.DFC_AcChrgrIntkTSRCMin_CA "" VAL_BLK 0x8024B73C ValA_Wu8 17.0000000000 DINH_LimDFCVerb 0.00 17.0000000000 FORMAT "%13.10" MATRIX_DIM 17 /end CHARACTERISTIC
/begin CHARACTERISTIC DINH_Lim.DFC_BattUBMaxBatt_CA "" VAL_BLK 0x8024B74D ValA_Wu8 17.0000000000 DINH_LimDFCVerb 0.00 17.0000000000 FORMAT "%13.10" MATRIX_DIM 13 /end CHARACTERISTIC
/begin CHARACTERISTIC DINH_Lim.DFC_BattUBMaxNoBatt_CA "" VAL_BLK 0x8024B75A ValA_Wu8 17.0000000000 DINH_LimDFCVerb 0.00 17.0000000000 FORMAT "%13.10" MATRIX_DIM 13 /end CHARACTERISTIC
/begin CHARACTERISTIC DINH_Lim.DFC_BattUBMinBatt_CA "" VAL_BLK 0x8024B767 ValA_Wu8 17.0000000000 DINH_LimDFCVerb 0.00 17.0000000000 FORMAT "%13.10" MATRIX_DIM 14 /end CHARACTERISTIC
/begin CHARACTERISTIC DINH_Lim.DFC_BattUBMinNoBatt_CA "" VAL_BLK 0x8024B775 ValA_Wu8 17.0000000000 DINH_LimDFCVerb 0.00 17.0000000000 FORMAT "%13.10" MATRIX_DIM 13 /end CHARACTERISTIC
/begin CHARACTERISTIC DINH_Lim.DFC_BattUSRCMax_CA "" VAL_BLK 0x8024B782 ValA_Wu8 17.0000000000 DINH_LimDFCVerb 0.00 17.0000000000 FORMAT "%13.10" MATRIX_DIM 15 /end CHARACTERISTIC
/begin CHARACTERISTIC DINH_Lim.DFC_BattUSRCMin_CA "" VAL_BLK 0x8024B791 ValA_Wu8 17.0000000000 DINH_LimDFCVerb 0.00 17.0000000000 FORMAT "%13.10" MATRIX_DIM 15 /end CHARACTERISTIC
/begin CHARACTERISTIC DINH_Lim.DFC_BrkBstPHiCautionDfct_CA "" VAL_BLK 0x8024B7A0 ValA_Wu8 17.0000000000 DINH_LimDFCVerb 0.00 17.0000000000 FORMAT "%13.10" MATRIX_DIM 14 /end CHARACTERISTIC
/begin CHARACTERISTIC DINH_Lim.DFC_BrkBstPHiWarnDfct_CA "" VAL_BLK 0x8024B7AE ValA_Wu8 17.0000000000 DINH_LimDFCVerb 0.00 17.0000000000 FORMAT "%13.10" MATRIX_DIM 14 /end CHARACTERISTIC
/begin CHARACTERISTIC DINH_Lim.DFC_BrkBstPSnsr12PlausDfct_CA "" VAL_BLK 0x8024B7BC ValA_Wu8 17.0000000000 DINH_LimDFCVerb 0.00 17.0000000000 FORMAT "%13.10" MATRIX_DIM 17 /end CHARACTERISTIC
/begin CHARACTERISTIC DINH_Lim.DFC_BrkBstPSnsr1Scb_CA "" VAL_BLK 0x8024B7CD ValA_Wu8 17.0000000000 DINH_LimDFCVerb 0.00 17.0000000000 FORMAT "%13.10" MATRIX_DIM 17 /end CHARACTERISTIC
/begin CHARACTERISTIC DINH_Lim.DFC_BrkBstPSnsr1Scg_CA "" VAL_BLK 0x8024B7DE ValA_Wu8 17.0000000000 DINH_LimDFCVerb 0.00 17.0000000000 FORMAT "%13.10" MATRIX_DIM 17 /end CHARACTERISTIC
/begin CHARACTERISTIC DINH_Lim.DFC_BrkBstPSnsr2Scb_CA "" VAL_BLK 0x8024B7EF ValA_Wu8 17.0000000000 DINH_LimDFCVerb 0.00 17.0000000000 FORMAT "%13.10" MATRIX_DIM 17 /end CHARACTERISTIC
/begin CHARACTERISTIC DINH_Lim.DFC_BrkBstPSnsr2Scg_CA "" VAL_BLK 0x8024B800 ValA_Wu8 17.0000000000 DINH_LimDFCVerb 0.00 17.0000000000 FORMAT "%13.10" MATRIX_DIM 17 /end CHARACTERISTIC
/begin CHARACTERISTIC DINH_Lim.DFC_BrkBstPSnsrMax_CA "" VAL_BLK 0x8024B811 ValA_Wu8 17.0000000000 DINH_LimDFCVerb 0.00 17.0000000000 FORMAT "%13.10" MATRIX_DIM 14 /end CHARACTERISTIC
/begin CHARACTERISTIC DINH_Lim.DFC_BrkBstPSnsrMin_CA "" VAL_BLK 0x8024B81F ValA_Wu8 17.0000000000 DINH_LimDFCVerb 0.00 17.0000000000 FORMAT "%13.10" MATRIX_DIM 15 /end CHARACTERISTIC
/begin CHARACTERISTIC DINH_Lim.DFC_BrkBstPhyRngChkMax_CA "" VAL_BLK 0x8024B82E ValA_Wu8 17.0000000000 DINH_LimDFCVerb 0.00 17.0000000000 FORMAT "%13.10" MATRIX_DIM 15 /end CHARACTERISTIC
/begin CHARACTERISTIC DINH_Lim.DFC_BrkBstPhyRngChkMin_CA "" VAL_BLK 0x8024B83D ValA_Wu8 17.0000000000 DINH_LimDFCVerb 0.00 17.0000000000 FORMAT "%13.10" MATRIX_DIM 15 /end CHARACTERISTIC
/begin CHARACTERISTIC DINH_Lim.DFC_BrkBstPmpHsScb_CA "" VAL_BLK 0x8024B84C ValA_Wu8 17.0000000000 DINH_LimDFCVerb 0.00 17.0000000000 FORMAT "%13.10" MATRIX_DIM 17 /end CHARACTERISTIC
/begin CHARACTERISTIC DINH_Lim.DFC_BrkBstPmpHsScg_CA "" VAL_BLK 0x8024B85D ValA_Wu8 17.0000000000 DINH_LimDFCVerb 0.00 17.0000000000 FORMAT "%13.10" MATRIX_DIM 19 /end CHARACTERISTIC
/begin CHARACTERISTIC DINH_Lim.DFC_BrkBstPmpLsOl_CA "" VAL_BLK 0x8024B870 ValA_Wu8 17.0000000000 DINH_LimDFCVerb 0.00 17.0000000000 FORMAT "%13.10" MATRIX_DIM 17 /end CHARACTERISTIC
/begin CHARACTERISTIC DINH_Lim.DFC_BrkBstPmpLsScb_CA "" VAL_BLK 0x8024B881 ValA_Wu8 17.0000000000 DINH_LimDFCVerb 0.00 17.0000000000 FORMAT "%13.10" MATRIX_DIM 19 /end CHARACTERISTIC
/begin CHARACTERISTIC DINH_Lim.DFC_BrkBstPmpLsScg_CA "" VAL_BLK 0x8024B894 ValA_Wu8 17.0000000000 DINH_LimDFCVerb 0.00 17.0000000000 FORMAT "%13.10" MATRIX_DIM 18 /end CHARACTERISTIC
/begin CHARACTERISTIC DINH_Lim.DFC_CbnHeatgHeatrRlyOpend_CA "" VAL_BLK 0x8024B8A6 ValA_Wu8 17.0000000000 DINH_LimDFCVerb 0.00 17.0000000000 FORMAT "%13.10" MATRIX_DIM 14 /end CHARACTERISTIC
/begin CHARACTERISTIC DINH_Lim.DFC_CbnHeatgHeatrRlyWldd_CA "" VAL_BLK 0x8024B8B4 ValA_Wu8 17.0000000000 DINH_LimDFCVerb 0.00 17.0000000000 FORMAT "%13.10" MATRIX_DIM 14 /end CHARACTERISTIC
/begin CHARACTERISTIC DINH_Lim.DFC_CcsDcIBattExcdd_CA "" VAL_BLK 0x8024B8C2 ValA_Wu8 17.0000000000 DINH_LimDFCVerb 0.00 17.0000000000 FORMAT "%13.10" MATRIX_DIM 14 /end CHARACTERISTIC
/begin CHARACTERISTIC DINH_Lim.DFC_CcsDcIEvseOutDe_CA "" VAL_BLK 0x8024B8D0 ValA_Wu8 17.0000000000 DINH_LimDFCVerb 0.00 17.0000000000 FORMAT "%13.10" MATRIX_DIM 13 /end CHARACTERISTIC
/begin CHARACTERISTIC DINH_Lim.DFC_CcsDcIOutDe_CA "" VAL_BLK 0x8024B8DD ValA_Wu8 17.0000000000 DINH_LimDFCVerb 0.00 17.0000000000 FORMAT "%13.10" MATRIX_DIM 15 /end CHARACTERISTIC
/begin CHARACTERISTIC DINH_Lim.DFC_CcsDcIOutExcdd_CA "" VAL_BLK 0x8024B8EC ValA_Wu8 17.0000000000 DINH_LimDFCVerb 0.00 17.0000000000 FORMAT "%13.10" MATRIX_DIM 15 /end CHARACTERISTIC
/begin CHARACTERISTIC DINH_Lim.DFC_CcsDcUOutDe_CA "" VAL_BLK 0x8024B8FB ValA_Wu8 17.0000000000 DINH_LimDFCVerb 0.00 17.0000000000 FORMAT "%13.10" MATRIX_DIM 14 /end CHARACTERISTIC
/begin CHARACTERISTIC DINH_Lim.DFC_CcsDcUOutExcdd_CA "" VAL_BLK 0x8024B909 ValA_Wu8 17.0000000000 DINH_LimDFCVerb 0.00 17.0000000000 FORMAT "%13.10" MATRIX_DIM 14 /end CHARACTERISTIC
/begin CHARACTERISTIC DINH_Lim.DFC_CcsPwrLineChpRstOL_CA "" VAL_BLK 0x8024B917 ValA_Wu8 17.0000000000 DINH_LimDFCVerb 0.00 17.0000000000 FORMAT "%13.10" MATRIX_DIM 15 /end CHARACTERISTIC
/begin CHARACTERISTIC DINH_Lim.DFC_CcsPwrLineChpRstOvrTemp_CA "" VAL_BLK 0x8024B926 ValA_Wu8 17.0000000000 DINH_LimDFCVerb 0.00 17.0000000000 FORMAT "%13.10" MATRIX_DIM 15 /end CHARACTERISTIC
/begin CHARACTERISTIC DINH_Lim.DFC_CcsPwrLineChpRstSCB_CA "" VAL_BLK 0x8024B935 ValA_Wu8 17.0000000000 DINH_LimDFCVerb 0.00 17.0000000000 FORMAT "%13.10" MATRIX_DIM 15 /end CHARACTERISTIC
/begin CHARACTERISTIC DINH_Lim.DFC_CcsPwrLineChpRstSCG_CA "" VAL_BLK 0x8024B944 ValA_Wu8 17.0000000000 DINH_LimDFCVerb 0.00 17.0000000000 FORMAT "%13.10" MATRIX_DIM 15 /end CHARACTERISTIC
/begin CHARACTERISTIC DINH_Lim.DFC_CcsPwrLineChpVccEnaOL_CA "" VAL_BLK 0x8024B953 ValA_Wu8 17.0000000000 DINH_LimDFCVerb 0.00 17.0000000000 FORMAT "%13.10" MATRIX_DIM 15 /end CHARACTERISTIC
/begin CHARACTERISTIC DINH_Lim.DFC_CcsPwrLineChpVccEnaOvrTemp_CA "" VAL_BLK 0x8024B962 ValA_Wu8 17.0000000000 DINH_LimDFCVerb 0.00 17.0000000000 FORMAT "%13.10" MATRIX_DIM 15 /end CHARACTERISTIC
/begin CHARACTERISTIC DINH_Lim.DFC_CcsPwrLineChpVccEnaSCB_CA "" VAL_BLK 0x8024B971 ValA_Wu8 17.0000000000 DINH_LimDFCVerb 0.00 17.0000000000 FORMAT "%13.10" MATRIX_DIM 15 /end CHARACTERISTIC
/begin CHARACTERISTIC DINH_Lim.DFC_CcsPwrLineChpVccEnaSCG_CA "" VAL_BLK 0x8024B980 ValA_Wu8 17.0000000000 DINH_LimDFCVerb 0.00 17.0000000000 FORMAT "%13.10" MATRIX_DIM 15 /end CHARACTERISTIC
/begin CHARACTERISTIC DINH_Lim.DFC_CcsPwrLineChpVccSRCMin_CA "" VAL_BLK 0x8024B98F ValA_Wu8 17.0000000000 DINH_LimDFCVerb 0.00 17.0000000000 FORMAT "%13.10" MATRIX_DIM 17 /end CHARACTERISTIC
/begin CHARACTERISTIC DINH_Lim.DFC_CcsPwrLineComChpTSRCMin_CA "" VAL_BLK 0x8024B9A0 ValA_Wu8 17.0000000000 DINH_LimDFCVerb 0.00 17.0000000000 FORMAT "%13.10" MATRIX_DIM 18 /end CHARACTERISTIC
/begin CHARACTERISTIC DINH_Lim.DFC_CtPSwtActrOL_CA "" VAL_BLK 0x8024B9B2 ValA_Wu8 17.0000000000 DINH_LimDFCVerb 0.00 17.0000000000 FORMAT "%13.10" MATRIX_DIM 15 /end CHARACTERISTIC
/begin CHARACTERISTIC DINH_Lim.DFC_CtPSwtActrOvrTemp_CA "" VAL_BLK 0x8024B9C1 ValA_Wu8 17.0000000000 DINH_LimDFCVerb 0.00 17.0000000000 FORMAT "%13.10" MATRIX_DIM 15 /end CHARACTERISTIC
/begin CHARACTERISTIC DINH_Lim.DFC_CtPSwtActrSCB_CA "" VAL_BLK 0x8024B9D0 ValA_Wu8 17.0000000000 DINH_LimDFCVerb 0.00 17.0000000000 FORMAT "%13.10" MATRIX_DIM 15 /end CHARACTERISTIC
/begin CHARACTERISTIC DINH_Lim.DFC_CtPSwtActrSCG_CA "" VAL_BLK 0x8024B9DF ValA_Wu8 17.0000000000 DINH_LimDFCVerb 0.00 17.0000000000 FORMAT "%13.10" MATRIX_DIM 15 /end CHARACTERISTIC
/begin CHARACTERISTIC DINH_Lim.DFC_CtPSwtDiagSRCMin_CA "" VAL_BLK 0x8024B9EE ValA_Wu8 17.0000000000 DINH_LimDFCVerb 0.00 17.0000000000 FORMAT "%13.10" MATRIX_DIM 17 /end CHARACTERISTIC
/begin CHARACTERISTIC DINH_Lim.DFC_CtpCarrFrqSRCMin_CA "" VAL_BLK 0x8024B9FF ValA_Wu8 17.0000000000 DINH_LimDFCVerb 0.00 17.0000000000 FORMAT "%13.10" MATRIX_DIM 17 /end CHARACTERISTIC
/begin CHARACTERISTIC DINH_Lim.DFC_DcChrgrIntkT2SRCMin_CA "" VAL_BLK 0x8024BA10 ValA_Wu8 17.0000000000 DINH_LimDFCVerb 0.00 17.0000000000 FORMAT "%13.10" MATRIX_DIM 18 /end CHARACTERISTIC
/begin CHARACTERISTIC DINH_Lim.DFC_DcChrgrIntkTSRCMin_CA "" VAL_BLK 0x8024BA22 ValA_Wu8 17.0000000000 DINH_LimDFCVerb 0.00 17.0000000000 FORMAT "%13.10" MATRIX_DIM 18 /end CHARACTERISTIC
/begin CHARACTERISTIC DINH_Lim.DFC_DevLibBattUHi_CA "" VAL_BLK 0x8024BA34 ValA_Wu8 17.0000000000 DINH_LimDFCVerb 0.00 17.0000000000 FORMAT "%13.10" MATRIX_DIM 13 /end CHARACTERISTIC
/begin CHARACTERISTIC DINH_Lim.DFC_DevLibBattULo_CA "" VAL_BLK 0x8024BA41 ValA_Wu8 17.0000000000 DINH_LimDFCVerb 0.00 17.0000000000 FORMAT "%13.10" MATRIX_DIM 13 /end CHARACTERISTIC
/begin CHARACTERISTIC DINH_Lim.DFC_EmWakeupSigOL_CA "" VAL_BLK 0x8024BA4E ValA_Wu8 17.0000000000 DINH_LimDFCVerb 0.00 17.0000000000 FORMAT "%13.10" MATRIX_DIM 15 /end CHARACTERISTIC
/begin CHARACTERISTIC DINH_Lim.DFC_EmWakeupSigOvrTemp_CA "" VAL_BLK 0x8024BA5D ValA_Wu8 17.0000000000 DINH_LimDFCVerb 0.00 17.0000000000 FORMAT "%13.10" MATRIX_DIM 15 /end CHARACTERISTIC
/begin CHARACTERISTIC DINH_Lim.DFC_EmWakeupSigSCB_CA "" VAL_BLK 0x8024BA6C ValA_Wu8 17.0000000000 DINH_LimDFCVerb 0.00 17.0000000000 FORMAT "%13.10" MATRIX_DIM 15 /end CHARACTERISTIC
/begin CHARACTERISTIC DINH_Lim.DFC_EmWakeupSigSCG_CA "" VAL_BLK 0x8024BA7B ValA_Wu8 17.0000000000 DINH_LimDFCVerb 0.00 17.0000000000 FORMAT "%13.10" MATRIX_DIM 15 /end CHARACTERISTIC
/begin CHARACTERISTIC DINH_Lim.DFC_Fan1OL_CA "" VAL_BLK 0x8024BA8A ValA_Wu8 17.0000000000 DINH_LimDFCVerb 0.00 17.0000000000 FORMAT "%13.10" MATRIX_DIM 17 /end CHARACTERISTIC
/begin CHARACTERISTIC DINH_Lim.DFC_Fan1OvrTemp_CA "" VAL_BLK 0x8024BA9B ValA_Wu8 17.0000000000 DINH_LimDFCVerb 0.00 17.0000000000 FORMAT "%13.10" MATRIX_DIM 16 /end CHARACTERISTIC
/begin CHARACTERISTIC DINH_Lim.DFC_Fan1SCB_CA "" VAL_BLK 0x8024BAAB ValA_Wu8 17.0000000000 DINH_LimDFCVerb 0.00 17.0000000000 FORMAT "%13.10" MATRIX_DIM 17 /end CHARACTERISTIC
/begin CHARACTERISTIC DINH_Lim.DFC_FanRlySCB_CA "" VAL_BLK 0x8024BABC ValA_Wu8 17.0000000000 DINH_LimDFCVerb 0.00 17.0000000000 FORMAT "%13.10" MATRIX_DIM 13 /end CHARACTERISTIC
/begin CHARACTERISTIC DINH_Lim.DFC_FanRlySCG_CA "" VAL_BLK 0x8024BAC9 ValA_Wu8 17.0000000000 DINH_LimDFCVerb 0.00 17.0000000000 FORMAT "%13.10" MATRIX_DIM 13 /end CHARACTERISTIC
/begin CHARACTERISTIC DINH_Lim.DFC_FanSpdSRCMin_CA "" VAL_BLK 0x8024BAD6 ValA_Wu8 17.0000000000 DINH_LimDFCVerb 0.00 17.0000000000 FORMAT "%13.10" MATRIX_DIM 17 /end CHARACTERISTIC
/begin CHARACTERISTIC DINH_Lim.DFC_FreonPSRCMin_CA "" VAL_BLK 0x8024BAE7 ValA_Wu8 17.0000000000 DINH_LimDFCVerb 0.00 17.0000000000 FORMAT "%13.10" MATRIX_DIM 19 /end CHARACTERISTIC
/begin CHARACTERISTIC DINH_Lim.DFC_HLCCcsPLnCChipTHi_CA "" VAL_BLK 0x8024BAFA ValA_Wu8 17.0000000000 DINH_LimDFCVerb 0.00 17.0000000000 FORMAT "%13.10" MATRIX_DIM 14 /end CHARACTERISTIC
/begin CHARACTERISTIC DINH_Lim.DFC_HeatrCoreTSRCMin_CA "" VAL_BLK 0x8024BB08 ValA_Wu8 17.0000000000 DINH_LimDFCVerb 0.00 17.0000000000 FORMAT "%13.10" MATRIX_DIM 17 /end CHARACTERISTIC
/begin CHARACTERISTIC DINH_Lim.DFC_PwmCtPSRCMin_CA "" VAL_BLK 0x8024BB19 ValA_Wu8 17.0000000000 DINH_LimDFCVerb 0.00 17.0000000000 FORMAT "%13.10" MATRIX_DIM 17 /end CHARACTERISTIC
/begin CHARACTERISTIC DINH_Lim.DFC_PwrDistbnUnitTSRCMin_CA "" VAL_BLK 0x8024BB2A ValA_Wu8 17.0000000000 DINH_LimDFCVerb 0.00 17.0000000000 FORMAT "%13.10" MATRIX_DIM 21 /end CHARACTERISTIC
/begin CHARACTERISTIC DINH_Lim.DFC_SCtPmp1OL_CA "" VAL_BLK 0x8024BB3F ValA_Wu8 17.0000000000 DINH_LimDFCVerb 0.00 17.0000000000 FORMAT "%13.10" MATRIX_DIM 20 /end CHARACTERISTIC
/begin CHARACTERISTIC DINH_Lim.DFC_SCtPmp1OvrTemp_CA "" VAL_BLK 0x8024BB53 ValA_Wu8 17.0000000000 DINH_LimDFCVerb 0.00 17.0000000000 FORMAT "%13.10" MATRIX_DIM 18 /end CHARACTERISTIC
/begin CHARACTERISTIC DINH_Lim.DFC_SCtPmp1SCB_CA "" VAL_BLK 0x8024BB65 ValA_Wu8 17.0000000000 DINH_LimDFCVerb 0.00 17.0000000000 FORMAT "%13.10" MATRIX_DIM 20 /end CHARACTERISTIC
/begin CHARACTERISTIC DINH_Lim.DFC_SCtPmpRlyOL_CA "" VAL_BLK 0x8024BB79 ValA_Wu8 17.0000000000 DINH_LimDFCVerb 0.00 17.0000000000 FORMAT "%13.10" MATRIX_DIM 15 /end CHARACTERISTIC
/begin CHARACTERISTIC DINH_Lim.DFC_SCtPmpRlyOvrTemp_CA "" VAL_BLK 0x8024BB88 ValA_Wu8 17.0000000000 DINH_LimDFCVerb 0.00 17.0000000000 FORMAT "%13.10" MATRIX_DIM 14 /end CHARACTERISTIC
/begin CHARACTERISTIC DINH_Lim.DFC_SCtPmpRlySCB_CA "" VAL_BLK 0x8024BB96 ValA_Wu8 17.0000000000 DINH_LimDFCVerb 0.00 17.0000000000 FORMAT "%13.10" MATRIX_DIM 15 /end CHARACTERISTIC
/begin CHARACTERISTIC DINH_Lim.DFC_SpplCooltPmpRlyOL_CA "" VAL_BLK 0x8024BBA5 ValA_Wu8 17.0000000000 DINH_LimDFCVerb 0.00 17.0000000000 FORMAT "%13.10" MATRIX_DIM 15 /end CHARACTERISTIC
/begin CHARACTERISTIC DINH_Lim.DFC_SpplCooltPmpRlyOvrTemp_CA "" VAL_BLK 0x8024BBB4 ValA_Wu8 17.0000000000 DINH_LimDFCVerb 0.00 17.0000000000 FORMAT "%13.10" MATRIX_DIM 14 /end CHARACTERISTIC
/begin CHARACTERISTIC DINH_Lim.DFC_SpplCooltPmpRlySCB_CA "" VAL_BLK 0x8024BBC2 ValA_Wu8 17.0000000000 DINH_LimDFCVerb 0.00 17.0000000000 FORMAT "%13.10" MATRIX_DIM 15 /end CHARACTERISTIC
/begin CHARACTERISTIC DINH_Lim.DFC_UCtPSRCMin_CA "" VAL_BLK 0x8024BBD1 ValA_Wu8 17.0000000000 DINH_LimDFCVerb 0.00 17.0000000000 FORMAT "%13.10" MATRIX_DIM 17 /end CHARACTERISTIC
/begin CHARACTERISTIC DINH_Lim.DFC_UPxP1SRCMin_CA "" VAL_BLK 0x8024BBE2 ValA_Wu8 17.0000000000 DINH_LimDFCVerb 0.00 17.0000000000 FORMAT "%13.10" MATRIX_DIM 17 /end CHARACTERISTIC
/begin CHARACTERISTIC DINH_Lim.DFC_ComHSN1CANMute_CA "" VAL_BLK 0x8024BBF3 ValA_Wu8 17.0000000000 DINH_LimDFCVerb 0.00 17.0000000000 FORMAT "%13.10" MATRIX_DIM 13 /end CHARACTERISTIC
/begin CHARACTERISTIC DINH_Lim.DFC_ComHSN3CANMute_CA "" VAL_BLK 0x8024BC00 ValA_Wu8 17.0000000000 DINH_LimDFCVerb 0.00 17.0000000000 FORMAT "%13.10" MATRIX_DIM 13 /end CHARACTERISTIC
/begin CHARACTERISTIC DINH_Lim.DFC_AcChrgrIntkTPhysRngHi_CA "" VAL_BLK 0x8024BC0D ValA_Wu8 17.0000000000 DINH_LimDFCVerb 0.00 17.0000000000 FORMAT "%13.10" MATRIX_DIM 15 /end CHARACTERISTIC
/begin CHARACTERISTIC DINH_Lim.DFC_AcChrgrIntkTPhysRngLo_CA "" VAL_BLK 0x8024BC1C ValA_Wu8 17.0000000000 DINH_LimDFCVerb 0.00 17.0000000000 FORMAT "%13.10" MATRIX_DIM 15 /end CHARACTERISTIC
/begin CHARACTERISTIC DINH_Lim.DFC_AcChrgrIntkTSRCOpn_CA "" VAL_BLK 0x8024BC2B ValA_Wu8 17.0000000000 DINH_LimDFCVerb 0.00 17.0000000000 FORMAT "%13.10" MATRIX_DIM 13 /end CHARACTERISTIC
/begin CHARACTERISTIC DINH_Lim.DFC_CcsPwrLineChpVccPhysRngHi_CA "" VAL_BLK 0x8024BC38 ValA_Wu8 17.0000000000 DINH_LimDFCVerb 0.00 17.0000000000 FORMAT "%13.10" MATRIX_DIM 15 /end CHARACTERISTIC
/begin CHARACTERISTIC DINH_Lim.DFC_CcsPwrLineChpVccPhysRngLo_CA "" VAL_BLK 0x8024BC47 ValA_Wu8 17.0000000000 DINH_LimDFCVerb 0.00 17.0000000000 FORMAT "%13.10" MATRIX_DIM 15 /end CHARACTERISTIC
/begin CHARACTERISTIC DINH_Lim.DFC_CcsPwrLineChpVccSRCOpn_CA "" VAL_BLK 0x8024BC56 ValA_Wu8 17.0000000000 DINH_LimDFCVerb 0.00 17.0000000000 FORMAT "%13.10" MATRIX_DIM 13 /end CHARACTERISTIC
/begin CHARACTERISTIC DINH_Lim.DFC_CcsPwrLineComChpTPhysRngHi_CA "" VAL_BLK 0x8024BC63 ValA_Wu8 17.0000000000 DINH_LimDFCVerb 0.00 17.0000000000 FORMAT "%13.10" MATRIX_DIM 15 /end CHARACTERISTIC
/begin CHARACTERISTIC DINH_Lim.DFC_CcsPwrLineComChpTPhysRngLo_CA "" VAL_BLK 0x8024BC72 ValA_Wu8 17.0000000000 DINH_LimDFCVerb 0.00 17.0000000000 FORMAT "%13.10" MATRIX_DIM 15 /end CHARACTERISTIC
/begin CHARACTERISTIC DINH_Lim.DFC_CcsPwrLineComChpTSRCOpn_CA "" VAL_BLK 0x8024BC81 ValA_Wu8 17.0000000000 DINH_LimDFCVerb 0.00 17.0000000000 FORMAT "%13.10" MATRIX_DIM 14 /end CHARACTERISTIC
/begin CHARACTERISTIC DINH_Lim.DFC_CtPSwtDiagPhysRngHi_CA "" VAL_BLK 0x8024BC8F ValA_Wu8 17.0000000000 DINH_LimDFCVerb 0.00 17.0000000000 FORMAT "%13.10" MATRIX_DIM 15 /end CHARACTERISTIC
/begin CHARACTERISTIC DINH_Lim.DFC_CtPSwtDiagPhysRngLo_CA "" VAL_BLK 0x8024BC9E ValA_Wu8 17.0000000000 DINH_LimDFCVerb 0.00 17.0000000000 FORMAT "%13.10" MATRIX_DIM 15 /end CHARACTERISTIC
/begin CHARACTERISTIC DINH_Lim.DFC_CtPSwtDiagSRCOpn_CA "" VAL_BLK 0x8024BCAD ValA_Wu8 17.0000000000 DINH_LimDFCVerb 0.00 17.0000000000 FORMAT "%13.10" MATRIX_DIM 13 /end CHARACTERISTIC
/begin CHARACTERISTIC DINH_Lim.DFC_CtpCarrFrqPhysRngHi_CA "" VAL_BLK 0x8024BCBA ValA_Wu8 17.0000000000 DINH_LimDFCVerb 0.00 17.0000000000 FORMAT "%13.10" MATRIX_DIM 15 /end CHARACTERISTIC
/begin CHARACTERISTIC DINH_Lim.DFC_CtpCarrFrqPhysRngLo_CA "" VAL_BLK 0x8024BCC9 ValA_Wu8 17.0000000000 DINH_LimDFCVerb 0.00 17.0000000000 FORMAT "%13.10" MATRIX_DIM 15 /end CHARACTERISTIC
/begin CHARACTERISTIC DINH_Lim.DFC_CtpCarrFrqSRCMax_CA "" VAL_BLK 0x8024BCD8 ValA_Wu8 17.0000000000 DINH_LimDFCVerb 0.00 17.0000000000 FORMAT "%13.10" MATRIX_DIM 17 /end CHARACTERISTIC
/begin CHARACTERISTIC DINH_Lim.DFC_DcChrgrIntkT2PhysRngHi_CA "" VAL_BLK 0x8024BCE9 ValA_Wu8 17.0000000000 DINH_LimDFCVerb 0.00 17.0000000000 FORMAT "%13.10" MATRIX_DIM 15 /end CHARACTERISTIC
/begin CHARACTERISTIC DINH_Lim.DFC_DcChrgrIntkT2PhysRngLo_CA "" VAL_BLK 0x8024BCF8 ValA_Wu8 17.0000000000 DINH_LimDFCVerb 0.00 17.0000000000 FORMAT "%13.10" MATRIX_DIM 15 /end CHARACTERISTIC
/begin CHARACTERISTIC DINH_Lim.DFC_DcChrgrIntkT2SRCOpn_CA "" VAL_BLK 0x8024BD07 ValA_Wu8 17.0000000000 DINH_LimDFCVerb 0.00 17.0000000000 FORMAT "%13.10" MATRIX_DIM 13 /end CHARACTERISTIC
/begin CHARACTERISTIC DINH_Lim.DFC_DcChrgrIntkTPhysRngHi_CA "" VAL_BLK 0x8024BD14 ValA_Wu8 17.0000000000 DINH_LimDFCVerb 0.00 17.0000000000 FORMAT "%13.10" MATRIX_DIM 15 /end CHARACTERISTIC
/begin CHARACTERISTIC DINH_Lim.DFC_DcChrgrIntkTPhysRngLo_CA "" VAL_BLK 0x8024BD23 ValA_Wu8 17.0000000000 DINH_LimDFCVerb 0.00 17.0000000000 FORMAT "%13.10" MATRIX_DIM 15 /end CHARACTERISTIC
/begin CHARACTERISTIC DINH_Lim.DFC_DcChrgrIntkTSRCOpn_CA "" VAL_BLK 0x8024BD32 ValA_Wu8 17.0000000000 DINH_LimDFCVerb 0.00 17.0000000000 FORMAT "%13.10" MATRIX_DIM 13 /end CHARACTERISTIC
/begin CHARACTERISTIC DINH_Lim.DFC_Fan1SCG_CA "" VAL_BLK 0x8024BD3F ValA_Wu8 17.0000000000 DINH_LimDFCVerb 0.00 17.0000000000 FORMAT "%13.10" MATRIX_DIM 17 /end CHARACTERISTIC
/begin CHARACTERISTIC DINH_Lim.DFC_FanSpdPhysRngHi_CA "" VAL_BLK 0x8024BD50 ValA_Wu8 17.0000000000 DINH_LimDFCVerb 0.00 17.0000000000 FORMAT "%13.10" MATRIX_DIM 15 /end CHARACTERISTIC
/begin CHARACTERISTIC DINH_Lim.DFC_FanSpdPhysRngLo_CA "" VAL_BLK 0x8024BD5F ValA_Wu8 17.0000000000 DINH_LimDFCVerb 0.00 17.0000000000 FORMAT "%13.10" MATRIX_DIM 15 /end CHARACTERISTIC
/begin CHARACTERISTIC DINH_Lim.DFC_FanSpdSRCOpn_CA "" VAL_BLK 0x8024BD6E ValA_Wu8 17.0000000000 DINH_LimDFCVerb 0.00 17.0000000000 FORMAT "%13.10" MATRIX_DIM 13 /end CHARACTERISTIC
/begin CHARACTERISTIC DINH_Lim.DFC_FreonPPhysRngHi_CA "" VAL_BLK 0x8024BD7B ValA_Wu8 17.0000000000 DINH_LimDFCVerb 0.00 17.0000000000 FORMAT "%13.10" MATRIX_DIM 16 /end CHARACTERISTIC
/begin CHARACTERISTIC DINH_Lim.DFC_FreonPPhysRngLo_CA "" VAL_BLK 0x8024BD8B ValA_Wu8 17.0000000000 DINH_LimDFCVerb 0.00 17.0000000000 FORMAT "%13.10" MATRIX_DIM 16 /end CHARACTERISTIC
/begin CHARACTERISTIC DINH_Lim.DFC_FreonPSRCOpn_CA "" VAL_BLK 0x8024BD9B ValA_Wu8 17.0000000000 DINH_LimDFCVerb 0.00 17.0000000000 FORMAT "%13.10" MATRIX_DIM 15 /end CHARACTERISTIC
/begin CHARACTERISTIC DINH_Lim.DFC_HeatrCoreTPhysRngHi_CA "" VAL_BLK 0x8024BDAA ValA_Wu8 17.0000000000 DINH_LimDFCVerb 0.00 17.0000000000 FORMAT "%13.10" MATRIX_DIM 15 /end CHARACTERISTIC
/begin CHARACTERISTIC DINH_Lim.DFC_HeatrCoreTPhysRngLo_CA "" VAL_BLK 0x8024BDB9 ValA_Wu8 17.0000000000 DINH_LimDFCVerb 0.00 17.0000000000 FORMAT "%13.10" MATRIX_DIM 15 /end CHARACTERISTIC
/begin CHARACTERISTIC DINH_Lim.DFC_HeatrCoreTSRCOpn_CA "" VAL_BLK 0x8024BDC8 ValA_Wu8 17.0000000000 DINH_LimDFCVerb 0.00 17.0000000000 FORMAT "%13.10" MATRIX_DIM 13 /end CHARACTERISTIC
/begin CHARACTERISTIC DINH_Lim.DFC_HvGridUMaxSftyLim_CA "" VAL_BLK 0x8024BDD5 ValA_Wu8 17.0000000000 DINH_LimDFCVerb 0.00 17.0000000000 FORMAT "%13.10" MATRIX_DIM 14 /end CHARACTERISTIC
/begin CHARACTERISTIC DINH_Lim.DFC_HvGridUMinSftyLim_CA "" VAL_BLK 0x8024BDE3 ValA_Wu8 17.0000000000 DINH_LimDFCVerb 0.00 17.0000000000 FORMAT "%13.10" MATRIX_DIM 14 /end CHARACTERISTIC
/begin CHARACTERISTIC DINH_Lim.DFC_HvGridUPlausy_CA "" VAL_BLK 0x8024BDF1 ValA_Wu8 17.0000000000 DINH_LimDFCVerb 0.00 17.0000000000 FORMAT "%13.10" MATRIX_DIM 16 /end CHARACTERISTIC
/begin CHARACTERISTIC DINH_Lim.DFC_IntlckChrgPlgHBrgOpnLd_CA "" VAL_BLK 0x8024BE01 ValA_Wu8 17.0000000000 DINH_LimDFCVerb 0.00 17.0000000000 FORMAT "%13.10" MATRIX_DIM 15 /end CHARACTERISTIC
/begin CHARACTERISTIC DINH_Lim.DFC_IntlckChrgPlgHBrgOvrCurr_CA "" VAL_BLK 0x8024BE10 ValA_Wu8 17.0000000000 DINH_LimDFCVerb 0.00 17.0000000000 FORMAT "%13.10" MATRIX_DIM 14 /end CHARACTERISTIC
/begin CHARACTERISTIC DINH_Lim.DFC_IntlckChrgPlgHBrgOvrTemp_CA "" VAL_BLK 0x8024BE1E ValA_Wu8 17.0000000000 DINH_LimDFCVerb 0.00 17.0000000000 FORMAT "%13.10" MATRIX_DIM 14 /end CHARACTERISTIC
/begin CHARACTERISTIC DINH_Lim.DFC_IntlckChrgPlgHBrgShCirBatt1_CA "" VAL_BLK 0x8024BE2C ValA_Wu8 17.0000000000 DINH_LimDFCVerb 0.00 17.0000000000 FORMAT "%13.10" MATRIX_DIM 15 /end CHARACTERISTIC
/begin CHARACTERISTIC DINH_Lim.DFC_IntlckChrgPlgHBrgShCirBatt2_CA "" VAL_BLK 0x8024BE3B ValA_Wu8 17.0000000000 DINH_LimDFCVerb 0.00 17.0000000000 FORMAT "%13.10" MATRIX_DIM 15 /end CHARACTERISTIC
/begin CHARACTERISTIC DINH_Lim.DFC_IntlckChrgPlgHBrgShCirGnd1_CA "" VAL_BLK 0x8024BE4A ValA_Wu8 17.0000000000 DINH_LimDFCVerb 0.00 17.0000000000 FORMAT "%13.10" MATRIX_DIM 15 /end CHARACTERISTIC
/begin CHARACTERISTIC DINH_Lim.DFC_IntlckChrgPlgHBrgShCirGnd2_CA "" VAL_BLK 0x8024BE59 ValA_Wu8 17.0000000000 DINH_LimDFCVerb 0.00 17.0000000000 FORMAT "%13.10" MATRIX_DIM 15 /end CHARACTERISTIC
/begin CHARACTERISTIC DINH_Lim.DFC_IntlckChrgPlgHBrgShCirOvrLd_CA "" VAL_BLK 0x8024BE68 ValA_Wu8 17.0000000000 DINH_LimDFCVerb 0.00 17.0000000000 FORMAT "%13.10" MATRIX_DIM 15 /end CHARACTERISTIC
/begin CHARACTERISTIC DINH_Lim.DFC_IntlckChrgPlgHBrgTempOvrCurr_CA "" VAL_BLK 0x8024BE77 ValA_Wu8 17.0000000000 DINH_LimDFCVerb 0.00 17.0000000000 FORMAT "%13.10" MATRIX_DIM 14 /end CHARACTERISTIC
/begin CHARACTERISTIC DINH_Lim.DFC_IntlckChrgPlgHBrgUndrVltg_CA "" VAL_BLK 0x8024BE85 ValA_Wu8 17.0000000000 DINH_LimDFCVerb 0.00 17.0000000000 FORMAT "%13.10" MATRIX_DIM 14 /end CHARACTERISTIC
/begin CHARACTERISTIC DINH_Lim.DFC_IntlckChrgPlgPosnRngFlt_CA "" VAL_BLK 0x8024BE93 ValA_Wu8 17.0000000000 DINH_LimDFCVerb 0.00 17.0000000000 FORMAT "%13.10" MATRIX_DIM 13 /end CHARACTERISTIC
/begin CHARACTERISTIC DINH_Lim.DFC_IntlckChrgPlgPosnSrcMax_CA "" VAL_BLK 0x8024BEA0 ValA_Wu8 17.0000000000 DINH_LimDFCVerb 0.00 17.0000000000 FORMAT "%13.10" MATRIX_DIM 14 /end CHARACTERISTIC
/begin CHARACTERISTIC DINH_Lim.DFC_IntlckChrgPlgPosnSrcMin_CA "" VAL_BLK 0x8024BEAE ValA_Wu8 17.0000000000 DINH_LimDFCVerb 0.00 17.0000000000 FORMAT "%13.10" MATRIX_DIM 14 /end CHARACTERISTIC
/begin CHARACTERISTIC DINH_Lim.DFC_PwmCtPPhysRngHi_CA "" VAL_BLK 0x8024BEBC ValA_Wu8 17.0000000000 DINH_LimDFCVerb 0.00 17.0000000000 FORMAT "%13.10" MATRIX_DIM 15 /end CHARACTERISTIC
/begin CHARACTERISTIC DINH_Lim.DFC_PwmCtPPhysRngLo_CA "" VAL_BLK 0x8024BECB ValA_Wu8 17.0000000000 DINH_LimDFCVerb 0.00 17.0000000000 FORMAT "%13.10" MATRIX_DIM 15 /end CHARACTERISTIC
/begin CHARACTERISTIC DINH_Lim.DFC_PwmCtPSRCMax_CA "" VAL_BLK 0x8024BEDA ValA_Wu8 17.0000000000 DINH_LimDFCVerb 0.00 17.0000000000 FORMAT "%13.10" MATRIX_DIM 17 /end CHARACTERISTIC
/begin CHARACTERISTIC DINH_Lim.DFC_PwrDistbnUnitTPhysRngHi_CA "" VAL_BLK 0x8024BEEB ValA_Wu8 17.0000000000 DINH_LimDFCVerb 0.00 17.0000000000 FORMAT "%13.10" MATRIX_DIM 15 /end CHARACTERISTIC
/begin CHARACTERISTIC DINH_Lim.DFC_PwrDistbnUnitTPhysRngLo_CA "" VAL_BLK 0x8024BEFA ValA_Wu8 17.0000000000 DINH_LimDFCVerb 0.00 17.0000000000 FORMAT "%13.10" MATRIX_DIM 15 /end CHARACTERISTIC
/begin CHARACTERISTIC DINH_Lim.DFC_PwrDistbnUnitTSRCOpn_CA "" VAL_BLK 0x8024BF09 ValA_Wu8 17.0000000000 DINH_LimDFCVerb 0.00 17.0000000000 FORMAT "%13.10" MATRIX_DIM 17 /end CHARACTERISTIC
/begin CHARACTERISTIC DINH_Lim.DFC_SCtPmpRlySCG_CA "" VAL_BLK 0x8024BF1A ValA_Wu8 17.0000000000 DINH_LimDFCVerb 0.00 17.0000000000 FORMAT "%13.10" MATRIX_DIM 15 /end CHARACTERISTIC
/begin CHARACTERISTIC DINH_Lim.DFC_SpplCooltPmpRlySCG_CA "" VAL_BLK 0x8024BF29 ValA_Wu8 17.0000000000 DINH_LimDFCVerb 0.00 17.0000000000 FORMAT "%13.10" MATRIX_DIM 15 /end CHARACTERISTIC
/begin CHARACTERISTIC DINH_Lim.DFC_UCtPPhysRngHi_CA "" VAL_BLK 0x8024BF38 ValA_Wu8 17.0000000000 DINH_LimDFCVerb 0.00 17.0000000000 FORMAT "%13.10" MATRIX_DIM 15 /end CHARACTERISTIC
/begin CHARACTERISTIC DINH_Lim.DFC_UCtPPhysRngLo_CA "" VAL_BLK 0x8024BF47 ValA_Wu8 17.0000000000 DINH_LimDFCVerb 0.00 17.0000000000 FORMAT "%13.10" MATRIX_DIM 15 /end CHARACTERISTIC
/begin CHARACTERISTIC DINH_Lim.DFC_UCtPSRCOpn_CA "" VAL_BLK 0x8024BF56 ValA_Wu8 17.0000000000 DINH_LimDFCVerb 0.00 17.0000000000 FORMAT "%13.10" MATRIX_DIM 13 /end CHARACTERISTIC
/begin CHARACTERISTIC DINH_Lim.DFC_UPxP1PhysRngHi_CA "" VAL_BLK 0x8024BF63 ValA_Wu8 17.0000000000 DINH_LimDFCVerb 0.00 17.0000000000 FORMAT "%13.10" MATRIX_DIM 15 /end CHARACTERISTIC
/begin CHARACTERISTIC DINH_Lim.DFC_UPxP1PhysRngLo_CA "" VAL_BLK 0x8024BF72 ValA_Wu8 17.0000000000 DINH_LimDFCVerb 0.00 17.0000000000 FORMAT "%13.10" MATRIX_DIM 15 /end CHARACTERISTIC
/begin CHARACTERISTIC DINH_Lim.DFC_UPxP1SRCOpn_CA "" VAL_BLK 0x8024BF81 ValA_Wu8 17.0000000000 DINH_LimDFCVerb 0.00 17.0000000000 FORMAT "%13.10" MATRIX_DIM 13 /end CHARACTERISTIC
/begin CHARACTERISTIC DINH_Lim.DFC_VehVPhysRngHi_CA "" VAL_BLK 0x8024BF8E ValA_Wu8 17.0000000000 DINH_LimDFCVerb 0.00 17.0000000000 FORMAT "%13.10" MATRIX_DIM 15 /end CHARACTERISTIC
/begin CHARACTERISTIC DINH_Lim.DFC_VehVPhysRngLo_CA "" VAL_BLK 0x8024BF9D ValA_Wu8 17.0000000000 DINH_LimDFCVerb 0.00 17.0000000000 FORMAT "%13.10" MATRIX_DIM 15 /end CHARACTERISTIC
/begin CHARACTERISTIC DINH_Lim.DFC_VehVSigCan_CA "" VAL_BLK 0x8024BFAC ValA_Wu8 17.0000000000 DINH_LimDFCVerb 0.00 17.0000000000 FORMAT "%13.10" MATRIX_DIM 15 /end CHARACTERISTIC
/begin CHARACTERISTIC DINH_Lim.DFC_VehVSigCanSafe_CA "" VAL_BLK 0x8024BFBB ValA_Wu8 17.0000000000 DINH_LimDFCVerb 0.00 17.0000000000 FORMAT "%13.10" MATRIX_DIM 15 /end CHARACTERISTIC
/begin CHARACTERISTIC DINH_Lim.DFC_SCtPmp1DiagGrdKey1_CA "" VAL_BLK 0x8024BFCA ValA_Wu8 17.0000000000 DINH_LimDFCVerb 0.00 17.0000000000 FORMAT "%13.10" MATRIX_DIM 14 /end CHARACTERISTIC
/begin CHARACTERISTIC DINH_Lim.DFC_SCtPmp1DiagGrdKey2_CA "" VAL_BLK 0x8024BFD8 ValA_Wu8 17.0000000000 DINH_LimDFCVerb 0.00 17.0000000000 FORMAT "%13.10" MATRIX_DIM 14 /end CHARACTERISTIC
/begin CHARACTERISTIC DINH_Lim.DFC_SCtPmp1DiagGrdKey3_CA "" VAL_BLK 0x8024BFE6 ValA_Wu8 17.0000000000 DINH_LimDFCVerb 0.00 17.0000000000 FORMAT "%13.10" MATRIX_DIM 14 /end CHARACTERISTIC
/begin CHARACTERISTIC DINH_Lim.DFC_SCtPmp1DiagGrdKey4_CA "" VAL_BLK 0x8024BFF4 ValA_Wu8 17.0000000000 DINH_LimDFCVerb 0.00 17.0000000000 FORMAT "%13.10" MATRIX_DIM 14 /end CHARACTERISTIC
/begin CHARACTERISTIC DINH_Lim.DFC_SCtPmp1DiagGrdKey5_CA "" VAL_BLK 0x8024C002 ValA_Wu8 17.0000000000 DINH_LimDFCVerb 0.00 17.0000000000 FORMAT "%13.10" MATRIX_DIM 14 /end CHARACTERISTIC
/begin CHARACTERISTIC DINH_Lim.DFC_ChrgPlgLiveCntctHzrdCcs_CA "" VAL_BLK 0x8024C010 ValA_Wu8 17.0000000000 DINH_LimDFCVerb 0.00 17.0000000000 FORMAT "%13.10" MATRIX_DIM 13 /end CHARACTERISTIC
/begin CHARACTERISTIC DINH_Lim.DFC_ChrgPlgProxPltImps_CA "" VAL_BLK 0x8024C01D ValA_Wu8 17.0000000000 DINH_LimDFCVerb 0.00 17.0000000000 FORMAT "%13.10" MATRIX_DIM 13 /end CHARACTERISTIC
/begin CHARACTERISTIC DINH_Lim.DFC_ChrgPlgTHiCcsDc_CA "" VAL_BLK 0x8024C02A ValA_Wu8 17.0000000000 DINH_LimDFCVerb 0.00 17.0000000000 FORMAT "%13.10" MATRIX_DIM 14 /end CHARACTERISTIC
/begin CHARACTERISTIC DINH_Lim.DFC_ElMActvDchaFailr_CA "" VAL_BLK 0x8024C038 ValA_Wu8 17.0000000000 DINH_LimDFCVerb 0.00 17.0000000000 FORMAT "%13.10" MATRIX_DIM 13 /end CHARACTERISTIC
/begin CHARACTERISTIC DINH_Lim.DFC_ElMActvDchaFlt_CA "" VAL_BLK 0x8024C045 ValA_Wu8 17.0000000000 DINH_LimDFCVerb 0.00 17.0000000000 FORMAT "%13.10" MATRIX_DIM 13 /end CHARACTERISTIC
/begin CHARACTERISTIC DINH_Lim.DFC_ElMFbdnIvtrModDrv01_CA "" VAL_BLK 0x8024C052 ValA_Wu8 17.0000000000 DINH_LimDFCVerb 0.00 17.0000000000 FORMAT "%13.10" MATRIX_DIM 13 /end CHARACTERISTIC
/begin CHARACTERISTIC DINH_Lim.DFC_ElMImobAuthent_CA "" VAL_BLK 0x8024C05F ValA_Wu8 17.0000000000 DINH_LimDFCVerb 0.00 17.0000000000 FORMAT "%13.10" MATRIX_DIM 13 /end CHARACTERISTIC
/begin CHARACTERISTIC DINH_Lim.DFC_ElMIsoMonFlt_CA "" VAL_BLK 0x8024C06C ValA_Wu8 17.0000000000 DINH_LimDFCVerb 0.00 17.0000000000 FORMAT "%13.10" MATRIX_DIM 13 /end CHARACTERISTIC
/begin CHARACTERISTIC DINH_Lim.DFC_ElMIsoMonPlausyFlt_CA "" VAL_BLK 0x8024C079 ValA_Wu8 17.0000000000 DINH_LimDFCVerb 0.00 17.0000000000 FORMAT "%13.10" MATRIX_DIM 13 /end CHARACTERISTIC
/begin CHARACTERISTIC DINH_Lim.DFC_ElMIvtrCooltT01_CA "" VAL_BLK 0x8024C086 ValA_Wu8 17.0000000000 DINH_LimDFCVerb 0.00 17.0000000000 FORMAT "%13.10" MATRIX_DIM 13 /end CHARACTERISTIC
/begin CHARACTERISTIC DINH_Lim.DFC_ElMIvtrEmgyShtDwn01_CA "" VAL_BLK 0x8024C093 ValA_Wu8 17.0000000000 DINH_LimDFCVerb 0.00 17.0000000000 FORMAT "%13.10" MATRIX_DIM 15 /end CHARACTERISTIC
/begin CHARACTERISTIC DINH_Lim.DFC_ElMIvtrFailr01_CA "" VAL_BLK 0x8024C0A2 ValA_Wu8 17.0000000000 DINH_LimDFCVerb 0.00 17.0000000000 FORMAT "%13.10" MATRIX_DIM 15 /end CHARACTERISTIC
/begin CHARACTERISTIC DINH_Lim.DFC_ElMIvtrIntlck01_CA "" VAL_BLK 0x8024C0B1 ValA_Wu8 17.0000000000 DINH_LimDFCVerb 0.00 17.0000000000 FORMAT "%13.10" MATRIX_DIM 16 /end CHARACTERISTIC
/begin CHARACTERISTIC DINH_Lim.DFC_ElMIvtrTErr01_CA "" VAL_BLK 0x8024C0C1 ValA_Wu8 17.0000000000 DINH_LimDFCVerb 0.00 17.0000000000 FORMAT "%13.10" MATRIX_DIM 13 /end CHARACTERISTIC
/begin CHARACTERISTIC DINH_Lim.DFC_ElMOverSpdNeg01_CA "" VAL_BLK 0x8024C0CE ValA_Wu8 17.0000000000 DINH_LimDFCVerb 0.00 17.0000000000 FORMAT "%13.10" MATRIX_DIM 13 /end CHARACTERISTIC
/begin CHARACTERISTIC DINH_Lim.DFC_ElMOverSpdPos01_CA "" VAL_BLK 0x8024C0DB ValA_Wu8 17.0000000000 DINH_LimDFCVerb 0.00 17.0000000000 FORMAT "%13.10" MATRIX_DIM 13 /end CHARACTERISTIC
/begin CHARACTERISTIC DINH_Lim.DFC_ElMOverTqNeg01_CA "" VAL_BLK 0x8024C0E8 ValA_Wu8 17.0000000000 DINH_LimDFCVerb 0.00 17.0000000000 FORMAT "%13.10" MATRIX_DIM 13 /end CHARACTERISTIC
/begin CHARACTERISTIC DINH_Lim.DFC_ElMOverTqPos01_CA "" VAL_BLK 0x8024C0F5 ValA_Wu8 17.0000000000 DINH_LimDFCVerb 0.00 17.0000000000 FORMAT "%13.10" MATRIX_DIM 13 /end CHARACTERISTIC
/begin CHARACTERISTIC DINH_Lim.DFC_ElMPwrAuthn_CA "" VAL_BLK 0x8024C102 ValA_Wu8 17.0000000000 DINH_LimDFCVerb 0.00 17.0000000000 FORMAT "%13.10" MATRIX_DIM 13 /end CHARACTERISTIC
/begin CHARACTERISTIC DINH_Lim.DFC_ElMSpdErr01_CA "" VAL_BLK 0x8024C10F ValA_Wu8 17.0000000000 DINH_LimDFCVerb 0.00 17.0000000000 FORMAT "%13.10" MATRIX_DIM 13 /end CHARACTERISTIC
/begin CHARACTERISTIC DINH_Lim.DFC_ElMSvs01_CA "" VAL_BLK 0x8024C11C ValA_Wu8 17.0000000000 DINH_LimDFCVerb 0.00 17.0000000000 FORMAT "%13.10" MATRIX_DIM 13 /end CHARACTERISTIC
/begin CHARACTERISTIC DINH_Lim.DFC_PEnvCcMax_CA "" VAL_BLK 0x8024C129 ValA_Wu8 17.0000000000 DINH_LimDFCVerb 0.00 17.0000000000 FORMAT "%13.10" MATRIX_DIM 16 /end CHARACTERISTIC
/begin CHARACTERISTIC DINH_Lim.DFC_PEnvCcMin_CA "" VAL_BLK 0x8024C139 ValA_Wu8 17.0000000000 DINH_LimDFCVerb 0.00 17.0000000000 FORMAT "%13.10" MATRIX_DIM 16 /end CHARACTERISTIC
/begin CHARACTERISTIC DINH_Lim.DFC_PEnvRngChkMax_CA "" VAL_BLK 0x8024C149 ValA_Wu8 17.0000000000 DINH_LimDFCVerb 0.00 17.0000000000 FORMAT "%13.10" MATRIX_DIM 17 /end CHARACTERISTIC
/begin CHARACTERISTIC DINH_Lim.DFC_PEnvRngChkMin_CA "" VAL_BLK 0x8024C15A ValA_Wu8 17.0000000000 DINH_LimDFCVerb 0.00 17.0000000000 FORMAT "%13.10" MATRIX_DIM 17 /end CHARACTERISTIC
/begin CHARACTERISTIC DINH_Lim.DFC_PEnvSnsrPlaus_CA "" VAL_BLK 0x8024C16B ValA_Wu8 17.0000000000 DINH_LimDFCVerb 0.00 17.0000000000 FORMAT "%13.10" MATRIX_DIM 18 /end CHARACTERISTIC
/begin CHARACTERISTIC DINH_Lim.DFC_BrkBstPmpPlausGenn_CA "" VAL_BLK 0x8024C17D ValA_Wu8 17.0000000000 DINH_LimDFCVerb 0.00 17.0000000000 FORMAT "%13.10" MATRIX_DIM 14 /end CHARACTERISTIC
/begin CHARACTERISTIC DINH_Lim.DFC_CbnHeatrRlyLfLoWarn_CA "" VAL_BLK 0x8024C18B ValA_Wu8 17.0000000000 DINH_LimDFCVerb 0.00 17.0000000000 FORMAT "%13.10" MATRIX_DIM 13 /end CHARACTERISTIC
/begin CHARACTERISTIC DINH_Lim.DFC_ChgrPlugLockPinByndClsd_CA "" VAL_BLK 0x8024C198 ValA_Wu8 17.0000000000 DINH_LimDFCVerb 0.00 17.0000000000 FORMAT "%13.10" MATRIX_DIM 13 /end CHARACTERISTIC
/begin CHARACTERISTIC DINH_Lim.DFC_ChgrPlugLockPinMoveWoCmd_CA "" VAL_BLK 0x8024C1A5 ValA_Wu8 17.0000000000 DINH_LimDFCVerb 0.00 17.0000000000 FORMAT "%13.10" MATRIX_DIM 13 /end CHARACTERISTIC
/begin CHARACTERISTIC DINH_Lim.DFC_ChgrPlugLockPinStuckInClsd_CA "" VAL_BLK 0x8024C1B2 ValA_Wu8 17.0000000000 DINH_LimDFCVerb 0.00 17.0000000000 FORMAT "%13.10" MATRIX_DIM 13 /end CHARACTERISTIC
/begin CHARACTERISTIC DINH_Lim.DFC_ChgrPlugLockPinStuckInOpen_CA "" VAL_BLK 0x8024C1BF ValA_Wu8 17.0000000000 DINH_LimDFCVerb 0.00 17.0000000000 FORMAT "%13.10" MATRIX_DIM 13 /end CHARACTERISTIC
/begin CHARACTERISTIC DINH_Lim.DFC_ChrgrStErr_CA "" VAL_BLK 0x8024C1CC ValA_Wu8 17.0000000000 DINH_LimDFCVerb 0.00 17.0000000000 FORMAT "%13.10" MATRIX_DIM 13 /end CHARACTERISTIC
/begin CHARACTERISTIC DINH_Lim.DFC_ComHSN1BusOff_CA "" VAL_BLK 0x8024C1D9 ValA_Wu8 17.0000000000 DINH_LimDFCVerb 0.00 17.0000000000 FORMAT "%13.10" MATRIX_DIM 13 /end CHARACTERISTIC
/begin CHARACTERISTIC DINH_Lim.DFC_ComHSN3BusOff_CA "" VAL_BLK 0x8024C1E6 ValA_Wu8 17.0000000000 DINH_LimDFCVerb 0.00 17.0000000000 FORMAT "%13.10" MATRIX_DIM 13 /end CHARACTERISTIC
/begin CHARACTERISTIC DINH_Lim.DFC_ComVCInval_CA "" VAL_BLK 0x8024C1F3 ValA_Wu8 17.0000000000 DINH_LimDFCVerb 0.00 17.0000000000 FORMAT "%13.10" MATRIX_DIM 13 /end CHARACTERISTIC
/begin CHARACTERISTIC DINH_Lim.DFC_EemDcdcPrecSpdInhb_CA "" VAL_BLK 0x8024C200 ValA_Wu8 17.0000000000 DINH_LimDFCVerb 0.00 17.0000000000 FORMAT "%13.10" MATRIX_DIM 13 /end CHARACTERISTIC
/begin CHARACTERISTIC DINH_Lim.DFC_ExpPwrLatch_CA "" VAL_BLK 0x8024C20D ValA_Wu8 17.0000000000 DINH_LimDFCVerb 0.00 17.0000000000 FORMAT "%13.10" MATRIX_DIM 14 /end CHARACTERISTIC
/begin CHARACTERISTIC DINH_Lim.DFC_FanMaxOvrd_CA "" VAL_BLK 0x8024C21B ValA_Wu8 17.0000000000 DINH_LimDFCVerb 0.00 17.0000000000 FORMAT "%13.10" MATRIX_DIM 13 /end CHARACTERISTIC
/begin CHARACTERISTIC DINH_Lim.DFC_HLCCcsGnrlComErr_CA "" VAL_BLK 0x8024C228 ValA_Wu8 17.0000000000 DINH_LimDFCVerb 0.00 17.0000000000 FORMAT "%13.10" MATRIX_DIM 13 /end CHARACTERISTIC
/begin CHARACTERISTIC DINH_Lim.DFC_InmLINNodeHVACPanelAbsnt_CA "" VAL_BLK 0x8024C235 ValA_Wu8 17.0000000000 DINH_LimDFCVerb 0.00 17.0000000000 FORMAT "%13.10" MATRIX_DIM 15 /end CHARACTERISTIC
/begin CHARACTERISTIC DINH_Lim.DFC_ResetRcvNotAllwd_CA "" VAL_BLK 0x8024C244 ValA_Wu8 17.0000000000 DINH_LimDFCVerb 0.00 17.0000000000 FORMAT "%13.10" MATRIX_DIM 13 /end CHARACTERISTIC
/begin CHARACTERISTIC DINH_Lim.DFC_TelltlCooltPlaus_CA "" VAL_BLK 0x8024C251 ValA_Wu8 17.0000000000 DINH_LimDFCVerb 0.00 17.0000000000 FORMAT "%13.10" MATRIX_DIM 13 /end CHARACTERISTIC
/begin CHARACTERISTIC DINH_Lim.DFC_MRlyOL_CA "" VAL_BLK 0x8024C25E ValA_Wu8 17.0000000000 DINH_LimDFCVerb 0.00 17.0000000000 FORMAT "%13.10" MATRIX_DIM 13 /end CHARACTERISTIC
/begin CHARACTERISTIC DINH_Lim.DFC_MRlySCB_CA "" VAL_BLK 0x8024C26B ValA_Wu8 17.0000000000 DINH_LimDFCVerb 0.00 17.0000000000 FORMAT "%13.10" MATRIX_DIM 13 /end CHARACTERISTIC
/begin CHARACTERISTIC DINH_Lim.DFC_MRlySCG_CA "" VAL_BLK 0x8024C278 ValA_Wu8 17.0000000000 DINH_LimDFCVerb 0.00 17.0000000000 FORMAT "%13.10" MATRIX_DIM 14 /end CHARACTERISTIC
/begin CHARACTERISTIC DINH_Lim.DFC_SSpMon1_CA "" VAL_BLK 0x8024C286 ValA_Wu8 17.0000000000 DINH_LimDFCVerb 0.00 17.0000000000 FORMAT "%13.10" MATRIX_DIM 45 /end CHARACTERISTIC
/begin CHARACTERISTIC DINH_Lim.DFC_SSpMon1OV_CA "" VAL_BLK 0x8024C2B3 ValA_Wu8 17.0000000000 DINH_LimDFCVerb 0.00 17.0000000000 FORMAT "%13.10" MATRIX_DIM 17 /end CHARACTERISTIC
/begin CHARACTERISTIC DINH_Lim.DFC_SSpMon1SCG_CA "" VAL_BLK 0x8024C2C4 ValA_Wu8 17.0000000000 DINH_LimDFCVerb 0.00 17.0000000000 FORMAT "%13.10" MATRIX_DIM 17 /end CHARACTERISTIC
/begin CHARACTERISTIC DINH_Lim.DFC_SSpMon1UV_CA "" VAL_BLK 0x8024C2D5 ValA_Wu8 17.0000000000 DINH_LimDFCVerb 0.00 17.0000000000 FORMAT "%13.10" MATRIX_DIM 17 /end CHARACTERISTIC
/begin CHARACTERISTIC DINH_Lim.DFC_SSpMon2_CA "" VAL_BLK 0x8024C2E6 ValA_Wu8 17.0000000000 DINH_LimDFCVerb 0.00 17.0000000000 FORMAT "%13.10" MATRIX_DIM 42 /end CHARACTERISTIC
/begin CHARACTERISTIC DINH_Lim.DFC_SSpMon2OV_CA "" VAL_BLK 0x8024C310 ValA_Wu8 17.0000000000 DINH_LimDFCVerb 0.00 17.0000000000 FORMAT "%13.10" MATRIX_DIM 14 /end CHARACTERISTIC
/begin CHARACTERISTIC DINH_Lim.DFC_SSpMon2SCG_CA "" VAL_BLK 0x8024C31E ValA_Wu8 17.0000000000 DINH_LimDFCVerb 0.00 17.0000000000 FORMAT "%13.10" MATRIX_DIM 14 /end CHARACTERISTIC
/begin CHARACTERISTIC DINH_Lim.DFC_SSpMon2UV_CA "" VAL_BLK 0x8024C32C ValA_Wu8 17.0000000000 DINH_LimDFCVerb 0.00 17.0000000000 FORMAT "%13.10" MATRIX_DIM 14 /end CHARACTERISTIC
/begin CHARACTERISTIC DINH_Lim.DFC_SSpMon3_CA "" VAL_BLK 0x8024C33A ValA_Wu8 17.0000000000 DINH_LimDFCVerb 0.00 17.0000000000 FORMAT "%13.10" MATRIX_DIM 45 /end CHARACTERISTIC
/begin CHARACTERISTIC DINH_Lim.DFC_SSpMon3OV_CA "" VAL_BLK 0x8024C367 ValA_Wu8 17.0000000000 DINH_LimDFCVerb 0.00 17.0000000000 FORMAT "%13.10" MATRIX_DIM 16 /end CHARACTERISTIC
/begin CHARACTERISTIC DINH_Lim.DFC_SSpMon3SCG_CA "" VAL_BLK 0x8024C377 ValA_Wu8 17.0000000000 DINH_LimDFCVerb 0.00 17.0000000000 FORMAT "%13.10" MATRIX_DIM 16 /end CHARACTERISTIC
/begin CHARACTERISTIC DINH_Lim.DFC_SSpMon3UV_CA "" VAL_BLK 0x8024C387 ValA_Wu8 17.0000000000 DINH_LimDFCVerb 0.00 17.0000000000 FORMAT "%13.10" MATRIX_DIM 16 /end CHARACTERISTIC
/begin CHARACTERISTIC DINH_Lim.DFC_CANSM_E_BUS_OFF_NETWORK_HSN1_CAN_CA "" VAL_BLK 0x8024C397 ValA_Wu8 17.0000000000 DINH_LimDFCVerb 0.00 17.0000000000 FORMAT "%13.10" MATRIX_DIM 13 /end CHARACTERISTIC
/begin CHARACTERISTIC DINH_Lim.DFC_CANSM_E_BUS_OFF_NETWORK_HSN3_CAN_CA "" VAL_BLK 0x8024C3A4 ValA_Wu8 17.0000000000 DINH_LimDFCVerb 0.00 17.0000000000 FORMAT "%13.10" MATRIX_DIM 13 /end CHARACTERISTIC
/begin CHARACTERISTIC DINH_Lim.DFC_CANSM_E_BUS_OFF_NETWORK_HSN4_CAN_CA "" VAL_BLK 0x8024C3B1 ValA_Wu8 17.0000000000 DINH_LimDFCVerb 0.00 17.0000000000 FORMAT "%13.10" MATRIX_DIM 13 /end CHARACTERISTIC
/begin CHARACTERISTIC DINH_Lim.DFC_CANSM_E_BUS_OFF_NETWORK_XCP_CAN_CA "" VAL_BLK 0x8024C3BE ValA_Wu8 17.0000000000 DINH_LimDFCVerb 0.00 17.0000000000 FORMAT "%13.10" MATRIX_DIM 13 /end CHARACTERISTIC
/begin CHARACTERISTIC DINH_Lim.DFC_CANTRCV_E_NO_TRCV_CONTROL_0_CA "" VAL_BLK 0x8024C3CB ValA_Wu8 17.0000000000 DINH_LimDFCVerb 0.00 17.0000000000 FORMAT "%13.10" MATRIX_DIM 13 /end CHARACTERISTIC
/begin CHARACTERISTIC DINH_Lim.DFC_CAN_E_TIMEOUT_CA "" VAL_BLK 0x8024C3D8 ValA_Wu8 17.0000000000 DINH_LimDFCVerb 0.00 17.0000000000 FORMAT "%13.10" MATRIX_DIM 13 /end CHARACTERISTIC
/begin CHARACTERISTIC DINH_Lim.DFC_COMM_E_NET_START_IND_CHANNEL_0_CA "" VAL_BLK 0x8024C3E5 ValA_Wu8 17.0000000000 DINH_LimDFCVerb 0.00 17.0000000000 FORMAT "%13.10" MATRIX_DIM 13 /end CHARACTERISTIC
/begin CHARACTERISTIC DINH_Lim.DFC_COMM_E_NET_START_IND_CHANNEL_1_CA "" VAL_BLK 0x8024C3F2 ValA_Wu8 17.0000000000 DINH_LimDFCVerb 0.00 17.0000000000 FORMAT "%13.10" MATRIX_DIM 14 /end CHARACTERISTIC
/begin CHARACTERISTIC DINH_Lim.DFC_COMM_E_NET_START_IND_CHANNEL_2_CA "" VAL_BLK 0x8024C400 ValA_Wu8 17.0000000000 DINH_LimDFCVerb 0.00 17.0000000000 FORMAT "%13.10" MATRIX_DIM 13 /end CHARACTERISTIC
/begin CHARACTERISTIC DINH_Lim.DFC_COMM_E_NET_START_IND_CHANNEL_3_CA "" VAL_BLK 0x8024C40D ValA_Wu8 17.0000000000 DINH_LimDFCVerb 0.00 17.0000000000 FORMAT "%13.10" MATRIX_DIM 13 /end CHARACTERISTIC
/begin CHARACTERISTIC DINH_Lim.DFC_COMM_E_NET_START_IND_CHANNEL_4_CA "" VAL_BLK 0x8024C41A ValA_Wu8 17.0000000000 DINH_LimDFCVerb 0.00 17.0000000000 FORMAT "%13.10" MATRIX_DIM 13 /end CHARACTERISTIC
/begin CHARACTERISTIC DINH_Lim.DFC_COMM_E_NET_START_IND_CHANNEL_5_CA "" VAL_BLK 0x8024C427 ValA_Wu8 17.0000000000 DINH_LimDFCVerb 0.00 17.0000000000 FORMAT "%13.10" MATRIX_DIM 13 /end CHARACTERISTIC
/begin CHARACTERISTIC DINH_Lim.DFC_LIN_E_TIMEOUT_CA "" VAL_BLK 0x8024C434 ValA_Wu8 17.0000000000 DINH_LimDFCVerb 0.00 17.0000000000 FORMAT "%13.10" MATRIX_DIM 13 /end CHARACTERISTIC
/begin CHARACTERISTIC DINH_Lim.DFC_rba_EcuCtrl_TOMaxProlg_CA "" VAL_BLK 0x8024C441 ValA_Wu8 17.0000000000 DINH_LimDFCVerb 0.00 17.0000000000 FORMAT "%13.10" MATRIX_DIM 13 /end CHARACTERISTIC
/begin CHARACTERISTIC DINH_Lim.DFC_rba_EcuCtrl_TOMaxShutDwn_CA "" VAL_BLK 0x8024C44E ValA_Wu8 17.0000000000 DINH_LimDFCVerb 0.00 17.0000000000 FORMAT "%13.10" MATRIX_DIM 13 /end CHARACTERISTIC
/begin CHARACTERISTIC DINH_Lim.DFC_rba_MultiStackTrace_Threshold_CA "" VAL_BLK 0x8024C45B ValA_Wu8 17.0000000000 DINH_LimDFCVerb 0.00 17.0000000000 FORMAT "%13.10" MATRIX_DIM 13 /end CHARACTERISTIC
/begin CHARACTERISTIC DINH_Lim.DFC_rba_SyC_CustStates_Degraded_disord_Event_CA "" VAL_BLK 0x8024C468 ValA_Wu8 17.0000000000 DINH_LimDFCVerb 0.00 17.0000000000 FORMAT "%13.10" MATRIX_DIM 13 /end CHARACTERISTIC
/begin CHARACTERISTIC DINH_Lim.DFC_rba_SyC_CustStates_Degraded_incst_Event_CA "" VAL_BLK 0x8024C475 ValA_Wu8 17.0000000000 DINH_LimDFCVerb 0.00 17.0000000000 FORMAT "%13.10" MATRIX_DIM 13 /end CHARACTERISTIC
/begin CHARACTERISTIC DINH_Lim.DFC_rba_SyC_CustStates_TransNoWakReq_Event_CA "" VAL_BLK 0x8024C482 ValA_Wu8 17.0000000000 DINH_LimDFCVerb 0.00 17.0000000000 FORMAT "%13.10" MATRIX_DIM 13 /end CHARACTERISTIC
/begin CHARACTERISTIC DINH_Lim.DFC_RBA_IOEXTLIB_KEEPALIVE_DRV_CA "" VAL_BLK 0x8024C48F ValA_Wu8 17.0000000000 DINH_LimDFCVerb 0.00 17.0000000000 FORMAT "%13.10" MATRIX_DIM 13 /end CHARACTERISTIC
/begin CHARACTERISTIC DINH_Lim.DFC_RBA_IOEXTLIB_KEEPALIVE_INI_CA "" VAL_BLK 0x8024C49C ValA_Wu8 17.0000000000 DINH_LimDFCVerb 0.00 17.0000000000 FORMAT "%13.10" MATRIX_DIM 13 /end CHARACTERISTIC
/begin CHARACTERISTIC DINH_Lim.DFC_rba_IoSigRtc_StopCounter_CA "" VAL_BLK 0x8024C4A9 ValA_Wu8 17.0000000000 DINH_LimDFCVerb 0.00 17.0000000000 FORMAT "%13.10" MATRIX_DIM 13 /end CHARACTERISTIC
/begin CHARACTERISTIC DINH_Lim.DFC_rba_MRly_Diag_Stk_Event_CA "" VAL_BLK 0x8024C4B6 ValA_Wu8 17.0000000000 DINH_LimDFCVerb 0.00 17.0000000000 FORMAT "%13.10" MATRIX_DIM 13 /end CHARACTERISTIC
/begin CHARACTERISTIC DINH_Lim.DFC_rba_MemDiag_MemReadErr_CA "" VAL_BLK 0x8024C4C3 ValA_Wu8 17.0000000000 DINH_LimDFCVerb 0.00 17.0000000000 FORMAT "%13.10" MATRIX_DIM 13 /end CHARACTERISTIC
/begin CHARACTERISTIC DINH_Lim.DFC_rba_MemDiag_MemWrErr_CA "" VAL_BLK 0x8024C4D0 ValA_Wu8 17.0000000000 DINH_LimDFCVerb 0.00 17.0000000000 FORMAT "%13.10" MATRIX_DIM 13 /end CHARACTERISTIC
/begin CHARACTERISTIC DINH_Lim.DFC_rba_SyC_IrrSwOffTrigEngRun_Event_CA "" VAL_BLK 0x8024C4DD ValA_Wu8 17.0000000000 DINH_LimDFCVerb 0.00 17.0000000000 FORMAT "%13.10" MATRIX_DIM 13 /end CHARACTERISTIC
/begin CHARACTERISTIC DINH_Lim.DFC_AcChrgrIntkTSRCMax_CA "" VAL_BLK 0x8024C4EA ValA_Wu8 17.0000000000 DINH_LimDFCVerb 0.00 17.0000000000 FORMAT "%13.10" MATRIX_DIM 17 /end CHARACTERISTIC
/begin CHARACTERISTIC DINH_Lim.DFC_AcChrgrIntkTTmpErr_CA "" VAL_BLK 0x8024C4FB ValA_Wu8 17.0000000000 DINH_LimDFCVerb 0.00 17.0000000000 FORMAT "%13.10" MATRIX_DIM 13 /end CHARACTERISTIC
/begin CHARACTERISTIC DINH_Lim.DFC_AcFlt_CA "" VAL_BLK 0x8024C508 ValA_Wu8 17.0000000000 DINH_LimDFCVerb 0.00 17.0000000000 FORMAT "%13.10" MATRIX_DIM 14 /end CHARACTERISTIC
/begin CHARACTERISTIC DINH_Lim.DFC_AppAllSnsrDfct_CA "" VAL_BLK 0x8024C516 ValA_Wu8 17.0000000000 DINH_LimDFCVerb 0.00 17.0000000000 FORMAT "%13.10" MATRIX_DIM 18 /end CHARACTERISTIC
/begin CHARACTERISTIC DINH_Lim.DFC_BattUPwrFail_CA "" VAL_BLK 0x8024C528 ValA_Wu8 17.0000000000 DINH_LimDFCVerb 0.00 17.0000000000 FORMAT "%13.10" MATRIX_DIM 13 /end CHARACTERISTIC
/begin CHARACTERISTIC DINH_Lim.DFC_BrkBstBkupOvrn_CA "" VAL_BLK 0x8024C535 ValA_Wu8 17.0000000000 DINH_LimDFCVerb 0.00 17.0000000000 FORMAT "%13.10" MATRIX_DIM 13 /end CHARACTERISTIC
/begin CHARACTERISTIC DINH_Lim.DFC_BrkBstPmpOvld_CA "" VAL_BLK 0x8024C542 ValA_Wu8 17.0000000000 DINH_LimDFCVerb 0.00 17.0000000000 FORMAT "%13.10" MATRIX_DIM 15 /end CHARACTERISTIC
/begin CHARACTERISTIC DINH_Lim.DFC_BrkPlausChk_CA "" VAL_BLK 0x8024C551 ValA_Wu8 17.0000000000 DINH_LimDFCVerb 0.00 17.0000000000 FORMAT "%13.10" MATRIX_DIM 19 /end CHARACTERISTIC
/begin CHARACTERISTIC DINH_Lim.DFC_CbnHeatgSwtTmpErr_CA "" VAL_BLK 0x8024C564 ValA_Wu8 17.0000000000 DINH_LimDFCVerb 0.00 17.0000000000 FORMAT "%13.10" MATRIX_DIM 13 /end CHARACTERISTIC
/begin CHARACTERISTIC DINH_Lim.DFC_CcsPwrLineChpVccSRCMax_CA "" VAL_BLK 0x8024C571 ValA_Wu8 17.0000000000 DINH_LimDFCVerb 0.00 17.0000000000 FORMAT "%13.10" MATRIX_DIM 17 /end CHARACTERISTIC
/begin CHARACTERISTIC DINH_Lim.DFC_CcsPwrLineChpVccTmpErr_CA "" VAL_BLK 0x8024C582 ValA_Wu8 17.0000000000 DINH_LimDFCVerb 0.00 17.0000000000 FORMAT "%13.10" MATRIX_DIM 13 /end CHARACTERISTIC
/begin CHARACTERISTIC DINH_Lim.DFC_CcsPwrLineComChpTSRCMax_CA "" VAL_BLK 0x8024C58F ValA_Wu8 17.0000000000 DINH_LimDFCVerb 0.00 17.0000000000 FORMAT "%13.10" MATRIX_DIM 18 /end CHARACTERISTIC
/begin CHARACTERISTIC DINH_Lim.DFC_CcsPwrLineComChpTTmpErr_CA "" VAL_BLK 0x8024C5A1 ValA_Wu8 17.0000000000 DINH_LimDFCVerb 0.00 17.0000000000 FORMAT "%13.10" MATRIX_DIM 14 /end CHARACTERISTIC
/begin CHARACTERISTIC DINH_Lim.DFC_ChgrPlugCtpCarrFrqErr_CA "" VAL_BLK 0x8024C5AF ValA_Wu8 17.0000000000 DINH_LimDFCVerb 0.00 17.0000000000 FORMAT "%13.10" MATRIX_DIM 13 /end CHARACTERISTIC
/begin CHARACTERISTIC DINH_Lim.DFC_ChgrPlugCtpSwtStuckClsd_CA "" VAL_BLK 0x8024C5BC ValA_Wu8 17.0000000000 DINH_LimDFCVerb 0.00 17.0000000000 FORMAT "%13.10" MATRIX_DIM 13 /end CHARACTERISTIC
/begin CHARACTERISTIC DINH_Lim.DFC_ChgrPlugCtpSwtStuckOpen_CA "" VAL_BLK 0x8024C5C9 ValA_Wu8 17.0000000000 DINH_LimDFCVerb 0.00 17.0000000000 FORMAT "%13.10" MATRIX_DIM 13 /end CHARACTERISTIC
/begin CHARACTERISTIC DINH_Lim.DFC_ChgrPlugCtpUErrHi_CA "" VAL_BLK 0x8024C5D6 ValA_Wu8 17.0000000000 DINH_LimDFCVerb 0.00 17.0000000000 FORMAT "%13.10" MATRIX_DIM 13 /end CHARACTERISTIC
/begin CHARACTERISTIC DINH_Lim.DFC_ChgrPlugPxp1SrcErr_CA "" VAL_BLK 0x8024C5E3 ValA_Wu8 17.0000000000 DINH_LimDFCVerb 0.00 17.0000000000 FORMAT "%13.10" MATRIX_DIM 13 /end CHARACTERISTIC
/begin CHARACTERISTIC DINH_Lim.DFC_ChrgCntctAllWldd_CA "" VAL_BLK 0x8024C5F0 ValA_Wu8 17.0000000000 DINH_LimDFCVerb 0.00 17.0000000000 FORMAT "%13.10" MATRIX_DIM 16 /end CHARACTERISTIC
/begin CHARACTERISTIC DINH_Lim.DFC_ChrgCntctNegOperErr_CA "" VAL_BLK 0x8024C600 ValA_Wu8 17.0000000000 DINH_LimDFCVerb 0.00 17.0000000000 FORMAT "%13.10" MATRIX_DIM 13 /end CHARACTERISTIC
/begin CHARACTERISTIC DINH_Lim.DFC_ChrgCntctNegOperWarn_CA "" VAL_BLK 0x8024C60D ValA_Wu8 17.0000000000 DINH_LimDFCVerb 0.00 17.0000000000 FORMAT "%13.10" MATRIX_DIM 13 /end CHARACTERISTIC
/begin CHARACTERISTIC DINH_Lim.DFC_ChrgCntctNegWldd_CA "" VAL_BLK 0x8024C61A ValA_Wu8 17.0000000000 DINH_LimDFCVerb 0.00 17.0000000000 FORMAT "%13.10" MATRIX_DIM 16 /end CHARACTERISTIC
/begin CHARACTERISTIC DINH_Lim.DFC_ChrgCntctPosOperErr_CA "" VAL_BLK 0x8024C62A ValA_Wu8 17.0000000000 DINH_LimDFCVerb 0.00 17.0000000000 FORMAT "%13.10" MATRIX_DIM 13 /end CHARACTERISTIC
/begin CHARACTERISTIC DINH_Lim.DFC_ChrgCntctPosOperWarn_CA "" VAL_BLK 0x8024C637 ValA_Wu8 17.0000000000 DINH_LimDFCVerb 0.00 17.0000000000 FORMAT "%13.10" MATRIX_DIM 13 /end CHARACTERISTIC
/begin CHARACTERISTIC DINH_Lim.DFC_ChrgCntctPosWldd_CA "" VAL_BLK 0x8024C644 ValA_Wu8 17.0000000000 DINH_LimDFCVerb 0.00 17.0000000000 FORMAT "%13.10" MATRIX_DIM 16 /end CHARACTERISTIC
/begin CHARACTERISTIC DINH_Lim.DFC_ChrgCntctStuckOpen_CA "" VAL_BLK 0x8024C654 ValA_Wu8 17.0000000000 DINH_LimDFCVerb 0.00 17.0000000000 FORMAT "%13.10" MATRIX_DIM 14 /end CHARACTERISTIC
/begin CHARACTERISTIC DINH_Lim.DFC_ChrgPlgIntlckFaild_CA "" VAL_BLK 0x8024C662 ValA_Wu8 17.0000000000 DINH_LimDFCVerb 0.00 17.0000000000 FORMAT "%13.10" MATRIX_DIM 13 /end CHARACTERISTIC
/begin CHARACTERISTIC DINH_Lim.DFC_ChrgnUnplRqrd_CA "" VAL_BLK 0x8024C66F ValA_Wu8 17.0000000000 DINH_LimDFCVerb 0.00 17.0000000000 FORMAT "%13.10" MATRIX_DIM 13 /end CHARACTERISTIC
/begin CHARACTERISTIC DINH_Lim.DFC_CoElMOffsCalibActv01_CA "" VAL_BLK 0x8024C67C ValA_Wu8 17.0000000000 DINH_LimDFCVerb 0.00 17.0000000000 FORMAT "%13.10" MATRIX_DIM 13 /end CHARACTERISTIC
/begin CHARACTERISTIC DINH_Lim.DFC_CtPSwtDiagSRCMax_CA "" VAL_BLK 0x8024C689 ValA_Wu8 17.0000000000 DINH_LimDFCVerb 0.00 17.0000000000 FORMAT "%13.10" MATRIX_DIM 17 /end CHARACTERISTIC
/begin CHARACTERISTIC DINH_Lim.DFC_CtPSwtDiagTmpErr_CA "" VAL_BLK 0x8024C69A ValA_Wu8 17.0000000000 DINH_LimDFCVerb 0.00 17.0000000000 FORMAT "%13.10" MATRIX_DIM 13 /end CHARACTERISTIC
/begin CHARACTERISTIC DINH_Lim.DFC_CtpCarrFrqTmpErr_CA "" VAL_BLK 0x8024C6A7 ValA_Wu8 17.0000000000 DINH_LimDFCVerb 0.00 17.0000000000 FORMAT "%13.10" MATRIX_DIM 13 /end CHARACTERISTIC
/begin CHARACTERISTIC DINH_Lim.DFC_DcChrgrIntkT2SRCMax_CA "" VAL_BLK 0x8024C6B4 ValA_Wu8 17.0000000000 DINH_LimDFCVerb 0.00 17.0000000000 FORMAT "%13.10" MATRIX_DIM 18 /end CHARACTERISTIC
/begin CHARACTERISTIC DINH_Lim.DFC_DcChrgrIntkT2TmpErr_CA "" VAL_BLK 0x8024C6C6 ValA_Wu8 17.0000000000 DINH_LimDFCVerb 0.00 17.0000000000 FORMAT "%13.10" MATRIX_DIM 13 /end CHARACTERISTIC
/begin CHARACTERISTIC DINH_Lim.DFC_DcChrgrIntkTSRCMax_CA "" VAL_BLK 0x8024C6D3 ValA_Wu8 17.0000000000 DINH_LimDFCVerb 0.00 17.0000000000 FORMAT "%13.10" MATRIX_DIM 18 /end CHARACTERISTIC
/begin CHARACTERISTIC DINH_Lim.DFC_DcChrgrIntkTTmpErr_CA "" VAL_BLK 0x8024C6E5 ValA_Wu8 17.0000000000 DINH_LimDFCVerb 0.00 17.0000000000 FORMAT "%13.10" MATRIX_DIM 13 /end CHARACTERISTIC
/begin CHARACTERISTIC DINH_Lim.DFC_EChrDvPlinCntrThdExcdd_CA "" VAL_BLK 0x8024C6F2 ValA_Wu8 17.0000000000 DINH_LimDFCVerb 0.00 17.0000000000 FORMAT "%13.10" MATRIX_DIM 13 /end CHARACTERISTIC
/begin CHARACTERISTIC DINH_Lim.DFC_EemDiagCtctrClsTout_CA "" VAL_BLK 0x8024C6FF ValA_Wu8 17.0000000000 DINH_LimDFCVerb 0.00 17.0000000000 FORMAT "%13.10" MATRIX_DIM 13 /end CHARACTERISTIC
/begin CHARACTERISTIC DINH_Lim.DFC_EemDiagDcdcOffTOut_CA "" VAL_BLK 0x8024C70C ValA_Wu8 17.0000000000 DINH_LimDFCVerb 0.00 17.0000000000 FORMAT "%13.10" MATRIX_DIM 14 /end CHARACTERISTIC
/begin CHARACTERISTIC DINH_Lim.DFC_EemDiagHvCnsrOffTOut_CA "" VAL_BLK 0x8024C71A ValA_Wu8 17.0000000000 DINH_LimDFCVerb 0.00 17.0000000000 FORMAT "%13.10" MATRIX_DIM 14 /end CHARACTERISTIC
/begin CHARACTERISTIC DINH_Lim.DFC_EemDiagHvbOffTOut_CA "" VAL_BLK 0x8024C728 ValA_Wu8 17.0000000000 DINH_LimDFCVerb 0.00 17.0000000000 FORMAT "%13.10" MATRIX_DIM 15 /end CHARACTERISTIC
/begin CHARACTERISTIC DINH_Lim.DFC_FanSpdSRCMax_CA "" VAL_BLK 0x8024C737 ValA_Wu8 17.0000000000 DINH_LimDFCVerb 0.00 17.0000000000 FORMAT "%13.10" MATRIX_DIM 17 /end CHARACTERISTIC
/begin CHARACTERISTIC DINH_Lim.DFC_FanSpdTmpErr_CA "" VAL_BLK 0x8024C748 ValA_Wu8 17.0000000000 DINH_LimDFCVerb 0.00 17.0000000000 FORMAT "%13.10" MATRIX_DIM 13 /end CHARACTERISTIC
/begin CHARACTERISTIC DINH_Lim.DFC_FreonPSRCMax_CA "" VAL_BLK 0x8024C755 ValA_Wu8 17.0000000000 DINH_LimDFCVerb 0.00 17.0000000000 FORMAT "%13.10" MATRIX_DIM 19 /end CHARACTERISTIC
/begin CHARACTERISTIC DINH_Lim.DFC_FreonPTmpErr_CA "" VAL_BLK 0x8024C768 ValA_Wu8 17.0000000000 DINH_LimDFCVerb 0.00 17.0000000000 FORMAT "%13.10" MATRIX_DIM 15 /end CHARACTERISTIC
/begin CHARACTERISTIC DINH_Lim.DFC_HeatrCoreTSRCMax_CA "" VAL_BLK 0x8024C777 ValA_Wu8 17.0000000000 DINH_LimDFCVerb 0.00 17.0000000000 FORMAT "%13.10" MATRIX_DIM 17 /end CHARACTERISTIC
/begin CHARACTERISTIC DINH_Lim.DFC_HeatrCoreTTmpErr_CA "" VAL_BLK 0x8024C788 ValA_Wu8 17.0000000000 DINH_LimDFCVerb 0.00 17.0000000000 FORMAT "%13.10" MATRIX_DIM 13 /end CHARACTERISTIC
/begin CHARACTERISTIC DINH_Lim.DFC_HvGridSocMinLim_CA "" VAL_BLK 0x8024C795 ValA_Wu8 17.0000000000 DINH_LimDFCVerb 0.00 17.0000000000 FORMAT "%13.10" MATRIX_DIM 14 /end CHARACTERISTIC
/begin CHARACTERISTIC DINH_Lim.DFC_HvacBlwrFrntFlt_CA "" VAL_BLK 0x8024C7A3 ValA_Wu8 17.0000000000 DINH_LimDFCVerb 0.00 17.0000000000 FORMAT "%13.10" MATRIX_DIM 14 /end CHARACTERISTIC
/begin CHARACTERISTIC DINH_Lim.DFC_HvacEvapElecFlt_CA "" VAL_BLK 0x8024C7B1 ValA_Wu8 17.0000000000 DINH_LimDFCVerb 0.00 17.0000000000 FORMAT "%13.10" MATRIX_DIM 14 /end CHARACTERISTIC
/begin CHARACTERISTIC DINH_Lim.DFC_HvacEvapElecFltGnd_CA "" VAL_BLK 0x8024C7BF ValA_Wu8 17.0000000000 DINH_LimDFCVerb 0.00 17.0000000000 FORMAT "%13.10" MATRIX_DIM 14 /end CHARACTERISTIC
/begin CHARACTERISTIC DINH_Lim.DFC_HvacKnobPosnFlt_CA "" VAL_BLK 0x8024C7CD ValA_Wu8 17.0000000000 DINH_LimDFCVerb 0.00 17.0000000000 FORMAT "%13.10" MATRIX_DIM 14 /end CHARACTERISTIC
/begin CHARACTERISTIC DINH_Lim.DFC_InvBinID_CA "" VAL_BLK 0x8024C7DB ValA_Wu8 17.0000000000 DINH_LimDFCVerb 0.00 17.0000000000 FORMAT "%13.10" MATRIX_DIM 13 /end CHARACTERISTIC
/begin CHARACTERISTIC DINH_Lim.DFC_InvCalID_CA "" VAL_BLK 0x8024C7E8 ValA_Wu8 17.0000000000 DINH_LimDFCVerb 0.00 17.0000000000 FORMAT "%13.10" MATRIX_DIM 13 /end CHARACTERISTIC
/begin CHARACTERISTIC DINH_Lim.DFC_InvErotan_CA "" VAL_BLK 0x8024C7F5 ValA_Wu8 17.0000000000 DINH_LimDFCVerb 0.00 17.0000000000 FORMAT "%13.10" MATRIX_DIM 13 /end CHARACTERISTIC
/begin CHARACTERISTIC DINH_Lim.DFC_InvVinID_CA "" VAL_BLK 0x8024C802 ValA_Wu8 17.0000000000 DINH_LimDFCVerb 0.00 17.0000000000 FORMAT "%13.10" MATRIX_DIM 13 /end CHARACTERISTIC
/begin CHARACTERISTIC DINH_Lim.DFC_MOXEMM_SMU_ALM0_0_CA "" VAL_BLK 0x8024C80F ValA_Wu8 17.0000000000 DINH_LimDFCVerb 0.00 17.0000000000 FORMAT "%13.10" MATRIX_DIM 13 /end CHARACTERISTIC
/begin CHARACTERISTIC DINH_Lim.DFC_MOXEMM_SMU_ALM0_1_CA "" VAL_BLK 0x8024C81C ValA_Wu8 17.0000000000 DINH_LimDFCVerb 0.00 17.0000000000 FORMAT "%13.10" MATRIX_DIM 13 /end CHARACTERISTIC
/begin CHARACTERISTIC DINH_Lim.DFC_MOXEMM_SMU_ALM0_10_CA "" VAL_BLK 0x8024C829 ValA_Wu8 17.0000000000 DINH_LimDFCVerb 0.00 17.0000000000 FORMAT "%13.10" MATRIX_DIM 13 /end CHARACTERISTIC
/begin CHARACTERISTIC DINH_Lim.DFC_MOXEMM_SMU_ALM0_11_CA "" VAL_BLK 0x8024C836 ValA_Wu8 17.0000000000 DINH_LimDFCVerb 0.00 17.0000000000 FORMAT "%13.10" MATRIX_DIM 13 /end CHARACTERISTIC
/begin CHARACTERISTIC DINH_Lim.DFC_MOXEMM_SMU_ALM0_13_CA "" VAL_BLK 0x8024C843 ValA_Wu8 17.0000000000 DINH_LimDFCVerb 0.00 17.0000000000 FORMAT "%13.10" MATRIX_DIM 13 /end CHARACTERISTIC
/begin CHARACTERISTIC DINH_Lim.DFC_MOXEMM_SMU_ALM0_14_CA "" VAL_BLK 0x8024C850 ValA_Wu8 17.0000000000 DINH_LimDFCVerb 0.00 17.0000000000 FORMAT "%13.10" MATRIX_DIM 13 /end CHARACTERISTIC
/begin CHARACTERISTIC DINH_Lim.DFC_MOXEMM_SMU_ALM0_2_CA "" VAL_BLK 0x8024C85D ValA_Wu8 17.0000000000 DINH_LimDFCVerb 0.00 17.0000000000 FORMAT "%13.10" MATRIX_DIM 13 /end CHARACTERISTIC
/begin CHARACTERISTIC DINH_Lim.DFC_MOXEMM_SMU_ALM0_22_CA "" VAL_BLK 0x8024C86A ValA_Wu8 17.0000000000 DINH_LimDFCVerb 0.00 17.0000000000 FORMAT "%13.10" MATRIX_DIM 13 /end CHARACTERISTIC
/begin CHARACTERISTIC DINH_Lim.DFC_MOXEMM_SMU_ALM0_23_CA "" VAL_BLK 0x8024C877 ValA_Wu8 17.0000000000 DINH_LimDFCVerb 0.00 17.0000000000 FORMAT "%13.10" MATRIX_DIM 13 /end CHARACTERISTIC
/begin CHARACTERISTIC DINH_Lim.DFC_MOXEMM_SMU_ALM0_4_CA "" VAL_BLK 0x8024C884 ValA_Wu8 17.0000000000 DINH_LimDFCVerb 0.00 17.0000000000 FORMAT "%13.10" MATRIX_DIM 13 /end CHARACTERISTIC
/begin CHARACTERISTIC DINH_Lim.DFC_MOXEMM_SMU_ALM0_5_CA "" VAL_BLK 0x8024C891 ValA_Wu8 17.0000000000 DINH_LimDFCVerb 0.00 17.0000000000 FORMAT "%13.10" MATRIX_DIM 13 /end CHARACTERISTIC
/begin CHARACTERISTIC DINH_Lim.DFC_MOXEMM_SMU_ALM0_7_CA "" VAL_BLK 0x8024C89E ValA_Wu8 17.0000000000 DINH_LimDFCVerb 0.00 17.0000000000 FORMAT "%13.10" MATRIX_DIM 13 /end CHARACTERISTIC
/begin CHARACTERISTIC DINH_Lim.DFC_MOXEMM_SMU_ALM0_8_CA "" VAL_BLK 0x8024C8AB ValA_Wu8 17.0000000000 DINH_LimDFCVerb 0.00 17.0000000000 FORMAT "%13.10" MATRIX_DIM 13 /end CHARACTERISTIC
/begin CHARACTERISTIC DINH_Lim.DFC_MOXEMM_SMU_ALM10_16_CA "" VAL_BLK 0x8024C8B8 ValA_Wu8 17.0000000000 DINH_LimDFCVerb 0.00 17.0000000000 FORMAT "%13.10" MATRIX_DIM 13 /end CHARACTERISTIC
/begin CHARACTERISTIC DINH_Lim.DFC_MOXEMM_SMU_ALM10_17_CA "" VAL_BLK 0x8024C8C5 ValA_Wu8 17.0000000000 DINH_LimDFCVerb 0.00 17.0000000000 FORMAT "%13.10" MATRIX_DIM 13 /end CHARACTERISTIC
/begin CHARACTERISTIC DINH_Lim.DFC_MOXEMM_SMU_ALM10_21_CA "" VAL_BLK 0x8024C8D2 ValA_Wu8 17.0000000000 DINH_LimDFCVerb 0.00 17.0000000000 FORMAT "%13.10" MATRIX_DIM 13 /end CHARACTERISTIC
/begin CHARACTERISTIC DINH_Lim.DFC_MOXEMM_SMU_ALM11_0_CA "" VAL_BLK 0x8024C8DF ValA_Wu8 17.0000000000 DINH_LimDFCVerb 0.00 17.0000000000 FORMAT "%13.10" MATRIX_DIM 13 /end CHARACTERISTIC
/begin CHARACTERISTIC DINH_Lim.DFC_MOXEMM_SMU_ALM11_1_CA "" VAL_BLK 0x8024C8EC ValA_Wu8 17.0000000000 DINH_LimDFCVerb 0.00 17.0000000000 FORMAT "%13.10" MATRIX_DIM 13 /end CHARACTERISTIC
/begin CHARACTERISTIC DINH_Lim.DFC_MOXEMM_SMU_ALM11_2_CA "" VAL_BLK 0x8024C8F9 ValA_Wu8 17.0000000000 DINH_LimDFCVerb 0.00 17.0000000000 FORMAT "%13.10" MATRIX_DIM 13 /end CHARACTERISTIC
/begin CHARACTERISTIC DINH_Lim.DFC_MOXEMM_SMU_ALM11_3_CA "" VAL_BLK 0x8024C906 ValA_Wu8 17.0000000000 DINH_LimDFCVerb 0.00 17.0000000000 FORMAT "%13.10" MATRIX_DIM 13 /end CHARACTERISTIC
/begin CHARACTERISTIC DINH_Lim.DFC_MOXEMM_SMU_ALM11_4_CA "" VAL_BLK 0x8024C913 ValA_Wu8 17.0000000000 DINH_LimDFCVerb 0.00 17.0000000000 FORMAT "%13.10" MATRIX_DIM 13 /end CHARACTERISTIC
/begin CHARACTERISTIC DINH_Lim.DFC_MOXEMM_SMU_ALM11_5_CA "" VAL_BLK 0x8024C920 ValA_Wu8 17.0000000000 DINH_LimDFCVerb 0.00 17.0000000000 FORMAT "%13.10" MATRIX_DIM 13 /end CHARACTERISTIC
/begin CHARACTERISTIC DINH_Lim.DFC_MOXEMM_SMU_ALM11_8_CA "" VAL_BLK 0x8024C92D ValA_Wu8 17.0000000000 DINH_LimDFCVerb 0.00 17.0000000000 FORMAT "%13.10" MATRIX_DIM 13 /end CHARACTERISTIC
/begin CHARACTERISTIC DINH_Lim.DFC_MOXEMM_SMU_ALM11_9_CA "" VAL_BLK 0x8024C93A ValA_Wu8 17.0000000000 DINH_LimDFCVerb 0.00 17.0000000000 FORMAT "%13.10" MATRIX_DIM 13 /end CHARACTERISTIC
/begin CHARACTERISTIC DINH_Lim.DFC_MOXEMM_SMU_ALM1_0_CA "" VAL_BLK 0x8024C947 ValA_Wu8 17.0000000000 DINH_LimDFCVerb 0.00 17.0000000000 FORMAT "%13.10" MATRIX_DIM 13 /end CHARACTERISTIC
/begin CHARACTERISTIC DINH_Lim.DFC_MOXEMM_SMU_ALM1_1_CA "" VAL_BLK 0x8024C954 ValA_Wu8 17.0000000000 DINH_LimDFCVerb 0.00 17.0000000000 FORMAT "%13.10" MATRIX_DIM 13 /end CHARACTERISTIC
/begin CHARACTERISTIC DINH_Lim.DFC_MOXEMM_SMU_ALM1_10_CA "" VAL_BLK 0x8024C961 ValA_Wu8 17.0000000000 DINH_LimDFCVerb 0.00 17.0000000000 FORMAT "%13.10" MATRIX_DIM 13 /end CHARACTERISTIC
/begin CHARACTERISTIC DINH_Lim.DFC_MOXEMM_SMU_ALM1_11_CA "" VAL_BLK 0x8024C96E ValA_Wu8 17.0000000000 DINH_LimDFCVerb 0.00 17.0000000000 FORMAT "%13.10" MATRIX_DIM 13 /end CHARACTERISTIC
/begin CHARACTERISTIC DINH_Lim.DFC_MOXEMM_SMU_ALM1_13_CA "" VAL_BLK 0x8024C97B ValA_Wu8 17.0000000000 DINH_LimDFCVerb 0.00 17.0000000000 FORMAT "%13.10" MATRIX_DIM 13 /end CHARACTERISTIC
/begin CHARACTERISTIC DINH_Lim.DFC_MOXEMM_SMU_ALM1_14_CA "" VAL_BLK 0x8024C988 ValA_Wu8 17.0000000000 DINH_LimDFCVerb 0.00 17.0000000000 FORMAT "%13.10" MATRIX_DIM 13 /end CHARACTERISTIC
/begin CHARACTERISTIC DINH_Lim.DFC_MOXEMM_SMU_ALM1_2_CA "" VAL_BLK 0x8024C995 ValA_Wu8 17.0000000000 DINH_LimDFCVerb 0.00 17.0000000000 FORMAT "%13.10" MATRIX_DIM 13 /end CHARACTERISTIC
/begin CHARACTERISTIC DINH_Lim.DFC_MOXEMM_SMU_ALM1_22_CA "" VAL_BLK 0x8024C9A2 ValA_Wu8 17.0000000000 DINH_LimDFCVerb 0.00 17.0000000000 FORMAT "%13.10" MATRIX_DIM 13 /end CHARACTERISTIC
/begin CHARACTERISTIC DINH_Lim.DFC_MOXEMM_SMU_ALM1_23_CA "" VAL_BLK 0x8024C9AF ValA_Wu8 17.0000000000 DINH_LimDFCVerb 0.00 17.0000000000 FORMAT "%13.10" MATRIX_DIM 13 /end CHARACTERISTIC
/begin CHARACTERISTIC DINH_Lim.DFC_MOXEMM_SMU_ALM1_4_CA "" VAL_BLK 0x8024C9BC ValA_Wu8 17.0000000000 DINH_LimDFCVerb 0.00 17.0000000000 FORMAT "%13.10" MATRIX_DIM 13 /end CHARACTERISTIC
/begin CHARACTERISTIC DINH_Lim.DFC_MOXEMM_SMU_ALM1_5_CA "" VAL_BLK 0x8024C9C9 ValA_Wu8 17.0000000000 DINH_LimDFCVerb 0.00 17.0000000000 FORMAT "%13.10" MATRIX_DIM 13 /end CHARACTERISTIC
/begin CHARACTERISTIC DINH_Lim.DFC_MOXEMM_SMU_ALM1_7_CA "" VAL_BLK 0x8024C9D6 ValA_Wu8 17.0000000000 DINH_LimDFCVerb 0.00 17.0000000000 FORMAT "%13.10" MATRIX_DIM 13 /end CHARACTERISTIC
/begin CHARACTERISTIC DINH_Lim.DFC_MOXEMM_SMU_ALM1_8_CA "" VAL_BLK 0x8024C9E3 ValA_Wu8 17.0000000000 DINH_LimDFCVerb 0.00 17.0000000000 FORMAT "%13.10" MATRIX_DIM 13 /end CHARACTERISTIC
/begin CHARACTERISTIC DINH_Lim.DFC_MOXEMM_SMU_ALM21_0_CA "" VAL_BLK 0x8024C9F0 ValA_Wu8 17.0000000000 DINH_LimDFCVerb 0.00 17.0000000000 FORMAT "%13.10" MATRIX_DIM 13 /end CHARACTERISTIC
/begin CHARACTERISTIC DINH_Lim.DFC_MOXEMM_SMU_ALM21_16_CA "" VAL_BLK 0x8024C9FD ValA_Wu8 17.0000000000 DINH_LimDFCVerb 0.00 17.0000000000 FORMAT "%13.10" MATRIX_DIM 13 /end CHARACTERISTIC
/begin CHARACTERISTIC DINH_Lim.DFC_MOXEMM_SMU_ALM21_3_CA "" VAL_BLK 0x8024CA0A ValA_Wu8 17.0000000000 DINH_LimDFCVerb 0.00 17.0000000000 FORMAT "%13.10" MATRIX_DIM 13 /end CHARACTERISTIC
/begin CHARACTERISTIC DINH_Lim.DFC_MOXEMM_SMU_ALM2_1_CA "" VAL_BLK 0x8024CA17 ValA_Wu8 17.0000000000 DINH_LimDFCVerb 0.00 17.0000000000 FORMAT "%13.10" MATRIX_DIM 13 /end CHARACTERISTIC
/begin CHARACTERISTIC DINH_Lim.DFC_MOXEMM_SMU_ALM2_10_CA "" VAL_BLK 0x8024CA24 ValA_Wu8 17.0000000000 DINH_LimDFCVerb 0.00 17.0000000000 FORMAT "%13.10" MATRIX_DIM 13 /end CHARACTERISTIC
/begin CHARACTERISTIC DINH_Lim.DFC_MOXEMM_SMU_ALM2_11_CA "" VAL_BLK 0x8024CA31 ValA_Wu8 17.0000000000 DINH_LimDFCVerb 0.00 17.0000000000 FORMAT "%13.10" MATRIX_DIM 13 /end CHARACTERISTIC
/begin CHARACTERISTIC DINH_Lim.DFC_MOXEMM_SMU_ALM2_13_CA "" VAL_BLK 0x8024CA3E ValA_Wu8 17.0000000000 DINH_LimDFCVerb 0.00 17.0000000000 FORMAT "%13.10" MATRIX_DIM 13 /end CHARACTERISTIC
/begin CHARACTERISTIC DINH_Lim.DFC_MOXEMM_SMU_ALM2_14_CA "" VAL_BLK 0x8024CA4B ValA_Wu8 17.0000000000 DINH_LimDFCVerb 0.00 17.0000000000 FORMAT "%13.10" MATRIX_DIM 13 /end CHARACTERISTIC
/begin CHARACTERISTIC DINH_Lim.DFC_MOXEMM_SMU_ALM2_22_CA "" VAL_BLK 0x8024CA58 ValA_Wu8 17.0000000000 DINH_LimDFCVerb 0.00 17.0000000000 FORMAT "%13.10" MATRIX_DIM 13 /end CHARACTERISTIC
/begin CHARACTERISTIC DINH_Lim.DFC_MOXEMM_SMU_ALM2_23_CA "" VAL_BLK 0x8024CA65 ValA_Wu8 17.0000000000 DINH_LimDFCVerb 0.00 17.0000000000 FORMAT "%13.10" MATRIX_DIM 13 /end CHARACTERISTIC
/begin CHARACTERISTIC DINH_Lim.DFC_MOXEMM_SMU_ALM2_4_CA "" VAL_BLK 0x8024CA72 ValA_Wu8 17.0000000000 DINH_LimDFCVerb 0.00 17.0000000000 FORMAT "%13.10" MATRIX_DIM 13 /end CHARACTERISTIC
/begin CHARACTERISTIC DINH_Lim.DFC_MOXEMM_SMU_ALM2_5_CA "" VAL_BLK 0x8024CA7F ValA_Wu8 17.0000000000 DINH_LimDFCVerb 0.00 17.0000000000 FORMAT "%13.10" MATRIX_DIM 13 /end CHARACTERISTIC
/begin CHARACTERISTIC DINH_Lim.DFC_MOXEMM_SMU_ALM2_7_CA "" VAL_BLK 0x8024CA8C ValA_Wu8 17.0000000000 DINH_LimDFCVerb 0.00 17.0000000000 FORMAT "%13.10" MATRIX_DIM 13 /end CHARACTERISTIC
/begin CHARACTERISTIC DINH_Lim.DFC_MOXEMM_SMU_ALM2_8_CA "" VAL_BLK 0x8024CA99 ValA_Wu8 17.0000000000 DINH_LimDFCVerb 0.00 17.0000000000 FORMAT "%13.10" MATRIX_DIM 13 /end CHARACTERISTIC
/begin CHARACTERISTIC DINH_Lim.DFC_MOXEMM_SMU_ALM6_0_CA "" VAL_BLK 0x8024CAA6 ValA_Wu8 17.0000000000 DINH_LimDFCVerb 0.00 17.0000000000 FORMAT "%13.10" MATRIX_DIM 13 /end CHARACTERISTIC
/begin CHARACTERISTIC DINH_Lim.DFC_MOXEMM_SMU_ALM6_11_CA "" VAL_BLK 0x8024CAB3 ValA_Wu8 17.0000000000 DINH_LimDFCVerb 0.00 17.0000000000 FORMAT "%13.10" MATRIX_DIM 13 /end CHARACTERISTIC
/begin CHARACTERISTIC DINH_Lim.DFC_MOXEMM_SMU_ALM6_12_CA "" VAL_BLK 0x8024CAC0 ValA_Wu8 17.0000000000 DINH_LimDFCVerb 0.00 17.0000000000 FORMAT "%13.10" MATRIX_DIM 13 /end CHARACTERISTIC
/begin CHARACTERISTIC DINH_Lim.DFC_MOXEMM_SMU_ALM6_14_CA "" VAL_BLK 0x8024CACD ValA_Wu8 17.0000000000 DINH_LimDFCVerb 0.00 17.0000000000 FORMAT "%13.10" MATRIX_DIM 13 /end CHARACTERISTIC
/begin CHARACTERISTIC DINH_Lim.DFC_MOXEMM_SMU_ALM6_15_CA "" VAL_BLK 0x8024CADA ValA_Wu8 17.0000000000 DINH_LimDFCVerb 0.00 17.0000000000 FORMAT "%13.10" MATRIX_DIM 13 /end CHARACTERISTIC
/begin CHARACTERISTIC DINH_Lim.DFC_MOXEMM_SMU_ALM6_17_CA "" VAL_BLK 0x8024CAE7 ValA_Wu8 17.0000000000 DINH_LimDFCVerb 0.00 17.0000000000 FORMAT "%13.10" MATRIX_DIM 13 /end CHARACTERISTIC
/begin CHARACTERISTIC DINH_Lim.DFC_MOXEMM_SMU_ALM6_18_CA "" VAL_BLK 0x8024CAF4 ValA_Wu8 17.0000000000 DINH_LimDFCVerb 0.00 17.0000000000 FORMAT "%13.10" MATRIX_DIM 13 /end CHARACTERISTIC
/begin CHARACTERISTIC DINH_Lim.DFC_MOXEMM_SMU_ALM6_20_CA "" VAL_BLK 0x8024CB01 ValA_Wu8 17.0000000000 DINH_LimDFCVerb 0.00 17.0000000000 FORMAT "%13.10" MATRIX_DIM 13 /end CHARACTERISTIC
/begin CHARACTERISTIC DINH_Lim.DFC_MOXEMM_SMU_ALM6_21_CA "" VAL_BLK 0x8024CB0E ValA_Wu8 17.0000000000 DINH_LimDFCVerb 0.00 17.0000000000 FORMAT "%13.10" MATRIX_DIM 13 /end CHARACTERISTIC
/begin CHARACTERISTIC DINH_Lim.DFC_MOXEMM_SMU_ALM6_25_CA "" VAL_BLK 0x8024CB1B ValA_Wu8 17.0000000000 DINH_LimDFCVerb 0.00 17.0000000000 FORMAT "%13.10" MATRIX_DIM 13 /end CHARACTERISTIC
/begin CHARACTERISTIC DINH_Lim.DFC_MOXEMM_SMU_ALM6_4_CA "" VAL_BLK 0x8024CB28 ValA_Wu8 17.0000000000 DINH_LimDFCVerb 0.00 17.0000000000 FORMAT "%13.10" MATRIX_DIM 13 /end CHARACTERISTIC
/begin CHARACTERISTIC DINH_Lim.DFC_MOXEMM_SMU_ALM6_5_CA "" VAL_BLK 0x8024CB35 ValA_Wu8 17.0000000000 DINH_LimDFCVerb 0.00 17.0000000000 FORMAT "%13.10" MATRIX_DIM 13 /end CHARACTERISTIC
/begin CHARACTERISTIC DINH_Lim.DFC_MOXEMM_SMU_ALM6_7_CA "" VAL_BLK 0x8024CB42 ValA_Wu8 17.0000000000 DINH_LimDFCVerb 0.00 17.0000000000 FORMAT "%13.10" MATRIX_DIM 13 /end CHARACTERISTIC
/begin CHARACTERISTIC DINH_Lim.DFC_MOXEMM_SMU_ALM6_8_CA "" VAL_BLK 0x8024CB4F ValA_Wu8 17.0000000000 DINH_LimDFCVerb 0.00 17.0000000000 FORMAT "%13.10" MATRIX_DIM 13 /end CHARACTERISTIC
/begin CHARACTERISTIC DINH_Lim.DFC_MOXEMM_SMU_ALM7_1_CA "" VAL_BLK 0x8024CB5C ValA_Wu8 17.0000000000 DINH_LimDFCVerb 0.00 17.0000000000 FORMAT "%13.10" MATRIX_DIM 13 /end CHARACTERISTIC
/begin CHARACTERISTIC DINH_Lim.DFC_MOXEMM_SMU_ALM7_12_CA "" VAL_BLK 0x8024CB69 ValA_Wu8 17.0000000000 DINH_LimDFCVerb 0.00 17.0000000000 FORMAT "%13.10" MATRIX_DIM 13 /end CHARACTERISTIC
/begin CHARACTERISTIC DINH_Lim.DFC_MOXEMM_SMU_ALM7_13_CA "" VAL_BLK 0x8024CB76 ValA_Wu8 17.0000000000 DINH_LimDFCVerb 0.00 17.0000000000 FORMAT "%13.10" MATRIX_DIM 13 /end CHARACTERISTIC
/begin CHARACTERISTIC DINH_Lim.DFC_MOXEMM_SMU_ALM7_14_CA "" VAL_BLK 0x8024CB83 ValA_Wu8 17.0000000000 DINH_LimDFCVerb 0.00 17.0000000000 FORMAT "%13.10" MATRIX_DIM 13 /end CHARACTERISTIC
/begin CHARACTERISTIC DINH_Lim.DFC_MOXEMM_SMU_ALM7_15_CA "" VAL_BLK 0x8024CB90 ValA_Wu8 17.0000000000 DINH_LimDFCVerb 0.00 17.0000000000 FORMAT "%13.10" MATRIX_DIM 13 /end CHARACTERISTIC
/begin CHARACTERISTIC DINH_Lim.DFC_MOXEMM_SMU_ALM7_16_CA "" VAL_BLK 0x8024CB9D ValA_Wu8 17.0000000000 DINH_LimDFCVerb 0.00 17.0000000000 FORMAT "%13.10" MATRIX_DIM 13 /end CHARACTERISTIC
/begin CHARACTERISTIC DINH_Lim.DFC_MOXEMM_SMU_ALM7_17_CA "" VAL_BLK 0x8024CBAA ValA_Wu8 17.0000000000 DINH_LimDFCVerb 0.00 17.0000000000 FORMAT "%13.10" MATRIX_DIM 13 /end CHARACTERISTIC
/begin CHARACTERISTIC DINH_Lim.DFC_MOXEMM_SMU_ALM7_2_CA "" VAL_BLK 0x8024CBB7 ValA_Wu8 17.0000000000 DINH_LimDFCVerb 0.00 17.0000000000 FORMAT "%13.10" MATRIX_DIM 13 /end CHARACTERISTIC
/begin CHARACTERISTIC DINH_Lim.DFC_MOXEMM_SMU_ALM7_20_CA "" VAL_BLK 0x8024CBC4 ValA_Wu8 17.0000000000 DINH_LimDFCVerb 0.00 17.0000000000 FORMAT "%13.10" MATRIX_DIM 13 /end CHARACTERISTIC
/begin CHARACTERISTIC DINH_Lim.DFC_MOXEMM_SMU_ALM7_25_CA "" VAL_BLK 0x8024CBD1 ValA_Wu8 17.0000000000 DINH_LimDFCVerb 0.00 17.0000000000 FORMAT "%13.10" MATRIX_DIM 13 /end CHARACTERISTIC
/begin CHARACTERISTIC DINH_Lim.DFC_MOXEMM_SMU_ALM7_26_CA "" VAL_BLK 0x8024CBDE ValA_Wu8 17.0000000000 DINH_LimDFCVerb 0.00 17.0000000000 FORMAT "%13.10" MATRIX_DIM 13 /end CHARACTERISTIC
/begin CHARACTERISTIC DINH_Lim.DFC_MOXEMM_SMU_ALM7_28_CA "" VAL_BLK 0x8024CBEB ValA_Wu8 17.0000000000 DINH_LimDFCVerb 0.00 17.0000000000 FORMAT "%13.10" MATRIX_DIM 13 /end CHARACTERISTIC
/begin CHARACTERISTIC DINH_Lim.DFC_MOXEMM_SMU_ALM7_29_CA "" VAL_BLK 0x8024CBF8 ValA_Wu8 17.0000000000 DINH_LimDFCVerb 0.00 17.0000000000 FORMAT "%13.10" MATRIX_DIM 13 /end CHARACTERISTIC
/begin CHARACTERISTIC DINH_Lim.DFC_MOXEMM_SMU_ALM7_30_CA "" VAL_BLK 0x8024CC05 ValA_Wu8 17.0000000000 DINH_LimDFCVerb 0.00 17.0000000000 FORMAT "%13.10" MATRIX_DIM 13 /end CHARACTERISTIC
/begin CHARACTERISTIC DINH_Lim.DFC_MOXEMM_SMU_ALM7_31_CA "" VAL_BLK 0x8024CC12 ValA_Wu8 17.0000000000 DINH_LimDFCVerb 0.00 17.0000000000 FORMAT "%13.10" MATRIX_DIM 13 /end CHARACTERISTIC
/begin CHARACTERISTIC DINH_Lim.DFC_MOXEMM_SMU_ALM8_0_CA "" VAL_BLK 0x8024CC1F ValA_Wu8 17.0000000000 DINH_LimDFCVerb 0.00 17.0000000000 FORMAT "%13.10" MATRIX_DIM 13 /end CHARACTERISTIC
/begin CHARACTERISTIC DINH_Lim.DFC_MOXEMM_SMU_ALM8_1_CA "" VAL_BLK 0x8024CC2C ValA_Wu8 17.0000000000 DINH_LimDFCVerb 0.00 17.0000000000 FORMAT "%13.10" MATRIX_DIM 13 /end CHARACTERISTIC
/begin CHARACTERISTIC DINH_Lim.DFC_MOXEMM_SMU_ALM8_10_CA "" VAL_BLK 0x8024CC39 ValA_Wu8 17.0000000000 DINH_LimDFCVerb 0.00 17.0000000000 FORMAT "%13.10" MATRIX_DIM 13 /end CHARACTERISTIC
/begin CHARACTERISTIC DINH_Lim.DFC_MOXEMM_SMU_ALM8_11_CA "" VAL_BLK 0x8024CC46 ValA_Wu8 17.0000000000 DINH_LimDFCVerb 0.00 17.0000000000 FORMAT "%13.10" MATRIX_DIM 13 /end CHARACTERISTIC
/begin CHARACTERISTIC DINH_Lim.DFC_MOXEMM_SMU_ALM8_12_CA "" VAL_BLK 0x8024CC53 ValA_Wu8 17.0000000000 DINH_LimDFCVerb 0.00 17.0000000000 FORMAT "%13.10" MATRIX_DIM 13 /end CHARACTERISTIC
/begin CHARACTERISTIC DINH_Lim.DFC_MOXEMM_SMU_ALM8_16_CA "" VAL_BLK 0x8024CC60 ValA_Wu8 17.0000000000 DINH_LimDFCVerb 0.00 17.0000000000 FORMAT "%13.10" MATRIX_DIM 13 /end CHARACTERISTIC
/begin CHARACTERISTIC DINH_Lim.DFC_MOXEMM_SMU_ALM8_18_CA "" VAL_BLK 0x8024CC6D ValA_Wu8 17.0000000000 DINH_LimDFCVerb 0.00 17.0000000000 FORMAT "%13.10" MATRIX_DIM 13 /end CHARACTERISTIC
/begin CHARACTERISTIC DINH_Lim.DFC_MOXEMM_SMU_ALM8_2_CA "" VAL_BLK 0x8024CC7A ValA_Wu8 17.0000000000 DINH_LimDFCVerb 0.00 17.0000000000 FORMAT "%13.10" MATRIX_DIM 13 /end CHARACTERISTIC
/begin CHARACTERISTIC DINH_Lim.DFC_MOXEMM_SMU_ALM8_3_CA "" VAL_BLK 0x8024CC87 ValA_Wu8 17.0000000000 DINH_LimDFCVerb 0.00 17.0000000000 FORMAT "%13.10" MATRIX_DIM 13 /end CHARACTERISTIC
/begin CHARACTERISTIC DINH_Lim.DFC_MOXEMM_SMU_ALM8_31_CA "" VAL_BLK 0x8024CC94 ValA_Wu8 17.0000000000 DINH_LimDFCVerb 0.00 17.0000000000 FORMAT "%13.10" MATRIX_DIM 13 /end CHARACTERISTIC
/begin CHARACTERISTIC DINH_Lim.DFC_MOXEMM_SMU_ALM8_4_CA "" VAL_BLK 0x8024CCA1 ValA_Wu8 17.0000000000 DINH_LimDFCVerb 0.00 17.0000000000 FORMAT "%13.10" MATRIX_DIM 13 /end CHARACTERISTIC
/begin CHARACTERISTIC DINH_Lim.DFC_MOXEMM_SMU_ALM9_0_CA "" VAL_BLK 0x8024CCAE ValA_Wu8 17.0000000000 DINH_LimDFCVerb 0.00 17.0000000000 FORMAT "%13.10" MATRIX_DIM 13 /end CHARACTERISTIC
/begin CHARACTERISTIC DINH_Lim.DFC_MOXEMM_SMU_ALM9_15_CA "" VAL_BLK 0x8024CCBB ValA_Wu8 17.0000000000 DINH_LimDFCVerb 0.00 17.0000000000 FORMAT "%13.10" MATRIX_DIM 13 /end CHARACTERISTIC
/begin CHARACTERISTIC DINH_Lim.DFC_MOXEMM_SMU_ALM9_3_CA "" VAL_BLK 0x8024CCC8 ValA_Wu8 17.0000000000 DINH_LimDFCVerb 0.00 17.0000000000 FORMAT "%13.10" MATRIX_DIM 13 /end CHARACTERISTIC
/begin CHARACTERISTIC DINH_Lim.DFC_MoCADCNTPBnk1_CA "" VAL_BLK 0x8024CCD5 ValA_Wu8 17.0000000000 DINH_LimDFCVerb 0.00 17.0000000000 FORMAT "%13.10" MATRIX_DIM 13 /end CHARACTERISTIC
/begin CHARACTERISTIC DINH_Lim.DFC_MoCADCTestVoltBnk1_CA "" VAL_BLK 0x8024CCE2 ValA_Wu8 17.0000000000 DINH_LimDFCVerb 0.00 17.0000000000 FORMAT "%13.10" MATRIX_DIM 13 /end CHARACTERISTIC
/begin CHARACTERISTIC DINH_Lim.DFC_MoCSOPICO_CA "" VAL_BLK 0x8024CCEF ValA_Wu8 17.0000000000 DINH_LimDFCVerb 0.00 17.0000000000 FORMAT "%13.10" MATRIX_DIM 13 /end CHARACTERISTIC
/begin CHARACTERISTIC DINH_Lim.DFC_MoFAccr_CA "" VAL_BLK 0x8024CCFC ValA_Wu8 17.0000000000 DINH_LimDFCVerb 0.00 17.0000000000 FORMAT "%13.10" MATRIX_DIM 13 /end CHARACTERISTIC
/begin CHARACTERISTIC DINH_Lim.DFC_MoFCbnPreCdngOvrheat_CA "" VAL_BLK 0x8024CD09 ValA_Wu8 17.0000000000 DINH_LimDFCVerb 0.00 17.0000000000 FORMAT "%13.10" MATRIX_DIM 13 /end CHARACTERISTIC
/begin CHARACTERISTIC DINH_Lim.DFC_MoFCbnPreCdngTmrExpi_CA "" VAL_BLK 0x8024CD16 ValA_Wu8 17.0000000000 DINH_LimDFCVerb 0.00 17.0000000000 FORMAT "%13.10" MATRIX_DIM 13 /end CHARACTERISTIC
/begin CHARACTERISTIC DINH_Lim.DFC_MoFEvMngtBms_CA "" VAL_BLK 0x8024CD23 ValA_Wu8 17.0000000000 DINH_LimDFCVerb 0.00 17.0000000000 FORMAT "%13.10" MATRIX_DIM 13 /end CHARACTERISTIC
/begin CHARACTERISTIC DINH_Lim.DFC_MoFEvMngtDcdc_CA "" VAL_BLK 0x8024CD30 ValA_Wu8 17.0000000000 DINH_LimDFCVerb 0.00 17.0000000000 FORMAT "%13.10" MATRIX_DIM 13 /end CHARACTERISTIC
/begin CHARACTERISTIC DINH_Lim.DFC_MoFEvMngtEm01_CA "" VAL_BLK 0x8024CD3D ValA_Wu8 17.0000000000 DINH_LimDFCVerb 0.00 17.0000000000 FORMAT "%13.10" MATRIX_DIM 13 /end CHARACTERISTIC
/begin CHARACTERISTIC DINH_Lim.DFC_MoFEvMngtEm01BrkgToZr_CA "" VAL_BLK 0x8024CD4A ValA_Wu8 17.0000000000 DINH_LimDFCVerb 0.00 17.0000000000 FORMAT "%13.10" MATRIX_DIM 13 /end CHARACTERISTIC
/begin CHARACTERISTIC DINH_Lim.DFC_MoFEvMngtEm01EngSpd_CA "" VAL_BLK 0x8024CD57 ValA_Wu8 17.0000000000 DINH_LimDFCVerb 0.00 17.0000000000 FORMAT "%13.10" MATRIX_DIM 13 /end CHARACTERISTIC
/begin CHARACTERISTIC DINH_Lim.DFC_MoFEvMngtEm02EngSpd_CA "" VAL_BLK 0x8024CD64 ValA_Wu8 17.0000000000 DINH_LimDFCVerb 0.00 17.0000000000 FORMAT "%13.10" MATRIX_DIM 13 /end CHARACTERISTIC
/begin CHARACTERISTIC DINH_Lim.DFC_MoFEvMngtEm02Lvl1_CA "" VAL_BLK 0x8024CD71 ValA_Wu8 17.0000000000 DINH_LimDFCVerb 0.00 17.0000000000 FORMAT "%13.10" MATRIX_DIM 13 /end CHARACTERISTIC
/begin CHARACTERISTIC DINH_Lim.DFC_MoFEvMngtEm02Lvl2_CA "" VAL_BLK 0x8024CD7E ValA_Wu8 17.0000000000 DINH_LimDFCVerb 0.00 17.0000000000 FORMAT "%13.10" MATRIX_DIM 13 /end CHARACTERISTIC
/begin CHARACTERISTIC DINH_Lim.DFC_MoFExtCptAuxCpt_CA "" VAL_BLK 0x8024CD8B ValA_Wu8 17.0000000000 DINH_LimDFCVerb 0.00 17.0000000000 FORMAT "%13.10" MATRIX_DIM 13 /end CHARACTERISTIC
/begin CHARACTERISTIC DINH_Lim.DFC_MoFExtCptVacPmpErr_CA "" VAL_BLK 0x8024CD98 ValA_Wu8 17.0000000000 DINH_LimDFCVerb 0.00 17.0000000000 FORMAT "%13.10" MATRIX_DIM 13 /end CHARACTERISTIC
/begin CHARACTERISTIC DINH_Lim.DFC_MoFTqPtdAxle_CA "" VAL_BLK 0x8024CDA5 ValA_Wu8 17.0000000000 DINH_LimDFCVerb 0.00 17.0000000000 FORMAT "%13.10" MATRIX_DIM 13 /end CHARACTERISTIC
/begin CHARACTERISTIC DINH_Lim.DFC_MoFTqPtdAxleSec_CA "" VAL_BLK 0x8024CDB2 ValA_Wu8 17.0000000000 DINH_LimDFCVerb 0.00 17.0000000000 FORMAT "%13.10" MATRIX_DIM 13 /end CHARACTERISTIC
/begin CHARACTERISTIC DINH_Lim.DFC_MoFTqPtdEmPtRels_CA "" VAL_BLK 0x8024CDBF ValA_Wu8 17.0000000000 DINH_LimDFCVerb 0.00 17.0000000000 FORMAT "%13.10" MATRIX_DIM 13 /end CHARACTERISTIC
/begin CHARACTERISTIC DINH_Lim.DFC_MoFTqPtdEmPtRelsSec_CA "" VAL_BLK 0x8024CDCC ValA_Wu8 17.0000000000 DINH_LimDFCVerb 0.00 17.0000000000 FORMAT "%13.10" MATRIX_DIM 13 /end CHARACTERISTIC
/begin CHARACTERISTIC DINH_Lim.DFC_MoFTqPtdEmSign_CA "" VAL_BLK 0x8024CDD9 ValA_Wu8 17.0000000000 DINH_LimDFCVerb 0.00 17.0000000000 FORMAT "%13.10" MATRIX_DIM 13 /end CHARACTERISTIC
/begin CHARACTERISTIC DINH_Lim.DFC_MoFTqPtdEmSignSec_CA "" VAL_BLK 0x8024CDE6 ValA_Wu8 17.0000000000 DINH_LimDFCVerb 0.00 17.0000000000 FORMAT "%13.10" MATRIX_DIM 13 /end CHARACTERISTIC
/begin CHARACTERISTIC DINH_Lim.DFC_MoFTqPtdEmTq_CA "" VAL_BLK 0x8024CDF3 ValA_Wu8 17.0000000000 DINH_LimDFCVerb 0.00 17.0000000000 FORMAT "%13.10" MATRIX_DIM 13 /end CHARACTERISTIC
/begin CHARACTERISTIC DINH_Lim.DFC_MoFTqPtdEmTqSec_CA "" VAL_BLK 0x8024CE00 ValA_Wu8 17.0000000000 DINH_LimDFCVerb 0.00 17.0000000000 FORMAT "%13.10" MATRIX_DIM 13 /end CHARACTERISTIC
/begin CHARACTERISTIC DINH_Lim.DFC_MoFTqPtdVeh_CA "" VAL_BLK 0x8024CE0D ValA_Wu8 17.0000000000 DINH_LimDFCVerb 0.00 17.0000000000 FORMAT "%13.10" MATRIX_DIM 13 /end CHARACTERISTIC
/begin CHARACTERISTIC DINH_Lim.DFC_MoFVarPostBldSel_CA "" VAL_BLK 0x8024CE1A ValA_Wu8 17.0000000000 DINH_LimDFCVerb 0.00 17.0000000000 FORMAT "%13.10" MATRIX_DIM 13 /end CHARACTERISTIC
/begin CHARACTERISTIC DINH_Lim.DFC_MoSysCtrlReIni_CA "" VAL_BLK 0x8024CE27 ValA_Wu8 17.0000000000 DINH_LimDFCVerb 0.00 17.0000000000 FORMAT "%13.10" MATRIX_DIM 13 /end CHARACTERISTIC
/begin CHARACTERISTIC DINH_Lim.DFC_MoXEMMHwLTMCUFW_CA "" VAL_BLK 0x8024CE34 ValA_Wu8 17.0000000000 DINH_LimDFCVerb 0.00 17.0000000000 FORMAT "%13.10" MATRIX_DIM 13 /end CHARACTERISTIC
/begin CHARACTERISTIC DINH_Lim.DFC_MoXEMMHwLTMonBIST_CA "" VAL_BLK 0x8024CE41 ValA_Wu8 17.0000000000 DINH_LimDFCVerb 0.00 17.0000000000 FORMAT "%13.10" MATRIX_DIM 13 /end CHARACTERISTIC
/begin CHARACTERISTIC DINH_Lim.DFC_MoXEMMHwLTRegMonTest_CA "" VAL_BLK 0x8024CE4E ValA_Wu8 17.0000000000 DINH_LimDFCVerb 0.00 17.0000000000 FORMAT "%13.10" MATRIX_DIM 13 /end CHARACTERISTIC
/begin CHARACTERISTIC DINH_Lim.DFC_MoXEMMHwLTStbySMUAlvTest_CA "" VAL_BLK 0x8024CE5B ValA_Wu8 17.0000000000 DINH_LimDFCVerb 0.00 17.0000000000 FORMAT "%13.10" MATRIX_DIM 13 /end CHARACTERISTIC
/begin CHARACTERISTIC DINH_Lim.DFC_MoXEMMHwLTTempSens_CA "" VAL_BLK 0x8024CE68 ValA_Wu8 17.0000000000 DINH_LimDFCVerb 0.00 17.0000000000 FORMAT "%13.10" MATRIX_DIM 13 /end CHARACTERISTIC
/begin CHARACTERISTIC DINH_Lim.DFC_MoXEMMHwLTUCBCfg_CA "" VAL_BLK 0x8024CE75 ValA_Wu8 17.0000000000 DINH_LimDFCVerb 0.00 17.0000000000 FORMAT "%13.10" MATRIX_DIM 13 /end CHARACTERISTIC
/begin CHARACTERISTIC DINH_Lim.DFC_MonEgyChrgnCoorr_AcChrgnWoMofRels_CA "" VAL_BLK 0x8024CE82 ValA_Wu8 17.0000000000 DINH_LimDFCVerb 0.00 17.0000000000 FORMAT "%13.10" MATRIX_DIM 13 /end CHARACTERISTIC
/begin CHARACTERISTIC DINH_Lim.DFC_MonEgyChrgnCoorr_ChrgnAbortIgr_CA "" VAL_BLK 0x8024CE8F ValA_Wu8 17.0000000000 DINH_LimDFCVerb 0.00 17.0000000000 FORMAT "%13.10" MATRIX_DIM 13 /end CHARACTERISTIC
/begin CHARACTERISTIC DINH_Lim.DFC_MonEgyChrgnCoorr_DcCntctFailr_CA "" VAL_BLK 0x8024CE9C ValA_Wu8 17.0000000000 DINH_LimDFCVerb 0.00 17.0000000000 FORMAT "%13.10" MATRIX_DIM 13 /end CHARACTERISTIC
/begin CHARACTERISTIC DINH_Lim.DFC_MonEgyChrgnCoorr_ExtChrgnShtOffReq_CA "" VAL_BLK 0x8024CEA9 ValA_Wu8 17.0000000000 DINH_LimDFCVerb 0.00 17.0000000000 FORMAT "%13.10" MATRIX_DIM 13 /end CHARACTERISTIC
/begin CHARACTERISTIC DINH_Lim.DFC_MonEgyChrgnCoorr_ImpsChrgnMod_CA "" VAL_BLK 0x8024CEB6 ValA_Wu8 17.0000000000 DINH_LimDFCVerb 0.00 17.0000000000 FORMAT "%13.10" MATRIX_DIM 13 /end CHARACTERISTIC
/begin CHARACTERISTIC DINH_Lim.DFC_MonEgyChrgnCoorr_ImpsChrgnPrms_CA "" VAL_BLK 0x8024CEC3 ValA_Wu8 17.0000000000 DINH_LimDFCVerb 0.00 17.0000000000 FORMAT "%13.10" MATRIX_DIM 13 /end CHARACTERISTIC
/begin CHARACTERISTIC DINH_Lim.DFC_MonEgyChrgnCoorr_ImpsUDcIntk_CA "" VAL_BLK 0x8024CED0 ValA_Wu8 17.0000000000 DINH_LimDFCVerb 0.00 17.0000000000 FORMAT "%13.10" MATRIX_DIM 13 /end CHARACTERISTIC
/begin CHARACTERISTIC DINH_Lim.DFC_MonEgyChrgnCoorr_PlgLockMovmt_CA "" VAL_BLK 0x8024CEDD ValA_Wu8 17.0000000000 DINH_LimDFCVerb 0.00 17.0000000000 FORMAT "%13.10" MATRIX_DIM 13 /end CHARACTERISTIC
/begin CHARACTERISTIC DINH_Lim.DFC_MonEgyChrgnCoorr_VehCrashDetn_CA "" VAL_BLK 0x8024CEEA ValA_Wu8 17.0000000000 DINH_LimDFCVerb 0.00 17.0000000000 FORMAT "%13.10" MATRIX_DIM 13 /end CHARACTERISTIC
/begin CHARACTERISTIC DINH_Lim.DFC_MonEgyChrgnErrReactn_SftySwt_CA "" VAL_BLK 0x8024CEF7 ValA_Wu8 17.0000000000 DINH_LimDFCVerb 0.00 17.0000000000 FORMAT "%13.10" MATRIX_DIM 13 /end CHARACTERISTIC
/begin CHARACTERISTIC DINH_Lim.DFC_MonEgyChrgnInlet_CcsPlgCtp_CA "" VAL_BLK 0x8024CF04 ValA_Wu8 17.0000000000 DINH_LimDFCVerb 0.00 17.0000000000 FORMAT "%13.10" MATRIX_DIM 13 /end CHARACTERISTIC
/begin CHARACTERISTIC DINH_Lim.DFC_MonEgyChrgnInlet_CcsPlgCtpPwm_CA "" VAL_BLK 0x8024CF11 ValA_Wu8 17.0000000000 DINH_LimDFCVerb 0.00 17.0000000000 FORMAT "%13.10" MATRIX_DIM 13 /end CHARACTERISTIC
/begin CHARACTERISTIC DINH_Lim.DFC_MonEgyChrgnInlet_CcsPlgLockCtrlImpsAtmpt_CA "" VAL_BLK 0x8024CF1E ValA_Wu8 17.0000000000 DINH_LimDFCVerb 0.00 17.0000000000 FORMAT "%13.10" MATRIX_DIM 13 /end CHARACTERISTIC
/begin CHARACTERISTIC DINH_Lim.DFC_MonEgyChrgnInlet_CcsPlgLockSnsrSigRngChk_CA "" VAL_BLK 0x8024CF2B ValA_Wu8 17.0000000000 DINH_LimDFCVerb 0.00 17.0000000000 FORMAT "%13.10" MATRIX_DIM 13 /end CHARACTERISTIC
/begin CHARACTERISTIC DINH_Lim.DFC_MonEgyChrgnInlet_CcsPlgLockStImps_CA "" VAL_BLK 0x8024CF38 ValA_Wu8 17.0000000000 DINH_LimDFCVerb 0.00 17.0000000000 FORMAT "%13.10" MATRIX_DIM 13 /end CHARACTERISTIC
/begin CHARACTERISTIC DINH_Lim.DFC_MonEgyChrgnInlet_CcsPlgPxp_CA "" VAL_BLK 0x8024CF45 ValA_Wu8 17.0000000000 DINH_LimDFCVerb 0.00 17.0000000000 FORMAT "%13.10" MATRIX_DIM 13 /end CHARACTERISTIC
/begin CHARACTERISTIC DINH_Lim.DFC_MonEgyChrgnT_Snsr1GrdtChk_CA "" VAL_BLK 0x8024CF52 ValA_Wu8 17.0000000000 DINH_LimDFCVerb 0.00 17.0000000000 FORMAT "%13.10" MATRIX_DIM 13 /end CHARACTERISTIC
/begin CHARACTERISTIC DINH_Lim.DFC_MonEgyChrgnT_Snsr1SigRngChk_CA "" VAL_BLK 0x8024CF5F ValA_Wu8 17.0000000000 DINH_LimDFCVerb 0.00 17.0000000000 FORMAT "%13.10" MATRIX_DIM 13 /end CHARACTERISTIC
/begin CHARACTERISTIC DINH_Lim.DFC_MonEgyChrgnT_Snsr2GrdtChk_CA "" VAL_BLK 0x8024CF6C ValA_Wu8 17.0000000000 DINH_LimDFCVerb 0.00 17.0000000000 FORMAT "%13.10" MATRIX_DIM 13 /end CHARACTERISTIC
/begin CHARACTERISTIC DINH_Lim.DFC_MonEgyChrgnT_Snsr2SigRngChk_CA "" VAL_BLK 0x8024CF79 ValA_Wu8 17.0000000000 DINH_LimDFCVerb 0.00 17.0000000000 FORMAT "%13.10" MATRIX_DIM 13 /end CHARACTERISTIC
/begin CHARACTERISTIC DINH_Lim.DFC_MonEgyChrgnT_SnsrDif_CA "" VAL_BLK 0x8024CF86 ValA_Wu8 17.0000000000 DINH_LimDFCVerb 0.00 17.0000000000 FORMAT "%13.10" MATRIX_DIM 13 /end CHARACTERISTIC
/begin CHARACTERISTIC DINH_Lim.DFC_OCWDAABEActv_CA "" VAL_BLK 0x8024CF93 ValA_Wu8 17.0000000000 DINH_LimDFCVerb 0.00 17.0000000000 FORMAT "%13.10" MATRIX_DIM 13 /end CHARACTERISTIC
/begin CHARACTERISTIC DINH_Lim.DFC_OCWDACom_CA "" VAL_BLK 0x8024CFA0 ValA_Wu8 17.0000000000 DINH_LimDFCVerb 0.00 17.0000000000 FORMAT "%13.10" MATRIX_DIM 13 /end CHARACTERISTIC
/begin CHARACTERISTIC DINH_Lim.DFC_OCWDAErrPin_CA "" VAL_BLK 0x8024CFAD ValA_Wu8 17.0000000000 DINH_LimDFCVerb 0.00 17.0000000000 FORMAT "%13.10" MATRIX_DIM 13 /end CHARACTERISTIC
/begin CHARACTERISTIC DINH_Lim.DFC_OCWDAOvrVltg_CA "" VAL_BLK 0x8024CFBA ValA_Wu8 17.0000000000 DINH_LimDFCVerb 0.00 17.0000000000 FORMAT "%13.10" MATRIX_DIM 13 /end CHARACTERISTIC
/begin CHARACTERISTIC DINH_Lim.DFC_PUmax_CA "" VAL_BLK 0x8024CFC7 ValA_Wu8 17.0000000000 DINH_LimDFCVerb 0.00 17.0000000000 FORMAT "%13.10" MATRIX_DIM 13 /end CHARACTERISTIC
/begin CHARACTERISTIC DINH_Lim.DFC_PwmCtPTmpErr_CA "" VAL_BLK 0x8024CFD4 ValA_Wu8 17.0000000000 DINH_LimDFCVerb 0.00 17.0000000000 FORMAT "%13.10" MATRIX_DIM 13 /end CHARACTERISTIC
/begin CHARACTERISTIC DINH_Lim.DFC_PwrDistbnUnitTSRCMax_CA "" VAL_BLK 0x8024CFE1 ValA_Wu8 17.0000000000 DINH_LimDFCVerb 0.00 17.0000000000 FORMAT "%13.10" MATRIX_DIM 21 /end CHARACTERISTIC
/begin CHARACTERISTIC DINH_Lim.DFC_PwrDistbnUnitTTmpErr_CA "" VAL_BLK 0x8024CFF6 ValA_Wu8 17.0000000000 DINH_LimDFCVerb 0.00 17.0000000000 FORMAT "%13.10" MATRIX_DIM 17 /end CHARACTERISTIC
/begin CHARACTERISTIC DINH_Lim.DFC_SCtPmp1DiagGrdKeyErr_CA "" VAL_BLK 0x8024D007 ValA_Wu8 17.0000000000 DINH_LimDFCVerb 0.00 17.0000000000 FORMAT "%13.10" MATRIX_DIM 14 /end CHARACTERISTIC
/begin CHARACTERISTIC DINH_Lim.DFC_SRCHighAPP1_CA "" VAL_BLK 0x8024D015 ValA_Wu8 17.0000000000 DINH_LimDFCVerb 0.00 17.0000000000 FORMAT "%13.10" MATRIX_DIM 15 /end CHARACTERISTIC
/begin CHARACTERISTIC DINH_Lim.DFC_SRCHighAPP2_CA "" VAL_BLK 0x8024D024 ValA_Wu8 17.0000000000 DINH_LimDFCVerb 0.00 17.0000000000 FORMAT "%13.10" MATRIX_DIM 15 /end CHARACTERISTIC
/begin CHARACTERISTIC DINH_Lim.DFC_SRCLowAPP1_CA "" VAL_BLK 0x8024D033 ValA_Wu8 17.0000000000 DINH_LimDFCVerb 0.00 17.0000000000 FORMAT "%13.10" MATRIX_DIM 15 /end CHARACTERISTIC
/begin CHARACTERISTIC DINH_Lim.DFC_SRCLowAPP2_CA "" VAL_BLK 0x8024D042 ValA_Wu8 17.0000000000 DINH_LimDFCVerb 0.00 17.0000000000 FORMAT "%13.10" MATRIX_DIM 15 /end CHARACTERISTIC
/begin CHARACTERISTIC DINH_Lim.DFC_SWReset_0_CA "" VAL_BLK 0x8024D051 ValA_Wu8 17.0000000000 DINH_LimDFCVerb 0.00 17.0000000000 FORMAT "%13.10" MATRIX_DIM 13 /end CHARACTERISTIC
/begin CHARACTERISTIC DINH_Lim.DFC_SWReset_1_CA "" VAL_BLK 0x8024D05E ValA_Wu8 17.0000000000 DINH_LimDFCVerb 0.00 17.0000000000 FORMAT "%13.10" MATRIX_DIM 13 /end CHARACTERISTIC
/begin CHARACTERISTIC DINH_Lim.DFC_SWReset_2_CA "" VAL_BLK 0x8024D06B ValA_Wu8 17.0000000000 DINH_LimDFCVerb 0.00 17.0000000000 FORMAT "%13.10" MATRIX_DIM 13 /end CHARACTERISTIC
/begin CHARACTERISTIC DINH_Lim.DFC_Sia_InvldCode_CA "" VAL_BLK 0x8024D078 ValA_Wu8 17.0000000000 DINH_LimDFCVerb 0.00 17.0000000000 FORMAT "%13.10" MATRIX_DIM 13 /end CHARACTERISTIC
/begin CHARACTERISTIC DINH_Lim.DFC_Sia_InvldKey_CA "" VAL_BLK 0x8024D085 ValA_Wu8 17.0000000000 DINH_LimDFCVerb 0.00 17.0000000000 FORMAT "%13.10" MATRIX_DIM 13 /end CHARACTERISTIC
/begin CHARACTERISTIC DINH_Lim.DFC_Sia_NoRespUCx_CA "" VAL_BLK 0x8024D092 ValA_Wu8 17.0000000000 DINH_LimDFCVerb 0.00 17.0000000000 FORMAT "%13.10" MATRIX_DIM 13 /end CHARACTERISTIC
/begin CHARACTERISTIC DINH_Lim.DFC_Sia_TprotRttp_CA "" VAL_BLK 0x8024D09F ValA_Wu8 17.0000000000 DINH_LimDFCVerb 0.00 17.0000000000 FORMAT "%13.10" MATRIX_DIM 13 /end CHARACTERISTIC
/begin CHARACTERISTIC DINH_Lim.DFC_StrtUpEvStandStillDeactvn_CA "" VAL_BLK 0x8024D0AC ValA_Wu8 17.0000000000 DINH_LimDFCVerb 0.00 17.0000000000 FORMAT "%13.10" MATRIX_DIM 13 /end CHARACTERISTIC
/begin CHARACTERISTIC DINH_Lim.DFC_SyncAPP_CA "" VAL_BLK 0x8024D0B9 ValA_Wu8 17.0000000000 DINH_LimDFCVerb 0.00 17.0000000000 FORMAT "%13.10" MATRIX_DIM 15 /end CHARACTERISTIC
/begin CHARACTERISTIC DINH_Lim.DFC_UCtPSRCMax_CA "" VAL_BLK 0x8024D0C8 ValA_Wu8 17.0000000000 DINH_LimDFCVerb 0.00 17.0000000000 FORMAT "%13.10" MATRIX_DIM 17 /end CHARACTERISTIC
/begin CHARACTERISTIC DINH_Lim.DFC_UCtPTmpErr_CA "" VAL_BLK 0x8024D0D9 ValA_Wu8 17.0000000000 DINH_LimDFCVerb 0.00 17.0000000000 FORMAT "%13.10" MATRIX_DIM 13 /end CHARACTERISTIC
/begin CHARACTERISTIC DINH_Lim.DFC_UPxP1SRCMax_CA "" VAL_BLK 0x8024D0E6 ValA_Wu8 17.0000000000 DINH_LimDFCVerb 0.00 17.0000000000 FORMAT "%13.10" MATRIX_DIM 17 /end CHARACTERISTIC
/begin CHARACTERISTIC DINH_Lim.DFC_UPxP1TmpErr_CA "" VAL_BLK 0x8024D0F7 ValA_Wu8 17.0000000000 DINH_LimDFCVerb 0.00 17.0000000000 FORMAT "%13.10" MATRIX_DIM 13 /end CHARACTERISTIC
/begin CHARACTERISTIC DINH_Lim.DFC_VehVObd_CA "" VAL_BLK 0x8024D104 ValA_Wu8 17.0000000000 DINH_LimDFCVerb 0.00 17.0000000000 FORMAT "%13.10" MATRIX_DIM 13 /end CHARACTERISTIC
/begin CHARACTERISTIC DINH_Lim.DSQ_ACCmprPwrConsol_CA "" VAL_BLK 0x8024D111 ValA_Wu8 16.0000000000 DINH_LimDSQVerb 0.00 16.0000000000 FORMAT "%13.10" MATRIX_DIM 14 /end CHARACTERISTIC
/begin CHARACTERISTIC DINH_Lim.DSQ_ACCmprUConsol_CA "" VAL_BLK 0x8024D11F ValA_Wu8 16.0000000000 DINH_LimDSQVerb 0.00 16.0000000000 FORMAT "%13.10" MATRIX_DIM 14 /end CHARACTERISTIC
/begin CHARACTERISTIC DINH_Lim.DSQ_BattU_CA "" VAL_BLK 0x8024D12D ValA_Wu8 16.0000000000 DINH_LimDSQVerb 0.00 16.0000000000 FORMAT "%13.10" MATRIX_DIM 15 /end CHARACTERISTIC
/begin CHARACTERISTIC DINH_Lim.DSQ_DSMInhibitAlways_CA "" VAL_BLK 0x8024D13C ValA_Wu8 16.0000000000 DINH_LimDSQVerb 0.00 16.0000000000 FORMAT "%13.10" MATRIX_DIM 14 /end CHARACTERISTIC
/begin CHARACTERISTIC DINH_Lim.DSQ_T15TurnOfDly_CA "" VAL_BLK 0x8024D14A ValA_Wu8 16.0000000000 DINH_LimDSQVerb 0.00 16.0000000000 FORMAT "%13.10" MATRIX_DIM 13 /end CHARACTERISTIC
/begin CHARACTERISTIC DINH_tiUpdObsv_C "" VALUE 0x8024DA2C Val_Wu16 326.6000 Time_s 1.0000 327.6000 FORMAT "%8.4" EXTENDED_LIMITS 0.00 655.3500 /end CHARACTERISTIC
/begin CHARACTERISTIC DINH_xFIDObsv_C "" VALUE 0x8024DA2E Val_Wu16 1139.00000000 DINH_FIdVerb 0.00 1139.00000000 FORMAT "%13.8" /end CHARACTERISTIC
/begin CHARACTERISTIC DPSWATCHINDEX "Index of the observed output stage (in case of diagnosis problem)" VALUE 0x80252E6E KwUb 255.0 dez 0.00 255.0 FORMAT "%5.1" /end CHARACTERISTIC
/begin CHARACTERISTIC DrvDoor_bOpnRepl_C "Default calibration value for status of driver door in case of error" VALUE 0x8024E6E2 Val_Wu8 1.000 OneToOne 0.00 1.000 FORMAT "%5.3" EXTENDED_LIMITS 0.00 255.0 /end CHARACTERISTIC
/begin CHARACTERISTIC DrvDoor_tiHiLoComDrvDoor_C "Delay parameter for high to low transition for debouncing the Driver door switch status from CAN" VALUE 0x8024E6DE Val_Ws16 655350.0 TimeDeb -327680.0 327670.0 FORMAT "%8.1" /end CHARACTERISTIC
/begin CHARACTERISTIC DrvDoor_tiLoHiComDrvDoor_C "Delay parameter for low to high transition for debouncing the Driver door switch status from CAN" VALUE 0x8024E6E0 Val_Ws16 655350.0 TimeDeb -327680.0 327670.0 FORMAT "%8.1" /end CHARACTERISTIC
/begin CHARACTERISTIC DrvInfo_maskHvBattegyAvlSq_C "Calibratable mask for High voltage battery available energy signal quality" VALUE 0x80250314 RB_Val_Wu16 65535.00 OneToOne 0.00 65535.00 FORMAT "%8.2" /end CHARACTERISTIC
/begin CHARACTERISTIC DrvInfo_tiEmac01TrqCalc_C "Time constant to calculate torque for Emachine01" VALUE 0x80250318 RB_Val_Ws32 0.999990385564609 TimeDelay_s 0.000002000000001 0.999992385564610 FORMAT "%20.18" EXTENDED_LIMITS 0.000002000000001 4294.9672959999998 /end CHARACTERISTIC
/begin CHARACTERISTIC DrvModSeln_maskGearLvrPosnVldSq_C "Calibration mask for signal quality of gear lever position" VALUE 0x8025031C RB_Val_Wu16 65535.00 OneToOne 0.00 65535.00 FORMAT "%8.2" /end CHARACTERISTIC
/begin CHARACTERISTIC DrvModSeln_maskVehVVldySq_C "Calibration mask to detect the validity of vehicle speed" VALUE 0x8025031E RB_Val_Wu16 65535.00 OneToOne 0.00 65535.00 FORMAT "%8.2" /end CHARACTERISTIC
/begin CHARACTERISTIC DrvModSeln_tiReqdModDeb_C "Debouncing time for gear lever postion request" VALUE 0x80250320 RB_Val_Ws16 655.3500 RBPtCel_ti_0p01_1 -327.6800 327.6700 FORMAT "%8.4" /end CHARACTERISTIC
/begin CHARACTERISTIC DrvModSeln_vDrvToRvsPrmsThd_C "Vehicle speed threshold for drive to reverse transition during an F2 request" VALUE 0x80250322 RB_Val_Ws16 655.3500 Vel -327.6800 327.6700 FORMAT "%8.4" /end CHARACTERISTIC
/begin CHARACTERISTIC DrvModSeln_vRvsToDrvPrmsThd_C "Vehicle speed threshold for reverse to drive transition during an B2 request" VALUE 0x80250324 RB_Val_Ws16 655.3500 Vel -327.6800 327.6700 FORMAT "%8.4" /end CHARACTERISTIC
/begin CHARACTERISTIC DrvMod_flgDrvReqSeln_C "Application Parameter to denote when Drive Mode Request changes to DRVMOD_DRV (when eg the Drive Mode Selection cannot change its position physically) when set to True or to denote when Drive Mode Request is DRVMOD_DRV (when eg the Drive Mode Selection ca" VALUE 0x80250326 RB_Val_Wu8 1.00000000000 B_TRUE 0.00 1.00000000000 FORMAT "%13.11" /end CHARACTERISTIC
/begin CHARACTERISTIC DrvMod_flgHmiSwtOffDly_C "Application parameter to enable the Switch off Delay for the HMI Info of Drive Mode Position to be provided to the driver. In case the drive mode selector can change its position physically, the application parameter can be set to 0 and in case the drive" VALUE 0x80250327 RB_Val_Wu8 1.00000000000 B_TRUE 0.00 1.00000000000 FORMAT "%13.11" /end CHARACTERISTIC
/begin CHARACTERISTIC DrvMod_flgIniModReq_C "Application parameter to initialize the Drive Mode position to DRVMOD_PARK when false and DRVMOD_NEUT when true, when the drive mode selector cannot change its position physically." VALUE 0x80250328 RB_Val_Wu8 1.00000000000 B_TRUE 0.00 1.00000000000 FORMAT "%13.11" /end CHARACTERISTIC
/begin CHARACTERISTIC DrvMod_flgModSeln_C "Application parameter to indicate that Drive Mode Selector cannot change its position physically( eg buttons) when set to True and that the Drive Mode Selector can change its position physically(eg lever) when set to False." VALUE 0x80250329 RB_Val_Wu8 1.00000000000 B_TRUE 0.00 1.00000000000 FORMAT "%13.11" /end CHARACTERISTIC
/begin CHARACTERISTIC DrvMod_flgNeutReqSeln_C "Application Parameter to denote when Drive Mode Request changes to DRVMOD_NEUT (when eg the Drive Mode Selection cannot change its position physically) when set to True or to denote when Drive Mode Request is DRVMOD_NEUT (when eg the Drive Mode Selection" VALUE 0x8025032A RB_Val_Wu8 1.00000000000 B_TRUE 0.00 1.00000000000 FORMAT "%13.11" /end CHARACTERISTIC
/begin CHARACTERISTIC DrvMod_flgParkReqSeln_C "Application Parameter to denote when Drive Mode Request changes to DRVMOD_PARK (when eg the Drive Mode Selection cannot change its position physically) when set to True or to denote when Drive Mode Request is DRVMOD_PARK (when eg the Drive Mode Selection" VALUE 0x8025032B RB_Val_Wu8 1.00000000000 B_TRUE 0.00 1.00000000000 FORMAT "%13.11" /end CHARACTERISTIC
/begin CHARACTERISTIC DrvMod_flgRstRcvAllwd_C "Calibratable flag to allow the recovery of drive mode position during software reset" VALUE 0x8025032C RB_Val_Wu8 1.00000000000 B_TRUE 0.00 1.00000000000 FORMAT "%13.11" /end CHARACTERISTIC
/begin CHARACTERISTIC DrvMod_flgRvsReqSeln_C "Application Parameter to denote when Drive Mode Request changes to DRVMOD_RVS (when eg the Drive Mode Selection cannot change its position physically) when set to True or to denote when Drive Mode Request is DRVMOD_RVS (when eg the Drive Mode Selection ca" VALUE 0x8025032D RB_Val_Wu8 1.00000000000 B_TRUE 0.00 1.00000000000 FORMAT "%13.11" /end CHARACTERISTIC
/begin CHARACTERISTIC DrvMod_flgT15OffTranNeut_C "Drive mode position calibration to transit to Neutral during T15 off" VALUE 0x8025032E RB_Val_Wu8 1.00000000000 B_TRUE 0.00 1.00000000000 FORMAT "%13.11" /end CHARACTERISTIC
/begin CHARACTERISTIC DrvMod_ratAppDrvToNeut_C "Maximum value of APP ratio up to which switching from Drive to Neutral is allowed" VALUE 0x80250330 RB_Val_Ws16 799.9878 Prc -400.0000 399.9878 FORMAT "%8.4" /end CHARACTERISTIC
/begin CHARACTERISTIC DrvMod_ratAppDrvToRvs_C "Maximum value of APP ratio up to which switching from Drive to Reverse is allowed" VALUE 0x80250332 RB_Val_Ws16 799.9878 Prc -400.0000 399.9878 FORMAT "%8.4" /end CHARACTERISTIC
/begin CHARACTERISTIC DrvMod_ratAppNeutToDrv_C "Maximum value of APP ratio up to which switching from Neutral to Drive is allowed" VALUE 0x80250334 RB_Val_Ws16 799.9878 Prc -400.0000 399.9878 FORMAT "%8.4" /end CHARACTERISTIC
/begin CHARACTERISTIC DrvMod_ratAppNeutToRvs_C "Maximum value of APP ratio up to which switching from Neutral to Reverse is allowed." VALUE 0x80250336 RB_Val_Ws16 799.9878 Prc -400.0000 399.9878 FORMAT "%8.4" /end CHARACTERISTIC
/begin CHARACTERISTIC DrvMod_ratAppRvsToDrv_C "Maximum value of APP ratio up to which switching from Reverse to Drive is allowed" VALUE 0x80250338 RB_Val_Ws16 799.9878 Prc -400.0000 399.9878 FORMAT "%8.4" /end CHARACTERISTIC
/begin CHARACTERISTIC DrvMod_ratAppRvsToNeut_C "Maximum value of APP ratio up to which switching from Reverse to Neutral is allowed." VALUE 0x8025033A RB_Val_Ws16 799.9878 Prc -400.0000 399.9878 FORMAT "%8.4" /end CHARACTERISTIC
/begin CHARACTERISTIC DrvMod_stIniModReqLvr_C "Application parameter to initialize the Drive Mode Position to DRVMOD_PARK or DRVMO- D_NEUT or a calibratable parameter, when the drive mode selector can change its position physically(eg lever)." VALUE 0x8025033C RB_Val_Wu8 255.0 OneToOne 0.00 255.0 FORMAT "%5.1" /end CHARACTERISTIC
/begin CHARACTERISTIC DrvMod_stMaskBrkReqVld_C "Drive mode position mask for brake request validity" VALUE 0x8025033E RB_Val_Wu16 65535.00 OneToOne 0.00 65535.00 FORMAT "%8.2" /end CHARACTERISTIC
/begin CHARACTERISTIC DrvMod_stMaskReqIniVld_C "Application parameter for mask of Drive Mode Request Error to indicate the bits that corresponds to signal quality of Valid, to initialize the Drive Mode Position depending on the Drive Mode Request in the starting of the driving cycle." VALUE 0x80250340 RB_Val_Wu16 65535.00 OneToOne 0.00 65535.00 FORMAT "%8.2" /end CHARACTERISTIC
/begin CHARACTERISTIC DrvMod_stMaskReqVld_C "Application parameter for mask of Drive Mode Request Error to indicate the bits that corresponds to signal quality of Valid to indicate that there is no error in the Drive Mode Request." VALUE 0x80250342 RB_Val_Wu16 65535.00 OneToOne 0.00 65535.00 FORMAT "%8.2" /end CHARACTERISTIC
/begin CHARACTERISTIC DrvMod_tiBrkTranWarnHmi_C "Drive mode position delay time for brake transition HMI warning" VALUE 0x80250344 RB_Val_Ws16 655.3500 Time_s -327.6800 327.6700 FORMAT "%8.4" /end CHARACTERISTIC
/begin CHARACTERISTIC DrvMod_tiDrvSelnHmi_C "Application Paramter for the time for which the HMI Info Regarding Press brake or Drive Mode Request not realized should be dispalyed for the Drive Mode Selection HMI." VALUE 0x80250346 RB_Val_Ws16 655.3500 Time_s -327.6800 327.6700 FORMAT "%8.4" /end CHARACTERISTIC
/begin CHARACTERISTIC DrvMod_tiNeutToDrvRvs_C "time for transition from neutral to Drive or Reverse" VALUE 0x80250348 RB_Val_Ws16 655.3500 Time_s -327.6800 327.6700 FORMAT "%8.4" /end CHARACTERISTIC
/begin CHARACTERISTIC DrvMod_vDrvModErrNeut_C "Drive mode position velocity to move to Neutral from Drive during error" VALUE 0x8025034A RB_Val_Ws16 655.3500 Vel -327.6800 327.6700 FORMAT "%8.4" /end CHARACTERISTIC
/begin CHARACTERISTIC DrvMod_vRvsModErrNeut_C "Drive mode position velocity to move to Neutral from Reverse during erro" VALUE 0x8025034C RB_Val_Ws16 655.3500 Vel -327.6800 327.6700 FORMAT "%8.4" /end CHARACTERISTIC
/begin CHARACTERISTIC DrvMod_vSignDrv_C "Application parameter to indicate the minimum velocity above which if the Signed vehicle velocity goes, transition from R to D or N to D is allowed for Drive Mode Position if the other conditions are satisfied." VALUE 0x8025034E RB_Val_Ws16 655.3500 Vel -327.6800 327.6700 FORMAT "%8.4" /end CHARACTERISTIC
/begin CHARACTERISTIC DrvMod_vSignRvs_C "Application parameter to indicate the minimum velocity below which if the Signed vehicle velocity goes, transition from D to R or N to R is allowed for Drive Mode Position if the other conditions are satisfied." VALUE 0x80250350 RB_Val_Ws16 655.3500 Vel -327.6800 327.6700 FORMAT "%8.4" /end CHARACTERISTIC
/begin CHARACTERISTIC DrvMod_vVehStandStill_C "Calibration to determine whether Vehicle at Standstill" VALUE 0x80250352 RB_Val_Ws16 655.3500 Vel -327.6800 327.6700 FORMAT "%8.4" /end CHARACTERISTIC
/begin CHARACTERISTIC DrvPrg_maskEcoNormVldySq_C "Mask to the signal quality of drive mode request received via CAN" VALUE 0x80250354 RB_Val_Wu16 65535.00 OneToOne 0.00 65535.00 FORMAT "%8.2" /end CHARACTERISTIC
/begin CHARACTERISTIC DrvPrg_maskVehVVldySq_C "Mask to the Signal quality of Vehicle speed" VALUE 0x80250356 RB_Val_Wu16 65535.00 OneToOne 0.00 65535.00 FORMAT "%8.2" /end CHARACTERISTIC
/begin CHARACTERISTIC DrvPrg_ratAppLoThd_C "Acc. Ped depress lower threshold for drive mode switching" VALUE 0x80250358 RB_Val_Ws16 799.9878 Prc -400.0000 399.9878 FORMAT "%8.4" /end CHARACTERISTIC
/begin CHARACTERISTIC DrvPrg_tiEcoNormSwtDeb_C "Time debounce threshold for drive mode request" VALUE 0x8025035A RB_Val_Ws16 655.3500 RBPtCel_ti_0p01_1 -327.6800 327.6700 FORMAT "%8.4" /end CHARACTERISTIC
/begin CHARACTERISTIC DrvPrg_vThdSwRst_C "Vehicle velocity threshold to recover the drive state in the case of software reset." VALUE 0x8025035C RB_Val_Ws16 655.35000 Vel -327.68000 327.67000 FORMAT "%10.5" /end CHARACTERISTIC
/begin CHARACTERISTIC DrvPrg_vVehSpdThd_C "Vehicle speed threshold for drive mode switch" VALUE 0x8025035E RB_Val_Ws16 655.3500 Vel -327.6800 327.6700 FORMAT "%8.4" /end CHARACTERISTIC
/begin CHARACTERISTIC THP "delay time failure heiling powerstage diagnosis" VALUE 0x80252E6F KwUb 25.00 t_q0p1 0.50 25.50 FORMAT "%5.2" EXTENDED_LIMITS 0.00 25.50 /end CHARACTERISTIC
/begin CHARACTERISTIC TVP "delay time failure verification powerstage diagnosis ME(D) 9" VALUE 0x80252E70 KwUb 25.00 t_q0p1 0.50 25.50 FORMAT "%5.2" EXTENDED_LIMITS 0.00 25.50 /end CHARACTERISTIC
/begin MEASUREMENT DDRC_St.DFC_DrvDoorOpn "" ULONG DFC_OneToOne 1 100 0.00 536870911.000 BIT_MASK 0x1fffffff FORMAT "%13.3" ECU_ADDRESS 0x6001C374 /end MEASUREMENT
/begin MEASUREMENT DDRC_St.DFC_DrvModPosnDfct "" ULONG DFC_OneToOne 1 100 0.00 536870911.000 BIT_MASK 0x1fffffff FORMAT "%13.3" ECU_ADDRESS 0x6001C378 /end MEASUREMENT
/begin MEASUREMENT DFC_st.DFC_DrvDoorOpn "" UBYTE DFC_OneToOne 1 100 0.00 255.0 FORMAT "%5.1" ECU_ADDRESS 0x60034A40 /end MEASUREMENT
/begin MEASUREMENT DFC_st.DFC_DrvModPosnDfct "" UBYTE DFC_OneToOne 1 100 0.00 255.0 FORMAT "%5.1" ECU_ADDRESS 0x60034A41 /end MEASUREMENT
/begin MEASUREMENT DINH_nrActvInhReas.FId_DrvDoorCANSigFault "" UWORD DINH_ct_Compu 1 100 -4095.000 4096.000 BIT_MASK 0x1fff FORMAT "%8.3" ECU_ADDRESS 0x6002142C /end MEASUREMENT
/begin MEASUREMENT DINH_nrActvInhReas.FId_DrvInfoEgyAvlErr "" UWORD DINH_ct_Compu 1 100 -4095.000 4096.000 BIT_MASK 0x1fff FORMAT "%8.3" ECU_ADDRESS 0x6002142E /end MEASUREMENT
/begin MEASUREMENT DINH_nrActvInhReas.FId_DrvModPosnApp "" UWORD DINH_ct_Compu 1 100 -4095.000 4096.000 BIT_MASK 0x1fff FORMAT "%8.3" ECU_ADDRESS 0x60021430 /end MEASUREMENT
/begin MEASUREMENT DINH_nrActvInhReas.FId_DrvPrgSwtEna "" UWORD DINH_ct_Compu 1 100 -4095.000 4096.000 BIT_MASK 0x1fff FORMAT "%8.3" ECU_ADDRESS 0x60021432 /end MEASUREMENT
/begin MEASUREMENT DINH_stFId.FId_DrvDoorCANSigFault "" UWORD DFC_OneToOne 1 100 0.00 65535.00 FORMAT "%8.2" ECU_ADDRESS 0x6002142C /end MEASUREMENT
/begin MEASUREMENT DINH_stFId.FId_DrvInfoEgyAvlErr "" UWORD DFC_OneToOne 1 100 0.00 65535.00 FORMAT "%8.2" ECU_ADDRESS 0x6002142E /end MEASUREMENT
/begin MEASUREMENT DINH_stFId.FId_DrvModPosnApp "" UWORD DFC_OneToOne 1 100 0.00 65535.00 FORMAT "%8.2" ECU_ADDRESS 0x60021430 /end MEASUREMENT
/begin MEASUREMENT DINH_stFId.FId_DrvPrgSwtEna "" UWORD DFC_OneToOne 1 100 0.00 65535.00 FORMAT "%8.2" ECU_ADDRESS 0x60021432 /end MEASUREMENT
/begin MEASUREMENT dps_error "last read Pmd_GetErr() content of state OBSERVING" UWORD dez 1 100 0.00 65535.00 FORMAT "%8.2" ECU_ADDRESS 0x700015DE /end MEASUREMENT
/begin MEASUREMENT dps_errStat "read Pmd_GetErr() content in state VERIFY or RECOVERY; this content is compared to dps_error" UWORD dez 1 100 0.00 65535.00 FORMAT "%8.2" ECU_ADDRESS 0x700015DC /end MEASUREMENT
/begin MEASUREMENT dps_errStat_sum_rec "contains dps_errStat read during RECOVERY state" UWORD dez 1 100 0.00 65535.00 FORMAT "%8.2" ECU_ADDRESS 0x700015DA /end MEASUREMENT
/begin MEASUREMENT dps_errStat_sum_ver "contains dps_errStat read during VERIFY state" UWORD dez 1 100 0.00 65535.00 FORMAT "%8.2" ECU_ADDRESS 0x700015D8 /end MEASUREMENT
/begin MEASUREMENT dps_index "Indicates which powerstage is being observed" UBYTE dez 1 100 0.00 255.0 FORMAT "%5.1" ECU_ADDRESS 0x700015E4 /end MEASUREMENT
/begin MEASUREMENT dps_recoveryTime "Timer Recovery" UBYTE t_q0p1 1 100 0.00 25.50 FORMAT "%5.2" ECU_ADDRESS 0x700015E3 /end MEASUREMENT
/begin MEASUREMENT dps_state "Index Statemachine" UBYTE dez 1 100 0.00 255.0 FORMAT "%5.1" ECU_ADDRESS 0x700015E2 /end MEASUREMENT
/begin MEASUREMENT dps_verifyTime "Timer Verify" UBYTE t_q0p1 1 100 0.00 25.50 FORMAT "%5.2" ECU_ADDRESS 0x700015E1 /end MEASUREMENT
/begin MEASUREMENT DrvDoor_bFault "Status to indicate fault, if error in driver door CAN signal" UBYTE OneToOne 1 100 0.00 1.000 BIT_MASK 0x1 FORMAT "%5.3" ECU_ADDRESS 0x60023891
 /begin IF_DATA XCPplus 0x0102
  /begin DAQ_EVENT VARIABLE /end DAQ_EVENT
 /end IF_DATA
/end MEASUREMENT
/begin MEASUREMENT DrvDoor_bOpn "Status if driver door open" UBYTE OneToOne 1 100 0.00 1.000 BIT_MASK 0x1 FORMAT "%5.3" ECU_ADDRESS 0x60023890
 /begin IF_DATA XCPplus 0x0102
  /begin DAQ_EVENT VARIABLE /end DAQ_EVENT
 /end IF_DATA
/end MEASUREMENT
/begin MEASUREMENT DrvDoor_bOpnLoc "Intermediate message for status of driver door open" UBYTE OneToOne 1 100 0.00 1.000 BIT_MASK 0x1 FORMAT "%5.3" ECU_ADDRESS 0x6002388F
 /begin IF_DATA XCPplus 0x0102
  /begin DAQ_EVENT VARIABLE /end DAQ_EVENT
 /end IF_DATA
/end MEASUREMENT
/begin MEASUREMENT DrvInfo_facNegTrq "Minimum factorial value for E-machine01" SWORD RBPtCel_fac_0p01_1 1 100 -327.6800 327.6700 FORMAT "%8.4" ECU_ADDRESS 0x6001F4EE
 /begin IF_DATA XCPplus 0x0102
  /begin DAQ_EVENT VARIABLE /end DAQ_EVENT
 /end IF_DATA
/end MEASUREMENT
/begin MEASUREMENT DrvInfo_facPosTrq "Maximum factorial value for E-machine01" SWORD RBPtCel_fac_0p01_1 1 100 -327.6800 327.6700 FORMAT "%8.4" ECU_ADDRESS 0x6001F4EC
 /begin IF_DATA XCPplus 0x0102
  /begin DAQ_EVENT VARIABLE /end DAQ_EVENT
 /end IF_DATA
/end MEASUREMENT
/begin MEASUREMENT DrvInfo_flgRst "Reset flag for Trip drive energy economy" UBYTE B_TRUE 1 100 0.00 1.00000000000 BIT_MASK 0x1 FORMAT "%13.11" ECU_ADDRESS 0x7000019B
 /begin IF_DATA XCPplus 0x0102
  /begin DAQ_EVENT VARIABLE /end DAQ_EVENT
 /end IF_DATA
/end MEASUREMENT
/begin MEASUREMENT DrvInfo_pwrEgyAvlOld_f "Available energy of High Voltagebattery stored initially" FLOAT32_IEEE RBPtCel_pwr_1p0_4 1 100 -1.00E+037 1.00E+037 FORMAT "%9.2" ECU_ADDRESS 0x60000A04
 /begin IF_DATA XCPplus 0x0102
  /begin DAQ_EVENT VARIABLE /end DAQ_EVENT
 /end IF_DATA
/end MEASUREMENT
/begin MEASUREMENT DrvInfo_pwrHvBattEgyAvl "Available Energy for High Voltage Battery" FLOAT32_IEEE RBPtCel_pwr_1p0_4 1 100 -1.00E+037 1.00E+037 FORMAT "%9.2" ECU_ADDRESS 0x60000A00
 /begin IF_DATA XCPplus 0x0102
  /begin DAQ_EVENT VARIABLE /end DAQ_EVENT
 /end IF_DATA
/end MEASUREMENT
/begin MEASUREMENT DrvInfo_pwrTotTripEgyNVM "Total Trip energy stored in NVM" FLOAT32_IEEE RBPtCel_pwr_1p0_4 1 100 -1.00E+037 1.00E+037 FORMAT "%9.2" ECU_ADDRESS 0x60035FE4
 /begin IF_DATA XCPplus 0x0102
  /begin DAQ_EVENT VARIABLE /end DAQ_EVENT
 /end IF_DATA
/end MEASUREMENT
/begin MEASUREMENT DrvInfo_pwrTotTripEgy_f "Trip energy Consumed" FLOAT32_IEEE RBPtCel_pwr_1p0_4 1 100 -1.00E+037 1.00E+037 FORMAT "%9.2" ECU_ADDRESS 0x600009FC
 /begin IF_DATA XCPplus 0x0102
  /begin DAQ_EVENT VARIABLE /end DAQ_EVENT
 /end IF_DATA
/end MEASUREMENT
/begin MEASUREMENT DrvInfo_ratEmac01Trq "E-Machine 01 Torque" UWORD RBPtCel_fac_0p0625om125_1 1 100 -125.000 3970.938 FORMAT "%8.3" ECU_ADDRESS 0x6001F9BA
 /begin IF_DATA XCPplus 0x0102
  /begin DAQ_EVENT VARIABLE /end DAQ_EVENT
 /end IF_DATA
/end MEASUREMENT
/begin MEASUREMENT DrvInfo_ratEmac01TrqLoc "Local variable for Emachine01 torque ratio" UWORD RBPtCel_fac_0p0625om125_1 1 100 -125.000 3970.938 FORMAT "%8.3" ECU_ADDRESS 0x6001F4EA
 /begin IF_DATA XCPplus 0x0102
  /begin DAQ_EVENT VARIABLE /end DAQ_EVENT
 /end IF_DATA
/end MEASUREMENT
/begin MEASUREMENT DrvInfo_wTotTripEgy "Total Trip Energy" SLONG q1p0_W_h 1 100 -2147483648.00 2147483647.00 FORMAT "%13.2" ECU_ADDRESS 0x60000DF8
 /begin IF_DATA XCPplus 0x0102
  /begin DAQ_EVENT VARIABLE /end DAQ_EVENT
 /end IF_DATA
/end MEASUREMENT
/begin MEASUREMENT DrvModSeln_stGearLvrPosDeb "Debounced Status of Gear Lever Position" UBYTE OneToOne 1 100 0.00 255.0 FORMAT "%5.1" ECU_ADDRESS 0x60023167
 /begin IF_DATA XCPplus 0x0102
  /begin DAQ_EVENT VARIABLE /end DAQ_EVENT
 /end IF_DATA
/end MEASUREMENT
/begin MEASUREMENT DrvModSeln_stReq "Status of drive mode selection request" UBYTE DrvMod_stPosn_VERB 1 100 0.00 6.00000000000 FORMAT "%13.11" ECU_ADDRESS 0x600235B9
 /begin IF_DATA XCPplus 0x0102
  /begin DAQ_EVENT VARIABLE /end DAQ_EVENT
 /end IF_DATA
/end MEASUREMENT
/begin MEASUREMENT DrvModSeln_stReq_Sq "Signal quality of status of drive mode selection request" UBYTE SigQly_COMPU_VERB 1 100 0.00 15.0000000000 FORMAT "%13.10" ECU_ADDRESS 0x600235B8
 /begin IF_DATA XCPplus 0x0102
  /begin DAQ_EVENT VARIABLE /end DAQ_EVENT
 /end IF_DATA
/end MEASUREMENT
/begin MEASUREMENT DrvMod_flgBrkErr "Drive mode position brake error indication" UBYTE B_TRUE 1 100 0.00 1.00000000000 BIT_MASK 0x1 FORMAT "%13.11" ECU_ADDRESS 0x70000198
 /begin IF_DATA XCPplus 0x0102
  /begin DAQ_EVENT VARIABLE /end DAQ_EVENT
 /end IF_DATA
/end MEASUREMENT
/begin MEASUREMENT DrvMod_flgBrkHmi "Flag to indicate that Press Brake should be displayed from the HMI Drive Mode Postion" UBYTE B_TRUE 1 100 0.00 1.00000000000 BIT_MASK 0x1 FORMAT "%13.11" ECU_ADDRESS 0x70000197
 /begin IF_DATA XCPplus 0x0102
  /begin DAQ_EVENT VARIABLE /end DAQ_EVENT
 /end IF_DATA
/end MEASUREMENT
/begin MEASUREMENT DrvMod_flgBrkHmiTranWarn "Drive mode position brake HMI transition warning" UBYTE B_TRUE 1 100 0.00 1.00000000000 BIT_MASK 0x1 FORMAT "%13.11" ECU_ADDRESS 0x70000196
 /begin IF_DATA XCPplus 0x0102
  /begin DAQ_EVENT VARIABLE /end DAQ_EVENT
 /end IF_DATA
/end MEASUREMENT
/begin MEASUREMENT DrvMod_flgDrvCycIni "Flag to indicate that Valid Drive Mode Request is received." UBYTE B_TRUE 1 100 0.00 1.00000000000 BIT_MASK 0x1 FORMAT "%13.11" ECU_ADDRESS 0x70000195
 /begin IF_DATA XCPplus 0x0102
  /begin DAQ_EVENT VARIABLE /end DAQ_EVENT
 /end IF_DATA
/end MEASUREMENT
/begin MEASUREMENT DrvMod_flgDrvCycIniOld "Old value of the flag to indicate that Valid Drive Mode Request is received." UBYTE B_TRUE 1 100 0.00 1.00000000000 BIT_MASK 0x1 FORMAT "%13.11" ECU_ADDRESS 0x70000194
 /begin IF_DATA XCPplus 0x0102
  /begin DAQ_EVENT VARIABLE /end DAQ_EVENT
 /end IF_DATA
/end MEASUREMENT
/begin MEASUREMENT DrvMod_flgDrvModReqErr "Flag to indicate that the Signal quality for Drive Mode Request is not valid" UBYTE B_TRUE 1 100 0.00 1.00000000000 BIT_MASK 0x1 FORMAT "%13.11" ECU_ADDRESS 0x70000193
 /begin IF_DATA XCPplus 0x0102
  /begin DAQ_EVENT VARIABLE /end DAQ_EVENT
 /end IF_DATA
/end MEASUREMENT
/begin MEASUREMENT DrvMod_flgDrvModReqVld "Flag to indicate that the Signal quality for Drive Mode Request is valid and the Drive Mode Position is Initialized" UBYTE B_TRUE 1 100 0.00 1.00000000000 BIT_MASK 0x1 FORMAT "%13.11" ECU_ADDRESS 0x70000192
 /begin IF_DATA XCPplus 0x0102
  /begin DAQ_EVENT VARIABLE /end DAQ_EVENT
 /end IF_DATA
/end MEASUREMENT
/begin MEASUREMENT DrvMod_flgDrvRvsNeut "Flag to to indicate the transition from Neutral to Drive or Reverse" UBYTE B_TRUE 1 100 0.00 1.00000000000 BIT_MASK 0x1 FORMAT "%13.11" ECU_ADDRESS 0x70000191
 /begin IF_DATA XCPplus 0x0102
  /begin DAQ_EVENT VARIABLE /end DAQ_EVENT
 /end IF_DATA
/end MEASUREMENT
/begin MEASUREMENT DrvMod_flgT15ECURstOcc "Flag indicating T15 status based on reset occurrence" UBYTE B_TRUE 1 100 0.00 1.00000000000 BIT_MASK 0x1 FORMAT "%13.11" ECU_ADDRESS 0x70000190
 /begin IF_DATA XCPplus 0x0102
  /begin DAQ_EVENT VARIABLE /end DAQ_EVENT
 /end IF_DATA
/end MEASUREMENT
/begin MEASUREMENT DrvMod_stDrvSelnHmi "Drive Mode Position HMI Status message" UBYTE OneToOne 1 100 0.00 255.0 FORMAT "%5.1" ECU_ADDRESS 0x600235B7
 /begin IF_DATA XCPplus 0x0102
  /begin DAQ_EVENT VARIABLE /end DAQ_EVENT
 /end IF_DATA
/end MEASUREMENT
/begin MEASUREMENT DrvMod_stIniDrvMod "Initialized Drive Mode Request once valid Drive Mode Request is received" UBYTE OneToOne 1 100 0.00 255.0 FORMAT "%5.1" ECU_ADDRESS 0x60023166
 /begin IF_DATA XCPplus 0x0102
  /begin DAQ_EVENT VARIABLE /end DAQ_EVENT
 /end IF_DATA
/end MEASUREMENT
/begin MEASUREMENT DrvMod_stIniModPosn "Initialized Drive Mode Position" UBYTE OneToOne 1 100 0.00 255.0 FORMAT "%5.1" ECU_ADDRESS 0x60023165
 /begin IF_DATA XCPplus 0x0102
  /begin DAQ_EVENT VARIABLE /end DAQ_EVENT
 /end IF_DATA
/end MEASUREMENT
/begin MEASUREMENT DrvMod_stModReqd "Bit Coded message that represents the Requested Drive Mode with 0th Bit as P, 1st bit as N, 2nd bit as D, 3rd bit as R" UBYTE OneToOne 1 100 0.00 255.0 FORMAT "%5.1" ECU_ADDRESS 0x60023164
 /begin IF_DATA XCPplus 0x0102
  /begin DAQ_EVENT VARIABLE /end DAQ_EVENT
 /end IF_DATA
/end MEASUREMENT
/begin MEASUREMENT DrvMod_stPosn "Drive Mode Gear Position status based on Actual Gear status and Gear Lever Position" UBYTE DrvMod_stPosn_VERB 1 100 0.00 6.00000000000 FORMAT "%13.11" ECU_ADDRESS 0x600235B6
 /begin IF_DATA XCPplus 0x0102
  /begin DAQ_EVENT VARIABLE /end DAQ_EVENT
 /end IF_DATA
/end MEASUREMENT
/begin MEASUREMENT DrvMod_stPosnLoc "Drive Mode Gear Position status" UBYTE OneToOne 1 100 0.00 255.0 FORMAT "%5.1" ECU_ADDRESS 0x600347E4
 /begin IF_DATA XCPplus 0x0102
  /begin DAQ_EVENT VARIABLE /end DAQ_EVENT
 /end IF_DATA
/end MEASUREMENT
/begin MEASUREMENT DrvMod_tiSt1 "time duration for which Gear Position in neutral" SWORD Time_s 1 100 -327.6800 327.6700 FORMAT "%8.4" ECU_ADDRESS 0x6001F4E6
 /begin IF_DATA XCPplus 0x0102
  /begin DAQ_EVENT VARIABLE /end DAQ_EVENT
 /end IF_DATA
/end MEASUREMENT
/begin MEASUREMENT DrvPrgSwt_stReq "Drive program switch request status" UWORD OneToOne 1 100 0.00 65535.00 FORMAT "%8.2" ECU_ADDRESS 0x6001FA3A
 /begin IF_DATA XCPplus 0x0102
  /begin DAQ_EVENT VARIABLE /end DAQ_EVENT
 /end IF_DATA
/end MEASUREMENT
/begin MEASUREMENT DrvPrgSwt_stReqSeln "Drive program switch request selection status" UBYTE B_TRUE 1 100 0.00 1.00000000000 BIT_MASK 0x1 FORMAT "%13.11" ECU_ADDRESS 0x7000018C
 /begin IF_DATA XCPplus 0x0102
  /begin DAQ_EVENT VARIABLE /end DAQ_EVENT
 /end IF_DATA
/end MEASUREMENT
/begin MEASUREMENT DrvPrgSwt_stReq_Sq "Signal Quality of Drive Program Switch Request Status" UBYTE SigQly_COMPU_VERB 1 100 0.00 15.0000000000 FORMAT "%13.10" ECU_ADDRESS 0x600235B4
 /begin IF_DATA XCPplus 0x0102
  /begin DAQ_EVENT VARIABLE /end DAQ_EVENT
 /end IF_DATA
/end MEASUREMENT
/begin MEASUREMENT DrvPrg_stReqProtd "Drive program prodected state request." UWORD OneToOne 1 100 0.00 65535.00 FORMAT "%8.2" ECU_ADDRESS 0x600347E2
 /begin IF_DATA XCPplus 0x0102
  /begin DAQ_EVENT VARIABLE /end DAQ_EVENT
 /end IF_DATA
/end MEASUREMENT
/begin FUNCTION DINH "30000.25.0Diagnostic Inhibit Handler"
 /begin DEF_CHARACTERISTIC DINH_Lim.DFC_ComInvld_435h_HVBAT_MAX_CELL_VOLT_NUM_CA DINH_Lim.DFC_ComInvld_435h_HVBAT_MAX_SENSOR_TEMP_CA DINH_Lim.DFC_ComInvld_435h_HVBAT_MIN_CELL_VOLT_CA DINH_Lim.DFC_ComInvld_435h_HVBAT_MIN_CELL_VOLT_NUM_CA DINH_Lim.DFC_ComInvld_442h_BCCM_BLOWER_RELAY_STS_CA DINH_Lim.DFC_ComInvld_453h_OBC_IN_CURRENT_CA DINH_Lim.DFC_ComInvld_453h_OBC_IN_VOLTAGE_CA DINH_Lim.DFC_ComInvld_453h_OBC_IP_POWER_CA DINH_Lim.DFC_ComInvld_455h_HVBAT_NOMINAL_VOLTAGE_CA DINH_Lim.DFC_ComInvld_463h_OBC_OUT_CURRENT_CA DINH_Lim.DFC_ComInvld_463h_OBC_OUT_VOLTAGE_CA DINH_Lim.DFC_ComInvld_463h_OBC_TEMPERATURE_CA DINH_Lim.DFC_ComInvld_473h_DCDC_Coolant_Temperature_CA DINH_Lim.DFC_ComInvld_473h_DCDC_TEMPERATURE_CA DINH_Lim.DFC_ComInvld_47Bh_eCOMP_BusBarCurrent_CA DINH_Lim.DFC_ComInvld_47Bh_eCOMP_BusBarVoltage_CA DINH_Lim.DFC_ComInvld_47Bh_eCOMP_CompressorSpeed_CA DINH_Lim.DFC_ComInvld_47Bh_eCOMP_IGBT_Temp_CA DINH_Lim.DFC_ComInvld_47Bh_eCOMP_PeakPhaCurrent_CA DINH_Lim.DFC_ComInvld_47Bh_eCOMP_Power_consumption_CA DINH_Lim.DFC_ComInvld_4F2h_STATUS_SOC_CA DINH_Lim.DFC_ComInvld_4F2h_TEMP_BATT_STATUS_CA DINH_Lim.DFC_ComInvld_4F2h_VALEUR_SOC_ETENDUE_CA DINH_Lim.DFC_ComInvld_535h_HV_BATT_TEMP_AVG_CA DINH_Lim.DFC_ComInvld_543h_HVBAT_RESTBATTENERGY_CA DINH_Lim.DFC_ComInvld_543h_HVBAT_SOH_CA DINH_Lim.DFC_ComInvld_543h_HV_BATT_SOH_RES_CA DINH_Lim.DFC_ComInvld_552h_CPT_TEMPOREL_CA DINH_Lim.DFC_ComInvld_552h_KILOMETRAGE_CA DINH_Lim.DFC_ComInvld_583h_HV_BATT_DISCONT_CSE_OPEN_CA DINH_Lim.DFC_ComInvld_592h_CALIBRE_IBATT_CA DINH_Lim.DFC_ComInvld_592h_IBATT_1_CA DINH_Lim.DFC_ComInvld_592h_IBATT_2_CA DINH_Lim.DFC_ComInvld_592h_IBATT_3_CA DINH_Lim.DFC_ComInvld_592h_TEMP_BATT_CA DINH_Lim.DFC_ComInvld_592h_U_BATT_BECB_CA DINH_Lim.DFC_ComInvld_595h_HVBAT_TIME_TO_CHRG_80_CA DINH_Lim.DFC_ComInvld_5B2h_TEMP_AIR_EXT_CA DINH_Lim.DFC_ComInvld_5B5h_HVBAT_THERMAL_RUNAWAY_CA DINH_Lim.DFC_ComInvld_635h_HVBAT_NEG_CONT_COUNT_SEG1_CA DINH_Lim.DFC_ComInvld_635h_HVBAT_NEG_CONT_COUNT_SEG3_CA DINH_Lim.DFC_ComInvld_635h_HVBAT_NEG_CONT_COUNT_SEG4_CA DINH_Lim.DFC_ComInvld_635h_HVBAT_PST_CONT_COUNT_SEG1_CA DINH_Lim.DFC_ComInvld_635h_HVBAT_PST_CONT_COUNT_SEG3_CA DINH_Lim.DFC_ComInvld_635h_HVBAT_PST_CONT_COUNT_SEG4_CA DINH_Lim.DFC_ComInvld_645h_HVBAT_PRECHRGE_CONT_COUNT_SEG1_CA DINH_Lim.DFC_ComInvld_645h_HVBAT_PRECHRGE_CONT_COUNT_SEG2_CA DINH_Lim.DFC_ComInvld_675h_HVBAT_REMAININGBATTCAPACITY_CA DINH_Lim.DFC_ACCmprFltLvl1_CA DINH_Lim.DFC_ACCmprFltLvl2_CA DINH_Lim.DFC_ACCmprFltLvl3_CA DINH_Lim.DFC_ACCmprFltLvl4_CA DINH_Lim.DFC_ACCmprHiPFlt_CA DINH_Lim.DFC_ACCmprInvldCmprSt_CA DINH_Lim.DFC_ACCmprInvldElecActPwr_CA DINH_Lim.DFC_ACCmprLoPFlt_CA DINH_Lim.DFC_AcChrgrIntkTSRCMin_CA DINH_Lim.DFC_BattUBMaxBatt_CA DINH_Lim.DFC_BattUBMaxNoBatt_CA DINH_Lim.DFC_BattUBMinBatt_CA DINH_Lim.DFC_BattUBMinNoBatt_CA DINH_Lim.DFC_BattUSRCMax_CA DINH_Lim.DFC_BattUSRCMin_CA DINH_Lim.DFC_BrkBstPHiCautionDfct_CA DINH_Lim.DFC_BrkBstPHiWarnDfct_CA DINH_Lim.DFC_BrkBstPSnsr12PlausDfct_CA DINH_Lim.DFC_BrkBstPSnsr1Scb_CA DINH_Lim.DFC_BrkBstPSnsr1Scg_CA DINH_Lim.DFC_BrkBstPSnsr2Scb_CA DINH_Lim.DFC_BrkBstPSnsr2Scg_CA DINH_Lim.DFC_BrkBstPSnsrMax_CA DINH_Lim.DFC_BrkBstPSnsrMin_CA DINH_Lim.DFC_BrkBstPhyRngChkMax_CA DINH_Lim.DFC_BrkBstPhyRngChkMin_CA DINH_Lim.DFC_BrkBstPmpHsScb_CA DINH_Lim.DFC_BrkBstPmpHsScg_CA DINH_Lim.DFC_BrkBstPmpLsOl_CA DINH_Lim.DFC_BrkBstPmpLsScb_CA DINH_Lim.DFC_BrkBstPmpLsScg_CA DINH_Lim.DFC_CbnHeatgHeatrRlyOpend_CA DINH_Lim.DFC_CbnHeatgHeatrRlyWldd_CA DINH_Lim.DFC_CcsDcIBattExcdd_CA DINH_Lim.DFC_CcsDcIEvseOutDe_CA DINH_Lim.DFC_CcsDcIOutDe_CA DINH_Lim.DFC_CcsDcIOutExcdd_CA DINH_Lim.DFC_CcsDcUOutDe_CA DINH_Lim.DFC_CcsDcUOutExcdd_CA DINH_Lim.DFC_CcsPwrLineChpRstOL_CA DINH_Lim.DFC_CcsPwrLineChpRstOvrTemp_CA DINH_Lim.DFC_CcsPwrLineChpRstSCB_CA DINH_Lim.DFC_CcsPwrLineChpRstSCG_CA DINH_Lim.DFC_CcsPwrLineChpVccEnaOL_CA DINH_Lim.DFC_CcsPwrLineChpVccEnaOvrTemp_CA DINH_Lim.DFC_CcsPwrLineChpVccEnaSCB_CA DINH_Lim.DFC_CcsPwrLineChpVccEnaSCG_CA DINH_Lim.DFC_CcsPwrLineChpVccSRCMin_CA DINH_Lim.DFC_CcsPwrLineComChpTSRCMin_CA DINH_Lim.DFC_CtPSwtActrOL_CA DINH_Lim.DFC_CtPSwtActrOvrTemp_CA DINH_Lim.DFC_CtPSwtActrSCB_CA DINH_Lim.DFC_CtPSwtActrSCG_CA DINH_Lim.DFC_CtPSwtDiagSRCMin_CA DINH_Lim.DFC_CtpCarrFrqSRCMin_CA DINH_Lim.DFC_DcChrgrIntkT2SRCMin_CA DINH_Lim.DFC_DcChrgrIntkTSRCMin_CA DINH_Lim.DFC_DevLibBattUHi_CA DINH_Lim.DFC_DevLibBattULo_CA DINH_Lim.DFC_EmWakeupSigOL_CA DINH_Lim.DFC_EmWakeupSigOvrTemp_CA DINH_Lim.DFC_EmWakeupSigSCB_CA DINH_Lim.DFC_EmWakeupSigSCG_CA DINH_Lim.DFC_Fan1OL_CA DINH_Lim.DFC_Fan1OvrTemp_CA DINH_Lim.DFC_Fan1SCB_CA DINH_Lim.DFC_FanRlySCB_CA DINH_Lim.DFC_FanRlySCG_CA DINH_Lim.DFC_FanSpdSRCMin_CA DINH_Lim.DFC_FreonPSRCMin_CA DINH_Lim.DFC_HLCCcsPLnCChipTHi_CA DINH_Lim.DFC_HeatrCoreTSRCMin_CA DINH_Lim.DFC_PwmCtPSRCMin_CA DINH_Lim.DFC_PwrDistbnUnitTSRCMin_CA DINH_Lim.DFC_SCtPmp1OL_CA DINH_Lim.DFC_SCtPmp1OvrTemp_CA DINH_Lim.DFC_SCtPmp1SCB_CA DINH_Lim.DFC_SCtPmpRlyOL_CA DINH_Lim.DFC_SCtPmpRlyOvrTemp_CA DINH_Lim.DFC_SCtPmpRlySCB_CA DINH_Lim.DFC_SpplCooltPmpRlyOL_CA DINH_Lim.DFC_SpplCooltPmpRlyOvrTemp_CA DINH_Lim.DFC_SpplCooltPmpRlySCB_CA DINH_Lim.DFC_UCtPSRCMin_CA DINH_Lim.DFC_UPxP1SRCMin_CA DINH_Lim.DFC_ComHSN1CANMute_CA DINH_Lim.DFC_ComHSN3CANMute_CA DINH_Lim.DFC_AcChrgrIntkTPhysRngHi_CA DINH_Lim.DFC_AcChrgrIntkTPhysRngLo_CA DINH_Lim.DFC_AcChrgrIntkTSRCOpn_CA DINH_Lim.DFC_CcsPwrLineChpVccPhysRngHi_CA DINH_Lim.DFC_CcsPwrLineChpVccPhysRngLo_CA DINH_Lim.DFC_CcsPwrLineChpVccSRCOpn_CA DINH_Lim.DFC_CcsPwrLineComChpTPhysRngHi_CA DINH_Lim.DFC_CcsPwrLineComChpTPhysRngLo_CA DINH_Lim.DFC_CcsPwrLineComChpTSRCOpn_CA DINH_Lim.DFC_CtPSwtDiagPhysRngHi_CA DINH_Lim.DFC_CtPSwtDiagPhysRngLo_CA DINH_Lim.DFC_CtPSwtDiagSRCOpn_CA DINH_Lim.DFC_CtpCarrFrqPhysRngHi_CA DINH_Lim.DFC_CtpCarrFrqPhysRngLo_CA DINH_Lim.DFC_CtpCarrFrqSRCMax_CA DINH_Lim.DFC_DcChrgrIntkT2PhysRngHi_CA DINH_Lim.DFC_DcChrgrIntkT2PhysRngLo_CA DINH_Lim.DFC_DcChrgrIntkT2SRCOpn_CA DINH_Lim.DFC_DcChrgrIntkTPhysRngHi_CA DINH_Lim.DFC_DcChrgrIntkTPhysRngLo_CA DINH_Lim.DFC_DcChrgrIntkTSRCOpn_CA DINH_Lim.DFC_Fan1SCG_CA DINH_Lim.DFC_FanSpdPhysRngHi_CA DINH_Lim.DFC_FanSpdPhysRngLo_CA DINH_Lim.DFC_FanSpdSRCOpn_CA DINH_Lim.DFC_FreonPPhysRngHi_CA DINH_Lim.DFC_FreonPPhysRngLo_CA DINH_Lim.DFC_FreonPSRCOpn_CA DINH_Lim.DFC_HeatrCoreTPhysRngHi_CA DINH_Lim.DFC_HeatrCoreTPhysRngLo_CA DINH_Lim.DFC_HeatrCoreTSRCOpn_CA DINH_Lim.DFC_HvGridUMaxSftyLim_CA DINH_Lim.DFC_HvGridUMinSftyLim_CA DINH_Lim.DFC_HvGridUPlausy_CA DINH_Lim.DFC_IntlckChrgPlgHBrgOpnLd_CA DINH_Lim.DFC_IntlckChrgPlgHBrgOvrCurr_CA DINH_Lim.DFC_IntlckChrgPlgHBrgOvrTemp_CA DINH_Lim.DFC_IntlckChrgPlgHBrgShCirBatt1_CA DINH_Lim.DFC_IntlckChrgPlgHBrgShCirBatt2_CA DINH_Lim.DFC_IntlckChrgPlgHBrgShCirGnd1_CA DINH_Lim.DFC_IntlckChrgPlgHBrgShCirGnd2_CA DINH_Lim.DFC_IntlckChrgPlgHBrgShCirOvrLd_CA DINH_Lim.DFC_IntlckChrgPlgHBrgTempOvrCurr_CA DINH_Lim.DFC_IntlckChrgPlgHBrgUndrVltg_CA DINH_Lim.DFC_IntlckChrgPlgPosnRngFlt_CA DINH_Lim.DFC_IntlckChrgPlgPosnSrcMax_CA DINH_Lim.DFC_IntlckChrgPlgPosnSrcMin_CA DINH_Lim.DFC_PwmCtPPhysRngHi_CA DINH_Lim.DFC_PwmCtPPhysRngLo_CA DINH_Lim.DFC_PwmCtPSRCMax_CA DINH_Lim.DFC_PwrDistbnUnitTPhysRngHi_CA DINH_Lim.DFC_PwrDistbnUnitTPhysRngLo_CA DINH_Lim.DFC_PwrDistbnUnitTSRCOpn_CA DINH_Lim.DFC_SCtPmpRlySCG_CA DINH_Lim.DFC_SpplCooltPmpRlySCG_CA DINH_Lim.DFC_UCtPPhysRngHi_CA DINH_Lim.DFC_UCtPPhysRngLo_CA DINH_Lim.DFC_UCtPSRCOpn_CA DINH_Lim.DFC_UPxP1PhysRngHi_CA DINH_Lim.DFC_UPxP1PhysRngLo_CA DINH_Lim.DFC_UPxP1SRCOpn_CA DINH_Lim.DFC_VehVPhysRngHi_CA DINH_Lim.DFC_VehVPhysRngLo_CA DINH_Lim.DFC_VehVSigCan_CA DINH_Lim.DFC_VehVSigCanSafe_CA DINH_Lim.DFC_SCtPmp1DiagGrdKey1_CA DINH_Lim.DFC_SCtPmp1DiagGrdKey2_CA DINH_Lim.DFC_SCtPmp1DiagGrdKey3_CA DINH_Lim.DFC_SCtPmp1DiagGrdKey4_CA DINH_Lim.DFC_SCtPmp1DiagGrdKey5_CA DINH_Lim.DFC_ChrgPlgLiveCntctHzrdCcs_CA DINH_Lim.DFC_ChrgPlgProxPltImps_CA DINH_Lim.DFC_ChrgPlgTHiCcsDc_CA DINH_Lim.DFC_ElMActvDchaFailr_CA DINH_Lim.DFC_ElMActvDchaFlt_CA DINH_Lim.DFC_ElMFbdnIvtrModDrv01_CA DINH_Lim.DFC_ElMImobAuthent_CA DINH_Lim.DFC_ElMIsoMonFlt_CA DINH_Lim.DFC_ElMIsoMonPlausyFlt_CA DINH_Lim.DFC_ElMIvtrCooltT01_CA DINH_Lim.DFC_ElMIvtrEmgyShtDwn01_CA DINH_Lim.DFC_ElMIvtrFailr01_CA DINH_Lim.DFC_ElMIvtrIntlck01_CA DINH_Lim.DFC_ElMIvtrTErr01_CA DINH_Lim.DFC_ElMOverSpdNeg01_CA DINH_Lim.DFC_ElMOverSpdPos01_CA DINH_Lim.DFC_ElMOverTqNeg01_CA DINH_Lim.DFC_ElMOverTqPos01_CA DINH_Lim.DFC_ElMPwrAuthn_CA DINH_Lim.DFC_ElMSpdErr01_CA DINH_Lim.DFC_ElMSvs01_CA DINH_Lim.DFC_PEnvCcMax_CA DINH_Lim.DFC_PEnvCcMin_CA DINH_Lim.DFC_PEnvRngChkMax_CA DINH_Lim.DFC_PEnvRngChkMin_CA DINH_Lim.DFC_PEnvSnsrPlaus_CA DINH_Lim.DFC_BrkBstPmpPlausGenn_CA DINH_Lim.DFC_CbnHeatrRlyLfLoWarn_CA DINH_Lim.DFC_ChgrPlugLockPinByndClsd_CA DINH_Lim.DFC_ChgrPlugLockPinMoveWoCmd_CA DINH_Lim.DFC_ChgrPlugLockPinStuckInClsd_CA DINH_Lim.DFC_ChgrPlugLockPinStuckInOpen_CA DINH_Lim.DFC_ChrgrStErr_CA DINH_Lim.DFC_ComHSN1BusOff_CA DINH_Lim.DFC_ComHSN3BusOff_CA DINH_Lim.DFC_ComVCInval_CA DINH_Lim.DFC_EemDcdcPrecSpdInhb_CA DINH_Lim.DFC_ExpPwrLatch_CA DINH_Lim.DFC_FanMaxOvrd_CA DINH_Lim.DFC_HLCCcsGnrlComErr_CA DINH_Lim.DFC_InmLINNodeHVACPanelAbsnt_CA DINH_Lim.DFC_ResetRcvNotAllwd_CA DINH_Lim.DFC_TelltlCooltPlaus_CA DINH_Lim.DFC_MRlyOL_CA DINH_Lim.DFC_MRlySCB_CA DINH_Lim.DFC_MRlySCG_CA DINH_Lim.DFC_SSpMon1_CA DINH_Lim.DFC_SSpMon1OV_CA DINH_Lim.DFC_SSpMon1SCG_CA DINH_Lim.DFC_SSpMon1UV_CA DINH_Lim.DFC_SSpMon2_CA DINH_Lim.DFC_SSpMon2OV_CA DINH_Lim.DFC_SSpMon2SCG_CA DINH_Lim.DFC_SSpMon2UV_CA DINH_Lim.DFC_SSpMon3_CA DINH_Lim.DFC_SSpMon3OV_CA DINH_Lim.DFC_SSpMon3SCG_CA DINH_Lim.DFC_SSpMon3UV_CA DINH_Lim.DFC_CANSM_E_BUS_OFF_NETWORK_HSN1_CAN_CA DINH_Lim.DFC_CANSM_E_BUS_OFF_NETWORK_HSN3_CAN_CA DINH_Lim.DFC_CANSM_E_BUS_OFF_NETWORK_HSN4_CAN_CA DINH_Lim.DFC_CANSM_E_BUS_OFF_NETWORK_XCP_CAN_CA DINH_Lim.DFC_CANTRCV_E_NO_TRCV_CONTROL_0_CA DINH_Lim.DFC_CAN_E_TIMEOUT_CA DINH_Lim.DFC_COMM_E_NET_START_IND_CHANNEL_0_CA DINH_Lim.DFC_COMM_E_NET_START_IND_CHANNEL_1_CA DINH_Lim.DFC_COMM_E_NET_START_IND_CHANNEL_2_CA DINH_Lim.DFC_COMM_E_NET_START_IND_CHANNEL_3_CA DINH_Lim.DFC_COMM_E_NET_START_IND_CHANNEL_4_CA DINH_Lim.DFC_COMM_E_NET_START_IND_CHANNEL_5_CA DINH_Lim.DFC_LIN_E_TIMEOUT_CA DINH_Lim.DFC_rba_EcuCtrl_TOMaxProlg_CA DINH_Lim.DFC_rba_EcuCtrl_TOMaxShutDwn_CA DINH_Lim.DFC_rba_MultiStackTrace_Threshold_CA DINH_Lim.DFC_rba_SyC_CustStates_Degraded_disord_Event_CA DINH_Lim.DFC_rba_SyC_CustStates_Degraded_incst_Event_CA DINH_Lim.DFC_rba_SyC_CustStates_TransNoWakReq_Event_CA DINH_Lim.DFC_RBA_IOEXTLIB_KEEPALIVE_DRV_CA DINH_Lim.DFC_RBA_IOEXTLIB_KEEPALIVE_INI_CA DINH_Lim.DFC_rba_IoSigRtc_StopCounter_CA DINH_Lim.DFC_rba_MRly_Diag_Stk_Event_CA DINH_Lim.DFC_rba_MemDiag_MemReadErr_CA DINH_Lim.DFC_rba_MemDiag_MemWrErr_CA DINH_Lim.DFC_rba_SyC_IrrSwOffTrigEngRun_Event_CA DINH_Lim.DFC_AcChrgrIntkTSRCMax_CA DINH_Lim.DFC_AcChrgrIntkTTmpErr_CA DINH_Lim.DFC_AcFlt_CA DINH_Lim.DFC_AppAllSnsrDfct_CA DINH_Lim.DFC_BattUPwrFail_CA DINH_Lim.DFC_BrkBstBkupOvrn_CA DINH_Lim.DFC_BrkBstPmpOvld_CA DINH_Lim.DFC_BrkPlausChk_CA DINH_Lim.DFC_CbnHeatgSwtTmpErr_CA DINH_Lim.DFC_CcsPwrLineChpVccSRCMax_CA DINH_Lim.DFC_CcsPwrLineChpVccTmpErr_CA DINH_Lim.DFC_CcsPwrLineComChpTSRCMax_CA DINH_Lim.DFC_CcsPwrLineComChpTTmpErr_CA DINH_Lim.DFC_ChgrPlugCtpCarrFrqErr_CA DINH_Lim.DFC_ChgrPlugCtpSwtStuckClsd_CA DINH_Lim.DFC_ChgrPlugCtpSwtStuckOpen_CA DINH_Lim.DFC_ChgrPlugCtpUErrHi_CA DINH_Lim.DFC_ChgrPlugPxp1SrcErr_CA DINH_Lim.DFC_ChrgCntctAllWldd_CA DINH_Lim.DFC_ChrgCntctNegOperErr_CA DINH_Lim.DFC_ChrgCntctNegOperWarn_CA DINH_Lim.DFC_ChrgCntctNegWldd_CA DINH_Lim.DFC_ChrgCntctPosOperErr_CA DINH_Lim.DFC_ChrgCntctPosOperWarn_CA DINH_Lim.DFC_ChrgCntctPosWldd_CA DINH_Lim.DFC_ChrgCntctStuckOpen_CA DINH_Lim.DFC_ChrgPlgIntlckFaild_CA DINH_Lim.DFC_ChrgnUnplRqrd_CA DINH_Lim.DFC_CoElMOffsCalibActv01_CA DINH_Lim.DFC_CtPSwtDiagSRCMax_CA DINH_Lim.DFC_CtPSwtDiagTmpErr_CA DINH_Lim.DFC_CtpCarrFrqTmpErr_CA DINH_Lim.DFC_DcChrgrIntkT2SRCMax_CA DINH_Lim.DFC_DcChrgrIntkT2TmpErr_CA DINH_Lim.DFC_DcChrgrIntkTSRCMax_CA DINH_Lim.DFC_DcChrgrIntkTTmpErr_CA DINH_Lim.DFC_EChrDvPlinCntrThdExcdd_CA DINH_Lim.DFC_EemDiagCtctrClsTout_CA DINH_Lim.DFC_EemDiagDcdcOffTOut_CA DINH_Lim.DFC_EemDiagHvCnsrOffTOut_CA DINH_Lim.DFC_EemDiagHvbOffTOut_CA DINH_Lim.DFC_FanSpdSRCMax_CA DINH_Lim.DFC_FanSpdTmpErr_CA DINH_Lim.DFC_FreonPSRCMax_CA DINH_Lim.DFC_FreonPTmpErr_CA DINH_Lim.DFC_HeatrCoreTSRCMax_CA DINH_Lim.DFC_HeatrCoreTTmpErr_CA DINH_Lim.DFC_HvGridSocMinLim_CA DINH_Lim.DFC_HvacBlwrFrntFlt_CA DINH_Lim.DFC_HvacEvapElecFlt_CA DINH_Lim.DFC_HvacEvapElecFltGnd_CA DINH_Lim.DFC_HvacKnobPosnFlt_CA DINH_Lim.DFC_InvBinID_CA DINH_Lim.DFC_InvCalID_CA DINH_Lim.DFC_InvErotan_CA DINH_Lim.DFC_InvVinID_CA DINH_Lim.DFC_MOXEMM_SMU_ALM0_0_CA DINH_Lim.DFC_MOXEMM_SMU_ALM0_1_CA DINH_Lim.DFC_MOXEMM_SMU_ALM0_10_CA DINH_Lim.DFC_MOXEMM_SMU_ALM0_11_CA DINH_Lim.DFC_MOXEMM_SMU_ALM0_13_CA DINH_Lim.DFC_MOXEMM_SMU_ALM0_14_CA DINH_Lim.DFC_MOXEMM_SMU_ALM0_2_CA DINH_Lim.DFC_MOXEMM_SMU_ALM0_22_CA DINH_Lim.DFC_MOXEMM_SMU_ALM0_23_CA DINH_Lim.DFC_MOXEMM_SMU_ALM0_4_CA DINH_Lim.DFC_MOXEMM_SMU_ALM0_5_CA DINH_Lim.DFC_MOXEMM_SMU_ALM0_7_CA DINH_Lim.DFC_MOXEMM_SMU_ALM0_8_CA DINH_Lim.DFC_MOXEMM_SMU_ALM10_16_CA DINH_Lim.DFC_MOXEMM_SMU_ALM10_17_CA DINH_Lim.DFC_MOXEMM_SMU_ALM10_21_CA DINH_Lim.DFC_MOXEMM_SMU_ALM11_0_CA DINH_Lim.DFC_MOXEMM_SMU_ALM11_1_CA DINH_Lim.DFC_MOXEMM_SMU_ALM11_2_CA DINH_Lim.DFC_MOXEMM_SMU_ALM11_3_CA DINH_Lim.DFC_MOXEMM_SMU_ALM11_4_CA DINH_Lim.DFC_MOXEMM_SMU_ALM11_5_CA DINH_Lim.DFC_MOXEMM_SMU_ALM11_8_CA DINH_Lim.DFC_MOXEMM_SMU_ALM11_9_CA DINH_Lim.DFC_MOXEMM_SMU_ALM1_0_CA DINH_Lim.DFC_MOXEMM_SMU_ALM1_1_CA DINH_Lim.DFC_MOXEMM_SMU_ALM1_10_CA DINH_Lim.DFC_MOXEMM_SMU_ALM1_11_CA DINH_Lim.DFC_MOXEMM_SMU_ALM1_13_CA DINH_Lim.DFC_MOXEMM_SMU_ALM1_14_CA DINH_Lim.DFC_MOXEMM_SMU_ALM1_2_CA DINH_Lim.DFC_MOXEMM_SMU_ALM1_22_CA DINH_Lim.DFC_MOXEMM_SMU_ALM1_23_CA DINH_Lim.DFC_MOXEMM_SMU_ALM1_4_CA DINH_Lim.DFC_MOXEMM_SMU_ALM1_5_CA DINH_Lim.DFC_MOXEMM_SMU_ALM1_7_CA DINH_Lim.DFC_MOXEMM_SMU_ALM1_8_CA DINH_Lim.DFC_MOXEMM_SMU_ALM21_0_CA DINH_Lim.DFC_MOXEMM_SMU_ALM21_16_CA DINH_Lim.DFC_MOXEMM_SMU_ALM21_3_CA DINH_Lim.DFC_MOXEMM_SMU_ALM2_1_CA DINH_Lim.DFC_MOXEMM_SMU_ALM2_10_CA DINH_Lim.DFC_MOXEMM_SMU_ALM2_11_CA DINH_Lim.DFC_MOXEMM_SMU_ALM2_13_CA DINH_Lim.DFC_MOXEMM_SMU_ALM2_14_CA DINH_Lim.DFC_MOXEMM_SMU_ALM2_22_CA DINH_Lim.DFC_MOXEMM_SMU_ALM2_23_CA DINH_Lim.DFC_MOXEMM_SMU_ALM2_4_CA DINH_Lim.DFC_MOXEMM_SMU_ALM2_5_CA DINH_Lim.DFC_MOXEMM_SMU_ALM2_7_CA DINH_Lim.DFC_MOXEMM_SMU_ALM2_8_CA DINH_Lim.DFC_MOXEMM_SMU_ALM6_0_CA DINH_Lim.DFC_MOXEMM_SMU_ALM6_11_CA DINH_Lim.DFC_MOXEMM_SMU_ALM6_12_CA DINH_Lim.DFC_MOXEMM_SMU_ALM6_14_CA DINH_Lim.DFC_MOXEMM_SMU_ALM6_15_CA DINH_Lim.DFC_MOXEMM_SMU_ALM6_17_CA DINH_Lim.DFC_MOXEMM_SMU_ALM6_18_CA DINH_Lim.DFC_MOXEMM_SMU_ALM6_20_CA DINH_Lim.DFC_MOXEMM_SMU_ALM6_21_CA DINH_Lim.DFC_MOXEMM_SMU_ALM6_25_CA DINH_Lim.DFC_MOXEMM_SMU_ALM6_4_CA DINH_Lim.DFC_MOXEMM_SMU_ALM6_5_CA DINH_Lim.DFC_MOXEMM_SMU_ALM6_7_CA DINH_Lim.DFC_MOXEMM_SMU_ALM6_8_CA DINH_Lim.DFC_MOXEMM_SMU_ALM7_1_CA DINH_Lim.DFC_MOXEMM_SMU_ALM7_12_CA DINH_Lim.DFC_MOXEMM_SMU_ALM7_13_CA DINH_Lim.DFC_MOXEMM_SMU_ALM7_14_CA DINH_Lim.DFC_MOXEMM_SMU_ALM7_15_CA DINH_Lim.DFC_MOXEMM_SMU_ALM7_16_CA DINH_Lim.DFC_MOXEMM_SMU_ALM7_17_CA DINH_Lim.DFC_MOXEMM_SMU_ALM7_2_CA DINH_Lim.DFC_MOXEMM_SMU_ALM7_20_CA DINH_Lim.DFC_MOXEMM_SMU_ALM7_25_CA DINH_Lim.DFC_MOXEMM_SMU_ALM7_26_CA DINH_Lim.DFC_MOXEMM_SMU_ALM7_28_CA DINH_Lim.DFC_MOXEMM_SMU_ALM7_29_CA DINH_Lim.DFC_MOXEMM_SMU_ALM7_30_CA DINH_Lim.DFC_MOXEMM_SMU_ALM7_31_CA DINH_Lim.DFC_MOXEMM_SMU_ALM8_0_CA DINH_Lim.DFC_MOXEMM_SMU_ALM8_1_CA DINH_Lim.DFC_MOXEMM_SMU_ALM8_10_CA DINH_Lim.DFC_MOXEMM_SMU_ALM8_11_CA DINH_Lim.DFC_MOXEMM_SMU_ALM8_12_CA DINH_Lim.DFC_MOXEMM_SMU_ALM8_16_CA DINH_Lim.DFC_MOXEMM_SMU_ALM8_18_CA DINH_Lim.DFC_MOXEMM_SMU_ALM8_2_CA DINH_Lim.DFC_MOXEMM_SMU_ALM8_3_CA DINH_Lim.DFC_MOXEMM_SMU_ALM8_31_CA DINH_Lim.DFC_MOXEMM_SMU_ALM8_4_CA DINH_Lim.DFC_MOXEMM_SMU_ALM9_0_CA DINH_Lim.DFC_MOXEMM_SMU_ALM9_15_CA DINH_Lim.DFC_MOXEMM_SMU_ALM9_3_CA DINH_Lim.DFC_MoCADCNTPBnk1_CA DINH_Lim.DFC_MoCADCTestVoltBnk1_CA DINH_Lim.DFC_MoCSOPICO_CA DINH_Lim.DFC_MoFAccr_CA DINH_Lim.DFC_MoFCbnPreCdngOvrheat_CA DINH_Lim.DFC_MoFCbnPreCdngTmrExpi_CA DINH_Lim.DFC_MoFEvMngtBms_CA DINH_Lim.DFC_MoFEvMngtDcdc_CA DINH_Lim.DFC_MoFEvMngtEm01_CA DINH_Lim.DFC_MoFEvMngtEm01BrkgToZr_CA DINH_Lim.DFC_MoFEvMngtEm01EngSpd_CA DINH_Lim.DFC_MoFEvMngtEm02EngSpd_CA DINH_Lim.DFC_MoFEvMngtEm02Lvl1_CA DINH_Lim.DFC_MoFEvMngtEm02Lvl2_CA DINH_Lim.DFC_MoFExtCptAuxCpt_CA DINH_Lim.DFC_MoFExtCptVacPmpErr_CA DINH_Lim.DFC_MoFTqPtdAxle_CA DINH_Lim.DFC_MoFTqPtdAxleSec_CA DINH_Lim.DFC_MoFTqPtdEmPtRels_CA DINH_Lim.DFC_MoFTqPtdEmPtRelsSec_CA DINH_Lim.DFC_MoFTqPtdEmSign_CA DINH_Lim.DFC_MoFTqPtdEmSignSec_CA DINH_Lim.DFC_MoFTqPtdEmTq_CA DINH_Lim.DFC_MoFTqPtdEmTqSec_CA DINH_Lim.DFC_MoFTqPtdVeh_CA DINH_Lim.DFC_MoFVarPostBldSel_CA DINH_Lim.DFC_MoSysCtrlReIni_CA DINH_Lim.DFC_MoXEMMHwLTMCUFW_CA DINH_Lim.DFC_MoXEMMHwLTMonBIST_CA DINH_Lim.DFC_MoXEMMHwLTRegMonTest_CA DINH_Lim.DFC_MoXEMMHwLTStbySMUAlvTest_CA DINH_Lim.DFC_MoXEMMHwLTTempSens_CA DINH_Lim.DFC_MoXEMMHwLTUCBCfg_CA DINH_Lim.DFC_MonEgyChrgnCoorr_AcChrgnWoMofRels_CA DINH_Lim.DFC_MonEgyChrgnCoorr_ChrgnAbortIgr_CA DINH_Lim.DFC_MonEgyChrgnCoorr_DcCntctFailr_CA DINH_Lim.DFC_MonEgyChrgnCoorr_ExtChrgnShtOffReq_CA DINH_Lim.DFC_MonEgyChrgnCoorr_ImpsChrgnMod_CA DINH_Lim.DFC_MonEgyChrgnCoorr_ImpsChrgnPrms_CA DINH_Lim.DFC_MonEgyChrgnCoorr_ImpsUDcIntk_CA DINH_Lim.DFC_MonEgyChrgnCoorr_PlgLockMovmt_CA DINH_Lim.DFC_MonEgyChrgnCoorr_VehCrashDetn_CA DINH_Lim.DFC_MonEgyChrgnErrReactn_SftySwt_CA DINH_Lim.DFC_MonEgyChrgnInlet_CcsPlgCtp_CA DINH_Lim.DFC_MonEgyChrgnInlet_CcsPlgCtpPwm_CA DINH_Lim.DFC_MonEgyChrgnInlet_CcsPlgLockCtrlImpsAtmpt_CA DINH_Lim.DFC_MonEgyChrgnInlet_CcsPlgLockSnsrSigRngChk_CA DINH_Lim.DFC_MonEgyChrgnInlet_CcsPlgLockStImps_CA DINH_Lim.DFC_MonEgyChrgnInlet_CcsPlgPxp_CA DINH_Lim.DFC_MonEgyChrgnT_Snsr1GrdtChk_CA DINH_Lim.DFC_MonEgyChrgnT_Snsr1SigRngChk_CA DINH_Lim.DFC_MonEgyChrgnT_Snsr2GrdtChk_CA DINH_Lim.DFC_MonEgyChrgnT_Snsr2SigRngChk_CA DINH_Lim.DFC_MonEgyChrgnT_SnsrDif_CA DINH_Lim.DFC_OCWDAABEActv_CA DINH_Lim.DFC_OCWDACom_CA DINH_Lim.DFC_OCWDAErrPin_CA DINH_Lim.DFC_OCWDAOvrVltg_CA DINH_Lim.DFC_PUmax_CA DINH_Lim.DFC_PwmCtPTmpErr_CA DINH_Lim.DFC_PwrDistbnUnitTSRCMax_CA DINH_Lim.DFC_PwrDistbnUnitTTmpErr_CA DINH_Lim.DFC_SCtPmp1DiagGrdKeyErr_CA DINH_Lim.DFC_SRCHighAPP1_CA DINH_Lim.DFC_SRCHighAPP2_CA DINH_Lim.DFC_SRCLowAPP1_CA DINH_Lim.DFC_SRCLowAPP2_CA DINH_Lim.DFC_SWReset_0_CA DINH_Lim.DFC_SWReset_1_CA DINH_Lim.DFC_SWReset_2_CA DINH_Lim.DFC_Sia_InvldCode_CA DINH_Lim.DFC_Sia_InvldKey_CA DINH_Lim.DFC_Sia_NoRespUCx_CA DINH_Lim.DFC_Sia_TprotRttp_CA DINH_Lim.DFC_StrtUpEvStandStillDeactvn_CA DINH_Lim.DFC_SyncAPP_CA DINH_Lim.DFC_UCtPSRCMax_CA DINH_Lim.DFC_UCtPTmpErr_CA DINH_Lim.DFC_UPxP1SRCMax_CA DINH_Lim.DFC_UPxP1TmpErr_CA DINH_Lim.DFC_VehVObd_CA DINH_Lim.DSQ_ACCmprPwrConsol_CA DINH_Lim.DSQ_ACCmprUConsol_CA DINH_Lim.DSQ_BattU_CA DINH_Lim.DSQ_DSMInhibitAlways_CA DINH_Lim.DSQ_T15TurnOfDly_CA DINH_tiUpdObsv_C DINH_xFIDObsv_C /end DEF_CHARACTERISTIC
 FUNCTION_VERSION "30000.25.0" /end FUNCTION
/begin FUNCTION DIUMPR "30000.45.0Diagnostic In Use Monitor Performance Ratio" FUNCTION_VERSION "30000.45.0" /end FUNCTION
/begin FUNCTION DPS_Tmp "100.1.0   standard powerstage diagnosis" /begin DEF_CHARACTERISTIC DPSWATCHINDEX THP TVP /end DEF_CHARACTERISTIC /begin IN_MEASUREMENT B_PmdInit_msg /end IN_MEASUREMENT
 /begin LOC_MEASUREMENT dps_error dps_errStat dps_errStat_sum_rec dps_errStat_sum_ver dps_index dps_recoveryTime dps_state dps_verifyTime /end LOC_MEASUREMENT
 FUNCTION_VERSION "100.1.0" /end FUNCTION
/begin FUNCTION DrvDoor_DD "1.4.0     Driver Door Device Driver" /begin DEF_CHARACTERISTIC DrvDoor_tiHiLoComDrvDoor_C DrvDoor_tiLoHiComDrvDoor_C /end DEF_CHARACTERISTIC /begin IN_MEASUREMENT Com_stDrvDoor /end IN_MEASUREMENT
 /begin OUT_MEASUREMENT DINH_nrActvInhReas.FId_DrvDoorCANSigFault DINH_stFId.FId_DrvDoorCANSigFault DrvDoor_bFault DrvDoor_bOpnLoc /end OUT_MEASUREMENT
 FUNCTION_VERSION "1.4.0" /end FUNCTION
/begin FUNCTION DrvDoor_VD "1.3.0     Driver Door Virtual Driver"
 /begin DEF_CHARACTERISTIC DDRC_DurDeb.DrvDoor_tiOpnDebOk_C DDRC_DurDeb.DrvDoor_tiOpnDebDef_C DFC_CtlMsk2.DFC_DrvDoorOpn_C DFC_DisblMsk2.DFC_DrvDoorOpn_C DrvDoor_bOpnRepl_C /end DEF_CHARACTERISTIC
 /begin IN_MEASUREMENT DrvDoor_bFault DrvDoor_bOpnLoc /end IN_MEASUREMENT
 /begin OUT_MEASUREMENT DDRC_St.DFC_DrvDoorOpn DFC_st.DFC_DrvDoorOpn DrvDoor_bOpn /end OUT_MEASUREMENT
 FUNCTION_VERSION "1.3.0" /end FUNCTION
/begin FUNCTION DrvInfo_PwrCalc "1400.0.0  Processing of power for display purposes" /begin DEF_CHARACTERISTIC DrvInfo_maskHvBattegyAvlSq_C DrvInfo_tiEmac01TrqCalc_C /end DEF_CHARACTERISTIC
 /begin IN_MEASUREMENT Com_flgRstTripAEE Emac_tqAct01 HvBatt_egyAvl_f HvBatt_egyAvl_Sq TrsmEmac_tqProtnMax01 TrsmEmac_tqProtnMin01 VehCoorn_st /end IN_MEASUREMENT
 /begin OUT_MEASUREMENT DINH_nrActvInhReas.FId_DrvInfoEgyAvlErr DINH_stFId.FId_DrvInfoEgyAvlErr DrvInfo_ratEmac01Trq DrvInfo_wTotTripEgy /end OUT_MEASUREMENT
 /begin LOC_MEASUREMENT DrvInfo_facNegTrq DrvInfo_facPosTrq DrvInfo_flgRst DrvInfo_pwrEgyAvlOld_f DrvInfo_pwrHvBattEgyAvl DrvInfo_pwrTotTripEgyNVM DrvInfo_pwrTotTripEgy_f DrvInfo_ratEmac01TrqLoc /end LOC_MEASUREMENT
 FUNCTION_VERSION "1400.0.0" /end FUNCTION
/begin FUNCTION DrvModSeln_Vd "1400.2.0  Virtual Device for detection of selection drive mode"
 /begin DEF_CHARACTERISTIC DrvModSeln_maskGearLvrPosnVldSq_C DrvModSeln_maskVehVVldySq_C DrvModSeln_tiReqdModDeb_C DrvModSeln_vDrvToRvsPrmsThd_C DrvModSeln_vRvsToDrvPrmsThd_C /end DEF_CHARACTERISTIC
 /begin IN_MEASUREMENT Com_stGearLvrPos Com_stGearLvrPos_Sq DrvMod_stPosn VehV_v VehV_v_Sq /end IN_MEASUREMENT
 /begin OUT_MEASUREMENT DrvModSeln_stReq DrvModSeln_stReq_Sq /end OUT_MEASUREMENT
 /begin LOC_MEASUREMENT DrvModSeln_stGearLvrPosDeb /end LOC_MEASUREMENT
 FUNCTION_VERSION "1400.2.0" /end FUNCTION
/begin FUNCTION DrvMod_PosnDetrm "1400.3.0  Calculation of Actual Drive Mode"
 /begin DEF_CHARACTERISTIC DDRC_DurDeb.DFC_tiDrvModPosnDfctDebOk_C DDRC_DurDeb.DFC_tiDrvModPosnDfctDebDef_C DFC_CtlMsk2.DFC_DrvModPosnDfct_C DFC_DisblMsk2.DFC_DrvModPosnDfct_C DrvMod_flgDrvReqSeln_C DrvMod_flgHmiSwtOffDly_C DrvMod_flgIniModReq_C DrvMod_flgModSeln_C DrvMod_flgNeutReqSeln_C DrvMod_flgParkReqSeln_C DrvMod_flgRstRcvAllwd_C DrvMod_flgRvsReqSeln_C DrvMod_flgT15OffTranNeut_C DrvMod_ratAppDrvToNeut_C DrvMod_ratAppDrvToRvs_C DrvMod_ratAppNeutToDrv_C DrvMod_ratAppNeutToRvs_C DrvMod_ratAppRvsToDrv_C DrvMod_ratAppRvsToNeut_C DrvMod_stIniModReqLvr_C DrvMod_stMaskBrkReqVld_C DrvMod_stMaskReqIniVld_C DrvMod_stMaskReqVld_C DrvMod_tiBrkTranWarnHmi_C DrvMod_tiDrvSelnHmi_C DrvMod_tiNeutToDrvRvs_C DrvMod_vDrvModErrNeut_C DrvMod_vRvsModErrNeut_C DrvMod_vSignDrv_C DrvMod_vSignRvs_C DrvMod_vVehStandStill_C /end DEF_CHARACTERISTIC
 /begin IN_MEASUREMENT APP_r Brk_st Brk_st_Sq DrvModSeln_stReq DrvModSeln_stReq_Sq Reset_flgECURstOcc T15_st VehCoorn_st VehV_vSign /end IN_MEASUREMENT
 /begin OUT_MEASUREMENT DDRC_St.DFC_DrvModPosnDfct DFC_st.DFC_DrvModPosnDfct DINH_nrActvInhReas.FId_DrvModPosnApp DINH_stFId.FId_DrvModPosnApp DrvMod_stDrvSelnHmi DrvMod_stPosn /end OUT_MEASUREMENT
 /begin LOC_MEASUREMENT DrvMod_flgBrkErr DrvMod_flgBrkHmi DrvMod_flgBrkHmiTranWarn DrvMod_flgDrvCycIni DrvMod_flgDrvCycIniOld DrvMod_flgDrvModReqErr DrvMod_flgDrvModReqVld DrvMod_flgDrvRvsNeut DrvMod_flgT15ECURstOcc DrvMod_stIniDrvMod DrvMod_stIniModPosn DrvMod_stModReqd DrvMod_stPosnLoc DrvMod_tiSt1 /end LOC_MEASUREMENT
 FUNCTION_VERSION "1400.3.0" /end FUNCTION
/begin FUNCTION DrvPrg_Coorr "1400.2.0  coordinator of drive program"
 /begin DEF_CHARACTERISTIC DrvPrg_maskEcoNormVldySq_C DrvPrg_maskVehVVldySq_C DrvPrg_ratAppLoThd_C DrvPrg_tiEcoNormSwtDeb_C DrvPrg_vThdSwRst_C DrvPrg_vVehSpdThd_C /end DEF_CHARACTERISTIC
 /begin IN_MEASUREMENT APP_r Com_flgEcoNormReq Com_flgEcoNormReq_Sq Reset_flgECURstOcc Reset_VehV_v VehCoorn_st VehV_v VehV_v_Sq /end IN_MEASUREMENT
 /begin OUT_MEASUREMENT DINH_nrActvInhReas.FId_DrvPrgSwtEna DINH_stFId.FId_DrvPrgSwtEna DrvPrgSwt_stReq DrvPrgSwt_stReq_Sq /end OUT_MEASUREMENT
 /begin LOC_MEASUREMENT DrvPrgSwt_stReqSeln DrvPrg_stReqProtd /end LOC_MEASUREMENT
 FUNCTION_VERSION "1400.2.0" /end FUNCTION
/begin COMPU_METHOD B_TRUE "" TAB_VERB "%6.3" "" COMPU_TAB_REF B_TRUE /end COMPU_METHOD
/begin COMPU_VTAB B_TRUE "" TAB_VERB 2 0 "FALSE" 1 "TRUE" /end COMPU_VTAB
/begin COMPU_METHOD DDRCTime_ms "" RAT_FUNC "%6.1" "ms" COEFFS 0 1 0 0 0 10 /end COMPU_METHOD
/begin COMPU_METHOD dez "" RAT_FUNC "%6.2" "" COEFFS 0 1 0 0 0 1 /end COMPU_METHOD
/begin COMPU_METHOD DFC_OneToOne "" RAT_FUNC "%6.2" "-" COEFFS 0 1 0 0 0 1 /end COMPU_METHOD
/begin COMPU_METHOD DFES_OneToOne "" RAT_FUNC "%6.2" "-" COEFFS 0 1 0 0 0 1 /end COMPU_METHOD
/begin COMPU_METHOD DINH_ct_Compu "" RAT_FUNC "%6.0" "" COEFFS 0 -1 4096 0 0 1 /end COMPU_METHOD
/begin COMPU_METHOD DINH_FIdVerb "" TAB_VERB "%6.3" "-" COMPU_TAB_REF DINH_FIdVerb /end COMPU_METHOD
/begin COMPU_VTAB DINH_FIdVerb "" TAB_VERB 1140 0 "FId_Unused" 1 "FID_ElTSPwrChrgnOutErr" 2 "FID_ElTSPwrInActErr" 3 "FId_ACCmprFltPDiagEnad" 4 "FId_ACCmprInpErr" 5 "FId_ACpAC" 6 "FId_APP1SigPath" 7 "FId_APP2SigPath" 8 "FId_APPBrkErr" 9 "FId_APPVehVErr" 10 "FId_AcChrgrIntkTEnhdSRCMax" 11 "FId_AcChrgrIntkTFrzVal" 12 "FId_AcChrgrIntkTPhysRng" 13 "FId_AcChrgrIntkTRplVal" 14 "FId_AcChrgrIntkTSSpMon" 15 "FId_AcChrgrIntkTTmpErrCnt" 16 "FId_AcExtChrgrChrgn" 17 "FId_Airbg2MED" 18 "FId_AirbgAVSstCrash" 19 "FId_AirbgCan" 20 "FId_AirbgHw" 21 "FId_AirbgInpSigErr" 22 "FId_AirbgPWMErr" 23 "FId_AirbgPwmSrcErr" 24 "FId_BattUDiagEna" 25 "FId_BattUInvalid" 26 "FId_BattUReplcmt" 27 "FId_BattUVehVVld" 28 "FId_BlwrComErr" 29 "FId_BrkBstBrkSt" 30 "FId_BrkBstP" 31 "FId_BrkBstPEnaPrc" 32 "FId_BrkBstPFrzVal" 33 "FId_BrkBstPPlaus12FrznDfct" 34 "FId_BrkBstPPlaus12ReplcmtDfct" 35 "FId_BrkBstPReplVal" 36 "FId_BrkBstPSnsr1FrzDfct" 37 "FId_BrkBstPSnsr1ReplcmtDfct" 38 "FId_BrkBstPSnsr1SplyDfct" 39 "FId_BrkBstPSnsr2FrzDfct" 40 "FId_BrkBstPSnsr2ReplcmtDfct" 41 "FId_BrkBstPSnsr2SplyDfct" 42 "FId_BrkBstPmpActtnDiagEnad" 43 "FId_BrkBstPmpDeactvnDiagEnad" 44 "FId_BrkBstPmpLeakDiagEnad" 45 "FId_BrkBstPmpM1Err" 46 "FId_BrkBstPmpM2Err" 47 "FId_BrkBstPmpScgLsErr" 48 "FId_BrkBstPmpVacChkEna" 49 "FId_BrkBstTst" 50 "FId_BrkPlaus1Ena" 51 "FId_BrkPresAlrt" 52 "FId_BrkSigMaiCanFrzVal" 53 "FId_BrkSigMaiCanReplVal" 54 "FId_BrkStMnFinalDfct" 55 "FId_BrkStMnPrelDfct" 56 "FId_BrkStRdntFinalDfct" 57 "FId_BrkStRdntPrelDfct" 58 "FId_CanEifVehSpdVld" 59 "FId_CbnHeatgHeatrPsFlt" 60 "FId_CbnHeatgHeatrRlyDiagEnad" 61 "FId_CbnHeatgSwtFrzVal" 62 "FId_CbnHeatgSwtRplVal" 63 "FId_CbnHeatgSwtTmpErrCnt" 64 "FId_CcsDcStopChrgn" 65 "FId_CcsDcStopChrgnIDftl" 66 "FId_CcsPwrLineChpRstMonOff" 67 "FId_CcsPwrLineChpRstOff" 68 "FId_CcsPwrLineChpRstPsOff" 69 "FId_CcsPwrLineChpRstSnsr" 70 "FId_CcsPwrLineChpVccEnaMonOff" 71 "FId_CcsPwrLineChpVccEnaOff" 72 "FId_CcsPwrLineChpVccEnaPsOff" 73 "FId_CcsPwrLineChpVccEnaSnsr" 74 "FId_CcsPwrLineChpVccEnhdSRCMax" 75 "FId_CcsPwrLineChpVccFrzVal" 76 "FId_CcsPwrLineChpVccPhysRng" 77 "FId_CcsPwrLineChpVccRplVal" 78 "FId_CcsPwrLineChpVccSSpMon" 79 "FId_CcsPwrLineChpVccTmpErrCnt" 80 "FId_CcsPwrLineComChpTEnhdSRCMax" 81 "FId_CcsPwrLineComChpTFrzVal" 82 "FId_CcsPwrLineComChpTPhysRng" 83 "FId_CcsPwrLineComChpTRplVal" 84 "FId_CcsPwrLineComChpTSSpMon" 85 "FId_CcsPwrLineComChpTTmpErrCnt" 86 "FId_ChgrPlugCtpSwtSnsrActrErr" 87 "FId_ChgrPlugLockActrErr" 88 "FId_ChgrPlugLockSnsrErr" 89 "FId_ChgrPlugPxp1InhbDiagSrc" 90 "FId_ChgrPlugTPinDcErr" 91 "FId_ChrgPlgChrgrRlyWlddCcs" 92 "FId_ChrgPlugCtpDetnErr" 93 "FId_ChrgnCntctPsFlt" 94 "FId_ChrgnLmpChrgnFlt" 95 "FId_ChrgnLmpNoChrgn" 96 "FId_ChrgnUnplRqrd" 97 "FId_ChrgrRlyDcActNegErr" 98 "FId_ChrgrRlyDcActPosErr" 99 "FId_CmbdChrgnSysCntctErr" 100 "FId_CoElMDSQCanEMS01" 101 "FId_CoElMErr01" 102 "FId_CoPOMLimdPrpnHmi" 103 "FId_CoPOMMaxLimFltDetnPrim" 104 "FId_CoPOMMinLimFltDetnPrim" 105 "FId_CoPOMNoPrpnHmi" 106 "FId_CoPOMRecupPwrRednHmi" 107 "FId_CoPOMRgnInhbnPrim" 108 "FId_CoVMEvSysCptMaxErrPrim01" 109 "FId_CoVMEvSysCptMaxErrPrim02" 110 "FId_CoVMEvSysCptMaxErrPrim03" 111 "FId_CoVMEvSysCptMaxErrPrim04" 112 "FId_CoVMEvSysCptMaxErrPrim05" 113 "FId_CoVMEvSysCptMinErrPrim01" 114 "FId_CoVMEvSysCptMinErrPrim02" 115 "FId_CoVMEvSysCptMinErrPrim03" 116 "FId_CoVMEvVehVVld" 117 "FId_ComHillHldFrmErr" 118 "FId_Com_stMainWkuInvld" 119 "FId_CtPSwtActrMonOff" 120 "FId_CtPSwtActrOff" 121 "FId_CtPSwtActrPsOff" 122 "FId_CtPSwtActrSnsr" 123 "FId_CtPSwtDiagEnhdSRCMax" 124 "FId_CtPSwtDiagFrzVal" 125 "FId_CtPSwtDiagPhysRng" 126 "FId_CtPSwtDiagRplVal" 127 "FId_CtPSwtDiagSSpMon" 128 "FId_CtPSwtDiagTmpErrCnt" 129 "FId_CtpCarrFrqFrzVal" 130 "FId_CtpCarrFrqPhysRng" 131 "FId_CtpCarrFrqRplVal" 132 "FId_CtpCarrFrqSSpMon" 133 "FId_CtpCarrFrqTmpErrCnt" 134 "FId_DELibAcChrgrIntkT" 135 "FId_DELibDcChrgrIntkT" 136 "FId_DELibEnvP" 137 "FId_DELibEnvT" 138 "FId_DELibHeatrCoreT" 139 "FId_DSMAUXWucVrnt5" 140 "FId_DcChrgnCtrlChrgPrmExch" 141 "FId_DcChrgrIntkT2EnhdSRCMax" 142 "FId_DcChrgrIntkT2FrzVal" 143 "FId_DcChrgrIntkT2PhysRng" 144 "FId_DcChrgrIntkT2RplVal" 145 "FId_DcChrgrIntkT2SSpMon" 146 "FId_DcChrgrIntkT2TmpErrCnt" 147 "FId_DcChrgrIntkTEnhdSRCMax" 148 "FId_DcChrgrIntkTFrzVal" 149 "FId_DcChrgrIntkTPhysRng" 150 "FId_DcChrgrIntkTRplVal" 151 "FId_DcChrgrIntkTSSpMon" 152 "FId_DcChrgrIntkTTmpErrCnt" 153 "FId_DcdcDesOperModFwd" 154 "FId_DcdcPwrLoadMngtMaxPred" 155 "FId_DcdcUDesLvGrid" 156 "FId_DcmDspUDSStPwrLatch" 157 "FId_DrvDoorCANSigFault" 158 "FId_DrvInfoEgyAvlErr" 159 "FId_DrvModPosnApp" 160 "FId_DrvPrgSwtEna" 161 "FId_DrvStbltCANSigFault" 162 "FId_EBDLmpSig" 163 "FId_EVLmpBlnkIllmn" 164 "FId_EVLmpContIllmn" 165 "FId_EbsLinErr" 166 "FId_EemDcdcPrecErr" 167 "FId_EemDcdcUHVAct" 168 "FId_EemFltHvDcha" 169 "FId_EemFstHvShdwn" 170 "FId_EemHvBattMod" 171 "FId_EemHvOffTout" 172 "FId_EemHvShdwn" 173 "FId_EemNoHvStrtup" 174 "FId_ElMNoPrp01" 175 "FId_ElMnLim01" 176 "FId_ElMtrqLim01" 177 "FId_ElSSACCmprUFlt" 178 "FId_ElSSCabAirHtUFlt" 179 "FId_ElSSHvReqEna" 180 "FId_ElSSUHvDcBus" 181 "FId_ElTSHvIntlck" 182 "FId_EmWakeupSigMonOff" 183 "FId_EmWakeupSigOff" 184 "FId_EmWakeupSigPsOff" 185 "FId_EmWakeupSigSnsr" 186 "FId_EmacUDcLnk01" 187 "FId_EvThermLTClgDmdErr" 188 "FId_EvThermMTClgDmdErr" 189 "FId_Fan1ActrOff" 190 "FId_Fan1Mon" 191 "FId_Fan1Off" 192 "FId_Fan1PsSwtOff" 193 "FId_Fan1PwrStg" 194 "FId_FanCtlFan1Err" 195 "FId_FanRlyDiagEnad" 196 "FId_FanSpdEnhdSRCMax" 197 "FId_FanSpdFrzVal" 198 "FId_FanSpdPhysRng" 199 "FId_FanSpdRplVal" 200 "FId_FanSpdSSpMon" 201 "FId_FanSpdTmpErrCnt" 202 "FId_FansFacCor" 203 "FId_FiMFID_rba_MRly_Diag_Stk" 204 "FId_FiMFID_test" 205 "FId_FreonPEnhdSRCMax" 206 "FId_FreonPFrzVal" 207 "FId_FreonPPhysRng" 208 "FId_FreonPRplVal" 209 "FId_FreonPSSpMon" 210 "FId_FreonPTmpErrCnt" 211 "FId_GlbDaLSumvXPtd" 212 "FId_HLCCcs_CoornPLnCChipTHi" 213 "FId_HLCCcs_CoornPLnCChpT" 214 "FId_HeatrCoreTEnhdSRCMax" 215 "FId_HeatrCoreTFrzVal" 216 "FId_HeatrCoreTPhysRng" 217 "FId_HeatrCoreTRplVal" 218 "FId_HeatrCoreTSSpMon" 219 "FId_HeatrCoreTTmpErrCnt" 220 "FId_HvBattChrgLvl3DernFlt" 221 "FId_HvBattDchaLvl3DernFlt" 222 "FId_HvBattDesChrgIDern" 223 "FId_HvBattMaiSwtDiagEna" 224 "FId_HvBattMaxPwrBusTDern" 225 "FId_HvBattNegCntctrCnt" 226 "FId_HvBattPosCntctrCnt" 227 "FId_HvBattPrecCntctrCnt" 228 "FId_HvBattPwrDistbnTDern" 229 "FId_HvBattPwrDistbnTInhbn" 230 "FId_HvBattRatRSoh" 231 "FId_HvBattRatSoh" 232 "FId_HvGridAuxPwr01" 233 "FId_HvGridAuxPwr02" 234 "FId_HvGridAuxPwr03" 235 "FId_HvGridAuxPwr04" 236 "FId_HvGridDcdcPwr" 237 "FId_HvGridDcdcUSftyErr" 238 "FId_HvGridElM01USftyErr" 239 "FId_HvGridHvBattSftyLimErr" 240 "FId_HvGridMaiSwtErr" 241 "FId_HvGridPwrMaxChrgContnsErr" 242 "FId_HvGridPwrMaxChrgShoErr" 243 "FId_HvGridPwrMaxDchaContnsErr" 244 "FId_HvGridPwrMaxDchaShoErr" 245 "FId_HvacHmiFlt" 246 "FId_HvacModCoolgFlt" 247 "FId_HvacModHeatgFlt" 248 "FId_HvacPtcHeatrErr" 249 "FId_InhibitAlways" 250 "FId_InhibitNever" 251 "FId_IntlckChrgPlgActrOff" 252 "FId_IntlckChrgPlgHbrdgNotTstd" 253 "FId_IntlckChrgPlgHbrgOLErr" 254 "FId_IntlckChrgPlgMon" 255 "FId_IntlckChrgPlgPosnAdcInvld" 256 "FId_IntlckChrgPlgPsSwtOff" 257 "FId_IntlckChrgPlgPwrStg" 258 "FId_IntlckChrgPlg_VehvErr" 259 "FId_LvGridSocErr" 260 "FId_LvGridTErr" 261 "FId_LvGridTestPlsReq" 262 "FId_LvGridUErr" 263 "FId_MedTPmpFlt" 264 "FId_MedTPmpPwrCtrlRly" 265 "FId_MstWrnLmpBlink" 266 "FId_MstWrnLmpChime" 267 "FId_MstWrnLmpContIllmn" 268 "FId_PEnvCc" 269 "FId_PEnvEnaBndMdl" 270 "FId_PEnvMeasVld" 271 "FId_PEnvPlaus" 272 "FId_PEnvPrc" 273 "FId_PEnvRefSnsr" 274 "FId_PEnvSigRngVld" 275 "FId_PEnvSnsrPlaus" 276 "FId_PerfLimnActvLmpBlink" 277 "FId_PerfLimnActvLmpCont" 278 "FId_PerfLimnActvLmpContNoChime" 279 "FId_PwmCtPFrzVal" 280 "FId_PwmCtPPhysRng" 281 "FId_PwmCtPRplVal" 282 "FId_PwmCtPSSpMon" 283 "FId_PwmCtPTmpErrCnt" 284 "FId_PwrDistbnUnitTEnhdSRCMax" 285 "FId_PwrDistbnUnitTFrzVal" 286 "FId_PwrDistbnUnitTPhysRng" 287 "FId_PwrDistbnUnitTRplVal" 288 "FId_PwrDistbnUnitTSSpMon" 289 "FId_PwrDistbnUnitTTmpErrCnt" 290 "FId_SCtPmp1ActrOff" 291 "FId_SCtPmp1CircErr" 292 "FId_SCtPmp1Mon" 293 "FId_SCtPmp1Off" 294 "FId_SCtPmp1PsErr" 295 "FId_SCtPmp1PsSwtOff" 296 "FId_SCtPmp1PwrStg" 297 "FId_SCtPmp1QlySensFrzn" 298 "FId_SCtPmp1QlySensRplVal" 299 "FId_SCtPmp1_VehvErr" 300 "FId_SCtPmpRlyActrOff" 301 "FId_SCtPmpRlyMon" 302 "FId_SCtPmpRlyOff" 303 "FId_SCtPmpRlyPsSwtOff" 304 "FId_SCtPmpRlyPwrStg" 305 "FId_SVSWrnLmpBlnkIllmn" 306 "FId_SVSWrnLmpContIllmn" 307 "FId_SpplCooltPmpRlyActrOff" 308 "FId_SpplCooltPmpRlyMon" 309 "FId_SpplCooltPmpRlyOff" 310 "FId_SpplCooltPmpRlyPsSwtOff" 311 "FId_SpplCooltPmpRlyPwrStg" 312 "FId_StrtUpEvDrvAwy" 313 "FId_TelltlCooltTErr" 314 "FId_TelltlCooltTMon" 315 "FId_ThermHvacPreCdngFlt" 316 "FId_ThermModCritErr" 317 "FId_UCtPEnhdSRCMax" 318 "FId_UCtPFrzVal" 319 "FId_UCtPPhysRng" 320 "FId_UCtPRplVal" 321 "FId_UCtPSSpMon" 322 "FId_UCtPTmpErrCnt" 323 "FId_UPxP1EnhdSRCMax" 324 "FId_UPxP1FrzVal" 325 "FId_UPxP1PhysRng" 326 "FId_UPxP1RplVal" 327 "FId_UPxP1SSpMon" 328 "FId_UPxP1TmpErrCnt" 329 "FId_VMSIEvBrkFlt" 330 "FId_VMSIEvDCSRampShOff01" 331 "FId_VMSIEvDCSShOff01" 332 "FId_VMSIEvTCSRampShOff01" 333 "FId_VMSIEvTCSShOff01" 334 "FId_VMSIEvTVRampShOff01" 335 "FId_VMSIEvTVShOff01" 336 "FId_VacPmpErr" 337 "FId_VehCoornAuxAvrgEnvT" 338 "FId_VehCoornAuxAvrgPwr" 339 "FId_VehCoornAuxAvrgT" 340 "FId_VehCoornAuxAvrgVehV" 341 "FId_VehCoornDstRngPrdcDispDft" 342 "FId_VehCoornEgyRmn" 343 "FId_VehCoornErrExclChrg" 344 "FId_VehCoornErrExclDrv" 345 "FId_VehCoornHVErr" 346 "FId_VehCoornHvReq" 347 "FId_VehCoornImobTrqInhbn" 348 "FId_VehCoornPrpAvrg" 349 "FId_VehCoornRngPrdcAuxPwr" 350 "FId_VehCoornSigQualVehV" 351 "FId_VehVCANFrzVal" 352 "FId_VehVCANReplVal" 353 "FId_VehVCanSafeFrzVal" 354 "FId_VehVCanSafeReplVal" 355 "FId_VehVFrzVal" 356 "FId_VehVNActPhy01Dfct" 357 "FId_VehVReplVal" 358 "FId_VehVSigCan" 359 "FId_VehVSigCanSafe" 360 "FId_WtrPmp1Err" 361 "FId_bInhCanEif_HVBAT_NGTV_CONTACTOR_STS" 362 "FId_bInhCanEif_HVBAT_PRECHRG_CONTACTOR_STS" 363 "FId_bInhCanEif_HVBAT_PSTV_CONTACTOR_STS" 364 "FId_bInhCanEif_VCU_eBCCM_432h" 365 "FId_bInhCdtSpdVehImmo" 366 "FId_bInhComGw_Com_BMS_REMAININGBATTCAPACITY" 367 "FId_bInhComGw_Com_CONTACT_FREIN_PRK" 368 "FId_bInhComGw_Com_DCDC_IP_POWER" 369 "FId_bInhComGw_Com_HVBAT_ALERT_LOW_BATT_ENERGY" 370 "FId_bInhComGw_Com_HVBAT_CHARGING_STATUS" 371 "FId_bInhComGw_Com_HVBAT_SOC" 372 "FId_bInhComGw_Com_HVBAT_TEMPERATURE" 373 "FId_bInhComGw_Com_HVBAT_THERMAL_RUNAWAY" 374 "FId_bInhComGw_Com_HV_BATT_CELL_VOLT_MAX" 375 "FId_bInhComGw_Com_HV_BATT_CELL_VOLT_MIN" 376 "FId_bInhComGw_Com_HV_BATT_INSULATION_RESISTANCE" 377 "FId_bInhComGw_Com_HV_BATT_INSUL_FAILURE" 378 "FId_bInhComGw_Com_HV_BATT_INTERLOCK_LINE" 379 "FId_bInhComGw_Com_HV_BATT_MIN_VOLT_WARN" 380 "FId_bInhComGw_Com_HV_BATT_NB_CELL_VOLT_MAX" 381 "FId_bInhComGw_Com_HV_BATT_NB_CELL_VOLT_MIN" 382 "FId_bInhComGw_Com_HV_BATT_SOC" 383 "FId_bInhComGw_Com_HV_BATT_SOC_5C3" 384 "FId_bInhComGw_Com_HV_BATT_SOH_CAPA" 385 "FId_bInhComGw_Com_HV_BATT_SOH_RES" 386 "FId_bInhComGw_Com_HV_BATT_TEMP_AVG" 387 "FId_bInhComGw_Com_INV_MTR_INST_INPUT_POWER" 388 "FId_bInhComGw_Com_PEM_ENGINE_RPM" 389 "FId_bInhComGw_Com_PEM_ESTIM_TRQ" 390 "FId_bInhComGw_Com_PEM_INVERTER_TEMP" 391 "FId_bInhComGw_Com_PEM_INVERTOR_ALERT_TEMP" 392 "FId_bInhComGw_Com_PEM_OVERTEMP_FAILURE" 393 "FId_bInhComGw_Com_PEM_STATOR_TEMP" 394 "FId_bInhComGw_Com_VITESSE_VEHICULE_ROUES" 395 "FId_bInhComGw_Com_VVH_INDISP" 396 "FId_bInhComGw_Com_eCOMP_Power_consumption" 397 "FId_bInhComGw_MAIN_RELAY_ACTUATION_COUNTER" 398 "FId_bInhComGw_TIME_HV_BATT_OVER_TEMPERATURE" 399 "FId_bInhComGw_TOTAL_HV_BATT_POS_QTY_CURR" 400 "FId_bInhDiag_CLUSTER_5E7" 401 "FId_bInhDiag_CONTEXTE_1_5B2" 402 "FId_bInhDiag_DAT3_BSI_4F2h" 403 "FId_bInhDiag_DCDC_283h" 404 "FId_bInhDiag_DCDC_293h" 405 "FId_bInhDiag_DCDC_473h" 406 "FId_bInhDiag_DCDC_663h" 407 "FId_bInhDiag_HS3_AUTO_GEARBOX_SWITCH_STATUS" 408 "FId_bInhDiag_HVAC_PANEL_26h" 409 "FId_bInhDiag_HVBAT_205h" 410 "FId_bInhDiag_HVBAT_275h" 411 "FId_bInhDiag_HVBAT_285h" 412 "FId_bInhDiag_HVBAT_325h" 413 "FId_bInhDiag_HVBAT_335h" 414 "FId_bInhDiag_HVBAT_455h" 415 "FId_bInhDiag_HVBAT_535" 416 "FId_bInhDiag_HVBAT_595h" 417 "FId_bInhDiag_HVBAT_635h" 418 "FId_bInhDiag_HVBAT_645h" 419 "FId_bInhDiag_HVBAT_665h" 420 "FId_bInhDiag_HVBAT_675h" 421 "FId_bInhDiag_HVBAT_THERMAL_5B5" 422 "FId_bInhDiag_HVBAT_VCU_435h" 423 "FId_bInhDiag_HVBAT_VCU_543" 424 "FId_bInhDiag_HVBAT_VCU_583" 425 "FId_bInhDiag_INV_217h" 426 "FId_bInhDiag_INV_227h" 427 "FId_bInhDiag_INV_237" 428 "FId_bInhDiag_INV_427h" 429 "FId_bInhDiag_INV_497h" 430 "FId_bInhDiag_INV_IMMO_5C7" 431 "FId_bInhDiag_IS_DAT6_BSI_592h" 432 "FId_bInhDiag_IS_DAT_ABR_50Dh" 433 "FId_bInhDiag_IS_DAT_BSI_412h" 434 "FId_bInhDiag_IS_DYN_ABR_38Dh" 435 "FId_bInhDiag_IS_INTE_ELECTRON_BSI_092h" 436 "FId_bInhDiag_OBC_273h" 437 "FId_bInhDiag_OBC_453h" 438 "FId_bInhDiag_OBC_463h" 439 "FId_bInhDiag_PDU_BusVoltages_308" 440 "FId_bInhDiag_PDU_Current_318" 441 "FId_bInhDiag_SC_INFO_BCCM_442h" 442 "FId_bInhDiag_VCU_AIRBAG_351h" 443 "FId_bInhDiag_VCU_eBCCM_432h" 444 "FId_bInhDiag_VCU_eBCCM_552h" 445 "FId_bInhDiag_eBCCM_082h" 446 "FId_bInhDiag_eCOMP_Information_47B" 447 "FId_bInhDiag_eCOMP_Information_48B" 448 "FId_bInhFrbd_ComChrgr_iAcMax" 449 "FId_bInhFrbd_ComChrgr_iDcHvAct" 450 "FId_bInhFrbd_ComChrgr_pwrInAct" 451 "FId_bInhFrbd_ComChrgr_pwrOutpCpby" 452 "FId_bInhFrbd_ComChrgr_tChrgrMaxAct" 453 "FId_bInhFrbd_ComChrgr_uAcActL1" 454 "FId_bInhFrbd_ComChrgr_uDcHvAct" 455 "FId_bInhFrbd_ComEmac_iDcLnk01" 456 "FId_bInhFrbd_ComEmac_nAct01" 457 "FId_bInhFrbd_ComEmac_pwrInstnsInpRx" 458 "FId_bInhFrbd_ComEmac_stActvDcha" 459 "FId_bInhFrbd_ComEmac_stEVLmp" 460 "FId_bInhFrbd_ComEmac_stIvtrOpMod01" 461 "FId_bInhFrbd_ComEmac_stMod01Rx" 462 "FId_bInhFrbd_ComEmac_stMstWrnLmp" 463 "FId_bInhFrbd_ComEmac_stSVSLmp" 464 "FId_bInhFrbd_ComEmac_tqAbsltMax01" 465 "FId_bInhFrbd_ComEmac_tqAbsltMaxRx01" 466 "FId_bInhFrbd_ComEmac_tqAbsltMin01" 467 "FId_bInhFrbd_ComEmac_tqAbsltMinRx01" 468 "FId_bInhFrbd_ComEmac_tqAckd01" 469 "FId_bInhFrbd_ComEmac_tqAct01" 470 "FId_bInhFrbd_ComEmac_tqPtd01" 471 "FId_bInhFrbd_ComEmac_tqStabnMin" 472 "FId_bInhFrbd_ComEmac_uDcLnk01" 473 "FId_bInhFrbd_Com_HvbMaxSnsrTempRx" 474 "FId_bInhFrbd_Com_ctHvbNegCntctrSeg1" 475 "FId_bInhFrbd_Com_ctHvbNegCntctrSeg3" 476 "FId_bInhFrbd_Com_ctHvbNegCntctrSeg4" 477 "FId_bInhFrbd_Com_ctHvbPosCntctrSeg1" 478 "FId_bInhFrbd_Com_ctHvbPosCntctrSeg3" 479 "FId_bInhFrbd_Com_ctHvbPosCntctrSeg4" 480 "FId_bInhFrbd_Com_ctHvbPrecCntctrSeg1" 481 "FId_bInhFrbd_Com_ctHvbPrecCntctrSeg2" 482 "FId_bInhFrbd_Com_egyHvbAvl_fRx" 483 "FId_bInhFrbd_Com_flgEcoNormReqRx" 484 "FId_bInhFrbd_Com_iBattEBS1Rx" 485 "FId_bInhFrbd_Com_iBattEBS2Rx" 486 "FId_bInhFrbd_Com_iBattEBS3Rx" 487 "FId_bInhFrbd_Com_iDcdcHvActRvsn1" 488 "FId_bInhFrbd_Com_iDcdcLvActRvsn1" 489 "FId_bInhFrbd_Com_iElCmprHvAct" 490 "FId_bInhFrbd_Com_iElCmprPeakPha" 491 "FId_bInhFrbd_Com_iHvbActRx" 492 "FId_bInhFrbd_Com_iHvbChrgMaxSho" 493 "FId_bInhFrbd_Com_iHvbDchaMaxSho" 494 "FId_bInhFrbd_Com_iHvbDes" 495 "FId_bInhFrbd_Com_iHvbNomChrgn" 496 "FId_bInhFrbd_Com_nElCmprActl" 497 "FId_bInhFrbd_Com_nrSerMaxCell" 498 "FId_bInhFrbd_Com_nrSerMinCell" 499 "FId_bInhFrbd_Com_pwrDcdcOutpCpby" 500 "FId_bInhFrbd_Com_pwrElCmprActl" 501 "FId_bInhFrbd_Com_pwrMaxChrgSho" 502 "FId_bInhFrbd_Com_pwrMaxDchaSho" 503 "FId_bInhFrbd_Com_qHvbTotCpRx" 504 "FId_bInhFrbd_Com_rHvbIsoMeasmt" 505 "FId_bInhFrbd_Com_ratHvbSoc" 506 "FId_bInhFrbd_Com_ratHvbSoh" 507 "FId_bInhFrbd_Com_ratRHvbSoh" 508 "FId_bInhFrbd_Com_ratSocLvBatt" 509 "FId_bInhFrbd_Com_stElCmprFltLvl" 510 "FId_bInhFrbd_Com_stGearLvrPos" 511 "FId_bInhFrbd_Com_stIIvtrFltLvl01" 512 "FId_bInhFrbd_Com_steTogFailrLvl" 513 "FId_bInhFrbd_Com_tDcdcAct" 514 "FId_bInhFrbd_Com_tDcdcInltCoolt" 515 "FId_bInhFrbd_Com_tElCmprActl" 516 "FId_bInhFrbd_Com_tEnvT" 517 "FId_bInhFrbd_Com_tHvbAct" 518 "FId_bInhFrbd_Com_tHvbMax" 519 "FId_bInhFrbd_Com_tLvBatt" 520 "FId_bInhFrbd_Com_tiHvbChrgnHalfRx" 521 "FId_bInhFrbd_Com_uBattEBSRx" 522 "FId_bInhFrbd_Com_uDcdcHvAct" 523 "FId_bInhFrbd_Com_uDcdcLvAct" 524 "FId_bInhFrbd_Com_uElCmprHvAct" 525 "FId_bInhFrbd_Com_uHvbAct" 526 "FId_bInhFrbd_Com_uHvbDcBus" 527 "FId_bInhFrbd_Com_uHvbLimHi" 528 "FId_bInhFrbd_Com_uHvbMaxCell" 529 "FId_bInhFrbd_Com_uHvbMinCell" 530 "FId_bInhFrbd_Com_uHvbNomChrgn" 531 "FId_bInhInvld_ComChrgr_flgChrgrErrLvl" 532 "FId_bInhInvld_ComChrgr_iAcMax" 533 "FId_bInhInvld_ComChrgr_iDcHvAct" 534 "FId_bInhInvld_ComChrgr_pwrInAct" 535 "FId_bInhInvld_ComChrgr_pwrOutpCpby" 536 "FId_bInhInvld_ComChrgr_tChrgrMaxAct" 537 "FId_bInhInvld_ComChrgr_uAcActL1" 538 "FId_bInhInvld_ComChrgr_uDcHvAct" 539 "FId_bInhInvld_ComEmac_iDcLnk01" 540 "FId_bInhInvld_ComEmac_nAct01" 541 "FId_bInhInvld_ComEmac_pwrInstnsInpRx" 542 "FId_bInhInvld_ComEmac_stActvDcha" 543 "FId_bInhInvld_ComEmac_stIvtrOpMod01" 544 "FId_bInhInvld_ComEmac_tInvr01" 545 "FId_bInhInvld_ComEmac_tIvtrCooltIn01" 546 "FId_bInhInvld_ComEmac_tMac01" 547 "FId_bInhInvld_ComEmac_tqAbsltMax01" 548 "FId_bInhInvld_ComEmac_tqAbsltMaxRx01" 549 "FId_bInhInvld_ComEmac_tqAbsltMin01" 550 "FId_bInhInvld_ComEmac_tqAbsltMinRx01" 551 "FId_bInhInvld_ComEmac_tqAckd01" 552 "FId_bInhInvld_ComEmac_tqAct01" 553 "FId_bInhInvld_ComEmac_tqPtd01" 554 "FId_bInhInvld_ComEmac_tqStabnMin" 555 "FId_bInhInvld_ComEmac_uDcLnk01" 556 "FId_bInhInvld_Com_HvbMaxSnsrTempRx" 557 "FId_bInhInvld_Com_ctHvbNegCntctrSeg1" 558 "FId_bInhInvld_Com_ctHvbNegCntctrSeg3" 559 "FId_bInhInvld_Com_ctHvbNegCntctrSeg4" 560 "FId_bInhInvld_Com_ctHvbPosCntctrSeg1" 561 "FId_bInhInvld_Com_ctHvbPosCntctrSeg3" 562 "FId_bInhInvld_Com_ctHvbPosCntctrSeg4" 563 "FId_bInhInvld_Com_ctHvbPrecCntctrSeg1" 564 "FId_bInhInvld_Com_ctHvbPrecCntctrSeg2" 565 "FId_bInhInvld_Com_egyHvbAvl_fRx" 566 "FId_bInhInvld_Com_flgEcoNormReqRx" 567 "FId_bInhInvld_Com_flgVehSpdAvl" 568 "FId_bInhInvld_Com_iBattEBS1Rx" 569 "FId_bInhInvld_Com_iBattEBS2Rx" 570 "FId_bInhInvld_Com_iBattEBS3Rx" 571 "FId_bInhInvld_Com_iDcdcHvActRvsn1" 572 "FId_bInhInvld_Com_iDcdcLvActRvsn1" 573 "FId_bInhInvld_Com_iElCmprHvAct" 574 "FId_bInhInvld_Com_iElCmprPeakPha" 575 "FId_bInhInvld_Com_iHvbActRx" 576 "FId_bInhInvld_Com_iHvbChrgMaxSho" 577 "FId_bInhInvld_Com_iHvbDchaMaxSho" 578 "FId_bInhInvld_Com_iHvbDes" 579 "FId_bInhInvld_Com_iHvbNomChrgn" 580 "FId_bInhInvld_Com_lDstGlbDa" 581 "FId_bInhInvld_Com_lTotOdometer" 582 "FId_bInhInvld_Com_nElCmprActl" 583 "FId_bInhInvld_Com_nrSerMaxCell" 584 "FId_bInhInvld_Com_nrSerMinCell" 585 "FId_bInhInvld_Com_pwrDcdcOutpCpby" 586 "FId_bInhInvld_Com_pwrElCmprActl" 587 "FId_bInhInvld_Com_pwrMaxChrgSho" 588 "FId_bInhInvld_Com_pwrMaxDchaSho" 589 "FId_bInhInvld_Com_qHvbTotCpRx" 590 "FId_bInhInvld_Com_rHvbIsoMeasmt" 591 "FId_bInhInvld_Com_ratHvbSoc" 592 "FId_bInhInvld_Com_ratHvbSoh" 593 "FId_bInhInvld_Com_ratRHvbSoh" 594 "FId_bInhInvld_Com_ratSocLvBatt" 595 "FId_bInhInvld_Com_stAC" 596 "FId_bInhInvld_Com_stAlrtThermRunAwy" 597 "FId_bInhInvld_Com_stBlowrRly" 598 "FId_bInhInvld_Com_stDcdcFltLvl" 599 "FId_bInhInvld_Com_stEvapTFlt" 600 "FId_bInhInvld_Com_stGearLvrPos" 601 "FId_bInhInvld_Com_stHvacBlwrFront" 602 "FId_bInhInvld_Com_stHvacKnobPosn" 603 "FId_bInhInvld_Com_stHvacPanPotiFlt" 604 "FId_bInhInvld_Com_stHvbChrgn" 605 "FId_bInhInvld_Com_stHvbDiscnctReas" 606 "FId_bInhInvld_Com_stHvbIntlckRx" 607 "FId_bInhInvld_Com_stHvbIsoFltRx" 608 "FId_bInhInvld_Com_stHvbSrvPlgRx" 609 "FId_bInhInvld_Com_stIBattEBS" 610 "FId_bInhInvld_Com_stIIvtrFltLvl01" 611 "FId_bInhInvld_Com_stMainWkuReq" 612 "FId_bInhInvld_Com_stReFogReq" 613 "FId_bInhInvld_Com_stSocRx" 614 "FId_bInhInvld_Com_stT" 615 "FId_bInhInvld_Com_tDcdcAct" 616 "FId_bInhInvld_Com_tDcdcInltCoolt" 617 "FId_bInhInvld_Com_tElCmprActl" 618 "FId_bInhInvld_Com_tEnvT" 619 "FId_bInhInvld_Com_tEvapT" 620 "FId_bInhInvld_Com_tHvbAct" 621 "FId_bInhInvld_Com_tHvbMax" 622 "FId_bInhInvld_Com_tLvBatt" 623 "FId_bInhInvld_Com_tiCurVehTmr" 624 "FId_bInhInvld_Com_tiHvbChrgnHalfRx" 625 "FId_bInhInvld_Com_uBattEBSRx" 626 "FId_bInhInvld_Com_uDcdcHvAct" 627 "FId_bInhInvld_Com_uDcdcLvAct" 628 "FId_bInhInvld_Com_uElCmprHvAct" 629 "FId_bInhInvld_Com_uHvbAct" 630 "FId_bInhInvld_Com_uHvbDcBus" 631 "FId_bInhInvld_Com_uHvbLimHi" 632 "FId_bInhInvld_Com_uHvbMaxCell" 633 "FId_bInhInvld_Com_uHvbMinCell" 634 "FId_bInhInvld_Com_uHvbNomChrgn" 635 "FId_bInhInvld_Com_vVeh" 636 "FId_bInh_ACCmpr_pwrLimMax" 637 "FId_bInh_ACCtl_flgCmprEna" 638 "FId_bInh_ACCtl_nCmprSpdReq" 639 "FId_bInh_APP_rInp" 640 "FId_bInh_BattId_numOrganNature1" 641 "FId_bInh_BattId_numOrganNature2" 642 "FId_bInh_BattId_numOrganRef1" 643 "FId_bInh_BattId_numOrganRef2" 644 "FId_bInh_BattId_numOrganRef3" 645 "FId_bInh_BattId_numOrganRef4" 646 "FId_bInh_BattId_numSerl1" 647 "FId_bInh_BattId_numSerl2" 648 "FId_bInh_BattId_numSerl3" 649 "FId_bInh_BattId_numSerl4" 650 "FId_bInh_BattId_numSerl5" 651 "FId_bInh_BattId_numSerl6" 652 "FId_bInh_BattId_numSerl7" 653 "FId_bInh_Brk_stRed" 654 "FId_bInh_CbnHeatgHeatr_cntrRlyLf" 655 "FId_bInh_ChgrPlug_stPlgLockTx" 656 "FId_bInh_ChrgCntct_nrNegCntctElpdOper" 657 "FId_bInh_ChrgCntct_nrPosCntctElpdOper" 658 "FId_bInh_ChrgrRly_stRlyDes" 659 "FId_bInh_ChrgrVal_iChrgrDes" 660 "FId_bInh_ChrgrVal_iGridLimMax" 661 "FId_bInh_ChrgrVal_uHvMax" 662 "FId_bInh_CoDrvPITh_stEPSModeReq" 663 "FId_bInh_CoPtFH_stPwt" 664 "FId_bInh_ComChrg_stMod" 665 "FId_bInh_ComChrgn_iDcRly_Sq_Frz" 666 "FId_bInh_ComChrgn_uDcRly_Sq_Frz" 667 "FId_bInh_ComChrgr_flgChrgrErr_Sq_Frz" 668 "FId_bInh_ComChrgr_iAcMax_Sq_Frz" 669 "FId_bInh_ComChrgr_iDcHvAct_Sq_Frz" 670 "FId_bInh_ComChrgr_pwrInAct_Sq_Frz" 671 "FId_bInh_ComChrgr_stChrgnEna" 672 "FId_bInh_ComChrgr_stChrgr_Sq_Frz" 673 "FId_bInh_ComChrgr_tChrgrMaxAct_Sq_Frz" 674 "FId_bInh_ComChrgr_uAcActL1_Sq_Frz" 675 "FId_bInh_ComChrgr_uDcHvAct_Sq_Frz" 676 "FId_bInh_ComEmac_flgSvsReq01_Sq_Frz" 677 "FId_bInh_ComEmac_tIvtrCoolt01_Sq_Frz" 678 "FId_bInh_Com_25h_B1b0" 679 "FId_bInh_Com_25h_B1b2" 680 "FId_bInh_Com_25h_B1b4" 681 "FId_bInh_Com_25h_B1b6" 682 "FId_bInh_Com_HvbMaxSnsrTempTx" 683 "FId_bInh_Com_TogLedDrv" 684 "FId_bInh_Com_TogLedMod" 685 "FId_bInh_Com_TogLedNeut" 686 "FId_bInh_Com_TogLedRvs" 687 "FId_bInh_Com_bAcLedReq" 688 "FId_bInh_Com_bDiagMuxCAN" 689 "FId_bInh_Com_bGunCntInfoWkuReq" 690 "FId_bInh_Com_bHvBattRchrgWkuReq" 691 "FId_bInh_Com_bPostOperationWkuReq" 692 "FId_bInh_Com_bReFogRlySt" 693 "FId_bInh_Com_flgBlowrAuthn" 694 "FId_bInh_Com_flgBlowrRlyCtrl" 695 "FId_bInh_Com_flgBrkAlrt" 696 "FId_bInh_Com_flgDrvAwy" 697 "FId_bInh_Com_flgVehSpdQly" 698 "FId_bInh_Com_iDcdcHvActRvsn1_Sq_Frz" 699 "FId_bInh_Com_iDcdcLvActRvsn1_Sq_Frz" 700 "FId_bInh_Com_iElCmprHvAct_Sq_Frz" 701 "FId_bInh_Com_iHvbActTx" 702 "FId_bInh_Com_nElCmprActlTx" 703 "FId_bInh_Com_nIvtrMotAct01" 704 "FId_bInh_Com_noEditCal" 705 "FId_bInh_Com_noEditSw" 706 "FId_bInh_Com_noVerSysDay" 707 "FId_bInh_Com_noVersAdp" 708 "FId_bInh_Com_noVersSw" 709 "FId_bInh_Com_noVersSys" 710 "FId_bInh_Com_noVersSysMnth" 711 "FId_bInh_Com_noVersSysYr" 712 "FId_bInh_Com_ratHvbSoh_Sq_Frz" 713 "FId_bInh_Com_stACTx" 714 "FId_bInh_Com_stBrk" 715 "FId_bInh_Com_stBrkBstPFlt" 716 "FId_bInh_Com_stBrkCntctIndcn" 717 "FId_bInh_Com_stChrgPlg" 718 "FId_bInh_Com_stChrgPlgChrgn" 719 "FId_bInh_Com_stClstrStopIndcn" 720 "FId_bInh_Com_stCmdHvBattCntctr" 721 "FId_bInh_Com_stCmdOffsEM01" 722 "FId_bInh_Com_stDcdcOperModAct_Sq_Frz" 723 "FId_bInh_Com_stDrvAwyDi" 724 "FId_bInh_Com_stDrvModPosn" 725 "FId_bInh_Com_stEVLmp" 726 "FId_bInh_Com_stElCmprStatTx" 727 "FId_bInh_Com_stElMDesEem" 728 "FId_bInh_Com_stHvBattOperModDes" 729 "FId_bInh_Com_stHvacBlwrFront_CAN" 730 "FId_bInh_Com_stHvacKnobPosn_CAN" 731 "FId_bInh_Com_stMstWrnLmp" 732 "FId_bInh_Com_stNwCmdLIN" 733 "FId_bInh_Com_stPwrLimnLmp" 734 "FId_bInh_Com_stReFogReq_CAN" 735 "FId_bInh_Com_stSrvLmp" 736 "FId_bInh_Com_stVehCoorn" 737 "FId_bInh_Com_tDcdcAct_Sq_Frz" 738 "FId_bInh_Com_tDcdcInltCoolt_Sq" 739 "FId_bInh_Com_tqMotLimMax" 740 "FId_bInh_Com_uDcdcHvAct_Sq_Frz" 741 "FId_bInh_Com_uDcdcLvAct_Sq_Frz" 742 "FId_bInh_Com_uHvbActTx" 743 "FId_bInh_Com_valEepOffsEM01" 744 "FId_bInh_DcChrgnRly_ctMaxOperCyc" 745 "FId_bInh_Dcdc_flgDesLvGridULim" 746 "FId_bInh_Dcdc_iLimLvGrid" 747 "FId_bInh_Dcdc_stDesDcdc" 748 "FId_bInh_Dcdc_uDesLvGrid" 749 "FId_bInh_DrvInfo_wTotTripEgy" 750 "FId_bInh_EChrDv_cntPlin" 751 "FId_bInh_Eem_flgFstHvShdwn" 752 "FId_bInh_ElM_stDesEem01" 753 "FId_bInh_ElTS_egyTotChrgCyc" 754 "FId_bInh_ElTS_ratEmPowChrgn" 755 "FId_bInh_ElTS_ratEmPowDcha" 756 "FId_bInh_ElTS_stChrgCyc" 757 "FId_bInh_Emac_stIsoMonSwtReq" 758 "FId_bInh_Emac_tqDesCom01" 759 "FId_bInh_Ext_bSyncGPC" 760 "FId_bInh_HvBatt_flgIsoMeasmtDiReq" 761 "FId_bInh_HvBatt_ratSoc" 762 "FId_bInh_HvGrid_pwrMaxDcdc" 763 "FId_bInh_HvacPtc_stElHeatr" 764 "FId_bInh_Pdu_CLUSTER_5E7_Frz" 765 "FId_bInh_Pdu_CLUSTER_5E7_Rcf" 766 "FId_bInh_Pdu_CONTEXTE_1_5B2_Frz" 767 "FId_bInh_Pdu_CONTEXTE_1_5B2_Rcf" 768 "FId_bInh_Pdu_Com_pwrMaxChrgSho_Sq_Frz" 769 "FId_bInh_Pdu_Com_pwrMaxDchaSho_Sq_Frz" 770 "FId_bInh_Pdu_DAT3_BSI_4F2h_Frz" 771 "FId_bInh_Pdu_DAT3_BSI_4F2h_Rcf" 772 "FId_bInh_Pdu_DCDC_283h_Frz" 773 "FId_bInh_Pdu_DCDC_283h_Rcf" 774 "FId_bInh_Pdu_DCDC_293h_Frz" 775 "FId_bInh_Pdu_DCDC_293h_Rcf" 776 "FId_bInh_Pdu_DCDC_473h_Frz" 777 "FId_bInh_Pdu_DCDC_473h_Rcf" 778 "FId_bInh_Pdu_DCDC_663h_Frz" 779 "FId_bInh_Pdu_DCDC_663h_Rcf" 780 "FId_bInh_Pdu_HS3_AUTO_GEARBOX_SWITCH_STATUS_Frz" 781 "FId_bInh_Pdu_HS3_AUTO_GEARBOX_SWITCH_STATUS_Rcf" 782 "FId_bInh_Pdu_HVAC_PANEL_26h_Frz" 783 "FId_bInh_Pdu_HVAC_PANEL_26h_Rcf" 784 "FId_bInh_Pdu_HVBAT_205h_Frz" 785 "FId_bInh_Pdu_HVBAT_205h_Rcf" 786 "FId_bInh_Pdu_HVBAT_275h_Frz" 787 "FId_bInh_Pdu_HVBAT_275h_Rcf" 788 "FId_bInh_Pdu_HVBAT_285h_Frz" 789 "FId_bInh_Pdu_HVBAT_285h_Rcf" 790 "FId_bInh_Pdu_HVBAT_325h_Frz" 791 "FId_bInh_Pdu_HVBAT_325h_Rcf" 792 "FId_bInh_Pdu_HVBAT_335h_Frz" 793 "FId_bInh_Pdu_HVBAT_335h_Rcf" 794 "FId_bInh_Pdu_HVBAT_455h_Frz" 795 "FId_bInh_Pdu_HVBAT_455h_Rcf" 796 "FId_bInh_Pdu_HVBAT_535_Frz" 797 "FId_bInh_Pdu_HVBAT_535_Rcf" 798 "FId_bInh_Pdu_HVBAT_595h_Frz" 799 "FId_bInh_Pdu_HVBAT_595h_Rcf" 800 "FId_bInh_Pdu_HVBAT_635h_Frz" 801 "FId_bInh_Pdu_HVBAT_635h_Rcf" 802 "FId_bInh_Pdu_HVBAT_645h_Frz" 803 "FId_bInh_Pdu_HVBAT_645h_Rcf" 804 "FId_bInh_Pdu_HVBAT_665h_Frz" 805 "FId_bInh_Pdu_HVBAT_665h_Rcf" 806 "FId_bInh_Pdu_HVBAT_675h_Frz" 807 "FId_bInh_Pdu_HVBAT_675h_Rcf" 808 "FId_bInh_Pdu_HVBAT_THERMAL_5B5_Frz" 809 "FId_bInh_Pdu_HVBAT_THERMAL_5B5_Rcf" 810 "FId_bInh_Pdu_HVBAT_VCU_435h_Frz" 811 "FId_bInh_Pdu_HVBAT_VCU_435h_Rcf" 812 "FId_bInh_Pdu_HVBAT_VCU_543_Frz" 813 "FId_bInh_Pdu_HVBAT_VCU_543_Rcf" 814 "FId_bInh_Pdu_HVBAT_VCU_583_Frz" 815 "FId_bInh_Pdu_HVBAT_VCU_583_Rcf" 816 "FId_bInh_Pdu_INV_217h_Frz" 817 "FId_bInh_Pdu_INV_217h_Rcf" 818 "FId_bInh_Pdu_INV_227h_Frz" 819 "FId_bInh_Pdu_INV_227h_Rcf" 820 "FId_bInh_Pdu_INV_237_Frz" 821 "FId_bInh_Pdu_INV_237_Rcf" 822 "FId_bInh_Pdu_INV_427h_Frz" 823 "FId_bInh_Pdu_INV_427h_Rcf" 824 "FId_bInh_Pdu_INV_497h_Frz" 825 "FId_bInh_Pdu_INV_497h_Rcf" 826 "FId_bInh_Pdu_INV_IMMO_5C7_Frz" 827 "FId_bInh_Pdu_INV_IMMO_5C7_Rcf" 828 "FId_bInh_Pdu_IS_DAT6_BSI_592h_Frz" 829 "FId_bInh_Pdu_IS_DAT6_BSI_592h_Rcf" 830 "FId_bInh_Pdu_IS_DAT_ABR_50Dh_Frz" 831 "FId_bInh_Pdu_IS_DAT_ABR_50Dh_Rcf" 832 "FId_bInh_Pdu_IS_DAT_BSI_412h_Frz" 833 "FId_bInh_Pdu_IS_DAT_BSI_412h_Rcf" 834 "FId_bInh_Pdu_IS_DYN_ABR_38Dh_Frz" 835 "FId_bInh_Pdu_IS_DYN_ABR_38Dh_Rcf" 836 "FId_bInh_Pdu_IS_INTE_ELECTRON_BSI_092h_Frz" 837 "FId_bInh_Pdu_IS_INTE_ELECTRON_BSI_092h_Rcf" 838 "FId_bInh_Pdu_OBC_273h_Frz" 839 "FId_bInh_Pdu_OBC_273h_Rcf" 840 "FId_bInh_Pdu_OBC_453h_Frz" 841 "FId_bInh_Pdu_OBC_453h_Rcf" 842 "FId_bInh_Pdu_OBC_463h_Frz" 843 "FId_bInh_Pdu_OBC_463h_Rcf" 844 "FId_bInh_Pdu_PDU_BusVoltages_308_Frz" 845 "FId_bInh_Pdu_PDU_BusVoltages_308_Rcf" 846 "FId_bInh_Pdu_PDU_Current_318_Frz" 847 "FId_bInh_Pdu_PDU_Current_318_Rcf" 848 "FId_bInh_Pdu_SC_INFO_BCCM_442h_Frz" 849 "FId_bInh_Pdu_SC_INFO_BCCM_442h_Rcf" 850 "FId_bInh_Pdu_VCU_AIRBAG_351h_Frz" 851 "FId_bInh_Pdu_VCU_AIRBAG_351h_Rcf" 852 "FId_bInh_Pdu_VCU_AIRBAG_fault_Frz" 853 "FId_bInh_Pdu_VCU_eBCCM_432h_Frz" 854 "FId_bInh_Pdu_VCU_eBCCM_432h_Rcf" 855 "FId_bInh_Pdu_VCU_eBCCM_552h_Frz" 856 "FId_bInh_Pdu_VCU_eBCCM_552h_Rcf" 857 "FId_bInh_Pdu_eBCCM_082h_Frz" 858 "FId_bInh_Pdu_eBCCM_082h_Rcf" 859 "FId_bInh_Pdu_eCOMP_Information_47B_Frz" 860 "FId_bInh_Pdu_eCOMP_Information_47B_Rcf" 861 "FId_bInh_Pdu_eCOMP_Information_48B_Frz" 862 "FId_bInh_Pdu_eCOMP_Information_48B_Rcf" 863 "FId_bInh_Sig205h_Com_iHvbActRx_Frz" 864 "FId_bInh_Sig205h_Com_iHvbActRx_Rcf" 865 "FId_bInh_Sig205h_Com_ratHvbSoc_Frz" 866 "FId_bInh_Sig205h_Com_ratHvbSoc_Rcf" 867 "FId_bInh_Sig205h_Com_stHvbChrgn_Frz" 868 "FId_bInh_Sig205h_Com_stHvbChrgn_Rcf" 869 "FId_bInh_Sig205h_Com_uHvbAct_Frz" 870 "FId_bInh_Sig205h_Com_uHvbAct_Rcf" 871 "FId_bInh_Sig217h_ComEmac_nAct01_Frz" 872 "FId_bInh_Sig217h_ComEmac_nAct01_Rcf" 873 "FId_bInh_Sig217h_ComEmac_tqAckd01_Frz" 874 "FId_bInh_Sig217h_ComEmac_tqAckd01_Rcf" 875 "FId_bInh_Sig217h_ComEmac_tqAct01_Frz" 876 "FId_bInh_Sig217h_ComEmac_tqAct01_Rcf" 877 "FId_bInh_Sig217h_ComEmac_uDcLnk01_Frz" 878 "FId_bInh_Sig217h_ComEmac_uDcLnk01_Rcf" 879 "FId_bInh_Sig227h_ComEmac_iDcLnk01_Frz" 880 "FId_bInh_Sig227h_ComEmac_iDcLnk01_Rcf" 881 "FId_bInh_Sig227h_ComEmac_pwrInstnsInpRx_Frz" 882 "FId_bInh_Sig227h_ComEmac_pwrInstnsInpRx_Rcf" 883 "FId_bInh_Sig227h_ComEmac_tqAbsltMax01_Frz" 884 "FId_bInh_Sig227h_ComEmac_tqAbsltMax01_Rcf" 885 "FId_bInh_Sig227h_ComEmac_tqAbsltMaxRx01_Frz" 886 "FId_bInh_Sig227h_ComEmac_tqAbsltMaxRx01_Rcf" 887 "FId_bInh_Sig227h_ComEmac_tqAbsltMin01_Frz" 888 "FId_bInh_Sig227h_ComEmac_tqAbsltMin01_Rcf" 889 "FId_bInh_Sig227h_ComEmac_tqAbsltMinRx01_Frz" 890 "FId_bInh_Sig227h_ComEmac_tqAbsltMinRx01_Rcf" 891 "FId_bInh_Sig237h_ComEmac_stActvDcha_Frz" 892 "FId_bInh_Sig237h_ComEmac_stActvDcha_Rcf" 893 "FId_bInh_Sig237h_ComEmac_stEVLmp_Frz" 894 "FId_bInh_Sig237h_ComEmac_stEVLmp_Rcf" 895 "FId_bInh_Sig237h_ComEmac_stMod01Rx_Frz" 896 "FId_bInh_Sig237h_ComEmac_stMod01Rx_Rcf" 897 "FId_bInh_Sig237h_ComEmac_stMstWrnLmp_Frz" 898 "FId_bInh_Sig237h_ComEmac_stMstWrnLmp_Rcf" 899 "FId_bInh_Sig237h_ComEmac_stSVSLmp_Frz" 900 "FId_bInh_Sig237h_ComEmac_stSVSLmp_Rcf" 901 "FId_bInh_Sig237h_ComEmac_tqStabnMin_Frz" 902 "FId_bInh_Sig237h_ComEmac_tqStabnMin_Rcf" 903 "FId_bInh_Sig237h_Com_stIIvtrFltLvl01_Frz" 904 "FId_bInh_Sig237h_Com_stIIvtrFltLvl01_Rcf" 905 "FId_bInh_Sig259hFlt" 906 "FId_bInh_Sig259h_Com_flgEcoNormReqRx_Frz" 907 "FId_bInh_Sig259h_Com_flgEcoNormReqRx_Rcf" 908 "FId_bInh_Sig259h_Com_stGearLvrPos_Frz" 909 "FId_bInh_Sig259h_Com_stGearLvrPos_Rcf" 910 "FId_bInh_Sig259h_Com_steTogFailrLvl_Frz" 911 "FId_bInh_Sig259h_Com_steTogFailrLvl_Rcf" 912 "FId_bInh_Sig26h_Com_stAC_Frz" 913 "FId_bInh_Sig26h_Com_stAC_Rcf" 914 "FId_bInh_Sig26h_Com_stEvapTFlt_Frz" 915 "FId_bInh_Sig26h_Com_stEvapTFlt_Rcf" 916 "FId_bInh_Sig26h_Com_stHvacBlwrFront_Frz" 917 "FId_bInh_Sig26h_Com_stHvacBlwrFront_Rcf" 918 "FId_bInh_Sig26h_Com_stHvacKnobPosn_Frz" 919 "FId_bInh_Sig26h_Com_stHvacKnobPosn_Rcf" 920 "FId_bInh_Sig26h_Com_stHvacPanPotiFlt_Frz" 921 "FId_bInh_Sig26h_Com_stHvacPanPotiFlt_Rcf" 922 "FId_bInh_Sig26h_Com_stReFogReq_Frz" 923 "FId_bInh_Sig26h_Com_stReFogReq_Rcf" 924 "FId_bInh_Sig26h_Com_tEvapT_Frz" 925 "FId_bInh_Sig26h_Com_tEvapT_Rcf" 926 "FId_bInh_Sig273h_ComChrgr_flgChrgrErrLvl_Frz" 927 "FId_bInh_Sig273h_ComChrgr_flgChrgrErrLvl_Rcf" 928 "FId_bInh_Sig273h_ComChrgr_pwrOutpCpby_Frz" 929 "FId_bInh_Sig273h_ComChrgr_pwrOutpCpby_Rcf" 930 "FId_bInh_Sig275h_Com_iHvbDchaMaxSho_Frz" 931 "FId_bInh_Sig275h_Com_iHvbDchaMaxSho_Rcf" 932 "FId_bInh_Sig275h_Com_pwrMaxDchaSho_Frz" 933 "FId_bInh_Sig275h_Com_pwrMaxDchaSho_Rcf" 934 "FId_bInh_Sig283h_Com_iDcdcHvActRvsn1_Frz" 935 "FId_bInh_Sig283h_Com_iDcdcHvActRvsn1_Rcf" 936 "FId_bInh_Sig283h_Com_iDcdcLvActRvsn1_Frz" 937 "FId_bInh_Sig283h_Com_iDcdcLvActRvsn1_Rcf" 938 "FId_bInh_Sig283h_Com_uDcdcHvAct_Frz" 939 "FId_bInh_Sig283h_Com_uDcdcHvAct_Rcf" 940 "FId_bInh_Sig283h_Com_uDcdcLvAct_Frz" 941 "FId_bInh_Sig283h_Com_uDcdcLvAct_Rcf" 942 "FId_bInh_Sig285h_Com_iHvbChrgMaxSho_Frz" 943 "FId_bInh_Sig285h_Com_iHvbChrgMaxSho_Rcf" 944 "FId_bInh_Sig285h_Com_pwrMaxChrgSho_Frz" 945 "FId_bInh_Sig285h_Com_pwrMaxChrgSho_Rcf" 946 "FId_bInh_Sig293h_Com_pwrDcdcOutpCpby_Frz" 947 "FId_bInh_Sig293h_Com_pwrDcdcOutpCpby_Rcf" 948 "FId_bInh_Sig293h_Com_stDcdcFltLvl_Frz" 949 "FId_bInh_Sig293h_Com_stDcdcFltLvl_Rcf" 950 "FId_bInh_Sig325h_Com_rHvbIsoMeasmt_Frz" 951 "FId_bInh_Sig325h_Com_rHvbIsoMeasmt_Rcf" 952 "FId_bInh_Sig325h_Com_stHvbIntlckRx_Frz" 953 "FId_bInh_Sig325h_Com_stHvbIntlckRx_Rcf" 954 "FId_bInh_Sig325h_Com_stHvbIsoFltRx_Frz" 955 "FId_bInh_Sig325h_Com_stHvbIsoFltRx_Rcf" 956 "FId_bInh_Sig325h_Com_stHvbSrvPlgRx_Frz" 957 "FId_bInh_Sig325h_Com_stHvbSrvPlgRx_Rcf" 958 "FId_bInh_Sig325h_Com_tHvbMax_Frz" 959 "FId_bInh_Sig325h_Com_tHvbMax_Rcf" 960 "FId_bInh_Sig335h_Com_iHvbDes_Frz" 961 "FId_bInh_Sig335h_Com_iHvbDes_Rcf" 962 "FId_bInh_Sig335h_Com_iHvbNomChrgn_Frz" 963 "FId_bInh_Sig335h_Com_iHvbNomChrgn_Rcf" 964 "FId_bInh_Sig335h_Com_uHvbDcBus_Frz" 965 "FId_bInh_Sig335h_Com_uHvbDcBus_Rcf" 966 "FId_bInh_Sig335h_Com_uHvbLimHi_Frz" 967 "FId_bInh_Sig335h_Com_uHvbLimHi_Rcf" 968 "FId_bInh_Sig38Dh_Com_flgVehSpdAvl_Frz" 969 "FId_bInh_Sig38Dh_Com_flgVehSpdAvl_Rcf" 970 "FId_bInh_Sig38Dh_Com_vVeh_Frz" 971 "FId_bInh_Sig38Dh_Com_vVeh_Rcf" 972 "FId_bInh_Sig427h_ComEmac_stIvtrOpMod01_Frz" 973 "FId_bInh_Sig427h_ComEmac_stIvtrOpMod01_Rcf" 974 "FId_bInh_Sig427h_ComEmac_tInvr01_Frz" 975 "FId_bInh_Sig427h_ComEmac_tInvr01_Rcf" 976 "FId_bInh_Sig427h_ComEmac_tIvtrCooltIn01_Frz" 977 "FId_bInh_Sig427h_ComEmac_tIvtrCooltIn01_Rcf" 978 "FId_bInh_Sig427h_ComEmac_tMac01_Frz" 979 "FId_bInh_Sig427h_ComEmac_tMac01_Rcf" 980 "FId_bInh_Sig427h_ComEmac_tqPtd01_Frz" 981 "FId_bInh_Sig427h_ComEmac_tqPtd01_Rcf" 982 "FId_bInh_Sig432h_Com_stMainWkuReq_Frz" 983 "FId_bInh_Sig432h_Com_stMainWkuReq_Rcf" 984 "FId_bInh_Sig435h_Com_HvbMaxSnsrTempRx_Frz" 985 "FId_bInh_Sig435h_Com_HvbMaxSnsrTempRx_Rcf" 986 "FId_bInh_Sig435h_Com_nrSerMaxCell_Frz" 987 "FId_bInh_Sig435h_Com_nrSerMaxCell_Rcf" 988 "FId_bInh_Sig435h_Com_nrSerMinCell_Frz" 989 "FId_bInh_Sig435h_Com_nrSerMinCell_Rcf" 990 "FId_bInh_Sig435h_Com_uHvbMaxCell_Frz" 991 "FId_bInh_Sig435h_Com_uHvbMaxCell_Rcf" 992 "FId_bInh_Sig435h_Com_uHvbMinCell_Frz" 993 "FId_bInh_Sig435h_Com_uHvbMinCell_Rcf" 994 "FId_bInh_Sig442h_Com_stBlowrRly_Frz" 995 "FId_bInh_Sig442h_Com_stBlowrRly_Rcf" 996 "FId_bInh_Sig453h_ComChrgr_iAcMax_Frz" 997 "FId_bInh_Sig453h_ComChrgr_iAcMax_Rcf" 998 "FId_bInh_Sig453h_ComChrgr_pwrInAct_Frz" 999 "FId_bInh_Sig453h_ComChrgr_pwrInAct_Rcf" 1000 "FId_bInh_Sig453h_ComChrgr_uAcActL1_Frz" 1001 "FId_bInh_Sig453h_ComChrgr_uAcActL1_Rcf" 1002 "FId_bInh_Sig455h_Com_uHvbNomChrgn_Frz" 1003 "FId_bInh_Sig455h_Com_uHvbNomChrgn_Rcf" 1004 "FId_bInh_Sig463h_ComChrgr_iDcHvAct_Frz" 1005 "FId_bInh_Sig463h_ComChrgr_iDcHvAct_Rcf" 1006 "FId_bInh_Sig463h_ComChrgr_tChrgrMaxAct_Frz" 1007 "FId_bInh_Sig463h_ComChrgr_tChrgrMaxAct_Rcf" 1008 "FId_bInh_Sig463h_ComChrgr_uDcHvAct_Frz" 1009 "FId_bInh_Sig463h_ComChrgr_uDcHvAct_Rcf" 1010 "FId_bInh_Sig473h_Com_tDcdcAct_Frz" 1011 "FId_bInh_Sig473h_Com_tDcdcAct_Rcf" 1012 "FId_bInh_Sig473h_Com_tDcdcInltCoolt_Frz" 1013 "FId_bInh_Sig473h_Com_tDcdcInltCoolt_Rcf" 1014 "FId_bInh_Sig47Bh_Com_iElCmprHvAct_Frz" 1015 "FId_bInh_Sig47Bh_Com_iElCmprHvAct_Rcf" 1016 "FId_bInh_Sig47Bh_Com_iElCmprPeakPha_Frz" 1017 "FId_bInh_Sig47Bh_Com_iElCmprPeakPha_Rcf" 1018 "FId_bInh_Sig47Bh_Com_nElCmprActl_Frz" 1019 "FId_bInh_Sig47Bh_Com_nElCmprActl_Rcf" 1020 "FId_bInh_Sig47Bh_Com_pwrElCmprActl_Frz" 1021 "FId_bInh_Sig47Bh_Com_pwrElCmprActl_Rcf" 1022 "FId_bInh_Sig47Bh_Com_tElCmprActl_Frz" 1023 "FId_bInh_Sig47Bh_Com_tElCmprActl_Rcf" 1024 "FId_bInh_Sig47Bh_Com_uElCmprHvAct_Frz" 1025 "FId_bInh_Sig47Bh_Com_uElCmprHvAct_Rcf" 1026 "FId_bInh_Sig48Bh_Com_stElCmprFltLvl_Frz" 1027 "FId_bInh_Sig48Bh_Com_stElCmprFltLvl_Rcf" 1028 "FId_bInh_Sig4F2h_Com_ratSocLvBatt_Frz" 1029 "FId_bInh_Sig4F2h_Com_ratSocLvBatt_Rcf" 1030 "FId_bInh_Sig4F2h_Com_stSocRx_Frz" 1031 "FId_bInh_Sig4F2h_Com_stSocRx_Rcf" 1032 "FId_bInh_Sig4F2h_Com_stT_Frz" 1033 "FId_bInh_Sig4F2h_Com_stT_Rcf" 1034 "FId_bInh_Sig535h_Com_tHvbAct_Frz" 1035 "FId_bInh_Sig535h_Com_tHvbAct_Rcf" 1036 "FId_bInh_Sig543h_Com_egyHvbAvl_fRx_Frz" 1037 "FId_bInh_Sig543h_Com_egyHvbAvl_fRx_Rcf" 1038 "FId_bInh_Sig543h_Com_ratHvbSoh_Frz" 1039 "FId_bInh_Sig543h_Com_ratHvbSoh_Rcf" 1040 "FId_bInh_Sig543h_Com_ratRHvbSoh_Frz" 1041 "FId_bInh_Sig543h_Com_ratRHvbSoh_Rcf" 1042 "FId_bInh_Sig552h_Com_lDstGlbDa_Frz" 1043 "FId_bInh_Sig552h_Com_lDstGlbDa_Rcf" 1044 "FId_bInh_Sig552h_Com_lTotOdometer_Frz" 1045 "FId_bInh_Sig552h_Com_lTotOdometer_Rcf" 1046 "FId_bInh_Sig552h_Com_tiCurVehTmr_Frz" 1047 "FId_bInh_Sig552h_Com_tiCurVehTmr_Rcf" 1048 "FId_bInh_Sig583h_Com_stHvbDiscnctReas_Frz" 1049 "FId_bInh_Sig583h_Com_stHvbDiscnctReas_Rcf" 1050 "FId_bInh_Sig592h_Com_iBattEBS1Rx_Frz" 1051 "FId_bInh_Sig592h_Com_iBattEBS1Rx_Rcf" 1052 "FId_bInh_Sig592h_Com_iBattEBS2Rx_Frz" 1053 "FId_bInh_Sig592h_Com_iBattEBS2Rx_Rcf" 1054 "FId_bInh_Sig592h_Com_iBattEBS3Rx_Frz" 1055 "FId_bInh_Sig592h_Com_iBattEBS3Rx_Rcf" 1056 "FId_bInh_Sig592h_Com_stIBattEBS_Frz" 1057 "FId_bInh_Sig592h_Com_stIBattEBS_Rcf" 1058 "FId_bInh_Sig592h_Com_tLvBatt_Frz" 1059 "FId_bInh_Sig592h_Com_tLvBatt_Rcf" 1060 "FId_bInh_Sig592h_Com_uBattEBSRx_Frz" 1061 "FId_bInh_Sig592h_Com_uBattEBSRx_Rcf" 1062 "FId_bInh_Sig595h_Com_tiHvbChrgnHalfRx_Frz" 1063 "FId_bInh_Sig595h_Com_tiHvbChrgnHalfRx_Rcf" 1064 "FId_bInh_Sig5B2h_Com_tEnvT_Frz" 1065 "FId_bInh_Sig5B2h_Com_tEnvT_Rcf" 1066 "FId_bInh_Sig5B5h_Com_stAlrtThermRunAwy_Frz" 1067 "FId_bInh_Sig5B5h_Com_stAlrtThermRunAwy_Rcf" 1068 "FId_bInh_Sig635h_Com_ctHvbNegCntctrSeg1_Frz" 1069 "FId_bInh_Sig635h_Com_ctHvbNegCntctrSeg1_Rcf" 1070 "FId_bInh_Sig635h_Com_ctHvbNegCntctrSeg3_Frz" 1071 "FId_bInh_Sig635h_Com_ctHvbNegCntctrSeg3_Rcf" 1072 "FId_bInh_Sig635h_Com_ctHvbNegCntctrSeg4_Frz" 1073 "FId_bInh_Sig635h_Com_ctHvbNegCntctrSeg4_Rcf" 1074 "FId_bInh_Sig635h_Com_ctHvbPosCntctrSeg1_Frz" 1075 "FId_bInh_Sig635h_Com_ctHvbPosCntctrSeg1_Rcf" 1076 "FId_bInh_Sig635h_Com_ctHvbPosCntctrSeg3_Frz" 1077 "FId_bInh_Sig635h_Com_ctHvbPosCntctrSeg3_Rcf" 1078 "FId_bInh_Sig635h_Com_ctHvbPosCntctrSeg4_Frz" 1079 "FId_bInh_Sig635h_Com_ctHvbPosCntctrSeg4_Rcf" 1080 "FId_bInh_Sig645h_Com_ctHvbPrecCntctrSeg1_Frz" 1081 "FId_bInh_Sig645h_Com_ctHvbPrecCntctrSeg1_Rcf" 1082 "FId_bInh_Sig645h_Com_ctHvbPrecCntctrSeg2_Frz" 1083 "FId_bInh_Sig645h_Com_ctHvbPrecCntctrSeg2_Rcf" 1084 "FId_bInh_Sig675h_Com_qHvbTotCpRx_Frz" 1085 "FId_bInh_Sig675h_Com_qHvbTotCpRx_Rcf" 1086 "FId_bInh_Sig_ComEmac_flgImobAuthent_Sq_Frz" 1087 "FId_bInh_Sig_ComEmac_stIsoMonSwtAck_Sq_Frz" 1088 "FId_bInh_Sig_ComEmac_stPwrAuthn_Sq_Frz" 1089 "FId_bInh_Sig_Com_flgEcoNormReq_Frz" 1090 "FId_bInh_Sig_Com_pwrMaxChrgSho_Sq_Frz" 1091 "FId_bInh_Sig_Com_pwrMaxDchaSho_Sq_Frz" 1092 "FId_bInh_Sig_Com_stDcdcULimReq_Sq_Frz" 1093 "FId_bInh_Sig_Com_stGearLvrPos_Frz" 1094 "FId_bInh_Sig_Com_stIgnkeyPos_Sq_Frz" 1095 "FId_bInh_ThermHvac_stRemPrecndn" 1096 "FId_bInh_VehCoorn_dstRngPrdcDispTx" 1097 "FId_bInh_VehCoorn_wCnsTotWghtAvrgEffTripA" 1098 "FId_bInh_VehCoorn_wCnsTotWghtAvrgEffTripB" 1099 "FId_bInh_VehCoorn_wCnsTotWghtAvrgEffTx" 1100 "FId_bInh_VehCoorn_wCnsTotWghtTripAvrgEffTx" 1101 "FId_bInh_VehCoorn_wCnsWghtAvrgEffTripA" 1102 "FId_bInh_VehCoorn_wCnsWghtAvrgEffTripB" 1103 "FId_binnh_Sig_ComEmac_flgEmgyShtDwnReq01_Sq_Frz" 1104 "FId_binnh_Sig_ComEmac_flgImobAuthent_Sq_Frz" 1105 "FId_binnh_Sig_ComEmac_iDcLnk01_Sq_Frz" 1106 "FId_binnh_Sig_ComEmac_nAct01_Sq_Frz" 1107 "FId_binnh_Sig_ComEmac_stActvDcha_Sq_Frz" 1108 "FId_binnh_Sig_ComEmac_stIsoMonSwtAck_Sq_Frz" 1109 "FId_binnh_Sig_ComEmac_stMod01_Sq_Frz" 1110 "FId_binnh_Sig_ComEmac_stPwrAuthn_Sq_Frz" 1111 "FId_binnh_Sig_ComEmac_tInvr01_Sq_Frz" 1112 "FId_binnh_Sig_ComEmac_tMac01_Sq_Frz" 1113 "FId_binnh_Sig_ComEmac_tqAbsltMax01_Sq_Frz" 1114 "FId_binnh_Sig_ComEmac_tqAbsltMin01_Sq_Frz" 1115 "FId_binnh_Sig_ComEmac_tqAct01_Sq_Frz" 1116 "FId_binnh_Sig_ComEmac_uDcLnk01_sq_Frz" 1117 "FId_binnh_Sig_Com_egyHvbAvl_Sq_Frz" 1118 "FId_binnh_Sig_Com_iHvbAct_Sq_Frz" 1119 "FId_binnh_Sig_Com_iHvbChrgMaxSho_Sq_Frz" 1120 "FId_binnh_Sig_Com_iHvbDchaMaxSho_Sq_Frz" 1121 "FId_binnh_Sig_Com_iHvbDes_Sq_Frz" 1122 "FId_binnh_Sig_Com_pwrDcdcOutpCpby_Sq_Frz" 1123 "FId_binnh_Sig_Com_rHvbIsoMeasmt_Sq_Frz" 1124 "FId_binnh_Sig_Com_ratHvbSoc_Sq_Frz" 1125 "FId_binnh_Sig_Com_stDcdcULimReq_Sq_Frz" 1126 "FId_binnh_Sig_Com_stHvbCntct_Sq_Frz" 1127 "FId_binnh_Sig_Com_stHvbDernMaxT_Sq_Frz" 1128 "FId_binnh_Sig_Com_stHvbDernMinT_Sq_Frz" 1129 "FId_binnh_Sig_Com_stHvbFlt_Sq_Frz" 1130 "FId_binnh_Sig_Com_stHvbIntlck_Sq_Frz" 1131 "FId_binnh_Sig_Com_stHvbIsoFlt_Sq_Frz" 1132 "FId_binnh_Sig_Com_stHvbMod_Sq_Frz" 1133 "FId_binnh_Sig_Com_stHvbSrvPlg_Sq_Frz" 1134 "FId_binnh_Sig_Com_tHvbAct_Sq_Frz" 1135 "FId_binnh_Sig_Com_uElCmprHvAct_Sq_Frz" 1136 "FId_binnh_Sig_Com_uHvbAct_Sq_Frz" 1137 "FId_binnh_Sig_Com_uHvbDcBus_Sq_Frz" 1138 "FId_binnh_Sig_Com_uHvbLimHi_Sq_Frz" 1139 "FId_binnh_Sig_Com_uHvbNomChrgn_Sq_Frz" DEFAULT_VALUE "---" /end COMPU_VTAB
/begin COMPU_METHOD DINH_LimDFCVerb "" TAB_VERB "%6.3" "-" COMPU_TAB_REF DINH_LimDFCVerb /end COMPU_METHOD
/begin COMPU_VTAB DINH_LimDFCVerb "" TAB_VERB 18 0 "No_Inhibit" 1 "Def50_Deb100" 2 "Def100_Deb100" 3 "Def50_Deb100_Tst" 4 "Def100_Deb100_Tst" 5 "Def50_Deb100_or_NTst" 6 "Def100_Deb100_or_NTst" 7 "Tested" 8 "NotTested" 9 "Def100_Deb0" 10 "Def50_Deb0" 11 "Def25_Deb0" 12 "Def0_Deb0" 13 "Def50_Deb100_Tst_Trip" 14 "Def100_Deb100_Tst_Trip" 15 "Def50_Deb100_MILOn" 16 "Def50_Deb100_Trip" 17 "Def100_Deb100_Trip" /end COMPU_VTAB
/begin COMPU_METHOD DINH_LimDSQVerb "" TAB_VERB "%6.3" "-" COMPU_TAB_REF DINH_LimDSQVerb /end COMPU_METHOD
/begin COMPU_VTAB DINH_LimDSQVerb "" TAB_VERB 17 0 "Qual_AllOk_0" 1 "Qual_1" 2 "Qual_Meas_2" 3 "Qual_PremFrozen_3" 4 "Qual_Model_4" 5 "Qual_5" 6 "Qual_6" 7 "Qual_7" 8 "Qual_Frozen_8" 9 "Qual_9" 10 "Qual_10" 11 "Qual_Tester_11" 12 "Qual_Default_12" 13 "Qual_13" 14 "Qual_14" 15 "Qual_Invalid_15" 16 "No_Inhibit" /end COMPU_VTAB
/begin COMPU_METHOD DrvMod_stPosn_VERB "" TAB_VERB "%6.3" "" COMPU_TAB_REF DrvMod_stPosn_VERB /end COMPU_METHOD
/begin COMPU_VTAB DrvMod_stPosn_VERB "" TAB_VERB 5 0 "DRVMOD_PRK" 1 "DRVMOD_RVS" 2 "DRVMOD_NEUT" 3 "DRVMOD_DRV" 6 "DRVMOD_NOREQ" /end COMPU_VTAB
/begin COMPU_METHOD ETS_PFLT1_SY_Compu "" RAT_FUNC "%6.2" "" COEFFS 0 1 0 0 0 1 /end COMPU_METHOD
/begin COMPU_METHOD ETS_PFLT2_SY_Compu "" RAT_FUNC "%6.2" "" COEFFS 0 1 0 0 0 1 /end COMPU_METHOD
/begin COMPU_METHOD ETS_PHC_SY_Compu "" RAT_FUNC "%6.2" "" COEFFS 0 1 0 0 0 1 /end COMPU_METHOD
/begin COMPU_METHOD ETS_SOX_SY_Compu "" RAT_FUNC "%6.2" "" COEFFS 0 1 0 0 0 1 /end COMPU_METHOD
/begin COMPU_METHOD EVAPRDSMIXFLDP_TYPAVL_SC_Compu "" TAB_VERB "%6.3" "" COMPU_TAB_REF EVAPRDSMIXFLDP_TYPAVL_SC_Compu /end COMPU_METHOD
/begin COMPU_VTAB EVAPRDSMIXFLDP_TYPAVL_SC_Compu "" TAB_VERB 2 0 "False" 1 "True" /end COMPU_VTAB
/begin COMPU_METHOD EVAPRDSMIXFLDT_TYPAVL_SC_Compu "" TAB_VERB "%6.3" "" COMPU_TAB_REF EVAPRDSMIXFLDT_TYPAVL_SC_Compu /end COMPU_METHOD
/begin COMPU_VTAB EVAPRDSMIXFLDT_TYPAVL_SC_Compu "" TAB_VERB 2 0 "False" 1 "True" /end COMPU_VTAB
/begin COMPU_METHOD EVREX_SY_Compu "" TAB_VERB "%6.3" "" COMPU_TAB_REF EVREX_SY_Compu /end COMPU_METHOD
/begin COMPU_VTAB EVREX_SY_Compu "" TAB_VERB 3 0 "EVREX_NO" 1 "EVREX_ECU" 2 "EVREX_VCU" /end COMPU_VTAB
/begin COMPU_METHOD EVTYP_SY_Compu "" TAB_VERB "%6.3" "" COMPU_TAB_REF EVTYP_SY_Compu /end COMPU_METHOD
/begin COMPU_VTAB EVTYP_SY_Compu "" TAB_VERB 2 0 "NOEV" 1 "EV" /end COMPU_VTAB
/begin COMPU_METHOD EXHEVAPRDSFLDT_TYPAVL_SC_Compu "" TAB_VERB "%6.3" "" COMPU_TAB_REF EXHEVAPRDSFLDT_TYPAVL_SC_Compu /end COMPU_METHOD
/begin COMPU_VTAB EXHEVAPRDSFLDT_TYPAVL_SC_Compu "" TAB_VERB 2 0 "False" 1 "True" /end COMPU_VTAB
/begin COMPU_METHOD EXHEVAPRDSGAST_TYPAVL_SC_Compu "" TAB_VERB "%6.3" "" COMPU_TAB_REF EXHEVAPRDSGAST_TYPAVL_SC_Compu /end COMPU_METHOD
/begin COMPU_VTAB EXHEVAPRDSGAST_TYPAVL_SC_Compu "" TAB_VERB 2 0 "False" 1 "True" /end COMPU_VTAB
/begin COMPU_METHOD EXHEVAPRUSFLDP_TYPAVL_SC_Compu "" TAB_VERB "%6.3" "" COMPU_TAB_REF EXHEVAPRUSFLDP_TYPAVL_SC_Compu /end COMPU_METHOD
/begin COMPU_VTAB EXHEVAPRUSFLDP_TYPAVL_SC_Compu "" TAB_VERB 2 0 "False" 1 "True" /end COMPU_VTAB
/begin COMPU_METHOD EXHEVAPRUSFLDT_TYPAVL_SC_Compu "" TAB_VERB "%6.3" "" COMPU_TAB_REF EXHEVAPRUSFLDT_TYPAVL_SC_Compu /end COMPU_METHOD
/begin COMPU_VTAB EXHEVAPRUSFLDT_TYPAVL_SC_Compu "" TAB_VERB 2 0 "False" 1 "True" /end COMPU_VTAB
/begin COMPU_METHOD EXHEVAPRUSGAST_TYPAVL_SC_Compu "" TAB_VERB "%6.3" "" COMPU_TAB_REF EXHEVAPRUSGAST_TYPAVL_SC_Compu /end COMPU_METHOD
/begin COMPU_VTAB EXHEVAPRUSGAST_TYPAVL_SC_Compu "" TAB_VERB 2 0 "False" 1 "True" /end COMPU_VTAB
/begin COMPU_METHOD EXHFLPLPI_TYPAVL_SC_Compu "" TAB_VERB "%6.3" "" COMPU_TAB_REF EXHFLPLPI_TYPAVL_SC_Compu /end COMPU_METHOD
/begin COMPU_VTAB EXHFLPLPI_TYPAVL_SC_Compu "" TAB_VERB 2 0 "False" 1 "True" /end COMPU_VTAB
/begin COMPU_METHOD EXHPPFLT_TYPAVL_SY_Compu "" TAB_VERB "%6.3" "" COMPU_TAB_REF EXHPPFLT_TYPAVL_SY_Compu /end COMPU_METHOD
/begin COMPU_VTAB EXHPPFLT_TYPAVL_SY_Compu "" TAB_VERB 2 0 "False" 1 "True" /end COMPU_VTAB
/begin COMPU_METHOD OneToOne "" RAT_FUNC "%6.2" "-" COEFFS 0 1 0 0 0 1 /end COMPU_METHOD
/begin COMPU_METHOD Prc "" RAT_FUNC "%6.4" "%" COEFFS 0 81.92 0 0 0 1 /end COMPU_METHOD
/begin COMPU_METHOD q1p0_W_h "" RAT_FUNC "%6.2" "Wh" COEFFS 0 1 0 0 0 1 /end COMPU_METHOD
/begin COMPU_METHOD RBPtCel_fac_0p01_1 "" RAT_FUNC "%6.4" "-" COEFFS 0 100 0 0 0 1 /end COMPU_METHOD
/begin COMPU_METHOD RBPtCel_fac_0p0625om125_1 "" RAT_FUNC "%6.1" "%" COEFFS 0 1 125 0 0 0.0625 /end COMPU_METHOD
/begin COMPU_METHOD RBPtCel_pwr_1p0_4 "" RAT_FUNC "%6.2" "Ws" COEFFS 0 1 0 0 0 1 /end COMPU_METHOD
/begin COMPU_METHOD RBPtCel_ti_0p01_1 "" RAT_FUNC "%6.4" "s" COEFFS 0 100 0 0 0 1 /end COMPU_METHOD
/begin COMPU_METHOD SigQly_COMPU_VERB "" TAB_VERB "%6.3" "" COMPU_TAB_REF SigQly_COMPU_VERB /end COMPU_METHOD
/begin COMPU_VTAB SigQly_COMPU_VERB "" TAB_VERB 16 0 "SIGQLY_NOTCALC" 1 "SIGQLY_INIT" 2 "SIGQLY_OK" 3 "SIGQLY_MODEL" 4 "SIGQLY_REPLACEMENT" 5 "SIGQLY_FROZEN" 6 "SIGQLY_INVALID" 7 "SIGQLY_RESERVED_7" 8 "SIGQLY_RESERVED_8" 9 "SIGQLY_RESERVED_9" 10 "SIGQLY_RESERVED_10" 11 "SIGQLY_RESERVED_11" 12 "SIGQLY_RESERVED_12" 13 "SIGQLY_RESERVED_13" 14 "SIGQLY_RESERVED_14" 15 "SIGQLY_RESERVED_15" /end COMPU_VTAB
/begin COMPU_METHOD TimeDeb "" RAT_FUNC "%6.1" "ms" COEFFS 0 0.1 0 0 0 1 /end COMPU_METHOD
/begin COMPU_METHOD TimeDelay_s "" RAT_FUNC "%6.1" "s" COEFFS 0 0 1 0 0.00023283064365387 0 /end COMPU_METHOD
/begin COMPU_METHOD Time_s "" RAT_FUNC "%6.4" "s" COEFFS 0 100 0 0 0 1 /end COMPU_METHOD
/begin COMPU_METHOD t_q0p1 "" RAT_FUNC "%6.3" "s" COEFFS 0 10 0 0 0 1 /end COMPU_METHOD
/begin COMPU_METHOD Vel "" RAT_FUNC "%6.4" "km/h" COEFFS 0 100 0 0 0 1 /end COMPU_METHOD
/*********** End of merged RECORD_LAYOUT blocks ***********/
/begin RECORD_LAYOUT KwUb FNC_VALUES 1 UBYTE COLUMN_DIR DIRECT /end RECORD_LAYOUT
/begin RECORD_LAYOUT RB_Val_Ws16 FNC_VALUES 1 SWORD COLUMN_DIR DIRECT /end RECORD_LAYOUT
/begin RECORD_LAYOUT RB_Val_Ws32 FNC_VALUES 1 SLONG COLUMN_DIR DIRECT /end RECORD_LAYOUT
/begin RECORD_LAYOUT RB_Val_Wu16 FNC_VALUES 1 UWORD COLUMN_DIR DIRECT /end RECORD_LAYOUT
/begin RECORD_LAYOUT RB_Val_Wu8 FNC_VALUES 1 UBYTE COLUMN_DIR DIRECT /end RECORD_LAYOUT
/begin RECORD_LAYOUT ValA_Wu8 FNC_VALUES 1 UBYTE COLUMN_DIR DIRECT /end RECORD_LAYOUT
/begin RECORD_LAYOUT Val_Ws16 FNC_VALUES 1 SWORD COLUMN_DIR DIRECT /end RECORD_LAYOUT
/begin RECORD_LAYOUT Val_Wu16 FNC_VALUES 1 UWORD COLUMN_DIR DIRECT /end RECORD_LAYOUT
/begin RECORD_LAYOUT Val_Wu8 FNC_VALUES 1 UBYTE COLUMN_DIR DIRECT /end RECORD_LAYOUT
/end MODULE
/end PROJECT

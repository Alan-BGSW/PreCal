ASAP2_VERSION 1 70
/begin PROJECT MDG1C "VC1CP091_STLA_N_D061I3"
/begin HEADER "" VERSION "VC1CP091_STLA_N_D061I3" PROJECT_NO MDG1C /end HEADER
/begin MODULE DIM ""
/begin MOD_COMMON "" BYTE_ORDER MSB_LAST ALIGNMENT_BYTE 1 ALIGNMENT_WORD 2 ALIGNMENT_LONG 4 ALIGNMENT_INT64 4 ALIGNMENT_FLOAT32_IEEE 4 ALIGNMENT_FLOAT64_IEEE 4 DATA_SIZE 32 /end MOD_COMMON
/begin CHARACTERISTIC AirC_pRefgntUs_C "Calibration for AirC_pRefgntUs" VALUE 0x8025147C RB_Val_Ws16 131070.0 PresAC_hPa -65536.00 65534.00 FORMAT "%8.2" /end CHARACTERISTIC
/begin CHARACTERISTIC AirC_rClgDem_C "adapter value for fan cooling demad received via GMLan from AC ECU" VALUE 0x8025147E RB_Val_Ws16 799.9878 Prc -400.0000 399.9878 FORMAT "%8.4" /end CHARACTERISTIC
/begin CHARACTERISTIC CcsCom_stEgyTrfModSeld_Cur "" CURVE 0x80251480 RB_Curve_U8_U8 255.0 OneToOne 0.00 255.0 FORMAT "%5.1"
 /begin AXIS_DESCR STD_AXIS HLCCcs_stEgyTrfModSeld OneToOne 7 0.00 255.0 FORMAT "%5.1" DEPOSIT ABSOLUTE /end AXIS_DESCR
/end CHARACTERISTIC
/begin CHARACTERISTIC ChrgrRly_flgClsRly_C "Swadp for desired charging relay status" VALUE 0x8025148F RB_Val_Wu8 1.00000000000 B_TRUE 0.00 1.00000000000 FORMAT "%13.11" /end CHARACTERISTIC
/begin CHARACTERISTIC ChrgrRly_st_C "" VALUE 0x80251490 RB_Val_Wu8 7.00000000000 RBPtEChrDv_stChrgrRly_VERB 0.00 7.00000000000 FORMAT "%13.11" /end CHARACTERISTIC
/begin CHARACTERISTIC Com_25h_B1b0_C "Calibration for Com_25h_B1b0" VALUE 0x80251491 RB_Val_Wu8 255.0 OneToOne 0.00 255.0 FORMAT "%5.1" /end CHARACTERISTIC
/begin CHARACTERISTIC Com_25h_B1b2_C "Calibration for Com_25h_B1b2" VALUE 0x80251492 RB_Val_Wu8 255.0 OneToOne 0.00 255.0 FORMAT "%5.1" /end CHARACTERISTIC
/begin CHARACTERISTIC Com_25h_B1b4_C "Calibration for Com_25h_B1b4" VALUE 0x80251493 RB_Val_Wu8 255.0 OneToOne 0.00 255.0 FORMAT "%5.1" /end CHARACTERISTIC
/begin CHARACTERISTIC Com_25h_B1b6_C "Calibration for Com_25h_B1b6" VALUE 0x80251494 RB_Val_Wu8 1.00000000000 B_TRUE 0.00 1.00000000000 FORMAT "%13.11" /end CHARACTERISTIC
/begin CHARACTERISTIC Com_bDiagMuxOn_C "Calibration for Com_bDiagMuxOn" VALUE 0x80251495 RB_Val_Wu8 1.00000000000 B_TRUE 0.00 1.00000000000 FORMAT "%13.11" /end CHARACTERISTIC
/begin CHARACTERISTIC Com_stDsqElCmprFltLvl_C "Calibration for Com_stDsqElCmprFltLvl" VALUE 0x80251496 RB_Val_Wu8 255.0 OneToOne 0.00 255.0 FORMAT "%5.1" /end CHARACTERISTIC
/begin CHARACTERISTIC Com_stDsqpwrElCmprActl_C "Calibration for Com_stDsqpwrElCmprActl" VALUE 0x80251497 RB_Val_Wu8 255.0 OneToOne 0.00 255.0 FORMAT "%5.1" /end CHARACTERISTIC
/begin CHARACTERISTIC Com_stDsqstElCmprStat_C "Calibration for Com_stDsqstElCmprStat" VALUE 0x80251498 RB_Val_Wu8 255.0 OneToOne 0.00 255.0 FORMAT "%5.1" /end CHARACTERISTIC
/begin CHARACTERISTIC Com_stDsquElCmprHvAct_C "Calibration for Com_stDsquElCmprHvAct" VALUE 0x80251499 RB_Val_Wu8 255.0 OneToOne 0.00 255.0 FORMAT "%5.1" /end CHARACTERISTIC
/begin CHARACTERISTIC CtPSwtActr_stClsd_C "Calibration for CtPSwtActr_stClsd" VALUE 0x8025149A RB_Val_Ws16 799.9878 Prc -400.0000 399.9878 FORMAT "%8.4" /end CHARACTERISTIC
/begin CHARACTERISTIC CtPSwtActr_stOpen_C "Calibration for CtPSwtActr_stOpen" VALUE 0x8025149C RB_Val_Ws16 799.9878 Prc -400.0000 399.9878 FORMAT "%8.4" /end CHARACTERISTIC
/begin CHARACTERISTIC DDRC_DurDeb.SCtPmpRly_tiOLDebOk_C "" VALUE 0x802409A4 Val_Wu16 655350.0 DDRCTime_ms 0.00 655350.0 FORMAT "%8.1" /end CHARACTERISTIC
/begin CHARACTERISTIC DDRC_DurDeb.SCtPmpRly_tiOLDebDef_C "" VALUE 0x802409A6 Val_Wu16 655350.0 DDRCTime_ms 0.00 655350.0 FORMAT "%8.1" /end CHARACTERISTIC
/begin CHARACTERISTIC DDRC_DurDeb.SCtPmpRly_tiOvrTempDebOk_C "" VALUE 0x802409A8 Val_Wu16 655350.0 DDRCTime_ms 0.00 655350.0 FORMAT "%8.1" /end CHARACTERISTIC
/begin CHARACTERISTIC DDRC_DurDeb.SCtPmpRly_tiOvrTempDebDef_C "" VALUE 0x802409AA Val_Wu16 655350.0 DDRCTime_ms 0.00 655350.0 FORMAT "%8.1" /end CHARACTERISTIC
/begin CHARACTERISTIC DDRC_DurDeb.SCtPmpRly_tiSCBDebOk_C "" VALUE 0x802409AC Val_Wu16 655350.0 DDRCTime_ms 0.00 655350.0 FORMAT "%8.1" /end CHARACTERISTIC
/begin CHARACTERISTIC DDRC_DurDeb.SCtPmpRly_tiSCBDebDef_C "" VALUE 0x802409AE Val_Wu16 655350.0 DDRCTime_ms 0.00 655350.0 FORMAT "%8.1" /end CHARACTERISTIC
/begin CHARACTERISTIC DDRC_DurDeb.SpplCooltPmpRly_tiOLDebOk_C "" VALUE 0x802409B0 Val_Wu16 655350.0 DDRCTime_ms 0.00 655350.0 FORMAT "%8.1" /end CHARACTERISTIC
/begin CHARACTERISTIC DDRC_DurDeb.SpplCooltPmpRly_tiOLDebDef_C "" VALUE 0x802409B2 Val_Wu16 655350.0 DDRCTime_ms 0.00 655350.0 FORMAT "%8.1" /end CHARACTERISTIC
/begin CHARACTERISTIC DDRC_DurDeb.SpplCooltPmpRly_tiOvrTempDebOk_C "" VALUE 0x802409B4 Val_Wu16 655350.0 DDRCTime_ms 0.00 655350.0 FORMAT "%8.1" /end CHARACTERISTIC
/begin CHARACTERISTIC DDRC_DurDeb.SpplCooltPmpRly_tiOvrTempDebDef_C "" VALUE 0x802409B6 Val_Wu16 655350.0 DDRCTime_ms 0.00 655350.0 FORMAT "%8.1" /end CHARACTERISTIC
/begin CHARACTERISTIC DDRC_DurDeb.SpplCooltPmpRly_tiSCBDebOk_C "" VALUE 0x802409B8 Val_Wu16 655350.0 DDRCTime_ms 0.00 655350.0 FORMAT "%8.1" /end CHARACTERISTIC
/begin CHARACTERISTIC DDRC_DurDeb.SpplCooltPmpRly_tiSCBDebDef_C "" VALUE 0x802409BA Val_Wu16 655350.0 DDRCTime_ms 0.00 655350.0 FORMAT "%8.1" /end CHARACTERISTIC
/begin CHARACTERISTIC DDRC_DurDeb.SCtPmpRly_tiSCGDebOk_C "" VALUE 0x80240AA0 Val_Wu16 655350.0 DDRCTime_ms 0.00 655350.0 FORMAT "%8.1" /end CHARACTERISTIC
/begin CHARACTERISTIC DDRC_DurDeb.SCtPmpRly_tiSCGDebDef_C "" VALUE 0x80240AA2 Val_Wu16 655350.0 DDRCTime_ms 0.00 655350.0 FORMAT "%8.1" /end CHARACTERISTIC
/begin CHARACTERISTIC DDRC_DurDeb.SpplCooltPmpRly_tiSCGDebOk_C "" VALUE 0x80240AA4 Val_Wu16 655350.0 DDRCTime_ms 0.00 655350.0 FORMAT "%8.1" /end CHARACTERISTIC
/begin CHARACTERISTIC DDRC_DurDeb.SpplCooltPmpRly_tiSCGDebDef_C "" VALUE 0x80240AA6 Val_Wu16 655350.0 DDRCTime_ms 0.00 655350.0 FORMAT "%8.1" /end CHARACTERISTIC
/begin CHARACTERISTIC DDRC_DurDeb.Com_tiBlowrRlyErrDebOk_C "" VALUE 0x80240B84 Val_Wu16 655350.0 DDRCTime_ms 0.00 655350.0 FORMAT "%8.1" /end CHARACTERISTIC
/begin CHARACTERISTIC DDRC_DurDeb.Com_tiBlowrRlyErrDebDef_C "" VALUE 0x80240B86 Val_Wu16 655350.0 DDRCTime_ms 0.00 655350.0 FORMAT "%8.1" /end CHARACTERISTIC
/begin CHARACTERISTIC DDRC_DurDeb.Com_tiComElMIIvtrFltLvl4DebOk_C "" VALUE 0x80240BDC Val_Wu16 655350.0 DDRCTime_ms 0.00 655350.0 FORMAT "%8.1" /end CHARACTERISTIC
/begin CHARACTERISTIC DDRC_DurDeb.Com_tiComElMIIvtrFltLvl4DebDef_C "" VALUE 0x80240BDE Val_Wu16 655350.0 DDRCTime_ms 0.00 655350.0 FORMAT "%8.1" /end CHARACTERISTIC
/begin CHARACTERISTIC DDRC_DurDeb.Com_tiComElMIIvtrFltLvl5DebOk_C "" VALUE 0x80240BE0 Val_Wu16 655350.0 DDRCTime_ms 0.00 655350.0 FORMAT "%8.1" /end CHARACTERISTIC
/begin CHARACTERISTIC DDRC_DurDeb.Com_tiComElMIIvtrFltLvl5DebDef_C "" VALUE 0x80240BE2 Val_Wu16 655350.0 DDRCTime_ms 0.00 655350.0 FORMAT "%8.1" /end CHARACTERISTIC
/begin CHARACTERISTIC DDRC_DurDeb.Com_tiPrkgBrkFailrDebOk_C "" VALUE 0x80240CB8 Val_Wu16 655350.0 DDRCTime_ms 0.00 655350.0 FORMAT "%8.1" /end CHARACTERISTIC
/begin CHARACTERISTIC DDRC_DurDeb.Com_tiPrkgBrkFailrDebDef_C "" VALUE 0x80240CBA Val_Wu16 655350.0 DDRCTime_ms 0.00 655350.0 FORMAT "%8.1" /end CHARACTERISTIC
/begin CHARACTERISTIC DDRC_DurDeb.Com_tiPtSysLimErrDebOk_C "" VALUE 0x80240CBC Val_Wu16 655350.0 DDRCTime_ms 0.00 655350.0 FORMAT "%8.1" /end CHARACTERISTIC
/begin CHARACTERISTIC DDRC_DurDeb.Com_tiPtSysLimErrDebDef_C "" VALUE 0x80240CBE Val_Wu16 655350.0 DDRCTime_ms 0.00 655350.0 FORMAT "%8.1" /end CHARACTERISTIC
/begin CHARACTERISTIC DDRC_RatDeb.SCtPmpRly_tiOLUDRat_C "" VALUE 0x80248A6D Val_Wu8 3.00000000000 DDRC_Ratio 1.00000000000 4.00000000000 FORMAT "%13.11" /end CHARACTERISTIC
/begin CHARACTERISTIC DDRC_RatDeb.SCtPmpRly_tiOvrTempUDRat_C "" VALUE 0x80248A6E Val_Wu8 3.00000000000 DDRC_Ratio 1.00000000000 4.00000000000 FORMAT "%13.11" /end CHARACTERISTIC
/begin CHARACTERISTIC DDRC_RatDeb.SCtPmpRly_tiSCBUDRat_C "" VALUE 0x80248A6F Val_Wu8 3.00000000000 DDRC_Ratio 1.00000000000 4.00000000000 FORMAT "%13.11" /end CHARACTERISTIC
/begin CHARACTERISTIC DDRC_RatDeb.SpplCooltPmpRly_tiOLUDRat_C "" VALUE 0x80248A70 Val_Wu8 3.00000000000 DDRC_Ratio 1.00000000000 4.00000000000 FORMAT "%13.11" /end CHARACTERISTIC
/begin CHARACTERISTIC DDRC_RatDeb.SpplCooltPmpRly_tiOvrTempUDRat_C "" VALUE 0x80248A71 Val_Wu8 3.00000000000 DDRC_Ratio 1.00000000000 4.00000000000 FORMAT "%13.11" /end CHARACTERISTIC
/begin CHARACTERISTIC DDRC_RatDeb.SpplCooltPmpRly_tiSCBUDRat_C "" VALUE 0x80248A72 Val_Wu8 3.00000000000 DDRC_Ratio 1.00000000000 4.00000000000 FORMAT "%13.11" /end CHARACTERISTIC
/begin CHARACTERISTIC DDRC_RatDeb.SCtPmpRly_tiSCGUDRat_C "" VALUE 0x80248AAC Val_Wu8 3.00000000000 DDRC_Ratio 1.00000000000 4.00000000000 FORMAT "%13.11" /end CHARACTERISTIC
/begin CHARACTERISTIC DDRC_RatDeb.SpplCooltPmpRly_tiSCGUDRat_C "" VALUE 0x80248AAD Val_Wu8 3.00000000000 DDRC_Ratio 1.00000000000 4.00000000000 FORMAT "%13.11" /end CHARACTERISTIC
/begin CHARACTERISTIC DFC_CtlMsk2.DFC_BlowrRlyErr_C "" VALUE 0x80241300 Val_Wu8 255.0 DFES_OneToOne 0.00 255.0 FORMAT "%5.1" /end CHARACTERISTIC
/begin CHARACTERISTIC DFC_CtlMsk2.DFC_ComElMIIvtrFltLvl4_C "" VALUE 0x8024132A Val_Wu8 255.0 DFES_OneToOne 0.00 255.0 FORMAT "%5.1" /end CHARACTERISTIC
/begin CHARACTERISTIC DFC_CtlMsk2.DFC_ComElMIIvtrFltLvl5_C "" VALUE 0x8024132B Val_Wu8 255.0 DFES_OneToOne 0.00 255.0 FORMAT "%5.1" /end CHARACTERISTIC
/begin CHARACTERISTIC DFC_CtlMsk2.DFC_PrkgBrkFailr_C "" VALUE 0x80241396 Val_Wu8 255.0 DFES_OneToOne 0.00 255.0 FORMAT "%5.1" /end CHARACTERISTIC
/begin CHARACTERISTIC DFC_CtlMsk2.DFC_PtSysLimErr_C "" VALUE 0x80241397 Val_Wu8 255.0 DFES_OneToOne 0.00 255.0 FORMAT "%5.1" /end CHARACTERISTIC
/begin CHARACTERISTIC DFC_CtlMsk2.DFC_SCtPmpRlyOL_C "" VALUE 0x80241526 Val_Wu8 255.0 DFES_OneToOne 0.00 255.0 FORMAT "%5.1" /end CHARACTERISTIC
/begin CHARACTERISTIC DFC_CtlMsk2.DFC_SCtPmpRlyOvrTemp_C "" VALUE 0x80241527 Val_Wu8 255.0 DFES_OneToOne 0.00 255.0 FORMAT "%5.1" /end CHARACTERISTIC
/begin CHARACTERISTIC DFC_CtlMsk2.DFC_SCtPmpRlySCB_C "" VALUE 0x80241528 Val_Wu8 255.0 DFES_OneToOne 0.00 255.0 FORMAT "%5.1" /end CHARACTERISTIC
/begin CHARACTERISTIC DFC_CtlMsk2.DFC_SpplCooltPmpRlyOL_C "" VALUE 0x80241529 Val_Wu8 255.0 DFES_OneToOne 0.00 255.0 FORMAT "%5.1" /end CHARACTERISTIC
/begin CHARACTERISTIC DFC_CtlMsk2.DFC_SpplCooltPmpRlyOvrTemp_C "" VALUE 0x8024152A Val_Wu8 255.0 DFES_OneToOne 0.00 255.0 FORMAT "%5.1" /end CHARACTERISTIC
/begin CHARACTERISTIC DFC_CtlMsk2.DFC_SpplCooltPmpRlySCB_C "" VALUE 0x8024152B Val_Wu8 255.0 DFES_OneToOne 0.00 255.0 FORMAT "%5.1" /end CHARACTERISTIC
/begin CHARACTERISTIC DFC_CtlMsk2.DFC_SCtPmpRlySCG_C "" VALUE 0x80241565 Val_Wu8 255.0 DFES_OneToOne 0.00 255.0 FORMAT "%5.1" /end CHARACTERISTIC
/begin CHARACTERISTIC DFC_CtlMsk2.DFC_SpplCooltPmpRlySCG_C "" VALUE 0x80241566 Val_Wu8 255.0 DFES_OneToOne 0.00 255.0 FORMAT "%5.1" /end CHARACTERISTIC
/begin CHARACTERISTIC DFC_CtlMsk2.DFC_Sia_InvldCode_C "" VALUE 0x802416A6 Val_Wu8 255.0 DFES_OneToOne 0.00 255.0 FORMAT "%5.1" /end CHARACTERISTIC
/begin CHARACTERISTIC DFC_CtlMsk2.DFC_Sia_InvldKey_C "" VALUE 0x802416A7 Val_Wu8 255.0 DFES_OneToOne 0.00 255.0 FORMAT "%5.1" /end CHARACTERISTIC
/begin CHARACTERISTIC DFC_CtlMsk2.DFC_Sia_NoRespUCx_C "" VALUE 0x802416A8 Val_Wu8 255.0 DFES_OneToOne 0.00 255.0 FORMAT "%5.1" /end CHARACTERISTIC
/begin CHARACTERISTIC DFC_CtlMsk2.DFC_Sia_TprotRttp_C "" VALUE 0x802416A9 Val_Wu8 255.0 DFES_OneToOne 0.00 255.0 FORMAT "%5.1" /end CHARACTERISTIC
/begin CHARACTERISTIC DFC_CtlMsk2.DFC_StrtUpEvStandStillDeactvn_C "" VALUE 0x802416AA Val_Wu8 255.0 DFES_OneToOne 0.00 255.0 FORMAT "%5.1" /end CHARACTERISTIC
/begin CHARACTERISTIC DFC_DisblMsk2.DFC_BlowrRlyErr_C "" VALUE 0x80248AE6 Val_Wu16 65535.00 DFES_OneToOne 0.00 65535.00 FORMAT "%8.2" /end CHARACTERISTIC
/begin CHARACTERISTIC DFC_DisblMsk2.DFC_ComElMIIvtrFltLvl4_C "" VALUE 0x80248B3A Val_Wu16 65535.00 DFES_OneToOne 0.00 65535.00 FORMAT "%8.2" /end CHARACTERISTIC
/begin CHARACTERISTIC DFC_DisblMsk2.DFC_ComElMIIvtrFltLvl5_C "" VALUE 0x80248B3C Val_Wu16 65535.00 DFES_OneToOne 0.00 65535.00 FORMAT "%8.2" /end CHARACTERISTIC
/begin CHARACTERISTIC DFC_DisblMsk2.DFC_PrkgBrkFailr_C "" VALUE 0x80248C12 Val_Wu16 65535.00 DFES_OneToOne 0.00 65535.00 FORMAT "%8.2" /end CHARACTERISTIC
/begin CHARACTERISTIC DFC_DisblMsk2.DFC_PtSysLimErr_C "" VALUE 0x80248C14 Val_Wu16 65535.00 DFES_OneToOne 0.00 65535.00 FORMAT "%8.2" /end CHARACTERISTIC
/begin CHARACTERISTIC DFC_DisblMsk2.DFC_SCtPmpRlyOL_C "" VALUE 0x80248F32 Val_Wu16 65535.00 DFES_OneToOne 0.00 65535.00 FORMAT "%8.2" /end CHARACTERISTIC
/begin CHARACTERISTIC DFC_DisblMsk2.DFC_SCtPmpRlyOvrTemp_C "" VALUE 0x80248F34 Val_Wu16 65535.00 DFES_OneToOne 0.00 65535.00 FORMAT "%8.2" /end CHARACTERISTIC
/begin CHARACTERISTIC DFC_DisblMsk2.DFC_SCtPmpRlySCB_C "" VALUE 0x80248F36 Val_Wu16 65535.00 DFES_OneToOne 0.00 65535.00 FORMAT "%8.2" /end CHARACTERISTIC
/begin CHARACTERISTIC DFC_DisblMsk2.DFC_SpplCooltPmpRlyOL_C "" VALUE 0x80248F38 Val_Wu16 65535.00 DFES_OneToOne 0.00 65535.00 FORMAT "%8.2" /end CHARACTERISTIC
/begin CHARACTERISTIC DFC_DisblMsk2.DFC_SpplCooltPmpRlyOvrTemp_C "" VALUE 0x80248F3A Val_Wu16 65535.00 DFES_OneToOne 0.00 65535.00 FORMAT "%8.2" /end CHARACTERISTIC
/begin CHARACTERISTIC DFC_DisblMsk2.DFC_SpplCooltPmpRlySCB_C "" VALUE 0x80248F3C Val_Wu16 65535.00 DFES_OneToOne 0.00 65535.00 FORMAT "%8.2" /end CHARACTERISTIC
/begin CHARACTERISTIC DFC_DisblMsk2.DFC_SCtPmpRlySCG_C "" VALUE 0x80248FB0 Val_Wu16 65535.00 DFES_OneToOne 0.00 65535.00 FORMAT "%8.2" /end CHARACTERISTIC
/begin CHARACTERISTIC DFC_DisblMsk2.DFC_SpplCooltPmpRlySCG_C "" VALUE 0x80248FB2 Val_Wu16 65535.00 DFES_OneToOne 0.00 65535.00 FORMAT "%8.2" /end CHARACTERISTIC
/begin CHARACTERISTIC DFC_DisblMsk2.DFC_Sia_InvldCode_C "" VALUE 0x80249232 Val_Wu16 65535.00 DFES_OneToOne 0.00 65535.00 FORMAT "%8.2" /end CHARACTERISTIC
/begin CHARACTERISTIC DFC_DisblMsk2.DFC_Sia_InvldKey_C "" VALUE 0x80249234 Val_Wu16 65535.00 DFES_OneToOne 0.00 65535.00 FORMAT "%8.2" /end CHARACTERISTIC
/begin CHARACTERISTIC DFC_DisblMsk2.DFC_Sia_NoRespUCx_C "" VALUE 0x80249236 Val_Wu16 65535.00 DFES_OneToOne 0.00 65535.00 FORMAT "%8.2" /end CHARACTERISTIC
/begin CHARACTERISTIC DFC_DisblMsk2.DFC_Sia_TprotRttp_C "" VALUE 0x80249238 Val_Wu16 65535.00 DFES_OneToOne 0.00 65535.00 FORMAT "%8.2" /end CHARACTERISTIC
/begin CHARACTERISTIC DFC_DisblMsk2.DFC_StrtUpEvStandStillDeactvn_C "" VALUE 0x8024923A Val_Wu16 65535.00 DFES_OneToOne 0.00 65535.00 FORMAT "%8.2" /end CHARACTERISTIC
/begin CHARACTERISTIC Dspl_stVDSAry_C "" VAL_BLK 0x8025149E RB_ValA_Wu8 255.0 OneToOne 0.00 255.0 FORMAT "%5.1" MATRIX_DIM 6 /end CHARACTERISTIC
/begin CHARACTERISTIC Dspl_stVISAry_C "" VAL_BLK 0x802514A4 RB_ValA_Wu8 255.0 OneToOne 0.00 255.0 FORMAT "%5.1" MATRIX_DIM 84 /end CHARACTERISTIC
/begin CHARACTERISTIC Dspl_stWMIAry_C "" VAL_BLK 0x802514F8 RB_ValA_Wu8 255.0 OneToOne 0.00 255.0 FORMAT "%5.1" MATRIX_DIM 3 /end CHARACTERISTIC
/begin CHARACTERISTIC ElTS_facPtSysLimThd_C "" VALUE 0x802514FB RB_Val_Wu8 100.0 RBPtCel_Perc_1p0_1 0.00 100.0 FORMAT "%5.1" EXTENDED_LIMITS 0.00 255.0 /end CHARACTERISTIC
/begin CHARACTERISTIC HvBatt_uActLinkMeasd_C "" VALUE 0x802514FC RB_Val_Ws16 1023.969 Volt_V_q0p03125_COMPU 0.00 1023.969 FORMAT "%8.3" EXTENDED_LIMITS -1024.000 1023.969 /end CHARACTERISTIC
/begin CHARACTERISTIC HvBatt_uActLinkMeasd_Sq_C "Calibration for HvBatt_uActLinkMeasd_Sq" VALUE 0x802514FE RB_Val_Wu8 15.0000000000 SigQly_COMPU_VERB 0.00 15.0000000000 FORMAT "%13.10" /end CHARACTERISTIC
/begin CHARACTERISTIC IntlckChrgPlg_flgActrReqOFF_C "" VALUE 0x80268F4A Val_Wu8 255.0 OneToOne 0.00 255.0 FORMAT "%5.1" /end CHARACTERISTIC
/begin CHARACTERISTIC IntlckChrgPlg_flgActrReqON_C "" VALUE 0x80268F4B Val_Wu8 255.0 OneToOne 0.00 255.0 FORMAT "%5.1" /end CHARACTERISTIC
/begin CHARACTERISTIC IntlckChrgPlg_stHbrOLDiagExtReq_C "" VALUE 0x802514FF RB_Val_Wu8 255.0 OneToOne 0.00 255.0 FORMAT "%5.1" /end CHARACTERISTIC
/begin CHARACTERISTIC MoFAccr_flgPlausBrkDetdMsg_C "." VALUE 0x80251504 RB_Val_Wu8 1.00000000000 B_TRUE 0.00 1.00000000000 FORMAT "%13.11" /end CHARACTERISTIC
/begin CHARACTERISTIC MRly_stAct_C "" VALUE 0x80268F4C Val_Wu8 255.0 OneToOne 0.00 255.0 FORMAT "%5.1" /end CHARACTERISTIC
/begin CHARACTERISTIC PEnv_tiStrtReplVld_C "Time after end of start at which PEnv_p corresponds to PEnv_p at the start" VALUE 0x80251506 RB_Val_Wu16 6553.500 t100msxs_uw_b6553p5 0.00 6553.500 FORMAT "%8.3" /end CHARACTERISTIC
/begin CHARACTERISTIC RCDWakeup_Off_C "" VALUE 0x80268F4E Val_Ws16 799.9878 Prc -400.0000 399.9878 FORMAT "%8.4" /end CHARACTERISTIC
/begin CHARACTERISTIC RCDWakeup_On_C "" VALUE 0x80268F50 Val_Ws16 799.9878 Prc -400.0000 399.9878 FORMAT "%8.4" /end CHARACTERISTIC
/begin CHARACTERISTIC SCtPmpRly_numStdActr_C "" VALUE 0x80268F2C Val_Wu32 4294967295.00 OneToOne 0.00 4294967295.00 FORMAT "%13.2" /end CHARACTERISTIC
/begin CHARACTERISTIC SCtPmpRly_psDiagDigOut.nrTstPls_C " / Maximum number of test impulses possible in one driving cycle." VALUE 0x80268F30 Kw_Wu32 4294967295.00 OneToOne 0.00 4294967295.00 FORMAT "%13.2" /end CHARACTERISTIC
/begin CHARACTERISTIC SCtPmpRly_psDiagDigOut.tiBtwElecFlt_C " / Time between test in case a short circuit or open load is detected." VALUE 0x80268F34 Kw_Ws16 655350.0 Time_ms -327680.0 327670.0 FORMAT "%8.1" /end CHARACTERISTIC
/begin CHARACTERISTIC SCtPmpRly_psDiagDigOut.tiBtwOTFlt_C " / Time between test when an over temperature error is detected." VALUE 0x80268F36 Kw_Ws16 655.3500 Time_s -327.6800 327.6700 FORMAT "%8.4" /end CHARACTERISTIC
/begin CHARACTERISTIC SCtPmpRly_ratActLin_CUR "" CURVE 0x80268EC4 RB_Curve_S16_S16 511.9922 rel_q0p0078125 -256.0000 255.9922 FORMAT "%8.4"
 /begin AXIS_DESCR STD_AXIS SCtPmpRly_rAct Prc 25 -400.0000 399.9878 FORMAT "%8.4" DEPOSIT ABSOLUTE /end AXIS_DESCR
/end CHARACTERISTIC
/begin CHARACTERISTIC SCtPmpRly_r_C "Calibartion for auxillary water pump relay status" VALUE 0x80268F52 Val_Ws16 799.9878 Prc -400.0000 399.9878 FORMAT "%8.4" /end CHARACTERISTIC
/begin CHARACTERISTIC SCtPmpRly_swtConf2_C "" VALUE 0x80268EB8 Val_Wu32 4294967295.00 OneToOne 0.00 4294967295.00 FORMAT "%13.2" /end CHARACTERISTIC
/begin CHARACTERISTIC SCtPmpRly_swtConfStdActrSwVers162_C "" VALUE 0x80268EBC Val_Wu32 4294967295.00 OneToOne 0.00 4294967295.00 FORMAT "%13.2" /end CHARACTERISTIC
/begin CHARACTERISTIC SCtPmpRly_swtConf_C "" VALUE 0x80268EC0 Val_Wu32 4294967295.00 OneToOne 0.00 4294967295.00 FORMAT "%13.2" /end CHARACTERISTIC
/begin CHARACTERISTIC SCtPmpRly_swtPsDiag_C "" VALUE 0x80268F38 Val_Wu8 255.0 OneToOne 0.00 255.0 FORMAT "%5.1" /end CHARACTERISTIC
/begin CHARACTERISTIC Signals_Mode1Pid_CA "" VAL_BLK 0x80268F54 ValA_Wu8 255.0 OneToOne 0.00 255.0 FORMAT "%5.1" READ_ONLY MATRIX_DIM 206 /end CHARACTERISTIC
/begin CHARACTERISTIC Signals_Mode1SigNum_CA "" VAL_BLK 0x80269022 ValA_Wu16 313.000000000 Signals_IntSigNumVerb 0.00 313.000000000 FORMAT "%13.9" READ_ONLY MATRIX_DIM 206 /end CHARACTERISTIC
/begin CHARACTERISTIC Signals_stSrv01SuppPid_CA "" VAL_BLK 0x802691BE ValA_Wu16 172.000000000 Signals_PidVerbSupp 0.00 172.000000000 FORMAT "%13.9" MATRIX_DIM 206 /end CHARACTERISTIC
/begin CHARACTERISTIC SpplCooltPmpRly_ActrPwrStgDrvr_Cal.swtConf_C "e_:Calibration Parameter Structure for Linear Governor limitation Feature:_e;d_:Applikationsstruktur für das lineare Reglerbegrenzungsfeature:_d / e_:Minimum allowable motor torque/ motor torque threshold in downward direction to activate ramping:_e;d_:Minimales erlaubtes Motormoment in Richtung unten um Rampe zu aktivieren:_d" VALUE 0x802518C8 Val_Wu8 255.0 OneToOne 0.00 255.0 FORMAT "%5.1" /end CHARACTERISTIC
/begin CHARACTERISTIC SpplCooltPmpRly_ActrPwrStgDrvr_Cal.stMOCSOPChk_C "e_:Calibration Parameter Structure for Linear Governor limitation Feature:_e;d_:Applikationsstruktur für das lineare Reglerbegrenzungsfeature:_d / e_:Minimum upper motor torque:_e;d_:Minimum des oberen Motordrehmoments:_d" VALUE 0x802518C9 Val_Wu8 255.0 OneToOne 0.00 255.0 FORMAT "%5.1" /end CHARACTERISTIC
/begin CHARACTERISTIC SpplCooltPmpRly_ActrPwrStgDrvr_Cal.swtPSDis_C "e_:Calibration Parameter Structure for Linear Governor limitation Feature:_e;d_:Applikationsstruktur für das lineare Reglerbegrenzungsfeature:_d / e_:Minimum motor initial torque:_e;d_:Minimum des initialen Motormoments:_d" VALUE 0x802518CA Val_Wu16 65535.00 OneToOne 0.00 65535.00 FORMAT "%8.2" /end CHARACTERISTIC
/begin CHARACTERISTIC SpplCooltPmpRly_DevDrvrOutpDutyCycRampCal.swtConf_C " / e_:Configuration switch to activate Linear governor limitation:_e;d_:Konfigurationsschalter zum Aktivieren der Linearen Reglerbegrenzung:_d" VALUE 0x802518CC RB_Val_Wu8 7.000 OneToOne 0.00 7.000 FORMAT "%5.3" EXTENDED_LIMITS 0.00 255.0 /end CHARACTERISTIC
/begin CHARACTERISTIC SpplCooltPmpRly_numStdActr_C "" VALUE 0x802699D0 Val_Wu32 4294967295.00 OneToOne 0.00 4294967295.00 FORMAT "%13.2" /end CHARACTERISTIC
/begin CHARACTERISTIC SpplCooltPmpRly_psDiagDigOut.nrTstPls_C " / Maximum number of test impulses possible in one driving cycle." VALUE 0x802699D4 Kw_Wu32 4294967295.00 OneToOne 0.00 4294967295.00 FORMAT "%13.2" /end CHARACTERISTIC
/begin CHARACTERISTIC SpplCooltPmpRly_psDiagDigOut.tiBtwElecFlt_C " / Time between test in case a short circuit or open load is detected." VALUE 0x802699D8 Kw_Ws16 655350.0 Time_ms -327680.0 327670.0 FORMAT "%8.1" /end CHARACTERISTIC
/begin CHARACTERISTIC SpplCooltPmpRly_psDiagDigOut.tiBtwOTFlt_C " / Time between test when an over temperature error is detected." VALUE 0x802699DA Kw_Ws16 655.3500 Time_s -327.6800 327.6700 FORMAT "%8.4" /end CHARACTERISTIC
/begin CHARACTERISTIC SpplCooltPmpRly_ratActLin_CUR "" CURVE 0x80269968 RB_Curve_S16_S16 511.9922 rel_q0p0078125 -256.0000 255.9922 FORMAT "%8.4"
 /begin AXIS_DESCR STD_AXIS SpplCooltPmpRly_rAct Prc 25 -400.0000 399.9878 FORMAT "%8.4" DEPOSIT ABSOLUTE /end AXIS_DESCR
/end CHARACTERISTIC
/begin CHARACTERISTIC SpplCooltPmpRly_rCnv_MAP "" MAP 0x80269410 RB_Map_S16S16_S16 655.3500 DtyCyc -327.6800 327.6700 FORMAT "%8.4"
 /begin AXIS_DESCR STD_AXIS SpplCooltPmpRly_rActr Prc 25 -400.0000 399.9878 FORMAT "%8.4" DEPOSIT ABSOLUTE /end AXIS_DESCR
 /begin AXIS_DESCR STD_AXIS EnvP_p Pres_hPa 25 -32768.00 32767.00 FORMAT "%8.2" DEPOSIT ABSOLUTE /end AXIS_DESCR
/end CHARACTERISTIC
/begin CHARACTERISTIC SpplCooltPmpRly_rDesActrATS_CUR "" CURVE 0x802518CE RB_Curve_S16_S16 799.9878 Prc -400.0000 399.9878 FORMAT "%8.4"
 /begin AXIS_DESCR STD_AXIS SpplCooltPmpRly_rDesValATS Prc 25 -400.0000 399.9878 FORMAT "%8.4" DEPOSIT ABSOLUTE /end AXIS_DESCR
/end CHARACTERISTIC
/begin CHARACTERISTIC SpplCooltPmpRly_rDesActr_CUR "" CURVE 0x8026935C RB_Curve_S16_S16 799.9878 Prc -400.0000 399.9878 FORMAT "%8.4"
 /begin AXIS_DESCR STD_AXIS SpplCooltPmpRly_r Prc 25 -400.0000 399.9878 FORMAT "%8.4" DEPOSIT ABSOLUTE /end AXIS_DESCR
/end CHARACTERISTIC
/begin CHARACTERISTIC SpplCooltPmpRly_StdCal.tiDesValFlt_C " / PT1 Filter time constant for setpoint to calculate simulated feedback" VALUE 0x802693C4 Val_Ws32 4294.9672940000000 TimeDelay_s 0.0000020000000 4294.9672959999998 FORMAT "%19.14" EXTENDED_LIMITS 0.000002000000001 4294.9672959999998 /end CHARACTERISTIC
/begin CHARACTERISTIC SpplCooltPmpRly_StdCal.rPsOff_C " / Dutycycle value for actuator switch off" VALUE 0x802693C8 Val_Ws16 655.3500 DtyCyc -327.6800 327.6700 FORMAT "%8.4" /end CHARACTERISTIC
/begin CHARACTERISTIC SpplCooltPmpRly_StdCal.rActrStop_C " / Actuator shut off PWM duty cycle" VALUE 0x802693CA Val_Ws16 655.3500 DtyCyc -327.6800 327.6700 FORMAT "%8.4" /end CHARACTERISTIC
/begin CHARACTERISTIC SpplCooltPmpRly_StdCal.rHysHigh_C " / e_:upper hysteresis threshold:_e;d_:Obere Hystereseschwelle:_d" VALUE 0x802693CC Val_Ws16 655.3500 DtyCyc -327.6800 327.6700 FORMAT "%8.4" /end CHARACTERISTIC
/begin CHARACTERISTIC SpplCooltPmpRly_StdCal.rHysLow_C " / e_:lower hysteresis threshold:_e;d_:Untere Hystereseschwelle:_d" VALUE 0x802693CE Val_Ws16 655.3500 DtyCyc -327.6800 327.6700 FORMAT "%8.4" /end CHARACTERISTIC
/begin CHARACTERISTIC SpplCooltPmpRly_StdCal.stPwrStgDiaDis_C " / Mask to disable powerstage diagnosis" VALUE 0x802693D0 Val_Wu16 65535.00 OneToOne 0.00 65535.00 FORMAT "%8.2" /end CHARACTERISTIC
/begin CHARACTERISTIC SpplCooltPmpRly_StdCal.stPlausDiaDis_C " / e_:Mask to disable plausibility diagnosis:_e;d_:Maske zur Deaktivierung der Plausibilitätsdiagnose:_d" VALUE 0x802693D2 Val_Wu16 65535.00 OneToOne 0.00 65535.00 FORMAT "%8.2" /end CHARACTERISTIC
/begin CHARACTERISTIC SpplCooltPmpRly_StdCal.stPwrStgDis_C " / Mask to disable powerstage actuation under different conditions" VALUE 0x802693D4 Val_Wu16 65535.00 OneToOne 0.00 65535.00 FORMAT "%8.2" /end CHARACTERISTIC
/begin CHARACTERISTIC SpplCooltPmpRly_StdCal.stActrStop_C " / Bitcoded value of the states where actuator switchoff signal should be sent" VALUE 0x802693D6 Val_Wu16 65535.00 OneToOne 0.00 65535.00 FORMAT "%8.2" /end CHARACTERISTIC
/begin CHARACTERISTIC SpplCooltPmpRly_StdCal.stAllPwrStgDiaEna_C " / Switch configuration for power stage diagnosis for digital actuators" VALUE 0x802693D8 Val_Wu8 255.0 OneToOne 0.00 255.0 FORMAT "%5.1" /end CHARACTERISTIC
/begin CHARACTERISTIC SpplCooltPmpRly_StdCal.swtDesVal_C " / Switch to select default setpoint" VALUE 0x802693D9 Val_Wu8 255.0 OneToOne 0.00 255.0 FORMAT "%5.1" /end CHARACTERISTIC
/begin CHARACTERISTIC SpplCooltPmpRly_StdCal.numDiagTry_C " / Counter to limit the number of active diagnosis" VALUE 0x802693DA Val_Wu8 255.0 OneToOne 0.00 255.0 FORMAT "%5.1" /end CHARACTERISTIC
/begin CHARACTERISTIC SpplCooltPmpRly_StdCal.rDesValOff_C " / Default desired value in case of power stage errors" VALUE 0x802693DC Val_Ws16 799.9878 Prc -400.0000 399.9878 FORMAT "%8.4" /end CHARACTERISTIC
/begin CHARACTERISTIC SpplCooltPmpRly_StdCal.rDesValOn_C " / Default desired value for On position" VALUE 0x802693DE Val_Ws16 799.9878 Prc -400.0000 399.9878 FORMAT "%8.4" /end CHARACTERISTIC
/begin CHARACTERISTIC SpplCooltPmpRly_StdCal.numEngDaFrqPs_C " / variable frequency option in PWM signals" VALUE 0x802693E0 Val_Wu16 255.000000000 DELIB_ALLTEMP_VERB_COMPU 0.00 255.000000000 FORMAT "%13.9" /end CHARACTERISTIC
/begin CHARACTERISTIC SpplCooltPmpRly_StdCal.tiSlwRespSimPT1_C " / PT1 Filter time constant for slow response simulation" VALUE 0x802693E4 Val_Ws32 4294.9672940000000 TimeDelay_s 0.0000020000000 4294.9672959999998 FORMAT "%19.14" EXTENDED_LIMITS 0.000002000000001 4294.9672959999998 /end CHARACTERISTIC
/begin CHARACTERISTIC SpplCooltPmpRly_StdCal.uHiBattThd_C " / Upper hysteresis threshold for BattU_u" VALUE 0x802693E8 Val_Ws16 1310700. Volt_Batt -655360.0 655340.0 FORMAT "%8.1" /end CHARACTERISTIC
/begin CHARACTERISTIC SpplCooltPmpRly_StdCal.uLoBattThd_C " / Lower hysteresis threshold for BattU_u" VALUE 0x802693EA Val_Ws16 1310700. Volt_Batt -655360.0 655340.0 FORMAT "%8.1" /end CHARACTERISTIC
/begin CHARACTERISTIC SpplCooltPmpRly_StdCal.tiDebBattVoltOk_C " / Healing time of defected battery voltage" VALUE 0x802693EC Val_Ws16 655350.0 Time_ms -327680.0 327670.0 FORMAT "%8.1" /end CHARACTERISTIC
/begin CHARACTERISTIC SpplCooltPmpRly_StdCal.tiDebBattVoltDfct_C " / Debounce time to sense Battery voltage Defect" VALUE 0x802693EE Val_Ws16 655350.0 Time_ms -327680.0 327670.0 FORMAT "%8.1" /end CHARACTERISTIC
/begin CHARACTERISTIC SpplCooltPmpRly_StdCal.mskActrActv_C " / Bitmask to choose in which engine states the actuator is activated" VALUE 0x802693F0 Val_Wu8 255.0 OneToOne 0.00 255.0 FORMAT "%5.1" /end CHARACTERISTIC
/begin CHARACTERISTIC SpplCooltPmpRly_StdCal.tiDlyActrActvn_C " / Delay for actuator activation" VALUE 0x802693F2 Val_Wu16 6553.500 TiSec_q0p1_COMPU 0.00 6553.500 FORMAT "%8.3" /end CHARACTERISTIC
/begin CHARACTERISTIC SpplCooltPmpRly_StdCal.rPsActrOff_C " / Replacement value for powerstage dutycycle when actuator is not activated" VALUE 0x802693F4 Val_Ws16 655.3500 DtyCyc -327.6800 327.6700 FORMAT "%8.4" /end CHARACTERISTIC
/begin CHARACTERISTIC SpplCooltPmpRly_StdCal.uBattMin_C " / Minimum value of battery voltage to enable Clean and Verify" VALUE 0x802693F6 Val_Ws16 1310700. Volt_Batt -655360.0 655340.0 FORMAT "%8.1" /end CHARACTERISTIC
/begin CHARACTERISTIC SpplCooltPmpRly_StdCal.uBattMax_C " / Maximum value of battery voltage to enable zero point adaption" VALUE 0x802693F8 Val_Ws16 1310700. Volt_Batt -655360.0 655340.0 FORMAT "%8.1" /end CHARACTERISTIC
/begin CHARACTERISTIC SpplCooltPmpRly_StdCal.tiShOffCtrlDne_C " / Delay for deactivation of the actuator when shut off is done" VALUE 0x802693FA Val_Ws16 655350.0 Time_ms -327680.0 327670.0 FORMAT "%8.1" /end CHARACTERISTIC
/begin CHARACTERISTIC SpplCooltPmpRly_StdCal.swtDeactvn_C " / bitmask to deactivate the actuator by calibration" VALUE 0x802693FC Val_Wu8 255.0 OneToOne 0.00 255.0 FORMAT "%5.1" /end CHARACTERISTIC
/begin CHARACTERISTIC SpplCooltPmpRly_StdCal.tiSelfDiagStrt_C " / Delay time to start the self diagnosis of the powertstage once the engine state has reached the required state." VALUE 0x802693FE Val_Ws16 655350.0 Time_ms -327680.0 327670.0 FORMAT "%8.1" /end CHARACTERISTIC
/begin CHARACTERISTIC SpplCooltPmpRly_StdCal.flgReacvnPostDrv_C " / e_:Reactivation of actuator at transition into POSTDRIVE.:_e;d_:Reaktivierung des Stellers beim Ã?bergang in den POSTDRIVE.:_d" VALUE 0x80269400 Val_Wu8 255.0 OneToOne 0.00 255.0 FORMAT "%5.1" /end CHARACTERISTIC
/begin CHARACTERISTIC SpplCooltPmpRly_StdCal.rPsRlyOff_C " / e_:Calibration to indicate the switch-off dutycycle:_e;d_:Kalibrierung zur Anzeige des Ausschaltzyklus:_d" VALUE 0x80269402 Val_Ws16 655.3500 DtyCyc -327.6800 327.6700 FORMAT "%8.4" /end CHARACTERISTIC
/begin CHARACTERISTIC SpplCooltPmpRly_StdCal.tiRlyOnDly_C " / e_:Calibration to delay the enabling of powerstage:_e;d_:Kalibrierung, um die Aktivierung der Endstufe zu verzögern:_d" VALUE 0x80269404 Val_Ws16 33.55392 RBPtCel_ti_5p12em4_1 -16.77722 16.77670 FORMAT "%8.5" /end CHARACTERISTIC
/begin CHARACTERISTIC SpplCooltPmpRly_StdCal.nFMInWinMsk_C " / e_:Calibration mask to select the proper window representing the actuator jammed error:_e;d_:Maske für die Auswahl des Frequenzfensters für das blockierte Ventil:_d" VALUE 0x80269408 Val_Wu32 4294967295.00 OneToOne 0.00 4294967295.00 FORMAT "%13.2" /end CHARACTERISTIC
/begin CHARACTERISTIC SpplCooltPmpRly_StdCal.tiFMInDeb_C " / e_:Time for debouncing the frequency window::_e;d_:Zeit zum Entprellen des Frequenzfensters:_d" VALUE 0x8026940C Val_Wu8 2550. Time_ms 0.00 2550. FORMAT "%5.0" /end CHARACTERISTIC
/begin CHARACTERISTIC SpplCooltPmpRly_StdCal.tiJamActrWait_C " / e_:Time to start the jammed actuator debouncing after the preliminary error:_e;d_:Zeit zum Starten der Entprellung des blockierten Stellers nach dem vorläufigen Fehler:_d" VALUE 0x8026940E Val_Ws16 6553.500 t_q0p1 -3276.800 3276.700 FORMAT "%8.3" /end CHARACTERISTIC
/begin CHARACTERISTIC SpplCooltPmpRly_swtConf2_C "" VALUE 0x8026995C Val_Wu32 4294967295.00 OneToOne 0.00 4294967295.00 FORMAT "%13.2" /end CHARACTERISTIC
/begin CHARACTERISTIC SpplCooltPmpRly_swtConfStdActrSwVers162_C "" VALUE 0x80269960 Val_Wu32 4294967295.00 OneToOne 0.00 4294967295.00 FORMAT "%13.2" /end CHARACTERISTIC
/begin CHARACTERISTIC SpplCooltPmpRly_swtConf_C "" VALUE 0x80269964 Val_Wu32 4294967295.00 OneToOne 0.00 4294967295.00 FORMAT "%13.2" /end CHARACTERISTIC
/begin CHARACTERISTIC SpplCooltPmpRly_swtPsDiag_C "" VALUE 0x802699DC Val_Wu8 255.0 OneToOne 0.00 255.0 FORMAT "%5.1" /end CHARACTERISTIC
/begin CHARACTERISTIC SSwtS_swtGlbTyp_C "Global switch type : 1 = value from Eep, 2 = value from application" VALUE 0x80268F3C Val_Wu8 1.000 OneToOne 1.000 2.000 FORMAT "%5.3" EXTENDED_LIMITS 0.00 255.0 /end CHARACTERISTIC
/begin CHARACTERISTIC SSwtS_Val.GlbDa_swtNUMTLC_C "" VALUE 0x80268F3E Val_Wu8 255.0 OneToOne 0.00 255.0 FORMAT "%5.1" /end CHARACTERISTIC
/begin CHARACTERISTIC SSwtS_Val.GlbDa_swtCHRGSOCKET_C "" VALUE 0x80268F3F Val_Wu8 1.000 OneToOne 0.00 1.000 FORMAT "%5.3" EXTENDED_LIMITS 0.00 255.0 /end CHARACTERISTIC
/begin CHARACTERISTIC SSwtS_Val.GlbDa_swtVCU_RES_BIT1_C "" VALUE 0x80268F40 Val_Wu8 1.000 OneToOne 0.00 1.000 FORMAT "%5.3" EXTENDED_LIMITS 0.00 255.0 /end CHARACTERISTIC
/begin CHARACTERISTIC SSwtS_Val.GlbDa_swtVCU_RES_BIT2_C "" VALUE 0x80268F41 Val_Wu8 1.000 OneToOne 0.00 1.000 FORMAT "%5.3" EXTENDED_LIMITS 0.00 255.0 /end CHARACTERISTIC
/begin CHARACTERISTIC SSwtS_Val.GlbDa_swtVCU_RES_BIT3_C "" VALUE 0x80268F42 Val_Wu8 1.000 OneToOne 0.00 1.000 FORMAT "%5.3" EXTENDED_LIMITS 0.00 255.0 /end CHARACTERISTIC
/begin CHARACTERISTIC SSwtS_Val.GlbDa_swtVCU_RES_BIT4_C "" VALUE 0x80268F43 Val_Wu8 1.000 OneToOne 0.00 1.000 FORMAT "%5.3" EXTENDED_LIMITS 0.00 255.0 /end CHARACTERISTIC
/begin CHARACTERISTIC SSwtS_Val.GlbDa_swtVCU_RES_BIT5_C "" VALUE 0x80268F44 Val_Wu8 1.000 OneToOne 0.00 1.000 FORMAT "%5.3" EXTENDED_LIMITS 0.00 255.0 /end CHARACTERISTIC
/begin CHARACTERISTIC SSwtS_Val.GlbDa_swtVCU_RES_BIT6_C "" VALUE 0x80268F45 Val_Wu8 1.000 OneToOne 0.00 1.000 FORMAT "%5.3" EXTENDED_LIMITS 0.00 255.0 /end CHARACTERISTIC
/begin CHARACTERISTIC SSwtS_Val.GlbDa_swtVCU_RES_BIT7_C "" VALUE 0x80268F46 Val_Wu8 1.000 OneToOne 0.00 1.000 FORMAT "%5.3" EXTENDED_LIMITS 0.00 255.0 /end CHARACTERISTIC
/begin CHARACTERISTIC StrtUpEv_dTqDrvAwyIBrkPsdNeg_C "Negative slope of torque after deactivating of the crawling controller I part." VALUE 0x80251934 RB_Val_Ws32 6553599.99847 RmpTrqPrpHigh -3276800.00000 3276799.99847 FORMAT "%13.5" /end CHARACTERISTIC
/begin CHARACTERISTIC StrtUpEv_dTqDrvAwyIBrkPsdPos_C "Positive slope of torque after deactivating of the crawling controller I part." VALUE 0x80251938 RB_Val_Ws32 6553599.99847 RmpTrqPrpHigh -3276800.00000 3276799.99847 FORMAT "%13.5" /end CHARACTERISTIC
/begin CHARACTERISTIC StrtUpEv_dTqDrvAwyINeg_C "Slope of torque after deactivating of drive-away or crawling controller" VALUE 0x8025193C RB_Val_Ws32 6553599.99847 RmpTrqPrpHigh -3276800.00000 3276799.99847 FORMAT "%13.5" /end CHARACTERISTIC
/begin CHARACTERISTIC StrtUpEv_dTqDrvAwyIPos_C "Slope of torque after deactivating of drive-away or crawling controller" VALUE 0x80251940 RB_Val_Ws32 6553599.99847 RmpTrqPrpHigh -3276800.00000 3276799.99847 FORMAT "%13.5" /end CHARACTERISTIC
/begin CHARACTERISTIC StrtUpEv_dTqDrvAwyPBrkPsdNeg_C "Negative Slope of P-part torque after deactivating crawling controller" VALUE 0x80251944 RB_Val_Ws32 6553599.99847 RmpTrqPrpHigh -3276800.00000 3276799.99847 FORMAT "%13.5" /end CHARACTERISTIC
/begin CHARACTERISTIC StrtUpEv_dTqDrvAwyPBrkPsdPos_C "Positive slope of P-part torque after deactivating crawling controller" VALUE 0x80251948 RB_Val_Ws32 6553599.99847 RmpTrqPrpHigh -3276800.00000 3276799.99847 FORMAT "%13.5" /end CHARACTERISTIC
/begin CHARACTERISTIC StrtUpEv_dTqDrvAwyPNeg_C "Slope of P-part torque after deactivating" VALUE 0x8025194C RB_Val_Ws32 6553599.99847 RmpTrqPrpHigh -3276800.00000 3276799.99847 FORMAT "%13.5" /end CHARACTERISTIC
/begin CHARACTERISTIC StrtUpEv_dTqDrvAwyPPos_C "Slope of P-part torque after activating" VALUE 0x80251950 RB_Val_Ws32 6553599.99847 RmpTrqPrpHigh -3276800.00000 3276799.99847 FORMAT "%13.5" /end CHARACTERISTIC
/begin CHARACTERISTIC StrtUpEv_dvDrvAwyRmpNeg_M "Negative ramp slope to control the vehicle speed set point of the crawling controller" MAP 0x80251954 RB_Map_U16U8_S16_sao 9.999847 RmpVel -5.000000 4.999847 FORMAT "%8.6"
 /begin AXIS_DESCR STD_AXIS MoFTqPtdVeh_stDrvProgReqMsg OneToOne 3 0.00 65535.00 FORMAT "%8.2" DEPOSIT ABSOLUTE /end AXIS_DESCR
 /begin AXIS_DESCR STD_AXIS DrvMod_stPosn DrvMod_stPosn_VERB 3 0.00 6.00000000000 FORMAT "%13.11" DEPOSIT ABSOLUTE /end AXIS_DESCR
/end CHARACTERISTIC
/begin CHARACTERISTIC StrtUpEv_dvDrvAwyRmpPos_M "Positive ramp slope to control the vehicle speed set point of the crawling controller" MAP 0x80251974 RB_Map_U16U8_S16_sao 9.999847 RmpVel -5.000000 4.999847 FORMAT "%8.6"
 /begin AXIS_DESCR STD_AXIS MoFTqPtdVeh_stDrvProgReqMsg OneToOne 3 0.00 65535.00 FORMAT "%8.2" DEPOSIT ABSOLUTE /end AXIS_DESCR
 /begin AXIS_DESCR STD_AXIS DrvMod_stPosn DrvMod_stPosn_VERB 3 0.00 6.00000000000 FORMAT "%13.11" DEPOSIT ABSOLUTE /end AXIS_DESCR
/end CHARACTERISTIC
/begin CHARACTERISTIC StrtUpEv_facDrvAwyRmp_T "calibratable curve for factor to provide wide range of ramp rates based on vehicle speed" CURVE 0x80251994 RB_Curve_S16_S16 7.999878 Fact -4.000000 3.999878 FORMAT "%8.6"
 /begin AXIS_DESCR STD_AXIS StrtUpEv_vRef Vel 15 -327.6800 327.6700 FORMAT "%8.4" DEPOSIT ABSOLUTE /end AXIS_DESCR
/end CHARACTERISTIC
/begin CHARACTERISTIC StrtUpEv_flgHillHldEnad_C "Status flag indicating enabling or disabling creep function due to Hill hold function" VALUE 0x802519D2 RB_Val_Wboolean 1.00000000000 B_TRUE 0.00 1.00000000000 FORMAT "%13.11" /end CHARACTERISTIC
/begin CHARACTERISTIC StrtUpEv_rAPPReacvnThd_C "gas pedal threshold for reactivation of crawling controller after irreversible deactivation" VALUE 0x802519D4 RB_Val_Ws16 799.9878 Prc -400.0000 399.9878 FORMAT "%8.4" /end CHARACTERISTIC
/begin CHARACTERISTIC StrtUpEv_stDiDeactvnCdn_C "Codeword for disabling deactivation conditions" VALUE 0x802519D6 RB_Val_Wu8 255.0 OneToOne 0.00 255.0 FORMAT "%5.1" /end CHARACTERISTIC
/begin CHARACTERISTIC StrtUpEv_stDrvAwyCtrlDiMask_C "Bit mask for setting the deactivation conditions of the drive-away or crawling controller" VALUE 0x802519D8 RB_Val_Wu32 4294967295.00 OneToOne 0.00 4294967295.00 FORMAT "%13.2" /end CHARACTERISTIC
/begin CHARACTERISTIC StrtUpEv_stPrmntDeactvdMask_C "Bit mask for setting the permanent deactivation for crawling controller" VALUE 0x802519DC RB_Val_Wu32 4294967295.00 OneToOne 0.00 4294967295.00 FORMAT "%13.2" /end CHARACTERISTIC
/begin CHARACTERISTIC StrtUpEv_stPrmntDeactvn_C "by enabling or disabling the reactivation condition,it can be configured as either permanent or temporary deactivation condition" VALUE 0x802519E0 RB_Val_Wu8 255.0 OneToOne 0.00 255.0 FORMAT "%5.1" /end CHARACTERISTIC
/begin CHARACTERISTIC StrtUpEv_stTempDeactvdMask_C "Bit mask for setting the temporary deactivation for crawling controller" VALUE 0x802519E4 RB_Val_Wu32 4294967295.00 OneToOne 0.00 4294967295.00 FORMAT "%13.2" /end CHARACTERISTIC
/begin CHARACTERISTIC StrtUpEv_stTqIntvLimdMask_C "mask for selecting torque limitations of ESP or dynamic E-Machine limits" VALUE 0x802519E8 RB_Val_Wu8 255.0 OneToOne 0.00 255.0 FORMAT "%5.1" /end CHARACTERISTIC
/begin CHARACTERISTIC StrtUpEv_stTqLimdMask_C "Bit mask for selecting the limits of drive torque in entire powertrain related to Anti-Reset-Windup" VALUE 0x802519E9 RB_Val_Wu8 255.0 OneToOne 0.00 255.0 FORMAT "%5.1" /end CHARACTERISTIC
/begin CHARACTERISTIC StrtUpEv_tiStandStillDeactvn_C "Time threshold after which the active crawling controller or drive away controller is shut-off during vehicle stand still" VALUE 0x802519EA RB_Val_Ws16 655.3500 Time_s -327.6800 327.6700 FORMAT "%8.4" /end CHARACTERISTIC
/begin CHARACTERISTIC StrtUpEv_tqDesMax_T "Maximum torque for start up control. By calibration this value should be not bigger than static system limits, like gearbox protection torque (gearbox input limit)" CURVE 0x802519EC RB_Curve_S16_S32_sao 429496729.500 TrqPrpHigh -214748364.800 214748364.700 FORMAT "%13.3"
 /begin AXIS_DESCR STD_AXIS StrtUpEv_vRef Vel 9 -327.6800 327.6700 FORMAT "%8.4" DEPOSIT ABSOLUTE /end AXIS_DESCR
/end CHARACTERISTIC
/begin CHARACTERISTIC StrtUpEv_tqDesMin_T "Miniimum torque for start up control. By calibration this value should be not lower than static system limits, like gearbox protection torque (gearbox input limit). To avoid limitation of the recuperation requested by the acceleration pedal function, this" CURVE 0x80251A24 RB_Curve_S16_S32_sao 429496729.500 TrqPrpHigh -214748364.800 214748364.700 FORMAT "%13.3"
 /begin AXIS_DESCR STD_AXIS StrtUpEv_vRef Vel 9 -327.6800 327.6700 FORMAT "%8.4" DEPOSIT ABSOLUTE /end AXIS_DESCR
/end CHARACTERISTIC
/begin CHARACTERISTIC StrtUpEv_tqDesRvsMax_T "Maximum desired torque for gear set R" CURVE 0x80251A5C RB_Curve_S16_S32_sao 429496729.500 TrqPrpHigh -214748364.800 214748364.700 FORMAT "%13.3"
 /begin AXIS_DESCR STD_AXIS StrtUpEv_vRef Vel 9 -327.6800 327.6700 FORMAT "%8.4" DEPOSIT ABSOLUTE /end AXIS_DESCR
/end CHARACTERISTIC
/begin CHARACTERISTIC StrtUpEv_tqDesRvsMin_T "Minimum desired torque for gear set R." CURVE 0x80251A94 RB_Curve_S16_S32_sao 429496729.500 TrqPrpHigh -214748364.800 214748364.700 FORMAT "%13.3"
 /begin AXIS_DESCR STD_AXIS StrtUpEv_vRef Vel 9 -327.6800 327.6700 FORMAT "%8.4" DEPOSIT ABSOLUTE /end AXIS_DESCR
/end CHARACTERISTIC
/begin CHARACTERISTIC StrtUpEv_tqDrvAwyIEco_M "I-part of start up controller in Eco mode" MAP 0x80251ACC RB_Map_S16U8_S16_sao 65535.00 TrqPerSec -32768.00 32767.00 FORMAT "%8.2"
 /begin AXIS_DESCR STD_AXIS StrtUpEv_vDrvAwyDif Vel 15 -327.6800 327.6700 FORMAT "%8.4" DEPOSIT ABSOLUTE /end AXIS_DESCR
 /begin AXIS_DESCR STD_AXIS DrvMod_stPosn DrvMod_stPosn_VERB 3 0.00 6.00000000000 FORMAT "%13.11" DEPOSIT ABSOLUTE /end AXIS_DESCR
/end CHARACTERISTIC
/begin CHARACTERISTIC StrtUpEv_tqDrvAwyINorm_M "I-part of start up controller in normal mode" MAP 0x80251B4C RB_Map_S16U8_S16_sao 65535.00 TrqPerSec -32768.00 32767.00 FORMAT "%8.2"
 /begin AXIS_DESCR STD_AXIS StrtUpEv_vDrvAwyDif Vel 15 -327.6800 327.6700 FORMAT "%8.4" DEPOSIT ABSOLUTE /end AXIS_DESCR
 /begin AXIS_DESCR STD_AXIS DrvMod_stPosn DrvMod_stPosn_VERB 3 0.00 6.00000000000 FORMAT "%13.11" DEPOSIT ABSOLUTE /end AXIS_DESCR
/end CHARACTERISTIC
/begin CHARACTERISTIC StrtUpEv_tqDrvAwyISpt_M "I-part of start up controller in sports mode" MAP 0x80251BCC RB_Map_S16U8_S16_sao 65535.00 TrqPerSec -32768.00 32767.00 FORMAT "%8.2"
 /begin AXIS_DESCR STD_AXIS StrtUpEv_vDrvAwyDif Vel 15 -327.6800 327.6700 FORMAT "%8.4" DEPOSIT ABSOLUTE /end AXIS_DESCR
 /begin AXIS_DESCR STD_AXIS DrvMod_stPosn DrvMod_stPosn_VERB 3 0.00 6.00000000000 FORMAT "%13.11" DEPOSIT ABSOLUTE /end AXIS_DESCR
/end CHARACTERISTIC
/begin CHARACTERISTIC StrtUpEv_tqDrvAwyPEco_M "p-part of start up controller in Eco mode" MAP 0x80251C4C RB_Map_S16U8_S16_sao 104856.0 TrqPrp -52428.80 52427.20 FORMAT "%8.2"
 /begin AXIS_DESCR STD_AXIS StrtUpEv_vDrvAwyDif Vel 15 -327.6800 327.6700 FORMAT "%8.4" DEPOSIT ABSOLUTE /end AXIS_DESCR
 /begin AXIS_DESCR STD_AXIS DrvMod_stPosn DrvMod_stPosn_VERB 3 0.00 6.00000000000 FORMAT "%13.11" DEPOSIT ABSOLUTE /end AXIS_DESCR
/end CHARACTERISTIC
/begin CHARACTERISTIC StrtUpEv_tqDrvAwyPNorm_M "p-part of start up controller in Normal mode" MAP 0x80251CCC RB_Map_S16U8_S16_sao 104856.0 TrqPrp -52428.80 52427.20 FORMAT "%8.2"
 /begin AXIS_DESCR STD_AXIS StrtUpEv_vDrvAwyDif Vel 15 -327.6800 327.6700 FORMAT "%8.4" DEPOSIT ABSOLUTE /end AXIS_DESCR
 /begin AXIS_DESCR STD_AXIS DrvMod_stPosn DrvMod_stPosn_VERB 3 0.00 6.00000000000 FORMAT "%13.11" DEPOSIT ABSOLUTE /end AXIS_DESCR
/end CHARACTERISTIC
/begin CHARACTERISTIC StrtUpEv_tqDrvAwyPreCtrlEco_M "precontrol part of startup controller in Eco mode" MAP 0x80251D4C RB_Map_S16U8_S16_sao 104856.0 TrqPrp -52428.80 52427.20 FORMAT "%8.2"
 /begin AXIS_DESCR STD_AXIS StrtUpEv_vRef Vel 15 -327.6800 327.6700 FORMAT "%8.4" DEPOSIT ABSOLUTE /end AXIS_DESCR
 /begin AXIS_DESCR STD_AXIS DrvMod_stPosn DrvMod_stPosn_VERB 2 0.00 6.00000000000 FORMAT "%13.11" DEPOSIT ABSOLUTE /end AXIS_DESCR
/end CHARACTERISTIC
/begin CHARACTERISTIC StrtUpEv_tqDrvAwyPreCtrlNorm_M "precontrol part of startup controller in Normal mode" MAP 0x80251DAC RB_Map_S16U8_S16_sao 104856.0 TrqPrp -52428.80 52427.20 FORMAT "%8.2"
 /begin AXIS_DESCR STD_AXIS StrtUpEv_vRef Vel 15 -327.6800 327.6700 FORMAT "%8.4" DEPOSIT ABSOLUTE /end AXIS_DESCR
 /begin AXIS_DESCR STD_AXIS DrvMod_stPosn DrvMod_stPosn_VERB 2 0.00 6.00000000000 FORMAT "%13.11" DEPOSIT ABSOLUTE /end AXIS_DESCR
/end CHARACTERISTIC
/begin CHARACTERISTIC StrtUpEv_tqDrvAwyPreCtrlSpt_M "precontrol part of startup controller in sport mode" MAP 0x80251E0C RB_Map_S16U8_S16_sao 104856.0 TrqPrp -52428.80 52427.20 FORMAT "%8.2"
 /begin AXIS_DESCR STD_AXIS StrtUpEv_vRef Vel 15 -327.6800 327.6700 FORMAT "%8.4" DEPOSIT ABSOLUTE /end AXIS_DESCR
 /begin AXIS_DESCR STD_AXIS DrvMod_stPosn DrvMod_stPosn_VERB 2 0.00 6.00000000000 FORMAT "%13.11" DEPOSIT ABSOLUTE /end AXIS_DESCR
/end CHARACTERISTIC
/begin CHARACTERISTIC StrtUpEv_tqDrvAwyPSpt_M "p-part of start up controller in sport mode" MAP 0x80251E6C RB_Map_S16U8_S16_sao 104856.0 TrqPrp -52428.80 52427.20 FORMAT "%8.2"
 /begin AXIS_DESCR STD_AXIS StrtUpEv_vDrvAwyDif Vel 15 -327.6800 327.6700 FORMAT "%8.4" DEPOSIT ABSOLUTE /end AXIS_DESCR
 /begin AXIS_DESCR STD_AXIS DrvMod_stPosn DrvMod_stPosn_VERB 3 0.00 6.00000000000 FORMAT "%13.11" DEPOSIT ABSOLUTE /end AXIS_DESCR
/end CHARACTERISTIC
/begin CHARACTERISTIC StrtUpEv_tqIMax_C "Upper limit of integrator of the drive-away or crawling controller" VALUE 0x80251EEC RB_Val_Ws16 104856.0 TrqPrp -52428.80 52427.20 FORMAT "%8.2" /end CHARACTERISTIC
/begin CHARACTERISTIC StrtUpEv_tqIMin_C "Lower limit of integrator of the drive-away or crawling controller" VALUE 0x80251EEE RB_Val_Ws16 104856.0 TrqPrp -52428.80 52427.20 FORMAT "%8.2" /end CHARACTERISTIC
/begin CHARACTERISTIC StrtUpEv_vDeactvnPrmnt_C "Vehicle velocity for permanent deactivation" VALUE 0x80251EF0 RB_Val_Ws16 655.3500 Vel -327.6800 327.6700 FORMAT "%8.4" /end CHARACTERISTIC
/begin CHARACTERISTIC StrtUpEv_vDeltaDrvAwyCtrlActvn_C "Vehicle speed deviation for defining the lower vehicle speed threshold which the drive-away or crawling controller is reactivated" VALUE 0x80251EF2 RB_Val_Ws16 655.3500 Vel -327.6800 327.6700 FORMAT "%8.4" /end CHARACTERISTIC
/begin CHARACTERISTIC StrtUpEv_vDeltaDrvAwyCtrlDeactvn_C "Vehicle speed deviation for defining the upper vehicle speed threshold which the drive-away or crawling controller is deactivated" VALUE 0x80251EF4 RB_Val_Ws16 655.3500 Vel -327.6800 327.6700 FORMAT "%8.4" /end CHARACTERISTIC
/begin CHARACTERISTIC StrtUpEv_vDrvAwyDesBrkStEco_M "Map for creeping velocity depending on engaged gear and brake pedal state in Eco mode" MAP 0x80251EF6 RB_Map_U8U8_S16_sao 655.3500 Vel -327.6800 327.6700 FORMAT "%8.4"
 /begin AXIS_DESCR STD_AXIS Brk_st OneToOne 3 0.00 255.0 FORMAT "%5.1" DEPOSIT ABSOLUTE /end AXIS_DESCR
 /begin AXIS_DESCR STD_AXIS DrvMod_stPosn DrvMod_stPosn_VERB 3 0.00 6.00000000000 FORMAT "%13.11" DEPOSIT ABSOLUTE /end AXIS_DESCR
/end CHARACTERISTIC
/begin CHARACTERISTIC StrtUpEv_vDrvAwyDesBrkStNorm_M "Map for creeping velocity depending on engaged gear and brake pedal state in Normal mode" MAP 0x80251F10 RB_Map_U8U8_S16_sao 655.3500 Vel -327.6800 327.6700 FORMAT "%8.4"
 /begin AXIS_DESCR STD_AXIS Brk_st OneToOne 3 0.00 255.0 FORMAT "%5.1" DEPOSIT ABSOLUTE /end AXIS_DESCR
 /begin AXIS_DESCR STD_AXIS DrvMod_stPosn DrvMod_stPosn_VERB 3 0.00 6.00000000000 FORMAT "%13.11" DEPOSIT ABSOLUTE /end AXIS_DESCR
/end CHARACTERISTIC
/begin CHARACTERISTIC StrtUpEv_vDrvAwyDesBrkStSpt_M "Map for creeping velocity depending on engaged gear and brake pedal state in Sport mode" MAP 0x80251F2A RB_Map_U8U8_S16_sao 655.3500 Vel -327.6800 327.6700 FORMAT "%8.4"
 /begin AXIS_DESCR STD_AXIS Brk_st OneToOne 3 0.00 255.0 FORMAT "%5.1" DEPOSIT ABSOLUTE /end AXIS_DESCR
 /begin AXIS_DESCR STD_AXIS DrvMod_stPosn DrvMod_stPosn_VERB 3 0.00 6.00000000000 FORMAT "%13.11" DEPOSIT ABSOLUTE /end AXIS_DESCR
/end CHARACTERISTIC
/begin CHARACTERISTIC StrtUpEv_vReacvnThd_C "Vehicle speed for reactivaton" VALUE 0x80251F44 RB_Val_Ws16 655.3500 Vel -327.6800 327.6700 FORMAT "%8.4" /end CHARACTERISTIC
/begin CHARACTERISTIC StrtUpEv_vStandStill_C "Vehicle speed threshold for the detection of vehicle stand still for the deactivation of he crawling controller" VALUE 0x80251F46 RB_Val_Ws16 655.3500 Vel -327.6800 327.6700 FORMAT "%8.4" /end CHARACTERISTIC
/begin CHARACTERISTIC SVSLmp_tiBln_C "time of a half periode for blinking" VALUE 0x80268F48 Val_Wu8 12.65 t50msxs_q0p05 0.05 12.70 FORMAT "%5.2" EXTENDED_LIMITS 0.00 12.75 /end CHARACTERISTIC
/begin CHARACTERISTIC VehCoorn_wElecCnsTotWght_C "Calibration for VehCoorn_wElecCnsTotWght" VALUE 0x80251500 RB_Val_Wu16 65535.00 OneToOne 0.00 65535.00 FORMAT "%8.2" /end CHARACTERISTIC
/begin CHARACTERISTIC VehM_flgOnePedlDrvgOff_C "Callibration for Status Flag for one pedal driving off" VALUE 0x80251502 RB_Val_Wu8 1.000 OneToOne 0.00 1.000 FORMAT "%5.3" EXTENDED_LIMITS 0.00 255.0 /end CHARACTERISTIC
/begin MEASUREMENT ACCtl_nPwrLim "AC speed limitation based on HV power" UWORD RBPtCel_n_0p5_1 1 100 0.00 32767.50 FORMAT "%8.2" ECU_ADDRESS 0x6001FA44
 /begin IF_DATA XCPplus 0x0102
  /begin DAQ_EVENT VARIABLE /end DAQ_EVENT
 /end IF_DATA
/end MEASUREMENT
/begin MEASUREMENT AirC_pClnt "Air Condition coolant pressure" SWORD PresAC_hPa 1 100 -65536.00 65534.00 FORMAT "%8.2" ECU_ADDRESS 0x6001FC42
 /begin IF_DATA XCPplus 0x0102
  /begin DAQ_EVENT VARIABLE /end DAQ_EVENT
 /end IF_DATA
/end MEASUREMENT
/begin MEASUREMENT AirC_pRefgntUs "upstream refrigerant pressure" SWORD PresAC_hPa 1 100 -65536.00 65534.00 FORMAT "%8.2" ECU_ADDRESS 0x6001FC40
 /begin IF_DATA XCPplus 0x0102
  /begin DAQ_EVENT VARIABLE /end DAQ_EVENT
 /end IF_DATA
/end MEASUREMENT
/begin MEASUREMENT AirC_rClgDem "AC Compressor Cooling demand" SWORD Prc 1 100 -400.0000 399.9878 FORMAT "%8.4" ECU_ADDRESS 0x6001FC3E
 /begin IF_DATA XCPplus 0x0102
  /begin DAQ_EVENT VARIABLE /end DAQ_EVENT
 /end IF_DATA
/end MEASUREMENT
/begin MEASUREMENT Brk_flgPrkgBrkActv "Parking brake active" UBYTE B_TRUE 1 100 0.00 1.00000000000 BIT_MASK 0x1 FORMAT "%13.11" ECU_ADDRESS 0x600234E4
 /begin IF_DATA XCPplus 0x0102
  /begin DAQ_EVENT VARIABLE /end DAQ_EVENT
 /end IF_DATA
/end MEASUREMENT
/begin MEASUREMENT Brk_r "Standardized angle of brake pedal" SWORD Prc 1 100 0.00 100.0000 FORMAT "%8.4" ECU_ADDRESS 0x6001FC20
 /begin IF_DATA XCPplus 0x0102
  /begin DAQ_EVENT VARIABLE /end DAQ_EVENT
 /end IF_DATA
/end MEASUREMENT
/begin MEASUREMENT CcsCom_stEgyTrfModSeld "RequestedEnergyTransferMode" UBYTE CcsCom_stEgyTrfModSeld_VERB 1 100 0.00 6.00000000000 FORMAT "%13.11" ECU_ADDRESS 0x60023675
 /begin IF_DATA XCPplus 0x0102
  /begin DAQ_EVENT VARIABLE /end DAQ_EVENT
 /end IF_DATA
/end MEASUREMENT
/begin MEASUREMENT ChgrPlug_stCtpSwtActr "" UBYTE ChgrPlug_stCtpSwtActr_VERB 1 100 0.00 3.00000000000 FORMAT "%13.11" ECU_ADDRESS 0x60023663
 /begin IF_DATA XCPplus 0x0102
  /begin DAQ_EVENT VARIABLE /end DAQ_EVENT
 /end IF_DATA
/end MEASUREMENT
/begin MEASUREMENT ChgrPlug_stPlgLockTx "" UBYTE ChgrPlug_stPlgLock_VERB 1 100 0.00 3.00000000000 FORMAT "%13.11" ECU_ADDRESS 0x60023662
 /begin IF_DATA XCPplus 0x0102
  /begin DAQ_EVENT VARIABLE /end DAQ_EVENT
 /end IF_DATA
/end MEASUREMENT
/begin MEASUREMENT ChrgrRly_flgClsRly "desired charging relay status" UBYTE B_TRUE 1 100 0.00 1.00000000000 BIT_MASK 0x1 FORMAT "%13.11" ECU_ADDRESS 0x600234CE
 /begin IF_DATA XCPplus 0x0102
  /begin DAQ_EVENT VARIABLE /end DAQ_EVENT
 /end IF_DATA
/end MEASUREMENT
/begin MEASUREMENT ChrgrRly_st "Status of DC charging relay" UBYTE RBPtEChrDv_stChrgrRly_VERB 1 100 0.00 7.00000000000 FORMAT "%13.11" ECU_ADDRESS 0x60023650
 /begin IF_DATA XCPplus 0x0102
  /begin DAQ_EVENT VARIABLE /end DAQ_EVENT
 /end IF_DATA
/end MEASUREMENT
/begin MEASUREMENT CoEng_st "Engine operation status" UBYTE CoEng_st_COMPU_VERB 1 100 0.00 5.00000000000 FORMAT "%13.11" ECU_ADDRESS 0x60023648
 /begin IF_DATA XCPplus 0x0102
  /begin DAQ_EVENT VARIABLE /end DAQ_EVENT
 /end IF_DATA
/end MEASUREMENT
/begin MEASUREMENT ComEmac_flgEmgyShtDwnReq01_Sq "Signal quality message for ComEmac_flgEmgyShtDwnReq01" UBYTE SigQly_COMPU_VERB 1 100 0.00 15.0000000000 FORMAT "%13.10" ECU_ADDRESS 0x60023639
 /begin IF_DATA XCPplus 0x0102
  /begin DAQ_EVENT VARIABLE /end DAQ_EVENT
 /end IF_DATA
/end MEASUREMENT
/begin MEASUREMENT ComEmac_flgSvsReq01_Sq "Signal quality message for ComEmac_flgSvsReq01" UBYTE SigQly_COMPU_VERB 1 100 0.00 15.0000000000 FORMAT "%13.10" ECU_ADDRESS 0x60023638
 /begin IF_DATA XCPplus 0x0102
  /begin DAQ_EVENT VARIABLE /end DAQ_EVENT
 /end IF_DATA
/end MEASUREMENT
/begin MEASUREMENT ComEmac_flgSvsReq01_Sq_Loc "" UBYTE B_TRUE 1 100 0.00 1.00000000000 BIT_MASK 0x1 FORMAT "%13.11" ECU_ADDRESS 0x60023000
 /begin IF_DATA XCPplus 0x0102
  /begin DAQ_EVENT VARIABLE /end DAQ_EVENT
 /end IF_DATA
/end MEASUREMENT
/begin MEASUREMENT ComEmac_iDcLnk01_Sq "Signal quality for DC link current, e-machine 01" UBYTE SigQly_COMPU_VERB 1 100 0.00 15.0000000000 FORMAT "%13.10" ECU_ADDRESS 0x60023637
 /begin IF_DATA XCPplus 0x0102
  /begin DAQ_EVENT VARIABLE /end DAQ_EVENT
 /end IF_DATA
/end MEASUREMENT
/begin MEASUREMENT ComEmac_nAct01_Sq "Signal quality for Actual engine speed, e-machine 01" UBYTE SigQly_COMPU_VERB 1 100 0.00 15.0000000000 FORMAT "%13.10" ECU_ADDRESS 0x60023636
 /begin IF_DATA XCPplus 0x0102
  /begin DAQ_EVENT VARIABLE /end DAQ_EVENT
 /end IF_DATA
/end MEASUREMENT
/begin MEASUREMENT ComEmac_stMod01_Sq "Signal quality of E machine 01 state" UBYTE SigQly_COMPU_VERB 1 100 0.00 15.0000000000 FORMAT "%13.10" ECU_ADDRESS 0x60023632
 /begin IF_DATA XCPplus 0x0102
  /begin DAQ_EVENT VARIABLE /end DAQ_EVENT
 /end IF_DATA
/end MEASUREMENT
/begin MEASUREMENT ComEmac_tInvr01_Sq "Signal quality for Inverter temperature, e-machine 01" UBYTE SigQly_COMPU_VERB 1 100 0.00 15.0000000000 FORMAT "%13.10" ECU_ADDRESS 0x6002345C
 /begin IF_DATA XCPplus 0x0102
  /begin DAQ_EVENT VARIABLE /end DAQ_EVENT
 /end IF_DATA
/end MEASUREMENT
/begin MEASUREMENT ComEmac_tIvtrCoolt01_Sq "Signal quality for Coolant temperature of inverter, e-machine 01" UBYTE SigQly_COMPU_VERB 1 100 0.00 15.0000000000 FORMAT "%13.10" ECU_ADDRESS 0x60023630
 /begin IF_DATA XCPplus 0x0102
  /begin DAQ_EVENT VARIABLE /end DAQ_EVENT
 /end IF_DATA
/end MEASUREMENT
/begin MEASUREMENT ComEmac_tMac01_Sq "Signal quality for Stator temperature, e-machine 01" UBYTE SigQly_COMPU_VERB 1 100 0.00 15.0000000000 FORMAT "%13.10" ECU_ADDRESS 0x6002345B
 /begin IF_DATA XCPplus 0x0102
  /begin DAQ_EVENT VARIABLE /end DAQ_EVENT
 /end IF_DATA
/end MEASUREMENT
/begin MEASUREMENT ComEmac_tqAbsltMax01_Sq "signal quality for Absolute Maximum value for torque, e-machine 01" UBYTE SigQly_COMPU_VERB 1 100 0.00 15.0000000000 FORMAT "%13.10" ECU_ADDRESS 0x6002362F
 /begin IF_DATA XCPplus 0x0102
  /begin DAQ_EVENT VARIABLE /end DAQ_EVENT
 /end IF_DATA
/end MEASUREMENT
/begin MEASUREMENT ComEmac_tqAbsltMin01_Sq "signal quality for Absolute Minimum value for torque, e-machine 01" UBYTE SigQly_COMPU_VERB 1 100 0.00 15.0000000000 FORMAT "%13.10" ECU_ADDRESS 0x6002362E
 /begin IF_DATA XCPplus 0x0102
  /begin DAQ_EVENT VARIABLE /end DAQ_EVENT
 /end IF_DATA
/end MEASUREMENT
/begin MEASUREMENT ComEmac_tqAct01_Sq "Signal quality Actual torque, e-machine 01" UBYTE SigQly_COMPU_VERB 1 100 0.00 15.0000000000 FORMAT "%13.10" ECU_ADDRESS 0x6002362D
 /begin IF_DATA XCPplus 0x0102
  /begin DAQ_EVENT VARIABLE /end DAQ_EVENT
 /end IF_DATA
/end MEASUREMENT
/begin MEASUREMENT ComEmac_uDcLnk01_Sq "Signal quality for Actual DC link voltage of e-machine 01" UBYTE SigQly_COMPU_VERB 1 100 0.00 15.0000000000 FORMAT "%13.10" ECU_ADDRESS 0x6002362C
 /begin IF_DATA XCPplus 0x0102
  /begin DAQ_EVENT VARIABLE /end DAQ_EVENT
 /end IF_DATA
/end MEASUREMENT
/begin MEASUREMENT Com_25h_B1b0 "Definition for Com_25h_B1b0" UBYTE OneToOne 1 100 0.00 255.0 FORMAT "%5.1" ECU_ADDRESS 0x6002362B
 /begin IF_DATA XCPplus 0x0102
  /begin DAQ_EVENT VARIABLE /end DAQ_EVENT
 /end IF_DATA
/end MEASUREMENT
/begin MEASUREMENT Com_25h_B1b2 "Definition for Com_25h_B1b2" UBYTE OneToOne 1 100 0.00 255.0 FORMAT "%5.1" ECU_ADDRESS 0x6002362A
 /begin IF_DATA XCPplus 0x0102
  /begin DAQ_EVENT VARIABLE /end DAQ_EVENT
 /end IF_DATA
/end MEASUREMENT
/begin MEASUREMENT Com_25h_B1b4 "Definition for Com_25h_B1b4" UBYTE OneToOne 1 100 0.00 255.0 FORMAT "%5.1" ECU_ADDRESS 0x60023629
 /begin IF_DATA XCPplus 0x0102
  /begin DAQ_EVENT VARIABLE /end DAQ_EVENT
 /end IF_DATA
/end MEASUREMENT
/begin MEASUREMENT Com_25h_B1b6 "Definition for Com_25h_B1b6" UBYTE B_TRUE 1 100 0.00 1.00000000000 BIT_MASK 0x1 FORMAT "%13.11" ECU_ADDRESS 0x600234C2
 /begin IF_DATA XCPplus 0x0102
  /begin DAQ_EVENT VARIABLE /end DAQ_EVENT
 /end IF_DATA
/end MEASUREMENT
/begin MEASUREMENT Com_bDiagMuxOn "Defnitino for Com_bDiagMuxOn" UBYTE B_TRUE 1 100 0.00 1.00000000000 BIT_MASK 0x1 FORMAT "%13.11" ECU_ADDRESS 0x600234BE
 /begin IF_DATA XCPplus 0x0102
  /begin DAQ_EVENT VARIABLE /end DAQ_EVENT
 /end IF_DATA
/end MEASUREMENT
/begin MEASUREMENT Com_flgBlowrRlyCtrl "" UBYTE B_TRUE 1 100 0.00 1.00000000000 BIT_MASK 0x1 FORMAT "%13.11" ECU_ADDRESS 0x600234B9
 /begin IF_DATA XCPplus 0x0102
  /begin DAQ_EVENT VARIABLE /end DAQ_EVENT
 /end IF_DATA
/end MEASUREMENT
/begin MEASUREMENT Com_flgBlwrActv "Blower Active signal from BUS" UBYTE OneToOne 1 100 0.00 255.0 FORMAT "%5.1" ECU_ADDRESS 0x60023624
 /begin IF_DATA XCPplus 0x0102
  /begin DAQ_EVENT VARIABLE /end DAQ_EVENT
 /end IF_DATA
/end MEASUREMENT
/begin MEASUREMENT Com_flgEcoNormReq "Drive Mode request via CAN" UBYTE B_TRUE 1 100 0.00 1.00000000000 BIT_MASK 0x1 FORMAT "%13.11" ECU_ADDRESS 0x600234B4
 /begin IF_DATA XCPplus 0x0102
  /begin DAQ_EVENT VARIABLE /end DAQ_EVENT
 /end IF_DATA
/end MEASUREMENT
/begin MEASUREMENT Com_flgHillHldActvd_Sq "Signal Quality esp_HillHold_Status" UBYTE SigQly_COMPU_VERB 1 100 0.00 15.0000000000 FORMAT "%13.10" ECU_ADDRESS 0x60023622
 /begin IF_DATA XCPplus 0x0102
  /begin DAQ_EVENT VARIABLE /end DAQ_EVENT
 /end IF_DATA
/end MEASUREMENT
/begin MEASUREMENT Com_iElCmprHvAct_Sq "Signal Quality of Validity of measured compressor current" UBYTE SigQly_COMPU_VERB 1 100 0.00 15.0000000000 FORMAT "%13.10" ECU_ADDRESS 0x6002361E
 /begin IF_DATA XCPplus 0x0102
  /begin DAQ_EVENT VARIABLE /end DAQ_EVENT
 /end IF_DATA
/end MEASUREMENT
/begin MEASUREMENT Com_iElCmprHvAct_SqLoc "" UBYTE B_TRUE 1 100 0.00 1.00000000000 BIT_MASK 0x1 FORMAT "%13.11" ECU_ADDRESS 0x60022FFF
 /begin IF_DATA XCPplus 0x0102
  /begin DAQ_EVENT VARIABLE /end DAQ_EVENT
 /end IF_DATA
/end MEASUREMENT
/begin MEASUREMENT Com_iHvbAct_Sq "Actual current signal quality of the HV battery" UBYTE SigQly_COMPU_VERB 1 100 0.00 15.0000000000 FORMAT "%13.10" ECU_ADDRESS 0x6002361D
 /begin IF_DATA XCPplus 0x0102
  /begin DAQ_EVENT VARIABLE /end DAQ_EVENT
 /end IF_DATA
/end MEASUREMENT
/begin MEASUREMENT Com_iHvbChrgMaxContns "Continuous Maximum charging current of HV Battery" SWORD Curr_A_q0p03125_COMPU 1 100 -1024.000 1023.969 FORMAT "%8.3" ECU_ADDRESS 0x6001FBCE
 /begin IF_DATA XCPplus 0x0102
  /begin DAQ_EVENT VARIABLE /end DAQ_EVENT
 /end IF_DATA
/end MEASUREMENT
/begin MEASUREMENT Com_iHvbChrgMaxContns_Sq "Signal quality of Continuous Maximum charging current of HV Battery" UBYTE SigQly_COMPU_VERB 1 100 0.00 15.0000000000 FORMAT "%13.10" ECU_ADDRESS 0x6002361C
 /begin IF_DATA XCPplus 0x0102
  /begin DAQ_EVENT VARIABLE /end DAQ_EVENT
 /end IF_DATA
/end MEASUREMENT
/begin MEASUREMENT Com_iHvbChrgMaxSho_Sq "Signal quality of Short-term Maximum Charging current of HV Battery" UBYTE SigQly_COMPU_VERB 1 100 0.00 15.0000000000 FORMAT "%13.10" ECU_ADDRESS 0x6002361B
 /begin IF_DATA XCPplus 0x0102
  /begin DAQ_EVENT VARIABLE /end DAQ_EVENT
 /end IF_DATA
/end MEASUREMENT
/begin MEASUREMENT Com_iHvbDchaMaxContns "Continuous Maximum Discharging current of HV Battery" SWORD Curr_A_q0p03125_COMPU 1 100 -1024.000 1023.969 FORMAT "%8.3" ECU_ADDRESS 0x6001FBCC
 /begin IF_DATA XCPplus 0x0102
  /begin DAQ_EVENT VARIABLE /end DAQ_EVENT
 /end IF_DATA
/end MEASUREMENT
/begin MEASUREMENT Com_iHvbDchaMaxContns_Sq "Signal quality of Continuous Maximum Discharging current of HV Battery" UBYTE SigQly_COMPU_VERB 1 100 0.00 15.0000000000 FORMAT "%13.10" ECU_ADDRESS 0x6002361A
 /begin IF_DATA XCPplus 0x0102
  /begin DAQ_EVENT VARIABLE /end DAQ_EVENT
 /end IF_DATA
/end MEASUREMENT
/begin MEASUREMENT Com_iHvbDchaMaxSho_Sq "Signal quality of Short-term Maximum Discharging current of HV Battery" UBYTE SigQly_COMPU_VERB 1 100 0.00 15.0000000000 FORMAT "%13.10" ECU_ADDRESS 0x60023619
 /begin IF_DATA XCPplus 0x0102
  /begin DAQ_EVENT VARIABLE /end DAQ_EVENT
 /end IF_DATA
/end MEASUREMENT
/begin MEASUREMENT Com_iHvbDes_Sq "Signal quality of maximum desired current to HV battery" UBYTE SigQly_COMPU_VERB 1 100 0.00 15.0000000000 FORMAT "%13.10" ECU_ADDRESS 0x60023459
 /begin IF_DATA XCPplus 0x0102
  /begin DAQ_EVENT VARIABLE /end DAQ_EVENT
 /end IF_DATA
/end MEASUREMENT
/begin MEASUREMENT Com_ratHvbSoc_Sq "State of charge signal quality of the HV battery" UBYTE SigQly_COMPU_VERB 1 100 0.00 15.0000000000 FORMAT "%13.10" ECU_ADDRESS 0x60023612
 /begin IF_DATA XCPplus 0x0102
  /begin DAQ_EVENT VARIABLE /end DAQ_EVENT
 /end IF_DATA
/end MEASUREMENT
/begin MEASUREMENT Com_stDsqElCmprFltLvl "" UBYTE OneToOne 1 100 0.00 255.0 FORMAT "%5.1" ECU_ADDRESS 0x600235F9
 /begin IF_DATA XCPplus 0x0102
  /begin DAQ_EVENT VARIABLE /end DAQ_EVENT
 /end IF_DATA
/end MEASUREMENT
/begin MEASUREMENT Com_stDsqpwrElCmprActl "Validity of compressor actual power" UBYTE OneToOne 1 100 0.00 255.0 FORMAT "%5.1" ECU_ADDRESS 0x600235F8
 /begin IF_DATA XCPplus 0x0102
  /begin DAQ_EVENT VARIABLE /end DAQ_EVENT
 /end IF_DATA
/end MEASUREMENT
/begin MEASUREMENT Com_stDsqstElCmprStat "" UBYTE OneToOne 1 100 0.00 255.0 FORMAT "%5.1" ECU_ADDRESS 0x600235F7
 /begin IF_DATA XCPplus 0x0102
  /begin DAQ_EVENT VARIABLE /end DAQ_EVENT
 /end IF_DATA
/end MEASUREMENT
/begin MEASUREMENT Com_stDsquElCmprHvAct "Validity of compressor measured voltage" UBYTE OneToOne 1 100 0.00 255.0 FORMAT "%5.1" ECU_ADDRESS 0x600235F6
 /begin IF_DATA XCPplus 0x0102
  /begin DAQ_EVENT VARIABLE /end DAQ_EVENT
 /end IF_DATA
/end MEASUREMENT
/begin MEASUREMENT Com_stHvbCntct_Sq "Signal Quality Main contactor status of the HV battery" UBYTE SigQly_COMPU_VERB 1 100 0.00 15.0000000000 FORMAT "%13.10" ECU_ADDRESS 0x600235F0
 /begin IF_DATA XCPplus 0x0102
  /begin DAQ_EVENT VARIABLE /end DAQ_EVENT
 /end IF_DATA
/end MEASUREMENT
/begin MEASUREMENT Com_stHvbDernMaxT_Sq "Maxmimum Hv battery derating signal quality status" UBYTE SigQly_COMPU_VERB 1 100 0.00 15.0000000000 FORMAT "%13.10" ECU_ADDRESS 0x60023457
 /begin IF_DATA XCPplus 0x0102
  /begin DAQ_EVENT VARIABLE /end DAQ_EVENT
 /end IF_DATA
/end MEASUREMENT
/begin MEASUREMENT Com_stHvbDernMinT_Sq "signal quality state of the Hv battery temperature" UBYTE SigQly_COMPU_VERB 1 100 0.00 15.0000000000 FORMAT "%13.10" ECU_ADDRESS 0x60023456
 /begin IF_DATA XCPplus 0x0102
  /begin DAQ_EVENT VARIABLE /end DAQ_EVENT
 /end IF_DATA
/end MEASUREMENT
/begin MEASUREMENT Com_stHvbFlt_Sq "Signal Quality HV Battery Error" UBYTE SigQly_COMPU_VERB 1 100 0.00 15.0000000000 FORMAT "%13.10" ECU_ADDRESS 0x600235EE
 /begin IF_DATA XCPplus 0x0102
  /begin DAQ_EVENT VARIABLE /end DAQ_EVENT
 /end IF_DATA
/end MEASUREMENT
/begin MEASUREMENT Com_stHvbIntlck_Sq "HV interlock state signal quality" UBYTE SigQly_COMPU_VERB 1 100 0.00 15.0000000000 FORMAT "%13.10" ECU_ADDRESS 0x60023455
 /begin IF_DATA XCPplus 0x0102
  /begin DAQ_EVENT VARIABLE /end DAQ_EVENT
 /end IF_DATA
/end MEASUREMENT
/begin MEASUREMENT Com_stHvbIsoFlt_Sq "Isolations resistance error signal quality of HV battery" UBYTE SigQly_COMPU_VERB 1 100 0.00 15.0000000000 FORMAT "%13.10" ECU_ADDRESS 0x60023454
 /begin IF_DATA XCPplus 0x0102
  /begin DAQ_EVENT VARIABLE /end DAQ_EVENT
 /end IF_DATA
/end MEASUREMENT
/begin MEASUREMENT Com_stHvbMod_Sq "Signal Quality Status HV battery" UBYTE SigQly_COMPU_VERB 1 100 0.00 15.0000000000 FORMAT "%13.10" ECU_ADDRESS 0x600235EA
 /begin IF_DATA XCPplus 0x0102
  /begin DAQ_EVENT VARIABLE /end DAQ_EVENT
 /end IF_DATA
/end MEASUREMENT
/begin MEASUREMENT Com_tHvbAct_Sq "signal quality of Actual temperature of the high voltage battery" UBYTE SigQly_COMPU_VERB 1 100 0.00 15.0000000000 FORMAT "%13.10" ECU_ADDRESS 0x60023453
 /begin IF_DATA XCPplus 0x0102
  /begin DAQ_EVENT VARIABLE /end DAQ_EVENT
 /end IF_DATA
/end MEASUREMENT
/begin MEASUREMENT Com_uElCmprHvAct_Sq "Signal qualifier for Actual compressor measured voltage" UBYTE SigQly_COMPU_VERB 1 100 0.00 15.0000000000 FORMAT "%13.10" ECU_ADDRESS 0x60023452
 /begin IF_DATA XCPplus 0x0102
  /begin DAQ_EVENT VARIABLE /end DAQ_EVENT
 /end IF_DATA
/end MEASUREMENT
/begin MEASUREMENT Com_uHvbAct_Sq "Actual voltage signal quality of the HV battery" UBYTE SigQly_COMPU_VERB 1 100 0.00 15.0000000000 FORMAT "%13.10" ECU_ADDRESS 0x600235DB
 /begin IF_DATA XCPplus 0x0102
  /begin DAQ_EVENT VARIABLE /end DAQ_EVENT
 /end IF_DATA
/end MEASUREMENT
/begin MEASUREMENT Com_uHvbChrgMaxContns "Continuous Maximum Charging voltage of HV Battery" SWORD Volt_V_q0p03125_COMPU 1 100 -1024.000 1023.969 FORMAT "%8.3" ECU_ADDRESS 0x6001FBC4
 /begin IF_DATA XCPplus 0x0102
  /begin DAQ_EVENT VARIABLE /end DAQ_EVENT
 /end IF_DATA
/end MEASUREMENT
/begin MEASUREMENT Com_uHvbChrgMaxContns_Sq "Signal quality of Continuous Maximum Charging voltage of HV Battery" UBYTE SigQly_COMPU_VERB 1 100 0.00 15.0000000000 FORMAT "%13.10" ECU_ADDRESS 0x600235DA
 /begin IF_DATA XCPplus 0x0102
  /begin DAQ_EVENT VARIABLE /end DAQ_EVENT
 /end IF_DATA
/end MEASUREMENT
/begin MEASUREMENT Com_uHvbChrgMaxSho_Sq "signal quality of Short-term Maximum Charging voltage of HV Battery" UBYTE SigQly_COMPU_VERB 1 100 0.00 15.0000000000 FORMAT "%13.10" ECU_ADDRESS 0x600235D9
 /begin IF_DATA XCPplus 0x0102
  /begin DAQ_EVENT VARIABLE /end DAQ_EVENT
 /end IF_DATA
/end MEASUREMENT
/begin MEASUREMENT Com_uHvbDchaMaxContns "Continuous Maximum Discharging voltage of HV Battery" SWORD Volt_V_q0p03125_COMPU 1 100 -1024.000 1023.969 FORMAT "%8.3" ECU_ADDRESS 0x6001FBC0
 /begin IF_DATA XCPplus 0x0102
  /begin DAQ_EVENT VARIABLE /end DAQ_EVENT
 /end IF_DATA
/end MEASUREMENT
/begin MEASUREMENT Com_uHvbDchaMaxContns_Sq "Signal quality of Continuous Maximum Discharging voltage of HV Battery" UBYTE SigQly_COMPU_VERB 1 100 0.00 15.0000000000 FORMAT "%13.10" ECU_ADDRESS 0x600235D7
 /begin IF_DATA XCPplus 0x0102
  /begin DAQ_EVENT VARIABLE /end DAQ_EVENT
 /end IF_DATA
/end MEASUREMENT
/begin MEASUREMENT Com_uHvbDchaMaxSho_Sq "Signal quality of Short-term Maximum Discharging voltage of HV Battery" UBYTE SigQly_COMPU_VERB 1 100 0.00 15.0000000000 FORMAT "%13.10" ECU_ADDRESS 0x600235D6
 /begin IF_DATA XCPplus 0x0102
  /begin DAQ_EVENT VARIABLE /end DAQ_EVENT
 /end IF_DATA
/end MEASUREMENT
/begin MEASUREMENT Com_uHvbLimHi_Sq "Maximum Voltage signal quality of HV Battery" UBYTE SigQly_COMPU_VERB 1 100 0.00 15.0000000000 FORMAT "%13.10" ECU_ADDRESS 0x60023451
 /begin IF_DATA XCPplus 0x0102
  /begin DAQ_EVENT VARIABLE /end DAQ_EVENT
 /end IF_DATA
/end MEASUREMENT
/begin MEASUREMENT Com_uHvbNomChrgn_Sq "HV battery nominal voltage signal quality" UBYTE SigQly_COMPU_VERB 1 100 0.00 15.0000000000 FORMAT "%13.10" ECU_ADDRESS 0x600235D5
 /begin IF_DATA XCPplus 0x0102
  /begin DAQ_EVENT VARIABLE /end DAQ_EVENT
 /end IF_DATA
/end MEASUREMENT
/begin MEASUREMENT CtprotPostDrv_mp "Indicate if a postdrive extension is required" UBYTE OneToOne 1 100 0.00 255.0 BIT_MASK 0x1 FORMAT "%5.1" ECU_ADDRESS 0x70006C2B
 /begin IF_DATA XCPplus 0x0102
  /begin DAQ_EVENT VARIABLE /end DAQ_EVENT
 /end IF_DATA
/end MEASUREMENT
/begin MEASUREMENT Ctprot_stActFlag "Flag that indicates if the software is currently considered as illicit" UBYTE OneToOne 1 100 0.00 255.0 BIT_MASK 0x1 FORMAT "%5.1" ECU_ADDRESS 0x600234AB
 /begin IF_DATA XCPplus 0x0102
  /begin DAQ_EVENT VARIABLE /end DAQ_EVENT
 /end IF_DATA
/end MEASUREMENT
/begin MEASUREMENT Ctprot_stActFunc "Indicate if the ACT function is active or not." UBYTE OneToOne 1 100 0.00 255.0 BIT_MASK 0x1 FORMAT "%5.1" ECU_ADDRESS 0x600234AA
 /begin IF_DATA XCPplus 0x0102
  /begin DAQ_EVENT VARIABLE /end DAQ_EVENT
 /end IF_DATA
/end MEASUREMENT
/begin MEASUREMENT Ctprot_stActHistFlag "Flag that indicates if an illicit software was already installed." UBYTE OneToOne 1 100 0.00 255.0 BIT_MASK 0x1 FORMAT "%5.1" ECU_ADDRESS 0x600234A9
 /begin IF_DATA XCPplus 0x0102
  /begin DAQ_EVENT VARIABLE /end DAQ_EVENT
 /end IF_DATA
/end MEASUREMENT
/begin MEASUREMENT DcChrgrIntkT2_t "" SWORD q0p01_DegCgrd 1 100 -327.6800 327.6700 FORMAT "%8.4" ECU_ADDRESS 0x6001FBA6
 /begin IF_DATA XCPplus 0x0102
  /begin DAQ_EVENT VARIABLE /end DAQ_EVENT
 /end IF_DATA
/end MEASUREMENT
/begin MEASUREMENT DcChrgrIntkT_t "" SWORD q0p01_DegCgrd 1 100 -327.6800 327.6700 FORMAT "%8.4" ECU_ADDRESS 0x6001FBA4
 /begin IF_DATA XCPplus 0x0102
  /begin DAQ_EVENT VARIABLE /end DAQ_EVENT
 /end IF_DATA
/end MEASUREMENT
/begin MEASUREMENT DDRC_St.DFC_BlowrRlyErr "" ULONG DFC_OneToOne 1 100 0.00 536870911.000 BIT_MASK 0x1fffffff FORMAT "%13.3" ECU_ADDRESS 0x6001C1FC /end MEASUREMENT
/begin MEASUREMENT DDRC_St.DFC_ComElMIIvtrFltLvl4 "" ULONG DFC_OneToOne 1 100 0.00 536870911.000 BIT_MASK 0x1fffffff FORMAT "%13.3" ECU_ADDRESS 0x6001C2A4 /end MEASUREMENT
/begin MEASUREMENT DDRC_St.DFC_ComElMIIvtrFltLvl5 "" ULONG DFC_OneToOne 1 100 0.00 536870911.000 BIT_MASK 0x1fffffff FORMAT "%13.3" ECU_ADDRESS 0x6001C2A8 /end MEASUREMENT
/begin MEASUREMENT DDRC_St.DFC_PrkgBrkFailr "" ULONG DFC_OneToOne 1 100 0.00 536870911.000 BIT_MASK 0x1fffffff FORMAT "%13.3" ECU_ADDRESS 0x6001C454 /end MEASUREMENT
/begin MEASUREMENT DDRC_St.DFC_PtSysLimErr "" ULONG DFC_OneToOne 1 100 0.00 536870911.000 BIT_MASK 0x1fffffff FORMAT "%13.3" ECU_ADDRESS 0x6001C458 /end MEASUREMENT
/begin MEASUREMENT DDRC_St.DFC_SCtPmpRlyOL "" ULONG DFC_OneToOne 1 100 0.00 536870911.000 BIT_MASK 0x1fffffff FORMAT "%13.3" ECU_ADDRESS 0x6001CA94 /end MEASUREMENT
/begin MEASUREMENT DDRC_St.DFC_SCtPmpRlyOvrTemp "" ULONG DFC_OneToOne 1 100 0.00 536870911.000 BIT_MASK 0x1fffffff FORMAT "%13.3" ECU_ADDRESS 0x6001CA98 /end MEASUREMENT
/begin MEASUREMENT DDRC_St.DFC_SCtPmpRlySCB "" ULONG DFC_OneToOne 1 100 0.00 536870911.000 BIT_MASK 0x1fffffff FORMAT "%13.3" ECU_ADDRESS 0x6001CA9C /end MEASUREMENT
/begin MEASUREMENT DDRC_St.DFC_SpplCooltPmpRlyOL "" ULONG DFC_OneToOne 1 100 0.00 536870911.000 BIT_MASK 0x1fffffff FORMAT "%13.3" ECU_ADDRESS 0x6001CAA0 /end MEASUREMENT
/begin MEASUREMENT DDRC_St.DFC_SpplCooltPmpRlyOvrTemp "" ULONG DFC_OneToOne 1 100 0.00 536870911.000 BIT_MASK 0x1fffffff FORMAT "%13.3" ECU_ADDRESS 0x6001CAA4 /end MEASUREMENT
/begin MEASUREMENT DDRC_St.DFC_SpplCooltPmpRlySCB "" ULONG DFC_OneToOne 1 100 0.00 536870911.000 BIT_MASK 0x1fffffff FORMAT "%13.3" ECU_ADDRESS 0x6001CAA8 /end MEASUREMENT
/begin MEASUREMENT DDRC_St.DFC_SCtPmpRlySCG "" UWORD DFC_OneToOne 1 100 0.00 8191.000 BIT_MASK 0x1fff FORMAT "%8.3" ECU_ADDRESS 0x60021FE0 /end MEASUREMENT
/begin MEASUREMENT DDRC_St.DFC_SpplCooltPmpRlySCG "" UWORD DFC_OneToOne 1 100 0.00 8191.000 BIT_MASK 0x1fff FORMAT "%8.3" ECU_ADDRESS 0x60021FE2 /end MEASUREMENT
/begin MEASUREMENT DFC_st.DFC_BlowrRlyErr "" UBYTE DFC_OneToOne 1 100 0.00 255.0 FORMAT "%5.1" ECU_ADDRESS 0x600349E2 /end MEASUREMENT
/begin MEASUREMENT DFC_st.DFC_ComElMIIvtrFltLvl4 "" UBYTE DFC_OneToOne 1 100 0.00 255.0 FORMAT "%5.1" ECU_ADDRESS 0x60034A0C /end MEASUREMENT
/begin MEASUREMENT DFC_st.DFC_ComElMIIvtrFltLvl5 "" UBYTE DFC_OneToOne 1 100 0.00 255.0 FORMAT "%5.1" ECU_ADDRESS 0x60034A0D /end MEASUREMENT
/begin MEASUREMENT DFC_st.DFC_PrkgBrkFailr "" UBYTE DFC_OneToOne 1 100 0.00 255.0 FORMAT "%5.1" ECU_ADDRESS 0x60034A78 /end MEASUREMENT
/begin MEASUREMENT DFC_st.DFC_PtSysLimErr "" UBYTE DFC_OneToOne 1 100 0.00 255.0 FORMAT "%5.1" ECU_ADDRESS 0x60034A79 /end MEASUREMENT
/begin MEASUREMENT DFC_st.DFC_SCtPmpRlyOL "" UBYTE DFC_OneToOne 1 100 0.00 255.0 FORMAT "%5.1" ECU_ADDRESS 0x60034C08 /end MEASUREMENT
/begin MEASUREMENT DFC_st.DFC_SCtPmpRlyOvrTemp "" UBYTE DFC_OneToOne 1 100 0.00 255.0 FORMAT "%5.1" ECU_ADDRESS 0x60034C09 /end MEASUREMENT
/begin MEASUREMENT DFC_st.DFC_SCtPmpRlySCB "" UBYTE DFC_OneToOne 1 100 0.00 255.0 FORMAT "%5.1" ECU_ADDRESS 0x60034C0A /end MEASUREMENT
/begin MEASUREMENT DFC_st.DFC_SpplCooltPmpRlyOL "" UBYTE DFC_OneToOne 1 100 0.00 255.0 FORMAT "%5.1" ECU_ADDRESS 0x60034C0B /end MEASUREMENT
/begin MEASUREMENT DFC_st.DFC_SpplCooltPmpRlyOvrTemp "" UBYTE DFC_OneToOne 1 100 0.00 255.0 FORMAT "%5.1" ECU_ADDRESS 0x60034C0C /end MEASUREMENT
/begin MEASUREMENT DFC_st.DFC_SpplCooltPmpRlySCB "" UBYTE DFC_OneToOne 1 100 0.00 255.0 FORMAT "%5.1" ECU_ADDRESS 0x60034C0D /end MEASUREMENT
/begin MEASUREMENT DFC_st.DFC_SCtPmpRlySCG "" UBYTE DFC_OneToOne 1 100 0.00 255.0 FORMAT "%5.1" ECU_ADDRESS 0x60034C47 /end MEASUREMENT
/begin MEASUREMENT DFC_st.DFC_SpplCooltPmpRlySCG "" UBYTE DFC_OneToOne 1 100 0.00 255.0 FORMAT "%5.1" ECU_ADDRESS 0x60034C48 /end MEASUREMENT
/begin MEASUREMENT DFC_st.DFC_Sia_InvldCode "" UBYTE DFC_OneToOne 1 100 0.00 255.0 FORMAT "%5.1" ECU_ADDRESS 0x60034D88 /end MEASUREMENT
/begin MEASUREMENT DFC_st.DFC_Sia_InvldKey "" UBYTE DFC_OneToOne 1 100 0.00 255.0 FORMAT "%5.1" ECU_ADDRESS 0x60034D89 /end MEASUREMENT
/begin MEASUREMENT DFC_st.DFC_Sia_NoRespUCx "" UBYTE DFC_OneToOne 1 100 0.00 255.0 FORMAT "%5.1" ECU_ADDRESS 0x60034D8A /end MEASUREMENT
/begin MEASUREMENT DFC_st.DFC_Sia_TprotRttp "" UBYTE DFC_OneToOne 1 100 0.00 255.0 FORMAT "%5.1" ECU_ADDRESS 0x60034D8B /end MEASUREMENT
/begin MEASUREMENT DFC_st.DFC_StrtUpEvStandStillDeactvn "" UBYTE DFC_OneToOne 1 100 0.00 255.0 FORMAT "%5.1" ECU_ADDRESS 0x60034D8C /end MEASUREMENT
/begin MEASUREMENT DINH_nrActvInhReas.FId_PEnvRefSnsr "" UWORD DINH_ct_Compu 1 100 -4095.000 4096.000 BIT_MASK 0x1fff FORMAT "%8.3" ECU_ADDRESS 0x60021514 /end MEASUREMENT
/begin MEASUREMENT DINH_nrActvInhReas.FId_SCtPmpRlyMon "" UWORD DINH_ct_Compu 1 100 -4095.000 4096.000 BIT_MASK 0x1fff FORMAT "%8.3" ECU_ADDRESS 0x6002154C /end MEASUREMENT
/begin MEASUREMENT DINH_nrActvInhReas.FId_SCtPmpRlyPwrStg "" UWORD DINH_ct_Compu 1 100 -4095.000 4096.000 BIT_MASK 0x1fff FORMAT "%8.3" ECU_ADDRESS 0x60021552 /end MEASUREMENT
/begin MEASUREMENT DINH_nrActvInhReas.FId_SpplCooltPmpRlyActrOff "" UWORD DINH_ct_Compu 1 100 -4095.000 4096.000 BIT_MASK 0x1fff FORMAT "%8.3" ECU_ADDRESS 0x60021558 /end MEASUREMENT
/begin MEASUREMENT DINH_nrActvInhReas.FId_SpplCooltPmpRlyMon "" UWORD DINH_ct_Compu 1 100 -4095.000 4096.000 BIT_MASK 0x1fff FORMAT "%8.3" ECU_ADDRESS 0x6002155A /end MEASUREMENT
/begin MEASUREMENT DINH_nrActvInhReas.FId_SpplCooltPmpRlyOff "" UWORD DINH_ct_Compu 1 100 -4095.000 4096.000 BIT_MASK 0x1fff FORMAT "%8.3" ECU_ADDRESS 0x6002155C /end MEASUREMENT
/begin MEASUREMENT DINH_nrActvInhReas.FId_SpplCooltPmpRlyPwrStg "" UWORD DINH_ct_Compu 1 100 -4095.000 4096.000 BIT_MASK 0x1fff FORMAT "%8.3" ECU_ADDRESS 0x60021560 /end MEASUREMENT
/begin MEASUREMENT DINH_nrActvInhReas.FId_StrtUpEvDrvAwy "" UWORD DINH_ct_Compu 1 100 -4095.000 4096.000 BIT_MASK 0x1fff FORMAT "%8.3" ECU_ADDRESS 0x60021562 /end MEASUREMENT
/begin MEASUREMENT DINH_nrActvInhReas.FId_VMSIEvBrkFlt "" UWORD DINH_ct_Compu 1 100 -4095.000 4096.000 BIT_MASK 0x1fff FORMAT "%8.3" ECU_ADDRESS 0x60021584 /end MEASUREMENT
/begin MEASUREMENT DINH_nrActvInhReas.FId_bInhCdtSpdVehImmo "" UWORD DINH_ct_Compu 1 100 -4095.000 4096.000 BIT_MASK 0x1fff FORMAT "%8.3" ECU_ADDRESS 0x600215CC /end MEASUREMENT
/begin MEASUREMENT DINH_nrActvInhReas.FId_bInh_ComEmac_flgSvsReq01_Sq_Frz "" UWORD DINH_ct_Compu 1 100 -4095.000 4096.000 BIT_MASK 0x1fff FORMAT "%8.3" ECU_ADDRESS 0x6002183A /end MEASUREMENT
/begin MEASUREMENT DINH_nrActvInhReas.FId_bInh_ComEmac_tIvtrCoolt01_Sq_Frz "" UWORD DINH_ct_Compu 1 100 -4095.000 4096.000 BIT_MASK 0x1fff FORMAT "%8.3" ECU_ADDRESS 0x6002183C /end MEASUREMENT
/begin MEASUREMENT DINH_nrActvInhReas.FId_bInh_Com_iElCmprHvAct_Sq_Frz "" UWORD DINH_ct_Compu 1 100 -4095.000 4096.000 BIT_MASK 0x1fff FORMAT "%8.3" ECU_ADDRESS 0x6002186A /end MEASUREMENT
/begin MEASUREMENT DINH_nrActvInhReas.FId_bInh_Sig_Com_pwrMaxChrgSho_Sq_Frz "" UWORD DINH_ct_Compu 1 100 -4095.000 4096.000 BIT_MASK 0x1fff FORMAT "%8.3" ECU_ADDRESS 0x60021B76 /end MEASUREMENT
/begin MEASUREMENT DINH_nrActvInhReas.FId_bInh_Sig_Com_pwrMaxDchaSho_Sq_Frz "" UWORD DINH_ct_Compu 1 100 -4095.000 4096.000 BIT_MASK 0x1fff FORMAT "%8.3" ECU_ADDRESS 0x60021B78 /end MEASUREMENT
/begin MEASUREMENT DINH_nrActvInhReas.FId_binnh_Sig_ComEmac_flgEmgyShtDwnReq01_Sq_Frz "" UWORD DINH_ct_Compu 1 100 -4095.000 4096.000 BIT_MASK 0x1fff FORMAT "%8.3" ECU_ADDRESS 0x60021B90 /end MEASUREMENT
/begin MEASUREMENT DINH_nrActvInhReas.FId_binnh_Sig_ComEmac_flgImobAuthent_Sq_Frz "" UWORD DINH_ct_Compu 1 100 -4095.000 4096.000 BIT_MASK 0x1fff FORMAT "%8.3" ECU_ADDRESS 0x60021B92 /end MEASUREMENT
/begin MEASUREMENT DINH_nrActvInhReas.FId_binnh_Sig_ComEmac_iDcLnk01_Sq_Frz "" UWORD DINH_ct_Compu 1 100 -4095.000 4096.000 BIT_MASK 0x1fff FORMAT "%8.3" ECU_ADDRESS 0x60021B94 /end MEASUREMENT
/begin MEASUREMENT DINH_nrActvInhReas.FId_binnh_Sig_ComEmac_nAct01_Sq_Frz "" UWORD DINH_ct_Compu 1 100 -4095.000 4096.000 BIT_MASK 0x1fff FORMAT "%8.3" ECU_ADDRESS 0x60021B96 /end MEASUREMENT
/begin MEASUREMENT DINH_nrActvInhReas.FId_binnh_Sig_ComEmac_stIsoMonSwtAck_Sq_Frz "" UWORD DINH_ct_Compu 1 100 -4095.000 4096.000 BIT_MASK 0x1fff FORMAT "%8.3" ECU_ADDRESS 0x60021B9A /end MEASUREMENT
/begin MEASUREMENT DINH_nrActvInhReas.FId_binnh_Sig_ComEmac_stMod01_Sq_Frz "" UWORD DINH_ct_Compu 1 100 -4095.000 4096.000 BIT_MASK 0x1fff FORMAT "%8.3" ECU_ADDRESS 0x60021B9C /end MEASUREMENT
/begin MEASUREMENT DINH_nrActvInhReas.FId_binnh_Sig_ComEmac_stPwrAuthn_Sq_Frz "" UWORD DINH_ct_Compu 1 100 -4095.000 4096.000 BIT_MASK 0x1fff FORMAT "%8.3" ECU_ADDRESS 0x60021B9E /end MEASUREMENT
/begin MEASUREMENT DINH_nrActvInhReas.FId_binnh_Sig_ComEmac_tInvr01_Sq_Frz "" UWORD DINH_ct_Compu 1 100 -4095.000 4096.000 BIT_MASK 0x1fff FORMAT "%8.3" ECU_ADDRESS 0x60021BA0 /end MEASUREMENT
/begin MEASUREMENT DINH_nrActvInhReas.FId_binnh_Sig_ComEmac_tMac01_Sq_Frz "" UWORD DINH_ct_Compu 1 100 -4095.000 4096.000 BIT_MASK 0x1fff FORMAT "%8.3" ECU_ADDRESS 0x60021BA2 /end MEASUREMENT
/begin MEASUREMENT DINH_nrActvInhReas.FId_binnh_Sig_ComEmac_tqAbsltMax01_Sq_Frz "" UWORD DINH_ct_Compu 1 100 -4095.000 4096.000 BIT_MASK 0x1fff FORMAT "%8.3" ECU_ADDRESS 0x60021BA4 /end MEASUREMENT
/begin MEASUREMENT DINH_nrActvInhReas.FId_binnh_Sig_ComEmac_tqAbsltMin01_Sq_Frz "" UWORD DINH_ct_Compu 1 100 -4095.000 4096.000 BIT_MASK 0x1fff FORMAT "%8.3" ECU_ADDRESS 0x60021BA6 /end MEASUREMENT
/begin MEASUREMENT DINH_nrActvInhReas.FId_binnh_Sig_ComEmac_tqAct01_Sq_Frz "" UWORD DINH_ct_Compu 1 100 -4095.000 4096.000 BIT_MASK 0x1fff FORMAT "%8.3" ECU_ADDRESS 0x60021BA8 /end MEASUREMENT
/begin MEASUREMENT DINH_nrActvInhReas.FId_binnh_Sig_ComEmac_uDcLnk01_sq_Frz "" UWORD DINH_ct_Compu 1 100 -4095.000 4096.000 BIT_MASK 0x1fff FORMAT "%8.3" ECU_ADDRESS 0x60021BAA /end MEASUREMENT
/begin MEASUREMENT DINH_nrActvInhReas.FId_binnh_Sig_Com_iHvbAct_Sq_Frz "" UWORD DINH_ct_Compu 1 100 -4095.000 4096.000 BIT_MASK 0x1fff FORMAT "%8.3" ECU_ADDRESS 0x60021BAE /end MEASUREMENT
/begin MEASUREMENT DINH_nrActvInhReas.FId_binnh_Sig_Com_iHvbChrgMaxSho_Sq_Frz "" UWORD DINH_ct_Compu 1 100 -4095.000 4096.000 BIT_MASK 0x1fff FORMAT "%8.3" ECU_ADDRESS 0x60021BB0 /end MEASUREMENT
/begin MEASUREMENT DINH_nrActvInhReas.FId_binnh_Sig_Com_iHvbDchaMaxSho_Sq_Frz "" UWORD DINH_ct_Compu 1 100 -4095.000 4096.000 BIT_MASK 0x1fff FORMAT "%8.3" ECU_ADDRESS 0x60021BB2 /end MEASUREMENT
/begin MEASUREMENT DINH_nrActvInhReas.FId_binnh_Sig_Com_iHvbDes_Sq_Frz "" UWORD DINH_ct_Compu 1 100 -4095.000 4096.000 BIT_MASK 0x1fff FORMAT "%8.3" ECU_ADDRESS 0x60021BB4 /end MEASUREMENT
/begin MEASUREMENT DINH_nrActvInhReas.FId_binnh_Sig_Com_ratHvbSoc_Sq_Frz "" UWORD DINH_ct_Compu 1 100 -4095.000 4096.000 BIT_MASK 0x1fff FORMAT "%8.3" ECU_ADDRESS 0x60021BBA /end MEASUREMENT
/begin MEASUREMENT DINH_nrActvInhReas.FId_binnh_Sig_Com_stDcdcULimReq_Sq_Frz "" UWORD DINH_ct_Compu 1 100 -4095.000 4096.000 BIT_MASK 0x1fff FORMAT "%8.3" ECU_ADDRESS 0x60021BBC /end MEASUREMENT
/begin MEASUREMENT DINH_nrActvInhReas.FId_binnh_Sig_Com_stHvbCntct_Sq_Frz "" UWORD DINH_ct_Compu 1 100 -4095.000 4096.000 BIT_MASK 0x1fff FORMAT "%8.3" ECU_ADDRESS 0x60021BBE /end MEASUREMENT
/begin MEASUREMENT DINH_nrActvInhReas.FId_binnh_Sig_Com_stHvbDernMaxT_Sq_Frz "" UWORD DINH_ct_Compu 1 100 -4095.000 4096.000 BIT_MASK 0x1fff FORMAT "%8.3" ECU_ADDRESS 0x60021BC0 /end MEASUREMENT
/begin MEASUREMENT DINH_nrActvInhReas.FId_binnh_Sig_Com_stHvbDernMinT_Sq_Frz "" UWORD DINH_ct_Compu 1 100 -4095.000 4096.000 BIT_MASK 0x1fff FORMAT "%8.3" ECU_ADDRESS 0x60021BC2 /end MEASUREMENT
/begin MEASUREMENT DINH_nrActvInhReas.FId_binnh_Sig_Com_stHvbFlt_Sq_Frz "" UWORD DINH_ct_Compu 1 100 -4095.000 4096.000 BIT_MASK 0x1fff FORMAT "%8.3" ECU_ADDRESS 0x60021BC4 /end MEASUREMENT
/begin MEASUREMENT DINH_nrActvInhReas.FId_binnh_Sig_Com_stHvbIntlck_Sq_Frz "" UWORD DINH_ct_Compu 1 100 -4095.000 4096.000 BIT_MASK 0x1fff FORMAT "%8.3" ECU_ADDRESS 0x60021BC6 /end MEASUREMENT
/begin MEASUREMENT DINH_nrActvInhReas.FId_binnh_Sig_Com_stHvbIsoFlt_Sq_Frz "" UWORD DINH_ct_Compu 1 100 -4095.000 4096.000 BIT_MASK 0x1fff FORMAT "%8.3" ECU_ADDRESS 0x60021BC8 /end MEASUREMENT
/begin MEASUREMENT DINH_nrActvInhReas.FId_binnh_Sig_Com_stHvbMod_Sq_Frz "" UWORD DINH_ct_Compu 1 100 -4095.000 4096.000 BIT_MASK 0x1fff FORMAT "%8.3" ECU_ADDRESS 0x60021BCA /end MEASUREMENT
/begin MEASUREMENT DINH_nrActvInhReas.FId_binnh_Sig_Com_tHvbAct_Sq_Frz "" UWORD DINH_ct_Compu 1 100 -4095.000 4096.000 BIT_MASK 0x1fff FORMAT "%8.3" ECU_ADDRESS 0x60021BCE /end MEASUREMENT
/begin MEASUREMENT DINH_nrActvInhReas.FId_binnh_Sig_Com_uElCmprHvAct_Sq_Frz "" UWORD DINH_ct_Compu 1 100 -4095.000 4096.000 BIT_MASK 0x1fff FORMAT "%8.3" ECU_ADDRESS 0x60021BD0 /end MEASUREMENT
/begin MEASUREMENT DINH_nrActvInhReas.FId_binnh_Sig_Com_uHvbAct_Sq_Frz "" UWORD DINH_ct_Compu 1 100 -4095.000 4096.000 BIT_MASK 0x1fff FORMAT "%8.3" ECU_ADDRESS 0x60021BD2 /end MEASUREMENT
/begin MEASUREMENT DINH_nrActvInhReas.FId_binnh_Sig_Com_uHvbLimHi_Sq_Frz "" UWORD DINH_ct_Compu 1 100 -4095.000 4096.000 BIT_MASK 0x1fff FORMAT "%8.3" ECU_ADDRESS 0x60021BD6 /end MEASUREMENT
/begin MEASUREMENT DINH_nrActvInhReas.FId_binnh_Sig_Com_uHvbNomChrgn_Sq_Frz "" UWORD DINH_ct_Compu 1 100 -4095.000 4096.000 BIT_MASK 0x1fff FORMAT "%8.3" ECU_ADDRESS 0x60021BD8 /end MEASUREMENT
/begin MEASUREMENT DINH_stFId.FId_PEnvRefSnsr "" UWORD DFC_OneToOne 1 100 0.00 65535.00 FORMAT "%8.2" ECU_ADDRESS 0x60021514 /end MEASUREMENT
/begin MEASUREMENT DINH_stFId.FId_SCtPmpRlyMon "" UWORD DFC_OneToOne 1 100 0.00 65535.00 FORMAT "%8.2" ECU_ADDRESS 0x6002154C /end MEASUREMENT
/begin MEASUREMENT DINH_stFId.FId_SCtPmpRlyPwrStg "" UWORD DFC_OneToOne 1 100 0.00 65535.00 FORMAT "%8.2" ECU_ADDRESS 0x60021552 /end MEASUREMENT
/begin MEASUREMENT DINH_stFId.FId_SpplCooltPmpRlyActrOff "" UWORD DFC_OneToOne 1 100 0.00 65535.00 FORMAT "%8.2" ECU_ADDRESS 0x60021558 /end MEASUREMENT
/begin MEASUREMENT DINH_stFId.FId_SpplCooltPmpRlyMon "" UWORD DFC_OneToOne 1 100 0.00 65535.00 FORMAT "%8.2" ECU_ADDRESS 0x6002155A /end MEASUREMENT
/begin MEASUREMENT DINH_stFId.FId_SpplCooltPmpRlyOff "" UWORD DFC_OneToOne 1 100 0.00 65535.00 FORMAT "%8.2" ECU_ADDRESS 0x6002155C /end MEASUREMENT
/begin MEASUREMENT DINH_stFId.FId_SpplCooltPmpRlyPwrStg "" UWORD DFC_OneToOne 1 100 0.00 65535.00 FORMAT "%8.2" ECU_ADDRESS 0x60021560 /end MEASUREMENT
/begin MEASUREMENT DINH_stFId.FId_StrtUpEvDrvAwy "" UWORD DFC_OneToOne 1 100 0.00 65535.00 FORMAT "%8.2" ECU_ADDRESS 0x60021562 /end MEASUREMENT
/begin MEASUREMENT DINH_stFId.FId_VMSIEvBrkFlt "" UWORD DFC_OneToOne 1 100 0.00 65535.00 FORMAT "%8.2" ECU_ADDRESS 0x60021584 /end MEASUREMENT
/begin MEASUREMENT DINH_stFId.FId_bInhCdtSpdVehImmo "" UWORD DFC_OneToOne 1 100 0.00 65535.00 FORMAT "%8.2" ECU_ADDRESS 0x600215CC /end MEASUREMENT
/begin MEASUREMENT DINH_stFId.FId_bInh_ComEmac_flgSvsReq01_Sq_Frz "" UWORD DFC_OneToOne 1 100 0.00 65535.00 FORMAT "%8.2" ECU_ADDRESS 0x6002183A /end MEASUREMENT
/begin MEASUREMENT DINH_stFId.FId_bInh_ComEmac_tIvtrCoolt01_Sq_Frz "" UWORD DFC_OneToOne 1 100 0.00 65535.00 FORMAT "%8.2" ECU_ADDRESS 0x6002183C /end MEASUREMENT
/begin MEASUREMENT DINH_stFId.FId_bInh_Com_iElCmprHvAct_Sq_Frz "" UWORD DFC_OneToOne 1 100 0.00 65535.00 FORMAT "%8.2" ECU_ADDRESS 0x6002186A /end MEASUREMENT
/begin MEASUREMENT DINH_stFId.FId_bInh_Sig_Com_pwrMaxChrgSho_Sq_Frz "" UWORD DFC_OneToOne 1 100 0.00 65535.00 FORMAT "%8.2" ECU_ADDRESS 0x60021B76 /end MEASUREMENT
/begin MEASUREMENT DINH_stFId.FId_bInh_Sig_Com_pwrMaxDchaSho_Sq_Frz "" UWORD DFC_OneToOne 1 100 0.00 65535.00 FORMAT "%8.2" ECU_ADDRESS 0x60021B78 /end MEASUREMENT
/begin MEASUREMENT DINH_stFId.FId_binnh_Sig_ComEmac_flgEmgyShtDwnReq01_Sq_Frz "" UWORD DFC_OneToOne 1 100 0.00 65535.00 FORMAT "%8.2" ECU_ADDRESS 0x60021B90 /end MEASUREMENT
/begin MEASUREMENT DINH_stFId.FId_binnh_Sig_ComEmac_flgImobAuthent_Sq_Frz "" UWORD DFC_OneToOne 1 100 0.00 65535.00 FORMAT "%8.2" ECU_ADDRESS 0x60021B92 /end MEASUREMENT
/begin MEASUREMENT DINH_stFId.FId_binnh_Sig_ComEmac_iDcLnk01_Sq_Frz "" UWORD DFC_OneToOne 1 100 0.00 65535.00 FORMAT "%8.2" ECU_ADDRESS 0x60021B94 /end MEASUREMENT
/begin MEASUREMENT DINH_stFId.FId_binnh_Sig_ComEmac_nAct01_Sq_Frz "" UWORD DFC_OneToOne 1 100 0.00 65535.00 FORMAT "%8.2" ECU_ADDRESS 0x60021B96 /end MEASUREMENT
/begin MEASUREMENT DINH_stFId.FId_binnh_Sig_ComEmac_stIsoMonSwtAck_Sq_Frz "" UWORD DFC_OneToOne 1 100 0.00 65535.00 FORMAT "%8.2" ECU_ADDRESS 0x60021B9A /end MEASUREMENT
/begin MEASUREMENT DINH_stFId.FId_binnh_Sig_ComEmac_stMod01_Sq_Frz "" UWORD DFC_OneToOne 1 100 0.00 65535.00 FORMAT "%8.2" ECU_ADDRESS 0x60021B9C /end MEASUREMENT
/begin MEASUREMENT DINH_stFId.FId_binnh_Sig_ComEmac_stPwrAuthn_Sq_Frz "" UWORD DFC_OneToOne 1 100 0.00 65535.00 FORMAT "%8.2" ECU_ADDRESS 0x60021B9E /end MEASUREMENT
/begin MEASUREMENT DINH_stFId.FId_binnh_Sig_ComEmac_tInvr01_Sq_Frz "" UWORD DFC_OneToOne 1 100 0.00 65535.00 FORMAT "%8.2" ECU_ADDRESS 0x60021BA0 /end MEASUREMENT
/begin MEASUREMENT DINH_stFId.FId_binnh_Sig_ComEmac_tMac01_Sq_Frz "" UWORD DFC_OneToOne 1 100 0.00 65535.00 FORMAT "%8.2" ECU_ADDRESS 0x60021BA2 /end MEASUREMENT
/begin MEASUREMENT DINH_stFId.FId_binnh_Sig_ComEmac_tqAbsltMax01_Sq_Frz "" UWORD DFC_OneToOne 1 100 0.00 65535.00 FORMAT "%8.2" ECU_ADDRESS 0x60021BA4 /end MEASUREMENT
/begin MEASUREMENT DINH_stFId.FId_binnh_Sig_ComEmac_tqAbsltMin01_Sq_Frz "" UWORD DFC_OneToOne 1 100 0.00 65535.00 FORMAT "%8.2" ECU_ADDRESS 0x60021BA6 /end MEASUREMENT
/begin MEASUREMENT DINH_stFId.FId_binnh_Sig_ComEmac_tqAct01_Sq_Frz "" UWORD DFC_OneToOne 1 100 0.00 65535.00 FORMAT "%8.2" ECU_ADDRESS 0x60021BA8 /end MEASUREMENT
/begin MEASUREMENT DINH_stFId.FId_binnh_Sig_ComEmac_uDcLnk01_sq_Frz "" UWORD DFC_OneToOne 1 100 0.00 65535.00 FORMAT "%8.2" ECU_ADDRESS 0x60021BAA /end MEASUREMENT
/begin MEASUREMENT DINH_stFId.FId_binnh_Sig_Com_iHvbAct_Sq_Frz "" UWORD DFC_OneToOne 1 100 0.00 65535.00 FORMAT "%8.2" ECU_ADDRESS 0x60021BAE /end MEASUREMENT
/begin MEASUREMENT DINH_stFId.FId_binnh_Sig_Com_iHvbChrgMaxSho_Sq_Frz "" UWORD DFC_OneToOne 1 100 0.00 65535.00 FORMAT "%8.2" ECU_ADDRESS 0x60021BB0 /end MEASUREMENT
/begin MEASUREMENT DINH_stFId.FId_binnh_Sig_Com_iHvbDchaMaxSho_Sq_Frz "" UWORD DFC_OneToOne 1 100 0.00 65535.00 FORMAT "%8.2" ECU_ADDRESS 0x60021BB2 /end MEASUREMENT
/begin MEASUREMENT DINH_stFId.FId_binnh_Sig_Com_iHvbDes_Sq_Frz "" UWORD DFC_OneToOne 1 100 0.00 65535.00 FORMAT "%8.2" ECU_ADDRESS 0x60021BB4 /end MEASUREMENT
/begin MEASUREMENT DINH_stFId.FId_binnh_Sig_Com_ratHvbSoc_Sq_Frz "" UWORD DFC_OneToOne 1 100 0.00 65535.00 FORMAT "%8.2" ECU_ADDRESS 0x60021BBA /end MEASUREMENT
/begin MEASUREMENT DINH_stFId.FId_binnh_Sig_Com_stDcdcULimReq_Sq_Frz "" UWORD DFC_OneToOne 1 100 0.00 65535.00 FORMAT "%8.2" ECU_ADDRESS 0x60021BBC /end MEASUREMENT
/begin MEASUREMENT DINH_stFId.FId_binnh_Sig_Com_stHvbCntct_Sq_Frz "" UWORD DFC_OneToOne 1 100 0.00 65535.00 FORMAT "%8.2" ECU_ADDRESS 0x60021BBE /end MEASUREMENT
/begin MEASUREMENT DINH_stFId.FId_binnh_Sig_Com_stHvbDernMaxT_Sq_Frz "" UWORD DFC_OneToOne 1 100 0.00 65535.00 FORMAT "%8.2" ECU_ADDRESS 0x60021BC0 /end MEASUREMENT
/begin MEASUREMENT DINH_stFId.FId_binnh_Sig_Com_stHvbDernMinT_Sq_Frz "" UWORD DFC_OneToOne 1 100 0.00 65535.00 FORMAT "%8.2" ECU_ADDRESS 0x60021BC2 /end MEASUREMENT
/begin MEASUREMENT DINH_stFId.FId_binnh_Sig_Com_stHvbFlt_Sq_Frz "" UWORD DFC_OneToOne 1 100 0.00 65535.00 FORMAT "%8.2" ECU_ADDRESS 0x60021BC4 /end MEASUREMENT
/begin MEASUREMENT DINH_stFId.FId_binnh_Sig_Com_stHvbIntlck_Sq_Frz "" UWORD DFC_OneToOne 1 100 0.00 65535.00 FORMAT "%8.2" ECU_ADDRESS 0x60021BC6 /end MEASUREMENT
/begin MEASUREMENT DINH_stFId.FId_binnh_Sig_Com_stHvbIsoFlt_Sq_Frz "" UWORD DFC_OneToOne 1 100 0.00 65535.00 FORMAT "%8.2" ECU_ADDRESS 0x60021BC8 /end MEASUREMENT
/begin MEASUREMENT DINH_stFId.FId_binnh_Sig_Com_stHvbMod_Sq_Frz "" UWORD DFC_OneToOne 1 100 0.00 65535.00 FORMAT "%8.2" ECU_ADDRESS 0x60021BCA /end MEASUREMENT
/begin MEASUREMENT DINH_stFId.FId_binnh_Sig_Com_tHvbAct_Sq_Frz "" UWORD DFC_OneToOne 1 100 0.00 65535.00 FORMAT "%8.2" ECU_ADDRESS 0x60021BCE /end MEASUREMENT
/begin MEASUREMENT DINH_stFId.FId_binnh_Sig_Com_uElCmprHvAct_Sq_Frz "" UWORD DFC_OneToOne 1 100 0.00 65535.00 FORMAT "%8.2" ECU_ADDRESS 0x60021BD0 /end MEASUREMENT
/begin MEASUREMENT DINH_stFId.FId_binnh_Sig_Com_uHvbAct_Sq_Frz "" UWORD DFC_OneToOne 1 100 0.00 65535.00 FORMAT "%8.2" ECU_ADDRESS 0x60021BD2 /end MEASUREMENT
/begin MEASUREMENT DINH_stFId.FId_binnh_Sig_Com_uHvbLimHi_Sq_Frz "" UWORD DFC_OneToOne 1 100 0.00 65535.00 FORMAT "%8.2" ECU_ADDRESS 0x60021BD6 /end MEASUREMENT
/begin MEASUREMENT DINH_stFId.FId_binnh_Sig_Com_uHvbNomChrgn_Sq_Frz "" UWORD DFC_OneToOne 1 100 0.00 65535.00 FORMAT "%8.2" ECU_ADDRESS 0x60021BD8 /end MEASUREMENT
/begin MEASUREMENT DrvMod_flgBrkModRcptEna "flag for recuperation enabled" UBYTE B_TRUE 1 100 0.00 1.00000000000 BIT_MASK 0x1 FORMAT "%13.11" ECU_ADDRESS 0x600234A5 /end MEASUREMENT
/begin MEASUREMENT DrvMod_stPosnEnhd "Enhanced Drive mode information" UBYTE DrvMod_stPosn_VERB 1 100 0.00 6.00000000000 FORMAT "%13.11" ECU_ADDRESS 0x600235B5
 /begin IF_DATA XCPplus 0x0102
  /begin DAQ_EVENT VARIABLE /end DAQ_EVENT
 /end IF_DATA
/end MEASUREMENT
/begin MEASUREMENT Dspl_stVDSAry "Array interface for VDS" UBYTE OneToOne 1 100 0.00 255.0 FORMAT "%5.1" MATRIX_DIM 6 ECU_ADDRESS 0x60022FE6
 /begin IF_DATA XCPplus 0x0102
  /begin DAQ_EVENT VARIABLE /end DAQ_EVENT
 /end IF_DATA
/end MEASUREMENT
/begin MEASUREMENT Dspl_stVISAry "Array interface for VIS" UBYTE OneToOne 1 100 0.00 255.0 FORMAT "%5.1" MATRIX_DIM 8 ECU_ADDRESS 0x60022FDE
 /begin IF_DATA XCPplus 0x0102
  /begin DAQ_EVENT VARIABLE /end DAQ_EVENT
 /end IF_DATA
/end MEASUREMENT
/begin MEASUREMENT Dspl_stWMIAry "Array interface for WMI" UBYTE OneToOne 1 100 0.00 255.0 FORMAT "%5.1" MATRIX_DIM 3 ECU_ADDRESS 0x60022FDB
 /begin IF_DATA XCPplus 0x0102
  /begin DAQ_EVENT VARIABLE /end DAQ_EVENT
 /end IF_DATA
/end MEASUREMENT
/begin MEASUREMENT ErrLmp_stSVS "SVS Lamp status" UBYTE OneToOne 1 100 0.00 255.0 FORMAT "%5.1" ECU_ADDRESS 0x60023885
 /begin IF_DATA XCPplus 0x0102
  /begin DAQ_EVENT VARIABLE /end DAQ_EVENT
 /end IF_DATA
/end MEASUREMENT
/begin MEASUREMENT Ext_bSyncGPC "Flag to indicate Global powertrain cycle Realizationstate" UBYTE B_TRUE 1 100 0.00 1.00000000000 BIT_MASK 0x1 FORMAT "%13.11" ECU_ADDRESS 0x60023495
 /begin IF_DATA XCPplus 0x0102
  /begin DAQ_EVENT VARIABLE /end DAQ_EVENT
 /end IF_DATA
/end MEASUREMENT
/begin MEASUREMENT Gbx_stGearLvr "Selected gear position in case of automatic transmission system" UBYTE OneToOne 1 100 0.00 255.0 FORMAT "%5.1" ECU_ADDRESS 0x60023572
 /begin IF_DATA XCPplus 0x0102
  /begin DAQ_EVENT VARIABLE /end DAQ_EVENT
 /end IF_DATA
/end MEASUREMENT
/begin MEASUREMENT HvBatt_uActLinkMeasd "Link voltage vehicle measured by HV battery" SWORD Volt_V_q0p03125_COMPU 1 100 0.00 1023.969 FORMAT "%8.3" ECU_ADDRESS 0x6001FAC2
 /begin IF_DATA XCPplus 0x0102
  /begin DAQ_EVENT VARIABLE /end DAQ_EVENT
 /end IF_DATA
/end MEASUREMENT
/begin MEASUREMENT HvBatt_uActLinkMeasd_Sq "" UBYTE SigQly_COMPU_VERB 1 100 0.00 15.0000000000 FORMAT "%13.10" ECU_ADDRESS 0x6002353E
 /begin IF_DATA XCPplus 0x0102
  /begin DAQ_EVENT VARIABLE /end DAQ_EVENT
 /end IF_DATA
/end MEASUREMENT
/begin MEASUREMENT IntlckChrgPlg_stHbrOLDiagExtReq "External Request for switch off OL diagnosis of H-bridge powerstage" UBYTE OneToOne 1 100 0.00 255.0 FORMAT "%5.1" ECU_ADDRESS 0x60023534
 /begin IF_DATA XCPplus 0x0102
  /begin DAQ_EVENT VARIABLE /end DAQ_EVENT
 /end IF_DATA
/end MEASUREMENT
/begin MEASUREMENT MoFAccr_flgPlausBrkDetdMsg "message for level 1 that level 2 detects error in accped brake plausibility check" UBYTE B_TRUE 1 100 0.00 1.00000000000 BIT_MASK 0x1 FORMAT "%13.11" ECU_ADDRESS 0x7000148E
 /begin IF_DATA XCPplus 0x0102
  /begin DAQ_EVENT VARIABLE /end DAQ_EVENT
 /end IF_DATA
/end MEASUREMENT
/begin MEASUREMENT MRly_stActDid "" UBYTE OneToOne 1 100 0.00 255.0 FORMAT "%5.1" ECU_ADDRESS 0x60023530
 /begin IF_DATA XCPplus 0x0102
  /begin DAQ_EVENT VARIABLE /end DAQ_EVENT
 /end IF_DATA
/end MEASUREMENT
/begin MEASUREMENT PEnv_p_Sq "Signal qualifier for sensor output" UBYTE SigQly_COMPU_VERB 1 100 0.00 15.0000000000 FORMAT "%13.10" ECU_ADDRESS 0x60000240
 /begin IF_DATA XCPplus 0x0102
  /begin DAQ_EVENT VARIABLE /end DAQ_EVENT
 /end IF_DATA
/end MEASUREMENT
/begin MEASUREMENT PwmCtP_rRaw "" UBYTE RBPtCel_Perc_1p0_1 1 100 0.00 255.0 FORMAT "%5.1" ECU_ADDRESS 0x60023512
 /begin IF_DATA XCPplus 0x0102
  /begin DAQ_EVENT VARIABLE /end DAQ_EVENT
 /end IF_DATA
/end MEASUREMENT
/begin MEASUREMENT PwrDistbnUnitT_t "" SWORD RBPtCel_t_1p0_3 1 100 -32768.00 32767.00 FORMAT "%8.2" ECU_ADDRESS 0x6001FA72
 /begin IF_DATA XCPplus 0x0102
  /begin DAQ_EVENT VARIABLE /end DAQ_EVENT
 /end IF_DATA
/end MEASUREMENT
/begin MEASUREMENT rba_SyC_bWkuMain "" UBYTE B_TRUE 1 100 0.00 1.00000000000 BIT_MASK 0x1 FORMAT "%13.11" ECU_ADDRESS 0x7000020D
 /begin IF_DATA XCPplus 0x0102
  /begin DAQ_EVENT VARIABLE /end DAQ_EVENT
 /end IF_DATA
/end MEASUREMENT
/begin MEASUREMENT SCtPmpRly_rAct "" SWORD Prc 1 100 -400.0000 399.9878 FORMAT "%8.4" ECU_ADDRESS 0x6001FD70
 /begin IF_DATA XCPplus 0x0102
  /begin DAQ_EVENT VARIABLE /end DAQ_EVENT
 /end IF_DATA
/end MEASUREMENT
/begin MEASUREMENT SCtPmpRly_rAct_Sq "" UBYTE SigQly_COMPU_VERB 1 100 0.00 15.0000000000 FORMAT "%13.10" ECU_ADDRESS 0x60023782
 /begin IF_DATA XCPplus 0x0102
  /begin DAQ_EVENT VARIABLE /end DAQ_EVENT
 /end IF_DATA
/end MEASUREMENT
/begin MEASUREMENT SCtPmpRly_ratActPosnB1 "" SWORD rel_q0p0078125 1 100 -256.0000 255.9922 FORMAT "%8.4" ECU_ADDRESS 0x6001FD64
 /begin IF_DATA XCPplus 0x0102
  /begin DAQ_EVENT VARIABLE /end DAQ_EVENT
 /end IF_DATA
/end MEASUREMENT
/begin MEASUREMENT SCtPmpRly_rDesVal "" SWORD Prc 1 100 -400.0000 399.9878 FORMAT "%8.4" ECU_ADDRESS 0x6001FD6C
 /begin IF_DATA XCPplus 0x0102
  /begin DAQ_EVENT VARIABLE /end DAQ_EVENT
 /end IF_DATA
/end MEASUREMENT
/begin MEASUREMENT SCtPmpRly_selfDiagPostDrv_mp "" UBYTE OneToOne 1 100 0.00 255.0 FORMAT "%5.1" ECU_ADDRESS 0x70006B59 /end MEASUREMENT
/begin MEASUREMENT SCtPmpRly_stElecDiag "" UBYTE OneToOne 1 100 0.00 255.0 FORMAT "%5.1" ECU_ADDRESS 0x60023508
 /begin IF_DATA XCPplus 0x0102
  /begin DAQ_EVENT VARIABLE /end DAQ_EVENT
 /end IF_DATA
/end MEASUREMENT
/begin MEASUREMENT SCtPmpRly_stErrInfo "" ULONG OneToOne 1 100 0.00 4294967295.00 FORMAT "%13.2" ECU_ADDRESS 0x60001010
 /begin IF_DATA XCPplus 0x0102
  /begin DAQ_EVENT VARIABLE /end DAQ_EVENT
 /end IF_DATA
/end MEASUREMENT
/begin MEASUREMENT SCtPmpRly_stMon "" ULONG OneToOne 1 100 0.00 4294967295.00 FORMAT "%13.2" ECU_ADDRESS 0x6000100C
 /begin IF_DATA XCPplus 0x0102
  /begin DAQ_EVENT VARIABLE /end DAQ_EVENT
 /end IF_DATA
/end MEASUREMENT
/begin MEASUREMENT SCtPmpRly_stMonDDSens "" ULONG OneToOne 1 100 0.00 4294967295.00 FORMAT "%13.2" ECU_ADDRESS 0x60001000
 /begin IF_DATA XCPplus 0x0102
  /begin DAQ_EVENT VARIABLE /end DAQ_EVENT
 /end IF_DATA
/end MEASUREMENT
/begin MEASUREMENT SCtPmpRly_stPwrStgEnaCond "" UBYTE OneToOne 1 100 0.00 255.0 FORMAT "%5.1" ECU_ADDRESS 0x6002377D
 /begin IF_DATA XCPplus 0x0102
  /begin DAQ_EVENT VARIABLE /end DAQ_EVENT
 /end IF_DATA
/end MEASUREMENT
/begin MEASUREMENT SCtPmpRly_swtConf2C "" ULONG OneToOne 1 100 0.00 4294967295.00 FORMAT "%13.2" ECU_ADDRESS 0x60000620 /end MEASUREMENT
/begin MEASUREMENT SCtPmpRly_swtConfC "" ULONG OneToOne 1 100 0.00 4294967295.00 FORMAT "%13.2" ECU_ADDRESS 0x6000061C /end MEASUREMENT
/begin MEASUREMENT SCtPmpRly_swtConfStdActrSwVersC "" ULONG OneToOne 1 100 0.00 4294967295.00 FORMAT "%13.2" ECU_ADDRESS 0x60000618 /end MEASUREMENT
/begin MEASUREMENT Sia_bEleclPowLck "flag for electrical power lock" UBYTE OneToOne 1 100 0.00 255.0 FORMAT "%5.1" ECU_ADDRESS 0x6002300D /end MEASUREMENT
/begin MEASUREMENT Sia_bFlPmpLck "Fuel Pump lock status" UBYTE OneToOne 1 100 0.00 255.0 FORMAT "%5.1" ECU_ADDRESS 0x6002300C /end MEASUREMENT
/begin MEASUREMENT Sia_bFshPrgLck "Flash prog lock status" UBYTE OneToOne 1 100 0.00 255.0 FORMAT "%5.1" ECU_ADDRESS 0x6002300B /end MEASUREMENT
/begin MEASUREMENT Sia_bIgnLck "Ignition lock status" UBYTE OneToOne 1 100 0.00 255.0 FORMAT "%5.1" ECU_ADDRESS 0x6002300A /end MEASUREMENT
/begin MEASUREMENT Sia_bInjLck "Locking request immobiliser for injection" UBYTE OneToOne 1 100 0.00 255.0 FORMAT "%5.1" ECU_ADDRESS 0x60023009 /end MEASUREMENT
/begin MEASUREMENT Sia_bStaLck "starter lock status" UBYTE OneToOne 1 100 0.00 255.0 FORMAT "%5.1" ECU_ADDRESS 0x60023008 /end MEASUREMENT
/begin MEASUREMENT Sia_bThrVlvLck "throttle valve lock status (due to immobilizer)" UBYTE OneToOne 1 100 0.00 255.0 FORMAT "%5.1" ECU_ADDRESS 0x60023007 /end MEASUREMENT
/begin MEASUREMENT Sia_bTstSrvLck "Locking request immobiliser for Tester services" UBYTE OneToOne 1 100 0.00 255.0 FORMAT "%5.1" ECU_ADDRESS 0x60023006 /end MEASUREMENT
/begin MEASUREMENT SpplCooltPmpRly_flgActrReq "" UBYTE OneToOne 1 100 0.00 255.0 BIT_MASK 0x1 FORMAT "%5.1" ECU_ADDRESS 0x6002348A /end MEASUREMENT
/begin MEASUREMENT SpplCooltPmpRly_flgActrSwtOffReq "" UBYTE OneToOne 1 100 0.00 255.0 FORMAT "%5.1" ECU_ADDRESS 0x60023505
 /begin IF_DATA XCPplus 0x0102
  /begin DAQ_EVENT VARIABLE /end DAQ_EVENT
 /end IF_DATA
/end MEASUREMENT
/begin MEASUREMENT SpplCooltPmpRly_flgElecDiagSwtOffReq "" UBYTE OneToOne 1 100 0.00 255.0 FORMAT "%5.1" ECU_ADDRESS 0x60023504
 /begin IF_DATA XCPplus 0x0102
  /begin DAQ_EVENT VARIABLE /end DAQ_EVENT
 /end IF_DATA
/end MEASUREMENT
/begin MEASUREMENT SpplCooltPmpRly_flgMonXPostDrv_mp "" UBYTE OneToOne 1 100 0.00 255.0 FORMAT "%5.1" ECU_ADDRESS 0x70006B58 /end MEASUREMENT
/begin MEASUREMENT SpplCooltPmpRly_flgPwrStgReq "" UBYTE OneToOne 1 100 0.00 1.000 FORMAT "%5.3" ECU_ADDRESS 0x60023503
 /begin IF_DATA XCPplus 0x0102
  /begin DAQ_EVENT VARIABLE /end DAQ_EVENT
 /end IF_DATA
/end MEASUREMENT
/begin MEASUREMENT SpplCooltPmpRly_numSigID "" UWORD OneToOne 1 100 0.00 65535.00 FORMAT "%8.2" ECU_ADDRESS 0x6001F3F4 /end MEASUREMENT
/begin MEASUREMENT SpplCooltPmpRly_r "Commanded value from application SW" SWORD Prc 1 100 -400.0000 399.9878 FORMAT "%8.4" ECU_ADDRESS 0x6001FD62
 /begin IF_DATA XCPplus 0x0102
  /begin DAQ_EVENT VARIABLE /end DAQ_EVENT
 /end IF_DATA
/end MEASUREMENT
/begin MEASUREMENT SpplCooltPmpRly_rAct "" SWORD Prc 1 100 -400.0000 399.9878 FORMAT "%8.4" ECU_ADDRESS 0x6001FD60
 /begin IF_DATA XCPplus 0x0102
  /begin DAQ_EVENT VARIABLE /end DAQ_EVENT
 /end IF_DATA
/end MEASUREMENT
/begin MEASUREMENT SpplCooltPmpRly_rActr "" SWORD Prc 1 100 -400.0000 399.9878 FORMAT "%8.4" ECU_ADDRESS 0x6001FD5E
 /begin IF_DATA XCPplus 0x0102
  /begin DAQ_EVENT VARIABLE /end DAQ_EVENT
 /end IF_DATA
/end MEASUREMENT
/begin MEASUREMENT SpplCooltPmpRly_rAct_Sq "" UBYTE SigQly_COMPU_VERB 1 100 0.00 15.0000000000 FORMAT "%13.10" ECU_ADDRESS 0x6002377C
 /begin IF_DATA XCPplus 0x0102
  /begin DAQ_EVENT VARIABLE /end DAQ_EVENT
 /end IF_DATA
/end MEASUREMENT
/begin MEASUREMENT SpplCooltPmpRly_ratActPosnB1 "" SWORD rel_q0p0078125 1 100 -256.0000 255.9922 FORMAT "%8.4" ECU_ADDRESS 0x6001FD54
 /begin IF_DATA XCPplus 0x0102
  /begin DAQ_EVENT VARIABLE /end DAQ_EVENT
 /end IF_DATA
/end MEASUREMENT
/begin MEASUREMENT SpplCooltPmpRly_rDesVal "" SWORD Prc 1 100 -400.0000 399.9878 FORMAT "%8.4" ECU_ADDRESS 0x6001FD5C
 /begin IF_DATA XCPplus 0x0102
  /begin DAQ_EVENT VARIABLE /end DAQ_EVENT
 /end IF_DATA
/end MEASUREMENT
/begin MEASUREMENT SpplCooltPmpRly_rDesValATS "" SWORD Prc 1 100 -400.0000 399.9878 FORMAT "%8.4" ECU_ADDRESS 0x700012BC
 /begin IF_DATA XCPplus 0x0102
  /begin DAQ_EVENT VARIABLE /end DAQ_EVENT
 /end IF_DATA
/end MEASUREMENT
/begin MEASUREMENT SpplCooltPmpRly_rGovActr "" SWORD Prc 1 100 -400.0000 399.9878 FORMAT "%8.4" ECU_ADDRESS 0x70001524
 /begin IF_DATA XCPplus 0x0102
  /begin DAQ_EVENT VARIABLE /end DAQ_EVENT
 /end IF_DATA
/end MEASUREMENT
/begin MEASUREMENT SpplCooltPmpRly_rMax "" SWORD DtyCyc 1 100 -327.6800 327.6700 FORMAT "%8.4" ECU_ADDRESS 0x6001FD5A
 /begin IF_DATA XCPplus 0x0102
  /begin DAQ_EVENT VARIABLE /end DAQ_EVENT
 /end IF_DATA
/end MEASUREMENT
/begin MEASUREMENT SpplCooltPmpRly_rMin "" SWORD DtyCyc 1 100 -327.6800 327.6700 FORMAT "%8.4" ECU_ADDRESS 0x6001FD58
 /begin IF_DATA XCPplus 0x0102
  /begin DAQ_EVENT VARIABLE /end DAQ_EVENT
 /end IF_DATA
/end MEASUREMENT
/begin MEASUREMENT SpplCooltPmpRly_rPs "" SWORD DtyCyc 1 100 -327.6800 327.6700 FORMAT "%8.4" ECU_ADDRESS 0x6001FD56
 /begin IF_DATA XCPplus 0x0102
  /begin DAQ_EVENT VARIABLE /end DAQ_EVENT
 /end IF_DATA
/end MEASUREMENT
/begin MEASUREMENT SpplCooltPmpRly_selfDiagPostDrv_mp "" UBYTE OneToOne 1 100 0.00 255.0 FORMAT "%5.1" ECU_ADDRESS 0x70006B57 /end MEASUREMENT
/begin MEASUREMENT SpplCooltPmpRly_SigTyp "" UBYTE OneToOne 1 100 0.00 255.0 FORMAT "%5.1" ECU_ADDRESS 0x60023005
 /begin IF_DATA XCPplus 0x0102
  /begin DAQ_EVENT VARIABLE /end DAQ_EVENT
 /end IF_DATA
/end MEASUREMENT
/begin MEASUREMENT SpplCooltPmpRly_stCoEng "" UBYTE OneToOne 1 100 0.00 255.0 FORMAT "%5.1" ECU_ADDRESS 0x6002377B
 /begin IF_DATA XCPplus 0x0102
  /begin DAQ_EVENT VARIABLE /end DAQ_EVENT
 /end IF_DATA
/end MEASUREMENT
/begin MEASUREMENT SpplCooltPmpRly_stDeactvn "" UBYTE OneToOne 1 100 0.00 255.0 FORMAT "%5.1" ECU_ADDRESS 0x6002377A
 /begin IF_DATA XCPplus 0x0102
  /begin DAQ_EVENT VARIABLE /end DAQ_EVENT
 /end IF_DATA
/end MEASUREMENT
/begin MEASUREMENT SpplCooltPmpRly_stDesVal "" UBYTE OneToOne 1 100 0.00 255.0 FORMAT "%5.1" ECU_ADDRESS 0x60023779
 /begin IF_DATA XCPplus 0x0102
  /begin DAQ_EVENT VARIABLE /end DAQ_EVENT
 /end IF_DATA
/end MEASUREMENT
/begin MEASUREMENT SpplCooltPmpRly_stElecDiag "" UBYTE OneToOne 1 100 0.00 255.0 FORMAT "%5.1" ECU_ADDRESS 0x60023502
 /begin IF_DATA XCPplus 0x0102
  /begin DAQ_EVENT VARIABLE /end DAQ_EVENT
 /end IF_DATA
/end MEASUREMENT
/begin MEASUREMENT SpplCooltPmpRly_stErrInfo "" ULONG OneToOne 1 100 0.00 4294967295.00 FORMAT "%13.2" ECU_ADDRESS 0x60000FFC
 /begin IF_DATA XCPplus 0x0102
  /begin DAQ_EVENT VARIABLE /end DAQ_EVENT
 /end IF_DATA
/end MEASUREMENT
/begin MEASUREMENT SpplCooltPmpRly_stMon "" ULONG OneToOne 1 100 0.00 4294967295.00 FORMAT "%13.2" ECU_ADDRESS 0x60000FF8
 /begin IF_DATA XCPplus 0x0102
  /begin DAQ_EVENT VARIABLE /end DAQ_EVENT
 /end IF_DATA
/end MEASUREMENT
/begin MEASUREMENT SpplCooltPmpRly_stMonActrPwrStgDrvr "" ULONG OneToOne 1 100 0.00 2147483647.00 FORMAT "%13.2" ECU_ADDRESS 0x60000EB8
 /begin IF_DATA XCPplus 0x0102
  /begin DAQ_EVENT VARIABLE /end DAQ_EVENT
 /end IF_DATA
/end MEASUREMENT
/begin MEASUREMENT SpplCooltPmpRly_stMonCo "" ULONG OneToOne 1 100 0.00 4294967295.00 FORMAT "%13.2" ECU_ADDRESS 0x60000FF4
 /begin IF_DATA XCPplus 0x0102
  /begin DAQ_EVENT VARIABLE /end DAQ_EVENT
 /end IF_DATA
/end MEASUREMENT
/begin MEASUREMENT SpplCooltPmpRly_stMonDD "" ULONG OneToOne 1 100 0.00 4294967295.00 FORMAT "%13.2" ECU_ADDRESS 0x60000FF0
 /begin IF_DATA XCPplus 0x0102
  /begin DAQ_EVENT VARIABLE /end DAQ_EVENT
 /end IF_DATA
/end MEASUREMENT
/begin MEASUREMENT SpplCooltPmpRly_stMonDDSens "" ULONG OneToOne 1 100 0.00 4294967295.00 FORMAT "%13.2" ECU_ADDRESS 0x60000FEC
 /begin IF_DATA XCPplus 0x0102
  /begin DAQ_EVENT VARIABLE /end DAQ_EVENT
 /end IF_DATA
/end MEASUREMENT
/begin MEASUREMENT SpplCooltPmpRly_stMonGlbElecdd "" ULONG OneToOne 1 100 0.00 2147483647.00 FORMAT "%13.2" ECU_ADDRESS 0x60000EB4
 /begin IF_DATA XCPplus 0x0102
  /begin DAQ_EVENT VARIABLE /end DAQ_EVENT
 /end IF_DATA
/end MEASUREMENT
/begin MEASUREMENT SpplCooltPmpRly_stPs "" UBYTE OneToOne 1 100 0.00 255.0 FORMAT "%5.1" ECU_ADDRESS 0x60023778
 /begin IF_DATA XCPplus 0x0102
  /begin DAQ_EVENT VARIABLE /end DAQ_EVENT
 /end IF_DATA
/end MEASUREMENT
/begin MEASUREMENT SpplCooltPmpRly_stPwrStgDrvr "" UBYTE OneToOne 1 100 0.00 255.0 FORMAT "%5.1" ECU_ADDRESS 0x60023501
 /begin IF_DATA XCPplus 0x0102
  /begin DAQ_EVENT VARIABLE /end DAQ_EVENT
 /end IF_DATA
/end MEASUREMENT
/begin MEASUREMENT SpplCooltPmpRly_stPwrStgEnaCond "" UBYTE OneToOne 1 100 0.00 255.0 FORMAT "%5.1" ECU_ADDRESS 0x60023777
 /begin IF_DATA XCPplus 0x0102
  /begin DAQ_EVENT VARIABLE /end DAQ_EVENT
 /end IF_DATA
/end MEASUREMENT
/begin MEASUREMENT SpplCooltPmpRly_swtConf2C "" ULONG OneToOne 1 100 0.00 4294967295.00 FORMAT "%13.2" ECU_ADDRESS 0x60000614 /end MEASUREMENT
/begin MEASUREMENT SpplCooltPmpRly_swtConfActrPwrStgDrvr "" UBYTE OneToOne 1 100 0.00 255.0 FORMAT "%5.1" ECU_ADDRESS 0x60023500 /end MEASUREMENT
/begin MEASUREMENT SpplCooltPmpRly_swtConfC "" ULONG OneToOne 1 100 0.00 4294967295.00 FORMAT "%13.2" ECU_ADDRESS 0x60000610 /end MEASUREMENT
/begin MEASUREMENT SpplCooltPmpRly_swtConfDevDrvrOutpDutyCycRampC "" UBYTE OneToOne 1 100 0.00 255.0 FORMAT "%5.1" ECU_ADDRESS 0x700014B2 /end MEASUREMENT
/begin MEASUREMENT SpplCooltPmpRly_swtConfStdActrSwVersC "" ULONG OneToOne 1 100 0.00 4294967295.00 FORMAT "%13.2" ECU_ADDRESS 0x6000060C /end MEASUREMENT
/begin MEASUREMENT StrtUpEv_flgDrvAwyDi "Status flag indicating that the drive-away or crawling controller is deactivated" UBYTE B_TRUE 1 100 0.00 1.00000000000 BIT_MASK 0x1 FORMAT "%13.11" ECU_ADDRESS 0x60023488
 /begin IF_DATA XCPplus 0x0102
  /begin DAQ_EVENT VARIABLE /end DAQ_EVENT
 /end IF_DATA
/end MEASUREMENT
/begin MEASUREMENT StrtUpEv_flgDrvAwyFrz "Status flag indicating that the I-part of the drive-away or crawling controller is frozen" UBYTE B_TRUE 1 100 0.00 1.00000000000 BIT_MASK 0x1 FORMAT "%13.11" ECU_ADDRESS 0x60023004
 /begin IF_DATA XCPplus 0x0102
  /begin DAQ_EVENT VARIABLE /end DAQ_EVENT
 /end IF_DATA
/end MEASUREMENT
/begin MEASUREMENT StrtUpEv_flgPrmntDeactvd "Status flag indicating permenant deactivation" UBYTE B_TRUE 1 100 0.00 1.00000000000 BIT_MASK 0x1 FORMAT "%13.11" ECU_ADDRESS 0x60023487
 /begin IF_DATA XCPplus 0x0102
  /begin DAQ_EVENT VARIABLE /end DAQ_EVENT
 /end IF_DATA
/end MEASUREMENT
/begin MEASUREMENT StrtUpEv_flgStandStillDeactvn "Flag: Deactivation of crawling controller during standstill" UBYTE B_TRUE 1 100 0.00 1.00000000000 BIT_MASK 0x1 FORMAT "%13.11" ECU_ADDRESS 0x60023003
 /begin IF_DATA XCPplus 0x0102
  /begin DAQ_EVENT VARIABLE /end DAQ_EVENT
 /end IF_DATA
/end MEASUREMENT
/begin MEASUREMENT StrtUpEv_flgTmpDeactvd "Status flag indicating temporary deactivation" UBYTE B_TRUE 1 100 0.00 1.00000000000 BIT_MASK 0x1 FORMAT "%13.11" ECU_ADDRESS 0x60023486
 /begin IF_DATA XCPplus 0x0102
  /begin DAQ_EVENT VARIABLE /end DAQ_EVENT
 /end IF_DATA
/end MEASUREMENT
/begin MEASUREMENT StrtUpEv_flgWhlDes "Flag with 1 raster delay used when the controller is activated the P-contribution of the crawling controller initializes with the actual demand from the acceleration lever." UBYTE B_TRUE 1 100 0.00 1.00000000000 BIT_MASK 0x1 FORMAT "%13.11" ECU_ADDRESS 0x60023002
 /begin IF_DATA XCPplus 0x0102
  /begin DAQ_EVENT VARIABLE /end DAQ_EVENT
 /end IF_DATA
/end MEASUREMENT
/begin MEASUREMENT StrtUpEv_pBrk "Brake Pressure in MPa" SWORD Pres_LoRes_COMPU 1 100 -327.6800 327.6700 FORMAT "%8.4" ECU_ADDRESS 0x6001F3F2
 /begin IF_DATA XCPplus 0x0102
  /begin DAQ_EVENT VARIABLE /end DAQ_EVENT
 /end IF_DATA
/end MEASUREMENT
/begin MEASUREMENT StrtUpEv_stDrvAwyDi "Bit string of all deactivation conditions of the drive-away or crawling controller" ULONG OneToOne 1 100 0.00 4294967295.00 FORMAT "%13.2" ECU_ADDRESS 0x60000EB0
 /begin IF_DATA XCPplus 0x0102
  /begin DAQ_EVENT VARIABLE /end DAQ_EVENT
 /end IF_DATA
/end MEASUREMENT
/begin MEASUREMENT StrtUpEv_stTqLimd "Status for indicating which limitation is limiting the drive torque of the drive-away or crawling controller in this module itself" UBYTE OneToOne 1 100 0.00 255.0 FORMAT "%5.1" ECU_ADDRESS 0x60023001
 /begin IF_DATA XCPplus 0x0102
  /begin DAQ_EVENT VARIABLE /end DAQ_EVENT
 /end IF_DATA
/end MEASUREMENT
/begin MEASUREMENT StrtUpEv_tqDes "Torque demand after coordination of the starting torquebackroll-limitation torque with drive demand torque" SLONG TrqPrpHigh 1 100 -214748364.800 214748364.700 FORMAT "%13.3" ECU_ADDRESS 0x60000F4C
 /begin IF_DATA XCPplus 0x0102
  /begin DAQ_EVENT VARIABLE /end DAQ_EVENT
 /end IF_DATA
/end MEASUREMENT
/begin MEASUREMENT StrtUpEv_tqDrvAwyI "I-part of startup controller" SLONG TrqPrpHigh 1 100 -214748364.800 214748364.700 FORMAT "%13.3" ECU_ADDRESS 0x60000608
 /begin IF_DATA XCPplus 0x0102
  /begin DAQ_EVENT VARIABLE /end DAQ_EVENT
 /end IF_DATA
/end MEASUREMENT
/begin MEASUREMENT StrtUpEv_tqDrvAwyNotLimd "Unlimited total torque of the drive-away or crawling controller" SLONG TrqPrpHigh 1 100 -214748364.800 214748364.700 FORMAT "%13.3" ECU_ADDRESS 0x60000604
 /begin IF_DATA XCPplus 0x0102
  /begin DAQ_EVENT VARIABLE /end DAQ_EVENT
 /end IF_DATA
/end MEASUREMENT
/begin MEASUREMENT StrtUpEv_tqDrvAwyP "P-part of startup controller" SLONG TrqPrpHigh 1 100 -214748364.800 214748364.700 FORMAT "%13.3" ECU_ADDRESS 0x60000600
 /begin IF_DATA XCPplus 0x0102
  /begin DAQ_EVENT VARIABLE /end DAQ_EVENT
 /end IF_DATA
/end MEASUREMENT
/begin MEASUREMENT StrtUpEv_tqDrvAwyPreCtrl "Precontrol-part of startup controller" SLONG TrqPrpHigh 1 100 -214748364.800 214748364.700 FORMAT "%13.3" ECU_ADDRESS 0x600005FC
 /begin IF_DATA XCPplus 0x0102
  /begin DAQ_EVENT VARIABLE /end DAQ_EVENT
 /end IF_DATA
/end MEASUREMENT
/begin MEASUREMENT StrtUpEv_vDrvAwyDesRmp "ramped desired velocity of crawling controller" SWORD Vel 1 100 -327.6800 327.6700 FORMAT "%8.4" ECU_ADDRESS 0x6001F3F0
 /begin IF_DATA XCPplus 0x0102
  /begin DAQ_EVENT VARIABLE /end DAQ_EVENT
 /end IF_DATA
/end MEASUREMENT
/begin MEASUREMENT StrtUpEv_vDrvAwyDesUnRmp "unramped desired velocity of crawling controller" SWORD Vel 1 100 -327.6800 327.6700 FORMAT "%8.4" ECU_ADDRESS 0x6001F3EE
 /begin IF_DATA XCPplus 0x0102
  /begin DAQ_EVENT VARIABLE /end DAQ_EVENT
 /end IF_DATA
/end MEASUREMENT
/begin MEASUREMENT StrtUpEv_vDrvAwyDif "deviation for speed controller" SWORD Vel 1 100 -327.6800 327.6700 FORMAT "%8.4" ECU_ADDRESS 0x6001F3EC
 /begin IF_DATA XCPplus 0x0102
  /begin DAQ_EVENT VARIABLE /end DAQ_EVENT
 /end IF_DATA
/end MEASUREMENT
/begin MEASUREMENT StrtUpEv_vRef "reference vehicle speed for start up (creeping) function" SWORD Vel 1 100 -327.6800 327.6700 FORMAT "%8.4" ECU_ADDRESS 0x6001F3EA
 /begin IF_DATA XCPplus 0x0102
  /begin DAQ_EVENT VARIABLE /end DAQ_EVENT
 /end IF_DATA
/end MEASUREMENT
/begin MEASUREMENT SVSLmp_stPs "status of the SVS lamp powerstage (on, off)" UBYTE OneToOne 1 100 0.00 255.0 BIT_MASK 0x1 FORMAT "%5.1" ECU_ADDRESS 0x60023881
 /begin IF_DATA XCPplus 0x0102
  /begin DAQ_EVENT VARIABLE /end DAQ_EVENT
 /end IF_DATA
/end MEASUREMENT
/begin MEASUREMENT SVSLmp_stReqBln "SVS request register for blinking SVS requests" UWORD OneToOne 1 100 0.00 65535.00 FORMAT "%8.2" ECU_ADDRESS 0x60035E78
 /begin IF_DATA XCPplus 0x0102
  /begin DAQ_EVENT VARIABLE /end DAQ_EVENT
 /end IF_DATA
/end MEASUREMENT
/begin MEASUREMENT SVSLmp_stReqOn "SVS request register for continuous SVS requests" UWORD OneToOne 1 100 0.00 65535.00 FORMAT "%8.2" ECU_ADDRESS 0x60035E7A
 /begin IF_DATA XCPplus 0x0102
  /begin DAQ_EVENT VARIABLE /end DAQ_EVENT
 /end IF_DATA
/end MEASUREMENT
/begin MEASUREMENT SVSLmp_stSVS "SVS status (permanently illuminated, off, blink frequency)" UBYTE OneToOne 1 100 0.00 255.0 FORMAT "%5.1" ECU_ADDRESS 0x60023883
 /begin IF_DATA XCPplus 0x0102
  /begin DAQ_EVENT VARIABLE /end DAQ_EVENT
 /end IF_DATA
/end MEASUREMENT
/begin MEASUREMENT SVSLmp_stSVSWoTstr "SVS status without tester intervention" UBYTE OneToOne 1 100 0.00 255.0 FORMAT "%5.1" ECU_ADDRESS 0x60025788
 /begin IF_DATA XCPplus 0x0102
  /begin DAQ_EVENT VARIABLE /end DAQ_EVENT
 /end IF_DATA
/end MEASUREMENT
/begin MEASUREMENT SVSLmp_tiRmnBln "remaining time for SVS trigger during SVS_BLINK" UBYTE t50msxs_q0p05 1 100 0.00 12.75 FORMAT "%5.2" ECU_ADDRESS 0x60025786
 /begin IF_DATA XCPplus 0x0102
  /begin DAQ_EVENT VARIABLE /end DAQ_EVENT
 /end IF_DATA
/end MEASUREMENT
/begin MEASUREMENT SWAdp_ComEmac_tIvtrCoolt01_SqLoc "" UBYTE B_TRUE 1 100 0.00 1.00000000000 BIT_MASK 0x1 FORMAT "%13.11" ECU_ADDRESS 0x60022FFE
 /begin IF_DATA XCPplus 0x0102
  /begin DAQ_EVENT VARIABLE /end DAQ_EVENT
 /end IF_DATA
/end MEASUREMENT
/begin MEASUREMENT SWAdp_Com_flgHillHldActvd_SqLoc "" UBYTE B_TRUE 1 100 0.00 1.00000000000 BIT_MASK 0x1 FORMAT "%13.11" ECU_ADDRESS 0x60022FFD
 /begin IF_DATA XCPplus 0x0102
  /begin DAQ_EVENT VARIABLE /end DAQ_EVENT
 /end IF_DATA
/end MEASUREMENT
/begin MEASUREMENT SWAdp_Emac_iDcLnk01_SqLoc "" UBYTE B_TRUE 1 100 0.00 1.00000000000 BIT_MASK 0x1 FORMAT "%13.11" ECU_ADDRESS 0x60022FFC
 /begin IF_DATA XCPplus 0x0102
  /begin DAQ_EVENT VARIABLE /end DAQ_EVENT
 /end IF_DATA
/end MEASUREMENT
/begin MEASUREMENT SWAdp_Emac_nAct01_SqLoc "" UBYTE B_TRUE 1 100 0.00 1.00000000000 BIT_MASK 0x1 FORMAT "%13.11" ECU_ADDRESS 0x60022FFB
 /begin IF_DATA XCPplus 0x0102
  /begin DAQ_EVENT VARIABLE /end DAQ_EVENT
 /end IF_DATA
/end MEASUREMENT
/begin MEASUREMENT SWAdp_Emac_stMod01_SqLoc "" UBYTE B_TRUE 1 100 0.00 1.00000000000 BIT_MASK 0x1 FORMAT "%13.11" ECU_ADDRESS 0x60022FFA
 /begin IF_DATA XCPplus 0x0102
  /begin DAQ_EVENT VARIABLE /end DAQ_EVENT
 /end IF_DATA
/end MEASUREMENT
/begin MEASUREMENT SWAdp_Emac_tInvr01_SqLoc "" UBYTE B_TRUE 1 100 0.00 1.00000000000 BIT_MASK 0x1 FORMAT "%13.11" ECU_ADDRESS 0x60022FDA
 /begin IF_DATA XCPplus 0x0102
  /begin DAQ_EVENT VARIABLE /end DAQ_EVENT
 /end IF_DATA
/end MEASUREMENT
/begin MEASUREMENT SWAdp_Emac_tMac01_SqLoc "" UBYTE B_TRUE 1 100 0.00 1.00000000000 BIT_MASK 0x1 FORMAT "%13.11" ECU_ADDRESS 0x60022FD9
 /begin IF_DATA XCPplus 0x0102
  /begin DAQ_EVENT VARIABLE /end DAQ_EVENT
 /end IF_DATA
/end MEASUREMENT
/begin MEASUREMENT SWAdp_Emac_tqAbsltMax01_SqLoc "" UBYTE B_TRUE 1 100 0.00 1.00000000000 BIT_MASK 0x1 FORMAT "%13.11" ECU_ADDRESS 0x60022FF9
 /begin IF_DATA XCPplus 0x0102
  /begin DAQ_EVENT VARIABLE /end DAQ_EVENT
 /end IF_DATA
/end MEASUREMENT
/begin MEASUREMENT SWAdp_Emac_tqAbsltMin01_SqLoc "" UBYTE B_TRUE 1 100 0.00 1.00000000000 BIT_MASK 0x1 FORMAT "%13.11" ECU_ADDRESS 0x60022FF8
 /begin IF_DATA XCPplus 0x0102
  /begin DAQ_EVENT VARIABLE /end DAQ_EVENT
 /end IF_DATA
/end MEASUREMENT
/begin MEASUREMENT SWAdp_Emac_tqAct01_SqLoc "" UBYTE B_TRUE 1 100 0.00 1.00000000000 BIT_MASK 0x1 FORMAT "%13.11" ECU_ADDRESS 0x60022FF7
 /begin IF_DATA XCPplus 0x0102
  /begin DAQ_EVENT VARIABLE /end DAQ_EVENT
 /end IF_DATA
/end MEASUREMENT
/begin MEASUREMENT SWAdp_Emac_uDcLnk01_SqLoc "" UBYTE B_TRUE 1 100 0.00 1.00000000000 BIT_MASK 0x1 FORMAT "%13.11" ECU_ADDRESS 0x60022FF6
 /begin IF_DATA XCPplus 0x0102
  /begin DAQ_EVENT VARIABLE /end DAQ_EVENT
 /end IF_DATA
/end MEASUREMENT
/begin MEASUREMENT SWAdp_flgEmgyShtDwnReq01_SqLoc "" UBYTE B_TRUE 1 100 0.00 1.00000000000 BIT_MASK 0x1 FORMAT "%13.11" ECU_ADDRESS 0x60022FF5
 /begin IF_DATA XCPplus 0x0102
  /begin DAQ_EVENT VARIABLE /end DAQ_EVENT
 /end IF_DATA
/end MEASUREMENT
/begin MEASUREMENT SWAdp_iHvbAct_SqLoc "" UBYTE B_TRUE 1 100 0.00 1.00000000000 BIT_MASK 0x1 FORMAT "%13.11" ECU_ADDRESS 0x60022FF4
 /begin IF_DATA XCPplus 0x0102
  /begin DAQ_EVENT VARIABLE /end DAQ_EVENT
 /end IF_DATA
/end MEASUREMENT
/begin MEASUREMENT SWAdp_iHvbChrgMaxSho_SqLoc "" UBYTE B_TRUE 1 100 0.00 1.00000000000 BIT_MASK 0x1 FORMAT "%13.11" ECU_ADDRESS 0x60022FF3
 /begin IF_DATA XCPplus 0x0102
  /begin DAQ_EVENT VARIABLE /end DAQ_EVENT
 /end IF_DATA
/end MEASUREMENT
/begin MEASUREMENT SWAdp_iHvbDchaMaxSho_SqLoc "" UBYTE B_TRUE 1 100 0.00 1.00000000000 BIT_MASK 0x1 FORMAT "%13.11" ECU_ADDRESS 0x60022FF2
 /begin IF_DATA XCPplus 0x0102
  /begin DAQ_EVENT VARIABLE /end DAQ_EVENT
 /end IF_DATA
/end MEASUREMENT
/begin MEASUREMENT SWAdp_iHvbDes_SqLoc "" UBYTE B_TRUE 1 100 0.00 1.00000000000 BIT_MASK 0x1 FORMAT "%13.11" ECU_ADDRESS 0x60022FD8
 /begin IF_DATA XCPplus 0x0102
  /begin DAQ_EVENT VARIABLE /end DAQ_EVENT
 /end IF_DATA
/end MEASUREMENT
/begin MEASUREMENT SWAdp_ratHvbSoc_SqLoc "" UBYTE B_TRUE 1 100 0.00 1.00000000000 BIT_MASK 0x1 FORMAT "%13.11" ECU_ADDRESS 0x60022FF1
 /begin IF_DATA XCPplus 0x0102
  /begin DAQ_EVENT VARIABLE /end DAQ_EVENT
 /end IF_DATA
/end MEASUREMENT
/begin MEASUREMENT SWAdp_stHvbCntct_SqLoc "" UBYTE B_TRUE 1 100 0.00 1.00000000000 BIT_MASK 0x1 FORMAT "%13.11" ECU_ADDRESS 0x60022FF0
 /begin IF_DATA XCPplus 0x0102
  /begin DAQ_EVENT VARIABLE /end DAQ_EVENT
 /end IF_DATA
/end MEASUREMENT
/begin MEASUREMENT SWAdp_stHvbDernMaxT_SqLoc "" UBYTE B_TRUE 1 100 0.00 1.00000000000 BIT_MASK 0x1 FORMAT "%13.11" ECU_ADDRESS 0x60022FD7
 /begin IF_DATA XCPplus 0x0102
  /begin DAQ_EVENT VARIABLE /end DAQ_EVENT
 /end IF_DATA
/end MEASUREMENT
/begin MEASUREMENT SWAdp_stHvbDernMinT_SqLoc "" UBYTE B_TRUE 1 100 0.00 1.00000000000 BIT_MASK 0x1 FORMAT "%13.11" ECU_ADDRESS 0x60022FD6
 /begin IF_DATA XCPplus 0x0102
  /begin DAQ_EVENT VARIABLE /end DAQ_EVENT
 /end IF_DATA
/end MEASUREMENT
/begin MEASUREMENT SWAdp_stHvbFlt_SqLoc "" UBYTE B_TRUE 1 100 0.00 1.00000000000 BIT_MASK 0x1 FORMAT "%13.11" ECU_ADDRESS 0x60022FEF
 /begin IF_DATA XCPplus 0x0102
  /begin DAQ_EVENT VARIABLE /end DAQ_EVENT
 /end IF_DATA
/end MEASUREMENT
/begin MEASUREMENT SWAdp_stHvbIntlck_SqLoc "" UBYTE B_TRUE 1 100 0.00 1.00000000000 BIT_MASK 0x1 FORMAT "%13.11" ECU_ADDRESS 0x60022FD5
 /begin IF_DATA XCPplus 0x0102
  /begin DAQ_EVENT VARIABLE /end DAQ_EVENT
 /end IF_DATA
/end MEASUREMENT
/begin MEASUREMENT SWAdp_stHvbIsoFlt_SqLoc "" UBYTE B_TRUE 1 100 0.00 1.00000000000 BIT_MASK 0x1 FORMAT "%13.11" ECU_ADDRESS 0x60022FD4
 /begin IF_DATA XCPplus 0x0102
  /begin DAQ_EVENT VARIABLE /end DAQ_EVENT
 /end IF_DATA
/end MEASUREMENT
/begin MEASUREMENT SWAdp_stHvbMod_SqLoc "" UBYTE B_TRUE 1 100 0.00 1.00000000000 BIT_MASK 0x1 FORMAT "%13.11" ECU_ADDRESS 0x60022FEE
 /begin IF_DATA XCPplus 0x0102
  /begin DAQ_EVENT VARIABLE /end DAQ_EVENT
 /end IF_DATA
/end MEASUREMENT
/begin MEASUREMENT SWAdp_tHvbAct_SqLoc "" UBYTE B_TRUE 1 100 0.00 1.00000000000 BIT_MASK 0x1 FORMAT "%13.11" ECU_ADDRESS 0x60022FD3
 /begin IF_DATA XCPplus 0x0102
  /begin DAQ_EVENT VARIABLE /end DAQ_EVENT
 /end IF_DATA
/end MEASUREMENT
/begin MEASUREMENT SWAdp_uElCmprHvAct_SqLoc "" UBYTE B_TRUE 1 100 0.00 1.00000000000 BIT_MASK 0x1 FORMAT "%13.11" ECU_ADDRESS 0x60022FD2
 /begin IF_DATA XCPplus 0x0102
  /begin DAQ_EVENT VARIABLE /end DAQ_EVENT
 /end IF_DATA
/end MEASUREMENT
/begin MEASUREMENT SWAdp_uHvbAct_SqLoc "" UBYTE B_TRUE 1 100 0.00 1.00000000000 BIT_MASK 0x1 FORMAT "%13.11" ECU_ADDRESS 0x60022FED
 /begin IF_DATA XCPplus 0x0102
  /begin DAQ_EVENT VARIABLE /end DAQ_EVENT
 /end IF_DATA
/end MEASUREMENT
/begin MEASUREMENT SWAdp_uHvbLimHi_SqLoc "" UBYTE B_TRUE 1 100 0.00 1.00000000000 BIT_MASK 0x1 FORMAT "%13.11" ECU_ADDRESS 0x60022FD1
 /begin IF_DATA XCPplus 0x0102
  /begin DAQ_EVENT VARIABLE /end DAQ_EVENT
 /end IF_DATA
/end MEASUREMENT
/begin MEASUREMENT SWAdp_uHvbNomChrgn_SqLoc "" UBYTE B_TRUE 1 100 0.00 1.00000000000 BIT_MASK 0x1 FORMAT "%13.11" ECU_ADDRESS 0x60022FEC
 /begin IF_DATA XCPplus 0x0102
  /begin DAQ_EVENT VARIABLE /end DAQ_EVENT
 /end IF_DATA
/end MEASUREMENT
/begin MEASUREMENT UCtP_uSens "" SWORD RBPtCel_u_0p1_1 1 100 -3276.800 3276.700 FORMAT "%8.3" ECU_ADDRESS 0x6001FA6A
 /begin IF_DATA XCPplus 0x0102
  /begin DAQ_EVENT VARIABLE /end DAQ_EVENT
 /end IF_DATA
/end MEASUREMENT
/begin MEASUREMENT UPxP1_u "" SWORD RBPtCel_u_0p1_1 1 100 -3276.800 3276.700 FORMAT "%8.3" ECU_ADDRESS 0x6001FA68
 /begin IF_DATA XCPplus 0x0102
  /begin DAQ_EVENT VARIABLE /end DAQ_EVENT
 /end IF_DATA
/end MEASUREMENT
/begin MEASUREMENT VehCoorn_wElecCnsTotWght "total average electric consumption weigthed" UWORD OneToOne 1 100 0.00 65535.00 FORMAT "%8.2" ECU_ADDRESS 0x6001FA18
 /begin IF_DATA XCPplus 0x0102
  /begin DAQ_EVENT VARIABLE /end DAQ_EVENT
 /end IF_DATA
/end MEASUREMENT
/begin MEASUREMENT VehM_flgOnePedlDrvgOff "Status Flag for one pedal driving off" UBYTE B_TRUE 1 100 0.00 1.00000000000 BIT_MASK 0x1 FORMAT "%13.11" ECU_ADDRESS 0x60023484
 /begin IF_DATA XCPplus 0x0102
  /begin DAQ_EVENT VARIABLE /end DAQ_EVENT
 /end IF_DATA
/end MEASUREMENT
/begin FUNCTION SCtPmpRly_DELib_StdActrInin "9.5.0"
 /begin DEF_CHARACTERISTIC SCtPmpRly_swtConf2_C SCtPmpRly_swtConfStdActrSwVers162_C SCtPmpRly_swtConf_C /end DEF_CHARACTERISTIC
 /begin OUT_MEASUREMENT SCtPmpRly_swtConf2C SCtPmpRly_swtConfC SCtPmpRly_swtConfStdActrSwVersC /end OUT_MEASUREMENT
 FUNCTION_VERSION "9.5.0" /end FUNCTION
/begin FUNCTION SCtPmpRly_DELib_StdActrSnsrDd "6.4.0" /begin DEF_CHARACTERISTIC SCtPmpRly_ratActLin_CUR /end DEF_CHARACTERISTIC
 /begin REF_CHARACTERISTIC SCtPmpRly_StdCal.tiDesValFlt_C SCtPmpRly_StdCal.rPsOff_C SCtPmpRly_StdCal.rActrStop_C SCtPmpRly_StdCal.rHysHigh_C SCtPmpRly_StdCal.rHysLow_C SCtPmpRly_StdCal.stPwrStgDiaDis_C SCtPmpRly_StdCal.stPlausDiaDis_C SCtPmpRly_StdCal.stPwrStgDis_C SCtPmpRly_StdCal.stActrStop_C SCtPmpRly_StdCal.stAllPwrStgDiaEna_C SCtPmpRly_StdCal.swtDesVal_C SCtPmpRly_StdCal.numDiagTry_C SCtPmpRly_StdCal.rDesValOff_C SCtPmpRly_StdCal.rDesValOn_C SCtPmpRly_StdCal.numEngDaFrqPs_C SCtPmpRly_StdCal.tiSlwRespSimPT1_C SCtPmpRly_StdCal.uHiBattThd_C SCtPmpRly_StdCal.uLoBattThd_C SCtPmpRly_StdCal.tiDebBattVoltOk_C SCtPmpRly_StdCal.tiDebBattVoltDfct_C SCtPmpRly_StdCal.mskActrActv_C SCtPmpRly_StdCal.tiDlyActrActvn_C SCtPmpRly_StdCal.rPsActrOff_C SCtPmpRly_StdCal.uBattMin_C SCtPmpRly_StdCal.uBattMax_C SCtPmpRly_StdCal.tiShOffCtrlDne_C SCtPmpRly_StdCal.swtDeactvn_C SCtPmpRly_StdCal.tiSelfDiagStrt_C SCtPmpRly_StdCal.flgReacvnPostDrv_C SCtPmpRly_StdCal.rPsRlyOff_C SCtPmpRly_StdCal.tiRlyOnDly_C SCtPmpRly_StdCal.nFMInWinMsk_C SCtPmpRly_StdCal.tiFMInDeb_C SCtPmpRly_StdCal.tiJamActrWait_C SCtPmpRly_swtConf2_C SCtPmpRly_swtConf_C /end REF_CHARACTERISTIC
 /begin IN_MEASUREMENT SCtPmpRly_rDesVal SCtPmpRly_stDesVal SCtPmpRly_stMon SCtPmpRly_swtConf2C SCtPmpRly_swtConfC SCtPmpRly_swtConfStdActrSwVersC /end IN_MEASUREMENT
 /begin OUT_MEASUREMENT SCtPmpRly_rAct SCtPmpRly_rAct_Sq SCtPmpRly_ratActPosnB1 SCtPmpRly_stMonDDSens /end OUT_MEASUREMENT
 FUNCTION_VERSION "6.4.0" /end FUNCTION
/begin FUNCTION SCtPmpRly_DELib_StdActrVd "5.0.0" /begin IN_MEASUREMENT SCtPmpRly_rGovActr SCtPmpRly_swtConfC /end IN_MEASUREMENT /begin OUT_MEASUREMENT SCtPmpRly_rDesVal /end OUT_MEASUREMENT FUNCTION_VERSION "5.0.0" /end FUNCTION
/begin FUNCTION SCtPmpRly_DELib_StdActrVdMon "9.3.0"
 /begin DEF_CHARACTERISTIC DDRC_DurDeb.SCtPmpRly_tiOLDebOk_C DDRC_DurDeb.SCtPmpRly_tiOLDebDef_C DDRC_DurDeb.SCtPmpRly_tiOvrTempDebOk_C DDRC_DurDeb.SCtPmpRly_tiOvrTempDebDef_C DDRC_DurDeb.SCtPmpRly_tiSCBDebOk_C DDRC_DurDeb.SCtPmpRly_tiSCBDebDef_C DDRC_DurDeb.SCtPmpRly_tiSCGDebOk_C DDRC_DurDeb.SCtPmpRly_tiSCGDebDef_C DDRC_RatDeb.SCtPmpRly_tiOLUDRat_C DDRC_RatDeb.SCtPmpRly_tiOvrTempUDRat_C DDRC_RatDeb.SCtPmpRly_tiSCBUDRat_C DDRC_RatDeb.SCtPmpRly_tiSCGUDRat_C DFC_CtlMsk2.DFC_SCtPmpRlyOL_C DFC_CtlMsk2.DFC_SCtPmpRlyOvrTemp_C DFC_CtlMsk2.DFC_SCtPmpRlySCB_C DFC_CtlMsk2.DFC_SCtPmpRlySCG_C DFC_DisblMsk2.DFC_SCtPmpRlyOL_C DFC_DisblMsk2.DFC_SCtPmpRlyOvrTemp_C DFC_DisblMsk2.DFC_SCtPmpRlySCB_C DFC_DisblMsk2.DFC_SCtPmpRlySCG_C SCtPmpRly_numStdActr_C SCtPmpRly_psDiagDigOut.nrTstPls_C SCtPmpRly_psDiagDigOut.tiBtwElecFlt_C SCtPmpRly_psDiagDigOut.tiBtwOTFlt_C SCtPmpRly_swtPsDiag_C /end DEF_CHARACTERISTIC
 /begin REF_CHARACTERISTIC SCtPmpRly_StdCal.tiDesValFlt_C SCtPmpRly_StdCal.rPsOff_C SCtPmpRly_StdCal.rActrStop_C SCtPmpRly_StdCal.rHysHigh_C SCtPmpRly_StdCal.rHysLow_C SCtPmpRly_StdCal.stPwrStgDiaDis_C SCtPmpRly_StdCal.stPlausDiaDis_C SCtPmpRly_StdCal.stPwrStgDis_C SCtPmpRly_StdCal.stActrStop_C SCtPmpRly_StdCal.stAllPwrStgDiaEna_C SCtPmpRly_StdCal.swtDesVal_C SCtPmpRly_StdCal.numDiagTry_C SCtPmpRly_StdCal.rDesValOff_C SCtPmpRly_StdCal.rDesValOn_C SCtPmpRly_StdCal.numEngDaFrqPs_C SCtPmpRly_StdCal.tiSlwRespSimPT1_C SCtPmpRly_StdCal.uHiBattThd_C SCtPmpRly_StdCal.uLoBattThd_C SCtPmpRly_StdCal.tiDebBattVoltOk_C SCtPmpRly_StdCal.tiDebBattVoltDfct_C SCtPmpRly_StdCal.mskActrActv_C SCtPmpRly_StdCal.tiDlyActrActvn_C SCtPmpRly_StdCal.rPsActrOff_C SCtPmpRly_StdCal.uBattMin_C SCtPmpRly_StdCal.uBattMax_C SCtPmpRly_StdCal.tiShOffCtrlDne_C SCtPmpRly_StdCal.swtDeactvn_C SCtPmpRly_StdCal.tiSelfDiagStrt_C SCtPmpRly_StdCal.flgReacvnPostDrv_C SCtPmpRly_StdCal.rPsRlyOff_C SCtPmpRly_StdCal.tiRlyOnDly_C SCtPmpRly_StdCal.nFMInWinMsk_C SCtPmpRly_StdCal.tiFMInDeb_C SCtPmpRly_StdCal.tiJamActrWait_C /end REF_CHARACTERISTIC
 /begin IN_MEASUREMENT BattU_facCor BattU_u CoEng_st CoEng_tiNormal DELib_idxArrSnsr DELib_xArrSnsr DevLib_stPwrStgEnaCond EnvT_t SCtPmpRly_rPs SCtPmpRly_stMonCo SCtPmpRly_stMonDDSens SCtPmpRly_stPs SCtPmpRly_stPwrStgDrvr SCtPmpRly_swtConf2C SCtPmpRly_swtConfC SCtPmpRly_swtConfStdActrSwVersC /end IN_MEASUREMENT
 /begin OUT_MEASUREMENT DDRC_St.DFC_SCtPmpRlyOL DDRC_St.DFC_SCtPmpRlyOvrTemp DDRC_St.DFC_SCtPmpRlySCB DDRC_St.DFC_SCtPmpRlySCG DFC_st.DFC_SCtPmpRlyOL DFC_st.DFC_SCtPmpRlyOvrTemp DFC_st.DFC_SCtPmpRlySCB DFC_st.DFC_SCtPmpRlySCG DINH_nrActvInhReas.FId_SCtPmpRlyMon DINH_nrActvInhReas.FId_SCtPmpRlyPwrStg DINH_stFId.FId_SCtPmpRlyMon DINH_stFId.FId_SCtPmpRlyPwrStg SCtPmpRly_stElecDiag SCtPmpRly_stErrInfo SCtPmpRly_stMon SCtPmpRly_stPwrStgEnaCond /end OUT_MEASUREMENT
 /begin LOC_MEASUREMENT SCtPmpRly_selfDiagPostDrv_mp /end LOC_MEASUREMENT
 FUNCTION_VERSION "9.3.0" /end FUNCTION
/begin FUNCTION SIA_CTPROT "24.20407.0SIA customer specific tuning protection and EECrypt" /begin IN_MEASUREMENT Epm_nEng SyC_stSub VehV_v /end IN_MEASUREMENT /begin OUT_MEASUREMENT Ctprot_stActFlag Ctprot_stActFunc Ctprot_stActHistFlag /end OUT_MEASUREMENT /begin LOC_MEASUREMENT CtprotPostDrv_mp /end LOC_MEASUREMENT FUNCTION_VERSION "24.20407.0" /end FUNCTION
/begin FUNCTION SIA_EMSIFC "189.2.0   Immobilizer Interface"
 /begin DEF_CHARACTERISTIC DFC_CtlMsk2.DFC_Sia_InvldCode_C DFC_CtlMsk2.DFC_Sia_InvldKey_C DFC_CtlMsk2.DFC_Sia_NoRespUCx_C DFC_CtlMsk2.DFC_Sia_TprotRttp_C DFC_DisblMsk2.DFC_Sia_InvldCode_C DFC_DisblMsk2.DFC_Sia_InvldKey_C DFC_DisblMsk2.DFC_Sia_NoRespUCx_C DFC_DisblMsk2.DFC_Sia_TprotRttp_C /end DEF_CHARACTERISTIC
 /begin IN_MEASUREMENT T15_bECUTyp T15_flgOn /end IN_MEASUREMENT
 /begin OUT_MEASUREMENT DFC_st.DFC_Sia_InvldCode DFC_st.DFC_Sia_InvldKey DFC_st.DFC_Sia_NoRespUCx DFC_st.DFC_Sia_TprotRttp DINH_nrActvInhReas.FId_bInhCdtSpdVehImmo DINH_stFId.FId_bInhCdtSpdVehImmo /end OUT_MEASUREMENT
 FUNCTION_VERSION "189.2.0" /end FUNCTION
/begin FUNCTION SIA_Reaction "189.2.0   SIA interface module for the release information"
 /begin LOC_MEASUREMENT Sia_bEleclPowLck Sia_bFlPmpLck Sia_bFshPrgLck Sia_bIgnLck Sia_bInjLck Sia_bStaLck Sia_bThrVlvLck Sia_bTstSrvLck /end LOC_MEASUREMENT
 FUNCTION_VERSION "189.2.0" /end FUNCTION
/begin FUNCTION SignalsExtd_Std "30000.1.0 Interface for readout of ECU internal measurement values extended" FUNCTION_VERSION "30000.1.0" /end FUNCTION
/begin FUNCTION Signals_Std "30000.74.0Interface for readout of ECU internal measurement values"
 /begin DEF_CHARACTERISTIC Signals_Mode1Pid_CA Signals_Mode1SigNum_CA Signals_stSrv01SuppPid_CA /end DEF_CHARACTERISTIC
 /begin IN_MEASUREMENT I15031_PID83A I15031_PID9BA I15031_PIDA1A I15031_PIDA7A I15031_PIDA8A /end IN_MEASUREMENT
 FUNCTION_VERSION "30000.74.0" /end FUNCTION
/begin FUNCTION SigQly_GlbDefn "1.1.0     Signal Quality Global Definition" FUNCTION_VERSION "1.1.0" /end FUNCTION
/begin FUNCTION SigQly_Srv "1.2.0     Signal Quality Services" FUNCTION_VERSION "1.2.0" /end FUNCTION
/begin FUNCTION SpplCooltPmpRly_DELib_ActrPwrStgDrvr "1.0.0"
 /begin DEF_CHARACTERISTIC SpplCooltPmpRly_ActrPwrStgDrvr_Cal.swtConf_C SpplCooltPmpRly_ActrPwrStgDrvr_Cal.stMOCSOPChk_C SpplCooltPmpRly_ActrPwrStgDrvr_Cal.swtPSDis_C /end DEF_CHARACTERISTIC
 /begin IN_MEASUREMENT DevLib_stPwrStgEnaCond SpplCooltPmpRly_rPs SpplCooltPmpRly_stElecDiag SpplCooltPmpRly_stPs /end IN_MEASUREMENT
 /begin OUT_MEASUREMENT SpplCooltPmpRly_flgActrSwtOffReq SpplCooltPmpRly_flgElecDiagSwtOffReq SpplCooltPmpRly_flgPwrStgReq SpplCooltPmpRly_stMonActrPwrStgDrvr SpplCooltPmpRly_stPwrStgDrvr SpplCooltPmpRly_swtConfActrPwrStgDrvr /end OUT_MEASUREMENT
 /begin LOC_MEASUREMENT SpplCooltPmpRly_numSigID SpplCooltPmpRly_SigTyp SpplCooltPmpRly_stMonGlbElecdd /end LOC_MEASUREMENT
 FUNCTION_VERSION "1.0.0" /end FUNCTION
/begin FUNCTION SpplCooltPmpRly_DELib_DevDrvrOutpDutyCycRamp "1.0.0" /begin DEF_CHARACTERISTIC SpplCooltPmpRly_DevDrvrOutpDutyCycRampCal.swtConf_C /end DEF_CHARACTERISTIC /begin IN_MEASUREMENT SpplCooltPmpRly_rActr /end IN_MEASUREMENT
 /begin OUT_MEASUREMENT SpplCooltPmpRly_rGovActr SpplCooltPmpRly_swtConfDevDrvrOutpDutyCycRampC /end OUT_MEASUREMENT
 FUNCTION_VERSION "1.0.0" /end FUNCTION
/begin FUNCTION SpplCooltPmpRly_DELib_StdActrAvs "2.0.0" /begin IN_MEASUREMENT SpplCooltPmpRly_swtConfC /end IN_MEASUREMENT FUNCTION_VERSION "2.0.0" /end FUNCTION
/begin FUNCTION SpplCooltPmpRly_DELib_StdActrCoorr "8.1.0"
 /begin DEF_CHARACTERISTIC SpplCooltPmpRly_rDesActrATS_CUR SpplCooltPmpRly_rDesActr_CUR SpplCooltPmpRly_StdCal.tiDesValFlt_C SpplCooltPmpRly_StdCal.rPsOff_C SpplCooltPmpRly_StdCal.rActrStop_C SpplCooltPmpRly_StdCal.rHysHigh_C SpplCooltPmpRly_StdCal.rHysLow_C SpplCooltPmpRly_StdCal.stPwrStgDiaDis_C SpplCooltPmpRly_StdCal.stPlausDiaDis_C SpplCooltPmpRly_StdCal.stPwrStgDis_C SpplCooltPmpRly_StdCal.stActrStop_C SpplCooltPmpRly_StdCal.stAllPwrStgDiaEna_C SpplCooltPmpRly_StdCal.swtDesVal_C SpplCooltPmpRly_StdCal.numDiagTry_C SpplCooltPmpRly_StdCal.rDesValOff_C SpplCooltPmpRly_StdCal.rDesValOn_C SpplCooltPmpRly_StdCal.numEngDaFrqPs_C SpplCooltPmpRly_StdCal.tiSlwRespSimPT1_C SpplCooltPmpRly_StdCal.uHiBattThd_C SpplCooltPmpRly_StdCal.uLoBattThd_C SpplCooltPmpRly_StdCal.tiDebBattVoltOk_C SpplCooltPmpRly_StdCal.tiDebBattVoltDfct_C SpplCooltPmpRly_StdCal.mskActrActv_C SpplCooltPmpRly_StdCal.tiDlyActrActvn_C SpplCooltPmpRly_StdCal.rPsActrOff_C SpplCooltPmpRly_StdCal.uBattMin_C SpplCooltPmpRly_StdCal.uBattMax_C SpplCooltPmpRly_StdCal.tiShOffCtrlDne_C SpplCooltPmpRly_StdCal.swtDeactvn_C SpplCooltPmpRly_StdCal.tiSelfDiagStrt_C SpplCooltPmpRly_StdCal.flgReacvnPostDrv_C SpplCooltPmpRly_StdCal.rPsRlyOff_C SpplCooltPmpRly_StdCal.tiRlyOnDly_C SpplCooltPmpRly_StdCal.nFMInWinMsk_C SpplCooltPmpRly_StdCal.tiFMInDeb_C SpplCooltPmpRly_StdCal.tiJamActrWait_C /end DEF_CHARACTERISTIC
 /begin IN_MEASUREMENT BattU_u CoEng_st CoEng_stOld DELib_idxArrSnsr DELib_xArrSnsr Epm_nEng Epm_stSpd SpplCooltPmpRly_rDesVal SpplCooltPmpRly_rPs SpplCooltPmpRly_stMon SpplCooltPmpRly_swtConf2C SpplCooltPmpRly_swtConfC SpplCooltPmpRly_swtConfStdActrSwVersC SyC_stSub /end IN_MEASUREMENT
 /begin OUT_MEASUREMENT DINH_nrActvInhReas.FId_SpplCooltPmpRlyOff DINH_stFId.FId_SpplCooltPmpRlyOff SpplCooltPmpRly_r SpplCooltPmpRly_stDesVal SpplCooltPmpRly_stMonCo /end OUT_MEASUREMENT
 /begin LOC_MEASUREMENT SpplCooltPmpRly_flgMonXPostDrv_mp SpplCooltPmpRly_rDesValATS SpplCooltPmpRly_stCoEng SpplCooltPmpRly_stDeactvn /end LOC_MEASUREMENT
 FUNCTION_VERSION "8.1.0" /end FUNCTION
/begin FUNCTION SpplCooltPmpRly_DELib_StdActrDd "8.2.0" /begin DEF_CHARACTERISTIC SpplCooltPmpRly_rCnv_MAP /end DEF_CHARACTERISTIC
 /begin REF_CHARACTERISTIC SpplCooltPmpRly_StdCal.tiDesValFlt_C SpplCooltPmpRly_StdCal.rPsOff_C SpplCooltPmpRly_StdCal.rActrStop_C SpplCooltPmpRly_StdCal.rHysHigh_C SpplCooltPmpRly_StdCal.rHysLow_C SpplCooltPmpRly_StdCal.stPwrStgDiaDis_C SpplCooltPmpRly_StdCal.stPlausDiaDis_C SpplCooltPmpRly_StdCal.stPwrStgDis_C SpplCooltPmpRly_StdCal.stActrStop_C SpplCooltPmpRly_StdCal.stAllPwrStgDiaEna_C SpplCooltPmpRly_StdCal.swtDesVal_C SpplCooltPmpRly_StdCal.numDiagTry_C SpplCooltPmpRly_StdCal.rDesValOff_C SpplCooltPmpRly_StdCal.rDesValOn_C SpplCooltPmpRly_StdCal.numEngDaFrqPs_C SpplCooltPmpRly_StdCal.tiSlwRespSimPT1_C SpplCooltPmpRly_StdCal.uHiBattThd_C SpplCooltPmpRly_StdCal.uLoBattThd_C SpplCooltPmpRly_StdCal.tiDebBattVoltOk_C SpplCooltPmpRly_StdCal.tiDebBattVoltDfct_C SpplCooltPmpRly_StdCal.mskActrActv_C SpplCooltPmpRly_StdCal.tiDlyActrActvn_C SpplCooltPmpRly_StdCal.rPsActrOff_C SpplCooltPmpRly_StdCal.uBattMin_C SpplCooltPmpRly_StdCal.uBattMax_C SpplCooltPmpRly_StdCal.tiShOffCtrlDne_C SpplCooltPmpRly_StdCal.swtDeactvn_C SpplCooltPmpRly_StdCal.tiSelfDiagStrt_C SpplCooltPmpRly_StdCal.flgReacvnPostDrv_C SpplCooltPmpRly_StdCal.rPsRlyOff_C SpplCooltPmpRly_StdCal.tiRlyOnDly_C SpplCooltPmpRly_StdCal.nFMInWinMsk_C SpplCooltPmpRly_StdCal.tiFMInDeb_C SpplCooltPmpRly_StdCal.tiJamActrWait_C /end REF_CHARACTERISTIC
 /begin IN_MEASUREMENT BattU_facCor DELib_idxArrSnsr DELib_xArrSnsr DevLib_stPwrStgEnaCond EnvP_p SpplCooltPmpRly_flgPwrStgReq SpplCooltPmpRly_stMon SpplCooltPmpRly_stMonCo SpplCooltPmpRly_swtConf2C SpplCooltPmpRly_swtConfC SpplCooltPmpRly_swtConfStdActrSwVersC /end IN_MEASUREMENT
 /begin OUT_MEASUREMENT DINH_nrActvInhReas.FId_SpplCooltPmpRlyActrOff DINH_stFId.FId_SpplCooltPmpRlyActrOff SpplCooltPmpRly_flgActrReq SpplCooltPmpRly_rActr SpplCooltPmpRly_rMax SpplCooltPmpRly_rMin SpplCooltPmpRly_rPs SpplCooltPmpRly_stMonDD SpplCooltPmpRly_stPs /end OUT_MEASUREMENT
 FUNCTION_VERSION "8.2.0" /end FUNCTION
/begin FUNCTION SpplCooltPmpRly_DELib_StdActrDesValCntr "3.0.0" FUNCTION_VERSION "3.0.0" /end FUNCTION
/begin FUNCTION SpplCooltPmpRly_DELib_StdActrInin "9.5.0"
 /begin DEF_CHARACTERISTIC SpplCooltPmpRly_swtConf2_C SpplCooltPmpRly_swtConfStdActrSwVers162_C SpplCooltPmpRly_swtConf_C /end DEF_CHARACTERISTIC
 /begin OUT_MEASUREMENT SpplCooltPmpRly_swtConf2C SpplCooltPmpRly_swtConfC SpplCooltPmpRly_swtConfStdActrSwVersC /end OUT_MEASUREMENT
 FUNCTION_VERSION "9.5.0" /end FUNCTION
/begin FUNCTION SpplCooltPmpRly_DELib_StdActrSnsrDd "6.4.0" /begin DEF_CHARACTERISTIC SpplCooltPmpRly_ratActLin_CUR /end DEF_CHARACTERISTIC
 /begin REF_CHARACTERISTIC SpplCooltPmpRly_StdCal.tiDesValFlt_C SpplCooltPmpRly_StdCal.rPsOff_C SpplCooltPmpRly_StdCal.rActrStop_C SpplCooltPmpRly_StdCal.rHysHigh_C SpplCooltPmpRly_StdCal.rHysLow_C SpplCooltPmpRly_StdCal.stPwrStgDiaDis_C SpplCooltPmpRly_StdCal.stPlausDiaDis_C SpplCooltPmpRly_StdCal.stPwrStgDis_C SpplCooltPmpRly_StdCal.stActrStop_C SpplCooltPmpRly_StdCal.stAllPwrStgDiaEna_C SpplCooltPmpRly_StdCal.swtDesVal_C SpplCooltPmpRly_StdCal.numDiagTry_C SpplCooltPmpRly_StdCal.rDesValOff_C SpplCooltPmpRly_StdCal.rDesValOn_C SpplCooltPmpRly_StdCal.numEngDaFrqPs_C SpplCooltPmpRly_StdCal.tiSlwRespSimPT1_C SpplCooltPmpRly_StdCal.uHiBattThd_C SpplCooltPmpRly_StdCal.uLoBattThd_C SpplCooltPmpRly_StdCal.tiDebBattVoltOk_C SpplCooltPmpRly_StdCal.tiDebBattVoltDfct_C SpplCooltPmpRly_StdCal.mskActrActv_C SpplCooltPmpRly_StdCal.tiDlyActrActvn_C SpplCooltPmpRly_StdCal.rPsActrOff_C SpplCooltPmpRly_StdCal.uBattMin_C SpplCooltPmpRly_StdCal.uBattMax_C SpplCooltPmpRly_StdCal.tiShOffCtrlDne_C SpplCooltPmpRly_StdCal.swtDeactvn_C SpplCooltPmpRly_StdCal.tiSelfDiagStrt_C SpplCooltPmpRly_StdCal.flgReacvnPostDrv_C SpplCooltPmpRly_StdCal.rPsRlyOff_C SpplCooltPmpRly_StdCal.tiRlyOnDly_C SpplCooltPmpRly_StdCal.nFMInWinMsk_C SpplCooltPmpRly_StdCal.tiFMInDeb_C SpplCooltPmpRly_StdCal.tiJamActrWait_C SpplCooltPmpRly_swtConf2_C SpplCooltPmpRly_swtConf_C /end REF_CHARACTERISTIC
 /begin IN_MEASUREMENT SpplCooltPmpRly_rDesVal SpplCooltPmpRly_stDesVal SpplCooltPmpRly_stMon SpplCooltPmpRly_swtConf2C SpplCooltPmpRly_swtConfC SpplCooltPmpRly_swtConfStdActrSwVersC /end IN_MEASUREMENT
 /begin OUT_MEASUREMENT SpplCooltPmpRly_rAct SpplCooltPmpRly_rAct_Sq SpplCooltPmpRly_ratActPosnB1 SpplCooltPmpRly_stMonDDSens /end OUT_MEASUREMENT
 FUNCTION_VERSION "6.4.0" /end FUNCTION
/begin FUNCTION SpplCooltPmpRly_DELib_StdActrVd "5.0.0" /begin IN_MEASUREMENT SpplCooltPmpRly_rGovActr SpplCooltPmpRly_swtConfC /end IN_MEASUREMENT /begin OUT_MEASUREMENT SpplCooltPmpRly_rDesVal /end OUT_MEASUREMENT FUNCTION_VERSION "5.0.0" /end FUNCTION
/begin FUNCTION SpplCooltPmpRly_DELib_StdActrVdMon "9.3.0"
 /begin DEF_CHARACTERISTIC DDRC_DurDeb.SpplCooltPmpRly_tiOLDebOk_C DDRC_DurDeb.SpplCooltPmpRly_tiOLDebDef_C DDRC_DurDeb.SpplCooltPmpRly_tiOvrTempDebOk_C DDRC_DurDeb.SpplCooltPmpRly_tiOvrTempDebDef_C DDRC_DurDeb.SpplCooltPmpRly_tiSCBDebOk_C DDRC_DurDeb.SpplCooltPmpRly_tiSCBDebDef_C DDRC_DurDeb.SpplCooltPmpRly_tiSCGDebOk_C DDRC_DurDeb.SpplCooltPmpRly_tiSCGDebDef_C DDRC_RatDeb.SpplCooltPmpRly_tiOLUDRat_C DDRC_RatDeb.SpplCooltPmpRly_tiOvrTempUDRat_C DDRC_RatDeb.SpplCooltPmpRly_tiSCBUDRat_C DDRC_RatDeb.SpplCooltPmpRly_tiSCGUDRat_C DFC_CtlMsk2.DFC_SpplCooltPmpRlyOL_C DFC_CtlMsk2.DFC_SpplCooltPmpRlyOvrTemp_C DFC_CtlMsk2.DFC_SpplCooltPmpRlySCB_C DFC_CtlMsk2.DFC_SpplCooltPmpRlySCG_C DFC_DisblMsk2.DFC_SpplCooltPmpRlyOL_C DFC_DisblMsk2.DFC_SpplCooltPmpRlyOvrTemp_C DFC_DisblMsk2.DFC_SpplCooltPmpRlySCB_C DFC_DisblMsk2.DFC_SpplCooltPmpRlySCG_C SpplCooltPmpRly_numStdActr_C SpplCooltPmpRly_psDiagDigOut.nrTstPls_C SpplCooltPmpRly_psDiagDigOut.tiBtwElecFlt_C SpplCooltPmpRly_psDiagDigOut.tiBtwOTFlt_C SpplCooltPmpRly_swtPsDiag_C /end DEF_CHARACTERISTIC
 /begin REF_CHARACTERISTIC SpplCooltPmpRly_StdCal.tiDesValFlt_C SpplCooltPmpRly_StdCal.rPsOff_C SpplCooltPmpRly_StdCal.rActrStop_C SpplCooltPmpRly_StdCal.rHysHigh_C SpplCooltPmpRly_StdCal.rHysLow_C SpplCooltPmpRly_StdCal.stPwrStgDiaDis_C SpplCooltPmpRly_StdCal.stPlausDiaDis_C SpplCooltPmpRly_StdCal.stPwrStgDis_C SpplCooltPmpRly_StdCal.stActrStop_C SpplCooltPmpRly_StdCal.stAllPwrStgDiaEna_C SpplCooltPmpRly_StdCal.swtDesVal_C SpplCooltPmpRly_StdCal.numDiagTry_C SpplCooltPmpRly_StdCal.rDesValOff_C SpplCooltPmpRly_StdCal.rDesValOn_C SpplCooltPmpRly_StdCal.numEngDaFrqPs_C SpplCooltPmpRly_StdCal.tiSlwRespSimPT1_C SpplCooltPmpRly_StdCal.uHiBattThd_C SpplCooltPmpRly_StdCal.uLoBattThd_C SpplCooltPmpRly_StdCal.tiDebBattVoltOk_C SpplCooltPmpRly_StdCal.tiDebBattVoltDfct_C SpplCooltPmpRly_StdCal.mskActrActv_C SpplCooltPmpRly_StdCal.tiDlyActrActvn_C SpplCooltPmpRly_StdCal.rPsActrOff_C SpplCooltPmpRly_StdCal.uBattMin_C SpplCooltPmpRly_StdCal.uBattMax_C SpplCooltPmpRly_StdCal.tiShOffCtrlDne_C SpplCooltPmpRly_StdCal.swtDeactvn_C SpplCooltPmpRly_StdCal.tiSelfDiagStrt_C SpplCooltPmpRly_StdCal.flgReacvnPostDrv_C SpplCooltPmpRly_StdCal.rPsRlyOff_C SpplCooltPmpRly_StdCal.tiRlyOnDly_C SpplCooltPmpRly_StdCal.nFMInWinMsk_C SpplCooltPmpRly_StdCal.tiFMInDeb_C SpplCooltPmpRly_StdCal.tiJamActrWait_C /end REF_CHARACTERISTIC
 /begin IN_MEASUREMENT BattU_facCor BattU_u CoEng_st CoEng_tiNormal DELib_idxArrSnsr DELib_xArrSnsr DevLib_stPwrStgEnaCond EnvT_t SpplCooltPmpRly_rPs SpplCooltPmpRly_stMonCo SpplCooltPmpRly_stMonDDSens SpplCooltPmpRly_stPs SpplCooltPmpRly_stPwrStgDrvr SpplCooltPmpRly_swtConf2C SpplCooltPmpRly_swtConfC SpplCooltPmpRly_swtConfStdActrSwVersC /end IN_MEASUREMENT
 /begin OUT_MEASUREMENT DDRC_St.DFC_SpplCooltPmpRlyOL DDRC_St.DFC_SpplCooltPmpRlyOvrTemp DDRC_St.DFC_SpplCooltPmpRlySCB DDRC_St.DFC_SpplCooltPmpRlySCG DFC_st.DFC_SpplCooltPmpRlyOL DFC_st.DFC_SpplCooltPmpRlyOvrTemp DFC_st.DFC_SpplCooltPmpRlySCB DFC_st.DFC_SpplCooltPmpRlySCG DINH_nrActvInhReas.FId_SpplCooltPmpRlyMon DINH_nrActvInhReas.FId_SpplCooltPmpRlyPwrStg DINH_stFId.FId_SpplCooltPmpRlyMon DINH_stFId.FId_SpplCooltPmpRlyPwrStg SpplCooltPmpRly_stElecDiag SpplCooltPmpRly_stErrInfo SpplCooltPmpRly_stMon SpplCooltPmpRly_stPwrStgEnaCond /end OUT_MEASUREMENT
 /begin LOC_MEASUREMENT SpplCooltPmpRly_selfDiagPostDrv_mp /end LOC_MEASUREMENT
 FUNCTION_VERSION "9.3.0" /end FUNCTION
/begin FUNCTION SrvB "220.15.1  Basic Services" FUNCTION_VERSION "220.15.1" /end FUNCTION
/begin FUNCTION SrvF "220.8.0   Float Services" FUNCTION_VERSION "220.8.0" /end FUNCTION
/begin FUNCTION SrvX "220.11.0  Extended Services" FUNCTION_VERSION "220.11.0" /end FUNCTION
/begin FUNCTION SSwtS "10.8.0    Software Switch Service" FUNCTION_VERSION "10.8.0" /end FUNCTION
/begin FUNCTION SSwtS_SetSwt ""
 /begin DEF_CHARACTERISTIC SSwtS_swtGlbTyp_C SSwtS_Val.GlbDa_swtNUMTLC_C SSwtS_Val.GlbDa_swtCHRGSOCKET_C SSwtS_Val.GlbDa_swtVCU_RES_BIT1_C SSwtS_Val.GlbDa_swtVCU_RES_BIT2_C SSwtS_Val.GlbDa_swtVCU_RES_BIT3_C SSwtS_Val.GlbDa_swtVCU_RES_BIT4_C SSwtS_Val.GlbDa_swtVCU_RES_BIT5_C SSwtS_Val.GlbDa_swtVCU_RES_BIT6_C SSwtS_Val.GlbDa_swtVCU_RES_BIT7_C /end DEF_CHARACTERISTIC
/end FUNCTION
/begin FUNCTION StrtUpEv_Ctrl "1400.2.0  Govenor of driveaway assist and backroll limitation for an electric vehicle"
 /begin DEF_CHARACTERISTIC DFC_CtlMsk2.DFC_StrtUpEvStandStillDeactvn_C DFC_DisblMsk2.DFC_StrtUpEvStandStillDeactvn_C StrtUpEv_dTqDrvAwyIBrkPsdNeg_C StrtUpEv_dTqDrvAwyIBrkPsdPos_C StrtUpEv_dTqDrvAwyINeg_C StrtUpEv_dTqDrvAwyIPos_C StrtUpEv_dTqDrvAwyPBrkPsdNeg_C StrtUpEv_dTqDrvAwyPBrkPsdPos_C StrtUpEv_dTqDrvAwyPNeg_C StrtUpEv_dTqDrvAwyPPos_C StrtUpEv_dvDrvAwyRmpNeg_M StrtUpEv_dvDrvAwyRmpPos_M StrtUpEv_facDrvAwyRmp_T StrtUpEv_flgHillHldEnad_C StrtUpEv_rAPPReacvnThd_C StrtUpEv_stDiDeactvnCdn_C StrtUpEv_stDrvAwyCtrlDiMask_C StrtUpEv_stPrmntDeactvdMask_C StrtUpEv_stPrmntDeactvn_C StrtUpEv_stTempDeactvdMask_C StrtUpEv_stTqIntvLimdMask_C StrtUpEv_stTqLimdMask_C StrtUpEv_tiStandStillDeactvn_C StrtUpEv_tqDesMax_T StrtUpEv_tqDesMin_T StrtUpEv_tqDesRvsMax_T StrtUpEv_tqDesRvsMin_T StrtUpEv_tqDrvAwyIEco_M StrtUpEv_tqDrvAwyINorm_M StrtUpEv_tqDrvAwyISpt_M StrtUpEv_tqDrvAwyPEco_M StrtUpEv_tqDrvAwyPNorm_M StrtUpEv_tqDrvAwyPreCtrlEco_M StrtUpEv_tqDrvAwyPreCtrlNorm_M StrtUpEv_tqDrvAwyPreCtrlSpt_M StrtUpEv_tqDrvAwyPSpt_M StrtUpEv_tqIMax_C StrtUpEv_tqIMin_C StrtUpEv_vDeactvnPrmnt_C StrtUpEv_vDeltaDrvAwyCtrlActvn_C StrtUpEv_vDeltaDrvAwyCtrlDeactvn_C StrtUpEv_vDrvAwyDesBrkStEco_M StrtUpEv_vDrvAwyDesBrkStNorm_M StrtUpEv_vDrvAwyDesBrkStSpt_M StrtUpEv_vReacvnThd_C StrtUpEv_vStandStill_C /end DEF_CHARACTERISTIC
 /begin IN_MEASUREMENT APP_r Brk_flgPrkgBrkActv Brk_st Com_flgCrawlActvd Com_flgHillHldActvd CoPOM_tqWhlQstyMax CoPOM_tqWhlQstyMin CoPTEv_stTqLimd CoVMD_flgDrvDmdHiPrio DrvDoor_bOpn DrvMod_stPosn DrvStblt_bOpn ElM_stOperModAct01 MoFTqPtdVeh_flgDiCreepMsg MoFTqPtdVeh_stDrvProgReqMsg PT_tqWhlAct VehCoorn_st VehMot_stPrpLLim VehV_vSign /end IN_MEASUREMENT
 /begin OUT_MEASUREMENT DFC_st.DFC_StrtUpEvStandStillDeactvn DINH_nrActvInhReas.FId_StrtUpEvDrvAwy DINH_stFId.FId_StrtUpEvDrvAwy StrtUpEv_flgDrvAwyDi StrtUpEv_flgPrmntDeactvd StrtUpEv_flgTmpDeactvd StrtUpEv_stDrvAwyDi StrtUpEv_tqDes /end OUT_MEASUREMENT
 /begin LOC_MEASUREMENT StrtUpEv_flgDrvAwyFrz StrtUpEv_flgStandStillDeactvn StrtUpEv_flgWhlDes StrtUpEv_pBrk StrtUpEv_stTqLimd StrtUpEv_tqDrvAwyI StrtUpEv_tqDrvAwyNotLimd StrtUpEv_tqDrvAwyP StrtUpEv_tqDrvAwyPreCtrl StrtUpEv_vDrvAwyDesRmp StrtUpEv_vDrvAwyDesUnRmp StrtUpEv_vDrvAwyDif StrtUpEv_vRef /end LOC_MEASUREMENT
 FUNCTION_VERSION "1400.2.0" /end FUNCTION
/begin FUNCTION SVSLmp_DD "2.10.0    Device Driver for the SVS Control" /begin IN_MEASUREMENT SVSLmp_stReqBln SVSLmp_stReqOn SyC_stSub /end IN_MEASUREMENT /begin OUT_MEASUREMENT ErrLmp_stSVS SVSLmp_stPs SVSLmp_stSVS /end OUT_MEASUREMENT /begin LOC_MEASUREMENT SVSLmp_tiRmnBln /end LOC_MEASUREMENT FUNCTION_VERSION "2.10.0" /end FUNCTION
/begin FUNCTION SVSLmp_VD "3.10.0    Virtual Device for the SVS Control" /begin DEF_CHARACTERISTIC SVSLmp_tiBln_C /end DEF_CHARACTERISTIC /begin IN_MEASUREMENT SyC_stSub /end IN_MEASUREMENT /begin OUT_MEASUREMENT SVSLmp_stReqBln SVSLmp_stReqOn /end OUT_MEASUREMENT /begin LOC_MEASUREMENT SVSLmp_stSVSWoTstr /end LOC_MEASUREMENT FUNCTION_VERSION "3.10.0" /end FUNCTION
/begin FUNCTION SWAdp "1.0.0_STLA_N_D060I1central SW-Adapter (legacy)"
 /begin DEF_CHARACTERISTIC AirC_pRefgntUs_C AirC_rClgDem_C CcsCom_stEgyTrfModSeld_Cur ChrgrRly_flgClsRly_C ChrgrRly_st_C Com_25h_B1b0_C Com_25h_B1b2_C Com_25h_B1b4_C Com_25h_B1b6_C Com_bDiagMuxOn_C Com_stDsqElCmprFltLvl_C Com_stDsqpwrElCmprActl_C Com_stDsqstElCmprStat_C Com_stDsquElCmprHvAct_C CtPSwtActr_stClsd_C CtPSwtActr_stOpen_C DDRC_DurDeb.Com_tiBlowrRlyErrDebOk_C DDRC_DurDeb.Com_tiBlowrRlyErrDebDef_C DDRC_DurDeb.Com_tiComElMIIvtrFltLvl4DebOk_C DDRC_DurDeb.Com_tiComElMIIvtrFltLvl4DebDef_C DDRC_DurDeb.Com_tiComElMIIvtrFltLvl5DebOk_C DDRC_DurDeb.Com_tiComElMIIvtrFltLvl5DebDef_C DDRC_DurDeb.Com_tiPrkgBrkFailrDebOk_C DDRC_DurDeb.Com_tiPrkgBrkFailrDebDef_C DDRC_DurDeb.Com_tiPtSysLimErrDebOk_C DDRC_DurDeb.Com_tiPtSysLimErrDebDef_C DFC_CtlMsk2.DFC_BlowrRlyErr_C DFC_CtlMsk2.DFC_ComElMIIvtrFltLvl4_C DFC_CtlMsk2.DFC_ComElMIIvtrFltLvl5_C DFC_CtlMsk2.DFC_PrkgBrkFailr_C DFC_CtlMsk2.DFC_PtSysLimErr_C DFC_DisblMsk2.DFC_BlowrRlyErr_C DFC_DisblMsk2.DFC_ComElMIIvtrFltLvl4_C DFC_DisblMsk2.DFC_ComElMIIvtrFltLvl5_C DFC_DisblMsk2.DFC_PrkgBrkFailr_C DFC_DisblMsk2.DFC_PtSysLimErr_C Dspl_stVDSAry_C Dspl_stVISAry_C Dspl_stWMIAry_C ElTS_facPtSysLimThd_C HvBatt_uActLinkMeasd_C HvBatt_uActLinkMeasd_Sq_C IntlckChrgPlg_stHbrOLDiagExtReq_C VehCoorn_wElecCnsTotWght_C VehM_flgOnePedlDrvgOff_C /end DEF_CHARACTERISTIC
 /begin IN_MEASUREMENT ACCmpr_pwrLimMax Brk_st ChgrPlug_stPlgLock ComEmac_tqPtd01 Com_bPreCondElecWkuReq Com_flgEcoNormReqRx Com_iHvbChrgMaxSho Com_iHvbDchaMaxSho Com_pwrMaxChrgSho_Sq Com_pwrMaxDchaSho_Sq Com_stBlowrRly Com_stIIvtrFltLvl01 Com_stMainWkuReq Com_stPrkBrk Com_stPrkBrkRx Com_uHvbChrgMaxSho Com_uHvbDchaMaxSho CtPSwtActr_r DcChrgrIntkT2_t_f DcChrgrIntkT_t_f DrvMod_stPosn ElM_stOperModAct01 FreonP_p_f HLCCcs_stEgyTrfModSeld MRly_stAct PEnv_flgPMeasdVld PEnv_flgPVld PwmCtP_rDtyCycRaw_f PwrDistbnUnitT_t_f SyC_stRCD T15_st UCtP_uSens_f UPxP1_u_f /end IN_MEASUREMENT
 /begin OUT_MEASUREMENT ACCtl_nPwrLim AirC_pClnt AirC_pRefgntUs AirC_rClgDem Brk_flgPrkgBrkActv Brk_r CcsCom_stEgyTrfModSeld ChgrPlug_stCtpSwtActr ChgrPlug_stPlgLockTx ChrgrRly_flgClsRly ChrgrRly_st CoEng_st ComEmac_flgEmgyShtDwnReq01_Sq ComEmac_flgSvsReq01_Sq ComEmac_iDcLnk01_Sq ComEmac_nAct01_Sq ComEmac_stMod01_Sq ComEmac_tInvr01_Sq ComEmac_tIvtrCoolt01_Sq ComEmac_tMac01_Sq ComEmac_tqAbsltMax01_Sq ComEmac_tqAbsltMin01_Sq ComEmac_tqAct01_Sq ComEmac_uDcLnk01_Sq Com_25h_B1b0 Com_25h_B1b2 Com_25h_B1b4 Com_25h_B1b6 Com_bDiagMuxOn Com_flgBlowrRlyCtrl Com_flgBlwrActv Com_flgEcoNormReq Com_flgHillHldActvd_Sq Com_iElCmprHvAct_Sq Com_iHvbAct_Sq Com_iHvbChrgMaxContns Com_iHvbChrgMaxContns_Sq Com_iHvbChrgMaxSho_Sq Com_iHvbDchaMaxContns Com_iHvbDchaMaxContns_Sq Com_iHvbDchaMaxSho_Sq Com_iHvbDes_Sq Com_ratHvbSoc_Sq Com_stDsqElCmprFltLvl Com_stDsqpwrElCmprActl Com_stDsqstElCmprStat Com_stDsquElCmprHvAct Com_stHvbCntct_Sq Com_stHvbDernMaxT_Sq Com_stHvbDernMinT_Sq Com_stHvbFlt_Sq Com_stHvbIntlck_Sq Com_stHvbIsoFlt_Sq Com_stHvbMod_Sq Com_tHvbAct_Sq Com_uElCmprHvAct_Sq Com_uHvbAct_Sq Com_uHvbChrgMaxContns Com_uHvbChrgMaxContns_Sq Com_uHvbChrgMaxSho_Sq Com_uHvbDchaMaxContns Com_uHvbDchaMaxContns_Sq Com_uHvbDchaMaxSho_Sq Com_uHvbLimHi_Sq Com_uHvbNomChrgn_Sq DcChrgrIntkT2_t DcChrgrIntkT_t DDRC_St.DFC_BlowrRlyErr DDRC_St.DFC_ComElMIIvtrFltLvl4 DDRC_St.DFC_ComElMIIvtrFltLvl5 DDRC_St.DFC_PrkgBrkFailr DDRC_St.DFC_PtSysLimErr DFC_st.DFC_BlowrRlyErr DFC_st.DFC_ComElMIIvtrFltLvl4 DFC_st.DFC_ComElMIIvtrFltLvl5 DFC_st.DFC_PrkgBrkFailr DFC_st.DFC_PtSysLimErr DINH_nrActvInhReas.FId_PEnvRefSnsr DINH_nrActvInhReas.FId_VMSIEvBrkFlt DINH_nrActvInhReas.FId_bInh_ComEmac_flgSvsReq01_Sq_Frz DINH_nrActvInhReas.FId_bInh_ComEmac_tIvtrCoolt01_Sq_Frz DINH_nrActvInhReas.FId_bInh_Com_iElCmprHvAct_Sq_Frz DINH_nrActvInhReas.FId_bInh_Sig_Com_pwrMaxChrgSho_Sq_Frz DINH_nrActvInhReas.FId_bInh_Sig_Com_pwrMaxDchaSho_Sq_Frz DINH_nrActvInhReas.FId_binnh_Sig_ComEmac_flgEmgyShtDwnReq01_Sq_Frz DINH_nrActvInhReas.FId_binnh_Sig_ComEmac_flgImobAuthent_Sq_Frz DINH_nrActvInhReas.FId_binnh_Sig_ComEmac_iDcLnk01_Sq_Frz DINH_nrActvInhReas.FId_binnh_Sig_ComEmac_nAct01_Sq_Frz DINH_nrActvInhReas.FId_binnh_Sig_ComEmac_stIsoMonSwtAck_Sq_Frz DINH_nrActvInhReas.FId_binnh_Sig_ComEmac_stMod01_Sq_Frz DINH_nrActvInhReas.FId_binnh_Sig_ComEmac_stPwrAuthn_Sq_Frz DINH_nrActvInhReas.FId_binnh_Sig_ComEmac_tInvr01_Sq_Frz DINH_nrActvInhReas.FId_binnh_Sig_ComEmac_tMac01_Sq_Frz DINH_nrActvInhReas.FId_binnh_Sig_ComEmac_tqAbsltMax01_Sq_Frz DINH_nrActvInhReas.FId_binnh_Sig_ComEmac_tqAbsltMin01_Sq_Frz DINH_nrActvInhReas.FId_binnh_Sig_ComEmac_tqAct01_Sq_Frz DINH_nrActvInhReas.FId_binnh_Sig_ComEmac_uDcLnk01_sq_Frz DINH_nrActvInhReas.FId_binnh_Sig_Com_iHvbAct_Sq_Frz DINH_nrActvInhReas.FId_binnh_Sig_Com_iHvbChrgMaxSho_Sq_Frz DINH_nrActvInhReas.FId_binnh_Sig_Com_iHvbDchaMaxSho_Sq_Frz DINH_nrActvInhReas.FId_binnh_Sig_Com_iHvbDes_Sq_Frz DINH_nrActvInhReas.FId_binnh_Sig_Com_ratHvbSoc_Sq_Frz DINH_nrActvInhReas.FId_binnh_Sig_Com_stDcdcULimReq_Sq_Frz DINH_nrActvInhReas.FId_binnh_Sig_Com_stHvbCntct_Sq_Frz DINH_nrActvInhReas.FId_binnh_Sig_Com_stHvbDernMaxT_Sq_Frz DINH_nrActvInhReas.FId_binnh_Sig_Com_stHvbDernMinT_Sq_Frz DINH_nrActvInhReas.FId_binnh_Sig_Com_stHvbFlt_Sq_Frz DINH_nrActvInhReas.FId_binnh_Sig_Com_stHvbIntlck_Sq_Frz DINH_nrActvInhReas.FId_binnh_Sig_Com_stHvbIsoFlt_Sq_Frz DINH_nrActvInhReas.FId_binnh_Sig_Com_stHvbMod_Sq_Frz DINH_nrActvInhReas.FId_binnh_Sig_Com_tHvbAct_Sq_Frz DINH_nrActvInhReas.FId_binnh_Sig_Com_uElCmprHvAct_Sq_Frz DINH_nrActvInhReas.FId_binnh_Sig_Com_uHvbAct_Sq_Frz DINH_nrActvInhReas.FId_binnh_Sig_Com_uHvbLimHi_Sq_Frz DINH_nrActvInhReas.FId_binnh_Sig_Com_uHvbNomChrgn_Sq_Frz DINH_stFId.FId_PEnvRefSnsr DINH_stFId.FId_VMSIEvBrkFlt DINH_stFId.FId_bInh_ComEmac_flgSvsReq01_Sq_Frz DINH_stFId.FId_bInh_ComEmac_tIvtrCoolt01_Sq_Frz DINH_stFId.FId_bInh_Com_iElCmprHvAct_Sq_Frz DINH_stFId.FId_bInh_Sig_Com_pwrMaxChrgSho_Sq_Frz DINH_stFId.FId_bInh_Sig_Com_pwrMaxDchaSho_Sq_Frz DINH_stFId.FId_binnh_Sig_ComEmac_flgEmgyShtDwnReq01_Sq_Frz DINH_stFId.FId_binnh_Sig_ComEmac_flgImobAuthent_Sq_Frz DINH_stFId.FId_binnh_Sig_ComEmac_iDcLnk01_Sq_Frz DINH_stFId.FId_binnh_Sig_ComEmac_nAct01_Sq_Frz DINH_stFId.FId_binnh_Sig_ComEmac_stIsoMonSwtAck_Sq_Frz DINH_stFId.FId_binnh_Sig_ComEmac_stMod01_Sq_Frz DINH_stFId.FId_binnh_Sig_ComEmac_stPwrAuthn_Sq_Frz DINH_stFId.FId_binnh_Sig_ComEmac_tInvr01_Sq_Frz DINH_stFId.FId_binnh_Sig_ComEmac_tMac01_Sq_Frz DINH_stFId.FId_binnh_Sig_ComEmac_tqAbsltMax01_Sq_Frz DINH_stFId.FId_binnh_Sig_ComEmac_tqAbsltMin01_Sq_Frz DINH_stFId.FId_binnh_Sig_ComEmac_tqAct01_Sq_Frz DINH_stFId.FId_binnh_Sig_ComEmac_uDcLnk01_sq_Frz DINH_stFId.FId_binnh_Sig_Com_iHvbAct_Sq_Frz DINH_stFId.FId_binnh_Sig_Com_iHvbChrgMaxSho_Sq_Frz DINH_stFId.FId_binnh_Sig_Com_iHvbDchaMaxSho_Sq_Frz DINH_stFId.FId_binnh_Sig_Com_iHvbDes_Sq_Frz DINH_stFId.FId_binnh_Sig_Com_ratHvbSoc_Sq_Frz DINH_stFId.FId_binnh_Sig_Com_stDcdcULimReq_Sq_Frz DINH_stFId.FId_binnh_Sig_Com_stHvbCntct_Sq_Frz DINH_stFId.FId_binnh_Sig_Com_stHvbDernMaxT_Sq_Frz DINH_stFId.FId_binnh_Sig_Com_stHvbDernMinT_Sq_Frz DINH_stFId.FId_binnh_Sig_Com_stHvbFlt_Sq_Frz DINH_stFId.FId_binnh_Sig_Com_stHvbIntlck_Sq_Frz DINH_stFId.FId_binnh_Sig_Com_stHvbIsoFlt_Sq_Frz DINH_stFId.FId_binnh_Sig_Com_stHvbMod_Sq_Frz DINH_stFId.FId_binnh_Sig_Com_tHvbAct_Sq_Frz DINH_stFId.FId_binnh_Sig_Com_uElCmprHvAct_Sq_Frz DINH_stFId.FId_binnh_Sig_Com_uHvbAct_Sq_Frz DINH_stFId.FId_binnh_Sig_Com_uHvbLimHi_Sq_Frz DINH_stFId.FId_binnh_Sig_Com_uHvbNomChrgn_Sq_Frz DrvMod_flgBrkModRcptEna DrvMod_stPosnEnhd Dspl_stVDSAry Dspl_stVISAry Dspl_stWMIAry Ext_bSyncGPC HvBatt_uActLinkMeasd HvBatt_uActLinkMeasd_Sq IntlckChrgPlg_stHbrOLDiagExtReq MRly_stActDid PEnv_p_Sq PwmCtP_rRaw PwrDistbnUnitT_t rba_SyC_bWkuMain UCtP_uSens UPxP1_u VehCoorn_wElecCnsTotWght VehM_flgOnePedlDrvgOff /end OUT_MEASUREMENT
 /begin LOC_MEASUREMENT ComEmac_flgSvsReq01_Sq_Loc Com_iElCmprHvAct_SqLoc SWAdp_ComEmac_tIvtrCoolt01_SqLoc SWAdp_Com_flgHillHldActvd_SqLoc SWAdp_Emac_iDcLnk01_SqLoc SWAdp_Emac_nAct01_SqLoc SWAdp_Emac_stMod01_SqLoc SWAdp_Emac_tInvr01_SqLoc SWAdp_Emac_tMac01_SqLoc SWAdp_Emac_tqAbsltMax01_SqLoc SWAdp_Emac_tqAbsltMin01_SqLoc SWAdp_Emac_tqAct01_SqLoc SWAdp_Emac_uDcLnk01_SqLoc SWAdp_flgEmgyShtDwnReq01_SqLoc SWAdp_iHvbAct_SqLoc SWAdp_iHvbChrgMaxSho_SqLoc SWAdp_iHvbDchaMaxSho_SqLoc SWAdp_iHvbDes_SqLoc SWAdp_ratHvbSoc_SqLoc SWAdp_stHvbCntct_SqLoc SWAdp_stHvbDernMaxT_SqLoc SWAdp_stHvbDernMinT_SqLoc SWAdp_stHvbFlt_SqLoc SWAdp_stHvbIntlck_SqLoc SWAdp_stHvbIsoFlt_SqLoc SWAdp_stHvbMod_SqLoc SWAdp_tHvbAct_SqLoc SWAdp_uElCmprHvAct_SqLoc SWAdp_uHvbAct_SqLoc SWAdp_uHvbLimHi_SqLoc SWAdp_uHvbNomChrgn_SqLoc /end LOC_MEASUREMENT
 FUNCTION_VERSION "1.0.0_STLA_N_D060I1" /end FUNCTION
/begin FUNCTION SWAdp_CDI "1.0.0_VC1CP091_STLA_N_D060I4Software Sharing Adapter for Common Data Interface"
 /begin DEF_CHARACTERISTIC IntlckChrgPlg_flgActrReqOFF_C IntlckChrgPlg_flgActrReqON_C MoFAccr_flgPlausBrkDetdMsg_C MRly_stAct_C PEnv_tiStrtReplVld_C RCDWakeup_Off_C RCDWakeup_On_C SCtPmpRly_r_C /end DEF_CHARACTERISTIC
 /begin IN_MEASUREMENT ChgrPlug_flgPxpAndCtpDetnPls ChgrPlug_flgPxpDetnPls CommDev_bPostOperationWkuPls DrvMod_stPosn EmWakeupSig_r IntlckChrgPlg_flgActrReq IntlckChrgPlg_stHbrOLDiagExtReq MRly_stAct PEnv_flgPMeasdVld PEnv_flgPVld SCtPmpRly_r /end IN_MEASUREMENT
 /begin OUT_MEASUREMENT Gbx_stGearLvr MoFAccr_flgPlausBrkDetdMsg /end OUT_MEASUREMENT
 FUNCTION_VERSION "1.0.0_VC1CP091_STLA_N_D060I4" /end FUNCTION
/begin COMPU_METHOD B_TRUE "" TAB_VERB "%6.3" "" COMPU_TAB_REF B_TRUE /end COMPU_METHOD
/begin COMPU_VTAB B_TRUE "" TAB_VERB 2 0 "FALSE" 1 "TRUE" /end COMPU_VTAB
/begin COMPU_METHOD CcsCom_stEgyTrfModSeld_VERB "" TAB_VERB "%6.3" "" COMPU_TAB_REF CcsCom_stEgyTrfModSeld_VERB /end COMPU_METHOD
/begin COMPU_VTAB CcsCom_stEgyTrfModSeld_VERB "" TAB_VERB 7 0 "CCSCOM_EGYTRFMOD_NONE" 1 "CCSCOM_EGYTRFMOD_AC1PHA" 2 "CCSCOM_EGYTRFMOD_AC3PHA" 3 "CCSCOM_EGYTRFMOD_DCCORE" 4 "CCSCOM_EGYTRFMOD_DCEXTD" 5 "CCSCOM_EGYTRFMOD_DCCOMBOCORE" 6 "CCSCOM_EGYTRFMOD_DCUNIQUEE" /end COMPU_VTAB
/begin COMPU_METHOD ChgrPlug_stCtpSwtActr_VERB "" TAB_VERB "%6.3" "" COMPU_TAB_REF ChgrPlug_stCtpSwtActr_VERB /end COMPU_METHOD
/begin COMPU_VTAB ChgrPlug_stCtpSwtActr_VERB "" TAB_VERB 4 0 "CHGRPLUG_CTPSWTACTR_OPEN" 1 "CHGRPLUG_CTPSWTACTR_CLOSED" 2 "CHGRPLUG_CTPSWTACTR_STUCK_OPEN" 3 "CHGRPLUG_CTPSWTACTR_STUCK_CLOSD" /end COMPU_VTAB
/begin COMPU_METHOD ChgrPlug_stPlgLock_VERB "" TAB_VERB "%6.3" "" COMPU_TAB_REF ChgrPlug_stPlgLock_VERB /end COMPU_METHOD
/begin COMPU_VTAB ChgrPlug_stPlgLock_VERB "" TAB_VERB 4 0 "CHGRPLUG_ST_LOCK" 1 "CHGRPLUG_ST_UNLOCK" 2 "CHGRPLUG_ST_STUCK_OPEN" 3 "CHGRPLUG_ST_STUCK_CLOSED" /end COMPU_VTAB
/begin COMPU_METHOD CoEng_st_COMPU_VERB "" TAB_VERB "%6.3" "" COMPU_TAB_REF CoEng_st_COMPU_VERB /end COMPU_METHOD
/begin COMPU_VTAB CoEng_st_COMPU_VERB "" TAB_VERB 6 0 "COENG_STANDBY" 1 "COENG_READY" 2 "COENG_CRANKING" 3 "COENG_RUNNING" 4 "COENG_STOPPING" 5 "COENG_FINISH" /end COMPU_VTAB
/begin COMPU_METHOD Curr_A_q0p03125_COMPU "" RAT_FUNC "%6.4" "A" COEFFS 0 32 0 0 0 1 /end COMPU_METHOD
/begin COMPU_METHOD DDRCTime_ms "" RAT_FUNC "%6.1" "ms" COEFFS 0 1 0 0 0 10 /end COMPU_METHOD
/begin COMPU_METHOD DDRC_Ratio "" TAB_VERB "%6.3" "-" COMPU_TAB_REF DDRC_Ratio /end COMPU_METHOD
/begin COMPU_VTAB DDRC_Ratio "" TAB_VERB 4 1 "Ratio1" 2 "Ratio2" 3 "Ratio3" 4 "Ratio4" /end COMPU_VTAB
/begin COMPU_METHOD DELIB_ALLTEMP_VERB_COMPU "" TAB_VERB "%6.3" "" COMPU_TAB_REF DELIB_ALLTEMP_VERB_COMPU /end COMPU_METHOD
/begin COMPU_VTAB DELIB_ALLTEMP_VERB_COMPU "" TAB_VERB 6 85 "ACCHRGRINTKT" 86 "DCCHRGRINTKT" 0 "ENVT" 89 "HEATRCORET" 254 "DFLTEMP" 255 "NOTEMP" /end COMPU_VTAB
/begin COMPU_METHOD DFC_OneToOne "" RAT_FUNC "%6.2" "-" COEFFS 0 1 0 0 0 1 /end COMPU_METHOD
/begin COMPU_METHOD DFES_OneToOne "" RAT_FUNC "%6.2" "-" COEFFS 0 1 0 0 0 1 /end COMPU_METHOD
/begin COMPU_METHOD DINH_ct_Compu "" RAT_FUNC "%6.0" "" COEFFS 0 -1 4096 0 0 1 /end COMPU_METHOD
/begin COMPU_METHOD DrvMod_stPosn_VERB "" TAB_VERB "%6.3" "" COMPU_TAB_REF DrvMod_stPosn_VERB /end COMPU_METHOD
/begin COMPU_VTAB DrvMod_stPosn_VERB "" TAB_VERB 5 0 "DRVMOD_PRK" 1 "DRVMOD_RVS" 2 "DRVMOD_NEUT" 3 "DRVMOD_DRV" 6 "DRVMOD_NOREQ" /end COMPU_VTAB
/begin COMPU_METHOD DtyCyc "" RAT_FUNC "%6.4" "%" COEFFS 0 100 0 0 0 1 /end COMPU_METHOD
/begin COMPU_METHOD Fact "" RAT_FUNC "%6.5" "-" COEFFS 0 8192 0 0 0 1 /end COMPU_METHOD
/begin COMPU_METHOD OneToOne "" RAT_FUNC "%6.2" "-" COEFFS 0 1 0 0 0 1 /end COMPU_METHOD
/begin COMPU_METHOD Prc "" RAT_FUNC "%6.4" "%" COEFFS 0 81.92 0 0 0 1 /end COMPU_METHOD
/begin COMPU_METHOD PresAC_hPa "" RAT_FUNC "%6.2" "hPa" COEFFS 0 0.5 0 0 0 1 /end COMPU_METHOD
/begin COMPU_METHOD Pres_hPa "" RAT_FUNC "%6.2" "hPa" COEFFS 0 1 0 0 0 1 /end COMPU_METHOD
/begin COMPU_METHOD Pres_LoRes_COMPU "" RAT_FUNC "%6.4" "MPa" COEFFS 0 100 0 0 0 1 /end COMPU_METHOD
/begin COMPU_METHOD q0p01_DegCgrd "" RAT_FUNC "%6.4" "Deg C" COEFFS 0 100 0 0 0 1 /end COMPU_METHOD
/begin COMPU_METHOD RBPtCel_n_0p5_1 "" RAT_FUNC "%6.3" "rpm" COEFFS 0 2 0 0 0 1 /end COMPU_METHOD
/begin COMPU_METHOD RBPtCel_Perc_1p0_1 "" RAT_FUNC "%6.2" "%" COEFFS 0 1 0 0 0 1 /end COMPU_METHOD
/begin COMPU_METHOD RBPtCel_ti_5p12em4_1 "" RAT_FUNC "%6.5" "s" COEFFS 0 15625 0 0 0 8 /end COMPU_METHOD
/begin COMPU_METHOD RBPtCel_t_1p0_3 "" RAT_FUNC "%6.2" "Deg C" COEFFS 0 1 0 0 0 1 /end COMPU_METHOD
/begin COMPU_METHOD RBPtCel_u_0p1_1 "" RAT_FUNC "%6.3" "V" COEFFS 0 10 0 0 0 1 /end COMPU_METHOD
/begin COMPU_METHOD RBPtEChrDv_stChrgrRly_VERB "" TAB_VERB "%6.3" "" COMPU_TAB_REF RBPtEChrDv_stChrgrRly_VERB /end COMPU_METHOD
/begin COMPU_VTAB RBPtEChrDv_stChrgrRly_VERB "" TAB_VERB 8 0 "INI" 1 "PRECHARGE" 2 "CLOSED" 3 "WELDING_CHECK" 4 "OPEN" 5 "PARTLY_WELDED" 6 "WELDED" 7 "ERROR" /end COMPU_VTAB
/begin COMPU_METHOD rel_q0p0078125 "" RAT_FUNC "%6.4" "%" COEFFS 0 128 0 0 0 1 /end COMPU_METHOD
/begin COMPU_METHOD RmpTrqPrpHigh "" RAT_FUNC "%6.4" "Nm/s" COEFFS 0 655.36 0 0 0 1 /end COMPU_METHOD
/begin COMPU_METHOD RmpVel "" RAT_FUNC "%6.5" "(km/h)/s" COEFFS 0 6553.6 0 0 0 1 /end COMPU_METHOD
/begin COMPU_METHOD Signals_IntSigNumVerb "" TAB_VERB "%6.3" "" COMPU_TAB_REF Signals_IntSigNumVerb /end COMPU_METHOD
/begin COMPU_VTAB Signals_IntSigNumVerb "" TAB_VERB 314 0 "SIGNALS_Signals_Default" 1 "SIGNALS_ACCtl_nCmprSpdReq_DID_s" 2 "SIGNALS_ACCtl_nPwrLim_DID_s" 3 "SIGNALS_APP_rUnFlt" 4 "SIGNALS_APP_r_DID_s" 5 "SIGNALS_APP_uRaw1ADC_DID_s" 6 "SIGNALS_APP_uRaw2ADC_DID_s" 7 "SIGNALS_AcExtChrgr_pwrChrgnOut_DID_s" 8 "SIGNALS_AcExtChrgr_pwrChrgrIn_DID_s" 9 "SIGNALS_AirC_pClnt_DID_s" 10 "SIGNALS_Airbg_rPwmInpRat_DID_s" 11 "SIGNALS_Airbg_st_DID_s" 12 "SIGNALS_BattU_u" 13 "SIGNALS_BrkBstP_p_DID_s" 14 "SIGNALS_BrkBstP_uRaw1_DID_s" 15 "SIGNALS_BrkBstP_uRaw2_DID_s" 16 "SIGNALS_CbnHeatgSwt_stRaw_DID_s" 17 "SIGNALS_ChgrPlug_stCtpSwtActr_DID_s" 18 "SIGNALS_ChgrPlug_stPlgLockTx_DID_s" 19 "SIGNALS_ChrgMod_iChrgnMaxAvl_DID_s" 20 "SIGNALS_ChrgrRly_stRlyDes_DID_s" 21 "SIGNALS_ChrgrVal_iChrgrDes_DID_s" 22 "SIGNALS_ChrgrVal_uHvMax_DID_s" 23 "SIGNALS_CoDrvPITh_stEPSModeReq_DID_s" 24 "SIGNALS_CoPtFH_stPwt_DID_s" 25 "SIGNALS_ComChrgn_iDcRly_DID_s" 26 "SIGNALS_ComChrgn_uDcRly_DID_s" 27 "SIGNALS_ComChrgr_flgChrgrErrLvl_DID_s" 28 "SIGNALS_ComChrgr_iAcMax_DID_s" 29 "SIGNALS_ComChrgr_iDcHvAct_DID_s" 30 "SIGNALS_ComChrgr_pwrOutpCpby_DID_s" 31 "SIGNALS_ComChrgr_stChrgrRx_DID_s" 32 "SIGNALS_ComChrgr_stEVLmp_DID_s" 33 "SIGNALS_ComChrgr_stMstWrnLmp_DID_s" 34 "SIGNALS_ComChrgr_stSVSLmp_DID_s" 35 "SIGNALS_ComChrgr_tChrgrMaxAct_DID_s" 36 "SIGNALS_ComChrgr_uAcActL1_DID_s" 37 "SIGNALS_ComChrgr_uDcHvAct_DID_s" 38 "SIGNALS_ComEmac_iDcLnk01_DID_s" 39 "SIGNALS_ComEmac_nAct01_DID_s" 40 "SIGNALS_ComEmac_pwrInstnsInp_DID_s" 41 "SIGNALS_ComEmac_stActvDcha_DID_s" 42 "SIGNALS_ComEmac_stEVLmp_DID_s" 43 "SIGNALS_ComEmac_stHillHld_DID_s" 44 "SIGNALS_ComEmac_stIsoMonSwtAck_DID_s" 45 "SIGNALS_ComEmac_stIvtrOpMod01_DID_s" 46 "SIGNALS_ComEmac_stMod01Rx_DID_s" 47 "SIGNALS_ComEmac_stMstWrnLmp_DID_s" 48 "SIGNALS_ComEmac_stSVSLmp_DID_s" 49 "SIGNALS_ComEmac_tInvr01_DID_s" 50 "SIGNALS_ComEmac_tIvtrCooltIn01_DID_s" 51 "SIGNALS_ComEmac_tMac01_DID_s" 52 "SIGNALS_ComEmac_tqAbsltMax01_DID_s" 53 "SIGNALS_ComEmac_tqAbsltMin01_DID_s" 54 "SIGNALS_ComEmac_tqAckd01_DID_s" 55 "SIGNALS_ComEmac_tqAct01_DID_s" 56 "SIGNALS_ComEmac_tqPtd01_DID_s" 57 "SIGNALS_ComEmac_tqStabnMin_DID_s" 58 "SIGNALS_ComEmac_uDcLnk01_DID_s" 59 "SIGNALS_Com_flgEcoNormReqRx_DID_s" 60 "SIGNALS_Com_iDcdcHvActRvsn1_DID_s" 61 "SIGNALS_Com_iDcdcLvActRvsn1_DID_s" 62 "SIGNALS_Com_iElCmprHvAct_DID_s" 63 "SIGNALS_Com_iElCmprPeakPha_DID_s" 64 "SIGNALS_Com_iHvbAct_DID_s" 65 "SIGNALS_Com_iHvbChrgMaxSho_DID_s" 66 "SIGNALS_Com_iHvbDchaMaxSho_DID_s" 67 "SIGNALS_Com_iHvbDes_DID_s" 68 "SIGNALS_Com_iHvbNomChrgn_DID_s" 69 "SIGNALS_Com_lTotDstkm_DID_s" 70 "SIGNALS_Com_lTotOdometer_DID_s" 71 "SIGNALS_Com_nElCmprActlTx_DID_s" 72 "SIGNALS_Com_nElCmprActl_DID_s" 73 "SIGNALS_Com_numBSIEnv_DID_s" 74 "SIGNALS_Com_pwrDcdcOutpCpby_DID_s" 75 "SIGNALS_Com_pwrElCmprActl_DID_s" 76 "SIGNALS_Com_pwrMaxChrgSho_DID_s" 77 "SIGNALS_Com_pwrMaxDchaSho_DID_s" 78 "SIGNALS_Com_ratSocLvBatt_DID_s" 79 "SIGNALS_Com_stAC_DID_s" 80 "SIGNALS_Com_stAirbCrashSev_DID_s" 81 "SIGNALS_Com_stAlrtThermRunAwy_DID_s" 82 "SIGNALS_Com_stBrkBstPFlt_DID_s" 83 "SIGNALS_Com_stBrk_DID_s" 84 "SIGNALS_Com_stChrgPlgChrgn_DID_s" 85 "SIGNALS_Com_stChrgPlg_DID_s" 86 "SIGNALS_Com_stChrgnSpstReq_DID_s" 87 "SIGNALS_Com_stClstrStopIndcn_DID_s" 88 "SIGNALS_Com_stCmdHvBattCntctr_DID_s" 89 "SIGNALS_Com_stDayNight_DID_s" 90 "SIGNALS_Com_stDcdcEVLmp_DID_s" 91 "SIGNALS_Com_stDcdcFltLvl_DID_s" 92 "SIGNALS_Com_stDcdcMstWrnLmp_DID_s" 93 "SIGNALS_Com_stDcdcOperModActRx_DID_s" 94 "SIGNALS_Com_stDcdcSVSLmp_DID_s" 95 "SIGNALS_Com_stDcdcULimReq_DID_s" 96 "SIGNALS_Com_stDrvAwyDi_DID_s" 97 "SIGNALS_Com_stDrvModPosn_DID_s" 98 "SIGNALS_Com_stDrvStBltRx_DID_s" 99 "SIGNALS_Com_stEVLmp_DID_s" 100 "SIGNALS_Com_stElCmprFltLvl_DID_s" 101 "SIGNALS_Com_stElCmprStat_DID_s" 102 "SIGNALS_Com_stElMDesEem_DID_s" 103 "SIGNALS_Com_stGearLvrPos_DID_s" 104 "SIGNALS_Com_stHvBattOperModDes_DID_s" 105 "SIGNALS_Com_stHvacBlwrFront_DID_s" 106 "SIGNALS_Com_stHvacKnobPosn_DID_s" 107 "SIGNALS_Com_stHvbChrgFltRx_DID_s" 108 "SIGNALS_Com_stHvbChrgn_DID_s" 109 "SIGNALS_Com_stHvbCnctn_DID_s" 110 "SIGNALS_Com_stHvbEVLmp_DID_s" 111 "SIGNALS_Com_stHvbFltLvl_DID_s" 112 "SIGNALS_Com_stHvbIntlckRx_DID_s" 113 "SIGNALS_Com_stHvbIsoMeasmtActv_DID_s" 114 "SIGNALS_Com_stHvbModRx_DID_s" 115 "SIGNALS_Com_stHvbMstWrnLmp_DID_s" 116 "SIGNALS_Com_stHvbNegCntct_DID_s" 117 "SIGNALS_Com_stHvbPosCntct_DID_s" 118 "SIGNALS_Com_stHvbSVSLmp_DID_s" 119 "SIGNALS_Com_stIIvtrFltLvl01_DID_s" 120 "SIGNALS_Com_stIgnkeyPos_DID_s" 121 "SIGNALS_Com_stMstWrnLmp_DID_s" 122 "SIGNALS_Com_stPrkBrkRx_DID_s" 123 "SIGNALS_Com_stPwrLimnLmp_DID_s" 124 "SIGNALS_Com_stReFogReq_CAN_DID_s" 125 "SIGNALS_Com_stSocRx_DID_s" 126 "SIGNALS_Com_stSrvLmp_DID_s" 127 "SIGNALS_Com_stT50_DID_s" 128 "SIGNALS_Com_stT_DID_s" 129 "SIGNALS_Com_stVehCoorn_DID_s" 130 "SIGNALS_Com_steTogFailrLvl_DID_s" 131 "SIGNALS_Com_tDcdcAct_DID_s" 132 "SIGNALS_Com_tDcdcInltCoolt_DID_s" 133 "SIGNALS_Com_tElCmprActl_DID_s" 134 "SIGNALS_Com_tEvapT_DID_s" 135 "SIGNALS_Com_tLvBatt_DID_s" 136 "SIGNALS_Com_tiCurVehTmr_DID_s" 137 "SIGNALS_Com_tiRef_DID_s" 138 "SIGNALS_Com_uBattEBSRx_DID_s" 139 "SIGNALS_Com_uDcdcHvAct_DID_s" 140 "SIGNALS_Com_uDcdcLvAct_DID_s" 141 "SIGNALS_Com_uElCmprHvAct_DID_s" 142 "SIGNALS_Com_uHvbAct_DID_s" 143 "SIGNALS_Com_uHvbDcBus_DID_s" 144 "SIGNALS_Com_uHvbLimHi_DID_s" 145 "SIGNALS_Com_uHvbNomChrgn_DID_s" 146 "SIGNALS_Com_vVeh_DID_s" 147 "SIGNALS_DcChrgnRly_ctMaxOperCyc_DID_s" 148 "SIGNALS_DcChrgrIntkT2_t_DID_s" 149 "SIGNALS_DcChrgrIntkT_t_DID_s" 150 "SIGNALS_Dcdc_iLimLvGrid_DID_s" 151 "SIGNALS_Dcdc_stDesDcdc_DID_s" 152 "SIGNALS_Dcdc_uDesLvGrid_DID_s" 153 "SIGNALS_EChrDv_cntPlin_DID_s" 154 "SIGNALS_ElM_stDesEem01_DID_s" 155 "SIGNALS_ElTS_ratEmPowChrgn_s" 156 "SIGNALS_ElTS_ratEmPowDCha_DID_s" 157 "SIGNALS_EmWakeupSig_r_DID_s" 158 "SIGNALS_Emac_stIsoMonSwtReq_DID_s" 159 "SIGNALS_Emac_tqDesCom01_DID_s" 160 "SIGNALS_Emac_tqMaxLimCom01_DID_s" 161 "SIGNALS_Fan1_r_DID_s" 162 "SIGNALS_HLCCcs_iEvseDcPrsnt_DID_s" 163 "SIGNALS_HvBatt_ratSoc_DID_s" 164 "SIGNALS_HvGrid_pwrMaxDcdc_DID_s" 165 "SIGNALS_I15031_PID13h" 166 "SIGNALS_I15031_PID1Dh" 167 "SIGNALS_I15031_PID65Ah" 168 "SIGNALS_I15031_PID66Ah" 169 "SIGNALS_I15031_PID67Ah" 170 "SIGNALS_I15031_PID68Ah" 171 "SIGNALS_I15031_PID69Ah" 172 "SIGNALS_I15031_PID6AAh" 173 "SIGNALS_I15031_PID6BAh" 174 "SIGNALS_I15031_PID6CAh" 175 "SIGNALS_I15031_PID6DAh" 176 "SIGNALS_I15031_PID6EAh" 177 "SIGNALS_I15031_PID6FAh" 178 "SIGNALS_I15031_PID70Ah" 179 "SIGNALS_I15031_PID71Ah" 180 "SIGNALS_I15031_PID72Ah" 181 "SIGNALS_I15031_PID73Ah" 182 "SIGNALS_I15031_PID74Ah" 183 "SIGNALS_I15031_PID75Ah" 184 "SIGNALS_I15031_PID76Ah" 185 "SIGNALS_I15031_PID77Ah" 186 "SIGNALS_I15031_PID78Ah" 187 "SIGNALS_I15031_PID79Ah" 188 "SIGNALS_I15031_PID7AAh" 189 "SIGNALS_I15031_PID7BAh" 190 "SIGNALS_I15031_PID7CAh" 191 "SIGNALS_I15031_PID7FAh" 192 "SIGNALS_I15031_PID81Ah" 193 "SIGNALS_I15031_PID82Ah" 194 "SIGNALS_I15031_PID85Ah" 195 "SIGNALS_I15031_PID86Ah" 196 "SIGNALS_I15031_PID87Ah" 197 "SIGNALS_I15031_PID89Ah" 198 "SIGNALS_I15031_PID8AAh" 199 "SIGNALS_I15031_PID8FAh" 200 "SIGNALS_I15031_PID92Ah" 201 "SIGNALS_I15031_PID93Ah" 202 "SIGNALS_I15031_PID94Ah" 203 "SIGNALS_I15031_PID97Ah" 204 "SIGNALS_I15031_PID98Ah" 205 "SIGNALS_I15031_PID99Ah" 206 "SIGNALS_I15031_PID9CAh" 207 "SIGNALS_I15031_PIDA3Ah" 208 "SIGNALS_I15031_PIDA4Ah" 209 "SIGNALS_I15031_PIDA5Ah" 210 "SIGNALS_I15031_PIDA9Ah" 211 "SIGNALS_I15031_PIDACAh" 212 "SIGNALS_MRly_stActDid_DID_s" 213 "SIGNALS_MedTPmp_st_DID_s" 214 "SIGNALS_PEnv_p_DID_s" 215 "SIGNALS_PID01h" 216 "SIGNALS_PID0D_VehV_vSens" 217 "SIGNALS_PID1Ch" 218 "SIGNALS_PID21h" 219 "SIGNALS_PID30h" 220 "SIGNALS_PID31h" 221 "SIGNALS_PID33h_PEnv_pRaw" 222 "SIGNALS_PID42_BattU_uSens" 223 "SIGNALS_PID49_APP_uRaw1unLim" 224 "SIGNALS_PID4A_APP_uRaw2unLim" 225 "SIGNALS_PID4FAh" 226 "SIGNALS_PID4FBh" 227 "SIGNALS_PID4FCh" 228 "SIGNALS_PID4FDh" 229 "SIGNALS_PID50Ah" 230 "SIGNALS_PID50Bh" 231 "SIGNALS_PID50Ch" 232 "SIGNALS_PID50Dh" 233 "SIGNALS_PID5Fh" 234 "SIGNALS_PID8BAh" 235 "SIGNALS_PID8CAh" 236 "SIGNALS_PID9AAh" 237 "SIGNALS_PID9FAh" 238 "SIGNALS_PID_FILLSIG_1BIT" 239 "SIGNALS_PID_FILLSIG_1BITNZ" 240 "SIGNALS_PID_FILLSIG_1BYTE" 241 "SIGNALS_PID_FILLSIG_1BYTENZ" 242 "SIGNALS_PID_FILLSIG_2BIT" 243 "SIGNALS_PID_FILLSIG_2BITNZ" 244 "SIGNALS_PID_FILLSIG_2BYTE" 245 "SIGNALS_PID_FILLSIG_2BYTENZ" 246 "SIGNALS_PID_FILLSIG_3BIT" 247 "SIGNALS_PID_FILLSIG_3BITNZ" 248 "SIGNALS_PID_FILLSIG_4BIT" 249 "SIGNALS_PID_FILLSIG_4BITNZ" 250 "SIGNALS_PID_FILLSIG_4BYTE" 251 "SIGNALS_PID_FILLSIG_4BYTENZ" 252 "SIGNALS_PID_FILLSIG_5BIT" 253 "SIGNALS_PID_FILLSIG_5BITNZ" 254 "SIGNALS_PID_FILLSIG_6BIT" 255 "SIGNALS_PID_FILLSIG_6BITNZ" 256 "SIGNALS_PID_FILLSIG_7BIT" 257 "SIGNALS_PID_FILLSIG_7BITNZ" 258 "SIGNALS_PwmCtP_rRaw_DID_s" 259 "SIGNALS_PwrDistbnUnitT_t_DID_s" 260 "SIGNALS_SCtPmp1_rPs_DID_s" 261 "SIGNALS_SCtPmp1_r_DID_s" 262 "SIGNALS_SpplCooltPmpRly_r_DID_s" 263 "SIGNALS_ThermHvac_stRemPrecndn_DID_s" 264 "SIGNALS_UCtP_uSens_DID_s" 265 "SIGNALS_UPxP1_u_DID_s" 266 "SIGNALS_VehCoorn_dstRngPrdcDispTx_DID_s" 267 "SIGNALS_VehCoorn_st_DID_s" 268 "SIGNALS_VehCoorn_wCnsTotWghtAvrgEffTx_DID_s" 269 "SIGNALS_VehCoorn_wCnsTotWghtTripAvrgEffTx_DID_s" 270 "SIGNALS_VehV_a" 271 "SIGNALS_PID83h_A_BitCombineSignal" 272 "SIGNALS_PID9Bh_A_BitCombineSignal" 273 "SIGNALS_PIDA1h_A_BitCombineSignal" 274 "SIGNALS_PIDA7h_A_BitCombineSignal" 275 "SIGNALS_PIDA8h_A_BitCombineSignal" 276 "SIGNALS_Virtual_ACCtl_flgCmprEna_DID_s" 277 "SIGNALS_Virtual_BrkBstPmp_bPmpStrt_DID_s" 278 "SIGNALS_Virtual_BrkBstPmp_flgHsActr_DID_s" 279 "SIGNALS_Virtual_BrkBstPmp_flgLsActr_DID_s" 280 "SIGNALS_Virtual_BrkBst_flgBkupModActv_DID_s" 281 "SIGNALS_Virtual_CbnHeatgHeatr_flgHsActr_DID_s" 282 "SIGNALS_Virtual_CbnHeatgHeatr_flgLsActr_DID_s" 283 "SIGNALS_Virtual_ChrgnCntct_flgHsActr_DID_s" 284 "SIGNALS_Virtual_ChrgnCntct_flgLsNegActr_DID_s" 285 "SIGNALS_Virtual_ChrgnCntct_flgLsPosActr_DID_s" 286 "SIGNALS_Virtual_ComEmac_flgImobAuthent_DID_s" 287 "SIGNALS_Virtual_ComEmac_stPwrAuthn_DID_s" 288 "SIGNALS_Virtual_Com_bPreCondElecWkuReq_DID_s" 289 "SIGNALS_Virtual_Com_bReFogRlySt_DID_s" 290 "SIGNALS_Virtual_Com_bStpDlyHMIWkuReq_DID_s" 291 "SIGNALS_Virtual_Com_flgBlowrAuthn_DID_s" 292 "SIGNALS_Virtual_Com_flgBrkAlrt_DID_s" 293 "SIGNALS_Virtual_Com_flgBrkMaiDiag_DID_s" 294 "SIGNALS_Virtual_Com_flgBrkMai_DID_s" 295 "SIGNALS_Virtual_Com_flgCurMeasmtVld_DID_s" 296 "SIGNALS_Virtual_Com_flgDrvAwy_DID_s" 297 "SIGNALS_Virtual_Com_flgGearLvrMovmt_DID_s" 298 "SIGNALS_Virtual_Com_flgGunUnlckReq_DID_s" 299 "SIGNALS_Virtual_Com_flgHvBattAuthn_DID_s" 300 "SIGNALS_Virtual_Com_flgRstTripAEE_DID_s" 301 "SIGNALS_Virtual_Com_flgTPcbMeasmtVld_DID_s" 302 "SIGNALS_Virtual_Com_stABSActv_DID_s" 303 "SIGNALS_Virtual_Com_stACTx_DID_s" 304 "SIGNALS_Virtual_Com_stBrkCntctIndcn_DID_s" 305 "SIGNALS_Virtual_Com_stCmdOffsEM01_DID_s" 306 "SIGNALS_Virtual_Com_stDoor1_DID_s" 307 "SIGNALS_Virtual_Com_stDoor2_DID_s" 308 "SIGNALS_Virtual_Com_stDoor3_DID_s" 309 "SIGNALS_Virtual_Com_stDoor4_DID_s" 310 "SIGNALS_Virtual_Com_stElCmprStatTx_DID_s" 311 "SIGNALS_Virtual_Dcdc_flgDesLvGridULim_DID_s" 312 "SIGNALS_Virtual_Eem_flgFstHvShdwn_DID_s" 313 "SIGNALS_Virtual_HvBatt_flgIsoMeasmtDiReq_DID_s" /end COMPU_VTAB
/begin COMPU_METHOD Signals_PidVerbSupp "" TAB_VERB "%6.3" "" COMPU_TAB_REF Signals_PidVerbSupp /end COMPU_METHOD
/begin COMPU_VTAB Signals_PidVerbSupp "" TAB_VERB 68 0 "PID_NOT_SUPPORTED" 1 "PID_0x01" 13 "PID_0x0D" 19 "PID_0x13" 28 "PID_0x1C" 33 "PID_0x21" 48 "PID_0x30" 49 "PID_0x31" 51 "PID_0x33" 66 "PID_0x42" 73 "PID_0x49" 74 "PID_0x4A" 79 "PID_0x4F" 80 "PID_0x50" 101 "PID_0x65" 102 "PID_0x66" 103 "PID_0x67" 104 "PID_0x68" 105 "PID_0x69" 106 "PID_0x6A" 107 "PID_0x6B" 108 "PID_0x6C" 109 "PID_0x6D" 110 "PID_0x6E" 111 "PID_0x6F" 112 "PID_0x70" 113 "PID_0x71" 114 "PID_0x72" 115 "PID_0x73" 116 "PID_0x74" 117 "PID_0x75" 118 "PID_0x76" 119 "PID_0x77" 120 "PID_0x78" 121 "PID_0x79" 122 "PID_0x7A" 123 "PID_0x7B" 124 "PID_0x7C" 127 "PID_0x7F" 129 "PID_0x81" 130 "PID_0x82" 131 "PID_0x83" 133 "PID_0x85" 134 "PID_0x86" 135 "PID_0x87" 137 "PID_0x89" 138 "PID_0x8A" 139 "PID_0x8B" 140 "PID_0x8C" 143 "PID_0x8F" 146 "PID_0x92" 147 "PID_0x93" 148 "PID_0x94" 151 "PID_0x97" 152 "PID_0x98" 153 "PID_0x99" 154 "PID_0x9A" 155 "PID_0x9B" 156 "PID_0x9C" 159 "PID_0x9F" 161 "PID_0xA1" 163 "PID_0xA3" 164 "PID_0xA4" 165 "PID_0xA5" 167 "PID_0xA7" 168 "PID_0xA8" 169 "PID_0xA9" 172 "PID_0xAC" /end COMPU_VTAB
/begin COMPU_METHOD SigQly_COMPU_VERB "" TAB_VERB "%6.3" "" COMPU_TAB_REF SigQly_COMPU_VERB /end COMPU_METHOD
/begin COMPU_VTAB SigQly_COMPU_VERB "" TAB_VERB 16 0 "SIGQLY_NOTCALC" 1 "SIGQLY_INIT" 2 "SIGQLY_OK" 3 "SIGQLY_MODEL" 4 "SIGQLY_REPLACEMENT" 5 "SIGQLY_FROZEN" 6 "SIGQLY_INVALID" 7 "SIGQLY_RESERVED_7" 8 "SIGQLY_RESERVED_8" 9 "SIGQLY_RESERVED_9" 10 "SIGQLY_RESERVED_10" 11 "SIGQLY_RESERVED_11" 12 "SIGQLY_RESERVED_12" 13 "SIGQLY_RESERVED_13" 14 "SIGQLY_RESERVED_14" 15 "SIGQLY_RESERVED_15" /end COMPU_VTAB
/begin COMPU_METHOD t100msxs_uw_b6553p5 "" RAT_FUNC "%6.3" "s" COEFFS 0 1 0 0 0 0.1 /end COMPU_METHOD
/begin COMPU_METHOD t50msxs_q0p05 "" RAT_FUNC "%6.4" "s" COEFFS 0 1 0 0 0 0.05 /end COMPU_METHOD
/begin COMPU_METHOD Temp2Dyc_COMPU "" RAT_FUNC "%6.4" "deg C/%" COEFFS 0 100 0 0 0 1 /end COMPU_METHOD
/begin COMPU_METHOD TempDiff_Kelv_1K "" RAT_FUNC "%6.2" "K" COEFFS 0 1 0 0 0 1 /end COMPU_METHOD
/begin COMPU_METHOD TempK_float "" RAT_FUNC "%6.2" "K" COEFFS 0 1 0 0 0 1 /end COMPU_METHOD
/begin COMPU_METHOD Temp_Cels1 "" RAT_FUNC "%6.1" "deg C" COEFFS 0 100 27314 0 0 1 /end COMPU_METHOD
/begin COMPU_METHOD Temp_Cels_1deg "" RAT_FUNC "%6.1" "deg C" COEFFS 0 1 273.14 0 0 1 /end COMPU_METHOD
/begin COMPU_METHOD Temp_Fahr "" RAT_FUNC "%6.1" "deg F" COEFFS 0 5.55555555555556 2553.62222222222 0 0 1 /end COMPU_METHOD
/begin COMPU_METHOD Temp_Kelv "" RAT_FUNC "%6.3" "K" COEFFS 0 10 0 0 0 1 /end COMPU_METHOD
/begin COMPU_METHOD Temp_Kelv_Sec_CtT_Mon "" RAT_FUNC "%7.6" "deg C/s" COEFFS 0 40960 0 0 0 1 /end COMPU_METHOD
/begin COMPU_METHOD ThermalCoEff "" RAT_FUNC "%6.3" "W/m/m/k" COEFFS 0 10 0 0 0 1 /end COMPU_METHOD
/begin COMPU_METHOD ThmCnd "" RAT_FUNC "%6.5" "W/m/K" COEFFS 0 1000 0 0 0 1 /end COMPU_METHOD
/begin COMPU_METHOD THRVLVI_TYPAVL_SC_Compu "" TAB_VERB "%6.3" "" COMPU_TAB_REF THRVLVI_TYPAVL_SC_Compu /end COMPU_METHOD
/begin COMPU_VTAB THRVLVI_TYPAVL_SC_Compu "" TAB_VERB 2 0 "False" 1 "True" /end COMPU_VTAB
/begin COMPU_METHOD THRVLVUST_TYPAVL_SC_Compu "" TAB_VERB "%6.3" "" COMPU_TAB_REF THRVLVUST_TYPAVL_SC_Compu /end COMPU_METHOD
/begin COMPU_VTAB THRVLVUST_TYPAVL_SC_Compu "" TAB_VERB 2 0 "False" 1 "True" /end COMPU_VTAB
/begin COMPU_METHOD THRVLV_OPENPOSNLRN_SC_Compu "" TAB_VERB "%6.3" "" COMPU_TAB_REF THRVLV_OPENPOSNLRN_SC_Compu /end COMPU_METHOD
/begin COMPU_VTAB THRVLV_OPENPOSNLRN_SC_Compu "" TAB_VERB 2 0 "False" 1 "True" /end COMPU_VTAB
/begin COMPU_METHOD THS_LOTCIRCACTVCOOLG_SC_Compu "" TAB_VERB "%6.3" "" COMPU_TAB_REF THS_LOTCIRCACTVCOOLG_SC_Compu /end COMPU_METHOD
/begin COMPU_VTAB THS_LOTCIRCACTVCOOLG_SC_Compu "" TAB_VERB 2 0 "NO" 1 "CHILLR" /end COMPU_VTAB
/begin COMPU_METHOD THS_LOTCIRCACTVHEATG_SC_Compu "" TAB_VERB "%6.3" "" COMPU_TAB_REF THS_LOTCIRCACTVHEATG_SC_Compu /end COMPU_METHOD
/begin COMPU_VTAB THS_LOTCIRCACTVHEATG_SC_Compu "" TAB_VERB 2 0 "NO" 1 "PTC" /end COMPU_VTAB
/begin COMPU_METHOD THS_LOTCIRCPRSNT_SC_Compu "" TAB_VERB "%6.3" "" COMPU_TAB_REF THS_LOTCIRCPRSNT_SC_Compu /end COMPU_METHOD
/begin COMPU_VTAB THS_LOTCIRCPRSNT_SC_Compu "" TAB_VERB 2 0 "NO" 1 "YES" /end COMPU_VTAB
/begin COMPU_METHOD Time100HrsEngOn "" RAT_FUNC "%6.2" "[100h]" COEFFS 0 1 0 0 0 1 /end COMPU_METHOD
/begin COMPU_METHOD Time100_us "" RAT_FUNC "%6.0" "us" COEFFS 0 0.01 0 0 0 1 /end COMPU_METHOD
/begin COMPU_METHOD TimeDelay_s "" RAT_FUNC "%6.1" "s" COEFFS 0 0 1 0 0.00023283064365387 0 /end COMPU_METHOD
/begin COMPU_METHOD TimeDelay_s_2 "" RAT_FUNC "%13.6" "s" COEFFS 0 0 1 0 0.0596046447753906 0 /end COMPU_METHOD
/begin COMPU_METHOD TimeDelay_s_Lin_16 "" RAT_FUNC "%6.5" "s" COEFFS 0 6553.4 0 0 0 1 /end COMPU_METHOD
/begin COMPU_METHOD TimeEngOn "" RAT_FUNC "%6.2" "s" COEFFS 0 1 0 0 0 1 /end COMPU_METHOD
/begin COMPU_METHOD TimeEngOnOBD "" RAT_FUNC "%6.2" "min" COEFFS 0 1 0 0 0 1 /end COMPU_METHOD
/begin COMPU_METHOD TimeHrsEngOn "" RAT_FUNC "%6.0" "[100h]" COEFFS 0 0.01 0 0 0 1 /end COMPU_METHOD
/begin COMPU_METHOD TimeRed "" RAT_FUNC "%6.3" "s" COEFFS 0 6.25 0 0 0 1 /end COMPU_METHOD
/begin COMPU_METHOD TimeRed_OvrNght "" RAT_FUNC "%6.2" "s" COEFFS 0 0.390625 0 0 0 1 /end COMPU_METHOD
/begin COMPU_METHOD Time_Hr "" RAT_FUNC "%6.3" "h" COEFFS 0 2 0 0 0 1 /end COMPU_METHOD
/begin COMPU_METHOD Time_ms "" RAT_FUNC "%6.1" "ms" COEFFS 0 0.1 0 0 0 1 /end COMPU_METHOD
/begin COMPU_METHOD Time_ms_q0p01_COMPU "" RAT_FUNC "%6.4" "ms" COEFFS 0 100 0 0 0 1 /end COMPU_METHOD
/begin COMPU_METHOD Time_s "" RAT_FUNC "%6.4" "s" COEFFS 0 100 0 0 0 1 /end COMPU_METHOD
/begin COMPU_METHOD Time_s_1 "" RAT_FUNC "%6.5" "" COEFFS 0 1000 0 0 0 1 /end COMPU_METHOD
/begin COMPU_METHOD Time_s_LoRes "" RAT_FUNC "%6.2" "s" COEFFS 0 1 0 0 0 1 /end COMPU_METHOD
/begin COMPU_METHOD Time_WLvlPWM "" RAT_FUNC "%6.4" "ms" COEFFS 0 20 0 0 0 1 /end COMPU_METHOD
/begin COMPU_METHOD TINTKVUS_TYPAVL_SY_Compu "" TAB_VERB "%6.3" "" COMPU_TAB_REF TINTKVUS_TYPAVL_SY_Compu /end COMPU_METHOD
/begin COMPU_VTAB TINTKVUS_TYPAVL_SY_Compu "" TAB_VERB 2 0 "False" 1 "True" /end COMPU_VTAB
/begin COMPU_METHOD TiSec_q0p1_COMPU "" RAT_FUNC "%6.3" "s" COEFFS 0 10 0 0 0 1 /end COMPU_METHOD
/begin COMPU_METHOD TLE75602_SC_Compu "" TAB_VERB "%6.3" "" COMPU_TAB_REF TLE75602_SC_Compu /end COMPU_METHOD
/begin COMPU_VTAB TLE75602_SC_Compu "" TAB_VERB 4 0 "no Tle75602" 1 "one Tle75602" 2 "two Tle75602" 3 "three Tle75602" /end COMPU_VTAB
/begin COMPU_METHOD TOXDCAT_TYPAVL_SC_Compu "" TAB_VERB "%6.3" "" COMPU_TAB_REF TOXDCAT_TYPAVL_SC_Compu /end COMPU_METHOD
/begin COMPU_VTAB TOXDCAT_TYPAVL_SC_Compu "" TAB_VERB 2 0 "False" 1 "True" /end COMPU_VTAB
/begin COMPU_METHOD TOXICATDS_TYPAVL_SY_Compu "" TAB_VERB "%6.3" "" COMPU_TAB_REF TOXICATDS_TYPAVL_SY_Compu /end COMPU_METHOD
/begin COMPU_VTAB TOXICATDS_TYPAVL_SY_Compu "" TAB_VERB 2 0 "False" 1 "True" /end COMPU_VTAB
/begin COMPU_METHOD TOXICATUS_TYPAVL_SY_Compu "" TAB_VERB "%6.3" "" COMPU_TAB_REF TOXICATUS_TYPAVL_SY_Compu /end COMPU_METHOD
/begin COMPU_VTAB TOXICATUS_TYPAVL_SY_Compu "" TAB_VERB 2 0 "False" 1 "True" /end COMPU_VTAB
/begin COMPU_METHOD TPFLTDS_TYPAVL_SY_Compu "" TAB_VERB "%6.3" "" COMPU_TAB_REF TPFLTDS_TYPAVL_SY_Compu /end COMPU_METHOD
/begin COMPU_VTAB TPFLTDS_TYPAVL_SY_Compu "" TAB_VERB 2 0 "False" 1 "True" /end COMPU_VTAB
/begin COMPU_METHOD TPFLTUS_TYPAVL_SY_Compu "" TAB_VERB "%6.3" "" COMPU_TAB_REF TPFLTUS_TYPAVL_SY_Compu /end COMPU_METHOD
/begin COMPU_VTAB TPFLTUS_TYPAVL_SY_Compu "" TAB_VERB 2 0 "False" 1 "True" /end COMPU_VTAB
/begin COMPU_METHOD TPS65917_SC_Compu "" TAB_VERB "%6.3" "" COMPU_TAB_REF TPS65917_SC_Compu /end COMPU_METHOD
/begin COMPU_VTAB TPS65917_SC_Compu "" TAB_VERB 2 0 "no_device" 1 "one_device" /end COMPU_VTAB
/begin COMPU_METHOD TRANSFORMER_BASD_SC_Compu "" TAB_VERB "%6.3" "" COMPU_TAB_REF TRANSFORMER_BASD_SC_Compu /end COMPU_METHOD
/begin COMPU_VTAB TRANSFORMER_BASD_SC_Compu "" TAB_VERB 3 0 "NO_SERIALISATION" 1 "COM_XF" 2 "SOME_IP" /end COMPU_VTAB
/begin COMPU_METHOD TRBCHINSDT_TYPAVL_SC_Compu "" TAB_VERB "%6.3" "" COMPU_TAB_REF TRBCHINSDT_TYPAVL_SC_Compu /end COMPU_METHOD
/begin COMPU_VTAB TRBCHINSDT_TYPAVL_SC_Compu "" TAB_VERB 2 0 "False" 1 "True" /end COMPU_VTAB
/begin COMPU_METHOD TrbChN_float "" RAT_FUNC "%6.2" "rpm" COEFFS 0 1 0 0 0 1 /end COMPU_METHOD
/begin COMPU_METHOD TRBHP2I_TYPAVL_SC_Compu "" TAB_VERB "%6.3" "" COMPU_TAB_REF TRBHP2I_TYPAVL_SC_Compu /end COMPU_METHOD
/begin COMPU_VTAB TRBHP2I_TYPAVL_SC_Compu "" TAB_VERB 2 0 "False" 1 "True" /end COMPU_VTAB
/begin COMPU_METHOD TRBHPBYPI_TYPAVL_SC_Compu "" TAB_VERB "%6.3" "" COMPU_TAB_REF TRBHPBYPI_TYPAVL_SC_Compu /end COMPU_METHOD
/begin COMPU_VTAB TRBHPBYPI_TYPAVL_SC_Compu "" TAB_VERB 2 0 "False" 1 "True" /end COMPU_VTAB
/begin COMPU_METHOD TRBHPI_TYPAVL_SC_Compu "" TAB_VERB "%6.3" "" COMPU_TAB_REF TRBHPI_TYPAVL_SC_Compu /end COMPU_METHOD
/begin COMPU_VTAB TRBHPI_TYPAVL_SC_Compu "" TAB_VERB 2 0 "False" 1 "True" /end COMPU_VTAB
/begin COMPU_METHOD TRBLPI_TYPAVL_SC_Compu "" TAB_VERB "%6.3" "" COMPU_TAB_REF TRBLPI_TYPAVL_SC_Compu /end COMPU_METHOD
/begin COMPU_VTAB TRBLPI_TYPAVL_SC_Compu "" TAB_VERB 2 0 "False" 1 "True" /end COMPU_VTAB
/begin COMPU_METHOD TRBNBYVLV1INSDT_TYPAVL_SC_Compu "" TAB_VERB "%6.3" "" COMPU_TAB_REF TRBNBYVLV1INSDT_TYPAVL_SC_Compu /end COMPU_METHOD
/begin COMPU_VTAB TRBNBYVLV1INSDT_TYPAVL_SC_Compu "" TAB_VERB 2 0 "False" 1 "True" /end COMPU_VTAB
/begin COMPU_METHOD TRBNBYVLV2INSDT_TYPAVL_SC_Compu "" TAB_VERB "%6.3" "" COMPU_TAB_REF TRBNBYVLV2INSDT_TYPAVL_SC_Compu /end COMPU_METHOD
/begin COMPU_VTAB TRBNBYVLV2INSDT_TYPAVL_SC_Compu "" TAB_VERB 2 0 "False" 1 "True" /end COMPU_VTAB
/begin COMPU_METHOD TrqInrKd "" RAT_FUNC "%8.7" "%/Nm" COEFFS 0 655360 0 0 0 1 /end COMPU_METHOD
/begin COMPU_METHOD TrqInrKd_16 "" RAT_FUNC "%7.6" "%/Nm" COEFFS 0 40960 0 0 0 1 /end COMPU_METHOD
/begin COMPU_METHOD TrqInrKi "" RAT_FUNC "%7.6" "%/(Nm*s)" COEFFS 0 21474.83648 0 0 0 1 /end COMPU_METHOD
/begin COMPU_METHOD TrqInrKi_8 "" RAT_FUNC "%6.5" "%/(Nm*s)" COEFFS 0 2684.35456 0 0 0 1 /end COMPU_METHOD
/begin COMPU_METHOD TrqPerSec "" RAT_FUNC "%6.2" "Nm/s" COEFFS 0 1 0 0 0 1 /end COMPU_METHOD
/begin COMPU_METHOD TrqPrp "" RAT_FUNC "%6.2" "Nm" COEFFS 0 0.625 0 0 0 1 /end COMPU_METHOD
/begin COMPU_METHOD TrqPrpHigh "" RAT_FUNC "%6.3" "Nm" COEFFS 0 10 0 0 0 1 /end COMPU_METHOD
/begin COMPU_METHOD t_q0p1 "" RAT_FUNC "%6.3" "s" COEFFS 0 10 0 0 0 1 /end COMPU_METHOD
/begin COMPU_METHOD Vel "" RAT_FUNC "%6.4" "km/h" COEFFS 0 100 0 0 0 1 /end COMPU_METHOD
/begin COMPU_METHOD Volt_Batt "" RAT_FUNC "%6.1" "mV" COEFFS 0 0.05 0 0 0 1 /end COMPU_METHOD
/begin COMPU_METHOD Volt_V_q0p03125_COMPU "" RAT_FUNC "%6.4" "V" COEFFS 0 32 0 0 0 1 /end COMPU_METHOD
/begin RECORD_LAYOUT Kw_Ws16 FNC_VALUES 1 SWORD COLUMN_DIR DIRECT /end RECORD_LAYOUT
/begin RECORD_LAYOUT Kw_Wu32 FNC_VALUES 1 ULONG COLUMN_DIR DIRECT /end RECORD_LAYOUT
/begin RECORD_LAYOUT RB_Curve_S16_S16 NO_AXIS_PTS_X 1 SWORD AXIS_PTS_X 2 SWORD INDEX_INCR DIRECT FNC_VALUES 3 SWORD COLUMN_DIR DIRECT /end RECORD_LAYOUT
/begin RECORD_LAYOUT RB_Curve_S16_S32_sao NO_AXIS_PTS_X 1 SWORD AXIS_PTS_X 2 SWORD INDEX_INCR DIRECT FNC_VALUES 3 SLONG COLUMN_DIR DIRECT STATIC_ADDRESS_OFFSETS /end RECORD_LAYOUT
/begin RECORD_LAYOUT RB_Curve_U8_U8 NO_AXIS_PTS_X 1 UBYTE AXIS_PTS_X 2 UBYTE INDEX_INCR DIRECT FNC_VALUES 3 UBYTE COLUMN_DIR DIRECT /end RECORD_LAYOUT
/begin RECORD_LAYOUT RB_Map_S16S16_S16 NO_AXIS_PTS_X 1 SWORD NO_AXIS_PTS_Y 2 SWORD AXIS_PTS_X 3 SWORD INDEX_INCR DIRECT AXIS_PTS_Y 4 SWORD INDEX_INCR DIRECT FNC_VALUES 5 SWORD COLUMN_DIR DIRECT /end RECORD_LAYOUT
/begin RECORD_LAYOUT RB_Map_S16U8_S16_sao NO_AXIS_PTS_X 1 SWORD NO_AXIS_PTS_Y 2 SWORD AXIS_PTS_X 3 SWORD INDEX_INCR DIRECT AXIS_PTS_Y 4 UBYTE INDEX_INCR DIRECT FNC_VALUES 5 SWORD COLUMN_DIR DIRECT STATIC_ADDRESS_OFFSETS /end RECORD_LAYOUT
/begin RECORD_LAYOUT RB_Map_U16U8_S16_sao NO_AXIS_PTS_X 1 UWORD NO_AXIS_PTS_Y 2 UWORD AXIS_PTS_X 3 UWORD INDEX_INCR DIRECT AXIS_PTS_Y 4 UBYTE INDEX_INCR DIRECT FNC_VALUES 5 SWORD COLUMN_DIR DIRECT STATIC_ADDRESS_OFFSETS /end RECORD_LAYOUT
/begin RECORD_LAYOUT RB_Map_U8U8_S16_sao NO_AXIS_PTS_X 1 UBYTE NO_AXIS_PTS_Y 2 UBYTE AXIS_PTS_X 3 UBYTE INDEX_INCR DIRECT AXIS_PTS_Y 4 UBYTE INDEX_INCR DIRECT FNC_VALUES 5 SWORD COLUMN_DIR DIRECT STATIC_ADDRESS_OFFSETS /end RECORD_LAYOUT
/begin RECORD_LAYOUT RB_ValA_Wu8 FNC_VALUES 1 UBYTE COLUMN_DIR DIRECT /end RECORD_LAYOUT
/begin RECORD_LAYOUT RB_Val_Wboolean FNC_VALUES 1 UBYTE COLUMN_DIR DIRECT /end RECORD_LAYOUT
/begin RECORD_LAYOUT RB_Val_Ws16 FNC_VALUES 1 SWORD COLUMN_DIR DIRECT /end RECORD_LAYOUT
/begin RECORD_LAYOUT RB_Val_Ws32 FNC_VALUES 1 SLONG COLUMN_DIR DIRECT /end RECORD_LAYOUT
/begin RECORD_LAYOUT RB_Val_Wu16 FNC_VALUES 1 UWORD COLUMN_DIR DIRECT /end RECORD_LAYOUT
/begin RECORD_LAYOUT RB_Val_Wu32 FNC_VALUES 1 ULONG COLUMN_DIR DIRECT /end RECORD_LAYOUT
/begin RECORD_LAYOUT RB_Val_Wu8 FNC_VALUES 1 UBYTE COLUMN_DIR DIRECT /end RECORD_LAYOUT
/begin RECORD_LAYOUT ValA_Wu16 FNC_VALUES 1 UWORD COLUMN_DIR DIRECT /end RECORD_LAYOUT
/begin RECORD_LAYOUT ValA_Wu8 FNC_VALUES 1 UBYTE COLUMN_DIR DIRECT /end RECORD_LAYOUT
/begin RECORD_LAYOUT Val_Ws16 FNC_VALUES 1 SWORD COLUMN_DIR DIRECT /end RECORD_LAYOUT
/begin RECORD_LAYOUT Val_Ws32 FNC_VALUES 1 SLONG COLUMN_DIR DIRECT /end RECORD_LAYOUT
/begin RECORD_LAYOUT Val_Wu16 FNC_VALUES 1 UWORD COLUMN_DIR DIRECT /end RECORD_LAYOUT
/begin RECORD_LAYOUT Val_Wu32 FNC_VALUES 1 ULONG COLUMN_DIR DIRECT /end RECORD_LAYOUT
/begin RECORD_LAYOUT Val_Wu8 FNC_VALUES 1 UBYTE COLUMN_DIR DIRECT /end RECORD_LAYOUT
/end MODULE
/end PROJECT

ASAP2_VERSION 1 70
/begin PROJECT MDG1C "VC1CP091_STLA_N_D061I3"
/begin HEADER "" VERSION "VC1CP091_STLA_N_D061I3" PROJECT_NO MDG1C /end HEADER
/begin MODULE DIM ""
/begin MOD_COMMON "" BYTE_ORDER MSB_LAST ALIGNMENT_BYTE 1 ALIGNMENT_WORD 2 ALIGNMENT_LONG 4 ALIGNMENT_INT64 4 ALIGNMENT_FLOAT32_IEEE 4 ALIGNMENT_FLOAT64_IEEE 4 DATA_SIZE 32 /end MOD_COMMON
/begin CHARACTERISTIC AccPed_facRecupLvrLimd_C "Parameter for Limited factor of recuperation lever" VALUE 0x80251510 RB_Val_Ws16 7.999878 Fact -4.000000 3.999878 FORMAT "%8.6" /end CHARACTERISTIC
/begin CHARACTERISTIC ACSwt_tCbnSp_C "Cabin Temperature Set Point" VALUE 0x80251512 RB_Val_Ws16 6553.500 Temp_Cels -3549.940 3003.560 FORMAT "%8.3" /end CHARACTERISTIC
/begin CHARACTERISTIC AFS_mAirPerCyl_C "Calibration label for Air mass per cylinder" VALUE 0x80251514 RB_Val_Ws16 6553.500 AirMassPerCyl -3276.800 3276.700 FORMAT "%8.3" /end CHARACTERISTIC
/begin CHARACTERISTIC BrkECU_flgBrkEcuIntv_C "Calibration for message BrkECU_flgBrkEcuIntv" VALUE 0x80251516 RB_Val_Wu8 1.00000000000 B_TRUE 0.00 1.00000000000 FORMAT "%13.11" /end CHARACTERISTIC
/begin CHARACTERISTIC BrkgToZr_flgActvd_C "Parameter for flag for indication if braking to zero is active or inactive" VALUE 0x80251517 RB_Val_Wu8 1.00000000000 B_TRUE 0.00 1.00000000000 FORMAT "%13.11" /end CHARACTERISTIC
/begin CHARACTERISTIC BrkgToZr_flgPredActvn_C "Calibration parameter forFlag to indicate the status of predicted activation for transition to Hillhold Mode" VALUE 0x80251518 RB_Val_Wu8 1.00000000000 B_TRUE 0.00 1.00000000000 FORMAT "%13.11" /end CHARACTERISTIC
/begin CHARACTERISTIC BrkgToZr_nDes01_C "Parameter for EM01 engine speed setpoint request" VALUE 0x8025151A RB_Val_Ws16 65535.00 nmot_q1 -32768.00 32767.00 FORMAT "%8.2" /end CHARACTERISTIC
/begin CHARACTERISTIC BrkgToZr_tqHillHldRamp_C "Parameter for E-machine hillhold Ramp torque for ebraking to zero" VALUE 0x8025151C RB_Val_Ws32 429496729.500 TrqPrpHigh -214748364.800 214748364.700 FORMAT "%13.3" /end CHARACTERISTIC
/begin CHARACTERISTIC BrkTqEv_tqRcptSecAxle_C "Parameter for requested brake torque of the secondary axle" VALUE 0x80251520 RB_Val_Ws32 429496729.500 TrqPrpHigh -214748364.800 214748364.700 FORMAT "%13.3" /end CHARACTERISTIC
/begin CHARACTERISTIC B_fgfmsdh_msg_C "" VALUE 0x80251524 RB_Val_Wu8 1.00000000000 B_TRUE 0.00 1.00000000000 FORMAT "%13.11" /end CHARACTERISTIC
/begin CHARACTERISTIC B_msdkhfmg_msg_C "" VALUE 0x80251525 RB_Val_Wu8 1.00000000000 B_TRUE 0.00 1.00000000000 FORMAT "%13.11" /end CHARACTERISTIC
/begin CHARACTERISTIC Clth_st_C "Calibration for Debounced status of Clutch" VALUE 0x80251526 RB_Val_Wu8 255.0 q1 0.00 255.0 FORMAT "%5.1" /end CHARACTERISTIC
/begin CHARACTERISTIC CoEng_stMaiOld_C "" VALUE 0x80251528 RB_Val_Wu16 16384.0000000 CoEng_stMai_VERB 0.00 16384.0000000 FORMAT "%13.7" /end CHARACTERISTIC
/begin CHARACTERISTIC CoEng_stOld_C "engine state before current state was reached" VALUE 0x8025152A RB_Val_Wu8 5.00000000000 CoEng_st_COMPU_VERB 0.00 5.00000000000 FORMAT "%13.11" /end CHARACTERISTIC
/begin CHARACTERISTIC CoEng_tiNormal_C "Swadp for time since state COENG_RUNNING was reached" VALUE 0x8025152C RB_Val_Wu32 42949672950.0 Time_ms 0.00 42949672950.0 FORMAT "%13.1" /end CHARACTERISTIC
/begin CHARACTERISTIC CoETS_rTrq_C "Swadp for Calculated load value" VALUE 0x80251530 RB_Val_Ws16 799.9878 Prc -400.0000 399.9878 FORMAT "%8.4" /end CHARACTERISTIC
/begin CHARACTERISTIC ComChrgn_flgFltIDcRly_C "error flag for DC charging current" VALUE 0x80251532 RB_Val_Wu8 1.00000000000 B_TRUE 0.00 1.00000000000 FORMAT "%13.11" /end CHARACTERISTIC
/begin CHARACTERISTIC ComChrgn_flgFltUDcRly_C "error flag for DC charging voltage" VALUE 0x80251533 RB_Val_Wu8 1.00000000000 B_TRUE 0.00 1.00000000000 FORMAT "%13.11" /end CHARACTERISTIC
/begin CHARACTERISTIC ComChrgn_stDcRly_C "Calibration" VALUE 0x80251534 RB_Val_Wu8 255.0 OneToOne 0.00 255.0 FORMAT "%5.1" /end CHARACTERISTIC
/begin CHARACTERISTIC ComChrgr_uAcActL2_C "Swadp for L2 power supply of EVSE" VALUE 0x80251536 RB_Val_Ws16 6553.500 RBPtCel_u_0p1_1 -3276.800 3276.700 FORMAT "%8.3" /end CHARACTERISTIC
/begin CHARACTERISTIC ComChrgr_uAcActL2_Sq_C "Calibration for ComChrgr_uAcActL2_Sq" VALUE 0x80251538 RB_Val_Wu8 15.0000000000 SigQly_COMPU_VERB 0.00 15.0000000000 FORMAT "%13.10" /end CHARACTERISTIC
/begin CHARACTERISTIC ComChrgr_uAcActL3_C "Swadp for L3 power supply of EVSE" VALUE 0x8025153A RB_Val_Ws16 6553.500 RBPtCel_u_0p1_1 -3276.800 3276.700 FORMAT "%8.3" /end CHARACTERISTIC
/begin CHARACTERISTIC ComChrgr_uAcActL3_Sq_C "Calibration for ComChrgr_uAcActL3_Sq" VALUE 0x8025153C RB_Val_Wu8 15.0000000000 SigQly_COMPU_VERB 0.00 15.0000000000 FORMAT "%13.10" /end CHARACTERISTIC
/begin CHARACTERISTIC ComEmac_flgActvdDsbcCtl01_C "Substitution value for ComEmac_flgActvdDsbcCtl01." VALUE 0x8025153D RB_Val_Wu8 1.00000000000 B_TRUE 0.00 1.00000000000 FORMAT "%13.11" /end CHARACTERISTIC
/begin CHARACTERISTIC ComEmac_flgIntlckClsd01_C "calibration for message ComEmac_flgIntlckClsd01" VALUE 0x8025153E RB_Val_Wu8 1.00000000000 B_TRUE 0.00 1.00000000000 FORMAT "%13.11" /end CHARACTERISTIC
/begin CHARACTERISTIC ComEmac_flgIntlckClsd01_Sq_C "Flag that indicates that the invertrer HV interlock is closed" VALUE 0x8025153F RB_Val_Wu8 15.0000000000 SigQly_COMPU_VERB 0.00 15.0000000000 FORMAT "%13.10" /end CHARACTERISTIC
/begin CHARACTERISTIC ComEmac_flgReqDiag01_C "substitution value for ComEmac_flgReqDiag01" VALUE 0x80251540 RB_Val_Wu8 1.00000000000 B_TRUE 0.00 1.00000000000 FORMAT "%13.11" /end CHARACTERISTIC
/begin CHARACTERISTIC ComEmac_flgReqDiag01_Sq_C "" VALUE 0x80251541 RB_Val_Wu8 15.0000000000 SigQly_COMPU_VERB 0.00 15.0000000000 FORMAT "%13.10" /end CHARACTERISTIC
/begin CHARACTERISTIC ComEmac_nAct02_C "Parameter for actual engine speed, e-machine 02" VALUE 0x80251542 RB_Val_Ws16 65535.00 nmot_q1 -32768.00 32767.00 FORMAT "%8.2" /end CHARACTERISTIC
/begin CHARACTERISTIC ComEmac_stDsqflgEmgyShtDwnReq01_C "Calibration for Signal quality message for Emergency shut down signal Over CAN 1" VALUE 0x80251544 RB_Val_Wu8 255.0 OneToOne 0.00 255.0 FORMAT "%5.1" /end CHARACTERISTIC
/begin CHARACTERISTIC ComEmac_tqActWoDsbcCtl01_C "" VALUE 0x80251546 RB_Val_Ws16 6553.500 Trq -3276.800 3276.700 FORMAT "%8.3" /end CHARACTERISTIC
/begin CHARACTERISTIC ComEmac_tqActWoDsbcCtl01_Sq_C "" VALUE 0x80251548 RB_Val_Wu8 15.0000000000 SigQly_COMPU_VERB 0.00 15.0000000000 FORMAT "%13.10" /end CHARACTERISTIC
/begin CHARACTERISTIC ComEmac_tRtr01_C "Parameter for Rotor and Stator Temperature" VALUE 0x8025154A RB_Val_Ws16 6553.500 Temp_Cels -3549.940 3003.560 FORMAT "%8.3" /end CHARACTERISTIC
/begin CHARACTERISTIC ComEmac_tRtr01_Sq_C "" VALUE 0x8025154C RB_Val_Wu8 15.0000000000 SigQly_COMPU_VERB 0.00 15.0000000000 FORMAT "%13.10" /end CHARACTERISTIC
/begin CHARACTERISTIC Com_259hErr_GSUblinkEna_C "" VALUE 0x80251508 RB_Val_Wboolean 1.00000000000 B_TRUE 0.00 1.00000000000 FORMAT "%13.11" /end CHARACTERISTIC
/begin CHARACTERISTIC Com_aRecupOnePedlDrvg_C "Calibratable parameter to indicate Recuperation of one pedal driving" VALUE 0x8025154E RB_Val_Ws16 65.53500 Acc -32.76800 32.76700 FORMAT "%8.5" /end CHARACTERISTIC
/begin CHARACTERISTIC Com_aRecupRvsOnePedlDrvg_C "requested deceleration for one pedal driving is considered from external source" VALUE 0x80251550 RB_Val_Ws16 65.53500 Acc -32.76800 32.76700 FORMAT "%8.5" /end CHARACTERISTIC
/begin CHARACTERISTIC Com_bEbsComErr_C "Calibration for status of response error on communication from EBS" VALUE 0x80251552 RB_Val_Wu8 255.0 OneToOne 0.00 255.0 FORMAT "%5.1" /end CHARACTERISTIC
/begin CHARACTERISTIC Com_bEcoModeActv_C "calibration for message Com_bEcoModeActv" VALUE 0x80251553 RB_Val_Wu8 255.0 OneToOne 0.00 255.0 FORMAT "%5.1" /end CHARACTERISTIC
/begin CHARACTERISTIC Com_bErrClb_C "Calibration of status of calibration error" VALUE 0x80251554 RB_Val_Wu8 255.0 OneToOne 0.00 255.0 FORMAT "%5.1" /end CHARACTERISTIC
/begin CHARACTERISTIC Com_bErrIdn_C "Calibration of status of ID error" VALUE 0x80251555 RB_Val_Wu8 255.0 OneToOne 0.00 255.0 FORMAT "%5.1" /end CHARACTERISTIC
/begin CHARACTERISTIC Com_bInCstnc_C "Calibration for Status of inconsistency from EBS" VALUE 0x80251556 RB_Val_Wu8 255.0 OneToOne 0.00 255.0 FORMAT "%5.1" /end CHARACTERISTIC
/begin CHARACTERISTIC Com_bOBCClgWkuReq_C "" VALUE 0x80251557 RB_Val_Wu8 1.00000000000 B_TRUE 0.00 1.00000000000 FORMAT "%13.11" /end CHARACTERISTIC
/begin CHARACTERISTIC Com_bPreDrvWkuReq_C "" VALUE 0x80251558 RB_Val_Wu8 1.00000000000 B_TRUE 0.00 1.00000000000 FORMAT "%13.11" /end CHARACTERISTIC
/begin CHARACTERISTIC Com_bTBoxPtlWkuReq_C "" VALUE 0x80251559 RB_Val_Wu8 1.00000000000 B_TRUE 0.00 1.00000000000 FORMAT "%13.11" /end CHARACTERISTIC
/begin CHARACTERISTIC Com_egyTotNom_f_C "" VALUE 0x8025155C RB_Val_Wr32 2.00000000E+037 RBPtCel_pwr_1p0_4 -1.00000000E+037 1.00000000E+037 FORMAT "%13.3" EXTENDED_LIMITS -3.40282347E+038 3.40282347E+038 /end CHARACTERISTIC
/begin CHARACTERISTIC Com_flgCrawlActvd_C "Parameter for Flag to check crawling functionality is activated" VALUE 0x80251560 RB_Val_Wu8 1.00000000000 B_TRUE 0.00 1.00000000000 FORMAT "%13.11" /end CHARACTERISTIC
/begin CHARACTERISTIC Com_flgDcdcPrecCmpl_C "" VALUE 0x80251561 RB_Val_Wu8 1.00000000000 B_TRUE 0.00 1.00000000000 FORMAT "%13.11" /end CHARACTERISTIC
/begin CHARACTERISTIC Com_lTotDstkm_C "" VALUE 0x80251564 RB_Val_Wu32 4294967295.00 C126_dist_km_u32_q1p0_COMPU 0.00 4294967295.00 FORMAT "%13.2" /end CHARACTERISTIC
/begin CHARACTERISTIC Com_nrHvbHiCellPck_C "Calibration message of Com_nrHvbHiCellPck" VALUE 0x80251568 RB_Val_Wu8 255.0 OneToOne 0.00 255.0 FORMAT "%5.1" /end CHARACTERISTIC
/begin CHARACTERISTIC Com_nrSerlHiTDetn_C "Serial number of the highest temperature detection point (BMS)" VALUE 0x80251569 RB_Val_Wu8 255.0 OneToOne 0.00 255.0 FORMAT "%5.1" /end CHARACTERISTIC
/begin CHARACTERISTIC Com_nrSerlHiUCell_C "Serial number of the highest voltage of single power storage battery (Cell)" VALUE 0x8025156A RB_Val_Wu8 255.0 OneToOne 0.00 255.0 FORMAT "%5.1" /end CHARACTERISTIC
/begin CHARACTERISTIC Com_nrSerlLoTDetn_C "Serial number of the lowest temperature detection point (BMS)" VALUE 0x8025156B RB_Val_Wu8 255.0 OneToOne 0.00 255.0 FORMAT "%5.1" /end CHARACTERISTIC
/begin CHARACTERISTIC Com_numBSIEnv_C "" VALUE 0x8025156C RB_Val_Wu32 4294967295.00 OneToOne 0.00 4294967295.00 FORMAT "%13.2" /end CHARACTERISTIC
/begin CHARACTERISTIC Com_qSoh_C "Calibration for the init value of Com_qSoh" VALUE 0x80251570 RB_Val_Ws16 8191.875 ElecChrg_Ah_q0p125_COMPU -4096.000 4095.875 FORMAT "%8.3" /end CHARACTERISTIC
/begin CHARACTERISTIC Com_ratSoc_C "Default SOC value" VALUE 0x80251572 RB_Val_Wu8 255.0 RBPtCel_Perc_1p0_1 0.00 255.0 FORMAT "%5.1" /end CHARACTERISTIC
/begin CHARACTERISTIC Com_ratSoh_C "Calibration for battery SOH received from EBS" VALUE 0x80251573 RB_Val_Wu8 255.0 RBPtCel_Perc_1p0_1 0.00 255.0 FORMAT "%5.1" /end CHARACTERISTIC
/begin CHARACTERISTIC Com_ratThermIndcrMCU_C "" VALUE 0x80251574 RB_Val_Wu8 127.5 RBPtCel_Perc_0p5_1 0.00 127.5 FORMAT "%5.1" /end CHARACTERISTIC
/begin CHARACTERISTIC Com_rVirtZrPntExt_C "Calibration value for virtual zero point ratio for propulsion from external source" VALUE 0x80251576 RB_Val_Ws16 799.9878 Prc -400.0000 399.9878 FORMAT "%8.4" /end CHARACTERISTIC
/begin CHARACTERISTIC Com_stChrgnSpstReq_sq_C "" VALUE 0x80251578 RB_Val_Wu8 15.0000000000 SigQly_COMPU_VERB 0.00 15.0000000000 FORMAT "%13.10" /end CHARACTERISTIC
/begin CHARACTERISTIC Com_stCrCUIBtn_C "" VALUE 0x8025157A RB_Val_Wu16 32767.00 OneToOne 0.00 32767.00 FORMAT "%8.2" EXTENDED_LIMITS 0.00 65535.00 /end CHARACTERISTIC
/begin CHARACTERISTIC Com_stHvbTypCod_C "Calibration message of Com_stHvbTypCod" VALUE 0x8025157C RB_Val_Wu8 255.0 OneToOne 0.00 255.0 FORMAT "%5.1" /end CHARACTERISTIC
/begin CHARACTERISTIC Com_stIRng_C "Calibraiton for range for battery current from EBS" VALUE 0x8025157D RB_Val_Wu8 255.0 OneToOne 0.00 255.0 FORMAT "%5.1" /end CHARACTERISTIC
/begin CHARACTERISTIC Com_stI_C "Calibration for status of battery current" VALUE 0x8025157E RB_Val_Wu8 255.0 OneToOne 0.00 255.0 FORMAT "%5.1" /end CHARACTERISTIC
/begin CHARACTERISTIC Com_stNMStM_C "." VALUE 0x8025157F RB_Val_Wu8 4.00000000000 Com_NmStM_VERB 0.00 4.00000000000 FORMAT "%13.11" /end CHARACTERISTIC
/begin CHARACTERISTIC Com_stPrecTOut_C "" VALUE 0x80251580 RB_Val_Wu8 1.00000000000 B_TRUE 0.00 1.00000000000 FORMAT "%13.11" /end CHARACTERISTIC
/begin CHARACTERISTIC Com_stPrecTOut_Sq_C "" VALUE 0x80251581 RB_Val_Wu8 15.0000000000 SigQly_COMPU_VERB 0.00 15.0000000000 FORMAT "%13.10" /end CHARACTERISTIC
/begin CHARACTERISTIC Com_stSofASILErr_C "Interface to indicate the status of fitness of ASIL error" VALUE 0x80251582 RB_Val_Wu8 255.0 OneToOne 0.00 255.0 FORMAT "%5.1" /end CHARACTERISTIC
/begin CHARACTERISTIC Com_stSoh_C "calibration for message Com_stSoh" VALUE 0x80251583 RB_Val_Wu8 255.0 OneToOne 0.00 255.0 FORMAT "%5.1" /end CHARACTERISTIC
/begin CHARACTERISTIC Com_stU_C "Calibration status of battery voltage" VALUE 0x80251584 RB_Val_Wu8 255.0 OneToOne 0.00 255.0 FORMAT "%5.1" /end CHARACTERISTIC
/begin CHARACTERISTIC Com_tHvbAct_C "Calibration for Actual temperature of the high voltage battery" VALUE 0x8025150A RB_Val_Ws16 6553.500 Temp_Cels -3549.940 3003.560 FORMAT "%8.3" /end CHARACTERISTIC
/begin CHARACTERISTIC Com_tHvbCellMax_C "Calibration message of Com_tHvbCellMax" VALUE 0x80251586 RB_Val_Ws16 6553.500 RBPtCel_t_0p1om40_1 -3316.800 3236.700 FORMAT "%8.3" /end CHARACTERISTIC
/begin CHARACTERISTIC Com_tHvbCellMin_C "Calibration message of Com_tHvbCellMin" VALUE 0x80251588 RB_Val_Ws16 6553.500 RBPtCel_t_0p1om40_1 -3316.800 3236.700 FORMAT "%8.3" /end CHARACTERISTIC
/begin CHARACTERISTIC Com_tHvbMaxAllwbl_C "Max allowed HV batterie temperatur" VALUE 0x8025158A RB_Val_Ws16 6553.500 RBPtCel_t_0p1_3 -3276.800 3276.700 FORMAT "%8.3" /end CHARACTERISTIC
/begin CHARACTERISTIC Com_tiRef_C "" VALUE 0x8025158C RB_Val_Wu32 429496729.500 Time_sec_1 0.00 429496729.500 FORMAT "%13.3" /end CHARACTERISTIC
/begin CHARACTERISTIC Com_tqBrkDesPrimAxle_C "" VALUE 0x80251590 RB_Val_Ws32 429496729.500 TrqPrpHigh -214748364.800 214748364.700 FORMAT "%13.3" /end CHARACTERISTIC
/begin CHARACTERISTIC Com_uHvbCellLimHi_C "Calibration message of Com_uHvbCellLimHi" VALUE 0x80251594 RB_Val_Ws16 655.3500 RBPtCel_u_0p01_1 -327.6800 327.6700 FORMAT "%8.4" /end CHARACTERISTIC
/begin CHARACTERISTIC Com_uHvbHiCell_C "Calibration message of Com_uHvbHiCell" VALUE 0x80251596 RB_Val_Ws16 81.91875 RBPtCel_u_0p00125_1 -40.96000 40.95875 FORMAT "%8.5" /end CHARACTERISTIC
/begin CHARACTERISTIC Com_uHvbLimLo_C "" VALUE 0x80251598 RB_Val_Ws16 2047.969 Volt_V_q0p03125_COMPU -1024.000 1023.969 FORMAT "%8.3" /end CHARACTERISTIC
/begin CHARACTERISTIC Com_uHvbLimLo_Sq_C "" VALUE 0x8025159A RB_Val_Wu8 15.0000000000 SigQly_COMPU_VERB 0.00 15.0000000000 FORMAT "%13.10" /end CHARACTERISTIC
/begin CHARACTERISTIC Com_uHvbLoCell_C "Calibration message of Com_uHvbLoCell" VALUE 0x8025159C RB_Val_Ws16 81.91875 RBPtCel_u_0p00125_1 -40.96000 40.95875 FORMAT "%8.5" /end CHARACTERISTIC
/begin CHARACTERISTIC Com_uPtcAct_Sq_C "" VALUE 0x8025159E RB_Val_Wu8 15.0000000000 SigQly_COMPU_VERB 0.00 15.0000000000 FORMAT "%13.10" /end CHARACTERISTIC
/begin CHARACTERISTIC Com_uSofASIL_C "Interface to indicate the state of fitness of the ASIL voltage" VALUE 0x802515A0 RB_Val_Ws16 4095.938 spg_q0p0625_V -2048.000 2047.938 FORMAT "%8.3" /end CHARACTERISTIC
/begin CHARACTERISTIC CoPOM_ratTqDistbn_C "Parameter for factor for torque- resp. power distribution" VALUE 0x802515A2 RB_Val_Ws16 7.999878 fak_q1p22Em4 -4.000000 3.999878 FORMAT "%8.6" /end CHARACTERISTIC
/begin CHARACTERISTIC CoPOM_tqWhlQstyMaxWoDistbn_C "Calibration parameter for Maximum theoretical quasi-stationary torque without Distribution at wheel level" VALUE 0x802515A4 RB_Val_Ws32 429496729.500 TrqPrpHigh -214748364.800 214748364.700 FORMAT "%13.3" /end CHARACTERISTIC
/begin CHARACTERISTIC CoPT_tqRecupPotlWhlPrim_C "Calibration parameter for Recuperation potential torque for primary axle" VALUE 0x802515A8 RB_Val_Ws32 429496729.500 TrqPrpHigh -214748364.800 214748364.700 FORMAT "%13.3" /end CHARACTERISTIC
/begin CHARACTERISTIC CoPT_tqRecupPotlWhlSec_C "Calibration parameter for recuperation potential torque for Secondary axle." VALUE 0x802515AC RB_Val_Ws32 429496729.500 TrqPrpHigh -214748364.800 214748364.700 FORMAT "%13.3" /end CHARACTERISTIC
/begin CHARACTERISTIC CoVMD_stReqCrCtl_C "Parameter for Coordinated status of acceleration request" VALUE 0x802515B0 RB_Val_Wu8 255.0 OneToOne 0.00 255.0 FORMAT "%5.1" /end CHARACTERISTIC
/begin CHARACTERISTIC CoVMD_tqAdas_C "Software adapter calibration for ADAS torque" VALUE 0x802515B4 RB_Val_Ws32 429496729.500 TrqPrpHigh -214748364.800 214748364.700 FORMAT "%13.3" /end CHARACTERISTIC
/begin CHARACTERISTIC CoVMD_trqCrCtl_C "Parameter for Propulsion torque of cruise control" VALUE 0x802515B8 RB_Val_Ws32 429496729.500 TrqPrpHigh -214748364.800 214748364.700 FORMAT "%13.3" /end CHARACTERISTIC
/begin CHARACTERISTIC Dcdc_uDesLvGridLim_C "" VALUE 0x8025150C RB_Val_Ws16 127.9961 spg_q0p0039 0.00 127.9961 FORMAT "%8.4" EXTENDED_LIMITS -128.0000 127.9961 /end CHARACTERISTIC
/begin CHARACTERISTIC DDRC_DurDeb.Com_tiAirbgCan_CDebOk_C "" VALUE 0x80240B80 Val_Wu16 655350.0 DDRCTime_ms 0.00 655350.0 FORMAT "%8.1" /end CHARACTERISTIC
/begin CHARACTERISTIC DDRC_DurDeb.Com_tiAirbgCan_CDebDef_C "" VALUE 0x80240B82 Val_Wu16 655350.0 DDRCTime_ms 0.00 655350.0 FORMAT "%8.1" /end CHARACTERISTIC
/begin CHARACTERISTIC DDRC_DurDeb.Com_tiComChrgrEVCont_CDebOk_C "" VALUE 0x80240B90 Val_Wu16 655350.0 DDRCTime_ms 0.00 655350.0 FORMAT "%8.1" /end CHARACTERISTIC
/begin CHARACTERISTIC DDRC_DurDeb.Com_tiComChrgrEVCont_CDebDef_C "" VALUE 0x80240B92 Val_Wu16 655350.0 DDRCTime_ms 0.00 655350.0 FORMAT "%8.1" /end CHARACTERISTIC
/begin CHARACTERISTIC DDRC_DurDeb.Com_tiComChrgrEVtBlink_CDebOk_C "" VALUE 0x80240B94 Val_Wu16 655350.0 DDRCTime_ms 0.00 655350.0 FORMAT "%8.1" /end CHARACTERISTIC
/begin CHARACTERISTIC DDRC_DurDeb.Com_tiComChrgrEVtBlink_CDebDef_C "" VALUE 0x80240B96 Val_Wu16 655350.0 DDRCTime_ms 0.00 655350.0 FORMAT "%8.1" /end CHARACTERISTIC
/begin CHARACTERISTIC DDRC_DurDeb.Com_tiComChrgrMstBlink_CDebOk_C "" VALUE 0x80240B98 Val_Wu16 655350.0 DDRCTime_ms 0.00 655350.0 FORMAT "%8.1" /end CHARACTERISTIC
/begin CHARACTERISTIC DDRC_DurDeb.Com_tiComChrgrMstBlink_CDebDef_C "" VALUE 0x80240B9A Val_Wu16 655350.0 DDRCTime_ms 0.00 655350.0 FORMAT "%8.1" /end CHARACTERISTIC
/begin CHARACTERISTIC DDRC_DurDeb.Com_tiComChrgrMstCont_CDebOk_C "" VALUE 0x80240B9C Val_Wu16 655350.0 DDRCTime_ms 0.00 655350.0 FORMAT "%8.1" /end CHARACTERISTIC
/begin CHARACTERISTIC DDRC_DurDeb.Com_tiComChrgrMstCont_CDebDef_C "" VALUE 0x80240B9E Val_Wu16 655350.0 DDRCTime_ms 0.00 655350.0 FORMAT "%8.1" /end CHARACTERISTIC
/begin CHARACTERISTIC DDRC_DurDeb.Com_tiComChrgrSVSBlink_CDebOk_C "" VALUE 0x80240BA0 Val_Wu16 655350.0 DDRCTime_ms 0.00 655350.0 FORMAT "%8.1" /end CHARACTERISTIC
/begin CHARACTERISTIC DDRC_DurDeb.Com_tiComChrgrSVSBlink_CDebDef_C "" VALUE 0x80240BA2 Val_Wu16 655350.0 DDRCTime_ms 0.00 655350.0 FORMAT "%8.1" /end CHARACTERISTIC
/begin CHARACTERISTIC DDRC_DurDeb.Com_tiComChrgrSVSCont_CDebOk_C "" VALUE 0x80240BA4 Val_Wu16 655350.0 DDRCTime_ms 0.00 655350.0 FORMAT "%8.1" /end CHARACTERISTIC
/begin CHARACTERISTIC DDRC_DurDeb.Com_tiComChrgrSVSCont_CDebDef_C "" VALUE 0x80240BA6 Val_Wu16 655350.0 DDRCTime_ms 0.00 655350.0 FORMAT "%8.1" /end CHARACTERISTIC
/begin CHARACTERISTIC DDRC_DurDeb.Com_tiComDcdcEVBlink_CDebOk_C "" VALUE 0x80240BA8 Val_Wu16 655350.0 DDRCTime_ms 0.00 655350.0 FORMAT "%8.1" /end CHARACTERISTIC
/begin CHARACTERISTIC DDRC_DurDeb.Com_tiComDcdcEVBlink_CDebDef_C "" VALUE 0x80240BAA Val_Wu16 655350.0 DDRCTime_ms 0.00 655350.0 FORMAT "%8.1" /end CHARACTERISTIC
/begin CHARACTERISTIC DDRC_DurDeb.Com_tiComDcdcEVCont_CDebOk_C "" VALUE 0x80240BAC Val_Wu16 655350.0 DDRCTime_ms 0.00 655350.0 FORMAT "%8.1" /end CHARACTERISTIC
/begin CHARACTERISTIC DDRC_DurDeb.Com_tiComDcdcEVCont_CDebDef_C "" VALUE 0x80240BAE Val_Wu16 655350.0 DDRCTime_ms 0.00 655350.0 FORMAT "%8.1" /end CHARACTERISTIC
/begin CHARACTERISTIC DDRC_DurDeb.Com_tiComDcdcMstBlink_CDebOk_C "" VALUE 0x80240BC4 Val_Wu16 655350.0 DDRCTime_ms 0.00 655350.0 FORMAT "%8.1" /end CHARACTERISTIC
/begin CHARACTERISTIC DDRC_DurDeb.Com_tiComDcdcMstBlink_CDebDef_C "" VALUE 0x80240BC6 Val_Wu16 655350.0 DDRCTime_ms 0.00 655350.0 FORMAT "%8.1" /end CHARACTERISTIC
/begin CHARACTERISTIC DDRC_DurDeb.Com_tiComDcdcMstCont_CDebOk_C "" VALUE 0x80240BC8 Val_Wu16 655350.0 DDRCTime_ms 0.00 655350.0 FORMAT "%8.1" /end CHARACTERISTIC
/begin CHARACTERISTIC DDRC_DurDeb.Com_tiComDcdcMstCont_CDebDef_C "" VALUE 0x80240BCA Val_Wu16 655350.0 DDRCTime_ms 0.00 655350.0 FORMAT "%8.1" /end CHARACTERISTIC
/begin CHARACTERISTIC DDRC_DurDeb.Com_tiComDcdcSVSBlink_CDebOk_C "" VALUE 0x80240BCC Val_Wu16 655350.0 DDRCTime_ms 0.00 655350.0 FORMAT "%8.1" /end CHARACTERISTIC
/begin CHARACTERISTIC DDRC_DurDeb.Com_tiComDcdcSVSBlink_CDebDef_C "" VALUE 0x80240BCE Val_Wu16 655350.0 DDRCTime_ms 0.00 655350.0 FORMAT "%8.1" /end CHARACTERISTIC
/begin CHARACTERISTIC DDRC_DurDeb.Com_tiComDcdcSVSCont_CDebOk_C "" VALUE 0x80240BD0 Val_Wu16 655350.0 DDRCTime_ms 0.00 655350.0 FORMAT "%8.1" /end CHARACTERISTIC
/begin CHARACTERISTIC DDRC_DurDeb.Com_tiComDcdcSVSCont_CDebDef_C "" VALUE 0x80240BD2 Val_Wu16 655350.0 DDRCTime_ms 0.00 655350.0 FORMAT "%8.1" /end CHARACTERISTIC
/begin CHARACTERISTIC DDRC_DurDeb.Com_tiComEmacEVBlink_CDebOk_C "" VALUE 0x80240BE8 Val_Wu16 655350.0 DDRCTime_ms 0.00 655350.0 FORMAT "%8.1" /end CHARACTERISTIC
/begin CHARACTERISTIC DDRC_DurDeb.Com_tiComEmacEVBlink_CDebDef_C "" VALUE 0x80240BEA Val_Wu16 655350.0 DDRCTime_ms 0.00 655350.0 FORMAT "%8.1" /end CHARACTERISTIC
/begin CHARACTERISTIC DDRC_DurDeb.Com_tiComEmacEVCont_CDebOk_C "" VALUE 0x80240BEC Val_Wu16 655350.0 DDRCTime_ms 0.00 655350.0 FORMAT "%8.1" /end CHARACTERISTIC
/begin CHARACTERISTIC DDRC_DurDeb.Com_tiComEmacEVCont_CDebDef_C "" VALUE 0x80240BEE Val_Wu16 655350.0 DDRCTime_ms 0.00 655350.0 FORMAT "%8.1" /end CHARACTERISTIC
/begin CHARACTERISTIC DDRC_DurDeb.Com_tiComEmacMstCont_CDebOk_C "" VALUE 0x80240BF0 Val_Wu16 655350.0 DDRCTime_ms 0.00 655350.0 FORMAT "%8.1" /end CHARACTERISTIC
/begin CHARACTERISTIC DDRC_DurDeb.Com_tiComEmacMstCont_CDebDef_C "" VALUE 0x80240BF2 Val_Wu16 655350.0 DDRCTime_ms 0.00 655350.0 FORMAT "%8.1" /end CHARACTERISTIC
/begin CHARACTERISTIC DDRC_DurDeb.Com_tiComEmacMsttBlink_CDebOk_C "" VALUE 0x80240BF4 Val_Wu16 655350.0 DDRCTime_ms 0.00 655350.0 FORMAT "%8.1" /end CHARACTERISTIC
/begin CHARACTERISTIC DDRC_DurDeb.Com_tiComEmacMsttBlink_CDebDef_C "" VALUE 0x80240BF6 Val_Wu16 655350.0 DDRCTime_ms 0.00 655350.0 FORMAT "%8.1" /end CHARACTERISTIC
/begin CHARACTERISTIC DDRC_DurDeb.Com_tiComEmacSVSBlink_CDebOk_C "" VALUE 0x80240BF8 Val_Wu16 655350.0 DDRCTime_ms 0.00 655350.0 FORMAT "%8.1" /end CHARACTERISTIC
/begin CHARACTERISTIC DDRC_DurDeb.Com_tiComEmacSVSBlink_CDebDef_C "" VALUE 0x80240BFA Val_Wu16 655350.0 DDRCTime_ms 0.00 655350.0 FORMAT "%8.1" /end CHARACTERISTIC
/begin CHARACTERISTIC DDRC_DurDeb.Com_tiComEmacSVSCont_CDebOk_C "" VALUE 0x80240BFC Val_Wu16 655350.0 DDRCTime_ms 0.00 655350.0 FORMAT "%8.1" /end CHARACTERISTIC
/begin CHARACTERISTIC DDRC_DurDeb.Com_tiComEmacSVSCont_CDebDef_C "" VALUE 0x80240BFE Val_Wu16 655350.0 DDRCTime_ms 0.00 655350.0 FORMAT "%8.1" /end CHARACTERISTIC
/begin CHARACTERISTIC DDRC_DurDeb.Com_tiComHvbMstBlink_CDebOk_C "" VALUE 0x80240C20 Val_Wu16 655350.0 DDRCTime_ms 0.00 655350.0 FORMAT "%8.1" /end CHARACTERISTIC
/begin CHARACTERISTIC DDRC_DurDeb.Com_tiComHvbMstBlink_CDebDef_C "" VALUE 0x80240C22 Val_Wu16 655350.0 DDRCTime_ms 0.00 655350.0 FORMAT "%8.1" /end CHARACTERISTIC
/begin CHARACTERISTIC DDRC_DurDeb.Com_tiComHvbMstCont_CDebOk_C "" VALUE 0x80240C24 Val_Wu16 655350.0 DDRCTime_ms 0.00 655350.0 FORMAT "%8.1" /end CHARACTERISTIC
/begin CHARACTERISTIC DDRC_DurDeb.Com_tiComHvbMstCont_CDebDef_C "" VALUE 0x80240C26 Val_Wu16 655350.0 DDRCTime_ms 0.00 655350.0 FORMAT "%8.1" /end CHARACTERISTIC
/begin CHARACTERISTIC DDRC_DurDeb.Com_tiComflgCurMeasmtErr_CDebOk_C "" VALUE 0x80240C58 Val_Wu16 655350.0 DDRCTime_ms 0.00 655350.0 FORMAT "%8.1" /end CHARACTERISTIC
/begin CHARACTERISTIC DDRC_DurDeb.Com_tiComflgCurMeasmtErr_CDebDef_C "" VALUE 0x80240C5A Val_Wu16 655350.0 DDRCTime_ms 0.00 655350.0 FORMAT "%8.1" /end CHARACTERISTIC
/begin CHARACTERISTIC DDRC_DurDeb.Com_tiComflgCurMeasmtSysErr_CDebOk_C "" VALUE 0x80240C5C Val_Wu16 655350.0 DDRCTime_ms 0.00 655350.0 FORMAT "%8.1" /end CHARACTERISTIC
/begin CHARACTERISTIC DDRC_DurDeb.Com_tiComflgCurMeasmtSysErr_CDebDef_C "" VALUE 0x80240C5E Val_Wu16 655350.0 DDRCTime_ms 0.00 655350.0 FORMAT "%8.1" /end CHARACTERISTIC
/begin CHARACTERISTIC DDRC_DurDeb.Com_tiComflgCurMeasmtVld_CDebOk_C "" VALUE 0x80240C60 Val_Wu16 655350.0 DDRCTime_ms 0.00 655350.0 FORMAT "%8.1" /end CHARACTERISTIC
/begin CHARACTERISTIC DDRC_DurDeb.Com_tiComflgCurMeasmtVld_CDebDef_C "" VALUE 0x80240C62 Val_Wu16 655350.0 DDRCTime_ms 0.00 655350.0 FORMAT "%8.1" /end CHARACTERISTIC
/begin CHARACTERISTIC DDRC_DurDeb.Com_tiComflgCurRngErr_CDebOk_C "" VALUE 0x80240C64 Val_Wu16 655350.0 DDRCTime_ms 0.00 655350.0 FORMAT "%8.1" /end CHARACTERISTIC
/begin CHARACTERISTIC DDRC_DurDeb.Com_tiComflgCurRngErr_CDebDef_C "" VALUE 0x80240C66 Val_Wu16 655350.0 DDRCTime_ms 0.00 655350.0 FORMAT "%8.1" /end CHARACTERISTIC
/begin CHARACTERISTIC DDRC_DurDeb.Com_tiComflgTPcbMeasmtErr_CDebOk_C "" VALUE 0x80240C68 Val_Wu16 655350.0 DDRCTime_ms 0.00 655350.0 FORMAT "%8.1" /end CHARACTERISTIC
/begin CHARACTERISTIC DDRC_DurDeb.Com_tiComflgTPcbMeasmtErr_CDebDef_C "" VALUE 0x80240C6A Val_Wu16 655350.0 DDRCTime_ms 0.00 655350.0 FORMAT "%8.1" /end CHARACTERISTIC
/begin CHARACTERISTIC DDRC_DurDeb.Com_tiComflgTPcbMeasmtVld_CDebOk_C "" VALUE 0x80240C6C Val_Wu16 655350.0 DDRCTime_ms 0.00 655350.0 FORMAT "%8.1" /end CHARACTERISTIC
/begin CHARACTERISTIC DDRC_DurDeb.Com_tiComflgTPcbMeasmtVld_CDebDef_C "" VALUE 0x80240C6E Val_Wu16 655350.0 DDRCTime_ms 0.00 655350.0 FORMAT "%8.1" /end CHARACTERISTIC
/begin CHARACTERISTIC DDRC_DurDeb.Com_tiComflgTPcbRngErr_CDebOk_C "" VALUE 0x80240C70 Val_Wu16 655350.0 DDRCTime_ms 0.00 655350.0 FORMAT "%8.1" /end CHARACTERISTIC
/begin CHARACTERISTIC DDRC_DurDeb.Com_tiComflgTPcbRngErr_CDebDef_C "" VALUE 0x80240C72 Val_Wu16 655350.0 DDRCTime_ms 0.00 655350.0 FORMAT "%8.1" /end CHARACTERISTIC
/begin CHARACTERISTIC DDRC_DurDeb.Com_tiComflgTPcbSysErr_CDebOk_C "" VALUE 0x80240C74 Val_Wu16 655350.0 DDRCTime_ms 0.00 655350.0 FORMAT "%8.1" /end CHARACTERISTIC
/begin CHARACTERISTIC DDRC_DurDeb.Com_tiComflgTPcbSysErr_CDebDef_C "" VALUE 0x80240C76 Val_Wu16 655350.0 DDRCTime_ms 0.00 655350.0 FORMAT "%8.1" /end CHARACTERISTIC
/begin CHARACTERISTIC DDRC_DurDeb.Com_tiComflgTShntMeasmtErr_CDebOk_C "" VALUE 0x80240C78 Val_Wu16 655350.0 DDRCTime_ms 0.00 655350.0 FORMAT "%8.1" /end CHARACTERISTIC
/begin CHARACTERISTIC DDRC_DurDeb.Com_tiComflgTShntMeasmtErr_CDebDef_C "" VALUE 0x80240C7A Val_Wu16 655350.0 DDRCTime_ms 0.00 655350.0 FORMAT "%8.1" /end CHARACTERISTIC
/begin CHARACTERISTIC DDRC_DurDeb.Com_tiComflgTShntMeasmtVld_CDebOk_C "" VALUE 0x80240C7C Val_Wu16 655350.0 DDRCTime_ms 0.00 655350.0 FORMAT "%8.1" /end CHARACTERISTIC
/begin CHARACTERISTIC DDRC_DurDeb.Com_tiComflgTShntMeasmtVld_CDebDef_C "" VALUE 0x80240C7E Val_Wu16 655350.0 DDRCTime_ms 0.00 655350.0 FORMAT "%8.1" /end CHARACTERISTIC
/begin CHARACTERISTIC DDRC_DurDeb.Com_tiComflgTShntRngErr_CDebOk_C "" VALUE 0x80240C80 Val_Wu16 655350.0 DDRCTime_ms 0.00 655350.0 FORMAT "%8.1" /end CHARACTERISTIC
/begin CHARACTERISTIC DDRC_DurDeb.Com_tiComflgTShntRngErr_CDebDef_C "" VALUE 0x80240C82 Val_Wu16 655350.0 DDRCTime_ms 0.00 655350.0 FORMAT "%8.1" /end CHARACTERISTIC
/begin CHARACTERISTIC DDRC_DurDeb.Com_tiComflgTShntSysErr_CDebOk_C "" VALUE 0x80240C84 Val_Wu16 655350.0 DDRCTime_ms 0.00 655350.0 FORMAT "%8.1" /end CHARACTERISTIC
/begin CHARACTERISTIC DDRC_DurDeb.Com_tiComflgTShntSysErr_CDebDef_C "" VALUE 0x80240C86 Val_Wu16 655350.0 DDRCTime_ms 0.00 655350.0 FORMAT "%8.1" /end CHARACTERISTIC
/begin CHARACTERISTIC DDRC_DurDeb.Com_tiComflgVoltMeasmtErr_CDebOk_C "" VALUE 0x80240C88 Val_Wu16 655350.0 DDRCTime_ms 0.00 655350.0 FORMAT "%8.1" /end CHARACTERISTIC
/begin CHARACTERISTIC DDRC_DurDeb.Com_tiComflgVoltMeasmtErr_CDebDef_C "" VALUE 0x80240C8A Val_Wu16 655350.0 DDRCTime_ms 0.00 655350.0 FORMAT "%8.1" /end CHARACTERISTIC
/begin CHARACTERISTIC DDRC_DurDeb.Com_tiComflgVoltMeasmtSysErr_CDebOk_C "" VALUE 0x80240C8C Val_Wu16 655350.0 DDRCTime_ms 0.00 655350.0 FORMAT "%8.1" /end CHARACTERISTIC
/begin CHARACTERISTIC DDRC_DurDeb.Com_tiComflgVoltMeasmtSysErr_CDebDef_C "" VALUE 0x80240C8E Val_Wu16 655350.0 DDRCTime_ms 0.00 655350.0 FORMAT "%8.1" /end CHARACTERISTIC
/begin CHARACTERISTIC DDRC_DurDeb.Com_tiComflgVoltMeasmtVld_CDebOk_C "" VALUE 0x80240C90 Val_Wu16 655350.0 DDRCTime_ms 0.00 655350.0 FORMAT "%8.1" /end CHARACTERISTIC
/begin CHARACTERISTIC DDRC_DurDeb.Com_tiComflgVoltMeasmtVld_CDebDef_C "" VALUE 0x80240C92 Val_Wu16 655350.0 DDRCTime_ms 0.00 655350.0 FORMAT "%8.1" /end CHARACTERISTIC
/begin CHARACTERISTIC DDRC_DurDeb.Com_tiComflgVoltRngErr_CDebOk_C "" VALUE 0x80240C94 Val_Wu16 655350.0 DDRCTime_ms 0.00 655350.0 FORMAT "%8.1" /end CHARACTERISTIC
/begin CHARACTERISTIC DDRC_DurDeb.Com_tiComflgVoltRngErr_CDebDef_C "" VALUE 0x80240C96 Val_Wu16 655350.0 DDRCTime_ms 0.00 655350.0 FORMAT "%8.1" /end CHARACTERISTIC
/begin CHARACTERISTIC DDRC_DurDeb.Com_tiETogFailrLvl3_CDebOk_C "" VALUE 0x80240C98 Val_Wu16 655350.0 DDRCTime_ms 0.00 655350.0 FORMAT "%8.1" /end CHARACTERISTIC
/begin CHARACTERISTIC DDRC_DurDeb.Com_tiETogFailrLvl3_CDebDef_C "" VALUE 0x80240C9A Val_Wu16 655350.0 DDRCTime_ms 0.00 655350.0 FORMAT "%8.1" /end CHARACTERISTIC
/begin CHARACTERISTIC DDRC_DurDeb.Com_tiETogFailrLvl4_CDebOk_C "" VALUE 0x80240C9C Val_Wu16 655350.0 DDRCTime_ms 0.00 655350.0 FORMAT "%8.1" /end CHARACTERISTIC
/begin CHARACTERISTIC DDRC_DurDeb.Com_tiETogFailrLvl4_CDebDef_C "" VALUE 0x80240C9E Val_Wu16 655350.0 DDRCTime_ms 0.00 655350.0 FORMAT "%8.1" /end CHARACTERISTIC
/begin CHARACTERISTIC DDRC_DurDeb.Com_tiHvbEVLmpBlink_CDebOk_C "" VALUE 0x80240CA0 Val_Wu16 655350.0 DDRCTime_ms 0.00 655350.0 FORMAT "%8.1" /end CHARACTERISTIC
/begin CHARACTERISTIC DDRC_DurDeb.Com_tiHvbEVLmpBlink_CDebDef_C "" VALUE 0x80240CA2 Val_Wu16 655350.0 DDRCTime_ms 0.00 655350.0 FORMAT "%8.1" /end CHARACTERISTIC
/begin CHARACTERISTIC DDRC_DurDeb.Com_tiHvbEVLmpCont_CDebOk_C "" VALUE 0x80240CA4 Val_Wu16 655350.0 DDRCTime_ms 0.00 655350.0 FORMAT "%8.1" /end CHARACTERISTIC
/begin CHARACTERISTIC DDRC_DurDeb.Com_tiHvbEVLmpCont_CDebDef_C "" VALUE 0x80240CA6 Val_Wu16 655350.0 DDRCTime_ms 0.00 655350.0 FORMAT "%8.1" /end CHARACTERISTIC
/begin CHARACTERISTIC DFC_CtlMsk2.DFC_AirbgCan_C "" VALUE 0x802412FA Val_Wu8 255.0 DFES_OneToOne 0.00 255.0 FORMAT "%5.1" /end CHARACTERISTIC
/begin CHARACTERISTIC DFC_CtlMsk2.DFC_ComChrgrEVCont_C "" VALUE 0x80241317 Val_Wu8 255.0 DFES_OneToOne 0.00 255.0 FORMAT "%5.1" /end CHARACTERISTIC
/begin CHARACTERISTIC DFC_CtlMsk2.DFC_ComChrgrEVtBlink_C "" VALUE 0x80241318 Val_Wu8 255.0 DFES_OneToOne 0.00 255.0 FORMAT "%5.1" /end CHARACTERISTIC
/begin CHARACTERISTIC DFC_CtlMsk2.DFC_ComChrgrMstBlink_C "" VALUE 0x80241319 Val_Wu8 255.0 DFES_OneToOne 0.00 255.0 FORMAT "%5.1" /end CHARACTERISTIC
/begin CHARACTERISTIC DFC_CtlMsk2.DFC_ComChrgrMstCont_C "" VALUE 0x8024131A Val_Wu8 255.0 DFES_OneToOne 0.00 255.0 FORMAT "%5.1" /end CHARACTERISTIC
/begin CHARACTERISTIC DFC_CtlMsk2.DFC_ComChrgrSVSBlink_C "" VALUE 0x8024131B Val_Wu8 255.0 DFES_OneToOne 0.00 255.0 FORMAT "%5.1" /end CHARACTERISTIC
/begin CHARACTERISTIC DFC_CtlMsk2.DFC_ComChrgrSVSCont_C "" VALUE 0x8024131C Val_Wu8 255.0 DFES_OneToOne 0.00 255.0 FORMAT "%5.1" /end CHARACTERISTIC
/begin CHARACTERISTIC DFC_CtlMsk2.DFC_ComDcdcEVBlink_C "" VALUE 0x8024131D Val_Wu8 255.0 DFES_OneToOne 0.00 255.0 FORMAT "%5.1" /end CHARACTERISTIC
/begin CHARACTERISTIC DFC_CtlMsk2.DFC_ComDcdcEVCont_C "" VALUE 0x8024131E Val_Wu8 255.0 DFES_OneToOne 0.00 255.0 FORMAT "%5.1" /end CHARACTERISTIC
/begin CHARACTERISTIC DFC_CtlMsk2.DFC_ComDcdcMstBlink_C "" VALUE 0x80241324 Val_Wu8 255.0 DFES_OneToOne 0.00 255.0 FORMAT "%5.1" /end CHARACTERISTIC
/begin CHARACTERISTIC DFC_CtlMsk2.DFC_ComDcdcMstCont_C "" VALUE 0x80241325 Val_Wu8 255.0 DFES_OneToOne 0.00 255.0 FORMAT "%5.1" /end CHARACTERISTIC
/begin CHARACTERISTIC DFC_CtlMsk2.DFC_ComDcdcSVSBlink_C "" VALUE 0x80241326 Val_Wu8 255.0 DFES_OneToOne 0.00 255.0 FORMAT "%5.1" /end CHARACTERISTIC
/begin CHARACTERISTIC DFC_CtlMsk2.DFC_ComDcdcSVSCont_C "" VALUE 0x80241327 Val_Wu8 255.0 DFES_OneToOne 0.00 255.0 FORMAT "%5.1" /end CHARACTERISTIC
/begin CHARACTERISTIC DFC_CtlMsk2.DFC_ComEmacEVBlink_C "" VALUE 0x8024132D Val_Wu8 255.0 DFES_OneToOne 0.00 255.0 FORMAT "%5.1" /end CHARACTERISTIC
/begin CHARACTERISTIC DFC_CtlMsk2.DFC_ComEmacEVCont_C "" VALUE 0x8024132E Val_Wu8 255.0 DFES_OneToOne 0.00 255.0 FORMAT "%5.1" /end CHARACTERISTIC
/begin CHARACTERISTIC DFC_CtlMsk2.DFC_ComEmacMstCont_C "" VALUE 0x8024132F Val_Wu8 255.0 DFES_OneToOne 0.00 255.0 FORMAT "%5.1" /end CHARACTERISTIC
/begin CHARACTERISTIC DFC_CtlMsk2.DFC_ComEmacMsttBlink_C "" VALUE 0x80241330 Val_Wu8 255.0 DFES_OneToOne 0.00 255.0 FORMAT "%5.1" /end CHARACTERISTIC
/begin CHARACTERISTIC DFC_CtlMsk2.DFC_ComEmacSVSBlink_C "" VALUE 0x80241331 Val_Wu8 255.0 DFES_OneToOne 0.00 255.0 FORMAT "%5.1" /end CHARACTERISTIC
/begin CHARACTERISTIC DFC_CtlMsk2.DFC_ComEmacSVSCont_C "" VALUE 0x80241332 Val_Wu8 255.0 DFES_OneToOne 0.00 255.0 FORMAT "%5.1" /end CHARACTERISTIC
/begin CHARACTERISTIC DFC_CtlMsk2.DFC_ComHvbMstBlink_C "" VALUE 0x8024133B Val_Wu8 255.0 DFES_OneToOne 0.00 255.0 FORMAT "%5.1" /end CHARACTERISTIC
/begin CHARACTERISTIC DFC_CtlMsk2.DFC_ComHvbMstCont_C "" VALUE 0x8024133C Val_Wu8 255.0 DFES_OneToOne 0.00 255.0 FORMAT "%5.1" /end CHARACTERISTIC
/begin CHARACTERISTIC DFC_CtlMsk2.DFC_ComflgCurMeasmtErr_C "" VALUE 0x80241348 Val_Wu8 255.0 DFES_OneToOne 0.00 255.0 FORMAT "%5.1" /end CHARACTERISTIC
/begin CHARACTERISTIC DFC_CtlMsk2.DFC_ComflgCurMeasmtSysErr_C "" VALUE 0x80241349 Val_Wu8 255.0 DFES_OneToOne 0.00 255.0 FORMAT "%5.1" /end CHARACTERISTIC
/begin CHARACTERISTIC DFC_CtlMsk2.DFC_ComflgCurMeasmtVld_C "" VALUE 0x8024134A Val_Wu8 255.0 DFES_OneToOne 0.00 255.0 FORMAT "%5.1" /end CHARACTERISTIC
/begin CHARACTERISTIC DFC_CtlMsk2.DFC_ComflgCurRngErr_C "" VALUE 0x8024134B Val_Wu8 255.0 DFES_OneToOne 0.00 255.0 FORMAT "%5.1" /end CHARACTERISTIC
/begin CHARACTERISTIC DFC_CtlMsk2.DFC_ComflgTPcbMeasmtErr_C "" VALUE 0x8024134C Val_Wu8 255.0 DFES_OneToOne 0.00 255.0 FORMAT "%5.1" /end CHARACTERISTIC
/begin CHARACTERISTIC DFC_CtlMsk2.DFC_ComflgTPcbMeasmtVld_C "" VALUE 0x8024134D Val_Wu8 255.0 DFES_OneToOne 0.00 255.0 FORMAT "%5.1" /end CHARACTERISTIC
/begin CHARACTERISTIC DFC_CtlMsk2.DFC_ComflgTPcbRngErr_C "" VALUE 0x8024134E Val_Wu8 255.0 DFES_OneToOne 0.00 255.0 FORMAT "%5.1" /end CHARACTERISTIC
/begin CHARACTERISTIC DFC_CtlMsk2.DFC_ComflgTPcbSysErr_C "" VALUE 0x8024134F Val_Wu8 255.0 DFES_OneToOne 0.00 255.0 FORMAT "%5.1" /end CHARACTERISTIC
/begin CHARACTERISTIC DFC_CtlMsk2.DFC_ComflgTShntMeasmtErr_C "" VALUE 0x80241350 Val_Wu8 255.0 DFES_OneToOne 0.00 255.0 FORMAT "%5.1" /end CHARACTERISTIC
/begin CHARACTERISTIC DFC_CtlMsk2.DFC_ComflgTShntMeasmtVld_C "" VALUE 0x80241351 Val_Wu8 255.0 DFES_OneToOne 0.00 255.0 FORMAT "%5.1" /end CHARACTERISTIC
/begin CHARACTERISTIC DFC_CtlMsk2.DFC_ComflgTShntRngErr_C "" VALUE 0x80241352 Val_Wu8 255.0 DFES_OneToOne 0.00 255.0 FORMAT "%5.1" /end CHARACTERISTIC
/begin CHARACTERISTIC DFC_CtlMsk2.DFC_ComflgTShntSysErr_C "" VALUE 0x80241353 Val_Wu8 255.0 DFES_OneToOne 0.00 255.0 FORMAT "%5.1" /end CHARACTERISTIC
/begin CHARACTERISTIC DFC_CtlMsk2.DFC_ComflgVoltMeasmtErr_C "" VALUE 0x80241354 Val_Wu8 255.0 DFES_OneToOne 0.00 255.0 FORMAT "%5.1" /end CHARACTERISTIC
/begin CHARACTERISTIC DFC_CtlMsk2.DFC_ComflgVoltMeasmtSysErr_C "" VALUE 0x80241355 Val_Wu8 255.0 DFES_OneToOne 0.00 255.0 FORMAT "%5.1" /end CHARACTERISTIC
/begin CHARACTERISTIC DFC_CtlMsk2.DFC_ComflgVoltMeasmtVld_C "" VALUE 0x80241356 Val_Wu8 255.0 DFES_OneToOne 0.00 255.0 FORMAT "%5.1" /end CHARACTERISTIC
/begin CHARACTERISTIC DFC_CtlMsk2.DFC_ComflgVoltRngErr_C "" VALUE 0x80241357 Val_Wu8 255.0 DFES_OneToOne 0.00 255.0 FORMAT "%5.1" /end CHARACTERISTIC
/begin CHARACTERISTIC DFC_CtlMsk2.DFC_ETogFailrLvl3_C "" VALUE 0x80241361 Val_Wu8 255.0 DFES_OneToOne 0.00 255.0 FORMAT "%5.1" /end CHARACTERISTIC
/begin CHARACTERISTIC DFC_CtlMsk2.DFC_ETogFailrLvl4_C "" VALUE 0x80241362 Val_Wu8 255.0 DFES_OneToOne 0.00 255.0 FORMAT "%5.1" /end CHARACTERISTIC
/begin CHARACTERISTIC DFC_CtlMsk2.DFC_HvbEVLmpBlink_C "" VALUE 0x8024138D Val_Wu8 255.0 DFES_OneToOne 0.00 255.0 FORMAT "%5.1" /end CHARACTERISTIC
/begin CHARACTERISTIC DFC_CtlMsk2.DFC_HvbEVLmpCont_C "" VALUE 0x8024138E Val_Wu8 255.0 DFES_OneToOne 0.00 255.0 FORMAT "%5.1" /end CHARACTERISTIC
/begin CHARACTERISTIC DFC_DisblMsk2.DFC_AirbgCan_C "" VALUE 0x80248ADA Val_Wu16 65535.00 DFES_OneToOne 0.00 65535.00 FORMAT "%8.2" /end CHARACTERISTIC
/begin CHARACTERISTIC DFC_DisblMsk2.DFC_ComChrgrEVCont_C "" VALUE 0x80248B14 Val_Wu16 65535.00 DFES_OneToOne 0.00 65535.00 FORMAT "%8.2" /end CHARACTERISTIC
/begin CHARACTERISTIC DFC_DisblMsk2.DFC_ComChrgrEVtBlink_C "" VALUE 0x80248B16 Val_Wu16 65535.00 DFES_OneToOne 0.00 65535.00 FORMAT "%8.2" /end CHARACTERISTIC
/begin CHARACTERISTIC DFC_DisblMsk2.DFC_ComChrgrMstBlink_C "" VALUE 0x80248B18 Val_Wu16 65535.00 DFES_OneToOne 0.00 65535.00 FORMAT "%8.2" /end CHARACTERISTIC
/begin CHARACTERISTIC DFC_DisblMsk2.DFC_ComChrgrMstCont_C "" VALUE 0x80248B1A Val_Wu16 65535.00 DFES_OneToOne 0.00 65535.00 FORMAT "%8.2" /end CHARACTERISTIC
/begin CHARACTERISTIC DFC_DisblMsk2.DFC_ComChrgrSVSBlink_C "" VALUE 0x80248B1C Val_Wu16 65535.00 DFES_OneToOne 0.00 65535.00 FORMAT "%8.2" /end CHARACTERISTIC
/begin CHARACTERISTIC DFC_DisblMsk2.DFC_ComChrgrSVSCont_C "" VALUE 0x80248B1E Val_Wu16 65535.00 DFES_OneToOne 0.00 65535.00 FORMAT "%8.2" /end CHARACTERISTIC
/begin CHARACTERISTIC DFC_DisblMsk2.DFC_ComDcdcEVBlink_C "" VALUE 0x80248B20 Val_Wu16 65535.00 DFES_OneToOne 0.00 65535.00 FORMAT "%8.2" /end CHARACTERISTIC
/begin CHARACTERISTIC DFC_DisblMsk2.DFC_ComDcdcEVCont_C "" VALUE 0x80248B22 Val_Wu16 65535.00 DFES_OneToOne 0.00 65535.00 FORMAT "%8.2" /end CHARACTERISTIC
/begin CHARACTERISTIC DFC_DisblMsk2.DFC_ComDcdcMstBlink_C "" VALUE 0x80248B2E Val_Wu16 65535.00 DFES_OneToOne 0.00 65535.00 FORMAT "%8.2" /end CHARACTERISTIC
/begin CHARACTERISTIC DFC_DisblMsk2.DFC_ComDcdcMstCont_C "" VALUE 0x80248B30 Val_Wu16 65535.00 DFES_OneToOne 0.00 65535.00 FORMAT "%8.2" /end CHARACTERISTIC
/begin CHARACTERISTIC DFC_DisblMsk2.DFC_ComDcdcSVSBlink_C "" VALUE 0x80248B32 Val_Wu16 65535.00 DFES_OneToOne 0.00 65535.00 FORMAT "%8.2" /end CHARACTERISTIC
/begin CHARACTERISTIC DFC_DisblMsk2.DFC_ComDcdcSVSCont_C "" VALUE 0x80248B34 Val_Wu16 65535.00 DFES_OneToOne 0.00 65535.00 FORMAT "%8.2" /end CHARACTERISTIC
/begin CHARACTERISTIC DFC_DisblMsk2.DFC_ComEmacEVBlink_C "" VALUE 0x80248B40 Val_Wu16 65535.00 DFES_OneToOne 0.00 65535.00 FORMAT "%8.2" /end CHARACTERISTIC
/begin CHARACTERISTIC DFC_DisblMsk2.DFC_ComEmacEVCont_C "" VALUE 0x80248B42 Val_Wu16 65535.00 DFES_OneToOne 0.00 65535.00 FORMAT "%8.2" /end CHARACTERISTIC
/begin CHARACTERISTIC DFC_DisblMsk2.DFC_ComEmacMstCont_C "" VALUE 0x80248B44 Val_Wu16 65535.00 DFES_OneToOne 0.00 65535.00 FORMAT "%8.2" /end CHARACTERISTIC
/begin CHARACTERISTIC DFC_DisblMsk2.DFC_ComEmacMsttBlink_C "" VALUE 0x80248B46 Val_Wu16 65535.00 DFES_OneToOne 0.00 65535.00 FORMAT "%8.2" /end CHARACTERISTIC
/begin CHARACTERISTIC DFC_DisblMsk2.DFC_ComEmacSVSBlink_C "" VALUE 0x80248B48 Val_Wu16 65535.00 DFES_OneToOne 0.00 65535.00 FORMAT "%8.2" /end CHARACTERISTIC
/begin CHARACTERISTIC DFC_DisblMsk2.DFC_ComEmacSVSCont_C "" VALUE 0x80248B4A Val_Wu16 65535.00 DFES_OneToOne 0.00 65535.00 FORMAT "%8.2" /end CHARACTERISTIC
/begin CHARACTERISTIC DFC_DisblMsk2.DFC_ComHvbMstBlink_C "" VALUE 0x80248B5C Val_Wu16 65535.00 DFES_OneToOne 0.00 65535.00 FORMAT "%8.2" /end CHARACTERISTIC
/begin CHARACTERISTIC DFC_DisblMsk2.DFC_ComHvbMstCont_C "" VALUE 0x80248B5E Val_Wu16 65535.00 DFES_OneToOne 0.00 65535.00 FORMAT "%8.2" /end CHARACTERISTIC
/begin CHARACTERISTIC DFC_DisblMsk2.DFC_ComflgCurMeasmtErr_C "" VALUE 0x80248B76 Val_Wu16 65535.00 DFES_OneToOne 0.00 65535.00 FORMAT "%8.2" /end CHARACTERISTIC
/begin CHARACTERISTIC DFC_DisblMsk2.DFC_ComflgCurMeasmtSysErr_C "" VALUE 0x80248B78 Val_Wu16 65535.00 DFES_OneToOne 0.00 65535.00 FORMAT "%8.2" /end CHARACTERISTIC
/begin CHARACTERISTIC DFC_DisblMsk2.DFC_ComflgCurMeasmtVld_C "" VALUE 0x80248B7A Val_Wu16 65535.00 DFES_OneToOne 0.00 65535.00 FORMAT "%8.2" /end CHARACTERISTIC
/begin CHARACTERISTIC DFC_DisblMsk2.DFC_ComflgCurRngErr_C "" VALUE 0x80248B7C Val_Wu16 65535.00 DFES_OneToOne 0.00 65535.00 FORMAT "%8.2" /end CHARACTERISTIC
/begin CHARACTERISTIC DFC_DisblMsk2.DFC_ComflgTPcbMeasmtErr_C "" VALUE 0x80248B7E Val_Wu16 65535.00 DFES_OneToOne 0.00 65535.00 FORMAT "%8.2" /end CHARACTERISTIC
/begin CHARACTERISTIC DFC_DisblMsk2.DFC_ComflgTPcbMeasmtVld_C "" VALUE 0x80248B80 Val_Wu16 65535.00 DFES_OneToOne 0.00 65535.00 FORMAT "%8.2" /end CHARACTERISTIC
/begin CHARACTERISTIC DFC_DisblMsk2.DFC_ComflgTPcbRngErr_C "" VALUE 0x80248B82 Val_Wu16 65535.00 DFES_OneToOne 0.00 65535.00 FORMAT "%8.2" /end CHARACTERISTIC
/begin CHARACTERISTIC DFC_DisblMsk2.DFC_ComflgTPcbSysErr_C "" VALUE 0x80248B84 Val_Wu16 65535.00 DFES_OneToOne 0.00 65535.00 FORMAT "%8.2" /end CHARACTERISTIC
/begin CHARACTERISTIC DFC_DisblMsk2.DFC_ComflgTShntMeasmtErr_C "" VALUE 0x80248B86 Val_Wu16 65535.00 DFES_OneToOne 0.00 65535.00 FORMAT "%8.2" /end CHARACTERISTIC
/begin CHARACTERISTIC DFC_DisblMsk2.DFC_ComflgTShntMeasmtVld_C "" VALUE 0x80248B88 Val_Wu16 65535.00 DFES_OneToOne 0.00 65535.00 FORMAT "%8.2" /end CHARACTERISTIC
/begin CHARACTERISTIC DFC_DisblMsk2.DFC_ComflgTShntRngErr_C "" VALUE 0x80248B8A Val_Wu16 65535.00 DFES_OneToOne 0.00 65535.00 FORMAT "%8.2" /end CHARACTERISTIC
/begin CHARACTERISTIC DFC_DisblMsk2.DFC_ComflgTShntSysErr_C "" VALUE 0x80248B8C Val_Wu16 65535.00 DFES_OneToOne 0.00 65535.00 FORMAT "%8.2" /end CHARACTERISTIC
/begin CHARACTERISTIC DFC_DisblMsk2.DFC_ComflgVoltMeasmtErr_C "" VALUE 0x80248B8E Val_Wu16 65535.00 DFES_OneToOne 0.00 65535.00 FORMAT "%8.2" /end CHARACTERISTIC
/begin CHARACTERISTIC DFC_DisblMsk2.DFC_ComflgVoltMeasmtSysErr_C "" VALUE 0x80248B90 Val_Wu16 65535.00 DFES_OneToOne 0.00 65535.00 FORMAT "%8.2" /end CHARACTERISTIC
/begin CHARACTERISTIC DFC_DisblMsk2.DFC_ComflgVoltMeasmtVld_C "" VALUE 0x80248B92 Val_Wu16 65535.00 DFES_OneToOne 0.00 65535.00 FORMAT "%8.2" /end CHARACTERISTIC
/begin CHARACTERISTIC DFC_DisblMsk2.DFC_ComflgVoltRngErr_C "" VALUE 0x80248B94 Val_Wu16 65535.00 DFES_OneToOne 0.00 65535.00 FORMAT "%8.2" /end CHARACTERISTIC
/begin CHARACTERISTIC DFC_DisblMsk2.DFC_ETogFailrLvl3_C "" VALUE 0x80248BA8 Val_Wu16 65535.00 DFES_OneToOne 0.00 65535.00 FORMAT "%8.2" /end CHARACTERISTIC
/begin CHARACTERISTIC DFC_DisblMsk2.DFC_ETogFailrLvl4_C "" VALUE 0x80248BAA Val_Wu16 65535.00 DFES_OneToOne 0.00 65535.00 FORMAT "%8.2" /end CHARACTERISTIC
/begin CHARACTERISTIC DFC_DisblMsk2.DFC_HvbEVLmpBlink_C "" VALUE 0x80248C00 Val_Wu16 65535.00 DFES_OneToOne 0.00 65535.00 FORMAT "%8.2" /end CHARACTERISTIC
/begin CHARACTERISTIC DFC_DisblMsk2.DFC_HvbEVLmpCont_C "" VALUE 0x80248C02 Val_Wu16 65535.00 DFES_OneToOne 0.00 65535.00 FORMAT "%8.2" /end CHARACTERISTIC
/begin CHARACTERISTIC DrvPrgSwt_stRcpt_C "Parameter Gear Position not in D" VALUE 0x802515BC RB_Val_Wu8 255.0 OneToOne 0.00 255.0 FORMAT "%5.1" /end CHARACTERISTIC
/begin CHARACTERISTIC ElM_pwrElecPredTracMaxLo_C "" VALUE 0x802515BE RB_Val_Ws16 1638375. RBPtCel_pwr_25p0_1 -819200.0 819175.0 FORMAT "%8.1" /end CHARACTERISTIC
/begin CHARACTERISTIC Emac_tqDesCom02_C "Calibration for Emac_tqDesCom02 (desired torque e-machine 02)" VALUE 0x802515C0 RB_Val_Ws16 6553.500 Trq -3276.800 3276.700 FORMAT "%8.3" /end CHARACTERISTIC
/begin CHARACTERISTIC EnvT_t_C "Ambient air temp parameter" VALUE 0x802515C2 RB_Val_Ws16 6553.500 Temp_Cels -3549.940 3003.560 FORMAT "%8.3" /end CHARACTERISTIC
/begin CHARACTERISTIC EnvT_t_Sq_C "This is SW-CALPRM" VALUE 0x802515C4 RB_Val_Wu8 15.0000000000 SigQly_COMPU_VERB 0.00 15.0000000000 FORMAT "%13.10" /end CHARACTERISTIC
/begin CHARACTERISTIC Epm_nEngLRes_C "calibration for message Epm_nEngLRes" VALUE 0x802515C5 RB_Val_Wu8 10200. EngN_LRes 0.00 10200. FORMAT "%5.0" /end CHARACTERISTIC
/begin CHARACTERISTIC Epm_nEng_C "Calibratabel value for Engine Speed" VALUE 0x802515C6 RB_Val_Ws16 32767.50 EngN -16384.00 16383.50 FORMAT "%8.2" /end CHARACTERISTIC
/begin CHARACTERISTIC Epm_numCyl_C "Actual number of cylinder" VALUE 0x802515C8 RB_Val_Ws8 255.0 OneToOne -128.0 127.0 FORMAT "%5.1" /end CHARACTERISTIC
/begin CHARACTERISTIC Epm_stSpd_C "Epm_stSpd" VALUE 0x802515C9 RB_Val_Wu8 4.00000000000 Epm_stSpd_t 0.00 4.00000000000 FORMAT "%13.11" /end CHARACTERISTIC
/begin CHARACTERISTIC ExhMod_pRelPfilDs_C "Swadp for Modelled relative pressure downstream of particulate filter" VALUE 0x802515CA RB_Val_Ws16 65535.00 Pres_hPa -32768.00 32767.00 FORMAT "%8.2" /end CHARACTERISTIC
/begin CHARACTERISTIC Ext_bCalidEmCf_C "parameter of Ext_bCalidEmCf" VALUE 0x802515CC RB_Val_Wu8 1.00000000000 B_TRUE 0.00 1.00000000000 FORMAT "%13.11" /end CHARACTERISTIC
/begin CHARACTERISTIC Ext_bFctHldReqCdn_C "" VALUE 0x802515CD RB_Val_Wu8 1.00000000000 B_TRUE 0.00 1.00000000000 FORMAT "%13.11" /end CHARACTERISTIC
/begin CHARACTERISTIC fmsdhfs_w_msg_C "" VALUE 0x802515CE RB_Val_Wu16 3.999939 fak_uw_b4 0.00 3.999939 FORMAT "%8.6" /end CHARACTERISTIC
/begin CHARACTERISTIC ftu_msg_C "" VALUE 0x802515D0 RB_Val_Wu8 1.992188 fak_ub_b2 0.00 1.992188 FORMAT "%8.6" /end CHARACTERISTIC
/begin CHARACTERISTIC GbxPos_flgCustSpcCdn_C "" VALUE 0x802515D1 RB_Val_Wu8 1.00000000000 B_TRUE 0.00 1.00000000000 FORMAT "%13.11" /end CHARACTERISTIC
/begin CHARACTERISTIC GbxPos_stGearLvrPos_c "" VALUE 0x802515D2 RB_Val_Wu8 255.0 OneToOne 0.00 255.0 FORMAT "%5.1" /end CHARACTERISTIC
/begin CHARACTERISTIC GlbDa_lWhlCirc_C "parameter for wheel circumference" VALUE 0x802515D4 RB_Val_Ws16 65.53500 Length_fine -32.76800 32.76700 FORMAT "%8.5" /end CHARACTERISTIC
/begin CHARACTERISTIC GlbDa_rdWhl_C "Radius of wheel depending upon vehcile" VALUE 0x802515D6 RB_Val_Ws16 65.53500 LengthFine -32.76800 32.76700 FORMAT "%8.5" /end CHARACTERISTIC
/begin CHARACTERISTIC GlbDa_stTrqDem_C "Calibration parameter which contains highest prior function with torque demand" VALUE 0x802515D8 RB_Val_Wu16 65535.00 OneToOne 0.00 65535.00 FORMAT "%8.2" /end CHARACTERISTIC
/begin CHARACTERISTIC HndBrk_stDebVal_C "Calibration for Debounced value of Hand Brake switch" VALUE 0x802515DA RB_Val_Wu8 255.0 OneToOne 0.00 255.0 FORMAT "%5.1" /end CHARACTERISTIC
/begin CHARACTERISTIC HvBatt_egyAvlTot_f_C "" VALUE 0x802515DC RB_Val_Wr32 2.00000000E+037 RBPtCel_pwr_1p0_4 -1.00000000E+037 1.00000000E+037 FORMAT "%13.3" EXTENDED_LIMITS -3.40282347E+038 3.40282347E+038 /end CHARACTERISTIC
/begin CHARACTERISTIC InjCtl_qSetUnBal_C "current injection quantity" VALUE 0x802515E0 RB_Val_Ws16 655.3500 InjMass -327.6800 327.6700 FORMAT "%8.4" /end CHARACTERISTIC
/begin CHARACTERISTIC IntlckChrgPlg_rDesVal_C "" VALUE 0x802515E2 RB_Val_Ws16 799.9878 Prc -400.0000 399.9878 FORMAT "%8.4" /end CHARACTERISTIC
/begin CHARACTERISTIC MoFDrvrAssc_flgDrvrAsscPtdMsg_C "calibration for message MoFDrvrAssc_flgDrvrAsscPtdMsg" VALUE 0x802515E4 RB_Val_Wu8 1.00000000000 B_TRUE 0.00 1.00000000000 FORMAT "%13.11" /end CHARACTERISTIC
/begin CHARACTERISTIC MoFEmgOff_stPWMCrashDeploy_C "" VALUE 0x802515E5 RB_Val_Wu8 255.0 OneToOne 0.00 255.0 FORMAT "%5.1" /end CHARACTERISTIC
/begin CHARACTERISTIC mshfmdk_w_msg_C "" VALUE 0x802515E6 RB_Val_Wu16 6553.500 m_uw_b6553p5 0.00 6553.500 FORMAT "%8.3" /end CHARACTERISTIC
/begin CHARACTERISTIC ofpu_w_msg_C "" VALUE 0x802515E8 RB_Val_Ws16 2559.961 p_q0p039 -1280.000 1279.961 FORMAT "%8.3" /end CHARACTERISTIC
/begin CHARACTERISTIC PCR_pDesVal_C "desired boost pressure" VALUE 0x802515EA RB_Val_Ws16 65535.00 Pres_hPa -32768.00 32767.00 FORMAT "%8.2" /end CHARACTERISTIC
/begin CHARACTERISTIC PThrVlvUs_pB1_C "" VALUE 0x802515EC RB_Val_Wu16 5119.922 p_q0p078 0.00 5119.922 FORMAT "%8.3" /end CHARACTERISTIC
/begin CHARACTERISTIC SCtPmp1T_t_C "" VALUE 0x802515EE RB_Val_Ws16 6553.500 Temp_Cels -3549.940 3003.560 FORMAT "%8.3" /end CHARACTERISTIC
/begin CHARACTERISTIC StabyIntv_flgDCSIntv01_C "" VALUE 0x802515F0 RB_Val_Wu8 1.00000000000 B_TRUE 0.00 1.00000000000 FORMAT "%13.11" /end CHARACTERISTIC
/begin CHARACTERISTIC StabyIntv_flgTCSIntv01_C "" VALUE 0x802515F1 RB_Val_Wu8 1.00000000000 B_TRUE 0.00 1.00000000000 FORMAT "%13.11" /end CHARACTERISTIC
/begin CHARACTERISTIC StabyIntv_tqDCSDes01_C "Substitution val for StabyIntv_tqDCSDes01" VALUE 0x802515F4 RB_Val_Ws32 429496729.500 TrqPrpHigh -214748364.800 214748364.700 FORMAT "%13.3" /end CHARACTERISTIC
/begin CHARACTERISTIC StabyIntv_tqTCSDes01_C "substitution val for StabyIntv_tqTCSDes01" VALUE 0x802515F8 RB_Val_Ws32 429496729.500 TrqPrpHigh -214748364.800 214748364.700 FORMAT "%13.3" /end CHARACTERISTIC
/begin CHARACTERISTIC T15_bECUTyp_C "Configuration of the ECU Type (0: APC, 1: RCD)" VALUE 0x802515FC RB_Val_Wu8 1.00000000000 B_TRUE 0.00 1.00000000000 FORMAT "%13.11" /end CHARACTERISTIC
/begin CHARACTERISTIC ThrVlv_ratActPosnB1_C "Calibration for Autosar named Actuatorposition" VALUE 0x802515FE RB_Val_Ws16 511.9922 rel_q0p0078125 -256.0000 255.9922 FORMAT "%8.4" /end CHARACTERISTIC
/begin CHARACTERISTIC ThS_tCbnAct_C "Calibration value for the actual cabin temperature." VALUE 0x80251600 RB_Val_Ws16 6553.500 Temp_Cels -3549.940 3003.560 FORMAT "%8.3" /end CHARACTERISTIC
/begin CHARACTERISTIC VehCoorn_stEngIdleShtDwn_C "" VALUE 0x80251602 RB_Val_Wu8 255.0 q1 0.00 255.0 FORMAT "%5.1" /end CHARACTERISTIC
/begin CHARACTERISTIC VehCoorn_wElecCnsPrpLongAvrg_C "" VALUE 0x80251604 RB_Val_Wr32 2.00000000E+037 q1_W_s_DIV_m -1.00000000E+037 1.00000000E+037 FORMAT "%13.3" EXTENDED_LIMITS -3.40282347E+038 3.40282347E+038 /end CHARACTERISTIC
/begin CHARACTERISTIC VehDrvEv_tqSecAxleDes_C "Calibration for VehDrvEv_tqSecAxleDes (desired secondary axle torque)" VALUE 0x80251608 RB_Val_Ws32 429496729.500 TrqPrpHigh -214748364.800 214748364.700 FORMAT "%13.3" /end CHARACTERISTIC
/begin CHARACTERISTIC VehMot_stPrpAccPed_C "calibration for Status of propulsion demand by driver demand" VALUE 0x8025160C RB_Val_Wu8 1.00000000000 B_TRUE 0.00 1.00000000000 FORMAT "%13.11" /end CHARACTERISTIC
/begin CHARACTERISTIC VMSIEv_tqDesPrpInhb01_C "" VALUE 0x80251610 RB_Val_Ws32 429496729.500 TrqPrpHigh -214748364.800 214748364.700 FORMAT "%13.3" /end CHARACTERISTIC
/begin CHARACTERISTIC VMSIEv_tqDesRecupInhb01_C "" VALUE 0x80251614 RB_Val_Ws32 429496729.500 TrqPrpHigh -214748364.800 214748364.700 FORMAT "%13.3" /end CHARACTERISTIC
/begin MEASUREMENT AccPed_facRecupLvrLimd "Limited factor of recuperation lever" SWORD Fact 1 100 -4.000000 3.999878 FORMAT "%8.6" ECU_ADDRESS 0x70001574
 /begin IF_DATA XCPplus 0x0102
  /begin DAQ_EVENT VARIABLE /end DAQ_EVENT
 /end IF_DATA
/end MEASUREMENT
/begin MEASUREMENT ACSwt_stSwt "AC status flag" UBYTE OneToOne 1 100 0.00 255.0 FORMAT "%5.1" ECU_ADDRESS 0x700014FF
 /begin IF_DATA XCPplus 0x0102
  /begin DAQ_EVENT VARIABLE /end DAQ_EVENT
 /end IF_DATA
/end MEASUREMENT
/begin MEASUREMENT ACSwt_tCbnSp "Cabin temperature setpoint of the AC" SWORD Temp_Cels 1 100 -3549.940 3003.560 FORMAT "%8.3" ECU_ADDRESS 0x70001578
 /begin IF_DATA XCPplus 0x0102
  /begin DAQ_EVENT VARIABLE /end DAQ_EVENT
 /end IF_DATA
/end MEASUREMENT
/begin MEASUREMENT AFS_mAirPerCyl "Air mass per cylinder" SWORD AirMassPerCyl 1 100 -3276.800 3276.700 FORMAT "%8.3" ECU_ADDRESS 0x70001576
 /begin IF_DATA XCPplus 0x0102
  /begin DAQ_EVENT VARIABLE /end DAQ_EVENT
 /end IF_DATA
/end MEASUREMENT
/begin MEASUREMENT BrkECU_flgBrkEcuIntv "Break ECU intervention" UBYTE B_TRUE 1 100 0.00 1.00000000000 BIT_MASK 0x1 FORMAT "%13.11" ECU_ADDRESS 0x700014AD
 /begin IF_DATA XCPplus 0x0102
  /begin DAQ_EVENT VARIABLE /end DAQ_EVENT
 /end IF_DATA
/end MEASUREMENT
/begin MEASUREMENT BrkgToZr_flgActvd "flag for indication if braking to zero is active or inactive" UBYTE B_TRUE 1 100 0.00 1.00000000000 BIT_MASK 0x1 FORMAT "%13.11" ECU_ADDRESS 0x700014AC
 /begin IF_DATA XCPplus 0x0102
  /begin DAQ_EVENT VARIABLE /end DAQ_EVENT
 /end IF_DATA
/end MEASUREMENT
/begin MEASUREMENT BrkgToZr_flgPredActvn "Flag to indicate the status of predicted activation for transition to Hillhold Mode" UBYTE B_TRUE 1 100 0.00 1.00000000000 BIT_MASK 0x1 FORMAT "%13.11" ECU_ADDRESS 0x700014AB
 /begin IF_DATA XCPplus 0x0102
  /begin DAQ_EVENT VARIABLE /end DAQ_EVENT
 /end IF_DATA
/end MEASUREMENT
/begin MEASUREMENT BrkgToZr_nDes01 "EM01 engine speed setpoint request" SWORD nmot_q1 1 100 -32768.00 32767.00 FORMAT "%8.2" ECU_ADDRESS 0x70001572
 /begin IF_DATA XCPplus 0x0102
  /begin DAQ_EVENT VARIABLE /end DAQ_EVENT
 /end IF_DATA
/end MEASUREMENT
/begin MEASUREMENT BrkgToZr_tqHillHldRamp "E-machine hillhold Ramp torque for ebraking to zero" SLONG TrqPrpHigh 1 100 -214748364.800 214748364.700 FORMAT "%13.3" ECU_ADDRESS 0x700015C0
 /begin IF_DATA XCPplus 0x0102
  /begin DAQ_EVENT VARIABLE /end DAQ_EVENT
 /end IF_DATA
/end MEASUREMENT
/begin MEASUREMENT BrkTqEv_tqRcptSecAxle "requested brake torque of the secondary axle" SLONG TrqPrpHigh 1 100 -214748364.800 214748364.700 FORMAT "%13.3" ECU_ADDRESS 0x700015C4
 /begin IF_DATA XCPplus 0x0102
  /begin DAQ_EVENT VARIABLE /end DAQ_EVENT
 /end IF_DATA
/end MEASUREMENT
/begin MEASUREMENT Brk_r_Sq "Signal Quality of Brake pedal ratio" UBYTE SigQly_COMPU_VERB 1 100 0.00 15.0000000000 FORMAT "%13.10" ECU_ADDRESS 0x700014FE
 /begin IF_DATA XCPplus 0x0102
  /begin DAQ_EVENT VARIABLE /end DAQ_EVENT
 /end IF_DATA
/end MEASUREMENT
/begin MEASUREMENT B_fgfmsdh_msg "enable condition factor air mass flow based on throttle angle and main load sensor" UBYTE B_TRUE 1 100 0.00 1.00000000000 BIT_MASK 0x1 FORMAT "%13.11" ECU_ADDRESS 0x700014AF
 /begin IF_DATA XCPplus 0x0102
  /begin DAQ_EVENT VARIABLE /end DAQ_EVENT
 /end IF_DATA
/end MEASUREMENT
/begin MEASUREMENT B_msdkhfmg_msg "Condition Mass flow at the DK calculated from the sensor signal of the HFM valid" UBYTE B_TRUE 1 100 0.00 1.00000000000 BIT_MASK 0x1 FORMAT "%13.11" ECU_ADDRESS 0x700014AE
 /begin IF_DATA XCPplus 0x0102
  /begin DAQ_EVENT VARIABLE /end DAQ_EVENT
 /end IF_DATA
/end MEASUREMENT
/begin MEASUREMENT CbnHeatgHeatr_cntrPosCntctOper "" ULONG OneToOne 1 100 0.00 4294967295.00 FORMAT "%13.2" ECU_ADDRESS 0x7000158C
 /begin IF_DATA XCPplus 0x0102
  /begin DAQ_EVENT VARIABLE /end DAQ_EVENT
 /end IF_DATA
/end MEASUREMENT
/begin MEASUREMENT CcsAcCtrl_stChrgn "Charge control state" UBYTE ChrgCtrl_stChrgn_VERB 1 100 0.00 6.00000000000 FORMAT "%13.11" ECU_ADDRESS 0x700014FD
 /begin IF_DATA XCPplus 0x0102
  /begin DAQ_EVENT VARIABLE /end DAQ_EVENT
 /end IF_DATA
/end MEASUREMENT
/begin MEASUREMENT CcsDcCtrl_stChrgn "Active charging state" UBYTE ChrgCtrl_stChrgn_VERB 1 100 0.00 6.00000000000 FORMAT "%13.11" ECU_ADDRESS 0x700014FC
 /begin IF_DATA XCPplus 0x0102
  /begin DAQ_EVENT VARIABLE /end DAQ_EVENT
 /end IF_DATA
/end MEASUREMENT
/begin MEASUREMENT CcsPlg_stPlgLockCmd "Lock and unlock request of charge plug interlock control" UBYTE ChrgIf_stPlgLockCmd_VERB 1 100 0.00 2.00000000000 FORMAT "%13.11" ECU_ADDRESS 0x700014FB
 /begin IF_DATA XCPplus 0x0102
  /begin DAQ_EVENT VARIABLE /end DAQ_EVENT
 /end IF_DATA
/end MEASUREMENT
/begin MEASUREMENT Clth_st "Debounced status of Clutch" UBYTE q1 1 100 0.00 255.0 FORMAT "%5.1" ECU_ADDRESS 0x700014F8
 /begin IF_DATA XCPplus 0x0102
  /begin DAQ_EVENT VARIABLE /end DAQ_EVENT
 /end IF_DATA
/end MEASUREMENT
/begin MEASUREMENT CoEng_stMaiOld "Predecessor state of the current CoEng_stMai value" UWORD CoEng_stMai_VERB 1 100 0.00 16384.0000000 FORMAT "%13.7" ECU_ADDRESS 0x70001516
 /begin IF_DATA XCPplus 0x0102
  /begin DAQ_EVENT VARIABLE /end DAQ_EVENT
 /end IF_DATA
/end MEASUREMENT
/begin MEASUREMENT CoEng_stOld "engine state before current state was reached" UBYTE CoEng_st_COMPU_VERB 1 100 0.00 5.00000000000 FORMAT "%13.11" ECU_ADDRESS 0x700014F7
 /begin IF_DATA XCPplus 0x0102
  /begin DAQ_EVENT VARIABLE /end DAQ_EVENT
 /end IF_DATA
/end MEASUREMENT
/begin MEASUREMENT CoEng_tiNormal "time since running state was reached" ULONG Time_ms 1 100 0.00 42949672950.0 FORMAT "%13.1" ECU_ADDRESS 0x70001588
 /begin IF_DATA XCPplus 0x0102
  /begin DAQ_EVENT VARIABLE /end DAQ_EVENT
 /end IF_DATA
/end MEASUREMENT
/begin MEASUREMENT CoETS_rTrq "Calculated load value" SWORD Prc 1 100 -400.0000 399.9878 FORMAT "%8.4" ECU_ADDRESS 0x7000156E
 /begin IF_DATA XCPplus 0x0102
  /begin DAQ_EVENT VARIABLE /end DAQ_EVENT
 /end IF_DATA
/end MEASUREMENT
/begin MEASUREMENT ComChrgn_flgFltIDcRly "qualifier for DC charging current" UBYTE B_TRUE 1 100 0.00 1.00000000000 BIT_MASK 0x1 FORMAT "%13.11" ECU_ADDRESS 0x700014A8
 /begin IF_DATA XCPplus 0x0102
  /begin DAQ_EVENT VARIABLE /end DAQ_EVENT
 /end IF_DATA
/end MEASUREMENT
/begin MEASUREMENT ComChrgn_flgFltUDcRly "error flag for DC charging voltage" UBYTE B_TRUE 1 100 0.00 1.00000000000 BIT_MASK 0x1 FORMAT "%13.11" ECU_ADDRESS 0x700014A7
 /begin IF_DATA XCPplus 0x0102
  /begin DAQ_EVENT VARIABLE /end DAQ_EVENT
 /end IF_DATA
/end MEASUREMENT
/begin MEASUREMENT ComChrgn_stDcRly "charging relay status from CAN" UBYTE OneToOne 1 100 0.00 255.0 FORMAT "%5.1" ECU_ADDRESS 0x700014F5
 /begin IF_DATA XCPplus 0x0102
  /begin DAQ_EVENT VARIABLE /end DAQ_EVENT
 /end IF_DATA
/end MEASUREMENT
/begin MEASUREMENT ComChrgr_uAcActL2 "L2 power supply of EVSE" SWORD RBPtCel_u_0p1_1 1 100 -3276.800 3276.700 FORMAT "%8.3" ECU_ADDRESS 0x7000156A
 /begin IF_DATA XCPplus 0x0102
  /begin DAQ_EVENT VARIABLE /end DAQ_EVENT
 /end IF_DATA
/end MEASUREMENT
/begin MEASUREMENT ComChrgr_uAcActL2_Sq "Input voltage signal quality" UBYTE SigQly_COMPU_VERB 1 100 0.00 15.0000000000 FORMAT "%13.10" ECU_ADDRESS 0x700014F4
 /begin IF_DATA XCPplus 0x0102
  /begin DAQ_EVENT VARIABLE /end DAQ_EVENT
 /end IF_DATA
/end MEASUREMENT
/begin MEASUREMENT ComChrgr_uAcActL3 "L3 power supply of EVSE" SWORD RBPtCel_u_0p1_1 1 100 -3276.800 3276.700 FORMAT "%8.3" ECU_ADDRESS 0x70001568
 /begin IF_DATA XCPplus 0x0102
  /begin DAQ_EVENT VARIABLE /end DAQ_EVENT
 /end IF_DATA
/end MEASUREMENT
/begin MEASUREMENT ComChrgr_uAcActL3_Sq "Input voltage signal quality" UBYTE SigQly_COMPU_VERB 1 100 0.00 15.0000000000 FORMAT "%13.10" ECU_ADDRESS 0x700014F3
 /begin IF_DATA XCPplus 0x0102
  /begin DAQ_EVENT VARIABLE /end DAQ_EVENT
 /end IF_DATA
/end MEASUREMENT
/begin MEASUREMENT ComEmac_flgActvdDsbcCtl01 "Surge damping control is active, e-machine 01" UBYTE B_TRUE 1 100 0.00 1.00000000000 BIT_MASK 0x1 FORMAT "%13.11" ECU_ADDRESS 0x700014A6
 /begin IF_DATA XCPplus 0x0102
  /begin DAQ_EVENT VARIABLE /end DAQ_EVENT
 /end IF_DATA
/end MEASUREMENT
/begin MEASUREMENT ComEmac_flgIntlckClsd01 "Flag that indicates that the invertrer HV interlock is closed" UBYTE B_TRUE 1 100 0.00 1.00000000000 BIT_MASK 0x1 FORMAT "%13.11" ECU_ADDRESS 0x700014A5
 /begin IF_DATA XCPplus 0x0102
  /begin DAQ_EVENT VARIABLE /end DAQ_EVENT
 /end IF_DATA
/end MEASUREMENT
/begin MEASUREMENT ComEmac_flgIntlckClsd01_Sq "Signal quality message for ComEmac_flgIntlckClsd01" UBYTE SigQly_COMPU_VERB 1 100 0.00 15.0000000000 FORMAT "%13.10" ECU_ADDRESS 0x700014F2
 /begin IF_DATA XCPplus 0x0102
  /begin DAQ_EVENT VARIABLE /end DAQ_EVENT
 /end IF_DATA
/end MEASUREMENT
/begin MEASUREMENT ComEmac_flgReqDiag01 "Diagnostics request of e-machine 01" UBYTE B_TRUE 1 100 0.00 1.00000000000 BIT_MASK 0x1 FORMAT "%13.11" ECU_ADDRESS 0x700014A4
 /begin IF_DATA XCPplus 0x0102
  /begin DAQ_EVENT VARIABLE /end DAQ_EVENT
 /end IF_DATA
/end MEASUREMENT
/begin MEASUREMENT ComEmac_flgReqDiag01_Sq "Signal quality message for ComEmac_flgReqDiag01" UBYTE SigQly_COMPU_VERB 1 100 0.00 15.0000000000 FORMAT "%13.10" ECU_ADDRESS 0x700014F1
 /begin IF_DATA XCPplus 0x0102
  /begin DAQ_EVENT VARIABLE /end DAQ_EVENT
 /end IF_DATA
/end MEASUREMENT
/begin MEASUREMENT ComEmac_flgSvsReq01 "Flag that indicates Service light request is ON" UBYTE B_TRUE 1 100 0.00 1.00000000000 BIT_MASK 0x1 FORMAT "%13.11" ECU_ADDRESS 0x700014A3
 /begin IF_DATA XCPplus 0x0102
  /begin DAQ_EVENT VARIABLE /end DAQ_EVENT
 /end IF_DATA
/end MEASUREMENT
/begin MEASUREMENT ComEmac_nAct02 "Actual engine speed, e-machine 02" SWORD nmot_q1 1 100 -32768.00 32767.00 FORMAT "%8.2" ECU_ADDRESS 0x70001566
 /begin IF_DATA XCPplus 0x0102
  /begin DAQ_EVENT VARIABLE /end DAQ_EVENT
 /end IF_DATA
/end MEASUREMENT
/begin MEASUREMENT ComEmac_pwrInstnsInp "" SWORD q100_W 1 100 -3276800. 3276700. FORMAT "%8.0" ECU_ADDRESS 0x70001564
 /begin IF_DATA XCPplus 0x0102
  /begin DAQ_EVENT VARIABLE /end DAQ_EVENT
 /end IF_DATA
/end MEASUREMENT
/begin MEASUREMENT ComEmac_stActvDcha_Sq "Signal quality of inverter active discharge signal" UBYTE SigQly_COMPU_VERB 1 100 0.00 15.0000000000 FORMAT "%13.10" ECU_ADDRESS 0x60023635
 /begin IF_DATA XCPplus 0x0102
  /begin DAQ_EVENT VARIABLE /end DAQ_EVENT
 /end IF_DATA
/end MEASUREMENT
/begin MEASUREMENT ComEmac_stDsqflgEmgyShtDwnReq01 "Signal quality message for Emergency shut down signal Over CAN 1" UBYTE OneToOne 1 100 0.00 255.0 FORMAT "%5.1" ECU_ADDRESS 0x700014F0
 /begin IF_DATA XCPplus 0x0102
  /begin DAQ_EVENT VARIABLE /end DAQ_EVENT
 /end IF_DATA
/end MEASUREMENT
/begin MEASUREMENT ComEmac_tIvtrCoolt01 "Coolant temperature of inverter 01." SWORD Temp_Cels 1 100 -3549.940 3003.560 FORMAT "%8.3" ECU_ADDRESS 0x70001562
 /begin IF_DATA XCPplus 0x0102
  /begin DAQ_EVENT VARIABLE /end DAQ_EVENT
 /end IF_DATA
/end MEASUREMENT
/begin MEASUREMENT ComEmac_tqActWoDsbcCtl01 "Actual torque without disturbance control" SWORD Trq 1 100 -3276.800 3276.700 FORMAT "%8.3" ECU_ADDRESS 0x7000155E
 /begin IF_DATA XCPplus 0x0102
  /begin DAQ_EVENT VARIABLE /end DAQ_EVENT
 /end IF_DATA
/end MEASUREMENT
/begin MEASUREMENT ComEmac_tqActWoDsbcCtl01_Sq "Actual value for Disturbance control torque, emachine 01" UBYTE SigQly_COMPU_VERB 1 100 0.00 15.0000000000 FORMAT "%13.10" ECU_ADDRESS 0x700014EE
 /begin IF_DATA XCPplus 0x0102
  /begin DAQ_EVENT VARIABLE /end DAQ_EVENT
 /end IF_DATA
/end MEASUREMENT
/begin MEASUREMENT ComEmac_tRtr01 "Rotor temperature e-machine 01" SWORD Temp_Cels 1 100 -3549.940 3003.560 FORMAT "%8.3" ECU_ADDRESS 0x70001560
 /begin IF_DATA XCPplus 0x0102
  /begin DAQ_EVENT VARIABLE /end DAQ_EVENT
 /end IF_DATA
/end MEASUREMENT
/begin MEASUREMENT ComEmac_tRtr01_Sq "signal quality for rotor temperature, emachine 01" UBYTE SigQly_COMPU_VERB 1 100 0.00 15.0000000000 FORMAT "%13.10" ECU_ADDRESS 0x700014EF
 /begin IF_DATA XCPplus 0x0102
  /begin DAQ_EVENT VARIABLE /end DAQ_EVENT
 /end IF_DATA
/end MEASUREMENT
/begin MEASUREMENT Com_aRecupOnePedlDrvg "Interface to indicate Recuperation of one pedal driving" SWORD Acc 1 100 -32.76800 32.76700 FORMAT "%8.5" ECU_ADDRESS 0x7000155A
 /begin IF_DATA XCPplus 0x0102
  /begin DAQ_EVENT VARIABLE /end DAQ_EVENT
 /end IF_DATA
/end MEASUREMENT
/begin MEASUREMENT Com_aRecupRvsOnePedlDrvg "requested deceleration for one pedal driving is considered from external source" SWORD Acc 1 100 -32.76800 32.76700 FORMAT "%8.5" ECU_ADDRESS 0x70001558
 /begin IF_DATA XCPplus 0x0102
  /begin DAQ_EVENT VARIABLE /end DAQ_EVENT
 /end IF_DATA
/end MEASUREMENT
/begin MEASUREMENT Com_bAcLedReq "AC LED Request" UBYTE B_TRUE 1 100 0.00 1.00000000000 BIT_MASK 0x1 FORMAT "%13.11" ECU_ADDRESS 0x700014A1
 /begin IF_DATA XCPplus 0x0102
  /begin DAQ_EVENT VARIABLE /end DAQ_EVENT
 /end IF_DATA
/end MEASUREMENT
/begin MEASUREMENT Com_bEbsComErr "Status of response error on communication from EBS" UBYTE OneToOne 1 100 0.00 255.0 FORMAT "%5.1" ECU_ADDRESS 0x700014DF
 /begin IF_DATA XCPplus 0x0102
  /begin DAQ_EVENT VARIABLE /end DAQ_EVENT
 /end IF_DATA
/end MEASUREMENT
/begin MEASUREMENT Com_bEcoModeActv "Active ECO switch status" UBYTE OneToOne 1 100 0.00 255.0 FORMAT "%5.1" ECU_ADDRESS 0x700014DE
 /begin IF_DATA XCPplus 0x0102
  /begin DAQ_EVENT VARIABLE /end DAQ_EVENT
 /end IF_DATA
/end MEASUREMENT
/begin MEASUREMENT Com_bErrClb "Status of calibration error" UBYTE OneToOne 1 100 0.00 255.0 FORMAT "%5.1" ECU_ADDRESS 0x700014DD
 /begin IF_DATA XCPplus 0x0102
  /begin DAQ_EVENT VARIABLE /end DAQ_EVENT
 /end IF_DATA
/end MEASUREMENT
/begin MEASUREMENT Com_bErrIdn "Status of ID error" UBYTE OneToOne 1 100 0.00 255.0 FORMAT "%5.1" ECU_ADDRESS 0x700014DC
 /begin IF_DATA XCPplus 0x0102
  /begin DAQ_EVENT VARIABLE /end DAQ_EVENT
 /end IF_DATA
/end MEASUREMENT
/begin MEASUREMENT Com_bGunCntInfoWkuReq "" UBYTE B_TRUE 1 100 0.00 1.00000000000 BIT_MASK 0x1 FORMAT "%13.11" ECU_ADDRESS 0x7000149F
 /begin IF_DATA XCPplus 0x0102
  /begin DAQ_EVENT VARIABLE /end DAQ_EVENT
 /end IF_DATA
/end MEASUREMENT
/begin MEASUREMENT Com_bHvBattRchrgWkuReq "" UBYTE B_TRUE 1 100 0.00 1.00000000000 BIT_MASK 0x1 FORMAT "%13.11" ECU_ADDRESS 0x7000149E
 /begin IF_DATA XCPplus 0x0102
  /begin DAQ_EVENT VARIABLE /end DAQ_EVENT
 /end IF_DATA
/end MEASUREMENT
/begin MEASUREMENT Com_bInCstnc "Status of inconsistency from EBS" UBYTE OneToOne 1 100 0.00 255.0 FORMAT "%5.1" ECU_ADDRESS 0x700014DB
 /begin IF_DATA XCPplus 0x0102
  /begin DAQ_EVENT VARIABLE /end DAQ_EVENT
 /end IF_DATA
/end MEASUREMENT
/begin MEASUREMENT Com_bOBCClgWkuReq "" UBYTE B_TRUE 1 100 0.00 1.00000000000 BIT_MASK 0x1 FORMAT "%13.11" ECU_ADDRESS 0x7000149D
 /begin IF_DATA XCPplus 0x0102
  /begin DAQ_EVENT VARIABLE /end DAQ_EVENT
 /end IF_DATA
/end MEASUREMENT
/begin MEASUREMENT Com_bPreDrvWkuReq "" UBYTE B_TRUE 1 100 0.00 1.00000000000 BIT_MASK 0x1 FORMAT "%13.11" ECU_ADDRESS 0x7000149C
 /begin IF_DATA XCPplus 0x0102
  /begin DAQ_EVENT VARIABLE /end DAQ_EVENT
 /end IF_DATA
/end MEASUREMENT
/begin MEASUREMENT Com_bTBoxPtlWkuReq "" UBYTE B_TRUE 1 100 0.00 1.00000000000 BIT_MASK 0x1 FORMAT "%13.11" ECU_ADDRESS 0x7000149A
 /begin IF_DATA XCPplus 0x0102
  /begin DAQ_EVENT VARIABLE /end DAQ_EVENT
 /end IF_DATA
/end MEASUREMENT
/begin MEASUREMENT Com_egyHvbAvl_f "HVBattery Remaining energy" FLOAT32_IEEE RBPtCel_pwr_1p0_4 1 100 -1.00000000E+037 1.00000000E+037 FORMAT "%13.3" ECU_ADDRESS 0x60000FD4
 /begin IF_DATA XCPplus 0x0102
  /begin DAQ_EVENT VARIABLE /end DAQ_EVENT
 /end IF_DATA
/end MEASUREMENT
/begin MEASUREMENT Com_egyTotNom_f "energy" FLOAT32_IEEE RBPtCel_pwr_1p0_4 1 100 -1.00000000E+037 1.00000000E+037 FORMAT "%13.3" ECU_ADDRESS 0x700015D0
 /begin IF_DATA XCPplus 0x0102
  /begin DAQ_EVENT VARIABLE /end DAQ_EVENT
 /end IF_DATA
/end MEASUREMENT
/begin MEASUREMENT Com_flgBrkAlrt "Alert signal to incidate brake press during gear change" UBYTE B_TRUE 1 100 0.00 1.00000000000 BIT_MASK 0x1 FORMAT "%13.11" ECU_ADDRESS 0x6002342A
 /begin IF_DATA XCPplus 0x0102
  /begin DAQ_EVENT VARIABLE /end DAQ_EVENT
 /end IF_DATA
/end MEASUREMENT
/begin MEASUREMENT Com_flgChrgnStopReq "Request to stop charging" UBYTE B_TRUE 1 100 0.00 1.00000000000 BIT_MASK 0x1 FORMAT "%13.11" ECU_ADDRESS 0x600234B6
 /begin IF_DATA XCPplus 0x0102
  /begin DAQ_EVENT VARIABLE /end DAQ_EVENT
 /end IF_DATA
/end MEASUREMENT
/begin MEASUREMENT Com_flgChrgTarRea "Flag to indicate Target reached for charging" UBYTE B_TRUE 1 100 0.00 1.00000000000 BIT_MASK 0x1 FORMAT "%13.11" ECU_ADDRESS 0x600234B8
 /begin IF_DATA XCPplus 0x0102
  /begin DAQ_EVENT VARIABLE /end DAQ_EVENT
 /end IF_DATA
/end MEASUREMENT
/begin MEASUREMENT Com_flgCrawlActvd "Flag to check crawling functionality is activated" UBYTE B_TRUE 1 100 0.00 1.00000000000 BIT_MASK 0x1 FORMAT "%13.11" ECU_ADDRESS 0x70001499
 /begin IF_DATA XCPplus 0x0102
  /begin DAQ_EVENT VARIABLE /end DAQ_EVENT
 /end IF_DATA
/end MEASUREMENT
/begin MEASUREMENT Com_flgDcdcPrecCmpl "DCDC precharge complete flag" UBYTE B_TRUE 1 100 0.00 1.00000000000 BIT_MASK 0x1 FORMAT "%13.11" ECU_ADDRESS 0x70001498
 /begin IF_DATA XCPplus 0x0102
  /begin DAQ_EVENT VARIABLE /end DAQ_EVENT
 /end IF_DATA
/end MEASUREMENT
/begin MEASUREMENT Com_flgEcoNormReq_Sq "Signal quality of Eco normal switch" UBYTE SigQly_COMPU_VERB 1 100 0.00 15.0000000000 FORMAT "%13.10" ECU_ADDRESS 0x60023623
 /begin IF_DATA XCPplus 0x0102
  /begin DAQ_EVENT VARIABLE /end DAQ_EVENT
 /end IF_DATA
/end MEASUREMENT
/begin MEASUREMENT Com_HvbMaxSnsrTempTx "" SWORD RBPtCel_t_1p0_om40_1 1 100 -32808.00 32727.00 FORMAT "%8.2" ECU_ADDRESS 0x7000155C
 /begin IF_DATA XCPplus 0x0102
  /begin DAQ_EVENT VARIABLE /end DAQ_EVENT
 /end IF_DATA
/end MEASUREMENT
/begin MEASUREMENT Com_lTotDstkm "Absolute number of kilometers travelled" ULONG C126_dist_km_u32_q1p0_COMPU 1 100 0.00 4294967295.00 FORMAT "%13.2" ECU_ADDRESS 0x70001584
 /begin IF_DATA XCPplus 0x0102
  /begin DAQ_EVENT VARIABLE /end DAQ_EVENT
 /end IF_DATA
/end MEASUREMENT
/begin MEASUREMENT Com_nrHvbHiCellPck "Group number of Highest voltage of single power battery. It is in relationship with signal uHiCellBatt_ED" UBYTE OneToOne 1 100 0.00 255.0 FORMAT "%5.1" ECU_ADDRESS 0x700014D9
 /begin IF_DATA XCPplus 0x0102
  /begin DAQ_EVENT VARIABLE /end DAQ_EVENT
 /end IF_DATA
/end MEASUREMENT
/begin MEASUREMENT Com_nrSerlHiTDetn "Serial number of the highest temperature detection point (BMS)" UBYTE OneToOne 1 100 0.00 255.0 FORMAT "%5.1" ECU_ADDRESS 0x700014D8
 /begin IF_DATA XCPplus 0x0102
  /begin DAQ_EVENT VARIABLE /end DAQ_EVENT
 /end IF_DATA
/end MEASUREMENT
/begin MEASUREMENT Com_nrSerlHiUCell "Serial number of the highest voltage of single power storage battery (Cell)" UBYTE OneToOne 1 100 0.00 255.0 FORMAT "%5.1" ECU_ADDRESS 0x700014D7
 /begin IF_DATA XCPplus 0x0102
  /begin DAQ_EVENT VARIABLE /end DAQ_EVENT
 /end IF_DATA
/end MEASUREMENT
/begin MEASUREMENT Com_nrSerlLoTDetn "Serial number of the lowest temperature detection point (BMS)" UBYTE OneToOne 1 100 0.00 255.0 FORMAT "%5.1" ECU_ADDRESS 0x700014D6
 /begin IF_DATA XCPplus 0x0102
  /begin DAQ_EVENT VARIABLE /end DAQ_EVENT
 /end IF_DATA
/end MEASUREMENT
/begin MEASUREMENT Com_numBSIEnv "Environmental parameter frozen for JDD fault reporting for AEE2010" ULONG OneToOne 1 100 0.00 4294967295.00 FORMAT "%13.2" ECU_ADDRESS 0x70001580
 /begin IF_DATA XCPplus 0x0102
  /begin DAQ_EVENT VARIABLE /end DAQ_EVENT
 /end IF_DATA
/end MEASUREMENT
/begin MEASUREMENT Com_pwrDcdcOutpCpby_Sq "Signal quality for DCDC output poweer capability CAN signal" UBYTE SigQly_COMPU_VERB 1 100 0.00 15.0000000000 FORMAT "%13.10" ECU_ADDRESS 0x60023618
 /begin IF_DATA XCPplus 0x0102
  /begin DAQ_EVENT VARIABLE /end DAQ_EVENT
 /end IF_DATA
/end MEASUREMENT
/begin MEASUREMENT Com_qSoh "battery state of health with respect to charge capacity" SWORD ElecChrg_Ah_q0p125_COMPU 1 100 -4096.000 4095.875 FORMAT "%8.3" ECU_ADDRESS 0x70001556
 /begin IF_DATA XCPplus 0x0102
  /begin DAQ_EVENT VARIABLE /end DAQ_EVENT
 /end IF_DATA
/end MEASUREMENT
/begin MEASUREMENT Com_ratSoc "Status of charge" UBYTE RBPtCel_Perc_1p0_1 1 100 0.00 255.0 FORMAT "%5.1" ECU_ADDRESS 0x700014D5
 /begin IF_DATA XCPplus 0x0102
  /begin DAQ_EVENT VARIABLE /end DAQ_EVENT
 /end IF_DATA
/end MEASUREMENT
/begin MEASUREMENT Com_ratSoh "Battery SOH received from EBS" UBYTE RBPtCel_Perc_1p0_1 1 100 0.00 255.0 FORMAT "%5.1" ECU_ADDRESS 0x700014D4
 /begin IF_DATA XCPplus 0x0102
  /begin DAQ_EVENT VARIABLE /end DAQ_EVENT
 /end IF_DATA
/end MEASUREMENT
/begin MEASUREMENT Com_ratThermIndcrMCU "" UBYTE RBPtCel_Perc_0p5_1 1 100 0.00 127.5 FORMAT "%5.1" ECU_ADDRESS 0x700014D3
 /begin IF_DATA XCPplus 0x0102
  /begin DAQ_EVENT VARIABLE /end DAQ_EVENT
 /end IF_DATA
/end MEASUREMENT
/begin MEASUREMENT Com_rHvbIsoMeasmt_Sq "Signal quality of HV battery Isolation measurement signal" UBYTE SigQly_COMPU_VERB 1 100 0.00 15.0000000000 FORMAT "%13.10" ECU_ADDRESS 0x60023613
 /begin IF_DATA XCPplus 0x0102
  /begin DAQ_EVENT VARIABLE /end DAQ_EVENT
 /end IF_DATA
/end MEASUREMENT
/begin MEASUREMENT Com_rVirtZrPntExt "Virtual zero point ratio for propulsion from external source" SWORD Prc 1 100 -400.0000 399.9878 FORMAT "%8.4" ECU_ADDRESS 0x70001554
 /begin IF_DATA XCPplus 0x0102
  /begin DAQ_EVENT VARIABLE /end DAQ_EVENT
 /end IF_DATA
/end MEASUREMENT
/begin MEASUREMENT Com_stBattOvTemp "Battery Over Temperature Lamp Status" UBYTE OneToOne 1 100 0.00 1.000 FORMAT "%5.3" ECU_ADDRESS 0x60023610
 /begin IF_DATA XCPplus 0x0102
  /begin DAQ_EVENT VARIABLE /end DAQ_EVENT
 /end IF_DATA
/end MEASUREMENT
/begin MEASUREMENT Com_stBrkAlrt "Press brake Lamp Status" UBYTE OneToOne 1 100 0.00 1.000 FORMAT "%5.3" ECU_ADDRESS 0x6002360E
 /begin IF_DATA XCPplus 0x0102
  /begin DAQ_EVENT VARIABLE /end DAQ_EVENT
 /end IF_DATA
/end MEASUREMENT
/begin MEASUREMENT Com_stBrkBstPFlt "EBD Malfunction Lamp Status" UBYTE OneToOne 1 100 0.00 3.000 FORMAT "%5.3" ECU_ADDRESS 0x6002360D
 /begin IF_DATA XCPplus 0x0102
  /begin DAQ_EVENT VARIABLE /end DAQ_EVENT
 /end IF_DATA
/end MEASUREMENT
/begin MEASUREMENT Com_stBrkCntctIndcn "Uncertain brake pedal secondary switch" UBYTE B_TRUE 1 100 0.00 1.00000000000 BIT_MASK 0x1 FORMAT "%13.11" ECU_ADDRESS 0x600234B1
 /begin IF_DATA XCPplus 0x0102
  /begin DAQ_EVENT VARIABLE /end DAQ_EVENT
 /end IF_DATA
/end MEASUREMENT
/begin MEASUREMENT Com_stChrgnSpstReq_sq "Signal quality for Charging Spst Rquest" UBYTE SigQly_COMPU_VERB 1 100 0.00 15.0000000000 FORMAT "%13.10" ECU_ADDRESS 0x700014D2
 /begin IF_DATA XCPplus 0x0102
  /begin DAQ_EVENT VARIABLE /end DAQ_EVENT
 /end IF_DATA
/end MEASUREMENT
/begin MEASUREMENT Com_stCrCUIBtn "Com_stCrCUIBtn" UWORD OneToOne 1 100 0.00 32767.00 FORMAT "%8.2" ECU_ADDRESS 0x70001510
 /begin IF_DATA XCPplus 0x0102
  /begin DAQ_EVENT VARIABLE /end DAQ_EVENT
 /end IF_DATA
/end MEASUREMENT
/begin MEASUREMENT Com_stEVLmp "EV System Warning Lamp Status" UBYTE OneToOne 1 100 0.00 7.000 FORMAT "%5.3" ECU_ADDRESS 0x600235F5
 /begin IF_DATA XCPplus 0x0102
  /begin DAQ_EVENT VARIABLE /end DAQ_EVENT
 /end IF_DATA
/end MEASUREMENT
/begin MEASUREMENT Com_stGearLvrPos_Sq "Signal quality of Gear Lever position" UBYTE SigQly_COMPU_VERB 1 100 0.00 15.0000000000 FORMAT "%13.10" ECU_ADDRESS 0x600235F3
 /begin IF_DATA XCPplus 0x0102
  /begin DAQ_EVENT VARIABLE /end DAQ_EVENT
 /end IF_DATA
/end MEASUREMENT
/begin MEASUREMENT Com_stHvbDernMaxT "overtemperature derating" UBYTE B_TRUE 1 100 0.00 1.00000000000 BIT_MASK 0x1 FORMAT "%13.11" ECU_ADDRESS 0x600234AE
 /begin IF_DATA XCPplus 0x0102
  /begin DAQ_EVENT VARIABLE /end DAQ_EVENT
 /end IF_DATA
/end MEASUREMENT
/begin MEASUREMENT Com_stHvbDernMinT "undertemperature derating" UBYTE B_TRUE 1 100 0.00 1.00000000000 BIT_MASK 0x1 FORMAT "%13.11" ECU_ADDRESS 0x600234AD
 /begin IF_DATA XCPplus 0x0102
  /begin DAQ_EVENT VARIABLE /end DAQ_EVENT
 /end IF_DATA
/end MEASUREMENT
/begin MEASUREMENT Com_stHvbSrvPlg_Sq "Signal quality of HV battery service plug signal" UBYTE SigQly_COMPU_VERB 1 100 0.00 15.0000000000 FORMAT "%13.10" ECU_ADDRESS 0x600235E8
 /begin IF_DATA XCPplus 0x0102
  /begin DAQ_EVENT VARIABLE /end DAQ_EVENT
 /end IF_DATA
/end MEASUREMENT
/begin MEASUREMENT Com_stHvbTypCod "Code of Battery type (BMS)" UBYTE OneToOne 1 100 0.00 255.0 FORMAT "%5.1" ECU_ADDRESS 0x700014CF
 /begin IF_DATA XCPplus 0x0102
  /begin DAQ_EVENT VARIABLE /end DAQ_EVENT
 /end IF_DATA
/end MEASUREMENT
/begin MEASUREMENT Com_stI "Status of battery current" UBYTE OneToOne 1 100 0.00 255.0 FORMAT "%5.1" ECU_ADDRESS 0x700014CE
 /begin IF_DATA XCPplus 0x0102
  /begin DAQ_EVENT VARIABLE /end DAQ_EVENT
 /end IF_DATA
/end MEASUREMENT
/begin MEASUREMENT Com_stIRng "Range for battery current from EBS" UBYTE OneToOne 1 100 0.00 255.0 FORMAT "%5.1" ECU_ADDRESS 0x700014CD
 /begin IF_DATA XCPplus 0x0102
  /begin DAQ_EVENT VARIABLE /end DAQ_EVENT
 /end IF_DATA
/end MEASUREMENT
/begin MEASUREMENT Com_stMstWrnLmp "Master Warning Lamp Status" UBYTE OneToOne 1 100 0.00 7.000 FORMAT "%5.3" ECU_ADDRESS 0x600235E6
 /begin IF_DATA XCPplus 0x0102
  /begin DAQ_EVENT VARIABLE /end DAQ_EVENT
 /end IF_DATA
/end MEASUREMENT
/begin MEASUREMENT Com_stNMStM "Message for COM Network management States" UBYTE Com_NmStM_VERB 1 100 0.00 4.00000000000 FORMAT "%13.11" ECU_ADDRESS 0x700014CB
 /begin IF_DATA XCPplus 0x0102
  /begin DAQ_EVENT VARIABLE /end DAQ_EVENT
 /end IF_DATA
/end MEASUREMENT
/begin MEASUREMENT Com_stPrecTOut "Communication signal for Precharge timeout status" UBYTE B_TRUE 1 100 0.00 1.00000000000 BIT_MASK 0x1 FORMAT "%13.11" ECU_ADDRESS 0x70001496
 /begin IF_DATA XCPplus 0x0102
  /begin DAQ_EVENT VARIABLE /end DAQ_EVENT
 /end IF_DATA
/end MEASUREMENT
/begin MEASUREMENT Com_stPrecTOut_Sq "Signal quality for com precharge timeout status" UBYTE SigQly_COMPU_VERB 1 100 0.00 15.0000000000 FORMAT "%13.10" ECU_ADDRESS 0x700014C9
 /begin IF_DATA XCPplus 0x0102
  /begin DAQ_EVENT VARIABLE /end DAQ_EVENT
 /end IF_DATA
/end MEASUREMENT
/begin MEASUREMENT Com_stPwrLimnLmp "PowerLimitation lamp status" UBYTE OneToOne 1 100 0.00 4.000 FORMAT "%5.3" ECU_ADDRESS 0x600235E3
 /begin IF_DATA XCPplus 0x0102
  /begin DAQ_EVENT VARIABLE /end DAQ_EVENT
 /end IF_DATA
/end MEASUREMENT
/begin MEASUREMENT Com_stSofASILErr "Interface to indicate the status of fitness of ASIL error" UBYTE OneToOne 1 100 0.00 255.0 FORMAT "%5.1" ECU_ADDRESS 0x700014C7
 /begin IF_DATA XCPplus 0x0102
  /begin DAQ_EVENT VARIABLE /end DAQ_EVENT
 /end IF_DATA
/end MEASUREMENT
/begin MEASUREMENT Com_stSoh "state of health of battery reveived over can" UBYTE OneToOne 1 100 0.00 255.0 FORMAT "%5.1" ECU_ADDRESS 0x700014C6
 /begin IF_DATA XCPplus 0x0102
  /begin DAQ_EVENT VARIABLE /end DAQ_EVENT
 /end IF_DATA
/end MEASUREMENT
/begin MEASUREMENT Com_stSrvLmp "Service Lamp Status" UBYTE OneToOne 1 100 0.00 3.000 FORMAT "%5.3" ECU_ADDRESS 0x600235E1
 /begin IF_DATA XCPplus 0x0102
  /begin DAQ_EVENT VARIABLE /end DAQ_EVENT
 /end IF_DATA
/end MEASUREMENT
/begin MEASUREMENT Com_stU "Status of battery voltage" UBYTE OneToOne 1 100 0.00 255.0 FORMAT "%5.1" ECU_ADDRESS 0x700014C5
 /begin IF_DATA XCPplus 0x0102
  /begin DAQ_EVENT VARIABLE /end DAQ_EVENT
 /end IF_DATA
/end MEASUREMENT
/begin MEASUREMENT Com_tHvbCellMax "Com interface of maxCellTempHVBatInfo_CDI" SWORD RBPtCel_t_0p1om40_1 1 100 -3316.800 3236.700 FORMAT "%8.3" ECU_ADDRESS 0x70001552
 /begin IF_DATA XCPplus 0x0102
  /begin DAQ_EVENT VARIABLE /end DAQ_EVENT
 /end IF_DATA
/end MEASUREMENT
/begin MEASUREMENT Com_tHvbCellMin "Com interface of minCellTempHVBatInfo_CDI" SWORD RBPtCel_t_0p1om40_1 1 100 -3316.800 3236.700 FORMAT "%8.3" ECU_ADDRESS 0x70001550
 /begin IF_DATA XCPplus 0x0102
  /begin DAQ_EVENT VARIABLE /end DAQ_EVENT
 /end IF_DATA
/end MEASUREMENT
/begin MEASUREMENT Com_tHvbMaxAllwbl "Valid" SWORD RBPtCel_t_0p1_3 1 100 -3276.800 3276.700 FORMAT "%8.3" ECU_ADDRESS 0x7000154E
 /begin IF_DATA XCPplus 0x0102
  /begin DAQ_EVENT VARIABLE /end DAQ_EVENT
 /end IF_DATA
/end MEASUREMENT
/begin MEASUREMENT Com_tiRef "Synchronised timestamp" ULONG Time_sec_1 1 100 0.00 429496729.500 FORMAT "%13.3" ECU_ADDRESS 0x7000157C
 /begin IF_DATA XCPplus 0x0102
  /begin DAQ_EVENT VARIABLE /end DAQ_EVENT
 /end IF_DATA
/end MEASUREMENT
/begin MEASUREMENT Com_TogLedDrv "State expected for the LED D" UBYTE ETogLed_st_VERB 1 100 0.00 7.00000000000 FORMAT "%13.11" ECU_ADDRESS 0x60023628
 /begin IF_DATA XCPplus 0x0102
  /begin DAQ_EVENT VARIABLE /end DAQ_EVENT
 /end IF_DATA
/end MEASUREMENT
/begin MEASUREMENT Com_TogLedMod "State expected for the LED M and B" UBYTE ETogLed_st_VERB 1 100 0.00 7.00000000000 FORMAT "%13.11" ECU_ADDRESS 0x60023627
 /begin IF_DATA XCPplus 0x0102
  /begin DAQ_EVENT VARIABLE /end DAQ_EVENT
 /end IF_DATA
/end MEASUREMENT
/begin MEASUREMENT Com_TogLedNeut "State expected for the LED N" UBYTE ETogLed_st_VERB 1 100 0.00 7.00000000000 FORMAT "%13.11" ECU_ADDRESS 0x60023626
 /begin IF_DATA XCPplus 0x0102
  /begin DAQ_EVENT VARIABLE /end DAQ_EVENT
 /end IF_DATA
/end MEASUREMENT
/begin MEASUREMENT Com_TogLedRvs "State expected for the LED R" UBYTE ETogLed_st_VERB 1 100 0.00 7.00000000000 FORMAT "%13.11" ECU_ADDRESS 0x60023625
 /begin IF_DATA XCPplus 0x0102
  /begin DAQ_EVENT VARIABLE /end DAQ_EVENT
 /end IF_DATA
/end MEASUREMENT
/begin MEASUREMENT Com_tqBrkDesPrimAxle "brake torque primary axle" SLONG TrqPrpHigh 1 100 -214748364.800 214748364.700 FORMAT "%13.3" ECU_ADDRESS 0x700015A8
 /begin IF_DATA XCPplus 0x0102
  /begin DAQ_EVENT VARIABLE /end DAQ_EVENT
 /end IF_DATA
/end MEASUREMENT
/begin MEASUREMENT Com_uHvbCellLimHi "Maximum permissible charging voltage of single power storage Battery (static)" SWORD RBPtCel_u_0p01_1 1 100 -327.6800 327.6700 FORMAT "%8.4" ECU_ADDRESS 0x7000154C
 /begin IF_DATA XCPplus 0x0102
  /begin DAQ_EVENT VARIABLE /end DAQ_EVENT
 /end IF_DATA
/end MEASUREMENT
/begin MEASUREMENT Com_uHvbDcBus_Sq "Signal quality of HV Battery DC link voltage signal" UBYTE SigQly_COMPU_VERB 1 100 0.00 15.0000000000 FORMAT "%13.10" ECU_ADDRESS 0x600235D8
 /begin IF_DATA XCPplus 0x0102
  /begin DAQ_EVENT VARIABLE /end DAQ_EVENT
 /end IF_DATA
/end MEASUREMENT
/begin MEASUREMENT Com_uHvbHiCell "The highest single power storage battery (Cell) voltage. Group Number is send out in separate signal uHiCellnrPckInpGrp_ED" SWORD RBPtCel_u_0p00125_1 1 100 -40.96000 40.95875 FORMAT "%8.5" ECU_ADDRESS 0x7000154A
 /begin IF_DATA XCPplus 0x0102
  /begin DAQ_EVENT VARIABLE /end DAQ_EVENT
 /end IF_DATA
/end MEASUREMENT
/begin MEASUREMENT Com_uHvbLimLo "Minimum Voltage of HV Battery" SWORD Volt_V_q0p03125_COMPU 1 100 -1024.000 1023.969 FORMAT "%8.3" ECU_ADDRESS 0x70001548
 /begin IF_DATA XCPplus 0x0102
  /begin DAQ_EVENT VARIABLE /end DAQ_EVENT
 /end IF_DATA
/end MEASUREMENT
/begin MEASUREMENT Com_uHvbLimLo_Sq "Minimum Voltage signal quality of HV Battery" UBYTE SigQly_COMPU_VERB 1 100 0.00 15.0000000000 FORMAT "%13.10" ECU_ADDRESS 0x700014C3
 /begin IF_DATA XCPplus 0x0102
  /begin DAQ_EVENT VARIABLE /end DAQ_EVENT
 /end IF_DATA
/end MEASUREMENT
/begin MEASUREMENT Com_uHvbLoCell "HV battery low cell voltage" SWORD RBPtCel_u_0p00125_1 1 100 -40.96000 40.95875 FORMAT "%8.5" ECU_ADDRESS 0x70001546
 /begin IF_DATA XCPplus 0x0102
  /begin DAQ_EVENT VARIABLE /end DAQ_EVENT
 /end IF_DATA
/end MEASUREMENT
/begin MEASUREMENT Com_uPtcAct_Sq "Signal qualifier for voltage measurement from HVPTC" UBYTE SigQly_COMPU_VERB 1 100 0.00 15.0000000000 FORMAT "%13.10" ECU_ADDRESS 0x700014C2
 /begin IF_DATA XCPplus 0x0102
  /begin DAQ_EVENT VARIABLE /end DAQ_EVENT
 /end IF_DATA
/end MEASUREMENT
/begin MEASUREMENT Com_uSofASIL "Interface to indicate the state of fitness of the ASIL voltage" SWORD spg_q0p0625_V 1 100 -2048.000 2047.938 FORMAT "%8.3" ECU_ADDRESS 0x70001544
 /begin IF_DATA XCPplus 0x0102
  /begin DAQ_EVENT VARIABLE /end DAQ_EVENT
 /end IF_DATA
/end MEASUREMENT
/begin MEASUREMENT CoPOM_ratTqDistbn "factor for torque- resp. power distribution" SWORD fak_q1p22Em4 1 100 -4.000000 3.999878 FORMAT "%8.6" ECU_ADDRESS 0x7000156C
 /begin IF_DATA XCPplus 0x0102
  /begin DAQ_EVENT VARIABLE /end DAQ_EVENT
 /end IF_DATA
/end MEASUREMENT
/begin MEASUREMENT CoPOM_tqWhlQstyMaxWoDistbn "Maximum theoretical quasi-stationary torque without Distribution at wheel level" SLONG TrqPrpHigh 1 100 -214748364.800 214748364.700 FORMAT "%13.3" ECU_ADDRESS 0x700015BC
 /begin IF_DATA XCPplus 0x0102
  /begin DAQ_EVENT VARIABLE /end DAQ_EVENT
 /end IF_DATA
/end MEASUREMENT
/begin MEASUREMENT CoPT_tqRecupPotlWhlPrim "Recuperation potential torque for primary axle" SLONG TrqPrpHigh 1 100 -214748364.800 214748364.700 FORMAT "%13.3" ECU_ADDRESS 0x700015B8
 /begin IF_DATA XCPplus 0x0102
  /begin DAQ_EVENT VARIABLE /end DAQ_EVENT
 /end IF_DATA
/end MEASUREMENT
/begin MEASUREMENT CoPT_tqRecupPotlWhlSec "Recuperation potential torque for Secondary axle" SLONG TrqPrpHigh 1 100 -214748364.800 214748364.700 FORMAT "%13.3" ECU_ADDRESS 0x700015B4
 /begin IF_DATA XCPplus 0x0102
  /begin DAQ_EVENT VARIABLE /end DAQ_EVENT
 /end IF_DATA
/end MEASUREMENT
/begin MEASUREMENT CoVMD_stReqCrCtl "Coordinated status of acceleration request" UBYTE OneToOne 1 100 0.00 255.0 FORMAT "%5.1" ECU_ADDRESS 0x700014F6
 /begin IF_DATA XCPplus 0x0102
  /begin DAQ_EVENT VARIABLE /end DAQ_EVENT
 /end IF_DATA
/end MEASUREMENT
/begin MEASUREMENT CoVMD_tqAdas "Torque request for ADAS (ACC or Autonomous Parking)" SLONG TrqPrpHigh 1 100 -214748364.800 214748364.700 FORMAT "%13.3" ECU_ADDRESS 0x700015B0
 /begin IF_DATA XCPplus 0x0102
  /begin DAQ_EVENT VARIABLE /end DAQ_EVENT
 /end IF_DATA
/end MEASUREMENT
/begin MEASUREMENT CoVMD_trqCrCtl "Propulsion torque of cruise control" SLONG TrqPrpHigh 1 100 -214748364.800 214748364.700 FORMAT "%13.3" ECU_ADDRESS 0x700015AC
 /begin IF_DATA XCPplus 0x0102
  /begin DAQ_EVENT VARIABLE /end DAQ_EVENT
 /end IF_DATA
/end MEASUREMENT
/begin MEASUREMENT Dcdc_flgDesLvGridULim "LV Output Voltage limit request" UBYTE B_TRUE 1 100 0.00 1.00000000000 BIT_MASK 0x1 FORMAT "%13.11" ECU_ADDRESS 0x600234A8
 /begin IF_DATA XCPplus 0x0102
  /begin DAQ_EVENT VARIABLE /end DAQ_EVENT
 /end IF_DATA
/end MEASUREMENT
/begin MEASUREMENT DDRC_St.DFC_AirbgCan "" ULONG DFC_OneToOne 1 100 0.00 536870911.000 BIT_MASK 0x1fffffff FORMAT "%13.3" ECU_ADDRESS 0x6001C1E4 /end MEASUREMENT
/begin MEASUREMENT DDRC_St.DFC_ComChrgrEVCont "" ULONG DFC_OneToOne 1 100 0.00 536870911.000 BIT_MASK 0x1fffffff FORMAT "%13.3" ECU_ADDRESS 0x6001C258 /end MEASUREMENT
/begin MEASUREMENT DDRC_St.DFC_ComChrgrEVtBlink "" ULONG DFC_OneToOne 1 100 0.00 536870911.000 BIT_MASK 0x1fffffff FORMAT "%13.3" ECU_ADDRESS 0x6001C25C /end MEASUREMENT
/begin MEASUREMENT DDRC_St.DFC_ComChrgrMstBlink "" ULONG DFC_OneToOne 1 100 0.00 536870911.000 BIT_MASK 0x1fffffff FORMAT "%13.3" ECU_ADDRESS 0x6001C260 /end MEASUREMENT
/begin MEASUREMENT DDRC_St.DFC_ComChrgrMstCont "" ULONG DFC_OneToOne 1 100 0.00 536870911.000 BIT_MASK 0x1fffffff FORMAT "%13.3" ECU_ADDRESS 0x6001C264 /end MEASUREMENT
/begin MEASUREMENT DDRC_St.DFC_ComChrgrSVSBlink "" ULONG DFC_OneToOne 1 100 0.00 536870911.000 BIT_MASK 0x1fffffff FORMAT "%13.3" ECU_ADDRESS 0x6001C268 /end MEASUREMENT
/begin MEASUREMENT DDRC_St.DFC_ComChrgrSVSCont "" ULONG DFC_OneToOne 1 100 0.00 536870911.000 BIT_MASK 0x1fffffff FORMAT "%13.3" ECU_ADDRESS 0x6001C26C /end MEASUREMENT
/begin MEASUREMENT DDRC_St.DFC_ComDcdcEVBlink "" ULONG DFC_OneToOne 1 100 0.00 536870911.000 BIT_MASK 0x1fffffff FORMAT "%13.3" ECU_ADDRESS 0x6001C270 /end MEASUREMENT
/begin MEASUREMENT DDRC_St.DFC_ComDcdcEVCont "" ULONG DFC_OneToOne 1 100 0.00 536870911.000 BIT_MASK 0x1fffffff FORMAT "%13.3" ECU_ADDRESS 0x6001C274 /end MEASUREMENT
/begin MEASUREMENT DDRC_St.DFC_ComDcdcMstBlink "" ULONG DFC_OneToOne 1 100 0.00 536870911.000 BIT_MASK 0x1fffffff FORMAT "%13.3" ECU_ADDRESS 0x6001C28C /end MEASUREMENT
/begin MEASUREMENT DDRC_St.DFC_ComDcdcMstCont "" ULONG DFC_OneToOne 1 100 0.00 536870911.000 BIT_MASK 0x1fffffff FORMAT "%13.3" ECU_ADDRESS 0x6001C290 /end MEASUREMENT
/begin MEASUREMENT DDRC_St.DFC_ComDcdcSVSBlink "" ULONG DFC_OneToOne 1 100 0.00 536870911.000 BIT_MASK 0x1fffffff FORMAT "%13.3" ECU_ADDRESS 0x6001C294 /end MEASUREMENT
/begin MEASUREMENT DDRC_St.DFC_ComDcdcSVSCont "" ULONG DFC_OneToOne 1 100 0.00 536870911.000 BIT_MASK 0x1fffffff FORMAT "%13.3" ECU_ADDRESS 0x6001C298 /end MEASUREMENT
/begin MEASUREMENT DDRC_St.DFC_ComEmacEVBlink "" ULONG DFC_OneToOne 1 100 0.00 536870911.000 BIT_MASK 0x1fffffff FORMAT "%13.3" ECU_ADDRESS 0x6001C2B0 /end MEASUREMENT
/begin MEASUREMENT DDRC_St.DFC_ComEmacEVCont "" ULONG DFC_OneToOne 1 100 0.00 536870911.000 BIT_MASK 0x1fffffff FORMAT "%13.3" ECU_ADDRESS 0x6001C2B4 /end MEASUREMENT
/begin MEASUREMENT DDRC_St.DFC_ComEmacMstCont "" ULONG DFC_OneToOne 1 100 0.00 536870911.000 BIT_MASK 0x1fffffff FORMAT "%13.3" ECU_ADDRESS 0x6001C2B8 /end MEASUREMENT
/begin MEASUREMENT DDRC_St.DFC_ComEmacMsttBlink "" ULONG DFC_OneToOne 1 100 0.00 536870911.000 BIT_MASK 0x1fffffff FORMAT "%13.3" ECU_ADDRESS 0x6001C2BC /end MEASUREMENT
/begin MEASUREMENT DDRC_St.DFC_ComEmacSVSBlink "" ULONG DFC_OneToOne 1 100 0.00 536870911.000 BIT_MASK 0x1fffffff FORMAT "%13.3" ECU_ADDRESS 0x6001C2C0 /end MEASUREMENT
/begin MEASUREMENT DDRC_St.DFC_ComEmacSVSCont "" ULONG DFC_OneToOne 1 100 0.00 536870911.000 BIT_MASK 0x1fffffff FORMAT "%13.3" ECU_ADDRESS 0x6001C2C4 /end MEASUREMENT
/begin MEASUREMENT DDRC_St.DFC_ComHvbMstBlink "" ULONG DFC_OneToOne 1 100 0.00 536870911.000 BIT_MASK 0x1fffffff FORMAT "%13.3" ECU_ADDRESS 0x6001C2E8 /end MEASUREMENT
/begin MEASUREMENT DDRC_St.DFC_ComHvbMstCont "" ULONG DFC_OneToOne 1 100 0.00 536870911.000 BIT_MASK 0x1fffffff FORMAT "%13.3" ECU_ADDRESS 0x6001C2EC /end MEASUREMENT
/begin MEASUREMENT DDRC_St.DFC_ComflgCurMeasmtErr "" ULONG DFC_OneToOne 1 100 0.00 536870911.000 BIT_MASK 0x1fffffff FORMAT "%13.3" ECU_ADDRESS 0x6001C31C /end MEASUREMENT
/begin MEASUREMENT DDRC_St.DFC_ComflgCurMeasmtSysErr "" ULONG DFC_OneToOne 1 100 0.00 536870911.000 BIT_MASK 0x1fffffff FORMAT "%13.3" ECU_ADDRESS 0x6001C320 /end MEASUREMENT
/begin MEASUREMENT DDRC_St.DFC_ComflgCurMeasmtVld "" ULONG DFC_OneToOne 1 100 0.00 536870911.000 BIT_MASK 0x1fffffff FORMAT "%13.3" ECU_ADDRESS 0x6001C324 /end MEASUREMENT
/begin MEASUREMENT DDRC_St.DFC_ComflgCurRngErr "" ULONG DFC_OneToOne 1 100 0.00 536870911.000 BIT_MASK 0x1fffffff FORMAT "%13.3" ECU_ADDRESS 0x6001C328 /end MEASUREMENT
/begin MEASUREMENT DDRC_St.DFC_ComflgTPcbMeasmtErr "" ULONG DFC_OneToOne 1 100 0.00 536870911.000 BIT_MASK 0x1fffffff FORMAT "%13.3" ECU_ADDRESS 0x6001C32C /end MEASUREMENT
/begin MEASUREMENT DDRC_St.DFC_ComflgTPcbMeasmtVld "" ULONG DFC_OneToOne 1 100 0.00 536870911.000 BIT_MASK 0x1fffffff FORMAT "%13.3" ECU_ADDRESS 0x6001C330 /end MEASUREMENT
/begin MEASUREMENT DDRC_St.DFC_ComflgTPcbRngErr "" ULONG DFC_OneToOne 1 100 0.00 536870911.000 BIT_MASK 0x1fffffff FORMAT "%13.3" ECU_ADDRESS 0x6001C334 /end MEASUREMENT
/begin MEASUREMENT DDRC_St.DFC_ComflgTPcbSysErr "" ULONG DFC_OneToOne 1 100 0.00 536870911.000 BIT_MASK 0x1fffffff FORMAT "%13.3" ECU_ADDRESS 0x6001C338 /end MEASUREMENT
/begin MEASUREMENT DDRC_St.DFC_ComflgTShntMeasmtErr "" ULONG DFC_OneToOne 1 100 0.00 536870911.000 BIT_MASK 0x1fffffff FORMAT "%13.3" ECU_ADDRESS 0x6001C33C /end MEASUREMENT
/begin MEASUREMENT DDRC_St.DFC_ComflgTShntMeasmtVld "" ULONG DFC_OneToOne 1 100 0.00 536870911.000 BIT_MASK 0x1fffffff FORMAT "%13.3" ECU_ADDRESS 0x6001C340 /end MEASUREMENT
/begin MEASUREMENT DDRC_St.DFC_ComflgTShntRngErr "" ULONG DFC_OneToOne 1 100 0.00 536870911.000 BIT_MASK 0x1fffffff FORMAT "%13.3" ECU_ADDRESS 0x6001C344 /end MEASUREMENT
/begin MEASUREMENT DDRC_St.DFC_ComflgTShntSysErr "" ULONG DFC_OneToOne 1 100 0.00 536870911.000 BIT_MASK 0x1fffffff FORMAT "%13.3" ECU_ADDRESS 0x6001C348 /end MEASUREMENT
/begin MEASUREMENT DDRC_St.DFC_ComflgVoltMeasmtErr "" ULONG DFC_OneToOne 1 100 0.00 536870911.000 BIT_MASK 0x1fffffff FORMAT "%13.3" ECU_ADDRESS 0x6001C34C /end MEASUREMENT
/begin MEASUREMENT DDRC_St.DFC_ComflgVoltMeasmtSysErr "" ULONG DFC_OneToOne 1 100 0.00 536870911.000 BIT_MASK 0x1fffffff FORMAT "%13.3" ECU_ADDRESS 0x6001C350 /end MEASUREMENT
/begin MEASUREMENT DDRC_St.DFC_ComflgVoltMeasmtVld "" ULONG DFC_OneToOne 1 100 0.00 536870911.000 BIT_MASK 0x1fffffff FORMAT "%13.3" ECU_ADDRESS 0x6001C354 /end MEASUREMENT
/begin MEASUREMENT DDRC_St.DFC_ComflgVoltRngErr "" ULONG DFC_OneToOne 1 100 0.00 536870911.000 BIT_MASK 0x1fffffff FORMAT "%13.3" ECU_ADDRESS 0x6001C358 /end MEASUREMENT
/begin MEASUREMENT DDRC_St.DFC_ETogFailrLvl3 "" ULONG DFC_OneToOne 1 100 0.00 536870911.000 BIT_MASK 0x1fffffff FORMAT "%13.3" ECU_ADDRESS 0x6001C380 /end MEASUREMENT
/begin MEASUREMENT DDRC_St.DFC_ETogFailrLvl4 "" ULONG DFC_OneToOne 1 100 0.00 536870911.000 BIT_MASK 0x1fffffff FORMAT "%13.3" ECU_ADDRESS 0x6001C384 /end MEASUREMENT
/begin MEASUREMENT DDRC_St.DFC_HvbEVLmpBlink "" ULONG DFC_OneToOne 1 100 0.00 536870911.000 BIT_MASK 0x1fffffff FORMAT "%13.3" ECU_ADDRESS 0x6001C430 /end MEASUREMENT
/begin MEASUREMENT DDRC_St.DFC_HvbEVLmpCont "" ULONG DFC_OneToOne 1 100 0.00 536870911.000 BIT_MASK 0x1fffffff FORMAT "%13.3" ECU_ADDRESS 0x6001C434 /end MEASUREMENT
/begin MEASUREMENT DFC_st.DFC_AirbgCan "" UBYTE DFC_OneToOne 1 100 0.00 255.0 FORMAT "%5.1" ECU_ADDRESS 0x600349DC /end MEASUREMENT
/begin MEASUREMENT DFC_st.DFC_ComChrgrEVCont "" UBYTE DFC_OneToOne 1 100 0.00 255.0 FORMAT "%5.1" ECU_ADDRESS 0x600349F9 /end MEASUREMENT
/begin MEASUREMENT DFC_st.DFC_ComChrgrEVtBlink "" UBYTE DFC_OneToOne 1 100 0.00 255.0 FORMAT "%5.1" ECU_ADDRESS 0x600349FA /end MEASUREMENT
/begin MEASUREMENT DFC_st.DFC_ComChrgrMstBlink "" UBYTE DFC_OneToOne 1 100 0.00 255.0 FORMAT "%5.1" ECU_ADDRESS 0x600349FB /end MEASUREMENT
/begin MEASUREMENT DFC_st.DFC_ComChrgrMstCont "" UBYTE DFC_OneToOne 1 100 0.00 255.0 FORMAT "%5.1" ECU_ADDRESS 0x600349FC /end MEASUREMENT
/begin MEASUREMENT DFC_st.DFC_ComChrgrSVSBlink "" UBYTE DFC_OneToOne 1 100 0.00 255.0 FORMAT "%5.1" ECU_ADDRESS 0x600349FD /end MEASUREMENT
/begin MEASUREMENT DFC_st.DFC_ComChrgrSVSCont "" UBYTE DFC_OneToOne 1 100 0.00 255.0 FORMAT "%5.1" ECU_ADDRESS 0x600349FE /end MEASUREMENT
/begin MEASUREMENT DFC_st.DFC_ComDcdcEVBlink "" UBYTE DFC_OneToOne 1 100 0.00 255.0 FORMAT "%5.1" ECU_ADDRESS 0x600349FF /end MEASUREMENT
/begin MEASUREMENT DFC_st.DFC_ComDcdcEVCont "" UBYTE DFC_OneToOne 1 100 0.00 255.0 FORMAT "%5.1" ECU_ADDRESS 0x60034A00 /end MEASUREMENT
/begin MEASUREMENT DFC_st.DFC_ComDcdcMstBlink "" UBYTE DFC_OneToOne 1 100 0.00 255.0 FORMAT "%5.1" ECU_ADDRESS 0x60034A06 /end MEASUREMENT
/begin MEASUREMENT DFC_st.DFC_ComDcdcMstCont "" UBYTE DFC_OneToOne 1 100 0.00 255.0 FORMAT "%5.1" ECU_ADDRESS 0x60034A07 /end MEASUREMENT
/begin MEASUREMENT DFC_st.DFC_ComDcdcSVSBlink "" UBYTE DFC_OneToOne 1 100 0.00 255.0 FORMAT "%5.1" ECU_ADDRESS 0x60034A08 /end MEASUREMENT
/begin MEASUREMENT DFC_st.DFC_ComDcdcSVSCont "" UBYTE DFC_OneToOne 1 100 0.00 255.0 FORMAT "%5.1" ECU_ADDRESS 0x60034A09 /end MEASUREMENT
/begin MEASUREMENT DFC_st.DFC_ComEmacEVBlink "" UBYTE DFC_OneToOne 1 100 0.00 255.0 FORMAT "%5.1" ECU_ADDRESS 0x60034A0F /end MEASUREMENT
/begin MEASUREMENT DFC_st.DFC_ComEmacEVCont "" UBYTE DFC_OneToOne 1 100 0.00 255.0 FORMAT "%5.1" ECU_ADDRESS 0x60034A10 /end MEASUREMENT
/begin MEASUREMENT DFC_st.DFC_ComEmacMstCont "" UBYTE DFC_OneToOne 1 100 0.00 255.0 FORMAT "%5.1" ECU_ADDRESS 0x60034A11 /end MEASUREMENT
/begin MEASUREMENT DFC_st.DFC_ComEmacMsttBlink "" UBYTE DFC_OneToOne 1 100 0.00 255.0 FORMAT "%5.1" ECU_ADDRESS 0x60034A12 /end MEASUREMENT
/begin MEASUREMENT DFC_st.DFC_ComEmacSVSBlink "" UBYTE DFC_OneToOne 1 100 0.00 255.0 FORMAT "%5.1" ECU_ADDRESS 0x60034A13 /end MEASUREMENT
/begin MEASUREMENT DFC_st.DFC_ComEmacSVSCont "" UBYTE DFC_OneToOne 1 100 0.00 255.0 FORMAT "%5.1" ECU_ADDRESS 0x60034A14 /end MEASUREMENT
/begin MEASUREMENT DFC_st.DFC_ComHvbMstBlink "" UBYTE DFC_OneToOne 1 100 0.00 255.0 FORMAT "%5.1" ECU_ADDRESS 0x60034A1D /end MEASUREMENT
/begin MEASUREMENT DFC_st.DFC_ComHvbMstCont "" UBYTE DFC_OneToOne 1 100 0.00 255.0 FORMAT "%5.1" ECU_ADDRESS 0x60034A1E /end MEASUREMENT
/begin MEASUREMENT DFC_st.DFC_ComflgCurMeasmtErr "" UBYTE DFC_OneToOne 1 100 0.00 255.0 FORMAT "%5.1" ECU_ADDRESS 0x60034A2A /end MEASUREMENT
/begin MEASUREMENT DFC_st.DFC_ComflgCurMeasmtSysErr "" UBYTE DFC_OneToOne 1 100 0.00 255.0 FORMAT "%5.1" ECU_ADDRESS 0x60034A2B /end MEASUREMENT
/begin MEASUREMENT DFC_st.DFC_ComflgCurMeasmtVld "" UBYTE DFC_OneToOne 1 100 0.00 255.0 FORMAT "%5.1" ECU_ADDRESS 0x60034A2C /end MEASUREMENT
/begin MEASUREMENT DFC_st.DFC_ComflgCurRngErr "" UBYTE DFC_OneToOne 1 100 0.00 255.0 FORMAT "%5.1" ECU_ADDRESS 0x60034A2D /end MEASUREMENT
/begin MEASUREMENT DFC_st.DFC_ComflgTPcbMeasmtErr "" UBYTE DFC_OneToOne 1 100 0.00 255.0 FORMAT "%5.1" ECU_ADDRESS 0x60034A2E /end MEASUREMENT
/begin MEASUREMENT DFC_st.DFC_ComflgTPcbMeasmtVld "" UBYTE DFC_OneToOne 1 100 0.00 255.0 FORMAT "%5.1" ECU_ADDRESS 0x60034A2F /end MEASUREMENT
/begin MEASUREMENT DFC_st.DFC_ComflgTPcbRngErr "" UBYTE DFC_OneToOne 1 100 0.00 255.0 FORMAT "%5.1" ECU_ADDRESS 0x60034A30 /end MEASUREMENT
/begin MEASUREMENT DFC_st.DFC_ComflgTPcbSysErr "" UBYTE DFC_OneToOne 1 100 0.00 255.0 FORMAT "%5.1" ECU_ADDRESS 0x60034A31 /end MEASUREMENT
/begin MEASUREMENT DFC_st.DFC_ComflgTShntMeasmtErr "" UBYTE DFC_OneToOne 1 100 0.00 255.0 FORMAT "%5.1" ECU_ADDRESS 0x60034A32 /end MEASUREMENT
/begin MEASUREMENT DFC_st.DFC_ComflgTShntMeasmtVld "" UBYTE DFC_OneToOne 1 100 0.00 255.0 FORMAT "%5.1" ECU_ADDRESS 0x60034A33 /end MEASUREMENT
/begin MEASUREMENT DFC_st.DFC_ComflgTShntRngErr "" UBYTE DFC_OneToOne 1 100 0.00 255.0 FORMAT "%5.1" ECU_ADDRESS 0x60034A34 /end MEASUREMENT
/begin MEASUREMENT DFC_st.DFC_ComflgTShntSysErr "" UBYTE DFC_OneToOne 1 100 0.00 255.0 FORMAT "%5.1" ECU_ADDRESS 0x60034A35 /end MEASUREMENT
/begin MEASUREMENT DFC_st.DFC_ComflgVoltMeasmtErr "" UBYTE DFC_OneToOne 1 100 0.00 255.0 FORMAT "%5.1" ECU_ADDRESS 0x60034A36 /end MEASUREMENT
/begin MEASUREMENT DFC_st.DFC_ComflgVoltMeasmtSysErr "" UBYTE DFC_OneToOne 1 100 0.00 255.0 FORMAT "%5.1" ECU_ADDRESS 0x60034A37 /end MEASUREMENT
/begin MEASUREMENT DFC_st.DFC_ComflgVoltMeasmtVld "" UBYTE DFC_OneToOne 1 100 0.00 255.0 FORMAT "%5.1" ECU_ADDRESS 0x60034A38 /end MEASUREMENT
/begin MEASUREMENT DFC_st.DFC_ComflgVoltRngErr "" UBYTE DFC_OneToOne 1 100 0.00 255.0 FORMAT "%5.1" ECU_ADDRESS 0x60034A39 /end MEASUREMENT
/begin MEASUREMENT DFC_st.DFC_ETogFailrLvl3 "" UBYTE DFC_OneToOne 1 100 0.00 255.0 FORMAT "%5.1" ECU_ADDRESS 0x60034A43 /end MEASUREMENT
/begin MEASUREMENT DFC_st.DFC_ETogFailrLvl4 "" UBYTE DFC_OneToOne 1 100 0.00 255.0 FORMAT "%5.1" ECU_ADDRESS 0x60034A44 /end MEASUREMENT
/begin MEASUREMENT DFC_st.DFC_HvbEVLmpBlink "" UBYTE DFC_OneToOne 1 100 0.00 255.0 FORMAT "%5.1" ECU_ADDRESS 0x60034A6F /end MEASUREMENT
/begin MEASUREMENT DFC_st.DFC_HvbEVLmpCont "" UBYTE DFC_OneToOne 1 100 0.00 255.0 FORMAT "%5.1" ECU_ADDRESS 0x60034A70 /end MEASUREMENT
/begin MEASUREMENT DINH_nrActvInhReas.FId_BrkPresAlrt "" UWORD DINH_ct_Compu 1 100 -4095.000 4096.000 BIT_MASK 0x1fff FORMAT "%8.3" ECU_ADDRESS 0x60021358 /end MEASUREMENT
/begin MEASUREMENT DINH_nrActvInhReas.FId_EBDLmpSig "" UWORD DINH_ct_Compu 1 100 -4095.000 4096.000 BIT_MASK 0x1fff FORMAT "%8.3" ECU_ADDRESS 0x60021436 /end MEASUREMENT
/begin MEASUREMENT DINH_nrActvInhReas.FId_EVLmpBlnkIllmn "" UWORD DINH_ct_Compu 1 100 -4095.000 4096.000 BIT_MASK 0x1fff FORMAT "%8.3" ECU_ADDRESS 0x60021438 /end MEASUREMENT
/begin MEASUREMENT DINH_nrActvInhReas.FId_EVLmpContIllmn "" UWORD DINH_ct_Compu 1 100 -4095.000 4096.000 BIT_MASK 0x1fff FORMAT "%8.3" ECU_ADDRESS 0x6002143A /end MEASUREMENT
/begin MEASUREMENT DINH_nrActvInhReas.FId_MstWrnLmpBlink "" UWORD DINH_ct_Compu 1 100 -4095.000 4096.000 BIT_MASK 0x1fff FORMAT "%8.3" ECU_ADDRESS 0x60021504 /end MEASUREMENT
/begin MEASUREMENT DINH_nrActvInhReas.FId_MstWrnLmpChime "" UWORD DINH_ct_Compu 1 100 -4095.000 4096.000 BIT_MASK 0x1fff FORMAT "%8.3" ECU_ADDRESS 0x60021506 /end MEASUREMENT
/begin MEASUREMENT DINH_nrActvInhReas.FId_MstWrnLmpContIllmn "" UWORD DINH_ct_Compu 1 100 -4095.000 4096.000 BIT_MASK 0x1fff FORMAT "%8.3" ECU_ADDRESS 0x60021508 /end MEASUREMENT
/begin MEASUREMENT DINH_nrActvInhReas.FId_PerfLimnActvLmpBlink "" UWORD DINH_ct_Compu 1 100 -4095.000 4096.000 BIT_MASK 0x1fff FORMAT "%8.3" ECU_ADDRESS 0x6002151A /end MEASUREMENT
/begin MEASUREMENT DINH_nrActvInhReas.FId_PerfLimnActvLmpCont "" UWORD DINH_ct_Compu 1 100 -4095.000 4096.000 BIT_MASK 0x1fff FORMAT "%8.3" ECU_ADDRESS 0x6002151C /end MEASUREMENT
/begin MEASUREMENT DINH_nrActvInhReas.FId_PerfLimnActvLmpContNoChime "" UWORD DINH_ct_Compu 1 100 -4095.000 4096.000 BIT_MASK 0x1fff FORMAT "%8.3" ECU_ADDRESS 0x6002151E /end MEASUREMENT
/begin MEASUREMENT DINH_nrActvInhReas.FId_SVSWrnLmpBlnkIllmn "" UWORD DINH_ct_Compu 1 100 -4095.000 4096.000 BIT_MASK 0x1fff FORMAT "%8.3" ECU_ADDRESS 0x60021554 /end MEASUREMENT
/begin MEASUREMENT DINH_nrActvInhReas.FId_SVSWrnLmpContIllmn "" UWORD DINH_ct_Compu 1 100 -4095.000 4096.000 BIT_MASK 0x1fff FORMAT "%8.3" ECU_ADDRESS 0x60021556 /end MEASUREMENT
/begin MEASUREMENT DINH_nrActvInhReas.FId_bInh_Sig259hFlt "" UWORD DINH_ct_Compu 1 100 -4095.000 4096.000 BIT_MASK 0x1fff FORMAT "%8.3" ECU_ADDRESS 0x60021A04 /end MEASUREMENT
/begin MEASUREMENT DINH_nrActvInhReas.FId_bInh_Sig_Com_flgEcoNormReq_Frz "" UWORD DINH_ct_Compu 1 100 -4095.000 4096.000 BIT_MASK 0x1fff FORMAT "%8.3" ECU_ADDRESS 0x60021B74 /end MEASUREMENT
/begin MEASUREMENT DINH_nrActvInhReas.FId_bInh_Sig_Com_stGearLvrPos_Frz "" UWORD DINH_ct_Compu 1 100 -4095.000 4096.000 BIT_MASK 0x1fff FORMAT "%8.3" ECU_ADDRESS 0x60021B7C /end MEASUREMENT
/begin MEASUREMENT DINH_nrActvInhReas.FId_binnh_Sig_ComEmac_stActvDcha_Sq_Frz "" UWORD DINH_ct_Compu 1 100 -4095.000 4096.000 BIT_MASK 0x1fff FORMAT "%8.3" ECU_ADDRESS 0x60021B98 /end MEASUREMENT
/begin MEASUREMENT DINH_nrActvInhReas.FId_binnh_Sig_Com_pwrDcdcOutpCpby_Sq_Frz "" UWORD DINH_ct_Compu 1 100 -4095.000 4096.000 BIT_MASK 0x1fff FORMAT "%8.3" ECU_ADDRESS 0x60021BB6 /end MEASUREMENT
/begin MEASUREMENT DINH_nrActvInhReas.FId_binnh_Sig_Com_rHvbIsoMeasmt_Sq_Frz "" UWORD DINH_ct_Compu 1 100 -4095.000 4096.000 BIT_MASK 0x1fff FORMAT "%8.3" ECU_ADDRESS 0x60021BB8 /end MEASUREMENT
/begin MEASUREMENT DINH_nrActvInhReas.FId_binnh_Sig_Com_stHvbSrvPlg_Sq_Frz "" UWORD DINH_ct_Compu 1 100 -4095.000 4096.000 BIT_MASK 0x1fff FORMAT "%8.3" ECU_ADDRESS 0x60021BCC /end MEASUREMENT
/begin MEASUREMENT DINH_nrActvInhReas.FId_binnh_Sig_Com_uHvbDcBus_Sq_Frz "" UWORD DINH_ct_Compu 1 100 -4095.000 4096.000 BIT_MASK 0x1fff FORMAT "%8.3" ECU_ADDRESS 0x60021BD4 /end MEASUREMENT
/begin MEASUREMENT DINH_stFId.FId_BrkPresAlrt "" UWORD DFC_OneToOne 1 100 0.00 65535.00 FORMAT "%8.2" ECU_ADDRESS 0x60021358 /end MEASUREMENT
/begin MEASUREMENT DINH_stFId.FId_EBDLmpSig "" UWORD DFC_OneToOne 1 100 0.00 65535.00 FORMAT "%8.2" ECU_ADDRESS 0x60021436 /end MEASUREMENT
/begin MEASUREMENT DINH_stFId.FId_EVLmpBlnkIllmn "" UWORD DFC_OneToOne 1 100 0.00 65535.00 FORMAT "%8.2" ECU_ADDRESS 0x60021438 /end MEASUREMENT
/begin MEASUREMENT DINH_stFId.FId_EVLmpContIllmn "" UWORD DFC_OneToOne 1 100 0.00 65535.00 FORMAT "%8.2" ECU_ADDRESS 0x6002143A /end MEASUREMENT
/begin MEASUREMENT DINH_stFId.FId_MstWrnLmpBlink "" UWORD DFC_OneToOne 1 100 0.00 65535.00 FORMAT "%8.2" ECU_ADDRESS 0x60021504 /end MEASUREMENT
/begin MEASUREMENT DINH_stFId.FId_MstWrnLmpChime "" UWORD DFC_OneToOne 1 100 0.00 65535.00 FORMAT "%8.2" ECU_ADDRESS 0x60021506 /end MEASUREMENT
/begin MEASUREMENT DINH_stFId.FId_MstWrnLmpContIllmn "" UWORD DFC_OneToOne 1 100 0.00 65535.00 FORMAT "%8.2" ECU_ADDRESS 0x60021508 /end MEASUREMENT
/begin MEASUREMENT DINH_stFId.FId_PerfLimnActvLmpBlink "" UWORD DFC_OneToOne 1 100 0.00 65535.00 FORMAT "%8.2" ECU_ADDRESS 0x6002151A /end MEASUREMENT
/begin MEASUREMENT DINH_stFId.FId_PerfLimnActvLmpCont "" UWORD DFC_OneToOne 1 100 0.00 65535.00 FORMAT "%8.2" ECU_ADDRESS 0x6002151C /end MEASUREMENT
/begin MEASUREMENT DINH_stFId.FId_PerfLimnActvLmpContNoChime "" UWORD DFC_OneToOne 1 100 0.00 65535.00 FORMAT "%8.2" ECU_ADDRESS 0x6002151E /end MEASUREMENT
/begin MEASUREMENT DINH_stFId.FId_SVSWrnLmpBlnkIllmn "" UWORD DFC_OneToOne 1 100 0.00 65535.00 FORMAT "%8.2" ECU_ADDRESS 0x60021554 /end MEASUREMENT
/begin MEASUREMENT DINH_stFId.FId_SVSWrnLmpContIllmn "" UWORD DFC_OneToOne 1 100 0.00 65535.00 FORMAT "%8.2" ECU_ADDRESS 0x60021556 /end MEASUREMENT
/begin MEASUREMENT DINH_stFId.FId_bInh_Sig259hFlt "" UWORD DFC_OneToOne 1 100 0.00 65535.00 FORMAT "%8.2" ECU_ADDRESS 0x60021A04 /end MEASUREMENT
/begin MEASUREMENT DINH_stFId.FId_bInh_Sig_Com_flgEcoNormReq_Frz "" UWORD DFC_OneToOne 1 100 0.00 65535.00 FORMAT "%8.2" ECU_ADDRESS 0x60021B74 /end MEASUREMENT
/begin MEASUREMENT DINH_stFId.FId_bInh_Sig_Com_stGearLvrPos_Frz "" UWORD DFC_OneToOne 1 100 0.00 65535.00 FORMAT "%8.2" ECU_ADDRESS 0x60021B7C /end MEASUREMENT
/begin MEASUREMENT DINH_stFId.FId_binnh_Sig_ComEmac_stActvDcha_Sq_Frz "" UWORD DFC_OneToOne 1 100 0.00 65535.00 FORMAT "%8.2" ECU_ADDRESS 0x60021B98 /end MEASUREMENT
/begin MEASUREMENT DINH_stFId.FId_binnh_Sig_Com_pwrDcdcOutpCpby_Sq_Frz "" UWORD DFC_OneToOne 1 100 0.00 65535.00 FORMAT "%8.2" ECU_ADDRESS 0x60021BB6 /end MEASUREMENT
/begin MEASUREMENT DINH_stFId.FId_binnh_Sig_Com_rHvbIsoMeasmt_Sq_Frz "" UWORD DFC_OneToOne 1 100 0.00 65535.00 FORMAT "%8.2" ECU_ADDRESS 0x60021BB8 /end MEASUREMENT
/begin MEASUREMENT DINH_stFId.FId_binnh_Sig_Com_stHvbSrvPlg_Sq_Frz "" UWORD DFC_OneToOne 1 100 0.00 65535.00 FORMAT "%8.2" ECU_ADDRESS 0x60021BCC /end MEASUREMENT
/begin MEASUREMENT DINH_stFId.FId_binnh_Sig_Com_uHvbDcBus_Sq_Frz "" UWORD DFC_OneToOne 1 100 0.00 65535.00 FORMAT "%8.2" ECU_ADDRESS 0x60021BD4 /end MEASUREMENT
/begin MEASUREMENT DrvPrgSwt_stRcpt "Driver requested recuperation factor" UBYTE OneToOne 1 100 0.00 255.0 FORMAT "%5.1" ECU_ADDRESS 0x700014BF
 /begin IF_DATA XCPplus 0x0102
  /begin DAQ_EVENT VARIABLE /end DAQ_EVENT
 /end IF_DATA
/end MEASUREMENT
/begin MEASUREMENT Eem_pwrMaxLimDcdc "Maximum power limit of dcdc" SWORD RBPtCel_pwr_25p0_1 1 100 -819200.0 819175.0 FORMAT "%8.1" ECU_ADDRESS 0x70001542
 /begin IF_DATA XCPplus 0x0102
  /begin DAQ_EVENT VARIABLE /end DAQ_EVENT
 /end IF_DATA
/end MEASUREMENT
/begin MEASUREMENT ElM_pwrElecPredTracMaxLo "Power prediction for EM" SWORD RBPtCel_pwr_25p0_1 1 100 -819200.0 819175.0 FORMAT "%8.1" ECU_ADDRESS 0x70001540
 /begin IF_DATA XCPplus 0x0102
  /begin DAQ_EVENT VARIABLE /end DAQ_EVENT
 /end IF_DATA
/end MEASUREMENT
/begin MEASUREMENT Emac_tqDesCom02 "desired torque e-machine 02" SWORD Trq 1 100 -3276.800 3276.700 FORMAT "%8.3" ECU_ADDRESS 0x7000153E
 /begin IF_DATA XCPplus 0x0102
  /begin DAQ_EVENT VARIABLE /end DAQ_EVENT
 /end IF_DATA
/end MEASUREMENT
/begin MEASUREMENT EnvT_t "Environment temperature signal (with replacement reaction in case of sensor error)" SWORD Temp_Cels 1 100 -3549.940 3003.560 FORMAT "%8.3" ECU_ADDRESS 0x7000153C
 /begin IF_DATA XCPplus 0x0102
  /begin DAQ_EVENT VARIABLE /end DAQ_EVENT
 /end IF_DATA
/end MEASUREMENT
/begin MEASUREMENT EnvT_t_Sq "10) Signal Quality of Environment Temperature." UBYTE SigQly_COMPU_VERB 1 100 0.00 15.0000000000 FORMAT "%13.10" ECU_ADDRESS 0x700014BE
 /begin IF_DATA XCPplus 0x0102
  /begin DAQ_EVENT VARIABLE /end DAQ_EVENT
 /end IF_DATA
/end MEASUREMENT
/begin MEASUREMENT Epm_nEng "Average engine speed of one cylinder segment" SWORD EngN 1 100 -16384.00 16383.50 FORMAT "%8.2" ECU_ADDRESS 0x7000153A
 /begin IF_DATA XCPplus 0x0102
  /begin DAQ_EVENT VARIABLE /end DAQ_EVENT
 /end IF_DATA
/end MEASUREMENT
/begin MEASUREMENT Epm_nEngLRes "engine speed with low resolution" UBYTE EngN_LRes 1 100 0.00 10200. FORMAT "%5.0" ECU_ADDRESS 0x700014BD
 /begin IF_DATA XCPplus 0x0102
  /begin DAQ_EVENT VARIABLE /end DAQ_EVENT
 /end IF_DATA
/end MEASUREMENT
/begin MEASUREMENT Epm_numCyl "Actual number of cylinders" SBYTE OneToOne 1 100 -128.0 127.0 FORMAT "%5.1" ECU_ADDRESS 0x70001500
 /begin IF_DATA XCPplus 0x0102
  /begin DAQ_EVENT VARIABLE /end DAQ_EVENT
 /end IF_DATA
/end MEASUREMENT
/begin MEASUREMENT Epm_stSpd "Selection of the engine speed" UBYTE Epm_stSpd_t 1 100 0.00 4.00000000000 FORMAT "%13.11" ECU_ADDRESS 0x700014BC
 /begin IF_DATA XCPplus 0x0102
  /begin DAQ_EVENT VARIABLE /end DAQ_EVENT
 /end IF_DATA
/end MEASUREMENT
/begin MEASUREMENT ExhMod_pRelPfilDs "Modelled relative pressure downstream of particulate filter" SWORD Pres_hPa 1 100 -32768.00 32767.00 FORMAT "%8.2" ECU_ADDRESS 0x70001538
 /begin IF_DATA XCPplus 0x0102
  /begin DAQ_EVENT VARIABLE /end DAQ_EVENT
 /end IF_DATA
/end MEASUREMENT
/begin MEASUREMENT Ext_bCalidEmCf "Variable to diferentiate CN6 and Non CN norms" UBYTE B_TRUE 1 100 0.00 1.00000000000 BIT_MASK 0x1 FORMAT "%13.11" ECU_ADDRESS 0x70001491
 /begin IF_DATA XCPplus 0x0102
  /begin DAQ_EVENT VARIABLE /end DAQ_EVENT
 /end IF_DATA
/end MEASUREMENT
/begin MEASUREMENT Ext_bFctHldReqCdn "Wake-up hold condition" UBYTE B_TRUE 1 100 0.00 1.00000000000 BIT_MASK 0x1 FORMAT "%13.11" ECU_ADDRESS 0x70001490
 /begin IF_DATA XCPplus 0x0102
  /begin DAQ_EVENT VARIABLE /end DAQ_EVENT
 /end IF_DATA
/end MEASUREMENT
/begin MEASUREMENT fmsdhfs_w_msg "Factor of air mass flow by throttle valve and by main charge sensor" UWORD fak_uw_b4 1 100 0.00 3.999939 FORMAT "%8.6" ECU_ADDRESS 0x70001504
 /begin IF_DATA XCPplus 0x0102
  /begin DAQ_EVENT VARIABLE /end DAQ_EVENT
 /end IF_DATA
/end MEASUREMENT
/begin MEASUREMENT ftu_msg "factor: ambient temperature" UBYTE fak_ub_b2 1 100 0.00 1.992188 FORMAT "%8.6" ECU_ADDRESS 0x700014B0
 /begin IF_DATA XCPplus 0x0102
  /begin DAQ_EVENT VARIABLE /end DAQ_EVENT
 /end IF_DATA
/end MEASUREMENT
/begin MEASUREMENT GbxPos_flgCustSpcCdn "customer specific switching condition" UBYTE B_TRUE 1 100 0.00 1.00000000000 BIT_MASK 0x1 FORMAT "%13.11" ECU_ADDRESS 0x7000148F
 /begin IF_DATA XCPplus 0x0102
  /begin DAQ_EVENT VARIABLE /end DAQ_EVENT
 /end IF_DATA
/end MEASUREMENT
/begin MEASUREMENT GbxPos_stGearLvrPos "Gear lever position of Manual gearbox" UBYTE OneToOne 1 100 0.00 255.0 FORMAT "%5.1" ECU_ADDRESS 0x700014B9
 /begin IF_DATA XCPplus 0x0102
  /begin DAQ_EVENT VARIABLE /end DAQ_EVENT
 /end IF_DATA
/end MEASUREMENT
/begin MEASUREMENT GlbDa_lWhlCirc "wheel circumference" SWORD Length_fine 1 100 -32.76800 32.76700 FORMAT "%8.5" ECU_ADDRESS 0x70001534
 /begin IF_DATA XCPplus 0x0102
  /begin DAQ_EVENT VARIABLE /end DAQ_EVENT
 /end IF_DATA
/end MEASUREMENT
/begin MEASUREMENT GlbDa_rdWhl "Radius of the wheel" SWORD LengthFine 1 100 -32.76800 32.76700 FORMAT "%8.5" ECU_ADDRESS 0x70001532
 /begin IF_DATA XCPplus 0x0102
  /begin DAQ_EVENT VARIABLE /end DAQ_EVENT
 /end IF_DATA
/end MEASUREMENT
/begin MEASUREMENT GlbDa_stTrqDem "contains highest prior function with torque demand" UWORD OneToOne 1 100 0.00 65535.00 FORMAT "%8.2" ECU_ADDRESS 0x7000150C
 /begin IF_DATA XCPplus 0x0102
  /begin DAQ_EVENT VARIABLE /end DAQ_EVENT
 /end IF_DATA
/end MEASUREMENT
/begin MEASUREMENT HndBrk_stDebVal "Debounced value of Hand Brake switch" UBYTE OneToOne 1 100 0.00 255.0 FORMAT "%5.1" ECU_ADDRESS 0x700014B7
 /begin IF_DATA XCPplus 0x0102
  /begin DAQ_EVENT VARIABLE /end DAQ_EVENT
 /end IF_DATA
/end MEASUREMENT
/begin MEASUREMENT HvBatt_egyAvlTot_f "HV battery total available energy" FLOAT32_IEEE RBPtCel_pwr_1p0_4 1 100 -1.00000000E+037 1.00000000E+037 FORMAT "%13.3" ECU_ADDRESS 0x700015CC
 /begin IF_DATA XCPplus 0x0102
  /begin DAQ_EVENT VARIABLE /end DAQ_EVENT
 /end IF_DATA
/end MEASUREMENT
/begin MEASUREMENT InjCtl_qSetUnBal "current injection quantity" SWORD InjMass 1 100 -327.6800 327.6700 FORMAT "%8.4" ECU_ADDRESS 0x70001530
 /begin IF_DATA XCPplus 0x0102
  /begin DAQ_EVENT VARIABLE /end DAQ_EVENT
 /end IF_DATA
/end MEASUREMENT
/begin MEASUREMENT IntlckChrgPlg_rDesVal "Position setpoint" SWORD Prc 1 100 -400.0000 399.9878 FORMAT "%8.4" ECU_ADDRESS 0x7000152E
 /begin IF_DATA XCPplus 0x0102
  /begin DAQ_EVENT VARIABLE /end DAQ_EVENT
 /end IF_DATA
/end MEASUREMENT
/begin MEASUREMENT MoFDrvrAssc_flgDrvrAsscPtdMsg "message to level 1: a driver assistance function (cruise) is active and valid" UBYTE B_TRUE 1 100 0.00 1.00000000000 BIT_MASK 0x1 FORMAT "%13.11" ECU_ADDRESS 0x7000148D
 /begin IF_DATA XCPplus 0x0102
  /begin DAQ_EVENT VARIABLE /end DAQ_EVENT
 /end IF_DATA
/end MEASUREMENT
/begin MEASUREMENT MoFEmgOff_stPWMCrashDeploy "PWM crash status to monitoring team" UBYTE OneToOne 1 100 0.00 255.0 FORMAT "%5.1" ECU_ADDRESS 0x700014B5
 /begin IF_DATA XCPplus 0x0102
  /begin DAQ_EVENT VARIABLE /end DAQ_EVENT
 /end IF_DATA
/end MEASUREMENT
/begin MEASUREMENT mshfmdk_w_msg "model. air mass flow based on throttle at installed position of MAF sensor" UWORD m_uw_b6553p5 1 100 0.00 6553.500 FORMAT "%8.3" ECU_ADDRESS 0x70001502
 /begin IF_DATA XCPplus 0x0102
  /begin DAQ_EVENT VARIABLE /end DAQ_EVENT
 /end IF_DATA
/end MEASUREMENT
/begin MEASUREMENT ofpu_w_msg "Offset-voltage for ambient pressure sensor" SWORD p_q0p039 1 100 -1280.000 1279.961 FORMAT "%8.3" ECU_ADDRESS 0x7000151C
 /begin IF_DATA XCPplus 0x0102
  /begin DAQ_EVENT VARIABLE /end DAQ_EVENT
 /end IF_DATA
/end MEASUREMENT
/begin MEASUREMENT PCR_pDesVal "Limited boost pressure setpoint" SWORD Pres_hPa 1 100 -32768.00 32767.00 FORMAT "%8.2" ECU_ADDRESS 0x7000152C
 /begin IF_DATA XCPplus 0x0102
  /begin DAQ_EVENT VARIABLE /end DAQ_EVENT
 /end IF_DATA
/end MEASUREMENT
/begin MEASUREMENT PThrVlvUs_pB1 "pressure upstream throttle valve bank1" UWORD p_q0p078 1 100 0.00 5119.922 FORMAT "%8.3" ECU_ADDRESS 0x7000150A
 /begin IF_DATA XCPplus 0x0102
  /begin DAQ_EVENT VARIABLE /end DAQ_EVENT
 /end IF_DATA
/end MEASUREMENT
/begin MEASUREMENT SCtPmp1T_t "Actual physical value" SWORD Temp_Cels 1 100 -3549.940 3003.560 FORMAT "%8.3" ECU_ADDRESS 0x7000152A
 /begin IF_DATA XCPplus 0x0102
  /begin DAQ_EVENT VARIABLE /end DAQ_EVENT
 /end IF_DATA
/end MEASUREMENT
/begin MEASUREMENT StabyIntv_flgDCSIntv01 "DCS intervention requested (e-machine 1)" UBYTE B_TRUE 1 100 0.00 1.00000000000 BIT_MASK 0x1 FORMAT "%13.11" ECU_ADDRESS 0x7000148C
 /begin IF_DATA XCPplus 0x0102
  /begin DAQ_EVENT VARIABLE /end DAQ_EVENT
 /end IF_DATA
/end MEASUREMENT
/begin MEASUREMENT StabyIntv_flgTCSIntv01 "TCS intervention requested (e-machine 1)" UBYTE B_TRUE 1 100 0.00 1.00000000000 BIT_MASK 0x1 FORMAT "%13.11" ECU_ADDRESS 0x7000148B
 /begin IF_DATA XCPplus 0x0102
  /begin DAQ_EVENT VARIABLE /end DAQ_EVENT
 /end IF_DATA
/end MEASUREMENT
/begin MEASUREMENT StabyIntv_tqDCSDes01 "DCS intervention torque (e-machine 1)" SLONG TrqPrpHigh 1 100 -214748364.800 214748364.700 FORMAT "%13.3" ECU_ADDRESS 0x700015A4
 /begin IF_DATA XCPplus 0x0102
  /begin DAQ_EVENT VARIABLE /end DAQ_EVENT
 /end IF_DATA
/end MEASUREMENT
/begin MEASUREMENT StabyIntv_tqTCSDes01 "TCS intervention torque (e-machine 1)" SLONG TrqPrpHigh 1 100 -214748364.800 214748364.700 FORMAT "%13.3" ECU_ADDRESS 0x700015A0
 /begin IF_DATA XCPplus 0x0102
  /begin DAQ_EVENT VARIABLE /end DAQ_EVENT
 /end IF_DATA
/end MEASUREMENT
/begin MEASUREMENT SWAdpCOM_flgEcoNormReq_Sq "Flag to indicate Signal quality of Eco normal switch" UBYTE B_TRUE 1 100 0.00 1.00000000000 BIT_MASK 0x1 FORMAT "%13.11" ECU_ADDRESS 0x60022FD0
 /begin IF_DATA XCPplus 0x0102
  /begin DAQ_EVENT VARIABLE /end DAQ_EVENT
 /end IF_DATA
/end MEASUREMENT
/begin MEASUREMENT SWAdpCOM_pwrDcdcOutpCpby_SqLoc "SWAdpCOM_pwrDcdcOutpCpby_SqLoc" UBYTE B_TRUE 1 100 0.00 1.00000000000 BIT_MASK 0x1 FORMAT "%13.11" ECU_ADDRESS 0x60022FCF
 /begin IF_DATA XCPplus 0x0102
  /begin DAQ_EVENT VARIABLE /end DAQ_EVENT
 /end IF_DATA
/end MEASUREMENT
/begin MEASUREMENT SWAdpCOM_stGearLvrPos_Sq "Flag to indicate Signal quality of gear lever position" UBYTE B_TRUE 1 100 0.00 1.00000000000 BIT_MASK 0x1 FORMAT "%13.11" ECU_ADDRESS 0x60022FCE
 /begin IF_DATA XCPplus 0x0102
  /begin DAQ_EVENT VARIABLE /end DAQ_EVENT
 /end IF_DATA
/end MEASUREMENT
/begin MEASUREMENT SWAdp_flgDesLvGridULimLoc "SWAdp_flgDesLvGridULimLoc" UBYTE B_TRUE 1 100 0.00 1.00000000000 BIT_MASK 0x1 FORMAT "%13.11" ECU_ADDRESS 0x60022FCD
 /begin IF_DATA XCPplus 0x0102
  /begin DAQ_EVENT VARIABLE /end DAQ_EVENT
 /end IF_DATA
/end MEASUREMENT
/begin MEASUREMENT SWAdp_rHvbIsoMeasmt_SqLoc "SWAdp_rHvbIsoMeasmt_SqLoc" UBYTE B_TRUE 1 100 0.00 1.00000000000 BIT_MASK 0x1 FORMAT "%13.11" ECU_ADDRESS 0x60022FCC
 /begin IF_DATA XCPplus 0x0102
  /begin DAQ_EVENT VARIABLE /end DAQ_EVENT
 /end IF_DATA
/end MEASUREMENT
/begin MEASUREMENT SWAdp_stActvDcha_SqLoc "SWAdp_stActvDcha_SqLoc" UBYTE B_TRUE 1 100 0.00 1.00000000000 BIT_MASK 0x1 FORMAT "%13.11" ECU_ADDRESS 0x60022FCB
 /begin IF_DATA XCPplus 0x0102
  /begin DAQ_EVENT VARIABLE /end DAQ_EVENT
 /end IF_DATA
/end MEASUREMENT
/begin MEASUREMENT SWAdp_stHvbSrvPlg_SqLoc "SWAdp_stHvbSrvPlg_SqLoc" UBYTE B_TRUE 1 100 0.00 1.00000000000 BIT_MASK 0x1 FORMAT "%13.11" ECU_ADDRESS 0x60022FCA
 /begin IF_DATA XCPplus 0x0102
  /begin DAQ_EVENT VARIABLE /end DAQ_EVENT
 /end IF_DATA
/end MEASUREMENT
/begin MEASUREMENT SWAdp_uHvbDcBus_SqLoc "SWAdp_uHvbDcBus_SqLoc" UBYTE B_TRUE 1 100 0.00 1.00000000000 BIT_MASK 0x1 FORMAT "%13.11" ECU_ADDRESS 0x60022FC9
 /begin IF_DATA XCPplus 0x0102
  /begin DAQ_EVENT VARIABLE /end DAQ_EVENT
 /end IF_DATA
/end MEASUREMENT
/begin MEASUREMENT T15_bECUTyp "Flag to indicate the RCD type" UBYTE B_TRUE 1 100 0.00 1.00000000000 BIT_MASK 0x1 FORMAT "%13.11" ECU_ADDRESS 0x7000148A
 /begin IF_DATA XCPplus 0x0102
  /begin DAQ_EVENT VARIABLE /end DAQ_EVENT
 /end IF_DATA
/end MEASUREMENT
/begin MEASUREMENT T15_bRCDLine "Status of the RCD line" UBYTE B_TRUE 1 100 0.00 1.00000000000 BIT_MASK 0x1 FORMAT "%13.11" ECU_ADDRESS 0x70001489
 /begin IF_DATA XCPplus 0x0102
  /begin DAQ_EVENT VARIABLE /end DAQ_EVENT
 /end IF_DATA
/end MEASUREMENT
/begin MEASUREMENT ThrVlv_ratActPosnB1 "Autosar named Actuatorposition" SWORD rel_q0p0078125 1 100 -256.0000 255.9922 FORMAT "%8.4" ECU_ADDRESS 0x70001520
 /begin IF_DATA XCPplus 0x0102
  /begin DAQ_EVENT VARIABLE /end DAQ_EVENT
 /end IF_DATA
/end MEASUREMENT
/begin MEASUREMENT ThS_tCbnAct "dummy interface for the actual cabin temperature" SWORD Temp_Cels 1 100 -3549.940 3003.560 FORMAT "%8.3" ECU_ADDRESS 0x70001522
 /begin IF_DATA XCPplus 0x0102
  /begin DAQ_EVENT VARIABLE /end DAQ_EVENT
 /end IF_DATA
/end MEASUREMENT
/begin MEASUREMENT VehCoorn_dstRngPrdcDispTx "" SLONG RBPtCel_dst_1p0_4 1 100 -2147483648.00 2147483647.00 FORMAT "%13.2" ECU_ADDRESS 0x70001594
 /begin IF_DATA XCPplus 0x0102
  /begin DAQ_EVENT VARIABLE /end DAQ_EVENT
 /end IF_DATA
/end MEASUREMENT
/begin MEASUREMENT VehCoorn_stEngIdleShtDwn "AEIS: state for body control module" UBYTE q1 1 100 0.00 255.0 FORMAT "%5.1" ECU_ADDRESS 0x700014B1
 /begin IF_DATA XCPplus 0x0102
  /begin DAQ_EVENT VARIABLE /end DAQ_EVENT
 /end IF_DATA
/end MEASUREMENT
/begin MEASUREMENT VehCoorn_wCnsTotWghtAvrgEffTx "" UWORD q1_Wh_DIV_km 1 100 0.00 65535.00 FORMAT "%8.2" ECU_ADDRESS 0x70001508
 /begin IF_DATA XCPplus 0x0102
  /begin DAQ_EVENT VARIABLE /end DAQ_EVENT
 /end IF_DATA
/end MEASUREMENT
/begin MEASUREMENT VehCoorn_wCnsTotWghtTripAvrgEffTx "" UWORD q1_Wh_DIV_km 1 100 0.00 65535.00 FORMAT "%8.2" ECU_ADDRESS 0x70001506
 /begin IF_DATA XCPplus 0x0102
  /begin DAQ_EVENT VARIABLE /end DAQ_EVENT
 /end IF_DATA
/end MEASUREMENT
/begin MEASUREMENT VehCoorn_wElecCnsPrpLongAvrg "average electric consumption for propulsion long term" FLOAT32_IEEE q1_W_s_DIV_m 1 100 -1.00000000E+037 1.00000000E+037 FORMAT "%13.3" ECU_ADDRESS 0x700015C8
 /begin IF_DATA XCPplus 0x0102
  /begin DAQ_EVENT VARIABLE /end DAQ_EVENT
 /end IF_DATA
/end MEASUREMENT
/begin MEASUREMENT VehDrvEv_tqSecAxleDes "desired secondary axle torque" SLONG TrqPrpHigh 1 100 -214748364.800 214748364.700 FORMAT "%13.3" ECU_ADDRESS 0x70001590
 /begin IF_DATA XCPplus 0x0102
  /begin DAQ_EVENT VARIABLE /end DAQ_EVENT
 /end IF_DATA
/end MEASUREMENT
/begin MEASUREMENT VehMot_stPrpAccPed "Status of propulsion demand by driver demand" UBYTE B_TRUE 1 100 0.00 1.00000000000 BIT_MASK 0x1 FORMAT "%13.11" ECU_ADDRESS 0x70001488
 /begin IF_DATA XCPplus 0x0102
  /begin DAQ_EVENT VARIABLE /end DAQ_EVENT
 /end IF_DATA
/end MEASUREMENT
/begin MEASUREMENT VMSIEv_tqDesPrpInhb01 "Desired torque for propulsion inhibition EM-01" SLONG TrqPrpHigh 1 100 -214748364.800 214748364.700 FORMAT "%13.3" ECU_ADDRESS 0x7000159C
 /begin IF_DATA XCPplus 0x0102
  /begin DAQ_EVENT VARIABLE /end DAQ_EVENT
 /end IF_DATA
/end MEASUREMENT
/begin MEASUREMENT VMSIEv_tqDesRecupInhb01 "Desired torque for recurperation inhibition EM-01" SLONG TrqPrpHigh 1 100 -214748364.800 214748364.700 FORMAT "%13.3" ECU_ADDRESS 0x70001598
 /begin IF_DATA XCPplus 0x0102
  /begin DAQ_EVENT VARIABLE /end DAQ_EVENT
 /end IF_DATA
/end MEASUREMENT
/begin FUNCTION SWAdp_COM "1.6.0_STLA_N_D060SW adapter for communication"
 /begin DEF_CHARACTERISTIC Com_259hErr_GSUblinkEna_C Com_tHvbAct_C Dcdc_uDesLvGridLim_C DDRC_DurDeb.Com_tiAirbgCan_CDebOk_C DDRC_DurDeb.Com_tiAirbgCan_CDebDef_C DDRC_DurDeb.Com_tiComChrgrEVCont_CDebOk_C DDRC_DurDeb.Com_tiComChrgrEVCont_CDebDef_C DDRC_DurDeb.Com_tiComChrgrEVtBlink_CDebOk_C DDRC_DurDeb.Com_tiComChrgrEVtBlink_CDebDef_C DDRC_DurDeb.Com_tiComChrgrMstBlink_CDebOk_C DDRC_DurDeb.Com_tiComChrgrMstBlink_CDebDef_C DDRC_DurDeb.Com_tiComChrgrMstCont_CDebOk_C DDRC_DurDeb.Com_tiComChrgrMstCont_CDebDef_C DDRC_DurDeb.Com_tiComChrgrSVSBlink_CDebOk_C DDRC_DurDeb.Com_tiComChrgrSVSBlink_CDebDef_C DDRC_DurDeb.Com_tiComChrgrSVSCont_CDebOk_C DDRC_DurDeb.Com_tiComChrgrSVSCont_CDebDef_C DDRC_DurDeb.Com_tiComDcdcEVBlink_CDebOk_C DDRC_DurDeb.Com_tiComDcdcEVBlink_CDebDef_C DDRC_DurDeb.Com_tiComDcdcEVCont_CDebOk_C DDRC_DurDeb.Com_tiComDcdcEVCont_CDebDef_C DDRC_DurDeb.Com_tiComDcdcMstBlink_CDebOk_C DDRC_DurDeb.Com_tiComDcdcMstBlink_CDebDef_C DDRC_DurDeb.Com_tiComDcdcMstCont_CDebOk_C DDRC_DurDeb.Com_tiComDcdcMstCont_CDebDef_C DDRC_DurDeb.Com_tiComDcdcSVSBlink_CDebOk_C DDRC_DurDeb.Com_tiComDcdcSVSBlink_CDebDef_C DDRC_DurDeb.Com_tiComDcdcSVSCont_CDebOk_C DDRC_DurDeb.Com_tiComDcdcSVSCont_CDebDef_C DDRC_DurDeb.Com_tiComEmacEVBlink_CDebOk_C DDRC_DurDeb.Com_tiComEmacEVBlink_CDebDef_C DDRC_DurDeb.Com_tiComEmacEVCont_CDebOk_C DDRC_DurDeb.Com_tiComEmacEVCont_CDebDef_C DDRC_DurDeb.Com_tiComEmacMstCont_CDebOk_C DDRC_DurDeb.Com_tiComEmacMstCont_CDebDef_C DDRC_DurDeb.Com_tiComEmacMsttBlink_CDebOk_C DDRC_DurDeb.Com_tiComEmacMsttBlink_CDebDef_C DDRC_DurDeb.Com_tiComEmacSVSBlink_CDebOk_C DDRC_DurDeb.Com_tiComEmacSVSBlink_CDebDef_C DDRC_DurDeb.Com_tiComEmacSVSCont_CDebOk_C DDRC_DurDeb.Com_tiComEmacSVSCont_CDebDef_C DDRC_DurDeb.Com_tiComHvbMstBlink_CDebOk_C DDRC_DurDeb.Com_tiComHvbMstBlink_CDebDef_C DDRC_DurDeb.Com_tiComHvbMstCont_CDebOk_C DDRC_DurDeb.Com_tiComHvbMstCont_CDebDef_C DDRC_DurDeb.Com_tiComflgCurMeasmtErr_CDebOk_C DDRC_DurDeb.Com_tiComflgCurMeasmtErr_CDebDef_C DDRC_DurDeb.Com_tiComflgCurMeasmtSysErr_CDebOk_C DDRC_DurDeb.Com_tiComflgCurMeasmtSysErr_CDebDef_C DDRC_DurDeb.Com_tiComflgCurMeasmtVld_CDebOk_C DDRC_DurDeb.Com_tiComflgCurMeasmtVld_CDebDef_C DDRC_DurDeb.Com_tiComflgCurRngErr_CDebOk_C DDRC_DurDeb.Com_tiComflgCurRngErr_CDebDef_C DDRC_DurDeb.Com_tiComflgTPcbMeasmtErr_CDebOk_C DDRC_DurDeb.Com_tiComflgTPcbMeasmtErr_CDebDef_C DDRC_DurDeb.Com_tiComflgTPcbMeasmtVld_CDebOk_C DDRC_DurDeb.Com_tiComflgTPcbMeasmtVld_CDebDef_C DDRC_DurDeb.Com_tiComflgTPcbRngErr_CDebOk_C DDRC_DurDeb.Com_tiComflgTPcbRngErr_CDebDef_C DDRC_DurDeb.Com_tiComflgTPcbSysErr_CDebOk_C DDRC_DurDeb.Com_tiComflgTPcbSysErr_CDebDef_C DDRC_DurDeb.Com_tiComflgTShntMeasmtErr_CDebOk_C DDRC_DurDeb.Com_tiComflgTShntMeasmtErr_CDebDef_C DDRC_DurDeb.Com_tiComflgTShntMeasmtVld_CDebOk_C DDRC_DurDeb.Com_tiComflgTShntMeasmtVld_CDebDef_C DDRC_DurDeb.Com_tiComflgTShntRngErr_CDebOk_C DDRC_DurDeb.Com_tiComflgTShntRngErr_CDebDef_C DDRC_DurDeb.Com_tiComflgTShntSysErr_CDebOk_C DDRC_DurDeb.Com_tiComflgTShntSysErr_CDebDef_C DDRC_DurDeb.Com_tiComflgVoltMeasmtErr_CDebOk_C DDRC_DurDeb.Com_tiComflgVoltMeasmtErr_CDebDef_C DDRC_DurDeb.Com_tiComflgVoltMeasmtSysErr_CDebOk_C DDRC_DurDeb.Com_tiComflgVoltMeasmtSysErr_CDebDef_C DDRC_DurDeb.Com_tiComflgVoltMeasmtVld_CDebOk_C DDRC_DurDeb.Com_tiComflgVoltMeasmtVld_CDebDef_C DDRC_DurDeb.Com_tiComflgVoltRngErr_CDebOk_C DDRC_DurDeb.Com_tiComflgVoltRngErr_CDebDef_C DDRC_DurDeb.Com_tiETogFailrLvl3_CDebOk_C DDRC_DurDeb.Com_tiETogFailrLvl3_CDebDef_C DDRC_DurDeb.Com_tiETogFailrLvl4_CDebOk_C DDRC_DurDeb.Com_tiETogFailrLvl4_CDebDef_C DDRC_DurDeb.Com_tiHvbEVLmpBlink_CDebOk_C DDRC_DurDeb.Com_tiHvbEVLmpBlink_CDebDef_C DDRC_DurDeb.Com_tiHvbEVLmpCont_CDebOk_C DDRC_DurDeb.Com_tiHvbEVLmpCont_CDebDef_C DFC_CtlMsk2.DFC_AirbgCan_C DFC_CtlMsk2.DFC_ComChrgrEVCont_C DFC_CtlMsk2.DFC_ComChrgrEVtBlink_C DFC_CtlMsk2.DFC_ComChrgrMstBlink_C DFC_CtlMsk2.DFC_ComChrgrMstCont_C DFC_CtlMsk2.DFC_ComChrgrSVSBlink_C DFC_CtlMsk2.DFC_ComChrgrSVSCont_C DFC_CtlMsk2.DFC_ComDcdcEVBlink_C DFC_CtlMsk2.DFC_ComDcdcEVCont_C DFC_CtlMsk2.DFC_ComDcdcMstBlink_C DFC_CtlMsk2.DFC_ComDcdcMstCont_C DFC_CtlMsk2.DFC_ComDcdcSVSBlink_C DFC_CtlMsk2.DFC_ComDcdcSVSCont_C DFC_CtlMsk2.DFC_ComEmacEVBlink_C DFC_CtlMsk2.DFC_ComEmacEVCont_C DFC_CtlMsk2.DFC_ComEmacMstCont_C DFC_CtlMsk2.DFC_ComEmacMsttBlink_C DFC_CtlMsk2.DFC_ComEmacSVSBlink_C DFC_CtlMsk2.DFC_ComEmacSVSCont_C DFC_CtlMsk2.DFC_ComHvbMstBlink_C DFC_CtlMsk2.DFC_ComHvbMstCont_C DFC_CtlMsk2.DFC_ComflgCurMeasmtErr_C DFC_CtlMsk2.DFC_ComflgCurMeasmtSysErr_C DFC_CtlMsk2.DFC_ComflgCurMeasmtVld_C DFC_CtlMsk2.DFC_ComflgCurRngErr_C DFC_CtlMsk2.DFC_ComflgTPcbMeasmtErr_C DFC_CtlMsk2.DFC_ComflgTPcbMeasmtVld_C DFC_CtlMsk2.DFC_ComflgTPcbRngErr_C DFC_CtlMsk2.DFC_ComflgTPcbSysErr_C DFC_CtlMsk2.DFC_ComflgTShntMeasmtErr_C DFC_CtlMsk2.DFC_ComflgTShntMeasmtVld_C DFC_CtlMsk2.DFC_ComflgTShntRngErr_C DFC_CtlMsk2.DFC_ComflgTShntSysErr_C DFC_CtlMsk2.DFC_ComflgVoltMeasmtErr_C DFC_CtlMsk2.DFC_ComflgVoltMeasmtSysErr_C DFC_CtlMsk2.DFC_ComflgVoltMeasmtVld_C DFC_CtlMsk2.DFC_ComflgVoltRngErr_C DFC_CtlMsk2.DFC_ETogFailrLvl3_C DFC_CtlMsk2.DFC_ETogFailrLvl4_C DFC_CtlMsk2.DFC_HvbEVLmpBlink_C DFC_CtlMsk2.DFC_HvbEVLmpCont_C DFC_DisblMsk2.DFC_AirbgCan_C DFC_DisblMsk2.DFC_ComChrgrEVCont_C DFC_DisblMsk2.DFC_ComChrgrEVtBlink_C DFC_DisblMsk2.DFC_ComChrgrMstBlink_C DFC_DisblMsk2.DFC_ComChrgrMstCont_C DFC_DisblMsk2.DFC_ComChrgrSVSBlink_C DFC_DisblMsk2.DFC_ComChrgrSVSCont_C DFC_DisblMsk2.DFC_ComDcdcEVBlink_C DFC_DisblMsk2.DFC_ComDcdcEVCont_C DFC_DisblMsk2.DFC_ComDcdcMstBlink_C DFC_DisblMsk2.DFC_ComDcdcMstCont_C DFC_DisblMsk2.DFC_ComDcdcSVSBlink_C DFC_DisblMsk2.DFC_ComDcdcSVSCont_C DFC_DisblMsk2.DFC_ComEmacEVBlink_C DFC_DisblMsk2.DFC_ComEmacEVCont_C DFC_DisblMsk2.DFC_ComEmacMstCont_C DFC_DisblMsk2.DFC_ComEmacMsttBlink_C DFC_DisblMsk2.DFC_ComEmacSVSBlink_C DFC_DisblMsk2.DFC_ComEmacSVSCont_C DFC_DisblMsk2.DFC_ComHvbMstBlink_C DFC_DisblMsk2.DFC_ComHvbMstCont_C DFC_DisblMsk2.DFC_ComflgCurMeasmtErr_C DFC_DisblMsk2.DFC_ComflgCurMeasmtSysErr_C DFC_DisblMsk2.DFC_ComflgCurMeasmtVld_C DFC_DisblMsk2.DFC_ComflgCurRngErr_C DFC_DisblMsk2.DFC_ComflgTPcbMeasmtErr_C DFC_DisblMsk2.DFC_ComflgTPcbMeasmtVld_C DFC_DisblMsk2.DFC_ComflgTPcbRngErr_C DFC_DisblMsk2.DFC_ComflgTPcbSysErr_C DFC_DisblMsk2.DFC_ComflgTShntMeasmtErr_C DFC_DisblMsk2.DFC_ComflgTShntMeasmtVld_C DFC_DisblMsk2.DFC_ComflgTShntRngErr_C DFC_DisblMsk2.DFC_ComflgTShntSysErr_C DFC_DisblMsk2.DFC_ComflgVoltMeasmtErr_C DFC_DisblMsk2.DFC_ComflgVoltMeasmtSysErr_C DFC_DisblMsk2.DFC_ComflgVoltMeasmtVld_C DFC_DisblMsk2.DFC_ComflgVoltRngErr_C DFC_DisblMsk2.DFC_ETogFailrLvl3_C DFC_DisblMsk2.DFC_ETogFailrLvl4_C DFC_DisblMsk2.DFC_HvbEVLmpBlink_C DFC_DisblMsk2.DFC_HvbEVLmpCont_C /end DEF_CHARACTERISTIC
 /begin IN_MEASUREMENT Brk_stRed_Sq ComChrgr_stEVLmp ComChrgr_stMstWrnLmp ComChrgr_stSVSLmp ComEmac_stEVLmp ComEmac_stMstWrnLmp ComEmac_stSVSLmp Com_egyHvbAvl_fRx Com_flgCurMeasmtErr Com_flgCurMeasmtSysErr Com_flgCurMeasmtVld Com_flgCurRngErr Com_flgTPcbMeasmtErr Com_flgTPcbMeasmtVld Com_flgTPcbRngErr Com_flgTPcbSysErr Com_flgTShntMeasmtErr Com_flgTShntMeasmtVld Com_flgTShntRngErr Com_flgTShntSysErr Com_flgVoltMeasmtErr Com_flgVoltMeasmtSysErr Com_flgVoltMeasmtVld Com_flgVoltRngErr Com_stDayNight Com_stDcdcEVLmp Com_stDcdcMstWrnLmp Com_stDcdcSVSLmp Com_stDcdcULimReq Com_steTogFailrLvl Com_stHvBatHiTempWrn Com_stHvbChrgn Com_stHvbEVLmp Com_stHvbMstWrnLmp Com_tHvbAct Dcdc_uDesLvGrid DrvMod_stDrvSelnHmi DrvMod_stPosn DrvPrgSwt_stReq GlbDa_bChrgnSockCfg Telltl_stReqd VehCoorn_flgRmtChrgReq /end IN_MEASUREMENT
 /begin OUT_MEASUREMENT ComEmac_stActvDcha_Sq Com_egyHvbAvl_f Com_flgBrkAlrt Com_flgChrgnStopReq Com_flgChrgTarRea Com_flgEcoNormReq_Sq Com_pwrDcdcOutpCpby_Sq Com_rHvbIsoMeasmt_Sq Com_stBattOvTemp Com_stBrkAlrt Com_stBrkBstPFlt Com_stBrkCntctIndcn Com_stEVLmp Com_stGearLvrPos_Sq Com_stHvbDernMaxT Com_stHvbDernMinT Com_stHvbSrvPlg_Sq Com_stMstWrnLmp Com_stPwrLimnLmp Com_stSrvLmp Com_TogLedDrv Com_TogLedMod Com_TogLedNeut Com_TogLedRvs Com_uHvbDcBus_Sq Dcdc_flgDesLvGridULim DDRC_St.DFC_AirbgCan DDRC_St.DFC_ComChrgrEVCont DDRC_St.DFC_ComChrgrEVtBlink DDRC_St.DFC_ComChrgrMstBlink DDRC_St.DFC_ComChrgrMstCont DDRC_St.DFC_ComChrgrSVSBlink DDRC_St.DFC_ComChrgrSVSCont DDRC_St.DFC_ComDcdcEVBlink DDRC_St.DFC_ComDcdcEVCont DDRC_St.DFC_ComDcdcMstBlink DDRC_St.DFC_ComDcdcMstCont DDRC_St.DFC_ComDcdcSVSBlink DDRC_St.DFC_ComDcdcSVSCont DDRC_St.DFC_ComEmacEVBlink DDRC_St.DFC_ComEmacEVCont DDRC_St.DFC_ComEmacMstCont DDRC_St.DFC_ComEmacMsttBlink DDRC_St.DFC_ComEmacSVSBlink DDRC_St.DFC_ComEmacSVSCont DDRC_St.DFC_ComHvbMstBlink DDRC_St.DFC_ComHvbMstCont DDRC_St.DFC_ComflgCurMeasmtErr DDRC_St.DFC_ComflgCurMeasmtSysErr DDRC_St.DFC_ComflgCurMeasmtVld DDRC_St.DFC_ComflgCurRngErr DDRC_St.DFC_ComflgTPcbMeasmtErr DDRC_St.DFC_ComflgTPcbMeasmtVld DDRC_St.DFC_ComflgTPcbRngErr DDRC_St.DFC_ComflgTPcbSysErr DDRC_St.DFC_ComflgTShntMeasmtErr DDRC_St.DFC_ComflgTShntMeasmtVld DDRC_St.DFC_ComflgTShntRngErr DDRC_St.DFC_ComflgTShntSysErr DDRC_St.DFC_ComflgVoltMeasmtErr DDRC_St.DFC_ComflgVoltMeasmtSysErr DDRC_St.DFC_ComflgVoltMeasmtVld DDRC_St.DFC_ComflgVoltRngErr DDRC_St.DFC_ETogFailrLvl3 DDRC_St.DFC_ETogFailrLvl4 DDRC_St.DFC_HvbEVLmpBlink DDRC_St.DFC_HvbEVLmpCont DFC_st.DFC_AirbgCan DFC_st.DFC_ComChrgrEVCont DFC_st.DFC_ComChrgrEVtBlink DFC_st.DFC_ComChrgrMstBlink DFC_st.DFC_ComChrgrMstCont DFC_st.DFC_ComChrgrSVSBlink DFC_st.DFC_ComChrgrSVSCont DFC_st.DFC_ComDcdcEVBlink DFC_st.DFC_ComDcdcEVCont DFC_st.DFC_ComDcdcMstBlink DFC_st.DFC_ComDcdcMstCont DFC_st.DFC_ComDcdcSVSBlink DFC_st.DFC_ComDcdcSVSCont DFC_st.DFC_ComEmacEVBlink DFC_st.DFC_ComEmacEVCont DFC_st.DFC_ComEmacMstCont DFC_st.DFC_ComEmacMsttBlink DFC_st.DFC_ComEmacSVSBlink DFC_st.DFC_ComEmacSVSCont DFC_st.DFC_ComHvbMstBlink DFC_st.DFC_ComHvbMstCont DFC_st.DFC_ComflgCurMeasmtErr DFC_st.DFC_ComflgCurMeasmtSysErr DFC_st.DFC_ComflgCurMeasmtVld DFC_st.DFC_ComflgCurRngErr DFC_st.DFC_ComflgTPcbMeasmtErr DFC_st.DFC_ComflgTPcbMeasmtVld DFC_st.DFC_ComflgTPcbRngErr DFC_st.DFC_ComflgTPcbSysErr DFC_st.DFC_ComflgTShntMeasmtErr DFC_st.DFC_ComflgTShntMeasmtVld DFC_st.DFC_ComflgTShntRngErr DFC_st.DFC_ComflgTShntSysErr DFC_st.DFC_ComflgVoltMeasmtErr DFC_st.DFC_ComflgVoltMeasmtSysErr DFC_st.DFC_ComflgVoltMeasmtVld DFC_st.DFC_ComflgVoltRngErr DFC_st.DFC_ETogFailrLvl3 DFC_st.DFC_ETogFailrLvl4 DFC_st.DFC_HvbEVLmpBlink DFC_st.DFC_HvbEVLmpCont DINH_nrActvInhReas.FId_BrkPresAlrt DINH_nrActvInhReas.FId_EBDLmpSig DINH_nrActvInhReas.FId_EVLmpBlnkIllmn DINH_nrActvInhReas.FId_EVLmpContIllmn DINH_nrActvInhReas.FId_MstWrnLmpBlink DINH_nrActvInhReas.FId_MstWrnLmpChime DINH_nrActvInhReas.FId_MstWrnLmpContIllmn DINH_nrActvInhReas.FId_PerfLimnActvLmpBlink DINH_nrActvInhReas.FId_PerfLimnActvLmpCont DINH_nrActvInhReas.FId_PerfLimnActvLmpContNoChime DINH_nrActvInhReas.FId_SVSWrnLmpBlnkIllmn DINH_nrActvInhReas.FId_SVSWrnLmpContIllmn DINH_nrActvInhReas.FId_bInh_Sig259hFlt DINH_nrActvInhReas.FId_bInh_Sig_Com_flgEcoNormReq_Frz DINH_nrActvInhReas.FId_bInh_Sig_Com_stGearLvrPos_Frz DINH_nrActvInhReas.FId_binnh_Sig_ComEmac_stActvDcha_Sq_Frz DINH_nrActvInhReas.FId_binnh_Sig_Com_pwrDcdcOutpCpby_Sq_Frz DINH_nrActvInhReas.FId_binnh_Sig_Com_rHvbIsoMeasmt_Sq_Frz DINH_nrActvInhReas.FId_binnh_Sig_Com_stHvbSrvPlg_Sq_Frz DINH_nrActvInhReas.FId_binnh_Sig_Com_uHvbDcBus_Sq_Frz DINH_stFId.FId_BrkPresAlrt DINH_stFId.FId_EBDLmpSig DINH_stFId.FId_EVLmpBlnkIllmn DINH_stFId.FId_EVLmpContIllmn DINH_stFId.FId_MstWrnLmpBlink DINH_stFId.FId_MstWrnLmpChime DINH_stFId.FId_MstWrnLmpContIllmn DINH_stFId.FId_PerfLimnActvLmpBlink DINH_stFId.FId_PerfLimnActvLmpCont DINH_stFId.FId_PerfLimnActvLmpContNoChime DINH_stFId.FId_SVSWrnLmpBlnkIllmn DINH_stFId.FId_SVSWrnLmpContIllmn DINH_stFId.FId_bInh_Sig259hFlt DINH_stFId.FId_bInh_Sig_Com_flgEcoNormReq_Frz DINH_stFId.FId_bInh_Sig_Com_stGearLvrPos_Frz DINH_stFId.FId_binnh_Sig_ComEmac_stActvDcha_Sq_Frz DINH_stFId.FId_binnh_Sig_Com_pwrDcdcOutpCpby_Sq_Frz DINH_stFId.FId_binnh_Sig_Com_rHvbIsoMeasmt_Sq_Frz DINH_stFId.FId_binnh_Sig_Com_stHvbSrvPlg_Sq_Frz DINH_stFId.FId_binnh_Sig_Com_uHvbDcBus_Sq_Frz /end OUT_MEASUREMENT
 /begin LOC_MEASUREMENT SWAdpCOM_flgEcoNormReq_Sq SWAdpCOM_pwrDcdcOutpCpby_SqLoc SWAdpCOM_stGearLvrPos_Sq SWAdp_flgDesLvGridULimLoc SWAdp_rHvbIsoMeasmt_SqLoc SWAdp_stActvDcha_SqLoc SWAdp_stHvbSrvPlg_SqLoc SWAdp_uHvbDcBus_SqLoc /end LOC_MEASUREMENT
 FUNCTION_VERSION "1.6.0_STLA_N_D060" /end FUNCTION
/begin FUNCTION SWAdp_Gen "1.0.0_STLA_N_D060I5Softwareadapter (Generated with Ascet)"
 /begin DEF_CHARACTERISTIC AccPed_facRecupLvrLimd_C ACSwt_tCbnSp_C AFS_mAirPerCyl_C BrkECU_flgBrkEcuIntv_C BrkgToZr_flgActvd_C BrkgToZr_flgPredActvn_C BrkgToZr_nDes01_C BrkgToZr_tqHillHldRamp_C BrkTqEv_tqRcptSecAxle_C B_fgfmsdh_msg_C B_msdkhfmg_msg_C Clth_st_C CoEng_stMaiOld_C CoEng_stOld_C CoEng_tiNormal_C CoETS_rTrq_C ComChrgn_flgFltIDcRly_C ComChrgn_flgFltUDcRly_C ComChrgn_stDcRly_C ComChrgr_uAcActL2_C ComChrgr_uAcActL2_Sq_C ComChrgr_uAcActL3_C ComChrgr_uAcActL3_Sq_C ComEmac_flgActvdDsbcCtl01_C ComEmac_flgIntlckClsd01_C ComEmac_flgIntlckClsd01_Sq_C ComEmac_flgReqDiag01_C ComEmac_flgReqDiag01_Sq_C ComEmac_nAct02_C ComEmac_stDsqflgEmgyShtDwnReq01_C ComEmac_tqActWoDsbcCtl01_C ComEmac_tqActWoDsbcCtl01_Sq_C ComEmac_tRtr01_C ComEmac_tRtr01_Sq_C Com_aRecupOnePedlDrvg_C Com_aRecupRvsOnePedlDrvg_C Com_bEbsComErr_C Com_bEcoModeActv_C Com_bErrClb_C Com_bErrIdn_C Com_bInCstnc_C Com_bOBCClgWkuReq_C Com_bPreDrvWkuReq_C Com_bTBoxPtlWkuReq_C Com_egyTotNom_f_C Com_flgCrawlActvd_C Com_flgDcdcPrecCmpl_C Com_lTotDstkm_C Com_nrHvbHiCellPck_C Com_nrSerlHiTDetn_C Com_nrSerlHiUCell_C Com_nrSerlLoTDetn_C Com_numBSIEnv_C Com_qSoh_C Com_ratSoc_C Com_ratSoh_C Com_ratThermIndcrMCU_C Com_rVirtZrPntExt_C Com_stChrgnSpstReq_sq_C Com_stCrCUIBtn_C Com_stHvbTypCod_C Com_stIRng_C Com_stI_C Com_stNMStM_C Com_stPrecTOut_C Com_stPrecTOut_Sq_C Com_stSofASILErr_C Com_stSoh_C Com_stU_C Com_tHvbCellMax_C Com_tHvbCellMin_C Com_tHvbMaxAllwbl_C Com_tiRef_C Com_tqBrkDesPrimAxle_C Com_uHvbCellLimHi_C Com_uHvbHiCell_C Com_uHvbLimLo_C Com_uHvbLimLo_Sq_C Com_uHvbLoCell_C Com_uPtcAct_Sq_C Com_uSofASIL_C CoPOM_ratTqDistbn_C CoPOM_tqWhlQstyMaxWoDistbn_C CoPT_tqRecupPotlWhlPrim_C CoPT_tqRecupPotlWhlSec_C CoVMD_stReqCrCtl_C CoVMD_tqAdas_C CoVMD_trqCrCtl_C DrvPrgSwt_stRcpt_C ElM_pwrElecPredTracMaxLo_C Emac_tqDesCom02_C EnvT_t_C EnvT_t_Sq_C Epm_nEngLRes_C Epm_nEng_C Epm_numCyl_C Epm_stSpd_C ExhMod_pRelPfilDs_C Ext_bCalidEmCf_C Ext_bFctHldReqCdn_C fmsdhfs_w_msg_C ftu_msg_C GbxPos_flgCustSpcCdn_C GbxPos_stGearLvrPos_c GlbDa_lWhlCirc_C GlbDa_rdWhl_C GlbDa_stTrqDem_C HndBrk_stDebVal_C HvBatt_egyAvlTot_f_C InjCtl_qSetUnBal_C IntlckChrgPlg_rDesVal_C MoFDrvrAssc_flgDrvrAsscPtdMsg_C MoFEmgOff_stPWMCrashDeploy_C mshfmdk_w_msg_C ofpu_w_msg_C PCR_pDesVal_C PThrVlvUs_pB1_C SCtPmp1T_t_C StabyIntv_flgDCSIntv01_C StabyIntv_flgTCSIntv01_C StabyIntv_tqDCSDes01_C StabyIntv_tqTCSDes01_C T15_bECUTyp_C ThrVlv_ratActPosnB1_C ThS_tCbnAct_C VehCoorn_stEngIdleShtDwn_C VehCoorn_wElecCnsPrpLongAvrg_C VehDrvEv_tqSecAxleDes_C VehMot_stPrpAccPed_C VMSIEv_tqDesPrpInhb01_C VMSIEv_tqDesRecupInhb01_C /end DEF_CHARACTERISTIC
 /begin IN_MEASUREMENT AcExtChrgr_stChrgn Brk_st_Sq B_rcd_msg CbnHeatgHeatr_cntrCntctOper ChgrPlug_flgPxpAndCtpDetn ChgrPlug_flgPxpDetn ChrgPlg_stPlgLockCmd ComEmac_pwrInstnsInpRx ComEmac_stSVSLmp ComEmac_tIvtrCooltIn01 Com_HvbMaxSnsrTempRx DcChrgnCtrl_stChrgn HvacHmi_stAc HvGrid_pwrMaxDcdc T15_st VehCoorn_dstRngPrdcDisp VehCoorn_wCnsTotWghtAvrgEff VehCoorn_wCnsTotWghtTripAvrgEff /end IN_MEASUREMENT
 /begin OUT_MEASUREMENT AccPed_facRecupLvrLimd ACSwt_stSwt ACSwt_tCbnSp AFS_mAirPerCyl BrkECU_flgBrkEcuIntv BrkgToZr_flgActvd BrkgToZr_flgPredActvn BrkgToZr_nDes01 BrkgToZr_tqHillHldRamp BrkTqEv_tqRcptSecAxle Brk_r_Sq B_fgfmsdh_msg B_msdkhfmg_msg CbnHeatgHeatr_cntrPosCntctOper CcsAcCtrl_stChrgn CcsDcCtrl_stChrgn CcsPlg_stPlgLockCmd Clth_st CoEng_stMaiOld CoEng_stOld CoEng_tiNormal CoETS_rTrq ComChrgn_flgFltIDcRly ComChrgn_flgFltUDcRly ComChrgn_stDcRly ComChrgr_uAcActL2 ComChrgr_uAcActL2_Sq ComChrgr_uAcActL3 ComChrgr_uAcActL3_Sq ComEmac_flgActvdDsbcCtl01 ComEmac_flgIntlckClsd01 ComEmac_flgIntlckClsd01_Sq ComEmac_flgReqDiag01 ComEmac_flgReqDiag01_Sq ComEmac_flgSvsReq01 ComEmac_nAct02 ComEmac_pwrInstnsInp ComEmac_stDsqflgEmgyShtDwnReq01 ComEmac_tIvtrCoolt01 ComEmac_tqActWoDsbcCtl01 ComEmac_tqActWoDsbcCtl01_Sq ComEmac_tRtr01 ComEmac_tRtr01_Sq Com_aRecupOnePedlDrvg Com_aRecupRvsOnePedlDrvg Com_bAcLedReq Com_bEbsComErr Com_bEcoModeActv Com_bErrClb Com_bErrIdn Com_bGunCntInfoWkuReq Com_bHvBattRchrgWkuReq Com_bInCstnc Com_bOBCClgWkuReq Com_bPreDrvWkuReq Com_bTBoxPtlWkuReq Com_egyTotNom_f Com_flgCrawlActvd Com_flgDcdcPrecCmpl Com_HvbMaxSnsrTempTx Com_lTotDstkm Com_nrHvbHiCellPck Com_nrSerlHiTDetn Com_nrSerlHiUCell Com_nrSerlLoTDetn Com_numBSIEnv Com_qSoh Com_ratSoc Com_ratSoh Com_ratThermIndcrMCU Com_rVirtZrPntExt Com_stChrgnSpstReq_sq Com_stCrCUIBtn Com_stHvbTypCod Com_stI Com_stIRng Com_stNMStM Com_stPrecTOut Com_stPrecTOut_Sq Com_stSofASILErr Com_stSoh Com_stU Com_tHvbCellMax Com_tHvbCellMin Com_tHvbMaxAllwbl Com_tiRef Com_tqBrkDesPrimAxle Com_uHvbCellLimHi Com_uHvbHiCell Com_uHvbLimLo Com_uHvbLimLo_Sq Com_uHvbLoCell Com_uPtcAct_Sq Com_uSofASIL CoPOM_ratTqDistbn CoPOM_tqWhlQstyMaxWoDistbn CoPT_tqRecupPotlWhlPrim CoPT_tqRecupPotlWhlSec CoVMD_stReqCrCtl CoVMD_tqAdas CoVMD_trqCrCtl DrvPrgSwt_stRcpt Eem_pwrMaxLimDcdc ElM_pwrElecPredTracMaxLo Emac_tqDesCom02 EnvT_t EnvT_t_Sq Epm_nEng Epm_nEngLRes Epm_numCyl Epm_stSpd ExhMod_pRelPfilDs Ext_bCalidEmCf Ext_bFctHldReqCdn fmsdhfs_w_msg ftu_msg GbxPos_flgCustSpcCdn GbxPos_stGearLvrPos GlbDa_lWhlCirc GlbDa_rdWhl GlbDa_stTrqDem HndBrk_stDebVal HvBatt_egyAvlTot_f InjCtl_qSetUnBal IntlckChrgPlg_rDesVal MoFDrvrAssc_flgDrvrAsscPtdMsg MoFEmgOff_stPWMCrashDeploy mshfmdk_w_msg ofpu_w_msg PCR_pDesVal PThrVlvUs_pB1 SCtPmp1T_t StabyIntv_flgDCSIntv01 StabyIntv_flgTCSIntv01 StabyIntv_tqDCSDes01 StabyIntv_tqTCSDes01 T15_bECUTyp T15_bRCDLine ThrVlv_ratActPosnB1 ThS_tCbnAct VehCoorn_dstRngPrdcDispTx VehCoorn_stEngIdleShtDwn VehCoorn_wCnsTotWghtAvrgEffTx VehCoorn_wCnsTotWghtTripAvrgEffTx VehCoorn_wElecCnsPrpLongAvrg VehDrvEv_tqSecAxleDes VehMot_stPrpAccPed VMSIEv_tqDesPrpInhb01 VMSIEv_tqDesRecupInhb01 /end OUT_MEASUREMENT
 FUNCTION_VERSION "1.0.0_STLA_N_D060I5" /end FUNCTION
/*********** End of merged COMPU_METHOD blocks ***********/
/begin COMPU_METHOD Acc "" RAT_FUNC "%6.5" "m/s^2" COEFFS 0 1000 0 0 0 1 /end COMPU_METHOD
/begin COMPU_METHOD AirMassPerCyl "" RAT_FUNC "%6.3" "mg/Hub" COEFFS 0 10 0 0 0 1 /end COMPU_METHOD
/begin COMPU_METHOD B_TRUE "" TAB_VERB "%6.3" "" COMPU_TAB_REF B_TRUE /end COMPU_METHOD
/begin COMPU_VTAB B_TRUE "" TAB_VERB 2 0 "FALSE" 1 "TRUE" /end COMPU_VTAB
/begin COMPU_METHOD C126_dist_km_u32_q1p0_COMPU "" RAT_FUNC "%6.2" "Km" COEFFS 0 1 0 0 0 1 /end COMPU_METHOD
/begin COMPU_METHOD ChrgCtrl_stChrgn_VERB "" TAB_VERB "%6.3" "" COMPU_TAB_REF ChrgCtrl_stChrgn_VERB /end COMPU_METHOD
/begin COMPU_VTAB ChrgCtrl_stChrgn_VERB "" TAB_VERB 7 0 "CHRGCTRL_INI" 1 "CHRGCTRL_PREP" 2 "CHRGCTRL_CHRGN" 3 "CHRGCTRL_STOP" 4 "CHRGCTRL_FINSH" 5 "CHRGCTRL_CRITERR" 6 "CHRGCTRL_MNRERR" /end COMPU_VTAB
/begin COMPU_METHOD ChrgIf_stPlgLockCmd_VERB "" TAB_VERB "%6.3" "" COMPU_TAB_REF ChrgIf_stPlgLockCmd_VERB /end COMPU_METHOD
/begin COMPU_VTAB ChrgIf_stPlgLockCmd_VERB "" TAB_VERB 3 0 "CHRGPLG_INTLCK_LOCKREQ" 1 "CHRGPLG_INTLCK_UNLCKREQ" 2 "CHRGPLG_INTLCK_STYREQ" /end COMPU_VTAB
/begin COMPU_METHOD CoEng_stMai_VERB "" TAB_VERB "%6.3" "" COMPU_TAB_REF CoEng_stMai_VERB /end COMPU_METHOD
/begin COMPU_VTAB CoEng_stMai_VERB "" TAB_VERB 7 0 "COENG_ST_STANDBY" 4 "COENG_ST_READY" 16 "COENG_ST_STARTING" 64 "COENG_ST_AUTOSTOPPING" 1024 "COENG_ST_RUNNING" 4096 "COENG_ST_STOPPING" 16384 "COENG_ST_FINISH" /end COMPU_VTAB
/begin COMPU_METHOD CoEng_st_COMPU_VERB "" TAB_VERB "%6.3" "" COMPU_TAB_REF CoEng_st_COMPU_VERB /end COMPU_METHOD
/begin COMPU_VTAB CoEng_st_COMPU_VERB "" TAB_VERB 6 0 "COENG_STANDBY" 1 "COENG_READY" 2 "COENG_CRANKING" 3 "COENG_RUNNING" 4 "COENG_STOPPING" 5 "COENG_FINISH" /end COMPU_VTAB
/begin COMPU_METHOD Com_NmStM_VERB "" TAB_VERB "%6.3" "" COMPU_TAB_REF Com_NmStM_VERB /end COMPU_METHOD
/begin COMPU_VTAB Com_NmStM_VERB "" TAB_VERB 5 0 "COM_STANDBY" 1 "COM_NORMALMODE" 2 "COM_SHUTDOWN" 3 "COM_WAKE_UP" 4 "COM_COMOFF" /end COMPU_VTAB
/begin COMPU_METHOD DDRCTime_ms "" RAT_FUNC "%6.1" "ms" COEFFS 0 1 0 0 0 10 /end COMPU_METHOD
/begin COMPU_METHOD DFC_OneToOne "" RAT_FUNC "%6.2" "-" COEFFS 0 1 0 0 0 1 /end COMPU_METHOD
/begin COMPU_METHOD DFES_OneToOne "" RAT_FUNC "%6.2" "-" COEFFS 0 1 0 0 0 1 /end COMPU_METHOD
/begin COMPU_METHOD DINH_ct_Compu "" RAT_FUNC "%6.0" "" COEFFS 0 -1 4096 0 0 1 /end COMPU_METHOD
/begin COMPU_METHOD ElecChrg_Ah_q0p125_COMPU "" RAT_FUNC "%6.3" "Ah" COEFFS 0 8 0 0 0 1 /end COMPU_METHOD
/begin COMPU_METHOD EngN "" RAT_FUNC "%6.3" "rpm" COEFFS 0 2 0 0 0 1 /end COMPU_METHOD
/begin COMPU_METHOD EngN_LRes "" RAT_FUNC "%6.1" "rpm" COEFFS 0 0.025 0 0 0 1 /end COMPU_METHOD
/begin COMPU_METHOD Epm_stSpd_t "" TAB_VERB "%6.3" "" COMPU_TAB_REF Epm_stSpd_t /end COMPU_METHOD
/begin COMPU_VTAB Epm_stSpd_t "" TAB_VERB 5 0 "EPM_SPD_CRS" 1 "EPM_SPD_HOLD" 2 "EPM_SPD_ZERO" 3 "EPM_SPD_CAS" 4 "EPM_SPD_BACKUP" /end COMPU_VTAB
/begin COMPU_METHOD ETogLed_st_VERB "" TAB_VERB "%6.3" "" COMPU_TAB_REF ETogLed_st_VERB /end COMPU_METHOD
/begin COMPU_VTAB ETogLed_st_VERB "" TAB_VERB 5 0 "LIGHT_OFF" 1 "LIGHT_ON_DAY" 2 "LIGHT_BLINKING" 3 "BACKLIGHTING" 7 "LIGHT_ON_NIGHT" /end COMPU_VTAB
/begin COMPU_METHOD Fact "" RAT_FUNC "%6.5" "-" COEFFS 0 8192 0 0 0 1 /end COMPU_METHOD
/begin COMPU_METHOD fak_q1p22Em4 "" RAT_FUNC "%6.5" "-" COEFFS 0 8192 0 0 0 1 /end COMPU_METHOD
/begin COMPU_METHOD fak_ub_b2 "" RAT_FUNC "%8.5" "-" COEFFS 0 256 0 0 0 2 /end COMPU_METHOD
/begin COMPU_METHOD fak_uw_b4 "" RAT_FUNC "%7.6" "-" COEFFS 0 65536 0 0 0 4 /end COMPU_METHOD
/begin COMPU_METHOD InjMass "" RAT_FUNC "%6.4" "mg/hub" COEFFS 0 100 0 0 0 1 /end COMPU_METHOD
/begin COMPU_METHOD LengthFine "" RAT_FUNC "%6.5" "m" COEFFS 0 1000 0 0 0 1 /end COMPU_METHOD
/begin COMPU_METHOD Length_fine "" RAT_FUNC "%6.5" "m" COEFFS 0 1000 0 0 0 1 /end COMPU_METHOD
/begin COMPU_METHOD m_uw_b6553p5 "" RAT_FUNC "%6.3" "kg/h" COEFFS 0 1 0 0 0 0.1 /end COMPU_METHOD
/begin COMPU_METHOD nmot_q1 "" RAT_FUNC "%6.2" "1/min" COEFFS 0 1 0 0 0 1 /end COMPU_METHOD
/begin COMPU_METHOD OneToOne "" RAT_FUNC "%6.2" "-" COEFFS 0 1 0 0 0 1 /end COMPU_METHOD
/begin COMPU_METHOD Prc "" RAT_FUNC "%6.4" "%" COEFFS 0 81.92 0 0 0 1 /end COMPU_METHOD
/begin COMPU_METHOD Pres_hPa "" RAT_FUNC "%6.2" "hPa" COEFFS 0 1 0 0 0 1 /end COMPU_METHOD
/begin COMPU_METHOD p_q0p039 "" RAT_FUNC "%6.4" "hPa" COEFFS 0 256 0 0 0 10 /end COMPU_METHOD
/begin COMPU_METHOD p_q0p078 "" RAT_FUNC "%6.4" "hPa" COEFFS 0 64 0 0 0 5 /end COMPU_METHOD
/begin COMPU_METHOD q1 "" RAT_FUNC "%6.2" "-" COEFFS 0 1 0 0 0 1 /end COMPU_METHOD
/begin COMPU_METHOD q100_W "" RAT_FUNC "%6.0" "W" COEFFS 0 1 0 0 0 100 /end COMPU_METHOD
/begin COMPU_METHOD q1_Wh_DIV_km "" RAT_FUNC "%6.2" "Wh/km" COEFFS 0 1 0 0 0 1 /end COMPU_METHOD
/begin COMPU_METHOD q1_W_s_DIV_m "" RAT_FUNC "%6.2" "Ws/m" COEFFS 0 1 0 0 0 1 /end COMPU_METHOD
/begin COMPU_METHOD RBPtCel_dst_1p0_4 "" RAT_FUNC "%6.2" "km" COEFFS 0 1 0 0 0 1 /end COMPU_METHOD
/begin COMPU_METHOD RBPtCel_Perc_0p5_1 "" RAT_FUNC "%6.3" "%" COEFFS 0 2 0 0 0 1 /end COMPU_METHOD
/begin COMPU_METHOD RBPtCel_Perc_1p0_1 "" RAT_FUNC "%6.2" "%" COEFFS 0 1 0 0 0 1 /end COMPU_METHOD
/begin COMPU_METHOD RBPtCel_pwr_1p0_4 "" RAT_FUNC "%6.2" "Ws" COEFFS 0 1 0 0 0 1 /end COMPU_METHOD
/begin COMPU_METHOD RBPtCel_pwr_25p0_1 "" RAT_FUNC "%6.1" "W" COEFFS 0 1 0 0 0 25 /end COMPU_METHOD
/begin COMPU_METHOD RBPtCel_t_0p1om40_1 "" RAT_FUNC "%6.2" "Deg C" COEFFS 0 10 400 0 0 1 /end COMPU_METHOD
/begin COMPU_METHOD RBPtCel_t_0p1_3 "" RAT_FUNC "%6.3" "Deg C" COEFFS 0 10 0 0 0 1 /end COMPU_METHOD
/begin COMPU_METHOD RBPtCel_t_1p0_om40_1 "" RAT_FUNC "%6.2" "Deg C" COEFFS 0 1 40 0 0 1 /end COMPU_METHOD
/begin COMPU_METHOD RBPtCel_u_0p00125_1 "" RAT_FUNC "%6.4" "V" COEFFS 0 800 0 0 0 1 /end COMPU_METHOD
/begin COMPU_METHOD RBPtCel_u_0p01_1 "" RAT_FUNC "%6.4" "V" COEFFS 0 100 0 0 0 1 /end COMPU_METHOD
/begin COMPU_METHOD RBPtCel_u_0p1_1 "" RAT_FUNC "%6.3" "V" COEFFS 0 10 0 0 0 1 /end COMPU_METHOD
/begin COMPU_METHOD rel_q0p0078125 "" RAT_FUNC "%6.4" "%" COEFFS 0 128 0 0 0 1 /end COMPU_METHOD
/begin COMPU_METHOD SigQly_COMPU_VERB "" TAB_VERB "%6.3" "" COMPU_TAB_REF SigQly_COMPU_VERB /end COMPU_METHOD
/begin COMPU_VTAB SigQly_COMPU_VERB "" TAB_VERB 16 0 "SIGQLY_NOTCALC" 1 "SIGQLY_INIT" 2 "SIGQLY_OK" 3 "SIGQLY_MODEL" 4 "SIGQLY_REPLACEMENT" 5 "SIGQLY_FROZEN" 6 "SIGQLY_INVALID" 7 "SIGQLY_RESERVED_7" 8 "SIGQLY_RESERVED_8" 9 "SIGQLY_RESERVED_9" 10 "SIGQLY_RESERVED_10" 11 "SIGQLY_RESERVED_11" 12 "SIGQLY_RESERVED_12" 13 "SIGQLY_RESERVED_13" 14 "SIGQLY_RESERVED_14" 15 "SIGQLY_RESERVED_15" /end COMPU_VTAB
/begin COMPU_METHOD spg_q0p0039 "" RAT_FUNC "%6.4" "V" COEFFS 0 256 0 0 0 1 /end COMPU_METHOD
/begin COMPU_METHOD spg_q0p0625_V "" RAT_FUNC "%6.4" "V" COEFFS 0 16 0 0 0 1 /end COMPU_METHOD
/begin COMPU_METHOD Temp_Cels "" RAT_FUNC "%6.1" "deg C" COEFFS 0 10 2731.4 0 0 1 /end COMPU_METHOD
/begin COMPU_METHOD Time_ms "" RAT_FUNC "%6.1" "ms" COEFFS 0 0.1 0 0 0 1 /end COMPU_METHOD
/begin COMPU_METHOD Time_sec_1 "" RAT_FUNC "%6.3" "s" COEFFS 0 10 0 0 0 1 /end COMPU_METHOD
/begin COMPU_METHOD Trq "" RAT_FUNC "%6.3" "Nm" COEFFS 0 10 0 0 0 1 /end COMPU_METHOD
/begin COMPU_METHOD TrqInrKp "" RAT_FUNC "%8.7" "%/Nm" COEFFS 0 327680 0 0 0 1 /end COMPU_METHOD
/begin COMPU_METHOD TrqInrKp_128 "" RAT_FUNC "%6.5" "%/Nm" COEFFS 0 2560 0 0 0 1 /end COMPU_METHOD
/begin COMPU_METHOD TrqPrpHigh "" RAT_FUNC "%6.3" "Nm" COEFFS 0 10 0 0 0 1 /end COMPU_METHOD
/begin COMPU_METHOD TrqToNSqr "" RAT_FUNC "%10.9" "-" COEFFS 0 10000000 0 0 0 1 /end COMPU_METHOD
/begin COMPU_METHOD Volt_V_q0p03125_COMPU "" RAT_FUNC "%6.4" "V" COEFFS 0 32 0 0 0 1 /end COMPU_METHOD
/begin RECORD_LAYOUT RB_Val_Wboolean FNC_VALUES 1 UBYTE COLUMN_DIR DIRECT /end RECORD_LAYOUT
/begin RECORD_LAYOUT RB_Val_Wr32 FNC_VALUES 1 FLOAT32_IEEE COLUMN_DIR DIRECT /end RECORD_LAYOUT
/begin RECORD_LAYOUT RB_Val_Ws16 FNC_VALUES 1 SWORD COLUMN_DIR DIRECT /end RECORD_LAYOUT
/begin RECORD_LAYOUT RB_Val_Ws32 FNC_VALUES 1 SLONG COLUMN_DIR DIRECT /end RECORD_LAYOUT
/begin RECORD_LAYOUT RB_Val_Ws8 FNC_VALUES 1 SBYTE COLUMN_DIR DIRECT /end RECORD_LAYOUT
/begin RECORD_LAYOUT RB_Val_Wu16 FNC_VALUES 1 UWORD COLUMN_DIR DIRECT /end RECORD_LAYOUT
/begin RECORD_LAYOUT RB_Val_Wu32 FNC_VALUES 1 ULONG COLUMN_DIR DIRECT /end RECORD_LAYOUT
/begin RECORD_LAYOUT RB_Val_Wu8 FNC_VALUES 1 UBYTE COLUMN_DIR DIRECT /end RECORD_LAYOUT
/begin RECORD_LAYOUT Val_Wu16 FNC_VALUES 1 UWORD COLUMN_DIR DIRECT /end RECORD_LAYOUT
/begin RECORD_LAYOUT Val_Wu8 FNC_VALUES 1 UBYTE COLUMN_DIR DIRECT /end RECORD_LAYOUT
/end MODULE
/end PROJECT

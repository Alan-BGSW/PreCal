ASAP2_VERSION 1 70
/begin PROJECT MDG1C "VC1CP091_STLA_N_D061I3"
/begin HEADER "" VERSION "VC1CP091_STLA_N_D061I3" PROJECT_NO MDG1C /end HEADER
/begin MODULE DIM ""
/begin MOD_COMMON "" BYTE_ORDER MSB_LAST ALIGNMENT_BYTE 1 ALIGNMENT_WORD 2 ALIGNMENT_LONG 4 ALIGNMENT_INT64 4 ALIGNMENT_FLOAT32_IEEE 4 ALIGNMENT_FLOAT64_IEEE 4 DATA_SIZE 32 /end MOD_COMMON
/begin CHARACTERISTIC DFES_FaultTyp.DFC_HvBattIReqToChrgrErr_C "" VALUE 0x8024DE7E Val_Wu8 255.0 DFES_OneToOne 0.00 255.0 FORMAT "%5.1" /end CHARACTERISTIC
/begin CHARACTERISTIC DFES_FaultTyp.DFC_HvBattIReqToChrgrIni_C "" VALUE 0x8024DE7F Val_Wu8 255.0 DFES_OneToOne 0.00 255.0 FORMAT "%5.1" /end CHARACTERISTIC
/begin CHARACTERISTIC DFES_FaultTyp.DFC_HvBattIninTout_C "" VALUE 0x8024DE80 Val_Wu8 255.0 DFES_OneToOne 0.00 255.0 FORMAT "%5.1" /end CHARACTERISTIC
/begin CHARACTERISTIC DFES_FaultTyp.DFC_HvBattIntlckSt_C "" VALUE 0x8024DE81 Val_Wu8 255.0 DFES_OneToOne 0.00 255.0 FORMAT "%5.1" /end CHARACTERISTIC
/begin CHARACTERISTIC DFES_FaultTyp.DFC_HvBattIsoFlt_C "" VALUE 0x8024DE82 Val_Wu8 255.0 DFES_OneToOne 0.00 255.0 FORMAT "%5.1" /end CHARACTERISTIC
/begin CHARACTERISTIC DFES_FaultTyp.DFC_HvBattLimdPwr_C "" VALUE 0x8024DE83 Val_Wu8 255.0 DFES_OneToOne 0.00 255.0 FORMAT "%5.1" /end CHARACTERISTIC
/begin CHARACTERISTIC DFES_FaultTyp.DFC_HvBattMaiSwtClsngFlt_C "" VALUE 0x8024DE84 Val_Wu8 255.0 DFES_OneToOne 0.00 255.0 FORMAT "%5.1" /end CHARACTERISTIC
/begin CHARACTERISTIC DFES_FaultTyp.DFC_HvBattMaiSwtFlt_C "" VALUE 0x8024DE85 Val_Wu8 255.0 DFES_OneToOne 0.00 255.0 FORMAT "%5.1" /end CHARACTERISTIC
/begin CHARACTERISTIC DFES_FaultTyp.DFC_HvBattMaiSwtOpen_C "" VALUE 0x8024DE86 Val_Wu8 255.0 DFES_OneToOne 0.00 255.0 FORMAT "%5.1" /end CHARACTERISTIC
/begin CHARACTERISTIC DFES_FaultTyp.DFC_HvBattMaiSwtOpngFlt_C "" VALUE 0x8024DE87 Val_Wu8 255.0 DFES_OneToOne 0.00 255.0 FORMAT "%5.1" /end CHARACTERISTIC
/begin CHARACTERISTIC DFES_FaultTyp.DFC_HvBattMaiSwtWldd_C "" VALUE 0x8024DE88 Val_Wu8 255.0 DFES_OneToOne 0.00 255.0 FORMAT "%5.1" /end CHARACTERISTIC
/begin CHARACTERISTIC DFES_FaultTyp.DFC_HvBattNegCntctrCntErr_C "" VALUE 0x8024DE89 Val_Wu8 255.0 DFES_OneToOne 0.00 255.0 FORMAT "%5.1" /end CHARACTERISTIC
/begin CHARACTERISTIC DFES_FaultTyp.DFC_HvBattOperModChrgPlausy_C "" VALUE 0x8024DE8A Val_Wu8 255.0 DFES_OneToOne 0.00 255.0 FORMAT "%5.1" /end CHARACTERISTIC
/begin CHARACTERISTIC DFES_FaultTyp.DFC_HvBattOverTDern_C "" VALUE 0x8024DE8B Val_Wu8 255.0 DFES_OneToOne 0.00 255.0 FORMAT "%5.1" /end CHARACTERISTIC
/begin CHARACTERISTIC DFES_FaultTyp.DFC_HvBattPosCntctrCntErr_C "" VALUE 0x8024DE8C Val_Wu8 255.0 DFES_OneToOne 0.00 255.0 FORMAT "%5.1" /end CHARACTERISTIC
/begin CHARACTERISTIC DFES_FaultTyp.DFC_HvBattPrecCntctrCntErr_C "" VALUE 0x8024DE8D Val_Wu8 255.0 DFES_OneToOne 0.00 255.0 FORMAT "%5.1" /end CHARACTERISTIC
/begin CHARACTERISTIC DFES_FaultTyp.DFC_HvBattPwrDistbnTDern_C "" VALUE 0x8024DE8E Val_Wu8 255.0 DFES_OneToOne 0.00 255.0 FORMAT "%5.1" /end CHARACTERISTIC
/begin CHARACTERISTIC DFES_FaultTyp.DFC_HvBattPwrDistbnTInhbn_C "" VALUE 0x8024DE8F Val_Wu8 255.0 DFES_OneToOne 0.00 255.0 FORMAT "%5.1" /end CHARACTERISTIC
/begin CHARACTERISTIC DFES_FaultTyp.DFC_HvBattRatRSohErr_C "" VALUE 0x8024DE90 Val_Wu8 255.0 DFES_OneToOne 0.00 255.0 FORMAT "%5.1" /end CHARACTERISTIC
/begin CHARACTERISTIC DFES_FaultTyp.DFC_HvBattRatSohErr_C "" VALUE 0x8024DE91 Val_Wu8 255.0 DFES_OneToOne 0.00 255.0 FORMAT "%5.1" /end CHARACTERISTIC
/begin CHARACTERISTIC DFES_FaultTyp.DFC_HvBattSngIsoWarn_C "" VALUE 0x8024DE92 Val_Wu8 255.0 DFES_OneToOne 0.00 255.0 FORMAT "%5.1" /end CHARACTERISTIC
/begin CHARACTERISTIC DFES_FaultTyp.DFC_HvBattSrvPlgDiscnct_C "" VALUE 0x8024DE93 Val_Wu8 255.0 DFES_OneToOne 0.00 255.0 FORMAT "%5.1" /end CHARACTERISTIC
/begin CHARACTERISTIC DFES_FaultTyp.DFC_HvBattUNomChrgnErr_C "" VALUE 0x8024DE94 Val_Wu8 255.0 DFES_OneToOne 0.00 255.0 FORMAT "%5.1" /end CHARACTERISTIC
/begin CHARACTERISTIC DFES_FaultTyp.DFC_HvBattUNomChrgnIni_C "" VALUE 0x8024DE95 Val_Wu8 255.0 DFES_OneToOne 0.00 255.0 FORMAT "%5.1" /end CHARACTERISTIC
/begin CHARACTERISTIC DFES_FaultTyp.DFC_HvBattUnderTDern_C "" VALUE 0x8024DE96 Val_Wu8 255.0 DFES_OneToOne 0.00 255.0 FORMAT "%5.1" /end CHARACTERISTIC
/begin CHARACTERISTIC DFES_FaultTyp.DFC_HvbEVLmpBlink_C "" VALUE 0x8024DE97 Val_Wu8 255.0 DFES_OneToOne 0.00 255.0 FORMAT "%5.1" /end CHARACTERISTIC
/begin CHARACTERISTIC DFES_FaultTyp.DFC_HvbEVLmpCont_C "" VALUE 0x8024DE98 Val_Wu8 255.0 DFES_OneToOne 0.00 255.0 FORMAT "%5.1" /end CHARACTERISTIC
/begin CHARACTERISTIC DFES_FaultTyp.DFC_HvbSVSBlink_C "" VALUE 0x8024DE99 Val_Wu8 255.0 DFES_OneToOne 0.00 255.0 FORMAT "%5.1" /end CHARACTERISTIC
/begin CHARACTERISTIC DFES_FaultTyp.DFC_HvbSVSCont_C "" VALUE 0x8024DE9A Val_Wu8 255.0 DFES_OneToOne 0.00 255.0 FORMAT "%5.1" /end CHARACTERISTIC
/begin CHARACTERISTIC DFES_FaultTyp.DFC_InmLINBusBlk_C "" VALUE 0x8024DE9B Val_Wu8 255.0 DFES_OneToOne 0.00 255.0 FORMAT "%5.1" /end CHARACTERISTIC
/begin CHARACTERISTIC DFES_FaultTyp.DFC_PDUProgmFailr_C "" VALUE 0x8024DE9C Val_Wu8 255.0 DFES_OneToOne 0.00 255.0 FORMAT "%5.1" /end CHARACTERISTIC
/begin CHARACTERISTIC DFES_FaultTyp.DFC_PEnvSigRngMax_C "" VALUE 0x8024DE9D Val_Wu8 255.0 DFES_OneToOne 0.00 255.0 FORMAT "%5.1" /end CHARACTERISTIC
/begin CHARACTERISTIC DFES_FaultTyp.DFC_PEnvSigRngMin_C "" VALUE 0x8024DE9E Val_Wu8 255.0 DFES_OneToOne 0.00 255.0 FORMAT "%5.1" /end CHARACTERISTIC
/begin CHARACTERISTIC DFES_FaultTyp.DFC_PLnCChpDeactvnFaild_C "" VALUE 0x8024DE9F Val_Wu8 255.0 DFES_OneToOne 0.00 255.0 FORMAT "%5.1" /end CHARACTERISTIC
/begin CHARACTERISTIC DFES_FaultTyp.DFC_PrkgBrkFailr_C "" VALUE 0x8024DEA0 Val_Wu8 255.0 DFES_OneToOne 0.00 255.0 FORMAT "%5.1" /end CHARACTERISTIC
/begin CHARACTERISTIC DFES_FaultTyp.DFC_PtSysLimErr_C "" VALUE 0x8024DEA1 Val_Wu8 255.0 DFES_OneToOne 0.00 255.0 FORMAT "%5.1" /end CHARACTERISTIC
/begin CHARACTERISTIC DFES_FaultTyp.DFC_PwrMaxDchaShoLo_C "" VALUE 0x8024DEA2 Val_Wu8 255.0 DFES_OneToOne 0.00 255.0 FORMAT "%5.1" /end CHARACTERISTIC
/begin CHARACTERISTIC DFES_FaultTyp.DFC_SCtPmp1FailSafeNotSuc_C "" VALUE 0x8024DEA3 Val_Wu8 255.0 DFES_OneToOne 0.00 255.0 FORMAT "%5.1" /end CHARACTERISTIC
/begin CHARACTERISTIC DFES_FaultTyp.DFC_SCtPmp1SCG_C "" VALUE 0x8024DEA4 Val_Wu8 255.0 DFES_OneToOne 0.00 255.0 FORMAT "%5.1" /end CHARACTERISTIC
/begin CHARACTERISTIC DFES_FaultTyp.DFC_VehCoornDrvrNotPrsnt_C "" VALUE 0x8024DEA5 Val_Wu8 255.0 DFES_OneToOne 0.00 255.0 FORMAT "%5.1" /end CHARACTERISTIC
/begin CHARACTERISTIC DFES_FaultTyp.DFC_VehVCanAvl_C "" VALUE 0x8024DEA6 Val_Wu8 255.0 DFES_OneToOne 0.00 255.0 FORMAT "%5.1" /end CHARACTERISTIC
/begin CHARACTERISTIC DFES_FaultTyp.DFC_VehVCanErr_C "" VALUE 0x8024DEA7 Val_Wu8 255.0 DFES_OneToOne 0.00 255.0 FORMAT "%5.1" /end CHARACTERISTIC
/begin CHARACTERISTIC DFES_FaultTyp.DFC_eTogFailrLvlRes_C "" VALUE 0x8024DEA8 Val_Wu8 255.0 DFES_OneToOne 0.00 255.0 FORMAT "%5.1" /end CHARACTERISTIC
/begin CHARACTERISTIC DFES_FaultTyp.DFC_flgBrkMaiDiag_C "" VALUE 0x8024DEA9 Val_Wu8 255.0 DFES_OneToOne 0.00 255.0 FORMAT "%5.1" /end CHARACTERISTIC
/begin CHARACTERISTIC DFES_FaultTyp.DFC_stHvbIsoMeasmtRes_C "" VALUE 0x8024DEAA Val_Wu8 255.0 DFES_OneToOne 0.00 255.0 FORMAT "%5.1" /end CHARACTERISTIC
/begin CHARACTERISTIC DFES_FaultTyp.DFC_BrkBstPmpPLeakDfct_C "" VALUE 0x8024DEAB Val_Wu8 255.0 DFES_OneToOne 0.00 255.0 FORMAT "%5.1" /end CHARACTERISTIC
/begin CHARACTERISTIC DFES_FaultTyp.DFC_Com082hTooShort_C "" VALUE 0x8024DEAC Val_Wu8 255.0 DFES_OneToOne 0.00 255.0 FORMAT "%5.1" /end CHARACTERISTIC
/begin CHARACTERISTIC DFES_FaultTyp.DFC_Com092hTooShort_C "" VALUE 0x8024DEAD Val_Wu8 255.0 DFES_OneToOne 0.00 255.0 FORMAT "%5.1" /end CHARACTERISTIC
/begin CHARACTERISTIC DFES_FaultTyp.DFC_Com205hAbsent_C "" VALUE 0x8024DEAE Val_Wu8 255.0 DFES_OneToOne 0.00 255.0 FORMAT "%5.1" /end CHARACTERISTIC
/begin CHARACTERISTIC DFES_FaultTyp.DFC_Com205hChecksum_C "" VALUE 0x8024DEAF Val_Wu8 255.0 DFES_OneToOne 0.00 255.0 FORMAT "%5.1" /end CHARACTERISTIC
/begin CHARACTERISTIC DFES_FaultTyp.DFC_Com205hCounter_C "" VALUE 0x8024DEB0 Val_Wu8 255.0 DFES_OneToOne 0.00 255.0 FORMAT "%5.1" /end CHARACTERISTIC
/begin CHARACTERISTIC DFES_FaultTyp.DFC_Com205hTooShort_C "" VALUE 0x8024DEB1 Val_Wu8 255.0 DFES_OneToOne 0.00 255.0 FORMAT "%5.1" /end CHARACTERISTIC
/begin CHARACTERISTIC DFES_FaultTyp.DFC_Com217hAbsent_C "" VALUE 0x8024DEB2 Val_Wu8 255.0 DFES_OneToOne 0.00 255.0 FORMAT "%5.1" /end CHARACTERISTIC
/begin CHARACTERISTIC DFES_FaultTyp.DFC_Com217hChecksum_C "" VALUE 0x8024DEB3 Val_Wu8 255.0 DFES_OneToOne 0.00 255.0 FORMAT "%5.1" /end CHARACTERISTIC
/begin CHARACTERISTIC DFES_FaultTyp.DFC_Com217hCounter_C "" VALUE 0x8024DEB4 Val_Wu8 255.0 DFES_OneToOne 0.00 255.0 FORMAT "%5.1" /end CHARACTERISTIC
/begin CHARACTERISTIC DFES_FaultTyp.DFC_Com217hTooShort_C "" VALUE 0x8024DEB5 Val_Wu8 255.0 DFES_OneToOne 0.00 255.0 FORMAT "%5.1" /end CHARACTERISTIC
/begin CHARACTERISTIC DFES_FaultTyp.DFC_Com227hAbsent_C "" VALUE 0x8024DEB6 Val_Wu8 255.0 DFES_OneToOne 0.00 255.0 FORMAT "%5.1" /end CHARACTERISTIC
/begin CHARACTERISTIC DFES_FaultTyp.DFC_Com227hTooShort_C "" VALUE 0x8024DEB7 Val_Wu8 255.0 DFES_OneToOne 0.00 255.0 FORMAT "%5.1" /end CHARACTERISTIC
/begin CHARACTERISTIC DFES_FaultTyp.DFC_Com237hAbsent_C "" VALUE 0x8024DEB8 Val_Wu8 255.0 DFES_OneToOne 0.00 255.0 FORMAT "%5.1" /end CHARACTERISTIC
/begin CHARACTERISTIC DFES_FaultTyp.DFC_Com237hChecksum_C "" VALUE 0x8024DEB9 Val_Wu8 255.0 DFES_OneToOne 0.00 255.0 FORMAT "%5.1" /end CHARACTERISTIC
/begin CHARACTERISTIC DFES_FaultTyp.DFC_Com237hCounter_C "" VALUE 0x8024DEBA Val_Wu8 255.0 DFES_OneToOne 0.00 255.0 FORMAT "%5.1" /end CHARACTERISTIC
/begin CHARACTERISTIC DFES_FaultTyp.DFC_Com237hTooShort_C "" VALUE 0x8024DEBB Val_Wu8 255.0 DFES_OneToOne 0.00 255.0 FORMAT "%5.1" /end CHARACTERISTIC
/begin CHARACTERISTIC DFES_FaultTyp.DFC_Com259hAbsent_C "" VALUE 0x8024DEBC Val_Wu8 255.0 DFES_OneToOne 0.00 255.0 FORMAT "%5.1" /end CHARACTERISTIC
/begin CHARACTERISTIC DFES_FaultTyp.DFC_Com259hChecksum_C "" VALUE 0x8024DEBD Val_Wu8 255.0 DFES_OneToOne 0.00 255.0 FORMAT "%5.1" /end CHARACTERISTIC
/begin CHARACTERISTIC DFES_FaultTyp.DFC_Com259hCounter_C "" VALUE 0x8024DEBE Val_Wu8 255.0 DFES_OneToOne 0.00 255.0 FORMAT "%5.1" /end CHARACTERISTIC
/begin CHARACTERISTIC DFES_FaultTyp.DFC_Com259hTooShort_C "" VALUE 0x8024DEBF Val_Wu8 255.0 DFES_OneToOne 0.00 255.0 FORMAT "%5.1" /end CHARACTERISTIC
/begin CHARACTERISTIC DFES_FaultTyp.DFC_Com26hAbsent_C "" VALUE 0x8024DEC0 Val_Wu8 255.0 DFES_OneToOne 0.00 255.0 FORMAT "%5.1" /end CHARACTERISTIC
/begin CHARACTERISTIC DFES_FaultTyp.DFC_Com26hTooShort_C "" VALUE 0x8024DEC1 Val_Wu8 255.0 DFES_OneToOne 0.00 255.0 FORMAT "%5.1" /end CHARACTERISTIC
/begin CHARACTERISTIC DFES_FaultTyp.DFC_Com273hAbsent_C "" VALUE 0x8024DEC2 Val_Wu8 255.0 DFES_OneToOne 0.00 255.0 FORMAT "%5.1" /end CHARACTERISTIC
/begin CHARACTERISTIC DFES_FaultTyp.DFC_Com273hChecksum_C "" VALUE 0x8024DEC3 Val_Wu8 255.0 DFES_OneToOne 0.00 255.0 FORMAT "%5.1" /end CHARACTERISTIC
/begin CHARACTERISTIC DFES_FaultTyp.DFC_Com273hCounter_C "" VALUE 0x8024DEC4 Val_Wu8 255.0 DFES_OneToOne 0.00 255.0 FORMAT "%5.1" /end CHARACTERISTIC
/begin CHARACTERISTIC DFES_FaultTyp.DFC_Com273hTooShort_C "" VALUE 0x8024DEC5 Val_Wu8 255.0 DFES_OneToOne 0.00 255.0 FORMAT "%5.1" /end CHARACTERISTIC
/begin CHARACTERISTIC DFES_FaultTyp.DFC_Com275hAbsent_C "" VALUE 0x8024DEC6 Val_Wu8 255.0 DFES_OneToOne 0.00 255.0 FORMAT "%5.1" /end CHARACTERISTIC
/begin CHARACTERISTIC DFES_FaultTyp.DFC_Com275hChecksum_C "" VALUE 0x8024DEC7 Val_Wu8 255.0 DFES_OneToOne 0.00 255.0 FORMAT "%5.1" /end CHARACTERISTIC
/begin CHARACTERISTIC DFES_FaultTyp.DFC_Com275hCounter_C "" VALUE 0x8024DEC8 Val_Wu8 255.0 DFES_OneToOne 0.00 255.0 FORMAT "%5.1" /end CHARACTERISTIC
/begin CHARACTERISTIC DFES_FaultTyp.DFC_Com275hTooShort_C "" VALUE 0x8024DEC9 Val_Wu8 255.0 DFES_OneToOne 0.00 255.0 FORMAT "%5.1" /end CHARACTERISTIC
/begin CHARACTERISTIC DFES_FaultTyp.DFC_Com283hAbsent_C "" VALUE 0x8024DECA Val_Wu8 255.0 DFES_OneToOne 0.00 255.0 FORMAT "%5.1" /end CHARACTERISTIC
/begin CHARACTERISTIC DFES_FaultTyp.DFC_Com283hTooShort_C "" VALUE 0x8024DECB Val_Wu8 255.0 DFES_OneToOne 0.00 255.0 FORMAT "%5.1" /end CHARACTERISTIC
/begin CHARACTERISTIC DFES_FaultTyp.DFC_Com285hAbsent_C "" VALUE 0x8024DECC Val_Wu8 255.0 DFES_OneToOne 0.00 255.0 FORMAT "%5.1" /end CHARACTERISTIC
/begin CHARACTERISTIC DFES_FaultTyp.DFC_Com285hChecksum_C "" VALUE 0x8024DECD Val_Wu8 255.0 DFES_OneToOne 0.00 255.0 FORMAT "%5.1" /end CHARACTERISTIC
/begin CHARACTERISTIC DFES_FaultTyp.DFC_Com285hCounter_C "" VALUE 0x8024DECE Val_Wu8 255.0 DFES_OneToOne 0.00 255.0 FORMAT "%5.1" /end CHARACTERISTIC
/begin CHARACTERISTIC DFES_FaultTyp.DFC_Com285hTooShort_C "" VALUE 0x8024DECF Val_Wu8 255.0 DFES_OneToOne 0.00 255.0 FORMAT "%5.1" /end CHARACTERISTIC
/begin CHARACTERISTIC DFES_FaultTyp.DFC_Com293hAbsent_C "" VALUE 0x8024DED0 Val_Wu8 255.0 DFES_OneToOne 0.00 255.0 FORMAT "%5.1" /end CHARACTERISTIC
/begin CHARACTERISTIC DFES_FaultTyp.DFC_Com293hChecksum_C "" VALUE 0x8024DED1 Val_Wu8 255.0 DFES_OneToOne 0.00 255.0 FORMAT "%5.1" /end CHARACTERISTIC
/begin CHARACTERISTIC DFES_FaultTyp.DFC_Com293hCounter_C "" VALUE 0x8024DED2 Val_Wu8 255.0 DFES_OneToOne 0.00 255.0 FORMAT "%5.1" /end CHARACTERISTIC
/begin CHARACTERISTIC DFES_FaultTyp.DFC_Com293hTooShort_C "" VALUE 0x8024DED3 Val_Wu8 255.0 DFES_OneToOne 0.00 255.0 FORMAT "%5.1" /end CHARACTERISTIC
/begin CHARACTERISTIC DFES_FaultTyp.DFC_Com308hAbsent_C "" VALUE 0x8024DED4 Val_Wu8 255.0 DFES_OneToOne 0.00 255.0 FORMAT "%5.1" /end CHARACTERISTIC
/begin CHARACTERISTIC DFES_FaultTyp.DFC_Com308hChecksum_C "" VALUE 0x8024DED5 Val_Wu8 255.0 DFES_OneToOne 0.00 255.0 FORMAT "%5.1" /end CHARACTERISTIC
/begin CHARACTERISTIC DFES_FaultTyp.DFC_Com308hCounter_C "" VALUE 0x8024DED6 Val_Wu8 255.0 DFES_OneToOne 0.00 255.0 FORMAT "%5.1" /end CHARACTERISTIC
/begin CHARACTERISTIC DFES_FaultTyp.DFC_Com308hTooShort_C "" VALUE 0x8024DED7 Val_Wu8 255.0 DFES_OneToOne 0.00 255.0 FORMAT "%5.1" /end CHARACTERISTIC
/begin CHARACTERISTIC DFES_FaultTyp.DFC_Com318hAbsent_C "" VALUE 0x8024DED8 Val_Wu8 255.0 DFES_OneToOne 0.00 255.0 FORMAT "%5.1" /end CHARACTERISTIC
/begin CHARACTERISTIC DFES_FaultTyp.DFC_Com318hChecksum_C "" VALUE 0x8024DED9 Val_Wu8 255.0 DFES_OneToOne 0.00 255.0 FORMAT "%5.1" /end CHARACTERISTIC
/begin CHARACTERISTIC DFES_FaultTyp.DFC_Com318hCounter_C "" VALUE 0x8024DEDA Val_Wu8 255.0 DFES_OneToOne 0.00 255.0 FORMAT "%5.1" /end CHARACTERISTIC
/begin CHARACTERISTIC DFES_FaultTyp.DFC_Com318hTooShort_C "" VALUE 0x8024DEDB Val_Wu8 255.0 DFES_OneToOne 0.00 255.0 FORMAT "%5.1" /end CHARACTERISTIC
/begin CHARACTERISTIC DFES_FaultTyp.DFC_Com325hAbsent_C "" VALUE 0x8024DEDC Val_Wu8 255.0 DFES_OneToOne 0.00 255.0 FORMAT "%5.1" /end CHARACTERISTIC
/begin CHARACTERISTIC DFES_FaultTyp.DFC_Com325hChecksum_C "" VALUE 0x8024DEDD Val_Wu8 255.0 DFES_OneToOne 0.00 255.0 FORMAT "%5.1" /end CHARACTERISTIC
/begin CHARACTERISTIC DFES_FaultTyp.DFC_Com325hCounter_C "" VALUE 0x8024DEDE Val_Wu8 255.0 DFES_OneToOne 0.00 255.0 FORMAT "%5.1" /end CHARACTERISTIC
/begin CHARACTERISTIC DFES_FaultTyp.DFC_Com325hTooShort_C "" VALUE 0x8024DEDF Val_Wu8 255.0 DFES_OneToOne 0.00 255.0 FORMAT "%5.1" /end CHARACTERISTIC
/begin CHARACTERISTIC DFES_FaultTyp.DFC_Com335hAbsent_C "" VALUE 0x8024DEE0 Val_Wu8 255.0 DFES_OneToOne 0.00 255.0 FORMAT "%5.1" /end CHARACTERISTIC
/begin CHARACTERISTIC DFES_FaultTyp.DFC_Com335hChecksum_C "" VALUE 0x8024DEE1 Val_Wu8 255.0 DFES_OneToOne 0.00 255.0 FORMAT "%5.1" /end CHARACTERISTIC
/begin CHARACTERISTIC DFES_FaultTyp.DFC_Com335hCounter_C "" VALUE 0x8024DEE2 Val_Wu8 255.0 DFES_OneToOne 0.00 255.0 FORMAT "%5.1" /end CHARACTERISTIC
/begin CHARACTERISTIC DFES_FaultTyp.DFC_Com335hTooShort_C "" VALUE 0x8024DEE3 Val_Wu8 255.0 DFES_OneToOne 0.00 255.0 FORMAT "%5.1" /end CHARACTERISTIC
/begin CHARACTERISTIC DFES_FaultTyp.DFC_Com351hAbsent_C "" VALUE 0x8024DEE4 Val_Wu8 255.0 DFES_OneToOne 0.00 255.0 FORMAT "%5.1" /end CHARACTERISTIC
/begin CHARACTERISTIC DFES_FaultTyp.DFC_Com351hTooShort_C "" VALUE 0x8024DEE5 Val_Wu8 255.0 DFES_OneToOne 0.00 255.0 FORMAT "%5.1" /end CHARACTERISTIC
/begin CHARACTERISTIC DFES_FaultTyp.DFC_Com38DhAbsent_C "" VALUE 0x8024DEE6 Val_Wu8 255.0 DFES_OneToOne 0.00 255.0 FORMAT "%5.1" /end CHARACTERISTIC
/begin CHARACTERISTIC DFES_FaultTyp.DFC_Com38DhChecksum_C "" VALUE 0x8024DEE7 Val_Wu8 255.0 DFES_OneToOne 0.00 255.0 FORMAT "%5.1" /end CHARACTERISTIC
/begin CHARACTERISTIC DFES_FaultTyp.DFC_Com38DhCounter_C "" VALUE 0x8024DEE8 Val_Wu8 255.0 DFES_OneToOne 0.00 255.0 FORMAT "%5.1" /end CHARACTERISTIC
/begin CHARACTERISTIC DFES_FaultTyp.DFC_Com38DhTooShort_C "" VALUE 0x8024DEE9 Val_Wu8 255.0 DFES_OneToOne 0.00 255.0 FORMAT "%5.1" /end CHARACTERISTIC
/begin CHARACTERISTIC DFES_FaultTyp.DFC_Com412hAbsent_C "" VALUE 0x8024DEEA Val_Wu8 255.0 DFES_OneToOne 0.00 255.0 FORMAT "%5.1" /end CHARACTERISTIC
/begin CHARACTERISTIC DFES_FaultTyp.DFC_Com412hChecksum_C "" VALUE 0x8024DEEB Val_Wu8 255.0 DFES_OneToOne 0.00 255.0 FORMAT "%5.1" /end CHARACTERISTIC
/begin CHARACTERISTIC DFES_FaultTyp.DFC_Com412hCounter_C "" VALUE 0x8024DEEC Val_Wu8 255.0 DFES_OneToOne 0.00 255.0 FORMAT "%5.1" /end CHARACTERISTIC
/begin CHARACTERISTIC DFES_FaultTyp.DFC_Com412hTooShort_C "" VALUE 0x8024DEED Val_Wu8 255.0 DFES_OneToOne 0.00 255.0 FORMAT "%5.1" /end CHARACTERISTIC
/begin CHARACTERISTIC DFES_FaultTyp.DFC_Com427hAbsent_C "" VALUE 0x8024DEEE Val_Wu8 255.0 DFES_OneToOne 0.00 255.0 FORMAT "%5.1" /end CHARACTERISTIC
/begin CHARACTERISTIC DFES_FaultTyp.DFC_Com427hTooShort_C "" VALUE 0x8024DEEF Val_Wu8 255.0 DFES_OneToOne 0.00 255.0 FORMAT "%5.1" /end CHARACTERISTIC
/begin CHARACTERISTIC DFES_FaultTyp.DFC_Com432hAbsent_C "" VALUE 0x8024DEF0 Val_Wu8 255.0 DFES_OneToOne 0.00 255.0 FORMAT "%5.1" /end CHARACTERISTIC
/begin CHARACTERISTIC DFES_FaultTyp.DFC_Com432hChecksum_C "" VALUE 0x8024DEF1 Val_Wu8 255.0 DFES_OneToOne 0.00 255.0 FORMAT "%5.1" /end CHARACTERISTIC
/begin CHARACTERISTIC DFES_FaultTyp.DFC_Com432hCounter_C "" VALUE 0x8024DEF2 Val_Wu8 255.0 DFES_OneToOne 0.00 255.0 FORMAT "%5.1" /end CHARACTERISTIC
/begin CHARACTERISTIC DFES_FaultTyp.DFC_Com432hTooShort_C "" VALUE 0x8024DEF3 Val_Wu8 255.0 DFES_OneToOne 0.00 255.0 FORMAT "%5.1" /end CHARACTERISTIC
/begin CHARACTERISTIC DFES_FaultTyp.DFC_Com435hAbsent_C "" VALUE 0x8024DEF4 Val_Wu8 255.0 DFES_OneToOne 0.00 255.0 FORMAT "%5.1" /end CHARACTERISTIC
/begin CHARACTERISTIC DFES_FaultTyp.DFC_Com435hTooShort_C "" VALUE 0x8024DEF5 Val_Wu8 255.0 DFES_OneToOne 0.00 255.0 FORMAT "%5.1" /end CHARACTERISTIC
/begin CHARACTERISTIC DFES_FaultTyp.DFC_Com442hAbsent_C "" VALUE 0x8024DEF6 Val_Wu8 255.0 DFES_OneToOne 0.00 255.0 FORMAT "%5.1" /end CHARACTERISTIC
/begin CHARACTERISTIC DFES_FaultTyp.DFC_Com442hTooShort_C "" VALUE 0x8024DEF7 Val_Wu8 255.0 DFES_OneToOne 0.00 255.0 FORMAT "%5.1" /end CHARACTERISTIC
/begin CHARACTERISTIC DFES_FaultTyp.DFC_Com453hAbsent_C "" VALUE 0x8024DEF8 Val_Wu8 255.0 DFES_OneToOne 0.00 255.0 FORMAT "%5.1" /end CHARACTERISTIC
/begin CHARACTERISTIC DFES_FaultTyp.DFC_Com453hTooShort_C "" VALUE 0x8024DEF9 Val_Wu8 255.0 DFES_OneToOne 0.00 255.0 FORMAT "%5.1" /end CHARACTERISTIC
/begin CHARACTERISTIC DFES_FaultTyp.DFC_Com455hAbsent_C "" VALUE 0x8024DEFA Val_Wu8 255.0 DFES_OneToOne 0.00 255.0 FORMAT "%5.1" /end CHARACTERISTIC
/begin CHARACTERISTIC DFES_FaultTyp.DFC_Com455hTooShort_C "" VALUE 0x8024DEFB Val_Wu8 255.0 DFES_OneToOne 0.00 255.0 FORMAT "%5.1" /end CHARACTERISTIC
/begin CHARACTERISTIC DFES_FaultTyp.DFC_Com463hAbsent_C "" VALUE 0x8024DEFC Val_Wu8 255.0 DFES_OneToOne 0.00 255.0 FORMAT "%5.1" /end CHARACTERISTIC
/begin CHARACTERISTIC DFES_FaultTyp.DFC_Com463hTooShort_C "" VALUE 0x8024DEFD Val_Wu8 255.0 DFES_OneToOne 0.00 255.0 FORMAT "%5.1" /end CHARACTERISTIC
/begin CHARACTERISTIC DFES_FaultTyp.DFC_Com473hAbsent_C "" VALUE 0x8024DEFE Val_Wu8 255.0 DFES_OneToOne 0.00 255.0 FORMAT "%5.1" /end CHARACTERISTIC
/begin CHARACTERISTIC DFES_FaultTyp.DFC_Com473hTooShort_C "" VALUE 0x8024DEFF Val_Wu8 255.0 DFES_OneToOne 0.00 255.0 FORMAT "%5.1" /end CHARACTERISTIC
/begin CHARACTERISTIC DFES_FaultTyp.DFC_Com47BhAbsent_C "" VALUE 0x8024DF00 Val_Wu8 255.0 DFES_OneToOne 0.00 255.0 FORMAT "%5.1" /end CHARACTERISTIC
/begin CHARACTERISTIC DFES_FaultTyp.DFC_Com47BhTooShort_C "" VALUE 0x8024DF01 Val_Wu8 255.0 DFES_OneToOne 0.00 255.0 FORMAT "%5.1" /end CHARACTERISTIC
/begin CHARACTERISTIC DFES_FaultTyp.DFC_Com48BhAbsent_C "" VALUE 0x8024DF02 Val_Wu8 255.0 DFES_OneToOne 0.00 255.0 FORMAT "%5.1" /end CHARACTERISTIC
/begin CHARACTERISTIC DFES_FaultTyp.DFC_Com48BhTooShort_C "" VALUE 0x8024DF03 Val_Wu8 255.0 DFES_OneToOne 0.00 255.0 FORMAT "%5.1" /end CHARACTERISTIC
/begin CHARACTERISTIC DFES_FaultTyp.DFC_Com497hTooShort_C "" VALUE 0x8024DF04 Val_Wu8 255.0 DFES_OneToOne 0.00 255.0 FORMAT "%5.1" /end CHARACTERISTIC
/begin CHARACTERISTIC DFES_FaultTyp.DFC_Com4F2hAbsent_C "" VALUE 0x8024DF05 Val_Wu8 255.0 DFES_OneToOne 0.00 255.0 FORMAT "%5.1" /end CHARACTERISTIC
/begin CHARACTERISTIC DFES_FaultTyp.DFC_Com4F2hChecksum_C "" VALUE 0x8024DF06 Val_Wu8 255.0 DFES_OneToOne 0.00 255.0 FORMAT "%5.1" /end CHARACTERISTIC
/begin CHARACTERISTIC DFES_FaultTyp.DFC_Com4F2hCounter_C "" VALUE 0x8024DF07 Val_Wu8 255.0 DFES_OneToOne 0.00 255.0 FORMAT "%5.1" /end CHARACTERISTIC
/begin CHARACTERISTIC DFES_FaultTyp.DFC_Com4F2hTooShort_C "" VALUE 0x8024DF08 Val_Wu8 255.0 DFES_OneToOne 0.00 255.0 FORMAT "%5.1" /end CHARACTERISTIC
/begin CHARACTERISTIC DFES_FaultTyp.DFC_Com50DhAbsent_C "" VALUE 0x8024DF09 Val_Wu8 255.0 DFES_OneToOne 0.00 255.0 FORMAT "%5.1" /end CHARACTERISTIC
/begin CHARACTERISTIC DFES_FaultTyp.DFC_Com50DhTooShort_C "" VALUE 0x8024DF0A Val_Wu8 255.0 DFES_OneToOne 0.00 255.0 FORMAT "%5.1" /end CHARACTERISTIC
/begin CHARACTERISTIC DFES_FaultTyp.DFC_Com535hAbsent_C "" VALUE 0x8024DF0B Val_Wu8 255.0 DFES_OneToOne 0.00 255.0 FORMAT "%5.1" /end CHARACTERISTIC
/begin CHARACTERISTIC DFES_FaultTyp.DFC_Com535hTooShort_C "" VALUE 0x8024DF0C Val_Wu8 255.0 DFES_OneToOne 0.00 255.0 FORMAT "%5.1" /end CHARACTERISTIC
/begin CHARACTERISTIC DFES_FaultTyp.DFC_Com543hAbsent_C "" VALUE 0x8024DF0D Val_Wu8 255.0 DFES_OneToOne 0.00 255.0 FORMAT "%5.1" /end CHARACTERISTIC
/begin CHARACTERISTIC DFES_FaultTyp.DFC_Com543hTooShort_C "" VALUE 0x8024DF0E Val_Wu8 255.0 DFES_OneToOne 0.00 255.0 FORMAT "%5.1" /end CHARACTERISTIC
/begin CHARACTERISTIC DFES_FaultTyp.DFC_Com552hAbsent_C "" VALUE 0x8024DF0F Val_Wu8 255.0 DFES_OneToOne 0.00 255.0 FORMAT "%5.1" /end CHARACTERISTIC
/begin CHARACTERISTIC DFES_FaultTyp.DFC_Com552hTooShort_C "" VALUE 0x8024DF10 Val_Wu8 255.0 DFES_OneToOne 0.00 255.0 FORMAT "%5.1" /end CHARACTERISTIC
/begin CHARACTERISTIC DFES_FaultTyp.DFC_Com583hAbsent_C "" VALUE 0x8024DF11 Val_Wu8 255.0 DFES_OneToOne 0.00 255.0 FORMAT "%5.1" /end CHARACTERISTIC
/begin CHARACTERISTIC DFES_FaultTyp.DFC_Com583hTooShort_C "" VALUE 0x8024DF12 Val_Wu8 255.0 DFES_OneToOne 0.00 255.0 FORMAT "%5.1" /end CHARACTERISTIC
/begin CHARACTERISTIC DFES_FaultTyp.DFC_Com592hAbsent_C "" VALUE 0x8024DF13 Val_Wu8 255.0 DFES_OneToOne 0.00 255.0 FORMAT "%5.1" /end CHARACTERISTIC
/begin CHARACTERISTIC DFES_FaultTyp.DFC_Com592hChecksum_C "" VALUE 0x8024DF14 Val_Wu8 255.0 DFES_OneToOne 0.00 255.0 FORMAT "%5.1" /end CHARACTERISTIC
/begin CHARACTERISTIC DFES_FaultTyp.DFC_Com592hCounter_C "" VALUE 0x8024DF15 Val_Wu8 255.0 DFES_OneToOne 0.00 255.0 FORMAT "%5.1" /end CHARACTERISTIC
/begin CHARACTERISTIC DFES_FaultTyp.DFC_Com592hTooShort_C "" VALUE 0x8024DF16 Val_Wu8 255.0 DFES_OneToOne 0.00 255.0 FORMAT "%5.1" /end CHARACTERISTIC
/begin CHARACTERISTIC DFES_FaultTyp.DFC_Com595hAbsent_C "" VALUE 0x8024DF17 Val_Wu8 255.0 DFES_OneToOne 0.00 255.0 FORMAT "%5.1" /end CHARACTERISTIC
/begin CHARACTERISTIC DFES_FaultTyp.DFC_Com595hChecksum_C "" VALUE 0x8024DF18 Val_Wu8 255.0 DFES_OneToOne 0.00 255.0 FORMAT "%5.1" /end CHARACTERISTIC
/begin CHARACTERISTIC DFES_FaultTyp.DFC_Com595hCounter_C "" VALUE 0x8024DF19 Val_Wu8 255.0 DFES_OneToOne 0.00 255.0 FORMAT "%5.1" /end CHARACTERISTIC
/begin CHARACTERISTIC DFES_FaultTyp.DFC_Com595hTooShort_C "" VALUE 0x8024DF1A Val_Wu8 255.0 DFES_OneToOne 0.00 255.0 FORMAT "%5.1" /end CHARACTERISTIC
/begin CHARACTERISTIC DFES_FaultTyp.DFC_Com5B2hAbsent_C "" VALUE 0x8024DF1B Val_Wu8 255.0 DFES_OneToOne 0.00 255.0 FORMAT "%5.1" /end CHARACTERISTIC
/begin CHARACTERISTIC DFES_FaultTyp.DFC_Com5B2hTooShort_C "" VALUE 0x8024DF1C Val_Wu8 255.0 DFES_OneToOne 0.00 255.0 FORMAT "%5.1" /end CHARACTERISTIC
/begin CHARACTERISTIC DFES_FaultTyp.DFC_Com5B5hAbsent_C "" VALUE 0x8024DF1D Val_Wu8 255.0 DFES_OneToOne 0.00 255.0 FORMAT "%5.1" /end CHARACTERISTIC
/begin CHARACTERISTIC DFES_FaultTyp.DFC_Com5B5hChecksum_C "" VALUE 0x8024DF1E Val_Wu8 255.0 DFES_OneToOne 0.00 255.0 FORMAT "%5.1" /end CHARACTERISTIC
/begin CHARACTERISTIC DFES_FaultTyp.DFC_Com5B5hCounter_C "" VALUE 0x8024DF1F Val_Wu8 255.0 DFES_OneToOne 0.00 255.0 FORMAT "%5.1" /end CHARACTERISTIC
/begin CHARACTERISTIC DFES_FaultTyp.DFC_Com5B5hTooShort_C "" VALUE 0x8024DF20 Val_Wu8 255.0 DFES_OneToOne 0.00 255.0 FORMAT "%5.1" /end CHARACTERISTIC
/begin CHARACTERISTIC DFES_FaultTyp.DFC_Com5C7hTooShort_C "" VALUE 0x8024DF21 Val_Wu8 255.0 DFES_OneToOne 0.00 255.0 FORMAT "%5.1" /end CHARACTERISTIC
/begin CHARACTERISTIC DFES_FaultTyp.DFC_Com5E7hAbsent_C "" VALUE 0x8024DF22 Val_Wu8 255.0 DFES_OneToOne 0.00 255.0 FORMAT "%5.1" /end CHARACTERISTIC
/begin CHARACTERISTIC DFES_FaultTyp.DFC_Com5E7hTooShort_C "" VALUE 0x8024DF23 Val_Wu8 255.0 DFES_OneToOne 0.00 255.0 FORMAT "%5.1" /end CHARACTERISTIC
/begin CHARACTERISTIC DFES_FaultTyp.DFC_Com635hTooShort_C "" VALUE 0x8024DF24 Val_Wu8 255.0 DFES_OneToOne 0.00 255.0 FORMAT "%5.1" /end CHARACTERISTIC
/begin CHARACTERISTIC DFES_FaultTyp.DFC_Com645hTooShort_C "" VALUE 0x8024DF25 Val_Wu8 255.0 DFES_OneToOne 0.00 255.0 FORMAT "%5.1" /end CHARACTERISTIC
/begin CHARACTERISTIC DFES_FaultTyp.DFC_Com663hAbsent_C "" VALUE 0x8024DF26 Val_Wu8 255.0 DFES_OneToOne 0.00 255.0 FORMAT "%5.1" /end CHARACTERISTIC
/begin CHARACTERISTIC DFES_FaultTyp.DFC_Com663hTooShort_C "" VALUE 0x8024DF27 Val_Wu8 255.0 DFES_OneToOne 0.00 255.0 FORMAT "%5.1" /end CHARACTERISTIC
/begin CHARACTERISTIC DFES_FaultTyp.DFC_Com665hAbsent_C "" VALUE 0x8024DF28 Val_Wu8 255.0 DFES_OneToOne 0.00 255.0 FORMAT "%5.1" /end CHARACTERISTIC
/begin CHARACTERISTIC DFES_FaultTyp.DFC_Com665hTooShort_C "" VALUE 0x8024DF29 Val_Wu8 255.0 DFES_OneToOne 0.00 255.0 FORMAT "%5.1" /end CHARACTERISTIC
/begin CHARACTERISTIC DFES_FaultTyp.DFC_Com675hAbsent_C "" VALUE 0x8024DF2A Val_Wu8 255.0 DFES_OneToOne 0.00 255.0 FORMAT "%5.1" /end CHARACTERISTIC
/begin CHARACTERISTIC DFES_FaultTyp.DFC_Com675hTooShort_C "" VALUE 0x8024DF2B Val_Wu8 255.0 DFES_OneToOne 0.00 255.0 FORMAT "%5.1" /end CHARACTERISTIC
/begin CHARACTERISTIC DFES_FaultTyp.DFC_ComFrbd_205h_HVBAT_PACK_CURRENT_C "" VALUE 0x8024DF2C Val_Wu8 255.0 DFES_OneToOne 0.00 255.0 FORMAT "%5.1" /end CHARACTERISTIC
/begin CHARACTERISTIC DFES_FaultTyp.DFC_ComFrbd_205h_HVBAT_SOC_DISPLAY_C "" VALUE 0x8024DF2D Val_Wu8 255.0 DFES_OneToOne 0.00 255.0 FORMAT "%5.1" /end CHARACTERISTIC
/begin CHARACTERISTIC DFES_FaultTyp.DFC_ComFrbd_205h_HVBAT_VOLTAGE_C "" VALUE 0x8024DF2E Val_Wu8 255.0 DFES_OneToOne 0.00 255.0 FORMAT "%5.1" /end CHARACTERISTIC
/begin CHARACTERISTIC DFES_FaultTyp.DFC_ComFrbd_217h_INV_DC_BUS_VOLTAGE_C "" VALUE 0x8024DF2F Val_Wu8 255.0 DFES_OneToOne 0.00 255.0 FORMAT "%5.1" /end CHARACTERISTIC
/begin CHARACTERISTIC DFES_FaultTyp.DFC_ComFrbd_217h_INV_MTR_ACTUAL_TRQ_C "" VALUE 0x8024DF30 Val_Wu8 255.0 DFES_OneToOne 0.00 255.0 FORMAT "%5.1" /end CHARACTERISTIC
/begin CHARACTERISTIC DFES_FaultTyp.DFC_ComFrbd_217h_INV_MTR_SPEED_C "" VALUE 0x8024DF31 Val_Wu8 255.0 DFES_OneToOne 0.00 255.0 FORMAT "%5.1" /end CHARACTERISTIC
/begin CHARACTERISTIC DFES_FaultTyp.DFC_ComFrbd_217h_INV_MTR_TRQ_C "" VALUE 0x8024DF32 Val_Wu8 255.0 DFES_OneToOne 0.00 255.0 FORMAT "%5.1" /end CHARACTERISTIC
/begin CHARACTERISTIC DFES_FaultTyp.DFC_ComFrbd_227h_INV_DC_CURRENT_C "" VALUE 0x8024DF33 Val_Wu8 255.0 DFES_OneToOne 0.00 255.0 FORMAT "%5.1" /end CHARACTERISTIC
/begin CHARACTERISTIC DFES_FaultTyp.DFC_ComFrbd_227h_INV_MOTORING_PEAK_TRQ_C "" VALUE 0x8024DF34 Val_Wu8 255.0 DFES_OneToOne 0.00 255.0 FORMAT "%5.1" /end CHARACTERISTIC
/begin CHARACTERISTIC DFES_FaultTyp.DFC_ComFrbd_227h_INV_MTR_INST_INPUT_POWER_C "" VALUE 0x8024DF35 Val_Wu8 255.0 DFES_OneToOne 0.00 255.0 FORMAT "%5.1" /end CHARACTERISTIC
/begin CHARACTERISTIC DFES_FaultTyp.DFC_ComFrbd_227h_INV_REGEN_PEAK_TRQ_C "" VALUE 0x8024DF36 Val_Wu8 255.0 DFES_OneToOne 0.00 255.0 FORMAT "%5.1" /end CHARACTERISTIC
/begin CHARACTERISTIC DFES_FaultTyp.DFC_ComFrbd_237h_INV_ACTIVE_DISCHARGE_STATUS_C "" VALUE 0x8024DF37 Val_Wu8 255.0 DFES_OneToOne 0.00 255.0 FORMAT "%5.1" /end CHARACTERISTIC
/begin CHARACTERISTIC DFES_FaultTyp.DFC_ComFrbd_237h_INV_CTRL_MODE_ACK_C "" VALUE 0x8024DF38 Val_Wu8 255.0 DFES_OneToOne 0.00 255.0 FORMAT "%5.1" /end CHARACTERISTIC
/begin CHARACTERISTIC DFES_FaultTyp.DFC_ComFrbd_237h_INV_EV_WARNING_C "" VALUE 0x8024DF39 Val_Wu8 255.0 DFES_OneToOne 0.00 255.0 FORMAT "%5.1" /end CHARACTERISTIC
/begin CHARACTERISTIC DFES_FaultTyp.DFC_ComFrbd_237h_INV_FAULT_LEVEL_C "" VALUE 0x8024DF3A Val_Wu8 255.0 DFES_OneToOne 0.00 255.0 FORMAT "%5.1" /end CHARACTERISTIC
/begin CHARACTERISTIC DFES_FaultTyp.DFC_ComFrbd_237h_INV_MASTER_STOP_C "" VALUE 0x8024DF3B Val_Wu8 255.0 DFES_OneToOne 0.00 255.0 FORMAT "%5.1" /end CHARACTERISTIC
/begin CHARACTERISTIC DFES_FaultTyp.DFC_ComFrbd_237h_INV_SERVICE_DUE_C "" VALUE 0x8024DF3C Val_Wu8 255.0 DFES_OneToOne 0.00 255.0 FORMAT "%5.1" /end CHARACTERISTIC
/begin CHARACTERISTIC DFES_FaultTyp.DFC_ComFrbd_237h_INV_STAB_MIN_TRQ_C "" VALUE 0x8024DF3D Val_Wu8 255.0 DFES_OneToOne 0.00 255.0 FORMAT "%5.1" /end CHARACTERISTIC
/begin CHARACTERISTIC DFES_FaultTyp.DFC_ComFrbd_259h_TGLM_FAILURE_STATE_C "" VALUE 0x8024DF3E Val_Wu8 255.0 DFES_OneToOne 0.00 255.0 FORMAT "%5.1" /end CHARACTERISTIC
/begin CHARACTERISTIC DFES_FaultTyp.DFC_ComFrbd_259h_TGLM_MODE_PUSH_C "" VALUE 0x8024DF3F Val_Wu8 255.0 DFES_OneToOne 0.00 255.0 FORMAT "%5.1" /end CHARACTERISTIC
/begin CHARACTERISTIC DFES_FaultTyp.DFC_ComFrbd_259h_TOGGLE_MONOSTABLE_POS_C "" VALUE 0x8024DF40 Val_Wu8 255.0 DFES_OneToOne 0.00 255.0 FORMAT "%5.1" /end CHARACTERISTIC
/begin CHARACTERISTIC DFES_FaultTyp.DFC_ComFrbd_273h_OBC_outputpower_capability_C "" VALUE 0x8024DF41 Val_Wu8 255.0 DFES_OneToOne 0.00 255.0 FORMAT "%5.1" /end CHARACTERISTIC
/begin CHARACTERISTIC DFES_FaultTyp.DFC_ComFrbd_275h_HVBAT_DISCHARGE_30S_AVAILABLE_CURRENT_C "" VALUE 0x8024DF42 Val_Wu8 255.0 DFES_OneToOne 0.00 255.0 FORMAT "%5.1" /end CHARACTERISTIC
/begin CHARACTERISTIC DFES_FaultTyp.DFC_ComFrbd_275h_HVBAT_DISCHARGE_30S_AVAILABLE_POWER_C "" VALUE 0x8024DF43 Val_Wu8 255.0 DFES_OneToOne 0.00 255.0 FORMAT "%5.1" /end CHARACTERISTIC
/begin CHARACTERISTIC DFES_FaultTyp.DFC_ComFrbd_283h_DCDC_IN_CURRENT_C "" VALUE 0x8024DF44 Val_Wu8 255.0 DFES_OneToOne 0.00 255.0 FORMAT "%5.1" /end CHARACTERISTIC
/begin CHARACTERISTIC DFES_FaultTyp.DFC_ComFrbd_283h_DCDC_IN_VOLTAGE_C "" VALUE 0x8024DF45 Val_Wu8 255.0 DFES_OneToOne 0.00 255.0 FORMAT "%5.1" /end CHARACTERISTIC
/begin CHARACTERISTIC DFES_FaultTyp.DFC_ComFrbd_283h_DCDC_OUT_CURRENT_C "" VALUE 0x8024DF46 Val_Wu8 255.0 DFES_OneToOne 0.00 255.0 FORMAT "%5.1" /end CHARACTERISTIC
/begin CHARACTERISTIC DFES_FaultTyp.DFC_ComFrbd_283h_DCDC_OUT_VOLTAGE_C "" VALUE 0x8024DF47 Val_Wu8 255.0 DFES_OneToOne 0.00 255.0 FORMAT "%5.1" /end CHARACTERISTIC
/begin CHARACTERISTIC DFES_FaultTyp.DFC_ComFrbd_285h_HVBAT_REGEN_CHG_30S_CURRENT_LIMIT_C "" VALUE 0x8024DF48 Val_Wu8 255.0 DFES_OneToOne 0.00 255.0 FORMAT "%5.1" /end CHARACTERISTIC
/begin CHARACTERISTIC DFES_FaultTyp.DFC_ComFrbd_285h_HVBAT_REGEN_CHRG_30S_POWER_LIMIT_C "" VALUE 0x8024DF49 Val_Wu8 255.0 DFES_OneToOne 0.00 255.0 FORMAT "%5.1" /end CHARACTERISTIC
/begin CHARACTERISTIC DFES_FaultTyp.DFC_ComFrbd_293h_DCDC_outputpower_capability_C "" VALUE 0x8024DF4A Val_Wu8 255.0 DFES_OneToOne 0.00 255.0 FORMAT "%5.1" /end CHARACTERISTIC
/begin CHARACTERISTIC DFES_FaultTyp.DFC_ComFrbd_325h_HVBAT_INSULATION_RESISTANCE_C "" VALUE 0x8024DF4B Val_Wu8 255.0 DFES_OneToOne 0.00 255.0 FORMAT "%5.1" /end CHARACTERISTIC
/begin CHARACTERISTIC DFES_FaultTyp.DFC_ComFrbd_325h_HVBAT_TEMPERATURE_C "" VALUE 0x8024DF4C Val_Wu8 255.0 DFES_OneToOne 0.00 255.0 FORMAT "%5.1" /end CHARACTERISTIC
/begin CHARACTERISTIC DFES_FaultTyp.DFC_ComFrbd_335h_HVBAT_CHRG_CONTINUOUS_CURR_MAX_C "" VALUE 0x8024DF4D Val_Wu8 255.0 DFES_OneToOne 0.00 255.0 FORMAT "%5.1" /end CHARACTERISTIC
/begin CHARACTERISTIC DFES_FaultTyp.DFC_ComFrbd_335h_HVBAT_CHRG_COTINUOUS_CURR_REQ_C "" VALUE 0x8024DF4E Val_Wu8 255.0 DFES_OneToOne 0.00 255.0 FORMAT "%5.1" /end CHARACTERISTIC
/begin CHARACTERISTIC DFES_FaultTyp.DFC_ComFrbd_335h_HVBAT_CHRG_MAX_VOLT_C "" VALUE 0x8024DF4F Val_Wu8 255.0 DFES_OneToOne 0.00 255.0 FORMAT "%5.1" /end CHARACTERISTIC
/begin CHARACTERISTIC DFES_FaultTyp.DFC_ComFrbd_335h_HVBAT_DC_BUS_VOLTAGE_C "" VALUE 0x8024DF50 Val_Wu8 255.0 DFES_OneToOne 0.00 255.0 FORMAT "%5.1" /end CHARACTERISTIC
/begin CHARACTERISTIC DFES_FaultTyp.DFC_ComFrbd_427h_INV_OP_MODE_C "" VALUE 0x8024DF51 Val_Wu8 255.0 DFES_OneToOne 0.00 255.0 FORMAT "%5.1" /end CHARACTERISTIC
/begin CHARACTERISTIC DFES_FaultTyp.DFC_ComFrbd_427h_INV_PERMISIBLE_TORQUE_C "" VALUE 0x8024DF52 Val_Wu8 255.0 DFES_OneToOne 0.00 255.0 FORMAT "%5.1" /end CHARACTERISTIC
/begin CHARACTERISTIC DFES_FaultTyp.DFC_ComFrbd_435h_HVBAT_MAX_CELL_VOLT_C "" VALUE 0x8024DF53 Val_Wu8 255.0 DFES_OneToOne 0.00 255.0 FORMAT "%5.1" /end CHARACTERISTIC
/begin CHARACTERISTIC DFES_FaultTyp.DFC_ComFrbd_435h_HVBAT_MAX_CELL_VOLT_NUM_C "" VALUE 0x8024DF54 Val_Wu8 255.0 DFES_OneToOne 0.00 255.0 FORMAT "%5.1" /end CHARACTERISTIC
/begin CHARACTERISTIC DFES_FaultTyp.DFC_ComFrbd_435h_HVBAT_MAX_SENSOR_TEMP_C "" VALUE 0x8024DF55 Val_Wu8 255.0 DFES_OneToOne 0.00 255.0 FORMAT "%5.1" /end CHARACTERISTIC
/begin CHARACTERISTIC DFES_FaultTyp.DFC_ComFrbd_435h_HVBAT_MIN_CELL_VOLT_C "" VALUE 0x8024DF56 Val_Wu8 255.0 DFES_OneToOne 0.00 255.0 FORMAT "%5.1" /end CHARACTERISTIC
/begin CHARACTERISTIC DFES_FaultTyp.DFC_ComFrbd_435h_HVBAT_MIN_CELL_VOLT_NUM_C "" VALUE 0x8024DF57 Val_Wu8 255.0 DFES_OneToOne 0.00 255.0 FORMAT "%5.1" /end CHARACTERISTIC
/begin CHARACTERISTIC DFES_FaultTyp.DFC_ComFrbd_453h_OBC_IN_CURRENT_C "" VALUE 0x8024DF58 Val_Wu8 255.0 DFES_OneToOne 0.00 255.0 FORMAT "%5.1" /end CHARACTERISTIC
/begin CHARACTERISTIC DFES_FaultTyp.DFC_ComFrbd_453h_OBC_IN_VOLTAGE_C "" VALUE 0x8024DF59 Val_Wu8 255.0 DFES_OneToOne 0.00 255.0 FORMAT "%5.1" /end CHARACTERISTIC
/begin CHARACTERISTIC DFES_FaultTyp.DFC_ComFrbd_453h_OBC_IP_POWER_C "" VALUE 0x8024DF5A Val_Wu8 255.0 DFES_OneToOne 0.00 255.0 FORMAT "%5.1" /end CHARACTERISTIC
/begin CHARACTERISTIC DFES_FaultTyp.DFC_ComFrbd_455h_HVBAT_NOMINAL_VOLTAGE_C "" VALUE 0x8024DF5B Val_Wu8 255.0 DFES_OneToOne 0.00 255.0 FORMAT "%5.1" /end CHARACTERISTIC
/begin CHARACTERISTIC DFES_FaultTyp.DFC_ComFrbd_463h_OBC_OUT_CURRENT_C "" VALUE 0x8024DF5C Val_Wu8 255.0 DFES_OneToOne 0.00 255.0 FORMAT "%5.1" /end CHARACTERISTIC
/begin CHARACTERISTIC DFES_FaultTyp.DFC_ComFrbd_463h_OBC_OUT_VOLTAGE_C "" VALUE 0x8024DF5D Val_Wu8 255.0 DFES_OneToOne 0.00 255.0 FORMAT "%5.1" /end CHARACTERISTIC
/begin CHARACTERISTIC DFES_FaultTyp.DFC_ComFrbd_463h_OBC_TEMPERATURE_C "" VALUE 0x8024DF5E Val_Wu8 255.0 DFES_OneToOne 0.00 255.0 FORMAT "%5.1" /end CHARACTERISTIC
/begin CHARACTERISTIC DFES_FaultTyp.DFC_ComFrbd_473h_DCDC_Coolant_Temperature_C "" VALUE 0x8024DF5F Val_Wu8 255.0 DFES_OneToOne 0.00 255.0 FORMAT "%5.1" /end CHARACTERISTIC
/begin CHARACTERISTIC DFES_FaultTyp.DFC_ComFrbd_473h_DCDC_TEMPERATURE_C "" VALUE 0x8024DF60 Val_Wu8 255.0 DFES_OneToOne 0.00 255.0 FORMAT "%5.1" /end CHARACTERISTIC
/begin CHARACTERISTIC DFES_FaultTyp.DFC_ComFrbd_47Bh_eCOMP_BusBarCurrent_C "" VALUE 0x8024DF61 Val_Wu8 255.0 DFES_OneToOne 0.00 255.0 FORMAT "%5.1" /end CHARACTERISTIC
/begin CHARACTERISTIC DFES_FaultTyp.DFC_ComFrbd_47Bh_eCOMP_BusBarVoltage_C "" VALUE 0x8024DF62 Val_Wu8 255.0 DFES_OneToOne 0.00 255.0 FORMAT "%5.1" /end CHARACTERISTIC
/begin CHARACTERISTIC DFES_FaultTyp.DFC_ComFrbd_47Bh_eCOMP_CompressorSpeed_C "" VALUE 0x8024DF63 Val_Wu8 255.0 DFES_OneToOne 0.00 255.0 FORMAT "%5.1" /end CHARACTERISTIC
/begin CHARACTERISTIC DFES_FaultTyp.DFC_ComFrbd_47Bh_eCOMP_IGBT_Temp_C "" VALUE 0x8024DF64 Val_Wu8 255.0 DFES_OneToOne 0.00 255.0 FORMAT "%5.1" /end CHARACTERISTIC
/begin CHARACTERISTIC DFES_FaultTyp.DFC_ComFrbd_47Bh_eCOMP_PeakPhaCurrent_C "" VALUE 0x8024DF65 Val_Wu8 255.0 DFES_OneToOne 0.00 255.0 FORMAT "%5.1" /end CHARACTERISTIC
/begin CHARACTERISTIC DFES_FaultTyp.DFC_ComFrbd_47Bh_eCOMP_Power_consumption_C "" VALUE 0x8024DF66 Val_Wu8 255.0 DFES_OneToOne 0.00 255.0 FORMAT "%5.1" /end CHARACTERISTIC
/begin CHARACTERISTIC DFES_FaultTyp.DFC_ComFrbd_48Bh_eCOMP_Fault_Level_C "" VALUE 0x8024DF67 Val_Wu8 255.0 DFES_OneToOne 0.00 255.0 FORMAT "%5.1" /end CHARACTERISTIC
/begin CHARACTERISTIC DFES_FaultTyp.DFC_ComFrbd_4F2h_VALEUR_SOC_ETENDUE_C "" VALUE 0x8024DF68 Val_Wu8 255.0 DFES_OneToOne 0.00 255.0 FORMAT "%5.1" /end CHARACTERISTIC
/begin CHARACTERISTIC DFES_FaultTyp.DFC_ComFrbd_535h_HV_BATT_TEMP_AVG_C "" VALUE 0x8024DF69 Val_Wu8 255.0 DFES_OneToOne 0.00 255.0 FORMAT "%5.1" /end CHARACTERISTIC
/begin CHARACTERISTIC DFES_FaultTyp.DFC_ComFrbd_543h_HVBAT_RESTBATTENERGY_C "" VALUE 0x8024DF6A Val_Wu8 255.0 DFES_OneToOne 0.00 255.0 FORMAT "%5.1" /end CHARACTERISTIC
/begin CHARACTERISTIC DFES_FaultTyp.DFC_ComFrbd_543h_HVBAT_SOH_C "" VALUE 0x8024DF6B Val_Wu8 255.0 DFES_OneToOne 0.00 255.0 FORMAT "%5.1" /end CHARACTERISTIC
/begin CHARACTERISTIC DFES_FaultTyp.DFC_ComFrbd_543h_HV_BATT_SOH_RES_C "" VALUE 0x8024DF6C Val_Wu8 255.0 DFES_OneToOne 0.00 255.0 FORMAT "%5.1" /end CHARACTERISTIC
/begin CHARACTERISTIC DFES_FaultTyp.DFC_ComFrbd_592h_IBATT_1_C "" VALUE 0x8024DF6D Val_Wu8 255.0 DFES_OneToOne 0.00 255.0 FORMAT "%5.1" /end CHARACTERISTIC
/begin CHARACTERISTIC DFES_FaultTyp.DFC_ComFrbd_592h_IBATT_2_C "" VALUE 0x8024DF6E Val_Wu8 255.0 DFES_OneToOne 0.00 255.0 FORMAT "%5.1" /end CHARACTERISTIC
/begin CHARACTERISTIC DFES_FaultTyp.DFC_ComFrbd_592h_IBATT_3_C "" VALUE 0x8024DF6F Val_Wu8 255.0 DFES_OneToOne 0.00 255.0 FORMAT "%5.1" /end CHARACTERISTIC
/begin CHARACTERISTIC DFES_FaultTyp.DFC_ComFrbd_592h_TEMP_BATT_C "" VALUE 0x8024DF70 Val_Wu8 255.0 DFES_OneToOne 0.00 255.0 FORMAT "%5.1" /end CHARACTERISTIC
/begin CHARACTERISTIC DFES_FaultTyp.DFC_ComFrbd_592h_U_BATT_BECB_C "" VALUE 0x8024DF71 Val_Wu8 255.0 DFES_OneToOne 0.00 255.0 FORMAT "%5.1" /end CHARACTERISTIC
/begin CHARACTERISTIC DFES_FaultTyp.DFC_ComFrbd_595h_HVBAT_TIME_TO_CHRG_80_C "" VALUE 0x8024DF72 Val_Wu8 255.0 DFES_OneToOne 0.00 255.0 FORMAT "%5.1" /end CHARACTERISTIC
/begin CHARACTERISTIC DFES_FaultTyp.DFC_ComFrbd_5B2h_TEMP_AIR_EXT_C "" VALUE 0x8024DF73 Val_Wu8 255.0 DFES_OneToOne 0.00 255.0 FORMAT "%5.1" /end CHARACTERISTIC
/begin CHARACTERISTIC DFES_FaultTyp.DFC_ComFrbd_635h_HVBAT_NEG_CONT_COUNT_SEG1_C "" VALUE 0x8024DF74 Val_Wu8 255.0 DFES_OneToOne 0.00 255.0 FORMAT "%5.1" /end CHARACTERISTIC
/begin CHARACTERISTIC DFES_FaultTyp.DFC_ComFrbd_635h_HVBAT_NEG_CONT_COUNT_SEG3_C "" VALUE 0x8024DF75 Val_Wu8 255.0 DFES_OneToOne 0.00 255.0 FORMAT "%5.1" /end CHARACTERISTIC
/begin CHARACTERISTIC DFES_FaultTyp.DFC_ComFrbd_635h_HVBAT_NEG_CONT_COUNT_SEG4_C "" VALUE 0x8024DF76 Val_Wu8 255.0 DFES_OneToOne 0.00 255.0 FORMAT "%5.1" /end CHARACTERISTIC
/begin CHARACTERISTIC DFES_FaultTyp.DFC_ComFrbd_635h_HVBAT_PST_CONT_COUNT_SEG1_C "" VALUE 0x8024DF77 Val_Wu8 255.0 DFES_OneToOne 0.00 255.0 FORMAT "%5.1" /end CHARACTERISTIC
/begin CHARACTERISTIC DFES_FaultTyp.DFC_ComFrbd_635h_HVBAT_PST_CONT_COUNT_SEG3_C "" VALUE 0x8024DF78 Val_Wu8 255.0 DFES_OneToOne 0.00 255.0 FORMAT "%5.1" /end CHARACTERISTIC
/begin CHARACTERISTIC DFES_FaultTyp.DFC_ComFrbd_635h_HVBAT_PST_CONT_COUNT_SEG4_C "" VALUE 0x8024DF79 Val_Wu8 255.0 DFES_OneToOne 0.00 255.0 FORMAT "%5.1" /end CHARACTERISTIC
/begin CHARACTERISTIC DFES_FaultTyp.DFC_ComFrbd_645h_HVBAT_PRECHRGE_CONT_COUNT_SEG1_C "" VALUE 0x8024DF7A Val_Wu8 255.0 DFES_OneToOne 0.00 255.0 FORMAT "%5.1" /end CHARACTERISTIC
/begin CHARACTERISTIC DFES_FaultTyp.DFC_ComFrbd_645h_HVBAT_PRECHRGE_CONT_COUNT_SEG2_C "" VALUE 0x8024DF7B Val_Wu8 255.0 DFES_OneToOne 0.00 255.0 FORMAT "%5.1" /end CHARACTERISTIC
/begin CHARACTERISTIC DFES_FaultTyp.DFC_ComFrbd_675h_HVBAT_REMAININGBATTCAPACITY_C "" VALUE 0x8024DF7C Val_Wu8 255.0 DFES_OneToOne 0.00 255.0 FORMAT "%5.1" /end CHARACTERISTIC
/begin CHARACTERISTIC DFES_FaultTyp.DFC_ComInvld_205h_HVBAT_CHARGING_STATUS_C "" VALUE 0x8024DF7D Val_Wu8 255.0 DFES_OneToOne 0.00 255.0 FORMAT "%5.1" /end CHARACTERISTIC
/begin CHARACTERISTIC DFES_FaultTyp.DFC_ComInvld_205h_HVBAT_PACK_CURRENT_C "" VALUE 0x8024DF7E Val_Wu8 255.0 DFES_OneToOne 0.00 255.0 FORMAT "%5.1" /end CHARACTERISTIC
/begin CHARACTERISTIC DFES_FaultTyp.DFC_ComInvld_205h_HVBAT_SOC_DISPLAY_C "" VALUE 0x8024DF7F Val_Wu8 255.0 DFES_OneToOne 0.00 255.0 FORMAT "%5.1" /end CHARACTERISTIC
/begin CHARACTERISTIC DFES_FaultTyp.DFC_ComInvld_205h_HVBAT_VOLTAGE_C "" VALUE 0x8024DF80 Val_Wu8 255.0 DFES_OneToOne 0.00 255.0 FORMAT "%5.1" /end CHARACTERISTIC
/begin CHARACTERISTIC DFES_FaultTyp.DFC_ComInvld_217h_INV_DC_BUS_VOLTAGE_C "" VALUE 0x8024DF81 Val_Wu8 255.0 DFES_OneToOne 0.00 255.0 FORMAT "%5.1" /end CHARACTERISTIC
/begin CHARACTERISTIC DFES_FaultTyp.DFC_ComInvld_217h_INV_MTR_ACTUAL_TRQ_C "" VALUE 0x8024DF82 Val_Wu8 255.0 DFES_OneToOne 0.00 255.0 FORMAT "%5.1" /end CHARACTERISTIC
/begin CHARACTERISTIC DFES_FaultTyp.DFC_ComInvld_217h_INV_MTR_SPEED_C "" VALUE 0x8024DF83 Val_Wu8 255.0 DFES_OneToOne 0.00 255.0 FORMAT "%5.1" /end CHARACTERISTIC
/begin CHARACTERISTIC DFES_FaultTyp.DFC_ComInvld_217h_INV_MTR_TRQ_C "" VALUE 0x8024DF84 Val_Wu8 255.0 DFES_OneToOne 0.00 255.0 FORMAT "%5.1" /end CHARACTERISTIC
/begin CHARACTERISTIC DFES_FaultTyp.DFC_ComInvld_227h_INV_DC_CURRENT_C "" VALUE 0x8024DF85 Val_Wu8 255.0 DFES_OneToOne 0.00 255.0 FORMAT "%5.1" /end CHARACTERISTIC
/begin CHARACTERISTIC DFES_FaultTyp.DFC_ComInvld_227h_INV_MOTORING_PEAK_TRQ_C "" VALUE 0x8024DF86 Val_Wu8 255.0 DFES_OneToOne 0.00 255.0 FORMAT "%5.1" /end CHARACTERISTIC
/begin CHARACTERISTIC DFES_FaultTyp.DFC_ComInvld_227h_INV_MTR_INST_INPUT_POWER_C "" VALUE 0x8024DF87 Val_Wu8 255.0 DFES_OneToOne 0.00 255.0 FORMAT "%5.1" /end CHARACTERISTIC
/begin CHARACTERISTIC DFES_FaultTyp.DFC_ComInvld_227h_INV_REGEN_PEAK_TRQ_C "" VALUE 0x8024DF88 Val_Wu8 255.0 DFES_OneToOne 0.00 255.0 FORMAT "%5.1" /end CHARACTERISTIC
/begin CHARACTERISTIC DFES_FaultTyp.DFC_ComInvld_237h_INV_ACTIVE_DISCHARGE_STATUS_C "" VALUE 0x8024DF89 Val_Wu8 255.0 DFES_OneToOne 0.00 255.0 FORMAT "%5.1" /end CHARACTERISTIC
/begin CHARACTERISTIC DFES_FaultTyp.DFC_ComInvld_237h_INV_FAULT_LEVEL_C "" VALUE 0x8024DF8A Val_Wu8 255.0 DFES_OneToOne 0.00 255.0 FORMAT "%5.1" /end CHARACTERISTIC
/begin CHARACTERISTIC DFES_FaultTyp.DFC_ComInvld_237h_INV_STAB_MIN_TRQ_C "" VALUE 0x8024DF8B Val_Wu8 255.0 DFES_OneToOne 0.00 255.0 FORMAT "%5.1" /end CHARACTERISTIC
/begin CHARACTERISTIC DFES_FaultTyp.DFC_ComInvld_259h_TGLM_MODE_PUSH_C "" VALUE 0x8024DF8C Val_Wu8 255.0 DFES_OneToOne 0.00 255.0 FORMAT "%5.1" /end CHARACTERISTIC
/begin CHARACTERISTIC DFES_FaultTyp.DFC_ComInvld_259h_TOGGLE_MONOSTABLE_POS_C "" VALUE 0x8024DF8D Val_Wu8 255.0 DFES_OneToOne 0.00 255.0 FORMAT "%5.1" /end CHARACTERISTIC
/begin CHARACTERISTIC DFES_FaultTyp.DFC_ComInvld_26h_AC_SWITCH_REQ_C "" VALUE 0x8024DF8E Val_Wu8 255.0 DFES_OneToOne 0.00 255.0 FORMAT "%5.1" /end CHARACTERISTIC
/begin CHARACTERISTIC DFES_FaultTyp.DFC_ComInvld_26h_BLOWER_POSITION_C "" VALUE 0x8024DF8F Val_Wu8 255.0 DFES_OneToOne 0.00 255.0 FORMAT "%5.1" /end CHARACTERISTIC
/begin CHARACTERISTIC DFES_FaultTyp.DFC_ComInvld_26h_EVAP_SENSOR_FAULT_C "" VALUE 0x8024DF90 Val_Wu8 255.0 DFES_OneToOne 0.00 255.0 FORMAT "%5.1" /end CHARACTERISTIC
/begin CHARACTERISTIC DFES_FaultTyp.DFC_ComInvld_26h_EVAP_SENSOR_VALUE_C "" VALUE 0x8024DF91 Val_Wu8 255.0 DFES_OneToOne 0.00 255.0 FORMAT "%5.1" /end CHARACTERISTIC
/begin CHARACTERISTIC DFES_FaultTyp.DFC_ComInvld_26h_POTENTIOMETER_FAULT_C "" VALUE 0x8024DF92 Val_Wu8 255.0 DFES_OneToOne 0.00 255.0 FORMAT "%5.1" /end CHARACTERISTIC
/begin CHARACTERISTIC DFES_FaultTyp.DFC_ComInvld_26h_REAR_DEFOG_REQ_C "" VALUE 0x8024DF93 Val_Wu8 255.0 DFES_OneToOne 0.00 255.0 FORMAT "%5.1" /end CHARACTERISTIC
/begin CHARACTERISTIC DFES_FaultTyp.DFC_ComInvld_26h_TEMP_POSITION_C "" VALUE 0x8024DF94 Val_Wu8 255.0 DFES_OneToOne 0.00 255.0 FORMAT "%5.1" /end CHARACTERISTIC
/begin CHARACTERISTIC DFES_FaultTyp.DFC_ComInvld_273h_OBC_FAULT_LEVEL_C "" VALUE 0x8024DF95 Val_Wu8 255.0 DFES_OneToOne 0.00 255.0 FORMAT "%5.1" /end CHARACTERISTIC
/begin CHARACTERISTIC DFES_FaultTyp.DFC_ComInvld_273h_OBC_outputpower_capability_C "" VALUE 0x8024DF96 Val_Wu8 255.0 DFES_OneToOne 0.00 255.0 FORMAT "%5.1" /end CHARACTERISTIC
/begin CHARACTERISTIC DFES_FaultTyp.DFC_ComInvld_275h_HVBAT_DISCHARGE_30S_AVAILABLE_CURRENT_C "" VALUE 0x8024DF97 Val_Wu8 255.0 DFES_OneToOne 0.00 255.0 FORMAT "%5.1" /end CHARACTERISTIC
/begin CHARACTERISTIC DFES_FaultTyp.DFC_ComInvld_275h_HVBAT_DISCHARGE_30S_AVAILABLE_POWER_C "" VALUE 0x8024DF98 Val_Wu8 255.0 DFES_OneToOne 0.00 255.0 FORMAT "%5.1" /end CHARACTERISTIC
/begin CHARACTERISTIC DFES_FaultTyp.DFC_ComInvld_283h_DCDC_IN_CURRENT_C "" VALUE 0x8024DF99 Val_Wu8 255.0 DFES_OneToOne 0.00 255.0 FORMAT "%5.1" /end CHARACTERISTIC
/begin CHARACTERISTIC DFES_FaultTyp.DFC_ComInvld_283h_DCDC_IN_VOLTAGE_C "" VALUE 0x8024DF9A Val_Wu8 255.0 DFES_OneToOne 0.00 255.0 FORMAT "%5.1" /end CHARACTERISTIC
/begin CHARACTERISTIC DFES_FaultTyp.DFC_ComInvld_283h_DCDC_OUT_CURRENT_C "" VALUE 0x8024DF9B Val_Wu8 255.0 DFES_OneToOne 0.00 255.0 FORMAT "%5.1" /end CHARACTERISTIC
/begin CHARACTERISTIC DFES_FaultTyp.DFC_ComInvld_283h_DCDC_OUT_VOLTAGE_C "" VALUE 0x8024DF9C Val_Wu8 255.0 DFES_OneToOne 0.00 255.0 FORMAT "%5.1" /end CHARACTERISTIC
/begin CHARACTERISTIC DFES_FaultTyp.DFC_ComInvld_285h_HVBAT_REGEN_CHG_30S_CURRENT_LIMIT_C "" VALUE 0x8024DF9D Val_Wu8 255.0 DFES_OneToOne 0.00 255.0 FORMAT "%5.1" /end CHARACTERISTIC
/begin CHARACTERISTIC DFES_FaultTyp.DFC_ComInvld_285h_HVBAT_REGEN_CHRG_30S_POWER_LIMIT_C "" VALUE 0x8024DF9E Val_Wu8 255.0 DFES_OneToOne 0.00 255.0 FORMAT "%5.1" /end CHARACTERISTIC
/begin CHARACTERISTIC DFES_FaultTyp.DFC_ComInvld_293h_DCDC_FAULT_LEVEL_C "" VALUE 0x8024DF9F Val_Wu8 255.0 DFES_OneToOne 0.00 255.0 FORMAT "%5.1" /end CHARACTERISTIC
/begin CHARACTERISTIC DFES_FaultTyp.DFC_ComInvld_293h_DCDC_outputpower_capability_C "" VALUE 0x8024DFA0 Val_Wu8 255.0 DFES_OneToOne 0.00 255.0 FORMAT "%5.1" /end CHARACTERISTIC
/begin CHARACTERISTIC DFES_FaultTyp.DFC_ComInvld_325h_HVBAT_EPLUG_STATUS_C "" VALUE 0x8024DFA1 Val_Wu8 255.0 DFES_OneToOne 0.00 255.0 FORMAT "%5.1" /end CHARACTERISTIC
/begin CHARACTERISTIC DFES_FaultTyp.DFC_ComInvld_325h_HVBAT_HVIL_STS_C "" VALUE 0x8024DFA2 Val_Wu8 255.0 DFES_OneToOne 0.00 255.0 FORMAT "%5.1" /end CHARACTERISTIC
/begin CHARACTERISTIC DFES_FaultTyp.DFC_ComInvld_325h_HVBAT_INSULATION_FAULT_C "" VALUE 0x8024DFA3 Val_Wu8 255.0 DFES_OneToOne 0.00 255.0 FORMAT "%5.1" /end CHARACTERISTIC
/begin CHARACTERISTIC DFES_FaultTyp.DFC_ComInvld_325h_HVBAT_INSULATION_RESISTANCE_C "" VALUE 0x8024DFA4 Val_Wu8 255.0 DFES_OneToOne 0.00 255.0 FORMAT "%5.1" /end CHARACTERISTIC
/begin CHARACTERISTIC DFES_FaultTyp.DFC_ComInvld_325h_HVBAT_TEMPERATURE_C "" VALUE 0x8024DFA5 Val_Wu8 255.0 DFES_OneToOne 0.00 255.0 FORMAT "%5.1" /end CHARACTERISTIC
/begin CHARACTERISTIC DFES_FaultTyp.DFC_ComInvld_335h_HVBAT_CHRG_CONTINUOUS_CURR_MAX_C "" VALUE 0x8024DFA6 Val_Wu8 255.0 DFES_OneToOne 0.00 255.0 FORMAT "%5.1" /end CHARACTERISTIC
/begin CHARACTERISTIC DFES_FaultTyp.DFC_ComInvld_335h_HVBAT_CHRG_COTINUOUS_CURR_REQ_C "" VALUE 0x8024DFA7 Val_Wu8 255.0 DFES_OneToOne 0.00 255.0 FORMAT "%5.1" /end CHARACTERISTIC
/begin CHARACTERISTIC DFES_FaultTyp.DFC_ComInvld_335h_HVBAT_CHRG_MAX_VOLT_C "" VALUE 0x8024DFA8 Val_Wu8 255.0 DFES_OneToOne 0.00 255.0 FORMAT "%5.1" /end CHARACTERISTIC
/begin CHARACTERISTIC DFES_FaultTyp.DFC_ComInvld_335h_HVBAT_DC_BUS_VOLTAGE_C "" VALUE 0x8024DFA9 Val_Wu8 255.0 DFES_OneToOne 0.00 255.0 FORMAT "%5.1" /end CHARACTERISTIC
/begin CHARACTERISTIC DFES_FaultTyp.DFC_ComInvld_38Dh_VITESSE_VEHICULE_ROUES_C "" VALUE 0x8024DFAA Val_Wu8 255.0 DFES_OneToOne 0.00 255.0 FORMAT "%5.1" /end CHARACTERISTIC
/begin CHARACTERISTIC DFES_FaultTyp.DFC_ComInvld_38Dh_VVH_INDISP_C "" VALUE 0x8024DFAB Val_Wu8 255.0 DFES_OneToOne 0.00 255.0 FORMAT "%5.1" /end CHARACTERISTIC
/begin CHARACTERISTIC DFES_FaultTyp.DFC_ComInvld_427h_INV_COOLANT_TEMP_C "" VALUE 0x8024DFAC Val_Wu8 255.0 DFES_OneToOne 0.00 255.0 FORMAT "%5.1" /end CHARACTERISTIC
/begin CHARACTERISTIC DFES_FaultTyp.DFC_ComInvld_427h_INV_MOTOR_TEMP_C "" VALUE 0x8024DFAD Val_Wu8 255.0 DFES_OneToOne 0.00 255.0 FORMAT "%5.1" /end CHARACTERISTIC
/begin CHARACTERISTIC DFES_FaultTyp.DFC_ComInvld_427h_INV_OP_MODE_C "" VALUE 0x8024DFAE Val_Wu8 255.0 DFES_OneToOne 0.00 255.0 FORMAT "%5.1" /end CHARACTERISTIC
/begin CHARACTERISTIC DFES_FaultTyp.DFC_ComInvld_427h_INV_PERMISIBLE_TORQUE_C "" VALUE 0x8024DFAF Val_Wu8 255.0 DFES_OneToOne 0.00 255.0 FORMAT "%5.1" /end CHARACTERISTIC
/begin CHARACTERISTIC DFES_FaultTyp.DFC_ComInvld_427h_INV_TEMP_C "" VALUE 0x8024DFB0 Val_Wu8 255.0 DFES_OneToOne 0.00 255.0 FORMAT "%5.1" /end CHARACTERISTIC
/begin CHARACTERISTIC DFES_FaultTyp.DFC_ComInvld_432h_REVEIL_PRINCIPAL_C "" VALUE 0x8024DFB1 Val_Wu8 255.0 DFES_OneToOne 0.00 255.0 FORMAT "%5.1" /end CHARACTERISTIC
/begin CHARACTERISTIC DFES_FaultTyp.DFC_ComInvld_435h_HVBAT_MAX_CELL_VOLT_C "" VALUE 0x8024DFB2 Val_Wu8 255.0 DFES_OneToOne 0.00 255.0 FORMAT "%5.1" /end CHARACTERISTIC
/begin CHARACTERISTIC DFES_FaultTyp.DFC_ComInvld_435h_HVBAT_MAX_CELL_VOLT_NUM_C "" VALUE 0x8024DFB3 Val_Wu8 255.0 DFES_OneToOne 0.00 255.0 FORMAT "%5.1" /end CHARACTERISTIC
/begin CHARACTERISTIC DFES_FaultTyp.DFC_ComInvld_435h_HVBAT_MAX_SENSOR_TEMP_C "" VALUE 0x8024DFB4 Val_Wu8 255.0 DFES_OneToOne 0.00 255.0 FORMAT "%5.1" /end CHARACTERISTIC
/begin CHARACTERISTIC DFES_FaultTyp.DFC_ComInvld_435h_HVBAT_MIN_CELL_VOLT_C "" VALUE 0x8024DFB5 Val_Wu8 255.0 DFES_OneToOne 0.00 255.0 FORMAT "%5.1" /end CHARACTERISTIC
/begin CHARACTERISTIC DFES_FaultTyp.DFC_ComInvld_435h_HVBAT_MIN_CELL_VOLT_NUM_C "" VALUE 0x8024DFB6 Val_Wu8 255.0 DFES_OneToOne 0.00 255.0 FORMAT "%5.1" /end CHARACTERISTIC
/begin CHARACTERISTIC DFES_FaultTyp.DFC_ComInvld_442h_BCCM_BLOWER_RELAY_STS_C "" VALUE 0x8024DFB7 Val_Wu8 255.0 DFES_OneToOne 0.00 255.0 FORMAT "%5.1" /end CHARACTERISTIC
/begin CHARACTERISTIC DFES_FaultTyp.DFC_ComInvld_453h_OBC_IN_CURRENT_C "" VALUE 0x8024DFB8 Val_Wu8 255.0 DFES_OneToOne 0.00 255.0 FORMAT "%5.1" /end CHARACTERISTIC
/begin CHARACTERISTIC DFES_FaultTyp.DFC_ComInvld_453h_OBC_IN_VOLTAGE_C "" VALUE 0x8024DFB9 Val_Wu8 255.0 DFES_OneToOne 0.00 255.0 FORMAT "%5.1" /end CHARACTERISTIC
/begin CHARACTERISTIC DFES_FaultTyp.DFC_ComInvld_453h_OBC_IP_POWER_C "" VALUE 0x8024DFBA Val_Wu8 255.0 DFES_OneToOne 0.00 255.0 FORMAT "%5.1" /end CHARACTERISTIC
/begin CHARACTERISTIC DFES_FaultTyp.DFC_ComInvld_455h_HVBAT_NOMINAL_VOLTAGE_C "" VALUE 0x8024DFBB Val_Wu8 255.0 DFES_OneToOne 0.00 255.0 FORMAT "%5.1" /end CHARACTERISTIC
/begin CHARACTERISTIC DFES_FaultTyp.DFC_ComInvld_463h_OBC_OUT_CURRENT_C "" VALUE 0x8024DFBC Val_Wu8 255.0 DFES_OneToOne 0.00 255.0 FORMAT "%5.1" /end CHARACTERISTIC
/begin CHARACTERISTIC DFES_FaultTyp.DFC_ComInvld_463h_OBC_OUT_VOLTAGE_C "" VALUE 0x8024DFBD Val_Wu8 255.0 DFES_OneToOne 0.00 255.0 FORMAT "%5.1" /end CHARACTERISTIC
/begin CHARACTERISTIC DFES_FaultTyp.DFC_ComInvld_463h_OBC_TEMPERATURE_C "" VALUE 0x8024DFBE Val_Wu8 255.0 DFES_OneToOne 0.00 255.0 FORMAT "%5.1" /end CHARACTERISTIC
/begin CHARACTERISTIC DFES_FaultTyp.DFC_ComInvld_473h_DCDC_Coolant_Temperature_C "" VALUE 0x8024DFBF Val_Wu8 255.0 DFES_OneToOne 0.00 255.0 FORMAT "%5.1" /end CHARACTERISTIC
/begin CHARACTERISTIC DFES_FaultTyp.DFC_ComInvld_473h_DCDC_TEMPERATURE_C "" VALUE 0x8024DFC0 Val_Wu8 255.0 DFES_OneToOne 0.00 255.0 FORMAT "%5.1" /end CHARACTERISTIC
/begin CHARACTERISTIC DFES_FaultTyp.DFC_ComInvld_47Bh_eCOMP_BusBarCurrent_C "" VALUE 0x8024DFC1 Val_Wu8 255.0 DFES_OneToOne 0.00 255.0 FORMAT "%5.1" /end CHARACTERISTIC
/begin CHARACTERISTIC DFES_FaultTyp.DFC_ComInvld_47Bh_eCOMP_BusBarVoltage_C "" VALUE 0x8024DFC2 Val_Wu8 255.0 DFES_OneToOne 0.00 255.0 FORMAT "%5.1" /end CHARACTERISTIC
/begin CHARACTERISTIC DFES_FaultTyp.DFC_ComInvld_47Bh_eCOMP_CompressorSpeed_C "" VALUE 0x8024DFC3 Val_Wu8 255.0 DFES_OneToOne 0.00 255.0 FORMAT "%5.1" /end CHARACTERISTIC
/begin CHARACTERISTIC DFES_FaultTyp.DFC_ComInvld_47Bh_eCOMP_IGBT_Temp_C "" VALUE 0x8024DFC4 Val_Wu8 255.0 DFES_OneToOne 0.00 255.0 FORMAT "%5.1" /end CHARACTERISTIC
/begin CHARACTERISTIC DFES_FaultTyp.DFC_ComInvld_47Bh_eCOMP_PeakPhaCurrent_C "" VALUE 0x8024DFC5 Val_Wu8 255.0 DFES_OneToOne 0.00 255.0 FORMAT "%5.1" /end CHARACTERISTIC
/begin CHARACTERISTIC DFES_FaultTyp.DFC_ComInvld_47Bh_eCOMP_Power_consumption_C "" VALUE 0x8024DFC6 Val_Wu8 255.0 DFES_OneToOne 0.00 255.0 FORMAT "%5.1" /end CHARACTERISTIC
/begin CHARACTERISTIC DFES_FaultTyp.DFC_ComInvld_4F2h_STATUS_SOC_C "" VALUE 0x8024DFC7 Val_Wu8 255.0 DFES_OneToOne 0.00 255.0 FORMAT "%5.1" /end CHARACTERISTIC
/begin CHARACTERISTIC DFES_FaultTyp.DFC_ComInvld_4F2h_TEMP_BATT_STATUS_C "" VALUE 0x8024DFC8 Val_Wu8 255.0 DFES_OneToOne 0.00 255.0 FORMAT "%5.1" /end CHARACTERISTIC
/begin CHARACTERISTIC DFES_FaultTyp.DFC_ComInvld_4F2h_VALEUR_SOC_ETENDUE_C "" VALUE 0x8024DFC9 Val_Wu8 255.0 DFES_OneToOne 0.00 255.0 FORMAT "%5.1" /end CHARACTERISTIC
/begin CHARACTERISTIC DFES_FaultTyp.DFC_ComInvld_535h_HV_BATT_TEMP_AVG_C "" VALUE 0x8024DFCA Val_Wu8 255.0 DFES_OneToOne 0.00 255.0 FORMAT "%5.1" /end CHARACTERISTIC
/begin CHARACTERISTIC DFES_FaultTyp.DFC_ComInvld_543h_HVBAT_RESTBATTENERGY_C "" VALUE 0x8024DFCB Val_Wu8 255.0 DFES_OneToOne 0.00 255.0 FORMAT "%5.1" /end CHARACTERISTIC
/begin CHARACTERISTIC DFES_FaultTyp.DFC_ComInvld_543h_HVBAT_SOH_C "" VALUE 0x8024DFCC Val_Wu8 255.0 DFES_OneToOne 0.00 255.0 FORMAT "%5.1" /end CHARACTERISTIC
/begin CHARACTERISTIC DFES_FaultTyp.DFC_ComInvld_543h_HV_BATT_SOH_RES_C "" VALUE 0x8024DFCD Val_Wu8 255.0 DFES_OneToOne 0.00 255.0 FORMAT "%5.1" /end CHARACTERISTIC
/begin CHARACTERISTIC DFES_FaultTyp.DFC_ComInvld_552h_CPT_TEMPOREL_C "" VALUE 0x8024DFCE Val_Wu8 255.0 DFES_OneToOne 0.00 255.0 FORMAT "%5.1" /end CHARACTERISTIC
/begin CHARACTERISTIC DFES_FaultTyp.DFC_ComInvld_552h_KILOMETRAGE_C "" VALUE 0x8024DFCF Val_Wu8 255.0 DFES_OneToOne 0.00 255.0 FORMAT "%5.1" /end CHARACTERISTIC
/begin CHARACTERISTIC DFES_FaultTyp.DFC_ComInvld_583h_HV_BATT_DISCONT_CSE_OPEN_C "" VALUE 0x8024DFD0 Val_Wu8 255.0 DFES_OneToOne 0.00 255.0 FORMAT "%5.1" /end CHARACTERISTIC
/begin CHARACTERISTIC DFES_FaultTyp.DFC_ComInvld_592h_CALIBRE_IBATT_C "" VALUE 0x8024DFD1 Val_Wu8 255.0 DFES_OneToOne 0.00 255.0 FORMAT "%5.1" /end CHARACTERISTIC
/begin CHARACTERISTIC DFES_FaultTyp.DFC_ComInvld_592h_IBATT_1_C "" VALUE 0x8024DFD2 Val_Wu8 255.0 DFES_OneToOne 0.00 255.0 FORMAT "%5.1" /end CHARACTERISTIC
/begin CHARACTERISTIC DFES_FaultTyp.DFC_ComInvld_592h_IBATT_2_C "" VALUE 0x8024DFD3 Val_Wu8 255.0 DFES_OneToOne 0.00 255.0 FORMAT "%5.1" /end CHARACTERISTIC
/begin CHARACTERISTIC DFES_FaultTyp.DFC_ComInvld_592h_IBATT_3_C "" VALUE 0x8024DFD4 Val_Wu8 255.0 DFES_OneToOne 0.00 255.0 FORMAT "%5.1" /end CHARACTERISTIC
/begin CHARACTERISTIC DFES_FaultTyp.DFC_ComInvld_592h_TEMP_BATT_C "" VALUE 0x8024DFD5 Val_Wu8 255.0 DFES_OneToOne 0.00 255.0 FORMAT "%5.1" /end CHARACTERISTIC
/begin CHARACTERISTIC DFES_FaultTyp.DFC_ComInvld_592h_U_BATT_BECB_C "" VALUE 0x8024DFD6 Val_Wu8 255.0 DFES_OneToOne 0.00 255.0 FORMAT "%5.1" /end CHARACTERISTIC
/begin CHARACTERISTIC DFES_FaultTyp.DFC_ComInvld_595h_HVBAT_TIME_TO_CHRG_80_C "" VALUE 0x8024DFD7 Val_Wu8 255.0 DFES_OneToOne 0.00 255.0 FORMAT "%5.1" /end CHARACTERISTIC
/begin CHARACTERISTIC DFES_FaultTyp.DFC_ComInvld_5B2h_TEMP_AIR_EXT_C "" VALUE 0x8024DFD8 Val_Wu8 255.0 DFES_OneToOne 0.00 255.0 FORMAT "%5.1" /end CHARACTERISTIC
/begin CHARACTERISTIC DFES_FaultTyp.DFC_ComInvld_5B5h_HVBAT_THERMAL_RUNAWAY_C "" VALUE 0x8024DFD9 Val_Wu8 255.0 DFES_OneToOne 0.00 255.0 FORMAT "%5.1" /end CHARACTERISTIC
/begin CHARACTERISTIC DFES_FaultTyp.DFC_ComInvld_635h_HVBAT_NEG_CONT_COUNT_SEG1_C "" VALUE 0x8024DFDA Val_Wu8 255.0 DFES_OneToOne 0.00 255.0 FORMAT "%5.1" /end CHARACTERISTIC
/begin CHARACTERISTIC DFES_FaultTyp.DFC_ComInvld_635h_HVBAT_NEG_CONT_COUNT_SEG3_C "" VALUE 0x8024DFDB Val_Wu8 255.0 DFES_OneToOne 0.00 255.0 FORMAT "%5.1" /end CHARACTERISTIC
/begin CHARACTERISTIC DFES_FaultTyp.DFC_ComInvld_635h_HVBAT_NEG_CONT_COUNT_SEG4_C "" VALUE 0x8024DFDC Val_Wu8 255.0 DFES_OneToOne 0.00 255.0 FORMAT "%5.1" /end CHARACTERISTIC
/begin CHARACTERISTIC DFES_FaultTyp.DFC_ComInvld_635h_HVBAT_PST_CONT_COUNT_SEG1_C "" VALUE 0x8024DFDD Val_Wu8 255.0 DFES_OneToOne 0.00 255.0 FORMAT "%5.1" /end CHARACTERISTIC
/begin CHARACTERISTIC DFES_FaultTyp.DFC_ComInvld_635h_HVBAT_PST_CONT_COUNT_SEG3_C "" VALUE 0x8024DFDE Val_Wu8 255.0 DFES_OneToOne 0.00 255.0 FORMAT "%5.1" /end CHARACTERISTIC
/begin CHARACTERISTIC DFES_FaultTyp.DFC_ComInvld_635h_HVBAT_PST_CONT_COUNT_SEG4_C "" VALUE 0x8024DFDF Val_Wu8 255.0 DFES_OneToOne 0.00 255.0 FORMAT "%5.1" /end CHARACTERISTIC
/begin CHARACTERISTIC DFES_FaultTyp.DFC_ComInvld_645h_HVBAT_PRECHRGE_CONT_COUNT_SEG1_C "" VALUE 0x8024DFE0 Val_Wu8 255.0 DFES_OneToOne 0.00 255.0 FORMAT "%5.1" /end CHARACTERISTIC
/begin CHARACTERISTIC DFES_FaultTyp.DFC_ComInvld_645h_HVBAT_PRECHRGE_CONT_COUNT_SEG2_C "" VALUE 0x8024DFE1 Val_Wu8 255.0 DFES_OneToOne 0.00 255.0 FORMAT "%5.1" /end CHARACTERISTIC
/begin CHARACTERISTIC DFES_FaultTyp.DFC_ComInvld_675h_HVBAT_REMAININGBATTCAPACITY_C "" VALUE 0x8024DFE2 Val_Wu8 255.0 DFES_OneToOne 0.00 255.0 FORMAT "%5.1" /end CHARACTERISTIC
/begin CHARACTERISTIC DFES_FaultTyp.DFC_ACCmprFltLvl1_C "" VALUE 0x8024DFE3 Val_Wu8 255.0 DFES_OneToOne 0.00 255.0 FORMAT "%5.1" /end CHARACTERISTIC
/begin CHARACTERISTIC DFES_FaultTyp.DFC_ACCmprFltLvl2_C "" VALUE 0x8024DFE4 Val_Wu8 255.0 DFES_OneToOne 0.00 255.0 FORMAT "%5.1" /end CHARACTERISTIC
/begin CHARACTERISTIC DFES_FaultTyp.DFC_ACCmprFltLvl3_C "" VALUE 0x8024DFE5 Val_Wu8 255.0 DFES_OneToOne 0.00 255.0 FORMAT "%5.1" /end CHARACTERISTIC
/begin CHARACTERISTIC DFES_FaultTyp.DFC_ACCmprFltLvl4_C "" VALUE 0x8024DFE6 Val_Wu8 255.0 DFES_OneToOne 0.00 255.0 FORMAT "%5.1" /end CHARACTERISTIC
/begin CHARACTERISTIC DFES_FaultTyp.DFC_ACCmprHiPFlt_C "" VALUE 0x8024DFE7 Val_Wu8 255.0 DFES_OneToOne 0.00 255.0 FORMAT "%5.1" /end CHARACTERISTIC
/begin CHARACTERISTIC DFES_FaultTyp.DFC_ACCmprInvldCmprSt_C "" VALUE 0x8024DFE8 Val_Wu8 255.0 DFES_OneToOne 0.00 255.0 FORMAT "%5.1" /end CHARACTERISTIC
/begin CHARACTERISTIC DFES_FaultTyp.DFC_ACCmprInvldElecActPwr_C "" VALUE 0x8024DFE9 Val_Wu8 255.0 DFES_OneToOne 0.00 255.0 FORMAT "%5.1" /end CHARACTERISTIC
/begin CHARACTERISTIC DFES_FaultTyp.DFC_ACCmprLoPFlt_C "" VALUE 0x8024DFEA Val_Wu8 255.0 DFES_OneToOne 0.00 255.0 FORMAT "%5.1" /end CHARACTERISTIC
/begin CHARACTERISTIC DFES_FaultTyp.DFC_AcChrgrIntkTSRCMin_C "" VALUE 0x8024DFEB Val_Wu8 255.0 DFES_OneToOne 0.00 255.0 FORMAT "%5.1" /end CHARACTERISTIC
/begin CHARACTERISTIC DFES_FaultTyp.DFC_BattUBMaxBatt_C "" VALUE 0x8024DFEC Val_Wu8 255.0 DFES_OneToOne 0.00 255.0 FORMAT "%5.1" /end CHARACTERISTIC
/begin CHARACTERISTIC DFES_FaultTyp.DFC_BattUBMaxNoBatt_C "" VALUE 0x8024DFED Val_Wu8 255.0 DFES_OneToOne 0.00 255.0 FORMAT "%5.1" /end CHARACTERISTIC
/begin CHARACTERISTIC DFES_FaultTyp.DFC_BattUBMinBatt_C "" VALUE 0x8024DFEE Val_Wu8 255.0 DFES_OneToOne 0.00 255.0 FORMAT "%5.1" /end CHARACTERISTIC
/begin CHARACTERISTIC DFES_FaultTyp.DFC_BattUBMinNoBatt_C "" VALUE 0x8024DFEF Val_Wu8 255.0 DFES_OneToOne 0.00 255.0 FORMAT "%5.1" /end CHARACTERISTIC
/begin CHARACTERISTIC DFES_FaultTyp.DFC_BattUSRCMax_C "" VALUE 0x8024DFF0 Val_Wu8 255.0 DFES_OneToOne 0.00 255.0 FORMAT "%5.1" /end CHARACTERISTIC
/begin CHARACTERISTIC DFES_FaultTyp.DFC_BattUSRCMin_C "" VALUE 0x8024DFF1 Val_Wu8 255.0 DFES_OneToOne 0.00 255.0 FORMAT "%5.1" /end CHARACTERISTIC
/begin CHARACTERISTIC DFES_FaultTyp.DFC_BrkBstPHiCautionDfct_C "" VALUE 0x8024DFF2 Val_Wu8 255.0 DFES_OneToOne 0.00 255.0 FORMAT "%5.1" /end CHARACTERISTIC
/begin CHARACTERISTIC DFES_FaultTyp.DFC_BrkBstPHiWarnDfct_C "" VALUE 0x8024DFF3 Val_Wu8 255.0 DFES_OneToOne 0.00 255.0 FORMAT "%5.1" /end CHARACTERISTIC
/begin CHARACTERISTIC DFES_FaultTyp.DFC_BrkBstPSnsr12PlausDfct_C "" VALUE 0x8024DFF4 Val_Wu8 255.0 DFES_OneToOne 0.00 255.0 FORMAT "%5.1" /end CHARACTERISTIC
/begin CHARACTERISTIC DFES_FaultTyp.DFC_BrkBstPSnsr1Scb_C "" VALUE 0x8024DFF5 Val_Wu8 255.0 DFES_OneToOne 0.00 255.0 FORMAT "%5.1" /end CHARACTERISTIC
/begin CHARACTERISTIC DFES_FaultTyp.DFC_BrkBstPSnsr1Scg_C "" VALUE 0x8024DFF6 Val_Wu8 255.0 DFES_OneToOne 0.00 255.0 FORMAT "%5.1" /end CHARACTERISTIC
/begin CHARACTERISTIC DFES_FaultTyp.DFC_BrkBstPSnsr2Scb_C "" VALUE 0x8024DFF7 Val_Wu8 255.0 DFES_OneToOne 0.00 255.0 FORMAT "%5.1" /end CHARACTERISTIC
/begin CHARACTERISTIC DFES_FaultTyp.DFC_BrkBstPSnsr2Scg_C "" VALUE 0x8024DFF8 Val_Wu8 255.0 DFES_OneToOne 0.00 255.0 FORMAT "%5.1" /end CHARACTERISTIC
/begin CHARACTERISTIC DFES_FaultTyp.DFC_BrkBstPSnsrMax_C "" VALUE 0x8024DFF9 Val_Wu8 255.0 DFES_OneToOne 0.00 255.0 FORMAT "%5.1" /end CHARACTERISTIC
/begin CHARACTERISTIC DFES_FaultTyp.DFC_BrkBstPSnsrMin_C "" VALUE 0x8024DFFA Val_Wu8 255.0 DFES_OneToOne 0.00 255.0 FORMAT "%5.1" /end CHARACTERISTIC
/begin CHARACTERISTIC DFES_FaultTyp.DFC_BrkBstPhyRngChkMax_C "" VALUE 0x8024DFFB Val_Wu8 255.0 DFES_OneToOne 0.00 255.0 FORMAT "%5.1" /end CHARACTERISTIC
/begin CHARACTERISTIC DFES_FaultTyp.DFC_BrkBstPhyRngChkMin_C "" VALUE 0x8024DFFC Val_Wu8 255.0 DFES_OneToOne 0.00 255.0 FORMAT "%5.1" /end CHARACTERISTIC
/begin CHARACTERISTIC DFES_FaultTyp.DFC_BrkBstPmpHsScb_C "" VALUE 0x8024DFFD Val_Wu8 255.0 DFES_OneToOne 0.00 255.0 FORMAT "%5.1" /end CHARACTERISTIC
/begin CHARACTERISTIC DFES_FaultTyp.DFC_BrkBstPmpHsScg_C "" VALUE 0x8024DFFE Val_Wu8 255.0 DFES_OneToOne 0.00 255.0 FORMAT "%5.1" /end CHARACTERISTIC
/begin CHARACTERISTIC DFES_FaultTyp.DFC_BrkBstPmpLsOl_C "" VALUE 0x8024DFFF Val_Wu8 255.0 DFES_OneToOne 0.00 255.0 FORMAT "%5.1" /end CHARACTERISTIC
/begin CHARACTERISTIC DFES_FaultTyp.DFC_BrkBstPmpLsScb_C "" VALUE 0x8024E000 Val_Wu8 255.0 DFES_OneToOne 0.00 255.0 FORMAT "%5.1" /end CHARACTERISTIC
/begin CHARACTERISTIC DFES_FaultTyp.DFC_BrkBstPmpLsScg_C "" VALUE 0x8024E001 Val_Wu8 255.0 DFES_OneToOne 0.00 255.0 FORMAT "%5.1" /end CHARACTERISTIC
/begin CHARACTERISTIC DFES_FaultTyp.DFC_CbnHeatgHeatrRlyOpend_C "" VALUE 0x8024E002 Val_Wu8 255.0 DFES_OneToOne 0.00 255.0 FORMAT "%5.1" /end CHARACTERISTIC
/begin CHARACTERISTIC DFES_FaultTyp.DFC_CbnHeatgHeatrRlyWldd_C "" VALUE 0x8024E003 Val_Wu8 255.0 DFES_OneToOne 0.00 255.0 FORMAT "%5.1" /end CHARACTERISTIC
/begin CHARACTERISTIC DFES_FaultTyp.DFC_CcsDcIBattExcdd_C "" VALUE 0x8024E004 Val_Wu8 255.0 DFES_OneToOne 0.00 255.0 FORMAT "%5.1" /end CHARACTERISTIC
/begin CHARACTERISTIC DFES_FaultTyp.DFC_CcsDcIEvseOutDe_C "" VALUE 0x8024E005 Val_Wu8 255.0 DFES_OneToOne 0.00 255.0 FORMAT "%5.1" /end CHARACTERISTIC
/begin CHARACTERISTIC DFES_FaultTyp.DFC_CcsDcIOutDe_C "" VALUE 0x8024E006 Val_Wu8 255.0 DFES_OneToOne 0.00 255.0 FORMAT "%5.1" /end CHARACTERISTIC
/begin CHARACTERISTIC DFES_FaultTyp.DFC_CcsDcIOutExcdd_C "" VALUE 0x8024E007 Val_Wu8 255.0 DFES_OneToOne 0.00 255.0 FORMAT "%5.1" /end CHARACTERISTIC
/begin CHARACTERISTIC DFES_FaultTyp.DFC_CcsDcUOutDe_C "" VALUE 0x8024E008 Val_Wu8 255.0 DFES_OneToOne 0.00 255.0 FORMAT "%5.1" /end CHARACTERISTIC
/begin CHARACTERISTIC DFES_FaultTyp.DFC_CcsDcUOutExcdd_C "" VALUE 0x8024E009 Val_Wu8 255.0 DFES_OneToOne 0.00 255.0 FORMAT "%5.1" /end CHARACTERISTIC
/begin CHARACTERISTIC DFES_FaultTyp.DFC_CcsPwrLineChpRstOL_C "" VALUE 0x8024E00A Val_Wu8 255.0 DFES_OneToOne 0.00 255.0 FORMAT "%5.1" /end CHARACTERISTIC
/begin CHARACTERISTIC DFES_FaultTyp.DFC_CcsPwrLineChpRstOvrTemp_C "" VALUE 0x8024E00B Val_Wu8 255.0 DFES_OneToOne 0.00 255.0 FORMAT "%5.1" /end CHARACTERISTIC
/begin CHARACTERISTIC DFES_FaultTyp.DFC_CcsPwrLineChpRstSCB_C "" VALUE 0x8024E00C Val_Wu8 255.0 DFES_OneToOne 0.00 255.0 FORMAT "%5.1" /end CHARACTERISTIC
/begin CHARACTERISTIC DFES_FaultTyp.DFC_CcsPwrLineChpRstSCG_C "" VALUE 0x8024E00D Val_Wu8 255.0 DFES_OneToOne 0.00 255.0 FORMAT "%5.1" /end CHARACTERISTIC
/begin CHARACTERISTIC DFES_FaultTyp.DFC_CcsPwrLineChpVccEnaOL_C "" VALUE 0x8024E00E Val_Wu8 255.0 DFES_OneToOne 0.00 255.0 FORMAT "%5.1" /end CHARACTERISTIC
/begin CHARACTERISTIC DFES_FaultTyp.DFC_CcsPwrLineChpVccEnaOvrTemp_C "" VALUE 0x8024E00F Val_Wu8 255.0 DFES_OneToOne 0.00 255.0 FORMAT "%5.1" /end CHARACTERISTIC
/begin CHARACTERISTIC DFES_FaultTyp.DFC_CcsPwrLineChpVccEnaSCB_C "" VALUE 0x8024E010 Val_Wu8 255.0 DFES_OneToOne 0.00 255.0 FORMAT "%5.1" /end CHARACTERISTIC
/begin CHARACTERISTIC DFES_FaultTyp.DFC_CcsPwrLineChpVccEnaSCG_C "" VALUE 0x8024E011 Val_Wu8 255.0 DFES_OneToOne 0.00 255.0 FORMAT "%5.1" /end CHARACTERISTIC
/begin CHARACTERISTIC DFES_FaultTyp.DFC_CcsPwrLineChpVccSRCMin_C "" VALUE 0x8024E012 Val_Wu8 255.0 DFES_OneToOne 0.00 255.0 FORMAT "%5.1" /end CHARACTERISTIC
/begin CHARACTERISTIC DFES_FaultTyp.DFC_CcsPwrLineComChpTSRCMin_C "" VALUE 0x8024E013 Val_Wu8 255.0 DFES_OneToOne 0.00 255.0 FORMAT "%5.1" /end CHARACTERISTIC
/begin CHARACTERISTIC DFES_FaultTyp.DFC_CtPSwtActrOL_C "" VALUE 0x8024E014 Val_Wu8 255.0 DFES_OneToOne 0.00 255.0 FORMAT "%5.1" /end CHARACTERISTIC
/begin CHARACTERISTIC DFES_FaultTyp.DFC_CtPSwtActrOvrTemp_C "" VALUE 0x8024E015 Val_Wu8 255.0 DFES_OneToOne 0.00 255.0 FORMAT "%5.1" /end CHARACTERISTIC
/begin CHARACTERISTIC DFES_FaultTyp.DFC_CtPSwtActrSCB_C "" VALUE 0x8024E016 Val_Wu8 255.0 DFES_OneToOne 0.00 255.0 FORMAT "%5.1" /end CHARACTERISTIC
/begin CHARACTERISTIC DFES_FaultTyp.DFC_CtPSwtActrSCG_C "" VALUE 0x8024E017 Val_Wu8 255.0 DFES_OneToOne 0.00 255.0 FORMAT "%5.1" /end CHARACTERISTIC
/begin CHARACTERISTIC DFES_FaultTyp.DFC_CtPSwtDiagSRCMin_C "" VALUE 0x8024E018 Val_Wu8 255.0 DFES_OneToOne 0.00 255.0 FORMAT "%5.1" /end CHARACTERISTIC
/begin CHARACTERISTIC DFES_FaultTyp.DFC_CtpCarrFrqSRCMin_C "" VALUE 0x8024E019 Val_Wu8 255.0 DFES_OneToOne 0.00 255.0 FORMAT "%5.1" /end CHARACTERISTIC
/begin CHARACTERISTIC DFES_FaultTyp.DFC_DcChrgrIntkT2SRCMin_C "" VALUE 0x8024E01A Val_Wu8 255.0 DFES_OneToOne 0.00 255.0 FORMAT "%5.1" /end CHARACTERISTIC
/begin CHARACTERISTIC DFES_FaultTyp.DFC_DcChrgrIntkTSRCMin_C "" VALUE 0x8024E01B Val_Wu8 255.0 DFES_OneToOne 0.00 255.0 FORMAT "%5.1" /end CHARACTERISTIC
/begin CHARACTERISTIC DFES_FaultTyp.DFC_DevLibBattUHi_C "" VALUE 0x8024E01C Val_Wu8 255.0 DFES_OneToOne 0.00 255.0 FORMAT "%5.1" /end CHARACTERISTIC
/begin CHARACTERISTIC DFES_FaultTyp.DFC_DevLibBattULo_C "" VALUE 0x8024E01D Val_Wu8 255.0 DFES_OneToOne 0.00 255.0 FORMAT "%5.1" /end CHARACTERISTIC
/begin CHARACTERISTIC DFES_FaultTyp.DFC_EmWakeupSigOL_C "" VALUE 0x8024E01E Val_Wu8 255.0 DFES_OneToOne 0.00 255.0 FORMAT "%5.1" /end CHARACTERISTIC
/begin CHARACTERISTIC DFES_FaultTyp.DFC_EmWakeupSigOvrTemp_C "" VALUE 0x8024E01F Val_Wu8 255.0 DFES_OneToOne 0.00 255.0 FORMAT "%5.1" /end CHARACTERISTIC
/begin CHARACTERISTIC DFES_FaultTyp.DFC_EmWakeupSigSCB_C "" VALUE 0x8024E020 Val_Wu8 255.0 DFES_OneToOne 0.00 255.0 FORMAT "%5.1" /end CHARACTERISTIC
/begin CHARACTERISTIC DFES_FaultTyp.DFC_EmWakeupSigSCG_C "" VALUE 0x8024E021 Val_Wu8 255.0 DFES_OneToOne 0.00 255.0 FORMAT "%5.1" /end CHARACTERISTIC
/begin CHARACTERISTIC DFES_FaultTyp.DFC_Fan1OL_C "" VALUE 0x8024E022 Val_Wu8 255.0 DFES_OneToOne 0.00 255.0 FORMAT "%5.1" /end CHARACTERISTIC
/begin CHARACTERISTIC DFES_FaultTyp.DFC_Fan1OvrTemp_C "" VALUE 0x8024E023 Val_Wu8 255.0 DFES_OneToOne 0.00 255.0 FORMAT "%5.1" /end CHARACTERISTIC
/begin CHARACTERISTIC DFES_FaultTyp.DFC_Fan1SCB_C "" VALUE 0x8024E024 Val_Wu8 255.0 DFES_OneToOne 0.00 255.0 FORMAT "%5.1" /end CHARACTERISTIC
/begin CHARACTERISTIC DFES_FaultTyp.DFC_FanRlySCB_C "" VALUE 0x8024E025 Val_Wu8 255.0 DFES_OneToOne 0.00 255.0 FORMAT "%5.1" /end CHARACTERISTIC
/begin CHARACTERISTIC DFES_FaultTyp.DFC_FanRlySCG_C "" VALUE 0x8024E026 Val_Wu8 255.0 DFES_OneToOne 0.00 255.0 FORMAT "%5.1" /end CHARACTERISTIC
/begin CHARACTERISTIC DFES_FaultTyp.DFC_FanSpdSRCMin_C "" VALUE 0x8024E027 Val_Wu8 255.0 DFES_OneToOne 0.00 255.0 FORMAT "%5.1" /end CHARACTERISTIC
/begin CHARACTERISTIC DFES_FaultTyp.DFC_FreonPSRCMin_C "" VALUE 0x8024E028 Val_Wu8 255.0 DFES_OneToOne 0.00 255.0 FORMAT "%5.1" /end CHARACTERISTIC
/begin CHARACTERISTIC DFES_FaultTyp.DFC_HLCCcsPLnCChipTHi_C "" VALUE 0x8024E029 Val_Wu8 255.0 DFES_OneToOne 0.00 255.0 FORMAT "%5.1" /end CHARACTERISTIC
/begin CHARACTERISTIC DFES_FaultTyp.DFC_HeatrCoreTSRCMin_C "" VALUE 0x8024E02A Val_Wu8 255.0 DFES_OneToOne 0.00 255.0 FORMAT "%5.1" /end CHARACTERISTIC
/begin CHARACTERISTIC DFES_FaultTyp.DFC_PwmCtPSRCMin_C "" VALUE 0x8024E02B Val_Wu8 255.0 DFES_OneToOne 0.00 255.0 FORMAT "%5.1" /end CHARACTERISTIC
/begin CHARACTERISTIC DFES_FaultTyp.DFC_PwrDistbnUnitTSRCMin_C "" VALUE 0x8024E02C Val_Wu8 255.0 DFES_OneToOne 0.00 255.0 FORMAT "%5.1" /end CHARACTERISTIC
/begin CHARACTERISTIC DFES_FaultTyp.DFC_SCtPmp1OL_C "" VALUE 0x8024E02D Val_Wu8 255.0 DFES_OneToOne 0.00 255.0 FORMAT "%5.1" /end CHARACTERISTIC
/begin CHARACTERISTIC DFES_FaultTyp.DFC_SCtPmp1OvrTemp_C "" VALUE 0x8024E02E Val_Wu8 255.0 DFES_OneToOne 0.00 255.0 FORMAT "%5.1" /end CHARACTERISTIC
/begin CHARACTERISTIC DFES_FaultTyp.DFC_SCtPmp1SCB_C "" VALUE 0x8024E02F Val_Wu8 255.0 DFES_OneToOne 0.00 255.0 FORMAT "%5.1" /end CHARACTERISTIC
/begin CHARACTERISTIC DFES_FaultTyp.DFC_SCtPmpRlyOL_C "" VALUE 0x8024E030 Val_Wu8 255.0 DFES_OneToOne 0.00 255.0 FORMAT "%5.1" /end CHARACTERISTIC
/begin CHARACTERISTIC DFES_FaultTyp.DFC_SCtPmpRlyOvrTemp_C "" VALUE 0x8024E031 Val_Wu8 255.0 DFES_OneToOne 0.00 255.0 FORMAT "%5.1" /end CHARACTERISTIC
/begin CHARACTERISTIC DFES_FaultTyp.DFC_SCtPmpRlySCB_C "" VALUE 0x8024E032 Val_Wu8 255.0 DFES_OneToOne 0.00 255.0 FORMAT "%5.1" /end CHARACTERISTIC
/begin CHARACTERISTIC DFES_FaultTyp.DFC_SpplCooltPmpRlyOL_C "" VALUE 0x8024E033 Val_Wu8 255.0 DFES_OneToOne 0.00 255.0 FORMAT "%5.1" /end CHARACTERISTIC
/begin CHARACTERISTIC DFES_FaultTyp.DFC_SpplCooltPmpRlyOvrTemp_C "" VALUE 0x8024E034 Val_Wu8 255.0 DFES_OneToOne 0.00 255.0 FORMAT "%5.1" /end CHARACTERISTIC
/begin CHARACTERISTIC DFES_FaultTyp.DFC_SpplCooltPmpRlySCB_C "" VALUE 0x8024E035 Val_Wu8 255.0 DFES_OneToOne 0.00 255.0 FORMAT "%5.1" /end CHARACTERISTIC
/begin CHARACTERISTIC DFES_FaultTyp.DFC_UCtPSRCMin_C "" VALUE 0x8024E036 Val_Wu8 255.0 DFES_OneToOne 0.00 255.0 FORMAT "%5.1" /end CHARACTERISTIC
/begin CHARACTERISTIC DFES_FaultTyp.DFC_UPxP1SRCMin_C "" VALUE 0x8024E037 Val_Wu8 255.0 DFES_OneToOne 0.00 255.0 FORMAT "%5.1" /end CHARACTERISTIC
/begin CHARACTERISTIC DFES_FaultTyp.DFC_ComHSN1CANMute_C "" VALUE 0x8024E038 Val_Wu8 255.0 DFES_OneToOne 0.00 255.0 FORMAT "%5.1" /end CHARACTERISTIC
/begin CHARACTERISTIC DFES_FaultTyp.DFC_ComHSN3CANMute_C "" VALUE 0x8024E039 Val_Wu8 255.0 DFES_OneToOne 0.00 255.0 FORMAT "%5.1" /end CHARACTERISTIC
/begin CHARACTERISTIC DFES_FaultTyp.DFC_AcChrgrIntkTPhysRngHi_C "" VALUE 0x8024E03A Val_Wu8 255.0 DFES_OneToOne 0.00 255.0 FORMAT "%5.1" /end CHARACTERISTIC
/begin CHARACTERISTIC DFES_FaultTyp.DFC_AcChrgrIntkTPhysRngLo_C "" VALUE 0x8024E03B Val_Wu8 255.0 DFES_OneToOne 0.00 255.0 FORMAT "%5.1" /end CHARACTERISTIC
/begin CHARACTERISTIC DFES_FaultTyp.DFC_AcChrgrIntkTSRCOpn_C "" VALUE 0x8024E03C Val_Wu8 255.0 DFES_OneToOne 0.00 255.0 FORMAT "%5.1" /end CHARACTERISTIC
/begin CHARACTERISTIC DFES_FaultTyp.DFC_CcsPwrLineChpVccPhysRngHi_C "" VALUE 0x8024E03D Val_Wu8 255.0 DFES_OneToOne 0.00 255.0 FORMAT "%5.1" /end CHARACTERISTIC
/begin CHARACTERISTIC DFES_FaultTyp.DFC_CcsPwrLineChpVccPhysRngLo_C "" VALUE 0x8024E03E Val_Wu8 255.0 DFES_OneToOne 0.00 255.0 FORMAT "%5.1" /end CHARACTERISTIC
/begin CHARACTERISTIC DFES_FaultTyp.DFC_CcsPwrLineChpVccSRCOpn_C "" VALUE 0x8024E03F Val_Wu8 255.0 DFES_OneToOne 0.00 255.0 FORMAT "%5.1" /end CHARACTERISTIC
/begin CHARACTERISTIC DFES_FaultTyp.DFC_CcsPwrLineComChpTPhysRngHi_C "" VALUE 0x8024E040 Val_Wu8 255.0 DFES_OneToOne 0.00 255.0 FORMAT "%5.1" /end CHARACTERISTIC
/begin CHARACTERISTIC DFES_FaultTyp.DFC_CcsPwrLineComChpTPhysRngLo_C "" VALUE 0x8024E041 Val_Wu8 255.0 DFES_OneToOne 0.00 255.0 FORMAT "%5.1" /end CHARACTERISTIC
/begin CHARACTERISTIC DFES_FaultTyp.DFC_CcsPwrLineComChpTSRCOpn_C "" VALUE 0x8024E042 Val_Wu8 255.0 DFES_OneToOne 0.00 255.0 FORMAT "%5.1" /end CHARACTERISTIC
/begin CHARACTERISTIC DFES_FaultTyp.DFC_CtPSwtDiagPhysRngHi_C "" VALUE 0x8024E043 Val_Wu8 255.0 DFES_OneToOne 0.00 255.0 FORMAT "%5.1" /end CHARACTERISTIC
/begin CHARACTERISTIC DFES_FaultTyp.DFC_CtPSwtDiagPhysRngLo_C "" VALUE 0x8024E044 Val_Wu8 255.0 DFES_OneToOne 0.00 255.0 FORMAT "%5.1" /end CHARACTERISTIC
/begin CHARACTERISTIC DFES_FaultTyp.DFC_CtPSwtDiagSRCOpn_C "" VALUE 0x8024E045 Val_Wu8 255.0 DFES_OneToOne 0.00 255.0 FORMAT "%5.1" /end CHARACTERISTIC
/begin CHARACTERISTIC DFES_FaultTyp.DFC_CtpCarrFrqPhysRngHi_C "" VALUE 0x8024E046 Val_Wu8 255.0 DFES_OneToOne 0.00 255.0 FORMAT "%5.1" /end CHARACTERISTIC
/begin CHARACTERISTIC DFES_FaultTyp.DFC_CtpCarrFrqPhysRngLo_C "" VALUE 0x8024E047 Val_Wu8 255.0 DFES_OneToOne 0.00 255.0 FORMAT "%5.1" /end CHARACTERISTIC
/begin CHARACTERISTIC DFES_FaultTyp.DFC_CtpCarrFrqSRCMax_C "" VALUE 0x8024E048 Val_Wu8 255.0 DFES_OneToOne 0.00 255.0 FORMAT "%5.1" /end CHARACTERISTIC
/begin CHARACTERISTIC DFES_FaultTyp.DFC_DcChrgrIntkT2PhysRngHi_C "" VALUE 0x8024E049 Val_Wu8 255.0 DFES_OneToOne 0.00 255.0 FORMAT "%5.1" /end CHARACTERISTIC
/begin CHARACTERISTIC DFES_FaultTyp.DFC_DcChrgrIntkT2PhysRngLo_C "" VALUE 0x8024E04A Val_Wu8 255.0 DFES_OneToOne 0.00 255.0 FORMAT "%5.1" /end CHARACTERISTIC
/begin CHARACTERISTIC DFES_FaultTyp.DFC_DcChrgrIntkT2SRCOpn_C "" VALUE 0x8024E04B Val_Wu8 255.0 DFES_OneToOne 0.00 255.0 FORMAT "%5.1" /end CHARACTERISTIC
/begin CHARACTERISTIC DFES_FaultTyp.DFC_DcChrgrIntkTPhysRngHi_C "" VALUE 0x8024E04C Val_Wu8 255.0 DFES_OneToOne 0.00 255.0 FORMAT "%5.1" /end CHARACTERISTIC
/begin CHARACTERISTIC DFES_FaultTyp.DFC_DcChrgrIntkTPhysRngLo_C "" VALUE 0x8024E04D Val_Wu8 255.0 DFES_OneToOne 0.00 255.0 FORMAT "%5.1" /end CHARACTERISTIC
/begin CHARACTERISTIC DFES_FaultTyp.DFC_DcChrgrIntkTSRCOpn_C "" VALUE 0x8024E04E Val_Wu8 255.0 DFES_OneToOne 0.00 255.0 FORMAT "%5.1" /end CHARACTERISTIC
/begin CHARACTERISTIC DFES_FaultTyp.DFC_Fan1SCG_C "" VALUE 0x8024E04F Val_Wu8 255.0 DFES_OneToOne 0.00 255.0 FORMAT "%5.1" /end CHARACTERISTIC
/begin CHARACTERISTIC DFES_FaultTyp.DFC_FanSpdPhysRngHi_C "" VALUE 0x8024E050 Val_Wu8 255.0 DFES_OneToOne 0.00 255.0 FORMAT "%5.1" /end CHARACTERISTIC
/begin CHARACTERISTIC DFES_FaultTyp.DFC_FanSpdPhysRngLo_C "" VALUE 0x8024E051 Val_Wu8 255.0 DFES_OneToOne 0.00 255.0 FORMAT "%5.1" /end CHARACTERISTIC
/begin CHARACTERISTIC DFES_FaultTyp.DFC_FanSpdSRCOpn_C "" VALUE 0x8024E052 Val_Wu8 255.0 DFES_OneToOne 0.00 255.0 FORMAT "%5.1" /end CHARACTERISTIC
/begin CHARACTERISTIC DFES_FaultTyp.DFC_FreonPPhysRngHi_C "" VALUE 0x8024E053 Val_Wu8 255.0 DFES_OneToOne 0.00 255.0 FORMAT "%5.1" /end CHARACTERISTIC
/begin CHARACTERISTIC DFES_FaultTyp.DFC_FreonPPhysRngLo_C "" VALUE 0x8024E054 Val_Wu8 255.0 DFES_OneToOne 0.00 255.0 FORMAT "%5.1" /end CHARACTERISTIC
/begin CHARACTERISTIC DFES_FaultTyp.DFC_FreonPSRCOpn_C "" VALUE 0x8024E055 Val_Wu8 255.0 DFES_OneToOne 0.00 255.0 FORMAT "%5.1" /end CHARACTERISTIC
/begin CHARACTERISTIC DFES_FaultTyp.DFC_HeatrCoreTPhysRngHi_C "" VALUE 0x8024E056 Val_Wu8 255.0 DFES_OneToOne 0.00 255.0 FORMAT "%5.1" /end CHARACTERISTIC
/begin CHARACTERISTIC DFES_FaultTyp.DFC_HeatrCoreTPhysRngLo_C "" VALUE 0x8024E057 Val_Wu8 255.0 DFES_OneToOne 0.00 255.0 FORMAT "%5.1" /end CHARACTERISTIC
/begin CHARACTERISTIC DFES_FaultTyp.DFC_HeatrCoreTSRCOpn_C "" VALUE 0x8024E058 Val_Wu8 255.0 DFES_OneToOne 0.00 255.0 FORMAT "%5.1" /end CHARACTERISTIC
/begin CHARACTERISTIC DFES_FaultTyp.DFC_HvGridUMaxSftyLim_C "" VALUE 0x8024E059 Val_Wu8 255.0 DFES_OneToOne 0.00 255.0 FORMAT "%5.1" /end CHARACTERISTIC
/begin CHARACTERISTIC DFES_FaultTyp.DFC_HvGridUMinSftyLim_C "" VALUE 0x8024E05A Val_Wu8 255.0 DFES_OneToOne 0.00 255.0 FORMAT "%5.1" /end CHARACTERISTIC
/begin CHARACTERISTIC DFES_FaultTyp.DFC_HvGridUPlausy_C "" VALUE 0x8024E05B Val_Wu8 255.0 DFES_OneToOne 0.00 255.0 FORMAT "%5.1" /end CHARACTERISTIC
/begin CHARACTERISTIC DFES_FaultTyp.DFC_IntlckChrgPlgHBrgOpnLd_C "" VALUE 0x8024E05C Val_Wu8 255.0 DFES_OneToOne 0.00 255.0 FORMAT "%5.1" /end CHARACTERISTIC
/begin CHARACTERISTIC DFES_FaultTyp.DFC_IntlckChrgPlgHBrgOvrCurr_C "" VALUE 0x8024E05D Val_Wu8 255.0 DFES_OneToOne 0.00 255.0 FORMAT "%5.1" /end CHARACTERISTIC
/begin CHARACTERISTIC DFES_FaultTyp.DFC_IntlckChrgPlgHBrgOvrTemp_C "" VALUE 0x8024E05E Val_Wu8 255.0 DFES_OneToOne 0.00 255.0 FORMAT "%5.1" /end CHARACTERISTIC
/begin CHARACTERISTIC DFES_FaultTyp.DFC_IntlckChrgPlgHBrgShCirBatt1_C "" VALUE 0x8024E05F Val_Wu8 255.0 DFES_OneToOne 0.00 255.0 FORMAT "%5.1" /end CHARACTERISTIC
/begin CHARACTERISTIC DFES_FaultTyp.DFC_IntlckChrgPlgHBrgShCirBatt2_C "" VALUE 0x8024E060 Val_Wu8 255.0 DFES_OneToOne 0.00 255.0 FORMAT "%5.1" /end CHARACTERISTIC
/begin CHARACTERISTIC DFES_FaultTyp.DFC_IntlckChrgPlgHBrgShCirGnd1_C "" VALUE 0x8024E061 Val_Wu8 255.0 DFES_OneToOne 0.00 255.0 FORMAT "%5.1" /end CHARACTERISTIC
/begin CHARACTERISTIC DFES_FaultTyp.DFC_IntlckChrgPlgHBrgShCirGnd2_C "" VALUE 0x8024E062 Val_Wu8 255.0 DFES_OneToOne 0.00 255.0 FORMAT "%5.1" /end CHARACTERISTIC
/begin CHARACTERISTIC DFES_FaultTyp.DFC_IntlckChrgPlgHBrgShCirOvrLd_C "" VALUE 0x8024E063 Val_Wu8 255.0 DFES_OneToOne 0.00 255.0 FORMAT "%5.1" /end CHARACTERISTIC
/begin CHARACTERISTIC DFES_FaultTyp.DFC_IntlckChrgPlgHBrgTempOvrCurr_C "" VALUE 0x8024E064 Val_Wu8 255.0 DFES_OneToOne 0.00 255.0 FORMAT "%5.1" /end CHARACTERISTIC
/begin CHARACTERISTIC DFES_FaultTyp.DFC_IntlckChrgPlgHBrgUndrVltg_C "" VALUE 0x8024E065 Val_Wu8 255.0 DFES_OneToOne 0.00 255.0 FORMAT "%5.1" /end CHARACTERISTIC
/begin CHARACTERISTIC DFES_FaultTyp.DFC_IntlckChrgPlgPosnRngFlt_C "" VALUE 0x8024E066 Val_Wu8 255.0 DFES_OneToOne 0.00 255.0 FORMAT "%5.1" /end CHARACTERISTIC
/begin CHARACTERISTIC DFES_FaultTyp.DFC_IntlckChrgPlgPosnSrcMax_C "" VALUE 0x8024E067 Val_Wu8 255.0 DFES_OneToOne 0.00 255.0 FORMAT "%5.1" /end CHARACTERISTIC
/begin CHARACTERISTIC DFES_FaultTyp.DFC_IntlckChrgPlgPosnSrcMin_C "" VALUE 0x8024E068 Val_Wu8 255.0 DFES_OneToOne 0.00 255.0 FORMAT "%5.1" /end CHARACTERISTIC
/begin CHARACTERISTIC DFES_FaultTyp.DFC_PwmCtPPhysRngHi_C "" VALUE 0x8024E069 Val_Wu8 255.0 DFES_OneToOne 0.00 255.0 FORMAT "%5.1" /end CHARACTERISTIC
/begin CHARACTERISTIC DFES_FaultTyp.DFC_PwmCtPPhysRngLo_C "" VALUE 0x8024E06A Val_Wu8 255.0 DFES_OneToOne 0.00 255.0 FORMAT "%5.1" /end CHARACTERISTIC
/begin CHARACTERISTIC DFES_FaultTyp.DFC_PwmCtPSRCMax_C "" VALUE 0x8024E06B Val_Wu8 255.0 DFES_OneToOne 0.00 255.0 FORMAT "%5.1" /end CHARACTERISTIC
/begin CHARACTERISTIC DFES_FaultTyp.DFC_PwrDistbnUnitTPhysRngHi_C "" VALUE 0x8024E06C Val_Wu8 255.0 DFES_OneToOne 0.00 255.0 FORMAT "%5.1" /end CHARACTERISTIC
/begin CHARACTERISTIC DFES_FaultTyp.DFC_PwrDistbnUnitTPhysRngLo_C "" VALUE 0x8024E06D Val_Wu8 255.0 DFES_OneToOne 0.00 255.0 FORMAT "%5.1" /end CHARACTERISTIC
/begin CHARACTERISTIC DFES_FaultTyp.DFC_PwrDistbnUnitTSRCOpn_C "" VALUE 0x8024E06E Val_Wu8 255.0 DFES_OneToOne 0.00 255.0 FORMAT "%5.1" /end CHARACTERISTIC
/begin CHARACTERISTIC DFES_FaultTyp.DFC_SCtPmpRlySCG_C "" VALUE 0x8024E06F Val_Wu8 255.0 DFES_OneToOne 0.00 255.0 FORMAT "%5.1" /end CHARACTERISTIC
/begin CHARACTERISTIC DFES_FaultTyp.DFC_SpplCooltPmpRlySCG_C "" VALUE 0x8024E070 Val_Wu8 255.0 DFES_OneToOne 0.00 255.0 FORMAT "%5.1" /end CHARACTERISTIC
/begin CHARACTERISTIC DFES_FaultTyp.DFC_UCtPPhysRngHi_C "" VALUE 0x8024E071 Val_Wu8 255.0 DFES_OneToOne 0.00 255.0 FORMAT "%5.1" /end CHARACTERISTIC
/begin CHARACTERISTIC DFES_FaultTyp.DFC_UCtPPhysRngLo_C "" VALUE 0x8024E072 Val_Wu8 255.0 DFES_OneToOne 0.00 255.0 FORMAT "%5.1" /end CHARACTERISTIC
/begin CHARACTERISTIC DFES_FaultTyp.DFC_UCtPSRCOpn_C "" VALUE 0x8024E073 Val_Wu8 255.0 DFES_OneToOne 0.00 255.0 FORMAT "%5.1" /end CHARACTERISTIC
/begin CHARACTERISTIC DFES_FaultTyp.DFC_UPxP1PhysRngHi_C "" VALUE 0x8024E074 Val_Wu8 255.0 DFES_OneToOne 0.00 255.0 FORMAT "%5.1" /end CHARACTERISTIC
/begin CHARACTERISTIC DFES_FaultTyp.DFC_UPxP1PhysRngLo_C "" VALUE 0x8024E075 Val_Wu8 255.0 DFES_OneToOne 0.00 255.0 FORMAT "%5.1" /end CHARACTERISTIC
/begin CHARACTERISTIC DFES_FaultTyp.DFC_UPxP1SRCOpn_C "" VALUE 0x8024E076 Val_Wu8 255.0 DFES_OneToOne 0.00 255.0 FORMAT "%5.1" /end CHARACTERISTIC
/begin CHARACTERISTIC DFES_FaultTyp.DFC_VehVPhysRngHi_C "" VALUE 0x8024E077 Val_Wu8 255.0 DFES_OneToOne 0.00 255.0 FORMAT "%5.1" /end CHARACTERISTIC
/begin CHARACTERISTIC DFES_FaultTyp.DFC_VehVPhysRngLo_C "" VALUE 0x8024E078 Val_Wu8 255.0 DFES_OneToOne 0.00 255.0 FORMAT "%5.1" /end CHARACTERISTIC
/begin CHARACTERISTIC DFES_FaultTyp.DFC_VehVSigCan_C "" VALUE 0x8024E079 Val_Wu8 255.0 DFES_OneToOne 0.00 255.0 FORMAT "%5.1" /end CHARACTERISTIC
/begin CHARACTERISTIC DFES_FaultTyp.DFC_VehVSigCanSafe_C "" VALUE 0x8024E07A Val_Wu8 255.0 DFES_OneToOne 0.00 255.0 FORMAT "%5.1" /end CHARACTERISTIC
/begin CHARACTERISTIC DFES_FaultTyp.DFC_SCtPmp1DiagGrdKey1_C "" VALUE 0x8024E07B Val_Wu8 255.0 DFES_OneToOne 0.00 255.0 FORMAT "%5.1" /end CHARACTERISTIC
/begin CHARACTERISTIC DFES_FaultTyp.DFC_SCtPmp1DiagGrdKey2_C "" VALUE 0x8024E07C Val_Wu8 255.0 DFES_OneToOne 0.00 255.0 FORMAT "%5.1" /end CHARACTERISTIC
/begin CHARACTERISTIC DFES_FaultTyp.DFC_SCtPmp1DiagGrdKey3_C "" VALUE 0x8024E07D Val_Wu8 255.0 DFES_OneToOne 0.00 255.0 FORMAT "%5.1" /end CHARACTERISTIC
/begin CHARACTERISTIC DFES_FaultTyp.DFC_SCtPmp1DiagGrdKey4_C "" VALUE 0x8024E07E Val_Wu8 255.0 DFES_OneToOne 0.00 255.0 FORMAT "%5.1" /end CHARACTERISTIC
/begin CHARACTERISTIC DFES_FaultTyp.DFC_SCtPmp1DiagGrdKey5_C "" VALUE 0x8024E07F Val_Wu8 255.0 DFES_OneToOne 0.00 255.0 FORMAT "%5.1" /end CHARACTERISTIC
/begin CHARACTERISTIC DFES_FaultTyp.DFC_ChrgPlgLiveCntctHzrdCcs_C "" VALUE 0x8024E080 Val_Wu8 255.0 DFES_OneToOne 0.00 255.0 FORMAT "%5.1" /end CHARACTERISTIC
/begin CHARACTERISTIC DFES_FaultTyp.DFC_ChrgPlgProxPltImps_C "" VALUE 0x8024E081 Val_Wu8 255.0 DFES_OneToOne 0.00 255.0 FORMAT "%5.1" /end CHARACTERISTIC
/begin CHARACTERISTIC DFES_FaultTyp.DFC_ChrgPlgTHiCcsDc_C "" VALUE 0x8024E082 Val_Wu8 255.0 DFES_OneToOne 0.00 255.0 FORMAT "%5.1" /end CHARACTERISTIC
/begin CHARACTERISTIC DFES_FaultTyp.DFC_ElMActvDchaFailr_C "" VALUE 0x8024E083 Val_Wu8 255.0 DFES_OneToOne 0.00 255.0 FORMAT "%5.1" /end CHARACTERISTIC
/begin CHARACTERISTIC DFES_FaultTyp.DFC_ElMActvDchaFlt_C "" VALUE 0x8024E084 Val_Wu8 255.0 DFES_OneToOne 0.00 255.0 FORMAT "%5.1" /end CHARACTERISTIC
/begin CHARACTERISTIC DFES_FaultTyp.DFC_ElMFbdnIvtrModDrv01_C "" VALUE 0x8024E085 Val_Wu8 255.0 DFES_OneToOne 0.00 255.0 FORMAT "%5.1" /end CHARACTERISTIC
/begin CHARACTERISTIC DFES_FaultTyp.DFC_ElMImobAuthent_C "" VALUE 0x8024E086 Val_Wu8 255.0 DFES_OneToOne 0.00 255.0 FORMAT "%5.1" /end CHARACTERISTIC
/begin CHARACTERISTIC DFES_FaultTyp.DFC_ElMIsoMonFlt_C "" VALUE 0x8024E087 Val_Wu8 255.0 DFES_OneToOne 0.00 255.0 FORMAT "%5.1" /end CHARACTERISTIC
/begin CHARACTERISTIC DFES_FaultTyp.DFC_ElMIsoMonPlausyFlt_C "" VALUE 0x8024E088 Val_Wu8 255.0 DFES_OneToOne 0.00 255.0 FORMAT "%5.1" /end CHARACTERISTIC
/begin CHARACTERISTIC DFES_FaultTyp.DFC_ElMIvtrCooltT01_C "" VALUE 0x8024E089 Val_Wu8 255.0 DFES_OneToOne 0.00 255.0 FORMAT "%5.1" /end CHARACTERISTIC
/begin CHARACTERISTIC DFES_FaultTyp.DFC_ElMIvtrEmgyShtDwn01_C "" VALUE 0x8024E08A Val_Wu8 255.0 DFES_OneToOne 0.00 255.0 FORMAT "%5.1" /end CHARACTERISTIC
/begin CHARACTERISTIC DFES_FaultTyp.DFC_ElMIvtrFailr01_C "" VALUE 0x8024E08B Val_Wu8 255.0 DFES_OneToOne 0.00 255.0 FORMAT "%5.1" /end CHARACTERISTIC
/begin CHARACTERISTIC DFES_FaultTyp.DFC_ElMIvtrIntlck01_C "" VALUE 0x8024E08C Val_Wu8 255.0 DFES_OneToOne 0.00 255.0 FORMAT "%5.1" /end CHARACTERISTIC
/begin CHARACTERISTIC DFES_FaultTyp.DFC_ElMIvtrTErr01_C "" VALUE 0x8024E08D Val_Wu8 255.0 DFES_OneToOne 0.00 255.0 FORMAT "%5.1" /end CHARACTERISTIC
/begin CHARACTERISTIC DFES_FaultTyp.DFC_ElMOverSpdNeg01_C "" VALUE 0x8024E08E Val_Wu8 255.0 DFES_OneToOne 0.00 255.0 FORMAT "%5.1" /end CHARACTERISTIC
/begin CHARACTERISTIC DFES_FaultTyp.DFC_ElMOverSpdPos01_C "" VALUE 0x8024E08F Val_Wu8 255.0 DFES_OneToOne 0.00 255.0 FORMAT "%5.1" /end CHARACTERISTIC
/begin CHARACTERISTIC DFES_FaultTyp.DFC_ElMOverTqNeg01_C "" VALUE 0x8024E090 Val_Wu8 255.0 DFES_OneToOne 0.00 255.0 FORMAT "%5.1" /end CHARACTERISTIC
/begin CHARACTERISTIC DFES_FaultTyp.DFC_ElMOverTqPos01_C "" VALUE 0x8024E091 Val_Wu8 255.0 DFES_OneToOne 0.00 255.0 FORMAT "%5.1" /end CHARACTERISTIC
/begin CHARACTERISTIC DFES_FaultTyp.DFC_ElMPwrAuthn_C "" VALUE 0x8024E092 Val_Wu8 255.0 DFES_OneToOne 0.00 255.0 FORMAT "%5.1" /end CHARACTERISTIC
/begin CHARACTERISTIC DFES_FaultTyp.DFC_ElMSpdErr01_C "" VALUE 0x8024E093 Val_Wu8 255.0 DFES_OneToOne 0.00 255.0 FORMAT "%5.1" /end CHARACTERISTIC
/begin CHARACTERISTIC DFES_FaultTyp.DFC_ElMSvs01_C "" VALUE 0x8024E094 Val_Wu8 255.0 DFES_OneToOne 0.00 255.0 FORMAT "%5.1" /end CHARACTERISTIC
/begin CHARACTERISTIC DFES_FaultTyp.DFC_PEnvCcMax_C "" VALUE 0x8024E095 Val_Wu8 255.0 DFES_OneToOne 0.00 255.0 FORMAT "%5.1" /end CHARACTERISTIC
/begin CHARACTERISTIC DFES_FaultTyp.DFC_PEnvCcMin_C "" VALUE 0x8024E096 Val_Wu8 255.0 DFES_OneToOne 0.00 255.0 FORMAT "%5.1" /end CHARACTERISTIC
/begin CHARACTERISTIC DFES_FaultTyp.DFC_PEnvRngChkMax_C "" VALUE 0x8024E097 Val_Wu8 255.0 DFES_OneToOne 0.00 255.0 FORMAT "%5.1" /end CHARACTERISTIC
/begin CHARACTERISTIC DFES_FaultTyp.DFC_PEnvRngChkMin_C "" VALUE 0x8024E098 Val_Wu8 255.0 DFES_OneToOne 0.00 255.0 FORMAT "%5.1" /end CHARACTERISTIC
/begin CHARACTERISTIC DFES_FaultTyp.DFC_PEnvSnsrPlaus_C "" VALUE 0x8024E099 Val_Wu8 255.0 DFES_OneToOne 0.00 255.0 FORMAT "%5.1" /end CHARACTERISTIC
/begin CHARACTERISTIC DFES_FaultTyp.DFC_BrkBstPmpPlausGenn_C "" VALUE 0x8024E09A Val_Wu8 255.0 DFES_OneToOne 0.00 255.0 FORMAT "%5.1" /end CHARACTERISTIC
/begin CHARACTERISTIC DFES_FaultTyp.DFC_CbnHeatrRlyLfLoWarn_C "" VALUE 0x8024E09B Val_Wu8 255.0 DFES_OneToOne 0.00 255.0 FORMAT "%5.1" /end CHARACTERISTIC
/begin CHARACTERISTIC DFES_FaultTyp.DFC_ChgrPlugLockPinByndClsd_C "" VALUE 0x8024E09C Val_Wu8 255.0 DFES_OneToOne 0.00 255.0 FORMAT "%5.1" /end CHARACTERISTIC
/begin CHARACTERISTIC DFES_FaultTyp.DFC_ChgrPlugLockPinMoveWoCmd_C "" VALUE 0x8024E09D Val_Wu8 255.0 DFES_OneToOne 0.00 255.0 FORMAT "%5.1" /end CHARACTERISTIC
/begin CHARACTERISTIC DFES_FaultTyp.DFC_ChgrPlugLockPinStuckInClsd_C "" VALUE 0x8024E09E Val_Wu8 255.0 DFES_OneToOne 0.00 255.0 FORMAT "%5.1" /end CHARACTERISTIC
/begin CHARACTERISTIC DFES_FaultTyp.DFC_ChgrPlugLockPinStuckInOpen_C "" VALUE 0x8024E09F Val_Wu8 255.0 DFES_OneToOne 0.00 255.0 FORMAT "%5.1" /end CHARACTERISTIC
/begin CHARACTERISTIC DFES_FaultTyp.DFC_ChrgrStErr_C "" VALUE 0x8024E0A0 Val_Wu8 255.0 DFES_OneToOne 0.00 255.0 FORMAT "%5.1" /end CHARACTERISTIC
/begin CHARACTERISTIC DFES_FaultTyp.DFC_ComHSN1BusOff_C "" VALUE 0x8024E0A1 Val_Wu8 255.0 DFES_OneToOne 0.00 255.0 FORMAT "%5.1" /end CHARACTERISTIC
/begin CHARACTERISTIC DFES_FaultTyp.DFC_ComHSN3BusOff_C "" VALUE 0x8024E0A2 Val_Wu8 255.0 DFES_OneToOne 0.00 255.0 FORMAT "%5.1" /end CHARACTERISTIC
/begin CHARACTERISTIC DFES_FaultTyp.DFC_ComVCInval_C "" VALUE 0x8024E0A3 Val_Wu8 255.0 DFES_OneToOne 0.00 255.0 FORMAT "%5.1" /end CHARACTERISTIC
/begin CHARACTERISTIC DFES_FaultTyp.DFC_EemDcdcPrecSpdInhb_C "" VALUE 0x8024E0A4 Val_Wu8 255.0 DFES_OneToOne 0.00 255.0 FORMAT "%5.1" /end CHARACTERISTIC
/begin CHARACTERISTIC DFES_FaultTyp.DFC_ExpPwrLatch_C "" VALUE 0x8024E0A5 Val_Wu8 255.0 DFES_OneToOne 0.00 255.0 FORMAT "%5.1" /end CHARACTERISTIC
/begin CHARACTERISTIC DFES_FaultTyp.DFC_FanMaxOvrd_C "" VALUE 0x8024E0A6 Val_Wu8 255.0 DFES_OneToOne 0.00 255.0 FORMAT "%5.1" /end CHARACTERISTIC
/begin CHARACTERISTIC DFES_FaultTyp.DFC_HLCCcsGnrlComErr_C "" VALUE 0x8024E0A7 Val_Wu8 255.0 DFES_OneToOne 0.00 255.0 FORMAT "%5.1" /end CHARACTERISTIC
/begin CHARACTERISTIC DFES_FaultTyp.DFC_InmLINNodeHVACPanelAbsnt_C "" VALUE 0x8024E0A8 Val_Wu8 255.0 DFES_OneToOne 0.00 255.0 FORMAT "%5.1" /end CHARACTERISTIC
/begin CHARACTERISTIC DFES_FaultTyp.DFC_ResetRcvNotAllwd_C "" VALUE 0x8024E0A9 Val_Wu8 255.0 DFES_OneToOne 0.00 255.0 FORMAT "%5.1" /end CHARACTERISTIC
/begin CHARACTERISTIC DFES_FaultTyp.DFC_TelltlCooltPlaus_C "" VALUE 0x8024E0AA Val_Wu8 255.0 DFES_OneToOne 0.00 255.0 FORMAT "%5.1" /end CHARACTERISTIC
/begin CHARACTERISTIC DFES_FaultTyp.DFC_MRlyOL_C "" VALUE 0x8024E0AB Val_Wu8 255.0 DFES_OneToOne 0.00 255.0 FORMAT "%5.1" /end CHARACTERISTIC
/begin CHARACTERISTIC DFES_FaultTyp.DFC_MRlySCB_C "" VALUE 0x8024E0AC Val_Wu8 255.0 DFES_OneToOne 0.00 255.0 FORMAT "%5.1" /end CHARACTERISTIC
/begin CHARACTERISTIC DFES_FaultTyp.DFC_MRlySCG_C "" VALUE 0x8024E0AD Val_Wu8 255.0 DFES_OneToOne 0.00 255.0 FORMAT "%5.1" /end CHARACTERISTIC
/begin CHARACTERISTIC DFES_FaultTyp.DFC_SSpMon1_C "" VALUE 0x8024E0AE Val_Wu8 255.0 DFES_OneToOne 0.00 255.0 FORMAT "%5.1" /end CHARACTERISTIC
/begin CHARACTERISTIC DFES_FaultTyp.DFC_SSpMon1OV_C "" VALUE 0x8024E0AF Val_Wu8 255.0 DFES_OneToOne 0.00 255.0 FORMAT "%5.1" /end CHARACTERISTIC
/begin CHARACTERISTIC DFES_FaultTyp.DFC_SSpMon1SCG_C "" VALUE 0x8024E0B0 Val_Wu8 255.0 DFES_OneToOne 0.00 255.0 FORMAT "%5.1" /end CHARACTERISTIC
/begin CHARACTERISTIC DFES_FaultTyp.DFC_SSpMon1UV_C "" VALUE 0x8024E0B1 Val_Wu8 255.0 DFES_OneToOne 0.00 255.0 FORMAT "%5.1" /end CHARACTERISTIC
/begin CHARACTERISTIC DFES_FaultTyp.DFC_SSpMon2_C "" VALUE 0x8024E0B2 Val_Wu8 255.0 DFES_OneToOne 0.00 255.0 FORMAT "%5.1" /end CHARACTERISTIC
/begin CHARACTERISTIC DFES_FaultTyp.DFC_SSpMon2OV_C "" VALUE 0x8024E0B3 Val_Wu8 255.0 DFES_OneToOne 0.00 255.0 FORMAT "%5.1" /end CHARACTERISTIC
/begin CHARACTERISTIC DFES_FaultTyp.DFC_SSpMon2SCG_C "" VALUE 0x8024E0B4 Val_Wu8 255.0 DFES_OneToOne 0.00 255.0 FORMAT "%5.1" /end CHARACTERISTIC
/begin CHARACTERISTIC DFES_FaultTyp.DFC_SSpMon2UV_C "" VALUE 0x8024E0B5 Val_Wu8 255.0 DFES_OneToOne 0.00 255.0 FORMAT "%5.1" /end CHARACTERISTIC
/begin CHARACTERISTIC DFES_FaultTyp.DFC_SSpMon3_C "" VALUE 0x8024E0B6 Val_Wu8 255.0 DFES_OneToOne 0.00 255.0 FORMAT "%5.1" /end CHARACTERISTIC
/begin CHARACTERISTIC DFES_FaultTyp.DFC_SSpMon3OV_C "" VALUE 0x8024E0B7 Val_Wu8 255.0 DFES_OneToOne 0.00 255.0 FORMAT "%5.1" /end CHARACTERISTIC
/begin CHARACTERISTIC DFES_FaultTyp.DFC_SSpMon3SCG_C "" VALUE 0x8024E0B8 Val_Wu8 255.0 DFES_OneToOne 0.00 255.0 FORMAT "%5.1" /end CHARACTERISTIC
/begin CHARACTERISTIC DFES_FaultTyp.DFC_SSpMon3UV_C "" VALUE 0x8024E0B9 Val_Wu8 255.0 DFES_OneToOne 0.00 255.0 FORMAT "%5.1" /end CHARACTERISTIC
/begin CHARACTERISTIC DFES_FaultTyp.DFC_CANSM_E_BUS_OFF_NETWORK_HSN1_CAN_C "" VALUE 0x8024E0BA Val_Wu8 255.0 DFES_OneToOne 0.00 255.0 FORMAT "%5.1" /end CHARACTERISTIC
/begin CHARACTERISTIC DFES_FaultTyp.DFC_CANSM_E_BUS_OFF_NETWORK_HSN3_CAN_C "" VALUE 0x8024E0BB Val_Wu8 255.0 DFES_OneToOne 0.00 255.0 FORMAT "%5.1" /end CHARACTERISTIC
/begin CHARACTERISTIC DFES_FaultTyp.DFC_CANSM_E_BUS_OFF_NETWORK_HSN4_CAN_C "" VALUE 0x8024E0BC Val_Wu8 255.0 DFES_OneToOne 0.00 255.0 FORMAT "%5.1" /end CHARACTERISTIC
/begin CHARACTERISTIC DFES_FaultTyp.DFC_CANSM_E_BUS_OFF_NETWORK_XCP_CAN_C "" VALUE 0x8024E0BD Val_Wu8 255.0 DFES_OneToOne 0.00 255.0 FORMAT "%5.1" /end CHARACTERISTIC
/begin CHARACTERISTIC DFES_FaultTyp.DFC_CANTRCV_E_NO_TRCV_CONTROL_0_C "" VALUE 0x8024E0BE Val_Wu8 255.0 DFES_OneToOne 0.00 255.0 FORMAT "%5.1" /end CHARACTERISTIC
/begin CHARACTERISTIC DFES_FaultTyp.DFC_CAN_E_TIMEOUT_C "" VALUE 0x8024E0BF Val_Wu8 255.0 DFES_OneToOne 0.00 255.0 FORMAT "%5.1" /end CHARACTERISTIC
/begin CHARACTERISTIC DFES_FaultTyp.DFC_COMM_E_NET_START_IND_CHANNEL_0_C "" VALUE 0x8024E0C0 Val_Wu8 255.0 DFES_OneToOne 0.00 255.0 FORMAT "%5.1" /end CHARACTERISTIC
/begin CHARACTERISTIC DFES_FaultTyp.DFC_COMM_E_NET_START_IND_CHANNEL_1_C "" VALUE 0x8024E0C1 Val_Wu8 255.0 DFES_OneToOne 0.00 255.0 FORMAT "%5.1" /end CHARACTERISTIC
/begin CHARACTERISTIC DFES_FaultTyp.DFC_COMM_E_NET_START_IND_CHANNEL_2_C "" VALUE 0x8024E0C2 Val_Wu8 255.0 DFES_OneToOne 0.00 255.0 FORMAT "%5.1" /end CHARACTERISTIC
/begin CHARACTERISTIC DFES_FaultTyp.DFC_COMM_E_NET_START_IND_CHANNEL_3_C "" VALUE 0x8024E0C3 Val_Wu8 255.0 DFES_OneToOne 0.00 255.0 FORMAT "%5.1" /end CHARACTERISTIC
/begin CHARACTERISTIC DFES_FaultTyp.DFC_COMM_E_NET_START_IND_CHANNEL_4_C "" VALUE 0x8024E0C4 Val_Wu8 255.0 DFES_OneToOne 0.00 255.0 FORMAT "%5.1" /end CHARACTERISTIC
/begin CHARACTERISTIC DFES_FaultTyp.DFC_COMM_E_NET_START_IND_CHANNEL_5_C "" VALUE 0x8024E0C5 Val_Wu8 255.0 DFES_OneToOne 0.00 255.0 FORMAT "%5.1" /end CHARACTERISTIC
/begin CHARACTERISTIC DFES_FaultTyp.DFC_LIN_E_TIMEOUT_C "" VALUE 0x8024E0C6 Val_Wu8 255.0 DFES_OneToOne 0.00 255.0 FORMAT "%5.1" /end CHARACTERISTIC
/begin CHARACTERISTIC DFES_FaultTyp.DFC_rba_EcuCtrl_TOMaxProlg_C "" VALUE 0x8024E0C7 Val_Wu8 255.0 DFES_OneToOne 0.00 255.0 FORMAT "%5.1" /end CHARACTERISTIC
/begin CHARACTERISTIC DFES_FaultTyp.DFC_rba_EcuCtrl_TOMaxShutDwn_C "" VALUE 0x8024E0C8 Val_Wu8 255.0 DFES_OneToOne 0.00 255.0 FORMAT "%5.1" /end CHARACTERISTIC
/begin CHARACTERISTIC DFES_FaultTyp.DFC_rba_MultiStackTrace_Threshold_C "" VALUE 0x8024E0C9 Val_Wu8 255.0 DFES_OneToOne 0.00 255.0 FORMAT "%5.1" /end CHARACTERISTIC
/begin CHARACTERISTIC DFES_FaultTyp.DFC_rba_SyC_CustStates_Degraded_disord_Event_C "" VALUE 0x8024E0CA Val_Wu8 255.0 DFES_OneToOne 0.00 255.0 FORMAT "%5.1" /end CHARACTERISTIC
/begin CHARACTERISTIC DFES_FaultTyp.DFC_rba_SyC_CustStates_Degraded_incst_Event_C "" VALUE 0x8024E0CB Val_Wu8 255.0 DFES_OneToOne 0.00 255.0 FORMAT "%5.1" /end CHARACTERISTIC
/begin CHARACTERISTIC DFES_FaultTyp.DFC_rba_SyC_CustStates_TransNoWakReq_Event_C "" VALUE 0x8024E0CC Val_Wu8 255.0 DFES_OneToOne 0.00 255.0 FORMAT "%5.1" /end CHARACTERISTIC
/begin CHARACTERISTIC DFES_FaultTyp.DFC_RBA_IOEXTLIB_KEEPALIVE_DRV_C "" VALUE 0x8024E0CD Val_Wu8 255.0 DFES_OneToOne 0.00 255.0 FORMAT "%5.1" /end CHARACTERISTIC
/begin CHARACTERISTIC DFES_FaultTyp.DFC_RBA_IOEXTLIB_KEEPALIVE_INI_C "" VALUE 0x8024E0CE Val_Wu8 255.0 DFES_OneToOne 0.00 255.0 FORMAT "%5.1" /end CHARACTERISTIC
/begin CHARACTERISTIC DFES_FaultTyp.DFC_rba_IoSigRtc_StopCounter_C "" VALUE 0x8024E0CF Val_Wu8 255.0 DFES_OneToOne 0.00 255.0 FORMAT "%5.1" /end CHARACTERISTIC
/begin CHARACTERISTIC DFES_FaultTyp.DFC_rba_MRly_Diag_Stk_Event_C "" VALUE 0x8024E0D0 Val_Wu8 255.0 DFES_OneToOne 0.00 255.0 FORMAT "%5.1" /end CHARACTERISTIC
/begin CHARACTERISTIC DFES_FaultTyp.DFC_rba_MemDiag_MemReadErr_C "" VALUE 0x8024E0D1 Val_Wu8 255.0 DFES_OneToOne 0.00 255.0 FORMAT "%5.1" /end CHARACTERISTIC
/begin CHARACTERISTIC DFES_FaultTyp.DFC_rba_MemDiag_MemWrErr_C "" VALUE 0x8024E0D2 Val_Wu8 255.0 DFES_OneToOne 0.00 255.0 FORMAT "%5.1" /end CHARACTERISTIC
/begin CHARACTERISTIC DFES_FaultTyp.DFC_rba_SyC_IrrSwOffTrigEngRun_Event_C "" VALUE 0x8024E0D3 Val_Wu8 255.0 DFES_OneToOne 0.00 255.0 FORMAT "%5.1" /end CHARACTERISTIC
/begin CHARACTERISTIC DFES_FaultTyp.DFC_AcChrgrIntkTSRCMax_C "" VALUE 0x8024E0D4 Val_Wu8 255.0 DFES_OneToOne 0.00 255.0 FORMAT "%5.1" /end CHARACTERISTIC
/begin CHARACTERISTIC DFES_FaultTyp.DFC_AcChrgrIntkTTmpErr_C "" VALUE 0x8024E0D5 Val_Wu8 255.0 DFES_OneToOne 0.00 255.0 FORMAT "%5.1" /end CHARACTERISTIC
/begin CHARACTERISTIC DFES_FaultTyp.DFC_AcFlt_C "" VALUE 0x8024E0D6 Val_Wu8 255.0 DFES_OneToOne 0.00 255.0 FORMAT "%5.1" /end CHARACTERISTIC
/begin CHARACTERISTIC DFES_FaultTyp.DFC_AppAllSnsrDfct_C "" VALUE 0x8024E0D7 Val_Wu8 255.0 DFES_OneToOne 0.00 255.0 FORMAT "%5.1" /end CHARACTERISTIC
/begin CHARACTERISTIC DFES_FaultTyp.DFC_BattUPwrFail_C "" VALUE 0x8024E0D8 Val_Wu8 255.0 DFES_OneToOne 0.00 255.0 FORMAT "%5.1" /end CHARACTERISTIC
/begin CHARACTERISTIC DFES_FaultTyp.DFC_BrkBstBkupOvrn_C "" VALUE 0x8024E0D9 Val_Wu8 255.0 DFES_OneToOne 0.00 255.0 FORMAT "%5.1" /end CHARACTERISTIC
/begin CHARACTERISTIC DFES_FaultTyp.DFC_BrkBstPmpOvld_C "" VALUE 0x8024E0DA Val_Wu8 255.0 DFES_OneToOne 0.00 255.0 FORMAT "%5.1" /end CHARACTERISTIC
/begin CHARACTERISTIC DFES_FaultTyp.DFC_BrkPlausChk_C "" VALUE 0x8024E0DB Val_Wu8 255.0 DFES_OneToOne 0.00 255.0 FORMAT "%5.1" /end CHARACTERISTIC
/begin CHARACTERISTIC DFES_FaultTyp.DFC_CbnHeatgSwtTmpErr_C "" VALUE 0x8024E0DC Val_Wu8 255.0 DFES_OneToOne 0.00 255.0 FORMAT "%5.1" /end CHARACTERISTIC
/begin CHARACTERISTIC DFES_FaultTyp.DFC_CcsPwrLineChpVccSRCMax_C "" VALUE 0x8024E0DD Val_Wu8 255.0 DFES_OneToOne 0.00 255.0 FORMAT "%5.1" /end CHARACTERISTIC
/begin CHARACTERISTIC DFES_FaultTyp.DFC_CcsPwrLineChpVccTmpErr_C "" VALUE 0x8024E0DE Val_Wu8 255.0 DFES_OneToOne 0.00 255.0 FORMAT "%5.1" /end CHARACTERISTIC
/begin CHARACTERISTIC DFES_FaultTyp.DFC_CcsPwrLineComChpTSRCMax_C "" VALUE 0x8024E0DF Val_Wu8 255.0 DFES_OneToOne 0.00 255.0 FORMAT "%5.1" /end CHARACTERISTIC
/begin CHARACTERISTIC DFES_FaultTyp.DFC_CcsPwrLineComChpTTmpErr_C "" VALUE 0x8024E0E0 Val_Wu8 255.0 DFES_OneToOne 0.00 255.0 FORMAT "%5.1" /end CHARACTERISTIC
/begin CHARACTERISTIC DFES_FaultTyp.DFC_ChgrPlugCtpCarrFrqErr_C "" VALUE 0x8024E0E1 Val_Wu8 255.0 DFES_OneToOne 0.00 255.0 FORMAT "%5.1" /end CHARACTERISTIC
/begin CHARACTERISTIC DFES_FaultTyp.DFC_ChgrPlugCtpSwtStuckClsd_C "" VALUE 0x8024E0E2 Val_Wu8 255.0 DFES_OneToOne 0.00 255.0 FORMAT "%5.1" /end CHARACTERISTIC
/begin CHARACTERISTIC DFES_FaultTyp.DFC_ChgrPlugCtpSwtStuckOpen_C "" VALUE 0x8024E0E3 Val_Wu8 255.0 DFES_OneToOne 0.00 255.0 FORMAT "%5.1" /end CHARACTERISTIC
/begin CHARACTERISTIC DFES_FaultTyp.DFC_ChgrPlugCtpUErrHi_C "" VALUE 0x8024E0E4 Val_Wu8 255.0 DFES_OneToOne 0.00 255.0 FORMAT "%5.1" /end CHARACTERISTIC
/begin CHARACTERISTIC DFES_FaultTyp.DFC_ChgrPlugPxp1SrcErr_C "" VALUE 0x8024E0E5 Val_Wu8 255.0 DFES_OneToOne 0.00 255.0 FORMAT "%5.1" /end CHARACTERISTIC
/begin CHARACTERISTIC DFES_FaultTyp.DFC_ChrgCntctAllWldd_C "" VALUE 0x8024E0E6 Val_Wu8 255.0 DFES_OneToOne 0.00 255.0 FORMAT "%5.1" /end CHARACTERISTIC
/begin CHARACTERISTIC DFES_FaultTyp.DFC_ChrgCntctNegOperErr_C "" VALUE 0x8024E0E7 Val_Wu8 255.0 DFES_OneToOne 0.00 255.0 FORMAT "%5.1" /end CHARACTERISTIC
/begin CHARACTERISTIC DFES_FaultTyp.DFC_ChrgCntctNegOperWarn_C "" VALUE 0x8024E0E8 Val_Wu8 255.0 DFES_OneToOne 0.00 255.0 FORMAT "%5.1" /end CHARACTERISTIC
/begin CHARACTERISTIC DFES_FaultTyp.DFC_ChrgCntctNegWldd_C "" VALUE 0x8024E0E9 Val_Wu8 255.0 DFES_OneToOne 0.00 255.0 FORMAT "%5.1" /end CHARACTERISTIC
/begin CHARACTERISTIC DFES_FaultTyp.DFC_ChrgCntctPosOperErr_C "" VALUE 0x8024E0EA Val_Wu8 255.0 DFES_OneToOne 0.00 255.0 FORMAT "%5.1" /end CHARACTERISTIC
/begin CHARACTERISTIC DFES_FaultTyp.DFC_ChrgCntctPosOperWarn_C "" VALUE 0x8024E0EB Val_Wu8 255.0 DFES_OneToOne 0.00 255.0 FORMAT "%5.1" /end CHARACTERISTIC
/begin CHARACTERISTIC DFES_FaultTyp.DFC_ChrgCntctPosWldd_C "" VALUE 0x8024E0EC Val_Wu8 255.0 DFES_OneToOne 0.00 255.0 FORMAT "%5.1" /end CHARACTERISTIC
/begin CHARACTERISTIC DFES_FaultTyp.DFC_ChrgCntctStuckOpen_C "" VALUE 0x8024E0ED Val_Wu8 255.0 DFES_OneToOne 0.00 255.0 FORMAT "%5.1" /end CHARACTERISTIC
/begin CHARACTERISTIC DFES_FaultTyp.DFC_ChrgPlgIntlckFaild_C "" VALUE 0x8024E0EE Val_Wu8 255.0 DFES_OneToOne 0.00 255.0 FORMAT "%5.1" /end CHARACTERISTIC
/begin CHARACTERISTIC DFES_FaultTyp.DFC_ChrgnUnplRqrd_C "" VALUE 0x8024E0EF Val_Wu8 255.0 DFES_OneToOne 0.00 255.0 FORMAT "%5.1" /end CHARACTERISTIC
/begin CHARACTERISTIC DFES_FaultTyp.DFC_CoElMOffsCalibActv01_C "" VALUE 0x8024E0F0 Val_Wu8 255.0 DFES_OneToOne 0.00 255.0 FORMAT "%5.1" /end CHARACTERISTIC
/begin CHARACTERISTIC DFES_FaultTyp.DFC_CtPSwtDiagSRCMax_C "" VALUE 0x8024E0F1 Val_Wu8 255.0 DFES_OneToOne 0.00 255.0 FORMAT "%5.1" /end CHARACTERISTIC
/begin CHARACTERISTIC DFES_FaultTyp.DFC_CtPSwtDiagTmpErr_C "" VALUE 0x8024E0F2 Val_Wu8 255.0 DFES_OneToOne 0.00 255.0 FORMAT "%5.1" /end CHARACTERISTIC
/begin CHARACTERISTIC DFES_FaultTyp.DFC_CtpCarrFrqTmpErr_C "" VALUE 0x8024E0F3 Val_Wu8 255.0 DFES_OneToOne 0.00 255.0 FORMAT "%5.1" /end CHARACTERISTIC
/begin CHARACTERISTIC DFES_FaultTyp.DFC_DcChrgrIntkT2SRCMax_C "" VALUE 0x8024E0F4 Val_Wu8 255.0 DFES_OneToOne 0.00 255.0 FORMAT "%5.1" /end CHARACTERISTIC
/begin CHARACTERISTIC DFES_FaultTyp.DFC_DcChrgrIntkT2TmpErr_C "" VALUE 0x8024E0F5 Val_Wu8 255.0 DFES_OneToOne 0.00 255.0 FORMAT "%5.1" /end CHARACTERISTIC
/begin CHARACTERISTIC DFES_FaultTyp.DFC_DcChrgrIntkTSRCMax_C "" VALUE 0x8024E0F6 Val_Wu8 255.0 DFES_OneToOne 0.00 255.0 FORMAT "%5.1" /end CHARACTERISTIC
/begin CHARACTERISTIC DFES_FaultTyp.DFC_DcChrgrIntkTTmpErr_C "" VALUE 0x8024E0F7 Val_Wu8 255.0 DFES_OneToOne 0.00 255.0 FORMAT "%5.1" /end CHARACTERISTIC
/begin CHARACTERISTIC DFES_FaultTyp.DFC_EChrDvPlinCntrThdExcdd_C "" VALUE 0x8024E0F8 Val_Wu8 255.0 DFES_OneToOne 0.00 255.0 FORMAT "%5.1" /end CHARACTERISTIC
/begin CHARACTERISTIC DFES_FaultTyp.DFC_EemDiagCtctrClsTout_C "" VALUE 0x8024E0F9 Val_Wu8 255.0 DFES_OneToOne 0.00 255.0 FORMAT "%5.1" /end CHARACTERISTIC
/begin CHARACTERISTIC DFES_FaultTyp.DFC_EemDiagDcdcOffTOut_C "" VALUE 0x8024E0FA Val_Wu8 255.0 DFES_OneToOne 0.00 255.0 FORMAT "%5.1" /end CHARACTERISTIC
/begin CHARACTERISTIC DFES_FaultTyp.DFC_EemDiagHvCnsrOffTOut_C "" VALUE 0x8024E0FB Val_Wu8 255.0 DFES_OneToOne 0.00 255.0 FORMAT "%5.1" /end CHARACTERISTIC
/begin CHARACTERISTIC DFES_FaultTyp.DFC_EemDiagHvbOffTOut_C "" VALUE 0x8024E0FC Val_Wu8 255.0 DFES_OneToOne 0.00 255.0 FORMAT "%5.1" /end CHARACTERISTIC
/begin CHARACTERISTIC DFES_FaultTyp.DFC_FanSpdSRCMax_C "" VALUE 0x8024E0FD Val_Wu8 255.0 DFES_OneToOne 0.00 255.0 FORMAT "%5.1" /end CHARACTERISTIC
/begin CHARACTERISTIC DFES_FaultTyp.DFC_FanSpdTmpErr_C "" VALUE 0x8024E0FE Val_Wu8 255.0 DFES_OneToOne 0.00 255.0 FORMAT "%5.1" /end CHARACTERISTIC
/begin CHARACTERISTIC DFES_FaultTyp.DFC_FreonPSRCMax_C "" VALUE 0x8024E0FF Val_Wu8 255.0 DFES_OneToOne 0.00 255.0 FORMAT "%5.1" /end CHARACTERISTIC
/begin CHARACTERISTIC DFES_FaultTyp.DFC_FreonPTmpErr_C "" VALUE 0x8024E100 Val_Wu8 255.0 DFES_OneToOne 0.00 255.0 FORMAT "%5.1" /end CHARACTERISTIC
/begin CHARACTERISTIC DFES_FaultTyp.DFC_HeatrCoreTSRCMax_C "" VALUE 0x8024E101 Val_Wu8 255.0 DFES_OneToOne 0.00 255.0 FORMAT "%5.1" /end CHARACTERISTIC
/begin CHARACTERISTIC DFES_FaultTyp.DFC_HeatrCoreTTmpErr_C "" VALUE 0x8024E102 Val_Wu8 255.0 DFES_OneToOne 0.00 255.0 FORMAT "%5.1" /end CHARACTERISTIC
/begin CHARACTERISTIC DFES_FaultTyp.DFC_HvGridSocMinLim_C "" VALUE 0x8024E103 Val_Wu8 255.0 DFES_OneToOne 0.00 255.0 FORMAT "%5.1" /end CHARACTERISTIC
/begin CHARACTERISTIC DFES_FaultTyp.DFC_HvacBlwrFrntFlt_C "" VALUE 0x8024E104 Val_Wu8 255.0 DFES_OneToOne 0.00 255.0 FORMAT "%5.1" /end CHARACTERISTIC
/begin CHARACTERISTIC DFES_FaultTyp.DFC_HvacEvapElecFlt_C "" VALUE 0x8024E105 Val_Wu8 255.0 DFES_OneToOne 0.00 255.0 FORMAT "%5.1" /end CHARACTERISTIC
/begin CHARACTERISTIC DFES_FaultTyp.DFC_HvacEvapElecFltGnd_C "" VALUE 0x8024E106 Val_Wu8 255.0 DFES_OneToOne 0.00 255.0 FORMAT "%5.1" /end CHARACTERISTIC
/begin CHARACTERISTIC DFES_FaultTyp.DFC_HvacKnobPosnFlt_C "" VALUE 0x8024E107 Val_Wu8 255.0 DFES_OneToOne 0.00 255.0 FORMAT "%5.1" /end CHARACTERISTIC
/begin CHARACTERISTIC DFES_FaultTyp.DFC_InvBinID_C "" VALUE 0x8024E108 Val_Wu8 255.0 DFES_OneToOne 0.00 255.0 FORMAT "%5.1" /end CHARACTERISTIC
/begin CHARACTERISTIC DFES_FaultTyp.DFC_InvCalID_C "" VALUE 0x8024E109 Val_Wu8 255.0 DFES_OneToOne 0.00 255.0 FORMAT "%5.1" /end CHARACTERISTIC
/begin CHARACTERISTIC DFES_FaultTyp.DFC_InvErotan_C "" VALUE 0x8024E10A Val_Wu8 255.0 DFES_OneToOne 0.00 255.0 FORMAT "%5.1" /end CHARACTERISTIC
/begin CHARACTERISTIC DFES_FaultTyp.DFC_InvVinID_C "" VALUE 0x8024E10B Val_Wu8 255.0 DFES_OneToOne 0.00 255.0 FORMAT "%5.1" /end CHARACTERISTIC
/begin CHARACTERISTIC DFES_FaultTyp.DFC_MOXEMM_SMU_ALM0_0_C "" VALUE 0x8024E10C Val_Wu8 255.0 DFES_OneToOne 0.00 255.0 FORMAT "%5.1" /end CHARACTERISTIC
/begin CHARACTERISTIC DFES_FaultTyp.DFC_MOXEMM_SMU_ALM0_1_C "" VALUE 0x8024E10D Val_Wu8 255.0 DFES_OneToOne 0.00 255.0 FORMAT "%5.1" /end CHARACTERISTIC
/begin CHARACTERISTIC DFES_FaultTyp.DFC_MOXEMM_SMU_ALM0_10_C "" VALUE 0x8024E10E Val_Wu8 255.0 DFES_OneToOne 0.00 255.0 FORMAT "%5.1" /end CHARACTERISTIC
/begin CHARACTERISTIC DFES_FaultTyp.DFC_MOXEMM_SMU_ALM0_11_C "" VALUE 0x8024E10F Val_Wu8 255.0 DFES_OneToOne 0.00 255.0 FORMAT "%5.1" /end CHARACTERISTIC
/begin CHARACTERISTIC DFES_FaultTyp.DFC_MOXEMM_SMU_ALM0_13_C "" VALUE 0x8024E110 Val_Wu8 255.0 DFES_OneToOne 0.00 255.0 FORMAT "%5.1" /end CHARACTERISTIC
/begin CHARACTERISTIC DFES_FaultTyp.DFC_MOXEMM_SMU_ALM0_14_C "" VALUE 0x8024E111 Val_Wu8 255.0 DFES_OneToOne 0.00 255.0 FORMAT "%5.1" /end CHARACTERISTIC
/begin CHARACTERISTIC DFES_FaultTyp.DFC_MOXEMM_SMU_ALM0_2_C "" VALUE 0x8024E112 Val_Wu8 255.0 DFES_OneToOne 0.00 255.0 FORMAT "%5.1" /end CHARACTERISTIC
/begin CHARACTERISTIC DFES_FaultTyp.DFC_MOXEMM_SMU_ALM0_22_C "" VALUE 0x8024E113 Val_Wu8 255.0 DFES_OneToOne 0.00 255.0 FORMAT "%5.1" /end CHARACTERISTIC
/begin CHARACTERISTIC DFES_FaultTyp.DFC_MOXEMM_SMU_ALM0_23_C "" VALUE 0x8024E114 Val_Wu8 255.0 DFES_OneToOne 0.00 255.0 FORMAT "%5.1" /end CHARACTERISTIC
/begin CHARACTERISTIC DFES_FaultTyp.DFC_MOXEMM_SMU_ALM0_4_C "" VALUE 0x8024E115 Val_Wu8 255.0 DFES_OneToOne 0.00 255.0 FORMAT "%5.1" /end CHARACTERISTIC
/begin CHARACTERISTIC DFES_FaultTyp.DFC_MOXEMM_SMU_ALM0_5_C "" VALUE 0x8024E116 Val_Wu8 255.0 DFES_OneToOne 0.00 255.0 FORMAT "%5.1" /end CHARACTERISTIC
/begin CHARACTERISTIC DFES_FaultTyp.DFC_MOXEMM_SMU_ALM0_7_C "" VALUE 0x8024E117 Val_Wu8 255.0 DFES_OneToOne 0.00 255.0 FORMAT "%5.1" /end CHARACTERISTIC
/begin CHARACTERISTIC DFES_FaultTyp.DFC_MOXEMM_SMU_ALM0_8_C "" VALUE 0x8024E118 Val_Wu8 255.0 DFES_OneToOne 0.00 255.0 FORMAT "%5.1" /end CHARACTERISTIC
/begin CHARACTERISTIC DFES_FaultTyp.DFC_MOXEMM_SMU_ALM10_16_C "" VALUE 0x8024E119 Val_Wu8 255.0 DFES_OneToOne 0.00 255.0 FORMAT "%5.1" /end CHARACTERISTIC
/begin CHARACTERISTIC DFES_FaultTyp.DFC_MOXEMM_SMU_ALM10_17_C "" VALUE 0x8024E11A Val_Wu8 255.0 DFES_OneToOne 0.00 255.0 FORMAT "%5.1" /end CHARACTERISTIC
/begin CHARACTERISTIC DFES_FaultTyp.DFC_MOXEMM_SMU_ALM10_21_C "" VALUE 0x8024E11B Val_Wu8 255.0 DFES_OneToOne 0.00 255.0 FORMAT "%5.1" /end CHARACTERISTIC
/begin CHARACTERISTIC DFES_FaultTyp.DFC_MOXEMM_SMU_ALM11_0_C "" VALUE 0x8024E11C Val_Wu8 255.0 DFES_OneToOne 0.00 255.0 FORMAT "%5.1" /end CHARACTERISTIC
/begin CHARACTERISTIC DFES_FaultTyp.DFC_MOXEMM_SMU_ALM11_1_C "" VALUE 0x8024E11D Val_Wu8 255.0 DFES_OneToOne 0.00 255.0 FORMAT "%5.1" /end CHARACTERISTIC
/begin CHARACTERISTIC DFES_FaultTyp.DFC_MOXEMM_SMU_ALM11_2_C "" VALUE 0x8024E11E Val_Wu8 255.0 DFES_OneToOne 0.00 255.0 FORMAT "%5.1" /end CHARACTERISTIC
/begin CHARACTERISTIC DFES_FaultTyp.DFC_MOXEMM_SMU_ALM11_3_C "" VALUE 0x8024E11F Val_Wu8 255.0 DFES_OneToOne 0.00 255.0 FORMAT "%5.1" /end CHARACTERISTIC
/begin CHARACTERISTIC DFES_FaultTyp.DFC_MOXEMM_SMU_ALM11_4_C "" VALUE 0x8024E120 Val_Wu8 255.0 DFES_OneToOne 0.00 255.0 FORMAT "%5.1" /end CHARACTERISTIC
/begin CHARACTERISTIC DFES_FaultTyp.DFC_MOXEMM_SMU_ALM11_5_C "" VALUE 0x8024E121 Val_Wu8 255.0 DFES_OneToOne 0.00 255.0 FORMAT "%5.1" /end CHARACTERISTIC
/begin CHARACTERISTIC DFES_FaultTyp.DFC_MOXEMM_SMU_ALM11_8_C "" VALUE 0x8024E122 Val_Wu8 255.0 DFES_OneToOne 0.00 255.0 FORMAT "%5.1" /end CHARACTERISTIC
/begin CHARACTERISTIC DFES_FaultTyp.DFC_MOXEMM_SMU_ALM11_9_C "" VALUE 0x8024E123 Val_Wu8 255.0 DFES_OneToOne 0.00 255.0 FORMAT "%5.1" /end CHARACTERISTIC
/begin CHARACTERISTIC DFES_FaultTyp.DFC_MOXEMM_SMU_ALM1_0_C "" VALUE 0x8024E124 Val_Wu8 255.0 DFES_OneToOne 0.00 255.0 FORMAT "%5.1" /end CHARACTERISTIC
/begin CHARACTERISTIC DFES_FaultTyp.DFC_MOXEMM_SMU_ALM1_1_C "" VALUE 0x8024E125 Val_Wu8 255.0 DFES_OneToOne 0.00 255.0 FORMAT "%5.1" /end CHARACTERISTIC
/begin CHARACTERISTIC DFES_FaultTyp.DFC_MOXEMM_SMU_ALM1_10_C "" VALUE 0x8024E126 Val_Wu8 255.0 DFES_OneToOne 0.00 255.0 FORMAT "%5.1" /end CHARACTERISTIC
/begin CHARACTERISTIC DFES_FaultTyp.DFC_MOXEMM_SMU_ALM1_11_C "" VALUE 0x8024E127 Val_Wu8 255.0 DFES_OneToOne 0.00 255.0 FORMAT "%5.1" /end CHARACTERISTIC
/begin CHARACTERISTIC DFES_FaultTyp.DFC_MOXEMM_SMU_ALM1_13_C "" VALUE 0x8024E128 Val_Wu8 255.0 DFES_OneToOne 0.00 255.0 FORMAT "%5.1" /end CHARACTERISTIC
/begin CHARACTERISTIC DFES_FaultTyp.DFC_MOXEMM_SMU_ALM1_14_C "" VALUE 0x8024E129 Val_Wu8 255.0 DFES_OneToOne 0.00 255.0 FORMAT "%5.1" /end CHARACTERISTIC
/begin CHARACTERISTIC DFES_FaultTyp.DFC_MOXEMM_SMU_ALM1_2_C "" VALUE 0x8024E12A Val_Wu8 255.0 DFES_OneToOne 0.00 255.0 FORMAT "%5.1" /end CHARACTERISTIC
/begin CHARACTERISTIC DFES_FaultTyp.DFC_MOXEMM_SMU_ALM1_22_C "" VALUE 0x8024E12B Val_Wu8 255.0 DFES_OneToOne 0.00 255.0 FORMAT "%5.1" /end CHARACTERISTIC
/begin CHARACTERISTIC DFES_FaultTyp.DFC_MOXEMM_SMU_ALM1_23_C "" VALUE 0x8024E12C Val_Wu8 255.0 DFES_OneToOne 0.00 255.0 FORMAT "%5.1" /end CHARACTERISTIC
/begin CHARACTERISTIC DFES_FaultTyp.DFC_MOXEMM_SMU_ALM1_4_C "" VALUE 0x8024E12D Val_Wu8 255.0 DFES_OneToOne 0.00 255.0 FORMAT "%5.1" /end CHARACTERISTIC
/begin CHARACTERISTIC DFES_FaultTyp.DFC_MOXEMM_SMU_ALM1_5_C "" VALUE 0x8024E12E Val_Wu8 255.0 DFES_OneToOne 0.00 255.0 FORMAT "%5.1" /end CHARACTERISTIC
/begin CHARACTERISTIC DFES_FaultTyp.DFC_MOXEMM_SMU_ALM1_7_C "" VALUE 0x8024E12F Val_Wu8 255.0 DFES_OneToOne 0.00 255.0 FORMAT "%5.1" /end CHARACTERISTIC
/begin CHARACTERISTIC DFES_FaultTyp.DFC_MOXEMM_SMU_ALM1_8_C "" VALUE 0x8024E130 Val_Wu8 255.0 DFES_OneToOne 0.00 255.0 FORMAT "%5.1" /end CHARACTERISTIC
/begin CHARACTERISTIC DFES_FaultTyp.DFC_MOXEMM_SMU_ALM21_0_C "" VALUE 0x8024E131 Val_Wu8 255.0 DFES_OneToOne 0.00 255.0 FORMAT "%5.1" /end CHARACTERISTIC
/begin CHARACTERISTIC DFES_FaultTyp.DFC_MOXEMM_SMU_ALM21_16_C "" VALUE 0x8024E132 Val_Wu8 255.0 DFES_OneToOne 0.00 255.0 FORMAT "%5.1" /end CHARACTERISTIC
/begin CHARACTERISTIC DFES_FaultTyp.DFC_MOXEMM_SMU_ALM21_3_C "" VALUE 0x8024E133 Val_Wu8 255.0 DFES_OneToOne 0.00 255.0 FORMAT "%5.1" /end CHARACTERISTIC
/begin CHARACTERISTIC DFES_FaultTyp.DFC_MOXEMM_SMU_ALM2_1_C "" VALUE 0x8024E134 Val_Wu8 255.0 DFES_OneToOne 0.00 255.0 FORMAT "%5.1" /end CHARACTERISTIC
/begin CHARACTERISTIC DFES_FaultTyp.DFC_MOXEMM_SMU_ALM2_10_C "" VALUE 0x8024E135 Val_Wu8 255.0 DFES_OneToOne 0.00 255.0 FORMAT "%5.1" /end CHARACTERISTIC
/begin CHARACTERISTIC DFES_FaultTyp.DFC_MOXEMM_SMU_ALM2_11_C "" VALUE 0x8024E136 Val_Wu8 255.0 DFES_OneToOne 0.00 255.0 FORMAT "%5.1" /end CHARACTERISTIC
/begin CHARACTERISTIC DFES_FaultTyp.DFC_MOXEMM_SMU_ALM2_13_C "" VALUE 0x8024E137 Val_Wu8 255.0 DFES_OneToOne 0.00 255.0 FORMAT "%5.1" /end CHARACTERISTIC
/begin CHARACTERISTIC DFES_FaultTyp.DFC_MOXEMM_SMU_ALM2_14_C "" VALUE 0x8024E138 Val_Wu8 255.0 DFES_OneToOne 0.00 255.0 FORMAT "%5.1" /end CHARACTERISTIC
/begin CHARACTERISTIC DFES_FaultTyp.DFC_MOXEMM_SMU_ALM2_22_C "" VALUE 0x8024E139 Val_Wu8 255.0 DFES_OneToOne 0.00 255.0 FORMAT "%5.1" /end CHARACTERISTIC
/begin CHARACTERISTIC DFES_FaultTyp.DFC_MOXEMM_SMU_ALM2_23_C "" VALUE 0x8024E13A Val_Wu8 255.0 DFES_OneToOne 0.00 255.0 FORMAT "%5.1" /end CHARACTERISTIC
/begin CHARACTERISTIC DFES_FaultTyp.DFC_MOXEMM_SMU_ALM2_4_C "" VALUE 0x8024E13B Val_Wu8 255.0 DFES_OneToOne 0.00 255.0 FORMAT "%5.1" /end CHARACTERISTIC
/begin CHARACTERISTIC DFES_FaultTyp.DFC_MOXEMM_SMU_ALM2_5_C "" VALUE 0x8024E13C Val_Wu8 255.0 DFES_OneToOne 0.00 255.0 FORMAT "%5.1" /end CHARACTERISTIC
/begin CHARACTERISTIC DFES_FaultTyp.DFC_MOXEMM_SMU_ALM2_7_C "" VALUE 0x8024E13D Val_Wu8 255.0 DFES_OneToOne 0.00 255.0 FORMAT "%5.1" /end CHARACTERISTIC
/begin CHARACTERISTIC DFES_FaultTyp.DFC_MOXEMM_SMU_ALM2_8_C "" VALUE 0x8024E13E Val_Wu8 255.0 DFES_OneToOne 0.00 255.0 FORMAT "%5.1" /end CHARACTERISTIC
/begin CHARACTERISTIC DFES_FaultTyp.DFC_MOXEMM_SMU_ALM6_0_C "" VALUE 0x8024E13F Val_Wu8 255.0 DFES_OneToOne 0.00 255.0 FORMAT "%5.1" /end CHARACTERISTIC
/begin CHARACTERISTIC DFES_FaultTyp.DFC_MOXEMM_SMU_ALM6_11_C "" VALUE 0x8024E140 Val_Wu8 255.0 DFES_OneToOne 0.00 255.0 FORMAT "%5.1" /end CHARACTERISTIC
/begin CHARACTERISTIC DFES_FaultTyp.DFC_MOXEMM_SMU_ALM6_12_C "" VALUE 0x8024E141 Val_Wu8 255.0 DFES_OneToOne 0.00 255.0 FORMAT "%5.1" /end CHARACTERISTIC
/begin CHARACTERISTIC DFES_FaultTyp.DFC_MOXEMM_SMU_ALM6_14_C "" VALUE 0x8024E142 Val_Wu8 255.0 DFES_OneToOne 0.00 255.0 FORMAT "%5.1" /end CHARACTERISTIC
/begin CHARACTERISTIC DFES_FaultTyp.DFC_MOXEMM_SMU_ALM6_15_C "" VALUE 0x8024E143 Val_Wu8 255.0 DFES_OneToOne 0.00 255.0 FORMAT "%5.1" /end CHARACTERISTIC
/begin CHARACTERISTIC DFES_FaultTyp.DFC_MOXEMM_SMU_ALM6_17_C "" VALUE 0x8024E144 Val_Wu8 255.0 DFES_OneToOne 0.00 255.0 FORMAT "%5.1" /end CHARACTERISTIC
/begin CHARACTERISTIC DFES_FaultTyp.DFC_MOXEMM_SMU_ALM6_18_C "" VALUE 0x8024E145 Val_Wu8 255.0 DFES_OneToOne 0.00 255.0 FORMAT "%5.1" /end CHARACTERISTIC
/begin CHARACTERISTIC DFES_FaultTyp.DFC_MOXEMM_SMU_ALM6_20_C "" VALUE 0x8024E146 Val_Wu8 255.0 DFES_OneToOne 0.00 255.0 FORMAT "%5.1" /end CHARACTERISTIC
/begin CHARACTERISTIC DFES_FaultTyp.DFC_MOXEMM_SMU_ALM6_21_C "" VALUE 0x8024E147 Val_Wu8 255.0 DFES_OneToOne 0.00 255.0 FORMAT "%5.1" /end CHARACTERISTIC
/begin CHARACTERISTIC DFES_FaultTyp.DFC_MOXEMM_SMU_ALM6_25_C "" VALUE 0x8024E148 Val_Wu8 255.0 DFES_OneToOne 0.00 255.0 FORMAT "%5.1" /end CHARACTERISTIC
/begin CHARACTERISTIC DFES_FaultTyp.DFC_MOXEMM_SMU_ALM6_4_C "" VALUE 0x8024E149 Val_Wu8 255.0 DFES_OneToOne 0.00 255.0 FORMAT "%5.1" /end CHARACTERISTIC
/begin CHARACTERISTIC DFES_FaultTyp.DFC_MOXEMM_SMU_ALM6_5_C "" VALUE 0x8024E14A Val_Wu8 255.0 DFES_OneToOne 0.00 255.0 FORMAT "%5.1" /end CHARACTERISTIC
/begin CHARACTERISTIC DFES_FaultTyp.DFC_MOXEMM_SMU_ALM6_7_C "" VALUE 0x8024E14B Val_Wu8 255.0 DFES_OneToOne 0.00 255.0 FORMAT "%5.1" /end CHARACTERISTIC
/begin CHARACTERISTIC DFES_FaultTyp.DFC_MOXEMM_SMU_ALM6_8_C "" VALUE 0x8024E14C Val_Wu8 255.0 DFES_OneToOne 0.00 255.0 FORMAT "%5.1" /end CHARACTERISTIC
/begin CHARACTERISTIC DFES_FaultTyp.DFC_MOXEMM_SMU_ALM7_1_C "" VALUE 0x8024E14D Val_Wu8 255.0 DFES_OneToOne 0.00 255.0 FORMAT "%5.1" /end CHARACTERISTIC
/begin CHARACTERISTIC DFES_FaultTyp.DFC_MOXEMM_SMU_ALM7_12_C "" VALUE 0x8024E14E Val_Wu8 255.0 DFES_OneToOne 0.00 255.0 FORMAT "%5.1" /end CHARACTERISTIC
/begin CHARACTERISTIC DFES_FaultTyp.DFC_MOXEMM_SMU_ALM7_13_C "" VALUE 0x8024E14F Val_Wu8 255.0 DFES_OneToOne 0.00 255.0 FORMAT "%5.1" /end CHARACTERISTIC
/begin CHARACTERISTIC DFES_FaultTyp.DFC_MOXEMM_SMU_ALM7_14_C "" VALUE 0x8024E150 Val_Wu8 255.0 DFES_OneToOne 0.00 255.0 FORMAT "%5.1" /end CHARACTERISTIC
/begin CHARACTERISTIC DFES_FaultTyp.DFC_MOXEMM_SMU_ALM7_15_C "" VALUE 0x8024E151 Val_Wu8 255.0 DFES_OneToOne 0.00 255.0 FORMAT "%5.1" /end CHARACTERISTIC
/begin CHARACTERISTIC DFES_FaultTyp.DFC_MOXEMM_SMU_ALM7_16_C "" VALUE 0x8024E152 Val_Wu8 255.0 DFES_OneToOne 0.00 255.0 FORMAT "%5.1" /end CHARACTERISTIC
/begin CHARACTERISTIC DFES_FaultTyp.DFC_MOXEMM_SMU_ALM7_17_C "" VALUE 0x8024E153 Val_Wu8 255.0 DFES_OneToOne 0.00 255.0 FORMAT "%5.1" /end CHARACTERISTIC
/begin CHARACTERISTIC DFES_FaultTyp.DFC_MOXEMM_SMU_ALM7_2_C "" VALUE 0x8024E154 Val_Wu8 255.0 DFES_OneToOne 0.00 255.0 FORMAT "%5.1" /end CHARACTERISTIC
/begin CHARACTERISTIC DFES_FaultTyp.DFC_MOXEMM_SMU_ALM7_20_C "" VALUE 0x8024E155 Val_Wu8 255.0 DFES_OneToOne 0.00 255.0 FORMAT "%5.1" /end CHARACTERISTIC
/begin CHARACTERISTIC DFES_FaultTyp.DFC_MOXEMM_SMU_ALM7_25_C "" VALUE 0x8024E156 Val_Wu8 255.0 DFES_OneToOne 0.00 255.0 FORMAT "%5.1" /end CHARACTERISTIC
/begin CHARACTERISTIC DFES_FaultTyp.DFC_MOXEMM_SMU_ALM7_26_C "" VALUE 0x8024E157 Val_Wu8 255.0 DFES_OneToOne 0.00 255.0 FORMAT "%5.1" /end CHARACTERISTIC
/begin CHARACTERISTIC DFES_FaultTyp.DFC_MOXEMM_SMU_ALM7_28_C "" VALUE 0x8024E158 Val_Wu8 255.0 DFES_OneToOne 0.00 255.0 FORMAT "%5.1" /end CHARACTERISTIC
/begin CHARACTERISTIC DFES_FaultTyp.DFC_MOXEMM_SMU_ALM7_29_C "" VALUE 0x8024E159 Val_Wu8 255.0 DFES_OneToOne 0.00 255.0 FORMAT "%5.1" /end CHARACTERISTIC
/begin CHARACTERISTIC DFES_FaultTyp.DFC_MOXEMM_SMU_ALM7_30_C "" VALUE 0x8024E15A Val_Wu8 255.0 DFES_OneToOne 0.00 255.0 FORMAT "%5.1" /end CHARACTERISTIC
/begin CHARACTERISTIC DFES_FaultTyp.DFC_MOXEMM_SMU_ALM7_31_C "" VALUE 0x8024E15B Val_Wu8 255.0 DFES_OneToOne 0.00 255.0 FORMAT "%5.1" /end CHARACTERISTIC
/begin CHARACTERISTIC DFES_FaultTyp.DFC_MOXEMM_SMU_ALM8_0_C "" VALUE 0x8024E15C Val_Wu8 255.0 DFES_OneToOne 0.00 255.0 FORMAT "%5.1" /end CHARACTERISTIC
/begin CHARACTERISTIC DFES_FaultTyp.DFC_MOXEMM_SMU_ALM8_1_C "" VALUE 0x8024E15D Val_Wu8 255.0 DFES_OneToOne 0.00 255.0 FORMAT "%5.1" /end CHARACTERISTIC
/begin CHARACTERISTIC DFES_FaultTyp.DFC_MOXEMM_SMU_ALM8_10_C "" VALUE 0x8024E15E Val_Wu8 255.0 DFES_OneToOne 0.00 255.0 FORMAT "%5.1" /end CHARACTERISTIC
/begin CHARACTERISTIC DFES_FaultTyp.DFC_MOXEMM_SMU_ALM8_11_C "" VALUE 0x8024E15F Val_Wu8 255.0 DFES_OneToOne 0.00 255.0 FORMAT "%5.1" /end CHARACTERISTIC
/begin CHARACTERISTIC DFES_FaultTyp.DFC_MOXEMM_SMU_ALM8_12_C "" VALUE 0x8024E160 Val_Wu8 255.0 DFES_OneToOne 0.00 255.0 FORMAT "%5.1" /end CHARACTERISTIC
/begin CHARACTERISTIC DFES_FaultTyp.DFC_MOXEMM_SMU_ALM8_16_C "" VALUE 0x8024E161 Val_Wu8 255.0 DFES_OneToOne 0.00 255.0 FORMAT "%5.1" /end CHARACTERISTIC
/begin CHARACTERISTIC DFES_FaultTyp.DFC_MOXEMM_SMU_ALM8_18_C "" VALUE 0x8024E162 Val_Wu8 255.0 DFES_OneToOne 0.00 255.0 FORMAT "%5.1" /end CHARACTERISTIC
/begin CHARACTERISTIC DFES_FaultTyp.DFC_MOXEMM_SMU_ALM8_2_C "" VALUE 0x8024E163 Val_Wu8 255.0 DFES_OneToOne 0.00 255.0 FORMAT "%5.1" /end CHARACTERISTIC
/begin CHARACTERISTIC DFES_FaultTyp.DFC_MOXEMM_SMU_ALM8_3_C "" VALUE 0x8024E164 Val_Wu8 255.0 DFES_OneToOne 0.00 255.0 FORMAT "%5.1" /end CHARACTERISTIC
/begin CHARACTERISTIC DFES_FaultTyp.DFC_MOXEMM_SMU_ALM8_31_C "" VALUE 0x8024E165 Val_Wu8 255.0 DFES_OneToOne 0.00 255.0 FORMAT "%5.1" /end CHARACTERISTIC
/begin CHARACTERISTIC DFES_FaultTyp.DFC_MOXEMM_SMU_ALM8_4_C "" VALUE 0x8024E166 Val_Wu8 255.0 DFES_OneToOne 0.00 255.0 FORMAT "%5.1" /end CHARACTERISTIC
/begin CHARACTERISTIC DFES_FaultTyp.DFC_MOXEMM_SMU_ALM9_0_C "" VALUE 0x8024E167 Val_Wu8 255.0 DFES_OneToOne 0.00 255.0 FORMAT "%5.1" /end CHARACTERISTIC
/begin CHARACTERISTIC DFES_FaultTyp.DFC_MOXEMM_SMU_ALM9_15_C "" VALUE 0x8024E168 Val_Wu8 255.0 DFES_OneToOne 0.00 255.0 FORMAT "%5.1" /end CHARACTERISTIC
/begin CHARACTERISTIC DFES_FaultTyp.DFC_MOXEMM_SMU_ALM9_3_C "" VALUE 0x8024E169 Val_Wu8 255.0 DFES_OneToOne 0.00 255.0 FORMAT "%5.1" /end CHARACTERISTIC
/begin CHARACTERISTIC DFES_FaultTyp.DFC_MoCADCNTPBnk1_C "" VALUE 0x8024E16A Val_Wu8 255.0 DFES_OneToOne 0.00 255.0 FORMAT "%5.1" /end CHARACTERISTIC
/begin CHARACTERISTIC DFES_FaultTyp.DFC_MoCADCTestVoltBnk1_C "" VALUE 0x8024E16B Val_Wu8 255.0 DFES_OneToOne 0.00 255.0 FORMAT "%5.1" /end CHARACTERISTIC
/begin CHARACTERISTIC DFES_FaultTyp.DFC_MoCSOPICO_C "" VALUE 0x8024E16C Val_Wu8 255.0 DFES_OneToOne 0.00 255.0 FORMAT "%5.1" /end CHARACTERISTIC
/begin CHARACTERISTIC DFES_FaultTyp.DFC_MoFAccr_C "" VALUE 0x8024E16D Val_Wu8 255.0 DFES_OneToOne 0.00 255.0 FORMAT "%5.1" /end CHARACTERISTIC
/begin CHARACTERISTIC DFES_FaultTyp.DFC_MoFCbnPreCdngOvrheat_C "" VALUE 0x8024E16E Val_Wu8 255.0 DFES_OneToOne 0.00 255.0 FORMAT "%5.1" /end CHARACTERISTIC
/begin CHARACTERISTIC DFES_FaultTyp.DFC_MoFCbnPreCdngTmrExpi_C "" VALUE 0x8024E16F Val_Wu8 255.0 DFES_OneToOne 0.00 255.0 FORMAT "%5.1" /end CHARACTERISTIC
/begin CHARACTERISTIC DFES_FaultTyp.DFC_MoFEvMngtBms_C "" VALUE 0x8024E170 Val_Wu8 255.0 DFES_OneToOne 0.00 255.0 FORMAT "%5.1" /end CHARACTERISTIC
/begin CHARACTERISTIC DFES_FaultTyp.DFC_MoFEvMngtDcdc_C "" VALUE 0x8024E171 Val_Wu8 255.0 DFES_OneToOne 0.00 255.0 FORMAT "%5.1" /end CHARACTERISTIC
/begin CHARACTERISTIC DFES_FaultTyp.DFC_MoFEvMngtEm01_C "" VALUE 0x8024E172 Val_Wu8 255.0 DFES_OneToOne 0.00 255.0 FORMAT "%5.1" /end CHARACTERISTIC
/begin CHARACTERISTIC DFES_FaultTyp.DFC_MoFEvMngtEm01BrkgToZr_C "" VALUE 0x8024E173 Val_Wu8 255.0 DFES_OneToOne 0.00 255.0 FORMAT "%5.1" /end CHARACTERISTIC
/begin CHARACTERISTIC DFES_FaultTyp.DFC_MoFEvMngtEm01EngSpd_C "" VALUE 0x8024E174 Val_Wu8 255.0 DFES_OneToOne 0.00 255.0 FORMAT "%5.1" /end CHARACTERISTIC
/begin CHARACTERISTIC DFES_FaultTyp.DFC_MoFEvMngtEm02EngSpd_C "" VALUE 0x8024E175 Val_Wu8 255.0 DFES_OneToOne 0.00 255.0 FORMAT "%5.1" /end CHARACTERISTIC
/begin CHARACTERISTIC DFES_FaultTyp.DFC_MoFEvMngtEm02Lvl1_C "" VALUE 0x8024E176 Val_Wu8 255.0 DFES_OneToOne 0.00 255.0 FORMAT "%5.1" /end CHARACTERISTIC
/begin CHARACTERISTIC DFES_FaultTyp.DFC_MoFEvMngtEm02Lvl2_C "" VALUE 0x8024E177 Val_Wu8 255.0 DFES_OneToOne 0.00 255.0 FORMAT "%5.1" /end CHARACTERISTIC
/begin CHARACTERISTIC DFES_FaultTyp.DFC_MoFExtCptAuxCpt_C "" VALUE 0x8024E178 Val_Wu8 255.0 DFES_OneToOne 0.00 255.0 FORMAT "%5.1" /end CHARACTERISTIC
/begin CHARACTERISTIC DFES_FaultTyp.DFC_MoFExtCptVacPmpErr_C "" VALUE 0x8024E179 Val_Wu8 255.0 DFES_OneToOne 0.00 255.0 FORMAT "%5.1" /end CHARACTERISTIC
/begin CHARACTERISTIC DFES_FaultTyp.DFC_MoFTqPtdAxle_C "" VALUE 0x8024E17A Val_Wu8 255.0 DFES_OneToOne 0.00 255.0 FORMAT "%5.1" /end CHARACTERISTIC
/begin CHARACTERISTIC DFES_FaultTyp.DFC_MoFTqPtdAxleSec_C "" VALUE 0x8024E17B Val_Wu8 255.0 DFES_OneToOne 0.00 255.0 FORMAT "%5.1" /end CHARACTERISTIC
/begin CHARACTERISTIC DFES_FaultTyp.DFC_MoFTqPtdEmPtRels_C "" VALUE 0x8024E17C Val_Wu8 255.0 DFES_OneToOne 0.00 255.0 FORMAT "%5.1" /end CHARACTERISTIC
/begin CHARACTERISTIC DFES_FaultTyp.DFC_MoFTqPtdEmPtRelsSec_C "" VALUE 0x8024E17D Val_Wu8 255.0 DFES_OneToOne 0.00 255.0 FORMAT "%5.1" /end CHARACTERISTIC
/begin CHARACTERISTIC DFES_FaultTyp.DFC_MoFTqPtdEmSign_C "" VALUE 0x8024E17E Val_Wu8 255.0 DFES_OneToOne 0.00 255.0 FORMAT "%5.1" /end CHARACTERISTIC
/begin CHARACTERISTIC DFES_FaultTyp.DFC_MoFTqPtdEmSignSec_C "" VALUE 0x8024E17F Val_Wu8 255.0 DFES_OneToOne 0.00 255.0 FORMAT "%5.1" /end CHARACTERISTIC
/begin CHARACTERISTIC DFES_FaultTyp.DFC_MoFTqPtdEmTq_C "" VALUE 0x8024E180 Val_Wu8 255.0 DFES_OneToOne 0.00 255.0 FORMAT "%5.1" /end CHARACTERISTIC
/begin CHARACTERISTIC DFES_FaultTyp.DFC_MoFTqPtdEmTqSec_C "" VALUE 0x8024E181 Val_Wu8 255.0 DFES_OneToOne 0.00 255.0 FORMAT "%5.1" /end CHARACTERISTIC
/begin CHARACTERISTIC DFES_FaultTyp.DFC_MoFTqPtdVeh_C "" VALUE 0x8024E182 Val_Wu8 255.0 DFES_OneToOne 0.00 255.0 FORMAT "%5.1" /end CHARACTERISTIC
/begin CHARACTERISTIC DFES_FaultTyp.DFC_MoFVarPostBldSel_C "" VALUE 0x8024E183 Val_Wu8 255.0 DFES_OneToOne 0.00 255.0 FORMAT "%5.1" /end CHARACTERISTIC
/begin CHARACTERISTIC DFES_FaultTyp.DFC_MoSysCtrlReIni_C "" VALUE 0x8024E184 Val_Wu8 255.0 DFES_OneToOne 0.00 255.0 FORMAT "%5.1" /end CHARACTERISTIC
/begin CHARACTERISTIC DFES_FaultTyp.DFC_MoXEMMHwLTMCUFW_C "" VALUE 0x8024E185 Val_Wu8 255.0 DFES_OneToOne 0.00 255.0 FORMAT "%5.1" /end CHARACTERISTIC
/begin CHARACTERISTIC DFES_FaultTyp.DFC_MoXEMMHwLTMonBIST_C "" VALUE 0x8024E186 Val_Wu8 255.0 DFES_OneToOne 0.00 255.0 FORMAT "%5.1" /end CHARACTERISTIC
/begin CHARACTERISTIC DFES_FaultTyp.DFC_MoXEMMHwLTRegMonTest_C "" VALUE 0x8024E187 Val_Wu8 255.0 DFES_OneToOne 0.00 255.0 FORMAT "%5.1" /end CHARACTERISTIC
/begin CHARACTERISTIC DFES_FaultTyp.DFC_MoXEMMHwLTStbySMUAlvTest_C "" VALUE 0x8024E188 Val_Wu8 255.0 DFES_OneToOne 0.00 255.0 FORMAT "%5.1" /end CHARACTERISTIC
/begin CHARACTERISTIC DFES_FaultTyp.DFC_MoXEMMHwLTTempSens_C "" VALUE 0x8024E189 Val_Wu8 255.0 DFES_OneToOne 0.00 255.0 FORMAT "%5.1" /end CHARACTERISTIC
/begin CHARACTERISTIC DFES_FaultTyp.DFC_MoXEMMHwLTUCBCfg_C "" VALUE 0x8024E18A Val_Wu8 255.0 DFES_OneToOne 0.00 255.0 FORMAT "%5.1" /end CHARACTERISTIC
/begin CHARACTERISTIC DFES_FaultTyp.DFC_MonEgyChrgnCoorr_AcChrgnWoMofRels_C "" VALUE 0x8024E18B Val_Wu8 255.0 DFES_OneToOne 0.00 255.0 FORMAT "%5.1" /end CHARACTERISTIC
/begin CHARACTERISTIC DFES_FaultTyp.DFC_MonEgyChrgnCoorr_ChrgnAbortIgr_C "" VALUE 0x8024E18C Val_Wu8 255.0 DFES_OneToOne 0.00 255.0 FORMAT "%5.1" /end CHARACTERISTIC
/begin CHARACTERISTIC DFES_FaultTyp.DFC_MonEgyChrgnCoorr_DcCntctFailr_C "" VALUE 0x8024E18D Val_Wu8 255.0 DFES_OneToOne 0.00 255.0 FORMAT "%5.1" /end CHARACTERISTIC
/begin CHARACTERISTIC DFES_FaultTyp.DFC_MonEgyChrgnCoorr_ExtChrgnShtOffReq_C "" VALUE 0x8024E18E Val_Wu8 255.0 DFES_OneToOne 0.00 255.0 FORMAT "%5.1" /end CHARACTERISTIC
/begin CHARACTERISTIC DFES_FaultTyp.DFC_MonEgyChrgnCoorr_ImpsChrgnMod_C "" VALUE 0x8024E18F Val_Wu8 255.0 DFES_OneToOne 0.00 255.0 FORMAT "%5.1" /end CHARACTERISTIC
/begin CHARACTERISTIC DFES_FaultTyp.DFC_MonEgyChrgnCoorr_ImpsChrgnPrms_C "" VALUE 0x8024E190 Val_Wu8 255.0 DFES_OneToOne 0.00 255.0 FORMAT "%5.1" /end CHARACTERISTIC
/begin CHARACTERISTIC DFES_FaultTyp.DFC_MonEgyChrgnCoorr_ImpsUDcIntk_C "" VALUE 0x8024E191 Val_Wu8 255.0 DFES_OneToOne 0.00 255.0 FORMAT "%5.1" /end CHARACTERISTIC
/begin CHARACTERISTIC DFES_FaultTyp.DFC_MonEgyChrgnCoorr_PlgLockMovmt_C "" VALUE 0x8024E192 Val_Wu8 255.0 DFES_OneToOne 0.00 255.0 FORMAT "%5.1" /end CHARACTERISTIC
/begin CHARACTERISTIC DFES_FaultTyp.DFC_MonEgyChrgnCoorr_VehCrashDetn_C "" VALUE 0x8024E193 Val_Wu8 255.0 DFES_OneToOne 0.00 255.0 FORMAT "%5.1" /end CHARACTERISTIC
/begin CHARACTERISTIC DFES_FaultTyp.DFC_MonEgyChrgnErrReactn_SftySwt_C "" VALUE 0x8024E194 Val_Wu8 255.0 DFES_OneToOne 0.00 255.0 FORMAT "%5.1" /end CHARACTERISTIC
/begin CHARACTERISTIC DFES_FaultTyp.DFC_MonEgyChrgnInlet_CcsPlgCtp_C "" VALUE 0x8024E195 Val_Wu8 255.0 DFES_OneToOne 0.00 255.0 FORMAT "%5.1" /end CHARACTERISTIC
/begin CHARACTERISTIC DFES_FaultTyp.DFC_MonEgyChrgnInlet_CcsPlgCtpPwm_C "" VALUE 0x8024E196 Val_Wu8 255.0 DFES_OneToOne 0.00 255.0 FORMAT "%5.1" /end CHARACTERISTIC
/begin CHARACTERISTIC DFES_FaultTyp.DFC_MonEgyChrgnInlet_CcsPlgLockCtrlImpsAtmpt_C "" VALUE 0x8024E197 Val_Wu8 255.0 DFES_OneToOne 0.00 255.0 FORMAT "%5.1" /end CHARACTERISTIC
/begin CHARACTERISTIC DFES_FaultTyp.DFC_MonEgyChrgnInlet_CcsPlgLockSnsrSigRngChk_C "" VALUE 0x8024E198 Val_Wu8 255.0 DFES_OneToOne 0.00 255.0 FORMAT "%5.1" /end CHARACTERISTIC
/begin CHARACTERISTIC DFES_FaultTyp.DFC_MonEgyChrgnInlet_CcsPlgLockStImps_C "" VALUE 0x8024E199 Val_Wu8 255.0 DFES_OneToOne 0.00 255.0 FORMAT "%5.1" /end CHARACTERISTIC
/begin CHARACTERISTIC DFES_FaultTyp.DFC_MonEgyChrgnInlet_CcsPlgPxp_C "" VALUE 0x8024E19A Val_Wu8 255.0 DFES_OneToOne 0.00 255.0 FORMAT "%5.1" /end CHARACTERISTIC
/begin CHARACTERISTIC DFES_FaultTyp.DFC_MonEgyChrgnT_Snsr1GrdtChk_C "" VALUE 0x8024E19B Val_Wu8 255.0 DFES_OneToOne 0.00 255.0 FORMAT "%5.1" /end CHARACTERISTIC
/begin CHARACTERISTIC DFES_FaultTyp.DFC_MonEgyChrgnT_Snsr1SigRngChk_C "" VALUE 0x8024E19C Val_Wu8 255.0 DFES_OneToOne 0.00 255.0 FORMAT "%5.1" /end CHARACTERISTIC
/begin CHARACTERISTIC DFES_FaultTyp.DFC_MonEgyChrgnT_Snsr2GrdtChk_C "" VALUE 0x8024E19D Val_Wu8 255.0 DFES_OneToOne 0.00 255.0 FORMAT "%5.1" /end CHARACTERISTIC
/begin CHARACTERISTIC DFES_FaultTyp.DFC_MonEgyChrgnT_Snsr2SigRngChk_C "" VALUE 0x8024E19E Val_Wu8 255.0 DFES_OneToOne 0.00 255.0 FORMAT "%5.1" /end CHARACTERISTIC
/begin CHARACTERISTIC DFES_FaultTyp.DFC_MonEgyChrgnT_SnsrDif_C "" VALUE 0x8024E19F Val_Wu8 255.0 DFES_OneToOne 0.00 255.0 FORMAT "%5.1" /end CHARACTERISTIC
/begin CHARACTERISTIC DFES_FaultTyp.DFC_OCWDAABEActv_C "" VALUE 0x8024E1A0 Val_Wu8 255.0 DFES_OneToOne 0.00 255.0 FORMAT "%5.1" /end CHARACTERISTIC
/begin CHARACTERISTIC DFES_FaultTyp.DFC_OCWDACom_C "" VALUE 0x8024E1A1 Val_Wu8 255.0 DFES_OneToOne 0.00 255.0 FORMAT "%5.1" /end CHARACTERISTIC
/begin CHARACTERISTIC DFES_FaultTyp.DFC_OCWDAErrPin_C "" VALUE 0x8024E1A2 Val_Wu8 255.0 DFES_OneToOne 0.00 255.0 FORMAT "%5.1" /end CHARACTERISTIC
/begin CHARACTERISTIC DFES_FaultTyp.DFC_OCWDAOvrVltg_C "" VALUE 0x8024E1A3 Val_Wu8 255.0 DFES_OneToOne 0.00 255.0 FORMAT "%5.1" /end CHARACTERISTIC
/begin CHARACTERISTIC DFES_FaultTyp.DFC_PUmax_C "" VALUE 0x8024E1A4 Val_Wu8 255.0 DFES_OneToOne 0.00 255.0 FORMAT "%5.1" /end CHARACTERISTIC
/begin CHARACTERISTIC DFES_FaultTyp.DFC_PwmCtPTmpErr_C "" VALUE 0x8024E1A5 Val_Wu8 255.0 DFES_OneToOne 0.00 255.0 FORMAT "%5.1" /end CHARACTERISTIC
/begin CHARACTERISTIC DFES_FaultTyp.DFC_PwrDistbnUnitTSRCMax_C "" VALUE 0x8024E1A6 Val_Wu8 255.0 DFES_OneToOne 0.00 255.0 FORMAT "%5.1" /end CHARACTERISTIC
/begin CHARACTERISTIC DFES_FaultTyp.DFC_PwrDistbnUnitTTmpErr_C "" VALUE 0x8024E1A7 Val_Wu8 255.0 DFES_OneToOne 0.00 255.0 FORMAT "%5.1" /end CHARACTERISTIC
/begin CHARACTERISTIC DFES_FaultTyp.DFC_SCtPmp1DiagGrdKeyErr_C "" VALUE 0x8024E1A8 Val_Wu8 255.0 DFES_OneToOne 0.00 255.0 FORMAT "%5.1" /end CHARACTERISTIC
/begin CHARACTERISTIC DFES_FaultTyp.DFC_SRCHighAPP1_C "" VALUE 0x8024E1A9 Val_Wu8 255.0 DFES_OneToOne 0.00 255.0 FORMAT "%5.1" /end CHARACTERISTIC
/begin CHARACTERISTIC DFES_FaultTyp.DFC_SRCHighAPP2_C "" VALUE 0x8024E1AA Val_Wu8 255.0 DFES_OneToOne 0.00 255.0 FORMAT "%5.1" /end CHARACTERISTIC
/begin CHARACTERISTIC DFES_FaultTyp.DFC_SRCLowAPP1_C "" VALUE 0x8024E1AB Val_Wu8 255.0 DFES_OneToOne 0.00 255.0 FORMAT "%5.1" /end CHARACTERISTIC
/begin CHARACTERISTIC DFES_FaultTyp.DFC_SRCLowAPP2_C "" VALUE 0x8024E1AC Val_Wu8 255.0 DFES_OneToOne 0.00 255.0 FORMAT "%5.1" /end CHARACTERISTIC
/begin CHARACTERISTIC DFES_FaultTyp.DFC_SWReset_0_C "" VALUE 0x8024E1AD Val_Wu8 255.0 DFES_OneToOne 0.00 255.0 FORMAT "%5.1" /end CHARACTERISTIC
/begin CHARACTERISTIC DFES_FaultTyp.DFC_SWReset_1_C "" VALUE 0x8024E1AE Val_Wu8 255.0 DFES_OneToOne 0.00 255.0 FORMAT "%5.1" /end CHARACTERISTIC
/begin CHARACTERISTIC DFES_FaultTyp.DFC_SWReset_2_C "" VALUE 0x8024E1AF Val_Wu8 255.0 DFES_OneToOne 0.00 255.0 FORMAT "%5.1" /end CHARACTERISTIC
/begin CHARACTERISTIC DFES_FaultTyp.DFC_Sia_InvldCode_C "" VALUE 0x8024E1B0 Val_Wu8 255.0 DFES_OneToOne 0.00 255.0 FORMAT "%5.1" /end CHARACTERISTIC
/begin CHARACTERISTIC DFES_FaultTyp.DFC_Sia_InvldKey_C "" VALUE 0x8024E1B1 Val_Wu8 255.0 DFES_OneToOne 0.00 255.0 FORMAT "%5.1" /end CHARACTERISTIC
/begin CHARACTERISTIC DFES_FaultTyp.DFC_Sia_NoRespUCx_C "" VALUE 0x8024E1B2 Val_Wu8 255.0 DFES_OneToOne 0.00 255.0 FORMAT "%5.1" /end CHARACTERISTIC
/begin CHARACTERISTIC DFES_FaultTyp.DFC_Sia_TprotRttp_C "" VALUE 0x8024E1B3 Val_Wu8 255.0 DFES_OneToOne 0.00 255.0 FORMAT "%5.1" /end CHARACTERISTIC
/begin CHARACTERISTIC DFES_FaultTyp.DFC_StrtUpEvStandStillDeactvn_C "" VALUE 0x8024E1B4 Val_Wu8 255.0 DFES_OneToOne 0.00 255.0 FORMAT "%5.1" /end CHARACTERISTIC
/begin CHARACTERISTIC DFES_FaultTyp.DFC_SyncAPP_C "" VALUE 0x8024E1B5 Val_Wu8 255.0 DFES_OneToOne 0.00 255.0 FORMAT "%5.1" /end CHARACTERISTIC
/begin CHARACTERISTIC DFES_FaultTyp.DFC_UCtPSRCMax_C "" VALUE 0x8024E1B6 Val_Wu8 255.0 DFES_OneToOne 0.00 255.0 FORMAT "%5.1" /end CHARACTERISTIC
/begin CHARACTERISTIC DFES_FaultTyp.DFC_UCtPTmpErr_C "" VALUE 0x8024E1B7 Val_Wu8 255.0 DFES_OneToOne 0.00 255.0 FORMAT "%5.1" /end CHARACTERISTIC
/begin CHARACTERISTIC DFES_FaultTyp.DFC_UPxP1SRCMax_C "" VALUE 0x8024E1B8 Val_Wu8 255.0 DFES_OneToOne 0.00 255.0 FORMAT "%5.1" /end CHARACTERISTIC
/begin CHARACTERISTIC DFES_FaultTyp.DFC_UPxP1TmpErr_C "" VALUE 0x8024E1B9 Val_Wu8 255.0 DFES_OneToOne 0.00 255.0 FORMAT "%5.1" /end CHARACTERISTIC
/begin CHARACTERISTIC DFES_FaultTyp.DFC_VehVObd_C "" VALUE 0x8024E1BA Val_Wu8 255.0 DFES_OneToOne 0.00 255.0 FORMAT "%5.1" /end CHARACTERISTIC
/begin CHARACTERISTIC DFES_MonEvtMSK0_C "Event filter mask of Monitoring - Mask Id mast have 0 at bit mask 0 positions" VALUE 0x80241A7E Val_Wu16 65535.00 OneToOne 0.00 65535.00 FORMAT "%8.2" /end CHARACTERISTIC
/begin CHARACTERISTIC DFES_MonEvtMSK1_C "Event filter mask of Monitoring - Mask Id mast have 1 at bit mask 1 positions" VALUE 0x80241A80 Val_Wu16 65535.00 OneToOne 0.00 65535.00 FORMAT "%8.2" /end CHARACTERISTIC
/begin CHARACTERISTIC DFES_MonRepeat_C "switch to ignore same kind of monitoring events, set to 0 to suppress identical events in a row" VALUE 0x80241A82 Val_Wu8 255.0 OneToOne 0.00 255.0 FORMAT "%5.1" /end CHARACTERISTIC
/begin CHARACTERISTIC DFES_numClsDlt_CA "" VAL_BLK 0x80241A83 ValA_Wu8 255.0 DFES_OneToOne 0.00 255.0 FORMAT "%5.1" MATRIX_DIM 4 /end CHARACTERISTIC
/begin CHARACTERISTIC DFES_numClsFaultCycl_CA "" VAL_BLK 0x80241A87 ValA_Wu8 255.0 DFES_OneToOne 0.00 255.0 FORMAT "%5.1" MATRIX_DIM 4 /end CHARACTERISTIC
/begin CHARACTERISTIC DFES_numClsHealCycl_CA "" VAL_BLK 0x80241A8B ValA_Wu8 255.0 DFES_OneToOne 0.00 255.0 FORMAT "%5.1" MATRIX_DIM 4 /end CHARACTERISTIC
/begin CHARACTERISTIC DFES_numClsPndDlt_CA "" VAL_BLK 0x80241A8F ValA_Wu8 255.0 DFES_OneToOne 0.00 255.0 FORMAT "%5.1" MATRIX_DIM 4 /end CHARACTERISTIC
/begin CHARACTERISTIC DFES_numClsSvcDlt_CA "" VAL_BLK 0x80241A93 ValA_Wu8 255.0 DFES_OneToOne 0.00 255.0 FORMAT "%5.1" MATRIX_DIM 4 /end CHARACTERISTIC
/begin CHARACTERISTIC DFES_numClsSVSFaultCycl_CA "" VAL_BLK 0x80241A97 ValA_Wu8 255.0 DFES_OneToOne 0.00 255.0 FORMAT "%5.1" MATRIX_DIM 4 /end CHARACTERISTIC
/begin CHARACTERISTIC DFES_numClsSVSHealCycl_CA "" VAL_BLK 0x80241A9B ValA_Wu8 255.0 DFES_OneToOne 0.00 255.0 FORMAT "%5.1" MATRIX_DIM 4 /end CHARACTERISTIC
/begin CHARACTERISTIC DFES_xAsgnEnvAllSetsDid_CA "" VAL_BLK 0x80241AA0 ValA_Wu16 61846.0000000 DID_Verb 0.00 61846.0000000 FORMAT "%13.7" MATRIX_DIM 25 /end CHARACTERISTIC
/begin CHARACTERISTIC DFES_xAsgnFrzFrDid_CA "" VAL_BLK 0x80241AD4 ValA_Wu16 61846.0000000 DID_Verb 0.00 61846.0000000 FORMAT "%13.7" MATRIX_DIM 1 /end CHARACTERISTIC
/begin CHARACTERISTIC DFES_xClsDltTrg_CA "" VAL_BLK 0x80241AD6 ValA_Wu8 5.00000000000 DSMAUX_DTRGVerb 0.00 5.00000000000 FORMAT "%13.11" MATRIX_DIM 4 /end CHARACTERISTIC
/begin CHARACTERISTIC DFES_xClsFaultTrg_CA "" VAL_BLK 0x80241ADA ValA_Wu8 5.00000000000 DSMAUX_DTRGVerb 0.00 5.00000000000 FORMAT "%13.11" MATRIX_DIM 4 /end CHARACTERISTIC
/begin CHARACTERISTIC DFES_xClsFltMIL_CA "" VAL_BLK 0x80241ADE ValA_Wu8 3.00000000000 DFES_LampFltMIL 0.00 3.00000000000 FORMAT "%13.11" MATRIX_DIM 4 /end CHARACTERISTIC
/begin CHARACTERISTIC DFES_xClsFltSVS_CA "" VAL_BLK 0x80241AE2 ValA_Wu8 8.00000000000 DFES_LampFltSVS 0.00 8.00000000000 FORMAT "%13.11" MATRIX_DIM 4 /end CHARACTERISTIC
/begin CHARACTERISTIC DFES_xClsHealTrg_CA "" VAL_BLK 0x80241AE6 ValA_Wu8 5.00000000000 DSMAUX_DTRGVerb 0.00 5.00000000000 FORMAT "%13.11" MATRIX_DIM 4 /end CHARACTERISTIC
/begin CHARACTERISTIC DFES_xClsPndDltTrg_CA "" VAL_BLK 0x80241AEA ValA_Wu8 5.00000000000 DSMAUX_DTRGVerb 0.00 5.00000000000 FORMAT "%13.11" MATRIX_DIM 4 /end CHARACTERISTIC
/begin CHARACTERISTIC DFES_xClsPrio_CA "" VAL_BLK 0x80241AEE ValA_Wu8 214.000000000 DFES_TstVisAndPrio 3.000000000 217.000000000 FORMAT "%13.9" MATRIX_DIM 4 /end CHARACTERISTIC
/begin CHARACTERISTIC DFES_xClsSvcDltTrg_CA "" VAL_BLK 0x80241AF2 ValA_Wu8 5.00000000000 DSMAUX_DTRGVerb 0.00 5.00000000000 FORMAT "%13.11" MATRIX_DIM 4 /end CHARACTERISTIC
/begin CHARACTERISTIC DFES_xClsSVSFaultTrg_CA "" VAL_BLK 0x80241AF6 ValA_Wu8 5.00000000000 DSMAUX_DTRGVerb 0.00 5.00000000000 FORMAT "%13.11" MATRIX_DIM 4 /end CHARACTERISTIC
/begin CHARACTERISTIC DFES_xClsSVSHealTrg_CA "" VAL_BLK 0x80241AFA ValA_Wu8 5.00000000000 DSMAUX_DTRGVerb 0.00 5.00000000000 FORMAT "%13.11" MATRIX_DIM 4 /end CHARACTERISTIC
/begin CHARACTERISTIC DiaActr_ElecHBrdgDiag_DbgSigId_C "Select H-Bridge signal to be debugged." VALUE 0x8025EE40 Val_Wu16 65535.00 OneToOne 0.00 65535.00 FORMAT "%8.2" /end CHARACTERISTIC
/begin CHARACTERISTIC DiaActr_ElecHBrdgDiag_DbgSigType_C "Select the signal type of signal to be debugged." VALUE 0x8025EE42 Val_Wu8 1.00000000000 DiaActr_ElecHBrdgDiag_DbgSigType_COMPU_VERB 0.00 1.00000000000 FORMAT "%13.11" /end CHARACTERISTIC
/begin CHARACTERISTIC DiaActr_ElecHBrdgDiag_OlEnaSwtOff_C "Enable powerstage switchoff during permanent error and preliminary heal of open load error. [Relevant only if open load is configured in active \ normal drive mode]." VALUE 0x8025EE43 Val_Wu8 1.00000000000 DiaActr_ElecHBrdgDiag_OlEnaSwtOff_COMPU_VERB 0.00 1.00000000000 FORMAT "%13.11" /end CHARACTERISTIC
/begin CHARACTERISTIC DiaActr_ElecPsDiag_DbgSigId_C "Signal Id to be debugged" VALUE 0x8025EE44 Val_Wu32 4294967295.00 OneToOne 0.00 4294967295.00 FORMAT "%13.2" /end CHARACTERISTIC
/begin CHARACTERISTIC DiaActr_ElecPsDiag_DbgSigTyp_C "Type of the output signal (PWMOut, DigOut, Pmd) to be debugged." VALUE 0x8025EE48 Val_Wu8 3.00000000000 DiaActr_ElecPsDiag_DbgSigTyp_COMPU_VERB 0.00 3.00000000000 FORMAT "%13.11" /end CHARACTERISTIC
/begin CHARACTERISTIC DiaActr_ElecPsDiag_SigOutDurgOpenLd_C "Take into account Open-Load-Error for Shut-Off request." VALUE 0x8025EE49 Val_Wu8 1.000 OneToOne 0.00 1.000 FORMAT "%5.3" EXTENDED_LIMITS 0.00 255.0 /end CHARACTERISTIC
/begin MEASUREMENT DiaActrElecPsDiag_cntTestPlsTsk_mp "L-1 L=enNumber of testpulses in current driving cycleL-1" UWORD OneToOne 1 100 0.00 65535.00 FORMAT "%8.2" ECU_ADDRESS 0x70006A38 /end MEASUREMENT
/begin MEASUREMENT DiaActrElecPsDiag_nrDiagErr_mp "Number of supported errors of the diagnosis signal" UBYTE OneToOne 1 100 0.00 255.0 FORMAT "%5.1" ECU_ADDRESS 0x70006C14 /end MEASUREMENT
/begin MEASUREMENT DiaActrElecPsDiag_nrTestPls_mp "Number of testpulses in current driving cycle" ULONG OneToOne 1 100 0.00 4294967295.00 FORMAT "%13.2" ECU_ADDRESS 0x700068C0 /end MEASUREMENT
/begin MEASUREMENT DiaActrElecPsDiag_stAttribOL_mp "Current DSM attribute (Tested detection) of the open load error when reporting open load error to DSM module" ULONG OneToOne 1 100 0.00 4294967295.00 FORMAT "%13.2" ECU_ADDRESS 0x700068BC /end MEASUREMENT
/begin MEASUREMENT DiaActrElecPsDiag_stAttribOT_mp "Current DSM attribute (Tested detection) of the overtemperature error when reporting overtemperature error to DSM module" ULONG OneToOne 1 100 0.00 4294967295.00 FORMAT "%13.2" ECU_ADDRESS 0x700068B8 /end MEASUREMENT
/begin MEASUREMENT DiaActrElecPsDiag_stAttribSCB_mp "Current DSM attribute (Tested detection) of the short circuit to battery error when reporting short circuit to battery error to DSM module" ULONG OneToOne 1 100 0.00 4294967295.00 FORMAT "%13.2" ECU_ADDRESS 0x700068B4 /end MEASUREMENT
/begin MEASUREMENT DiaActrElecPsDiag_stAttribSCG_mp "Current DSM attribute (Tested detection) of the short circuit to ground error when reporting short circuit to ground error to DSM module" ULONG OneToOne 1 100 0.00 4294967295.00 FORMAT "%13.2" ECU_ADDRESS 0x700068B0 /end MEASUREMENT
/begin MEASUREMENT DiaActrElecPsDiag_stDsmDebOpenLoad_mp "Debounce status of OL error" ULONG OneToOne 1 100 0.00 4294967295.00 FORMAT "%13.2" ECU_ADDRESS 0x700068AC /end MEASUREMENT
/begin MEASUREMENT DiaActrElecPsDiag_stDsmDebOverT_mp "Debounce status of OT error" ULONG OneToOne 1 100 0.00 4294967295.00 FORMAT "%13.2" ECU_ADDRESS 0x700068A8 /end MEASUREMENT
/begin MEASUREMENT DiaActrElecPsDiag_stDsmDebScb_mp "Debounce status of SCB error" ULONG OneToOne 1 100 0.00 4294967295.00 FORMAT "%13.2" ECU_ADDRESS 0x700068A4 /end MEASUREMENT
/begin MEASUREMENT DiaActrElecPsDiag_stDsmDebScg_mp "Debounce status of SCG error" ULONG OneToOne 1 100 0.00 4294967295.00 FORMAT "%13.2" ECU_ADDRESS 0x700068A0 /end MEASUREMENT
/begin MEASUREMENT DiaActrElecPsDiag_stErrCfgOpenLoad_mp "Configuration of behaviour for OL error" UBYTE OneToOne 1 100 0.00 255.0 FORMAT "%5.1" ECU_ADDRESS 0x70006C13 /end MEASUREMENT
/begin MEASUREMENT DiaActrElecPsDiag_stErrCfgOverT_mp "Configuration of behaviour for OT error" UBYTE OneToOne 1 100 0.00 255.0 FORMAT "%5.1" ECU_ADDRESS 0x70006C12 /end MEASUREMENT
/begin MEASUREMENT DiaActrElecPsDiag_stErrCfgScb_mp "Configuration of behaviour for SCB error" UBYTE OneToOne 1 100 0.00 255.0 FORMAT "%5.1" ECU_ADDRESS 0x70006C11 /end MEASUREMENT
/begin MEASUREMENT DiaActrElecPsDiag_stErrCfgScg_mp "Configuration of behaviour for SCG error" UBYTE OneToOne 1 100 0.00 255.0 FORMAT "%5.1" ECU_ADDRESS 0x70006C10 /end MEASUREMENT
/begin MEASUREMENT DiaActrElecPsDiag_stPrvTstRslt_mp "The latest result of test impulse" ULONG OneToOne 1 100 0.00 4294967295.00 FORMAT "%13.2" ECU_ADDRESS 0x7000689C /end MEASUREMENT
/begin MEASUREMENT DiaActrElecPsDiag_stSigCfg_mp "Configuration of the diagnosis signal" UBYTE OneToOne 1 100 0.00 255.0 FORMAT "%5.1" ECU_ADDRESS 0x70006C0F /end MEASUREMENT
/begin MEASUREMENT DiaActrElecPsDiag_stSigErrInfo_mp "The last error information of HWE read from the chip" ULONG OneToOne 1 100 0.00 4294967295.00 FORMAT "%13.2" ECU_ADDRESS 0x70006898 /end MEASUREMENT
/begin MEASUREMENT DiaActrElecPsDiag_stSig_mp "Actual state of the diagnosis signal: INVALID, NOTEST, NOFAULT, FAULT, PREFAULT, HEALFAULT, WAITSTATE" UBYTE DiaActrElecPsDiag_stSig_COMPU_VERB 1 100 0.00 6.00000000000 FORMAT "%13.11" ECU_ADDRESS 0x70006C0E /end MEASUREMENT
/begin MEASUREMENT DiaActrElecPsDiag_stTestPls_mp "L-1 L=enThe actual state of the testpulse state machine: NO, REQUESTED, RUN, FINISHED, RE-TRIGGEREDL-1" UBYTE DiaActrElecPsDiag_stTestPls_COMPU_VERB 1 100 1.00000000000 5.00000000000 FORMAT "%13.11" ECU_ADDRESS 0x70006C0D /end MEASUREMENT
/begin MEASUREMENT DiaActrElecPsDiag_stTmngTestPls_mp "The current time to wait between two testpulses" UBYTE DiaActrElecPsDiag_stTmngTestPls_COMPU_VERB 1 100 0.00 3.00000000000 FORMAT "%13.11" ECU_ADDRESS 0x70006C0C /end MEASUREMENT
/begin MEASUREMENT DiaActrElecPsDiag_tiTstPls_mp "Current status of timer for the time between testpulses during permanent fault" SWORD OneToOne 1 100 -32768.00 32767.00 FORMAT "%8.2" ECU_ADDRESS 0x70006A36 /end MEASUREMENT
/begin MEASUREMENT DiaActrElecPsDiag_TstPlsCnt_Cfg_mp "Measurement points for test pulse counter setting" UBYTE OneToOne 1 100 0.00 255.0 FORMAT "%5.1" ECU_ADDRESS 0x70006C0B /end MEASUREMENT
/begin MEASUREMENT DiaActr_ElecHBrdgDiag_HBrDiagInfo_mp "Diagnosis information from HWE - HBr." ULONG OneToOne 1 100 0.00 4294967295.00 FORMAT "%13.2" ECU_ADDRESS 0x700068D4 /end MEASUREMENT
/begin MEASUREMENT DiaActr_ElecHBrdgDiag_HlfBrDiagInfo_mp "Diagnosis information from IoSrv - HlfBr" ULONG OneToOne 1 100 0.00 4294967295.00 FORMAT "%13.2" MATRIX_DIM 2 ECU_ADDRESS 0x700068CC /end MEASUREMENT
/begin MEASUREMENT DiaActr_ElecHBrdgDiag_nrDiagErr_mp "Number of diagnostic errors Size of error object array." UBYTE OneToOne 1 100 0.00 255.0 FORMAT "%5.1" ECU_ADDRESS 0x70006C1E /end MEASUREMENT
/begin MEASUREMENT DiaActr_ElecHBrdgDiag_OLSigErrInfo_mp "Signal error information during open load diagnosis." ULONG OneToOne 1 100 0.00 4294967295.00 FORMAT "%13.2" ECU_ADDRESS 0x700068C8 /end MEASUREMENT
/begin MEASUREMENT DiaActr_ElecHBrdgDiag_ReasOLAbort_mp "Measuring point indicating reason for open load diagnosis abort. [Relevant only if open load is configured in switchoff or disable mode]." UBYTE OneToOne 1 100 0.00 255.0 FORMAT "%5.1" ECU_ADDRESS 0x70006C1D /end MEASUREMENT
/begin MEASUREMENT DiaActr_ElecHBrdgDiag_SigErrInfo_mp "Signal error information during normal diagnosis." ULONG OneToOne 1 100 0.00 4294967295.00 FORMAT "%13.2" ECU_ADDRESS 0x700068C4 /end MEASUREMENT
/begin MEASUREMENT DiaActr_ElecHBrdgDiag_stAddOLDiag_mp "Additional open load diagnosis status." UBYTE OneToOne 1 100 0.00 255.0 FORMAT "%5.1" ECU_ADDRESS 0x70006C1C /end MEASUREMENT
/begin MEASUREMENT DiaActr_ElecHBrdgDiag_stDiagCtrl_mp "Status of diagnosis software (DiaActr_ElecHBrdgDiag) controlling H-Bridge output." UBYTE OneToOne 1 100 0.00 255.0 FORMAT "%5.1" ECU_ADDRESS 0x70006C1B /end MEASUREMENT
/begin MEASUREMENT DiaActr_ElecHBrdgDiag_stDiagDi_mp "Diagnosis disable status." UBYTE OneToOne 1 100 0.00 255.0 FORMAT "%5.1" ECU_ADDRESS 0x70006C1A /end MEASUREMENT
/begin MEASUREMENT DiaActr_ElecHBrdgDiag_stOLAbortReq_mp "Open load abort request status." UBYTE OneToOne 1 100 0.00 255.0 FORMAT "%5.1" ECU_ADDRESS 0x70006C19 /end MEASUREMENT
/begin MEASUREMENT DiaActr_ElecHBrdgDiag_stOLDiagMode_mp "Open load diagnosis mode." UBYTE OneToOne 1 100 0.00 255.0 FORMAT "%5.1" ECU_ADDRESS 0x70006C18 /end MEASUREMENT
/begin MEASUREMENT DiaActr_ElecHBrdgDiag_stOLDiag_mp "Open load diagnosis status." UBYTE OneToOne 1 100 0.00 255.0 FORMAT "%5.1" ECU_ADDRESS 0x70006C17 /end MEASUREMENT
/begin MEASUREMENT DiaActr_ElecHBrdgDiag_stSigQly_mp "Signal quality returned." UBYTE OneToOne 1 100 0.00 255.0 FORMAT "%5.1" ECU_ADDRESS 0x70006C16 /end MEASUREMENT
/begin MEASUREMENT DiaActr_ElecHBrdgDiag_TestPlsReq_mp "Test pulse request status." UBYTE OneToOne 1 100 0.00 255.0 FORMAT "%5.1" ECU_ADDRESS 0x70006C15 /end MEASUREMENT
/begin FUNCTION DFES "30000.70.0Diagnostic Fault Event Storage"
 /begin DEF_CHARACTERISTIC DFES_FaultTyp.DFC_HvBattIReqToChrgrErr_C DFES_FaultTyp.DFC_HvBattIReqToChrgrIni_C DFES_FaultTyp.DFC_HvBattIninTout_C DFES_FaultTyp.DFC_HvBattIntlckSt_C DFES_FaultTyp.DFC_HvBattIsoFlt_C DFES_FaultTyp.DFC_HvBattLimdPwr_C DFES_FaultTyp.DFC_HvBattMaiSwtClsngFlt_C DFES_FaultTyp.DFC_HvBattMaiSwtFlt_C DFES_FaultTyp.DFC_HvBattMaiSwtOpen_C DFES_FaultTyp.DFC_HvBattMaiSwtOpngFlt_C DFES_FaultTyp.DFC_HvBattMaiSwtWldd_C DFES_FaultTyp.DFC_HvBattNegCntctrCntErr_C DFES_FaultTyp.DFC_HvBattOperModChrgPlausy_C DFES_FaultTyp.DFC_HvBattOverTDern_C DFES_FaultTyp.DFC_HvBattPosCntctrCntErr_C DFES_FaultTyp.DFC_HvBattPrecCntctrCntErr_C DFES_FaultTyp.DFC_HvBattPwrDistbnTDern_C DFES_FaultTyp.DFC_HvBattPwrDistbnTInhbn_C DFES_FaultTyp.DFC_HvBattRatRSohErr_C DFES_FaultTyp.DFC_HvBattRatSohErr_C DFES_FaultTyp.DFC_HvBattSngIsoWarn_C DFES_FaultTyp.DFC_HvBattSrvPlgDiscnct_C DFES_FaultTyp.DFC_HvBattUNomChrgnErr_C DFES_FaultTyp.DFC_HvBattUNomChrgnIni_C DFES_FaultTyp.DFC_HvBattUnderTDern_C DFES_FaultTyp.DFC_HvbEVLmpBlink_C DFES_FaultTyp.DFC_HvbEVLmpCont_C DFES_FaultTyp.DFC_HvbSVSBlink_C DFES_FaultTyp.DFC_HvbSVSCont_C DFES_FaultTyp.DFC_InmLINBusBlk_C DFES_FaultTyp.DFC_PDUProgmFailr_C DFES_FaultTyp.DFC_PEnvSigRngMax_C DFES_FaultTyp.DFC_PEnvSigRngMin_C DFES_FaultTyp.DFC_PLnCChpDeactvnFaild_C DFES_FaultTyp.DFC_PrkgBrkFailr_C DFES_FaultTyp.DFC_PtSysLimErr_C DFES_FaultTyp.DFC_PwrMaxDchaShoLo_C DFES_FaultTyp.DFC_SCtPmp1FailSafeNotSuc_C DFES_FaultTyp.DFC_SCtPmp1SCG_C DFES_FaultTyp.DFC_VehCoornDrvrNotPrsnt_C DFES_FaultTyp.DFC_VehVCanAvl_C DFES_FaultTyp.DFC_VehVCanErr_C DFES_FaultTyp.DFC_eTogFailrLvlRes_C DFES_FaultTyp.DFC_flgBrkMaiDiag_C DFES_FaultTyp.DFC_stHvbIsoMeasmtRes_C DFES_FaultTyp.DFC_BrkBstPmpPLeakDfct_C DFES_FaultTyp.DFC_Com082hTooShort_C DFES_FaultTyp.DFC_Com092hTooShort_C DFES_FaultTyp.DFC_Com205hAbsent_C DFES_FaultTyp.DFC_Com205hChecksum_C DFES_FaultTyp.DFC_Com205hCounter_C DFES_FaultTyp.DFC_Com205hTooShort_C DFES_FaultTyp.DFC_Com217hAbsent_C DFES_FaultTyp.DFC_Com217hChecksum_C DFES_FaultTyp.DFC_Com217hCounter_C DFES_FaultTyp.DFC_Com217hTooShort_C DFES_FaultTyp.DFC_Com227hAbsent_C DFES_FaultTyp.DFC_Com227hTooShort_C DFES_FaultTyp.DFC_Com237hAbsent_C DFES_FaultTyp.DFC_Com237hChecksum_C DFES_FaultTyp.DFC_Com237hCounter_C DFES_FaultTyp.DFC_Com237hTooShort_C DFES_FaultTyp.DFC_Com259hAbsent_C DFES_FaultTyp.DFC_Com259hChecksum_C DFES_FaultTyp.DFC_Com259hCounter_C DFES_FaultTyp.DFC_Com259hTooShort_C DFES_FaultTyp.DFC_Com26hAbsent_C DFES_FaultTyp.DFC_Com26hTooShort_C DFES_FaultTyp.DFC_Com273hAbsent_C DFES_FaultTyp.DFC_Com273hChecksum_C DFES_FaultTyp.DFC_Com273hCounter_C DFES_FaultTyp.DFC_Com273hTooShort_C DFES_FaultTyp.DFC_Com275hAbsent_C DFES_FaultTyp.DFC_Com275hChecksum_C DFES_FaultTyp.DFC_Com275hCounter_C DFES_FaultTyp.DFC_Com275hTooShort_C DFES_FaultTyp.DFC_Com283hAbsent_C DFES_FaultTyp.DFC_Com283hTooShort_C DFES_FaultTyp.DFC_Com285hAbsent_C DFES_FaultTyp.DFC_Com285hChecksum_C DFES_FaultTyp.DFC_Com285hCounter_C DFES_FaultTyp.DFC_Com285hTooShort_C DFES_FaultTyp.DFC_Com293hAbsent_C DFES_FaultTyp.DFC_Com293hChecksum_C DFES_FaultTyp.DFC_Com293hCounter_C DFES_FaultTyp.DFC_Com293hTooShort_C DFES_FaultTyp.DFC_Com308hAbsent_C DFES_FaultTyp.DFC_Com308hChecksum_C DFES_FaultTyp.DFC_Com308hCounter_C DFES_FaultTyp.DFC_Com308hTooShort_C DFES_FaultTyp.DFC_Com318hAbsent_C DFES_FaultTyp.DFC_Com318hChecksum_C DFES_FaultTyp.DFC_Com318hCounter_C DFES_FaultTyp.DFC_Com318hTooShort_C DFES_FaultTyp.DFC_Com325hAbsent_C DFES_FaultTyp.DFC_Com325hChecksum_C DFES_FaultTyp.DFC_Com325hCounter_C DFES_FaultTyp.DFC_Com325hTooShort_C DFES_FaultTyp.DFC_Com335hAbsent_C DFES_FaultTyp.DFC_Com335hChecksum_C DFES_FaultTyp.DFC_Com335hCounter_C DFES_FaultTyp.DFC_Com335hTooShort_C DFES_FaultTyp.DFC_Com351hAbsent_C DFES_FaultTyp.DFC_Com351hTooShort_C DFES_FaultTyp.DFC_Com38DhAbsent_C DFES_FaultTyp.DFC_Com38DhChecksum_C DFES_FaultTyp.DFC_Com38DhCounter_C DFES_FaultTyp.DFC_Com38DhTooShort_C DFES_FaultTyp.DFC_Com412hAbsent_C DFES_FaultTyp.DFC_Com412hChecksum_C DFES_FaultTyp.DFC_Com412hCounter_C DFES_FaultTyp.DFC_Com412hTooShort_C DFES_FaultTyp.DFC_Com427hAbsent_C DFES_FaultTyp.DFC_Com427hTooShort_C DFES_FaultTyp.DFC_Com432hAbsent_C DFES_FaultTyp.DFC_Com432hChecksum_C DFES_FaultTyp.DFC_Com432hCounter_C DFES_FaultTyp.DFC_Com432hTooShort_C DFES_FaultTyp.DFC_Com435hAbsent_C DFES_FaultTyp.DFC_Com435hTooShort_C DFES_FaultTyp.DFC_Com442hAbsent_C DFES_FaultTyp.DFC_Com442hTooShort_C DFES_FaultTyp.DFC_Com453hAbsent_C DFES_FaultTyp.DFC_Com453hTooShort_C DFES_FaultTyp.DFC_Com455hAbsent_C DFES_FaultTyp.DFC_Com455hTooShort_C DFES_FaultTyp.DFC_Com463hAbsent_C DFES_FaultTyp.DFC_Com463hTooShort_C DFES_FaultTyp.DFC_Com473hAbsent_C DFES_FaultTyp.DFC_Com473hTooShort_C DFES_FaultTyp.DFC_Com47BhAbsent_C DFES_FaultTyp.DFC_Com47BhTooShort_C DFES_FaultTyp.DFC_Com48BhAbsent_C DFES_FaultTyp.DFC_Com48BhTooShort_C DFES_FaultTyp.DFC_Com497hTooShort_C DFES_FaultTyp.DFC_Com4F2hAbsent_C DFES_FaultTyp.DFC_Com4F2hChecksum_C DFES_FaultTyp.DFC_Com4F2hCounter_C DFES_FaultTyp.DFC_Com4F2hTooShort_C DFES_FaultTyp.DFC_Com50DhAbsent_C DFES_FaultTyp.DFC_Com50DhTooShort_C DFES_FaultTyp.DFC_Com535hAbsent_C DFES_FaultTyp.DFC_Com535hTooShort_C DFES_FaultTyp.DFC_Com543hAbsent_C DFES_FaultTyp.DFC_Com543hTooShort_C DFES_FaultTyp.DFC_Com552hAbsent_C DFES_FaultTyp.DFC_Com552hTooShort_C DFES_FaultTyp.DFC_Com583hAbsent_C DFES_FaultTyp.DFC_Com583hTooShort_C DFES_FaultTyp.DFC_Com592hAbsent_C DFES_FaultTyp.DFC_Com592hChecksum_C DFES_FaultTyp.DFC_Com592hCounter_C DFES_FaultTyp.DFC_Com592hTooShort_C DFES_FaultTyp.DFC_Com595hAbsent_C DFES_FaultTyp.DFC_Com595hChecksum_C DFES_FaultTyp.DFC_Com595hCounter_C DFES_FaultTyp.DFC_Com595hTooShort_C DFES_FaultTyp.DFC_Com5B2hAbsent_C DFES_FaultTyp.DFC_Com5B2hTooShort_C DFES_FaultTyp.DFC_Com5B5hAbsent_C DFES_FaultTyp.DFC_Com5B5hChecksum_C DFES_FaultTyp.DFC_Com5B5hCounter_C DFES_FaultTyp.DFC_Com5B5hTooShort_C DFES_FaultTyp.DFC_Com5C7hTooShort_C DFES_FaultTyp.DFC_Com5E7hAbsent_C DFES_FaultTyp.DFC_Com5E7hTooShort_C DFES_FaultTyp.DFC_Com635hTooShort_C DFES_FaultTyp.DFC_Com645hTooShort_C DFES_FaultTyp.DFC_Com663hAbsent_C DFES_FaultTyp.DFC_Com663hTooShort_C DFES_FaultTyp.DFC_Com665hAbsent_C DFES_FaultTyp.DFC_Com665hTooShort_C DFES_FaultTyp.DFC_Com675hAbsent_C DFES_FaultTyp.DFC_Com675hTooShort_C DFES_FaultTyp.DFC_ComFrbd_205h_HVBAT_PACK_CURRENT_C DFES_FaultTyp.DFC_ComFrbd_205h_HVBAT_SOC_DISPLAY_C DFES_FaultTyp.DFC_ComFrbd_205h_HVBAT_VOLTAGE_C DFES_FaultTyp.DFC_ComFrbd_217h_INV_DC_BUS_VOLTAGE_C DFES_FaultTyp.DFC_ComFrbd_217h_INV_MTR_ACTUAL_TRQ_C DFES_FaultTyp.DFC_ComFrbd_217h_INV_MTR_SPEED_C DFES_FaultTyp.DFC_ComFrbd_217h_INV_MTR_TRQ_C DFES_FaultTyp.DFC_ComFrbd_227h_INV_DC_CURRENT_C DFES_FaultTyp.DFC_ComFrbd_227h_INV_MOTORING_PEAK_TRQ_C DFES_FaultTyp.DFC_ComFrbd_227h_INV_MTR_INST_INPUT_POWER_C DFES_FaultTyp.DFC_ComFrbd_227h_INV_REGEN_PEAK_TRQ_C DFES_FaultTyp.DFC_ComFrbd_237h_INV_ACTIVE_DISCHARGE_STATUS_C DFES_FaultTyp.DFC_ComFrbd_237h_INV_CTRL_MODE_ACK_C DFES_FaultTyp.DFC_ComFrbd_237h_INV_EV_WARNING_C DFES_FaultTyp.DFC_ComFrbd_237h_INV_FAULT_LEVEL_C DFES_FaultTyp.DFC_ComFrbd_237h_INV_MASTER_STOP_C DFES_FaultTyp.DFC_ComFrbd_237h_INV_SERVICE_DUE_C DFES_FaultTyp.DFC_ComFrbd_237h_INV_STAB_MIN_TRQ_C DFES_FaultTyp.DFC_ComFrbd_259h_TGLM_FAILURE_STATE_C DFES_FaultTyp.DFC_ComFrbd_259h_TGLM_MODE_PUSH_C DFES_FaultTyp.DFC_ComFrbd_259h_TOGGLE_MONOSTABLE_POS_C DFES_FaultTyp.DFC_ComFrbd_273h_OBC_outputpower_capability_C DFES_FaultTyp.DFC_ComFrbd_275h_HVBAT_DISCHARGE_30S_AVAILABLE_CURRENT_C DFES_FaultTyp.DFC_ComFrbd_275h_HVBAT_DISCHARGE_30S_AVAILABLE_POWER_C DFES_FaultTyp.DFC_ComFrbd_283h_DCDC_IN_CURRENT_C DFES_FaultTyp.DFC_ComFrbd_283h_DCDC_IN_VOLTAGE_C DFES_FaultTyp.DFC_ComFrbd_283h_DCDC_OUT_CURRENT_C DFES_FaultTyp.DFC_ComFrbd_283h_DCDC_OUT_VOLTAGE_C DFES_FaultTyp.DFC_ComFrbd_285h_HVBAT_REGEN_CHG_30S_CURRENT_LIMIT_C DFES_FaultTyp.DFC_ComFrbd_285h_HVBAT_REGEN_CHRG_30S_POWER_LIMIT_C DFES_FaultTyp.DFC_ComFrbd_293h_DCDC_outputpower_capability_C DFES_FaultTyp.DFC_ComFrbd_325h_HVBAT_INSULATION_RESISTANCE_C DFES_FaultTyp.DFC_ComFrbd_325h_HVBAT_TEMPERATURE_C DFES_FaultTyp.DFC_ComFrbd_335h_HVBAT_CHRG_CONTINUOUS_CURR_MAX_C DFES_FaultTyp.DFC_ComFrbd_335h_HVBAT_CHRG_COTINUOUS_CURR_REQ_C DFES_FaultTyp.DFC_ComFrbd_335h_HVBAT_CHRG_MAX_VOLT_C DFES_FaultTyp.DFC_ComFrbd_335h_HVBAT_DC_BUS_VOLTAGE_C DFES_FaultTyp.DFC_ComFrbd_427h_INV_OP_MODE_C DFES_FaultTyp.DFC_ComFrbd_427h_INV_PERMISIBLE_TORQUE_C DFES_FaultTyp.DFC_ComFrbd_435h_HVBAT_MAX_CELL_VOLT_C DFES_FaultTyp.DFC_ComFrbd_435h_HVBAT_MAX_CELL_VOLT_NUM_C DFES_FaultTyp.DFC_ComFrbd_435h_HVBAT_MAX_SENSOR_TEMP_C DFES_FaultTyp.DFC_ComFrbd_435h_HVBAT_MIN_CELL_VOLT_C DFES_FaultTyp.DFC_ComFrbd_435h_HVBAT_MIN_CELL_VOLT_NUM_C DFES_FaultTyp.DFC_ComFrbd_453h_OBC_IN_CURRENT_C DFES_FaultTyp.DFC_ComFrbd_453h_OBC_IN_VOLTAGE_C DFES_FaultTyp.DFC_ComFrbd_453h_OBC_IP_POWER_C DFES_FaultTyp.DFC_ComFrbd_455h_HVBAT_NOMINAL_VOLTAGE_C DFES_FaultTyp.DFC_ComFrbd_463h_OBC_OUT_CURRENT_C DFES_FaultTyp.DFC_ComFrbd_463h_OBC_OUT_VOLTAGE_C DFES_FaultTyp.DFC_ComFrbd_463h_OBC_TEMPERATURE_C DFES_FaultTyp.DFC_ComFrbd_473h_DCDC_Coolant_Temperature_C DFES_FaultTyp.DFC_ComFrbd_473h_DCDC_TEMPERATURE_C DFES_FaultTyp.DFC_ComFrbd_47Bh_eCOMP_BusBarCurrent_C DFES_FaultTyp.DFC_ComFrbd_47Bh_eCOMP_BusBarVoltage_C DFES_FaultTyp.DFC_ComFrbd_47Bh_eCOMP_CompressorSpeed_C DFES_FaultTyp.DFC_ComFrbd_47Bh_eCOMP_IGBT_Temp_C DFES_FaultTyp.DFC_ComFrbd_47Bh_eCOMP_PeakPhaCurrent_C DFES_FaultTyp.DFC_ComFrbd_47Bh_eCOMP_Power_consumption_C DFES_FaultTyp.DFC_ComFrbd_48Bh_eCOMP_Fault_Level_C DFES_FaultTyp.DFC_ComFrbd_4F2h_VALEUR_SOC_ETENDUE_C DFES_FaultTyp.DFC_ComFrbd_535h_HV_BATT_TEMP_AVG_C DFES_FaultTyp.DFC_ComFrbd_543h_HVBAT_RESTBATTENERGY_C DFES_FaultTyp.DFC_ComFrbd_543h_HVBAT_SOH_C DFES_FaultTyp.DFC_ComFrbd_543h_HV_BATT_SOH_RES_C DFES_FaultTyp.DFC_ComFrbd_592h_IBATT_1_C DFES_FaultTyp.DFC_ComFrbd_592h_IBATT_2_C DFES_FaultTyp.DFC_ComFrbd_592h_IBATT_3_C DFES_FaultTyp.DFC_ComFrbd_592h_TEMP_BATT_C DFES_FaultTyp.DFC_ComFrbd_592h_U_BATT_BECB_C DFES_FaultTyp.DFC_ComFrbd_595h_HVBAT_TIME_TO_CHRG_80_C DFES_FaultTyp.DFC_ComFrbd_5B2h_TEMP_AIR_EXT_C DFES_FaultTyp.DFC_ComFrbd_635h_HVBAT_NEG_CONT_COUNT_SEG1_C DFES_FaultTyp.DFC_ComFrbd_635h_HVBAT_NEG_CONT_COUNT_SEG3_C DFES_FaultTyp.DFC_ComFrbd_635h_HVBAT_NEG_CONT_COUNT_SEG4_C DFES_FaultTyp.DFC_ComFrbd_635h_HVBAT_PST_CONT_COUNT_SEG1_C DFES_FaultTyp.DFC_ComFrbd_635h_HVBAT_PST_CONT_COUNT_SEG3_C DFES_FaultTyp.DFC_ComFrbd_635h_HVBAT_PST_CONT_COUNT_SEG4_C DFES_FaultTyp.DFC_ComFrbd_645h_HVBAT_PRECHRGE_CONT_COUNT_SEG1_C DFES_FaultTyp.DFC_ComFrbd_645h_HVBAT_PRECHRGE_CONT_COUNT_SEG2_C DFES_FaultTyp.DFC_ComFrbd_675h_HVBAT_REMAININGBATTCAPACITY_C DFES_FaultTyp.DFC_ComInvld_205h_HVBAT_CHARGING_STATUS_C DFES_FaultTyp.DFC_ComInvld_205h_HVBAT_PACK_CURRENT_C DFES_FaultTyp.DFC_ComInvld_205h_HVBAT_SOC_DISPLAY_C DFES_FaultTyp.DFC_ComInvld_205h_HVBAT_VOLTAGE_C DFES_FaultTyp.DFC_ComInvld_217h_INV_DC_BUS_VOLTAGE_C DFES_FaultTyp.DFC_ComInvld_217h_INV_MTR_ACTUAL_TRQ_C DFES_FaultTyp.DFC_ComInvld_217h_INV_MTR_SPEED_C DFES_FaultTyp.DFC_ComInvld_217h_INV_MTR_TRQ_C DFES_FaultTyp.DFC_ComInvld_227h_INV_DC_CURRENT_C DFES_FaultTyp.DFC_ComInvld_227h_INV_MOTORING_PEAK_TRQ_C DFES_FaultTyp.DFC_ComInvld_227h_INV_MTR_INST_INPUT_POWER_C DFES_FaultTyp.DFC_ComInvld_227h_INV_REGEN_PEAK_TRQ_C DFES_FaultTyp.DFC_ComInvld_237h_INV_ACTIVE_DISCHARGE_STATUS_C DFES_FaultTyp.DFC_ComInvld_237h_INV_FAULT_LEVEL_C DFES_FaultTyp.DFC_ComInvld_237h_INV_STAB_MIN_TRQ_C DFES_FaultTyp.DFC_ComInvld_259h_TGLM_MODE_PUSH_C DFES_FaultTyp.DFC_ComInvld_259h_TOGGLE_MONOSTABLE_POS_C DFES_FaultTyp.DFC_ComInvld_26h_AC_SWITCH_REQ_C DFES_FaultTyp.DFC_ComInvld_26h_BLOWER_POSITION_C DFES_FaultTyp.DFC_ComInvld_26h_EVAP_SENSOR_FAULT_C DFES_FaultTyp.DFC_ComInvld_26h_EVAP_SENSOR_VALUE_C DFES_FaultTyp.DFC_ComInvld_26h_POTENTIOMETER_FAULT_C DFES_FaultTyp.DFC_ComInvld_26h_REAR_DEFOG_REQ_C DFES_FaultTyp.DFC_ComInvld_26h_TEMP_POSITION_C DFES_FaultTyp.DFC_ComInvld_273h_OBC_FAULT_LEVEL_C DFES_FaultTyp.DFC_ComInvld_273h_OBC_outputpower_capability_C DFES_FaultTyp.DFC_ComInvld_275h_HVBAT_DISCHARGE_30S_AVAILABLE_CURRENT_C DFES_FaultTyp.DFC_ComInvld_275h_HVBAT_DISCHARGE_30S_AVAILABLE_POWER_C DFES_FaultTyp.DFC_ComInvld_283h_DCDC_IN_CURRENT_C DFES_FaultTyp.DFC_ComInvld_283h_DCDC_IN_VOLTAGE_C DFES_FaultTyp.DFC_ComInvld_283h_DCDC_OUT_CURRENT_C DFES_FaultTyp.DFC_ComInvld_283h_DCDC_OUT_VOLTAGE_C DFES_FaultTyp.DFC_ComInvld_285h_HVBAT_REGEN_CHG_30S_CURRENT_LIMIT_C DFES_FaultTyp.DFC_ComInvld_285h_HVBAT_REGEN_CHRG_30S_POWER_LIMIT_C DFES_FaultTyp.DFC_ComInvld_293h_DCDC_FAULT_LEVEL_C DFES_FaultTyp.DFC_ComInvld_293h_DCDC_outputpower_capability_C DFES_FaultTyp.DFC_ComInvld_325h_HVBAT_EPLUG_STATUS_C DFES_FaultTyp.DFC_ComInvld_325h_HVBAT_HVIL_STS_C DFES_FaultTyp.DFC_ComInvld_325h_HVBAT_INSULATION_FAULT_C DFES_FaultTyp.DFC_ComInvld_325h_HVBAT_INSULATION_RESISTANCE_C DFES_FaultTyp.DFC_ComInvld_325h_HVBAT_TEMPERATURE_C DFES_FaultTyp.DFC_ComInvld_335h_HVBAT_CHRG_CONTINUOUS_CURR_MAX_C DFES_FaultTyp.DFC_ComInvld_335h_HVBAT_CHRG_COTINUOUS_CURR_REQ_C DFES_FaultTyp.DFC_ComInvld_335h_HVBAT_CHRG_MAX_VOLT_C DFES_FaultTyp.DFC_ComInvld_335h_HVBAT_DC_BUS_VOLTAGE_C DFES_FaultTyp.DFC_ComInvld_38Dh_VITESSE_VEHICULE_ROUES_C DFES_FaultTyp.DFC_ComInvld_38Dh_VVH_INDISP_C DFES_FaultTyp.DFC_ComInvld_427h_INV_COOLANT_TEMP_C DFES_FaultTyp.DFC_ComInvld_427h_INV_MOTOR_TEMP_C DFES_FaultTyp.DFC_ComInvld_427h_INV_OP_MODE_C DFES_FaultTyp.DFC_ComInvld_427h_INV_PERMISIBLE_TORQUE_C DFES_FaultTyp.DFC_ComInvld_427h_INV_TEMP_C DFES_FaultTyp.DFC_ComInvld_432h_REVEIL_PRINCIPAL_C DFES_FaultTyp.DFC_ComInvld_435h_HVBAT_MAX_CELL_VOLT_C DFES_FaultTyp.DFC_ComInvld_435h_HVBAT_MAX_CELL_VOLT_NUM_C DFES_FaultTyp.DFC_ComInvld_435h_HVBAT_MAX_SENSOR_TEMP_C DFES_FaultTyp.DFC_ComInvld_435h_HVBAT_MIN_CELL_VOLT_C DFES_FaultTyp.DFC_ComInvld_435h_HVBAT_MIN_CELL_VOLT_NUM_C DFES_FaultTyp.DFC_ComInvld_442h_BCCM_BLOWER_RELAY_STS_C DFES_FaultTyp.DFC_ComInvld_453h_OBC_IN_CURRENT_C DFES_FaultTyp.DFC_ComInvld_453h_OBC_IN_VOLTAGE_C DFES_FaultTyp.DFC_ComInvld_453h_OBC_IP_POWER_C DFES_FaultTyp.DFC_ComInvld_455h_HVBAT_NOMINAL_VOLTAGE_C DFES_FaultTyp.DFC_ComInvld_463h_OBC_OUT_CURRENT_C DFES_FaultTyp.DFC_ComInvld_463h_OBC_OUT_VOLTAGE_C DFES_FaultTyp.DFC_ComInvld_463h_OBC_TEMPERATURE_C DFES_FaultTyp.DFC_ComInvld_473h_DCDC_Coolant_Temperature_C DFES_FaultTyp.DFC_ComInvld_473h_DCDC_TEMPERATURE_C DFES_FaultTyp.DFC_ComInvld_47Bh_eCOMP_BusBarCurrent_C DFES_FaultTyp.DFC_ComInvld_47Bh_eCOMP_BusBarVoltage_C DFES_FaultTyp.DFC_ComInvld_47Bh_eCOMP_CompressorSpeed_C DFES_FaultTyp.DFC_ComInvld_47Bh_eCOMP_IGBT_Temp_C DFES_FaultTyp.DFC_ComInvld_47Bh_eCOMP_PeakPhaCurrent_C DFES_FaultTyp.DFC_ComInvld_47Bh_eCOMP_Power_consumption_C DFES_FaultTyp.DFC_ComInvld_4F2h_STATUS_SOC_C DFES_FaultTyp.DFC_ComInvld_4F2h_TEMP_BATT_STATUS_C DFES_FaultTyp.DFC_ComInvld_4F2h_VALEUR_SOC_ETENDUE_C DFES_FaultTyp.DFC_ComInvld_535h_HV_BATT_TEMP_AVG_C DFES_FaultTyp.DFC_ComInvld_543h_HVBAT_RESTBATTENERGY_C DFES_FaultTyp.DFC_ComInvld_543h_HVBAT_SOH_C DFES_FaultTyp.DFC_ComInvld_543h_HV_BATT_SOH_RES_C DFES_FaultTyp.DFC_ComInvld_552h_CPT_TEMPOREL_C DFES_FaultTyp.DFC_ComInvld_552h_KILOMETRAGE_C DFES_FaultTyp.DFC_ComInvld_583h_HV_BATT_DISCONT_CSE_OPEN_C DFES_FaultTyp.DFC_ComInvld_592h_CALIBRE_IBATT_C DFES_FaultTyp.DFC_ComInvld_592h_IBATT_1_C DFES_FaultTyp.DFC_ComInvld_592h_IBATT_2_C DFES_FaultTyp.DFC_ComInvld_592h_IBATT_3_C DFES_FaultTyp.DFC_ComInvld_592h_TEMP_BATT_C DFES_FaultTyp.DFC_ComInvld_592h_U_BATT_BECB_C DFES_FaultTyp.DFC_ComInvld_595h_HVBAT_TIME_TO_CHRG_80_C DFES_FaultTyp.DFC_ComInvld_5B2h_TEMP_AIR_EXT_C DFES_FaultTyp.DFC_ComInvld_5B5h_HVBAT_THERMAL_RUNAWAY_C DFES_FaultTyp.DFC_ComInvld_635h_HVBAT_NEG_CONT_COUNT_SEG1_C DFES_FaultTyp.DFC_ComInvld_635h_HVBAT_NEG_CONT_COUNT_SEG3_C DFES_FaultTyp.DFC_ComInvld_635h_HVBAT_NEG_CONT_COUNT_SEG4_C DFES_FaultTyp.DFC_ComInvld_635h_HVBAT_PST_CONT_COUNT_SEG1_C DFES_FaultTyp.DFC_ComInvld_635h_HVBAT_PST_CONT_COUNT_SEG3_C DFES_FaultTyp.DFC_ComInvld_635h_HVBAT_PST_CONT_COUNT_SEG4_C DFES_FaultTyp.DFC_ComInvld_645h_HVBAT_PRECHRGE_CONT_COUNT_SEG1_C DFES_FaultTyp.DFC_ComInvld_645h_HVBAT_PRECHRGE_CONT_COUNT_SEG2_C DFES_FaultTyp.DFC_ComInvld_675h_HVBAT_REMAININGBATTCAPACITY_C DFES_FaultTyp.DFC_ACCmprFltLvl1_C DFES_FaultTyp.DFC_ACCmprFltLvl2_C DFES_FaultTyp.DFC_ACCmprFltLvl3_C DFES_FaultTyp.DFC_ACCmprFltLvl4_C DFES_FaultTyp.DFC_ACCmprHiPFlt_C DFES_FaultTyp.DFC_ACCmprInvldCmprSt_C DFES_FaultTyp.DFC_ACCmprInvldElecActPwr_C DFES_FaultTyp.DFC_ACCmprLoPFlt_C DFES_FaultTyp.DFC_AcChrgrIntkTSRCMin_C DFES_FaultTyp.DFC_BattUBMaxBatt_C DFES_FaultTyp.DFC_BattUBMaxNoBatt_C DFES_FaultTyp.DFC_BattUBMinBatt_C DFES_FaultTyp.DFC_BattUBMinNoBatt_C DFES_FaultTyp.DFC_BattUSRCMax_C DFES_FaultTyp.DFC_BattUSRCMin_C DFES_FaultTyp.DFC_BrkBstPHiCautionDfct_C DFES_FaultTyp.DFC_BrkBstPHiWarnDfct_C DFES_FaultTyp.DFC_BrkBstPSnsr12PlausDfct_C DFES_FaultTyp.DFC_BrkBstPSnsr1Scb_C DFES_FaultTyp.DFC_BrkBstPSnsr1Scg_C DFES_FaultTyp.DFC_BrkBstPSnsr2Scb_C DFES_FaultTyp.DFC_BrkBstPSnsr2Scg_C DFES_FaultTyp.DFC_BrkBstPSnsrMax_C DFES_FaultTyp.DFC_BrkBstPSnsrMin_C DFES_FaultTyp.DFC_BrkBstPhyRngChkMax_C DFES_FaultTyp.DFC_BrkBstPhyRngChkMin_C DFES_FaultTyp.DFC_BrkBstPmpHsScb_C DFES_FaultTyp.DFC_BrkBstPmpHsScg_C DFES_FaultTyp.DFC_BrkBstPmpLsOl_C DFES_FaultTyp.DFC_BrkBstPmpLsScb_C DFES_FaultTyp.DFC_BrkBstPmpLsScg_C DFES_FaultTyp.DFC_CbnHeatgHeatrRlyOpend_C DFES_FaultTyp.DFC_CbnHeatgHeatrRlyWldd_C DFES_FaultTyp.DFC_CcsDcIBattExcdd_C DFES_FaultTyp.DFC_CcsDcIEvseOutDe_C DFES_FaultTyp.DFC_CcsDcIOutDe_C DFES_FaultTyp.DFC_CcsDcIOutExcdd_C DFES_FaultTyp.DFC_CcsDcUOutDe_C DFES_FaultTyp.DFC_CcsDcUOutExcdd_C DFES_FaultTyp.DFC_CcsPwrLineChpRstOL_C DFES_FaultTyp.DFC_CcsPwrLineChpRstOvrTemp_C DFES_FaultTyp.DFC_CcsPwrLineChpRstSCB_C DFES_FaultTyp.DFC_CcsPwrLineChpRstSCG_C DFES_FaultTyp.DFC_CcsPwrLineChpVccEnaOL_C DFES_FaultTyp.DFC_CcsPwrLineChpVccEnaOvrTemp_C DFES_FaultTyp.DFC_CcsPwrLineChpVccEnaSCB_C DFES_FaultTyp.DFC_CcsPwrLineChpVccEnaSCG_C DFES_FaultTyp.DFC_CcsPwrLineChpVccSRCMin_C DFES_FaultTyp.DFC_CcsPwrLineComChpTSRCMin_C DFES_FaultTyp.DFC_CtPSwtActrOL_C DFES_FaultTyp.DFC_CtPSwtActrOvrTemp_C DFES_FaultTyp.DFC_CtPSwtActrSCB_C DFES_FaultTyp.DFC_CtPSwtActrSCG_C DFES_FaultTyp.DFC_CtPSwtDiagSRCMin_C DFES_FaultTyp.DFC_CtpCarrFrqSRCMin_C DFES_FaultTyp.DFC_DcChrgrIntkT2SRCMin_C DFES_FaultTyp.DFC_DcChrgrIntkTSRCMin_C DFES_FaultTyp.DFC_DevLibBattUHi_C DFES_FaultTyp.DFC_DevLibBattULo_C DFES_FaultTyp.DFC_EmWakeupSigOL_C DFES_FaultTyp.DFC_EmWakeupSigOvrTemp_C DFES_FaultTyp.DFC_EmWakeupSigSCB_C DFES_FaultTyp.DFC_EmWakeupSigSCG_C DFES_FaultTyp.DFC_Fan1OL_C DFES_FaultTyp.DFC_Fan1OvrTemp_C DFES_FaultTyp.DFC_Fan1SCB_C DFES_FaultTyp.DFC_FanRlySCB_C DFES_FaultTyp.DFC_FanRlySCG_C DFES_FaultTyp.DFC_FanSpdSRCMin_C DFES_FaultTyp.DFC_FreonPSRCMin_C DFES_FaultTyp.DFC_HLCCcsPLnCChipTHi_C DFES_FaultTyp.DFC_HeatrCoreTSRCMin_C DFES_FaultTyp.DFC_PwmCtPSRCMin_C DFES_FaultTyp.DFC_PwrDistbnUnitTSRCMin_C DFES_FaultTyp.DFC_SCtPmp1OL_C DFES_FaultTyp.DFC_SCtPmp1OvrTemp_C DFES_FaultTyp.DFC_SCtPmp1SCB_C DFES_FaultTyp.DFC_SCtPmpRlyOL_C DFES_FaultTyp.DFC_SCtPmpRlyOvrTemp_C DFES_FaultTyp.DFC_SCtPmpRlySCB_C DFES_FaultTyp.DFC_SpplCooltPmpRlyOL_C DFES_FaultTyp.DFC_SpplCooltPmpRlyOvrTemp_C DFES_FaultTyp.DFC_SpplCooltPmpRlySCB_C DFES_FaultTyp.DFC_UCtPSRCMin_C DFES_FaultTyp.DFC_UPxP1SRCMin_C DFES_FaultTyp.DFC_ComHSN1CANMute_C DFES_FaultTyp.DFC_ComHSN3CANMute_C DFES_FaultTyp.DFC_AcChrgrIntkTPhysRngHi_C DFES_FaultTyp.DFC_AcChrgrIntkTPhysRngLo_C DFES_FaultTyp.DFC_AcChrgrIntkTSRCOpn_C DFES_FaultTyp.DFC_CcsPwrLineChpVccPhysRngHi_C DFES_FaultTyp.DFC_CcsPwrLineChpVccPhysRngLo_C DFES_FaultTyp.DFC_CcsPwrLineChpVccSRCOpn_C DFES_FaultTyp.DFC_CcsPwrLineComChpTPhysRngHi_C DFES_FaultTyp.DFC_CcsPwrLineComChpTPhysRngLo_C DFES_FaultTyp.DFC_CcsPwrLineComChpTSRCOpn_C DFES_FaultTyp.DFC_CtPSwtDiagPhysRngHi_C DFES_FaultTyp.DFC_CtPSwtDiagPhysRngLo_C DFES_FaultTyp.DFC_CtPSwtDiagSRCOpn_C DFES_FaultTyp.DFC_CtpCarrFrqPhysRngHi_C DFES_FaultTyp.DFC_CtpCarrFrqPhysRngLo_C DFES_FaultTyp.DFC_CtpCarrFrqSRCMax_C DFES_FaultTyp.DFC_DcChrgrIntkT2PhysRngHi_C DFES_FaultTyp.DFC_DcChrgrIntkT2PhysRngLo_C DFES_FaultTyp.DFC_DcChrgrIntkT2SRCOpn_C DFES_FaultTyp.DFC_DcChrgrIntkTPhysRngHi_C DFES_FaultTyp.DFC_DcChrgrIntkTPhysRngLo_C DFES_FaultTyp.DFC_DcChrgrIntkTSRCOpn_C DFES_FaultTyp.DFC_Fan1SCG_C DFES_FaultTyp.DFC_FanSpdPhysRngHi_C DFES_FaultTyp.DFC_FanSpdPhysRngLo_C DFES_FaultTyp.DFC_FanSpdSRCOpn_C DFES_FaultTyp.DFC_FreonPPhysRngHi_C DFES_FaultTyp.DFC_FreonPPhysRngLo_C DFES_FaultTyp.DFC_FreonPSRCOpn_C DFES_FaultTyp.DFC_HeatrCoreTPhysRngHi_C DFES_FaultTyp.DFC_HeatrCoreTPhysRngLo_C DFES_FaultTyp.DFC_HeatrCoreTSRCOpn_C DFES_FaultTyp.DFC_HvGridUMaxSftyLim_C DFES_FaultTyp.DFC_HvGridUMinSftyLim_C DFES_FaultTyp.DFC_HvGridUPlausy_C DFES_FaultTyp.DFC_IntlckChrgPlgHBrgOpnLd_C DFES_FaultTyp.DFC_IntlckChrgPlgHBrgOvrCurr_C DFES_FaultTyp.DFC_IntlckChrgPlgHBrgOvrTemp_C DFES_FaultTyp.DFC_IntlckChrgPlgHBrgShCirBatt1_C DFES_FaultTyp.DFC_IntlckChrgPlgHBrgShCirBatt2_C DFES_FaultTyp.DFC_IntlckChrgPlgHBrgShCirGnd1_C DFES_FaultTyp.DFC_IntlckChrgPlgHBrgShCirGnd2_C DFES_FaultTyp.DFC_IntlckChrgPlgHBrgShCirOvrLd_C DFES_FaultTyp.DFC_IntlckChrgPlgHBrgTempOvrCurr_C DFES_FaultTyp.DFC_IntlckChrgPlgHBrgUndrVltg_C DFES_FaultTyp.DFC_IntlckChrgPlgPosnRngFlt_C DFES_FaultTyp.DFC_IntlckChrgPlgPosnSrcMax_C DFES_FaultTyp.DFC_IntlckChrgPlgPosnSrcMin_C DFES_FaultTyp.DFC_PwmCtPPhysRngHi_C DFES_FaultTyp.DFC_PwmCtPPhysRngLo_C DFES_FaultTyp.DFC_PwmCtPSRCMax_C DFES_FaultTyp.DFC_PwrDistbnUnitTPhysRngHi_C DFES_FaultTyp.DFC_PwrDistbnUnitTPhysRngLo_C DFES_FaultTyp.DFC_PwrDistbnUnitTSRCOpn_C DFES_FaultTyp.DFC_SCtPmpRlySCG_C DFES_FaultTyp.DFC_SpplCooltPmpRlySCG_C DFES_FaultTyp.DFC_UCtPPhysRngHi_C DFES_FaultTyp.DFC_UCtPPhysRngLo_C DFES_FaultTyp.DFC_UCtPSRCOpn_C DFES_FaultTyp.DFC_UPxP1PhysRngHi_C DFES_FaultTyp.DFC_UPxP1PhysRngLo_C DFES_FaultTyp.DFC_UPxP1SRCOpn_C DFES_FaultTyp.DFC_VehVPhysRngHi_C DFES_FaultTyp.DFC_VehVPhysRngLo_C DFES_FaultTyp.DFC_VehVSigCan_C DFES_FaultTyp.DFC_VehVSigCanSafe_C DFES_FaultTyp.DFC_SCtPmp1DiagGrdKey1_C DFES_FaultTyp.DFC_SCtPmp1DiagGrdKey2_C DFES_FaultTyp.DFC_SCtPmp1DiagGrdKey3_C DFES_FaultTyp.DFC_SCtPmp1DiagGrdKey4_C DFES_FaultTyp.DFC_SCtPmp1DiagGrdKey5_C DFES_FaultTyp.DFC_ChrgPlgLiveCntctHzrdCcs_C DFES_FaultTyp.DFC_ChrgPlgProxPltImps_C DFES_FaultTyp.DFC_ChrgPlgTHiCcsDc_C DFES_FaultTyp.DFC_ElMActvDchaFailr_C DFES_FaultTyp.DFC_ElMActvDchaFlt_C DFES_FaultTyp.DFC_ElMFbdnIvtrModDrv01_C DFES_FaultTyp.DFC_ElMImobAuthent_C DFES_FaultTyp.DFC_ElMIsoMonFlt_C DFES_FaultTyp.DFC_ElMIsoMonPlausyFlt_C DFES_FaultTyp.DFC_ElMIvtrCooltT01_C DFES_FaultTyp.DFC_ElMIvtrEmgyShtDwn01_C DFES_FaultTyp.DFC_ElMIvtrFailr01_C DFES_FaultTyp.DFC_ElMIvtrIntlck01_C DFES_FaultTyp.DFC_ElMIvtrTErr01_C DFES_FaultTyp.DFC_ElMOverSpdNeg01_C DFES_FaultTyp.DFC_ElMOverSpdPos01_C DFES_FaultTyp.DFC_ElMOverTqNeg01_C DFES_FaultTyp.DFC_ElMOverTqPos01_C DFES_FaultTyp.DFC_ElMPwrAuthn_C DFES_FaultTyp.DFC_ElMSpdErr01_C DFES_FaultTyp.DFC_ElMSvs01_C DFES_FaultTyp.DFC_PEnvCcMax_C DFES_FaultTyp.DFC_PEnvCcMin_C DFES_FaultTyp.DFC_PEnvRngChkMax_C DFES_FaultTyp.DFC_PEnvRngChkMin_C DFES_FaultTyp.DFC_PEnvSnsrPlaus_C DFES_FaultTyp.DFC_BrkBstPmpPlausGenn_C DFES_FaultTyp.DFC_CbnHeatrRlyLfLoWarn_C DFES_FaultTyp.DFC_ChgrPlugLockPinByndClsd_C DFES_FaultTyp.DFC_ChgrPlugLockPinMoveWoCmd_C DFES_FaultTyp.DFC_ChgrPlugLockPinStuckInClsd_C DFES_FaultTyp.DFC_ChgrPlugLockPinStuckInOpen_C DFES_FaultTyp.DFC_ChrgrStErr_C DFES_FaultTyp.DFC_ComHSN1BusOff_C DFES_FaultTyp.DFC_ComHSN3BusOff_C DFES_FaultTyp.DFC_ComVCInval_C DFES_FaultTyp.DFC_EemDcdcPrecSpdInhb_C DFES_FaultTyp.DFC_ExpPwrLatch_C DFES_FaultTyp.DFC_FanMaxOvrd_C DFES_FaultTyp.DFC_HLCCcsGnrlComErr_C DFES_FaultTyp.DFC_InmLINNodeHVACPanelAbsnt_C DFES_FaultTyp.DFC_ResetRcvNotAllwd_C DFES_FaultTyp.DFC_TelltlCooltPlaus_C DFES_FaultTyp.DFC_MRlyOL_C DFES_FaultTyp.DFC_MRlySCB_C DFES_FaultTyp.DFC_MRlySCG_C DFES_FaultTyp.DFC_SSpMon1_C DFES_FaultTyp.DFC_SSpMon1OV_C DFES_FaultTyp.DFC_SSpMon1SCG_C DFES_FaultTyp.DFC_SSpMon1UV_C DFES_FaultTyp.DFC_SSpMon2_C DFES_FaultTyp.DFC_SSpMon2OV_C DFES_FaultTyp.DFC_SSpMon2SCG_C DFES_FaultTyp.DFC_SSpMon2UV_C DFES_FaultTyp.DFC_SSpMon3_C DFES_FaultTyp.DFC_SSpMon3OV_C DFES_FaultTyp.DFC_SSpMon3SCG_C DFES_FaultTyp.DFC_SSpMon3UV_C DFES_FaultTyp.DFC_CANSM_E_BUS_OFF_NETWORK_HSN1_CAN_C DFES_FaultTyp.DFC_CANSM_E_BUS_OFF_NETWORK_HSN3_CAN_C DFES_FaultTyp.DFC_CANSM_E_BUS_OFF_NETWORK_HSN4_CAN_C DFES_FaultTyp.DFC_CANSM_E_BUS_OFF_NETWORK_XCP_CAN_C DFES_FaultTyp.DFC_CANTRCV_E_NO_TRCV_CONTROL_0_C DFES_FaultTyp.DFC_CAN_E_TIMEOUT_C DFES_FaultTyp.DFC_COMM_E_NET_START_IND_CHANNEL_0_C DFES_FaultTyp.DFC_COMM_E_NET_START_IND_CHANNEL_1_C DFES_FaultTyp.DFC_COMM_E_NET_START_IND_CHANNEL_2_C DFES_FaultTyp.DFC_COMM_E_NET_START_IND_CHANNEL_3_C DFES_FaultTyp.DFC_COMM_E_NET_START_IND_CHANNEL_4_C DFES_FaultTyp.DFC_COMM_E_NET_START_IND_CHANNEL_5_C DFES_FaultTyp.DFC_LIN_E_TIMEOUT_C DFES_FaultTyp.DFC_rba_EcuCtrl_TOMaxProlg_C DFES_FaultTyp.DFC_rba_EcuCtrl_TOMaxShutDwn_C DFES_FaultTyp.DFC_rba_MultiStackTrace_Threshold_C DFES_FaultTyp.DFC_rba_SyC_CustStates_Degraded_disord_Event_C DFES_FaultTyp.DFC_rba_SyC_CustStates_Degraded_incst_Event_C DFES_FaultTyp.DFC_rba_SyC_CustStates_TransNoWakReq_Event_C DFES_FaultTyp.DFC_RBA_IOEXTLIB_KEEPALIVE_DRV_C DFES_FaultTyp.DFC_RBA_IOEXTLIB_KEEPALIVE_INI_C DFES_FaultTyp.DFC_rba_IoSigRtc_StopCounter_C DFES_FaultTyp.DFC_rba_MRly_Diag_Stk_Event_C DFES_FaultTyp.DFC_rba_MemDiag_MemReadErr_C DFES_FaultTyp.DFC_rba_MemDiag_MemWrErr_C DFES_FaultTyp.DFC_rba_SyC_IrrSwOffTrigEngRun_Event_C DFES_FaultTyp.DFC_AcChrgrIntkTSRCMax_C DFES_FaultTyp.DFC_AcChrgrIntkTTmpErr_C DFES_FaultTyp.DFC_AcFlt_C DFES_FaultTyp.DFC_AppAllSnsrDfct_C DFES_FaultTyp.DFC_BattUPwrFail_C DFES_FaultTyp.DFC_BrkBstBkupOvrn_C DFES_FaultTyp.DFC_BrkBstPmpOvld_C DFES_FaultTyp.DFC_BrkPlausChk_C DFES_FaultTyp.DFC_CbnHeatgSwtTmpErr_C DFES_FaultTyp.DFC_CcsPwrLineChpVccSRCMax_C DFES_FaultTyp.DFC_CcsPwrLineChpVccTmpErr_C DFES_FaultTyp.DFC_CcsPwrLineComChpTSRCMax_C DFES_FaultTyp.DFC_CcsPwrLineComChpTTmpErr_C DFES_FaultTyp.DFC_ChgrPlugCtpCarrFrqErr_C DFES_FaultTyp.DFC_ChgrPlugCtpSwtStuckClsd_C DFES_FaultTyp.DFC_ChgrPlugCtpSwtStuckOpen_C DFES_FaultTyp.DFC_ChgrPlugCtpUErrHi_C DFES_FaultTyp.DFC_ChgrPlugPxp1SrcErr_C DFES_FaultTyp.DFC_ChrgCntctAllWldd_C DFES_FaultTyp.DFC_ChrgCntctNegOperErr_C DFES_FaultTyp.DFC_ChrgCntctNegOperWarn_C DFES_FaultTyp.DFC_ChrgCntctNegWldd_C DFES_FaultTyp.DFC_ChrgCntctPosOperErr_C DFES_FaultTyp.DFC_ChrgCntctPosOperWarn_C DFES_FaultTyp.DFC_ChrgCntctPosWldd_C DFES_FaultTyp.DFC_ChrgCntctStuckOpen_C DFES_FaultTyp.DFC_ChrgPlgIntlckFaild_C DFES_FaultTyp.DFC_ChrgnUnplRqrd_C DFES_FaultTyp.DFC_CoElMOffsCalibActv01_C DFES_FaultTyp.DFC_CtPSwtDiagSRCMax_C DFES_FaultTyp.DFC_CtPSwtDiagTmpErr_C DFES_FaultTyp.DFC_CtpCarrFrqTmpErr_C DFES_FaultTyp.DFC_DcChrgrIntkT2SRCMax_C DFES_FaultTyp.DFC_DcChrgrIntkT2TmpErr_C DFES_FaultTyp.DFC_DcChrgrIntkTSRCMax_C DFES_FaultTyp.DFC_DcChrgrIntkTTmpErr_C DFES_FaultTyp.DFC_EChrDvPlinCntrThdExcdd_C DFES_FaultTyp.DFC_EemDiagCtctrClsTout_C DFES_FaultTyp.DFC_EemDiagDcdcOffTOut_C DFES_FaultTyp.DFC_EemDiagHvCnsrOffTOut_C DFES_FaultTyp.DFC_EemDiagHvbOffTOut_C DFES_FaultTyp.DFC_FanSpdSRCMax_C DFES_FaultTyp.DFC_FanSpdTmpErr_C DFES_FaultTyp.DFC_FreonPSRCMax_C DFES_FaultTyp.DFC_FreonPTmpErr_C DFES_FaultTyp.DFC_HeatrCoreTSRCMax_C DFES_FaultTyp.DFC_HeatrCoreTTmpErr_C DFES_FaultTyp.DFC_HvGridSocMinLim_C DFES_FaultTyp.DFC_HvacBlwrFrntFlt_C DFES_FaultTyp.DFC_HvacEvapElecFlt_C DFES_FaultTyp.DFC_HvacEvapElecFltGnd_C DFES_FaultTyp.DFC_HvacKnobPosnFlt_C DFES_FaultTyp.DFC_InvBinID_C DFES_FaultTyp.DFC_InvCalID_C DFES_FaultTyp.DFC_InvErotan_C DFES_FaultTyp.DFC_InvVinID_C DFES_FaultTyp.DFC_MOXEMM_SMU_ALM0_0_C DFES_FaultTyp.DFC_MOXEMM_SMU_ALM0_1_C DFES_FaultTyp.DFC_MOXEMM_SMU_ALM0_10_C DFES_FaultTyp.DFC_MOXEMM_SMU_ALM0_11_C DFES_FaultTyp.DFC_MOXEMM_SMU_ALM0_13_C DFES_FaultTyp.DFC_MOXEMM_SMU_ALM0_14_C DFES_FaultTyp.DFC_MOXEMM_SMU_ALM0_2_C DFES_FaultTyp.DFC_MOXEMM_SMU_ALM0_22_C DFES_FaultTyp.DFC_MOXEMM_SMU_ALM0_23_C DFES_FaultTyp.DFC_MOXEMM_SMU_ALM0_4_C DFES_FaultTyp.DFC_MOXEMM_SMU_ALM0_5_C DFES_FaultTyp.DFC_MOXEMM_SMU_ALM0_7_C DFES_FaultTyp.DFC_MOXEMM_SMU_ALM0_8_C DFES_FaultTyp.DFC_MOXEMM_SMU_ALM10_16_C DFES_FaultTyp.DFC_MOXEMM_SMU_ALM10_17_C DFES_FaultTyp.DFC_MOXEMM_SMU_ALM10_21_C DFES_FaultTyp.DFC_MOXEMM_SMU_ALM11_0_C DFES_FaultTyp.DFC_MOXEMM_SMU_ALM11_1_C DFES_FaultTyp.DFC_MOXEMM_SMU_ALM11_2_C DFES_FaultTyp.DFC_MOXEMM_SMU_ALM11_3_C DFES_FaultTyp.DFC_MOXEMM_SMU_ALM11_4_C DFES_FaultTyp.DFC_MOXEMM_SMU_ALM11_5_C DFES_FaultTyp.DFC_MOXEMM_SMU_ALM11_8_C DFES_FaultTyp.DFC_MOXEMM_SMU_ALM11_9_C DFES_FaultTyp.DFC_MOXEMM_SMU_ALM1_0_C DFES_FaultTyp.DFC_MOXEMM_SMU_ALM1_1_C DFES_FaultTyp.DFC_MOXEMM_SMU_ALM1_10_C DFES_FaultTyp.DFC_MOXEMM_SMU_ALM1_11_C DFES_FaultTyp.DFC_MOXEMM_SMU_ALM1_13_C DFES_FaultTyp.DFC_MOXEMM_SMU_ALM1_14_C DFES_FaultTyp.DFC_MOXEMM_SMU_ALM1_2_C DFES_FaultTyp.DFC_MOXEMM_SMU_ALM1_22_C DFES_FaultTyp.DFC_MOXEMM_SMU_ALM1_23_C DFES_FaultTyp.DFC_MOXEMM_SMU_ALM1_4_C DFES_FaultTyp.DFC_MOXEMM_SMU_ALM1_5_C DFES_FaultTyp.DFC_MOXEMM_SMU_ALM1_7_C DFES_FaultTyp.DFC_MOXEMM_SMU_ALM1_8_C DFES_FaultTyp.DFC_MOXEMM_SMU_ALM21_0_C DFES_FaultTyp.DFC_MOXEMM_SMU_ALM21_16_C DFES_FaultTyp.DFC_MOXEMM_SMU_ALM21_3_C DFES_FaultTyp.DFC_MOXEMM_SMU_ALM2_1_C DFES_FaultTyp.DFC_MOXEMM_SMU_ALM2_10_C DFES_FaultTyp.DFC_MOXEMM_SMU_ALM2_11_C DFES_FaultTyp.DFC_MOXEMM_SMU_ALM2_13_C DFES_FaultTyp.DFC_MOXEMM_SMU_ALM2_14_C DFES_FaultTyp.DFC_MOXEMM_SMU_ALM2_22_C DFES_FaultTyp.DFC_MOXEMM_SMU_ALM2_23_C DFES_FaultTyp.DFC_MOXEMM_SMU_ALM2_4_C DFES_FaultTyp.DFC_MOXEMM_SMU_ALM2_5_C DFES_FaultTyp.DFC_MOXEMM_SMU_ALM2_7_C DFES_FaultTyp.DFC_MOXEMM_SMU_ALM2_8_C DFES_FaultTyp.DFC_MOXEMM_SMU_ALM6_0_C DFES_FaultTyp.DFC_MOXEMM_SMU_ALM6_11_C DFES_FaultTyp.DFC_MOXEMM_SMU_ALM6_12_C DFES_FaultTyp.DFC_MOXEMM_SMU_ALM6_14_C DFES_FaultTyp.DFC_MOXEMM_SMU_ALM6_15_C DFES_FaultTyp.DFC_MOXEMM_SMU_ALM6_17_C DFES_FaultTyp.DFC_MOXEMM_SMU_ALM6_18_C DFES_FaultTyp.DFC_MOXEMM_SMU_ALM6_20_C DFES_FaultTyp.DFC_MOXEMM_SMU_ALM6_21_C DFES_FaultTyp.DFC_MOXEMM_SMU_ALM6_25_C DFES_FaultTyp.DFC_MOXEMM_SMU_ALM6_4_C DFES_FaultTyp.DFC_MOXEMM_SMU_ALM6_5_C DFES_FaultTyp.DFC_MOXEMM_SMU_ALM6_7_C DFES_FaultTyp.DFC_MOXEMM_SMU_ALM6_8_C DFES_FaultTyp.DFC_MOXEMM_SMU_ALM7_1_C DFES_FaultTyp.DFC_MOXEMM_SMU_ALM7_12_C DFES_FaultTyp.DFC_MOXEMM_SMU_ALM7_13_C DFES_FaultTyp.DFC_MOXEMM_SMU_ALM7_14_C DFES_FaultTyp.DFC_MOXEMM_SMU_ALM7_15_C DFES_FaultTyp.DFC_MOXEMM_SMU_ALM7_16_C DFES_FaultTyp.DFC_MOXEMM_SMU_ALM7_17_C DFES_FaultTyp.DFC_MOXEMM_SMU_ALM7_2_C DFES_FaultTyp.DFC_MOXEMM_SMU_ALM7_20_C DFES_FaultTyp.DFC_MOXEMM_SMU_ALM7_25_C DFES_FaultTyp.DFC_MOXEMM_SMU_ALM7_26_C DFES_FaultTyp.DFC_MOXEMM_SMU_ALM7_28_C DFES_FaultTyp.DFC_MOXEMM_SMU_ALM7_29_C DFES_FaultTyp.DFC_MOXEMM_SMU_ALM7_30_C DFES_FaultTyp.DFC_MOXEMM_SMU_ALM7_31_C DFES_FaultTyp.DFC_MOXEMM_SMU_ALM8_0_C DFES_FaultTyp.DFC_MOXEMM_SMU_ALM8_1_C DFES_FaultTyp.DFC_MOXEMM_SMU_ALM8_10_C DFES_FaultTyp.DFC_MOXEMM_SMU_ALM8_11_C DFES_FaultTyp.DFC_MOXEMM_SMU_ALM8_12_C DFES_FaultTyp.DFC_MOXEMM_SMU_ALM8_16_C DFES_FaultTyp.DFC_MOXEMM_SMU_ALM8_18_C DFES_FaultTyp.DFC_MOXEMM_SMU_ALM8_2_C DFES_FaultTyp.DFC_MOXEMM_SMU_ALM8_3_C DFES_FaultTyp.DFC_MOXEMM_SMU_ALM8_31_C DFES_FaultTyp.DFC_MOXEMM_SMU_ALM8_4_C DFES_FaultTyp.DFC_MOXEMM_SMU_ALM9_0_C DFES_FaultTyp.DFC_MOXEMM_SMU_ALM9_15_C DFES_FaultTyp.DFC_MOXEMM_SMU_ALM9_3_C DFES_FaultTyp.DFC_MoCADCNTPBnk1_C DFES_FaultTyp.DFC_MoCADCTestVoltBnk1_C DFES_FaultTyp.DFC_MoCSOPICO_C DFES_FaultTyp.DFC_MoFAccr_C DFES_FaultTyp.DFC_MoFCbnPreCdngOvrheat_C DFES_FaultTyp.DFC_MoFCbnPreCdngTmrExpi_C DFES_FaultTyp.DFC_MoFEvMngtBms_C DFES_FaultTyp.DFC_MoFEvMngtDcdc_C DFES_FaultTyp.DFC_MoFEvMngtEm01_C DFES_FaultTyp.DFC_MoFEvMngtEm01BrkgToZr_C DFES_FaultTyp.DFC_MoFEvMngtEm01EngSpd_C DFES_FaultTyp.DFC_MoFEvMngtEm02EngSpd_C DFES_FaultTyp.DFC_MoFEvMngtEm02Lvl1_C DFES_FaultTyp.DFC_MoFEvMngtEm02Lvl2_C DFES_FaultTyp.DFC_MoFExtCptAuxCpt_C DFES_FaultTyp.DFC_MoFExtCptVacPmpErr_C DFES_FaultTyp.DFC_MoFTqPtdAxle_C DFES_FaultTyp.DFC_MoFTqPtdAxleSec_C DFES_FaultTyp.DFC_MoFTqPtdEmPtRels_C DFES_FaultTyp.DFC_MoFTqPtdEmPtRelsSec_C DFES_FaultTyp.DFC_MoFTqPtdEmSign_C DFES_FaultTyp.DFC_MoFTqPtdEmSignSec_C DFES_FaultTyp.DFC_MoFTqPtdEmTq_C DFES_FaultTyp.DFC_MoFTqPtdEmTqSec_C DFES_FaultTyp.DFC_MoFTqPtdVeh_C DFES_FaultTyp.DFC_MoFVarPostBldSel_C DFES_FaultTyp.DFC_MoSysCtrlReIni_C DFES_FaultTyp.DFC_MoXEMMHwLTMCUFW_C DFES_FaultTyp.DFC_MoXEMMHwLTMonBIST_C DFES_FaultTyp.DFC_MoXEMMHwLTRegMonTest_C DFES_FaultTyp.DFC_MoXEMMHwLTStbySMUAlvTest_C DFES_FaultTyp.DFC_MoXEMMHwLTTempSens_C DFES_FaultTyp.DFC_MoXEMMHwLTUCBCfg_C DFES_FaultTyp.DFC_MonEgyChrgnCoorr_AcChrgnWoMofRels_C DFES_FaultTyp.DFC_MonEgyChrgnCoorr_ChrgnAbortIgr_C DFES_FaultTyp.DFC_MonEgyChrgnCoorr_DcCntctFailr_C DFES_FaultTyp.DFC_MonEgyChrgnCoorr_ExtChrgnShtOffReq_C DFES_FaultTyp.DFC_MonEgyChrgnCoorr_ImpsChrgnMod_C DFES_FaultTyp.DFC_MonEgyChrgnCoorr_ImpsChrgnPrms_C DFES_FaultTyp.DFC_MonEgyChrgnCoorr_ImpsUDcIntk_C DFES_FaultTyp.DFC_MonEgyChrgnCoorr_PlgLockMovmt_C DFES_FaultTyp.DFC_MonEgyChrgnCoorr_VehCrashDetn_C DFES_FaultTyp.DFC_MonEgyChrgnErrReactn_SftySwt_C DFES_FaultTyp.DFC_MonEgyChrgnInlet_CcsPlgCtp_C DFES_FaultTyp.DFC_MonEgyChrgnInlet_CcsPlgCtpPwm_C DFES_FaultTyp.DFC_MonEgyChrgnInlet_CcsPlgLockCtrlImpsAtmpt_C DFES_FaultTyp.DFC_MonEgyChrgnInlet_CcsPlgLockSnsrSigRngChk_C DFES_FaultTyp.DFC_MonEgyChrgnInlet_CcsPlgLockStImps_C DFES_FaultTyp.DFC_MonEgyChrgnInlet_CcsPlgPxp_C DFES_FaultTyp.DFC_MonEgyChrgnT_Snsr1GrdtChk_C DFES_FaultTyp.DFC_MonEgyChrgnT_Snsr1SigRngChk_C DFES_FaultTyp.DFC_MonEgyChrgnT_Snsr2GrdtChk_C DFES_FaultTyp.DFC_MonEgyChrgnT_Snsr2SigRngChk_C DFES_FaultTyp.DFC_MonEgyChrgnT_SnsrDif_C DFES_FaultTyp.DFC_OCWDAABEActv_C DFES_FaultTyp.DFC_OCWDACom_C DFES_FaultTyp.DFC_OCWDAErrPin_C DFES_FaultTyp.DFC_OCWDAOvrVltg_C DFES_FaultTyp.DFC_PUmax_C DFES_FaultTyp.DFC_PwmCtPTmpErr_C DFES_FaultTyp.DFC_PwrDistbnUnitTSRCMax_C DFES_FaultTyp.DFC_PwrDistbnUnitTTmpErr_C DFES_FaultTyp.DFC_SCtPmp1DiagGrdKeyErr_C DFES_FaultTyp.DFC_SRCHighAPP1_C DFES_FaultTyp.DFC_SRCHighAPP2_C DFES_FaultTyp.DFC_SRCLowAPP1_C DFES_FaultTyp.DFC_SRCLowAPP2_C DFES_FaultTyp.DFC_SWReset_0_C DFES_FaultTyp.DFC_SWReset_1_C DFES_FaultTyp.DFC_SWReset_2_C DFES_FaultTyp.DFC_Sia_InvldCode_C DFES_FaultTyp.DFC_Sia_InvldKey_C DFES_FaultTyp.DFC_Sia_NoRespUCx_C DFES_FaultTyp.DFC_Sia_TprotRttp_C DFES_FaultTyp.DFC_StrtUpEvStandStillDeactvn_C DFES_FaultTyp.DFC_SyncAPP_C DFES_FaultTyp.DFC_UCtPSRCMax_C DFES_FaultTyp.DFC_UCtPTmpErr_C DFES_FaultTyp.DFC_UPxP1SRCMax_C DFES_FaultTyp.DFC_UPxP1TmpErr_C DFES_FaultTyp.DFC_VehVObd_C DFES_MonEvtMSK0_C DFES_MonEvtMSK1_C DFES_MonRepeat_C DFES_numClsDlt_CA DFES_numClsFaultCycl_CA DFES_numClsHealCycl_CA DFES_numClsPndDlt_CA DFES_numClsSvcDlt_CA DFES_numClsSVSFaultCycl_CA DFES_numClsSVSHealCycl_CA DFES_xAsgnEnvAllSetsDid_CA DFES_xAsgnFrzFrDid_CA DFES_xClsDltTrg_CA DFES_xClsFaultTrg_CA DFES_xClsFltMIL_CA DFES_xClsFltSVS_CA DFES_xClsHealTrg_CA DFES_xClsPndDltTrg_CA DFES_xClsPrio_CA DFES_xClsSvcDltTrg_CA DFES_xClsSVSFaultTrg_CA DFES_xClsSVSHealTrg_CA /end DEF_CHARACTERISTIC
 FUNCTION_VERSION "30000.70.0" /end FUNCTION
/begin FUNCTION DFP "30000.7.0 Diagnostic Fault Path" FUNCTION_VERSION "30000.7.0" /end FUNCTION
/begin FUNCTION DfpCl "1.1.0     support of DFP handling" FUNCTION_VERSION "1.1.0" /end FUNCTION
/begin FUNCTION DiaActr_ElecHBrdgDiag "1.9.0     Diagnostic service for electrical error detection on H-Bridge power stage outputs"
 /begin DEF_CHARACTERISTIC DiaActr_ElecHBrdgDiag_DbgSigId_C DiaActr_ElecHBrdgDiag_DbgSigType_C DiaActr_ElecHBrdgDiag_OlEnaSwtOff_C /end DEF_CHARACTERISTIC
 /begin LOC_MEASUREMENT DiaActr_ElecHBrdgDiag_HBrDiagInfo_mp DiaActr_ElecHBrdgDiag_HlfBrDiagInfo_mp DiaActr_ElecHBrdgDiag_nrDiagErr_mp DiaActr_ElecHBrdgDiag_OLSigErrInfo_mp DiaActr_ElecHBrdgDiag_ReasOLAbort_mp DiaActr_ElecHBrdgDiag_SigErrInfo_mp DiaActr_ElecHBrdgDiag_stAddOLDiag_mp DiaActr_ElecHBrdgDiag_stDiagCtrl_mp DiaActr_ElecHBrdgDiag_stDiagDi_mp DiaActr_ElecHBrdgDiag_stOLAbortReq_mp DiaActr_ElecHBrdgDiag_stOLDiagMode_mp DiaActr_ElecHBrdgDiag_stOLDiag_mp DiaActr_ElecHBrdgDiag_stSigQly_mp DiaActr_ElecHBrdgDiag_TestPlsReq_mp /end LOC_MEASUREMENT
 FUNCTION_VERSION "1.9.0" /end FUNCTION
/begin FUNCTION DiaActr_ElecPsDiag "1.6.0     Standardized electrical power stage diagnosis for discrete output signals"
 /begin DEF_CHARACTERISTIC DiaActr_ElecPsDiag_DbgSigId_C DiaActr_ElecPsDiag_DbgSigTyp_C DiaActr_ElecPsDiag_SigOutDurgOpenLd_C /end DEF_CHARACTERISTIC
 /begin LOC_MEASUREMENT DiaActrElecPsDiag_cntTestPlsTsk_mp DiaActrElecPsDiag_nrDiagErr_mp DiaActrElecPsDiag_nrTestPls_mp DiaActrElecPsDiag_stAttribOL_mp DiaActrElecPsDiag_stAttribOT_mp DiaActrElecPsDiag_stAttribSCB_mp DiaActrElecPsDiag_stAttribSCG_mp DiaActrElecPsDiag_stDsmDebOpenLoad_mp DiaActrElecPsDiag_stDsmDebOverT_mp DiaActrElecPsDiag_stDsmDebScb_mp DiaActrElecPsDiag_stDsmDebScg_mp DiaActrElecPsDiag_stErrCfgOpenLoad_mp DiaActrElecPsDiag_stErrCfgOverT_mp DiaActrElecPsDiag_stErrCfgScb_mp DiaActrElecPsDiag_stErrCfgScg_mp DiaActrElecPsDiag_stPrvTstRslt_mp DiaActrElecPsDiag_stSigCfg_mp DiaActrElecPsDiag_stSigErrInfo_mp DiaActrElecPsDiag_stSig_mp DiaActrElecPsDiag_stTestPls_mp DiaActrElecPsDiag_stTmngTestPls_mp DiaActrElecPsDiag_tiTstPls_mp DiaActrElecPsDiag_TstPlsCnt_Cfg_mp /end LOC_MEASUREMENT
 FUNCTION_VERSION "1.6.0" /end FUNCTION
/begin FUNCTION DiaBas_BufAcs "30000.8.0 Functions for platform independent access (swapping) to data stored in an MSB buffer" FUNCTION_VERSION "30000.8.0" /end FUNCTION
/begin FUNCTION DINH "30000.25.0Diagnostic Inhibit Handler"
 /begin IN_MEASUREMENT DINH_nrActvInhReas.FID_ElTSPwrChrgnOutErr DINH_nrActvInhReas.FID_ElTSPwrInActErr DINH_nrActvInhReas.FId_ACCmprFltPDiagEnad DINH_nrActvInhReas.FId_ACCmprInpErr DINH_nrActvInhReas.FId_ACpAC DINH_nrActvInhReas.FId_APP1SigPath DINH_nrActvInhReas.FId_APP2SigPath DINH_nrActvInhReas.FId_APPBrkErr DINH_nrActvInhReas.FId_APPVehVErr DINH_nrActvInhReas.FId_AcChrgrIntkTEnhdSRCMax DINH_nrActvInhReas.FId_AcChrgrIntkTFrzVal DINH_nrActvInhReas.FId_AcChrgrIntkTPhysRng DINH_nrActvInhReas.FId_AcChrgrIntkTRplVal DINH_nrActvInhReas.FId_AcChrgrIntkTSSpMon DINH_nrActvInhReas.FId_AcChrgrIntkTTmpErrCnt DINH_nrActvInhReas.FId_AcExtChrgrChrgn DINH_nrActvInhReas.FId_Airbg2MED DINH_nrActvInhReas.FId_AirbgAVSstCrash DINH_nrActvInhReas.FId_AirbgCan DINH_nrActvInhReas.FId_AirbgHw DINH_nrActvInhReas.FId_AirbgInpSigErr DINH_nrActvInhReas.FId_AirbgPWMErr DINH_nrActvInhReas.FId_AirbgPwmSrcErr DINH_nrActvInhReas.FId_BattUDiagEna DINH_nrActvInhReas.FId_BattUInvalid DINH_nrActvInhReas.FId_BattUReplcmt DINH_nrActvInhReas.FId_BattUVehVVld DINH_nrActvInhReas.FId_BlwrComErr DINH_nrActvInhReas.FId_BrkBstBrkSt DINH_nrActvInhReas.FId_BrkBstP DINH_nrActvInhReas.FId_BrkBstPEnaPrc DINH_nrActvInhReas.FId_BrkBstPFrzVal DINH_nrActvInhReas.FId_BrkBstPPlaus12FrznDfct DINH_nrActvInhReas.FId_BrkBstPPlaus12ReplcmtDfct DINH_nrActvInhReas.FId_BrkBstPReplVal DINH_nrActvInhReas.FId_BrkBstPSnsr1FrzDfct DINH_nrActvInhReas.FId_BrkBstPSnsr1ReplcmtDfct DINH_nrActvInhReas.FId_BrkBstPSnsr1SplyDfct DINH_nrActvInhReas.FId_BrkBstPSnsr2FrzDfct DINH_nrActvInhReas.FId_BrkBstPSnsr2ReplcmtDfct DINH_nrActvInhReas.FId_BrkBstPSnsr2SplyDfct DINH_nrActvInhReas.FId_BrkBstPmpActtnDiagEnad DINH_nrActvInhReas.FId_BrkBstPmpDeactvnDiagEnad DINH_nrActvInhReas.FId_BrkBstPmpLeakDiagEnad DINH_nrActvInhReas.FId_BrkBstPmpM1Err DINH_nrActvInhReas.FId_BrkBstPmpM2Err DINH_nrActvInhReas.FId_BrkBstPmpScgLsErr DINH_nrActvInhReas.FId_BrkBstPmpVacChkEna DINH_nrActvInhReas.FId_BrkBstTst DINH_nrActvInhReas.FId_BrkPlaus1Ena DINH_nrActvInhReas.FId_BrkPresAlrt DINH_nrActvInhReas.FId_BrkSigMaiCanFrzVal DINH_nrActvInhReas.FId_BrkSigMaiCanReplVal DINH_nrActvInhReas.FId_BrkStMnFinalDfct DINH_nrActvInhReas.FId_BrkStMnPrelDfct DINH_nrActvInhReas.FId_BrkStRdntFinalDfct DINH_nrActvInhReas.FId_BrkStRdntPrelDfct DINH_nrActvInhReas.FId_CanEifVehSpdVld DINH_nrActvInhReas.FId_CbnHeatgHeatrPsFlt DINH_nrActvInhReas.FId_CbnHeatgHeatrRlyDiagEnad DINH_nrActvInhReas.FId_CbnHeatgSwtFrzVal DINH_nrActvInhReas.FId_CbnHeatgSwtRplVal DINH_nrActvInhReas.FId_CbnHeatgSwtTmpErrCnt DINH_nrActvInhReas.FId_CcsDcStopChrgn DINH_nrActvInhReas.FId_CcsDcStopChrgnIDftl DINH_nrActvInhReas.FId_CcsPwrLineChpRstMonOff DINH_nrActvInhReas.FId_CcsPwrLineChpRstOff DINH_nrActvInhReas.FId_CcsPwrLineChpRstPsOff DINH_nrActvInhReas.FId_CcsPwrLineChpRstSnsr DINH_nrActvInhReas.FId_CcsPwrLineChpVccEnaMonOff DINH_nrActvInhReas.FId_CcsPwrLineChpVccEnaOff DINH_nrActvInhReas.FId_CcsPwrLineChpVccEnaPsOff DINH_nrActvInhReas.FId_CcsPwrLineChpVccEnaSnsr DINH_nrActvInhReas.FId_CcsPwrLineChpVccEnhdSRCMax DINH_nrActvInhReas.FId_CcsPwrLineChpVccFrzVal DINH_nrActvInhReas.FId_CcsPwrLineChpVccPhysRng DINH_nrActvInhReas.FId_CcsPwrLineChpVccRplVal DINH_nrActvInhReas.FId_CcsPwrLineChpVccSSpMon DINH_nrActvInhReas.FId_CcsPwrLineChpVccTmpErrCnt DINH_nrActvInhReas.FId_CcsPwrLineComChpTEnhdSRCMax DINH_nrActvInhReas.FId_CcsPwrLineComChpTFrzVal DINH_nrActvInhReas.FId_CcsPwrLineComChpTPhysRng DINH_nrActvInhReas.FId_CcsPwrLineComChpTRplVal DINH_nrActvInhReas.FId_CcsPwrLineComChpTSSpMon DINH_nrActvInhReas.FId_CcsPwrLineComChpTTmpErrCnt DINH_nrActvInhReas.FId_ChgrPlugCtpSwtSnsrActrErr DINH_nrActvInhReas.FId_ChgrPlugLockActrErr DINH_nrActvInhReas.FId_ChgrPlugLockSnsrErr DINH_nrActvInhReas.FId_ChgrPlugPxp1InhbDiagSrc DINH_nrActvInhReas.FId_ChgrPlugTPinDcErr DINH_nrActvInhReas.FId_ChrgPlgChrgrRlyWlddCcs DINH_nrActvInhReas.FId_ChrgPlugCtpDetnErr DINH_nrActvInhReas.FId_ChrgnCntctPsFlt DINH_nrActvInhReas.FId_ChrgnLmpChrgnFlt DINH_nrActvInhReas.FId_ChrgnLmpNoChrgn DINH_nrActvInhReas.FId_ChrgnUnplRqrd DINH_nrActvInhReas.FId_ChrgrRlyDcActNegErr DINH_nrActvInhReas.FId_ChrgrRlyDcActPosErr DINH_nrActvInhReas.FId_CmbdChrgnSysCntctErr DINH_nrActvInhReas.FId_CoElMDSQCanEMS01 DINH_nrActvInhReas.FId_CoElMErr01 DINH_nrActvInhReas.FId_CoPOMLimdPrpnHmi DINH_nrActvInhReas.FId_CoPOMMaxLimFltDetnPrim DINH_nrActvInhReas.FId_CoPOMMinLimFltDetnPrim DINH_nrActvInhReas.FId_CoPOMNoPrpnHmi DINH_nrActvInhReas.FId_CoPOMRecupPwrRednHmi DINH_nrActvInhReas.FId_CoPOMRgnInhbnPrim DINH_nrActvInhReas.FId_CoVMEvSysCptMaxErrPrim01 DINH_nrActvInhReas.FId_CoVMEvSysCptMaxErrPrim02 DINH_nrActvInhReas.FId_CoVMEvSysCptMaxErrPrim03 DINH_nrActvInhReas.FId_CoVMEvSysCptMaxErrPrim04 DINH_nrActvInhReas.FId_CoVMEvSysCptMaxErrPrim05 DINH_nrActvInhReas.FId_CoVMEvSysCptMinErrPrim01 DINH_nrActvInhReas.FId_CoVMEvSysCptMinErrPrim02 DINH_nrActvInhReas.FId_CoVMEvSysCptMinErrPrim03 DINH_nrActvInhReas.FId_CoVMEvVehVVld DINH_nrActvInhReas.FId_ComHillHldFrmErr DINH_nrActvInhReas.FId_Com_stMainWkuInvld DINH_nrActvInhReas.FId_CtPSwtActrMonOff DINH_nrActvInhReas.FId_CtPSwtActrOff DINH_nrActvInhReas.FId_CtPSwtActrPsOff DINH_nrActvInhReas.FId_CtPSwtActrSnsr DINH_nrActvInhReas.FId_CtPSwtDiagEnhdSRCMax DINH_nrActvInhReas.FId_CtPSwtDiagFrzVal DINH_nrActvInhReas.FId_CtPSwtDiagPhysRng DINH_nrActvInhReas.FId_CtPSwtDiagRplVal DINH_nrActvInhReas.FId_CtPSwtDiagSSpMon DINH_nrActvInhReas.FId_CtPSwtDiagTmpErrCnt DINH_nrActvInhReas.FId_CtpCarrFrqFrzVal DINH_nrActvInhReas.FId_CtpCarrFrqPhysRng DINH_nrActvInhReas.FId_CtpCarrFrqRplVal DINH_nrActvInhReas.FId_CtpCarrFrqSSpMon DINH_nrActvInhReas.FId_CtpCarrFrqTmpErrCnt DINH_nrActvInhReas.FId_DELibAcChrgrIntkT DINH_nrActvInhReas.FId_DELibDcChrgrIntkT DINH_nrActvInhReas.FId_DELibEnvP DINH_nrActvInhReas.FId_DELibEnvT DINH_nrActvInhReas.FId_DELibHeatrCoreT DINH_nrActvInhReas.FId_DSMAUXWucVrnt5 DINH_nrActvInhReas.FId_DcChrgnCtrlChrgPrmExch DINH_nrActvInhReas.FId_DcChrgrIntkT2EnhdSRCMax DINH_nrActvInhReas.FId_DcChrgrIntkT2FrzVal DINH_nrActvInhReas.FId_DcChrgrIntkT2PhysRng DINH_nrActvInhReas.FId_DcChrgrIntkT2RplVal DINH_nrActvInhReas.FId_DcChrgrIntkT2SSpMon DINH_nrActvInhReas.FId_DcChrgrIntkT2TmpErrCnt DINH_nrActvInhReas.FId_DcChrgrIntkTEnhdSRCMax DINH_nrActvInhReas.FId_DcChrgrIntkTFrzVal DINH_nrActvInhReas.FId_DcChrgrIntkTPhysRng DINH_nrActvInhReas.FId_DcChrgrIntkTRplVal DINH_nrActvInhReas.FId_DcChrgrIntkTSSpMon DINH_nrActvInhReas.FId_DcChrgrIntkTTmpErrCnt DINH_nrActvInhReas.FId_DcdcDesOperModFwd DINH_nrActvInhReas.FId_DcdcPwrLoadMngtMaxPred DINH_nrActvInhReas.FId_DcdcUDesLvGrid DINH_nrActvInhReas.FId_DcmDspUDSStPwrLatch DINH_nrActvInhReas.FId_DrvDoorCANSigFault DINH_nrActvInhReas.FId_DrvInfoEgyAvlErr DINH_nrActvInhReas.FId_DrvModPosnApp DINH_nrActvInhReas.FId_DrvPrgSwtEna DINH_nrActvInhReas.FId_DrvStbltCANSigFault DINH_nrActvInhReas.FId_EBDLmpSig DINH_nrActvInhReas.FId_EVLmpBlnkIllmn DINH_nrActvInhReas.FId_EVLmpContIllmn DINH_nrActvInhReas.FId_EbsLinErr DINH_nrActvInhReas.FId_EemDcdcPrecErr DINH_nrActvInhReas.FId_EemDcdcUHVAct DINH_nrActvInhReas.FId_EemFltHvDcha DINH_nrActvInhReas.FId_EemFstHvShdwn DINH_nrActvInhReas.FId_EemHvBattMod DINH_nrActvInhReas.FId_EemHvOffTout DINH_nrActvInhReas.FId_EemHvShdwn DINH_nrActvInhReas.FId_EemNoHvStrtup DINH_nrActvInhReas.FId_ElMNoPrp01 DINH_nrActvInhReas.FId_ElMnLim01 DINH_nrActvInhReas.FId_ElMtrqLim01 DINH_nrActvInhReas.FId_ElSSACCmprUFlt DINH_nrActvInhReas.FId_ElSSCabAirHtUFlt DINH_nrActvInhReas.FId_ElSSHvReqEna DINH_nrActvInhReas.FId_ElSSUHvDcBus DINH_nrActvInhReas.FId_ElTSHvIntlck DINH_nrActvInhReas.FId_EmWakeupSigMonOff DINH_nrActvInhReas.FId_EmWakeupSigOff DINH_nrActvInhReas.FId_EmWakeupSigPsOff DINH_nrActvInhReas.FId_EmWakeupSigSnsr DINH_nrActvInhReas.FId_EmacUDcLnk01 DINH_nrActvInhReas.FId_EvThermLTClgDmdErr DINH_nrActvInhReas.FId_EvThermMTClgDmdErr DINH_nrActvInhReas.FId_Fan1ActrOff DINH_nrActvInhReas.FId_Fan1Mon DINH_nrActvInhReas.FId_Fan1Off DINH_nrActvInhReas.FId_Fan1PwrStg DINH_nrActvInhReas.FId_FanCtlFan1Err DINH_nrActvInhReas.FId_FanRlyDiagEnad DINH_nrActvInhReas.FId_FanSpdEnhdSRCMax DINH_nrActvInhReas.FId_FanSpdFrzVal DINH_nrActvInhReas.FId_FanSpdPhysRng DINH_nrActvInhReas.FId_FanSpdRplVal DINH_nrActvInhReas.FId_FanSpdSSpMon DINH_nrActvInhReas.FId_FanSpdTmpErrCnt DINH_nrActvInhReas.FId_FansFacCor DINH_nrActvInhReas.FId_FiMFID_rba_MRly_Diag_Stk DINH_nrActvInhReas.FId_FiMFID_test DINH_nrActvInhReas.FId_FreonPEnhdSRCMax DINH_nrActvInhReas.FId_FreonPFrzVal DINH_nrActvInhReas.FId_FreonPPhysRng DINH_nrActvInhReas.FId_FreonPRplVal DINH_nrActvInhReas.FId_FreonPSSpMon DINH_nrActvInhReas.FId_FreonPTmpErrCnt DINH_nrActvInhReas.FId_GlbDaLSumvXPtd DINH_nrActvInhReas.FId_HLCCcs_CoornPLnCChipTHi DINH_nrActvInhReas.FId_HLCCcs_CoornPLnCChpT /end IN_MEASUREMENT
 FUNCTION_VERSION "30000.25.0" /end FUNCTION
/begin COMPU_METHOD DFES_LampFltMIL "" TAB_VERB "%6.3" "-" COMPU_TAB_REF DFES_LampFltMIL /end COMPU_METHOD
/begin COMPU_VTAB DFES_LampFltMIL "" TAB_VERB 4 0 "NO_Lamp_Activation" 1 "Continous_Lamp_Support" 2 "Blinking_Lamp_Support" 3 "Blinking_and_Continous_Lamp_Supp" /end COMPU_VTAB
/begin COMPU_METHOD DFES_LampFltSVS "" TAB_VERB "%6.3" "-" COMPU_TAB_REF DFES_LampFltSVS /end COMPU_METHOD
/begin COMPU_VTAB DFES_LampFltSVS "" TAB_VERB 6 0 "NO_Lamp_Activation" 1 "Continous_Lamp_Support" 2 "Blinking_Lamp_Support" 3 "Blinking_and_Continous_Lamp_Supp" 4 "Continuous_SVS_Support_LDF" 8 "Continuous_SVS_Support_LDF_FLC" /end COMPU_VTAB
/begin COMPU_METHOD DFES_OneToOne "" RAT_FUNC "%6.2" "-" COEFFS 0 1 0 0 0 1 /end COMPU_METHOD
/begin COMPU_METHOD DFES_TstVisAndPrio "" TAB_VERB "%6.3" "-" COMPU_TAB_REF DFES_TstVisAndPrio /end COMPU_METHOD
/begin COMPU_VTAB DFES_TstVisAndPrio "" TAB_VERB 12 3 "invisible_for_all_Testers" 5 "ServiceLow" 7 "ServiceHigh" 9 "ServiceHigh_PrioOffs_1" 11 "ServiceHigh_PrioOffs_2" 205 "OBDLow" 207 "OBDHigh" 209 "OBDHighPlus" 211 "ServiceHigh_MaxPrio" 213 "ServiceHigh_OBDLow_MaxPrio" 215 "ServiceHigh_OBDHigh_MaxPrio" 217 "ServiceHigh_OBDHighPlus_MaxPrio" /end COMPU_VTAB
/begin COMPU_METHOD DiaActrElecPsDiag_stSig_COMPU_VERB "" TAB_VERB "%6.3" "" COMPU_TAB_REF DiaActrElecPsDiag_stSig_COMPU_VERB /end COMPU_METHOD
/begin COMPU_VTAB DiaActrElecPsDiag_stSig_COMPU_VERB "" TAB_VERB 7 0 "INVALID" 1 "NOTEST" 2 "NOFAULT" 3 "FAULT" 4 "PREFAULT" 5 "HEALFAULT" 6 "WAITSTATE" DEFAULT_VALUE "0" /end COMPU_VTAB
/begin COMPU_METHOD DiaActrElecPsDiag_stTestPls_COMPU_VERB "" TAB_VERB "%6.3" "" COMPU_TAB_REF DiaActrElecPsDiag_stTestPls_COMPU_VERB /end COMPU_METHOD
/begin COMPU_VTAB DiaActrElecPsDiag_stTestPls_COMPU_VERB "" TAB_VERB 5 1 "NO" 2 "REQUESTED" 3 "RUNNING" 4 "FINISHED" 5 "RE-TRIGGERED" DEFAULT_VALUE "1" /end COMPU_VTAB
/begin COMPU_METHOD DiaActrElecPsDiag_stTmngTestPls_COMPU_VERB "" TAB_VERB "%6.3" "" COMPU_TAB_REF DiaActrElecPsDiag_stTmngTestPls_COMPU_VERB /end COMPU_METHOD
/begin COMPU_VTAB DiaActrElecPsDiag_stTmngTestPls_COMPU_VERB "" TAB_VERB 4 1 "EVERY_RASTER" 2 "TIME_BETWEEN_TEST_1" 3 "TIME_BETWEEN_TEST_2" 0 "NO" DEFAULT_VALUE "0" /end COMPU_VTAB
/begin COMPU_METHOD DiaActr_ElecHBrdgDiag_DbgSigType_COMPU_VERB "" TAB_VERB "%6.3" "" COMPU_TAB_REF DiaActr_ElecHBrdgDiag_DbgSigType_COMPU_VERB /end COMPU_METHOD
/begin COMPU_VTAB DiaActr_ElecHBrdgDiag_DbgSigType_COMPU_VERB "" TAB_VERB 2 0 "HBR_SIGNAL" 1 "HLFBR_SIGNAL" DEFAULT_VALUE "0" /end COMPU_VTAB
/begin COMPU_METHOD DiaActr_ElecHBrdgDiag_OlEnaSwtOff_COMPU_VERB "" TAB_VERB "%6.3" "" COMPU_TAB_REF DiaActr_ElecHBrdgDiag_OlEnaSwtOff_COMPU_VERB /end COMPU_METHOD
/begin COMPU_VTAB DiaActr_ElecHBrdgDiag_OlEnaSwtOff_COMPU_VERB "" TAB_VERB 2 0 "NO_SWITCHOFF" 1 "SWITCHOFF" DEFAULT_VALUE "0" /end COMPU_VTAB
/begin COMPU_METHOD DiaActr_ElecPsDiag_DbgSigTyp_COMPU_VERB "" TAB_VERB "%6.3" "" COMPU_TAB_REF DiaActr_ElecPsDiag_DbgSigTyp_COMPU_VERB /end COMPU_METHOD
/begin COMPU_VTAB DiaActr_ElecPsDiag_DbgSigTyp_COMPU_VERB "" TAB_VERB 4 1 "DIGITAL_OUTPUT" 2 "PWM_OUTPUT" 3 "PMD_OUTPUT" 0 "NONE" DEFAULT_VALUE "0" /end COMPU_VTAB
/begin COMPU_METHOD DID_Verb "" TAB_VERB "%6.3" "" COMPU_TAB_REF DID_Verb /end COMPU_METHOD
/begin COMPU_VTAB DID_Verb "" TAB_VERB 253 0 "Unused" 256 "DID 0x0100" 3328 "DID 0x0D00" 3329 "DID 0x0D01" 4352 "DID 0x1100" 8448 "DID 0x2100" 8449 "DID 0x2101" 49154 "DID 0xC002" 54272 "DID 0xD400" 54273 "DID 0xD401" 54274 "DID 0xD402" 54275 "DID 0xD403" 54276 "DID 0xD404" 54278 "DID 0xD406" 54280 "DID 0xD408" 54281 "DID 0xD409" 54282 "DID 0xD40A" 54283 "DID 0xD40B" 54284 "DID 0xD40C" 54288 "DID 0xD410" 54289 "DID 0xD411" 54290 "DID 0xD412" 54291 "DID 0xD413" 54294 "DID 0xD416" 54298 "DID 0xD41A" 54304 "DID 0xD420" 54305 "DID 0xD421" 54307 "DID 0xD423" 54309 "DID 0xD425" 54312 "DID 0xD428" 54313 "DID 0xD429" 54315 "DID 0xD42B" 54316 "DID 0xD42C" 54318 "DID 0xD42E" 54319 "DID 0xD42F" 54322 "DID 0xD432" 54324 "DID 0xD434" 54330 "DID 0xD43A" 54341 "DID 0xD445" 54342 "DID 0xD446" 54343 "DID 0xD447" 54344 "DID 0xD448" 54345 "DID 0xD449" 54346 "DID 0xD44A" 54347 "DID 0xD44B" 54348 "DID 0xD44C" 54351 "DID 0xD44F" 54356 "DID 0xD454" 54357 "DID 0xD455" 54358 "DID 0xD456" 54359 "DID 0xD457" 54360 "DID 0xD458" 54361 "DID 0xD459" 54362 "DID 0xD45A" 54363 "DID 0xD45B" 54364 "DID 0xD45C" 54366 "DID 0xD45E" 54367 "DID 0xD45F" 54368 "DID 0xD460" 54374 "DID 0xD466" 54380 "DID 0xD46C" 54381 "DID 0xD46D" 54387 "DID 0xD473" 54388 "DID 0xD474" 54389 "DID 0xD475" 54390 "DID 0xD476" 54391 "DID 0xD477" 54393 "DID 0xD479" 54395 "DID 0xD47B" 54397 "DID 0xD47D" 54398 "DID 0xD47E" 54400 "DID 0xD480" 54403 "DID 0xD483" 54405 "DID 0xD485" 54412 "DID 0xD48C" 54413 "DID 0xD48D" 54420 "DID 0xD494" 54421 "DID 0xD495" 54422 "DID 0xD496" 54424 "DID 0xD498" 54425 "DID 0xD499" 54426 "DID 0xD49A" 54428 "DID 0xD49C" 54530 "DID 0xD502" 54531 "DID 0xD503" 54532 "DID 0xD504" 54533 "DID 0xD505" 54534 "DID 0xD506" 54535 "DID 0xD507" 54536 "DID 0xD508" 54538 "DID 0xD50A" 54550 "DID 0xD516" 54551 "DID 0xD517" 54553 "DID 0xD519" 54554 "DID 0xD51A" 54555 "DID 0xD51B" 54556 "DID 0xD51C" 54560 "DID 0xD520" 54561 "DID 0xD521" 54562 "DID 0xD522" 54563 "DID 0xD523" 54565 "DID 0xD525" 54566 "DID 0xD526" 54567 "DID 0xD527" 54570 "DID 0xD52A" 54572 "DID 0xD52C" 54575 "DID 0xD52F" 54576 "DID 0xD530" 54577 "DID 0xD531" 54578 "DID 0xD532" 54581 "DID 0xD535" 54586 "DID 0xD53A" 54587 "DID 0xD53B" 54589 "DID 0xD53D" 54590 "DID 0xD53E" 54591 "DID 0xD53F" 54592 "DID 0xD540" 54593 "DID 0xD541" 54596 "DID 0xD544" 54597 "DID 0xD545" 54598 "DID 0xD546" 54599 "DID 0xD547" 54600 "DID 0xD548" 54601 "DID 0xD549" 54604 "DID 0xD54C" 54605 "DID 0xD54D" 54606 "DID 0xD54E" 54607 "DID 0xD54F" 54608 "DID 0xD550" 54610 "DID 0xD552" 54611 "DID 0xD553" 54612 "DID 0xD554" 54613 "DID 0xD555" 54614 "DID 0xD556" 54615 "DID 0xD557" 54616 "DID 0xD558" 54617 "DID 0xD559" 54618 "DID 0xD55A" 54619 "DID 0xD55B" 54621 "DID 0xD55D" 54622 "DID 0xD55E" 54623 "DID 0xD55F" 54624 "DID 0xD560" 54625 "DID 0xD561" 54626 "DID 0xD562" 54627 "DID 0xD563" 54628 "DID 0xD564" 54629 "DID 0xD565" 54632 "DID 0xD568" 54633 "DID 0xD569" 54634 "DID 0xD56A" 54635 "DID 0xD56B" 54636 "DID 0xD56C" 54637 "DID 0xD56D" 54638 "DID 0xD56E" 54639 "DID 0xD56F" 54640 "DID 0xD570" 54641 "DID 0xD571" 54642 "DID 0xD572" 54643 "DID 0xD573" 54644 "DID 0xD574" 54647 "DID 0xD577" 54648 "DID 0xD578" 54650 "DID 0xD57A" 54651 "DID 0xD57B" 54652 "DID 0xD57C" 54653 "DID 0xD57D" 54654 "DID 0xD57E" 54655 "DID 0xD57F" 54656 "DID 0xD580" 54657 "DID 0xD581" 54658 "DID 0xD582" 54659 "DID 0xD583" 54660 "DID 0xD584" 54661 "DID 0xD585" 54662 "DID 0xD586" 54663 "DID 0xD587" 54664 "DID 0xD588" 54666 "DID 0xD58A" 54667 "DID 0xD58B" 54668 "DID 0xD58C" 54669 "DID 0xD58D" 54670 "DID 0xD58E" 54673 "DID 0xD591" 54676 "DID 0xD594" 54677 "DID 0xD595" 54678 "DID 0xD596" 54679 "DID 0xD597" 54680 "DID 0xD598" 54681 "DID 0xD599" 54682 "DID 0xD59A" 54683 "DID 0xD59B" 54684 "DID 0xD59C" 54685 "DID 0xD59D" 54686 "DID 0xD59E" 54691 "DID 0xD5A3" 54692 "DID 0xD5A4" 54694 "DID 0xD5A6" 54696 "DID 0xD5A8" 54697 "DID 0xD5A9" 54700 "DID 0xD5AC" 54701 "DID 0xD5AD" 54702 "DID 0xD5AE" 54703 "DID 0xD5AF" 54704 "DID 0xD5B0" 54705 "DID 0xD5B1" 54706 "DID 0xD5B2" 54707 "DID 0xD5B3" 54708 "DID 0xD5B4" 54709 "DID 0xD5B5" 54710 "DID 0xD5B6" 54711 "DID 0xD5B7" 54712 "DID 0xD5B8" 54713 "DID 0xD5B9" 54714 "DID 0xD5BA" 54715 "DID 0xD5BB" 54717 "DID 0xD5BD" 54719 "DID 0xD5BF" 54721 "DID 0xD5C1" 54725 "DID 0xD5C5" 54726 "DID 0xD5C6" 54727 "DID 0xD5C7" 54728 "DID 0xD5C8" 54730 "DID 0xD5CA" 54731 "DID 0xD5CB" 54732 "DID 0xD5CC" 54733 "DID 0xD5CD" 54734 "DID 0xD5CE" 54737 "DID 0xD5D1" 54738 "DID 0xD5D2" 54739 "DID 0xD5D3" 54741 "DID 0xD5D5" 54742 "DID 0xD5D6" 54743 "DID 0xD5D7" 54744 "DID 0xD5D8" 54745 "DID 0xD5D9" 54746 "DID 0xD5DA" 54747 "DID 0xD5DB" 56321 "DID 0xDC01" 56322 "DID 0xDC02" 56323 "DID 0xDC03" 61456 "DID 0xF010" 61457 "DID 0xF011" 61458 "DID 0xF012" 61568 "DID 0xF080" 61693 "DID 0xF0FD" 61694 "DID 0xF0FE" 61824 "DID 0xF180" 61830 "DID 0xF186" 61835 "DID 0xF18B" 61836 "DID 0xF18C" 61840 "DID 0xF190" 61846 "DID 0xF196" /end COMPU_VTAB
/begin COMPU_METHOD DSMAUX_DTRGVerb "" TAB_VERB "%6.3" "-" COMPU_TAB_REF DSMAUX_DTRGVerb /end COMPU_METHOD
/begin COMPU_VTAB DSMAUX_DTRGVerb "" TAB_VERB 6 1 "DTRG_AlwaysTrue" 2 "DTRG_DrivingCycleFLC" 3 "DTRG_DrivingCycleHLC" 4 "DTRG_NoTrigger" 0 "DTRG_Time200ms" 5 "DTRG_WarmUpCycle" DEFAULT_VALUE "---" /end COMPU_VTAB
/begin COMPU_METHOD ETCtlGovRmp "" RAT_FUNC "%6.3" "s" COEFFS 0 0 1 0 0.0152587890625 0 /end COMPU_METHOD
/begin COMPU_METHOD ETCtlGov_p0q001 "" RAT_FUNC "%6.5" "-" COEFFS 0 1000 0 0 0 1 /end COMPU_METHOD
/begin COMPU_METHOD ETC_Act_SY_Compu "" TAB_VERB "%6.3" "" COMPU_TAB_REF ETC_Act_SY_Compu /end COMPU_METHOD
/begin COMPU_VTAB ETC_Act_SY_Compu "" TAB_VERB 2 0 "False" 1 "True" /end COMPU_VTAB
/begin COMPU_METHOD ETHIPCORETYPE_SC_Compu "" TAB_VERB "%6.3" "" COMPU_TAB_REF ETHIPCORETYPE_SC_Compu /end COMPU_METHOD
/begin COMPU_VTAB ETHIPCORETYPE_SC_Compu "" TAB_VERB 3 0 "0" 1 "1" 2 "2" /end COMPU_VTAB
/begin COMPU_METHOD ETHSWT_SC_Compu "" TAB_VERB "%6.3" "" COMPU_TAB_REF ETHSWT_SC_Compu /end COMPU_METHOD
/begin COMPU_VTAB ETHSWT_SC_Compu "" TAB_VERB 4 0 "0" 1 "1" 2 "2" 3 "3" /end COMPU_VTAB
/begin COMPU_METHOD ETHTSYN_SC_Compu "" TAB_VERB "%6.3" "" COMPU_TAB_REF ETHTSYN_SC_Compu /end COMPU_METHOD
/begin COMPU_VTAB ETHTSYN_SC_Compu "" TAB_VERB 2 0 "False" 1 "True" /end COMPU_VTAB
/begin COMPU_METHOD ETH_SC_Compu "" TAB_VERB "%6.3" "" COMPU_TAB_REF ETH_SC_Compu /end COMPU_METHOD
/begin COMPU_VTAB ETH_SC_Compu "" TAB_VERB 2 0 "False" 1 "True" /end COMPU_VTAB
/begin COMPU_METHOD ETKS_SY_Compu "" TAB_VERB "%6.3" "" COMPU_TAB_REF ETKS_SY_Compu /end COMPU_METHOD
/begin COMPU_VTAB ETKS_SY_Compu "" TAB_VERB 2 0 "No ETKS" 1 "ETKS" /end COMPU_VTAB
/begin COMPU_METHOD ETS_LEAN_SY_Compu "" RAT_FUNC "%6.2" "" COEFFS 0 1 0 0 0 1 /end COMPU_METHOD
/begin COMPU_METHOD ETS_NSC_SY_Compu "" RAT_FUNC "%6.2" "" COEFFS 0 1 0 0 0 1 /end COMPU_METHOD
/begin COMPU_METHOD OneToOne "" RAT_FUNC "%6.2" "-" COEFFS 0 1 0 0 0 1 /end COMPU_METHOD
/begin RECORD_LAYOUT ValA_Wu16 FNC_VALUES 1 UWORD COLUMN_DIR DIRECT /end RECORD_LAYOUT
/begin RECORD_LAYOUT ValA_Wu8 FNC_VALUES 1 UBYTE COLUMN_DIR DIRECT /end RECORD_LAYOUT
/begin RECORD_LAYOUT Val_Wu16 FNC_VALUES 1 UWORD COLUMN_DIR DIRECT /end RECORD_LAYOUT
/begin RECORD_LAYOUT Val_Wu32 FNC_VALUES 1 ULONG COLUMN_DIR DIRECT /end RECORD_LAYOUT
/begin RECORD_LAYOUT Val_Wu8 FNC_VALUES 1 UBYTE COLUMN_DIR DIRECT /end RECORD_LAYOUT
/end MODULE
/end PROJECT

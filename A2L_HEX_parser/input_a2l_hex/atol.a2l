ASAP2_VERSION 1 70
/begin PROJECT MDG1C "VC1CP091_STLA_N_D061I3"
/begin HEADER "" VERSION "VC1CP091_STLA_N_D061I3" PROJECT_NO MDG1C /end HEADER
/begin MODULE DIM ""
/begin MOD_COMMON "" BYTE_ORDER MSB_LAST ALIGNMENT_BYTE 1 ALIGNMENT_WORD 2 ALIGNMENT_LONG 4 ALIGNMENT_INT64 4 ALIGNMENT_FLOAT32_IEEE 4 ALIGNMENT_FLOAT64_IEEE 4 DATA_SIZE 32 /end MOD_COMMON
/begin CHARACTERISTIC DFES_DTCM.DFC_EbsLvBattUDiagFltLvl1_C "" VALUE 0x8024933A Val_Wu16 65535.00 DFES_OneToOne 0.00 65535.00 FORMAT "%8.2" /end CHARACTERISTIC
/begin CHARACTERISTIC DFES_DTCM.DFC_EbsLvBattUDiagFltLvl2_C "" VALUE 0x8024933C Val_Wu16 65535.00 DFES_OneToOne 0.00 65535.00 FORMAT "%8.2" /end CHARACTERISTIC
/begin CHARACTERISTIC DFES_DTCM.DFC_EbsLvBattUDiagLo_C "" VALUE 0x8024933E Val_Wu16 65535.00 DFES_OneToOne 0.00 65535.00 FORMAT "%8.2" /end CHARACTERISTIC
/begin CHARACTERISTIC DFES_DTCM.DFC_EbsSnsrSt_C "" VALUE 0x80249340 Val_Wu16 65535.00 DFES_OneToOne 0.00 65535.00 FORMAT "%8.2" /end CHARACTERISTIC
/begin CHARACTERISTIC DFES_DTCM.DFC_EbsSofASILErr_C "" VALUE 0x80249342 Val_Wu16 65535.00 DFES_OneToOne 0.00 65535.00 FORMAT "%8.2" /end CHARACTERISTIC
/begin CHARACTERISTIC DFES_DTCM.DFC_ElTSPtSysLimDrvErr_C "" VALUE 0x80249344 Val_Wu16 65535.00 DFES_OneToOne 0.00 65535.00 FORMAT "%8.2" /end CHARACTERISTIC
/begin CHARACTERISTIC DFES_DTCM.DFC_ElTSPtSysLimRgnErr_C "" VALUE 0x80249346 Val_Wu16 65535.00 DFES_OneToOne 0.00 65535.00 FORMAT "%8.2" /end CHARACTERISTIC
/begin CHARACTERISTIC DFES_DTCM.DFC_HLCCcsFwDwnl_C "" VALUE 0x80249348 Val_Wu16 65535.00 DFES_OneToOne 0.00 65535.00 FORMAT "%8.2" /end CHARACTERISTIC
/begin CHARACTERISTIC DFES_DTCM.DFC_HvBattChrgPwrMax_C "" VALUE 0x8024934A Val_Wu16 65535.00 DFES_OneToOne 0.00 65535.00 FORMAT "%8.2" /end CHARACTERISTIC
/begin CHARACTERISTIC DFES_DTCM.DFC_HvBattCrashDetd_C "" VALUE 0x8024934C Val_Wu16 65535.00 DFES_OneToOne 0.00 65535.00 FORMAT "%8.2" /end CHARACTERISTIC
/begin CHARACTERISTIC DFES_DTCM.DFC_HvBattDchaPwrMax_C "" VALUE 0x8024934E Val_Wu16 65535.00 DFES_OneToOne 0.00 65535.00 FORMAT "%8.2" /end CHARACTERISTIC
/begin CHARACTERISTIC DFES_DTCM.DFC_HvBattEmgyOff_C "" VALUE 0x80249350 Val_Wu16 65535.00 DFES_OneToOne 0.00 65535.00 FORMAT "%8.2" /end CHARACTERISTIC
/begin CHARACTERISTIC DFES_DTCM.DFC_HvBattEmgyOffIntlck_C "" VALUE 0x80249352 Val_Wu16 65535.00 DFES_OneToOne 0.00 65535.00 FORMAT "%8.2" /end CHARACTERISTIC
/begin CHARACTERISTIC DFES_DTCM.DFC_HvBattEmgyOffReq_C "" VALUE 0x80249354 Val_Wu16 65535.00 DFES_OneToOne 0.00 65535.00 FORMAT "%8.2" /end CHARACTERISTIC
/begin CHARACTERISTIC DFES_DTCM.DFC_HvBattFltMod_C "" VALUE 0x80249356 Val_Wu16 65535.00 DFES_OneToOne 0.00 65535.00 FORMAT "%8.2" /end CHARACTERISTIC
/begin CHARACTERISTIC DFES_DTCM.DFC_HvBattIReqToChrgrErr_C "" VALUE 0x80249358 Val_Wu16 65535.00 DFES_OneToOne 0.00 65535.00 FORMAT "%8.2" /end CHARACTERISTIC
/begin CHARACTERISTIC DFES_DTCM.DFC_HvBattIReqToChrgrIni_C "" VALUE 0x8024935A Val_Wu16 65535.00 DFES_OneToOne 0.00 65535.00 FORMAT "%8.2" /end CHARACTERISTIC
/begin CHARACTERISTIC DFES_DTCM.DFC_HvBattIninTout_C "" VALUE 0x8024935C Val_Wu16 65535.00 DFES_OneToOne 0.00 65535.00 FORMAT "%8.2" /end CHARACTERISTIC
/begin CHARACTERISTIC DFES_DTCM.DFC_HvBattIntlckSt_C "" VALUE 0x8024935E Val_Wu16 65535.00 DFES_OneToOne 0.00 65535.00 FORMAT "%8.2" /end CHARACTERISTIC
/begin CHARACTERISTIC DFES_DTCM.DFC_HvBattIsoFlt_C "" VALUE 0x80249360 Val_Wu16 65535.00 DFES_OneToOne 0.00 65535.00 FORMAT "%8.2" /end CHARACTERISTIC
/begin CHARACTERISTIC DFES_DTCM.DFC_HvBattLimdPwr_C "" VALUE 0x80249362 Val_Wu16 65535.00 DFES_OneToOne 0.00 65535.00 FORMAT "%8.2" /end CHARACTERISTIC
/begin CHARACTERISTIC DFES_DTCM.DFC_HvBattMaiSwtClsngFlt_C "" VALUE 0x80249364 Val_Wu16 65535.00 DFES_OneToOne 0.00 65535.00 FORMAT "%8.2" /end CHARACTERISTIC
/begin CHARACTERISTIC DFES_DTCM.DFC_HvBattMaiSwtFlt_C "" VALUE 0x80249366 Val_Wu16 65535.00 DFES_OneToOne 0.00 65535.00 FORMAT "%8.2" /end CHARACTERISTIC
/begin CHARACTERISTIC DFES_DTCM.DFC_HvBattMaiSwtOpen_C "" VALUE 0x80249368 Val_Wu16 65535.00 DFES_OneToOne 0.00 65535.00 FORMAT "%8.2" /end CHARACTERISTIC
/begin CHARACTERISTIC DFES_DTCM.DFC_HvBattMaiSwtOpngFlt_C "" VALUE 0x8024936A Val_Wu16 65535.00 DFES_OneToOne 0.00 65535.00 FORMAT "%8.2" /end CHARACTERISTIC
/begin CHARACTERISTIC DFES_DTCM.DFC_HvBattMaiSwtWldd_C "" VALUE 0x8024936C Val_Wu16 65535.00 DFES_OneToOne 0.00 65535.00 FORMAT "%8.2" /end CHARACTERISTIC
/begin CHARACTERISTIC DFES_DTCM.DFC_HvBattNegCntctrCntErr_C "" VALUE 0x8024936E Val_Wu16 65535.00 DFES_OneToOne 0.00 65535.00 FORMAT "%8.2" /end CHARACTERISTIC
/begin CHARACTERISTIC DFES_DTCM.DFC_HvBattOperModChrgPlausy_C "" VALUE 0x80249370 Val_Wu16 65535.00 DFES_OneToOne 0.00 65535.00 FORMAT "%8.2" /end CHARACTERISTIC
/begin CHARACTERISTIC DFES_DTCM.DFC_HvBattOverTDern_C "" VALUE 0x80249372 Val_Wu16 65535.00 DFES_OneToOne 0.00 65535.00 FORMAT "%8.2" /end CHARACTERISTIC
/begin CHARACTERISTIC DFES_DTCM.DFC_HvBattPosCntctrCntErr_C "" VALUE 0x80249374 Val_Wu16 65535.00 DFES_OneToOne 0.00 65535.00 FORMAT "%8.2" /end CHARACTERISTIC
/begin CHARACTERISTIC DFES_DTCM.DFC_HvBattPrecCntctrCntErr_C "" VALUE 0x80249376 Val_Wu16 65535.00 DFES_OneToOne 0.00 65535.00 FORMAT "%8.2" /end CHARACTERISTIC
/begin CHARACTERISTIC DFES_DTCM.DFC_HvBattPwrDistbnTDern_C "" VALUE 0x80249378 Val_Wu16 65535.00 DFES_OneToOne 0.00 65535.00 FORMAT "%8.2" /end CHARACTERISTIC
/begin CHARACTERISTIC DFES_DTCM.DFC_HvBattPwrDistbnTInhbn_C "" VALUE 0x8024937A Val_Wu16 65535.00 DFES_OneToOne 0.00 65535.00 FORMAT "%8.2" /end CHARACTERISTIC
/begin CHARACTERISTIC DFES_DTCM.DFC_HvBattRatRSohErr_C "" VALUE 0x8024937C Val_Wu16 65535.00 DFES_OneToOne 0.00 65535.00 FORMAT "%8.2" /end CHARACTERISTIC
/begin CHARACTERISTIC DFES_DTCM.DFC_HvBattRatSohErr_C "" VALUE 0x8024937E Val_Wu16 65535.00 DFES_OneToOne 0.00 65535.00 FORMAT "%8.2" /end CHARACTERISTIC
/begin CHARACTERISTIC DFES_DTCM.DFC_HvBattSngIsoWarn_C "" VALUE 0x80249380 Val_Wu16 65535.00 DFES_OneToOne 0.00 65535.00 FORMAT "%8.2" /end CHARACTERISTIC
/begin CHARACTERISTIC DFES_DTCM.DFC_HvBattSrvPlgDiscnct_C "" VALUE 0x80249382 Val_Wu16 65535.00 DFES_OneToOne 0.00 65535.00 FORMAT "%8.2" /end CHARACTERISTIC
/begin CHARACTERISTIC DFES_DTCM.DFC_HvBattUNomChrgnErr_C "" VALUE 0x80249384 Val_Wu16 65535.00 DFES_OneToOne 0.00 65535.00 FORMAT "%8.2" /end CHARACTERISTIC
/begin CHARACTERISTIC DFES_DTCM.DFC_HvBattUNomChrgnIni_C "" VALUE 0x80249386 Val_Wu16 65535.00 DFES_OneToOne 0.00 65535.00 FORMAT "%8.2" /end CHARACTERISTIC
/begin CHARACTERISTIC DFES_DTCM.DFC_HvBattUnderTDern_C "" VALUE 0x80249388 Val_Wu16 65535.00 DFES_OneToOne 0.00 65535.00 FORMAT "%8.2" /end CHARACTERISTIC
/begin CHARACTERISTIC DFES_DTCM.DFC_HvbEVLmpBlink_C "" VALUE 0x8024938A Val_Wu16 65535.00 DFES_OneToOne 0.00 65535.00 FORMAT "%8.2" /end CHARACTERISTIC
/begin CHARACTERISTIC DFES_DTCM.DFC_HvbEVLmpCont_C "" VALUE 0x8024938C Val_Wu16 65535.00 DFES_OneToOne 0.00 65535.00 FORMAT "%8.2" /end CHARACTERISTIC
/begin CHARACTERISTIC DFES_DTCM.DFC_HvbSVSBlink_C "" VALUE 0x8024938E Val_Wu16 65535.00 DFES_OneToOne 0.00 65535.00 FORMAT "%8.2" /end CHARACTERISTIC
/begin CHARACTERISTIC DFES_DTCM.DFC_HvbSVSCont_C "" VALUE 0x80249390 Val_Wu16 65535.00 DFES_OneToOne 0.00 65535.00 FORMAT "%8.2" /end CHARACTERISTIC
/begin CHARACTERISTIC DFES_DTCM.DFC_InmLINBusBlk_C "" VALUE 0x80249392 Val_Wu16 65535.00 DFES_OneToOne 0.00 65535.00 FORMAT "%8.2" /end CHARACTERISTIC
/begin CHARACTERISTIC DFES_DTCM.DFC_PDUProgmFailr_C "" VALUE 0x80249394 Val_Wu16 65535.00 DFES_OneToOne 0.00 65535.00 FORMAT "%8.2" /end CHARACTERISTIC
/begin CHARACTERISTIC DFES_DTCM.DFC_PEnvSigRngMax_C "" VALUE 0x80249396 Val_Wu16 65535.00 DFES_OneToOne 0.00 65535.00 FORMAT "%8.2" /end CHARACTERISTIC
/begin CHARACTERISTIC DFES_DTCM.DFC_PEnvSigRngMin_C "" VALUE 0x80249398 Val_Wu16 65535.00 DFES_OneToOne 0.00 65535.00 FORMAT "%8.2" /end CHARACTERISTIC
/begin CHARACTERISTIC DFES_DTCM.DFC_PLnCChpDeactvnFaild_C "" VALUE 0x8024939A Val_Wu16 65535.00 DFES_OneToOne 0.00 65535.00 FORMAT "%8.2" /end CHARACTERISTIC
/begin CHARACTERISTIC DFES_DTCM.DFC_PrkgBrkFailr_C "" VALUE 0x8024939C Val_Wu16 65535.00 DFES_OneToOne 0.00 65535.00 FORMAT "%8.2" /end CHARACTERISTIC
/begin CHARACTERISTIC DFES_DTCM.DFC_PtSysLimErr_C "" VALUE 0x8024939E Val_Wu16 65535.00 DFES_OneToOne 0.00 65535.00 FORMAT "%8.2" /end CHARACTERISTIC
/begin CHARACTERISTIC DFES_DTCM.DFC_PwrMaxDchaShoLo_C "" VALUE 0x802493A0 Val_Wu16 65535.00 DFES_OneToOne 0.00 65535.00 FORMAT "%8.2" /end CHARACTERISTIC
/begin CHARACTERISTIC DFES_DTCM.DFC_SCtPmp1FailSafeNotSuc_C "" VALUE 0x802493A2 Val_Wu16 65535.00 DFES_OneToOne 0.00 65535.00 FORMAT "%8.2" /end CHARACTERISTIC
/begin CHARACTERISTIC DFES_DTCM.DFC_SCtPmp1SCG_C "" VALUE 0x802493A4 Val_Wu16 65535.00 DFES_OneToOne 0.00 65535.00 FORMAT "%8.2" /end CHARACTERISTIC
/begin CHARACTERISTIC DFES_DTCM.DFC_VehCoornDrvrNotPrsnt_C "" VALUE 0x802493A6 Val_Wu16 65535.00 DFES_OneToOne 0.00 65535.00 FORMAT "%8.2" /end CHARACTERISTIC
/begin CHARACTERISTIC DFES_DTCM.DFC_VehVCanAvl_C "" VALUE 0x802493A8 Val_Wu16 65535.00 DFES_OneToOne 0.00 65535.00 FORMAT "%8.2" /end CHARACTERISTIC
/begin CHARACTERISTIC DFES_DTCM.DFC_VehVCanErr_C "" VALUE 0x802493AA Val_Wu16 65535.00 DFES_OneToOne 0.00 65535.00 FORMAT "%8.2" /end CHARACTERISTIC
/begin CHARACTERISTIC DFES_DTCM.DFC_eTogFailrLvlRes_C "" VALUE 0x802493AC Val_Wu16 65535.00 DFES_OneToOne 0.00 65535.00 FORMAT "%8.2" /end CHARACTERISTIC
/begin CHARACTERISTIC DFES_DTCM.DFC_flgBrkMaiDiag_C "" VALUE 0x802493AE Val_Wu16 65535.00 DFES_OneToOne 0.00 65535.00 FORMAT "%8.2" /end CHARACTERISTIC
/begin CHARACTERISTIC DFES_DTCM.DFC_stHvbIsoMeasmtRes_C "" VALUE 0x802493B0 Val_Wu16 65535.00 DFES_OneToOne 0.00 65535.00 FORMAT "%8.2" /end CHARACTERISTIC
/begin CHARACTERISTIC DFES_DTCM.DFC_BrkBstPmpPLeakDfct_C "" VALUE 0x802493B2 Val_Wu16 65535.00 DFES_OneToOne 0.00 65535.00 FORMAT "%8.2" /end CHARACTERISTIC
/begin CHARACTERISTIC DFES_DTCM.DFC_Com082hTooShort_C "" VALUE 0x802493B4 Val_Wu16 65535.00 DFES_OneToOne 0.00 65535.00 FORMAT "%8.2" /end CHARACTERISTIC
/begin CHARACTERISTIC DFES_DTCM.DFC_Com092hTooShort_C "" VALUE 0x802493B6 Val_Wu16 65535.00 DFES_OneToOne 0.00 65535.00 FORMAT "%8.2" /end CHARACTERISTIC
/begin CHARACTERISTIC DFES_DTCM.DFC_Com205hAbsent_C "" VALUE 0x802493B8 Val_Wu16 65535.00 DFES_OneToOne 0.00 65535.00 FORMAT "%8.2" /end CHARACTERISTIC
/begin CHARACTERISTIC DFES_DTCM.DFC_Com205hChecksum_C "" VALUE 0x802493BA Val_Wu16 65535.00 DFES_OneToOne 0.00 65535.00 FORMAT "%8.2" /end CHARACTERISTIC
/begin CHARACTERISTIC DFES_DTCM.DFC_Com205hCounter_C "" VALUE 0x802493BC Val_Wu16 65535.00 DFES_OneToOne 0.00 65535.00 FORMAT "%8.2" /end CHARACTERISTIC
/begin CHARACTERISTIC DFES_DTCM.DFC_Com205hTooShort_C "" VALUE 0x802493BE Val_Wu16 65535.00 DFES_OneToOne 0.00 65535.00 FORMAT "%8.2" /end CHARACTERISTIC
/begin CHARACTERISTIC DFES_DTCM.DFC_Com217hAbsent_C "" VALUE 0x802493C0 Val_Wu16 65535.00 DFES_OneToOne 0.00 65535.00 FORMAT "%8.2" /end CHARACTERISTIC
/begin CHARACTERISTIC DFES_DTCM.DFC_Com217hChecksum_C "" VALUE 0x802493C2 Val_Wu16 65535.00 DFES_OneToOne 0.00 65535.00 FORMAT "%8.2" /end CHARACTERISTIC
/begin CHARACTERISTIC DFES_DTCM.DFC_Com217hCounter_C "" VALUE 0x802493C4 Val_Wu16 65535.00 DFES_OneToOne 0.00 65535.00 FORMAT "%8.2" /end CHARACTERISTIC
/begin CHARACTERISTIC DFES_DTCM.DFC_Com217hTooShort_C "" VALUE 0x802493C6 Val_Wu16 65535.00 DFES_OneToOne 0.00 65535.00 FORMAT "%8.2" /end CHARACTERISTIC
/begin CHARACTERISTIC DFES_DTCM.DFC_Com227hAbsent_C "" VALUE 0x802493C8 Val_Wu16 65535.00 DFES_OneToOne 0.00 65535.00 FORMAT "%8.2" /end CHARACTERISTIC
/begin CHARACTERISTIC DFES_DTCM.DFC_Com227hTooShort_C "" VALUE 0x802493CA Val_Wu16 65535.00 DFES_OneToOne 0.00 65535.00 FORMAT "%8.2" /end CHARACTERISTIC
/begin CHARACTERISTIC DFES_DTCM.DFC_Com237hAbsent_C "" VALUE 0x802493CC Val_Wu16 65535.00 DFES_OneToOne 0.00 65535.00 FORMAT "%8.2" /end CHARACTERISTIC
/begin CHARACTERISTIC DFES_DTCM.DFC_Com237hChecksum_C "" VALUE 0x802493CE Val_Wu16 65535.00 DFES_OneToOne 0.00 65535.00 FORMAT "%8.2" /end CHARACTERISTIC
/begin CHARACTERISTIC DFES_DTCM.DFC_Com237hCounter_C "" VALUE 0x802493D0 Val_Wu16 65535.00 DFES_OneToOne 0.00 65535.00 FORMAT "%8.2" /end CHARACTERISTIC
/begin CHARACTERISTIC DFES_DTCM.DFC_Com237hTooShort_C "" VALUE 0x802493D2 Val_Wu16 65535.00 DFES_OneToOne 0.00 65535.00 FORMAT "%8.2" /end CHARACTERISTIC
/begin CHARACTERISTIC DFES_DTCM.DFC_Com259hAbsent_C "" VALUE 0x802493D4 Val_Wu16 65535.00 DFES_OneToOne 0.00 65535.00 FORMAT "%8.2" /end CHARACTERISTIC
/begin CHARACTERISTIC DFES_DTCM.DFC_Com259hChecksum_C "" VALUE 0x802493D6 Val_Wu16 65535.00 DFES_OneToOne 0.00 65535.00 FORMAT "%8.2" /end CHARACTERISTIC
/begin CHARACTERISTIC DFES_DTCM.DFC_Com259hCounter_C "" VALUE 0x802493D8 Val_Wu16 65535.00 DFES_OneToOne 0.00 65535.00 FORMAT "%8.2" /end CHARACTERISTIC
/begin CHARACTERISTIC DFES_DTCM.DFC_Com259hTooShort_C "" VALUE 0x802493DA Val_Wu16 65535.00 DFES_OneToOne 0.00 65535.00 FORMAT "%8.2" /end CHARACTERISTIC
/begin CHARACTERISTIC DFES_DTCM.DFC_Com26hAbsent_C "" VALUE 0x802493DC Val_Wu16 65535.00 DFES_OneToOne 0.00 65535.00 FORMAT "%8.2" /end CHARACTERISTIC
/begin CHARACTERISTIC DFES_DTCM.DFC_Com26hTooShort_C "" VALUE 0x802493DE Val_Wu16 65535.00 DFES_OneToOne 0.00 65535.00 FORMAT "%8.2" /end CHARACTERISTIC
/begin CHARACTERISTIC DFES_DTCM.DFC_Com273hAbsent_C "" VALUE 0x802493E0 Val_Wu16 65535.00 DFES_OneToOne 0.00 65535.00 FORMAT "%8.2" /end CHARACTERISTIC
/begin CHARACTERISTIC DFES_DTCM.DFC_Com273hChecksum_C "" VALUE 0x802493E2 Val_Wu16 65535.00 DFES_OneToOne 0.00 65535.00 FORMAT "%8.2" /end CHARACTERISTIC
/begin CHARACTERISTIC DFES_DTCM.DFC_Com273hCounter_C "" VALUE 0x802493E4 Val_Wu16 65535.00 DFES_OneToOne 0.00 65535.00 FORMAT "%8.2" /end CHARACTERISTIC
/begin CHARACTERISTIC DFES_DTCM.DFC_Com273hTooShort_C "" VALUE 0x802493E6 Val_Wu16 65535.00 DFES_OneToOne 0.00 65535.00 FORMAT "%8.2" /end CHARACTERISTIC
/begin CHARACTERISTIC DFES_DTCM.DFC_Com275hAbsent_C "" VALUE 0x802493E8 Val_Wu16 65535.00 DFES_OneToOne 0.00 65535.00 FORMAT "%8.2" /end CHARACTERISTIC
/begin CHARACTERISTIC DFES_DTCM.DFC_Com275hChecksum_C "" VALUE 0x802493EA Val_Wu16 65535.00 DFES_OneToOne 0.00 65535.00 FORMAT "%8.2" /end CHARACTERISTIC
/begin CHARACTERISTIC DFES_DTCM.DFC_Com275hCounter_C "" VALUE 0x802493EC Val_Wu16 65535.00 DFES_OneToOne 0.00 65535.00 FORMAT "%8.2" /end CHARACTERISTIC
/begin CHARACTERISTIC DFES_DTCM.DFC_Com275hTooShort_C "" VALUE 0x802493EE Val_Wu16 65535.00 DFES_OneToOne 0.00 65535.00 FORMAT "%8.2" /end CHARACTERISTIC
/begin CHARACTERISTIC DFES_DTCM.DFC_Com283hAbsent_C "" VALUE 0x802493F0 Val_Wu16 65535.00 DFES_OneToOne 0.00 65535.00 FORMAT "%8.2" /end CHARACTERISTIC
/begin CHARACTERISTIC DFES_DTCM.DFC_Com283hTooShort_C "" VALUE 0x802493F2 Val_Wu16 65535.00 DFES_OneToOne 0.00 65535.00 FORMAT "%8.2" /end CHARACTERISTIC
/begin CHARACTERISTIC DFES_DTCM.DFC_Com285hAbsent_C "" VALUE 0x802493F4 Val_Wu16 65535.00 DFES_OneToOne 0.00 65535.00 FORMAT "%8.2" /end CHARACTERISTIC
/begin CHARACTERISTIC DFES_DTCM.DFC_Com285hChecksum_C "" VALUE 0x802493F6 Val_Wu16 65535.00 DFES_OneToOne 0.00 65535.00 FORMAT "%8.2" /end CHARACTERISTIC
/begin CHARACTERISTIC DFES_DTCM.DFC_Com285hCounter_C "" VALUE 0x802493F8 Val_Wu16 65535.00 DFES_OneToOne 0.00 65535.00 FORMAT "%8.2" /end CHARACTERISTIC
/begin CHARACTERISTIC DFES_DTCM.DFC_Com285hTooShort_C "" VALUE 0x802493FA Val_Wu16 65535.00 DFES_OneToOne 0.00 65535.00 FORMAT "%8.2" /end CHARACTERISTIC
/begin CHARACTERISTIC DFES_DTCM.DFC_Com293hAbsent_C "" VALUE 0x802493FC Val_Wu16 65535.00 DFES_OneToOne 0.00 65535.00 FORMAT "%8.2" /end CHARACTERISTIC
/begin CHARACTERISTIC DFES_DTCM.DFC_Com293hChecksum_C "" VALUE 0x802493FE Val_Wu16 65535.00 DFES_OneToOne 0.00 65535.00 FORMAT "%8.2" /end CHARACTERISTIC
/begin CHARACTERISTIC DFES_DTCM.DFC_Com293hCounter_C "" VALUE 0x80249400 Val_Wu16 65535.00 DFES_OneToOne 0.00 65535.00 FORMAT "%8.2" /end CHARACTERISTIC
/begin CHARACTERISTIC DFES_DTCM.DFC_Com293hTooShort_C "" VALUE 0x80249402 Val_Wu16 65535.00 DFES_OneToOne 0.00 65535.00 FORMAT "%8.2" /end CHARACTERISTIC
/begin CHARACTERISTIC DFES_DTCM.DFC_Com308hAbsent_C "" VALUE 0x80249404 Val_Wu16 65535.00 DFES_OneToOne 0.00 65535.00 FORMAT "%8.2" /end CHARACTERISTIC
/begin CHARACTERISTIC DFES_DTCM.DFC_Com308hChecksum_C "" VALUE 0x80249406 Val_Wu16 65535.00 DFES_OneToOne 0.00 65535.00 FORMAT "%8.2" /end CHARACTERISTIC
/begin CHARACTERISTIC DFES_DTCM.DFC_Com308hCounter_C "" VALUE 0x80249408 Val_Wu16 65535.00 DFES_OneToOne 0.00 65535.00 FORMAT "%8.2" /end CHARACTERISTIC
/begin CHARACTERISTIC DFES_DTCM.DFC_Com308hTooShort_C "" VALUE 0x8024940A Val_Wu16 65535.00 DFES_OneToOne 0.00 65535.00 FORMAT "%8.2" /end CHARACTERISTIC
/begin CHARACTERISTIC DFES_DTCM.DFC_Com318hAbsent_C "" VALUE 0x8024940C Val_Wu16 65535.00 DFES_OneToOne 0.00 65535.00 FORMAT "%8.2" /end CHARACTERISTIC
/begin CHARACTERISTIC DFES_DTCM.DFC_Com318hChecksum_C "" VALUE 0x8024940E Val_Wu16 65535.00 DFES_OneToOne 0.00 65535.00 FORMAT "%8.2" /end CHARACTERISTIC
/begin CHARACTERISTIC DFES_DTCM.DFC_Com318hCounter_C "" VALUE 0x80249410 Val_Wu16 65535.00 DFES_OneToOne 0.00 65535.00 FORMAT "%8.2" /end CHARACTERISTIC
/begin CHARACTERISTIC DFES_DTCM.DFC_Com318hTooShort_C "" VALUE 0x80249412 Val_Wu16 65535.00 DFES_OneToOne 0.00 65535.00 FORMAT "%8.2" /end CHARACTERISTIC
/begin CHARACTERISTIC DFES_DTCM.DFC_Com325hAbsent_C "" VALUE 0x80249414 Val_Wu16 65535.00 DFES_OneToOne 0.00 65535.00 FORMAT "%8.2" /end CHARACTERISTIC
/begin CHARACTERISTIC DFES_DTCM.DFC_Com325hChecksum_C "" VALUE 0x80249416 Val_Wu16 65535.00 DFES_OneToOne 0.00 65535.00 FORMAT "%8.2" /end CHARACTERISTIC
/begin CHARACTERISTIC DFES_DTCM.DFC_Com325hCounter_C "" VALUE 0x80249418 Val_Wu16 65535.00 DFES_OneToOne 0.00 65535.00 FORMAT "%8.2" /end CHARACTERISTIC
/begin CHARACTERISTIC DFES_DTCM.DFC_Com325hTooShort_C "" VALUE 0x8024941A Val_Wu16 65535.00 DFES_OneToOne 0.00 65535.00 FORMAT "%8.2" /end CHARACTERISTIC
/begin CHARACTERISTIC DFES_DTCM.DFC_Com335hAbsent_C "" VALUE 0x8024941C Val_Wu16 65535.00 DFES_OneToOne 0.00 65535.00 FORMAT "%8.2" /end CHARACTERISTIC
/begin CHARACTERISTIC DFES_DTCM.DFC_Com335hChecksum_C "" VALUE 0x8024941E Val_Wu16 65535.00 DFES_OneToOne 0.00 65535.00 FORMAT "%8.2" /end CHARACTERISTIC
/begin CHARACTERISTIC DFES_DTCM.DFC_Com335hCounter_C "" VALUE 0x80249420 Val_Wu16 65535.00 DFES_OneToOne 0.00 65535.00 FORMAT "%8.2" /end CHARACTERISTIC
/begin CHARACTERISTIC DFES_DTCM.DFC_Com335hTooShort_C "" VALUE 0x80249422 Val_Wu16 65535.00 DFES_OneToOne 0.00 65535.00 FORMAT "%8.2" /end CHARACTERISTIC
/begin CHARACTERISTIC DFES_DTCM.DFC_Com351hAbsent_C "" VALUE 0x80249424 Val_Wu16 65535.00 DFES_OneToOne 0.00 65535.00 FORMAT "%8.2" /end CHARACTERISTIC
/begin CHARACTERISTIC DFES_DTCM.DFC_Com351hTooShort_C "" VALUE 0x80249426 Val_Wu16 65535.00 DFES_OneToOne 0.00 65535.00 FORMAT "%8.2" /end CHARACTERISTIC
/begin CHARACTERISTIC DFES_DTCM.DFC_Com38DhAbsent_C "" VALUE 0x80249428 Val_Wu16 65535.00 DFES_OneToOne 0.00 65535.00 FORMAT "%8.2" /end CHARACTERISTIC
/begin CHARACTERISTIC DFES_DTCM.DFC_Com38DhChecksum_C "" VALUE 0x8024942A Val_Wu16 65535.00 DFES_OneToOne 0.00 65535.00 FORMAT "%8.2" /end CHARACTERISTIC
/begin CHARACTERISTIC DFES_DTCM.DFC_Com38DhCounter_C "" VALUE 0x8024942C Val_Wu16 65535.00 DFES_OneToOne 0.00 65535.00 FORMAT "%8.2" /end CHARACTERISTIC
/begin CHARACTERISTIC DFES_DTCM.DFC_Com38DhTooShort_C "" VALUE 0x8024942E Val_Wu16 65535.00 DFES_OneToOne 0.00 65535.00 FORMAT "%8.2" /end CHARACTERISTIC
/begin CHARACTERISTIC DFES_DTCM.DFC_Com412hAbsent_C "" VALUE 0x80249430 Val_Wu16 65535.00 DFES_OneToOne 0.00 65535.00 FORMAT "%8.2" /end CHARACTERISTIC
/begin CHARACTERISTIC DFES_DTCM.DFC_Com412hChecksum_C "" VALUE 0x80249432 Val_Wu16 65535.00 DFES_OneToOne 0.00 65535.00 FORMAT "%8.2" /end CHARACTERISTIC
/begin CHARACTERISTIC DFES_DTCM.DFC_Com412hCounter_C "" VALUE 0x80249434 Val_Wu16 65535.00 DFES_OneToOne 0.00 65535.00 FORMAT "%8.2" /end CHARACTERISTIC
/begin CHARACTERISTIC DFES_DTCM.DFC_Com412hTooShort_C "" VALUE 0x80249436 Val_Wu16 65535.00 DFES_OneToOne 0.00 65535.00 FORMAT "%8.2" /end CHARACTERISTIC
/begin CHARACTERISTIC DFES_DTCM.DFC_Com427hAbsent_C "" VALUE 0x80249438 Val_Wu16 65535.00 DFES_OneToOne 0.00 65535.00 FORMAT "%8.2" /end CHARACTERISTIC
/begin CHARACTERISTIC DFES_DTCM.DFC_Com427hTooShort_C "" VALUE 0x8024943A Val_Wu16 65535.00 DFES_OneToOne 0.00 65535.00 FORMAT "%8.2" /end CHARACTERISTIC
/begin CHARACTERISTIC DFES_DTCM.DFC_Com432hAbsent_C "" VALUE 0x8024943C Val_Wu16 65535.00 DFES_OneToOne 0.00 65535.00 FORMAT "%8.2" /end CHARACTERISTIC
/begin CHARACTERISTIC DFES_DTCM.DFC_Com432hChecksum_C "" VALUE 0x8024943E Val_Wu16 65535.00 DFES_OneToOne 0.00 65535.00 FORMAT "%8.2" /end CHARACTERISTIC
/begin CHARACTERISTIC DFES_DTCM.DFC_Com432hCounter_C "" VALUE 0x80249440 Val_Wu16 65535.00 DFES_OneToOne 0.00 65535.00 FORMAT "%8.2" /end CHARACTERISTIC
/begin CHARACTERISTIC DFES_DTCM.DFC_Com432hTooShort_C "" VALUE 0x80249442 Val_Wu16 65535.00 DFES_OneToOne 0.00 65535.00 FORMAT "%8.2" /end CHARACTERISTIC
/begin CHARACTERISTIC DFES_DTCM.DFC_Com435hAbsent_C "" VALUE 0x80249444 Val_Wu16 65535.00 DFES_OneToOne 0.00 65535.00 FORMAT "%8.2" /end CHARACTERISTIC
/begin CHARACTERISTIC DFES_DTCM.DFC_Com435hTooShort_C "" VALUE 0x80249446 Val_Wu16 65535.00 DFES_OneToOne 0.00 65535.00 FORMAT "%8.2" /end CHARACTERISTIC
/begin CHARACTERISTIC DFES_DTCM.DFC_Com442hAbsent_C "" VALUE 0x80249448 Val_Wu16 65535.00 DFES_OneToOne 0.00 65535.00 FORMAT "%8.2" /end CHARACTERISTIC
/begin CHARACTERISTIC DFES_DTCM.DFC_Com442hTooShort_C "" VALUE 0x8024944A Val_Wu16 65535.00 DFES_OneToOne 0.00 65535.00 FORMAT "%8.2" /end CHARACTERISTIC
/begin CHARACTERISTIC DFES_DTCM.DFC_Com453hAbsent_C "" VALUE 0x8024944C Val_Wu16 65535.00 DFES_OneToOne 0.00 65535.00 FORMAT "%8.2" /end CHARACTERISTIC
/begin CHARACTERISTIC DFES_DTCM.DFC_Com453hTooShort_C "" VALUE 0x8024944E Val_Wu16 65535.00 DFES_OneToOne 0.00 65535.00 FORMAT "%8.2" /end CHARACTERISTIC
/begin CHARACTERISTIC DFES_DTCM.DFC_Com455hAbsent_C "" VALUE 0x80249450 Val_Wu16 65535.00 DFES_OneToOne 0.00 65535.00 FORMAT "%8.2" /end CHARACTERISTIC
/begin CHARACTERISTIC DFES_DTCM.DFC_Com455hTooShort_C "" VALUE 0x80249452 Val_Wu16 65535.00 DFES_OneToOne 0.00 65535.00 FORMAT "%8.2" /end CHARACTERISTIC
/begin CHARACTERISTIC DFES_DTCM.DFC_Com463hAbsent_C "" VALUE 0x80249454 Val_Wu16 65535.00 DFES_OneToOne 0.00 65535.00 FORMAT "%8.2" /end CHARACTERISTIC
/begin CHARACTERISTIC DFES_DTCM.DFC_Com463hTooShort_C "" VALUE 0x80249456 Val_Wu16 65535.00 DFES_OneToOne 0.00 65535.00 FORMAT "%8.2" /end CHARACTERISTIC
/begin CHARACTERISTIC DFES_DTCM.DFC_Com473hAbsent_C "" VALUE 0x80249458 Val_Wu16 65535.00 DFES_OneToOne 0.00 65535.00 FORMAT "%8.2" /end CHARACTERISTIC
/begin CHARACTERISTIC DFES_DTCM.DFC_Com473hTooShort_C "" VALUE 0x8024945A Val_Wu16 65535.00 DFES_OneToOne 0.00 65535.00 FORMAT "%8.2" /end CHARACTERISTIC
/begin CHARACTERISTIC DFES_DTCM.DFC_Com47BhAbsent_C "" VALUE 0x8024945C Val_Wu16 65535.00 DFES_OneToOne 0.00 65535.00 FORMAT "%8.2" /end CHARACTERISTIC
/begin CHARACTERISTIC DFES_DTCM.DFC_Com47BhTooShort_C "" VALUE 0x8024945E Val_Wu16 65535.00 DFES_OneToOne 0.00 65535.00 FORMAT "%8.2" /end CHARACTERISTIC
/begin CHARACTERISTIC DFES_DTCM.DFC_Com48BhAbsent_C "" VALUE 0x80249460 Val_Wu16 65535.00 DFES_OneToOne 0.00 65535.00 FORMAT "%8.2" /end CHARACTERISTIC
/begin CHARACTERISTIC DFES_DTCM.DFC_Com48BhTooShort_C "" VALUE 0x80249462 Val_Wu16 65535.00 DFES_OneToOne 0.00 65535.00 FORMAT "%8.2" /end CHARACTERISTIC
/begin CHARACTERISTIC DFES_DTCM.DFC_Com497hTooShort_C "" VALUE 0x80249464 Val_Wu16 65535.00 DFES_OneToOne 0.00 65535.00 FORMAT "%8.2" /end CHARACTERISTIC
/begin CHARACTERISTIC DFES_DTCM.DFC_Com4F2hAbsent_C "" VALUE 0x80249466 Val_Wu16 65535.00 DFES_OneToOne 0.00 65535.00 FORMAT "%8.2" /end CHARACTERISTIC
/begin CHARACTERISTIC DFES_DTCM.DFC_Com4F2hChecksum_C "" VALUE 0x80249468 Val_Wu16 65535.00 DFES_OneToOne 0.00 65535.00 FORMAT "%8.2" /end CHARACTERISTIC
/begin CHARACTERISTIC DFES_DTCM.DFC_Com4F2hCounter_C "" VALUE 0x8024946A Val_Wu16 65535.00 DFES_OneToOne 0.00 65535.00 FORMAT "%8.2" /end CHARACTERISTIC
/begin CHARACTERISTIC DFES_DTCM.DFC_Com4F2hTooShort_C "" VALUE 0x8024946C Val_Wu16 65535.00 DFES_OneToOne 0.00 65535.00 FORMAT "%8.2" /end CHARACTERISTIC
/begin CHARACTERISTIC DFES_DTCM.DFC_Com50DhAbsent_C "" VALUE 0x8024946E Val_Wu16 65535.00 DFES_OneToOne 0.00 65535.00 FORMAT "%8.2" /end CHARACTERISTIC
/begin CHARACTERISTIC DFES_DTCM.DFC_Com50DhTooShort_C "" VALUE 0x80249470 Val_Wu16 65535.00 DFES_OneToOne 0.00 65535.00 FORMAT "%8.2" /end CHARACTERISTIC
/begin CHARACTERISTIC DFES_DTCM.DFC_Com535hAbsent_C "" VALUE 0x80249472 Val_Wu16 65535.00 DFES_OneToOne 0.00 65535.00 FORMAT "%8.2" /end CHARACTERISTIC
/begin CHARACTERISTIC DFES_DTCM.DFC_Com535hTooShort_C "" VALUE 0x80249474 Val_Wu16 65535.00 DFES_OneToOne 0.00 65535.00 FORMAT "%8.2" /end CHARACTERISTIC
/begin CHARACTERISTIC DFES_DTCM.DFC_Com543hAbsent_C "" VALUE 0x80249476 Val_Wu16 65535.00 DFES_OneToOne 0.00 65535.00 FORMAT "%8.2" /end CHARACTERISTIC
/begin CHARACTERISTIC DFES_DTCM.DFC_Com543hTooShort_C "" VALUE 0x80249478 Val_Wu16 65535.00 DFES_OneToOne 0.00 65535.00 FORMAT "%8.2" /end CHARACTERISTIC
/begin CHARACTERISTIC DFES_DTCM.DFC_Com552hAbsent_C "" VALUE 0x8024947A Val_Wu16 65535.00 DFES_OneToOne 0.00 65535.00 FORMAT "%8.2" /end CHARACTERISTIC
/begin CHARACTERISTIC DFES_DTCM.DFC_Com552hTooShort_C "" VALUE 0x8024947C Val_Wu16 65535.00 DFES_OneToOne 0.00 65535.00 FORMAT "%8.2" /end CHARACTERISTIC
/begin CHARACTERISTIC DFES_DTCM.DFC_Com583hAbsent_C "" VALUE 0x8024947E Val_Wu16 65535.00 DFES_OneToOne 0.00 65535.00 FORMAT "%8.2" /end CHARACTERISTIC
/begin CHARACTERISTIC DFES_DTCM.DFC_Com583hTooShort_C "" VALUE 0x80249480 Val_Wu16 65535.00 DFES_OneToOne 0.00 65535.00 FORMAT "%8.2" /end CHARACTERISTIC
/begin CHARACTERISTIC DFES_DTCM.DFC_Com592hAbsent_C "" VALUE 0x80249482 Val_Wu16 65535.00 DFES_OneToOne 0.00 65535.00 FORMAT "%8.2" /end CHARACTERISTIC
/begin CHARACTERISTIC DFES_DTCM.DFC_Com592hChecksum_C "" VALUE 0x80249484 Val_Wu16 65535.00 DFES_OneToOne 0.00 65535.00 FORMAT "%8.2" /end CHARACTERISTIC
/begin CHARACTERISTIC DFES_DTCM.DFC_Com592hCounter_C "" VALUE 0x80249486 Val_Wu16 65535.00 DFES_OneToOne 0.00 65535.00 FORMAT "%8.2" /end CHARACTERISTIC
/begin CHARACTERISTIC DFES_DTCM.DFC_Com592hTooShort_C "" VALUE 0x80249488 Val_Wu16 65535.00 DFES_OneToOne 0.00 65535.00 FORMAT "%8.2" /end CHARACTERISTIC
/begin CHARACTERISTIC DFES_DTCM.DFC_Com595hAbsent_C "" VALUE 0x8024948A Val_Wu16 65535.00 DFES_OneToOne 0.00 65535.00 FORMAT "%8.2" /end CHARACTERISTIC
/begin CHARACTERISTIC DFES_DTCM.DFC_Com595hChecksum_C "" VALUE 0x8024948C Val_Wu16 65535.00 DFES_OneToOne 0.00 65535.00 FORMAT "%8.2" /end CHARACTERISTIC
/begin CHARACTERISTIC DFES_DTCM.DFC_Com595hCounter_C "" VALUE 0x8024948E Val_Wu16 65535.00 DFES_OneToOne 0.00 65535.00 FORMAT "%8.2" /end CHARACTERISTIC
/begin CHARACTERISTIC DFES_DTCM.DFC_Com595hTooShort_C "" VALUE 0x80249490 Val_Wu16 65535.00 DFES_OneToOne 0.00 65535.00 FORMAT "%8.2" /end CHARACTERISTIC
/begin CHARACTERISTIC DFES_DTCM.DFC_Com5B2hAbsent_C "" VALUE 0x80249492 Val_Wu16 65535.00 DFES_OneToOne 0.00 65535.00 FORMAT "%8.2" /end CHARACTERISTIC
/begin CHARACTERISTIC DFES_DTCM.DFC_Com5B2hTooShort_C "" VALUE 0x80249494 Val_Wu16 65535.00 DFES_OneToOne 0.00 65535.00 FORMAT "%8.2" /end CHARACTERISTIC
/begin CHARACTERISTIC DFES_DTCM.DFC_Com5B5hAbsent_C "" VALUE 0x80249496 Val_Wu16 65535.00 DFES_OneToOne 0.00 65535.00 FORMAT "%8.2" /end CHARACTERISTIC
/begin CHARACTERISTIC DFES_DTCM.DFC_Com5B5hChecksum_C "" VALUE 0x80249498 Val_Wu16 65535.00 DFES_OneToOne 0.00 65535.00 FORMAT "%8.2" /end CHARACTERISTIC
/begin CHARACTERISTIC DFES_DTCM.DFC_Com5B5hCounter_C "" VALUE 0x8024949A Val_Wu16 65535.00 DFES_OneToOne 0.00 65535.00 FORMAT "%8.2" /end CHARACTERISTIC
/begin CHARACTERISTIC DFES_DTCM.DFC_Com5B5hTooShort_C "" VALUE 0x8024949C Val_Wu16 65535.00 DFES_OneToOne 0.00 65535.00 FORMAT "%8.2" /end CHARACTERISTIC
/begin CHARACTERISTIC DFES_DTCM.DFC_Com5C7hTooShort_C "" VALUE 0x8024949E Val_Wu16 65535.00 DFES_OneToOne 0.00 65535.00 FORMAT "%8.2" /end CHARACTERISTIC
/begin CHARACTERISTIC DFES_DTCM.DFC_Com5E7hAbsent_C "" VALUE 0x802494A0 Val_Wu16 65535.00 DFES_OneToOne 0.00 65535.00 FORMAT "%8.2" /end CHARACTERISTIC
/begin CHARACTERISTIC DFES_DTCM.DFC_Com5E7hTooShort_C "" VALUE 0x802494A2 Val_Wu16 65535.00 DFES_OneToOne 0.00 65535.00 FORMAT "%8.2" /end CHARACTERISTIC
/begin CHARACTERISTIC DFES_DTCM.DFC_Com635hTooShort_C "" VALUE 0x802494A4 Val_Wu16 65535.00 DFES_OneToOne 0.00 65535.00 FORMAT "%8.2" /end CHARACTERISTIC
/begin CHARACTERISTIC DFES_DTCM.DFC_Com645hTooShort_C "" VALUE 0x802494A6 Val_Wu16 65535.00 DFES_OneToOne 0.00 65535.00 FORMAT "%8.2" /end CHARACTERISTIC
/begin CHARACTERISTIC DFES_DTCM.DFC_Com663hAbsent_C "" VALUE 0x802494A8 Val_Wu16 65535.00 DFES_OneToOne 0.00 65535.00 FORMAT "%8.2" /end CHARACTERISTIC
/begin CHARACTERISTIC DFES_DTCM.DFC_Com663hTooShort_C "" VALUE 0x802494AA Val_Wu16 65535.00 DFES_OneToOne 0.00 65535.00 FORMAT "%8.2" /end CHARACTERISTIC
/begin CHARACTERISTIC DFES_DTCM.DFC_Com665hAbsent_C "" VALUE 0x802494AC Val_Wu16 65535.00 DFES_OneToOne 0.00 65535.00 FORMAT "%8.2" /end CHARACTERISTIC
/begin CHARACTERISTIC DFES_DTCM.DFC_Com665hTooShort_C "" VALUE 0x802494AE Val_Wu16 65535.00 DFES_OneToOne 0.00 65535.00 FORMAT "%8.2" /end CHARACTERISTIC
/begin CHARACTERISTIC DFES_DTCM.DFC_Com675hAbsent_C "" VALUE 0x802494B0 Val_Wu16 65535.00 DFES_OneToOne 0.00 65535.00 FORMAT "%8.2" /end CHARACTERISTIC
/begin CHARACTERISTIC DFES_DTCM.DFC_Com675hTooShort_C "" VALUE 0x802494B2 Val_Wu16 65535.00 DFES_OneToOne 0.00 65535.00 FORMAT "%8.2" /end CHARACTERISTIC
/begin CHARACTERISTIC DFES_DTCM.DFC_ComFrbd_205h_HVBAT_PACK_CURRENT_C "" VALUE 0x802494B4 Val_Wu16 65535.00 DFES_OneToOne 0.00 65535.00 FORMAT "%8.2" /end CHARACTERISTIC
/begin CHARACTERISTIC DFES_DTCM.DFC_ComFrbd_205h_HVBAT_SOC_DISPLAY_C "" VALUE 0x802494B6 Val_Wu16 65535.00 DFES_OneToOne 0.00 65535.00 FORMAT "%8.2" /end CHARACTERISTIC
/begin CHARACTERISTIC DFES_DTCM.DFC_ComFrbd_205h_HVBAT_VOLTAGE_C "" VALUE 0x802494B8 Val_Wu16 65535.00 DFES_OneToOne 0.00 65535.00 FORMAT "%8.2" /end CHARACTERISTIC
/begin CHARACTERISTIC DFES_DTCM.DFC_ComFrbd_217h_INV_DC_BUS_VOLTAGE_C "" VALUE 0x802494BA Val_Wu16 65535.00 DFES_OneToOne 0.00 65535.00 FORMAT "%8.2" /end CHARACTERISTIC
/begin CHARACTERISTIC DFES_DTCM.DFC_ComFrbd_217h_INV_MTR_ACTUAL_TRQ_C "" VALUE 0x802494BC Val_Wu16 65535.00 DFES_OneToOne 0.00 65535.00 FORMAT "%8.2" /end CHARACTERISTIC
/begin CHARACTERISTIC DFES_DTCM.DFC_ComFrbd_217h_INV_MTR_SPEED_C "" VALUE 0x802494BE Val_Wu16 65535.00 DFES_OneToOne 0.00 65535.00 FORMAT "%8.2" /end CHARACTERISTIC
/begin CHARACTERISTIC DFES_DTCM.DFC_ComFrbd_217h_INV_MTR_TRQ_C "" VALUE 0x802494C0 Val_Wu16 65535.00 DFES_OneToOne 0.00 65535.00 FORMAT "%8.2" /end CHARACTERISTIC
/begin CHARACTERISTIC DFES_DTCM.DFC_ComFrbd_227h_INV_DC_CURRENT_C "" VALUE 0x802494C2 Val_Wu16 65535.00 DFES_OneToOne 0.00 65535.00 FORMAT "%8.2" /end CHARACTERISTIC
/begin CHARACTERISTIC DFES_DTCM.DFC_ComFrbd_227h_INV_MOTORING_PEAK_TRQ_C "" VALUE 0x802494C4 Val_Wu16 65535.00 DFES_OneToOne 0.00 65535.00 FORMAT "%8.2" /end CHARACTERISTIC
/begin CHARACTERISTIC DFES_DTCM.DFC_ComFrbd_227h_INV_MTR_INST_INPUT_POWER_C "" VALUE 0x802494C6 Val_Wu16 65535.00 DFES_OneToOne 0.00 65535.00 FORMAT "%8.2" /end CHARACTERISTIC
/begin CHARACTERISTIC DFES_DTCM.DFC_ComFrbd_227h_INV_REGEN_PEAK_TRQ_C "" VALUE 0x802494C8 Val_Wu16 65535.00 DFES_OneToOne 0.00 65535.00 FORMAT "%8.2" /end CHARACTERISTIC
/begin CHARACTERISTIC DFES_DTCM.DFC_ComFrbd_237h_INV_ACTIVE_DISCHARGE_STATUS_C "" VALUE 0x802494CA Val_Wu16 65535.00 DFES_OneToOne 0.00 65535.00 FORMAT "%8.2" /end CHARACTERISTIC
/begin CHARACTERISTIC DFES_DTCM.DFC_ComFrbd_237h_INV_CTRL_MODE_ACK_C "" VALUE 0x802494CC Val_Wu16 65535.00 DFES_OneToOne 0.00 65535.00 FORMAT "%8.2" /end CHARACTERISTIC
/begin CHARACTERISTIC DFES_DTCM.DFC_ComFrbd_237h_INV_EV_WARNING_C "" VALUE 0x802494CE Val_Wu16 65535.00 DFES_OneToOne 0.00 65535.00 FORMAT "%8.2" /end CHARACTERISTIC
/begin CHARACTERISTIC DFES_DTCM.DFC_ComFrbd_237h_INV_FAULT_LEVEL_C "" VALUE 0x802494D0 Val_Wu16 65535.00 DFES_OneToOne 0.00 65535.00 FORMAT "%8.2" /end CHARACTERISTIC
/begin CHARACTERISTIC DFES_DTCM.DFC_ComFrbd_237h_INV_MASTER_STOP_C "" VALUE 0x802494D2 Val_Wu16 65535.00 DFES_OneToOne 0.00 65535.00 FORMAT "%8.2" /end CHARACTERISTIC
/begin CHARACTERISTIC DFES_DTCM.DFC_ComFrbd_237h_INV_SERVICE_DUE_C "" VALUE 0x802494D4 Val_Wu16 65535.00 DFES_OneToOne 0.00 65535.00 FORMAT "%8.2" /end CHARACTERISTIC
/begin CHARACTERISTIC DFES_DTCM.DFC_ComFrbd_237h_INV_STAB_MIN_TRQ_C "" VALUE 0x802494D6 Val_Wu16 65535.00 DFES_OneToOne 0.00 65535.00 FORMAT "%8.2" /end CHARACTERISTIC
/begin CHARACTERISTIC DFES_DTCM.DFC_ComFrbd_259h_TGLM_FAILURE_STATE_C "" VALUE 0x802494D8 Val_Wu16 65535.00 DFES_OneToOne 0.00 65535.00 FORMAT "%8.2" /end CHARACTERISTIC
/begin CHARACTERISTIC DFES_DTCM.DFC_ComFrbd_259h_TGLM_MODE_PUSH_C "" VALUE 0x802494DA Val_Wu16 65535.00 DFES_OneToOne 0.00 65535.00 FORMAT "%8.2" /end CHARACTERISTIC
/begin CHARACTERISTIC DFES_DTCM.DFC_ComFrbd_259h_TOGGLE_MONOSTABLE_POS_C "" VALUE 0x802494DC Val_Wu16 65535.00 DFES_OneToOne 0.00 65535.00 FORMAT "%8.2" /end CHARACTERISTIC
/begin CHARACTERISTIC DFES_DTCM.DFC_ComFrbd_273h_OBC_outputpower_capability_C "" VALUE 0x802494DE Val_Wu16 65535.00 DFES_OneToOne 0.00 65535.00 FORMAT "%8.2" /end CHARACTERISTIC
/begin CHARACTERISTIC DFES_DTCM.DFC_ComFrbd_275h_HVBAT_DISCHARGE_30S_AVAILABLE_CURRENT_C "" VALUE 0x802494E0 Val_Wu16 65535.00 DFES_OneToOne 0.00 65535.00 FORMAT "%8.2" /end CHARACTERISTIC
/begin CHARACTERISTIC DFES_DTCM.DFC_ComFrbd_275h_HVBAT_DISCHARGE_30S_AVAILABLE_POWER_C "" VALUE 0x802494E2 Val_Wu16 65535.00 DFES_OneToOne 0.00 65535.00 FORMAT "%8.2" /end CHARACTERISTIC
/begin CHARACTERISTIC DFES_DTCM.DFC_ComFrbd_283h_DCDC_IN_CURRENT_C "" VALUE 0x802494E4 Val_Wu16 65535.00 DFES_OneToOne 0.00 65535.00 FORMAT "%8.2" /end CHARACTERISTIC
/begin CHARACTERISTIC DFES_DTCM.DFC_ComFrbd_283h_DCDC_IN_VOLTAGE_C "" VALUE 0x802494E6 Val_Wu16 65535.00 DFES_OneToOne 0.00 65535.00 FORMAT "%8.2" /end CHARACTERISTIC
/begin CHARACTERISTIC DFES_DTCM.DFC_ComFrbd_283h_DCDC_OUT_CURRENT_C "" VALUE 0x802494E8 Val_Wu16 65535.00 DFES_OneToOne 0.00 65535.00 FORMAT "%8.2" /end CHARACTERISTIC
/begin CHARACTERISTIC DFES_DTCM.DFC_ComFrbd_283h_DCDC_OUT_VOLTAGE_C "" VALUE 0x802494EA Val_Wu16 65535.00 DFES_OneToOne 0.00 65535.00 FORMAT "%8.2" /end CHARACTERISTIC
/begin CHARACTERISTIC DFES_DTCM.DFC_ComFrbd_285h_HVBAT_REGEN_CHG_30S_CURRENT_LIMIT_C "" VALUE 0x802494EC Val_Wu16 65535.00 DFES_OneToOne 0.00 65535.00 FORMAT "%8.2" /end CHARACTERISTIC
/begin CHARACTERISTIC DFES_DTCM.DFC_ComFrbd_285h_HVBAT_REGEN_CHRG_30S_POWER_LIMIT_C "" VALUE 0x802494EE Val_Wu16 65535.00 DFES_OneToOne 0.00 65535.00 FORMAT "%8.2" /end CHARACTERISTIC
/begin CHARACTERISTIC DFES_DTCM.DFC_ComFrbd_293h_DCDC_outputpower_capability_C "" VALUE 0x802494F0 Val_Wu16 65535.00 DFES_OneToOne 0.00 65535.00 FORMAT "%8.2" /end CHARACTERISTIC
/begin CHARACTERISTIC DFES_DTCM.DFC_ComFrbd_325h_HVBAT_INSULATION_RESISTANCE_C "" VALUE 0x802494F2 Val_Wu16 65535.00 DFES_OneToOne 0.00 65535.00 FORMAT "%8.2" /end CHARACTERISTIC
/begin CHARACTERISTIC DFES_DTCM.DFC_ComFrbd_325h_HVBAT_TEMPERATURE_C "" VALUE 0x802494F4 Val_Wu16 65535.00 DFES_OneToOne 0.00 65535.00 FORMAT "%8.2" /end CHARACTERISTIC
/begin CHARACTERISTIC DFES_DTCM.DFC_ComFrbd_335h_HVBAT_CHRG_CONTINUOUS_CURR_MAX_C "" VALUE 0x802494F6 Val_Wu16 65535.00 DFES_OneToOne 0.00 65535.00 FORMAT "%8.2" /end CHARACTERISTIC
/begin CHARACTERISTIC DFES_DTCM.DFC_ComFrbd_335h_HVBAT_CHRG_COTINUOUS_CURR_REQ_C "" VALUE 0x802494F8 Val_Wu16 65535.00 DFES_OneToOne 0.00 65535.00 FORMAT "%8.2" /end CHARACTERISTIC
/begin CHARACTERISTIC DFES_DTCM.DFC_ComFrbd_335h_HVBAT_CHRG_MAX_VOLT_C "" VALUE 0x802494FA Val_Wu16 65535.00 DFES_OneToOne 0.00 65535.00 FORMAT "%8.2" /end CHARACTERISTIC
/begin CHARACTERISTIC DFES_DTCM.DFC_ComFrbd_335h_HVBAT_DC_BUS_VOLTAGE_C "" VALUE 0x802494FC Val_Wu16 65535.00 DFES_OneToOne 0.00 65535.00 FORMAT "%8.2" /end CHARACTERISTIC
/begin CHARACTERISTIC DFES_DTCM.DFC_ComFrbd_427h_INV_OP_MODE_C "" VALUE 0x802494FE Val_Wu16 65535.00 DFES_OneToOne 0.00 65535.00 FORMAT "%8.2" /end CHARACTERISTIC
/begin CHARACTERISTIC DFES_DTCM.DFC_ComFrbd_427h_INV_PERMISIBLE_TORQUE_C "" VALUE 0x80249500 Val_Wu16 65535.00 DFES_OneToOne 0.00 65535.00 FORMAT "%8.2" /end CHARACTERISTIC
/begin CHARACTERISTIC DFES_DTCM.DFC_ComFrbd_435h_HVBAT_MAX_CELL_VOLT_C "" VALUE 0x80249502 Val_Wu16 65535.00 DFES_OneToOne 0.00 65535.00 FORMAT "%8.2" /end CHARACTERISTIC
/begin CHARACTERISTIC DFES_DTCM.DFC_ComFrbd_435h_HVBAT_MAX_CELL_VOLT_NUM_C "" VALUE 0x80249504 Val_Wu16 65535.00 DFES_OneToOne 0.00 65535.00 FORMAT "%8.2" /end CHARACTERISTIC
/begin CHARACTERISTIC DFES_DTCM.DFC_ComFrbd_435h_HVBAT_MAX_SENSOR_TEMP_C "" VALUE 0x80249506 Val_Wu16 65535.00 DFES_OneToOne 0.00 65535.00 FORMAT "%8.2" /end CHARACTERISTIC
/begin CHARACTERISTIC DFES_DTCM.DFC_ComFrbd_435h_HVBAT_MIN_CELL_VOLT_C "" VALUE 0x80249508 Val_Wu16 65535.00 DFES_OneToOne 0.00 65535.00 FORMAT "%8.2" /end CHARACTERISTIC
/begin CHARACTERISTIC DFES_DTCM.DFC_ComFrbd_435h_HVBAT_MIN_CELL_VOLT_NUM_C "" VALUE 0x8024950A Val_Wu16 65535.00 DFES_OneToOne 0.00 65535.00 FORMAT "%8.2" /end CHARACTERISTIC
/begin CHARACTERISTIC DFES_DTCM.DFC_ComFrbd_453h_OBC_IN_CURRENT_C "" VALUE 0x8024950C Val_Wu16 65535.00 DFES_OneToOne 0.00 65535.00 FORMAT "%8.2" /end CHARACTERISTIC
/begin CHARACTERISTIC DFES_DTCM.DFC_ComFrbd_453h_OBC_IN_VOLTAGE_C "" VALUE 0x8024950E Val_Wu16 65535.00 DFES_OneToOne 0.00 65535.00 FORMAT "%8.2" /end CHARACTERISTIC
/begin CHARACTERISTIC DFES_DTCM.DFC_ComFrbd_453h_OBC_IP_POWER_C "" VALUE 0x80249510 Val_Wu16 65535.00 DFES_OneToOne 0.00 65535.00 FORMAT "%8.2" /end CHARACTERISTIC
/begin CHARACTERISTIC DFES_DTCM.DFC_ComFrbd_455h_HVBAT_NOMINAL_VOLTAGE_C "" VALUE 0x80249512 Val_Wu16 65535.00 DFES_OneToOne 0.00 65535.00 FORMAT "%8.2" /end CHARACTERISTIC
/begin CHARACTERISTIC DFES_DTCM.DFC_ComFrbd_463h_OBC_OUT_CURRENT_C "" VALUE 0x80249514 Val_Wu16 65535.00 DFES_OneToOne 0.00 65535.00 FORMAT "%8.2" /end CHARACTERISTIC
/begin CHARACTERISTIC DFES_DTCM.DFC_ComFrbd_463h_OBC_OUT_VOLTAGE_C "" VALUE 0x80249516 Val_Wu16 65535.00 DFES_OneToOne 0.00 65535.00 FORMAT "%8.2" /end CHARACTERISTIC
/begin CHARACTERISTIC DFES_DTCM.DFC_ComFrbd_463h_OBC_TEMPERATURE_C "" VALUE 0x80249518 Val_Wu16 65535.00 DFES_OneToOne 0.00 65535.00 FORMAT "%8.2" /end CHARACTERISTIC
/begin CHARACTERISTIC DFES_DTCM.DFC_ComFrbd_473h_DCDC_Coolant_Temperature_C "" VALUE 0x8024951A Val_Wu16 65535.00 DFES_OneToOne 0.00 65535.00 FORMAT "%8.2" /end CHARACTERISTIC
/begin CHARACTERISTIC DFES_DTCM.DFC_ComFrbd_473h_DCDC_TEMPERATURE_C "" VALUE 0x8024951C Val_Wu16 65535.00 DFES_OneToOne 0.00 65535.00 FORMAT "%8.2" /end CHARACTERISTIC
/begin CHARACTERISTIC DFES_DTCM.DFC_ComFrbd_47Bh_eCOMP_BusBarCurrent_C "" VALUE 0x8024951E Val_Wu16 65535.00 DFES_OneToOne 0.00 65535.00 FORMAT "%8.2" /end CHARACTERISTIC
/begin CHARACTERISTIC DFES_DTCM.DFC_ComFrbd_47Bh_eCOMP_BusBarVoltage_C "" VALUE 0x80249520 Val_Wu16 65535.00 DFES_OneToOne 0.00 65535.00 FORMAT "%8.2" /end CHARACTERISTIC
/begin CHARACTERISTIC DFES_DTCM.DFC_ComFrbd_47Bh_eCOMP_CompressorSpeed_C "" VALUE 0x80249522 Val_Wu16 65535.00 DFES_OneToOne 0.00 65535.00 FORMAT "%8.2" /end CHARACTERISTIC
/begin CHARACTERISTIC DFES_DTCM.DFC_ComFrbd_47Bh_eCOMP_IGBT_Temp_C "" VALUE 0x80249524 Val_Wu16 65535.00 DFES_OneToOne 0.00 65535.00 FORMAT "%8.2" /end CHARACTERISTIC
/begin CHARACTERISTIC DFES_DTCM.DFC_ComFrbd_47Bh_eCOMP_PeakPhaCurrent_C "" VALUE 0x80249526 Val_Wu16 65535.00 DFES_OneToOne 0.00 65535.00 FORMAT "%8.2" /end CHARACTERISTIC
/begin CHARACTERISTIC DFES_DTCM.DFC_ComFrbd_47Bh_eCOMP_Power_consumption_C "" VALUE 0x80249528 Val_Wu16 65535.00 DFES_OneToOne 0.00 65535.00 FORMAT "%8.2" /end CHARACTERISTIC
/begin CHARACTERISTIC DFES_DTCM.DFC_ComFrbd_48Bh_eCOMP_Fault_Level_C "" VALUE 0x8024952A Val_Wu16 65535.00 DFES_OneToOne 0.00 65535.00 FORMAT "%8.2" /end CHARACTERISTIC
/begin CHARACTERISTIC DFES_DTCM.DFC_ComFrbd_4F2h_VALEUR_SOC_ETENDUE_C "" VALUE 0x8024952C Val_Wu16 65535.00 DFES_OneToOne 0.00 65535.00 FORMAT "%8.2" /end CHARACTERISTIC
/begin CHARACTERISTIC DFES_DTCM.DFC_ComFrbd_535h_HV_BATT_TEMP_AVG_C "" VALUE 0x8024952E Val_Wu16 65535.00 DFES_OneToOne 0.00 65535.00 FORMAT "%8.2" /end CHARACTERISTIC
/begin CHARACTERISTIC DFES_DTCM.DFC_ComFrbd_543h_HVBAT_RESTBATTENERGY_C "" VALUE 0x80249530 Val_Wu16 65535.00 DFES_OneToOne 0.00 65535.00 FORMAT "%8.2" /end CHARACTERISTIC
/begin CHARACTERISTIC DFES_DTCM.DFC_ComFrbd_543h_HVBAT_SOH_C "" VALUE 0x80249532 Val_Wu16 65535.00 DFES_OneToOne 0.00 65535.00 FORMAT "%8.2" /end CHARACTERISTIC
/begin CHARACTERISTIC DFES_DTCM.DFC_ComFrbd_543h_HV_BATT_SOH_RES_C "" VALUE 0x80249534 Val_Wu16 65535.00 DFES_OneToOne 0.00 65535.00 FORMAT "%8.2" /end CHARACTERISTIC
/begin CHARACTERISTIC DFES_DTCM.DFC_ComFrbd_592h_IBATT_1_C "" VALUE 0x80249536 Val_Wu16 65535.00 DFES_OneToOne 0.00 65535.00 FORMAT "%8.2" /end CHARACTERISTIC
/begin CHARACTERISTIC DFES_DTCM.DFC_ComFrbd_592h_IBATT_2_C "" VALUE 0x80249538 Val_Wu16 65535.00 DFES_OneToOne 0.00 65535.00 FORMAT "%8.2" /end CHARACTERISTIC
/begin CHARACTERISTIC DFES_DTCM.DFC_ComFrbd_592h_IBATT_3_C "" VALUE 0x8024953A Val_Wu16 65535.00 DFES_OneToOne 0.00 65535.00 FORMAT "%8.2" /end CHARACTERISTIC
/begin CHARACTERISTIC DFES_DTCM.DFC_ComFrbd_592h_TEMP_BATT_C "" VALUE 0x8024953C Val_Wu16 65535.00 DFES_OneToOne 0.00 65535.00 FORMAT "%8.2" /end CHARACTERISTIC
/begin CHARACTERISTIC DFES_DTCM.DFC_ComFrbd_592h_U_BATT_BECB_C "" VALUE 0x8024953E Val_Wu16 65535.00 DFES_OneToOne 0.00 65535.00 FORMAT "%8.2" /end CHARACTERISTIC
/begin CHARACTERISTIC DFES_DTCM.DFC_ComFrbd_595h_HVBAT_TIME_TO_CHRG_80_C "" VALUE 0x80249540 Val_Wu16 65535.00 DFES_OneToOne 0.00 65535.00 FORMAT "%8.2" /end CHARACTERISTIC
/begin CHARACTERISTIC DFES_DTCM.DFC_ComFrbd_5B2h_TEMP_AIR_EXT_C "" VALUE 0x80249542 Val_Wu16 65535.00 DFES_OneToOne 0.00 65535.00 FORMAT "%8.2" /end CHARACTERISTIC
/begin CHARACTERISTIC DFES_DTCM.DFC_ComFrbd_635h_HVBAT_NEG_CONT_COUNT_SEG1_C "" VALUE 0x80249544 Val_Wu16 65535.00 DFES_OneToOne 0.00 65535.00 FORMAT "%8.2" /end CHARACTERISTIC
/begin CHARACTERISTIC DFES_DTCM.DFC_ComFrbd_635h_HVBAT_NEG_CONT_COUNT_SEG3_C "" VALUE 0x80249546 Val_Wu16 65535.00 DFES_OneToOne 0.00 65535.00 FORMAT "%8.2" /end CHARACTERISTIC
/begin CHARACTERISTIC DFES_DTCM.DFC_ComFrbd_635h_HVBAT_NEG_CONT_COUNT_SEG4_C "" VALUE 0x80249548 Val_Wu16 65535.00 DFES_OneToOne 0.00 65535.00 FORMAT "%8.2" /end CHARACTERISTIC
/begin CHARACTERISTIC DFES_DTCM.DFC_ComFrbd_635h_HVBAT_PST_CONT_COUNT_SEG1_C "" VALUE 0x8024954A Val_Wu16 65535.00 DFES_OneToOne 0.00 65535.00 FORMAT "%8.2" /end CHARACTERISTIC
/begin CHARACTERISTIC DFES_DTCM.DFC_ComFrbd_635h_HVBAT_PST_CONT_COUNT_SEG3_C "" VALUE 0x8024954C Val_Wu16 65535.00 DFES_OneToOne 0.00 65535.00 FORMAT "%8.2" /end CHARACTERISTIC
/begin CHARACTERISTIC DFES_DTCM.DFC_ComFrbd_635h_HVBAT_PST_CONT_COUNT_SEG4_C "" VALUE 0x8024954E Val_Wu16 65535.00 DFES_OneToOne 0.00 65535.00 FORMAT "%8.2" /end CHARACTERISTIC
/begin CHARACTERISTIC DFES_DTCM.DFC_ComFrbd_645h_HVBAT_PRECHRGE_CONT_COUNT_SEG1_C "" VALUE 0x80249550 Val_Wu16 65535.00 DFES_OneToOne 0.00 65535.00 FORMAT "%8.2" /end CHARACTERISTIC
/begin CHARACTERISTIC DFES_DTCM.DFC_ComFrbd_645h_HVBAT_PRECHRGE_CONT_COUNT_SEG2_C "" VALUE 0x80249552 Val_Wu16 65535.00 DFES_OneToOne 0.00 65535.00 FORMAT "%8.2" /end CHARACTERISTIC
/begin CHARACTERISTIC DFES_DTCM.DFC_ComFrbd_675h_HVBAT_REMAININGBATTCAPACITY_C "" VALUE 0x80249554 Val_Wu16 65535.00 DFES_OneToOne 0.00 65535.00 FORMAT "%8.2" /end CHARACTERISTIC
/begin CHARACTERISTIC DFES_DTCM.DFC_ComInvld_205h_HVBAT_CHARGING_STATUS_C "" VALUE 0x80249556 Val_Wu16 65535.00 DFES_OneToOne 0.00 65535.00 FORMAT "%8.2" /end CHARACTERISTIC
/begin CHARACTERISTIC DFES_DTCM.DFC_ComInvld_205h_HVBAT_PACK_CURRENT_C "" VALUE 0x80249558 Val_Wu16 65535.00 DFES_OneToOne 0.00 65535.00 FORMAT "%8.2" /end CHARACTERISTIC
/begin CHARACTERISTIC DFES_DTCM.DFC_ComInvld_205h_HVBAT_SOC_DISPLAY_C "" VALUE 0x8024955A Val_Wu16 65535.00 DFES_OneToOne 0.00 65535.00 FORMAT "%8.2" /end CHARACTERISTIC
/begin CHARACTERISTIC DFES_DTCM.DFC_ComInvld_205h_HVBAT_VOLTAGE_C "" VALUE 0x8024955C Val_Wu16 65535.00 DFES_OneToOne 0.00 65535.00 FORMAT "%8.2" /end CHARACTERISTIC
/begin CHARACTERISTIC DFES_DTCM.DFC_ComInvld_217h_INV_DC_BUS_VOLTAGE_C "" VALUE 0x8024955E Val_Wu16 65535.00 DFES_OneToOne 0.00 65535.00 FORMAT "%8.2" /end CHARACTERISTIC
/begin CHARACTERISTIC DFES_DTCM.DFC_ComInvld_217h_INV_MTR_ACTUAL_TRQ_C "" VALUE 0x80249560 Val_Wu16 65535.00 DFES_OneToOne 0.00 65535.00 FORMAT "%8.2" /end CHARACTERISTIC
/begin CHARACTERISTIC DFES_DTCM.DFC_ComInvld_217h_INV_MTR_SPEED_C "" VALUE 0x80249562 Val_Wu16 65535.00 DFES_OneToOne 0.00 65535.00 FORMAT "%8.2" /end CHARACTERISTIC
/begin CHARACTERISTIC DFES_DTCM.DFC_ComInvld_217h_INV_MTR_TRQ_C "" VALUE 0x80249564 Val_Wu16 65535.00 DFES_OneToOne 0.00 65535.00 FORMAT "%8.2" /end CHARACTERISTIC
/begin CHARACTERISTIC DFES_DTCM.DFC_ComInvld_227h_INV_DC_CURRENT_C "" VALUE 0x80249566 Val_Wu16 65535.00 DFES_OneToOne 0.00 65535.00 FORMAT "%8.2" /end CHARACTERISTIC
/begin CHARACTERISTIC DFES_DTCM.DFC_ComInvld_227h_INV_MOTORING_PEAK_TRQ_C "" VALUE 0x80249568 Val_Wu16 65535.00 DFES_OneToOne 0.00 65535.00 FORMAT "%8.2" /end CHARACTERISTIC
/begin CHARACTERISTIC DFES_DTCM.DFC_ComInvld_227h_INV_MTR_INST_INPUT_POWER_C "" VALUE 0x8024956A Val_Wu16 65535.00 DFES_OneToOne 0.00 65535.00 FORMAT "%8.2" /end CHARACTERISTIC
/begin CHARACTERISTIC DFES_DTCM.DFC_ComInvld_227h_INV_REGEN_PEAK_TRQ_C "" VALUE 0x8024956C Val_Wu16 65535.00 DFES_OneToOne 0.00 65535.00 FORMAT "%8.2" /end CHARACTERISTIC
/begin CHARACTERISTIC DFES_DTCM.DFC_ComInvld_237h_INV_ACTIVE_DISCHARGE_STATUS_C "" VALUE 0x8024956E Val_Wu16 65535.00 DFES_OneToOne 0.00 65535.00 FORMAT "%8.2" /end CHARACTERISTIC
/begin CHARACTERISTIC DFES_DTCM.DFC_ComInvld_237h_INV_FAULT_LEVEL_C "" VALUE 0x80249570 Val_Wu16 65535.00 DFES_OneToOne 0.00 65535.00 FORMAT "%8.2" /end CHARACTERISTIC
/begin CHARACTERISTIC DFES_DTCM.DFC_ComInvld_237h_INV_STAB_MIN_TRQ_C "" VALUE 0x80249572 Val_Wu16 65535.00 DFES_OneToOne 0.00 65535.00 FORMAT "%8.2" /end CHARACTERISTIC
/begin CHARACTERISTIC DFES_DTCM.DFC_ComInvld_259h_TGLM_MODE_PUSH_C "" VALUE 0x80249574 Val_Wu16 65535.00 DFES_OneToOne 0.00 65535.00 FORMAT "%8.2" /end CHARACTERISTIC
/begin CHARACTERISTIC DFES_DTCM.DFC_ComInvld_259h_TOGGLE_MONOSTABLE_POS_C "" VALUE 0x80249576 Val_Wu16 65535.00 DFES_OneToOne 0.00 65535.00 FORMAT "%8.2" /end CHARACTERISTIC
/begin CHARACTERISTIC DFES_DTCM.DFC_ComInvld_26h_AC_SWITCH_REQ_C "" VALUE 0x80249578 Val_Wu16 65535.00 DFES_OneToOne 0.00 65535.00 FORMAT "%8.2" /end CHARACTERISTIC
/begin CHARACTERISTIC DFES_DTCM.DFC_ComInvld_26h_BLOWER_POSITION_C "" VALUE 0x8024957A Val_Wu16 65535.00 DFES_OneToOne 0.00 65535.00 FORMAT "%8.2" /end CHARACTERISTIC
/begin CHARACTERISTIC DFES_DTCM.DFC_ComInvld_26h_EVAP_SENSOR_FAULT_C "" VALUE 0x8024957C Val_Wu16 65535.00 DFES_OneToOne 0.00 65535.00 FORMAT "%8.2" /end CHARACTERISTIC
/begin CHARACTERISTIC DFES_DTCM.DFC_ComInvld_26h_EVAP_SENSOR_VALUE_C "" VALUE 0x8024957E Val_Wu16 65535.00 DFES_OneToOne 0.00 65535.00 FORMAT "%8.2" /end CHARACTERISTIC
/begin CHARACTERISTIC DFES_DTCM.DFC_ComInvld_26h_POTENTIOMETER_FAULT_C "" VALUE 0x80249580 Val_Wu16 65535.00 DFES_OneToOne 0.00 65535.00 FORMAT "%8.2" /end CHARACTERISTIC
/begin CHARACTERISTIC DFES_DTCM.DFC_ComInvld_26h_REAR_DEFOG_REQ_C "" VALUE 0x80249582 Val_Wu16 65535.00 DFES_OneToOne 0.00 65535.00 FORMAT "%8.2" /end CHARACTERISTIC
/begin CHARACTERISTIC DFES_DTCM.DFC_ComInvld_26h_TEMP_POSITION_C "" VALUE 0x80249584 Val_Wu16 65535.00 DFES_OneToOne 0.00 65535.00 FORMAT "%8.2" /end CHARACTERISTIC
/begin CHARACTERISTIC DFES_DTCM.DFC_ComInvld_273h_OBC_FAULT_LEVEL_C "" VALUE 0x80249586 Val_Wu16 65535.00 DFES_OneToOne 0.00 65535.00 FORMAT "%8.2" /end CHARACTERISTIC
/begin CHARACTERISTIC DFES_DTCM.DFC_ComInvld_273h_OBC_outputpower_capability_C "" VALUE 0x80249588 Val_Wu16 65535.00 DFES_OneToOne 0.00 65535.00 FORMAT "%8.2" /end CHARACTERISTIC
/begin CHARACTERISTIC DFES_DTCM.DFC_ComInvld_275h_HVBAT_DISCHARGE_30S_AVAILABLE_CURRENT_C "" VALUE 0x8024958A Val_Wu16 65535.00 DFES_OneToOne 0.00 65535.00 FORMAT "%8.2" /end CHARACTERISTIC
/begin CHARACTERISTIC DFES_DTCM.DFC_ComInvld_275h_HVBAT_DISCHARGE_30S_AVAILABLE_POWER_C "" VALUE 0x8024958C Val_Wu16 65535.00 DFES_OneToOne 0.00 65535.00 FORMAT "%8.2" /end CHARACTERISTIC
/begin CHARACTERISTIC DFES_DTCM.DFC_ComInvld_283h_DCDC_IN_CURRENT_C "" VALUE 0x8024958E Val_Wu16 65535.00 DFES_OneToOne 0.00 65535.00 FORMAT "%8.2" /end CHARACTERISTIC
/begin CHARACTERISTIC DFES_DTCM.DFC_ComInvld_283h_DCDC_IN_VOLTAGE_C "" VALUE 0x80249590 Val_Wu16 65535.00 DFES_OneToOne 0.00 65535.00 FORMAT "%8.2" /end CHARACTERISTIC
/begin CHARACTERISTIC DFES_DTCM.DFC_ComInvld_283h_DCDC_OUT_CURRENT_C "" VALUE 0x80249592 Val_Wu16 65535.00 DFES_OneToOne 0.00 65535.00 FORMAT "%8.2" /end CHARACTERISTIC
/begin CHARACTERISTIC DFES_DTCM.DFC_ComInvld_283h_DCDC_OUT_VOLTAGE_C "" VALUE 0x80249594 Val_Wu16 65535.00 DFES_OneToOne 0.00 65535.00 FORMAT "%8.2" /end CHARACTERISTIC
/begin CHARACTERISTIC DFES_DTCM.DFC_ComInvld_285h_HVBAT_REGEN_CHG_30S_CURRENT_LIMIT_C "" VALUE 0x80249596 Val_Wu16 65535.00 DFES_OneToOne 0.00 65535.00 FORMAT "%8.2" /end CHARACTERISTIC
/begin CHARACTERISTIC DFES_DTCM.DFC_ComInvld_285h_HVBAT_REGEN_CHRG_30S_POWER_LIMIT_C "" VALUE 0x80249598 Val_Wu16 65535.00 DFES_OneToOne 0.00 65535.00 FORMAT "%8.2" /end CHARACTERISTIC
/begin CHARACTERISTIC DFES_DTCM.DFC_ComInvld_293h_DCDC_FAULT_LEVEL_C "" VALUE 0x8024959A Val_Wu16 65535.00 DFES_OneToOne 0.00 65535.00 FORMAT "%8.2" /end CHARACTERISTIC
/begin CHARACTERISTIC DFES_DTCM.DFC_ComInvld_293h_DCDC_outputpower_capability_C "" VALUE 0x8024959C Val_Wu16 65535.00 DFES_OneToOne 0.00 65535.00 FORMAT "%8.2" /end CHARACTERISTIC
/begin CHARACTERISTIC DFES_DTCM.DFC_ComInvld_325h_HVBAT_EPLUG_STATUS_C "" VALUE 0x8024959E Val_Wu16 65535.00 DFES_OneToOne 0.00 65535.00 FORMAT "%8.2" /end CHARACTERISTIC
/begin CHARACTERISTIC DFES_DTCM.DFC_ComInvld_325h_HVBAT_HVIL_STS_C "" VALUE 0x802495A0 Val_Wu16 65535.00 DFES_OneToOne 0.00 65535.00 FORMAT "%8.2" /end CHARACTERISTIC
/begin CHARACTERISTIC DFES_DTCM.DFC_ComInvld_325h_HVBAT_INSULATION_FAULT_C "" VALUE 0x802495A2 Val_Wu16 65535.00 DFES_OneToOne 0.00 65535.00 FORMAT "%8.2" /end CHARACTERISTIC
/begin CHARACTERISTIC DFES_DTCM.DFC_ComInvld_325h_HVBAT_INSULATION_RESISTANCE_C "" VALUE 0x802495A4 Val_Wu16 65535.00 DFES_OneToOne 0.00 65535.00 FORMAT "%8.2" /end CHARACTERISTIC
/begin CHARACTERISTIC DFES_DTCM.DFC_ComInvld_325h_HVBAT_TEMPERATURE_C "" VALUE 0x802495A6 Val_Wu16 65535.00 DFES_OneToOne 0.00 65535.00 FORMAT "%8.2" /end CHARACTERISTIC
/begin CHARACTERISTIC DFES_DTCM.DFC_ComInvld_335h_HVBAT_CHRG_CONTINUOUS_CURR_MAX_C "" VALUE 0x802495A8 Val_Wu16 65535.00 DFES_OneToOne 0.00 65535.00 FORMAT "%8.2" /end CHARACTERISTIC
/begin CHARACTERISTIC DFES_DTCM.DFC_ComInvld_335h_HVBAT_CHRG_COTINUOUS_CURR_REQ_C "" VALUE 0x802495AA Val_Wu16 65535.00 DFES_OneToOne 0.00 65535.00 FORMAT "%8.2" /end CHARACTERISTIC
/begin CHARACTERISTIC DFES_DTCM.DFC_ComInvld_335h_HVBAT_CHRG_MAX_VOLT_C "" VALUE 0x802495AC Val_Wu16 65535.00 DFES_OneToOne 0.00 65535.00 FORMAT "%8.2" /end CHARACTERISTIC
/begin CHARACTERISTIC DFES_DTCM.DFC_ComInvld_335h_HVBAT_DC_BUS_VOLTAGE_C "" VALUE 0x802495AE Val_Wu16 65535.00 DFES_OneToOne 0.00 65535.00 FORMAT "%8.2" /end CHARACTERISTIC
/begin CHARACTERISTIC DFES_DTCM.DFC_ComInvld_38Dh_VITESSE_VEHICULE_ROUES_C "" VALUE 0x802495B0 Val_Wu16 65535.00 DFES_OneToOne 0.00 65535.00 FORMAT "%8.2" /end CHARACTERISTIC
/begin CHARACTERISTIC DFES_DTCM.DFC_ComInvld_38Dh_VVH_INDISP_C "" VALUE 0x802495B2 Val_Wu16 65535.00 DFES_OneToOne 0.00 65535.00 FORMAT "%8.2" /end CHARACTERISTIC
/begin CHARACTERISTIC DFES_DTCM.DFC_ComInvld_427h_INV_COOLANT_TEMP_C "" VALUE 0x802495B4 Val_Wu16 65535.00 DFES_OneToOne 0.00 65535.00 FORMAT "%8.2" /end CHARACTERISTIC
/begin CHARACTERISTIC DFES_DTCM.DFC_ComInvld_427h_INV_MOTOR_TEMP_C "" VALUE 0x802495B6 Val_Wu16 65535.00 DFES_OneToOne 0.00 65535.00 FORMAT "%8.2" /end CHARACTERISTIC
/begin CHARACTERISTIC DFES_DTCM.DFC_ComInvld_427h_INV_OP_MODE_C "" VALUE 0x802495B8 Val_Wu16 65535.00 DFES_OneToOne 0.00 65535.00 FORMAT "%8.2" /end CHARACTERISTIC
/begin CHARACTERISTIC DFES_DTCM.DFC_ComInvld_427h_INV_PERMISIBLE_TORQUE_C "" VALUE 0x802495BA Val_Wu16 65535.00 DFES_OneToOne 0.00 65535.00 FORMAT "%8.2" /end CHARACTERISTIC
/begin CHARACTERISTIC DFES_DTCM.DFC_ComInvld_427h_INV_TEMP_C "" VALUE 0x802495BC Val_Wu16 65535.00 DFES_OneToOne 0.00 65535.00 FORMAT "%8.2" /end CHARACTERISTIC
/begin CHARACTERISTIC DFES_DTCM.DFC_ComInvld_432h_REVEIL_PRINCIPAL_C "" VALUE 0x802495BE Val_Wu16 65535.00 DFES_OneToOne 0.00 65535.00 FORMAT "%8.2" /end CHARACTERISTIC
/begin CHARACTERISTIC DFES_DTCM.DFC_ComInvld_435h_HVBAT_MAX_CELL_VOLT_C "" VALUE 0x802495C0 Val_Wu16 65535.00 DFES_OneToOne 0.00 65535.00 FORMAT "%8.2" /end CHARACTERISTIC
/begin CHARACTERISTIC DFES_DTCM.DFC_ComInvld_435h_HVBAT_MAX_CELL_VOLT_NUM_C "" VALUE 0x802495C2 Val_Wu16 65535.00 DFES_OneToOne 0.00 65535.00 FORMAT "%8.2" /end CHARACTERISTIC
/begin CHARACTERISTIC DFES_DTCM.DFC_ComInvld_435h_HVBAT_MAX_SENSOR_TEMP_C "" VALUE 0x802495C4 Val_Wu16 65535.00 DFES_OneToOne 0.00 65535.00 FORMAT "%8.2" /end CHARACTERISTIC
/begin CHARACTERISTIC DFES_DTCM.DFC_ComInvld_435h_HVBAT_MIN_CELL_VOLT_C "" VALUE 0x802495C6 Val_Wu16 65535.00 DFES_OneToOne 0.00 65535.00 FORMAT "%8.2" /end CHARACTERISTIC
/begin CHARACTERISTIC DFES_DTCM.DFC_ComInvld_435h_HVBAT_MIN_CELL_VOLT_NUM_C "" VALUE 0x802495C8 Val_Wu16 65535.00 DFES_OneToOne 0.00 65535.00 FORMAT "%8.2" /end CHARACTERISTIC
/begin CHARACTERISTIC DFES_DTCM.DFC_ComInvld_442h_BCCM_BLOWER_RELAY_STS_C "" VALUE 0x802495CA Val_Wu16 65535.00 DFES_OneToOne 0.00 65535.00 FORMAT "%8.2" /end CHARACTERISTIC
/begin CHARACTERISTIC DFES_DTCM.DFC_ComInvld_453h_OBC_IN_CURRENT_C "" VALUE 0x802495CC Val_Wu16 65535.00 DFES_OneToOne 0.00 65535.00 FORMAT "%8.2" /end CHARACTERISTIC
/begin CHARACTERISTIC DFES_DTCM.DFC_ComInvld_453h_OBC_IN_VOLTAGE_C "" VALUE 0x802495CE Val_Wu16 65535.00 DFES_OneToOne 0.00 65535.00 FORMAT "%8.2" /end CHARACTERISTIC
/begin CHARACTERISTIC DFES_DTCM.DFC_ComInvld_453h_OBC_IP_POWER_C "" VALUE 0x802495D0 Val_Wu16 65535.00 DFES_OneToOne 0.00 65535.00 FORMAT "%8.2" /end CHARACTERISTIC
/begin CHARACTERISTIC DFES_DTCM.DFC_ComInvld_455h_HVBAT_NOMINAL_VOLTAGE_C "" VALUE 0x802495D2 Val_Wu16 65535.00 DFES_OneToOne 0.00 65535.00 FORMAT "%8.2" /end CHARACTERISTIC
/begin CHARACTERISTIC DFES_DTCM.DFC_ComInvld_463h_OBC_OUT_CURRENT_C "" VALUE 0x802495D4 Val_Wu16 65535.00 DFES_OneToOne 0.00 65535.00 FORMAT "%8.2" /end CHARACTERISTIC
/begin CHARACTERISTIC DFES_DTCM.DFC_ComInvld_463h_OBC_OUT_VOLTAGE_C "" VALUE 0x802495D6 Val_Wu16 65535.00 DFES_OneToOne 0.00 65535.00 FORMAT "%8.2" /end CHARACTERISTIC
/begin CHARACTERISTIC DFES_DTCM.DFC_ComInvld_463h_OBC_TEMPERATURE_C "" VALUE 0x802495D8 Val_Wu16 65535.00 DFES_OneToOne 0.00 65535.00 FORMAT "%8.2" /end CHARACTERISTIC
/begin CHARACTERISTIC DFES_DTCM.DFC_ComInvld_473h_DCDC_Coolant_Temperature_C "" VALUE 0x802495DA Val_Wu16 65535.00 DFES_OneToOne 0.00 65535.00 FORMAT "%8.2" /end CHARACTERISTIC
/begin CHARACTERISTIC DFES_DTCM.DFC_ComInvld_473h_DCDC_TEMPERATURE_C "" VALUE 0x802495DC Val_Wu16 65535.00 DFES_OneToOne 0.00 65535.00 FORMAT "%8.2" /end CHARACTERISTIC
/begin CHARACTERISTIC DFES_DTCM.DFC_ComInvld_47Bh_eCOMP_BusBarCurrent_C "" VALUE 0x802495DE Val_Wu16 65535.00 DFES_OneToOne 0.00 65535.00 FORMAT "%8.2" /end CHARACTERISTIC
/begin CHARACTERISTIC DFES_DTCM.DFC_ComInvld_47Bh_eCOMP_BusBarVoltage_C "" VALUE 0x802495E0 Val_Wu16 65535.00 DFES_OneToOne 0.00 65535.00 FORMAT "%8.2" /end CHARACTERISTIC
/begin CHARACTERISTIC DFES_DTCM.DFC_ComInvld_47Bh_eCOMP_CompressorSpeed_C "" VALUE 0x802495E2 Val_Wu16 65535.00 DFES_OneToOne 0.00 65535.00 FORMAT "%8.2" /end CHARACTERISTIC
/begin CHARACTERISTIC DFES_DTCM.DFC_ComInvld_47Bh_eCOMP_IGBT_Temp_C "" VALUE 0x802495E4 Val_Wu16 65535.00 DFES_OneToOne 0.00 65535.00 FORMAT "%8.2" /end CHARACTERISTIC
/begin CHARACTERISTIC DFES_DTCM.DFC_ComInvld_47Bh_eCOMP_PeakPhaCurrent_C "" VALUE 0x802495E6 Val_Wu16 65535.00 DFES_OneToOne 0.00 65535.00 FORMAT "%8.2" /end CHARACTERISTIC
/begin CHARACTERISTIC DFES_DTCM.DFC_ComInvld_47Bh_eCOMP_Power_consumption_C "" VALUE 0x802495E8 Val_Wu16 65535.00 DFES_OneToOne 0.00 65535.00 FORMAT "%8.2" /end CHARACTERISTIC
/begin CHARACTERISTIC DFES_DTCM.DFC_ComInvld_4F2h_STATUS_SOC_C "" VALUE 0x802495EA Val_Wu16 65535.00 DFES_OneToOne 0.00 65535.00 FORMAT "%8.2" /end CHARACTERISTIC
/begin CHARACTERISTIC DFES_DTCM.DFC_ComInvld_4F2h_TEMP_BATT_STATUS_C "" VALUE 0x802495EC Val_Wu16 65535.00 DFES_OneToOne 0.00 65535.00 FORMAT "%8.2" /end CHARACTERISTIC
/begin CHARACTERISTIC DFES_DTCM.DFC_ComInvld_4F2h_VALEUR_SOC_ETENDUE_C "" VALUE 0x802495EE Val_Wu16 65535.00 DFES_OneToOne 0.00 65535.00 FORMAT "%8.2" /end CHARACTERISTIC
/begin CHARACTERISTIC DFES_DTCM.DFC_ComInvld_535h_HV_BATT_TEMP_AVG_C "" VALUE 0x802495F0 Val_Wu16 65535.00 DFES_OneToOne 0.00 65535.00 FORMAT "%8.2" /end CHARACTERISTIC
/begin CHARACTERISTIC DFES_DTCM.DFC_ComInvld_543h_HVBAT_RESTBATTENERGY_C "" VALUE 0x802495F2 Val_Wu16 65535.00 DFES_OneToOne 0.00 65535.00 FORMAT "%8.2" /end CHARACTERISTIC
/begin CHARACTERISTIC DFES_DTCM.DFC_ComInvld_543h_HVBAT_SOH_C "" VALUE 0x802495F4 Val_Wu16 65535.00 DFES_OneToOne 0.00 65535.00 FORMAT "%8.2" /end CHARACTERISTIC
/begin CHARACTERISTIC DFES_DTCM.DFC_ComInvld_543h_HV_BATT_SOH_RES_C "" VALUE 0x802495F6 Val_Wu16 65535.00 DFES_OneToOne 0.00 65535.00 FORMAT "%8.2" /end CHARACTERISTIC
/begin CHARACTERISTIC DFES_DTCM.DFC_ComInvld_552h_CPT_TEMPOREL_C "" VALUE 0x802495F8 Val_Wu16 65535.00 DFES_OneToOne 0.00 65535.00 FORMAT "%8.2" /end CHARACTERISTIC
/begin CHARACTERISTIC DFES_DTCM.DFC_ComInvld_552h_KILOMETRAGE_C "" VALUE 0x802495FA Val_Wu16 65535.00 DFES_OneToOne 0.00 65535.00 FORMAT "%8.2" /end CHARACTERISTIC
/begin CHARACTERISTIC DFES_DTCM.DFC_ComInvld_583h_HV_BATT_DISCONT_CSE_OPEN_C "" VALUE 0x802495FC Val_Wu16 65535.00 DFES_OneToOne 0.00 65535.00 FORMAT "%8.2" /end CHARACTERISTIC
/begin CHARACTERISTIC DFES_DTCM.DFC_ComInvld_592h_CALIBRE_IBATT_C "" VALUE 0x802495FE Val_Wu16 65535.00 DFES_OneToOne 0.00 65535.00 FORMAT "%8.2" /end CHARACTERISTIC
/begin CHARACTERISTIC DFES_DTCM.DFC_ComInvld_592h_IBATT_1_C "" VALUE 0x80249600 Val_Wu16 65535.00 DFES_OneToOne 0.00 65535.00 FORMAT "%8.2" /end CHARACTERISTIC
/begin CHARACTERISTIC DFES_DTCM.DFC_ComInvld_592h_IBATT_2_C "" VALUE 0x80249602 Val_Wu16 65535.00 DFES_OneToOne 0.00 65535.00 FORMAT "%8.2" /end CHARACTERISTIC
/begin CHARACTERISTIC DFES_DTCM.DFC_ComInvld_592h_IBATT_3_C "" VALUE 0x80249604 Val_Wu16 65535.00 DFES_OneToOne 0.00 65535.00 FORMAT "%8.2" /end CHARACTERISTIC
/begin CHARACTERISTIC DFES_DTCM.DFC_ComInvld_592h_TEMP_BATT_C "" VALUE 0x80249606 Val_Wu16 65535.00 DFES_OneToOne 0.00 65535.00 FORMAT "%8.2" /end CHARACTERISTIC
/begin CHARACTERISTIC DFES_DTCM.DFC_ComInvld_592h_U_BATT_BECB_C "" VALUE 0x80249608 Val_Wu16 65535.00 DFES_OneToOne 0.00 65535.00 FORMAT "%8.2" /end CHARACTERISTIC
/begin CHARACTERISTIC DFES_DTCM.DFC_ComInvld_595h_HVBAT_TIME_TO_CHRG_80_C "" VALUE 0x8024960A Val_Wu16 65535.00 DFES_OneToOne 0.00 65535.00 FORMAT "%8.2" /end CHARACTERISTIC
/begin CHARACTERISTIC DFES_DTCM.DFC_ComInvld_5B2h_TEMP_AIR_EXT_C "" VALUE 0x8024960C Val_Wu16 65535.00 DFES_OneToOne 0.00 65535.00 FORMAT "%8.2" /end CHARACTERISTIC
/begin CHARACTERISTIC DFES_DTCM.DFC_ComInvld_5B5h_HVBAT_THERMAL_RUNAWAY_C "" VALUE 0x8024960E Val_Wu16 65535.00 DFES_OneToOne 0.00 65535.00 FORMAT "%8.2" /end CHARACTERISTIC
/begin CHARACTERISTIC DFES_DTCM.DFC_ComInvld_635h_HVBAT_NEG_CONT_COUNT_SEG1_C "" VALUE 0x80249610 Val_Wu16 65535.00 DFES_OneToOne 0.00 65535.00 FORMAT "%8.2" /end CHARACTERISTIC
/begin CHARACTERISTIC DFES_DTCM.DFC_ComInvld_635h_HVBAT_NEG_CONT_COUNT_SEG3_C "" VALUE 0x80249612 Val_Wu16 65535.00 DFES_OneToOne 0.00 65535.00 FORMAT "%8.2" /end CHARACTERISTIC
/begin CHARACTERISTIC DFES_DTCM.DFC_ComInvld_635h_HVBAT_NEG_CONT_COUNT_SEG4_C "" VALUE 0x80249614 Val_Wu16 65535.00 DFES_OneToOne 0.00 65535.00 FORMAT "%8.2" /end CHARACTERISTIC
/begin CHARACTERISTIC DFES_DTCM.DFC_ComInvld_635h_HVBAT_PST_CONT_COUNT_SEG1_C "" VALUE 0x80249616 Val_Wu16 65535.00 DFES_OneToOne 0.00 65535.00 FORMAT "%8.2" /end CHARACTERISTIC
/begin CHARACTERISTIC DFES_DTCM.DFC_ComInvld_635h_HVBAT_PST_CONT_COUNT_SEG3_C "" VALUE 0x80249618 Val_Wu16 65535.00 DFES_OneToOne 0.00 65535.00 FORMAT "%8.2" /end CHARACTERISTIC
/begin CHARACTERISTIC DFES_DTCM.DFC_ComInvld_635h_HVBAT_PST_CONT_COUNT_SEG4_C "" VALUE 0x8024961A Val_Wu16 65535.00 DFES_OneToOne 0.00 65535.00 FORMAT "%8.2" /end CHARACTERISTIC
/begin CHARACTERISTIC DFES_DTCM.DFC_ComInvld_645h_HVBAT_PRECHRGE_CONT_COUNT_SEG1_C "" VALUE 0x8024961C Val_Wu16 65535.00 DFES_OneToOne 0.00 65535.00 FORMAT "%8.2" /end CHARACTERISTIC
/begin CHARACTERISTIC DFES_DTCM.DFC_ComInvld_645h_HVBAT_PRECHRGE_CONT_COUNT_SEG2_C "" VALUE 0x8024961E Val_Wu16 65535.00 DFES_OneToOne 0.00 65535.00 FORMAT "%8.2" /end CHARACTERISTIC
/begin CHARACTERISTIC DFES_DTCM.DFC_ComInvld_675h_HVBAT_REMAININGBATTCAPACITY_C "" VALUE 0x80249620 Val_Wu16 65535.00 DFES_OneToOne 0.00 65535.00 FORMAT "%8.2" /end CHARACTERISTIC
/begin CHARACTERISTIC DFES_DTCM.DFC_ACCmprFltLvl1_C "" VALUE 0x80249622 Val_Wu16 65535.00 DFES_OneToOne 0.00 65535.00 FORMAT "%8.2" /end CHARACTERISTIC
/begin CHARACTERISTIC DFES_DTCM.DFC_ACCmprFltLvl2_C "" VALUE 0x80249624 Val_Wu16 65535.00 DFES_OneToOne 0.00 65535.00 FORMAT "%8.2" /end CHARACTERISTIC
/begin CHARACTERISTIC DFES_DTCM.DFC_ACCmprFltLvl3_C "" VALUE 0x80249626 Val_Wu16 65535.00 DFES_OneToOne 0.00 65535.00 FORMAT "%8.2" /end CHARACTERISTIC
/begin CHARACTERISTIC DFES_DTCM.DFC_ACCmprFltLvl4_C "" VALUE 0x80249628 Val_Wu16 65535.00 DFES_OneToOne 0.00 65535.00 FORMAT "%8.2" /end CHARACTERISTIC
/begin CHARACTERISTIC DFES_DTCM.DFC_ACCmprHiPFlt_C "" VALUE 0x8024962A Val_Wu16 65535.00 DFES_OneToOne 0.00 65535.00 FORMAT "%8.2" /end CHARACTERISTIC
/begin CHARACTERISTIC DFES_DTCM.DFC_ACCmprInvldCmprSt_C "" VALUE 0x8024962C Val_Wu16 65535.00 DFES_OneToOne 0.00 65535.00 FORMAT "%8.2" /end CHARACTERISTIC
/begin CHARACTERISTIC DFES_DTCM.DFC_ACCmprInvldElecActPwr_C "" VALUE 0x8024962E Val_Wu16 65535.00 DFES_OneToOne 0.00 65535.00 FORMAT "%8.2" /end CHARACTERISTIC
/begin CHARACTERISTIC DFES_DTCM.DFC_ACCmprLoPFlt_C "" VALUE 0x80249630 Val_Wu16 65535.00 DFES_OneToOne 0.00 65535.00 FORMAT "%8.2" /end CHARACTERISTIC
/begin CHARACTERISTIC DFES_DTCM.DFC_AcChrgrIntkTSRCMin_C "" VALUE 0x80249632 Val_Wu16 65535.00 DFES_OneToOne 0.00 65535.00 FORMAT "%8.2" /end CHARACTERISTIC
/begin CHARACTERISTIC DFES_DTCM.DFC_BattUBMaxBatt_C "" VALUE 0x80249634 Val_Wu16 65535.00 DFES_OneToOne 0.00 65535.00 FORMAT "%8.2" /end CHARACTERISTIC
/begin CHARACTERISTIC DFES_DTCM.DFC_BattUBMaxNoBatt_C "" VALUE 0x80249636 Val_Wu16 65535.00 DFES_OneToOne 0.00 65535.00 FORMAT "%8.2" /end CHARACTERISTIC
/begin CHARACTERISTIC DFES_DTCM.DFC_BattUBMinBatt_C "" VALUE 0x80249638 Val_Wu16 65535.00 DFES_OneToOne 0.00 65535.00 FORMAT "%8.2" /end CHARACTERISTIC
/begin CHARACTERISTIC DFES_DTCM.DFC_BattUBMinNoBatt_C "" VALUE 0x8024963A Val_Wu16 65535.00 DFES_OneToOne 0.00 65535.00 FORMAT "%8.2" /end CHARACTERISTIC
/begin CHARACTERISTIC DFES_DTCM.DFC_BattUSRCMax_C "" VALUE 0x8024963C Val_Wu16 65535.00 DFES_OneToOne 0.00 65535.00 FORMAT "%8.2" /end CHARACTERISTIC
/begin CHARACTERISTIC DFES_DTCM.DFC_BattUSRCMin_C "" VALUE 0x8024963E Val_Wu16 65535.00 DFES_OneToOne 0.00 65535.00 FORMAT "%8.2" /end CHARACTERISTIC
/begin CHARACTERISTIC DFES_DTCM.DFC_BrkBstPHiCautionDfct_C "" VALUE 0x80249640 Val_Wu16 65535.00 DFES_OneToOne 0.00 65535.00 FORMAT "%8.2" /end CHARACTERISTIC
/begin CHARACTERISTIC DFES_DTCM.DFC_BrkBstPHiWarnDfct_C "" VALUE 0x80249642 Val_Wu16 65535.00 DFES_OneToOne 0.00 65535.00 FORMAT "%8.2" /end CHARACTERISTIC
/begin CHARACTERISTIC DFES_DTCM.DFC_BrkBstPSnsr12PlausDfct_C "" VALUE 0x80249644 Val_Wu16 65535.00 DFES_OneToOne 0.00 65535.00 FORMAT "%8.2" /end CHARACTERISTIC
/begin CHARACTERISTIC DFES_DTCM.DFC_BrkBstPSnsr1Scb_C "" VALUE 0x80249646 Val_Wu16 65535.00 DFES_OneToOne 0.00 65535.00 FORMAT "%8.2" /end CHARACTERISTIC
/begin CHARACTERISTIC DFES_DTCM.DFC_BrkBstPSnsr1Scg_C "" VALUE 0x80249648 Val_Wu16 65535.00 DFES_OneToOne 0.00 65535.00 FORMAT "%8.2" /end CHARACTERISTIC
/begin CHARACTERISTIC DFES_DTCM.DFC_BrkBstPSnsr2Scb_C "" VALUE 0x8024964A Val_Wu16 65535.00 DFES_OneToOne 0.00 65535.00 FORMAT "%8.2" /end CHARACTERISTIC
/begin CHARACTERISTIC DFES_DTCM.DFC_BrkBstPSnsr2Scg_C "" VALUE 0x8024964C Val_Wu16 65535.00 DFES_OneToOne 0.00 65535.00 FORMAT "%8.2" /end CHARACTERISTIC
/begin CHARACTERISTIC DFES_DTCM.DFC_BrkBstPSnsrMax_C "" VALUE 0x8024964E Val_Wu16 65535.00 DFES_OneToOne 0.00 65535.00 FORMAT "%8.2" /end CHARACTERISTIC
/begin CHARACTERISTIC DFES_DTCM.DFC_BrkBstPSnsrMin_C "" VALUE 0x80249650 Val_Wu16 65535.00 DFES_OneToOne 0.00 65535.00 FORMAT "%8.2" /end CHARACTERISTIC
/begin CHARACTERISTIC DFES_DTCM.DFC_BrkBstPhyRngChkMax_C "" VALUE 0x80249652 Val_Wu16 65535.00 DFES_OneToOne 0.00 65535.00 FORMAT "%8.2" /end CHARACTERISTIC
/begin CHARACTERISTIC DFES_DTCM.DFC_BrkBstPhyRngChkMin_C "" VALUE 0x80249654 Val_Wu16 65535.00 DFES_OneToOne 0.00 65535.00 FORMAT "%8.2" /end CHARACTERISTIC
/begin CHARACTERISTIC DFES_DTCM.DFC_BrkBstPmpHsScb_C "" VALUE 0x80249656 Val_Wu16 65535.00 DFES_OneToOne 0.00 65535.00 FORMAT "%8.2" /end CHARACTERISTIC
/begin CHARACTERISTIC DFES_DTCM.DFC_BrkBstPmpHsScg_C "" VALUE 0x80249658 Val_Wu16 65535.00 DFES_OneToOne 0.00 65535.00 FORMAT "%8.2" /end CHARACTERISTIC
/begin CHARACTERISTIC DFES_DTCM.DFC_BrkBstPmpLsOl_C "" VALUE 0x8024965A Val_Wu16 65535.00 DFES_OneToOne 0.00 65535.00 FORMAT "%8.2" /end CHARACTERISTIC
/begin CHARACTERISTIC DFES_DTCM.DFC_BrkBstPmpLsScb_C "" VALUE 0x8024965C Val_Wu16 65535.00 DFES_OneToOne 0.00 65535.00 FORMAT "%8.2" /end CHARACTERISTIC
/begin CHARACTERISTIC DFES_DTCM.DFC_BrkBstPmpLsScg_C "" VALUE 0x8024965E Val_Wu16 65535.00 DFES_OneToOne 0.00 65535.00 FORMAT "%8.2" /end CHARACTERISTIC
/begin CHARACTERISTIC DFES_DTCM.DFC_CbnHeatgHeatrRlyOpend_C "" VALUE 0x80249660 Val_Wu16 65535.00 DFES_OneToOne 0.00 65535.00 FORMAT "%8.2" /end CHARACTERISTIC
/begin CHARACTERISTIC DFES_DTCM.DFC_CbnHeatgHeatrRlyWldd_C "" VALUE 0x80249662 Val_Wu16 65535.00 DFES_OneToOne 0.00 65535.00 FORMAT "%8.2" /end CHARACTERISTIC
/begin CHARACTERISTIC DFES_DTCM.DFC_CcsDcIBattExcdd_C "" VALUE 0x80249664 Val_Wu16 65535.00 DFES_OneToOne 0.00 65535.00 FORMAT "%8.2" /end CHARACTERISTIC
/begin CHARACTERISTIC DFES_DTCM.DFC_CcsDcIEvseOutDe_C "" VALUE 0x80249666 Val_Wu16 65535.00 DFES_OneToOne 0.00 65535.00 FORMAT "%8.2" /end CHARACTERISTIC
/begin CHARACTERISTIC DFES_DTCM.DFC_CcsDcIOutDe_C "" VALUE 0x80249668 Val_Wu16 65535.00 DFES_OneToOne 0.00 65535.00 FORMAT "%8.2" /end CHARACTERISTIC
/begin CHARACTERISTIC DFES_DTCM.DFC_CcsDcIOutExcdd_C "" VALUE 0x8024966A Val_Wu16 65535.00 DFES_OneToOne 0.00 65535.00 FORMAT "%8.2" /end CHARACTERISTIC
/begin CHARACTERISTIC DFES_DTCM.DFC_CcsDcUOutDe_C "" VALUE 0x8024966C Val_Wu16 65535.00 DFES_OneToOne 0.00 65535.00 FORMAT "%8.2" /end CHARACTERISTIC
/begin CHARACTERISTIC DFES_DTCM.DFC_CcsDcUOutExcdd_C "" VALUE 0x8024966E Val_Wu16 65535.00 DFES_OneToOne 0.00 65535.00 FORMAT "%8.2" /end CHARACTERISTIC
/begin CHARACTERISTIC DFES_DTCM.DFC_CcsPwrLineChpRstOL_C "" VALUE 0x80249670 Val_Wu16 65535.00 DFES_OneToOne 0.00 65535.00 FORMAT "%8.2" /end CHARACTERISTIC
/begin CHARACTERISTIC DFES_DTCM.DFC_CcsPwrLineChpRstOvrTemp_C "" VALUE 0x80249672 Val_Wu16 65535.00 DFES_OneToOne 0.00 65535.00 FORMAT "%8.2" /end CHARACTERISTIC
/begin CHARACTERISTIC DFES_DTCM.DFC_CcsPwrLineChpRstSCB_C "" VALUE 0x80249674 Val_Wu16 65535.00 DFES_OneToOne 0.00 65535.00 FORMAT "%8.2" /end CHARACTERISTIC
/begin CHARACTERISTIC DFES_DTCM.DFC_CcsPwrLineChpRstSCG_C "" VALUE 0x80249676 Val_Wu16 65535.00 DFES_OneToOne 0.00 65535.00 FORMAT "%8.2" /end CHARACTERISTIC
/begin CHARACTERISTIC DFES_DTCM.DFC_CcsPwrLineChpVccEnaOL_C "" VALUE 0x80249678 Val_Wu16 65535.00 DFES_OneToOne 0.00 65535.00 FORMAT "%8.2" /end CHARACTERISTIC
/begin CHARACTERISTIC DFES_DTCM.DFC_CcsPwrLineChpVccEnaOvrTemp_C "" VALUE 0x8024967A Val_Wu16 65535.00 DFES_OneToOne 0.00 65535.00 FORMAT "%8.2" /end CHARACTERISTIC
/begin CHARACTERISTIC DFES_DTCM.DFC_CcsPwrLineChpVccEnaSCB_C "" VALUE 0x8024967C Val_Wu16 65535.00 DFES_OneToOne 0.00 65535.00 FORMAT "%8.2" /end CHARACTERISTIC
/begin CHARACTERISTIC DFES_DTCM.DFC_CcsPwrLineChpVccEnaSCG_C "" VALUE 0x8024967E Val_Wu16 65535.00 DFES_OneToOne 0.00 65535.00 FORMAT "%8.2" /end CHARACTERISTIC
/begin CHARACTERISTIC DFES_DTCM.DFC_CcsPwrLineChpVccSRCMin_C "" VALUE 0x80249680 Val_Wu16 65535.00 DFES_OneToOne 0.00 65535.00 FORMAT "%8.2" /end CHARACTERISTIC
/begin CHARACTERISTIC DFES_DTCM.DFC_CcsPwrLineComChpTSRCMin_C "" VALUE 0x80249682 Val_Wu16 65535.00 DFES_OneToOne 0.00 65535.00 FORMAT "%8.2" /end CHARACTERISTIC
/begin CHARACTERISTIC DFES_DTCM.DFC_CtPSwtActrOL_C "" VALUE 0x80249684 Val_Wu16 65535.00 DFES_OneToOne 0.00 65535.00 FORMAT "%8.2" /end CHARACTERISTIC
/begin CHARACTERISTIC DFES_DTCM.DFC_CtPSwtActrOvrTemp_C "" VALUE 0x80249686 Val_Wu16 65535.00 DFES_OneToOne 0.00 65535.00 FORMAT "%8.2" /end CHARACTERISTIC
/begin CHARACTERISTIC DFES_DTCM.DFC_CtPSwtActrSCB_C "" VALUE 0x80249688 Val_Wu16 65535.00 DFES_OneToOne 0.00 65535.00 FORMAT "%8.2" /end CHARACTERISTIC
/begin CHARACTERISTIC DFES_DTCM.DFC_CtPSwtActrSCG_C "" VALUE 0x8024968A Val_Wu16 65535.00 DFES_OneToOne 0.00 65535.00 FORMAT "%8.2" /end CHARACTERISTIC
/begin CHARACTERISTIC DFES_DTCM.DFC_CtPSwtDiagSRCMin_C "" VALUE 0x8024968C Val_Wu16 65535.00 DFES_OneToOne 0.00 65535.00 FORMAT "%8.2" /end CHARACTERISTIC
/begin CHARACTERISTIC DFES_DTCM.DFC_CtpCarrFrqSRCMin_C "" VALUE 0x8024968E Val_Wu16 65535.00 DFES_OneToOne 0.00 65535.00 FORMAT "%8.2" /end CHARACTERISTIC
/begin CHARACTERISTIC DFES_DTCM.DFC_DcChrgrIntkT2SRCMin_C "" VALUE 0x80249690 Val_Wu16 65535.00 DFES_OneToOne 0.00 65535.00 FORMAT "%8.2" /end CHARACTERISTIC
/begin CHARACTERISTIC DFES_DTCM.DFC_DcChrgrIntkTSRCMin_C "" VALUE 0x80249692 Val_Wu16 65535.00 DFES_OneToOne 0.00 65535.00 FORMAT "%8.2" /end CHARACTERISTIC
/begin CHARACTERISTIC DFES_DTCM.DFC_DevLibBattUHi_C "" VALUE 0x80249694 Val_Wu16 65535.00 DFES_OneToOne 0.00 65535.00 FORMAT "%8.2" /end CHARACTERISTIC
/begin CHARACTERISTIC DFES_DTCM.DFC_DevLibBattULo_C "" VALUE 0x80249696 Val_Wu16 65535.00 DFES_OneToOne 0.00 65535.00 FORMAT "%8.2" /end CHARACTERISTIC
/begin CHARACTERISTIC DFES_DTCM.DFC_EmWakeupSigOL_C "" VALUE 0x80249698 Val_Wu16 65535.00 DFES_OneToOne 0.00 65535.00 FORMAT "%8.2" /end CHARACTERISTIC
/begin CHARACTERISTIC DFES_DTCM.DFC_EmWakeupSigOvrTemp_C "" VALUE 0x8024969A Val_Wu16 65535.00 DFES_OneToOne 0.00 65535.00 FORMAT "%8.2" /end CHARACTERISTIC
/begin CHARACTERISTIC DFES_DTCM.DFC_EmWakeupSigSCB_C "" VALUE 0x8024969C Val_Wu16 65535.00 DFES_OneToOne 0.00 65535.00 FORMAT "%8.2" /end CHARACTERISTIC
/begin CHARACTERISTIC DFES_DTCM.DFC_EmWakeupSigSCG_C "" VALUE 0x8024969E Val_Wu16 65535.00 DFES_OneToOne 0.00 65535.00 FORMAT "%8.2" /end CHARACTERISTIC
/begin CHARACTERISTIC DFES_DTCM.DFC_Fan1OL_C "" VALUE 0x802496A0 Val_Wu16 65535.00 DFES_OneToOne 0.00 65535.00 FORMAT "%8.2" /end CHARACTERISTIC
/begin CHARACTERISTIC DFES_DTCM.DFC_Fan1OvrTemp_C "" VALUE 0x802496A2 Val_Wu16 65535.00 DFES_OneToOne 0.00 65535.00 FORMAT "%8.2" /end CHARACTERISTIC
/begin CHARACTERISTIC DFES_DTCM.DFC_Fan1SCB_C "" VALUE 0x802496A4 Val_Wu16 65535.00 DFES_OneToOne 0.00 65535.00 FORMAT "%8.2" /end CHARACTERISTIC
/begin CHARACTERISTIC DFES_DTCM.DFC_FanRlySCB_C "" VALUE 0x802496A6 Val_Wu16 65535.00 DFES_OneToOne 0.00 65535.00 FORMAT "%8.2" /end CHARACTERISTIC
/begin CHARACTERISTIC DFES_DTCM.DFC_FanRlySCG_C "" VALUE 0x802496A8 Val_Wu16 65535.00 DFES_OneToOne 0.00 65535.00 FORMAT "%8.2" /end CHARACTERISTIC
/begin CHARACTERISTIC DFES_DTCM.DFC_FanSpdSRCMin_C "" VALUE 0x802496AA Val_Wu16 65535.00 DFES_OneToOne 0.00 65535.00 FORMAT "%8.2" /end CHARACTERISTIC
/begin CHARACTERISTIC DFES_DTCM.DFC_FreonPSRCMin_C "" VALUE 0x802496AC Val_Wu16 65535.00 DFES_OneToOne 0.00 65535.00 FORMAT "%8.2" /end CHARACTERISTIC
/begin CHARACTERISTIC DFES_DTCM.DFC_HLCCcsPLnCChipTHi_C "" VALUE 0x802496AE Val_Wu16 65535.00 DFES_OneToOne 0.00 65535.00 FORMAT "%8.2" /end CHARACTERISTIC
/begin CHARACTERISTIC DFES_DTCM.DFC_HeatrCoreTSRCMin_C "" VALUE 0x802496B0 Val_Wu16 65535.00 DFES_OneToOne 0.00 65535.00 FORMAT "%8.2" /end CHARACTERISTIC
/begin CHARACTERISTIC DFES_DTCM.DFC_PwmCtPSRCMin_C "" VALUE 0x802496B2 Val_Wu16 65535.00 DFES_OneToOne 0.00 65535.00 FORMAT "%8.2" /end CHARACTERISTIC
/begin CHARACTERISTIC DFES_DTCM.DFC_PwrDistbnUnitTSRCMin_C "" VALUE 0x802496B4 Val_Wu16 65535.00 DFES_OneToOne 0.00 65535.00 FORMAT "%8.2" /end CHARACTERISTIC
/begin CHARACTERISTIC DFES_DTCM.DFC_SCtPmp1OL_C "" VALUE 0x802496B6 Val_Wu16 65535.00 DFES_OneToOne 0.00 65535.00 FORMAT "%8.2" /end CHARACTERISTIC
/begin CHARACTERISTIC DFES_DTCM.DFC_SCtPmp1OvrTemp_C "" VALUE 0x802496B8 Val_Wu16 65535.00 DFES_OneToOne 0.00 65535.00 FORMAT "%8.2" /end CHARACTERISTIC
/begin CHARACTERISTIC DFES_DTCM.DFC_SCtPmp1SCB_C "" VALUE 0x802496BA Val_Wu16 65535.00 DFES_OneToOne 0.00 65535.00 FORMAT "%8.2" /end CHARACTERISTIC
/begin CHARACTERISTIC DFES_DTCM.DFC_SCtPmpRlyOL_C "" VALUE 0x802496BC Val_Wu16 65535.00 DFES_OneToOne 0.00 65535.00 FORMAT "%8.2" /end CHARACTERISTIC
/begin CHARACTERISTIC DFES_DTCM.DFC_SCtPmpRlyOvrTemp_C "" VALUE 0x802496BE Val_Wu16 65535.00 DFES_OneToOne 0.00 65535.00 FORMAT "%8.2" /end CHARACTERISTIC
/begin CHARACTERISTIC DFES_DTCM.DFC_SCtPmpRlySCB_C "" VALUE 0x802496C0 Val_Wu16 65535.00 DFES_OneToOne 0.00 65535.00 FORMAT "%8.2" /end CHARACTERISTIC
/begin CHARACTERISTIC DFES_DTCM.DFC_SpplCooltPmpRlyOL_C "" VALUE 0x802496C2 Val_Wu16 65535.00 DFES_OneToOne 0.00 65535.00 FORMAT "%8.2" /end CHARACTERISTIC
/begin CHARACTERISTIC DFES_DTCM.DFC_SpplCooltPmpRlyOvrTemp_C "" VALUE 0x802496C4 Val_Wu16 65535.00 DFES_OneToOne 0.00 65535.00 FORMAT "%8.2" /end CHARACTERISTIC
/begin CHARACTERISTIC DFES_DTCM.DFC_SpplCooltPmpRlySCB_C "" VALUE 0x802496C6 Val_Wu16 65535.00 DFES_OneToOne 0.00 65535.00 FORMAT "%8.2" /end CHARACTERISTIC
/begin CHARACTERISTIC DFES_DTCM.DFC_UCtPSRCMin_C "" VALUE 0x802496C8 Val_Wu16 65535.00 DFES_OneToOne 0.00 65535.00 FORMAT "%8.2" /end CHARACTERISTIC
/begin CHARACTERISTIC DFES_DTCM.DFC_UPxP1SRCMin_C "" VALUE 0x802496CA Val_Wu16 65535.00 DFES_OneToOne 0.00 65535.00 FORMAT "%8.2" /end CHARACTERISTIC
/begin CHARACTERISTIC DFES_DTCM.DFC_ComHSN1CANMute_C "" VALUE 0x802496CC Val_Wu16 65535.00 DFES_OneToOne 0.00 65535.00 FORMAT "%8.2" /end CHARACTERISTIC
/begin CHARACTERISTIC DFES_DTCM.DFC_ComHSN3CANMute_C "" VALUE 0x802496CE Val_Wu16 65535.00 DFES_OneToOne 0.00 65535.00 FORMAT "%8.2" /end CHARACTERISTIC
/begin CHARACTERISTIC DFES_DTCM.DFC_AcChrgrIntkTPhysRngHi_C "" VALUE 0x802496D0 Val_Wu16 65535.00 DFES_OneToOne 0.00 65535.00 FORMAT "%8.2" /end CHARACTERISTIC
/begin CHARACTERISTIC DFES_DTCM.DFC_AcChrgrIntkTPhysRngLo_C "" VALUE 0x802496D2 Val_Wu16 65535.00 DFES_OneToOne 0.00 65535.00 FORMAT "%8.2" /end CHARACTERISTIC
/begin CHARACTERISTIC DFES_DTCM.DFC_AcChrgrIntkTSRCOpn_C "" VALUE 0x802496D4 Val_Wu16 65535.00 DFES_OneToOne 0.00 65535.00 FORMAT "%8.2" /end CHARACTERISTIC
/begin CHARACTERISTIC DFES_DTCM.DFC_CcsPwrLineChpVccPhysRngHi_C "" VALUE 0x802496D6 Val_Wu16 65535.00 DFES_OneToOne 0.00 65535.00 FORMAT "%8.2" /end CHARACTERISTIC
/begin CHARACTERISTIC DFES_DTCM.DFC_CcsPwrLineChpVccPhysRngLo_C "" VALUE 0x802496D8 Val_Wu16 65535.00 DFES_OneToOne 0.00 65535.00 FORMAT "%8.2" /end CHARACTERISTIC
/begin CHARACTERISTIC DFES_DTCM.DFC_CcsPwrLineChpVccSRCOpn_C "" VALUE 0x802496DA Val_Wu16 65535.00 DFES_OneToOne 0.00 65535.00 FORMAT "%8.2" /end CHARACTERISTIC
/begin CHARACTERISTIC DFES_DTCM.DFC_CcsPwrLineComChpTPhysRngHi_C "" VALUE 0x802496DC Val_Wu16 65535.00 DFES_OneToOne 0.00 65535.00 FORMAT "%8.2" /end CHARACTERISTIC
/begin CHARACTERISTIC DFES_DTCM.DFC_CcsPwrLineComChpTPhysRngLo_C "" VALUE 0x802496DE Val_Wu16 65535.00 DFES_OneToOne 0.00 65535.00 FORMAT "%8.2" /end CHARACTERISTIC
/begin CHARACTERISTIC DFES_DTCM.DFC_CcsPwrLineComChpTSRCOpn_C "" VALUE 0x802496E0 Val_Wu16 65535.00 DFES_OneToOne 0.00 65535.00 FORMAT "%8.2" /end CHARACTERISTIC
/begin CHARACTERISTIC DFES_DTCM.DFC_CtPSwtDiagPhysRngHi_C "" VALUE 0x802496E2 Val_Wu16 65535.00 DFES_OneToOne 0.00 65535.00 FORMAT "%8.2" /end CHARACTERISTIC
/begin CHARACTERISTIC DFES_DTCM.DFC_CtPSwtDiagPhysRngLo_C "" VALUE 0x802496E4 Val_Wu16 65535.00 DFES_OneToOne 0.00 65535.00 FORMAT "%8.2" /end CHARACTERISTIC
/begin CHARACTERISTIC DFES_DTCM.DFC_CtPSwtDiagSRCOpn_C "" VALUE 0x802496E6 Val_Wu16 65535.00 DFES_OneToOne 0.00 65535.00 FORMAT "%8.2" /end CHARACTERISTIC
/begin CHARACTERISTIC DFES_DTCM.DFC_CtpCarrFrqPhysRngHi_C "" VALUE 0x802496E8 Val_Wu16 65535.00 DFES_OneToOne 0.00 65535.00 FORMAT "%8.2" /end CHARACTERISTIC
/begin CHARACTERISTIC DFES_DTCM.DFC_CtpCarrFrqPhysRngLo_C "" VALUE 0x802496EA Val_Wu16 65535.00 DFES_OneToOne 0.00 65535.00 FORMAT "%8.2" /end CHARACTERISTIC
/begin CHARACTERISTIC DFES_DTCM.DFC_CtpCarrFrqSRCMax_C "" VALUE 0x802496EC Val_Wu16 65535.00 DFES_OneToOne 0.00 65535.00 FORMAT "%8.2" /end CHARACTERISTIC
/begin CHARACTERISTIC DFES_DTCM.DFC_DcChrgrIntkT2PhysRngHi_C "" VALUE 0x802496EE Val_Wu16 65535.00 DFES_OneToOne 0.00 65535.00 FORMAT "%8.2" /end CHARACTERISTIC
/begin CHARACTERISTIC DFES_DTCM.DFC_DcChrgrIntkT2PhysRngLo_C "" VALUE 0x802496F0 Val_Wu16 65535.00 DFES_OneToOne 0.00 65535.00 FORMAT "%8.2" /end CHARACTERISTIC
/begin CHARACTERISTIC DFES_DTCM.DFC_DcChrgrIntkT2SRCOpn_C "" VALUE 0x802496F2 Val_Wu16 65535.00 DFES_OneToOne 0.00 65535.00 FORMAT "%8.2" /end CHARACTERISTIC
/begin CHARACTERISTIC DFES_DTCM.DFC_DcChrgrIntkTPhysRngHi_C "" VALUE 0x802496F4 Val_Wu16 65535.00 DFES_OneToOne 0.00 65535.00 FORMAT "%8.2" /end CHARACTERISTIC
/begin CHARACTERISTIC DFES_DTCM.DFC_DcChrgrIntkTPhysRngLo_C "" VALUE 0x802496F6 Val_Wu16 65535.00 DFES_OneToOne 0.00 65535.00 FORMAT "%8.2" /end CHARACTERISTIC
/begin CHARACTERISTIC DFES_DTCM.DFC_DcChrgrIntkTSRCOpn_C "" VALUE 0x802496F8 Val_Wu16 65535.00 DFES_OneToOne 0.00 65535.00 FORMAT "%8.2" /end CHARACTERISTIC
/begin CHARACTERISTIC DFES_DTCM.DFC_Fan1SCG_C "" VALUE 0x802496FA Val_Wu16 65535.00 DFES_OneToOne 0.00 65535.00 FORMAT "%8.2" /end CHARACTERISTIC
/begin CHARACTERISTIC DFES_DTCM.DFC_FanSpdPhysRngHi_C "" VALUE 0x802496FC Val_Wu16 65535.00 DFES_OneToOne 0.00 65535.00 FORMAT "%8.2" /end CHARACTERISTIC
/begin CHARACTERISTIC DFES_DTCM.DFC_FanSpdPhysRngLo_C "" VALUE 0x802496FE Val_Wu16 65535.00 DFES_OneToOne 0.00 65535.00 FORMAT "%8.2" /end CHARACTERISTIC
/begin CHARACTERISTIC DFES_DTCM.DFC_FanSpdSRCOpn_C "" VALUE 0x80249700 Val_Wu16 65535.00 DFES_OneToOne 0.00 65535.00 FORMAT "%8.2" /end CHARACTERISTIC
/begin CHARACTERISTIC DFES_DTCM.DFC_FreonPPhysRngHi_C "" VALUE 0x80249702 Val_Wu16 65535.00 DFES_OneToOne 0.00 65535.00 FORMAT "%8.2" /end CHARACTERISTIC
/begin CHARACTERISTIC DFES_DTCM.DFC_FreonPPhysRngLo_C "" VALUE 0x80249704 Val_Wu16 65535.00 DFES_OneToOne 0.00 65535.00 FORMAT "%8.2" /end CHARACTERISTIC
/begin CHARACTERISTIC DFES_DTCM.DFC_FreonPSRCOpn_C "" VALUE 0x80249706 Val_Wu16 65535.00 DFES_OneToOne 0.00 65535.00 FORMAT "%8.2" /end CHARACTERISTIC
/begin CHARACTERISTIC DFES_DTCM.DFC_HeatrCoreTPhysRngHi_C "" VALUE 0x80249708 Val_Wu16 65535.00 DFES_OneToOne 0.00 65535.00 FORMAT "%8.2" /end CHARACTERISTIC
/begin CHARACTERISTIC DFES_DTCM.DFC_HeatrCoreTPhysRngLo_C "" VALUE 0x8024970A Val_Wu16 65535.00 DFES_OneToOne 0.00 65535.00 FORMAT "%8.2" /end CHARACTERISTIC
/begin CHARACTERISTIC DFES_DTCM.DFC_HeatrCoreTSRCOpn_C "" VALUE 0x8024970C Val_Wu16 65535.00 DFES_OneToOne 0.00 65535.00 FORMAT "%8.2" /end CHARACTERISTIC
/begin CHARACTERISTIC DFES_DTCM.DFC_HvGridUMaxSftyLim_C "" VALUE 0x8024970E Val_Wu16 65535.00 DFES_OneToOne 0.00 65535.00 FORMAT "%8.2" /end CHARACTERISTIC
/begin CHARACTERISTIC DFES_DTCM.DFC_HvGridUMinSftyLim_C "" VALUE 0x80249710 Val_Wu16 65535.00 DFES_OneToOne 0.00 65535.00 FORMAT "%8.2" /end CHARACTERISTIC
/begin CHARACTERISTIC DFES_DTCM.DFC_HvGridUPlausy_C "" VALUE 0x80249712 Val_Wu16 65535.00 DFES_OneToOne 0.00 65535.00 FORMAT "%8.2" /end CHARACTERISTIC
/begin CHARACTERISTIC DFES_DTCM.DFC_IntlckChrgPlgHBrgOpnLd_C "" VALUE 0x80249714 Val_Wu16 65535.00 DFES_OneToOne 0.00 65535.00 FORMAT "%8.2" /end CHARACTERISTIC
/begin CHARACTERISTIC DFES_DTCM.DFC_IntlckChrgPlgHBrgOvrCurr_C "" VALUE 0x80249716 Val_Wu16 65535.00 DFES_OneToOne 0.00 65535.00 FORMAT "%8.2" /end CHARACTERISTIC
/begin CHARACTERISTIC DFES_DTCM.DFC_IntlckChrgPlgHBrgOvrTemp_C "" VALUE 0x80249718 Val_Wu16 65535.00 DFES_OneToOne 0.00 65535.00 FORMAT "%8.2" /end CHARACTERISTIC
/begin CHARACTERISTIC DFES_DTCM.DFC_IntlckChrgPlgHBrgShCirBatt1_C "" VALUE 0x8024971A Val_Wu16 65535.00 DFES_OneToOne 0.00 65535.00 FORMAT "%8.2" /end CHARACTERISTIC
/begin CHARACTERISTIC DFES_DTCM.DFC_IntlckChrgPlgHBrgShCirBatt2_C "" VALUE 0x8024971C Val_Wu16 65535.00 DFES_OneToOne 0.00 65535.00 FORMAT "%8.2" /end CHARACTERISTIC
/begin CHARACTERISTIC DFES_DTCM.DFC_IntlckChrgPlgHBrgShCirGnd1_C "" VALUE 0x8024971E Val_Wu16 65535.00 DFES_OneToOne 0.00 65535.00 FORMAT "%8.2" /end CHARACTERISTIC
/begin CHARACTERISTIC DFES_DTCM.DFC_IntlckChrgPlgHBrgShCirGnd2_C "" VALUE 0x80249720 Val_Wu16 65535.00 DFES_OneToOne 0.00 65535.00 FORMAT "%8.2" /end CHARACTERISTIC
/begin CHARACTERISTIC DFES_DTCM.DFC_IntlckChrgPlgHBrgShCirOvrLd_C "" VALUE 0x80249722 Val_Wu16 65535.00 DFES_OneToOne 0.00 65535.00 FORMAT "%8.2" /end CHARACTERISTIC
/begin CHARACTERISTIC DFES_DTCM.DFC_IntlckChrgPlgHBrgTempOvrCurr_C "" VALUE 0x80249724 Val_Wu16 65535.00 DFES_OneToOne 0.00 65535.00 FORMAT "%8.2" /end CHARACTERISTIC
/begin CHARACTERISTIC DFES_DTCM.DFC_IntlckChrgPlgHBrgUndrVltg_C "" VALUE 0x80249726 Val_Wu16 65535.00 DFES_OneToOne 0.00 65535.00 FORMAT "%8.2" /end CHARACTERISTIC
/begin CHARACTERISTIC DFES_DTCM.DFC_IntlckChrgPlgPosnRngFlt_C "" VALUE 0x80249728 Val_Wu16 65535.00 DFES_OneToOne 0.00 65535.00 FORMAT "%8.2" /end CHARACTERISTIC
/begin CHARACTERISTIC DFES_DTCM.DFC_IntlckChrgPlgPosnSrcMax_C "" VALUE 0x8024972A Val_Wu16 65535.00 DFES_OneToOne 0.00 65535.00 FORMAT "%8.2" /end CHARACTERISTIC
/begin CHARACTERISTIC DFES_DTCM.DFC_IntlckChrgPlgPosnSrcMin_C "" VALUE 0x8024972C Val_Wu16 65535.00 DFES_OneToOne 0.00 65535.00 FORMAT "%8.2" /end CHARACTERISTIC
/begin CHARACTERISTIC DFES_DTCM.DFC_PwmCtPPhysRngHi_C "" VALUE 0x8024972E Val_Wu16 65535.00 DFES_OneToOne 0.00 65535.00 FORMAT "%8.2" /end CHARACTERISTIC
/begin CHARACTERISTIC DFES_DTCM.DFC_PwmCtPPhysRngLo_C "" VALUE 0x80249730 Val_Wu16 65535.00 DFES_OneToOne 0.00 65535.00 FORMAT "%8.2" /end CHARACTERISTIC
/begin CHARACTERISTIC DFES_DTCM.DFC_PwmCtPSRCMax_C "" VALUE 0x80249732 Val_Wu16 65535.00 DFES_OneToOne 0.00 65535.00 FORMAT "%8.2" /end CHARACTERISTIC
/begin CHARACTERISTIC DFES_DTCM.DFC_PwrDistbnUnitTPhysRngHi_C "" VALUE 0x80249734 Val_Wu16 65535.00 DFES_OneToOne 0.00 65535.00 FORMAT "%8.2" /end CHARACTERISTIC
/begin CHARACTERISTIC DFES_DTCM.DFC_PwrDistbnUnitTPhysRngLo_C "" VALUE 0x80249736 Val_Wu16 65535.00 DFES_OneToOne 0.00 65535.00 FORMAT "%8.2" /end CHARACTERISTIC
/begin CHARACTERISTIC DFES_DTCM.DFC_PwrDistbnUnitTSRCOpn_C "" VALUE 0x80249738 Val_Wu16 65535.00 DFES_OneToOne 0.00 65535.00 FORMAT "%8.2" /end CHARACTERISTIC
/begin CHARACTERISTIC DFES_DTCM.DFC_SCtPmpRlySCG_C "" VALUE 0x8024973A Val_Wu16 65535.00 DFES_OneToOne 0.00 65535.00 FORMAT "%8.2" /end CHARACTERISTIC
/begin CHARACTERISTIC DFES_DTCM.DFC_SpplCooltPmpRlySCG_C "" VALUE 0x8024973C Val_Wu16 65535.00 DFES_OneToOne 0.00 65535.00 FORMAT "%8.2" /end CHARACTERISTIC
/begin CHARACTERISTIC DFES_DTCM.DFC_UCtPPhysRngHi_C "" VALUE 0x8024973E Val_Wu16 65535.00 DFES_OneToOne 0.00 65535.00 FORMAT "%8.2" /end CHARACTERISTIC
/begin CHARACTERISTIC DFES_DTCM.DFC_UCtPPhysRngLo_C "" VALUE 0x80249740 Val_Wu16 65535.00 DFES_OneToOne 0.00 65535.00 FORMAT "%8.2" /end CHARACTERISTIC
/begin CHARACTERISTIC DFES_DTCM.DFC_UCtPSRCOpn_C "" VALUE 0x80249742 Val_Wu16 65535.00 DFES_OneToOne 0.00 65535.00 FORMAT "%8.2" /end CHARACTERISTIC
/begin CHARACTERISTIC DFES_DTCM.DFC_UPxP1PhysRngHi_C "" VALUE 0x80249744 Val_Wu16 65535.00 DFES_OneToOne 0.00 65535.00 FORMAT "%8.2" /end CHARACTERISTIC
/begin CHARACTERISTIC DFES_DTCM.DFC_UPxP1PhysRngLo_C "" VALUE 0x80249746 Val_Wu16 65535.00 DFES_OneToOne 0.00 65535.00 FORMAT "%8.2" /end CHARACTERISTIC
/begin CHARACTERISTIC DFES_DTCM.DFC_UPxP1SRCOpn_C "" VALUE 0x80249748 Val_Wu16 65535.00 DFES_OneToOne 0.00 65535.00 FORMAT "%8.2" /end CHARACTERISTIC
/begin CHARACTERISTIC DFES_DTCM.DFC_VehVPhysRngHi_C "" VALUE 0x8024974A Val_Wu16 65535.00 DFES_OneToOne 0.00 65535.00 FORMAT "%8.2" /end CHARACTERISTIC
/begin CHARACTERISTIC DFES_DTCM.DFC_VehVPhysRngLo_C "" VALUE 0x8024974C Val_Wu16 65535.00 DFES_OneToOne 0.00 65535.00 FORMAT "%8.2" /end CHARACTERISTIC
/begin CHARACTERISTIC DFES_DTCM.DFC_VehVSigCan_C "" VALUE 0x8024974E Val_Wu16 65535.00 DFES_OneToOne 0.00 65535.00 FORMAT "%8.2" /end CHARACTERISTIC
/begin CHARACTERISTIC DFES_DTCM.DFC_VehVSigCanSafe_C "" VALUE 0x80249750 Val_Wu16 65535.00 DFES_OneToOne 0.00 65535.00 FORMAT "%8.2" /end CHARACTERISTIC
/begin CHARACTERISTIC DFES_DTCM.DFC_SCtPmp1DiagGrdKey1_C "" VALUE 0x80249752 Val_Wu16 65535.00 DFES_OneToOne 0.00 65535.00 FORMAT "%8.2" /end CHARACTERISTIC
/begin CHARACTERISTIC DFES_DTCM.DFC_SCtPmp1DiagGrdKey2_C "" VALUE 0x80249754 Val_Wu16 65535.00 DFES_OneToOne 0.00 65535.00 FORMAT "%8.2" /end CHARACTERISTIC
/begin CHARACTERISTIC DFES_DTCM.DFC_SCtPmp1DiagGrdKey3_C "" VALUE 0x80249756 Val_Wu16 65535.00 DFES_OneToOne 0.00 65535.00 FORMAT "%8.2" /end CHARACTERISTIC
/begin CHARACTERISTIC DFES_DTCM.DFC_SCtPmp1DiagGrdKey4_C "" VALUE 0x80249758 Val_Wu16 65535.00 DFES_OneToOne 0.00 65535.00 FORMAT "%8.2" /end CHARACTERISTIC
/begin CHARACTERISTIC DFES_DTCM.DFC_SCtPmp1DiagGrdKey5_C "" VALUE 0x8024975A Val_Wu16 65535.00 DFES_OneToOne 0.00 65535.00 FORMAT "%8.2" /end CHARACTERISTIC
/begin CHARACTERISTIC DFES_DTCM.DFC_ChrgPlgLiveCntctHzrdCcs_C "" VALUE 0x8024975C Val_Wu16 65535.00 DFES_OneToOne 0.00 65535.00 FORMAT "%8.2" /end CHARACTERISTIC
/begin CHARACTERISTIC DFES_DTCM.DFC_ChrgPlgProxPltImps_C "" VALUE 0x8024975E Val_Wu16 65535.00 DFES_OneToOne 0.00 65535.00 FORMAT "%8.2" /end CHARACTERISTIC
/begin CHARACTERISTIC DFES_DTCM.DFC_ChrgPlgTHiCcsDc_C "" VALUE 0x80249760 Val_Wu16 65535.00 DFES_OneToOne 0.00 65535.00 FORMAT "%8.2" /end CHARACTERISTIC
/begin CHARACTERISTIC DFES_DTCM.DFC_ElMActvDchaFailr_C "" VALUE 0x80249762 Val_Wu16 65535.00 DFES_OneToOne 0.00 65535.00 FORMAT "%8.2" /end CHARACTERISTIC
/begin CHARACTERISTIC DFES_DTCM.DFC_ElMActvDchaFlt_C "" VALUE 0x80249764 Val_Wu16 65535.00 DFES_OneToOne 0.00 65535.00 FORMAT "%8.2" /end CHARACTERISTIC
/begin CHARACTERISTIC DFES_DTCM.DFC_ElMFbdnIvtrModDrv01_C "" VALUE 0x80249766 Val_Wu16 65535.00 DFES_OneToOne 0.00 65535.00 FORMAT "%8.2" /end CHARACTERISTIC
/begin CHARACTERISTIC DFES_DTCM.DFC_ElMImobAuthent_C "" VALUE 0x80249768 Val_Wu16 65535.00 DFES_OneToOne 0.00 65535.00 FORMAT "%8.2" /end CHARACTERISTIC
/begin CHARACTERISTIC DFES_DTCM.DFC_ElMIsoMonFlt_C "" VALUE 0x8024976A Val_Wu16 65535.00 DFES_OneToOne 0.00 65535.00 FORMAT "%8.2" /end CHARACTERISTIC
/begin CHARACTERISTIC DFES_DTCM.DFC_ElMIsoMonPlausyFlt_C "" VALUE 0x8024976C Val_Wu16 65535.00 DFES_OneToOne 0.00 65535.00 FORMAT "%8.2" /end CHARACTERISTIC
/begin CHARACTERISTIC DFES_DTCM.DFC_ElMIvtrCooltT01_C "" VALUE 0x8024976E Val_Wu16 65535.00 DFES_OneToOne 0.00 65535.00 FORMAT "%8.2" /end CHARACTERISTIC
/begin CHARACTERISTIC DFES_DTCM.DFC_ElMIvtrEmgyShtDwn01_C "" VALUE 0x80249770 Val_Wu16 65535.00 DFES_OneToOne 0.00 65535.00 FORMAT "%8.2" /end CHARACTERISTIC
/begin CHARACTERISTIC DFES_DTCM.DFC_ElMIvtrFailr01_C "" VALUE 0x80249772 Val_Wu16 65535.00 DFES_OneToOne 0.00 65535.00 FORMAT "%8.2" /end CHARACTERISTIC
/begin CHARACTERISTIC DFES_DTCM.DFC_ElMIvtrIntlck01_C "" VALUE 0x80249774 Val_Wu16 65535.00 DFES_OneToOne 0.00 65535.00 FORMAT "%8.2" /end CHARACTERISTIC
/begin CHARACTERISTIC DFES_DTCM.DFC_ElMIvtrTErr01_C "" VALUE 0x80249776 Val_Wu16 65535.00 DFES_OneToOne 0.00 65535.00 FORMAT "%8.2" /end CHARACTERISTIC
/begin CHARACTERISTIC DFES_DTCM.DFC_ElMOverSpdNeg01_C "" VALUE 0x80249778 Val_Wu16 65535.00 DFES_OneToOne 0.00 65535.00 FORMAT "%8.2" /end CHARACTERISTIC
/begin CHARACTERISTIC DFES_DTCM.DFC_ElMOverSpdPos01_C "" VALUE 0x8024977A Val_Wu16 65535.00 DFES_OneToOne 0.00 65535.00 FORMAT "%8.2" /end CHARACTERISTIC
/begin CHARACTERISTIC DFES_DTCM.DFC_ElMOverTqNeg01_C "" VALUE 0x8024977C Val_Wu16 65535.00 DFES_OneToOne 0.00 65535.00 FORMAT "%8.2" /end CHARACTERISTIC
/begin CHARACTERISTIC DFES_DTCM.DFC_ElMOverTqPos01_C "" VALUE 0x8024977E Val_Wu16 65535.00 DFES_OneToOne 0.00 65535.00 FORMAT "%8.2" /end CHARACTERISTIC
/begin CHARACTERISTIC DFES_DTCM.DFC_ElMPwrAuthn_C "" VALUE 0x80249780 Val_Wu16 65535.00 DFES_OneToOne 0.00 65535.00 FORMAT "%8.2" /end CHARACTERISTIC
/begin CHARACTERISTIC DFES_DTCM.DFC_ElMSpdErr01_C "" VALUE 0x80249782 Val_Wu16 65535.00 DFES_OneToOne 0.00 65535.00 FORMAT "%8.2" /end CHARACTERISTIC
/begin CHARACTERISTIC DFES_DTCM.DFC_ElMSvs01_C "" VALUE 0x80249784 Val_Wu16 65535.00 DFES_OneToOne 0.00 65535.00 FORMAT "%8.2" /end CHARACTERISTIC
/begin CHARACTERISTIC DFES_DTCM.DFC_PEnvCcMax_C "" VALUE 0x80249786 Val_Wu16 65535.00 DFES_OneToOne 0.00 65535.00 FORMAT "%8.2" /end CHARACTERISTIC
/begin CHARACTERISTIC DFES_DTCM.DFC_PEnvCcMin_C "" VALUE 0x80249788 Val_Wu16 65535.00 DFES_OneToOne 0.00 65535.00 FORMAT "%8.2" /end CHARACTERISTIC
/begin CHARACTERISTIC DFES_DTCM.DFC_PEnvRngChkMax_C "" VALUE 0x8024978A Val_Wu16 65535.00 DFES_OneToOne 0.00 65535.00 FORMAT "%8.2" /end CHARACTERISTIC
/begin CHARACTERISTIC DFES_DTCM.DFC_PEnvRngChkMin_C "" VALUE 0x8024978C Val_Wu16 65535.00 DFES_OneToOne 0.00 65535.00 FORMAT "%8.2" /end CHARACTERISTIC
/begin CHARACTERISTIC DFES_DTCM.DFC_PEnvSnsrPlaus_C "" VALUE 0x8024978E Val_Wu16 65535.00 DFES_OneToOne 0.00 65535.00 FORMAT "%8.2" /end CHARACTERISTIC
/begin CHARACTERISTIC DFES_DTCM.DFC_BrkBstPmpPlausGenn_C "" VALUE 0x80249790 Val_Wu16 65535.00 DFES_OneToOne 0.00 65535.00 FORMAT "%8.2" /end CHARACTERISTIC
/begin CHARACTERISTIC DFES_DTCM.DFC_CbnHeatrRlyLfLoWarn_C "" VALUE 0x80249792 Val_Wu16 65535.00 DFES_OneToOne 0.00 65535.00 FORMAT "%8.2" /end CHARACTERISTIC
/begin CHARACTERISTIC DFES_DTCM.DFC_ChgrPlugLockPinByndClsd_C "" VALUE 0x80249794 Val_Wu16 65535.00 DFES_OneToOne 0.00 65535.00 FORMAT "%8.2" /end CHARACTERISTIC
/begin CHARACTERISTIC DFES_DTCM.DFC_ChgrPlugLockPinMoveWoCmd_C "" VALUE 0x80249796 Val_Wu16 65535.00 DFES_OneToOne 0.00 65535.00 FORMAT "%8.2" /end CHARACTERISTIC
/begin CHARACTERISTIC DFES_DTCM.DFC_ChgrPlugLockPinStuckInClsd_C "" VALUE 0x80249798 Val_Wu16 65535.00 DFES_OneToOne 0.00 65535.00 FORMAT "%8.2" /end CHARACTERISTIC
/begin CHARACTERISTIC DFES_DTCM.DFC_ChgrPlugLockPinStuckInOpen_C "" VALUE 0x8024979A Val_Wu16 65535.00 DFES_OneToOne 0.00 65535.00 FORMAT "%8.2" /end CHARACTERISTIC
/begin CHARACTERISTIC DFES_DTCM.DFC_ChrgrStErr_C "" VALUE 0x8024979C Val_Wu16 65535.00 DFES_OneToOne 0.00 65535.00 FORMAT "%8.2" /end CHARACTERISTIC
/begin CHARACTERISTIC DFES_DTCM.DFC_ComHSN1BusOff_C "" VALUE 0x8024979E Val_Wu16 65535.00 DFES_OneToOne 0.00 65535.00 FORMAT "%8.2" /end CHARACTERISTIC
/begin CHARACTERISTIC DFES_DTCM.DFC_ComHSN3BusOff_C "" VALUE 0x802497A0 Val_Wu16 65535.00 DFES_OneToOne 0.00 65535.00 FORMAT "%8.2" /end CHARACTERISTIC
/begin CHARACTERISTIC DFES_DTCM.DFC_ComVCInval_C "" VALUE 0x802497A2 Val_Wu16 65535.00 DFES_OneToOne 0.00 65535.00 FORMAT "%8.2" /end CHARACTERISTIC
/begin CHARACTERISTIC DFES_DTCM.DFC_EemDcdcPrecSpdInhb_C "" VALUE 0x802497A4 Val_Wu16 65535.00 DFES_OneToOne 0.00 65535.00 FORMAT "%8.2" /end CHARACTERISTIC
/begin CHARACTERISTIC DFES_DTCM.DFC_ExpPwrLatch_C "" VALUE 0x802497A6 Val_Wu16 65535.00 DFES_OneToOne 0.00 65535.00 FORMAT "%8.2" /end CHARACTERISTIC
/begin CHARACTERISTIC DFES_DTCM.DFC_FanMaxOvrd_C "" VALUE 0x802497A8 Val_Wu16 65535.00 DFES_OneToOne 0.00 65535.00 FORMAT "%8.2" /end CHARACTERISTIC
/begin CHARACTERISTIC DFES_DTCM.DFC_HLCCcsGnrlComErr_C "" VALUE 0x802497AA Val_Wu16 65535.00 DFES_OneToOne 0.00 65535.00 FORMAT "%8.2" /end CHARACTERISTIC
/begin CHARACTERISTIC DFES_DTCM.DFC_InmLINNodeHVACPanelAbsnt_C "" VALUE 0x802497AC Val_Wu16 65535.00 DFES_OneToOne 0.00 65535.00 FORMAT "%8.2" /end CHARACTERISTIC
/begin CHARACTERISTIC DFES_DTCM.DFC_ResetRcvNotAllwd_C "" VALUE 0x802497AE Val_Wu16 65535.00 DFES_OneToOne 0.00 65535.00 FORMAT "%8.2" /end CHARACTERISTIC
/begin CHARACTERISTIC DFES_DTCM.DFC_TelltlCooltPlaus_C "" VALUE 0x802497B0 Val_Wu16 65535.00 DFES_OneToOne 0.00 65535.00 FORMAT "%8.2" /end CHARACTERISTIC
/begin CHARACTERISTIC DFES_DTCM.DFC_MRlyOL_C "" VALUE 0x802497B2 Val_Wu16 65535.00 DFES_OneToOne 0.00 65535.00 FORMAT "%8.2" /end CHARACTERISTIC
/begin CHARACTERISTIC DFES_DTCM.DFC_MRlySCB_C "" VALUE 0x802497B4 Val_Wu16 65535.00 DFES_OneToOne 0.00 65535.00 FORMAT "%8.2" /end CHARACTERISTIC
/begin CHARACTERISTIC DFES_DTCM.DFC_MRlySCG_C "" VALUE 0x802497B6 Val_Wu16 65535.00 DFES_OneToOne 0.00 65535.00 FORMAT "%8.2" /end CHARACTERISTIC
/begin CHARACTERISTIC DFES_DTCM.DFC_SSpMon1_C "" VALUE 0x802497B8 Val_Wu16 65535.00 DFES_OneToOne 0.00 65535.00 FORMAT "%8.2" /end CHARACTERISTIC
/begin CHARACTERISTIC DFES_DTCM.DFC_SSpMon1OV_C "" VALUE 0x802497BA Val_Wu16 65535.00 DFES_OneToOne 0.00 65535.00 FORMAT "%8.2" /end CHARACTERISTIC
/begin CHARACTERISTIC DFES_DTCM.DFC_SSpMon1SCG_C "" VALUE 0x802497BC Val_Wu16 65535.00 DFES_OneToOne 0.00 65535.00 FORMAT "%8.2" /end CHARACTERISTIC
/begin CHARACTERISTIC DFES_DTCM.DFC_SSpMon1UV_C "" VALUE 0x802497BE Val_Wu16 65535.00 DFES_OneToOne 0.00 65535.00 FORMAT "%8.2" /end CHARACTERISTIC
/begin CHARACTERISTIC DFES_DTCM.DFC_SSpMon2_C "" VALUE 0x802497C0 Val_Wu16 65535.00 DFES_OneToOne 0.00 65535.00 FORMAT "%8.2" /end CHARACTERISTIC
/begin CHARACTERISTIC DFES_DTCM.DFC_SSpMon2OV_C "" VALUE 0x802497C2 Val_Wu16 65535.00 DFES_OneToOne 0.00 65535.00 FORMAT "%8.2" /end CHARACTERISTIC
/begin CHARACTERISTIC DFES_DTCM.DFC_SSpMon2SCG_C "" VALUE 0x802497C4 Val_Wu16 65535.00 DFES_OneToOne 0.00 65535.00 FORMAT "%8.2" /end CHARACTERISTIC
/begin CHARACTERISTIC DFES_DTCM.DFC_SSpMon2UV_C "" VALUE 0x802497C6 Val_Wu16 65535.00 DFES_OneToOne 0.00 65535.00 FORMAT "%8.2" /end CHARACTERISTIC
/begin CHARACTERISTIC DFES_DTCM.DFC_SSpMon3_C "" VALUE 0x802497C8 Val_Wu16 65535.00 DFES_OneToOne 0.00 65535.00 FORMAT "%8.2" /end CHARACTERISTIC
/begin CHARACTERISTIC DFES_DTCM.DFC_SSpMon3OV_C "" VALUE 0x802497CA Val_Wu16 65535.00 DFES_OneToOne 0.00 65535.00 FORMAT "%8.2" /end CHARACTERISTIC
/begin CHARACTERISTIC DFES_DTCM.DFC_SSpMon3SCG_C "" VALUE 0x802497CC Val_Wu16 65535.00 DFES_OneToOne 0.00 65535.00 FORMAT "%8.2" /end CHARACTERISTIC
/begin CHARACTERISTIC DFES_DTCM.DFC_SSpMon3UV_C "" VALUE 0x802497CE Val_Wu16 65535.00 DFES_OneToOne 0.00 65535.00 FORMAT "%8.2" /end CHARACTERISTIC
/begin CHARACTERISTIC DFES_DTCM.DFC_CANSM_E_BUS_OFF_NETWORK_HSN1_CAN_C "" VALUE 0x802497D0 Val_Wu16 65535.00 DFES_OneToOne 0.00 65535.00 FORMAT "%8.2" /end CHARACTERISTIC
/begin CHARACTERISTIC DFES_DTCM.DFC_CANSM_E_BUS_OFF_NETWORK_HSN3_CAN_C "" VALUE 0x802497D2 Val_Wu16 65535.00 DFES_OneToOne 0.00 65535.00 FORMAT "%8.2" /end CHARACTERISTIC
/begin CHARACTERISTIC DFES_DTCM.DFC_CANSM_E_BUS_OFF_NETWORK_HSN4_CAN_C "" VALUE 0x802497D4 Val_Wu16 65535.00 DFES_OneToOne 0.00 65535.00 FORMAT "%8.2" /end CHARACTERISTIC
/begin CHARACTERISTIC DFES_DTCM.DFC_CANSM_E_BUS_OFF_NETWORK_XCP_CAN_C "" VALUE 0x802497D6 Val_Wu16 65535.00 DFES_OneToOne 0.00 65535.00 FORMAT "%8.2" /end CHARACTERISTIC
/begin CHARACTERISTIC DFES_DTCM.DFC_CANTRCV_E_NO_TRCV_CONTROL_0_C "" VALUE 0x802497D8 Val_Wu16 65535.00 DFES_OneToOne 0.00 65535.00 FORMAT "%8.2" /end CHARACTERISTIC
/begin CHARACTERISTIC DFES_DTCM.DFC_CAN_E_TIMEOUT_C "" VALUE 0x802497DA Val_Wu16 65535.00 DFES_OneToOne 0.00 65535.00 FORMAT "%8.2" /end CHARACTERISTIC
/begin CHARACTERISTIC DFES_DTCM.DFC_COMM_E_NET_START_IND_CHANNEL_0_C "" VALUE 0x802497DC Val_Wu16 65535.00 DFES_OneToOne 0.00 65535.00 FORMAT "%8.2" /end CHARACTERISTIC
/begin CHARACTERISTIC DFES_DTCM.DFC_COMM_E_NET_START_IND_CHANNEL_1_C "" VALUE 0x802497DE Val_Wu16 65535.00 DFES_OneToOne 0.00 65535.00 FORMAT "%8.2" /end CHARACTERISTIC
/begin CHARACTERISTIC DFES_DTCM.DFC_COMM_E_NET_START_IND_CHANNEL_2_C "" VALUE 0x802497E0 Val_Wu16 65535.00 DFES_OneToOne 0.00 65535.00 FORMAT "%8.2" /end CHARACTERISTIC
/begin CHARACTERISTIC DFES_DTCM.DFC_COMM_E_NET_START_IND_CHANNEL_3_C "" VALUE 0x802497E2 Val_Wu16 65535.00 DFES_OneToOne 0.00 65535.00 FORMAT "%8.2" /end CHARACTERISTIC
/begin CHARACTERISTIC DFES_DTCM.DFC_COMM_E_NET_START_IND_CHANNEL_4_C "" VALUE 0x802497E4 Val_Wu16 65535.00 DFES_OneToOne 0.00 65535.00 FORMAT "%8.2" /end CHARACTERISTIC
/begin CHARACTERISTIC DFES_DTCM.DFC_COMM_E_NET_START_IND_CHANNEL_5_C "" VALUE 0x802497E6 Val_Wu16 65535.00 DFES_OneToOne 0.00 65535.00 FORMAT "%8.2" /end CHARACTERISTIC
/begin CHARACTERISTIC DFES_DTCM.DFC_LIN_E_TIMEOUT_C "" VALUE 0x802497E8 Val_Wu16 65535.00 DFES_OneToOne 0.00 65535.00 FORMAT "%8.2" /end CHARACTERISTIC
/begin CHARACTERISTIC DFES_DTCM.DFC_rba_EcuCtrl_TOMaxProlg_C "" VALUE 0x802497EA Val_Wu16 65535.00 DFES_OneToOne 0.00 65535.00 FORMAT "%8.2" /end CHARACTERISTIC
/begin CHARACTERISTIC DFES_DTCM.DFC_rba_EcuCtrl_TOMaxShutDwn_C "" VALUE 0x802497EC Val_Wu16 65535.00 DFES_OneToOne 0.00 65535.00 FORMAT "%8.2" /end CHARACTERISTIC
/begin CHARACTERISTIC DFES_DTCM.DFC_rba_MultiStackTrace_Threshold_C "" VALUE 0x802497EE Val_Wu16 65535.00 DFES_OneToOne 0.00 65535.00 FORMAT "%8.2" /end CHARACTERISTIC
/begin CHARACTERISTIC DFES_DTCM.DFC_rba_SyC_CustStates_Degraded_disord_Event_C "" VALUE 0x802497F0 Val_Wu16 65535.00 DFES_OneToOne 0.00 65535.00 FORMAT "%8.2" /end CHARACTERISTIC
/begin CHARACTERISTIC DFES_DTCM.DFC_rba_SyC_CustStates_Degraded_incst_Event_C "" VALUE 0x802497F2 Val_Wu16 65535.00 DFES_OneToOne 0.00 65535.00 FORMAT "%8.2" /end CHARACTERISTIC
/begin CHARACTERISTIC DFES_DTCM.DFC_rba_SyC_CustStates_TransNoWakReq_Event_C "" VALUE 0x802497F4 Val_Wu16 65535.00 DFES_OneToOne 0.00 65535.00 FORMAT "%8.2" /end CHARACTERISTIC
/begin CHARACTERISTIC DFES_DTCM.DFC_RBA_IOEXTLIB_KEEPALIVE_DRV_C "" VALUE 0x802497F6 Val_Wu16 65535.00 DFES_OneToOne 0.00 65535.00 FORMAT "%8.2" /end CHARACTERISTIC
/begin CHARACTERISTIC DFES_DTCM.DFC_RBA_IOEXTLIB_KEEPALIVE_INI_C "" VALUE 0x802497F8 Val_Wu16 65535.00 DFES_OneToOne 0.00 65535.00 FORMAT "%8.2" /end CHARACTERISTIC
/begin CHARACTERISTIC DFES_DTCM.DFC_rba_IoSigRtc_StopCounter_C "" VALUE 0x802497FA Val_Wu16 65535.00 DFES_OneToOne 0.00 65535.00 FORMAT "%8.2" /end CHARACTERISTIC
/begin CHARACTERISTIC DFES_DTCM.DFC_rba_MRly_Diag_Stk_Event_C "" VALUE 0x802497FC Val_Wu16 65535.00 DFES_OneToOne 0.00 65535.00 FORMAT "%8.2" /end CHARACTERISTIC
/begin CHARACTERISTIC DFES_DTCM.DFC_rba_MemDiag_MemReadErr_C "" VALUE 0x802497FE Val_Wu16 65535.00 DFES_OneToOne 0.00 65535.00 FORMAT "%8.2" /end CHARACTERISTIC
/begin CHARACTERISTIC DFES_DTCM.DFC_rba_MemDiag_MemWrErr_C "" VALUE 0x80249800 Val_Wu16 65535.00 DFES_OneToOne 0.00 65535.00 FORMAT "%8.2" /end CHARACTERISTIC
/begin CHARACTERISTIC DFES_DTCM.DFC_rba_SyC_IrrSwOffTrigEngRun_Event_C "" VALUE 0x80249802 Val_Wu16 65535.00 DFES_OneToOne 0.00 65535.00 FORMAT "%8.2" /end CHARACTERISTIC
/begin CHARACTERISTIC DFES_DTCM.DFC_AcChrgrIntkTSRCMax_C "" VALUE 0x80249804 Val_Wu16 65535.00 DFES_OneToOne 0.00 65535.00 FORMAT "%8.2" /end CHARACTERISTIC
/begin CHARACTERISTIC DFES_DTCM.DFC_AcChrgrIntkTTmpErr_C "" VALUE 0x80249806 Val_Wu16 65535.00 DFES_OneToOne 0.00 65535.00 FORMAT "%8.2" /end CHARACTERISTIC
/begin CHARACTERISTIC DFES_DTCM.DFC_AcFlt_C "" VALUE 0x80249808 Val_Wu16 65535.00 DFES_OneToOne 0.00 65535.00 FORMAT "%8.2" /end CHARACTERISTIC
/begin CHARACTERISTIC DFES_DTCM.DFC_AppAllSnsrDfct_C "" VALUE 0x8024980A Val_Wu16 65535.00 DFES_OneToOne 0.00 65535.00 FORMAT "%8.2" /end CHARACTERISTIC
/begin CHARACTERISTIC DFES_DTCM.DFC_BattUPwrFail_C "" VALUE 0x8024980C Val_Wu16 65535.00 DFES_OneToOne 0.00 65535.00 FORMAT "%8.2" /end CHARACTERISTIC
/begin CHARACTERISTIC DFES_DTCM.DFC_BrkBstBkupOvrn_C "" VALUE 0x8024980E Val_Wu16 65535.00 DFES_OneToOne 0.00 65535.00 FORMAT "%8.2" /end CHARACTERISTIC
/begin CHARACTERISTIC DFES_DTCM.DFC_BrkBstPmpOvld_C "" VALUE 0x80249810 Val_Wu16 65535.00 DFES_OneToOne 0.00 65535.00 FORMAT "%8.2" /end CHARACTERISTIC
/begin CHARACTERISTIC DFES_DTCM.DFC_BrkPlausChk_C "" VALUE 0x80249812 Val_Wu16 65535.00 DFES_OneToOne 0.00 65535.00 FORMAT "%8.2" /end CHARACTERISTIC
/begin CHARACTERISTIC DFES_DTCM.DFC_CbnHeatgSwtTmpErr_C "" VALUE 0x80249814 Val_Wu16 65535.00 DFES_OneToOne 0.00 65535.00 FORMAT "%8.2" /end CHARACTERISTIC
/begin CHARACTERISTIC DFES_DTCM.DFC_CcsPwrLineChpVccSRCMax_C "" VALUE 0x80249816 Val_Wu16 65535.00 DFES_OneToOne 0.00 65535.00 FORMAT "%8.2" /end CHARACTERISTIC
/begin CHARACTERISTIC DFES_DTCM.DFC_CcsPwrLineChpVccTmpErr_C "" VALUE 0x80249818 Val_Wu16 65535.00 DFES_OneToOne 0.00 65535.00 FORMAT "%8.2" /end CHARACTERISTIC
/begin CHARACTERISTIC DFES_DTCM.DFC_CcsPwrLineComChpTSRCMax_C "" VALUE 0x8024981A Val_Wu16 65535.00 DFES_OneToOne 0.00 65535.00 FORMAT "%8.2" /end CHARACTERISTIC
/begin CHARACTERISTIC DFES_DTCM.DFC_CcsPwrLineComChpTTmpErr_C "" VALUE 0x8024981C Val_Wu16 65535.00 DFES_OneToOne 0.00 65535.00 FORMAT "%8.2" /end CHARACTERISTIC
/begin CHARACTERISTIC DFES_DTCM.DFC_ChgrPlugCtpCarrFrqErr_C "" VALUE 0x8024981E Val_Wu16 65535.00 DFES_OneToOne 0.00 65535.00 FORMAT "%8.2" /end CHARACTERISTIC
/begin CHARACTERISTIC DFES_DTCM.DFC_ChgrPlugCtpSwtStuckClsd_C "" VALUE 0x80249820 Val_Wu16 65535.00 DFES_OneToOne 0.00 65535.00 FORMAT "%8.2" /end CHARACTERISTIC
/begin CHARACTERISTIC DFES_DTCM.DFC_ChgrPlugCtpSwtStuckOpen_C "" VALUE 0x80249822 Val_Wu16 65535.00 DFES_OneToOne 0.00 65535.00 FORMAT "%8.2" /end CHARACTERISTIC
/begin CHARACTERISTIC DFES_DTCM.DFC_ChgrPlugCtpUErrHi_C "" VALUE 0x80249824 Val_Wu16 65535.00 DFES_OneToOne 0.00 65535.00 FORMAT "%8.2" /end CHARACTERISTIC
/begin CHARACTERISTIC DFES_DTCM.DFC_ChgrPlugPxp1SrcErr_C "" VALUE 0x80249826 Val_Wu16 65535.00 DFES_OneToOne 0.00 65535.00 FORMAT "%8.2" /end CHARACTERISTIC
/begin CHARACTERISTIC DFES_DTCM.DFC_ChrgCntctAllWldd_C "" VALUE 0x80249828 Val_Wu16 65535.00 DFES_OneToOne 0.00 65535.00 FORMAT "%8.2" /end CHARACTERISTIC
/begin CHARACTERISTIC DFES_DTCM.DFC_ChrgCntctNegOperErr_C "" VALUE 0x8024982A Val_Wu16 65535.00 DFES_OneToOne 0.00 65535.00 FORMAT "%8.2" /end CHARACTERISTIC
/begin CHARACTERISTIC DFES_DTCM.DFC_ChrgCntctNegOperWarn_C "" VALUE 0x8024982C Val_Wu16 65535.00 DFES_OneToOne 0.00 65535.00 FORMAT "%8.2" /end CHARACTERISTIC
/begin CHARACTERISTIC DFES_DTCM.DFC_ChrgCntctNegWldd_C "" VALUE 0x8024982E Val_Wu16 65535.00 DFES_OneToOne 0.00 65535.00 FORMAT "%8.2" /end CHARACTERISTIC
/begin CHARACTERISTIC DFES_DTCM.DFC_ChrgCntctPosOperErr_C "" VALUE 0x80249830 Val_Wu16 65535.00 DFES_OneToOne 0.00 65535.00 FORMAT "%8.2" /end CHARACTERISTIC
/begin CHARACTERISTIC DFES_DTCM.DFC_ChrgCntctPosOperWarn_C "" VALUE 0x80249832 Val_Wu16 65535.00 DFES_OneToOne 0.00 65535.00 FORMAT "%8.2" /end CHARACTERISTIC
/begin CHARACTERISTIC DFES_DTCM.DFC_ChrgCntctPosWldd_C "" VALUE 0x80249834 Val_Wu16 65535.00 DFES_OneToOne 0.00 65535.00 FORMAT "%8.2" /end CHARACTERISTIC
/begin CHARACTERISTIC DFES_DTCM.DFC_ChrgCntctStuckOpen_C "" VALUE 0x80249836 Val_Wu16 65535.00 DFES_OneToOne 0.00 65535.00 FORMAT "%8.2" /end CHARACTERISTIC
/begin CHARACTERISTIC DFES_DTCM.DFC_ChrgPlgIntlckFaild_C "" VALUE 0x80249838 Val_Wu16 65535.00 DFES_OneToOne 0.00 65535.00 FORMAT "%8.2" /end CHARACTERISTIC
/begin CHARACTERISTIC DFES_DTCM.DFC_ChrgnUnplRqrd_C "" VALUE 0x8024983A Val_Wu16 65535.00 DFES_OneToOne 0.00 65535.00 FORMAT "%8.2" /end CHARACTERISTIC
/begin CHARACTERISTIC DFES_DTCM.DFC_CoElMOffsCalibActv01_C "" VALUE 0x8024983C Val_Wu16 65535.00 DFES_OneToOne 0.00 65535.00 FORMAT "%8.2" /end CHARACTERISTIC
/begin CHARACTERISTIC DFES_DTCM.DFC_CtPSwtDiagSRCMax_C "" VALUE 0x8024983E Val_Wu16 65535.00 DFES_OneToOne 0.00 65535.00 FORMAT "%8.2" /end CHARACTERISTIC
/begin CHARACTERISTIC DFES_DTCM.DFC_CtPSwtDiagTmpErr_C "" VALUE 0x80249840 Val_Wu16 65535.00 DFES_OneToOne 0.00 65535.00 FORMAT "%8.2" /end CHARACTERISTIC
/begin CHARACTERISTIC DFES_DTCM.DFC_CtpCarrFrqTmpErr_C "" VALUE 0x80249842 Val_Wu16 65535.00 DFES_OneToOne 0.00 65535.00 FORMAT "%8.2" /end CHARACTERISTIC
/begin CHARACTERISTIC DFES_DTCM.DFC_DcChrgrIntkT2SRCMax_C "" VALUE 0x80249844 Val_Wu16 65535.00 DFES_OneToOne 0.00 65535.00 FORMAT "%8.2" /end CHARACTERISTIC
/begin CHARACTERISTIC DFES_DTCM.DFC_DcChrgrIntkT2TmpErr_C "" VALUE 0x80249846 Val_Wu16 65535.00 DFES_OneToOne 0.00 65535.00 FORMAT "%8.2" /end CHARACTERISTIC
/begin CHARACTERISTIC DFES_DTCM.DFC_DcChrgrIntkTSRCMax_C "" VALUE 0x80249848 Val_Wu16 65535.00 DFES_OneToOne 0.00 65535.00 FORMAT "%8.2" /end CHARACTERISTIC
/begin CHARACTERISTIC DFES_DTCM.DFC_DcChrgrIntkTTmpErr_C "" VALUE 0x8024984A Val_Wu16 65535.00 DFES_OneToOne 0.00 65535.00 FORMAT "%8.2" /end CHARACTERISTIC
/begin CHARACTERISTIC DFES_DTCM.DFC_EChrDvPlinCntrThdExcdd_C "" VALUE 0x8024984C Val_Wu16 65535.00 DFES_OneToOne 0.00 65535.00 FORMAT "%8.2" /end CHARACTERISTIC
/begin CHARACTERISTIC DFES_DTCM.DFC_EemDiagCtctrClsTout_C "" VALUE 0x8024984E Val_Wu16 65535.00 DFES_OneToOne 0.00 65535.00 FORMAT "%8.2" /end CHARACTERISTIC
/begin CHARACTERISTIC DFES_DTCM.DFC_EemDiagDcdcOffTOut_C "" VALUE 0x80249850 Val_Wu16 65535.00 DFES_OneToOne 0.00 65535.00 FORMAT "%8.2" /end CHARACTERISTIC
/begin CHARACTERISTIC DFES_DTCM.DFC_EemDiagHvCnsrOffTOut_C "" VALUE 0x80249852 Val_Wu16 65535.00 DFES_OneToOne 0.00 65535.00 FORMAT "%8.2" /end CHARACTERISTIC
/begin CHARACTERISTIC DFES_DTCM.DFC_EemDiagHvbOffTOut_C "" VALUE 0x80249854 Val_Wu16 65535.00 DFES_OneToOne 0.00 65535.00 FORMAT "%8.2" /end CHARACTERISTIC
/begin CHARACTERISTIC DFES_DTCM.DFC_FanSpdSRCMax_C "" VALUE 0x80249856 Val_Wu16 65535.00 DFES_OneToOne 0.00 65535.00 FORMAT "%8.2" /end CHARACTERISTIC
/begin CHARACTERISTIC DFES_DTCM.DFC_FanSpdTmpErr_C "" VALUE 0x80249858 Val_Wu16 65535.00 DFES_OneToOne 0.00 65535.00 FORMAT "%8.2" /end CHARACTERISTIC
/begin CHARACTERISTIC DFES_DTCM.DFC_FreonPSRCMax_C "" VALUE 0x8024985A Val_Wu16 65535.00 DFES_OneToOne 0.00 65535.00 FORMAT "%8.2" /end CHARACTERISTIC
/begin CHARACTERISTIC DFES_DTCM.DFC_FreonPTmpErr_C "" VALUE 0x8024985C Val_Wu16 65535.00 DFES_OneToOne 0.00 65535.00 FORMAT "%8.2" /end CHARACTERISTIC
/begin CHARACTERISTIC DFES_DTCM.DFC_HeatrCoreTSRCMax_C "" VALUE 0x8024985E Val_Wu16 65535.00 DFES_OneToOne 0.00 65535.00 FORMAT "%8.2" /end CHARACTERISTIC
/begin CHARACTERISTIC DFES_DTCM.DFC_HeatrCoreTTmpErr_C "" VALUE 0x80249860 Val_Wu16 65535.00 DFES_OneToOne 0.00 65535.00 FORMAT "%8.2" /end CHARACTERISTIC
/begin CHARACTERISTIC DFES_DTCM.DFC_HvGridSocMinLim_C "" VALUE 0x80249862 Val_Wu16 65535.00 DFES_OneToOne 0.00 65535.00 FORMAT "%8.2" /end CHARACTERISTIC
/begin CHARACTERISTIC DFES_DTCM.DFC_HvacBlwrFrntFlt_C "" VALUE 0x80249864 Val_Wu16 65535.00 DFES_OneToOne 0.00 65535.00 FORMAT "%8.2" /end CHARACTERISTIC
/begin CHARACTERISTIC DFES_DTCM.DFC_HvacEvapElecFlt_C "" VALUE 0x80249866 Val_Wu16 65535.00 DFES_OneToOne 0.00 65535.00 FORMAT "%8.2" /end CHARACTERISTIC
/begin CHARACTERISTIC DFES_DTCM.DFC_HvacEvapElecFltGnd_C "" VALUE 0x80249868 Val_Wu16 65535.00 DFES_OneToOne 0.00 65535.00 FORMAT "%8.2" /end CHARACTERISTIC
/begin CHARACTERISTIC DFES_DTCM.DFC_HvacKnobPosnFlt_C "" VALUE 0x8024986A Val_Wu16 65535.00 DFES_OneToOne 0.00 65535.00 FORMAT "%8.2" /end CHARACTERISTIC
/begin CHARACTERISTIC DFES_DTCM.DFC_InvBinID_C "" VALUE 0x8024986C Val_Wu16 65535.00 DFES_OneToOne 0.00 65535.00 FORMAT "%8.2" /end CHARACTERISTIC
/begin CHARACTERISTIC DFES_DTCM.DFC_InvCalID_C "" VALUE 0x8024986E Val_Wu16 65535.00 DFES_OneToOne 0.00 65535.00 FORMAT "%8.2" /end CHARACTERISTIC
/begin CHARACTERISTIC DFES_DTCM.DFC_InvErotan_C "" VALUE 0x80249870 Val_Wu16 65535.00 DFES_OneToOne 0.00 65535.00 FORMAT "%8.2" /end CHARACTERISTIC
/begin CHARACTERISTIC DFES_DTCM.DFC_InvVinID_C "" VALUE 0x80249872 Val_Wu16 65535.00 DFES_OneToOne 0.00 65535.00 FORMAT "%8.2" /end CHARACTERISTIC
/begin CHARACTERISTIC DFES_DTCM.DFC_MOXEMM_SMU_ALM0_0_C "" VALUE 0x80249874 Val_Wu16 65535.00 DFES_OneToOne 0.00 65535.00 FORMAT "%8.2" /end CHARACTERISTIC
/begin CHARACTERISTIC DFES_DTCM.DFC_MOXEMM_SMU_ALM0_1_C "" VALUE 0x80249876 Val_Wu16 65535.00 DFES_OneToOne 0.00 65535.00 FORMAT "%8.2" /end CHARACTERISTIC
/begin CHARACTERISTIC DFES_DTCM.DFC_MOXEMM_SMU_ALM0_10_C "" VALUE 0x80249878 Val_Wu16 65535.00 DFES_OneToOne 0.00 65535.00 FORMAT "%8.2" /end CHARACTERISTIC
/begin CHARACTERISTIC DFES_DTCM.DFC_MOXEMM_SMU_ALM0_11_C "" VALUE 0x8024987A Val_Wu16 65535.00 DFES_OneToOne 0.00 65535.00 FORMAT "%8.2" /end CHARACTERISTIC
/begin CHARACTERISTIC DFES_DTCM.DFC_MOXEMM_SMU_ALM0_13_C "" VALUE 0x8024987C Val_Wu16 65535.00 DFES_OneToOne 0.00 65535.00 FORMAT "%8.2" /end CHARACTERISTIC
/begin CHARACTERISTIC DFES_DTCM.DFC_MOXEMM_SMU_ALM0_14_C "" VALUE 0x8024987E Val_Wu16 65535.00 DFES_OneToOne 0.00 65535.00 FORMAT "%8.2" /end CHARACTERISTIC
/begin CHARACTERISTIC DFES_DTCM.DFC_MOXEMM_SMU_ALM0_2_C "" VALUE 0x80249880 Val_Wu16 65535.00 DFES_OneToOne 0.00 65535.00 FORMAT "%8.2" /end CHARACTERISTIC
/begin CHARACTERISTIC DFES_DTCM.DFC_MOXEMM_SMU_ALM0_22_C "" VALUE 0x80249882 Val_Wu16 65535.00 DFES_OneToOne 0.00 65535.00 FORMAT "%8.2" /end CHARACTERISTIC
/begin CHARACTERISTIC DFES_DTCM.DFC_MOXEMM_SMU_ALM0_23_C "" VALUE 0x80249884 Val_Wu16 65535.00 DFES_OneToOne 0.00 65535.00 FORMAT "%8.2" /end CHARACTERISTIC
/begin CHARACTERISTIC DFES_DTCM.DFC_MOXEMM_SMU_ALM0_4_C "" VALUE 0x80249886 Val_Wu16 65535.00 DFES_OneToOne 0.00 65535.00 FORMAT "%8.2" /end CHARACTERISTIC
/begin CHARACTERISTIC DFES_DTCM.DFC_MOXEMM_SMU_ALM0_5_C "" VALUE 0x80249888 Val_Wu16 65535.00 DFES_OneToOne 0.00 65535.00 FORMAT "%8.2" /end CHARACTERISTIC
/begin CHARACTERISTIC DFES_DTCM.DFC_MOXEMM_SMU_ALM0_7_C "" VALUE 0x8024988A Val_Wu16 65535.00 DFES_OneToOne 0.00 65535.00 FORMAT "%8.2" /end CHARACTERISTIC
/begin CHARACTERISTIC DFES_DTCM.DFC_MOXEMM_SMU_ALM0_8_C "" VALUE 0x8024988C Val_Wu16 65535.00 DFES_OneToOne 0.00 65535.00 FORMAT "%8.2" /end CHARACTERISTIC
/begin CHARACTERISTIC DFES_DTCM.DFC_MOXEMM_SMU_ALM10_16_C "" VALUE 0x8024988E Val_Wu16 65535.00 DFES_OneToOne 0.00 65535.00 FORMAT "%8.2" /end CHARACTERISTIC
/begin CHARACTERISTIC DFES_DTCM.DFC_MOXEMM_SMU_ALM10_17_C "" VALUE 0x80249890 Val_Wu16 65535.00 DFES_OneToOne 0.00 65535.00 FORMAT "%8.2" /end CHARACTERISTIC
/begin CHARACTERISTIC DFES_DTCM.DFC_MOXEMM_SMU_ALM10_21_C "" VALUE 0x80249892 Val_Wu16 65535.00 DFES_OneToOne 0.00 65535.00 FORMAT "%8.2" /end CHARACTERISTIC
/begin CHARACTERISTIC DFES_DTCM.DFC_MOXEMM_SMU_ALM11_0_C "" VALUE 0x80249894 Val_Wu16 65535.00 DFES_OneToOne 0.00 65535.00 FORMAT "%8.2" /end CHARACTERISTIC
/begin CHARACTERISTIC DFES_DTCM.DFC_MOXEMM_SMU_ALM11_1_C "" VALUE 0x80249896 Val_Wu16 65535.00 DFES_OneToOne 0.00 65535.00 FORMAT "%8.2" /end CHARACTERISTIC
/begin CHARACTERISTIC DFES_DTCM.DFC_MOXEMM_SMU_ALM11_2_C "" VALUE 0x80249898 Val_Wu16 65535.00 DFES_OneToOne 0.00 65535.00 FORMAT "%8.2" /end CHARACTERISTIC
/begin CHARACTERISTIC DFES_DTCM.DFC_MOXEMM_SMU_ALM11_3_C "" VALUE 0x8024989A Val_Wu16 65535.00 DFES_OneToOne 0.00 65535.00 FORMAT "%8.2" /end CHARACTERISTIC
/begin CHARACTERISTIC DFES_DTCM.DFC_MOXEMM_SMU_ALM11_4_C "" VALUE 0x8024989C Val_Wu16 65535.00 DFES_OneToOne 0.00 65535.00 FORMAT "%8.2" /end CHARACTERISTIC
/begin CHARACTERISTIC DFES_DTCM.DFC_MOXEMM_SMU_ALM11_5_C "" VALUE 0x8024989E Val_Wu16 65535.00 DFES_OneToOne 0.00 65535.00 FORMAT "%8.2" /end CHARACTERISTIC
/begin CHARACTERISTIC DFES_DTCM.DFC_MOXEMM_SMU_ALM11_8_C "" VALUE 0x802498A0 Val_Wu16 65535.00 DFES_OneToOne 0.00 65535.00 FORMAT "%8.2" /end CHARACTERISTIC
/begin CHARACTERISTIC DFES_DTCM.DFC_MOXEMM_SMU_ALM11_9_C "" VALUE 0x802498A2 Val_Wu16 65535.00 DFES_OneToOne 0.00 65535.00 FORMAT "%8.2" /end CHARACTERISTIC
/begin CHARACTERISTIC DFES_DTCM.DFC_MOXEMM_SMU_ALM1_0_C "" VALUE 0x802498A4 Val_Wu16 65535.00 DFES_OneToOne 0.00 65535.00 FORMAT "%8.2" /end CHARACTERISTIC
/begin CHARACTERISTIC DFES_DTCM.DFC_MOXEMM_SMU_ALM1_1_C "" VALUE 0x802498A6 Val_Wu16 65535.00 DFES_OneToOne 0.00 65535.00 FORMAT "%8.2" /end CHARACTERISTIC
/begin CHARACTERISTIC DFES_DTCM.DFC_MOXEMM_SMU_ALM1_10_C "" VALUE 0x802498A8 Val_Wu16 65535.00 DFES_OneToOne 0.00 65535.00 FORMAT "%8.2" /end CHARACTERISTIC
/begin CHARACTERISTIC DFES_DTCM.DFC_MOXEMM_SMU_ALM1_11_C "" VALUE 0x802498AA Val_Wu16 65535.00 DFES_OneToOne 0.00 65535.00 FORMAT "%8.2" /end CHARACTERISTIC
/begin CHARACTERISTIC DFES_DTCM.DFC_MOXEMM_SMU_ALM1_13_C "" VALUE 0x802498AC Val_Wu16 65535.00 DFES_OneToOne 0.00 65535.00 FORMAT "%8.2" /end CHARACTERISTIC
/begin CHARACTERISTIC DFES_DTCM.DFC_MOXEMM_SMU_ALM1_14_C "" VALUE 0x802498AE Val_Wu16 65535.00 DFES_OneToOne 0.00 65535.00 FORMAT "%8.2" /end CHARACTERISTIC
/begin CHARACTERISTIC DFES_DTCM.DFC_MOXEMM_SMU_ALM1_2_C "" VALUE 0x802498B0 Val_Wu16 65535.00 DFES_OneToOne 0.00 65535.00 FORMAT "%8.2" /end CHARACTERISTIC
/begin CHARACTERISTIC DFES_DTCM.DFC_MOXEMM_SMU_ALM1_22_C "" VALUE 0x802498B2 Val_Wu16 65535.00 DFES_OneToOne 0.00 65535.00 FORMAT "%8.2" /end CHARACTERISTIC
/begin CHARACTERISTIC DFES_DTCM.DFC_MOXEMM_SMU_ALM1_23_C "" VALUE 0x802498B4 Val_Wu16 65535.00 DFES_OneToOne 0.00 65535.00 FORMAT "%8.2" /end CHARACTERISTIC
/begin CHARACTERISTIC DFES_DTCM.DFC_MOXEMM_SMU_ALM1_4_C "" VALUE 0x802498B6 Val_Wu16 65535.00 DFES_OneToOne 0.00 65535.00 FORMAT "%8.2" /end CHARACTERISTIC
/begin CHARACTERISTIC DFES_DTCM.DFC_MOXEMM_SMU_ALM1_5_C "" VALUE 0x802498B8 Val_Wu16 65535.00 DFES_OneToOne 0.00 65535.00 FORMAT "%8.2" /end CHARACTERISTIC
/begin CHARACTERISTIC DFES_DTCM.DFC_MOXEMM_SMU_ALM1_7_C "" VALUE 0x802498BA Val_Wu16 65535.00 DFES_OneToOne 0.00 65535.00 FORMAT "%8.2" /end CHARACTERISTIC
/begin CHARACTERISTIC DFES_DTCM.DFC_MOXEMM_SMU_ALM1_8_C "" VALUE 0x802498BC Val_Wu16 65535.00 DFES_OneToOne 0.00 65535.00 FORMAT "%8.2" /end CHARACTERISTIC
/begin CHARACTERISTIC DFES_DTCM.DFC_MOXEMM_SMU_ALM21_0_C "" VALUE 0x802498BE Val_Wu16 65535.00 DFES_OneToOne 0.00 65535.00 FORMAT "%8.2" /end CHARACTERISTIC
/begin CHARACTERISTIC DFES_DTCM.DFC_MOXEMM_SMU_ALM21_16_C "" VALUE 0x802498C0 Val_Wu16 65535.00 DFES_OneToOne 0.00 65535.00 FORMAT "%8.2" /end CHARACTERISTIC
/begin CHARACTERISTIC DFES_DTCM.DFC_MOXEMM_SMU_ALM21_3_C "" VALUE 0x802498C2 Val_Wu16 65535.00 DFES_OneToOne 0.00 65535.00 FORMAT "%8.2" /end CHARACTERISTIC
/begin CHARACTERISTIC DFES_DTCM.DFC_MOXEMM_SMU_ALM2_1_C "" VALUE 0x802498C4 Val_Wu16 65535.00 DFES_OneToOne 0.00 65535.00 FORMAT "%8.2" /end CHARACTERISTIC
/begin CHARACTERISTIC DFES_DTCM.DFC_MOXEMM_SMU_ALM2_10_C "" VALUE 0x802498C6 Val_Wu16 65535.00 DFES_OneToOne 0.00 65535.00 FORMAT "%8.2" /end CHARACTERISTIC
/begin CHARACTERISTIC DFES_DTCM.DFC_MOXEMM_SMU_ALM2_11_C "" VALUE 0x802498C8 Val_Wu16 65535.00 DFES_OneToOne 0.00 65535.00 FORMAT "%8.2" /end CHARACTERISTIC
/begin CHARACTERISTIC DFES_DTCM.DFC_MOXEMM_SMU_ALM2_13_C "" VALUE 0x802498CA Val_Wu16 65535.00 DFES_OneToOne 0.00 65535.00 FORMAT "%8.2" /end CHARACTERISTIC
/begin CHARACTERISTIC DFES_DTCM.DFC_MOXEMM_SMU_ALM2_14_C "" VALUE 0x802498CC Val_Wu16 65535.00 DFES_OneToOne 0.00 65535.00 FORMAT "%8.2" /end CHARACTERISTIC
/begin CHARACTERISTIC DFES_DTCM.DFC_MOXEMM_SMU_ALM2_22_C "" VALUE 0x802498CE Val_Wu16 65535.00 DFES_OneToOne 0.00 65535.00 FORMAT "%8.2" /end CHARACTERISTIC
/begin CHARACTERISTIC DFES_DTCM.DFC_MOXEMM_SMU_ALM2_23_C "" VALUE 0x802498D0 Val_Wu16 65535.00 DFES_OneToOne 0.00 65535.00 FORMAT "%8.2" /end CHARACTERISTIC
/begin CHARACTERISTIC DFES_DTCM.DFC_MOXEMM_SMU_ALM2_4_C "" VALUE 0x802498D2 Val_Wu16 65535.00 DFES_OneToOne 0.00 65535.00 FORMAT "%8.2" /end CHARACTERISTIC
/begin CHARACTERISTIC DFES_DTCM.DFC_MOXEMM_SMU_ALM2_5_C "" VALUE 0x802498D4 Val_Wu16 65535.00 DFES_OneToOne 0.00 65535.00 FORMAT "%8.2" /end CHARACTERISTIC
/begin CHARACTERISTIC DFES_DTCM.DFC_MOXEMM_SMU_ALM2_7_C "" VALUE 0x802498D6 Val_Wu16 65535.00 DFES_OneToOne 0.00 65535.00 FORMAT "%8.2" /end CHARACTERISTIC
/begin CHARACTERISTIC DFES_DTCM.DFC_MOXEMM_SMU_ALM2_8_C "" VALUE 0x802498D8 Val_Wu16 65535.00 DFES_OneToOne 0.00 65535.00 FORMAT "%8.2" /end CHARACTERISTIC
/begin CHARACTERISTIC DFES_DTCM.DFC_MOXEMM_SMU_ALM6_0_C "" VALUE 0x802498DA Val_Wu16 65535.00 DFES_OneToOne 0.00 65535.00 FORMAT "%8.2" /end CHARACTERISTIC
/begin CHARACTERISTIC DFES_DTCM.DFC_MOXEMM_SMU_ALM6_11_C "" VALUE 0x802498DC Val_Wu16 65535.00 DFES_OneToOne 0.00 65535.00 FORMAT "%8.2" /end CHARACTERISTIC
/begin CHARACTERISTIC DFES_DTCM.DFC_MOXEMM_SMU_ALM6_12_C "" VALUE 0x802498DE Val_Wu16 65535.00 DFES_OneToOne 0.00 65535.00 FORMAT "%8.2" /end CHARACTERISTIC
/begin CHARACTERISTIC DFES_DTCM.DFC_MOXEMM_SMU_ALM6_14_C "" VALUE 0x802498E0 Val_Wu16 65535.00 DFES_OneToOne 0.00 65535.00 FORMAT "%8.2" /end CHARACTERISTIC
/begin CHARACTERISTIC DFES_DTCM.DFC_MOXEMM_SMU_ALM6_15_C "" VALUE 0x802498E2 Val_Wu16 65535.00 DFES_OneToOne 0.00 65535.00 FORMAT "%8.2" /end CHARACTERISTIC
/begin CHARACTERISTIC DFES_DTCM.DFC_MOXEMM_SMU_ALM6_17_C "" VALUE 0x802498E4 Val_Wu16 65535.00 DFES_OneToOne 0.00 65535.00 FORMAT "%8.2" /end CHARACTERISTIC
/begin CHARACTERISTIC DFES_DTCM.DFC_MOXEMM_SMU_ALM6_18_C "" VALUE 0x802498E6 Val_Wu16 65535.00 DFES_OneToOne 0.00 65535.00 FORMAT "%8.2" /end CHARACTERISTIC
/begin CHARACTERISTIC DFES_DTCM.DFC_MOXEMM_SMU_ALM6_20_C "" VALUE 0x802498E8 Val_Wu16 65535.00 DFES_OneToOne 0.00 65535.00 FORMAT "%8.2" /end CHARACTERISTIC
/begin CHARACTERISTIC DFES_DTCM.DFC_MOXEMM_SMU_ALM6_21_C "" VALUE 0x802498EA Val_Wu16 65535.00 DFES_OneToOne 0.00 65535.00 FORMAT "%8.2" /end CHARACTERISTIC
/begin CHARACTERISTIC DFES_DTCM.DFC_MOXEMM_SMU_ALM6_25_C "" VALUE 0x802498EC Val_Wu16 65535.00 DFES_OneToOne 0.00 65535.00 FORMAT "%8.2" /end CHARACTERISTIC
/begin CHARACTERISTIC DFES_DTCM.DFC_MOXEMM_SMU_ALM6_4_C "" VALUE 0x802498EE Val_Wu16 65535.00 DFES_OneToOne 0.00 65535.00 FORMAT "%8.2" /end CHARACTERISTIC
/begin CHARACTERISTIC DFES_DTCM.DFC_MOXEMM_SMU_ALM6_5_C "" VALUE 0x802498F0 Val_Wu16 65535.00 DFES_OneToOne 0.00 65535.00 FORMAT "%8.2" /end CHARACTERISTIC
/begin CHARACTERISTIC DFES_DTCM.DFC_MOXEMM_SMU_ALM6_7_C "" VALUE 0x802498F2 Val_Wu16 65535.00 DFES_OneToOne 0.00 65535.00 FORMAT "%8.2" /end CHARACTERISTIC
/begin CHARACTERISTIC DFES_DTCM.DFC_MOXEMM_SMU_ALM6_8_C "" VALUE 0x802498F4 Val_Wu16 65535.00 DFES_OneToOne 0.00 65535.00 FORMAT "%8.2" /end CHARACTERISTIC
/begin CHARACTERISTIC DFES_DTCM.DFC_MOXEMM_SMU_ALM7_1_C "" VALUE 0x802498F6 Val_Wu16 65535.00 DFES_OneToOne 0.00 65535.00 FORMAT "%8.2" /end CHARACTERISTIC
/begin CHARACTERISTIC DFES_DTCM.DFC_MOXEMM_SMU_ALM7_12_C "" VALUE 0x802498F8 Val_Wu16 65535.00 DFES_OneToOne 0.00 65535.00 FORMAT "%8.2" /end CHARACTERISTIC
/begin CHARACTERISTIC DFES_DTCM.DFC_MOXEMM_SMU_ALM7_13_C "" VALUE 0x802498FA Val_Wu16 65535.00 DFES_OneToOne 0.00 65535.00 FORMAT "%8.2" /end CHARACTERISTIC
/begin CHARACTERISTIC DFES_DTCM.DFC_MOXEMM_SMU_ALM7_14_C "" VALUE 0x802498FC Val_Wu16 65535.00 DFES_OneToOne 0.00 65535.00 FORMAT "%8.2" /end CHARACTERISTIC
/begin CHARACTERISTIC DFES_DTCM.DFC_MOXEMM_SMU_ALM7_15_C "" VALUE 0x802498FE Val_Wu16 65535.00 DFES_OneToOne 0.00 65535.00 FORMAT "%8.2" /end CHARACTERISTIC
/begin CHARACTERISTIC DFES_DTCM.DFC_MOXEMM_SMU_ALM7_16_C "" VALUE 0x80249900 Val_Wu16 65535.00 DFES_OneToOne 0.00 65535.00 FORMAT "%8.2" /end CHARACTERISTIC
/begin CHARACTERISTIC DFES_DTCM.DFC_MOXEMM_SMU_ALM7_17_C "" VALUE 0x80249902 Val_Wu16 65535.00 DFES_OneToOne 0.00 65535.00 FORMAT "%8.2" /end CHARACTERISTIC
/begin CHARACTERISTIC DFES_DTCM.DFC_MOXEMM_SMU_ALM7_2_C "" VALUE 0x80249904 Val_Wu16 65535.00 DFES_OneToOne 0.00 65535.00 FORMAT "%8.2" /end CHARACTERISTIC
/begin CHARACTERISTIC DFES_DTCM.DFC_MOXEMM_SMU_ALM7_20_C "" VALUE 0x80249906 Val_Wu16 65535.00 DFES_OneToOne 0.00 65535.00 FORMAT "%8.2" /end CHARACTERISTIC
/begin CHARACTERISTIC DFES_DTCM.DFC_MOXEMM_SMU_ALM7_25_C "" VALUE 0x80249908 Val_Wu16 65535.00 DFES_OneToOne 0.00 65535.00 FORMAT "%8.2" /end CHARACTERISTIC
/begin CHARACTERISTIC DFES_DTCM.DFC_MOXEMM_SMU_ALM7_26_C "" VALUE 0x8024990A Val_Wu16 65535.00 DFES_OneToOne 0.00 65535.00 FORMAT "%8.2" /end CHARACTERISTIC
/begin CHARACTERISTIC DFES_DTCM.DFC_MOXEMM_SMU_ALM7_28_C "" VALUE 0x8024990C Val_Wu16 65535.00 DFES_OneToOne 0.00 65535.00 FORMAT "%8.2" /end CHARACTERISTIC
/begin CHARACTERISTIC DFES_DTCM.DFC_MOXEMM_SMU_ALM7_29_C "" VALUE 0x8024990E Val_Wu16 65535.00 DFES_OneToOne 0.00 65535.00 FORMAT "%8.2" /end CHARACTERISTIC
/begin CHARACTERISTIC DFES_DTCM.DFC_MOXEMM_SMU_ALM7_30_C "" VALUE 0x80249910 Val_Wu16 65535.00 DFES_OneToOne 0.00 65535.00 FORMAT "%8.2" /end CHARACTERISTIC
/begin CHARACTERISTIC DFES_DTCM.DFC_MOXEMM_SMU_ALM7_31_C "" VALUE 0x80249912 Val_Wu16 65535.00 DFES_OneToOne 0.00 65535.00 FORMAT "%8.2" /end CHARACTERISTIC
/begin CHARACTERISTIC DFES_DTCM.DFC_MOXEMM_SMU_ALM8_0_C "" VALUE 0x80249914 Val_Wu16 65535.00 DFES_OneToOne 0.00 65535.00 FORMAT "%8.2" /end CHARACTERISTIC
/begin CHARACTERISTIC DFES_DTCM.DFC_MOXEMM_SMU_ALM8_1_C "" VALUE 0x80249916 Val_Wu16 65535.00 DFES_OneToOne 0.00 65535.00 FORMAT "%8.2" /end CHARACTERISTIC
/begin CHARACTERISTIC DFES_DTCM.DFC_MOXEMM_SMU_ALM8_10_C "" VALUE 0x80249918 Val_Wu16 65535.00 DFES_OneToOne 0.00 65535.00 FORMAT "%8.2" /end CHARACTERISTIC
/begin CHARACTERISTIC DFES_DTCM.DFC_MOXEMM_SMU_ALM8_11_C "" VALUE 0x8024991A Val_Wu16 65535.00 DFES_OneToOne 0.00 65535.00 FORMAT "%8.2" /end CHARACTERISTIC
/begin CHARACTERISTIC DFES_DTCM.DFC_MOXEMM_SMU_ALM8_12_C "" VALUE 0x8024991C Val_Wu16 65535.00 DFES_OneToOne 0.00 65535.00 FORMAT "%8.2" /end CHARACTERISTIC
/begin CHARACTERISTIC DFES_DTCM.DFC_MOXEMM_SMU_ALM8_16_C "" VALUE 0x8024991E Val_Wu16 65535.00 DFES_OneToOne 0.00 65535.00 FORMAT "%8.2" /end CHARACTERISTIC
/begin CHARACTERISTIC DFES_DTCM.DFC_MOXEMM_SMU_ALM8_18_C "" VALUE 0x80249920 Val_Wu16 65535.00 DFES_OneToOne 0.00 65535.00 FORMAT "%8.2" /end CHARACTERISTIC
/begin CHARACTERISTIC DFES_DTCM.DFC_MOXEMM_SMU_ALM8_2_C "" VALUE 0x80249922 Val_Wu16 65535.00 DFES_OneToOne 0.00 65535.00 FORMAT "%8.2" /end CHARACTERISTIC
/begin CHARACTERISTIC DFES_DTCM.DFC_MOXEMM_SMU_ALM8_3_C "" VALUE 0x80249924 Val_Wu16 65535.00 DFES_OneToOne 0.00 65535.00 FORMAT "%8.2" /end CHARACTERISTIC
/begin CHARACTERISTIC DFES_DTCM.DFC_MOXEMM_SMU_ALM8_31_C "" VALUE 0x80249926 Val_Wu16 65535.00 DFES_OneToOne 0.00 65535.00 FORMAT "%8.2" /end CHARACTERISTIC
/begin CHARACTERISTIC DFES_DTCM.DFC_MOXEMM_SMU_ALM8_4_C "" VALUE 0x80249928 Val_Wu16 65535.00 DFES_OneToOne 0.00 65535.00 FORMAT "%8.2" /end CHARACTERISTIC
/begin CHARACTERISTIC DFES_DTCM.DFC_MOXEMM_SMU_ALM9_0_C "" VALUE 0x8024992A Val_Wu16 65535.00 DFES_OneToOne 0.00 65535.00 FORMAT "%8.2" /end CHARACTERISTIC
/begin CHARACTERISTIC DFES_DTCM.DFC_MOXEMM_SMU_ALM9_15_C "" VALUE 0x8024992C Val_Wu16 65535.00 DFES_OneToOne 0.00 65535.00 FORMAT "%8.2" /end CHARACTERISTIC
/begin CHARACTERISTIC DFES_DTCM.DFC_MOXEMM_SMU_ALM9_3_C "" VALUE 0x8024992E Val_Wu16 65535.00 DFES_OneToOne 0.00 65535.00 FORMAT "%8.2" /end CHARACTERISTIC
/begin CHARACTERISTIC DFES_DTCM.DFC_MoCADCNTPBnk1_C "" VALUE 0x80249930 Val_Wu16 65535.00 DFES_OneToOne 0.00 65535.00 FORMAT "%8.2" /end CHARACTERISTIC
/begin CHARACTERISTIC DFES_DTCM.DFC_MoCADCTestVoltBnk1_C "" VALUE 0x80249932 Val_Wu16 65535.00 DFES_OneToOne 0.00 65535.00 FORMAT "%8.2" /end CHARACTERISTIC
/begin CHARACTERISTIC DFES_DTCM.DFC_MoCSOPICO_C "" VALUE 0x80249934 Val_Wu16 65535.00 DFES_OneToOne 0.00 65535.00 FORMAT "%8.2" /end CHARACTERISTIC
/begin CHARACTERISTIC DFES_DTCM.DFC_MoFAccr_C "" VALUE 0x80249936 Val_Wu16 65535.00 DFES_OneToOne 0.00 65535.00 FORMAT "%8.2" /end CHARACTERISTIC
/begin CHARACTERISTIC DFES_DTCM.DFC_MoFCbnPreCdngOvrheat_C "" VALUE 0x80249938 Val_Wu16 65535.00 DFES_OneToOne 0.00 65535.00 FORMAT "%8.2" /end CHARACTERISTIC
/begin CHARACTERISTIC DFES_DTCM.DFC_MoFCbnPreCdngTmrExpi_C "" VALUE 0x8024993A Val_Wu16 65535.00 DFES_OneToOne 0.00 65535.00 FORMAT "%8.2" /end CHARACTERISTIC
/begin CHARACTERISTIC DFES_DTCM.DFC_MoFEvMngtBms_C "" VALUE 0x8024993C Val_Wu16 65535.00 DFES_OneToOne 0.00 65535.00 FORMAT "%8.2" /end CHARACTERISTIC
/begin CHARACTERISTIC DFES_DTCM.DFC_MoFEvMngtDcdc_C "" VALUE 0x8024993E Val_Wu16 65535.00 DFES_OneToOne 0.00 65535.00 FORMAT "%8.2" /end CHARACTERISTIC
/begin CHARACTERISTIC DFES_DTCM.DFC_MoFEvMngtEm01_C "" VALUE 0x80249940 Val_Wu16 65535.00 DFES_OneToOne 0.00 65535.00 FORMAT "%8.2" /end CHARACTERISTIC
/begin CHARACTERISTIC DFES_DTCM.DFC_MoFEvMngtEm01BrkgToZr_C "" VALUE 0x80249942 Val_Wu16 65535.00 DFES_OneToOne 0.00 65535.00 FORMAT "%8.2" /end CHARACTERISTIC
/begin CHARACTERISTIC DFES_DTCM.DFC_MoFEvMngtEm01EngSpd_C "" VALUE 0x80249944 Val_Wu16 65535.00 DFES_OneToOne 0.00 65535.00 FORMAT "%8.2" /end CHARACTERISTIC
/begin CHARACTERISTIC DFES_DTCM.DFC_MoFEvMngtEm02EngSpd_C "" VALUE 0x80249946 Val_Wu16 65535.00 DFES_OneToOne 0.00 65535.00 FORMAT "%8.2" /end CHARACTERISTIC
/begin CHARACTERISTIC DFES_DTCM.DFC_MoFEvMngtEm02Lvl1_C "" VALUE 0x80249948 Val_Wu16 65535.00 DFES_OneToOne 0.00 65535.00 FORMAT "%8.2" /end CHARACTERISTIC
/begin CHARACTERISTIC DFES_DTCM.DFC_MoFEvMngtEm02Lvl2_C "" VALUE 0x8024994A Val_Wu16 65535.00 DFES_OneToOne 0.00 65535.00 FORMAT "%8.2" /end CHARACTERISTIC
/begin CHARACTERISTIC DFES_DTCM.DFC_MoFExtCptAuxCpt_C "" VALUE 0x8024994C Val_Wu16 65535.00 DFES_OneToOne 0.00 65535.00 FORMAT "%8.2" /end CHARACTERISTIC
/begin CHARACTERISTIC DFES_DTCM.DFC_MoFExtCptVacPmpErr_C "" VALUE 0x8024994E Val_Wu16 65535.00 DFES_OneToOne 0.00 65535.00 FORMAT "%8.2" /end CHARACTERISTIC
/begin CHARACTERISTIC DFES_DTCM.DFC_MoFTqPtdAxle_C "" VALUE 0x80249950 Val_Wu16 65535.00 DFES_OneToOne 0.00 65535.00 FORMAT "%8.2" /end CHARACTERISTIC
/begin CHARACTERISTIC DFES_DTCM.DFC_MoFTqPtdAxleSec_C "" VALUE 0x80249952 Val_Wu16 65535.00 DFES_OneToOne 0.00 65535.00 FORMAT "%8.2" /end CHARACTERISTIC
/begin CHARACTERISTIC DFES_DTCM.DFC_MoFTqPtdEmPtRels_C "" VALUE 0x80249954 Val_Wu16 65535.00 DFES_OneToOne 0.00 65535.00 FORMAT "%8.2" /end CHARACTERISTIC
/begin CHARACTERISTIC DFES_DTCM.DFC_MoFTqPtdEmPtRelsSec_C "" VALUE 0x80249956 Val_Wu16 65535.00 DFES_OneToOne 0.00 65535.00 FORMAT "%8.2" /end CHARACTERISTIC
/begin CHARACTERISTIC DFES_DTCM.DFC_MoFTqPtdEmSign_C "" VALUE 0x80249958 Val_Wu16 65535.00 DFES_OneToOne 0.00 65535.00 FORMAT "%8.2" /end CHARACTERISTIC
/begin CHARACTERISTIC DFES_DTCM.DFC_MoFTqPtdEmSignSec_C "" VALUE 0x8024995A Val_Wu16 65535.00 DFES_OneToOne 0.00 65535.00 FORMAT "%8.2" /end CHARACTERISTIC
/begin CHARACTERISTIC DFES_DTCM.DFC_MoFTqPtdEmTq_C "" VALUE 0x8024995C Val_Wu16 65535.00 DFES_OneToOne 0.00 65535.00 FORMAT "%8.2" /end CHARACTERISTIC
/begin CHARACTERISTIC DFES_DTCM.DFC_MoFTqPtdEmTqSec_C "" VALUE 0x8024995E Val_Wu16 65535.00 DFES_OneToOne 0.00 65535.00 FORMAT "%8.2" /end CHARACTERISTIC
/begin CHARACTERISTIC DFES_DTCM.DFC_MoFTqPtdVeh_C "" VALUE 0x80249960 Val_Wu16 65535.00 DFES_OneToOne 0.00 65535.00 FORMAT "%8.2" /end CHARACTERISTIC
/begin CHARACTERISTIC DFES_DTCM.DFC_MoFVarPostBldSel_C "" VALUE 0x80249962 Val_Wu16 65535.00 DFES_OneToOne 0.00 65535.00 FORMAT "%8.2" /end CHARACTERISTIC
/begin CHARACTERISTIC DFES_DTCM.DFC_MoSysCtrlReIni_C "" VALUE 0x80249964 Val_Wu16 65535.00 DFES_OneToOne 0.00 65535.00 FORMAT "%8.2" /end CHARACTERISTIC
/begin CHARACTERISTIC DFES_DTCM.DFC_MoXEMMHwLTMCUFW_C "" VALUE 0x80249966 Val_Wu16 65535.00 DFES_OneToOne 0.00 65535.00 FORMAT "%8.2" /end CHARACTERISTIC
/begin CHARACTERISTIC DFES_DTCM.DFC_MoXEMMHwLTMonBIST_C "" VALUE 0x80249968 Val_Wu16 65535.00 DFES_OneToOne 0.00 65535.00 FORMAT "%8.2" /end CHARACTERISTIC
/begin CHARACTERISTIC DFES_DTCM.DFC_MoXEMMHwLTRegMonTest_C "" VALUE 0x8024996A Val_Wu16 65535.00 DFES_OneToOne 0.00 65535.00 FORMAT "%8.2" /end CHARACTERISTIC
/begin CHARACTERISTIC DFES_DTCM.DFC_MoXEMMHwLTStbySMUAlvTest_C "" VALUE 0x8024996C Val_Wu16 65535.00 DFES_OneToOne 0.00 65535.00 FORMAT "%8.2" /end CHARACTERISTIC
/begin CHARACTERISTIC DFES_DTCM.DFC_MoXEMMHwLTTempSens_C "" VALUE 0x8024996E Val_Wu16 65535.00 DFES_OneToOne 0.00 65535.00 FORMAT "%8.2" /end CHARACTERISTIC
/begin CHARACTERISTIC DFES_DTCM.DFC_MoXEMMHwLTUCBCfg_C "" VALUE 0x80249970 Val_Wu16 65535.00 DFES_OneToOne 0.00 65535.00 FORMAT "%8.2" /end CHARACTERISTIC
/begin CHARACTERISTIC DFES_DTCM.DFC_MonEgyChrgnCoorr_AcChrgnWoMofRels_C "" VALUE 0x80249972 Val_Wu16 65535.00 DFES_OneToOne 0.00 65535.00 FORMAT "%8.2" /end CHARACTERISTIC
/begin CHARACTERISTIC DFES_DTCM.DFC_MonEgyChrgnCoorr_ChrgnAbortIgr_C "" VALUE 0x80249974 Val_Wu16 65535.00 DFES_OneToOne 0.00 65535.00 FORMAT "%8.2" /end CHARACTERISTIC
/begin CHARACTERISTIC DFES_DTCM.DFC_MonEgyChrgnCoorr_DcCntctFailr_C "" VALUE 0x80249976 Val_Wu16 65535.00 DFES_OneToOne 0.00 65535.00 FORMAT "%8.2" /end CHARACTERISTIC
/begin CHARACTERISTIC DFES_DTCM.DFC_MonEgyChrgnCoorr_ExtChrgnShtOffReq_C "" VALUE 0x80249978 Val_Wu16 65535.00 DFES_OneToOne 0.00 65535.00 FORMAT "%8.2" /end CHARACTERISTIC
/begin CHARACTERISTIC DFES_DTCM.DFC_MonEgyChrgnCoorr_ImpsChrgnMod_C "" VALUE 0x8024997A Val_Wu16 65535.00 DFES_OneToOne 0.00 65535.00 FORMAT "%8.2" /end CHARACTERISTIC
/begin CHARACTERISTIC DFES_DTCM.DFC_MonEgyChrgnCoorr_ImpsChrgnPrms_C "" VALUE 0x8024997C Val_Wu16 65535.00 DFES_OneToOne 0.00 65535.00 FORMAT "%8.2" /end CHARACTERISTIC
/begin CHARACTERISTIC DFES_DTCM.DFC_MonEgyChrgnCoorr_ImpsUDcIntk_C "" VALUE 0x8024997E Val_Wu16 65535.00 DFES_OneToOne 0.00 65535.00 FORMAT "%8.2" /end CHARACTERISTIC
/begin CHARACTERISTIC DFES_DTCM.DFC_MonEgyChrgnCoorr_PlgLockMovmt_C "" VALUE 0x80249980 Val_Wu16 65535.00 DFES_OneToOne 0.00 65535.00 FORMAT "%8.2" /end CHARACTERISTIC
/begin CHARACTERISTIC DFES_DTCM.DFC_MonEgyChrgnCoorr_VehCrashDetn_C "" VALUE 0x80249982 Val_Wu16 65535.00 DFES_OneToOne 0.00 65535.00 FORMAT "%8.2" /end CHARACTERISTIC
/begin CHARACTERISTIC DFES_DTCM.DFC_MonEgyChrgnErrReactn_SftySwt_C "" VALUE 0x80249984 Val_Wu16 65535.00 DFES_OneToOne 0.00 65535.00 FORMAT "%8.2" /end CHARACTERISTIC
/begin CHARACTERISTIC DFES_DTCM.DFC_MonEgyChrgnInlet_CcsPlgCtp_C "" VALUE 0x80249986 Val_Wu16 65535.00 DFES_OneToOne 0.00 65535.00 FORMAT "%8.2" /end CHARACTERISTIC
/begin CHARACTERISTIC DFES_DTCM.DFC_MonEgyChrgnInlet_CcsPlgCtpPwm_C "" VALUE 0x80249988 Val_Wu16 65535.00 DFES_OneToOne 0.00 65535.00 FORMAT "%8.2" /end CHARACTERISTIC
/begin CHARACTERISTIC DFES_DTCM.DFC_MonEgyChrgnInlet_CcsPlgLockCtrlImpsAtmpt_C "" VALUE 0x8024998A Val_Wu16 65535.00 DFES_OneToOne 0.00 65535.00 FORMAT "%8.2" /end CHARACTERISTIC
/begin CHARACTERISTIC DFES_DTCM.DFC_MonEgyChrgnInlet_CcsPlgLockSnsrSigRngChk_C "" VALUE 0x8024998C Val_Wu16 65535.00 DFES_OneToOne 0.00 65535.00 FORMAT "%8.2" /end CHARACTERISTIC
/begin CHARACTERISTIC DFES_DTCM.DFC_MonEgyChrgnInlet_CcsPlgLockStImps_C "" VALUE 0x8024998E Val_Wu16 65535.00 DFES_OneToOne 0.00 65535.00 FORMAT "%8.2" /end CHARACTERISTIC
/begin CHARACTERISTIC DFES_DTCM.DFC_MonEgyChrgnInlet_CcsPlgPxp_C "" VALUE 0x80249990 Val_Wu16 65535.00 DFES_OneToOne 0.00 65535.00 FORMAT "%8.2" /end CHARACTERISTIC
/begin CHARACTERISTIC DFES_DTCM.DFC_MonEgyChrgnT_Snsr1GrdtChk_C "" VALUE 0x80249992 Val_Wu16 65535.00 DFES_OneToOne 0.00 65535.00 FORMAT "%8.2" /end CHARACTERISTIC
/begin CHARACTERISTIC DFES_DTCM.DFC_MonEgyChrgnT_Snsr1SigRngChk_C "" VALUE 0x80249994 Val_Wu16 65535.00 DFES_OneToOne 0.00 65535.00 FORMAT "%8.2" /end CHARACTERISTIC
/begin CHARACTERISTIC DFES_DTCM.DFC_MonEgyChrgnT_Snsr2GrdtChk_C "" VALUE 0x80249996 Val_Wu16 65535.00 DFES_OneToOne 0.00 65535.00 FORMAT "%8.2" /end CHARACTERISTIC
/begin CHARACTERISTIC DFES_DTCM.DFC_MonEgyChrgnT_Snsr2SigRngChk_C "" VALUE 0x80249998 Val_Wu16 65535.00 DFES_OneToOne 0.00 65535.00 FORMAT "%8.2" /end CHARACTERISTIC
/begin CHARACTERISTIC DFES_DTCM.DFC_MonEgyChrgnT_SnsrDif_C "" VALUE 0x8024999A Val_Wu16 65535.00 DFES_OneToOne 0.00 65535.00 FORMAT "%8.2" /end CHARACTERISTIC
/begin CHARACTERISTIC DFES_DTCM.DFC_OCWDAABEActv_C "" VALUE 0x8024999C Val_Wu16 65535.00 DFES_OneToOne 0.00 65535.00 FORMAT "%8.2" /end CHARACTERISTIC
/begin CHARACTERISTIC DFES_DTCM.DFC_OCWDACom_C "" VALUE 0x8024999E Val_Wu16 65535.00 DFES_OneToOne 0.00 65535.00 FORMAT "%8.2" /end CHARACTERISTIC
/begin CHARACTERISTIC DFES_DTCM.DFC_OCWDAErrPin_C "" VALUE 0x802499A0 Val_Wu16 65535.00 DFES_OneToOne 0.00 65535.00 FORMAT "%8.2" /end CHARACTERISTIC
/begin CHARACTERISTIC DFES_DTCM.DFC_OCWDAOvrVltg_C "" VALUE 0x802499A2 Val_Wu16 65535.00 DFES_OneToOne 0.00 65535.00 FORMAT "%8.2" /end CHARACTERISTIC
/begin CHARACTERISTIC DFES_DTCM.DFC_PUmax_C "" VALUE 0x802499A4 Val_Wu16 65535.00 DFES_OneToOne 0.00 65535.00 FORMAT "%8.2" /end CHARACTERISTIC
/begin CHARACTERISTIC DFES_DTCM.DFC_PwmCtPTmpErr_C "" VALUE 0x802499A6 Val_Wu16 65535.00 DFES_OneToOne 0.00 65535.00 FORMAT "%8.2" /end CHARACTERISTIC
/begin CHARACTERISTIC DFES_DTCM.DFC_PwrDistbnUnitTSRCMax_C "" VALUE 0x802499A8 Val_Wu16 65535.00 DFES_OneToOne 0.00 65535.00 FORMAT "%8.2" /end CHARACTERISTIC
/begin CHARACTERISTIC DFES_DTCM.DFC_PwrDistbnUnitTTmpErr_C "" VALUE 0x802499AA Val_Wu16 65535.00 DFES_OneToOne 0.00 65535.00 FORMAT "%8.2" /end CHARACTERISTIC
/begin CHARACTERISTIC DFES_DTCM.DFC_SCtPmp1DiagGrdKeyErr_C "" VALUE 0x802499AC Val_Wu16 65535.00 DFES_OneToOne 0.00 65535.00 FORMAT "%8.2" /end CHARACTERISTIC
/begin CHARACTERISTIC DFES_DTCM.DFC_SRCHighAPP1_C "" VALUE 0x802499AE Val_Wu16 65535.00 DFES_OneToOne 0.00 65535.00 FORMAT "%8.2" /end CHARACTERISTIC
/begin CHARACTERISTIC DFES_DTCM.DFC_SRCHighAPP2_C "" VALUE 0x802499B0 Val_Wu16 65535.00 DFES_OneToOne 0.00 65535.00 FORMAT "%8.2" /end CHARACTERISTIC
/begin CHARACTERISTIC DFES_DTCM.DFC_SRCLowAPP1_C "" VALUE 0x802499B2 Val_Wu16 65535.00 DFES_OneToOne 0.00 65535.00 FORMAT "%8.2" /end CHARACTERISTIC
/begin CHARACTERISTIC DFES_DTCM.DFC_SRCLowAPP2_C "" VALUE 0x802499B4 Val_Wu16 65535.00 DFES_OneToOne 0.00 65535.00 FORMAT "%8.2" /end CHARACTERISTIC
/begin CHARACTERISTIC DFES_DTCM.DFC_SWReset_0_C "" VALUE 0x802499B6 Val_Wu16 65535.00 DFES_OneToOne 0.00 65535.00 FORMAT "%8.2" /end CHARACTERISTIC
/begin CHARACTERISTIC DFES_DTCM.DFC_SWReset_1_C "" VALUE 0x802499B8 Val_Wu16 65535.00 DFES_OneToOne 0.00 65535.00 FORMAT "%8.2" /end CHARACTERISTIC
/begin CHARACTERISTIC DFES_DTCM.DFC_SWReset_2_C "" VALUE 0x802499BA Val_Wu16 65535.00 DFES_OneToOne 0.00 65535.00 FORMAT "%8.2" /end CHARACTERISTIC
/begin CHARACTERISTIC DFES_DTCM.DFC_Sia_InvldCode_C "" VALUE 0x802499BC Val_Wu16 65535.00 DFES_OneToOne 0.00 65535.00 FORMAT "%8.2" /end CHARACTERISTIC
/begin CHARACTERISTIC DFES_DTCM.DFC_Sia_InvldKey_C "" VALUE 0x802499BE Val_Wu16 65535.00 DFES_OneToOne 0.00 65535.00 FORMAT "%8.2" /end CHARACTERISTIC
/begin CHARACTERISTIC DFES_DTCM.DFC_Sia_NoRespUCx_C "" VALUE 0x802499C0 Val_Wu16 65535.00 DFES_OneToOne 0.00 65535.00 FORMAT "%8.2" /end CHARACTERISTIC
/begin CHARACTERISTIC DFES_DTCM.DFC_Sia_TprotRttp_C "" VALUE 0x802499C2 Val_Wu16 65535.00 DFES_OneToOne 0.00 65535.00 FORMAT "%8.2" /end CHARACTERISTIC
/begin CHARACTERISTIC DFES_DTCM.DFC_StrtUpEvStandStillDeactvn_C "" VALUE 0x802499C4 Val_Wu16 65535.00 DFES_OneToOne 0.00 65535.00 FORMAT "%8.2" /end CHARACTERISTIC
/begin CHARACTERISTIC DFES_DTCM.DFC_SyncAPP_C "" VALUE 0x802499C6 Val_Wu16 65535.00 DFES_OneToOne 0.00 65535.00 FORMAT "%8.2" /end CHARACTERISTIC
/begin CHARACTERISTIC DFES_DTCM.DFC_UCtPSRCMax_C "" VALUE 0x802499C8 Val_Wu16 65535.00 DFES_OneToOne 0.00 65535.00 FORMAT "%8.2" /end CHARACTERISTIC
/begin CHARACTERISTIC DFES_DTCM.DFC_UCtPTmpErr_C "" VALUE 0x802499CA Val_Wu16 65535.00 DFES_OneToOne 0.00 65535.00 FORMAT "%8.2" /end CHARACTERISTIC
/begin CHARACTERISTIC DFES_DTCM.DFC_UPxP1SRCMax_C "" VALUE 0x802499CC Val_Wu16 65535.00 DFES_OneToOne 0.00 65535.00 FORMAT "%8.2" /end CHARACTERISTIC
/begin CHARACTERISTIC DFES_DTCM.DFC_UPxP1TmpErr_C "" VALUE 0x802499CE Val_Wu16 65535.00 DFES_OneToOne 0.00 65535.00 FORMAT "%8.2" /end CHARACTERISTIC
/begin CHARACTERISTIC DFES_DTCM.DFC_VehVObd_C "" VALUE 0x802499D0 Val_Wu16 65535.00 DFES_OneToOne 0.00 65535.00 FORMAT "%8.2" /end CHARACTERISTIC
/begin CHARACTERISTIC DFES_DTCO.DFC_Unused_C "" VALUE 0x8024D2A2 Val_Wu16 65535.00 DFES_OneToOne 0.00 65535.00 FORMAT "%8.2" READ_ONLY /end CHARACTERISTIC
/begin CHARACTERISTIC DFES_DTCO.DFC_ACCmprFltLvlRes_C "" VALUE 0x8024D2A4 Val_Wu16 65535.00 DFES_OneToOne 0.00 65535.00 FORMAT "%8.2" /end CHARACTERISTIC
/begin CHARACTERISTIC DFES_DTCO.DFC_AbgHiSigFlt_C "" VALUE 0x8024D2A6 Val_Wu16 65535.00 DFES_OneToOne 0.00 65535.00 FORMAT "%8.2" /end CHARACTERISTIC
/begin CHARACTERISTIC DFES_DTCO.DFC_AbgIntPatFlt_C "" VALUE 0x8024D2A8 Val_Wu16 65535.00 DFES_OneToOne 0.00 65535.00 FORMAT "%8.2" /end CHARACTERISTIC
/begin CHARACTERISTIC DFES_DTCO.DFC_AbgLoSigFlt_C "" VALUE 0x8024D2AA Val_Wu16 65535.00 DFES_OneToOne 0.00 65535.00 FORMAT "%8.2" /end CHARACTERISTIC
/begin CHARACTERISTIC DFES_DTCO.DFC_AbgUnkwnErrSigFlt_C "" VALUE 0x8024D2AC Val_Wu16 65535.00 DFES_OneToOne 0.00 65535.00 FORMAT "%8.2" /end CHARACTERISTIC
/begin CHARACTERISTIC DFES_DTCO.DFC_AcExtChrgrIBattExcdd_C "" VALUE 0x8024D2AE Val_Wu16 65535.00 DFES_OneToOne 0.00 65535.00 FORMAT "%8.2" /end CHARACTERISTIC
/begin CHARACTERISTIC DFES_DTCO.DFC_AcExtChrgrIInExcdd_C "" VALUE 0x8024D2B0 Val_Wu16 65535.00 DFES_OneToOne 0.00 65535.00 FORMAT "%8.2" /end CHARACTERISTIC
/begin CHARACTERISTIC DFES_DTCO.DFC_AcExtChrgrIOutDe_C "" VALUE 0x8024D2B2 Val_Wu16 65535.00 DFES_OneToOne 0.00 65535.00 FORMAT "%8.2" /end CHARACTERISTIC
/begin CHARACTERISTIC DFES_DTCO.DFC_AcExtChrgrIOutExcdd_C "" VALUE 0x8024D2B4 Val_Wu16 65535.00 DFES_OneToOne 0.00 65535.00 FORMAT "%8.2" /end CHARACTERISTIC
/begin CHARACTERISTIC DFES_DTCO.DFC_AcExtChrgrUOutDe_C "" VALUE 0x8024D2B6 Val_Wu16 65535.00 DFES_OneToOne 0.00 65535.00 FORMAT "%8.2" /end CHARACTERISTIC
/begin CHARACTERISTIC DFES_DTCO.DFC_AdpActvDChaFailr_C "" VALUE 0x8024D2B8 Val_Wu16 65535.00 DFES_OneToOne 0.00 65535.00 FORMAT "%8.2" /end CHARACTERISTIC
/begin CHARACTERISTIC DFES_DTCO.DFC_AirbcuFlt_C "" VALUE 0x8024D2BA Val_Wu16 65535.00 DFES_OneToOne 0.00 65535.00 FORMAT "%8.2" /end CHARACTERISTIC
/begin CHARACTERISTIC DFES_DTCO.DFC_Airbg_C "" VALUE 0x8024D2BC Val_Wu16 65535.00 DFES_OneToOne 0.00 65535.00 FORMAT "%8.2" /end CHARACTERISTIC
/begin CHARACTERISTIC DFES_DTCO.DFC_AirbgCan_C "" VALUE 0x8024D2BE Val_Wu16 65535.00 DFES_OneToOne 0.00 65535.00 FORMAT "%8.2" /end CHARACTERISTIC
/begin CHARACTERISTIC DFES_DTCO.DFC_AirbgCanHWPlaus_C "" VALUE 0x8024D2C0 Val_Wu16 65535.00 DFES_OneToOne 0.00 65535.00 FORMAT "%8.2" /end CHARACTERISTIC
/begin CHARACTERISTIC DFES_DTCO.DFC_AirbgHWCanPlaus_C "" VALUE 0x8024D2C2 Val_Wu16 65535.00 DFES_OneToOne 0.00 65535.00 FORMAT "%8.2" /end CHARACTERISTIC
/begin CHARACTERISTIC DFES_DTCO.DFC_AirbgMnr_C "" VALUE 0x8024D2C4 Val_Wu16 65535.00 DFES_OneToOne 0.00 65535.00 FORMAT "%8.2" /end CHARACTERISTIC
/begin CHARACTERISTIC DFES_DTCO.DFC_AirbgPerHi_C "" VALUE 0x8024D2C6 Val_Wu16 65535.00 DFES_OneToOne 0.00 65535.00 FORMAT "%8.2" /end CHARACTERISTIC
/begin CHARACTERISTIC DFES_DTCO.DFC_AirbgPerdRngFlt_C "" VALUE 0x8024D2C8 Val_Wu16 65535.00 DFES_OneToOne 0.00 65535.00 FORMAT "%8.2" /end CHARACTERISTIC
/begin CHARACTERISTIC DFES_DTCO.DFC_BlowrRlyErr_C "" VALUE 0x8024D2CA Val_Wu16 65535.00 DFES_OneToOne 0.00 65535.00 FORMAT "%8.2" /end CHARACTERISTIC
/begin CHARACTERISTIC DFES_DTCO.DFC_BrkBstPmpActtnDfct_C "" VALUE 0x8024D2CC Val_Wu16 65535.00 DFES_OneToOne 0.00 65535.00 FORMAT "%8.2" /end CHARACTERISTIC
/begin CHARACTERISTIC DFES_DTCO.DFC_BrkBstPmpDeactvnDfct_C "" VALUE 0x8024D2CE Val_Wu16 65535.00 DFES_OneToOne 0.00 65535.00 FORMAT "%8.2" /end CHARACTERISTIC
/begin CHARACTERISTIC DFES_DTCO.DFC_BrkSwtFlt_C "" VALUE 0x8024D2D0 Val_Wu16 65535.00 DFES_OneToOne 0.00 65535.00 FORMAT "%8.2" /end CHARACTERISTIC
/begin CHARACTERISTIC DFES_DTCO.DFC_CbnHeatgHeatrHsScb_C "" VALUE 0x8024D2D2 Val_Wu16 65535.00 DFES_OneToOne 0.00 65535.00 FORMAT "%8.2" /end CHARACTERISTIC
/begin CHARACTERISTIC DFES_DTCO.DFC_CbnHeatgHeatrHsScg_C "" VALUE 0x8024D2D4 Val_Wu16 65535.00 DFES_OneToOne 0.00 65535.00 FORMAT "%8.2" /end CHARACTERISTIC
/begin CHARACTERISTIC DFES_DTCO.DFC_CbnHeatgHeatrLsOl_C "" VALUE 0x8024D2D6 Val_Wu16 65535.00 DFES_OneToOne 0.00 65535.00 FORMAT "%8.2" /end CHARACTERISTIC
/begin CHARACTERISTIC DFES_DTCO.DFC_CbnHeatgHeatrLsScb_C "" VALUE 0x8024D2D8 Val_Wu16 65535.00 DFES_OneToOne 0.00 65535.00 FORMAT "%8.2" /end CHARACTERISTIC
/begin CHARACTERISTIC DFES_DTCO.DFC_CbnHeatgHeatrLsScg_C "" VALUE 0x8024D2DA Val_Wu16 65535.00 DFES_OneToOne 0.00 65535.00 FORMAT "%8.2" /end CHARACTERISTIC
/begin CHARACTERISTIC DFES_DTCO.DFC_CbnHeatgHeatrUnUsed_C "" VALUE 0x8024D2DC Val_Wu16 65535.00 DFES_OneToOne 0.00 65535.00 FORMAT "%8.2" /end CHARACTERISTIC
/begin CHARACTERISTIC DFES_DTCO.DFC_ChrgnCntctHsOt_C "" VALUE 0x8024D2DE Val_Wu16 65535.00 DFES_OneToOne 0.00 65535.00 FORMAT "%8.2" /end CHARACTERISTIC
/begin CHARACTERISTIC DFES_DTCO.DFC_ChrgnCntctHsScb_C "" VALUE 0x8024D2E0 Val_Wu16 65535.00 DFES_OneToOne 0.00 65535.00 FORMAT "%8.2" /end CHARACTERISTIC
/begin CHARACTERISTIC DFES_DTCO.DFC_ChrgnCntctHsScg_C "" VALUE 0x8024D2E2 Val_Wu16 65535.00 DFES_OneToOne 0.00 65535.00 FORMAT "%8.2" /end CHARACTERISTIC
/begin CHARACTERISTIC DFES_DTCO.DFC_ChrgnCntctLsNegOl_C "" VALUE 0x8024D2E4 Val_Wu16 65535.00 DFES_OneToOne 0.00 65535.00 FORMAT "%8.2" /end CHARACTERISTIC
/begin CHARACTERISTIC DFES_DTCO.DFC_ChrgnCntctLsNegOt_C "" VALUE 0x8024D2E6 Val_Wu16 65535.00 DFES_OneToOne 0.00 65535.00 FORMAT "%8.2" /end CHARACTERISTIC
/begin CHARACTERISTIC DFES_DTCO.DFC_ChrgnCntctLsNegScb_C "" VALUE 0x8024D2E8 Val_Wu16 65535.00 DFES_OneToOne 0.00 65535.00 FORMAT "%8.2" /end CHARACTERISTIC
/begin CHARACTERISTIC DFES_DTCO.DFC_ChrgnCntctLsNegScg_C "" VALUE 0x8024D2EA Val_Wu16 65535.00 DFES_OneToOne 0.00 65535.00 FORMAT "%8.2" /end CHARACTERISTIC
/begin CHARACTERISTIC DFES_DTCO.DFC_ChrgnCntctLsPosOl_C "" VALUE 0x8024D2EC Val_Wu16 65535.00 DFES_OneToOne 0.00 65535.00 FORMAT "%8.2" /end CHARACTERISTIC
/begin CHARACTERISTIC DFES_DTCO.DFC_ChrgnCntctLsPosOt_C "" VALUE 0x8024D2EE Val_Wu16 65535.00 DFES_OneToOne 0.00 65535.00 FORMAT "%8.2" /end CHARACTERISTIC
/begin CHARACTERISTIC DFES_DTCO.DFC_ChrgnCntctLsPosScb_C "" VALUE 0x8024D2F0 Val_Wu16 65535.00 DFES_OneToOne 0.00 65535.00 FORMAT "%8.2" /end CHARACTERISTIC
/begin CHARACTERISTIC DFES_DTCO.DFC_ChrgnCntctLsPosScg_C "" VALUE 0x8024D2F2 Val_Wu16 65535.00 DFES_OneToOne 0.00 65535.00 FORMAT "%8.2" /end CHARACTERISTIC
/begin CHARACTERISTIC DFES_DTCO.DFC_ChrgnCntctUnUsed_C "" VALUE 0x8024D2F4 Val_Wu16 65535.00 DFES_OneToOne 0.00 65535.00 FORMAT "%8.2" /end CHARACTERISTIC
/begin CHARACTERISTIC DFES_DTCO.DFC_ComBrkMai_C "" VALUE 0x8024D2F6 Val_Wu16 65535.00 DFES_OneToOne 0.00 65535.00 FORMAT "%8.2" /end CHARACTERISTIC
/begin CHARACTERISTIC DFES_DTCO.DFC_ComChrgrEVCont_C "" VALUE 0x8024D2F8 Val_Wu16 65535.00 DFES_OneToOne 0.00 65535.00 FORMAT "%8.2" /end CHARACTERISTIC
/begin CHARACTERISTIC DFES_DTCO.DFC_ComChrgrEVtBlink_C "" VALUE 0x8024D2FA Val_Wu16 65535.00 DFES_OneToOne 0.00 65535.00 FORMAT "%8.2" /end CHARACTERISTIC
/begin CHARACTERISTIC DFES_DTCO.DFC_ComChrgrMstBlink_C "" VALUE 0x8024D2FC Val_Wu16 65535.00 DFES_OneToOne 0.00 65535.00 FORMAT "%8.2" /end CHARACTERISTIC
/begin CHARACTERISTIC DFES_DTCO.DFC_ComChrgrMstCont_C "" VALUE 0x8024D2FE Val_Wu16 65535.00 DFES_OneToOne 0.00 65535.00 FORMAT "%8.2" /end CHARACTERISTIC
/begin CHARACTERISTIC DFES_DTCO.DFC_ComChrgrSVSBlink_C "" VALUE 0x8024D300 Val_Wu16 65535.00 DFES_OneToOne 0.00 65535.00 FORMAT "%8.2" /end CHARACTERISTIC
/begin CHARACTERISTIC DFES_DTCO.DFC_ComChrgrSVSCont_C "" VALUE 0x8024D302 Val_Wu16 65535.00 DFES_OneToOne 0.00 65535.00 FORMAT "%8.2" /end CHARACTERISTIC
/begin CHARACTERISTIC DFES_DTCO.DFC_ComDcdcEVBlink_C "" VALUE 0x8024D304 Val_Wu16 65535.00 DFES_OneToOne 0.00 65535.00 FORMAT "%8.2" /end CHARACTERISTIC
/begin CHARACTERISTIC DFES_DTCO.DFC_ComDcdcEVCont_C "" VALUE 0x8024D306 Val_Wu16 65535.00 DFES_OneToOne 0.00 65535.00 FORMAT "%8.2" /end CHARACTERISTIC
/begin CHARACTERISTIC DFES_DTCO.DFC_ComDcdcFltLvl2_C "" VALUE 0x8024D308 Val_Wu16 65535.00 DFES_OneToOne 0.00 65535.00 FORMAT "%8.2" /end CHARACTERISTIC
/begin CHARACTERISTIC DFES_DTCO.DFC_ComDcdcFltLvl3_C "" VALUE 0x8024D30A Val_Wu16 65535.00 DFES_OneToOne 0.00 65535.00 FORMAT "%8.2" /end CHARACTERISTIC
/begin CHARACTERISTIC DFES_DTCO.DFC_ComDcdcFltLvl4_C "" VALUE 0x8024D30C Val_Wu16 65535.00 DFES_OneToOne 0.00 65535.00 FORMAT "%8.2" /end CHARACTERISTIC
/begin CHARACTERISTIC DFES_DTCO.DFC_ComDcdcFltLvl5_C "" VALUE 0x8024D30E Val_Wu16 65535.00 DFES_OneToOne 0.00 65535.00 FORMAT "%8.2" /end CHARACTERISTIC
/begin CHARACTERISTIC DFES_DTCO.DFC_ComDcdcFltLvlRes_C "" VALUE 0x8024D310 Val_Wu16 65535.00 DFES_OneToOne 0.00 65535.00 FORMAT "%8.2" /end CHARACTERISTIC
/begin CHARACTERISTIC DFES_DTCO.DFC_ComDcdcMstBlink_C "" VALUE 0x8024D312 Val_Wu16 65535.00 DFES_OneToOne 0.00 65535.00 FORMAT "%8.2" /end CHARACTERISTIC
/begin CHARACTERISTIC DFES_DTCO.DFC_ComDcdcMstCont_C "" VALUE 0x8024D314 Val_Wu16 65535.00 DFES_OneToOne 0.00 65535.00 FORMAT "%8.2" /end CHARACTERISTIC
/begin CHARACTERISTIC DFES_DTCO.DFC_ComDcdcSVSBlink_C "" VALUE 0x8024D316 Val_Wu16 65535.00 DFES_OneToOne 0.00 65535.00 FORMAT "%8.2" /end CHARACTERISTIC
/begin CHARACTERISTIC DFES_DTCO.DFC_ComDcdcSVSCont_C "" VALUE 0x8024D318 Val_Wu16 65535.00 DFES_OneToOne 0.00 65535.00 FORMAT "%8.2" /end CHARACTERISTIC
/begin CHARACTERISTIC DFES_DTCO.DFC_ComElMIIvtrFltLvl2_C "" VALUE 0x8024D31A Val_Wu16 65535.00 DFES_OneToOne 0.00 65535.00 FORMAT "%8.2" /end CHARACTERISTIC
/begin CHARACTERISTIC DFES_DTCO.DFC_ComElMIIvtrFltLvl3_C "" VALUE 0x8024D31C Val_Wu16 65535.00 DFES_OneToOne 0.00 65535.00 FORMAT "%8.2" /end CHARACTERISTIC
/begin CHARACTERISTIC DFES_DTCO.DFC_ComElMIIvtrFltLvl4_C "" VALUE 0x8024D31E Val_Wu16 65535.00 DFES_OneToOne 0.00 65535.00 FORMAT "%8.2" /end CHARACTERISTIC
/begin CHARACTERISTIC DFES_DTCO.DFC_ComElMIIvtrFltLvl5_C "" VALUE 0x8024D320 Val_Wu16 65535.00 DFES_OneToOne 0.00 65535.00 FORMAT "%8.2" /end CHARACTERISTIC
/begin CHARACTERISTIC DFES_DTCO.DFC_ComElMIIvtrFltLvlRes_C "" VALUE 0x8024D322 Val_Wu16 65535.00 DFES_OneToOne 0.00 65535.00 FORMAT "%8.2" /end CHARACTERISTIC
/begin CHARACTERISTIC DFES_DTCO.DFC_ComEmacEVBlink_C "" VALUE 0x8024D324 Val_Wu16 65535.00 DFES_OneToOne 0.00 65535.00 FORMAT "%8.2" /end CHARACTERISTIC
/begin CHARACTERISTIC DFES_DTCO.DFC_ComEmacEVCont_C "" VALUE 0x8024D326 Val_Wu16 65535.00 DFES_OneToOne 0.00 65535.00 FORMAT "%8.2" /end CHARACTERISTIC
/begin CHARACTERISTIC DFES_DTCO.DFC_ComEmacMstCont_C "" VALUE 0x8024D328 Val_Wu16 65535.00 DFES_OneToOne 0.00 65535.00 FORMAT "%8.2" /end CHARACTERISTIC
/begin CHARACTERISTIC DFES_DTCO.DFC_ComEmacMsttBlink_C "" VALUE 0x8024D32A Val_Wu16 65535.00 DFES_OneToOne 0.00 65535.00 FORMAT "%8.2" /end CHARACTERISTIC
/begin CHARACTERISTIC DFES_DTCO.DFC_ComEmacSVSBlink_C "" VALUE 0x8024D32C Val_Wu16 65535.00 DFES_OneToOne 0.00 65535.00 FORMAT "%8.2" /end CHARACTERISTIC
/begin CHARACTERISTIC DFES_DTCO.DFC_ComEmacSVSCont_C "" VALUE 0x8024D32E Val_Wu16 65535.00 DFES_OneToOne 0.00 65535.00 FORMAT "%8.2" /end CHARACTERISTIC
/begin CHARACTERISTIC DFES_DTCO.DFC_ComGunCntInfoWkuReq_C "" VALUE 0x8024D330 Val_Wu16 65535.00 DFES_OneToOne 0.00 65535.00 FORMAT "%8.2" /end CHARACTERISTIC
/begin CHARACTERISTIC DFES_DTCO.DFC_ComHillHldFlt_C "" VALUE 0x8024D332 Val_Wu16 65535.00 DFES_OneToOne 0.00 65535.00 FORMAT "%8.2" /end CHARACTERISTIC
/begin CHARACTERISTIC DFES_DTCO.DFC_ComHvBattRchrgWkuReq_C "" VALUE 0x8024D334 Val_Wu16 65535.00 DFES_OneToOne 0.00 65535.00 FORMAT "%8.2" /end CHARACTERISTIC
/begin CHARACTERISTIC DFES_DTCO.DFC_ComHvbFltLvl2_C "" VALUE 0x8024D336 Val_Wu16 65535.00 DFES_OneToOne 0.00 65535.00 FORMAT "%8.2" /end CHARACTERISTIC
/begin CHARACTERISTIC DFES_DTCO.DFC_ComHvbFltLvl3_C "" VALUE 0x8024D338 Val_Wu16 65535.00 DFES_OneToOne 0.00 65535.00 FORMAT "%8.2" /end CHARACTERISTIC
/begin CHARACTERISTIC DFES_DTCO.DFC_ComHvbFltLvl4_C "" VALUE 0x8024D33A Val_Wu16 65535.00 DFES_OneToOne 0.00 65535.00 FORMAT "%8.2" /end CHARACTERISTIC
/begin CHARACTERISTIC DFES_DTCO.DFC_ComHvbFltLvl5_C "" VALUE 0x8024D33C Val_Wu16 65535.00 DFES_OneToOne 0.00 65535.00 FORMAT "%8.2" /end CHARACTERISTIC
/begin CHARACTERISTIC DFES_DTCO.DFC_ComHvbFltLvlRes_C "" VALUE 0x8024D33E Val_Wu16 65535.00 DFES_OneToOne 0.00 65535.00 FORMAT "%8.2" /end CHARACTERISTIC
/begin CHARACTERISTIC DFES_DTCO.DFC_ComHvbMstBlink_C "" VALUE 0x8024D340 Val_Wu16 65535.00 DFES_OneToOne 0.00 65535.00 FORMAT "%8.2" /end CHARACTERISTIC
/begin CHARACTERISTIC DFES_DTCO.DFC_ComHvbMstCont_C "" VALUE 0x8024D342 Val_Wu16 65535.00 DFES_OneToOne 0.00 65535.00 FORMAT "%8.2" /end CHARACTERISTIC
/begin CHARACTERISTIC DFES_DTCO.DFC_ComImmoUnlockWkuReq_C "" VALUE 0x8024D344 Val_Wu16 65535.00 DFES_OneToOne 0.00 65535.00 FORMAT "%8.2" /end CHARACTERISTIC
/begin CHARACTERISTIC DFES_DTCO.DFC_ComInfoReqPtlWkuReq_C "" VALUE 0x8024D346 Val_Wu16 65535.00 DFES_OneToOne 0.00 65535.00 FORMAT "%8.2" /end CHARACTERISTIC
/begin CHARACTERISTIC DFES_DTCO.DFC_ComOBCFltLvl2_C "" VALUE 0x8024D348 Val_Wu16 65535.00 DFES_OneToOne 0.00 65535.00 FORMAT "%8.2" /end CHARACTERISTIC
/begin CHARACTERISTIC DFES_DTCO.DFC_ComOBCFltLvl3_C "" VALUE 0x8024D34A Val_Wu16 65535.00 DFES_OneToOne 0.00 65535.00 FORMAT "%8.2" /end CHARACTERISTIC
/begin CHARACTERISTIC DFES_DTCO.DFC_ComOBCFltLvl4_C "" VALUE 0x8024D34C Val_Wu16 65535.00 DFES_OneToOne 0.00 65535.00 FORMAT "%8.2" /end CHARACTERISTIC
/begin CHARACTERISTIC DFES_DTCO.DFC_ComOBCFltLvl5_C "" VALUE 0x8024D34E Val_Wu16 65535.00 DFES_OneToOne 0.00 65535.00 FORMAT "%8.2" /end CHARACTERISTIC
/begin CHARACTERISTIC DFES_DTCO.DFC_ComOBCFltLvlRes_C "" VALUE 0x8024D350 Val_Wu16 65535.00 DFES_OneToOne 0.00 65535.00 FORMAT "%8.2" /end CHARACTERISTIC
/begin CHARACTERISTIC DFES_DTCO.DFC_ComPostOperationWkuReq_C "" VALUE 0x8024D352 Val_Wu16 65535.00 DFES_OneToOne 0.00 65535.00 FORMAT "%8.2" /end CHARACTERISTIC
/begin CHARACTERISTIC DFES_DTCO.DFC_ComPreCondElecWkuReq_C "" VALUE 0x8024D354 Val_Wu16 65535.00 DFES_OneToOne 0.00 65535.00 FORMAT "%8.2" /end CHARACTERISTIC
/begin CHARACTERISTIC DFES_DTCO.DFC_ComRemUnlckWkuReq_C "" VALUE 0x8024D356 Val_Wu16 65535.00 DFES_OneToOne 0.00 65535.00 FORMAT "%8.2" /end CHARACTERISTIC
/begin CHARACTERISTIC DFES_DTCO.DFC_ComStpDlyHMIWkuReq_C "" VALUE 0x8024D358 Val_Wu16 65535.00 DFES_OneToOne 0.00 65535.00 FORMAT "%8.2" /end CHARACTERISTIC
/begin CHARACTERISTIC DFES_DTCO.DFC_ComflgCurMeasmtErr_C "" VALUE 0x8024D35A Val_Wu16 65535.00 DFES_OneToOne 0.00 65535.00 FORMAT "%8.2" /end CHARACTERISTIC
/begin CHARACTERISTIC DFES_DTCO.DFC_ComflgCurMeasmtSysErr_C "" VALUE 0x8024D35C Val_Wu16 65535.00 DFES_OneToOne 0.00 65535.00 FORMAT "%8.2" /end CHARACTERISTIC
/begin CHARACTERISTIC DFES_DTCO.DFC_ComflgCurMeasmtVld_C "" VALUE 0x8024D35E Val_Wu16 65535.00 DFES_OneToOne 0.00 65535.00 FORMAT "%8.2" /end CHARACTERISTIC
/begin CHARACTERISTIC DFES_DTCO.DFC_ComflgCurRngErr_C "" VALUE 0x8024D360 Val_Wu16 65535.00 DFES_OneToOne 0.00 65535.00 FORMAT "%8.2" /end CHARACTERISTIC
/begin CHARACTERISTIC DFES_DTCO.DFC_ComflgTPcbMeasmtErr_C "" VALUE 0x8024D362 Val_Wu16 65535.00 DFES_OneToOne 0.00 65535.00 FORMAT "%8.2" /end CHARACTERISTIC
/begin CHARACTERISTIC DFES_DTCO.DFC_ComflgTPcbMeasmtVld_C "" VALUE 0x8024D364 Val_Wu16 65535.00 DFES_OneToOne 0.00 65535.00 FORMAT "%8.2" /end CHARACTERISTIC
/begin CHARACTERISTIC DFES_DTCO.DFC_ComflgTPcbRngErr_C "" VALUE 0x8024D366 Val_Wu16 65535.00 DFES_OneToOne 0.00 65535.00 FORMAT "%8.2" /end CHARACTERISTIC
/begin CHARACTERISTIC DFES_DTCO.DFC_ComflgTPcbSysErr_C "" VALUE 0x8024D368 Val_Wu16 65535.00 DFES_OneToOne 0.00 65535.00 FORMAT "%8.2" /end CHARACTERISTIC
/begin CHARACTERISTIC DFES_DTCO.DFC_ComflgTShntMeasmtErr_C "" VALUE 0x8024D36A Val_Wu16 65535.00 DFES_OneToOne 0.00 65535.00 FORMAT "%8.2" /end CHARACTERISTIC
/begin CHARACTERISTIC DFES_DTCO.DFC_ComflgTShntMeasmtVld_C "" VALUE 0x8024D36C Val_Wu16 65535.00 DFES_OneToOne 0.00 65535.00 FORMAT "%8.2" /end CHARACTERISTIC
/begin CHARACTERISTIC DFES_DTCO.DFC_ComflgTShntRngErr_C "" VALUE 0x8024D36E Val_Wu16 65535.00 DFES_OneToOne 0.00 65535.00 FORMAT "%8.2" /end CHARACTERISTIC
/begin CHARACTERISTIC DFES_DTCO.DFC_ComflgTShntSysErr_C "" VALUE 0x8024D370 Val_Wu16 65535.00 DFES_OneToOne 0.00 65535.00 FORMAT "%8.2" /end CHARACTERISTIC
/begin CHARACTERISTIC DFES_DTCO.DFC_ComflgVoltMeasmtErr_C "" VALUE 0x8024D372 Val_Wu16 65535.00 DFES_OneToOne 0.00 65535.00 FORMAT "%8.2" /end CHARACTERISTIC
/begin CHARACTERISTIC DFES_DTCO.DFC_ComflgVoltMeasmtSysErr_C "" VALUE 0x8024D374 Val_Wu16 65535.00 DFES_OneToOne 0.00 65535.00 FORMAT "%8.2" /end CHARACTERISTIC
/begin CHARACTERISTIC DFES_DTCO.DFC_ComflgVoltMeasmtVld_C "" VALUE 0x8024D376 Val_Wu16 65535.00 DFES_OneToOne 0.00 65535.00 FORMAT "%8.2" /end CHARACTERISTIC
/begin CHARACTERISTIC DFES_DTCO.DFC_ComflgVoltRngErr_C "" VALUE 0x8024D378 Val_Wu16 65535.00 DFES_OneToOne 0.00 65535.00 FORMAT "%8.2" /end CHARACTERISTIC
/begin CHARACTERISTIC DFES_DTCO.DFC_CrashEveOcc_C "" VALUE 0x8024D37A Val_Wu16 65535.00 DFES_OneToOne 0.00 65535.00 FORMAT "%8.2" /end CHARACTERISTIC
/begin CHARACTERISTIC DFES_DTCO.DFC_DcdcFwdModStuck_C "" VALUE 0x8024D37C Val_Wu16 65535.00 DFES_OneToOne 0.00 65535.00 FORMAT "%8.2" /end CHARACTERISTIC
/begin CHARACTERISTIC DFES_DTCO.DFC_DcdcLvUDifMaxFlt_C "" VALUE 0x8024D37E Val_Wu16 65535.00 DFES_OneToOne 0.00 65535.00 FORMAT "%8.2" /end CHARACTERISTIC
/begin CHARACTERISTIC DFES_DTCO.DFC_DcdcOffModStuck_C "" VALUE 0x8024D380 Val_Wu16 65535.00 DFES_OneToOne 0.00 65535.00 FORMAT "%8.2" /end CHARACTERISTIC
/begin CHARACTERISTIC DFES_DTCO.DFC_DcdcOperModFailr_C "" VALUE 0x8024D382 Val_Wu16 65535.00 DFES_OneToOne 0.00 65535.00 FORMAT "%8.2" /end CHARACTERISTIC
/begin CHARACTERISTIC DFES_DTCO.DFC_DcdcPrecModStuck_C "" VALUE 0x8024D384 Val_Wu16 65535.00 DFES_OneToOne 0.00 65535.00 FORMAT "%8.2" /end CHARACTERISTIC
/begin CHARACTERISTIC DFES_DTCO.DFC_DrvDoorOpn_C "" VALUE 0x8024D386 Val_Wu16 65535.00 DFES_OneToOne 0.00 65535.00 FORMAT "%8.2" /end CHARACTERISTIC
/begin CHARACTERISTIC DFES_DTCO.DFC_DrvModPosnDfct_C "" VALUE 0x8024D388 Val_Wu16 65535.00 DFES_OneToOne 0.00 65535.00 FORMAT "%8.2" /end CHARACTERISTIC
/begin CHARACTERISTIC DFES_DTCO.DFC_DrvStbltOpn_C "" VALUE 0x8024D38A Val_Wu16 65535.00 DFES_OneToOne 0.00 65535.00 FORMAT "%8.2" /end CHARACTERISTIC
/begin CHARACTERISTIC DFES_DTCO.DFC_ETogFailrLvl3_C "" VALUE 0x8024D38C Val_Wu16 65535.00 DFES_OneToOne 0.00 65535.00 FORMAT "%8.2" /end CHARACTERISTIC
/begin CHARACTERISTIC DFES_DTCO.DFC_ETogFailrLvl4_C "" VALUE 0x8024D38E Val_Wu16 65535.00 DFES_OneToOne 0.00 65535.00 FORMAT "%8.2" /end CHARACTERISTIC
/begin CHARACTERISTIC DFES_DTCO.DFC_EbsLvBattSocDiagLo_C "" VALUE 0x8024D390 Val_Wu16 65535.00 DFES_OneToOne 0.00 65535.00 FORMAT "%8.2" /end CHARACTERISTIC
/begin CHARACTERISTIC DFES_DTCO.DFC_EbsLvBattUDiagDiOper_C "" VALUE 0x8024D392 Val_Wu16 65535.00 DFES_OneToOne 0.00 65535.00 FORMAT "%8.2" /end CHARACTERISTIC
/begin CHARACTERISTIC DFES_DTCO.DFC_EbsLvBattUDiagFltLvl1_C "" VALUE 0x8024D394 Val_Wu16 65535.00 DFES_OneToOne 0.00 65535.00 FORMAT "%8.2" /end CHARACTERISTIC
/begin CHARACTERISTIC DFES_DTCO.DFC_EbsLvBattUDiagFltLvl2_C "" VALUE 0x8024D396 Val_Wu16 65535.00 DFES_OneToOne 0.00 65535.00 FORMAT "%8.2" /end CHARACTERISTIC
/begin CHARACTERISTIC DFES_DTCO.DFC_EbsLvBattUDiagLo_C "" VALUE 0x8024D398 Val_Wu16 65535.00 DFES_OneToOne 0.00 65535.00 FORMAT "%8.2" /end CHARACTERISTIC
/begin CHARACTERISTIC DFES_DTCO.DFC_EbsSnsrSt_C "" VALUE 0x8024D39A Val_Wu16 65535.00 DFES_OneToOne 0.00 65535.00 FORMAT "%8.2" /end CHARACTERISTIC
/begin CHARACTERISTIC DFES_DTCO.DFC_EbsSofASILErr_C "" VALUE 0x8024D39C Val_Wu16 65535.00 DFES_OneToOne 0.00 65535.00 FORMAT "%8.2" /end CHARACTERISTIC
/begin CHARACTERISTIC DFES_DTCO.DFC_ElTSPtSysLimDrvErr_C "" VALUE 0x8024D39E Val_Wu16 65535.00 DFES_OneToOne 0.00 65535.00 FORMAT "%8.2" /end CHARACTERISTIC
/begin CHARACTERISTIC DFES_DTCO.DFC_ElTSPtSysLimRgnErr_C "" VALUE 0x8024D3A0 Val_Wu16 65535.00 DFES_OneToOne 0.00 65535.00 FORMAT "%8.2" /end CHARACTERISTIC
/begin CHARACTERISTIC DFES_DTCO.DFC_HLCCcsFwDwnl_C "" VALUE 0x8024D3A2 Val_Wu16 65535.00 DFES_OneToOne 0.00 65535.00 FORMAT "%8.2" /end CHARACTERISTIC
/begin CHARACTERISTIC DFES_DTCO.DFC_HvBattChrgPwrMax_C "" VALUE 0x8024D3A4 Val_Wu16 65535.00 DFES_OneToOne 0.00 65535.00 FORMAT "%8.2" /end CHARACTERISTIC
/begin CHARACTERISTIC DFES_DTCO.DFC_HvBattCrashDetd_C "" VALUE 0x8024D3A6 Val_Wu16 65535.00 DFES_OneToOne 0.00 65535.00 FORMAT "%8.2" /end CHARACTERISTIC
/begin CHARACTERISTIC DFES_DTCO.DFC_HvBattDchaPwrMax_C "" VALUE 0x8024D3A8 Val_Wu16 65535.00 DFES_OneToOne 0.00 65535.00 FORMAT "%8.2" /end CHARACTERISTIC
/begin CHARACTERISTIC DFES_DTCO.DFC_HvBattEmgyOff_C "" VALUE 0x8024D3AA Val_Wu16 65535.00 DFES_OneToOne 0.00 65535.00 FORMAT "%8.2" /end CHARACTERISTIC
/begin CHARACTERISTIC DFES_DTCO.DFC_HvBattEmgyOffIntlck_C "" VALUE 0x8024D3AC Val_Wu16 65535.00 DFES_OneToOne 0.00 65535.00 FORMAT "%8.2" /end CHARACTERISTIC
/begin CHARACTERISTIC DFES_DTCO.DFC_HvBattEmgyOffReq_C "" VALUE 0x8024D3AE Val_Wu16 65535.00 DFES_OneToOne 0.00 65535.00 FORMAT "%8.2" /end CHARACTERISTIC
/begin CHARACTERISTIC DFES_DTCO.DFC_HvBattFltMod_C "" VALUE 0x8024D3B0 Val_Wu16 65535.00 DFES_OneToOne 0.00 65535.00 FORMAT "%8.2" /end CHARACTERISTIC
/begin CHARACTERISTIC DFES_DTCO.DFC_HvBattIReqToChrgrErr_C "" VALUE 0x8024D3B2 Val_Wu16 65535.00 DFES_OneToOne 0.00 65535.00 FORMAT "%8.2" /end CHARACTERISTIC
/begin CHARACTERISTIC DFES_DTCO.DFC_HvBattIReqToChrgrIni_C "" VALUE 0x8024D3B4 Val_Wu16 65535.00 DFES_OneToOne 0.00 65535.00 FORMAT "%8.2" /end CHARACTERISTIC
/begin CHARACTERISTIC DFES_DTCO.DFC_HvBattIninTout_C "" VALUE 0x8024D3B6 Val_Wu16 65535.00 DFES_OneToOne 0.00 65535.00 FORMAT "%8.2" /end CHARACTERISTIC
/begin CHARACTERISTIC DFES_DTCO.DFC_HvBattIntlckSt_C "" VALUE 0x8024D3B8 Val_Wu16 65535.00 DFES_OneToOne 0.00 65535.00 FORMAT "%8.2" /end CHARACTERISTIC
/begin CHARACTERISTIC DFES_DTCO.DFC_HvBattIsoFlt_C "" VALUE 0x8024D3BA Val_Wu16 65535.00 DFES_OneToOne 0.00 65535.00 FORMAT "%8.2" /end CHARACTERISTIC
/begin CHARACTERISTIC DFES_DTCO.DFC_HvBattLimdPwr_C "" VALUE 0x8024D3BC Val_Wu16 65535.00 DFES_OneToOne 0.00 65535.00 FORMAT "%8.2" /end CHARACTERISTIC
/begin CHARACTERISTIC DFES_DTCO.DFC_HvBattMaiSwtClsngFlt_C "" VALUE 0x8024D3BE Val_Wu16 65535.00 DFES_OneToOne 0.00 65535.00 FORMAT "%8.2" /end CHARACTERISTIC
/begin CHARACTERISTIC DFES_DTCO.DFC_HvBattMaiSwtFlt_C "" VALUE 0x8024D3C0 Val_Wu16 65535.00 DFES_OneToOne 0.00 65535.00 FORMAT "%8.2" /end CHARACTERISTIC
/begin CHARACTERISTIC DFES_DTCO.DFC_HvBattMaiSwtOpen_C "" VALUE 0x8024D3C2 Val_Wu16 65535.00 DFES_OneToOne 0.00 65535.00 FORMAT "%8.2" /end CHARACTERISTIC
/begin CHARACTERISTIC DFES_DTCO.DFC_HvBattMaiSwtOpngFlt_C "" VALUE 0x8024D3C4 Val_Wu16 65535.00 DFES_OneToOne 0.00 65535.00 FORMAT "%8.2" /end CHARACTERISTIC
/begin CHARACTERISTIC DFES_DTCO.DFC_HvBattMaiSwtWldd_C "" VALUE 0x8024D3C6 Val_Wu16 65535.00 DFES_OneToOne 0.00 65535.00 FORMAT "%8.2" /end CHARACTERISTIC
/begin CHARACTERISTIC DFES_DTCO.DFC_HvBattNegCntctrCntErr_C "" VALUE 0x8024D3C8 Val_Wu16 65535.00 DFES_OneToOne 0.00 65535.00 FORMAT "%8.2" /end CHARACTERISTIC
/begin CHARACTERISTIC DFES_DTCO.DFC_HvBattOperModChrgPlausy_C "" VALUE 0x8024D3CA Val_Wu16 65535.00 DFES_OneToOne 0.00 65535.00 FORMAT "%8.2" /end CHARACTERISTIC
/begin CHARACTERISTIC DFES_DTCO.DFC_HvBattOverTDern_C "" VALUE 0x8024D3CC Val_Wu16 65535.00 DFES_OneToOne 0.00 65535.00 FORMAT "%8.2" /end CHARACTERISTIC
/begin CHARACTERISTIC DFES_DTCO.DFC_HvBattPosCntctrCntErr_C "" VALUE 0x8024D3CE Val_Wu16 65535.00 DFES_OneToOne 0.00 65535.00 FORMAT "%8.2" /end CHARACTERISTIC
/begin CHARACTERISTIC DFES_DTCO.DFC_HvBattPrecCntctrCntErr_C "" VALUE 0x8024D3D0 Val_Wu16 65535.00 DFES_OneToOne 0.00 65535.00 FORMAT "%8.2" /end CHARACTERISTIC
/begin CHARACTERISTIC DFES_DTCO.DFC_HvBattPwrDistbnTDern_C "" VALUE 0x8024D3D2 Val_Wu16 65535.00 DFES_OneToOne 0.00 65535.00 FORMAT "%8.2" /end CHARACTERISTIC
/begin CHARACTERISTIC DFES_DTCO.DFC_HvBattPwrDistbnTInhbn_C "" VALUE 0x8024D3D4 Val_Wu16 65535.00 DFES_OneToOne 0.00 65535.00 FORMAT "%8.2" /end CHARACTERISTIC
/begin CHARACTERISTIC DFES_DTCO.DFC_HvBattRatRSohErr_C "" VALUE 0x8024D3D6 Val_Wu16 65535.00 DFES_OneToOne 0.00 65535.00 FORMAT "%8.2" /end CHARACTERISTIC
/begin CHARACTERISTIC DFES_DTCO.DFC_HvBattRatSohErr_C "" VALUE 0x8024D3D8 Val_Wu16 65535.00 DFES_OneToOne 0.00 65535.00 FORMAT "%8.2" /end CHARACTERISTIC
/begin CHARACTERISTIC DFES_DTCO.DFC_HvBattSngIsoWarn_C "" VALUE 0x8024D3DA Val_Wu16 65535.00 DFES_OneToOne 0.00 65535.00 FORMAT "%8.2" /end CHARACTERISTIC
/begin CHARACTERISTIC DFES_DTCO.DFC_HvBattSrvPlgDiscnct_C "" VALUE 0x8024D3DC Val_Wu16 65535.00 DFES_OneToOne 0.00 65535.00 FORMAT "%8.2" /end CHARACTERISTIC
/begin CHARACTERISTIC DFES_DTCO.DFC_HvBattUNomChrgnErr_C "" VALUE 0x8024D3DE Val_Wu16 65535.00 DFES_OneToOne 0.00 65535.00 FORMAT "%8.2" /end CHARACTERISTIC
/begin CHARACTERISTIC DFES_DTCO.DFC_HvBattUNomChrgnIni_C "" VALUE 0x8024D3E0 Val_Wu16 65535.00 DFES_OneToOne 0.00 65535.00 FORMAT "%8.2" /end CHARACTERISTIC
/begin CHARACTERISTIC DFES_DTCO.DFC_HvBattUnderTDern_C "" VALUE 0x8024D3E2 Val_Wu16 65535.00 DFES_OneToOne 0.00 65535.00 FORMAT "%8.2" /end CHARACTERISTIC
/begin CHARACTERISTIC DFES_DTCO.DFC_HvbEVLmpBlink_C "" VALUE 0x8024D3E4 Val_Wu16 65535.00 DFES_OneToOne 0.00 65535.00 FORMAT "%8.2" /end CHARACTERISTIC
/begin CHARACTERISTIC DFES_DTCO.DFC_HvbEVLmpCont_C "" VALUE 0x8024D3E6 Val_Wu16 65535.00 DFES_OneToOne 0.00 65535.00 FORMAT "%8.2" /end CHARACTERISTIC
/begin CHARACTERISTIC DFES_DTCO.DFC_HvbSVSBlink_C "" VALUE 0x8024D3E8 Val_Wu16 65535.00 DFES_OneToOne 0.00 65535.00 FORMAT "%8.2" /end CHARACTERISTIC
/begin CHARACTERISTIC DFES_DTCO.DFC_HvbSVSCont_C "" VALUE 0x8024D3EA Val_Wu16 65535.00 DFES_OneToOne 0.00 65535.00 FORMAT "%8.2" /end CHARACTERISTIC
/begin CHARACTERISTIC DFES_DTCO.DFC_InmLINBusBlk_C "" VALUE 0x8024D3EC Val_Wu16 65535.00 DFES_OneToOne 0.00 65535.00 FORMAT "%8.2" /end CHARACTERISTIC
/begin CHARACTERISTIC DFES_DTCO.DFC_PDUProgmFailr_C "" VALUE 0x8024D3EE Val_Wu16 65535.00 DFES_OneToOne 0.00 65535.00 FORMAT "%8.2" /end CHARACTERISTIC
/begin CHARACTERISTIC DFES_DTCO.DFC_PEnvSigRngMax_C "" VALUE 0x8024D3F0 Val_Wu16 65535.00 DFES_OneToOne 0.00 65535.00 FORMAT "%8.2" /end CHARACTERISTIC
/begin CHARACTERISTIC DFES_DTCO.DFC_PEnvSigRngMin_C "" VALUE 0x8024D3F2 Val_Wu16 65535.00 DFES_OneToOne 0.00 65535.00 FORMAT "%8.2" /end CHARACTERISTIC
/begin CHARACTERISTIC DFES_DTCO.DFC_PLnCChpDeactvnFaild_C "" VALUE 0x8024D3F4 Val_Wu16 65535.00 DFES_OneToOne 0.00 65535.00 FORMAT "%8.2" /end CHARACTERISTIC
/begin CHARACTERISTIC DFES_DTCO.DFC_PrkgBrkFailr_C "" VALUE 0x8024D3F6 Val_Wu16 65535.00 DFES_OneToOne 0.00 65535.00 FORMAT "%8.2" /end CHARACTERISTIC
/begin CHARACTERISTIC DFES_DTCO.DFC_PtSysLimErr_C "" VALUE 0x8024D3F8 Val_Wu16 65535.00 DFES_OneToOne 0.00 65535.00 FORMAT "%8.2" /end CHARACTERISTIC
/begin CHARACTERISTIC DFES_DTCO.DFC_PwrMaxDchaShoLo_C "" VALUE 0x8024D3FA Val_Wu16 65535.00 DFES_OneToOne 0.00 65535.00 FORMAT "%8.2" /end CHARACTERISTIC
/begin CHARACTERISTIC DFES_DTCO.DFC_SCtPmp1FailSafeNotSuc_C "" VALUE 0x8024D3FC Val_Wu16 65535.00 DFES_OneToOne 0.00 65535.00 FORMAT "%8.2" /end CHARACTERISTIC
/begin CHARACTERISTIC DFES_DTCO.DFC_SCtPmp1SCG_C "" VALUE 0x8024D3FE Val_Wu16 65535.00 DFES_OneToOne 0.00 65535.00 FORMAT "%8.2" /end CHARACTERISTIC
/begin CHARACTERISTIC DFES_DTCO.DFC_VehCoornDrvrNotPrsnt_C "" VALUE 0x8024D400 Val_Wu16 65535.00 DFES_OneToOne 0.00 65535.00 FORMAT "%8.2" /end CHARACTERISTIC
/begin FUNCTION DFES "30000.70.0Diagnostic Fault Event Storage"
 /begin DEF_CHARACTERISTIC DFES_DTCM.DFC_EbsLvBattUDiagFltLvl1_C DFES_DTCM.DFC_EbsLvBattUDiagFltLvl2_C DFES_DTCM.DFC_EbsLvBattUDiagLo_C DFES_DTCM.DFC_EbsSnsrSt_C DFES_DTCM.DFC_EbsSofASILErr_C DFES_DTCM.DFC_ElTSPtSysLimDrvErr_C DFES_DTCM.DFC_ElTSPtSysLimRgnErr_C DFES_DTCM.DFC_HLCCcsFwDwnl_C DFES_DTCM.DFC_HvBattChrgPwrMax_C DFES_DTCM.DFC_HvBattCrashDetd_C DFES_DTCM.DFC_HvBattDchaPwrMax_C DFES_DTCM.DFC_HvBattEmgyOff_C DFES_DTCM.DFC_HvBattEmgyOffIntlck_C DFES_DTCM.DFC_HvBattEmgyOffReq_C DFES_DTCM.DFC_HvBattFltMod_C DFES_DTCM.DFC_HvBattIReqToChrgrErr_C DFES_DTCM.DFC_HvBattIReqToChrgrIni_C DFES_DTCM.DFC_HvBattIninTout_C DFES_DTCM.DFC_HvBattIntlckSt_C DFES_DTCM.DFC_HvBattIsoFlt_C DFES_DTCM.DFC_HvBattLimdPwr_C DFES_DTCM.DFC_HvBattMaiSwtClsngFlt_C DFES_DTCM.DFC_HvBattMaiSwtFlt_C DFES_DTCM.DFC_HvBattMaiSwtOpen_C DFES_DTCM.DFC_HvBattMaiSwtOpngFlt_C DFES_DTCM.DFC_HvBattMaiSwtWldd_C DFES_DTCM.DFC_HvBattNegCntctrCntErr_C DFES_DTCM.DFC_HvBattOperModChrgPlausy_C DFES_DTCM.DFC_HvBattOverTDern_C DFES_DTCM.DFC_HvBattPosCntctrCntErr_C DFES_DTCM.DFC_HvBattPrecCntctrCntErr_C DFES_DTCM.DFC_HvBattPwrDistbnTDern_C DFES_DTCM.DFC_HvBattPwrDistbnTInhbn_C DFES_DTCM.DFC_HvBattRatRSohErr_C DFES_DTCM.DFC_HvBattRatSohErr_C DFES_DTCM.DFC_HvBattSngIsoWarn_C DFES_DTCM.DFC_HvBattSrvPlgDiscnct_C DFES_DTCM.DFC_HvBattUNomChrgnErr_C DFES_DTCM.DFC_HvBattUNomChrgnIni_C DFES_DTCM.DFC_HvBattUnderTDern_C DFES_DTCM.DFC_HvbEVLmpBlink_C DFES_DTCM.DFC_HvbEVLmpCont_C DFES_DTCM.DFC_HvbSVSBlink_C DFES_DTCM.DFC_HvbSVSCont_C DFES_DTCM.DFC_InmLINBusBlk_C DFES_DTCM.DFC_PDUProgmFailr_C DFES_DTCM.DFC_PEnvSigRngMax_C DFES_DTCM.DFC_PEnvSigRngMin_C DFES_DTCM.DFC_PLnCChpDeactvnFaild_C DFES_DTCM.DFC_PrkgBrkFailr_C DFES_DTCM.DFC_PtSysLimErr_C DFES_DTCM.DFC_PwrMaxDchaShoLo_C DFES_DTCM.DFC_SCtPmp1FailSafeNotSuc_C DFES_DTCM.DFC_SCtPmp1SCG_C DFES_DTCM.DFC_VehCoornDrvrNotPrsnt_C DFES_DTCM.DFC_VehVCanAvl_C DFES_DTCM.DFC_VehVCanErr_C DFES_DTCM.DFC_eTogFailrLvlRes_C DFES_DTCM.DFC_flgBrkMaiDiag_C DFES_DTCM.DFC_stHvbIsoMeasmtRes_C DFES_DTCM.DFC_BrkBstPmpPLeakDfct_C DFES_DTCM.DFC_Com082hTooShort_C DFES_DTCM.DFC_Com092hTooShort_C DFES_DTCM.DFC_Com205hAbsent_C DFES_DTCM.DFC_Com205hChecksum_C DFES_DTCM.DFC_Com205hCounter_C DFES_DTCM.DFC_Com205hTooShort_C DFES_DTCM.DFC_Com217hAbsent_C DFES_DTCM.DFC_Com217hChecksum_C DFES_DTCM.DFC_Com217hCounter_C DFES_DTCM.DFC_Com217hTooShort_C DFES_DTCM.DFC_Com227hAbsent_C DFES_DTCM.DFC_Com227hTooShort_C DFES_DTCM.DFC_Com237hAbsent_C DFES_DTCM.DFC_Com237hChecksum_C DFES_DTCM.DFC_Com237hCounter_C DFES_DTCM.DFC_Com237hTooShort_C DFES_DTCM.DFC_Com259hAbsent_C DFES_DTCM.DFC_Com259hChecksum_C DFES_DTCM.DFC_Com259hCounter_C DFES_DTCM.DFC_Com259hTooShort_C DFES_DTCM.DFC_Com26hAbsent_C DFES_DTCM.DFC_Com26hTooShort_C DFES_DTCM.DFC_Com273hAbsent_C DFES_DTCM.DFC_Com273hChecksum_C DFES_DTCM.DFC_Com273hCounter_C DFES_DTCM.DFC_Com273hTooShort_C DFES_DTCM.DFC_Com275hAbsent_C DFES_DTCM.DFC_Com275hChecksum_C DFES_DTCM.DFC_Com275hCounter_C DFES_DTCM.DFC_Com275hTooShort_C DFES_DTCM.DFC_Com283hAbsent_C DFES_DTCM.DFC_Com283hTooShort_C DFES_DTCM.DFC_Com285hAbsent_C DFES_DTCM.DFC_Com285hChecksum_C DFES_DTCM.DFC_Com285hCounter_C DFES_DTCM.DFC_Com285hTooShort_C DFES_DTCM.DFC_Com293hAbsent_C DFES_DTCM.DFC_Com293hChecksum_C DFES_DTCM.DFC_Com293hCounter_C DFES_DTCM.DFC_Com293hTooShort_C DFES_DTCM.DFC_Com308hAbsent_C DFES_DTCM.DFC_Com308hChecksum_C DFES_DTCM.DFC_Com308hCounter_C DFES_DTCM.DFC_Com308hTooShort_C DFES_DTCM.DFC_Com318hAbsent_C DFES_DTCM.DFC_Com318hChecksum_C DFES_DTCM.DFC_Com318hCounter_C DFES_DTCM.DFC_Com318hTooShort_C DFES_DTCM.DFC_Com325hAbsent_C DFES_DTCM.DFC_Com325hChecksum_C DFES_DTCM.DFC_Com325hCounter_C DFES_DTCM.DFC_Com325hTooShort_C DFES_DTCM.DFC_Com335hAbsent_C DFES_DTCM.DFC_Com335hChecksum_C DFES_DTCM.DFC_Com335hCounter_C DFES_DTCM.DFC_Com335hTooShort_C DFES_DTCM.DFC_Com351hAbsent_C DFES_DTCM.DFC_Com351hTooShort_C DFES_DTCM.DFC_Com38DhAbsent_C DFES_DTCM.DFC_Com38DhChecksum_C DFES_DTCM.DFC_Com38DhCounter_C DFES_DTCM.DFC_Com38DhTooShort_C DFES_DTCM.DFC_Com412hAbsent_C DFES_DTCM.DFC_Com412hChecksum_C DFES_DTCM.DFC_Com412hCounter_C DFES_DTCM.DFC_Com412hTooShort_C DFES_DTCM.DFC_Com427hAbsent_C DFES_DTCM.DFC_Com427hTooShort_C DFES_DTCM.DFC_Com432hAbsent_C DFES_DTCM.DFC_Com432hChecksum_C DFES_DTCM.DFC_Com432hCounter_C DFES_DTCM.DFC_Com432hTooShort_C DFES_DTCM.DFC_Com435hAbsent_C DFES_DTCM.DFC_Com435hTooShort_C DFES_DTCM.DFC_Com442hAbsent_C DFES_DTCM.DFC_Com442hTooShort_C DFES_DTCM.DFC_Com453hAbsent_C DFES_DTCM.DFC_Com453hTooShort_C DFES_DTCM.DFC_Com455hAbsent_C DFES_DTCM.DFC_Com455hTooShort_C DFES_DTCM.DFC_Com463hAbsent_C DFES_DTCM.DFC_Com463hTooShort_C DFES_DTCM.DFC_Com473hAbsent_C DFES_DTCM.DFC_Com473hTooShort_C DFES_DTCM.DFC_Com47BhAbsent_C DFES_DTCM.DFC_Com47BhTooShort_C DFES_DTCM.DFC_Com48BhAbsent_C DFES_DTCM.DFC_Com48BhTooShort_C DFES_DTCM.DFC_Com497hTooShort_C DFES_DTCM.DFC_Com4F2hAbsent_C DFES_DTCM.DFC_Com4F2hChecksum_C DFES_DTCM.DFC_Com4F2hCounter_C DFES_DTCM.DFC_Com4F2hTooShort_C DFES_DTCM.DFC_Com50DhAbsent_C DFES_DTCM.DFC_Com50DhTooShort_C DFES_DTCM.DFC_Com535hAbsent_C DFES_DTCM.DFC_Com535hTooShort_C DFES_DTCM.DFC_Com543hAbsent_C DFES_DTCM.DFC_Com543hTooShort_C DFES_DTCM.DFC_Com552hAbsent_C DFES_DTCM.DFC_Com552hTooShort_C DFES_DTCM.DFC_Com583hAbsent_C DFES_DTCM.DFC_Com583hTooShort_C DFES_DTCM.DFC_Com592hAbsent_C DFES_DTCM.DFC_Com592hChecksum_C DFES_DTCM.DFC_Com592hCounter_C DFES_DTCM.DFC_Com592hTooShort_C DFES_DTCM.DFC_Com595hAbsent_C DFES_DTCM.DFC_Com595hChecksum_C DFES_DTCM.DFC_Com595hCounter_C DFES_DTCM.DFC_Com595hTooShort_C DFES_DTCM.DFC_Com5B2hAbsent_C DFES_DTCM.DFC_Com5B2hTooShort_C DFES_DTCM.DFC_Com5B5hAbsent_C DFES_DTCM.DFC_Com5B5hChecksum_C DFES_DTCM.DFC_Com5B5hCounter_C DFES_DTCM.DFC_Com5B5hTooShort_C DFES_DTCM.DFC_Com5C7hTooShort_C DFES_DTCM.DFC_Com5E7hAbsent_C DFES_DTCM.DFC_Com5E7hTooShort_C DFES_DTCM.DFC_Com635hTooShort_C DFES_DTCM.DFC_Com645hTooShort_C DFES_DTCM.DFC_Com663hAbsent_C DFES_DTCM.DFC_Com663hTooShort_C DFES_DTCM.DFC_Com665hAbsent_C DFES_DTCM.DFC_Com665hTooShort_C DFES_DTCM.DFC_Com675hAbsent_C DFES_DTCM.DFC_Com675hTooShort_C DFES_DTCM.DFC_ComFrbd_205h_HVBAT_PACK_CURRENT_C DFES_DTCM.DFC_ComFrbd_205h_HVBAT_SOC_DISPLAY_C DFES_DTCM.DFC_ComFrbd_205h_HVBAT_VOLTAGE_C DFES_DTCM.DFC_ComFrbd_217h_INV_DC_BUS_VOLTAGE_C DFES_DTCM.DFC_ComFrbd_217h_INV_MTR_ACTUAL_TRQ_C DFES_DTCM.DFC_ComFrbd_217h_INV_MTR_SPEED_C DFES_DTCM.DFC_ComFrbd_217h_INV_MTR_TRQ_C DFES_DTCM.DFC_ComFrbd_227h_INV_DC_CURRENT_C DFES_DTCM.DFC_ComFrbd_227h_INV_MOTORING_PEAK_TRQ_C DFES_DTCM.DFC_ComFrbd_227h_INV_MTR_INST_INPUT_POWER_C DFES_DTCM.DFC_ComFrbd_227h_INV_REGEN_PEAK_TRQ_C DFES_DTCM.DFC_ComFrbd_237h_INV_ACTIVE_DISCHARGE_STATUS_C DFES_DTCM.DFC_ComFrbd_237h_INV_CTRL_MODE_ACK_C DFES_DTCM.DFC_ComFrbd_237h_INV_EV_WARNING_C DFES_DTCM.DFC_ComFrbd_237h_INV_FAULT_LEVEL_C DFES_DTCM.DFC_ComFrbd_237h_INV_MASTER_STOP_C DFES_DTCM.DFC_ComFrbd_237h_INV_SERVICE_DUE_C DFES_DTCM.DFC_ComFrbd_237h_INV_STAB_MIN_TRQ_C DFES_DTCM.DFC_ComFrbd_259h_TGLM_FAILURE_STATE_C DFES_DTCM.DFC_ComFrbd_259h_TGLM_MODE_PUSH_C DFES_DTCM.DFC_ComFrbd_259h_TOGGLE_MONOSTABLE_POS_C DFES_DTCM.DFC_ComFrbd_273h_OBC_outputpower_capability_C DFES_DTCM.DFC_ComFrbd_275h_HVBAT_DISCHARGE_30S_AVAILABLE_CURRENT_C DFES_DTCM.DFC_ComFrbd_275h_HVBAT_DISCHARGE_30S_AVAILABLE_POWER_C DFES_DTCM.DFC_ComFrbd_283h_DCDC_IN_CURRENT_C DFES_DTCM.DFC_ComFrbd_283h_DCDC_IN_VOLTAGE_C DFES_DTCM.DFC_ComFrbd_283h_DCDC_OUT_CURRENT_C DFES_DTCM.DFC_ComFrbd_283h_DCDC_OUT_VOLTAGE_C DFES_DTCM.DFC_ComFrbd_285h_HVBAT_REGEN_CHG_30S_CURRENT_LIMIT_C DFES_DTCM.DFC_ComFrbd_285h_HVBAT_REGEN_CHRG_30S_POWER_LIMIT_C DFES_DTCM.DFC_ComFrbd_293h_DCDC_outputpower_capability_C DFES_DTCM.DFC_ComFrbd_325h_HVBAT_INSULATION_RESISTANCE_C DFES_DTCM.DFC_ComFrbd_325h_HVBAT_TEMPERATURE_C DFES_DTCM.DFC_ComFrbd_335h_HVBAT_CHRG_CONTINUOUS_CURR_MAX_C DFES_DTCM.DFC_ComFrbd_335h_HVBAT_CHRG_COTINUOUS_CURR_REQ_C DFES_DTCM.DFC_ComFrbd_335h_HVBAT_CHRG_MAX_VOLT_C DFES_DTCM.DFC_ComFrbd_335h_HVBAT_DC_BUS_VOLTAGE_C DFES_DTCM.DFC_ComFrbd_427h_INV_OP_MODE_C DFES_DTCM.DFC_ComFrbd_427h_INV_PERMISIBLE_TORQUE_C DFES_DTCM.DFC_ComFrbd_435h_HVBAT_MAX_CELL_VOLT_C DFES_DTCM.DFC_ComFrbd_435h_HVBAT_MAX_CELL_VOLT_NUM_C DFES_DTCM.DFC_ComFrbd_435h_HVBAT_MAX_SENSOR_TEMP_C DFES_DTCM.DFC_ComFrbd_435h_HVBAT_MIN_CELL_VOLT_C DFES_DTCM.DFC_ComFrbd_435h_HVBAT_MIN_CELL_VOLT_NUM_C DFES_DTCM.DFC_ComFrbd_453h_OBC_IN_CURRENT_C DFES_DTCM.DFC_ComFrbd_453h_OBC_IN_VOLTAGE_C DFES_DTCM.DFC_ComFrbd_453h_OBC_IP_POWER_C DFES_DTCM.DFC_ComFrbd_455h_HVBAT_NOMINAL_VOLTAGE_C DFES_DTCM.DFC_ComFrbd_463h_OBC_OUT_CURRENT_C DFES_DTCM.DFC_ComFrbd_463h_OBC_OUT_VOLTAGE_C DFES_DTCM.DFC_ComFrbd_463h_OBC_TEMPERATURE_C DFES_DTCM.DFC_ComFrbd_473h_DCDC_Coolant_Temperature_C DFES_DTCM.DFC_ComFrbd_473h_DCDC_TEMPERATURE_C DFES_DTCM.DFC_ComFrbd_47Bh_eCOMP_BusBarCurrent_C DFES_DTCM.DFC_ComFrbd_47Bh_eCOMP_BusBarVoltage_C DFES_DTCM.DFC_ComFrbd_47Bh_eCOMP_CompressorSpeed_C DFES_DTCM.DFC_ComFrbd_47Bh_eCOMP_IGBT_Temp_C DFES_DTCM.DFC_ComFrbd_47Bh_eCOMP_PeakPhaCurrent_C DFES_DTCM.DFC_ComFrbd_47Bh_eCOMP_Power_consumption_C DFES_DTCM.DFC_ComFrbd_48Bh_eCOMP_Fault_Level_C DFES_DTCM.DFC_ComFrbd_4F2h_VALEUR_SOC_ETENDUE_C DFES_DTCM.DFC_ComFrbd_535h_HV_BATT_TEMP_AVG_C DFES_DTCM.DFC_ComFrbd_543h_HVBAT_RESTBATTENERGY_C DFES_DTCM.DFC_ComFrbd_543h_HVBAT_SOH_C DFES_DTCM.DFC_ComFrbd_543h_HV_BATT_SOH_RES_C DFES_DTCM.DFC_ComFrbd_592h_IBATT_1_C DFES_DTCM.DFC_ComFrbd_592h_IBATT_2_C DFES_DTCM.DFC_ComFrbd_592h_IBATT_3_C DFES_DTCM.DFC_ComFrbd_592h_TEMP_BATT_C DFES_DTCM.DFC_ComFrbd_592h_U_BATT_BECB_C DFES_DTCM.DFC_ComFrbd_595h_HVBAT_TIME_TO_CHRG_80_C DFES_DTCM.DFC_ComFrbd_5B2h_TEMP_AIR_EXT_C DFES_DTCM.DFC_ComFrbd_635h_HVBAT_NEG_CONT_COUNT_SEG1_C DFES_DTCM.DFC_ComFrbd_635h_HVBAT_NEG_CONT_COUNT_SEG3_C DFES_DTCM.DFC_ComFrbd_635h_HVBAT_NEG_CONT_COUNT_SEG4_C DFES_DTCM.DFC_ComFrbd_635h_HVBAT_PST_CONT_COUNT_SEG1_C DFES_DTCM.DFC_ComFrbd_635h_HVBAT_PST_CONT_COUNT_SEG3_C DFES_DTCM.DFC_ComFrbd_635h_HVBAT_PST_CONT_COUNT_SEG4_C DFES_DTCM.DFC_ComFrbd_645h_HVBAT_PRECHRGE_CONT_COUNT_SEG1_C DFES_DTCM.DFC_ComFrbd_645h_HVBAT_PRECHRGE_CONT_COUNT_SEG2_C DFES_DTCM.DFC_ComFrbd_675h_HVBAT_REMAININGBATTCAPACITY_C DFES_DTCM.DFC_ComInvld_205h_HVBAT_CHARGING_STATUS_C DFES_DTCM.DFC_ComInvld_205h_HVBAT_PACK_CURRENT_C DFES_DTCM.DFC_ComInvld_205h_HVBAT_SOC_DISPLAY_C DFES_DTCM.DFC_ComInvld_205h_HVBAT_VOLTAGE_C DFES_DTCM.DFC_ComInvld_217h_INV_DC_BUS_VOLTAGE_C DFES_DTCM.DFC_ComInvld_217h_INV_MTR_ACTUAL_TRQ_C DFES_DTCM.DFC_ComInvld_217h_INV_MTR_SPEED_C DFES_DTCM.DFC_ComInvld_217h_INV_MTR_TRQ_C DFES_DTCM.DFC_ComInvld_227h_INV_DC_CURRENT_C DFES_DTCM.DFC_ComInvld_227h_INV_MOTORING_PEAK_TRQ_C DFES_DTCM.DFC_ComInvld_227h_INV_MTR_INST_INPUT_POWER_C DFES_DTCM.DFC_ComInvld_227h_INV_REGEN_PEAK_TRQ_C DFES_DTCM.DFC_ComInvld_237h_INV_ACTIVE_DISCHARGE_STATUS_C DFES_DTCM.DFC_ComInvld_237h_INV_FAULT_LEVEL_C DFES_DTCM.DFC_ComInvld_237h_INV_STAB_MIN_TRQ_C DFES_DTCM.DFC_ComInvld_259h_TGLM_MODE_PUSH_C DFES_DTCM.DFC_ComInvld_259h_TOGGLE_MONOSTABLE_POS_C DFES_DTCM.DFC_ComInvld_26h_AC_SWITCH_REQ_C DFES_DTCM.DFC_ComInvld_26h_BLOWER_POSITION_C DFES_DTCM.DFC_ComInvld_26h_EVAP_SENSOR_FAULT_C DFES_DTCM.DFC_ComInvld_26h_EVAP_SENSOR_VALUE_C DFES_DTCM.DFC_ComInvld_26h_POTENTIOMETER_FAULT_C DFES_DTCM.DFC_ComInvld_26h_REAR_DEFOG_REQ_C DFES_DTCM.DFC_ComInvld_26h_TEMP_POSITION_C DFES_DTCM.DFC_ComInvld_273h_OBC_FAULT_LEVEL_C DFES_DTCM.DFC_ComInvld_273h_OBC_outputpower_capability_C DFES_DTCM.DFC_ComInvld_275h_HVBAT_DISCHARGE_30S_AVAILABLE_CURRENT_C DFES_DTCM.DFC_ComInvld_275h_HVBAT_DISCHARGE_30S_AVAILABLE_POWER_C DFES_DTCM.DFC_ComInvld_283h_DCDC_IN_CURRENT_C DFES_DTCM.DFC_ComInvld_283h_DCDC_IN_VOLTAGE_C DFES_DTCM.DFC_ComInvld_283h_DCDC_OUT_CURRENT_C DFES_DTCM.DFC_ComInvld_283h_DCDC_OUT_VOLTAGE_C DFES_DTCM.DFC_ComInvld_285h_HVBAT_REGEN_CHG_30S_CURRENT_LIMIT_C DFES_DTCM.DFC_ComInvld_285h_HVBAT_REGEN_CHRG_30S_POWER_LIMIT_C DFES_DTCM.DFC_ComInvld_293h_DCDC_FAULT_LEVEL_C DFES_DTCM.DFC_ComInvld_293h_DCDC_outputpower_capability_C DFES_DTCM.DFC_ComInvld_325h_HVBAT_EPLUG_STATUS_C DFES_DTCM.DFC_ComInvld_325h_HVBAT_HVIL_STS_C DFES_DTCM.DFC_ComInvld_325h_HVBAT_INSULATION_FAULT_C DFES_DTCM.DFC_ComInvld_325h_HVBAT_INSULATION_RESISTANCE_C DFES_DTCM.DFC_ComInvld_325h_HVBAT_TEMPERATURE_C DFES_DTCM.DFC_ComInvld_335h_HVBAT_CHRG_CONTINUOUS_CURR_MAX_C DFES_DTCM.DFC_ComInvld_335h_HVBAT_CHRG_COTINUOUS_CURR_REQ_C DFES_DTCM.DFC_ComInvld_335h_HVBAT_CHRG_MAX_VOLT_C DFES_DTCM.DFC_ComInvld_335h_HVBAT_DC_BUS_VOLTAGE_C DFES_DTCM.DFC_ComInvld_38Dh_VITESSE_VEHICULE_ROUES_C DFES_DTCM.DFC_ComInvld_38Dh_VVH_INDISP_C DFES_DTCM.DFC_ComInvld_427h_INV_COOLANT_TEMP_C DFES_DTCM.DFC_ComInvld_427h_INV_MOTOR_TEMP_C DFES_DTCM.DFC_ComInvld_427h_INV_OP_MODE_C DFES_DTCM.DFC_ComInvld_427h_INV_PERMISIBLE_TORQUE_C DFES_DTCM.DFC_ComInvld_427h_INV_TEMP_C DFES_DTCM.DFC_ComInvld_432h_REVEIL_PRINCIPAL_C DFES_DTCM.DFC_ComInvld_435h_HVBAT_MAX_CELL_VOLT_C DFES_DTCM.DFC_ComInvld_435h_HVBAT_MAX_CELL_VOLT_NUM_C DFES_DTCM.DFC_ComInvld_435h_HVBAT_MAX_SENSOR_TEMP_C DFES_DTCM.DFC_ComInvld_435h_HVBAT_MIN_CELL_VOLT_C DFES_DTCM.DFC_ComInvld_435h_HVBAT_MIN_CELL_VOLT_NUM_C DFES_DTCM.DFC_ComInvld_442h_BCCM_BLOWER_RELAY_STS_C DFES_DTCM.DFC_ComInvld_453h_OBC_IN_CURRENT_C DFES_DTCM.DFC_ComInvld_453h_OBC_IN_VOLTAGE_C DFES_DTCM.DFC_ComInvld_453h_OBC_IP_POWER_C DFES_DTCM.DFC_ComInvld_455h_HVBAT_NOMINAL_VOLTAGE_C DFES_DTCM.DFC_ComInvld_463h_OBC_OUT_CURRENT_C DFES_DTCM.DFC_ComInvld_463h_OBC_OUT_VOLTAGE_C DFES_DTCM.DFC_ComInvld_463h_OBC_TEMPERATURE_C DFES_DTCM.DFC_ComInvld_473h_DCDC_Coolant_Temperature_C DFES_DTCM.DFC_ComInvld_473h_DCDC_TEMPERATURE_C DFES_DTCM.DFC_ComInvld_47Bh_eCOMP_BusBarCurrent_C DFES_DTCM.DFC_ComInvld_47Bh_eCOMP_BusBarVoltage_C DFES_DTCM.DFC_ComInvld_47Bh_eCOMP_CompressorSpeed_C DFES_DTCM.DFC_ComInvld_47Bh_eCOMP_IGBT_Temp_C DFES_DTCM.DFC_ComInvld_47Bh_eCOMP_PeakPhaCurrent_C DFES_DTCM.DFC_ComInvld_47Bh_eCOMP_Power_consumption_C DFES_DTCM.DFC_ComInvld_4F2h_STATUS_SOC_C DFES_DTCM.DFC_ComInvld_4F2h_TEMP_BATT_STATUS_C DFES_DTCM.DFC_ComInvld_4F2h_VALEUR_SOC_ETENDUE_C DFES_DTCM.DFC_ComInvld_535h_HV_BATT_TEMP_AVG_C DFES_DTCM.DFC_ComInvld_543h_HVBAT_RESTBATTENERGY_C DFES_DTCM.DFC_ComInvld_543h_HVBAT_SOH_C DFES_DTCM.DFC_ComInvld_543h_HV_BATT_SOH_RES_C DFES_DTCM.DFC_ComInvld_552h_CPT_TEMPOREL_C DFES_DTCM.DFC_ComInvld_552h_KILOMETRAGE_C DFES_DTCM.DFC_ComInvld_583h_HV_BATT_DISCONT_CSE_OPEN_C DFES_DTCM.DFC_ComInvld_592h_CALIBRE_IBATT_C DFES_DTCM.DFC_ComInvld_592h_IBATT_1_C DFES_DTCM.DFC_ComInvld_592h_IBATT_2_C DFES_DTCM.DFC_ComInvld_592h_IBATT_3_C DFES_DTCM.DFC_ComInvld_592h_TEMP_BATT_C DFES_DTCM.DFC_ComInvld_592h_U_BATT_BECB_C DFES_DTCM.DFC_ComInvld_595h_HVBAT_TIME_TO_CHRG_80_C DFES_DTCM.DFC_ComInvld_5B2h_TEMP_AIR_EXT_C DFES_DTCM.DFC_ComInvld_5B5h_HVBAT_THERMAL_RUNAWAY_C DFES_DTCM.DFC_ComInvld_635h_HVBAT_NEG_CONT_COUNT_SEG1_C DFES_DTCM.DFC_ComInvld_635h_HVBAT_NEG_CONT_COUNT_SEG3_C DFES_DTCM.DFC_ComInvld_635h_HVBAT_NEG_CONT_COUNT_SEG4_C DFES_DTCM.DFC_ComInvld_635h_HVBAT_PST_CONT_COUNT_SEG1_C DFES_DTCM.DFC_ComInvld_635h_HVBAT_PST_CONT_COUNT_SEG3_C DFES_DTCM.DFC_ComInvld_635h_HVBAT_PST_CONT_COUNT_SEG4_C DFES_DTCM.DFC_ComInvld_645h_HVBAT_PRECHRGE_CONT_COUNT_SEG1_C DFES_DTCM.DFC_ComInvld_645h_HVBAT_PRECHRGE_CONT_COUNT_SEG2_C DFES_DTCM.DFC_ComInvld_675h_HVBAT_REMAININGBATTCAPACITY_C DFES_DTCM.DFC_ACCmprFltLvl1_C DFES_DTCM.DFC_ACCmprFltLvl2_C DFES_DTCM.DFC_ACCmprFltLvl3_C DFES_DTCM.DFC_ACCmprFltLvl4_C DFES_DTCM.DFC_ACCmprHiPFlt_C DFES_DTCM.DFC_ACCmprInvldCmprSt_C DFES_DTCM.DFC_ACCmprInvldElecActPwr_C DFES_DTCM.DFC_ACCmprLoPFlt_C DFES_DTCM.DFC_AcChrgrIntkTSRCMin_C DFES_DTCM.DFC_BattUBMaxBatt_C DFES_DTCM.DFC_BattUBMaxNoBatt_C DFES_DTCM.DFC_BattUBMinBatt_C DFES_DTCM.DFC_BattUBMinNoBatt_C DFES_DTCM.DFC_BattUSRCMax_C DFES_DTCM.DFC_BattUSRCMin_C DFES_DTCM.DFC_BrkBstPHiCautionDfct_C DFES_DTCM.DFC_BrkBstPHiWarnDfct_C DFES_DTCM.DFC_BrkBstPSnsr12PlausDfct_C DFES_DTCM.DFC_BrkBstPSnsr1Scb_C DFES_DTCM.DFC_BrkBstPSnsr1Scg_C DFES_DTCM.DFC_BrkBstPSnsr2Scb_C DFES_DTCM.DFC_BrkBstPSnsr2Scg_C DFES_DTCM.DFC_BrkBstPSnsrMax_C DFES_DTCM.DFC_BrkBstPSnsrMin_C DFES_DTCM.DFC_BrkBstPhyRngChkMax_C DFES_DTCM.DFC_BrkBstPhyRngChkMin_C DFES_DTCM.DFC_BrkBstPmpHsScb_C DFES_DTCM.DFC_BrkBstPmpHsScg_C DFES_DTCM.DFC_BrkBstPmpLsOl_C DFES_DTCM.DFC_BrkBstPmpLsScb_C DFES_DTCM.DFC_BrkBstPmpLsScg_C DFES_DTCM.DFC_CbnHeatgHeatrRlyOpend_C DFES_DTCM.DFC_CbnHeatgHeatrRlyWldd_C DFES_DTCM.DFC_CcsDcIBattExcdd_C DFES_DTCM.DFC_CcsDcIEvseOutDe_C DFES_DTCM.DFC_CcsDcIOutDe_C DFES_DTCM.DFC_CcsDcIOutExcdd_C DFES_DTCM.DFC_CcsDcUOutDe_C DFES_DTCM.DFC_CcsDcUOutExcdd_C DFES_DTCM.DFC_CcsPwrLineChpRstOL_C DFES_DTCM.DFC_CcsPwrLineChpRstOvrTemp_C DFES_DTCM.DFC_CcsPwrLineChpRstSCB_C DFES_DTCM.DFC_CcsPwrLineChpRstSCG_C DFES_DTCM.DFC_CcsPwrLineChpVccEnaOL_C DFES_DTCM.DFC_CcsPwrLineChpVccEnaOvrTemp_C DFES_DTCM.DFC_CcsPwrLineChpVccEnaSCB_C DFES_DTCM.DFC_CcsPwrLineChpVccEnaSCG_C DFES_DTCM.DFC_CcsPwrLineChpVccSRCMin_C DFES_DTCM.DFC_CcsPwrLineComChpTSRCMin_C DFES_DTCM.DFC_CtPSwtActrOL_C DFES_DTCM.DFC_CtPSwtActrOvrTemp_C DFES_DTCM.DFC_CtPSwtActrSCB_C DFES_DTCM.DFC_CtPSwtActrSCG_C DFES_DTCM.DFC_CtPSwtDiagSRCMin_C DFES_DTCM.DFC_CtpCarrFrqSRCMin_C DFES_DTCM.DFC_DcChrgrIntkT2SRCMin_C DFES_DTCM.DFC_DcChrgrIntkTSRCMin_C DFES_DTCM.DFC_DevLibBattUHi_C DFES_DTCM.DFC_DevLibBattULo_C DFES_DTCM.DFC_EmWakeupSigOL_C DFES_DTCM.DFC_EmWakeupSigOvrTemp_C DFES_DTCM.DFC_EmWakeupSigSCB_C DFES_DTCM.DFC_EmWakeupSigSCG_C DFES_DTCM.DFC_Fan1OL_C DFES_DTCM.DFC_Fan1OvrTemp_C DFES_DTCM.DFC_Fan1SCB_C DFES_DTCM.DFC_FanRlySCB_C DFES_DTCM.DFC_FanRlySCG_C DFES_DTCM.DFC_FanSpdSRCMin_C DFES_DTCM.DFC_FreonPSRCMin_C DFES_DTCM.DFC_HLCCcsPLnCChipTHi_C DFES_DTCM.DFC_HeatrCoreTSRCMin_C DFES_DTCM.DFC_PwmCtPSRCMin_C DFES_DTCM.DFC_PwrDistbnUnitTSRCMin_C DFES_DTCM.DFC_SCtPmp1OL_C DFES_DTCM.DFC_SCtPmp1OvrTemp_C DFES_DTCM.DFC_SCtPmp1SCB_C DFES_DTCM.DFC_SCtPmpRlyOL_C DFES_DTCM.DFC_SCtPmpRlyOvrTemp_C DFES_DTCM.DFC_SCtPmpRlySCB_C DFES_DTCM.DFC_SpplCooltPmpRlyOL_C DFES_DTCM.DFC_SpplCooltPmpRlyOvrTemp_C DFES_DTCM.DFC_SpplCooltPmpRlySCB_C DFES_DTCM.DFC_UCtPSRCMin_C DFES_DTCM.DFC_UPxP1SRCMin_C DFES_DTCM.DFC_ComHSN1CANMute_C DFES_DTCM.DFC_ComHSN3CANMute_C DFES_DTCM.DFC_AcChrgrIntkTPhysRngHi_C DFES_DTCM.DFC_AcChrgrIntkTPhysRngLo_C DFES_DTCM.DFC_AcChrgrIntkTSRCOpn_C DFES_DTCM.DFC_CcsPwrLineChpVccPhysRngHi_C DFES_DTCM.DFC_CcsPwrLineChpVccPhysRngLo_C DFES_DTCM.DFC_CcsPwrLineChpVccSRCOpn_C DFES_DTCM.DFC_CcsPwrLineComChpTPhysRngHi_C DFES_DTCM.DFC_CcsPwrLineComChpTPhysRngLo_C DFES_DTCM.DFC_CcsPwrLineComChpTSRCOpn_C DFES_DTCM.DFC_CtPSwtDiagPhysRngHi_C DFES_DTCM.DFC_CtPSwtDiagPhysRngLo_C DFES_DTCM.DFC_CtPSwtDiagSRCOpn_C DFES_DTCM.DFC_CtpCarrFrqPhysRngHi_C DFES_DTCM.DFC_CtpCarrFrqPhysRngLo_C DFES_DTCM.DFC_CtpCarrFrqSRCMax_C DFES_DTCM.DFC_DcChrgrIntkT2PhysRngHi_C DFES_DTCM.DFC_DcChrgrIntkT2PhysRngLo_C DFES_DTCM.DFC_DcChrgrIntkT2SRCOpn_C DFES_DTCM.DFC_DcChrgrIntkTPhysRngHi_C DFES_DTCM.DFC_DcChrgrIntkTPhysRngLo_C DFES_DTCM.DFC_DcChrgrIntkTSRCOpn_C DFES_DTCM.DFC_Fan1SCG_C DFES_DTCM.DFC_FanSpdPhysRngHi_C DFES_DTCM.DFC_FanSpdPhysRngLo_C DFES_DTCM.DFC_FanSpdSRCOpn_C DFES_DTCM.DFC_FreonPPhysRngHi_C DFES_DTCM.DFC_FreonPPhysRngLo_C DFES_DTCM.DFC_FreonPSRCOpn_C DFES_DTCM.DFC_HeatrCoreTPhysRngHi_C DFES_DTCM.DFC_HeatrCoreTPhysRngLo_C DFES_DTCM.DFC_HeatrCoreTSRCOpn_C DFES_DTCM.DFC_HvGridUMaxSftyLim_C DFES_DTCM.DFC_HvGridUMinSftyLim_C DFES_DTCM.DFC_HvGridUPlausy_C DFES_DTCM.DFC_IntlckChrgPlgHBrgOpnLd_C DFES_DTCM.DFC_IntlckChrgPlgHBrgOvrCurr_C DFES_DTCM.DFC_IntlckChrgPlgHBrgOvrTemp_C DFES_DTCM.DFC_IntlckChrgPlgHBrgShCirBatt1_C DFES_DTCM.DFC_IntlckChrgPlgHBrgShCirBatt2_C DFES_DTCM.DFC_IntlckChrgPlgHBrgShCirGnd1_C DFES_DTCM.DFC_IntlckChrgPlgHBrgShCirGnd2_C DFES_DTCM.DFC_IntlckChrgPlgHBrgShCirOvrLd_C DFES_DTCM.DFC_IntlckChrgPlgHBrgTempOvrCurr_C DFES_DTCM.DFC_IntlckChrgPlgHBrgUndrVltg_C DFES_DTCM.DFC_IntlckChrgPlgPosnRngFlt_C DFES_DTCM.DFC_IntlckChrgPlgPosnSrcMax_C DFES_DTCM.DFC_IntlckChrgPlgPosnSrcMin_C DFES_DTCM.DFC_PwmCtPPhysRngHi_C DFES_DTCM.DFC_PwmCtPPhysRngLo_C DFES_DTCM.DFC_PwmCtPSRCMax_C DFES_DTCM.DFC_PwrDistbnUnitTPhysRngHi_C DFES_DTCM.DFC_PwrDistbnUnitTPhysRngLo_C DFES_DTCM.DFC_PwrDistbnUnitTSRCOpn_C DFES_DTCM.DFC_SCtPmpRlySCG_C DFES_DTCM.DFC_SpplCooltPmpRlySCG_C DFES_DTCM.DFC_UCtPPhysRngHi_C DFES_DTCM.DFC_UCtPPhysRngLo_C DFES_DTCM.DFC_UCtPSRCOpn_C DFES_DTCM.DFC_UPxP1PhysRngHi_C DFES_DTCM.DFC_UPxP1PhysRngLo_C DFES_DTCM.DFC_UPxP1SRCOpn_C DFES_DTCM.DFC_VehVPhysRngHi_C DFES_DTCM.DFC_VehVPhysRngLo_C DFES_DTCM.DFC_VehVSigCan_C DFES_DTCM.DFC_VehVSigCanSafe_C DFES_DTCM.DFC_SCtPmp1DiagGrdKey1_C DFES_DTCM.DFC_SCtPmp1DiagGrdKey2_C DFES_DTCM.DFC_SCtPmp1DiagGrdKey3_C DFES_DTCM.DFC_SCtPmp1DiagGrdKey4_C DFES_DTCM.DFC_SCtPmp1DiagGrdKey5_C DFES_DTCM.DFC_ChrgPlgLiveCntctHzrdCcs_C DFES_DTCM.DFC_ChrgPlgProxPltImps_C DFES_DTCM.DFC_ChrgPlgTHiCcsDc_C DFES_DTCM.DFC_ElMActvDchaFailr_C DFES_DTCM.DFC_ElMActvDchaFlt_C DFES_DTCM.DFC_ElMFbdnIvtrModDrv01_C DFES_DTCM.DFC_ElMImobAuthent_C DFES_DTCM.DFC_ElMIsoMonFlt_C DFES_DTCM.DFC_ElMIsoMonPlausyFlt_C DFES_DTCM.DFC_ElMIvtrCooltT01_C DFES_DTCM.DFC_ElMIvtrEmgyShtDwn01_C DFES_DTCM.DFC_ElMIvtrFailr01_C DFES_DTCM.DFC_ElMIvtrIntlck01_C DFES_DTCM.DFC_ElMIvtrTErr01_C DFES_DTCM.DFC_ElMOverSpdNeg01_C DFES_DTCM.DFC_ElMOverSpdPos01_C DFES_DTCM.DFC_ElMOverTqNeg01_C DFES_DTCM.DFC_ElMOverTqPos01_C DFES_DTCM.DFC_ElMPwrAuthn_C DFES_DTCM.DFC_ElMSpdErr01_C DFES_DTCM.DFC_ElMSvs01_C DFES_DTCM.DFC_PEnvCcMax_C DFES_DTCM.DFC_PEnvCcMin_C DFES_DTCM.DFC_PEnvRngChkMax_C DFES_DTCM.DFC_PEnvRngChkMin_C DFES_DTCM.DFC_PEnvSnsrPlaus_C DFES_DTCM.DFC_BrkBstPmpPlausGenn_C DFES_DTCM.DFC_CbnHeatrRlyLfLoWarn_C DFES_DTCM.DFC_ChgrPlugLockPinByndClsd_C DFES_DTCM.DFC_ChgrPlugLockPinMoveWoCmd_C DFES_DTCM.DFC_ChgrPlugLockPinStuckInClsd_C DFES_DTCM.DFC_ChgrPlugLockPinStuckInOpen_C DFES_DTCM.DFC_ChrgrStErr_C DFES_DTCM.DFC_ComHSN1BusOff_C DFES_DTCM.DFC_ComHSN3BusOff_C DFES_DTCM.DFC_ComVCInval_C DFES_DTCM.DFC_EemDcdcPrecSpdInhb_C DFES_DTCM.DFC_ExpPwrLatch_C DFES_DTCM.DFC_FanMaxOvrd_C DFES_DTCM.DFC_HLCCcsGnrlComErr_C DFES_DTCM.DFC_InmLINNodeHVACPanelAbsnt_C DFES_DTCM.DFC_ResetRcvNotAllwd_C DFES_DTCM.DFC_TelltlCooltPlaus_C DFES_DTCM.DFC_MRlyOL_C DFES_DTCM.DFC_MRlySCB_C DFES_DTCM.DFC_MRlySCG_C DFES_DTCM.DFC_SSpMon1_C DFES_DTCM.DFC_SSpMon1OV_C DFES_DTCM.DFC_SSpMon1SCG_C DFES_DTCM.DFC_SSpMon1UV_C DFES_DTCM.DFC_SSpMon2_C DFES_DTCM.DFC_SSpMon2OV_C DFES_DTCM.DFC_SSpMon2SCG_C DFES_DTCM.DFC_SSpMon2UV_C DFES_DTCM.DFC_SSpMon3_C DFES_DTCM.DFC_SSpMon3OV_C DFES_DTCM.DFC_SSpMon3SCG_C DFES_DTCM.DFC_SSpMon3UV_C DFES_DTCM.DFC_CANSM_E_BUS_OFF_NETWORK_HSN1_CAN_C DFES_DTCM.DFC_CANSM_E_BUS_OFF_NETWORK_HSN3_CAN_C DFES_DTCM.DFC_CANSM_E_BUS_OFF_NETWORK_HSN4_CAN_C DFES_DTCM.DFC_CANSM_E_BUS_OFF_NETWORK_XCP_CAN_C DFES_DTCM.DFC_CANTRCV_E_NO_TRCV_CONTROL_0_C DFES_DTCM.DFC_CAN_E_TIMEOUT_C DFES_DTCM.DFC_COMM_E_NET_START_IND_CHANNEL_0_C DFES_DTCM.DFC_COMM_E_NET_START_IND_CHANNEL_1_C DFES_DTCM.DFC_COMM_E_NET_START_IND_CHANNEL_2_C DFES_DTCM.DFC_COMM_E_NET_START_IND_CHANNEL_3_C DFES_DTCM.DFC_COMM_E_NET_START_IND_CHANNEL_4_C DFES_DTCM.DFC_COMM_E_NET_START_IND_CHANNEL_5_C DFES_DTCM.DFC_LIN_E_TIMEOUT_C DFES_DTCM.DFC_rba_EcuCtrl_TOMaxProlg_C DFES_DTCM.DFC_rba_EcuCtrl_TOMaxShutDwn_C DFES_DTCM.DFC_rba_MultiStackTrace_Threshold_C DFES_DTCM.DFC_rba_SyC_CustStates_Degraded_disord_Event_C DFES_DTCM.DFC_rba_SyC_CustStates_Degraded_incst_Event_C DFES_DTCM.DFC_rba_SyC_CustStates_TransNoWakReq_Event_C DFES_DTCM.DFC_RBA_IOEXTLIB_KEEPALIVE_DRV_C DFES_DTCM.DFC_RBA_IOEXTLIB_KEEPALIVE_INI_C DFES_DTCM.DFC_rba_IoSigRtc_StopCounter_C DFES_DTCM.DFC_rba_MRly_Diag_Stk_Event_C DFES_DTCM.DFC_rba_MemDiag_MemReadErr_C DFES_DTCM.DFC_rba_MemDiag_MemWrErr_C DFES_DTCM.DFC_rba_SyC_IrrSwOffTrigEngRun_Event_C DFES_DTCM.DFC_AcChrgrIntkTSRCMax_C DFES_DTCM.DFC_AcChrgrIntkTTmpErr_C DFES_DTCM.DFC_AcFlt_C DFES_DTCM.DFC_AppAllSnsrDfct_C DFES_DTCM.DFC_BattUPwrFail_C DFES_DTCM.DFC_BrkBstBkupOvrn_C DFES_DTCM.DFC_BrkBstPmpOvld_C DFES_DTCM.DFC_BrkPlausChk_C DFES_DTCM.DFC_CbnHeatgSwtTmpErr_C DFES_DTCM.DFC_CcsPwrLineChpVccSRCMax_C DFES_DTCM.DFC_CcsPwrLineChpVccTmpErr_C DFES_DTCM.DFC_CcsPwrLineComChpTSRCMax_C DFES_DTCM.DFC_CcsPwrLineComChpTTmpErr_C DFES_DTCM.DFC_ChgrPlugCtpCarrFrqErr_C DFES_DTCM.DFC_ChgrPlugCtpSwtStuckClsd_C DFES_DTCM.DFC_ChgrPlugCtpSwtStuckOpen_C DFES_DTCM.DFC_ChgrPlugCtpUErrHi_C DFES_DTCM.DFC_ChgrPlugPxp1SrcErr_C DFES_DTCM.DFC_ChrgCntctAllWldd_C DFES_DTCM.DFC_ChrgCntctNegOperErr_C DFES_DTCM.DFC_ChrgCntctNegOperWarn_C DFES_DTCM.DFC_ChrgCntctNegWldd_C DFES_DTCM.DFC_ChrgCntctPosOperErr_C DFES_DTCM.DFC_ChrgCntctPosOperWarn_C DFES_DTCM.DFC_ChrgCntctPosWldd_C DFES_DTCM.DFC_ChrgCntctStuckOpen_C DFES_DTCM.DFC_ChrgPlgIntlckFaild_C DFES_DTCM.DFC_ChrgnUnplRqrd_C DFES_DTCM.DFC_CoElMOffsCalibActv01_C DFES_DTCM.DFC_CtPSwtDiagSRCMax_C DFES_DTCM.DFC_CtPSwtDiagTmpErr_C DFES_DTCM.DFC_CtpCarrFrqTmpErr_C DFES_DTCM.DFC_DcChrgrIntkT2SRCMax_C DFES_DTCM.DFC_DcChrgrIntkT2TmpErr_C DFES_DTCM.DFC_DcChrgrIntkTSRCMax_C DFES_DTCM.DFC_DcChrgrIntkTTmpErr_C DFES_DTCM.DFC_EChrDvPlinCntrThdExcdd_C DFES_DTCM.DFC_EemDiagCtctrClsTout_C DFES_DTCM.DFC_EemDiagDcdcOffTOut_C DFES_DTCM.DFC_EemDiagHvCnsrOffTOut_C DFES_DTCM.DFC_EemDiagHvbOffTOut_C DFES_DTCM.DFC_FanSpdSRCMax_C DFES_DTCM.DFC_FanSpdTmpErr_C DFES_DTCM.DFC_FreonPSRCMax_C DFES_DTCM.DFC_FreonPTmpErr_C DFES_DTCM.DFC_HeatrCoreTSRCMax_C DFES_DTCM.DFC_HeatrCoreTTmpErr_C DFES_DTCM.DFC_HvGridSocMinLim_C DFES_DTCM.DFC_HvacBlwrFrntFlt_C DFES_DTCM.DFC_HvacEvapElecFlt_C DFES_DTCM.DFC_HvacEvapElecFltGnd_C DFES_DTCM.DFC_HvacKnobPosnFlt_C DFES_DTCM.DFC_InvBinID_C DFES_DTCM.DFC_InvCalID_C DFES_DTCM.DFC_InvErotan_C DFES_DTCM.DFC_InvVinID_C DFES_DTCM.DFC_MOXEMM_SMU_ALM0_0_C DFES_DTCM.DFC_MOXEMM_SMU_ALM0_1_C DFES_DTCM.DFC_MOXEMM_SMU_ALM0_10_C DFES_DTCM.DFC_MOXEMM_SMU_ALM0_11_C DFES_DTCM.DFC_MOXEMM_SMU_ALM0_13_C DFES_DTCM.DFC_MOXEMM_SMU_ALM0_14_C DFES_DTCM.DFC_MOXEMM_SMU_ALM0_2_C DFES_DTCM.DFC_MOXEMM_SMU_ALM0_22_C DFES_DTCM.DFC_MOXEMM_SMU_ALM0_23_C DFES_DTCM.DFC_MOXEMM_SMU_ALM0_4_C DFES_DTCM.DFC_MOXEMM_SMU_ALM0_5_C DFES_DTCM.DFC_MOXEMM_SMU_ALM0_7_C DFES_DTCM.DFC_MOXEMM_SMU_ALM0_8_C DFES_DTCM.DFC_MOXEMM_SMU_ALM10_16_C DFES_DTCM.DFC_MOXEMM_SMU_ALM10_17_C DFES_DTCM.DFC_MOXEMM_SMU_ALM10_21_C DFES_DTCM.DFC_MOXEMM_SMU_ALM11_0_C DFES_DTCM.DFC_MOXEMM_SMU_ALM11_1_C DFES_DTCM.DFC_MOXEMM_SMU_ALM11_2_C DFES_DTCM.DFC_MOXEMM_SMU_ALM11_3_C DFES_DTCM.DFC_MOXEMM_SMU_ALM11_4_C DFES_DTCM.DFC_MOXEMM_SMU_ALM11_5_C DFES_DTCM.DFC_MOXEMM_SMU_ALM11_8_C DFES_DTCM.DFC_MOXEMM_SMU_ALM11_9_C DFES_DTCM.DFC_MOXEMM_SMU_ALM1_0_C DFES_DTCM.DFC_MOXEMM_SMU_ALM1_1_C DFES_DTCM.DFC_MOXEMM_SMU_ALM1_10_C DFES_DTCM.DFC_MOXEMM_SMU_ALM1_11_C DFES_DTCM.DFC_MOXEMM_SMU_ALM1_13_C DFES_DTCM.DFC_MOXEMM_SMU_ALM1_14_C DFES_DTCM.DFC_MOXEMM_SMU_ALM1_2_C DFES_DTCM.DFC_MOXEMM_SMU_ALM1_22_C DFES_DTCM.DFC_MOXEMM_SMU_ALM1_23_C DFES_DTCM.DFC_MOXEMM_SMU_ALM1_4_C DFES_DTCM.DFC_MOXEMM_SMU_ALM1_5_C DFES_DTCM.DFC_MOXEMM_SMU_ALM1_7_C DFES_DTCM.DFC_MOXEMM_SMU_ALM1_8_C DFES_DTCM.DFC_MOXEMM_SMU_ALM21_0_C DFES_DTCM.DFC_MOXEMM_SMU_ALM21_16_C DFES_DTCM.DFC_MOXEMM_SMU_ALM21_3_C DFES_DTCM.DFC_MOXEMM_SMU_ALM2_1_C DFES_DTCM.DFC_MOXEMM_SMU_ALM2_10_C DFES_DTCM.DFC_MOXEMM_SMU_ALM2_11_C DFES_DTCM.DFC_MOXEMM_SMU_ALM2_13_C DFES_DTCM.DFC_MOXEMM_SMU_ALM2_14_C DFES_DTCM.DFC_MOXEMM_SMU_ALM2_22_C DFES_DTCM.DFC_MOXEMM_SMU_ALM2_23_C DFES_DTCM.DFC_MOXEMM_SMU_ALM2_4_C DFES_DTCM.DFC_MOXEMM_SMU_ALM2_5_C DFES_DTCM.DFC_MOXEMM_SMU_ALM2_7_C DFES_DTCM.DFC_MOXEMM_SMU_ALM2_8_C DFES_DTCM.DFC_MOXEMM_SMU_ALM6_0_C DFES_DTCM.DFC_MOXEMM_SMU_ALM6_11_C DFES_DTCM.DFC_MOXEMM_SMU_ALM6_12_C DFES_DTCM.DFC_MOXEMM_SMU_ALM6_14_C DFES_DTCM.DFC_MOXEMM_SMU_ALM6_15_C DFES_DTCM.DFC_MOXEMM_SMU_ALM6_17_C DFES_DTCM.DFC_MOXEMM_SMU_ALM6_18_C DFES_DTCM.DFC_MOXEMM_SMU_ALM6_20_C DFES_DTCM.DFC_MOXEMM_SMU_ALM6_21_C DFES_DTCM.DFC_MOXEMM_SMU_ALM6_25_C DFES_DTCM.DFC_MOXEMM_SMU_ALM6_4_C DFES_DTCM.DFC_MOXEMM_SMU_ALM6_5_C DFES_DTCM.DFC_MOXEMM_SMU_ALM6_7_C DFES_DTCM.DFC_MOXEMM_SMU_ALM6_8_C DFES_DTCM.DFC_MOXEMM_SMU_ALM7_1_C DFES_DTCM.DFC_MOXEMM_SMU_ALM7_12_C DFES_DTCM.DFC_MOXEMM_SMU_ALM7_13_C DFES_DTCM.DFC_MOXEMM_SMU_ALM7_14_C DFES_DTCM.DFC_MOXEMM_SMU_ALM7_15_C DFES_DTCM.DFC_MOXEMM_SMU_ALM7_16_C DFES_DTCM.DFC_MOXEMM_SMU_ALM7_17_C DFES_DTCM.DFC_MOXEMM_SMU_ALM7_2_C DFES_DTCM.DFC_MOXEMM_SMU_ALM7_20_C DFES_DTCM.DFC_MOXEMM_SMU_ALM7_25_C DFES_DTCM.DFC_MOXEMM_SMU_ALM7_26_C DFES_DTCM.DFC_MOXEMM_SMU_ALM7_28_C DFES_DTCM.DFC_MOXEMM_SMU_ALM7_29_C DFES_DTCM.DFC_MOXEMM_SMU_ALM7_30_C DFES_DTCM.DFC_MOXEMM_SMU_ALM7_31_C DFES_DTCM.DFC_MOXEMM_SMU_ALM8_0_C DFES_DTCM.DFC_MOXEMM_SMU_ALM8_1_C DFES_DTCM.DFC_MOXEMM_SMU_ALM8_10_C DFES_DTCM.DFC_MOXEMM_SMU_ALM8_11_C DFES_DTCM.DFC_MOXEMM_SMU_ALM8_12_C DFES_DTCM.DFC_MOXEMM_SMU_ALM8_16_C DFES_DTCM.DFC_MOXEMM_SMU_ALM8_18_C DFES_DTCM.DFC_MOXEMM_SMU_ALM8_2_C DFES_DTCM.DFC_MOXEMM_SMU_ALM8_3_C DFES_DTCM.DFC_MOXEMM_SMU_ALM8_31_C DFES_DTCM.DFC_MOXEMM_SMU_ALM8_4_C DFES_DTCM.DFC_MOXEMM_SMU_ALM9_0_C DFES_DTCM.DFC_MOXEMM_SMU_ALM9_15_C DFES_DTCM.DFC_MOXEMM_SMU_ALM9_3_C DFES_DTCM.DFC_MoCADCNTPBnk1_C DFES_DTCM.DFC_MoCADCTestVoltBnk1_C DFES_DTCM.DFC_MoCSOPICO_C DFES_DTCM.DFC_MoFAccr_C DFES_DTCM.DFC_MoFCbnPreCdngOvrheat_C DFES_DTCM.DFC_MoFCbnPreCdngTmrExpi_C DFES_DTCM.DFC_MoFEvMngtBms_C DFES_DTCM.DFC_MoFEvMngtDcdc_C DFES_DTCM.DFC_MoFEvMngtEm01_C DFES_DTCM.DFC_MoFEvMngtEm01BrkgToZr_C DFES_DTCM.DFC_MoFEvMngtEm01EngSpd_C DFES_DTCM.DFC_MoFEvMngtEm02EngSpd_C DFES_DTCM.DFC_MoFEvMngtEm02Lvl1_C DFES_DTCM.DFC_MoFEvMngtEm02Lvl2_C DFES_DTCM.DFC_MoFExtCptAuxCpt_C DFES_DTCM.DFC_MoFExtCptVacPmpErr_C DFES_DTCM.DFC_MoFTqPtdAxle_C DFES_DTCM.DFC_MoFTqPtdAxleSec_C DFES_DTCM.DFC_MoFTqPtdEmPtRels_C DFES_DTCM.DFC_MoFTqPtdEmPtRelsSec_C DFES_DTCM.DFC_MoFTqPtdEmSign_C DFES_DTCM.DFC_MoFTqPtdEmSignSec_C DFES_DTCM.DFC_MoFTqPtdEmTq_C DFES_DTCM.DFC_MoFTqPtdEmTqSec_C DFES_DTCM.DFC_MoFTqPtdVeh_C DFES_DTCM.DFC_MoFVarPostBldSel_C DFES_DTCM.DFC_MoSysCtrlReIni_C DFES_DTCM.DFC_MoXEMMHwLTMCUFW_C DFES_DTCM.DFC_MoXEMMHwLTMonBIST_C DFES_DTCM.DFC_MoXEMMHwLTRegMonTest_C DFES_DTCM.DFC_MoXEMMHwLTStbySMUAlvTest_C DFES_DTCM.DFC_MoXEMMHwLTTempSens_C DFES_DTCM.DFC_MoXEMMHwLTUCBCfg_C DFES_DTCM.DFC_MonEgyChrgnCoorr_AcChrgnWoMofRels_C DFES_DTCM.DFC_MonEgyChrgnCoorr_ChrgnAbortIgr_C DFES_DTCM.DFC_MonEgyChrgnCoorr_DcCntctFailr_C DFES_DTCM.DFC_MonEgyChrgnCoorr_ExtChrgnShtOffReq_C DFES_DTCM.DFC_MonEgyChrgnCoorr_ImpsChrgnMod_C DFES_DTCM.DFC_MonEgyChrgnCoorr_ImpsChrgnPrms_C DFES_DTCM.DFC_MonEgyChrgnCoorr_ImpsUDcIntk_C DFES_DTCM.DFC_MonEgyChrgnCoorr_PlgLockMovmt_C DFES_DTCM.DFC_MonEgyChrgnCoorr_VehCrashDetn_C DFES_DTCM.DFC_MonEgyChrgnErrReactn_SftySwt_C DFES_DTCM.DFC_MonEgyChrgnInlet_CcsPlgCtp_C DFES_DTCM.DFC_MonEgyChrgnInlet_CcsPlgCtpPwm_C DFES_DTCM.DFC_MonEgyChrgnInlet_CcsPlgLockCtrlImpsAtmpt_C DFES_DTCM.DFC_MonEgyChrgnInlet_CcsPlgLockSnsrSigRngChk_C DFES_DTCM.DFC_MonEgyChrgnInlet_CcsPlgLockStImps_C DFES_DTCM.DFC_MonEgyChrgnInlet_CcsPlgPxp_C DFES_DTCM.DFC_MonEgyChrgnT_Snsr1GrdtChk_C DFES_DTCM.DFC_MonEgyChrgnT_Snsr1SigRngChk_C DFES_DTCM.DFC_MonEgyChrgnT_Snsr2GrdtChk_C DFES_DTCM.DFC_MonEgyChrgnT_Snsr2SigRngChk_C DFES_DTCM.DFC_MonEgyChrgnT_SnsrDif_C DFES_DTCM.DFC_OCWDAABEActv_C DFES_DTCM.DFC_OCWDACom_C DFES_DTCM.DFC_OCWDAErrPin_C DFES_DTCM.DFC_OCWDAOvrVltg_C DFES_DTCM.DFC_PUmax_C DFES_DTCM.DFC_PwmCtPTmpErr_C DFES_DTCM.DFC_PwrDistbnUnitTSRCMax_C DFES_DTCM.DFC_PwrDistbnUnitTTmpErr_C DFES_DTCM.DFC_SCtPmp1DiagGrdKeyErr_C DFES_DTCM.DFC_SRCHighAPP1_C DFES_DTCM.DFC_SRCHighAPP2_C DFES_DTCM.DFC_SRCLowAPP1_C DFES_DTCM.DFC_SRCLowAPP2_C DFES_DTCM.DFC_SWReset_0_C DFES_DTCM.DFC_SWReset_1_C DFES_DTCM.DFC_SWReset_2_C DFES_DTCM.DFC_Sia_InvldCode_C DFES_DTCM.DFC_Sia_InvldKey_C DFES_DTCM.DFC_Sia_NoRespUCx_C DFES_DTCM.DFC_Sia_TprotRttp_C DFES_DTCM.DFC_StrtUpEvStandStillDeactvn_C DFES_DTCM.DFC_SyncAPP_C DFES_DTCM.DFC_UCtPSRCMax_C DFES_DTCM.DFC_UCtPTmpErr_C DFES_DTCM.DFC_UPxP1SRCMax_C DFES_DTCM.DFC_UPxP1TmpErr_C DFES_DTCM.DFC_VehVObd_C DFES_DTCO.DFC_Unused_C DFES_DTCO.DFC_ACCmprFltLvlRes_C DFES_DTCO.DFC_AbgHiSigFlt_C DFES_DTCO.DFC_AbgIntPatFlt_C DFES_DTCO.DFC_AbgLoSigFlt_C DFES_DTCO.DFC_AbgUnkwnErrSigFlt_C DFES_DTCO.DFC_AcExtChrgrIBattExcdd_C DFES_DTCO.DFC_AcExtChrgrIInExcdd_C DFES_DTCO.DFC_AcExtChrgrIOutDe_C DFES_DTCO.DFC_AcExtChrgrIOutExcdd_C DFES_DTCO.DFC_AcExtChrgrUOutDe_C DFES_DTCO.DFC_AdpActvDChaFailr_C DFES_DTCO.DFC_AirbcuFlt_C DFES_DTCO.DFC_Airbg_C DFES_DTCO.DFC_AirbgCan_C DFES_DTCO.DFC_AirbgCanHWPlaus_C DFES_DTCO.DFC_AirbgHWCanPlaus_C DFES_DTCO.DFC_AirbgMnr_C DFES_DTCO.DFC_AirbgPerHi_C DFES_DTCO.DFC_AirbgPerdRngFlt_C DFES_DTCO.DFC_BlowrRlyErr_C DFES_DTCO.DFC_BrkBstPmpActtnDfct_C DFES_DTCO.DFC_BrkBstPmpDeactvnDfct_C DFES_DTCO.DFC_BrkSwtFlt_C DFES_DTCO.DFC_CbnHeatgHeatrHsScb_C DFES_DTCO.DFC_CbnHeatgHeatrHsScg_C DFES_DTCO.DFC_CbnHeatgHeatrLsOl_C DFES_DTCO.DFC_CbnHeatgHeatrLsScb_C DFES_DTCO.DFC_CbnHeatgHeatrLsScg_C DFES_DTCO.DFC_CbnHeatgHeatrUnUsed_C DFES_DTCO.DFC_ChrgnCntctHsOt_C DFES_DTCO.DFC_ChrgnCntctHsScb_C DFES_DTCO.DFC_ChrgnCntctHsScg_C DFES_DTCO.DFC_ChrgnCntctLsNegOl_C DFES_DTCO.DFC_ChrgnCntctLsNegOt_C DFES_DTCO.DFC_ChrgnCntctLsNegScb_C DFES_DTCO.DFC_ChrgnCntctLsNegScg_C DFES_DTCO.DFC_ChrgnCntctLsPosOl_C DFES_DTCO.DFC_ChrgnCntctLsPosOt_C DFES_DTCO.DFC_ChrgnCntctLsPosScb_C DFES_DTCO.DFC_ChrgnCntctLsPosScg_C DFES_DTCO.DFC_ChrgnCntctUnUsed_C DFES_DTCO.DFC_ComBrkMai_C DFES_DTCO.DFC_ComChrgrEVCont_C DFES_DTCO.DFC_ComChrgrEVtBlink_C DFES_DTCO.DFC_ComChrgrMstBlink_C DFES_DTCO.DFC_ComChrgrMstCont_C DFES_DTCO.DFC_ComChrgrSVSBlink_C DFES_DTCO.DFC_ComChrgrSVSCont_C DFES_DTCO.DFC_ComDcdcEVBlink_C DFES_DTCO.DFC_ComDcdcEVCont_C DFES_DTCO.DFC_ComDcdcFltLvl2_C DFES_DTCO.DFC_ComDcdcFltLvl3_C DFES_DTCO.DFC_ComDcdcFltLvl4_C DFES_DTCO.DFC_ComDcdcFltLvl5_C DFES_DTCO.DFC_ComDcdcFltLvlRes_C DFES_DTCO.DFC_ComDcdcMstBlink_C DFES_DTCO.DFC_ComDcdcMstCont_C DFES_DTCO.DFC_ComDcdcSVSBlink_C DFES_DTCO.DFC_ComDcdcSVSCont_C DFES_DTCO.DFC_ComElMIIvtrFltLvl2_C DFES_DTCO.DFC_ComElMIIvtrFltLvl3_C DFES_DTCO.DFC_ComElMIIvtrFltLvl4_C DFES_DTCO.DFC_ComElMIIvtrFltLvl5_C DFES_DTCO.DFC_ComElMIIvtrFltLvlRes_C DFES_DTCO.DFC_ComEmacEVBlink_C DFES_DTCO.DFC_ComEmacEVCont_C DFES_DTCO.DFC_ComEmacMstCont_C DFES_DTCO.DFC_ComEmacMsttBlink_C DFES_DTCO.DFC_ComEmacSVSBlink_C DFES_DTCO.DFC_ComEmacSVSCont_C DFES_DTCO.DFC_ComGunCntInfoWkuReq_C DFES_DTCO.DFC_ComHillHldFlt_C DFES_DTCO.DFC_ComHvBattRchrgWkuReq_C DFES_DTCO.DFC_ComHvbFltLvl2_C DFES_DTCO.DFC_ComHvbFltLvl3_C DFES_DTCO.DFC_ComHvbFltLvl4_C DFES_DTCO.DFC_ComHvbFltLvl5_C DFES_DTCO.DFC_ComHvbFltLvlRes_C DFES_DTCO.DFC_ComHvbMstBlink_C DFES_DTCO.DFC_ComHvbMstCont_C DFES_DTCO.DFC_ComImmoUnlockWkuReq_C DFES_DTCO.DFC_ComInfoReqPtlWkuReq_C DFES_DTCO.DFC_ComOBCFltLvl2_C DFES_DTCO.DFC_ComOBCFltLvl3_C DFES_DTCO.DFC_ComOBCFltLvl4_C DFES_DTCO.DFC_ComOBCFltLvl5_C DFES_DTCO.DFC_ComOBCFltLvlRes_C DFES_DTCO.DFC_ComPostOperationWkuReq_C DFES_DTCO.DFC_ComPreCondElecWkuReq_C DFES_DTCO.DFC_ComRemUnlckWkuReq_C DFES_DTCO.DFC_ComStpDlyHMIWkuReq_C DFES_DTCO.DFC_ComflgCurMeasmtErr_C DFES_DTCO.DFC_ComflgCurMeasmtSysErr_C DFES_DTCO.DFC_ComflgCurMeasmtVld_C DFES_DTCO.DFC_ComflgCurRngErr_C DFES_DTCO.DFC_ComflgTPcbMeasmtErr_C DFES_DTCO.DFC_ComflgTPcbMeasmtVld_C DFES_DTCO.DFC_ComflgTPcbRngErr_C DFES_DTCO.DFC_ComflgTPcbSysErr_C DFES_DTCO.DFC_ComflgTShntMeasmtErr_C DFES_DTCO.DFC_ComflgTShntMeasmtVld_C DFES_DTCO.DFC_ComflgTShntRngErr_C DFES_DTCO.DFC_ComflgTShntSysErr_C DFES_DTCO.DFC_ComflgVoltMeasmtErr_C DFES_DTCO.DFC_ComflgVoltMeasmtSysErr_C DFES_DTCO.DFC_ComflgVoltMeasmtVld_C DFES_DTCO.DFC_ComflgVoltRngErr_C DFES_DTCO.DFC_CrashEveOcc_C DFES_DTCO.DFC_DcdcFwdModStuck_C DFES_DTCO.DFC_DcdcLvUDifMaxFlt_C DFES_DTCO.DFC_DcdcOffModStuck_C DFES_DTCO.DFC_DcdcOperModFailr_C DFES_DTCO.DFC_DcdcPrecModStuck_C DFES_DTCO.DFC_DrvDoorOpn_C DFES_DTCO.DFC_DrvModPosnDfct_C DFES_DTCO.DFC_DrvStbltOpn_C DFES_DTCO.DFC_ETogFailrLvl3_C DFES_DTCO.DFC_ETogFailrLvl4_C DFES_DTCO.DFC_EbsLvBattSocDiagLo_C DFES_DTCO.DFC_EbsLvBattUDiagDiOper_C DFES_DTCO.DFC_EbsLvBattUDiagFltLvl1_C DFES_DTCO.DFC_EbsLvBattUDiagFltLvl2_C DFES_DTCO.DFC_EbsLvBattUDiagLo_C DFES_DTCO.DFC_EbsSnsrSt_C DFES_DTCO.DFC_EbsSofASILErr_C DFES_DTCO.DFC_ElTSPtSysLimDrvErr_C DFES_DTCO.DFC_ElTSPtSysLimRgnErr_C DFES_DTCO.DFC_HLCCcsFwDwnl_C DFES_DTCO.DFC_HvBattChrgPwrMax_C DFES_DTCO.DFC_HvBattCrashDetd_C DFES_DTCO.DFC_HvBattDchaPwrMax_C DFES_DTCO.DFC_HvBattEmgyOff_C DFES_DTCO.DFC_HvBattEmgyOffIntlck_C DFES_DTCO.DFC_HvBattEmgyOffReq_C DFES_DTCO.DFC_HvBattFltMod_C DFES_DTCO.DFC_HvBattIReqToChrgrErr_C DFES_DTCO.DFC_HvBattIReqToChrgrIni_C DFES_DTCO.DFC_HvBattIninTout_C DFES_DTCO.DFC_HvBattIntlckSt_C DFES_DTCO.DFC_HvBattIsoFlt_C DFES_DTCO.DFC_HvBattLimdPwr_C DFES_DTCO.DFC_HvBattMaiSwtClsngFlt_C DFES_DTCO.DFC_HvBattMaiSwtFlt_C DFES_DTCO.DFC_HvBattMaiSwtOpen_C DFES_DTCO.DFC_HvBattMaiSwtOpngFlt_C DFES_DTCO.DFC_HvBattMaiSwtWldd_C DFES_DTCO.DFC_HvBattNegCntctrCntErr_C DFES_DTCO.DFC_HvBattOperModChrgPlausy_C DFES_DTCO.DFC_HvBattOverTDern_C DFES_DTCO.DFC_HvBattPosCntctrCntErr_C DFES_DTCO.DFC_HvBattPrecCntctrCntErr_C DFES_DTCO.DFC_HvBattPwrDistbnTDern_C DFES_DTCO.DFC_HvBattPwrDistbnTInhbn_C DFES_DTCO.DFC_HvBattRatRSohErr_C DFES_DTCO.DFC_HvBattRatSohErr_C DFES_DTCO.DFC_HvBattSngIsoWarn_C DFES_DTCO.DFC_HvBattSrvPlgDiscnct_C DFES_DTCO.DFC_HvBattUNomChrgnErr_C DFES_DTCO.DFC_HvBattUNomChrgnIni_C DFES_DTCO.DFC_HvBattUnderTDern_C DFES_DTCO.DFC_HvbEVLmpBlink_C DFES_DTCO.DFC_HvbEVLmpCont_C DFES_DTCO.DFC_HvbSVSBlink_C DFES_DTCO.DFC_HvbSVSCont_C DFES_DTCO.DFC_InmLINBusBlk_C DFES_DTCO.DFC_PDUProgmFailr_C DFES_DTCO.DFC_PEnvSigRngMax_C DFES_DTCO.DFC_PEnvSigRngMin_C DFES_DTCO.DFC_PLnCChpDeactvnFaild_C DFES_DTCO.DFC_PrkgBrkFailr_C DFES_DTCO.DFC_PtSysLimErr_C DFES_DTCO.DFC_PwrMaxDchaShoLo_C DFES_DTCO.DFC_SCtPmp1FailSafeNotSuc_C DFES_DTCO.DFC_SCtPmp1SCG_C DFES_DTCO.DFC_VehCoornDrvrNotPrsnt_C /end DEF_CHARACTERISTIC
 FUNCTION_VERSION "30000.70.0" /end FUNCTION
/begin COMPU_METHOD DFES_OneToOne "" RAT_FUNC "%6.2" "-" COEFFS 0 1 0 0 0 1 /end COMPU_METHOD
/begin RECORD_LAYOUT Val_Wu16 FNC_VALUES 1 UWORD COLUMN_DIR DIRECT /end RECORD_LAYOUT
/end MODULE
/end PROJECT

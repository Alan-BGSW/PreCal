ASAP2_VERSION 1 70
/begin PROJECT MDG1C "VC1CP091_STLA_N_D061I3"
/begin HEADER "" VERSION "VC1CP091_STLA_N_D061I3" PROJECT_NO MDG1C /end HEADER
/begin MODULE DIM ""
/begin MOD_COMMON "" BYTE_ORDER MSB_LAST ALIGNMENT_BYTE 1 ALIGNMENT_WORD 2 ALIGNMENT_LONG 4 ALIGNMENT_INT64 4 ALIGNMENT_FLOAT32_IEEE 4 ALIGNMENT_FLOAT64_IEEE 4 DATA_SIZE 32 /end MOD_COMMON
/begin CHARACTERISTIC ChgrPlug_cntrTryClsng_C "Number of closing attempts" VALUE 0x8024FB60 RB_Val_Wu8 255.0 OneToOne 0.00 255.0 FORMAT "%5.1" /end CHARACTERISTIC
/begin CHARACTERISTIC ChgrPlug_cntrTryOpng_C "Number of opening attempts" VALUE 0x8024FB61 RB_Val_Wu8 255.0 OneToOne 0.00 255.0 FORMAT "%5.1" /end CHARACTERISTIC
/begin CHARACTERISTIC ChgrPlug_iCblLimCcsVal1_C "charging cable current limit 1" VALUE 0x8024FDF0 RB_Val_Ws16 2047.969 RBPtCel_i_0p03125_1 -1024.000 1023.969 FORMAT "%8.3" /end CHARACTERISTIC
/begin CHARACTERISTIC ChgrPlug_iCblLimCcsVal2_C "charging cable current limit 2" VALUE 0x8024FDF2 RB_Val_Ws16 2047.969 RBPtCel_i_0p03125_1 -1024.000 1023.969 FORMAT "%8.3" /end CHARACTERISTIC
/begin CHARACTERISTIC ChgrPlug_iCblLimCcsVal3_C "charging cable current limit 3" VALUE 0x8024FDF4 RB_Val_Ws16 2047.969 RBPtCel_i_0p03125_1 -1024.000 1023.969 FORMAT "%8.3" /end CHARACTERISTIC
/begin CHARACTERISTIC ChgrPlug_iCblLimCcsVal4_C "charging cable current limit 4" VALUE 0x8024FDF6 RB_Val_Ws16 2047.969 RBPtCel_i_0p03125_1 -1024.000 1023.969 FORMAT "%8.3" /end CHARACTERISTIC
/begin CHARACTERISTIC ChgrPlug_iCblLimCcsVal5_C "charging cable current limit 5" VALUE 0x8024FDF8 RB_Val_Ws16 2047.969 RBPtCel_i_0p03125_1 -1024.000 1023.969 FORMAT "%8.3" /end CHARACTERISTIC
/begin CHARACTERISTIC ChgrPlug_iCblLimCcsValErr_C "charging cable current limit in case of error in proximity pilot detection" VALUE 0x8024FDFA RB_Val_Ws16 2047.969 RBPtCel_i_0p03125_1 -1024.000 1023.969 FORMAT "%8.3" /end CHARACTERISTIC
/begin CHARACTERISTIC ChgrPlug_iCtpLimMpgCcs2_T "Mapping table of duty cycle of the EVSE to maximal avaiable current for CCS2 plug" CURVE 0x8024FB88 RB_Curve_S16_S16 2047.969 RBPtCel_i_0p03125_1 -1024.000 1023.969 FORMAT "%8.3"
 /begin AXIS_DESCR STD_AXIS NO_INPUT_QUANTITY RBPtCel_Perc_0p01_1 9 -327.6800 327.6700 FORMAT "%8.4" DEPOSIT ABSOLUTE /end AXIS_DESCR
/end CHARACTERISTIC
/begin CHARACTERISTIC ChgrPlug_iDcReplcmt_C "replacement value for DC current at charge inlet" VALUE 0x8024FB58 RB_Val_Ws16 2047.969 RBPtCel_i_0p03125_1 -1024.000 1023.969 FORMAT "%8.3" /end CHARACTERISTIC
/begin CHARACTERISTIC ChgrPlug_maskIDcRlyInvldSq_C "Bitmask for Signal qualifier for DC current at charge inlet from CAN" VALUE 0x8024FB5A RB_Val_Wu16 65535.00 OneToOne 0.00 65535.00 FORMAT "%8.2" /end CHARACTERISTIC
/begin CHARACTERISTIC ChgrPlug_maskNrAcPhaVldSq_C "mask of signal quality to define when respective signal is valid" VALUE 0x8024FDFC RB_Val_Wu16 65535.00 OneToOne 0.00 65535.00 FORMAT "%8.2" /end CHARACTERISTIC
/begin CHARACTERISTIC ChgrPlug_maskUDcRlyInvldSq_C "Bitmask for Signal qualifier for DC voltage at charge inlet from CAN" VALUE 0x8024FB5C RB_Val_Wu16 65535.00 OneToOne 0.00 65535.00 FORMAT "%8.2" /end CHARACTERISTIC
/begin CHARACTERISTIC ChgrPlug_ratPlgLockClsng_C "Ratio during closing attempt" VALUE 0x8024FB62 RB_Val_Ws16 799.9878 Prc -400.0000 399.9878 FORMAT "%8.4" /end CHARACTERISTIC
/begin CHARACTERISTIC ChgrPlug_ratPlgLockOff_C "Ratio for no movement" VALUE 0x8024FB64 RB_Val_Ws16 799.9878 Prc -400.0000 399.9878 FORMAT "%8.4" /end CHARACTERISTIC
/begin CHARACTERISTIC ChgrPlug_ratPlgLockOpng_C "Ratio during openig attempt" VALUE 0x8024FB66 RB_Val_Ws16 799.9878 Prc -400.0000 399.9878 FORMAT "%8.4" /end CHARACTERISTIC
/begin CHARACTERISTIC ChgrPlug_rCtpSwtClsd_C "Calibratable ratio for closing the S2 switch" VALUE 0x8024FB70 RB_Val_Ws16 799.9878 Prc -400.0000 399.9878 FORMAT "%8.4" /end CHARACTERISTIC
/begin CHARACTERISTIC ChgrPlug_rCtpSwtOpen_C "Calibratable ratio for opening the S2 switch" VALUE 0x8024FB72 RB_Val_Ws16 799.9878 Prc -400.0000 399.9878 FORMAT "%8.4" /end CHARACTERISTIC
/begin CHARACTERISTIC ChgrPlug_rCtpVldFrqHiThdCcs2_C "The upper threshold of the valid frequency range of the CCS2 plug" VALUE 0x8024FBAE RB_Val_Ws16 655.4 RBPtCel_Perc_0p01_1 -327.7 327.7 FORMAT "%5.1" /end CHARACTERISTIC
/begin CHARACTERISTIC ChgrPlug_rCtpVldFrqLoThdCcs2_C "The lower threshold of the valid frequency range of the CCS2 plug" VALUE 0x8024FBB0 RB_Val_Ws16 655.4 RBPtCel_Perc_0p01_1 -327.7 327.7 FORMAT "%5.1" /end CHARACTERISTIC
/begin CHARACTERISTIC ChgrPlug_stCtpIntMpgCcs2_T "Mapping table of duty cycle of the EVSE to internal Ctp state for CCS2 plug" CURVE 0x8024FBB2 RB_Curve_S16_U8_sao 255.0 OneToOne 0.00 255.0 FORMAT "%5.1"
 /begin AXIS_DESCR STD_AXIS NO_INPUT_QUANTITY RBPtCel_Perc_0p01_1 9 -327.6800 327.6700 FORMAT "%8.4" DEPOSIT ABSOLUTE /end AXIS_DESCR
/end CHARACTERISTIC
/begin CHARACTERISTIC ChgrPlug_stPxpIntMpgCcs2_T "mapping table for PP status at CCS inlet 2" CURVE 0x8024FDFE RB_Curve_S16_U8_sao 255.0 OneToOne 0.00 255.0 FORMAT "%5.1"
 /begin AXIS_DESCR STD_AXIS NO_INPUT_QUANTITY RBPtCel_u_0p001_1 11 -32.76800 32.76700 FORMAT "%8.5" DEPOSIT ABSOLUTE /end AXIS_DESCR
/end CHARACTERISTIC
/begin CHARACTERISTIC ChgrPlug_stUCtpIntMpgCcs2_T "Mapping table of voltage level of the EVSE to internal Ctp state for CCS2 plug" CURVE 0x8024FBD0 RB_Curve_S16_U8_sao 255.0 OneToOne 0.00 255.0 FORMAT "%5.1"
 /begin AXIS_DESCR STD_AXIS NO_INPUT_QUANTITY RBPtCel_u_0p01_1 3 -327.6800 327.6700 FORMAT "%8.4" DEPOSIT ABSOLUTE /end AXIS_DESCR
/end CHARACTERISTIC
/begin CHARACTERISTIC ChgrPlug_tiCtpSwtStDeb_C "Debounce time of internal state" VALUE 0x8024FB74 RB_Val_Ws16 655.3500 RBPtCel_ti_0p01_1 -327.6800 327.6700 FORMAT "%8.4" /end CHARACTERISTIC
/begin CHARACTERISTIC ChgrPlug_tiCtpSwtTog_C "Duration of on and off time during control pilot switch (S2) toggling" VALUE 0x8024FB76 RB_Val_Wu16 65.53500 RBPtCel_ti_0p001_2 0.00 65.53500 FORMAT "%8.5" /end CHARACTERISTIC
/begin CHARACTERISTIC ChgrPlug_tiDebPxp1StErr_C "debounce time for PP 1 error" VALUE 0x8024FE22 RB_Val_Wu16 65.53500 RBPtCel_ti_0p001_2 0.00 65.53500 FORMAT "%8.5" /end CHARACTERISTIC
/begin CHARACTERISTIC ChgrPlug_tiDebPxp1StOk_C "debounce time for PP 1 healing" VALUE 0x8024FE24 RB_Val_Wu16 65.53500 RBPtCel_ti_0p001_2 0.00 65.53500 FORMAT "%8.5" /end CHARACTERISTIC
/begin CHARACTERISTIC ChgrPlug_tiDebStCtp_C "Debouncing time of the internal state" VALUE 0x8024FBDC RB_Val_Ws16 655.3500 Time_s -327.6800 327.6700 FORMAT "%8.4" /end CHARACTERISTIC
/begin CHARACTERISTIC ChgrPlug_tiPlgLockClsng_C "debounce time to close the plug lock" VALUE 0x8024FB68 RB_Val_Wu16 65.53500 RBPtCel_ti_0p001_2 0.00 65.53500 FORMAT "%8.5" /end CHARACTERISTIC
/begin CHARACTERISTIC ChgrPlug_tiPlgLockOff_C "pause time of the lock pin actuator" VALUE 0x8024FB6A RB_Val_Wu16 65.53500 RBPtCel_ti_0p001_2 0.00 65.53500 FORMAT "%8.5" /end CHARACTERISTIC
/begin CHARACTERISTIC ChgrPlug_tiPlgLockOpng_C "debounce time to open the plug lock" VALUE 0x8024FB6C RB_Val_Wu16 65.53500 RBPtCel_ti_0p001_2 0.00 65.53500 FORMAT "%8.5" /end CHARACTERISTIC
/begin CHARACTERISTIC ChgrPlug_tiPlgLockPwrOn_C "Duration for wake up of components" VALUE 0x8024FB6E RB_Val_Wu16 65.53500 RBPtCel_ti_0p001_2 0.00 65.53500 FORMAT "%8.5" /end CHARACTERISTIC
/begin CHARACTERISTIC ChgrPlug_tiPT1ICtpLim_C "Debounce time of the PT1-flter" VALUE 0x8024FBE0 RB_Val_Ws32 4294.9672940000000 TimeDelay_s 0.0000020000000 4294.9672959999998 FORMAT "%19.14" EXTENDED_LIMITS 0.000002000000001 4294.9672959999998 /end CHARACTERISTIC
/begin CHARACTERISTIC ChgrPlug_uConHiLimClsdReq_C "Upper voltage limit for diagnosis while PWM is off and the request for S2 is CLSD" VALUE 0x8024FB78 RB_Val_Ws16 65.53500 RBPtCel_u_0p001_1 -32.76800 32.76700 FORMAT "%8.5" /end CHARACTERISTIC
/begin CHARACTERISTIC ChgrPlug_uConHiLimOpenReq_C "Upper voltage limit for diagnosis while PWM is off and the request for S2 is OPEN" VALUE 0x8024FB7A RB_Val_Ws16 65.53500 RBPtCel_u_0p001_1 -32.76800 32.76700 FORMAT "%8.5" /end CHARACTERISTIC
/begin CHARACTERISTIC ChgrPlug_uConLoLimClsdReq_C "Lower voltage limit for diagnosis while PWM is off and the request for S2 is CLSD" VALUE 0x8024FB7C RB_Val_Ws16 65.53500 RBPtCel_u_0p001_1 -32.76800 32.76700 FORMAT "%8.5" /end CHARACTERISTIC
/begin CHARACTERISTIC ChgrPlug_uConLoLimOpenReq_C "Lower voltage limit for diagnosis while PWM is off and the request for S2 is OPEN" VALUE 0x8024FB7E RB_Val_Ws16 65.53500 RBPtCel_u_0p001_1 -32.76800 32.76700 FORMAT "%8.5" /end CHARACTERISTIC
/begin CHARACTERISTIC ChgrPlug_uDcReplcmt_C "replacement value for DC voltage at charge inlet" VALUE 0x8024FB5E RB_Val_Ws16 6553.500 RBPtCel_u_0p1_1 -3276.800 3276.700 FORMAT "%8.3" /end CHARACTERISTIC
/begin CHARACTERISTIC ChgrPlug_uDiagHiLimClsdReq_C "Upper voltage limit for diagnosis while PWM is on and the request for S2 is CLSD" VALUE 0x8024FB80 RB_Val_Ws16 65.53500 RBPtCel_u_0p001_1 -32.76800 32.76700 FORMAT "%8.5" /end CHARACTERISTIC
/begin CHARACTERISTIC ChgrPlug_uDiagHiLimOpenReq_C "Upper voltage limit for diagnosis while PWM is on and the request for S2 is OPEN" VALUE 0x8024FB82 RB_Val_Ws16 65.53500 RBPtCel_u_0p001_1 -32.76800 32.76700 FORMAT "%8.5" /end CHARACTERISTIC
/begin CHARACTERISTIC ChgrPlug_uDiagLoLimClsdReq_C "Lower voltage limit for diagnosis while PWM is on and the request for S2 is CLSD" VALUE 0x8024FB84 RB_Val_Ws16 65.53500 RBPtCel_u_0p001_1 -32.76800 32.76700 FORMAT "%8.5" /end CHARACTERISTIC
/begin CHARACTERISTIC ChgrPlug_uDiagLoLimOpenReq_C "Lower voltage limit for diagnosis while PWM is on and the request for S2 is OPEN" VALUE 0x8024FB86 RB_Val_Ws16 65.53500 RBPtCel_u_0p001_1 -32.76800 32.76700 FORMAT "%8.5" /end CHARACTERISTIC
/begin CHARACTERISTIC ChkCntr_Enable_C "CHK_CNT Enable Disable" VALUE 0x80250094 Val_Wu8 255.0 OneToOne 0.00 255.0 FORMAT "%5.1" /end CHARACTERISTIC
/begin CHARACTERISTIC ChrgCntct_flgCntctBypSwt_C "Calibratable switch to set the positive and negative contactor position signals" VALUE 0x8024FDAC RB_Val_Wu8 1.00000000000 B_TRUE 0.00 1.00000000000 FORMAT "%13.11" /end CHARACTERISTIC
/begin CHARACTERISTIC ChrgCntct_flgCntctNeg_C "Calibratable Negative contactor position" VALUE 0x8024FDAD RB_Val_Wu8 1.00000000000 B_TRUE 0.00 1.00000000000 FORMAT "%13.11" /end CHARACTERISTIC
/begin CHARACTERISTIC ChrgCntct_flgCntctPos_C "Calibratable Positive contactor position" VALUE 0x8024FDAE RB_Val_Wu8 1.00000000000 B_TRUE 0.00 1.00000000000 FORMAT "%13.11" /end CHARACTERISTIC
/begin CHARACTERISTIC ChrgnCntct_nrMaxManTestImp_C "Calibratable maximum number of test pulses" VALUE 0x8024FDAF RB_Val_Wu8 255.0 OneToOne 0.00 255.0 FORMAT "%5.1" /end CHARACTERISTIC
/begin CHARACTERISTIC ChrgnCntct_nrTestMaxHs_C "calibratable maximum tests on HS" VALUE 0x8024FDB0 RB_Val_Wu16 65535.00 OneToOne 0.00 65535.00 FORMAT "%8.2" /end CHARACTERISTIC
/begin CHARACTERISTIC ChrgnCntct_nrTestMaxLsNeg_C "calibratable maximum tests on LS Neg" VALUE 0x8024FDB2 RB_Val_Wu16 65535.00 OneToOne 0.00 65535.00 FORMAT "%8.2" /end CHARACTERISTIC
/begin CHARACTERISTIC ChrgnCntct_nrTestMaxLsPos_C "calibratable maximum tests on LS Pos" VALUE 0x8024FDB4 RB_Val_Wu16 65535.00 OneToOne 0.00 65535.00 FORMAT "%8.2" /end CHARACTERISTIC
/begin CHARACTERISTIC ChrgnCntct_stPsDiagDi_C "calibratable mask for power stage diagnosis enabling condition" VALUE 0x8024FDB6 RB_Val_Wu16 65535.00 OneToOne 0.00 65535.00 FORMAT "%8.2" /end CHARACTERISTIC
/begin CHARACTERISTIC ChrgnCntct_stPsDi_C "calibratable mas for power stage enabling condition" VALUE 0x8024FDB8 RB_Val_Wu16 65535.00 OneToOne 0.00 65535.00 FORMAT "%8.2" /end CHARACTERISTIC
/begin CHARACTERISTIC ChrgnCntct_tiBtwTestImp_C "Calibratable time between test impulses" VALUE 0x8024FDBA RB_Val_Wu8 25.50 RBPtCel_ti_0p1_1 0.00 25.50 FORMAT "%5.2" /end CHARACTERISTIC
/begin CHARACTERISTIC ChrgnCntct_tiBtwTestOtHs_C "Calibratable time between OT test in HS" VALUE 0x8024FDBC RB_Val_Ws16 655350.0 Time_ms -327680.0 327670.0 FORMAT "%8.1" /end CHARACTERISTIC
/begin CHARACTERISTIC ChrgnCntct_tiBtwTestOtLsNeg_C "Calibratable time between OT test in LS neg" VALUE 0x8024FDBE RB_Val_Ws16 655350.0 Time_ms -327680.0 327670.0 FORMAT "%8.1" /end CHARACTERISTIC
/begin CHARACTERISTIC ChrgnCntct_tiBtwTestOtLsPos_C "Calibratable time between OT test in LS Pos" VALUE 0x8024FDC0 RB_Val_Ws16 655350.0 Time_ms -327680.0 327670.0 FORMAT "%8.1" /end CHARACTERISTIC
/begin CHARACTERISTIC ChrgnCntct_tiBtwTestScbHs_C "Calibratable time between SCB test in HS" VALUE 0x8024FDC2 RB_Val_Ws16 655350.0 Time_ms -327680.0 327670.0 FORMAT "%8.1" /end CHARACTERISTIC
/begin CHARACTERISTIC ChrgnCntct_tiBtwTestScbLsNeg_C "Calibratable time between SCB test in LS Neg" VALUE 0x8024FDC4 RB_Val_Ws16 655350.0 Time_ms -327680.0 327670.0 FORMAT "%8.1" /end CHARACTERISTIC
/begin CHARACTERISTIC ChrgnCntct_tiBtwTestScbLsPos_C "Calibratable time between SCB test in LS Pos" VALUE 0x8024FDC6 RB_Val_Ws16 655350.0 Time_ms -327680.0 327670.0 FORMAT "%8.1" /end CHARACTERISTIC
/begin CHARACTERISTIC ChrgnCntct_tiHsOnDiagEna_C "Calibratable time delay to enable diagnosis" VALUE 0x8024FDC8 RB_Val_Ws32 42949672.9500 RBPtCel_ti_0p01_1 -21474836.4800 21474836.4700 FORMAT "%13.4" /end CHARACTERISTIC
/begin CHARACTERISTIC ChrgnCntct_tiWaitMinOffDly_C "Calibratable turn off delay" VALUE 0x8024FDCC RB_Val_Ws16 655.3500 RBPtCel_ti_0p01_1 -327.6800 327.6700 FORMAT "%8.4" /end CHARACTERISTIC
/begin CHARACTERISTIC ChrgnCntct_tiWaitMinOnDly_C "Calibratable turn on delay" VALUE 0x8024FDCE RB_Val_Ws16 655.3500 RBPtCel_ti_0p01_1 -327.6800 327.6700 FORMAT "%8.4" /end CHARACTERISTIC
/begin CHARACTERISTIC ChrgPlg_facDernICcsDc_T "Curve for charging current reduction factor for CCS DC" CURVE 0x8024FC08 RB_Curve_S16_S8_sao 1.000 RBPtCel_fac_0p01_1 0.00 1.000 FORMAT "%5.3" EXTENDED_LIMITS -1.280 1.270
 /begin AXIS_DESCR STD_AXIS ChgrPlug_tPinCcsDc RBPtCel_t_0p1_3 5 -3276.800 3276.700 FORMAT "%8.3" DEPOSIT ABSOLUTE /end AXIS_DESCR
/end CHARACTERISTIC
/begin CHARACTERISTIC ChrgPlg_facDernIDfl_C "Default value for charging current reduction factor" VALUE 0x8024FC1A RB_Val_Ws8 1.000 RBPtCel_fac_0p01_1 0.00 1.000 FORMAT "%5.3" EXTENDED_LIMITS -1.280 1.270 /end CHARACTERISTIC
/begin CHARACTERISTIC ChrgPlg_flgMplPlgStopEna_C "If multiple plugs are detected charging stop shall be performed" VALUE 0x8024FBE4 RB_Val_Wboolean 1.00000000000 B_TRUE 0.00 1.00000000000 FORMAT "%13.11" /end CHARACTERISTIC
/begin CHARACTERISTIC ChrgPlg_iAcMaxRelsPlg_C "maximum AC current for charge plug release" VALUE 0x8024FBE8 RB_Val_Ws16 2047.969 RBPtCel_i_0p03125_1 -1024.000 1023.969 FORMAT "%8.3" /end CHARACTERISTIC
/begin CHARACTERISTIC ChrgPlg_maskRelsPlgIGridSq_C "Calibration mask of the signal quality of the AC charge plug current to release plug unlock" VALUE 0x8024FBEA RB_Val_Wu16 65535.00 OneToOne 0.00 65535.00 FORMAT "%8.2" /end CHARACTERISTIC
/begin CHARACTERISTIC ChrgPlg_maskRelsPlgUDcSq_C "Calibration mask of the signal quality of the DC charge plug voltage to release plug unlock" VALUE 0x8024FBEC RB_Val_Wu16 65535.00 OneToOne 0.00 65535.00 FORMAT "%8.2" /end CHARACTERISTIC
/begin CHARACTERISTIC ChrgPlg_maskRelsPlgUGridSq_C "Calibration mask of the signal quality of the AC charge plug voltage to release plug unlock" VALUE 0x8024FBEE RB_Val_Wu16 65535.00 OneToOne 0.00 65535.00 FORMAT "%8.2" /end CHARACTERISTIC
/begin CHARACTERISTIC ChrgPlg_prmIntlck.tiCmdAckdTout_C "charge plug Interlock control unit / maximum control demand time to lock or unlock the charge plug" VALUE 0x8024FBFA RB_Val_Wu16 655.3500 RBPtCel_ti_0p01_1 0.00 655.3500 FORMAT "%8.4" /end CHARACTERISTIC
/begin CHARACTERISTIC ChrgPlg_prmIntlck.tiLockPlg_C "charge plug Interlock control unit / activation time for charge plug interlock independent of charging process" VALUE 0x8024FBFC RB_Val_Wu16 655.3500 RBPtCel_ti_0p01_1 0.00 655.3500 FORMAT "%8.4" /end CHARACTERISTIC
/begin CHARACTERISTIC ChrgPlg_prmIntlck.tiPlgDetn_C "charge plug Interlock control unit / Delay time after power on with unchanged interlock command state" VALUE 0x8024FBFE RB_Val_Wu16 655.3500 RBPtCel_ti_0p01_1 0.00 655.3500 FORMAT "%8.4" /end CHARACTERISTIC
/begin CHARACTERISTIC ChrgPlg_prmIntlck.tiRelckPlg_C "charge plug Interlock control unit / activation time for charge plug interlock after unused release" VALUE 0x8024FC00 RB_Val_Wu16 655.3500 RBPtCel_ti_0p01_1 0.00 655.3500 FORMAT "%8.4" /end CHARACTERISTIC
/begin CHARACTERISTIC ChrgPlg_prmIntlck.tiUnlckPlgAc_C "charge plug Interlock control unit / Activation time of automatic plug unlock after AC charging" VALUE 0x8024FC02 RB_Val_Wu16 655.3500 RBPtCel_ti_0p01_1 0.00 655.3500 FORMAT "%8.4" /end CHARACTERISTIC
/begin CHARACTERISTIC ChrgPlg_prmIntlck.tiUnlckPlgDc_C "charge plug Interlock control unit / Activation time of automatic plug unlock after AC charging" VALUE 0x8024FC04 RB_Val_Wu16 655.3500 RBPtCel_ti_0p01_1 0.00 655.3500 FORMAT "%8.4" /end CHARACTERISTIC
/begin CHARACTERISTIC ChrgPlg_prmIntlck.tiWaitUIntkLowr_C "charge plug Interlock control unit / Maximum waiting time for suitable inlet voltages and currents to handle unlock request" VALUE 0x8024FC06 RB_Val_Wu16 655.3500 RBPtCel_ti_0p01_1 0.00 655.3500 FORMAT "%8.4" /end CHARACTERISTIC
/begin CHARACTERISTIC ChrgPlg_tDfl_C "Default value for pin temperature" VALUE 0x8024FC1C RB_Val_Ws16 6553.500 RBPtCel_t_0p1_3 -3276.800 3276.700 FORMAT "%8.3" /end CHARACTERISTIC
/begin CHARACTERISTIC ChrgPlg_tiDebUIntkLockPlg_C "Debounce time to lock charge plug dependent on inlet voltage and current" VALUE 0x8024FBF0 RB_Val_Ws16 655.3500 RBPtCel_ti_0p01_1 -327.6800 327.6700 FORMAT "%8.4" /end CHARACTERISTIC
/begin CHARACTERISTIC ChrgPlg_tiDebUIntkRelsPlg_C "Debounce time to release interlock of charge plug dependent on inlet voltage and current" VALUE 0x8024FBF2 RB_Val_Ws16 655.3500 RBPtCel_ti_0p01_1 -327.6800 327.6700 FORMAT "%8.4" /end CHARACTERISTIC
/begin CHARACTERISTIC ChrgPlg_tiLockDebUnpl_C "maximum validation time for detection Charging plug removed" VALUE 0x8024FBF4 RB_Val_Wu16 655.3500 RBPtCel_ti_0p01_1 0.00 655.3500 FORMAT "%8.4" /end CHARACTERISTIC
/begin CHARACTERISTIC ChrgPlg_tiPlgLockReqDly_C "delay time for plug lock request for charging" VALUE 0x8024FBE6 RB_Val_Wu16 655.3500 RBPtCel_ti_0p01_1 0.00 655.3500 FORMAT "%8.4" /end CHARACTERISTIC
/begin CHARACTERISTIC ChrgPlg_tPinCcsDcMax_C "Maximal temperature limit of DC pins of CCS charge plug" VALUE 0x8024FC1E RB_Val_Ws16 6553.500 RBPtCel_t_0p1_3 -3276.800 3276.700 FORMAT "%8.3" /end CHARACTERISTIC
/begin CHARACTERISTIC ChrgPlg_uAcMaxRelsPlg_C "maximum AC voltage for charge plug release" VALUE 0x8024FBF6 RB_Val_Ws16 6553.500 RBPtCel_u_0p1_1 -3276.800 3276.700 FORMAT "%8.3" /end CHARACTERISTIC
/begin CHARACTERISTIC ChrgPlg_uDcMaxRelsPlg_C "maximum DC voltage for charge plug release" VALUE 0x8024FBF8 RB_Val_Ws16 6553.500 RBPtCel_u_0p1_1 -3276.800 3276.700 FORMAT "%8.3" /end CHARACTERISTIC
/begin CHARACTERISTIC ChrgrSt_maskChrgrErrSq_C "Quality signal mask for charger error signal" VALUE 0x8024FE26 RB_Val_Wu16 65535.00 OneToOne 0.00 65535.00 FORMAT "%8.2" /end CHARACTERISTIC
/begin CHARACTERISTIC ChrgrSt_maskStChrgrSq_C "Quality signal mask for state signal" VALUE 0x8024FE28 RB_Val_Wu16 65535.00 OneToOne 0.00 65535.00 FORMAT "%8.2" /end CHARACTERISTIC
/begin CHARACTERISTIC ChrgrSt_stChrgnReqMpg_T "Mapping of charging request from VCU to OBC" CURVE 0x8024FDD0 RB_Curve_U8_U8 255.0 OneToOne 0.00 255.0 FORMAT "%5.1"
 /begin AXIS_DESCR STD_AXIS ChrgrSt_stChrgnReq ChrgCtrl_stChrgn_VERB 7 0.00 6.00000000000 FORMAT "%13.11" DEPOSIT ABSOLUTE /end AXIS_DESCR
/end CHARACTERISTIC
/begin CHARACTERISTIC ChrgrSt_stChrgn_M "Mapping table used to translate the actual charger state received over CAN to internal VCU states" MAP 0x8024FE2A RB_Map_U8U8_U8 6.00000000000 ChrgCtrl_stChrgn_VERB 0.00 6.00000000000 FORMAT "%13.11"
 /begin AXIS_DESCR STD_AXIS ComChrgr_stChrgr OneToOne 7 0.00 255.0 FORMAT "%5.1" DEPOSIT ABSOLUTE /end AXIS_DESCR
 /begin AXIS_DESCR STD_AXIS ChrgrSt_stChrgnReqInt ChrgCtrl_stChrgn_VERB 5 0.00 6.00000000000 FORMAT "%13.11" DEPOSIT ABSOLUTE /end AXIS_DESCR
/end CHARACTERISTIC
/begin CHARACTERISTIC ChrgrSt_stStrtVal_C "OBC desired state initial value." VALUE 0x8024FDDF RB_Val_Wu8 255.0 OneToOne 0.00 255.0 FORMAT "%5.1" /end CHARACTERISTIC
/begin CHARACTERISTIC ChrgrVal_iGridDft_C "Default value for max OBC AC input current" VALUE 0x8024FDE0 RB_Val_Ws16 2047.969 RBPtCel_i_0p03125_1 -1024.000 1023.969 FORMAT "%8.3" /end CHARACTERISTIC
/begin CHARACTERISTIC ChrgrVal_iOutDft_C "Default value for actual OBC DC output current" VALUE 0x8024FDE2 RB_Val_Ws16 2047.969 RBPtCel_i_0p03125_1 -1024.000 1023.969 FORMAT "%8.3" /end CHARACTERISTIC
/begin CHARACTERISTIC ChrgrVal_maskComChrgrInvldSq_C "Mask for an invalid signal quality" VALUE 0x8024FDE4 RB_Val_Wu16 65535.00 OneToOne 0.00 65535.00 FORMAT "%8.2" /end CHARACTERISTIC
/begin CHARACTERISTIC ChrgrVal_maskComChrgrVldSq_C "Mask for a valid signal quality" VALUE 0x8024FDE6 RB_Val_Wu16 65535.00 OneToOne 0.00 65535.00 FORMAT "%8.2" /end CHARACTERISTIC
/begin CHARACTERISTIC ChrgrVal_tDft_C "Default value for actual OBC temperature" VALUE 0x8024FDE8 RB_Val_Ws16 6553.500 RBPtCel_t_0p1_3 -3276.800 3276.700 FORMAT "%8.3" /end CHARACTERISTIC
/begin CHARACTERISTIC ChrgrVal_uAcActPhaThd_C "Threshold (voltage) to determin if an phase is active" VALUE 0x8024FDEA RB_Val_Ws16 6553.500 RBPtCel_u_0p1_1 -3276.800 3276.700 FORMAT "%8.3" /end CHARACTERISTIC
/begin CHARACTERISTIC ChrgrVal_uGridDft_C "Default value for max OBC AC input voltage" VALUE 0x8024FDEC RB_Val_Ws16 6553.500 RBPtCel_u_0p1_1 -3276.800 3276.700 FORMAT "%8.3" /end CHARACTERISTIC
/begin CHARACTERISTIC ChrgrVal_uOutDft_C "Default value for actual OBC DC output voltage" VALUE 0x8024FDEE RB_Val_Ws16 6553.500 RBPtCel_u_0p1_1 -3276.800 3276.700 FORMAT "%8.3" /end CHARACTERISTIC
/begin CHARACTERISTIC ChrgSdl_facCvLut_T "Lookup table for Time selection in CV mode" CURVE 0x8024FC20 RB_Curve_S16_S16 655.3500 RBPtCel_fac_0p01_1 -327.6800 327.6700 FORMAT "%8.4"
 /begin AXIS_DESCR STD_AXIS ChrgSdl_ratCvEnd Prc 7 -400.0000 399.9878 FORMAT "%8.4" DEPOSIT ABSOLUTE /end AXIS_DESCR
/end CHARACTERISTIC
/begin CHARACTERISTIC ChrgSdl_iCcLut_M "Lookup table for Actual CC mode current" MAP 0x8024FC3E RB_Map_S16S16_S16 2047.969 RBPtCel_i_0p03125_1 -1024.000 1023.969 FORMAT "%8.3"
 /begin AXIS_DESCR STD_AXIS ChrgSdl_facDeltaCc Prc 6 -400.0000 399.9878 FORMAT "%8.4" DEPOSIT ABSOLUTE /end AXIS_DESCR
 /begin AXIS_DESCR STD_AXIS ChrgSdl_ratCcStrt Prc 6 -400.0000 399.9878 FORMAT "%8.4" DEPOSIT ABSOLUTE /end AXIS_DESCR
/end CHARACTERISTIC
/begin CHARACTERISTIC ChrgSdl_iPre_C "CalPrm for PRE mode charging current" VALUE 0x8024FCA2 RB_Val_Ws16 2047.969 RBPtCel_i_0p03125_1 -1024.000 1023.969 FORMAT "%8.3" /end CHARACTERISTIC
/begin CHARACTERISTIC ChrgSdl_ratCcEndThd_C "CalPrm for CC mode end threshold" VALUE 0x8024FCA4 RB_Val_Ws16 799.9878 Prc -400.0000 399.9878 FORMAT "%8.4" /end CHARACTERISTIC
/begin CHARACTERISTIC ChrgSdl_ratCcStrtLut_M "Lookup table for CC mode start threshold" MAP 0x8024FCA6 RB_Map_S16S16_S16 799.9878 Prc -400.0000 399.9878 FORMAT "%8.4"
 /begin AXIS_DESCR STD_AXIS ChrgMod_iChrgnReq RBPtCel_i_0p03125_1 6 -1024.000 1023.969 FORMAT "%8.3" DEPOSIT ABSOLUTE /end AXIS_DESCR
 /begin AXIS_DESCR STD_AXIS HvBatt_ratSoc Prc 6 -400.0000 399.9878 FORMAT "%8.4" DEPOSIT ABSOLUTE /end AXIS_DESCR
/end CHARACTERISTIC
/begin CHARACTERISTIC ChrgSdl_tiCvLut_M "Lookup table for CV mode time selection" MAP 0x8024FD0C RB_Map_S16S16_S32_sao 4294967295.00 RBPtCel_ti_1p0_2 -2147483648.00 2147483647.00 FORMAT "%13.2"
 /begin AXIS_DESCR STD_AXIS ChrgSdl_iCv RBPtCel_i_0p03125_1 5 -1024.000 1023.969 FORMAT "%8.3" DEPOSIT ABSOLUTE /end AXIS_DESCR
 /begin AXIS_DESCR STD_AXIS ChrgSdl_facDeltaCp RBPtCel_fac_0p01_1 6 -327.6800 327.6700 FORMAT "%8.4" DEPOSIT ABSOLUTE /end AXIS_DESCR
/end CHARACTERISTIC
/begin CHARACTERISTIC ChrgSys_flgProlgPostDrive_C "Usage of postdrive prolongation concept to keep ECU on for charging" VALUE 0x8024FDA0 RB_Val_Wu8 1.000 OneToOne 0.00 1.000 FORMAT "%5.3" EXTENDED_LIMITS 0.00 255.0 /end CHARACTERISTIC
/begin CHARACTERISTIC ChrgSys_tiDlyProlgWaitComReq_C "Transition delay time from system state WAIT_PRLONG to WAIT_NETWORK to keep ECU on for charging" VALUE 0x8024FDA2 RB_Val_Ws16 327.6700 RBPtCel_ti_0p01_1 0.00 327.6700 FORMAT "%8.4" EXTENDED_LIMITS -327.6800 327.6700 /end CHARACTERISTIC
/begin CHARACTERISTIC ChrgSys_tiProlgWaitPlugDetn_C "Shutdown delay timer after wake-up to allow detection of charge request" VALUE 0x8024FDA4 RB_Val_Ws16 327.6700 RBPtCel_ti_0p01_1 0.00 327.6700 FORMAT "%8.4" EXTENDED_LIMITS -327.6800 327.6700 /end CHARACTERISTIC
/begin CHARACTERISTIC ChrgSys_tiProlMaxWoChrgnEnad_C "maximum wakeup prolongation time for charging without energy transfer enabled" VALUE 0x8024FDA8 RB_Val_Ws32 21474836.4700 RBPtCel_ti_0p01_1 0.00 21474836.4700 FORMAT "%13.4" EXTENDED_LIMITS -21474836.4800 21474836.4700 /end CHARACTERISTIC
/begin CHARACTERISTIC CmbdChrgnSys_diBattExddNeg_C "Negative slope of requested current" VALUE 0x8024FE6C RB_Val_Wu32 429496729.500 RBPtCel_di_0p1_1 0.00 429496729.500 FORMAT "%13.3" /end CHARACTERISTIC
/begin CHARACTERISTIC CmbdChrgnSys_diBattExddPos_C "Positive slope of requested current" VALUE 0x8024FE70 RB_Val_Wu32 429496729.500 RBPtCel_di_0p1_1 0.00 429496729.500 FORMAT "%13.3" /end CHARACTERISTIC
/begin CHARACTERISTIC CmbdChrgnSys_diOutExddNeg_C "Negative slppe of output current" VALUE 0x8024FE74 RB_Val_Wu32 429496729.500 RBPtCel_di_0p1_1 0.00 429496729.500 FORMAT "%13.3" /end CHARACTERISTIC
/begin CHARACTERISTIC CmbdChrgnSys_diOutExddPos_C "Positive slope of output current" VALUE 0x8024FE78 RB_Val_Wu32 429496729.500 RBPtCel_di_0p1_1 0.00 429496729.500 FORMAT "%13.3" /end CHARACTERISTIC
/begin CHARACTERISTIC CmbdChrgnSys_facDmdExcddTolr_C "CCS Current demand tolerance factor" VALUE 0x8024FE7C RB_Val_Ws8 2.550 RBPtCel_fac_0p01_1 -1.280 1.270 FORMAT "%5.3" /end CHARACTERISTIC
/begin CHARACTERISTIC CmbdChrgnSys_facHvBattExcddTolr_C "HV battery requested current demand tolerance" VALUE 0x8024FE7D RB_Val_Ws8 2.550 RBPtCel_fac_0p01_1 -1.280 1.270 FORMAT "%5.3" /end CHARACTERISTIC
/begin CHARACTERISTIC CmbdChrgnSys_facIEvseDcRglnTolr_C "CCS Evse current tolerance factor" VALUE 0x8024FE7E RB_Val_Ws8 2.550 RBPtCel_fac_0p01_1 -1.280 1.270 FORMAT "%5.3" /end CHARACTERISTIC
/begin CHARACTERISTIC CmbdChrgnSys_facUEvseDcRglnTolr_C "CCS Evse voltage tolerance factor" VALUE 0x8024FE7F RB_Val_Ws8 2.550 RBPtCel_fac_0p01_1 -1.280 1.270 FORMAT "%5.3" /end CHARACTERISTIC
/begin CHARACTERISTIC CmbdChrgnSys_flgAllwdDrvModNeutPosn_C "flag DrvMod_stPosn in NEUT for charging allowed" VALUE 0x8024FE5C RB_Val_Wboolean 1.00000000000 B_TRUE 0.00 1.00000000000 FORMAT "%13.11" /end CHARACTERISTIC
/begin CHARACTERISTIC CmbdChrgnSys_flgAuxUnitLoadHiEna_C "Use auxiliary unit load high for charging current diagnosis" VALUE 0x8024FE80 RB_Val_Wu8 1.00000000000 B_TRUE 0.00 1.00000000000 FORMAT "%13.11" /end CHARACTERISTIC
/begin CHARACTERISTIC CmbdChrgnSys_flgAuxUnitLoadLoEna_C "Use auxiliary unit load low for charging current demand" VALUE 0x8024FE81 RB_Val_Wu8 1.00000000000 B_TRUE 0.00 1.00000000000 FORMAT "%13.11" /end CHARACTERISTIC
/begin CHARACTERISTIC CmbdChrgnSys_flgEvseITolrDi_C "Ignore current tolerances of EVSE for charging current demand" VALUE 0x8024FE82 RB_Val_Wu8 1.00000000000 B_TRUE 0.00 1.00000000000 FORMAT "%13.11" /end CHARACTERISTIC
/begin CHARACTERISTIC CmbdChrgnSys_iAuxHiDeTolr_C "Auxiliary current high limit tolerance" VALUE 0x8024FE84 RB_Val_Ws16 2047.969 RBPtCel_i_0p03125_1 -1024.000 1023.969 FORMAT "%8.3" /end CHARACTERISTIC
/begin CHARACTERISTIC CmbdChrgnSys_iAuxLoDeTolr_C "Auxiliary current low limit tolerance" VALUE 0x8024FE86 RB_Val_Ws16 2047.969 RBPtCel_i_0p03125_1 -1024.000 1023.969 FORMAT "%8.3" /end CHARACTERISTIC
/begin CHARACTERISTIC CmbdChrgnSys_iAuxUnitLoadMax_C "Maximal auxiliary load to be considered for charging current demand CCS DC" VALUE 0x8024FE88 RB_Val_Ws16 2047.969 RBPtCel_i_0p03125_1 -1024.000 1023.969 FORMAT "%8.3" /end CHARACTERISTIC
/begin CHARACTERISTIC CmbdChrgnSys_iBattActLoCcsDc_C "Minimum actual charge current of HV battery to continue CCS DC charging" VALUE 0x8024FE5E RB_Val_Ws16 2047.969 RBPtCel_i_0p03125_1 -1024.000 1023.969 FORMAT "%8.3" /end CHARACTERISTIC
/begin CHARACTERISTIC CmbdChrgnSys_iBattReqLoCcsDc_C "Minimum charge current request of HV battery to start and continue CCS DC charging" VALUE 0x8024FE60 RB_Val_Ws16 2047.969 RBPtCel_i_0p03125_1 -1024.000 1023.969 FORMAT "%8.3" /end CHARACTERISTIC
/begin CHARACTERISTIC CmbdChrgnSys_iChrgnLimMax_C "Maximal charging current capability" VALUE 0x8024FE8A RB_Val_Ws16 2047.969 RBPtCel_i_0p03125_1 -1024.000 1023.969 FORMAT "%8.3" /end CHARACTERISTIC
/begin CHARACTERISTIC CmbdChrgnSys_iDmdExcddTolr_C "Demand current exceeded tolerance" VALUE 0x8024FE8C RB_Val_Ws16 2047.969 RBPtCel_i_0p03125_1 -1024.000 1023.969 FORMAT "%8.3" /end CHARACTERISTIC
/begin CHARACTERISTIC CmbdChrgnSys_iEvseDcRglnTolr_C "Evse regulation tolerance current" VALUE 0x8024FE8E RB_Val_Ws16 2047.969 RBPtCel_i_0p03125_1 -1024.000 1023.969 FORMAT "%8.3" /end CHARACTERISTIC
/begin CHARACTERISTIC CmbdChrgnSys_iHvBattExcddTolr_C "The accepted tolerance from which the battery current exceeded error is set" VALUE 0x8024FE90 RB_Val_Ws16 2047.969 RBPtCel_i_0p03125_1 -1024.000 1023.969 FORMAT "%8.3" /end CHARACTERISTIC
/begin CHARACTERISTIC CmbdChrgnSys_iPlgDeTolr_C "Current deviation tolerance" VALUE 0x8024FE92 RB_Val_Ws16 2047.969 RBPtCel_i_0p03125_1 -1024.000 1023.969 FORMAT "%8.3" /end CHARACTERISTIC
/begin CHARACTERISTIC CmbdChrgnSys_iTolSwtThd_C "Current threshold for tolerance switch CCS DC" VALUE 0x8024FE94 RB_Val_Ws16 2047.969 RBPtCel_i_0p03125_1 -1024.000 1023.969 FORMAT "%8.3" /end CHARACTERISTIC
/begin CHARACTERISTIC CmbdChrgnSys_maskPlgUDcSq_C "Kalibriermaske der Signalqualität der Ladestecker Eingangsspannung, um CCS DC Laden freizugeben" VALUE 0x8024FE62 RB_Val_Wu16 65535.00 OneToOne 0.00 65535.00 FORMAT "%8.2" /end CHARACTERISTIC
/begin CHARACTERISTIC CmbdChrgnSys_ratSocTarCcsDc_C "Target SOC of HV battery to stop CCS DC charging" VALUE 0x8024FE64 RB_Val_Ws16 799.9878 Prc -400.0000 399.9878 FORMAT "%8.4" /end CHARACTERISTIC
/begin CHARACTERISTIC CmbdChrgnSys_tiDebPrecFinshd_C "Debounce time of precharge condition qualification to allow switch-on of charging contactors" VALUE 0x8024FE66 RB_Val_Wu16 655.3500 RBPtCel_ti_0p01_1 0.00 655.3500 FORMAT "%8.4" /end CHARACTERISTIC
/begin CHARACTERISTIC CmbdChrgnSys_tiDlyActILoCcsDc_C "Time delay for charging stop request in case of low input current of HV battery" VALUE 0x8024FE68 RB_Val_Wu16 655.3500 RBPtCel_ti_0p01_1 0.00 655.3500 FORMAT "%8.4" /end CHARACTERISTIC
/begin CHARACTERISTIC CmbdChrgnSys_tiDlyIDmd_C "The time used to delay the current demand" VALUE 0x8024FE98 RB_Val_Ws32 4294.96729500 Time_Dt -2147.48364800 2147.48364700 FORMAT "%13.8" /end CHARACTERISTIC
/begin CHARACTERISTIC CmbdChrgnSys_tiDlyIReq_C "The time used to delay the requested current" VALUE 0x8024FE9C RB_Val_Ws32 4294.96729500 Time_Dt -2147.48364800 2147.48364700 FORMAT "%13.8" /end CHARACTERISTIC
/begin CHARACTERISTIC CmbdChrgnSys_uDeTolr_C "Voltage deviation tolerance" VALUE 0x8024FEA0 RB_Val_Ws16 6553.500 RBPtCel_u_0p1_1 -3276.800 3276.700 FORMAT "%8.3" /end CHARACTERISTIC
/begin CHARACTERISTIC CmbdChrgnSys_uMaxPrecFinshd_C "Maximum voltage difference at the charging contactors to allow switch-on" VALUE 0x8024FE6A RB_Val_Ws16 3276.700 RBPtCel_u_0p1_1 0.00 3276.700 FORMAT "%8.3" EXTENDED_LIMITS -3276.800 3276.700 /end CHARACTERISTIC
/begin CHARACTERISTIC CmbdChrgnSys_uPlgDeTolr_C "Inlet voltage deviation tolerance" VALUE 0x8024FEA2 RB_Val_Ws16 6553.500 RBPtCel_u_0p1_1 -3276.800 3276.700 FORMAT "%8.3" /end CHARACTERISTIC
/begin CHARACTERISTIC CmbdChrgnSys_uTarExcddTolr_C "Target voltage exceeded tolerance" VALUE 0x8024FEA4 RB_Val_Ws16 6553.500 RBPtCel_u_0p1_1 -3276.800 3276.700 FORMAT "%8.3" /end CHARACTERISTIC
/begin CHARACTERISTIC CoElM_ModSelcn01_I.ElM_flgSwtSetStby_C "Class for operating mode selection of EM 1 / Switch to activate automatic STANDBY in standstill." VALUE 0x8024FEAC RB_Val_Wu8 1.00000000000 B_TRUE 0.00 1.00000000000 FORMAT "%13.11" /end CHARACTERISTIC
/begin CHARACTERISTIC CoElM_ModSelcn01_I.ElM_nActThdStby_C "Class for operating mode selection of EM 1 / threshold actual e-machine speed for setting inverter to STBY" VALUE 0x8024FEAE RB_Val_Ws16 65535.00 nmot_q1 -32768.00 32767.00 FORMAT "%8.2" /end CHARACTERISTIC
/begin CHARACTERISTIC CoElM_ModSelcn01_I.ElM_nThdStby_C "Class for operating mode selection of EM 1 / threshold e-machine speed for setting inverter to STBY" VALUE 0x8024FEB0 RB_Val_Ws16 65535.00 nmot_q1 -32768.00 32767.00 FORMAT "%8.2" /end CHARACTERISTIC
/begin CHARACTERISTIC CoElM_ModSelcn01_I.ElM_tiStbyToD_C "Class for operating mode selection of EM 1 / delay time for setting inverter in STBY in standstill" VALUE 0x8024FEB4 RB_Val_Ws32 4294.96729500 Time_Dt -2147.48364800 2147.48364700 FORMAT "%13.8" /end CHARACTERISTIC
/begin CHARACTERISTIC CoElM_ModSelcn01_I.ElM_tqThdStby_C "Class for operating mode selection of EM 1 / threshold e-machine torque for setting inverter to STBY" VALUE 0x8024FEB8 RB_Val_Ws16 6553.500 Trq -3276.800 3276.700 FORMAT "%8.3" /end CHARACTERISTIC
/begin CHARACTERISTIC CoElM_ModSelcn01_I.OffsCal_StM_I.ELM_flgOffsCalByIvtrAllwd_C "Class for operating mode selection of EM 1 / Offset calibration state machine / if set inverter offset calibration request is not ignored" VALUE 0x8024FEC0 RB_Val_Wu8 1.00000000000 B_TRUE 0.00 1.00000000000 FORMAT "%13.11" /end CHARACTERISTIC
/begin CHARACTERISTIC CoElM_ModSelcn01_I.OffsCal_StM_I.ELM_flgOffsCalEna_C "Class for operating mode selection of EM 1 / Offset calibration state machine / flag to start offset calibration via INCA" VALUE 0x8024FEC1 RB_Val_Wu8 1.00000000000 B_TRUE 0.00 1.00000000000 FORMAT "%13.11" /end CHARACTERISTIC
/begin CHARACTERISTIC CoElM_ModSelcn01_I.OffsCal_StM_I.ELM_flgToutActv_C "Class for operating mode selection of EM 1 / Offset calibration state machine / time out activation or deactivation" VALUE 0x8024FEC2 RB_Val_Wu8 1.00000000000 B_TRUE 0.00 1.00000000000 FORMAT "%13.11" /end CHARACTERISTIC
/begin CHARACTERISTIC CoElM_ModSelcn01_I.OffsCal_StM_I.ElM_maskFlgReqDiagVldSq_C "Class for operating mode selection of EM 1 / Offset calibration state machine / bitmask to detect valid signal quality at ComEmac_flgReqDiag_Sq" VALUE 0x8024FEC4 RB_Val_Wu16 65535.00 OneToOne 0.00 65535.00 FORMAT "%8.2" /end CHARACTERISTIC
/begin CHARACTERISTIC CoElM_ModSelcn01_I.OffsCal_StM_I.ElM_nMaxThdOffsCal_C "Class for operating mode selection of EM 1 / Offset calibration state machine / minimum speed for offsCal" VALUE 0x8024FEC6 RB_Val_Ws16 32767.00 nmot_q1 0.00 32767.00 FORMAT "%8.2" EXTENDED_LIMITS -32768.00 32767.00 /end CHARACTERISTIC
/begin CHARACTERISTIC CoElM_ModSelcn01_I.OffsCal_StM_I.ElM_nMinThdOffsCal_C "Class for operating mode selection of EM 1 / Offset calibration state machine / maximum speed for offsCal" VALUE 0x8024FEC8 RB_Val_Ws16 32767.00 nmot_q1 0.00 32767.00 FORMAT "%8.2" EXTENDED_LIMITS -32768.00 32767.00 /end CHARACTERISTIC
/begin CHARACTERISTIC CoElM_ModSelcn01_I.OffsCal_StM_I.ElM_tiOffsCalTout_C "Class for operating mode selection of EM 1 / Offset calibration state machine / time out time value in s" VALUE 0x8024FECC RB_Val_Ws32 4294.96729500 Time_Dt -2147.48364800 2147.48364700 FORMAT "%13.8" /end CHARACTERISTIC
/begin CHARACTERISTIC CoElM_SM01_I.ElM_tiWaitShtDwn_C "Class instance of CoElM_StM for electrical machine 01 / Max wait time until inverter shutdown." VALUE 0x8024FED4 RB_Val_Ws32 4294.96729500 Time_Dt -2147.48364800 2147.48364700 FORMAT "%13.8" /end CHARACTERISTIC
/begin CHARACTERISTIC Com_DiagMonStsByp_C "Bypass calibration for monitoring condition" VALUE 0x80257BEC Val_Wu8 1.00000000000 B_TRUE 0.00 1.00000000000 FORMAT "%13.11" /end CHARACTERISTIC
/begin CHARACTERISTIC Com_tiDiagOff_C "Calibration holding delay value" VALUE 0x80257BEE Val_Wu16 327.6750 t_q0p005 0.00 327.6750 FORMAT "%8.4" /end CHARACTERISTIC
/begin CHARACTERISTIC Com_tiDiagOn_C "Calibration holding counter value" VALUE 0x80257BF0 Val_Wu16 327.6750 t_q0p005 0.00 327.6750 FORMAT "%8.4" /end CHARACTERISTIC
/begin CHARACTERISTIC Com_tiGunCntInfoWkuOff_C "Calibration holding counter value" VALUE 0x80257BF2 Val_Wu16 327.6750 t_q0p005 0.00 327.6750 FORMAT "%8.4" /end CHARACTERISTIC
/begin CHARACTERISTIC Com_tiGunCntInfoWkuOn_C "Calibration holding counter value" VALUE 0x80257BF4 Val_Wu16 327.6750 t_q0p005 0.00 327.6750 FORMAT "%8.4" /end CHARACTERISTIC
/begin CHARACTERISTIC Com_tiHvBattRchrgWkuOff_C "Calibration holding counter value" VALUE 0x80257BF6 Val_Wu16 327.6750 t_q0p005 0.00 327.6750 FORMAT "%8.4" /end CHARACTERISTIC
/begin CHARACTERISTIC Com_tiHvBattRchrgWkuOn_C "Calibration holding counter value" VALUE 0x80257BF8 Val_Wu16 327.6750 t_q0p005 0.00 327.6750 FORMAT "%8.4" /end CHARACTERISTIC
/begin CHARACTERISTIC Com_tiImmoUnlockWkuOff_C "Calibration holding counter value" VALUE 0x8024E674 Val_Wu16 327.6750 t_q0p005 0.00 327.6750 FORMAT "%8.4" /end CHARACTERISTIC
/begin CHARACTERISTIC Com_tiImmoUnlockWkuOn_C "Calibration holding counter value" VALUE 0x80257BFA Val_Wu16 327.6750 t_q0p005 0.00 327.6750 FORMAT "%8.4" /end CHARACTERISTIC
/begin CHARACTERISTIC Com_tiInfoReqPtlWkuOff_C "Calibration holding counter value" VALUE 0x8024E676 Val_Wu16 327.6750 t_q0p005 0.00 327.6750 FORMAT "%8.4" /end CHARACTERISTIC
/begin CHARACTERISTIC Com_tiInfoReqPtlWkuOn_C "Calibration holding counter value" VALUE 0x8024E678 Val_Wu16 327.6750 t_q0p005 0.00 327.6750 FORMAT "%8.4" /end CHARACTERISTIC
/begin CHARACTERISTIC Com_tiPostOperationWkuOff_C "Calibration holding counter value" VALUE 0x80257BFC Val_Wu16 327.6750 t_q0p005 0.00 327.6750 FORMAT "%8.4" /end CHARACTERISTIC
/begin CHARACTERISTIC Com_tiPostOperationWkuOn_C "Calibration holding counter value" VALUE 0x8024E67A Val_Wu16 327.6750 t_q0p005 0.00 327.6750 FORMAT "%8.4" /end CHARACTERISTIC
/begin CHARACTERISTIC Com_tiPreCondElecWkuOff_C "Calibration holding counter value" VALUE 0x80257BFE Val_Wu16 327.6750 t_q0p005 0.00 327.6750 FORMAT "%8.4" /end CHARACTERISTIC
/begin CHARACTERISTIC Com_tiPreCondElecWkuOn_C "Calibration holding counter value" VALUE 0x80257C00 Val_Wu16 327.6750 t_q0p005 0.00 327.6750 FORMAT "%8.4" /end CHARACTERISTIC
/begin CHARACTERISTIC Com_tiRemoteChargingWkuOff_C "Calibration holding counter value" VALUE 0x80257C02 Val_Wu16 327.6750 t_q0p005 0.00 327.6750 FORMAT "%8.4" /end CHARACTERISTIC
/begin CHARACTERISTIC Com_tiRemoteChargingWkuOn_C "Calibration holding counter value" VALUE 0x80257C04 Val_Wu16 327.6750 t_q0p005 0.00 327.6750 FORMAT "%8.4" /end CHARACTERISTIC
/begin CHARACTERISTIC Com_tiRemUnlckWkuOff_C "Calibration holding counter value" VALUE 0x8024E67C Val_Wu16 327.6750 t_q0p005 0.00 327.6750 FORMAT "%8.4" /end CHARACTERISTIC
/begin CHARACTERISTIC Com_tiRemUnlckWkuOn_C "Calibration holding counter value" VALUE 0x80257C06 Val_Wu16 327.6750 t_q0p005 0.00 327.6750 FORMAT "%8.4" /end CHARACTERISTIC
/begin CHARACTERISTIC DcChrgnRlyNeg_O_S_ATS_ATS.LimitTypeMsk_C "" VALUE 0x80252F30 Val_Wu8 255.0 OneToOne 0.00 255.0 FORMAT "%5.1" /end CHARACTERISTIC
/begin CHARACTERISTIC DcChrgnRlyNeg_O_S_ATS_ATS.CnvNorm_C "" VALUE 0x80252F31 Val_Wu8 255.0 OneToOne 0.00 255.0 FORMAT "%5.1" /end CHARACTERISTIC
/begin CHARACTERISTIC DcChrgnRlyNeg_O_S_ATS_ATS.LowLim_C "" VALUE 0x80252F32 Val_Ws16 65535.00 OneToOne -32768.00 32767.00 FORMAT "%8.2" /end CHARACTERISTIC
/begin CHARACTERISTIC DcChrgnRlyNeg_O_S_ATS_ATS.UpLim_C "" VALUE 0x80252F34 Val_Ws16 65535.00 OneToOne -32768.00 32767.00 FORMAT "%8.2" /end CHARACTERISTIC
/begin CHARACTERISTIC DcChrgnRlyNeg_O_S_ATS_ATS.CnvFac_C "" VALUE 0x80252F38 Val_Ws32 4294967295.00 OneToOne -2147483648.00 2147483647.00 FORMAT "%13.2" /end CHARACTERISTIC
/begin CHARACTERISTIC DcChrgnRlyNeg_O_S_ATS_ATS.CnvOfs_C "" VALUE 0x80252F3C Val_Ws16 65535.00 OneToOne -32768.00 32767.00 FORMAT "%8.2" /end CHARACTERISTIC
/begin CHARACTERISTIC DcChrgnRlyNeg_O_S_ATS_ATS.DfltVal_C "" VALUE 0x80252F3E Val_Ws16 65535.00 OneToOne -32768.00 32767.00 FORMAT "%8.2" /end CHARACTERISTIC
/begin CHARACTERISTIC DcChrgnRlyPos_O_S_ATS_ATS.LimitTypeMsk_C "" VALUE 0x80252F40 Val_Wu8 255.0 OneToOne 0.00 255.0 FORMAT "%5.1" /end CHARACTERISTIC
/begin CHARACTERISTIC DcChrgnRlyPos_O_S_ATS_ATS.CnvNorm_C "" VALUE 0x80252F41 Val_Wu8 255.0 OneToOne 0.00 255.0 FORMAT "%5.1" /end CHARACTERISTIC
/begin CHARACTERISTIC DcChrgnRlyPos_O_S_ATS_ATS.LowLim_C "" VALUE 0x80252F42 Val_Ws16 65535.00 OneToOne -32768.00 32767.00 FORMAT "%8.2" /end CHARACTERISTIC
/begin CHARACTERISTIC DcChrgnRlyPos_O_S_ATS_ATS.UpLim_C "" VALUE 0x80252F44 Val_Ws16 65535.00 OneToOne -32768.00 32767.00 FORMAT "%8.2" /end CHARACTERISTIC
/begin CHARACTERISTIC DcChrgnRlyPos_O_S_ATS_ATS.CnvFac_C "" VALUE 0x80252F48 Val_Ws32 4294967295.00 OneToOne -2147483648.00 2147483647.00 FORMAT "%13.2" /end CHARACTERISTIC
/begin CHARACTERISTIC DcChrgnRlyPos_O_S_ATS_ATS.CnvOfs_C "" VALUE 0x80252F4C Val_Ws16 65535.00 OneToOne -32768.00 32767.00 FORMAT "%8.2" /end CHARACTERISTIC
/begin CHARACTERISTIC DcChrgnRlyPos_O_S_ATS_ATS.DfltVal_C "" VALUE 0x80252F4E Val_Ws16 65535.00 OneToOne -32768.00 32767.00 FORMAT "%8.2" /end CHARACTERISTIC
/begin CHARACTERISTIC DDRC_DurDeb.CmbdChrgnSys_tiIBattExcddDebOk_C "" VALUE 0x80240934 Val_Wu16 655350.0 DDRCTime_ms 0.00 655350.0 FORMAT "%8.1" /end CHARACTERISTIC
/begin CHARACTERISTIC DDRC_DurDeb.CmbdChrgnSys_tiIBattExcddDebDef_C "" VALUE 0x80240936 Val_Wu16 655350.0 DDRCTime_ms 0.00 655350.0 FORMAT "%8.1" /end CHARACTERISTIC
/begin CHARACTERISTIC DDRC_DurDeb.CmbdChrgnSys_tiIEvseOutDeDebOk_C "" VALUE 0x80240938 Val_Wu16 655350.0 DDRCTime_ms 0.00 655350.0 FORMAT "%8.1" /end CHARACTERISTIC
/begin CHARACTERISTIC DDRC_DurDeb.CmbdChrgnSys_tiIEvseOutDeDebDef_C "" VALUE 0x8024093A Val_Wu16 655350.0 DDRCTime_ms 0.00 655350.0 FORMAT "%8.1" /end CHARACTERISTIC
/begin CHARACTERISTIC DDRC_DurDeb.CmbdChrgnSys_tiIOutDeDebOk_C "" VALUE 0x8024093C Val_Wu16 655350.0 DDRCTime_ms 0.00 655350.0 FORMAT "%8.1" /end CHARACTERISTIC
/begin CHARACTERISTIC DDRC_DurDeb.CmbdChrgnSys_tiIOutDeDebDef_C "" VALUE 0x8024093E Val_Wu16 655350.0 DDRCTime_ms 0.00 655350.0 FORMAT "%8.1" /end CHARACTERISTIC
/begin CHARACTERISTIC DDRC_DurDeb.CmbdChrgnSys_tiIOutExcddDebOk_C "" VALUE 0x80240940 Val_Wu16 655350.0 DDRCTime_ms 0.00 655350.0 FORMAT "%8.1" /end CHARACTERISTIC
/begin CHARACTERISTIC DDRC_DurDeb.CmbdChrgnSys_tiIOutExcddDebDef_C "" VALUE 0x80240942 Val_Wu16 655350.0 DDRCTime_ms 0.00 655350.0 FORMAT "%8.1" /end CHARACTERISTIC
/begin CHARACTERISTIC DDRC_DurDeb.CmbdChrgnSys_tiUOutDeDebOk_C "" VALUE 0x80240944 Val_Wu16 655350.0 DDRCTime_ms 0.00 655350.0 FORMAT "%8.1" /end CHARACTERISTIC
/begin CHARACTERISTIC DDRC_DurDeb.CmbdChrgnSys_tiUOutDeDebDef_C "" VALUE 0x80240946 Val_Wu16 655350.0 DDRCTime_ms 0.00 655350.0 FORMAT "%8.1" /end CHARACTERISTIC
/begin CHARACTERISTIC DDRC_DurDeb.CmbdChrgnSys_tiUOutExcddDebOk_C "" VALUE 0x80240948 Val_Wu16 655350.0 DDRCTime_ms 0.00 655350.0 FORMAT "%8.1" /end CHARACTERISTIC
/begin CHARACTERISTIC DDRC_DurDeb.CmbdChrgnSys_tiUOutExcddDebDef_C "" VALUE 0x8024094A Val_Wu16 655350.0 DDRCTime_ms 0.00 655350.0 FORMAT "%8.1" /end CHARACTERISTIC
/begin CHARACTERISTIC DDRC_DurDeb.ChrgnCntct_tiHsOtDebOk_C "" VALUE 0x80240B44 Val_Wu16 655350.0 DDRCTime_ms 0.00 655350.0 FORMAT "%8.1" /end CHARACTERISTIC
/begin CHARACTERISTIC DDRC_DurDeb.ChrgnCntct_tiHsOtDebDef_C "" VALUE 0x80240B46 Val_Wu16 655350.0 DDRCTime_ms 0.00 655350.0 FORMAT "%8.1" /end CHARACTERISTIC
/begin CHARACTERISTIC DDRC_DurDeb.ChrgnCntct_tiHsScbDebOk_C "" VALUE 0x80240B48 Val_Wu16 655350.0 DDRCTime_ms 0.00 655350.0 FORMAT "%8.1" /end CHARACTERISTIC
/begin CHARACTERISTIC DDRC_DurDeb.ChrgnCntct_tiHsScbDebDef_C "" VALUE 0x80240B4A Val_Wu16 655350.0 DDRCTime_ms 0.00 655350.0 FORMAT "%8.1" /end CHARACTERISTIC
/begin CHARACTERISTIC DDRC_DurDeb.ChrgnCntct_tiHsScgDebOk_C "" VALUE 0x80240B4C Val_Wu16 655350.0 DDRCTime_ms 0.00 655350.0 FORMAT "%8.1" /end CHARACTERISTIC
/begin CHARACTERISTIC DDRC_DurDeb.ChrgnCntct_tiHsScgDebDef_C "" VALUE 0x80240B4E Val_Wu16 655350.0 DDRCTime_ms 0.00 655350.0 FORMAT "%8.1" /end CHARACTERISTIC
/begin CHARACTERISTIC DDRC_DurDeb.ChrgnCntct_tiLsNegOlDebOk_C "" VALUE 0x80240B50 Val_Wu16 655350.0 DDRCTime_ms 0.00 655350.0 FORMAT "%8.1" /end CHARACTERISTIC
/begin CHARACTERISTIC DDRC_DurDeb.ChrgnCntct_tiLsNegOlDebDef_C "" VALUE 0x80240B52 Val_Wu16 655350.0 DDRCTime_ms 0.00 655350.0 FORMAT "%8.1" /end CHARACTERISTIC
/begin CHARACTERISTIC DDRC_DurDeb.ChrgnCntct_tiLsNegOtDebOk_C "" VALUE 0x80240B54 Val_Wu16 655350.0 DDRCTime_ms 0.00 655350.0 FORMAT "%8.1" /end CHARACTERISTIC
/begin CHARACTERISTIC DDRC_DurDeb.ChrgnCntct_tiLsNegOtDebDef_C "" VALUE 0x80240B56 Val_Wu16 655350.0 DDRCTime_ms 0.00 655350.0 FORMAT "%8.1" /end CHARACTERISTIC
/begin CHARACTERISTIC DDRC_DurDeb.ChrgnCntct_tiLsNegScbDebOk_C "" VALUE 0x80240B58 Val_Wu16 655350.0 DDRCTime_ms 0.00 655350.0 FORMAT "%8.1" /end CHARACTERISTIC
/begin CHARACTERISTIC DDRC_DurDeb.ChrgnCntct_tiLsNegScbDebDef_C "" VALUE 0x80240B5A Val_Wu16 655350.0 DDRCTime_ms 0.00 655350.0 FORMAT "%8.1" /end CHARACTERISTIC
/begin CHARACTERISTIC DDRC_DurDeb.ChrgnCntct_tiLsNegScgDebOk_C "" VALUE 0x80240B5C Val_Wu16 655350.0 DDRCTime_ms 0.00 655350.0 FORMAT "%8.1" /end CHARACTERISTIC
/begin CHARACTERISTIC DDRC_DurDeb.ChrgnCntct_tiLsNegScgDebDef_C "" VALUE 0x80240B5E Val_Wu16 655350.0 DDRCTime_ms 0.00 655350.0 FORMAT "%8.1" /end CHARACTERISTIC
/begin CHARACTERISTIC DDRC_DurDeb.ChrgnCntct_tiLsPosOlDebOk_C "" VALUE 0x80240B60 Val_Wu16 655350.0 DDRCTime_ms 0.00 655350.0 FORMAT "%8.1" /end CHARACTERISTIC
/begin CHARACTERISTIC DDRC_DurDeb.ChrgnCntct_tiLsPosOlDebDef_C "" VALUE 0x80240B62 Val_Wu16 655350.0 DDRCTime_ms 0.00 655350.0 FORMAT "%8.1" /end CHARACTERISTIC
/begin CHARACTERISTIC DDRC_DurDeb.ChrgnCntct_tiLsPosOtDebOk_C "" VALUE 0x80240B64 Val_Wu16 655350.0 DDRCTime_ms 0.00 655350.0 FORMAT "%8.1" /end CHARACTERISTIC
/begin CHARACTERISTIC DDRC_DurDeb.ChrgnCntct_tiLsPosOtDebDef_C "" VALUE 0x80240B66 Val_Wu16 655350.0 DDRCTime_ms 0.00 655350.0 FORMAT "%8.1" /end CHARACTERISTIC
/begin CHARACTERISTIC DDRC_DurDeb.ChrgnCntct_tiLsPosScbDebOk_C "" VALUE 0x80240B68 Val_Wu16 655350.0 DDRCTime_ms 0.00 655350.0 FORMAT "%8.1" /end CHARACTERISTIC
/begin CHARACTERISTIC DDRC_DurDeb.ChrgnCntct_tiLsPosScbDebDef_C "" VALUE 0x80240B6A Val_Wu16 655350.0 DDRCTime_ms 0.00 655350.0 FORMAT "%8.1" /end CHARACTERISTIC
/begin CHARACTERISTIC DDRC_DurDeb.ChrgnCntct_tiLsPosScgDebOk_C "" VALUE 0x80240B6C Val_Wu16 655350.0 DDRCTime_ms 0.00 655350.0 FORMAT "%8.1" /end CHARACTERISTIC
/begin CHARACTERISTIC DDRC_DurDeb.ChrgnCntct_tiLsPosScgDebDef_C "" VALUE 0x80240B6E Val_Wu16 655350.0 DDRCTime_ms 0.00 655350.0 FORMAT "%8.1" /end CHARACTERISTIC
/begin CHARACTERISTIC DDRC_DurDeb.ChrgnCntct_tiUnUsedDebOk_C "" VALUE 0x80240B70 Val_Wu16 655350.0 DDRCTime_ms 0.00 655350.0 FORMAT "%8.1" /end CHARACTERISTIC
/begin CHARACTERISTIC DDRC_DurDeb.ChrgnCntct_tiUnUsedDebDef_C "" VALUE 0x80240B72 Val_Wu16 655350.0 DDRCTime_ms 0.00 655350.0 FORMAT "%8.1" /end CHARACTERISTIC
/begin CHARACTERISTIC DDRC_DurDeb.ChrgPlg_tiLiveCntctHzrdCcsDebOk_C "" VALUE 0x80241290 Val_Wu16 655350.0 DDRCTime_ms 0.00 655350.0 FORMAT "%8.1" /end CHARACTERISTIC
/begin CHARACTERISTIC DDRC_DurDeb.ChrgPlg_tiLiveCntctHzrdCcsDebDef_C "" VALUE 0x80241292 Val_Wu16 655350.0 DDRCTime_ms 0.00 655350.0 FORMAT "%8.1" /end CHARACTERISTIC
/begin CHARACTERISTIC DDRC_DurDeb.ChrgPlg_tiProxPltImpsDebOk_C "" VALUE 0x80241294 Val_Wu16 655350.0 DDRCTime_ms 0.00 655350.0 FORMAT "%8.1" /end CHARACTERISTIC
/begin CHARACTERISTIC DDRC_DurDeb.ChrgPlg_tiProxPltImpsDebDef_C "" VALUE 0x80241296 Val_Wu16 655350.0 DDRCTime_ms 0.00 655350.0 FORMAT "%8.1" /end CHARACTERISTIC
/begin CHARACTERISTIC DDRC_DurDeb.ChrgPlg_tiTHiCcsDcDebOk_C "" VALUE 0x80241298 Val_Wu16 655350.0 DDRCTime_ms 0.00 655350.0 FORMAT "%8.1" /end CHARACTERISTIC
/begin CHARACTERISTIC DDRC_DurDeb.ChrgPlg_tiTHiCcsDcDebDef_C "" VALUE 0x8024129A Val_Wu16 655350.0 DDRCTime_ms 0.00 655350.0 FORMAT "%8.1" /end CHARACTERISTIC
/begin CHARACTERISTIC DDRC_RatDeb.CmbdChrgnSys_tiIBattExcddUDRat_C "" VALUE 0x80248A51 Val_Wu8 3.00000000000 DDRC_Ratio 1.00000000000 4.00000000000 FORMAT "%13.11" /end CHARACTERISTIC
/begin CHARACTERISTIC DDRC_RatDeb.CmbdChrgnSys_tiIEvseOutDeUDRat_C "" VALUE 0x80248A52 Val_Wu8 3.00000000000 DDRC_Ratio 1.00000000000 4.00000000000 FORMAT "%13.11" /end CHARACTERISTIC
/begin CHARACTERISTIC DDRC_RatDeb.CmbdChrgnSys_tiIOutDeUDRat_C "" VALUE 0x80248A53 Val_Wu8 3.00000000000 DDRC_Ratio 1.00000000000 4.00000000000 FORMAT "%13.11" /end CHARACTERISTIC
/begin CHARACTERISTIC DDRC_RatDeb.CmbdChrgnSys_tiIOutExcddUDRat_C "" VALUE 0x80248A54 Val_Wu8 3.00000000000 DDRC_Ratio 1.00000000000 4.00000000000 FORMAT "%13.11" /end CHARACTERISTIC
/begin CHARACTERISTIC DDRC_RatDeb.CmbdChrgnSys_tiUOutDeUDRat_C "" VALUE 0x80248A55 Val_Wu8 3.00000000000 DDRC_Ratio 1.00000000000 4.00000000000 FORMAT "%13.11" /end CHARACTERISTIC
/begin CHARACTERISTIC DDRC_RatDeb.CmbdChrgnSys_tiUOutExcddUDRat_C "" VALUE 0x80248A56 Val_Wu8 3.00000000000 DDRC_Ratio 1.00000000000 4.00000000000 FORMAT "%13.11" /end CHARACTERISTIC
/begin CHARACTERISTIC DFC_CtlMsk2.DFC_ChrgnCntctHsOt_C "" VALUE 0x8024130A Val_Wu8 255.0 DFES_OneToOne 0.00 255.0 FORMAT "%5.1" /end CHARACTERISTIC
/begin CHARACTERISTIC DFC_CtlMsk2.DFC_ChrgnCntctHsScb_C "" VALUE 0x8024130B Val_Wu8 255.0 DFES_OneToOne 0.00 255.0 FORMAT "%5.1" /end CHARACTERISTIC
/begin CHARACTERISTIC DFC_CtlMsk2.DFC_ChrgnCntctHsScg_C "" VALUE 0x8024130C Val_Wu8 255.0 DFES_OneToOne 0.00 255.0 FORMAT "%5.1" /end CHARACTERISTIC
/begin CHARACTERISTIC DFC_CtlMsk2.DFC_ChrgnCntctLsNegOl_C "" VALUE 0x8024130D Val_Wu8 255.0 DFES_OneToOne 0.00 255.0 FORMAT "%5.1" /end CHARACTERISTIC
/begin CHARACTERISTIC DFC_CtlMsk2.DFC_ChrgnCntctLsNegOt_C "" VALUE 0x8024130E Val_Wu8 255.0 DFES_OneToOne 0.00 255.0 FORMAT "%5.1" /end CHARACTERISTIC
/begin CHARACTERISTIC DFC_CtlMsk2.DFC_ChrgnCntctLsNegScb_C "" VALUE 0x8024130F Val_Wu8 255.0 DFES_OneToOne 0.00 255.0 FORMAT "%5.1" /end CHARACTERISTIC
/begin CHARACTERISTIC DFC_CtlMsk2.DFC_ChrgnCntctLsNegScg_C "" VALUE 0x80241310 Val_Wu8 255.0 DFES_OneToOne 0.00 255.0 FORMAT "%5.1" /end CHARACTERISTIC
/begin CHARACTERISTIC DFC_CtlMsk2.DFC_ChrgnCntctLsPosOl_C "" VALUE 0x80241311 Val_Wu8 255.0 DFES_OneToOne 0.00 255.0 FORMAT "%5.1" /end CHARACTERISTIC
/begin CHARACTERISTIC DFC_CtlMsk2.DFC_ChrgnCntctLsPosOt_C "" VALUE 0x80241312 Val_Wu8 255.0 DFES_OneToOne 0.00 255.0 FORMAT "%5.1" /end CHARACTERISTIC
/begin CHARACTERISTIC DFC_CtlMsk2.DFC_ChrgnCntctLsPosScb_C "" VALUE 0x80241313 Val_Wu8 255.0 DFES_OneToOne 0.00 255.0 FORMAT "%5.1" /end CHARACTERISTIC
/begin CHARACTERISTIC DFC_CtlMsk2.DFC_ChrgnCntctLsPosScg_C "" VALUE 0x80241314 Val_Wu8 255.0 DFES_OneToOne 0.00 255.0 FORMAT "%5.1" /end CHARACTERISTIC
/begin CHARACTERISTIC DFC_CtlMsk2.DFC_ChrgnCntctUnUsed_C "" VALUE 0x80241315 Val_Wu8 255.0 DFES_OneToOne 0.00 255.0 FORMAT "%5.1" /end CHARACTERISTIC
/begin CHARACTERISTIC DFC_CtlMsk2.DFC_CcsDcIBattExcdd_C "" VALUE 0x802414FA Val_Wu8 255.0 DFES_OneToOne 0.00 255.0 FORMAT "%5.1" /end CHARACTERISTIC
/begin CHARACTERISTIC DFC_CtlMsk2.DFC_CcsDcIEvseOutDe_C "" VALUE 0x802414FB Val_Wu8 255.0 DFES_OneToOne 0.00 255.0 FORMAT "%5.1" /end CHARACTERISTIC
/begin CHARACTERISTIC DFC_CtlMsk2.DFC_CcsDcIOutDe_C "" VALUE 0x802414FC Val_Wu8 255.0 DFES_OneToOne 0.00 255.0 FORMAT "%5.1" /end CHARACTERISTIC
/begin CHARACTERISTIC DFC_CtlMsk2.DFC_CcsDcIOutExcdd_C "" VALUE 0x802414FD Val_Wu8 255.0 DFES_OneToOne 0.00 255.0 FORMAT "%5.1" /end CHARACTERISTIC
/begin CHARACTERISTIC DFC_CtlMsk2.DFC_CcsDcUOutDe_C "" VALUE 0x802414FE Val_Wu8 255.0 DFES_OneToOne 0.00 255.0 FORMAT "%5.1" /end CHARACTERISTIC
/begin CHARACTERISTIC DFC_CtlMsk2.DFC_CcsDcUOutExcdd_C "" VALUE 0x802414FF Val_Wu8 255.0 DFES_OneToOne 0.00 255.0 FORMAT "%5.1" /end CHARACTERISTIC
/begin CHARACTERISTIC DFC_CtlMsk2.DFC_ChrgPlgLiveCntctHzrdCcs_C "" VALUE 0x80241576 Val_Wu8 255.0 DFES_OneToOne 0.00 255.0 FORMAT "%5.1" /end CHARACTERISTIC
/begin CHARACTERISTIC DFC_CtlMsk2.DFC_ChrgPlgProxPltImps_C "" VALUE 0x80241577 Val_Wu8 255.0 DFES_OneToOne 0.00 255.0 FORMAT "%5.1" /end CHARACTERISTIC
/begin CHARACTERISTIC DFC_CtlMsk2.DFC_ChrgPlgTHiCcsDc_C "" VALUE 0x80241578 Val_Wu8 255.0 DFES_OneToOne 0.00 255.0 FORMAT "%5.1" /end CHARACTERISTIC
/begin CHARACTERISTIC DFC_CtlMsk2.DFC_ChgrPlugLockPinByndClsd_C "" VALUE 0x80241592 Val_Wu8 255.0 DFES_OneToOne 0.00 255.0 FORMAT "%5.1" /end CHARACTERISTIC
/begin CHARACTERISTIC DFC_CtlMsk2.DFC_ChgrPlugLockPinMoveWoCmd_C "" VALUE 0x80241593 Val_Wu8 255.0 DFES_OneToOne 0.00 255.0 FORMAT "%5.1" /end CHARACTERISTIC
/begin CHARACTERISTIC DFC_CtlMsk2.DFC_ChgrPlugLockPinStuckInClsd_C "" VALUE 0x80241594 Val_Wu8 255.0 DFES_OneToOne 0.00 255.0 FORMAT "%5.1" /end CHARACTERISTIC
/begin CHARACTERISTIC DFC_CtlMsk2.DFC_ChgrPlugLockPinStuckInOpen_C "" VALUE 0x80241595 Val_Wu8 255.0 DFES_OneToOne 0.00 255.0 FORMAT "%5.1" /end CHARACTERISTIC
/begin CHARACTERISTIC DFC_CtlMsk2.DFC_ChrgrStErr_C "" VALUE 0x80241596 Val_Wu8 255.0 DFES_OneToOne 0.00 255.0 FORMAT "%5.1" /end CHARACTERISTIC
/begin CHARACTERISTIC DFC_CtlMsk2.DFC_ChgrPlugCtpCarrFrqErr_C "" VALUE 0x802415D7 Val_Wu8 255.0 DFES_OneToOne 0.00 255.0 FORMAT "%5.1" /end CHARACTERISTIC
/begin CHARACTERISTIC DFC_CtlMsk2.DFC_ChgrPlugCtpSwtStuckClsd_C "" VALUE 0x802415D8 Val_Wu8 255.0 DFES_OneToOne 0.00 255.0 FORMAT "%5.1" /end CHARACTERISTIC
/begin CHARACTERISTIC DFC_CtlMsk2.DFC_ChgrPlugCtpSwtStuckOpen_C "" VALUE 0x802415D9 Val_Wu8 255.0 DFES_OneToOne 0.00 255.0 FORMAT "%5.1" /end CHARACTERISTIC
/begin CHARACTERISTIC DFC_CtlMsk2.DFC_ChgrPlugCtpUErrHi_C "" VALUE 0x802415DA Val_Wu8 255.0 DFES_OneToOne 0.00 255.0 FORMAT "%5.1" /end CHARACTERISTIC
/begin CHARACTERISTIC DFC_CtlMsk2.DFC_ChgrPlugPxp1SrcErr_C "" VALUE 0x802415DB Val_Wu8 255.0 DFES_OneToOne 0.00 255.0 FORMAT "%5.1" /end CHARACTERISTIC
/begin CHARACTERISTIC DFC_CtlMsk2.DFC_ChrgPlgIntlckFaild_C "" VALUE 0x802415E4 Val_Wu8 255.0 DFES_OneToOne 0.00 255.0 FORMAT "%5.1" /end CHARACTERISTIC
/begin CHARACTERISTIC DFC_CtlMsk2.DFC_CoElMOffsCalibActv01_C "" VALUE 0x802415E6 Val_Wu8 255.0 DFES_OneToOne 0.00 255.0 FORMAT "%5.1" /end CHARACTERISTIC
/begin CHARACTERISTIC DFC_DisblMsk2.DFC_ChrgnCntctHsOt_C "" VALUE 0x80248AFA Val_Wu16 65535.00 DFES_OneToOne 0.00 65535.00 FORMAT "%8.2" /end CHARACTERISTIC
/begin CHARACTERISTIC DFC_DisblMsk2.DFC_ChrgnCntctHsScb_C "" VALUE 0x80248AFC Val_Wu16 65535.00 DFES_OneToOne 0.00 65535.00 FORMAT "%8.2" /end CHARACTERISTIC
/begin CHARACTERISTIC DFC_DisblMsk2.DFC_ChrgnCntctHsScg_C "" VALUE 0x80248AFE Val_Wu16 65535.00 DFES_OneToOne 0.00 65535.00 FORMAT "%8.2" /end CHARACTERISTIC
/begin CHARACTERISTIC DFC_DisblMsk2.DFC_ChrgnCntctLsNegOl_C "" VALUE 0x80248B00 Val_Wu16 65535.00 DFES_OneToOne 0.00 65535.00 FORMAT "%8.2" /end CHARACTERISTIC
/begin CHARACTERISTIC DFC_DisblMsk2.DFC_ChrgnCntctLsNegOt_C "" VALUE 0x80248B02 Val_Wu16 65535.00 DFES_OneToOne 0.00 65535.00 FORMAT "%8.2" /end CHARACTERISTIC
/begin CHARACTERISTIC DFC_DisblMsk2.DFC_ChrgnCntctLsNegScb_C "" VALUE 0x80248B04 Val_Wu16 65535.00 DFES_OneToOne 0.00 65535.00 FORMAT "%8.2" /end CHARACTERISTIC
/begin CHARACTERISTIC DFC_DisblMsk2.DFC_ChrgnCntctLsNegScg_C "" VALUE 0x80248B06 Val_Wu16 65535.00 DFES_OneToOne 0.00 65535.00 FORMAT "%8.2" /end CHARACTERISTIC
/begin CHARACTERISTIC DFC_DisblMsk2.DFC_ChrgnCntctLsPosOl_C "" VALUE 0x80248B08 Val_Wu16 65535.00 DFES_OneToOne 0.00 65535.00 FORMAT "%8.2" /end CHARACTERISTIC
/begin CHARACTERISTIC DFC_DisblMsk2.DFC_ChrgnCntctLsPosOt_C "" VALUE 0x80248B0A Val_Wu16 65535.00 DFES_OneToOne 0.00 65535.00 FORMAT "%8.2" /end CHARACTERISTIC
/begin CHARACTERISTIC DFC_DisblMsk2.DFC_ChrgnCntctLsPosScb_C "" VALUE 0x80248B0C Val_Wu16 65535.00 DFES_OneToOne 0.00 65535.00 FORMAT "%8.2" /end CHARACTERISTIC
/begin CHARACTERISTIC DFC_DisblMsk2.DFC_ChrgnCntctLsPosScg_C "" VALUE 0x80248B0E Val_Wu16 65535.00 DFES_OneToOne 0.00 65535.00 FORMAT "%8.2" /end CHARACTERISTIC
/begin CHARACTERISTIC DFC_DisblMsk2.DFC_ChrgnCntctUnUsed_C "" VALUE 0x80248B10 Val_Wu16 65535.00 DFES_OneToOne 0.00 65535.00 FORMAT "%8.2" /end CHARACTERISTIC
/begin CHARACTERISTIC DFC_DisblMsk2.DFC_CcsDcIBattExcdd_C "" VALUE 0x80248EDA Val_Wu16 65535.00 DFES_OneToOne 0.00 65535.00 FORMAT "%8.2" /end CHARACTERISTIC
/begin CHARACTERISTIC DFC_DisblMsk2.DFC_CcsDcIEvseOutDe_C "" VALUE 0x80248EDC Val_Wu16 65535.00 DFES_OneToOne 0.00 65535.00 FORMAT "%8.2" /end CHARACTERISTIC
/begin CHARACTERISTIC DFC_DisblMsk2.DFC_CcsDcIOutDe_C "" VALUE 0x80248EDE Val_Wu16 65535.00 DFES_OneToOne 0.00 65535.00 FORMAT "%8.2" /end CHARACTERISTIC
/begin CHARACTERISTIC DFC_DisblMsk2.DFC_CcsDcIOutExcdd_C "" VALUE 0x80248EE0 Val_Wu16 65535.00 DFES_OneToOne 0.00 65535.00 FORMAT "%8.2" /end CHARACTERISTIC
/begin CHARACTERISTIC DFC_DisblMsk2.DFC_CcsDcUOutDe_C "" VALUE 0x80248EE2 Val_Wu16 65535.00 DFES_OneToOne 0.00 65535.00 FORMAT "%8.2" /end CHARACTERISTIC
/begin CHARACTERISTIC DFC_DisblMsk2.DFC_CcsDcUOutExcdd_C "" VALUE 0x80248EE4 Val_Wu16 65535.00 DFES_OneToOne 0.00 65535.00 FORMAT "%8.2" /end CHARACTERISTIC
/begin CHARACTERISTIC DFC_DisblMsk2.DFC_ChrgPlgLiveCntctHzrdCcs_C "" VALUE 0x80248FD2 Val_Wu16 65535.00 DFES_OneToOne 0.00 65535.00 FORMAT "%8.2" /end CHARACTERISTIC
/begin CHARACTERISTIC DFC_DisblMsk2.DFC_ChrgPlgProxPltImps_C "" VALUE 0x80248FD4 Val_Wu16 65535.00 DFES_OneToOne 0.00 65535.00 FORMAT "%8.2" /end CHARACTERISTIC
/begin CHARACTERISTIC DFC_DisblMsk2.DFC_ChrgPlgTHiCcsDc_C "" VALUE 0x80248FD6 Val_Wu16 65535.00 DFES_OneToOne 0.00 65535.00 FORMAT "%8.2" /end CHARACTERISTIC
/begin CHARACTERISTIC DFC_DisblMsk2.DFC_ChgrPlugLockPinByndClsd_C "" VALUE 0x8024900A Val_Wu16 65535.00 DFES_OneToOne 0.00 65535.00 FORMAT "%8.2" /end CHARACTERISTIC
/begin CHARACTERISTIC DFC_DisblMsk2.DFC_ChgrPlugLockPinMoveWoCmd_C "" VALUE 0x8024900C Val_Wu16 65535.00 DFES_OneToOne 0.00 65535.00 FORMAT "%8.2" /end CHARACTERISTIC
/begin CHARACTERISTIC DFC_DisblMsk2.DFC_ChgrPlugLockPinStuckInClsd_C "" VALUE 0x8024900E Val_Wu16 65535.00 DFES_OneToOne 0.00 65535.00 FORMAT "%8.2" /end CHARACTERISTIC
/begin CHARACTERISTIC DFC_DisblMsk2.DFC_ChgrPlugLockPinStuckInOpen_C "" VALUE 0x80249010 Val_Wu16 65535.00 DFES_OneToOne 0.00 65535.00 FORMAT "%8.2" /end CHARACTERISTIC
/begin CHARACTERISTIC DFC_DisblMsk2.DFC_ChrgrStErr_C "" VALUE 0x80249012 Val_Wu16 65535.00 DFES_OneToOne 0.00 65535.00 FORMAT "%8.2" /end CHARACTERISTIC
/begin CHARACTERISTIC DFC_DisblMsk2.DFC_ChgrPlugCtpCarrFrqErr_C "" VALUE 0x80249094 Val_Wu16 65535.00 DFES_OneToOne 0.00 65535.00 FORMAT "%8.2" /end CHARACTERISTIC
/begin CHARACTERISTIC DFC_DisblMsk2.DFC_ChgrPlugCtpSwtStuckClsd_C "" VALUE 0x80249096 Val_Wu16 65535.00 DFES_OneToOne 0.00 65535.00 FORMAT "%8.2" /end CHARACTERISTIC
/begin CHARACTERISTIC DFC_DisblMsk2.DFC_ChgrPlugCtpSwtStuckOpen_C "" VALUE 0x80249098 Val_Wu16 65535.00 DFES_OneToOne 0.00 65535.00 FORMAT "%8.2" /end CHARACTERISTIC
/begin CHARACTERISTIC DFC_DisblMsk2.DFC_ChgrPlugCtpUErrHi_C "" VALUE 0x8024909A Val_Wu16 65535.00 DFES_OneToOne 0.00 65535.00 FORMAT "%8.2" /end CHARACTERISTIC
/begin CHARACTERISTIC DFC_DisblMsk2.DFC_ChgrPlugPxp1SrcErr_C "" VALUE 0x8024909C Val_Wu16 65535.00 DFES_OneToOne 0.00 65535.00 FORMAT "%8.2" /end CHARACTERISTIC
/begin CHARACTERISTIC DFC_DisblMsk2.DFC_ChrgPlgIntlckFaild_C "" VALUE 0x802490AE Val_Wu16 65535.00 DFES_OneToOne 0.00 65535.00 FORMAT "%8.2" /end CHARACTERISTIC
/begin CHARACTERISTIC DFC_DisblMsk2.DFC_CoElMOffsCalibActv01_C "" VALUE 0x802490B2 Val_Wu16 65535.00 DFES_OneToOne 0.00 65535.00 FORMAT "%8.2" /end CHARACTERISTIC
/begin MEASUREMENT ChgrPlug_cntrCtpSwtTog "Counter that counts the control pilot switch (S2) toggles" UWORD OneToOne 1 100 0.00 65535.00 FORMAT "%8.2" ECU_ADDRESS 0x70001518
 /begin IF_DATA XCPplus 0x0102
  /begin DAQ_EVENT VARIABLE /end DAQ_EVENT
 /end IF_DATA
/end MEASUREMENT
/begin MEASUREMENT ChgrPlug_cntrPlgLockActrActvn "Counter for actuator activations" UBYTE OneToOne 1 100 0.00 255.0 FORMAT "%5.1" ECU_ADDRESS 0x70001337
 /begin IF_DATA XCPplus 0x0102
  /begin DAQ_EVENT VARIABLE /end DAQ_EVENT
 /end IF_DATA
/end MEASUREMENT
/begin MEASUREMENT ChgrPlug_flgCtpSwtActr "Desired CP switch state" UBYTE B_TRUE 1 100 0.00 1.00000000000 BIT_MASK 0x1 FORMAT "%13.11" ECU_ADDRESS 0x700001A8
 /begin IF_DATA XCPplus 0x0102
  /begin DAQ_EVENT VARIABLE /end DAQ_EVENT
 /end IF_DATA
/end MEASUREMENT
/begin MEASUREMENT ChgrPlug_flgCtpSwtTogActv "Flag set to true if toggling of S2 switch is active" UBYTE B_TRUE 1 100 0.00 1.00000000000 BIT_MASK 0x1 FORMAT "%13.11" ECU_ADDRESS 0x7000028D
 /begin IF_DATA XCPplus 0x0102
  /begin DAQ_EVENT VARIABLE /end DAQ_EVENT
 /end IF_DATA
/end MEASUREMENT
/begin MEASUREMENT ChgrPlug_flgCtpSwtTogReq "Flag indicates that a toggling of the S2-switch is requested by the charge control" UBYTE B_TRUE 1 100 0.00 1.00000000000 BIT_MASK 0x1 FORMAT "%13.11" ECU_ADDRESS 0x700001A7
 /begin IF_DATA XCPplus 0x0102
  /begin DAQ_EVENT VARIABLE /end DAQ_EVENT
 /end IF_DATA
/end MEASUREMENT
/begin MEASUREMENT ChgrPlug_flgCtPSwtVld "Valid flag of Control Pilot to ASW" UBYTE B_TRUE 1 100 0.00 1.00000000000 BIT_MASK 0x1 FORMAT "%13.11" ECU_ADDRESS 0x7000028E
 /begin IF_DATA XCPplus 0x0102
  /begin DAQ_EVENT VARIABLE /end DAQ_EVENT
 /end IF_DATA
/end MEASUREMENT
/begin MEASUREMENT ChgrPlug_flgDigComRqrd "Digital communication required (PLC) - IEC 61851." UBYTE B_TRUE 1 100 0.00 1.00000000000 BIT_MASK 0x1 FORMAT "%13.11" ECU_ADDRESS 0x7000028C
 /begin IF_DATA XCPplus 0x0102
  /begin DAQ_EVENT VARIABLE /end DAQ_EVENT
 /end IF_DATA
/end MEASUREMENT
/begin MEASUREMENT ChgrPlug_iCblLimCcs "Cable current limitation interface to ASW" SWORD RBPtCel_i_0p03125_1 1 100 -1024.000 1023.969 FORMAT "%8.3" ECU_ADDRESS 0x70001570
 /begin IF_DATA XCPplus 0x0102
  /begin DAQ_EVENT VARIABLE /end DAQ_EVENT
 /end IF_DATA
/end MEASUREMENT
/begin MEASUREMENT ChgrPlug_iCtPLim "Maximum current to be drawn by vehicle" SWORD RBPtCel_i_0p03125_1 1 100 -1024.000 1023.969 FORMAT "%8.3" ECU_ADDRESS 0x6001FC06
 /begin IF_DATA XCPplus 0x0102
  /begin DAQ_EVENT VARIABLE /end DAQ_EVENT
 /end IF_DATA
/end MEASUREMENT
/begin MEASUREMENT ChgrPlug_iDc "DC current at charge inlet" SWORD RBPtCel_i_0p03125_1 1 100 -1024.000 1023.969 FORMAT "%8.3" ECU_ADDRESS 0x6001FC04
 /begin IF_DATA XCPplus 0x0102
  /begin DAQ_EVENT VARIABLE /end DAQ_EVENT
 /end IF_DATA
/end MEASUREMENT
/begin MEASUREMENT ChgrPlug_iDc_Sq "Signal qualifier for DC current at charge inlet" UBYTE SigQly_COMPU_VERB 1 100 0.00 15.0000000000 FORMAT "%13.10" ECU_ADDRESS 0x60023666
 /begin IF_DATA XCPplus 0x0102
  /begin DAQ_EVENT VARIABLE /end DAQ_EVENT
 /end IF_DATA
/end MEASUREMENT
/begin MEASUREMENT ChgrPlug_stCtP "charging system state" UBYTE RBPtEChrDv_stCtP_VERB 1 100 0.00 9.00000000000 FORMAT "%13.11" ECU_ADDRESS 0x60023665
 /begin IF_DATA XCPplus 0x0102
  /begin DAQ_EVENT VARIABLE /end DAQ_EVENT
 /end IF_DATA
/end MEASUREMENT
/begin MEASUREMENT ChgrPlug_stCtpDetd "CP detection status" UBYTE OneToOne 1 100 0.00 255.0 FORMAT "%5.1" ECU_ADDRESS 0x60023664
 /begin IF_DATA XCPplus 0x0102
  /begin DAQ_EVENT VARIABLE /end DAQ_EVENT
 /end IF_DATA
/end MEASUREMENT
/begin MEASUREMENT ChgrPlug_stCtpInt "FC internal control pilot state" UBYTE OneToOne 1 100 0.00 255.0 FORMAT "%5.1" ECU_ADDRESS 0x600231C1
 /begin IF_DATA XCPplus 0x0102
  /begin DAQ_EVENT VARIABLE /end DAQ_EVENT
 /end IF_DATA
/end MEASUREMENT
/begin MEASUREMENT ChgrPlug_stCtpIntUnfild "FC internal control pilot state before filtering" UBYTE OneToOne 1 100 0.00 255.0 FORMAT "%5.1" ECU_ADDRESS 0x600231C0
 /begin IF_DATA XCPplus 0x0102
  /begin DAQ_EVENT VARIABLE /end DAQ_EVENT
 /end IF_DATA
/end MEASUREMENT
/begin MEASUREMENT ChgrPlug_stCtpSwtDebd "Debounced internal state used for S2 diagnosis" UBYTE OneToOne 1 100 0.00 255.0 FORMAT "%5.1" ECU_ADDRESS 0x70001333
 /begin IF_DATA XCPplus 0x0102
  /begin DAQ_EVENT VARIABLE /end DAQ_EVENT
 /end IF_DATA
/end MEASUREMENT
/begin MEASUREMENT ChgrPlug_stCtpSwtNotDebd "Internal state used for S2 diagnosis before debouncing" UBYTE OneToOne 1 100 0.00 255.0 FORMAT "%5.1" ECU_ADDRESS 0x70001331
 /begin IF_DATA XCPplus 0x0102
  /begin DAQ_EVENT VARIABLE /end DAQ_EVENT
 /end IF_DATA
/end MEASUREMENT
/begin MEASUREMENT ChgrPlug_stPlgLock "Charge plug lock state" UBYTE RBPtEChrDv_stPlgLock_VERB 1 100 0.00 9.00000000000 FORMAT "%13.11" ECU_ADDRESS 0x700014FA
 /begin IF_DATA XCPplus 0x0102
  /begin DAQ_EVENT VARIABLE /end DAQ_EVENT
 /end IF_DATA
/end MEASUREMENT
/begin MEASUREMENT ChgrPlug_stPlgLockStMac "Internal state of charge lock state machine" UBYTE ChgrPlug_stPlgLockStMac_VERB 1 100 0.00 16.0000000000 FORMAT "%13.10" ECU_ADDRESS 0x70001336
 /begin IF_DATA XCPplus 0x0102
  /begin DAQ_EVENT VARIABLE /end DAQ_EVENT
 /end IF_DATA
/end MEASUREMENT
/begin MEASUREMENT ChgrPlug_stPxp1Int "status of proximity pilot 1 (AC), undebounced, received over HW (voltage)" UBYTE OneToOne 1 100 0.00 255.0 FORMAT "%5.1" ECU_ADDRESS 0x70001327
 /begin IF_DATA XCPplus 0x0102
  /begin DAQ_EVENT VARIABLE /end DAQ_EVENT
 /end IF_DATA
/end MEASUREMENT
/begin MEASUREMENT ChgrPlug_stPxp1IntDebd "status of proximity pilot 1 (AC), debounced" UBYTE OneToOne 1 100 0.00 255.0 FORMAT "%5.1" ECU_ADDRESS 0x70001326
 /begin IF_DATA XCPplus 0x0102
  /begin DAQ_EVENT VARIABLE /end DAQ_EVENT
 /end IF_DATA
/end MEASUREMENT
/begin MEASUREMENT ChgrPlug_stPxPCcs "state proximity pilot Combined Charging System" UBYTE RBPtEChrDv_stPxP_VERB 1 100 0.00 5.00000000000 FORMAT "%13.11" ECU_ADDRESS 0x700014F9
 /begin IF_DATA XCPplus 0x0102
  /begin DAQ_EVENT VARIABLE /end DAQ_EVENT
 /end IF_DATA
/end MEASUREMENT
/begin MEASUREMENT ChgrPlug_stStMacPxp1 "status of state machine of proximity pilot 1 (AC)" UBYTE OneToOne 1 100 0.00 255.0 FORMAT "%5.1" ECU_ADDRESS 0x70001325
 /begin IF_DATA XCPplus 0x0102
  /begin DAQ_EVENT VARIABLE /end DAQ_EVENT
 /end IF_DATA
/end MEASUREMENT
/begin MEASUREMENT ChgrPlug_stTPinCcsDc "Status of the temperature sensor for DC charging." UBYTE RBPtEChrDv_stTPin_VERB 1 100 0.00 3.00000000000 FORMAT "%13.11" ECU_ADDRESS 0x6002346A
 /begin IF_DATA XCPplus 0x0102
  /begin DAQ_EVENT VARIABLE /end DAQ_EVENT
 /end IF_DATA
/end MEASUREMENT
/begin MEASUREMENT ChgrPlug_tiPlgLock "internal timer of plug lock" UWORD RBPtCel_ti_0p001_2 1 100 0.00 65.53500 FORMAT "%8.5" ECU_ADDRESS 0x70001334
 /begin IF_DATA XCPplus 0x0102
  /begin DAQ_EVENT VARIABLE /end DAQ_EVENT
 /end IF_DATA
/end MEASUREMENT
/begin MEASUREMENT ChgrPlug_tPinCcsDc "Temperature from the DC charging inlet pin." SWORD RBPtCel_t_0p1_3 1 100 -3276.800 3276.700 FORMAT "%8.3" ECU_ADDRESS 0x6001F9FE
 /begin IF_DATA XCPplus 0x0102
  /begin DAQ_EVENT VARIABLE /end DAQ_EVENT
 /end IF_DATA
/end MEASUREMENT
/begin MEASUREMENT ChgrPlug_uDc "DC intake voltage at the charge inlet" SWORD RBPtCel_u_0p1_1 1 100 -3276.800 3276.700 FORMAT "%8.3" ECU_ADDRESS 0x6001FC02
 /begin IF_DATA XCPplus 0x0102
  /begin DAQ_EVENT VARIABLE /end DAQ_EVENT
 /end IF_DATA
/end MEASUREMENT
/begin MEASUREMENT ChgrPlug_uDc_Sq "Signal qualifier for DC voltage at charge inlet" UBYTE SigQly_COMPU_VERB 1 100 0.00 15.0000000000 FORMAT "%13.10" ECU_ADDRESS 0x60023661
 /begin IF_DATA XCPplus 0x0102
  /begin DAQ_EVENT VARIABLE /end DAQ_EVENT
 /end IF_DATA
/end MEASUREMENT
/begin MEASUREMENT ChrgnCntct_DigOutPrmStructHs.tiBtwTstSCB_C "High side error information from ASIC / Structure containing parameters for Digital output power stage error handling" SWORD OneToOne 1 100 -32768.00 32767.00 FORMAT "%8.2" ECU_ADDRESS 0x6001F588 /end MEASUREMENT
/begin MEASUREMENT ChrgnCntct_DigOutPrmStructHs.tiBtwTstOT_C "High side error information from ASIC / Time between tests for OT error" SWORD OneToOne 1 100 -32768.00 32767.00 FORMAT "%8.2" ECU_ADDRESS 0x6001F58A /end MEASUREMENT
/begin MEASUREMENT ChrgnCntct_DigOutPrmStructHs.numTstMax_C "High side error information from ASIC / Maximum number of tests allowed on permanent defect" UWORD OneToOne 1 100 0.00 65535.00 FORMAT "%8.2" ECU_ADDRESS 0x6001F58C /end MEASUREMENT
/begin MEASUREMENT ChrgnCntct_DigOutPrmStructLsNeg.tiBtwTstSCB_C "LS Neg error information from ASIC / Structure containing parameters for Digital output power stage error handling" SWORD OneToOne 1 100 -32768.00 32767.00 FORMAT "%8.2" ECU_ADDRESS 0x6001F582 /end MEASUREMENT
/begin MEASUREMENT ChrgnCntct_DigOutPrmStructLsNeg.tiBtwTstOT_C "LS Neg error information from ASIC / Time between tests for OT error" SWORD OneToOne 1 100 -32768.00 32767.00 FORMAT "%8.2" ECU_ADDRESS 0x6001F584 /end MEASUREMENT
/begin MEASUREMENT ChrgnCntct_DigOutPrmStructLsNeg.numTstMax_C "LS Neg error information from ASIC / Maximum number of tests allowed on permanent defect" UWORD OneToOne 1 100 0.00 65535.00 FORMAT "%8.2" ECU_ADDRESS 0x6001F586 /end MEASUREMENT
/begin MEASUREMENT ChrgnCntct_DigOutPrmStructLsPos.tiBtwTstSCB_C "LS pos error information from ASIC / Structure containing parameters for Digital output power stage error handling" SWORD OneToOne 1 100 -32768.00 32767.00 FORMAT "%8.2" ECU_ADDRESS 0x6001F57C /end MEASUREMENT
/begin MEASUREMENT ChrgnCntct_DigOutPrmStructLsPos.tiBtwTstOT_C "LS pos error information from ASIC / Time between tests for OT error" SWORD OneToOne 1 100 -32768.00 32767.00 FORMAT "%8.2" ECU_ADDRESS 0x6001F57E /end MEASUREMENT
/begin MEASUREMENT ChrgnCntct_DigOutPrmStructLsPos.numTstMax_C "LS pos error information from ASIC / Maximum number of tests allowed on permanent defect" UWORD OneToOne 1 100 0.00 65535.00 FORMAT "%8.2" ECU_ADDRESS 0x6001F580 /end MEASUREMENT
/begin MEASUREMENT ChrgnCntct_DigOutStatStructHs.tmrTBtwTst "HS error information from ASIC / Timer to save the time between tests" SWORD SrvB_SWTmrS16 1 100 -32768.00 32767.00 FORMAT "%8.2" ECU_ADDRESS 0x6001F576 /end MEASUREMENT
/begin MEASUREMENT ChrgnCntct_DigOutStatStructHs.ctTstDne "HS error information from ASIC / Static counter to save the test impulse in permanent error" UWORD OneToOne 1 100 0.00 65535.00 FORMAT "%8.2" ECU_ADDRESS 0x6001F578 /end MEASUREMENT
/begin MEASUREMENT ChrgnCntct_DigOutStatStructHs.stPrevTstRslt "HS error information from ASIC / Test Status of Power Stage Diagnosis" UWORD OneToOne 1 100 0.00 65535.00 FORMAT "%8.2" ECU_ADDRESS 0x6001F57A /end MEASUREMENT
/begin MEASUREMENT ChrgnCntct_DigOutStatStructLsNeg.tmrTBtwTst "LS Neg error information from ASIC / Timer to save the time between tests" SWORD SrvB_SWTmrS16 1 100 -32768.00 32767.00 FORMAT "%8.2" ECU_ADDRESS 0x6001F570 /end MEASUREMENT
/begin MEASUREMENT ChrgnCntct_DigOutStatStructLsNeg.ctTstDne "LS Neg error information from ASIC / Static counter to save the test impulse in permanent error" UWORD OneToOne 1 100 0.00 65535.00 FORMAT "%8.2" ECU_ADDRESS 0x6001F572 /end MEASUREMENT
/begin MEASUREMENT ChrgnCntct_DigOutStatStructLsNeg.stPrevTstRslt "LS Neg error information from ASIC / Test Status of Power Stage Diagnosis" UWORD OneToOne 1 100 0.00 65535.00 FORMAT "%8.2" ECU_ADDRESS 0x6001F574 /end MEASUREMENT
/begin MEASUREMENT ChrgnCntct_DigOutStatStructLsPos.tmrTBtwTst "LS Pos error information from ASIC / Timer to save the time between tests" SWORD SrvB_SWTmrS16 1 100 -32768.00 32767.00 FORMAT "%8.2" ECU_ADDRESS 0x6001F56A /end MEASUREMENT
/begin MEASUREMENT ChrgnCntct_DigOutStatStructLsPos.ctTstDne "LS Pos error information from ASIC / Static counter to save the test impulse in permanent error" UWORD OneToOne 1 100 0.00 65535.00 FORMAT "%8.2" ECU_ADDRESS 0x6001F56C /end MEASUREMENT
/begin MEASUREMENT ChrgnCntct_DigOutStatStructLsPos.stPrevTstRslt "LS Pos error information from ASIC / Test Status of Power Stage Diagnosis" UWORD OneToOne 1 100 0.00 65535.00 FORMAT "%8.2" ECU_ADDRESS 0x6001F56E /end MEASUREMENT
/begin MEASUREMENT ChrgnCntct_flgCntctNegAts "ATS based negative contactor position" UBYTE OneToOne 1 100 0.00 255.0 FORMAT "%5.1" ECU_ADDRESS 0x600231CA
 /begin IF_DATA XCPplus 0x0102
  /begin DAQ_EVENT VARIABLE /end DAQ_EVENT
 /end IF_DATA
/end MEASUREMENT
/begin MEASUREMENT ChrgnCntct_flgCntctPosAts "ATS based positive contactor position" UBYTE OneToOne 1 100 0.00 255.0 FORMAT "%5.1" ECU_ADDRESS 0x600231C9
 /begin IF_DATA XCPplus 0x0102
  /begin DAQ_EVENT VARIABLE /end DAQ_EVENT
 /end IF_DATA
/end MEASUREMENT
/begin MEASUREMENT ChrgnCntct_flgHsActr "Desired HS driver status" UBYTE B_TRUE 1 100 0.00 1.00000000000 BIT_MASK 0x1 FORMAT "%13.11" ECU_ADDRESS 0x7000028B
 /begin IF_DATA XCPplus 0x0102
  /begin DAQ_EVENT VARIABLE /end DAQ_EVENT
 /end IF_DATA
/end MEASUREMENT
/begin MEASUREMENT ChrgnCntct_flgLsNegActr "Desired LS Neg driver status" UBYTE B_TRUE 1 100 0.00 1.00000000000 BIT_MASK 0x1 FORMAT "%13.11" ECU_ADDRESS 0x7000028A
 /begin IF_DATA XCPplus 0x0102
  /begin DAQ_EVENT VARIABLE /end DAQ_EVENT
 /end IF_DATA
/end MEASUREMENT
/begin MEASUREMENT ChrgnCntct_flgLsPosActr "Desired LS Pos driver status" UBYTE B_TRUE 1 100 0.00 1.00000000000 BIT_MASK 0x1 FORMAT "%13.11" ECU_ADDRESS 0x70000289
 /begin IF_DATA XCPplus 0x0102
  /begin DAQ_EVENT VARIABLE /end DAQ_EVENT
 /end IF_DATA
/end MEASUREMENT
/begin MEASUREMENT ChrgnCntct_flgPsActvnDisad "Power stage enabling condition status" UBYTE B_TRUE 1 100 0.00 1.00000000000 BIT_MASK 0x1 FORMAT "%13.11" ECU_ADDRESS 0x700001B4
 /begin IF_DATA XCPplus 0x0102
  /begin DAQ_EVENT VARIABLE /end DAQ_EVENT
 /end IF_DATA
/end MEASUREMENT
/begin MEASUREMENT ChrgnCntct_flgPsDiagDisad "Power stage diagnosis enabling condition" UBYTE B_TRUE 1 100 0.00 1.00000000000 BIT_MASK 0x1 FORMAT "%13.11" ECU_ADDRESS 0x700001B3
 /begin IF_DATA XCPplus 0x0102
  /begin DAQ_EVENT VARIABLE /end DAQ_EVENT
 /end IF_DATA
/end MEASUREMENT
/begin MEASUREMENT ChrgnCntct_flgPsDisad "Power state fault condition" UBYTE B_TRUE 1 100 0.00 1.00000000000 BIT_MASK 0x1 FORMAT "%13.11" ECU_ADDRESS 0x700001B2
 /begin IF_DATA XCPplus 0x0102
  /begin DAQ_EVENT VARIABLE /end DAQ_EVENT
 /end IF_DATA
/end MEASUREMENT
/begin MEASUREMENT ChrgnCntct_flgScbLocnActv "Short circuit battery fault status" UBYTE B_TRUE 1 100 0.00 1.00000000000 BIT_MASK 0x1 FORMAT "%13.11" ECU_ADDRESS 0x700001B1
 /begin IF_DATA XCPplus 0x0102
  /begin DAQ_EVENT VARIABLE /end DAQ_EVENT
 /end IF_DATA
/end MEASUREMENT
/begin MEASUREMENT ChrgnCntct_flgScgLocnActv "Short circuit ground status" UBYTE B_TRUE 1 100 0.00 1.00000000000 BIT_MASK 0x1 FORMAT "%13.11" ECU_ADDRESS 0x700001AF
 /begin IF_DATA XCPplus 0x0102
  /begin DAQ_EVENT VARIABLE /end DAQ_EVENT
 /end IF_DATA
/end MEASUREMENT
/begin MEASUREMENT ChrgnCntct_stErrNeg "Error information on Negative contactor from ASIC" UWORD OneToOne 1 100 0.00 65535.00 FORMAT "%8.2" ECU_ADDRESS 0x6001F590
 /begin IF_DATA XCPplus 0x0102
  /begin DAQ_EVENT VARIABLE /end DAQ_EVENT
 /end IF_DATA
/end MEASUREMENT
/begin MEASUREMENT ChrgnCntct_stErrPos "Error information on Positive contactor from ASIC" UWORD OneToOne 1 100 0.00 65535.00 FORMAT "%8.2" ECU_ADDRESS 0x6001F58E
 /begin IF_DATA XCPplus 0x0102
  /begin DAQ_EVENT VARIABLE /end DAQ_EVENT
 /end IF_DATA
/end MEASUREMENT
/begin MEASUREMENT ChrgnCntct_stHsErrInfo "Error information on HS driver from ASIC" ULONG OneToOne 1 100 0.00 4294967295.00 FORMAT "%13.2" ECU_ADDRESS 0x60000B40
 /begin IF_DATA XCPplus 0x0102
  /begin DAQ_EVENT VARIABLE /end DAQ_EVENT
 /end IF_DATA
/end MEASUREMENT
/begin MEASUREMENT ChrgnCntct_stLsNegErrInfo "Error information on LS Neg driver from ASIC" ULONG OneToOne 1 100 0.00 4294967295.00 FORMAT "%13.2" ECU_ADDRESS 0x60000B3C
 /begin IF_DATA XCPplus 0x0102
  /begin DAQ_EVENT VARIABLE /end DAQ_EVENT
 /end IF_DATA
/end MEASUREMENT
/begin MEASUREMENT ChrgnCntct_stLsPosErrInfo "Error information on LS Pos driver from ASIC" ULONG OneToOne 1 100 0.00 4294967295.00 FORMAT "%13.2" ECU_ADDRESS 0x60000B38
 /begin IF_DATA XCPplus 0x0102
  /begin DAQ_EVENT VARIABLE /end DAQ_EVENT
 /end IF_DATA
/end MEASUREMENT
/begin MEASUREMENT ChrgnCntct_stReq "State of charing contactor positions" UBYTE OneToOne 1 100 0.00 255.0 FORMAT "%5.1" ECU_ADDRESS 0x60023651
 /begin IF_DATA XCPplus 0x0102
  /begin DAQ_EVENT VARIABLE /end DAQ_EVENT
 /end IF_DATA
/end MEASUREMENT
/begin MEASUREMENT ChrgnCntct_tiStTmrDiag "timer to start diagnosis" SLONG RBPtCel_ti_0p01_1 1 100 -21474836.4800 21474836.4700 FORMAT "%13.4" ECU_ADDRESS 0x60000FB4
 /begin IF_DATA XCPplus 0x0102
  /begin DAQ_EVENT VARIABLE /end DAQ_EVENT
 /end IF_DATA
/end MEASUREMENT
/begin MEASUREMENT ChrgPlg_facDernI "Charging current reduction factor depending on inlet temperature" SBYTE RBPtCel_fac_0p01_1 1 100 -1.280 1.270 FORMAT "%5.3" ECU_ADDRESS 0x60023697
 /begin IF_DATA XCPplus 0x0102
  /begin DAQ_EVENT VARIABLE /end DAQ_EVENT
 /end IF_DATA
/end MEASUREMENT
/begin MEASUREMENT ChrgPlg_flgChrgnStopReq "Request to stop charging process" UBYTE B_TRUE 1 100 0.00 1.00000000000 BIT_MASK 0x1 FORMAT "%13.11" ECU_ADDRESS 0x600234D4
 /begin IF_DATA XCPplus 0x0102
  /begin DAQ_EVENT VARIABLE /end DAQ_EVENT
 /end IF_DATA
/end MEASUREMENT
/begin MEASUREMENT ChrgPlg_flgChrgnStopReqCcs "Charging stop request CCS" UBYTE B_TRUE 1 100 0.00 1.00000000000 BIT_MASK 0x1 FORMAT "%13.11" ECU_ADDRESS 0x600234D3
 /begin IF_DATA XCPplus 0x0102
  /begin DAQ_EVENT VARIABLE /end DAQ_EVENT
 /end IF_DATA
/end MEASUREMENT
/begin MEASUREMENT ChrgPlg_flgMplPlgDetd "Multiple plugs detected" UBYTE B_TRUE 1 100 0.00 1.00000000000 BIT_MASK 0x1 FORMAT "%13.11" ECU_ADDRESS 0x600234D2
 /begin IF_DATA XCPplus 0x0102
  /begin DAQ_EVENT VARIABLE /end DAQ_EVENT
 /end IF_DATA
/end MEASUREMENT
/begin MEASUREMENT ChrgPlg_flgPlgLockReq "Plug lock request for charging" UBYTE B_TRUE 1 100 0.00 1.00000000000 BIT_MASK 0x1 FORMAT "%13.11" ECU_ADDRESS 0x600234D1
 /begin IF_DATA XCPplus 0x0102
  /begin DAQ_EVENT VARIABLE /end DAQ_EVENT
 /end IF_DATA
/end MEASUREMENT
/begin MEASUREMENT ChrgPlg_flgPlgLockReqTmp "undelayed Plug lock request for charging" UBYTE B_TRUE 1 100 0.00 1.00000000000 BIT_MASK 0x1 FORMAT "%13.11" ECU_ADDRESS 0x600231BF
 /begin IF_DATA XCPplus 0x0102
  /begin DAQ_EVENT VARIABLE /end DAQ_EVENT
 /end IF_DATA
/end MEASUREMENT
/begin MEASUREMENT ChrgPlg_flgRdyForShdwn "Shutdown release flag of the charge plug Interlock control" UBYTE B_TRUE 1 100 0.00 1.00000000000 BIT_MASK 0x1 FORMAT "%13.11" ECU_ADDRESS 0x600234D0
 /begin IF_DATA XCPplus 0x0102
  /begin DAQ_EVENT VARIABLE /end DAQ_EVENT
 /end IF_DATA
/end MEASUREMENT
/begin MEASUREMENT ChrgPlg_flgUIntkLockPlg "Request to lock charge plug dependent on the electrical condition at the charging plug inlet" UBYTE B_TRUE 1 100 0.00 1.00000000000 BIT_MASK 0x1 FORMAT "%13.11" ECU_ADDRESS 0x600231BE
 /begin IF_DATA XCPplus 0x0102
  /begin DAQ_EVENT VARIABLE /end DAQ_EVENT
 /end IF_DATA
/end MEASUREMENT
/begin MEASUREMENT ChrgPlg_flgUIntkRelsPlg "Combined charge plug release flag dependent on inlet voltage and current" UBYTE B_TRUE 1 100 0.00 1.00000000000 BIT_MASK 0x1 FORMAT "%13.11" ECU_ADDRESS 0x600231BD
 /begin IF_DATA XCPplus 0x0102
  /begin DAQ_EVENT VARIABLE /end DAQ_EVENT
 /end IF_DATA
/end MEASUREMENT
/begin MEASUREMENT ChrgPlg_Intlck_StMac.flgAutoUnlckDone "state machine charge plug lock / repetition lock for automatic plug unlock" UBYTE B_TRUE 1 100 0.00 1.00000000000 BIT_MASK 0x1 FORMAT "%13.11" ECU_ADDRESS 0x6001F55A
 /begin IF_DATA XCPplus 0x0102
  /begin DAQ_EVENT VARIABLE /end DAQ_EVENT
 /end IF_DATA
/end MEASUREMENT
/begin MEASUREMENT ChrgPlg_Intlck_StMac.flgDlyRelck "state machine charge plug lock / delayed re-lock required" UBYTE B_TRUE 1 100 0.00 1.00000000000 BIT_MASK 0x1 FORMAT "%13.11" ECU_ADDRESS 0x6001F55B
 /begin IF_DATA XCPplus 0x0102
  /begin DAQ_EVENT VARIABLE /end DAQ_EVENT
 /end IF_DATA
/end MEASUREMENT
/begin MEASUREMENT ChrgPlg_Intlck_StMac.flgDynLockReq "state machine charge plug lock / Lock request received" UBYTE B_TRUE 1 100 0.00 1.00000000000 BIT_MASK 0x1 FORMAT "%13.11" ECU_ADDRESS 0x6001F55C
 /begin IF_DATA XCPplus 0x0102
  /begin DAQ_EVENT VARIABLE /end DAQ_EVENT
 /end IF_DATA
/end MEASUREMENT
/begin MEASUREMENT ChrgPlg_Intlck_StMac.flgDynUnlckReq "state machine charge plug lock / Unlock request received" UBYTE B_TRUE 1 100 0.00 1.00000000000 BIT_MASK 0x1 FORMAT "%13.11" ECU_ADDRESS 0x6001F55D
 /begin IF_DATA XCPplus 0x0102
  /begin DAQ_EVENT VARIABLE /end DAQ_EVENT
 /end IF_DATA
/end MEASUREMENT
/begin MEASUREMENT ChrgPlg_Intlck_StMac.flgIniReqDone "state machine charge plug lock / Initial unlock request processed" UBYTE B_TRUE 1 100 0.00 1.00000000000 BIT_MASK 0x1 FORMAT "%13.11" ECU_ADDRESS 0x6001F55E
 /begin IF_DATA XCPplus 0x0102
  /begin DAQ_EVENT VARIABLE /end DAQ_EVENT
 /end IF_DATA
/end MEASUREMENT
/begin MEASUREMENT ChrgPlg_Intlck_StMac.sm "state machine charge plug lock / state machine of charge plug Interlock control" UBYTE ChrgPlg_Intlck_StMac_sm_VERB 1 100 0.00 16.0000000000 FORMAT "%13.10" ECU_ADDRESS 0x6001F560
 /begin IF_DATA XCPplus 0x0102
  /begin DAQ_EVENT VARIABLE /end DAQ_EVENT
 /end IF_DATA
/end MEASUREMENT
/begin MEASUREMENT ChrgPlg_Intlck_StMac.tiCmdAckdTout "state machine charge plug lock / control demand time to lock or unlock the charge plug" UWORD RBPtCel_ti_0p01_1 1 100 0.00 655.3500 FORMAT "%8.4" ECU_ADDRESS 0x6001F564
 /begin IF_DATA XCPplus 0x0102
  /begin DAQ_EVENT VARIABLE /end DAQ_EVENT
 /end IF_DATA
/end MEASUREMENT
/begin MEASUREMENT ChrgPlg_Intlck_StMac.tiTmr "state machine charge plug lock / general timer" UWORD RBPtCel_ti_0p01_1 1 100 0.00 655.3500 FORMAT "%8.4" ECU_ADDRESS 0x6001F566
 /begin IF_DATA XCPplus 0x0102
  /begin DAQ_EVENT VARIABLE /end DAQ_EVENT
 /end IF_DATA
/end MEASUREMENT
/begin MEASUREMENT ChrgPlg_Intlck_StMac.tiTmrUnlck "state machine charge plug lock / general timer for delayed charge plug unlocking" UWORD RBPtCel_ti_0p01_1 1 100 0.00 655.3500 FORMAT "%8.4" ECU_ADDRESS 0x6001F568
 /begin IF_DATA XCPplus 0x0102
  /begin DAQ_EVENT VARIABLE /end DAQ_EVENT
 /end IF_DATA
/end MEASUREMENT
/begin MEASUREMENT ChrgPlg_LockgFailr_StMac.sm "state machine plug lock failed / actual state" UBYTE ChrgPlg_LockgFailr_StMac_sm_VERB 1 100 0.00 3.00000000000 FORMAT "%13.11" ECU_ADDRESS 0x6001F556
 /begin IF_DATA XCPplus 0x0102
  /begin DAQ_EVENT VARIABLE /end DAQ_EVENT
 /end IF_DATA
/end MEASUREMENT
/begin MEASUREMENT ChrgPlg_LockgFailr_StMac.tiTmr "state machine plug lock failed / timer" UWORD RBPtCel_ti_0p01_1 1 100 0.00 655.3500 FORMAT "%8.4" ECU_ADDRESS 0x6001F558
 /begin IF_DATA XCPplus 0x0102
  /begin DAQ_EVENT VARIABLE /end DAQ_EVENT
 /end IF_DATA
/end MEASUREMENT
/begin MEASUREMENT ChrgPlg_stCcs "Plug status CCS" UBYTE ChrgIf_stPlg_VERB 1 100 0.00 2.00000000000 FORMAT "%13.11" ECU_ADDRESS 0x60023657
 /begin IF_DATA XCPplus 0x0102
  /begin DAQ_EVENT VARIABLE /end DAQ_EVENT
 /end IF_DATA
/end MEASUREMENT
/begin MEASUREMENT ChrgPlg_stChrgn "Readiness of plug control" UBYTE ChrgCtrl_stChrgn_VERB 1 100 0.00 6.00000000000 FORMAT "%13.11" ECU_ADDRESS 0x60023656
 /begin IF_DATA XCPplus 0x0102
  /begin DAQ_EVENT VARIABLE /end DAQ_EVENT
 /end IF_DATA
/end MEASUREMENT
/begin MEASUREMENT ChrgPlg_stIntlck "state charge plug locking device" UBYTE ChrgIf_stIntlck_VERB 1 100 0.00 9.00000000000 FORMAT "%13.11" ECU_ADDRESS 0x60023655
 /begin IF_DATA XCPplus 0x0102
  /begin DAQ_EVENT VARIABLE /end DAQ_EVENT
 /end IF_DATA
/end MEASUREMENT
/begin MEASUREMENT ChrgPlg_stPlg "Verified plug state" UBYTE ChrgIf_stPlg_VERB 1 100 0.00 2.00000000000 FORMAT "%13.11" ECU_ADDRESS 0x60023654
 /begin IF_DATA XCPplus 0x0102
  /begin DAQ_EVENT VARIABLE /end DAQ_EVENT
 /end IF_DATA
/end MEASUREMENT
/begin MEASUREMENT ChrgPlg_stPlgLockCmd "Lock and unlock request of charge plug Interlock control" UBYTE ChrgIf_stPlgLockCmd_VERB 1 100 0.00 2.00000000000 FORMAT "%13.11" ECU_ADDRESS 0x60023653
 /begin IF_DATA XCPplus 0x0102
  /begin DAQ_EVENT VARIABLE /end DAQ_EVENT
 /end IF_DATA
/end MEASUREMENT
/begin MEASUREMENT ChrgPlg_stTMon "state of charge plug temperature" UBYTE ChrgIf_stTMon_VERB 1 100 0.00 4.00000000000 FORMAT "%13.11" ECU_ADDRESS 0x60023652
 /begin IF_DATA XCPplus 0x0102
  /begin DAQ_EVENT VARIABLE /end DAQ_EVENT
 /end IF_DATA
/end MEASUREMENT
/begin MEASUREMENT ChrgPlg_tPin "Maximal pin temperature of active charge plug" SWORD RBPtCel_t_0p1_3 1 100 -3276.800 3276.700 FORMAT "%8.3" ECU_ADDRESS 0x6001FBF6
 /begin IF_DATA XCPplus 0x0102
  /begin DAQ_EVENT VARIABLE /end DAQ_EVENT
 /end IF_DATA
/end MEASUREMENT
/begin MEASUREMENT ChrgrRly_stDcCntctActNeg "Actual status of negative DC contactor" UBYTE OneToOne 1 100 0.00 255.0 FORMAT "%5.1" ECU_ADDRESS 0x6002364F
 /begin IF_DATA XCPplus 0x0102
  /begin DAQ_EVENT VARIABLE /end DAQ_EVENT
 /end IF_DATA
/end MEASUREMENT
/begin MEASUREMENT ChrgrRly_stDcCntctActPos "Actual status of positive DC contactor" UBYTE OneToOne 1 100 0.00 255.0 FORMAT "%5.1" ECU_ADDRESS 0x6002364E
 /begin IF_DATA XCPplus 0x0102
  /begin DAQ_EVENT VARIABLE /end DAQ_EVENT
 /end IF_DATA
/end MEASUREMENT
/begin MEASUREMENT ChrgrRly_stEem "EEM state of HV charging relay" UBYTE OneToOne 1 100 0.00 255.0 FORMAT "%5.1" ECU_ADDRESS 0x6002364D
 /begin IF_DATA XCPplus 0x0102
  /begin DAQ_EVENT VARIABLE /end DAQ_EVENT
 /end IF_DATA
/end MEASUREMENT
/begin MEASUREMENT ChrgrSt_flgChrgrErrComVld "Flag that reports an error in charger over valid communication and sets the DFC" UBYTE B_TRUE 1 100 0.00 1.00000000000 BIT_MASK 0x1 FORMAT "%13.11" ECU_ADDRESS 0x600231BB
 /begin IF_DATA XCPplus 0x0102
  /begin DAQ_EVENT VARIABLE /end DAQ_EVENT
 /end IF_DATA
/end MEASUREMENT
/begin MEASUREMENT ChrgrSt_flgChrgrOrComErr "Flag that reports an error in charger or invalid communication" UBYTE B_TRUE 1 100 0.00 1.00000000000 BIT_MASK 0x1 FORMAT "%13.11" ECU_ADDRESS 0x600231BA
 /begin IF_DATA XCPplus 0x0102
  /begin DAQ_EVENT VARIABLE /end DAQ_EVENT
 /end IF_DATA
/end MEASUREMENT
/begin MEASUREMENT ChrgrSt_stChrgn "Charger state" UBYTE ChrgCtrl_stChrgn_VERB 1 100 0.00 6.00000000000 FORMAT "%13.11" ECU_ADDRESS 0x60023468
 /begin IF_DATA XCPplus 0x0102
  /begin DAQ_EVENT VARIABLE /end DAQ_EVENT
 /end IF_DATA
/end MEASUREMENT
/begin MEASUREMENT ChrgrSt_stChrgnEna "requested operation mode of charger module" UBYTE OneToOne 1 100 0.00 255.0 FORMAT "%5.1" ECU_ADDRESS 0x60023467
 /begin IF_DATA XCPplus 0x0102
  /begin DAQ_EVENT VARIABLE /end DAQ_EVENT
 /end IF_DATA
/end MEASUREMENT
/begin MEASUREMENT ChrgrSt_stChrgnReq "Current charging request adapted to current charging mode" UBYTE ChrgCtrl_stChrgn_VERB 1 100 0.00 6.00000000000 FORMAT "%13.11" ECU_ADDRESS 0x600231BC
 /begin IF_DATA XCPplus 0x0102
  /begin DAQ_EVENT VARIABLE /end DAQ_EVENT
 /end IF_DATA
/end MEASUREMENT
/begin MEASUREMENT ChrgrSt_stChrgnReqInt "Internal charging request, different for AC and DC charging mode." UBYTE ChrgCtrl_stChrgn_VERB 1 100 0.00 6.00000000000 FORMAT "%13.11" ECU_ADDRESS 0x600231B9
 /begin IF_DATA XCPplus 0x0102
  /begin DAQ_EVENT VARIABLE /end DAQ_EVENT
 /end IF_DATA
/end MEASUREMENT
/begin MEASUREMENT ChrgrSt_stChrgrMpg "Charger state after mapping into internal VCU states, without error handling" UBYTE ChrgCtrl_stChrgn_VERB 1 100 0.00 6.00000000000 FORMAT "%13.11" ECU_ADDRESS 0x70001324
 /begin IF_DATA XCPplus 0x0102
  /begin DAQ_EVENT VARIABLE /end DAQ_EVENT
 /end IF_DATA
/end MEASUREMENT
/begin MEASUREMENT ChrgrSt_stEem "High voltag estate of AC charger" UBYTE OneToOne 1 100 0.00 255.0 FORMAT "%5.1" ECU_ADDRESS 0x60023466
 /begin IF_DATA XCPplus 0x0102
  /begin DAQ_EVENT VARIABLE /end DAQ_EVENT
 /end IF_DATA
/end MEASUREMENT
/begin MEASUREMENT ChrgrVal_iChrgrDes "Desired current for HV charger." SWORD RBPtCel_i_0p03125_1 1 100 -1024.000 1023.969 FORMAT "%8.3" ECU_ADDRESS 0x6001F9FC
 /begin IF_DATA XCPplus 0x0102
  /begin DAQ_EVENT VARIABLE /end DAQ_EVENT
 /end IF_DATA
/end MEASUREMENT
/begin MEASUREMENT ChrgrVal_iGrid "Current on grid side of charger." SWORD RBPtCel_i_0p03125_1 1 100 -1024.000 1023.969 FORMAT "%8.3" ECU_ADDRESS 0x6001F9FA
 /begin IF_DATA XCPplus 0x0102
  /begin DAQ_EVENT VARIABLE /end DAQ_EVENT
 /end IF_DATA
/end MEASUREMENT
/begin MEASUREMENT ChrgrVal_iGridLimMax "Max. allowed current of HV charger." SWORD RBPtCel_i_0p03125_1 1 100 -1024.000 1023.969 FORMAT "%8.3" ECU_ADDRESS 0x6001F9F8
 /begin IF_DATA XCPplus 0x0102
  /begin DAQ_EVENT VARIABLE /end DAQ_EVENT
 /end IF_DATA
/end MEASUREMENT
/begin MEASUREMENT ChrgrVal_iGrid_Sq "Qualtiy signal of max OBC AC input current" UBYTE SigQly_COMPU_VERB 1 100 0.00 15.0000000000 FORMAT "%13.10" ECU_ADDRESS 0x60023465
 /begin IF_DATA XCPplus 0x0102
  /begin DAQ_EVENT VARIABLE /end DAQ_EVENT
 /end IF_DATA
/end MEASUREMENT
/begin MEASUREMENT ChrgrVal_iOut "Current of the HV charger." SWORD RBPtCel_i_0p03125_1 1 100 -1024.000 1023.969 FORMAT "%8.3" ECU_ADDRESS 0x6001F9F6
 /begin IF_DATA XCPplus 0x0102
  /begin DAQ_EVENT VARIABLE /end DAQ_EVENT
 /end IF_DATA
/end MEASUREMENT
/begin MEASUREMENT ChrgrVal_iOut_Sq "Quality signal of actual OBC DC output current" UBYTE SigQly_COMPU_VERB 1 100 0.00 15.0000000000 FORMAT "%13.10" ECU_ADDRESS 0x60023464
 /begin IF_DATA XCPplus 0x0102
  /begin DAQ_EVENT VARIABLE /end DAQ_EVENT
 /end IF_DATA
/end MEASUREMENT
/begin MEASUREMENT ChrgrVal_nrAcPha "Number of active phases" UBYTE OneToOne 1 100 0.00 3.000 FORMAT "%5.3" ECU_ADDRESS 0x60023463
 /begin IF_DATA XCPplus 0x0102
  /begin DAQ_EVENT VARIABLE /end DAQ_EVENT
 /end IF_DATA
/end MEASUREMENT
/begin MEASUREMENT ChrgrVal_nrAcPha_Sq "signal quality of stated signal" UBYTE SigQly_COMPU_VERB 1 100 0.00 15.0000000000 FORMAT "%13.10" ECU_ADDRESS 0x60023462
 /begin IF_DATA XCPplus 0x0102
  /begin DAQ_EVENT VARIABLE /end DAQ_EVENT
 /end IF_DATA
/end MEASUREMENT
/begin MEASUREMENT ChrgrVal_t "Temperature of the HV charger." SWORD RBPtCel_t_0p1_3 1 100 -3276.800 3276.700 FORMAT "%8.3" ECU_ADDRESS 0x6001F9F4
 /begin IF_DATA XCPplus 0x0102
  /begin DAQ_EVENT VARIABLE /end DAQ_EVENT
 /end IF_DATA
/end MEASUREMENT
/begin MEASUREMENT ChrgrVal_t_Sq "Quality signal of actual charger temperature signal" UBYTE SigQly_COMPU_VERB 1 100 0.00 15.0000000000 FORMAT "%13.10" ECU_ADDRESS 0x60023461
 /begin IF_DATA XCPplus 0x0102
  /begin DAQ_EVENT VARIABLE /end DAQ_EVENT
 /end IF_DATA
/end MEASUREMENT
/begin MEASUREMENT ChrgrVal_uGrid "Voltage on grid side of charger." SWORD RBPtCel_u_0p1_1 1 100 -3276.800 3276.700 FORMAT "%8.3" ECU_ADDRESS 0x6001F9F2
 /begin IF_DATA XCPplus 0x0102
  /begin DAQ_EVENT VARIABLE /end DAQ_EVENT
 /end IF_DATA
/end MEASUREMENT
/begin MEASUREMENT ChrgrVal_uGrid_Sq "Quality signal of max OBC AC input voltage" UBYTE SigQly_COMPU_VERB 1 100 0.00 15.0000000000 FORMAT "%13.10" ECU_ADDRESS 0x60023460
 /begin IF_DATA XCPplus 0x0102
  /begin DAQ_EVENT VARIABLE /end DAQ_EVENT
 /end IF_DATA
/end MEASUREMENT
/begin MEASUREMENT ChrgrVal_uHvMax "Max. permitted voltage for HV charger." SWORD RBPtCel_u_0p1_1 1 100 -3276.800 3276.700 FORMAT "%8.3" ECU_ADDRESS 0x6001F9F0
 /begin IF_DATA XCPplus 0x0102
  /begin DAQ_EVENT VARIABLE /end DAQ_EVENT
 /end IF_DATA
/end MEASUREMENT
/begin MEASUREMENT ChrgrVal_uOut "Voltage of the HV charger." SWORD RBPtCel_u_0p1_1 1 100 -3276.800 3276.700 FORMAT "%8.3" ECU_ADDRESS 0x6001F9EE
 /begin IF_DATA XCPplus 0x0102
  /begin DAQ_EVENT VARIABLE /end DAQ_EVENT
 /end IF_DATA
/end MEASUREMENT
/begin MEASUREMENT ChrgrVal_uOut_Sq "Quality signal of actual OBC DC output voltage" UBYTE SigQly_COMPU_VERB 1 100 0.00 15.0000000000 FORMAT "%13.10" ECU_ADDRESS 0x6002345F
 /begin IF_DATA XCPplus 0x0102
  /begin DAQ_EVENT VARIABLE /end DAQ_EVENT
 /end IF_DATA
/end MEASUREMENT
/begin MEASUREMENT ChrgSdl_facCvCorrn "Correction factor of CV time calculation" SWORD RBPtCel_fac_0p01_1 1 100 -327.6800 327.6700 FORMAT "%8.4" ECU_ADDRESS 0x6001F554
 /begin IF_DATA XCPplus 0x0102
  /begin DAQ_EVENT VARIABLE /end DAQ_EVENT
 /end IF_DATA
/end MEASUREMENT
/begin MEASUREMENT ChrgSdl_facDeltaCc "Delta SOC in CC mode" SWORD Prc 1 100 -400.0000 399.9878 FORMAT "%8.4" ECU_ADDRESS 0x6001F552
 /begin IF_DATA XCPplus 0x0102
  /begin DAQ_EVENT VARIABLE /end DAQ_EVENT
 /end IF_DATA
/end MEASUREMENT
/begin MEASUREMENT ChrgSdl_facDeltaCp "Factor of delta capacity" SWORD RBPtCel_fac_0p01_1 1 100 -327.6800 327.6700 FORMAT "%8.4" ECU_ADDRESS 0x6001F550
 /begin IF_DATA XCPplus 0x0102
  /begin DAQ_EVENT VARIABLE /end DAQ_EVENT
 /end IF_DATA
/end MEASUREMENT
/begin MEASUREMENT ChrgSdl_flgThdUpd "Threshold updated flag" UBYTE B_TRUE 1 100 0.00 1.00000000000 BIT_MASK 0x1 FORMAT "%13.11" ECU_ADDRESS 0x700001A4
 /begin IF_DATA XCPplus 0x0102
  /begin DAQ_EVENT VARIABLE /end DAQ_EVENT
 /end IF_DATA
/end MEASUREMENT
/begin MEASUREMENT ChrgSdl_iCc "CC mode charging current" SWORD RBPtCel_i_0p03125_1 1 100 -1024.000 1023.969 FORMAT "%8.3" ECU_ADDRESS 0x6001F54E
 /begin IF_DATA XCPplus 0x0102
  /begin DAQ_EVENT VARIABLE /end DAQ_EVENT
 /end IF_DATA
/end MEASUREMENT
/begin MEASUREMENT ChrgSdl_iCcLut "Actual CC mode current from lookup table" SWORD RBPtCel_i_0p03125_1 1 100 -1024.000 1023.969 FORMAT "%8.3" ECU_ADDRESS 0x6001F54C
 /begin IF_DATA XCPplus 0x0102
  /begin DAQ_EVENT VARIABLE /end DAQ_EVENT
 /end IF_DATA
/end MEASUREMENT
/begin MEASUREMENT ChrgSdl_iChrgnMaxAvlPrv "Previous max. available current of the charging station" SWORD RBPtCel_i_0p03125_1 1 100 -1024.000 1023.969 FORMAT "%8.3" ECU_ADDRESS 0x6001F54A
 /begin IF_DATA XCPplus 0x0102
  /begin DAQ_EVENT VARIABLE /end DAQ_EVENT
 /end IF_DATA
/end MEASUREMENT
/begin MEASUREMENT ChrgSdl_iCv "Chraging current in CV mode" SWORD RBPtCel_i_0p03125_1 1 100 -1024.000 1023.969 FORMAT "%8.3" ECU_ADDRESS 0x6001F548
 /begin IF_DATA XCPplus 0x0102
  /begin DAQ_EVENT VARIABLE /end DAQ_EVENT
 /end IF_DATA
/end MEASUREMENT
/begin MEASUREMENT ChrgSdl_qTot "Total capacity of the battery" SWORD RBPtCel_q_0p125_1 1 100 -4096.000 4095.875 FORMAT "%8.3" ECU_ADDRESS 0x6001F546
 /begin IF_DATA XCPplus 0x0102
  /begin DAQ_EVENT VARIABLE /end DAQ_EVENT
 /end IF_DATA
/end MEASUREMENT
/begin MEASUREMENT ChrgSdl_ratCcEnd "CC mode end threshold" SWORD Prc 1 100 -400.0000 399.9878 FORMAT "%8.4" ECU_ADDRESS 0x6001F544
 /begin IF_DATA XCPplus 0x0102
  /begin DAQ_EVENT VARIABLE /end DAQ_EVENT
 /end IF_DATA
/end MEASUREMENT
/begin MEASUREMENT ChrgSdl_ratCcStrt "CC mode start threshold" SWORD Prc 1 100 -400.0000 399.9878 FORMAT "%8.4" ECU_ADDRESS 0x6001F542
 /begin IF_DATA XCPplus 0x0102
  /begin DAQ_EVENT VARIABLE /end DAQ_EVENT
 /end IF_DATA
/end MEASUREMENT
/begin MEASUREMENT ChrgSdl_ratCvEnd "CV mode end threshold" SWORD Prc 1 100 -400.0000 399.9878 FORMAT "%8.4" ECU_ADDRESS 0x6001F540
 /begin IF_DATA XCPplus 0x0102
  /begin DAQ_EVENT VARIABLE /end DAQ_EVENT
 /end IF_DATA
/end MEASUREMENT
/begin MEASUREMENT ChrgSdl_ratCvStrt "CV mode start threshold" SWORD Prc 1 100 -400.0000 399.9878 FORMAT "%8.4" ECU_ADDRESS 0x6001F53E
 /begin IF_DATA XCPplus 0x0102
  /begin DAQ_EVENT VARIABLE /end DAQ_EVENT
 /end IF_DATA
/end MEASUREMENT
/begin MEASUREMENT ChrgSdl_ratDeltaCv "Delta SOC to be covered in CV mode" SWORD Prc 1 100 -400.0000 399.9878 FORMAT "%8.4" ECU_ADDRESS 0x6001F53C
 /begin IF_DATA XCPplus 0x0102
  /begin DAQ_EVENT VARIABLE /end DAQ_EVENT
 /end IF_DATA
/end MEASUREMENT
/begin MEASUREMENT ChrgSdl_ratPreEnd "Precharging end threshold" SWORD Prc 1 100 -400.0000 399.9878 FORMAT "%8.4" ECU_ADDRESS 0x6001F53A
 /begin IF_DATA XCPplus 0x0102
  /begin DAQ_EVENT VARIABLE /end DAQ_EVENT
 /end IF_DATA
/end MEASUREMENT
/begin MEASUREMENT ChrgSdl_ratSocChrgnStopPrv "Previous value of the target charging SOC" SWORD Prc 1 100 -400.0000 399.9878 FORMAT "%8.4" ECU_ADDRESS 0x6001F538
 /begin IF_DATA XCPplus 0x0102
  /begin DAQ_EVENT VARIABLE /end DAQ_EVENT
 /end IF_DATA
/end MEASUREMENT
/begin MEASUREMENT ChrgSdl_stTiCalcn "Actual state of charge time calculation" UBYTE ChrgSdl_stTiCalcn_VERB 1 100 0.00 5.00000000000 FORMAT "%13.11" ECU_ADDRESS 0x60023469
 /begin IF_DATA XCPplus 0x0102
  /begin DAQ_EVENT VARIABLE /end DAQ_EVENT
 /end IF_DATA
/end MEASUREMENT
/begin MEASUREMENT ChrgSdl_stTiCalcnPrv "Previous value of Actual state of charge time calculation" UBYTE ChrgSdl_stTiCalcn_VERB 1 100 0.00 5.00000000000 FORMAT "%13.11" ECU_ADDRESS 0x600231B8
 /begin IF_DATA XCPplus 0x0102
  /begin DAQ_EVENT VARIABLE /end DAQ_EVENT
 /end IF_DATA
/end MEASUREMENT
/begin MEASUREMENT ChrgSdl_tiCc "Remaining time of CC charge" SLONG RBPtCel_ti_1p0_2 1 100 -2147483648.00 2147483647.00 FORMAT "%13.2" ECU_ADDRESS 0x60000B24
 /begin IF_DATA XCPplus 0x0102
  /begin DAQ_EVENT VARIABLE /end DAQ_EVENT
 /end IF_DATA
/end MEASUREMENT
/begin MEASUREMENT ChrgSdl_tiCcRmn "Remaining time of high speed charge" SLONG RBPtCel_ti_1p0_2 1 100 -2147483648.00 2147483647.00 FORMAT "%13.2" ECU_ADDRESS 0x60000E04
 /begin IF_DATA XCPplus 0x0102
  /begin DAQ_EVENT VARIABLE /end DAQ_EVENT
 /end IF_DATA
/end MEASUREMENT
/begin MEASUREMENT ChrgSdl_tiCv "Remaining time of CV charge" SLONG RBPtCel_ti_1p0_2 1 100 -2147483648.00 2147483647.00 FORMAT "%13.2" ECU_ADDRESS 0x60000B20
 /begin IF_DATA XCPplus 0x0102
  /begin DAQ_EVENT VARIABLE /end DAQ_EVENT
 /end IF_DATA
/end MEASUREMENT
/begin MEASUREMENT ChrgSdl_tiCvCorrn "Correction time value in CV mode" SLONG RBPtCel_ti_0p01_1 1 100 -21474836.4800 21474836.4700 FORMAT "%13.4" ECU_ADDRESS 0x60000B1C
 /begin IF_DATA XCPplus 0x0102
  /begin DAQ_EVENT VARIABLE /end DAQ_EVENT
 /end IF_DATA
/end MEASUREMENT
/begin MEASUREMENT ChrgSdl_tiCvLut "CV mode time selection lookup table" SLONG RBPtCel_ti_1p0_2 1 100 -2147483648.00 2147483647.00 FORMAT "%13.2" ECU_ADDRESS 0x60000B18
 /begin IF_DATA XCPplus 0x0102
  /begin DAQ_EVENT VARIABLE /end DAQ_EVENT
 /end IF_DATA
/end MEASUREMENT
/begin MEASUREMENT ChrgSdl_tiElpd "Total elapsed time of charge" SLONG RBPtCel_ti_0p01_1 1 100 -21474836.4800 21474836.4700 FORMAT "%13.4" ECU_ADDRESS 0x60000E00
 /begin IF_DATA XCPplus 0x0102
  /begin DAQ_EVENT VARIABLE /end DAQ_EVENT
 /end IF_DATA
/end MEASUREMENT
/begin MEASUREMENT ChrgSdl_tiPre "Remaining time of PRE charge" SLONG RBPtCel_ti_1p0_2 1 100 -2147483648.00 2147483647.00 FORMAT "%13.2" ECU_ADDRESS 0x60000B14
 /begin IF_DATA XCPplus 0x0102
  /begin DAQ_EVENT VARIABLE /end DAQ_EVENT
 /end IF_DATA
/end MEASUREMENT
/begin MEASUREMENT ChrgSdl_tiRmn "Total remaining time of charging" SLONG RBPtCel_ti_1p0_2 1 100 -2147483648.00 2147483647.00 FORMAT "%13.2" ECU_ADDRESS 0x60000DFC
 /begin IF_DATA XCPplus 0x0102
  /begin DAQ_EVENT VARIABLE /end DAQ_EVENT
 /end IF_DATA
/end MEASUREMENT
/begin MEASUREMENT ChrgSys_flgChrgNmComReq "network management communication request for charging sequence" UBYTE B_TRUE 1 100 0.00 1.00000000000 BIT_MASK 0x1 FORMAT "%13.11" ECU_ADDRESS 0x600234CF
 /begin IF_DATA XCPplus 0x0102
  /begin DAQ_EVENT VARIABLE /end DAQ_EVENT
 /end IF_DATA
/end MEASUREMENT
/begin MEASUREMENT ChrgSys_flgProlgPostDrive "Postdrive prolongation request state to keep ECU on for charging" UBYTE B_TRUE 1 100 0.00 1.00000000000 BIT_MASK 0x1 FORMAT "%13.11" ECU_ADDRESS 0x600231B7
 /begin IF_DATA XCPplus 0x0102
  /begin DAQ_EVENT VARIABLE /end DAQ_EVENT
 /end IF_DATA
/end MEASUREMENT
/begin MEASUREMENT ChrgSys_flgProlgWait "Predrive prolongation request state to keep ECU on for charging" UBYTE B_TRUE 1 100 0.00 1.00000000000 BIT_MASK 0x1 FORMAT "%13.11" ECU_ADDRESS 0x600231B6
 /begin IF_DATA XCPplus 0x0102
  /begin DAQ_EVENT VARIABLE /end DAQ_EVENT
 /end IF_DATA
/end MEASUREMENT
/begin MEASUREMENT ChrgSys_tiProlgWoChrgnEnad "summarized control unit wakeup prolongation time for charging without energy transfer enabled" SLONG RBPtCel_ti_0p01_1 1 100 -21474836.4800 21474836.4700 FORMAT "%13.4" ECU_ADDRESS 0x60000B10
 /begin IF_DATA XCPplus 0x0102
  /begin DAQ_EVENT VARIABLE /end DAQ_EVENT
 /end IF_DATA
/end MEASUREMENT
/begin MEASUREMENT CmbdChrgnSys_flgAuxHiLim "CCS EVSE current above limit" UBYTE B_TRUE 1 100 0.00 1.00000000000 BIT_MASK 0x1 FORMAT "%13.11" ECU_ADDRESS 0x700001A3
 /begin IF_DATA XCPplus 0x0102
  /begin DAQ_EVENT VARIABLE /end DAQ_EVENT
 /end IF_DATA
/end MEASUREMENT
/begin MEASUREMENT CmbdChrgnSys_flgAuxLoLim "CCS EVSE current below limit" UBYTE B_TRUE 1 100 0.00 1.00000000000 BIT_MASK 0x1 FORMAT "%13.11" ECU_ADDRESS 0x700001A2
 /begin IF_DATA XCPplus 0x0102
  /begin DAQ_EVENT VARIABLE /end DAQ_EVENT
 /end IF_DATA
/end MEASUREMENT
/begin MEASUREMENT CmbdChrgnSys_flgCritErrCcsDc "critical error occurrence during CCS DC charging requires a fast shutdown of the charging sequence" UBYTE B_TRUE 1 100 0.00 1.00000000000 BIT_MASK 0x1 FORMAT "%13.11" ECU_ADDRESS 0x600234CD
 /begin IF_DATA XCPplus 0x0102
  /begin DAQ_EVENT VARIABLE /end DAQ_EVENT
 /end IF_DATA
/end MEASUREMENT
/begin MEASUREMENT CmbdChrgnSys_flgMnrErrCcsDc "error occurrence during CCS DC charging requires a stop of the charging sequence" UBYTE B_TRUE 1 100 0.00 1.00000000000 BIT_MASK 0x1 FORMAT "%13.11" ECU_ADDRESS 0x600234CC
 /begin IF_DATA XCPplus 0x0102
  /begin DAQ_EVENT VARIABLE /end DAQ_EVENT
 /end IF_DATA
/end MEASUREMENT
/begin MEASUREMENT CmbdChrgnSys_flgPrecFinshdCcsDc "switch-on permission of the charging contactors, depending on the precharge status" UBYTE B_TRUE 1 100 0.00 1.00000000000 BIT_MASK 0x1 FORMAT "%13.11" ECU_ADDRESS 0x600234CB
 /begin IF_DATA XCPplus 0x0102
  /begin DAQ_EVENT VARIABLE /end DAQ_EVENT
 /end IF_DATA
/end MEASUREMENT
/begin MEASUREMENT CmbdChrgnSys_flgStopReqCcsDc "Summarized charging stop request of CCS DC charging" UBYTE B_TRUE 1 100 0.00 1.00000000000 BIT_MASK 0x1 FORMAT "%13.11" ECU_ADDRESS 0x600234CA
 /begin IF_DATA XCPplus 0x0102
  /begin DAQ_EVENT VARIABLE /end DAQ_EVENT
 /end IF_DATA
/end MEASUREMENT
/begin MEASUREMENT CmbdChrgnSys_flgStrtPndCcsDc "charging start delay request by a possible temporary error state" UBYTE B_TRUE 1 100 0.00 1.00000000000 BIT_MASK 0x1 FORMAT "%13.11" ECU_ADDRESS 0x600234C9
 /begin IF_DATA XCPplus 0x0102
  /begin DAQ_EVENT VARIABLE /end DAQ_EVENT
 /end IF_DATA
/end MEASUREMENT
/begin MEASUREMENT CmbdChrgnSys_iAuxUnitLoad "CCS auxiliary current consumption" SWORD RBPtCel_i_0p03125_1 1 100 -1024.000 1023.969 FORMAT "%8.3" ECU_ADDRESS 0x6001F536
 /begin IF_DATA XCPplus 0x0102
  /begin DAQ_EVENT VARIABLE /end DAQ_EVENT
 /end IF_DATA
/end MEASUREMENT
/begin MEASUREMENT CmbdChrgnSys_iAuxUnitLoadHi "CCS Auxiliary high current" SWORD RBPtCel_i_0p03125_1 1 100 -1024.000 1023.969 FORMAT "%8.3" ECU_ADDRESS 0x6001F534
 /begin IF_DATA XCPplus 0x0102
  /begin DAQ_EVENT VARIABLE /end DAQ_EVENT
 /end IF_DATA
/end MEASUREMENT
/begin MEASUREMENT CmbdChrgnSys_iBattReq "CCS battery current request with tolerance" SWORD RBPtCel_i_0p03125_1 1 100 -1024.000 1023.969 FORMAT "%8.3" ECU_ADDRESS 0x6001F532
 /begin IF_DATA XCPplus 0x0102
  /begin DAQ_EVENT VARIABLE /end DAQ_EVENT
 /end IF_DATA
/end MEASUREMENT
/begin MEASUREMENT CmbdChrgnSys_iDmdCcsDc "Charging current demand CCS DC" SWORD RBPtCel_i_0p03125_1 1 100 -1024.000 1023.969 FORMAT "%8.3" ECU_ADDRESS 0x6001FBF4
 /begin IF_DATA XCPplus 0x0102
  /begin DAQ_EVENT VARIABLE /end DAQ_EVENT
 /end IF_DATA
/end MEASUREMENT
/begin MEASUREMENT CmbdChrgnSys_iDmdCcsDcDlyd "Delayed demended current" SLONG RBPtCel_i_0p1_1 1 100 -214748364.800 214748364.700 FORMAT "%13.3" ECU_ADDRESS 0x60000B0C
 /begin IF_DATA XCPplus 0x0102
  /begin DAQ_EVENT VARIABLE /end DAQ_EVENT
 /end IF_DATA
/end MEASUREMENT
/begin MEASUREMENT CmbdChrgnSys_iDmdCcsLoc "CCS local current demand" SWORD RBPtCel_i_0p03125_1 1 100 -1024.000 1023.969 FORMAT "%8.3" ECU_ADDRESS 0x6001F530
 /begin IF_DATA XCPplus 0x0102
  /begin DAQ_EVENT VARIABLE /end DAQ_EVENT
 /end IF_DATA
/end MEASUREMENT
/begin MEASUREMENT CmbdChrgnSys_iDmdExcddTolr "Calculated tolerance for current demand" SWORD RBPtCel_i_0p03125_1 1 100 -1024.000 1023.969 FORMAT "%8.3" ECU_ADDRESS 0x6001F52E
 /begin IF_DATA XCPplus 0x0102
  /begin DAQ_EVENT VARIABLE /end DAQ_EVENT
 /end IF_DATA
/end MEASUREMENT
/begin MEASUREMENT CmbdChrgnSys_iDmdLimCcsDc "CCS DC Demanded current limit" SWORD RBPtCel_i_0p03125_1 1 100 -1024.000 1023.969 FORMAT "%8.3" ECU_ADDRESS 0x6001F52C
 /begin IF_DATA XCPplus 0x0102
  /begin DAQ_EVENT VARIABLE /end DAQ_EVENT
 /end IF_DATA
/end MEASUREMENT
/begin MEASUREMENT CmbdChrgnSys_iEvMax "Maximal DC charging current of EV" SWORD RBPtCel_i_0p03125_1 1 100 -1024.000 1023.969 FORMAT "%8.3" ECU_ADDRESS 0x6001FBF2
 /begin IF_DATA XCPplus 0x0102
  /begin DAQ_EVENT VARIABLE /end DAQ_EVENT
 /end IF_DATA
/end MEASUREMENT
/begin MEASUREMENT CmbdChrgnSys_iEvseAvlMax "CCS Evse maximum available current" SWORD RBPtCel_i_0p03125_1 1 100 -1024.000 1023.969 FORMAT "%8.3" ECU_ADDRESS 0x6001F52A
 /begin IF_DATA XCPplus 0x0102
  /begin DAQ_EVENT VARIABLE /end DAQ_EVENT
 /end IF_DATA
/end MEASUREMENT
/begin MEASUREMENT CmbdChrgnSys_iHvBattExcddTolr "Calculated tolerance for HV battery requested current" SWORD RBPtCel_i_0p03125_1 1 100 -1024.000 1023.969 FORMAT "%8.3" ECU_ADDRESS 0x6001F528
 /begin IF_DATA XCPplus 0x0102
  /begin DAQ_EVENT VARIABLE /end DAQ_EVENT
 /end IF_DATA
/end MEASUREMENT
/begin MEASUREMENT CmbdChrgnSys_iHvBattLim "HV battery requested current limit" SWORD RBPtCel_i_0p03125_1 1 100 -1024.000 1023.969 FORMAT "%8.3" ECU_ADDRESS 0x6001F526
 /begin IF_DATA XCPplus 0x0102
  /begin DAQ_EVENT VARIABLE /end DAQ_EVENT
 /end IF_DATA
/end MEASUREMENT
/begin MEASUREMENT CmbdChrgnSys_iMaxAvlCcsDc "Maximal DC charging current (excl. HV battery limit) CCS DC" SWORD RBPtCel_i_0p03125_1 1 100 -1024.000 1023.969 FORMAT "%8.3" ECU_ADDRESS 0x6001FBF0
 /begin IF_DATA XCPplus 0x0102
  /begin DAQ_EVENT VARIABLE /end DAQ_EVENT
 /end IF_DATA
/end MEASUREMENT
/begin MEASUREMENT CmbdChrgnSys_iReq "CCS battery and auxiliary load current request" SWORD RBPtCel_i_0p03125_1 1 100 -1024.000 1023.969 FORMAT "%8.3" ECU_ADDRESS 0x6001F524
 /begin IF_DATA XCPplus 0x0102
  /begin DAQ_EVENT VARIABLE /end DAQ_EVENT
 /end IF_DATA
/end MEASUREMENT
/begin MEASUREMENT CmbdChrgnSys_iReqToChrgrDlyd "Delayed current reqeust" SLONG RBPtCel_i_0p1_1 1 100 -214748364.800 214748364.700 FORMAT "%13.3" ECU_ADDRESS 0x60000B00
 /begin IF_DATA XCPplus 0x0102
  /begin DAQ_EVENT VARIABLE /end DAQ_EVENT
 /end IF_DATA
/end MEASUREMENT
/begin MEASUREMENT CmbdChrgnSys_iTolr "CCS Evse current tolerance" SWORD RBPtCel_i_0p03125_1 1 100 -1024.000 1023.969 FORMAT "%8.3" ECU_ADDRESS 0x6001F522
 /begin IF_DATA XCPplus 0x0102
  /begin DAQ_EVENT VARIABLE /end DAQ_EVENT
 /end IF_DATA
/end MEASUREMENT
/begin MEASUREMENT CmbdChrgnSys_pwrOutCcsDc "Actual charging power CCS DC" SWORD RBPtCel_pwr_25p0_1 1 100 -819200.0 819175.0 FORMAT "%8.1" ECU_ADDRESS 0x6001FBEE
 /begin IF_DATA XCPplus 0x0102
  /begin DAQ_EVENT VARIABLE /end DAQ_EVENT
 /end IF_DATA
/end MEASUREMENT
/begin MEASUREMENT CmbdChrgnSys_ratSocTarCcsDc "Target SOC of HV battery to stop CCS DC charging" SWORD Prc 1 100 -400.0000 399.9878 FORMAT "%8.4" ECU_ADDRESS 0x6001FBEC
 /begin IF_DATA XCPplus 0x0102
  /begin DAQ_EVENT VARIABLE /end DAQ_EVENT
 /end IF_DATA
/end MEASUREMENT
/begin MEASUREMENT CmbdChrgnSys_stEvErrCodCcsDc "error code of DC charging according CombinedChargingSystem" UBYTE ChrgCtrl_stEvCcsErrCod_VERB 1 100 0.00 14.0000000000 FORMAT "%13.10" ECU_ADDRESS 0x6002364B
 /begin IF_DATA XCPplus 0x0102
  /begin DAQ_EVENT VARIABLE /end DAQ_EVENT
 /end IF_DATA
/end MEASUREMENT
/begin MEASUREMENT CmbdChrgnSys_uEvseOutDeTolr "Evse voltage regulation tolerance" SWORD RBPtCel_u_0p1_1 1 100 -3276.800 3276.700 FORMAT "%8.3" ECU_ADDRESS 0x6001F520
 /begin IF_DATA XCPplus 0x0102
  /begin DAQ_EVENT VARIABLE /end DAQ_EVENT
 /end IF_DATA
/end MEASUREMENT
/begin MEASUREMENT CmbdChrgnSys_uMinSeln "Battery voltage minimum selection" SWORD RBPtCel_u_0p1_1 1 100 -3276.800 3276.700 FORMAT "%8.3" ECU_ADDRESS 0x6001F51E
 /begin IF_DATA XCPplus 0x0102
  /begin DAQ_EVENT VARIABLE /end DAQ_EVENT
 /end IF_DATA
/end MEASUREMENT
/begin MEASUREMENT CmbdChrgnSys_uTarCcsDc "Target charging voltage CCS DC" SWORD RBPtCel_u_0p1_1 1 100 -3276.800 3276.700 FORMAT "%8.3" ECU_ADDRESS 0x6001FBEA
 /begin IF_DATA XCPplus 0x0102
  /begin DAQ_EVENT VARIABLE /end DAQ_EVENT
 /end IF_DATA
/end MEASUREMENT
/begin MEASUREMENT CoElM_flgCalibActv01 "Offset Calibration for Em01 active" UBYTE B_TRUE 1 100 0.00 1.00000000000 BIT_MASK 0x1 FORMAT "%13.11" ECU_ADDRESS 0x600234C8
 /begin IF_DATA XCPplus 0x0102
  /begin DAQ_EVENT VARIABLE /end DAQ_EVENT
 /end IF_DATA
/end MEASUREMENT
/begin MEASUREMENT CoElM_flgTstOffsCalEna01 "AVS start request from tester" UBYTE B_TRUE 1 100 0.00 1.00000000000 BIT_MASK 0x1 FORMAT "%13.11" ECU_ADDRESS 0x600231B5
 /begin IF_DATA XCPplus 0x0102
  /begin DAQ_EVENT VARIABLE /end DAQ_EVENT
 /end IF_DATA
/end MEASUREMENT
/begin MEASUREMENT CoElM_ModSelcn01_I.ComEmac_flgReqDiag "Class for operating mode selection of EM 1 / Request for diagnosis" UBYTE B_TRUE 1 100 0.00 1.00000000000 BIT_MASK 0x1 FORMAT "%13.11" ECU_ADDRESS 0x60000AC4
 /begin IF_DATA XCPplus 0x0102
  /begin DAQ_EVENT VARIABLE /end DAQ_EVENT
 /end IF_DATA
/end MEASUREMENT
/begin MEASUREMENT CoElM_ModSelcn01_I.ComEmac_flgReqDiag_Sq "Class for operating mode selection of EM 1 / Signal quality for request for diagnosis" UBYTE OneToOne 1 100 0.00 15.00 FORMAT "%5.2" ECU_ADDRESS 0x60000AC5
 /begin IF_DATA XCPplus 0x0102
  /begin DAQ_EVENT VARIABLE /end DAQ_EVENT
 /end IF_DATA
/end MEASUREMENT
/begin MEASUREMENT CoElM_ModSelcn01_I.ElM_bFIdCoElMErr "Class for operating mode selection of EM 1 / FId for error mode active" UBYTE B_TRUE 1 100 0.00 1.00000000000 BIT_MASK 0x1 FORMAT "%13.11" ECU_ADDRESS 0x60000AC6
 /begin IF_DATA XCPplus 0x0102
  /begin DAQ_EVENT VARIABLE /end DAQ_EVENT
 /end IF_DATA
/end MEASUREMENT
/begin MEASUREMENT CoElM_ModSelcn01_I.ElM_flgCalActv "Class for operating mode selection of EM 1 / flag indicates an active offset calibration" UBYTE B_TRUE 1 100 0.00 1.00000000000 BIT_MASK 0x1 FORMAT "%13.11" ECU_ADDRESS 0x60000AC7
 /begin IF_DATA XCPplus 0x0102
  /begin DAQ_EVENT VARIABLE /end DAQ_EVENT
 /end IF_DATA
/end MEASUREMENT
/begin MEASUREMENT CoElM_ModSelcn01_I.ElM_stEem "Class for operating mode selection of EM 1 / Actual state of inverter" UBYTE OneToOne 1 100 0.00 255.0 FORMAT "%5.1" ECU_ADDRESS 0x60000AC8
 /begin IF_DATA XCPplus 0x0102
  /begin DAQ_EVENT VARIABLE /end DAQ_EVENT
 /end IF_DATA
/end MEASUREMENT
/begin MEASUREMENT CoElM_ModSelcn01_I.ElM_stModeDes "Class for operating mode selection of EM 1 / desired mode for EM0x (output of class)" UBYTE OneToOne 1 100 0.00 255.0 FORMAT "%5.1" ECU_ADDRESS 0x60000AC9
 /begin IF_DATA XCPplus 0x0102
  /begin DAQ_EVENT VARIABLE /end DAQ_EVENT
 /end IF_DATA
/end MEASUREMENT
/begin MEASUREMENT CoElM_ModSelcn01_I.ElM_stOffsCal "Class for operating mode selection of EM 1 / AVS return value of offset calibration" UBYTE OneToOne 1 100 0.00 255.0 FORMAT "%5.1" ECU_ADDRESS 0x60000ACA
 /begin IF_DATA XCPplus 0x0102
  /begin DAQ_EVENT VARIABLE /end DAQ_EVENT
 /end IF_DATA
/end MEASUREMENT
/begin MEASUREMENT CoElM_ModSelcn01_I.ElM_stOffsCalSt "Class for operating mode selection of EM 1 / state machine enum value" UBYTE OneToOne 1 100 0.00 255.0 FORMAT "%5.1" ECU_ADDRESS 0x60000ACB
 /begin IF_DATA XCPplus 0x0102
  /begin DAQ_EVENT VARIABLE /end DAQ_EVENT
 /end IF_DATA
/end MEASUREMENT
/begin MEASUREMENT CoElM_ModSelcn01_I.ElM_stOperModAct "Class for operating mode selection of EM 1 / Mode selection" UBYTE RBPtElTrac_stEmOperMod_VERB 1 100 0.00 31.0000000000 FORMAT "%13.10" ECU_ADDRESS 0x60000ACC
 /begin IF_DATA XCPplus 0x0102
  /begin DAQ_EVENT VARIABLE /end DAQ_EVENT
 /end IF_DATA
/end MEASUREMENT
/begin MEASUREMENT CoElM_ModSelcn01_I.PT_nDesEm "Class for operating mode selection of EM 1 / desired speed of e-machine as requested by torque structure" SWORD nmot_q1 1 100 -32768.00 32767.00 FORMAT "%8.2" ECU_ADDRESS 0x60000ACE
 /begin IF_DATA XCPplus 0x0102
  /begin DAQ_EVENT VARIABLE /end DAQ_EVENT
 /end IF_DATA
/end MEASUREMENT
/begin MEASUREMENT CoElM_ModSelcn01_I.PT_stOperModeDesEm "Class for operating mode selection of EM 1 / operation mode of e-machine as requested by torque structure" UBYTE OneToOne 1 100 0.00 255.0 FORMAT "%5.1" ECU_ADDRESS 0x60000AD0
 /begin IF_DATA XCPplus 0x0102
  /begin DAQ_EVENT VARIABLE /end DAQ_EVENT
 /end IF_DATA
/end MEASUREMENT
/begin MEASUREMENT CoElM_ModSelcn01_I.PT_tqDesEmac "Class for operating mode selection of EM 1 / desired torque of e-machine as requested by torque structure" SWORD Trq 1 100 -3276.800 3276.700 FORMAT "%8.3" ECU_ADDRESS 0x60000AD2
 /begin IF_DATA XCPplus 0x0102
  /begin DAQ_EVENT VARIABLE /end DAQ_EVENT
 /end IF_DATA
/end MEASUREMENT
/begin MEASUREMENT CoElM_ModSelcn01_I.flgSetStby "Class for operating mode selection of EM 1 / flag for setting inverter in STBY in standstill" UBYTE B_TRUE 1 100 0.00 1.00000000000 BIT_MASK 0x1 FORMAT "%13.11" ECU_ADDRESS 0x60000AD4
 /begin IF_DATA XCPplus 0x0102
  /begin DAQ_EVENT VARIABLE /end DAQ_EVENT
 /end IF_DATA
/end MEASUREMENT
/begin MEASUREMENT CoElM_ModSelcn01_I.stPTElM0 "Class for operating mode selection of EM 1 / temporary state after hillhold feature check" UBYTE OneToOne 1 100 0.00 255.0 FORMAT "%5.1" ECU_ADDRESS 0x60000AD5
 /begin IF_DATA XCPplus 0x0102
  /begin DAQ_EVENT VARIABLE /end DAQ_EVENT
 /end IF_DATA
/end MEASUREMENT
/begin MEASUREMENT CoElM_ModSelcn01_I.stPTElM1 "Class for operating mode selection of EM 1 / Temporary result for electrical machine request desired mode" UBYTE OneToOne 1 100 0.00 255.0 FORMAT "%5.1" ECU_ADDRESS 0x60000AD6
 /begin IF_DATA XCPplus 0x0102
  /begin DAQ_EVENT VARIABLE /end DAQ_EVENT
 /end IF_DATA
/end MEASUREMENT
/begin MEASUREMENT CoElM_ModSelcn01_I.stPTElM2 "Class for operating mode selection of EM 1 / Temporary result 2 for electrical machine request desired mode" UBYTE OneToOne 1 100 0.00 255.0 FORMAT "%5.1" ECU_ADDRESS 0x60000AD7
 /begin IF_DATA XCPplus 0x0102
  /begin DAQ_EVENT VARIABLE /end DAQ_EVENT
 /end IF_DATA
/end MEASUREMENT
/begin MEASUREMENT CoElM_ModSelcn01_I.stPTElM3 "Class for operating mode selection of EM 1 / Temporary result 3 for electrical machine request desired mode" UBYTE OneToOne 1 100 0.00 255.0 FORMAT "%5.1" ECU_ADDRESS 0x60000AD8
 /begin IF_DATA XCPplus 0x0102
  /begin DAQ_EVENT VARIABLE /end DAQ_EVENT
 /end IF_DATA
/end MEASUREMENT
/begin MEASUREMENT CoElM_ModSelcn01_I.OffsCal_StM_I.ComEmac_flgReqDiag "Class for operating mode selection of EM 1 / Offset calibration state machine / inverter offset calibration request" UBYTE B_TRUE 1 100 0.00 1.00000000000 BIT_MASK 0x1 FORMAT "%13.11" ECU_ADDRESS 0x60000ADC
 /begin IF_DATA XCPplus 0x0102
  /begin DAQ_EVENT VARIABLE /end DAQ_EVENT
 /end IF_DATA
/end MEASUREMENT
/begin MEASUREMENT CoElM_ModSelcn01_I.OffsCal_StM_I.ComEmac_flgReqDiagEF "Class for operating mode selection of EM 1 / Offset calibration state machine / inverter reports successful offset angle calibration" UBYTE B_TRUE 1 100 0.00 1.00000000000 BIT_MASK 0x1 FORMAT "%13.11" ECU_ADDRESS 0x60000ADD
 /begin IF_DATA XCPplus 0x0102
  /begin DAQ_EVENT VARIABLE /end DAQ_EVENT
 /end IF_DATA
/end MEASUREMENT
/begin MEASUREMENT CoElM_ModSelcn01_I.OffsCal_StM_I.Emac_nActPhy "Class for operating mode selection of EM 1 / Offset calibration state machine / filtered ComEmac_nAct without quadrant mapping" SWORD nmot_q1 1 100 -32768.00 32767.00 FORMAT "%8.2" ECU_ADDRESS 0x60000AE6
 /begin IF_DATA XCPplus 0x0102
  /begin DAQ_EVENT VARIABLE /end DAQ_EVENT
 /end IF_DATA
/end MEASUREMENT
/begin MEASUREMENT CoElM_ModSelcn01_I.OffsCal_StM_I.sm "Class for operating mode selection of EM 1 / Offset calibration state machine / state machin enum" UBYTE OffCal_StM_sm_VERB 1 100 0.00 4.00000000000 FORMAT "%13.11" ECU_ADDRESS 0x60000AEB
 /begin IF_DATA XCPplus 0x0102
  /begin DAQ_EVENT VARIABLE /end DAQ_EVENT
 /end IF_DATA
/end MEASUREMENT
/begin MEASUREMENT CoElM_SM01_I.EMS_stCANDSQ "Class instance of CoElM_StM for electrical machine 01 / DSQ for CAN" UBYTE B_TRUE 1 100 0.00 1.00000000000 BIT_MASK 0x1 FORMAT "%13.11" ECU_ADDRESS 0x60000AB8
 /begin IF_DATA XCPplus 0x0102
  /begin DAQ_EVENT VARIABLE /end DAQ_EVENT
 /end IF_DATA
/end MEASUREMENT
/begin MEASUREMENT CoElM_SM01_I.ElM_stModeDes "Class instance of CoElM_StM for electrical machine 01 / Aktuelle operating mode electrical machine" UBYTE RBPtElTrac_stEmOperMod_VERB 1 100 0.00 31.0000000000 FORMAT "%13.10" ECU_ADDRESS 0x60000AB9
 /begin IF_DATA XCPplus 0x0102
  /begin DAQ_EVENT VARIABLE /end DAQ_EVENT
 /end IF_DATA
/end MEASUREMENT
/begin MEASUREMENT CoElM_SM01_I.Emac_stLogl "Class instance of CoElM_StM for electrical machine 01 / Status of coordinator CoELM_StM" UBYTE RBPtElTrac_stEmOperMod_VERB 1 100 0.00 31.0000000000 FORMAT "%13.10" ECU_ADDRESS 0x60000ABA
 /begin IF_DATA XCPplus 0x0102
  /begin DAQ_EVENT VARIABLE /end DAQ_EVENT
 /end IF_DATA
/end MEASUREMENT
/begin MEASUREMENT CoElM_SM01_I.VehCoorn_st "Class instance of CoElM_StM for electrical machine 01 / Common vehicle state" UBYTE OneToOne 1 100 0.00 255.0 FORMAT "%5.1" ECU_ADDRESS 0x60000ABB
 /begin IF_DATA XCPplus 0x0102
  /begin DAQ_EVENT VARIABLE /end DAQ_EVENT
 /end IF_DATA
/end MEASUREMENT
/begin MEASUREMENT CoElM_SM01_I.sm "Class instance of CoElM_StM for electrical machine 01 / TBD" UBYTE CoElM_SM_sm_VERB 1 100 0.00 2.00000000000 FORMAT "%13.11" ECU_ADDRESS 0x60000ABC
 /begin IF_DATA XCPplus 0x0102
  /begin DAQ_EVENT VARIABLE /end DAQ_EVENT
 /end IF_DATA
/end MEASUREMENT
/begin MEASUREMENT CoELM_stAvsRetVal01 "Return value of AVS offset calibration" SLONG OneToOne 1 100 -2147483648.00 2147483647.00 FORMAT "%13.2" ECU_ADDRESS 0x60000AFC
 /begin IF_DATA XCPplus 0x0102
  /begin DAQ_EVENT VARIABLE /end DAQ_EVENT
 /end IF_DATA
/end MEASUREMENT
/begin MEASUREMENT CoElM_stTstrReq01 "State of AVS tester offset calibration request for Em01" UBYTE OneToOne 1 100 0.00 255.0 FORMAT "%5.1" ECU_ADDRESS 0x600231B4
 /begin IF_DATA XCPplus 0x0102
  /begin DAQ_EVENT VARIABLE /end DAQ_EVENT
 /end IF_DATA
/end MEASUREMENT
/begin MEASUREMENT Com_bDiagMonSts_DCDC_OBC "DCDC_OBC monitoring flag" UBYTE OneToOne 1 100 0.00 1.000 BIT_MASK 0x1 FORMAT "%5.3" ECU_ADDRESS 0x6002373C
 /begin IF_DATA XCPplus 0x0102
  /begin DAQ_EVENT VARIABLE /end DAQ_EVENT
 /end IF_DATA
/end MEASUREMENT
/begin MEASUREMENT Com_bDiagMonSts_eBCCM "eBCCM monitoring flag" UBYTE OneToOne 1 100 0.00 1.000 BIT_MASK 0x1 FORMAT "%5.3" ECU_ADDRESS 0x60023738
 /begin IF_DATA XCPplus 0x0102
  /begin DAQ_EVENT VARIABLE /end DAQ_EVENT
 /end IF_DATA
/end MEASUREMENT
/begin MEASUREMENT Com_bDiagMonSts_eCOMP "eCOMP monitoring flag" UBYTE OneToOne 1 100 0.00 1.000 BIT_MASK 0x1 FORMAT "%5.3" ECU_ADDRESS 0x60023737
 /begin IF_DATA XCPplus 0x0102
  /begin DAQ_EVENT VARIABLE /end DAQ_EVENT
 /end IF_DATA
/end MEASUREMENT
/begin MEASUREMENT Com_bDiagMonSts_HVBAT "HVBAT monitoring flag" UBYTE OneToOne 1 100 0.00 1.000 BIT_MASK 0x1 FORMAT "%5.3" ECU_ADDRESS 0x6002373B
 /begin IF_DATA XCPplus 0x0102
  /begin DAQ_EVENT VARIABLE /end DAQ_EVENT
 /end IF_DATA
/end MEASUREMENT
/begin MEASUREMENT Com_bDiagMonSts_INV "INV monitoring flag" UBYTE OneToOne 1 100 0.00 1.000 BIT_MASK 0x1 FORMAT "%5.3" ECU_ADDRESS 0x6002373A
 /begin IF_DATA XCPplus 0x0102
  /begin DAQ_EVENT VARIABLE /end DAQ_EVENT
 /end IF_DATA
/end MEASUREMENT
/begin MEASUREMENT Com_bDiagMonSts_PDU "PDU monitoring flag" UBYTE OneToOne 1 100 0.00 1.000 BIT_MASK 0x1 FORMAT "%5.3" ECU_ADDRESS 0x60023739
 /begin IF_DATA XCPplus 0x0102
  /begin DAQ_EVENT VARIABLE /end DAQ_EVENT
 /end IF_DATA
/end MEASUREMENT
/begin MEASUREMENT Com_bGunCntInfoWku_DCDCOBC "DCDC_OBC gun_connection partial wakeup monitoring flag" UBYTE OneToOne 1 100 0.00 1.000 BIT_MASK 0x1 FORMAT "%5.3" ECU_ADDRESS 0x60023734
 /begin IF_DATA XCPplus 0x0102
  /begin DAQ_EVENT VARIABLE /end DAQ_EVENT
 /end IF_DATA
/end MEASUREMENT
/begin MEASUREMENT Com_bGunCntInfoWku_eBCCM "eBCCM gun_connection partial wakeup monitoring flag" UBYTE OneToOne 1 100 0.00 1.000 BIT_MASK 0x1 FORMAT "%5.3" ECU_ADDRESS 0x60023731
 /begin IF_DATA XCPplus 0x0102
  /begin DAQ_EVENT VARIABLE /end DAQ_EVENT
 /end IF_DATA
/end MEASUREMENT
/begin MEASUREMENT Com_bGunCntInfoWku_HVBAT "hvbat gun_connection partial wakeup monitoring flag" UBYTE OneToOne 1 100 0.00 1.000 BIT_MASK 0x1 FORMAT "%5.3" ECU_ADDRESS 0x60023733
 /begin IF_DATA XCPplus 0x0102
  /begin DAQ_EVENT VARIABLE /end DAQ_EVENT
 /end IF_DATA
/end MEASUREMENT
/begin MEASUREMENT Com_bGunCntInfoWku_PDU "pdu gun_connection partial wakeup monitoring flag" UBYTE OneToOne 1 100 0.00 1.000 BIT_MASK 0x1 FORMAT "%5.3" ECU_ADDRESS 0x60023732
 /begin IF_DATA XCPplus 0x0102
  /begin DAQ_EVENT VARIABLE /end DAQ_EVENT
 /end IF_DATA
/end MEASUREMENT
/begin MEASUREMENT Com_bHvBattRchrgWku_DCDCOBC "Vehicle Charging - Normal Monitoring flag" UBYTE OneToOne 1 100 0.00 1.000 BIT_MASK 0x1 FORMAT "%5.3" ECU_ADDRESS 0x60023730
 /begin IF_DATA XCPplus 0x0102
  /begin DAQ_EVENT VARIABLE /end DAQ_EVENT
 /end IF_DATA
/end MEASUREMENT
/begin MEASUREMENT Com_bHvBattRchrgWku_eBCCM "Vehicle Charging - Normal Monitoring flag" UBYTE OneToOne 1 100 0.00 1.000 BIT_MASK 0x1 FORMAT "%5.3" ECU_ADDRESS 0x6002372D
 /begin IF_DATA XCPplus 0x0102
  /begin DAQ_EVENT VARIABLE /end DAQ_EVENT
 /end IF_DATA
/end MEASUREMENT
/begin MEASUREMENT Com_bHvBattRchrgWku_HVBAT "Vehicle Charging - Normal Monitoring flag" UBYTE OneToOne 1 100 0.00 1.000 BIT_MASK 0x1 FORMAT "%5.3" ECU_ADDRESS 0x6002372F
 /begin IF_DATA XCPplus 0x0102
  /begin DAQ_EVENT VARIABLE /end DAQ_EVENT
 /end IF_DATA
/end MEASUREMENT
/begin MEASUREMENT Com_bHvBattRchrgWku_PDU "PDU VEHICAL_charger_normal partial wakeup monitoring flag" UBYTE OneToOne 1 100 0.00 1.000 BIT_MASK 0x1 FORMAT "%5.3" ECU_ADDRESS 0x6002372E
 /begin IF_DATA XCPplus 0x0102
  /begin DAQ_EVENT VARIABLE /end DAQ_EVENT
 /end IF_DATA
/end MEASUREMENT
/begin MEASUREMENT Com_bImmoUnlockWku_eBCCM "Anti-theft wakeup Monitoring flag" UBYTE OneToOne 1 100 0.00 1.000 BIT_MASK 0x1 FORMAT "%5.3" ECU_ADDRESS 0x6002372A
 /begin IF_DATA XCPplus 0x0102
  /begin DAQ_EVENT VARIABLE /end DAQ_EVENT
 /end IF_DATA
/end MEASUREMENT
/begin MEASUREMENT Com_bImmoUnlockWku_INV "Anti-theft wakeup Monitoring flag" UBYTE OneToOne 1 100 0.00 1.000 BIT_MASK 0x1 FORMAT "%5.3" ECU_ADDRESS 0x6002372B
 /begin IF_DATA XCPplus 0x0102
  /begin DAQ_EVENT VARIABLE /end DAQ_EVENT
 /end IF_DATA
/end MEASUREMENT
/begin MEASUREMENT Com_bInfoReqPtlWkuReq_eBCCM "Remote request monitoring flag" UBYTE OneToOne 1 100 0.00 1.000 BIT_MASK 0x1 FORMAT "%5.3" ECU_ADDRESS 0x60023728
 /begin IF_DATA XCPplus 0x0102
  /begin DAQ_EVENT VARIABLE /end DAQ_EVENT
 /end IF_DATA
/end MEASUREMENT
/begin MEASUREMENT Com_bInfoReqPtlWku_HVBAT "Remote request monitoring flag" UBYTE OneToOne 1 100 0.00 1.000 BIT_MASK 0x1 FORMAT "%5.3" ECU_ADDRESS 0x60023727
 /begin IF_DATA XCPplus 0x0102
  /begin DAQ_EVENT VARIABLE /end DAQ_EVENT
 /end IF_DATA
/end MEASUREMENT
/begin MEASUREMENT Com_bMainWkuDiagMonSts "main wakeup monitoring flag" UBYTE OneToOne 1 100 0.00 1.000 BIT_MASK 0x1 FORMAT "%5.3" ECU_ADDRESS 0x60023726
 /begin IF_DATA XCPplus 0x0102
  /begin DAQ_EVENT VARIABLE /end DAQ_EVENT
 /end IF_DATA
/end MEASUREMENT
/begin MEASUREMENT Com_bPostOperationWku_DCDCOBC "DCDC_OBC Post Operation wakeup monitoring flag" UBYTE OneToOne 1 100 0.00 1.000 BIT_MASK 0x1 FORMAT "%5.3" ECU_ADDRESS 0x60023725
 /begin IF_DATA XCPplus 0x0102
  /begin DAQ_EVENT VARIABLE /end DAQ_EVENT
 /end IF_DATA
/end MEASUREMENT
/begin MEASUREMENT Com_bPostOperationWku_eBCCM "eBCCM Post Operation wakeup monitoring flag" UBYTE OneToOne 1 100 0.00 1.000 BIT_MASK 0x1 FORMAT "%5.3" ECU_ADDRESS 0x60023722
 /begin IF_DATA XCPplus 0x0102
  /begin DAQ_EVENT VARIABLE /end DAQ_EVENT
 /end IF_DATA
/end MEASUREMENT
/begin MEASUREMENT Com_bPostOperationWku_HVBAT "HVBAT Post Operation wakeup monitoring flag" UBYTE OneToOne 1 100 0.00 1.000 BIT_MASK 0x1 FORMAT "%5.3" ECU_ADDRESS 0x60023724
 /begin IF_DATA XCPplus 0x0102
  /begin DAQ_EVENT VARIABLE /end DAQ_EVENT
 /end IF_DATA
/end MEASUREMENT
/begin MEASUREMENT Com_bPostOperationWku_INV "eBCCM Post Operation wakeup monitoring flag" UBYTE OneToOne 1 100 0.00 1.000 BIT_MASK 0x1 FORMAT "%5.3" ECU_ADDRESS 0x60023723
 /begin IF_DATA XCPplus 0x0102
  /begin DAQ_EVENT VARIABLE /end DAQ_EVENT
 /end IF_DATA
/end MEASUREMENT
/begin MEASUREMENT Com_bPreCondElecWku_DCDCOBC "DCDC Precondition wakeup monitorig flag" UBYTE OneToOne 1 100 0.00 1.000 BIT_MASK 0x1 FORMAT "%5.3" ECU_ADDRESS 0x60023720
 /begin IF_DATA XCPplus 0x0102
  /begin DAQ_EVENT VARIABLE /end DAQ_EVENT
 /end IF_DATA
/end MEASUREMENT
/begin MEASUREMENT Com_bPreCondElecWku_eBCCM "eBCCM Remote Preconditioning monitoring Flag" UBYTE OneToOne 1 100 0.00 1.000 BIT_MASK 0x1 FORMAT "%5.3" ECU_ADDRESS 0x6002371E
 /begin IF_DATA XCPplus 0x0102
  /begin DAQ_EVENT VARIABLE /end DAQ_EVENT
 /end IF_DATA
/end MEASUREMENT
/begin MEASUREMENT Com_bPreCondElecWku_eCOMP "eCOMP Remote Preconditioning monitoring Flag" UBYTE OneToOne 1 100 0.00 1.000 BIT_MASK 0x1 FORMAT "%5.3" ECU_ADDRESS 0x6002371D
 /begin IF_DATA XCPplus 0x0102
  /begin DAQ_EVENT VARIABLE /end DAQ_EVENT
 /end IF_DATA
/end MEASUREMENT
/begin MEASUREMENT Com_bPreCondElecWku_HVBAT "preconditional ele wakeup monitoring flag" UBYTE OneToOne 1 100 0.00 1.000 BIT_MASK 0x1 FORMAT "%5.3" ECU_ADDRESS 0x6002371F
 /begin IF_DATA XCPplus 0x0102
  /begin DAQ_EVENT VARIABLE /end DAQ_EVENT
 /end IF_DATA
/end MEASUREMENT
/begin MEASUREMENT Com_bPtlWkuDiagMonSts_DCDC_OBC "DCDC partial wakeup monitoring falg" UBYTE OneToOne 1 100 0.00 1.000 BIT_MASK 0x1 FORMAT "%5.3" ECU_ADDRESS 0x6002371C
 /begin IF_DATA XCPplus 0x0102
  /begin DAQ_EVENT VARIABLE /end DAQ_EVENT
 /end IF_DATA
/end MEASUREMENT
/begin MEASUREMENT Com_bPtlWkuDiagMonSts_eBCCM "eBCCM partial wakeup monitoring falg" UBYTE OneToOne 1 100 0.00 1.000 BIT_MASK 0x1 FORMAT "%5.3" ECU_ADDRESS 0x60023718
 /begin IF_DATA XCPplus 0x0102
  /begin DAQ_EVENT VARIABLE /end DAQ_EVENT
 /end IF_DATA
/end MEASUREMENT
/begin MEASUREMENT Com_bPtlWkuDiagMonSts_eCOMP "eCOMP partial wakeup monitoring falg" UBYTE OneToOne 1 100 0.00 1.000 BIT_MASK 0x1 FORMAT "%5.3" ECU_ADDRESS 0x60023717
 /begin IF_DATA XCPplus 0x0102
  /begin DAQ_EVENT VARIABLE /end DAQ_EVENT
 /end IF_DATA
/end MEASUREMENT
/begin MEASUREMENT Com_bPtlWkuDiagMonSts_HVBAT "HVBAT partial wakeup monitoring falg" UBYTE OneToOne 1 100 0.00 1.000 BIT_MASK 0x1 FORMAT "%5.3" ECU_ADDRESS 0x6002371B
 /begin IF_DATA XCPplus 0x0102
  /begin DAQ_EVENT VARIABLE /end DAQ_EVENT
 /end IF_DATA
/end MEASUREMENT
/begin MEASUREMENT Com_bPtlWkuDiagMonSts_INV "INV partial wakeup monitoring falg" UBYTE OneToOne 1 100 0.00 1.000 BIT_MASK 0x1 FORMAT "%5.3" ECU_ADDRESS 0x6002371A
 /begin IF_DATA XCPplus 0x0102
  /begin DAQ_EVENT VARIABLE /end DAQ_EVENT
 /end IF_DATA
/end MEASUREMENT
/begin MEASUREMENT Com_bPtlWkuDiagMonSts_PDU "PDU partial wakeup monitoring falg" UBYTE OneToOne 1 100 0.00 1.000 BIT_MASK 0x1 FORMAT "%5.3" ECU_ADDRESS 0x60023719
 /begin IF_DATA XCPplus 0x0102
  /begin DAQ_EVENT VARIABLE /end DAQ_EVENT
 /end IF_DATA
/end MEASUREMENT
/begin MEASUREMENT Com_bReFogRlySt "Lin Interface for REAR_DEFOGGER_RELAY_STAT signal of VCU_25h frame" UBYTE B_TRUE 1 100 0.00 1.00000000000 BIT_MASK 0x1 FORMAT "%13.11" ECU_ADDRESS 0x7000149B
 /begin IF_DATA XCPplus 0x0102
  /begin DAQ_EVENT VARIABLE /end DAQ_EVENT
 /end IF_DATA
/end MEASUREMENT
/begin MEASUREMENT Com_bRemoteChargingWku_DCDCOBC "Remote Charging monitoring falg" UBYTE OneToOne 1 100 0.00 1.000 BIT_MASK 0x1 FORMAT "%5.3" ECU_ADDRESS 0x60023713
 /begin IF_DATA XCPplus 0x0102
  /begin DAQ_EVENT VARIABLE /end DAQ_EVENT
 /end IF_DATA
/end MEASUREMENT
/begin MEASUREMENT Com_bRemoteChargingWku_eBCCM "Remote Charging monitoring falg" UBYTE OneToOne 1 100 0.00 1.000 BIT_MASK 0x1 FORMAT "%5.3" ECU_ADDRESS 0x60023710
 /begin IF_DATA XCPplus 0x0102
  /begin DAQ_EVENT VARIABLE /end DAQ_EVENT
 /end IF_DATA
/end MEASUREMENT
/begin MEASUREMENT Com_bRemoteChargingWku_HVBAT "Remote Charging monitoring falg" UBYTE OneToOne 1 100 0.00 1.000 BIT_MASK 0x1 FORMAT "%5.3" ECU_ADDRESS 0x60023712
 /begin IF_DATA XCPplus 0x0102
  /begin DAQ_EVENT VARIABLE /end DAQ_EVENT
 /end IF_DATA
/end MEASUREMENT
/begin MEASUREMENT Com_bRemoteChargingWku_PDU "Remote Charging monitoring falg" UBYTE OneToOne 1 100 0.00 1.000 BIT_MASK 0x1 FORMAT "%5.3" ECU_ADDRESS 0x60023711
 /begin IF_DATA XCPplus 0x0102
  /begin DAQ_EVENT VARIABLE /end DAQ_EVENT
 /end IF_DATA
/end MEASUREMENT
/begin MEASUREMENT Com_bRemUnlckWkuReq_eBCCM "Remote unlock monitoring falg" UBYTE OneToOne 1 100 0.00 1.000 BIT_MASK 0x1 FORMAT "%5.3" ECU_ADDRESS 0x60023714
 /begin IF_DATA XCPplus 0x0102
  /begin DAQ_EVENT VARIABLE /end DAQ_EVENT
 /end IF_DATA
/end MEASUREMENT
/begin MEASUREMENT Com_stHvacBlwrFront_CAN "Interface for Blower knob position on can" UBYTE OneToOne 1 100 0.00 255.0 FORMAT "%5.1" ECU_ADDRESS 0x700014D1
 /begin IF_DATA XCPplus 0x0102
  /begin DAQ_EVENT VARIABLE /end DAQ_EVENT
 /end IF_DATA
/end MEASUREMENT
/begin MEASUREMENT Com_stHvacKnobPosn_CAN "Interface for Temperature knob position on can" UBYTE OneToOne 1 100 0.00 255.0 FORMAT "%5.1" ECU_ADDRESS 0x700014D0
 /begin IF_DATA XCPplus 0x0102
  /begin DAQ_EVENT VARIABLE /end DAQ_EVENT
 /end IF_DATA
/end MEASUREMENT
/begin MEASUREMENT Com_stReFogReq_CAN "Request to Defogger" UBYTE q1 1 100 0.00 255.0 FORMAT "%5.1" ECU_ADDRESS 0x700014C8
 /begin IF_DATA XCPplus 0x0102
  /begin DAQ_EVENT VARIABLE /end DAQ_EVENT
 /end IF_DATA
/end MEASUREMENT
/begin MEASUREMENT Com_tiDiagOff_Cntr "Counter for implemeting down counter" UWORD t_q0p005 1 100 0.00 327.6750 FORMAT "%8.4" ECU_ADDRESS 0x6001FCE6
 /begin IF_DATA XCPplus 0x0102
  /begin DAQ_EVENT VARIABLE /end DAQ_EVENT
 /end IF_DATA
/end MEASUREMENT
/begin MEASUREMENT Com_tiDiagOn_Cntr "Conter for implementing delay" UWORD t_q0p005 1 100 0.00 327.6750 FORMAT "%8.4" ECU_ADDRESS 0x6001FCE4
 /begin IF_DATA XCPplus 0x0102
  /begin DAQ_EVENT VARIABLE /end DAQ_EVENT
 /end IF_DATA
/end MEASUREMENT
/begin MEASUREMENT Com_tiGunCntInfoWkuOff_Cntr "Conter for implementing delay" UWORD t_q0p005 1 100 0.00 327.6750 FORMAT "%8.4" ECU_ADDRESS 0x6001FCE2
 /begin IF_DATA XCPplus 0x0102
  /begin DAQ_EVENT VARIABLE /end DAQ_EVENT
 /end IF_DATA
/end MEASUREMENT
/begin MEASUREMENT Com_tiGunCntInfoWkuOn_Cntr "Conter for implementing delay" UWORD t_q0p005 1 100 0.00 327.6750 FORMAT "%8.4" ECU_ADDRESS 0x6001FCE0
 /begin IF_DATA XCPplus 0x0102
  /begin DAQ_EVENT VARIABLE /end DAQ_EVENT
 /end IF_DATA
/end MEASUREMENT
/begin MEASUREMENT Com_tiHvBattRchrgWkuOff_Cntr "Conter for implementing delay" UWORD t_q0p005 1 100 0.00 327.6750 FORMAT "%8.4" ECU_ADDRESS 0x6001FCDE
 /begin IF_DATA XCPplus 0x0102
  /begin DAQ_EVENT VARIABLE /end DAQ_EVENT
 /end IF_DATA
/end MEASUREMENT
/begin MEASUREMENT Com_tiHvBattRchrgWkuOn_Cntr "Conter for implementing delay" UWORD t_q0p005 1 100 0.00 327.6750 FORMAT "%8.4" ECU_ADDRESS 0x6001FCDC
 /begin IF_DATA XCPplus 0x0102
  /begin DAQ_EVENT VARIABLE /end DAQ_EVENT
 /end IF_DATA
/end MEASUREMENT
/begin MEASUREMENT Com_tiImmoUnlockWkuOff_Cntr "Conter for implementing delay" UWORD t_q0p005 1 100 0.00 327.6750 FORMAT "%8.4" ECU_ADDRESS 0x6001FCD8
 /begin IF_DATA XCPplus 0x0102
  /begin DAQ_EVENT VARIABLE /end DAQ_EVENT
 /end IF_DATA
/end MEASUREMENT
/begin MEASUREMENT Com_tiImmoUnlockWkuOn_Cntr "Conter for implementing delay" UWORD t_q0p005 1 100 0.00 327.6750 FORMAT "%8.4" ECU_ADDRESS 0x6001FCD6
 /begin IF_DATA XCPplus 0x0102
  /begin DAQ_EVENT VARIABLE /end DAQ_EVENT
 /end IF_DATA
/end MEASUREMENT
/begin MEASUREMENT Com_tiInfoReqPtlWkuOff_Cntr "Conter for implementing delay" UWORD t_q0p005 1 100 0.00 327.6750 FORMAT "%8.4" ECU_ADDRESS 0x6001FCD4
 /begin IF_DATA XCPplus 0x0102
  /begin DAQ_EVENT VARIABLE /end DAQ_EVENT
 /end IF_DATA
/end MEASUREMENT
/begin MEASUREMENT Com_tiInfoReqPtlWkuOn_Cntr "Conter for implementing delay" UWORD t_q0p005 1 100 0.00 327.6750 FORMAT "%8.4" ECU_ADDRESS 0x6001FCD2
 /begin IF_DATA XCPplus 0x0102
  /begin DAQ_EVENT VARIABLE /end DAQ_EVENT
 /end IF_DATA
/end MEASUREMENT
/begin MEASUREMENT Com_tiPostOperationWkuOff_Cntr "Conter for implementing delay" UWORD t_q0p005 1 100 0.00 327.6750 FORMAT "%8.4" ECU_ADDRESS 0x6001FCD0
 /begin IF_DATA XCPplus 0x0102
  /begin DAQ_EVENT VARIABLE /end DAQ_EVENT
 /end IF_DATA
/end MEASUREMENT
/begin MEASUREMENT Com_tiPostOperationWkuOn_Cntr "Conter for implementing delay" UWORD t_q0p005 1 100 0.00 327.6750 FORMAT "%8.4" ECU_ADDRESS 0x6001FCCE
 /begin IF_DATA XCPplus 0x0102
  /begin DAQ_EVENT VARIABLE /end DAQ_EVENT
 /end IF_DATA
/end MEASUREMENT
/begin MEASUREMENT Com_tiPreCondElecWkuOff_Cntr "Conter for implementing delay" UWORD t_q0p005 1 100 0.00 327.6750 FORMAT "%8.4" ECU_ADDRESS 0x6001FCCC
 /begin IF_DATA XCPplus 0x0102
  /begin DAQ_EVENT VARIABLE /end DAQ_EVENT
 /end IF_DATA
/end MEASUREMENT
/begin MEASUREMENT Com_tiPreCondElecWkuOn_Cntr "Conter for implementing delay" UWORD t_q0p005 1 100 0.00 327.6750 FORMAT "%8.4" ECU_ADDRESS 0x6001FCCA
 /begin IF_DATA XCPplus 0x0102
  /begin DAQ_EVENT VARIABLE /end DAQ_EVENT
 /end IF_DATA
/end MEASUREMENT
/begin MEASUREMENT Com_tiRemoteChargingWkuOff_Cntr "Conter for implementing delay" UWORD t_q0p005 1 100 0.00 327.6750 FORMAT "%8.4" ECU_ADDRESS 0x6001FCC4
 /begin IF_DATA XCPplus 0x0102
  /begin DAQ_EVENT VARIABLE /end DAQ_EVENT
 /end IF_DATA
/end MEASUREMENT
/begin MEASUREMENT Com_tiRemoteChargingWkuOn_Cntr "Conter for implementing delay" UWORD t_q0p005 1 100 0.00 327.6750 FORMAT "%8.4" ECU_ADDRESS 0x6001FCC2
 /begin IF_DATA XCPplus 0x0102
  /begin DAQ_EVENT VARIABLE /end DAQ_EVENT
 /end IF_DATA
/end MEASUREMENT
/begin MEASUREMENT Com_tiRemUnlckWkuOff_Cntr "Conter for implementing delay" UWORD t_q0p005 1 100 0.00 327.6750 FORMAT "%8.4" ECU_ADDRESS 0x6001FCC8
 /begin IF_DATA XCPplus 0x0102
  /begin DAQ_EVENT VARIABLE /end DAQ_EVENT
 /end IF_DATA
/end MEASUREMENT
/begin MEASUREMENT Com_tiRemUnlckWkuOn_Cntr "Conter for implementing delay" UWORD t_q0p005 1 100 0.00 327.6750 FORMAT "%8.4" ECU_ADDRESS 0x6001FCC6
 /begin IF_DATA XCPplus 0x0102
  /begin DAQ_EVENT VARIABLE /end DAQ_EVENT
 /end IF_DATA
/end MEASUREMENT
/begin MEASUREMENT DDRC_St.DFC_ChrgnCntctHsOt "" ULONG DFC_OneToOne 1 100 0.00 536870911.000 BIT_MASK 0x1fffffff FORMAT "%13.3" ECU_ADDRESS 0x6001C224 /end MEASUREMENT
/begin MEASUREMENT DDRC_St.DFC_ChrgnCntctHsScb "" ULONG DFC_OneToOne 1 100 0.00 536870911.000 BIT_MASK 0x1fffffff FORMAT "%13.3" ECU_ADDRESS 0x6001C228 /end MEASUREMENT
/begin MEASUREMENT DDRC_St.DFC_ChrgnCntctHsScg "" ULONG DFC_OneToOne 1 100 0.00 536870911.000 BIT_MASK 0x1fffffff FORMAT "%13.3" ECU_ADDRESS 0x6001C22C /end MEASUREMENT
/begin MEASUREMENT DDRC_St.DFC_ChrgnCntctLsNegOl "" ULONG DFC_OneToOne 1 100 0.00 536870911.000 BIT_MASK 0x1fffffff FORMAT "%13.3" ECU_ADDRESS 0x6001C230 /end MEASUREMENT
/begin MEASUREMENT DDRC_St.DFC_ChrgnCntctLsNegOt "" ULONG DFC_OneToOne 1 100 0.00 536870911.000 BIT_MASK 0x1fffffff FORMAT "%13.3" ECU_ADDRESS 0x6001C234 /end MEASUREMENT
/begin MEASUREMENT DDRC_St.DFC_ChrgnCntctLsNegScb "" ULONG DFC_OneToOne 1 100 0.00 536870911.000 BIT_MASK 0x1fffffff FORMAT "%13.3" ECU_ADDRESS 0x6001C238 /end MEASUREMENT
/begin MEASUREMENT DDRC_St.DFC_ChrgnCntctLsNegScg "" ULONG DFC_OneToOne 1 100 0.00 536870911.000 BIT_MASK 0x1fffffff FORMAT "%13.3" ECU_ADDRESS 0x6001C23C /end MEASUREMENT
/begin MEASUREMENT DDRC_St.DFC_ChrgnCntctLsPosOl "" ULONG DFC_OneToOne 1 100 0.00 536870911.000 BIT_MASK 0x1fffffff FORMAT "%13.3" ECU_ADDRESS 0x6001C240 /end MEASUREMENT
/begin MEASUREMENT DDRC_St.DFC_ChrgnCntctLsPosOt "" ULONG DFC_OneToOne 1 100 0.00 536870911.000 BIT_MASK 0x1fffffff FORMAT "%13.3" ECU_ADDRESS 0x6001C244 /end MEASUREMENT
/begin MEASUREMENT DDRC_St.DFC_ChrgnCntctLsPosScb "" ULONG DFC_OneToOne 1 100 0.00 536870911.000 BIT_MASK 0x1fffffff FORMAT "%13.3" ECU_ADDRESS 0x6001C248 /end MEASUREMENT
/begin MEASUREMENT DDRC_St.DFC_ChrgnCntctLsPosScg "" ULONG DFC_OneToOne 1 100 0.00 536870911.000 BIT_MASK 0x1fffffff FORMAT "%13.3" ECU_ADDRESS 0x6001C24C /end MEASUREMENT
/begin MEASUREMENT DDRC_St.DFC_ChrgnCntctUnUsed "" ULONG DFC_OneToOne 1 100 0.00 536870911.000 BIT_MASK 0x1fffffff FORMAT "%13.3" ECU_ADDRESS 0x6001C250 /end MEASUREMENT
/begin MEASUREMENT DDRC_St.DFC_CcsDcIBattExcdd "" ULONG DFC_OneToOne 1 100 0.00 536870911.000 BIT_MASK 0x1fffffff FORMAT "%13.3" ECU_ADDRESS 0x6001C9E4 /end MEASUREMENT
/begin MEASUREMENT DDRC_St.DFC_CcsDcIEvseOutDe "" ULONG DFC_OneToOne 1 100 0.00 536870911.000 BIT_MASK 0x1fffffff FORMAT "%13.3" ECU_ADDRESS 0x6001C9E8 /end MEASUREMENT
/begin MEASUREMENT DDRC_St.DFC_CcsDcIOutDe "" ULONG DFC_OneToOne 1 100 0.00 536870911.000 BIT_MASK 0x1fffffff FORMAT "%13.3" ECU_ADDRESS 0x6001C9EC /end MEASUREMENT
/begin MEASUREMENT DDRC_St.DFC_CcsDcIOutExcdd "" ULONG DFC_OneToOne 1 100 0.00 536870911.000 BIT_MASK 0x1fffffff FORMAT "%13.3" ECU_ADDRESS 0x6001C9F0 /end MEASUREMENT
/begin MEASUREMENT DDRC_St.DFC_CcsDcUOutDe "" ULONG DFC_OneToOne 1 100 0.00 536870911.000 BIT_MASK 0x1fffffff FORMAT "%13.3" ECU_ADDRESS 0x6001C9F4 /end MEASUREMENT
/begin MEASUREMENT DDRC_St.DFC_CcsDcUOutExcdd "" ULONG DFC_OneToOne 1 100 0.00 536870911.000 BIT_MASK 0x1fffffff FORMAT "%13.3" ECU_ADDRESS 0x6001C9F8 /end MEASUREMENT
/begin MEASUREMENT DDRC_St.DFC_ChrgPlgLiveCntctHzrdCcs "" UWORD DFC_OneToOne 1 100 0.00 8191.000 BIT_MASK 0x1fff FORMAT "%8.3" ECU_ADDRESS 0x60022002 /end MEASUREMENT
/begin MEASUREMENT DDRC_St.DFC_ChrgPlgProxPltImps "" UWORD DFC_OneToOne 1 100 0.00 8191.000 BIT_MASK 0x1fff FORMAT "%8.3" ECU_ADDRESS 0x60022004 /end MEASUREMENT
/begin MEASUREMENT DDRC_St.DFC_ChrgPlgTHiCcsDc "" UWORD DFC_OneToOne 1 100 0.00 8191.000 BIT_MASK 0x1fff FORMAT "%8.3" ECU_ADDRESS 0x60022006 /end MEASUREMENT
/begin MEASUREMENT DFC_st.DFC_ChrgnCntctHsOt "" UBYTE DFC_OneToOne 1 100 0.00 255.0 FORMAT "%5.1" ECU_ADDRESS 0x600349EC /end MEASUREMENT
/begin MEASUREMENT DFC_st.DFC_ChrgnCntctHsScb "" UBYTE DFC_OneToOne 1 100 0.00 255.0 FORMAT "%5.1" ECU_ADDRESS 0x600349ED /end MEASUREMENT
/begin MEASUREMENT DFC_st.DFC_ChrgnCntctHsScg "" UBYTE DFC_OneToOne 1 100 0.00 255.0 FORMAT "%5.1" ECU_ADDRESS 0x600349EE /end MEASUREMENT
/begin MEASUREMENT DFC_st.DFC_ChrgnCntctLsNegOl "" UBYTE DFC_OneToOne 1 100 0.00 255.0 FORMAT "%5.1" ECU_ADDRESS 0x600349EF /end MEASUREMENT
/begin MEASUREMENT DFC_st.DFC_ChrgnCntctLsNegOt "" UBYTE DFC_OneToOne 1 100 0.00 255.0 FORMAT "%5.1" ECU_ADDRESS 0x600349F0 /end MEASUREMENT
/begin MEASUREMENT DFC_st.DFC_ChrgnCntctLsNegScb "" UBYTE DFC_OneToOne 1 100 0.00 255.0 FORMAT "%5.1" ECU_ADDRESS 0x600349F1 /end MEASUREMENT
/begin MEASUREMENT DFC_st.DFC_ChrgnCntctLsNegScg "" UBYTE DFC_OneToOne 1 100 0.00 255.0 FORMAT "%5.1" ECU_ADDRESS 0x600349F2 /end MEASUREMENT
/begin MEASUREMENT DFC_st.DFC_ChrgnCntctLsPosOl "" UBYTE DFC_OneToOne 1 100 0.00 255.0 FORMAT "%5.1" ECU_ADDRESS 0x600349F3 /end MEASUREMENT
/begin MEASUREMENT DFC_st.DFC_ChrgnCntctLsPosOt "" UBYTE DFC_OneToOne 1 100 0.00 255.0 FORMAT "%5.1" ECU_ADDRESS 0x600349F4 /end MEASUREMENT
/begin MEASUREMENT DFC_st.DFC_ChrgnCntctLsPosScb "" UBYTE DFC_OneToOne 1 100 0.00 255.0 FORMAT "%5.1" ECU_ADDRESS 0x600349F5 /end MEASUREMENT
/begin MEASUREMENT DFC_st.DFC_ChrgnCntctLsPosScg "" UBYTE DFC_OneToOne 1 100 0.00 255.0 FORMAT "%5.1" ECU_ADDRESS 0x600349F6 /end MEASUREMENT
/begin MEASUREMENT DFC_st.DFC_ChrgnCntctUnUsed "" UBYTE DFC_OneToOne 1 100 0.00 255.0 FORMAT "%5.1" ECU_ADDRESS 0x600349F7 /end MEASUREMENT
/begin MEASUREMENT DFC_st.DFC_CcsDcIBattExcdd "" UBYTE DFC_OneToOne 1 100 0.00 255.0 FORMAT "%5.1" ECU_ADDRESS 0x60034BDC /end MEASUREMENT
/begin MEASUREMENT DFC_st.DFC_CcsDcIEvseOutDe "" UBYTE DFC_OneToOne 1 100 0.00 255.0 FORMAT "%5.1" ECU_ADDRESS 0x60034BDD /end MEASUREMENT
/begin MEASUREMENT DFC_st.DFC_CcsDcIOutDe "" UBYTE DFC_OneToOne 1 100 0.00 255.0 FORMAT "%5.1" ECU_ADDRESS 0x60034BDE /end MEASUREMENT
/begin MEASUREMENT DFC_st.DFC_CcsDcIOutExcdd "" UBYTE DFC_OneToOne 1 100 0.00 255.0 FORMAT "%5.1" ECU_ADDRESS 0x60034BDF /end MEASUREMENT
/begin MEASUREMENT DFC_st.DFC_CcsDcUOutDe "" UBYTE DFC_OneToOne 1 100 0.00 255.0 FORMAT "%5.1" ECU_ADDRESS 0x60034BE0 /end MEASUREMENT
/begin MEASUREMENT DFC_st.DFC_CcsDcUOutExcdd "" UBYTE DFC_OneToOne 1 100 0.00 255.0 FORMAT "%5.1" ECU_ADDRESS 0x60034BE1 /end MEASUREMENT
/begin MEASUREMENT DFC_st.DFC_ChrgPlgLiveCntctHzrdCcs "" UBYTE DFC_OneToOne 1 100 0.00 255.0 FORMAT "%5.1" ECU_ADDRESS 0x60034C58 /end MEASUREMENT
/begin MEASUREMENT DFC_st.DFC_ChrgPlgProxPltImps "" UBYTE DFC_OneToOne 1 100 0.00 255.0 FORMAT "%5.1" ECU_ADDRESS 0x60034C59 /end MEASUREMENT
/begin MEASUREMENT DFC_st.DFC_ChrgPlgTHiCcsDc "" UBYTE DFC_OneToOne 1 100 0.00 255.0 FORMAT "%5.1" ECU_ADDRESS 0x60034C5A /end MEASUREMENT
/begin MEASUREMENT DFC_st.DFC_ChgrPlugLockPinByndClsd "" UBYTE DFC_OneToOne 1 100 0.00 255.0 FORMAT "%5.1" ECU_ADDRESS 0x60034C74 /end MEASUREMENT
/begin MEASUREMENT DFC_st.DFC_ChgrPlugLockPinMoveWoCmd "" UBYTE DFC_OneToOne 1 100 0.00 255.0 FORMAT "%5.1" ECU_ADDRESS 0x60034C75 /end MEASUREMENT
/begin MEASUREMENT DFC_st.DFC_ChgrPlugLockPinStuckInClsd "" UBYTE DFC_OneToOne 1 100 0.00 255.0 FORMAT "%5.1" ECU_ADDRESS 0x60034C76 /end MEASUREMENT
/begin MEASUREMENT DFC_st.DFC_ChgrPlugLockPinStuckInOpen "" UBYTE DFC_OneToOne 1 100 0.00 255.0 FORMAT "%5.1" ECU_ADDRESS 0x60034C77 /end MEASUREMENT
/begin MEASUREMENT DFC_st.DFC_ChrgrStErr "" UBYTE DFC_OneToOne 1 100 0.00 255.0 FORMAT "%5.1" ECU_ADDRESS 0x60034C78 /end MEASUREMENT
/begin MEASUREMENT DFC_st.DFC_ChgrPlugCtpCarrFrqErr "" UBYTE DFC_OneToOne 1 100 0.00 255.0 FORMAT "%5.1" ECU_ADDRESS 0x60034CB9 /end MEASUREMENT
/begin MEASUREMENT DFC_st.DFC_ChgrPlugCtpSwtStuckClsd "" UBYTE DFC_OneToOne 1 100 0.00 255.0 FORMAT "%5.1" ECU_ADDRESS 0x60034CBA /end MEASUREMENT
/begin MEASUREMENT DFC_st.DFC_ChgrPlugCtpSwtStuckOpen "" UBYTE DFC_OneToOne 1 100 0.00 255.0 FORMAT "%5.1" ECU_ADDRESS 0x60034CBB /end MEASUREMENT
/begin MEASUREMENT DFC_st.DFC_ChgrPlugCtpUErrHi "" UBYTE DFC_OneToOne 1 100 0.00 255.0 FORMAT "%5.1" ECU_ADDRESS 0x60034CBC /end MEASUREMENT
/begin MEASUREMENT DFC_st.DFC_ChgrPlugPxp1SrcErr "" UBYTE DFC_OneToOne 1 100 0.00 255.0 FORMAT "%5.1" ECU_ADDRESS 0x60034CBD /end MEASUREMENT
/begin MEASUREMENT DFC_st.DFC_ChrgPlgIntlckFaild "" UBYTE DFC_OneToOne 1 100 0.00 255.0 FORMAT "%5.1" ECU_ADDRESS 0x60034CC6 /end MEASUREMENT
/begin MEASUREMENT DFC_st.DFC_CoElMOffsCalibActv01 "" UBYTE DFC_OneToOne 1 100 0.00 255.0 FORMAT "%5.1" ECU_ADDRESS 0x60034CC8 /end MEASUREMENT
/begin MEASUREMENT DINH_nrActvInhReas.FId_CcsDcStopChrgn "" UWORD DINH_ct_Compu 1 100 -4095.000 4096.000 BIT_MASK 0x1fff FORMAT "%8.3" ECU_ADDRESS 0x60021372 /end MEASUREMENT
/begin MEASUREMENT DINH_nrActvInhReas.FId_CcsDcStopChrgnIDftl "" UWORD DINH_ct_Compu 1 100 -4095.000 4096.000 BIT_MASK 0x1fff FORMAT "%8.3" ECU_ADDRESS 0x60021374 /end MEASUREMENT
/begin MEASUREMENT DINH_nrActvInhReas.FId_ChgrPlugCtpSwtSnsrActrErr "" UWORD DINH_ct_Compu 1 100 -4095.000 4096.000 BIT_MASK 0x1fff FORMAT "%8.3" ECU_ADDRESS 0x6002139E /end MEASUREMENT
/begin MEASUREMENT DINH_nrActvInhReas.FId_ChgrPlugLockActrErr "" UWORD DINH_ct_Compu 1 100 -4095.000 4096.000 BIT_MASK 0x1fff FORMAT "%8.3" ECU_ADDRESS 0x600213A0 /end MEASUREMENT
/begin MEASUREMENT DINH_nrActvInhReas.FId_ChgrPlugLockSnsrErr "" UWORD DINH_ct_Compu 1 100 -4095.000 4096.000 BIT_MASK 0x1fff FORMAT "%8.3" ECU_ADDRESS 0x600213A2 /end MEASUREMENT
/begin MEASUREMENT DINH_nrActvInhReas.FId_ChgrPlugPxp1InhbDiagSrc "" UWORD DINH_ct_Compu 1 100 -4095.000 4096.000 BIT_MASK 0x1fff FORMAT "%8.3" ECU_ADDRESS 0x600213A4 /end MEASUREMENT
/begin MEASUREMENT DINH_nrActvInhReas.FId_ChgrPlugTPinDcErr "" UWORD DINH_ct_Compu 1 100 -4095.000 4096.000 BIT_MASK 0x1fff FORMAT "%8.3" ECU_ADDRESS 0x600213A6 /end MEASUREMENT
/begin MEASUREMENT DINH_nrActvInhReas.FId_ChrgPlgChrgrRlyWlddCcs "" UWORD DINH_ct_Compu 1 100 -4095.000 4096.000 BIT_MASK 0x1fff FORMAT "%8.3" ECU_ADDRESS 0x600213A8 /end MEASUREMENT
/begin MEASUREMENT DINH_nrActvInhReas.FId_ChrgPlugCtpDetnErr "" UWORD DINH_ct_Compu 1 100 -4095.000 4096.000 BIT_MASK 0x1fff FORMAT "%8.3" ECU_ADDRESS 0x600213AA /end MEASUREMENT
/begin MEASUREMENT DINH_nrActvInhReas.FId_ChrgnCntctPsFlt "" UWORD DINH_ct_Compu 1 100 -4095.000 4096.000 BIT_MASK 0x1fff FORMAT "%8.3" ECU_ADDRESS 0x600213AC /end MEASUREMENT
/begin MEASUREMENT DINH_nrActvInhReas.FId_ChrgrRlyDcActNegErr "" UWORD DINH_ct_Compu 1 100 -4095.000 4096.000 BIT_MASK 0x1fff FORMAT "%8.3" ECU_ADDRESS 0x600213B4 /end MEASUREMENT
/begin MEASUREMENT DINH_nrActvInhReas.FId_ChrgrRlyDcActPosErr "" UWORD DINH_ct_Compu 1 100 -4095.000 4096.000 BIT_MASK 0x1fff FORMAT "%8.3" ECU_ADDRESS 0x600213B6 /end MEASUREMENT
/begin MEASUREMENT DINH_nrActvInhReas.FId_CmbdChrgnSysCntctErr "" UWORD DINH_ct_Compu 1 100 -4095.000 4096.000 BIT_MASK 0x1fff FORMAT "%8.3" ECU_ADDRESS 0x600213B8 /end MEASUREMENT
/begin MEASUREMENT DINH_nrActvInhReas.FId_CoElMDSQCanEMS01 "" UWORD DINH_ct_Compu 1 100 -4095.000 4096.000 BIT_MASK 0x1fff FORMAT "%8.3" ECU_ADDRESS 0x600213BA /end MEASUREMENT
/begin MEASUREMENT DINH_nrActvInhReas.FId_CoElMErr01 "" UWORD DINH_ct_Compu 1 100 -4095.000 4096.000 BIT_MASK 0x1fff FORMAT "%8.3" ECU_ADDRESS 0x600213BC /end MEASUREMENT
/begin MEASUREMENT DINH_stFId.FId_CcsDcStopChrgn "" UWORD DFC_OneToOne 1 100 0.00 65535.00 FORMAT "%8.2" ECU_ADDRESS 0x60021372 /end MEASUREMENT
/begin MEASUREMENT DINH_stFId.FId_CcsDcStopChrgnIDftl "" UWORD DFC_OneToOne 1 100 0.00 65535.00 FORMAT "%8.2" ECU_ADDRESS 0x60021374 /end MEASUREMENT
/begin MEASUREMENT DINH_stFId.FId_ChgrPlugCtpSwtSnsrActrErr "" UWORD DFC_OneToOne 1 100 0.00 65535.00 FORMAT "%8.2" ECU_ADDRESS 0x6002139E /end MEASUREMENT
/begin MEASUREMENT DINH_stFId.FId_ChgrPlugLockActrErr "" UWORD DFC_OneToOne 1 100 0.00 65535.00 FORMAT "%8.2" ECU_ADDRESS 0x600213A0 /end MEASUREMENT
/begin MEASUREMENT DINH_stFId.FId_ChgrPlugLockSnsrErr "" UWORD DFC_OneToOne 1 100 0.00 65535.00 FORMAT "%8.2" ECU_ADDRESS 0x600213A2 /end MEASUREMENT
/begin MEASUREMENT DINH_stFId.FId_ChgrPlugPxp1InhbDiagSrc "" UWORD DFC_OneToOne 1 100 0.00 65535.00 FORMAT "%8.2" ECU_ADDRESS 0x600213A4 /end MEASUREMENT
/begin MEASUREMENT DINH_stFId.FId_ChgrPlugTPinDcErr "" UWORD DFC_OneToOne 1 100 0.00 65535.00 FORMAT "%8.2" ECU_ADDRESS 0x600213A6 /end MEASUREMENT
/begin MEASUREMENT DINH_stFId.FId_ChrgPlgChrgrRlyWlddCcs "" UWORD DFC_OneToOne 1 100 0.00 65535.00 FORMAT "%8.2" ECU_ADDRESS 0x600213A8 /end MEASUREMENT
/begin MEASUREMENT DINH_stFId.FId_ChrgPlugCtpDetnErr "" UWORD DFC_OneToOne 1 100 0.00 65535.00 FORMAT "%8.2" ECU_ADDRESS 0x600213AA /end MEASUREMENT
/begin MEASUREMENT DINH_stFId.FId_ChrgnCntctPsFlt "" UWORD DFC_OneToOne 1 100 0.00 65535.00 FORMAT "%8.2" ECU_ADDRESS 0x600213AC /end MEASUREMENT
/begin MEASUREMENT DINH_stFId.FId_ChrgrRlyDcActNegErr "" UWORD DFC_OneToOne 1 100 0.00 65535.00 FORMAT "%8.2" ECU_ADDRESS 0x600213B4 /end MEASUREMENT
/begin MEASUREMENT DINH_stFId.FId_ChrgrRlyDcActPosErr "" UWORD DFC_OneToOne 1 100 0.00 65535.00 FORMAT "%8.2" ECU_ADDRESS 0x600213B6 /end MEASUREMENT
/begin MEASUREMENT DINH_stFId.FId_CmbdChrgnSysCntctErr "" UWORD DFC_OneToOne 1 100 0.00 65535.00 FORMAT "%8.2" ECU_ADDRESS 0x600213B8 /end MEASUREMENT
/begin MEASUREMENT DINH_stFId.FId_CoElMDSQCanEMS01 "" UWORD DFC_OneToOne 1 100 0.00 65535.00 FORMAT "%8.2" ECU_ADDRESS 0x600213BA /end MEASUREMENT
/begin MEASUREMENT DINH_stFId.FId_CoElMErr01 "" UWORD DFC_OneToOne 1 100 0.00 65535.00 FORMAT "%8.2" ECU_ADDRESS 0x600213BC /end MEASUREMENT
/begin MEASUREMENT ElM_flgT15EdgFall "Falling Edge on T15" UBYTE B_TRUE 1 100 0.00 1.00000000000 BIT_MASK 0x1 FORMAT "%13.11" ECU_ADDRESS 0x600231B3
 /begin IF_DATA XCPplus 0x0102
  /begin DAQ_EVENT VARIABLE /end DAQ_EVENT
 /end IF_DATA
/end MEASUREMENT
/begin MEASUREMENT ElM_flgT15EdgRisng "Rising Edge on T15" UBYTE B_TRUE 1 100 0.00 1.00000000000 BIT_MASK 0x1 FORMAT "%13.11" ECU_ADDRESS 0x600231B2
 /begin IF_DATA XCPplus 0x0102
  /begin DAQ_EVENT VARIABLE /end DAQ_EVENT
 /end IF_DATA
/end MEASUREMENT
/begin MEASUREMENT ElM_stModeDes01 "desired state electrical machine 1" UBYTE RBPtElTrac_stEmOperMod_VERB 1 100 0.00 31.0000000000 FORMAT "%13.10" ECU_ADDRESS 0x600231B1
 /begin IF_DATA XCPplus 0x0102
  /begin DAQ_EVENT VARIABLE /end DAQ_EVENT
 /end IF_DATA
/end MEASUREMENT
/begin MEASUREMENT ElM_stOffsCal01 "Offset Calibration status Em01" UBYTE OneToOne 1 100 0.00 255.0 FORMAT "%5.1" ECU_ADDRESS 0x6002359F
 /begin IF_DATA XCPplus 0x0102
  /begin DAQ_EVENT VARIABLE /end DAQ_EVENT
 /end IF_DATA
/end MEASUREMENT
/begin MEASUREMENT ElM_stOffsCalSt01 "Offset Calibration Statemachine state number Em01" UBYTE OneToOne 1 100 0.00 255.0 FORMAT "%5.1" ECU_ADDRESS 0x600231B0
 /begin IF_DATA XCPplus 0x0102
  /begin DAQ_EVENT VARIABLE /end DAQ_EVENT
 /end IF_DATA
/end MEASUREMENT
/begin MEASUREMENT ElM_stOffsCalTstr01 "Offset Calibration status of Em01 used for Tester interface" UBYTE OneToOne 1 100 0.00 255.0 FORMAT "%5.1" ECU_ADDRESS 0x600231AF
 /begin IF_DATA XCPplus 0x0102
  /begin DAQ_EVENT VARIABLE /end DAQ_EVENT
 /end IF_DATA
/end MEASUREMENT
/begin MEASUREMENT Emac_stLogl01 "State of coordinator of electrical machine 1" UBYTE RBPtElTrac_stEmOperMod_VERB 1 100 0.00 31.0000000000 FORMAT "%13.10" ECU_ADDRESS 0x60023581
 /begin IF_DATA XCPplus 0x0102
  /begin DAQ_EVENT VARIABLE /end DAQ_EVENT
 /end IF_DATA
/end MEASUREMENT
/begin MEASUREMENT Ext_bMonRunHVAC_PANELtoEVCU "Monitoring condition for LIN" UBYTE B_TRUE 1 100 0.00 1.00000000000 FORMAT "%13.11" ECU_ADDRESS 0x600237EE /end MEASUREMENT
/begin FUNCTION ChrgnCntct_VD "5516.3.0  Charging Contactor control"
 /begin DEF_CHARACTERISTIC ChrgCntct_flgCntctBypSwt_C ChrgCntct_flgCntctNeg_C ChrgCntct_flgCntctPos_C ChrgnCntct_nrMaxManTestImp_C ChrgnCntct_nrTestMaxHs_C ChrgnCntct_nrTestMaxLsNeg_C ChrgnCntct_nrTestMaxLsPos_C ChrgnCntct_stPsDiagDi_C ChrgnCntct_stPsDi_C ChrgnCntct_tiBtwTestImp_C ChrgnCntct_tiBtwTestOtHs_C ChrgnCntct_tiBtwTestOtLsNeg_C ChrgnCntct_tiBtwTestOtLsPos_C ChrgnCntct_tiBtwTestScbHs_C ChrgnCntct_tiBtwTestScbLsNeg_C ChrgnCntct_tiBtwTestScbLsPos_C ChrgnCntct_tiHsOnDiagEna_C ChrgnCntct_tiWaitMinOffDly_C ChrgnCntct_tiWaitMinOnDly_C DcChrgnRlyNeg_O_S_ATS_ATS.LimitTypeMsk_C DcChrgnRlyNeg_O_S_ATS_ATS.CnvNorm_C DcChrgnRlyNeg_O_S_ATS_ATS.LowLim_C DcChrgnRlyNeg_O_S_ATS_ATS.UpLim_C DcChrgnRlyNeg_O_S_ATS_ATS.CnvFac_C DcChrgnRlyNeg_O_S_ATS_ATS.CnvOfs_C DcChrgnRlyNeg_O_S_ATS_ATS.DfltVal_C DcChrgnRlyPos_O_S_ATS_ATS.LimitTypeMsk_C DcChrgnRlyPos_O_S_ATS_ATS.CnvNorm_C DcChrgnRlyPos_O_S_ATS_ATS.LowLim_C DcChrgnRlyPos_O_S_ATS_ATS.UpLim_C DcChrgnRlyPos_O_S_ATS_ATS.CnvFac_C DcChrgnRlyPos_O_S_ATS_ATS.CnvOfs_C DcChrgnRlyPos_O_S_ATS_ATS.DfltVal_C DDRC_DurDeb.ChrgnCntct_tiHsOtDebOk_C DDRC_DurDeb.ChrgnCntct_tiHsOtDebDef_C DDRC_DurDeb.ChrgnCntct_tiHsScbDebOk_C DDRC_DurDeb.ChrgnCntct_tiHsScbDebDef_C DDRC_DurDeb.ChrgnCntct_tiHsScgDebOk_C DDRC_DurDeb.ChrgnCntct_tiHsScgDebDef_C DDRC_DurDeb.ChrgnCntct_tiLsNegOlDebOk_C DDRC_DurDeb.ChrgnCntct_tiLsNegOlDebDef_C DDRC_DurDeb.ChrgnCntct_tiLsNegOtDebOk_C DDRC_DurDeb.ChrgnCntct_tiLsNegOtDebDef_C DDRC_DurDeb.ChrgnCntct_tiLsNegScbDebOk_C DDRC_DurDeb.ChrgnCntct_tiLsNegScbDebDef_C DDRC_DurDeb.ChrgnCntct_tiLsNegScgDebOk_C DDRC_DurDeb.ChrgnCntct_tiLsNegScgDebDef_C DDRC_DurDeb.ChrgnCntct_tiLsPosOlDebOk_C DDRC_DurDeb.ChrgnCntct_tiLsPosOlDebDef_C DDRC_DurDeb.ChrgnCntct_tiLsPosOtDebOk_C DDRC_DurDeb.ChrgnCntct_tiLsPosOtDebDef_C DDRC_DurDeb.ChrgnCntct_tiLsPosScbDebOk_C DDRC_DurDeb.ChrgnCntct_tiLsPosScbDebDef_C DDRC_DurDeb.ChrgnCntct_tiLsPosScgDebOk_C DDRC_DurDeb.ChrgnCntct_tiLsPosScgDebDef_C DDRC_DurDeb.ChrgnCntct_tiUnUsedDebOk_C DDRC_DurDeb.ChrgnCntct_tiUnUsedDebDef_C DFC_CtlMsk2.DFC_ChrgnCntctHsOt_C DFC_CtlMsk2.DFC_ChrgnCntctHsScb_C DFC_CtlMsk2.DFC_ChrgnCntctHsScg_C DFC_CtlMsk2.DFC_ChrgnCntctLsNegOl_C DFC_CtlMsk2.DFC_ChrgnCntctLsNegOt_C DFC_CtlMsk2.DFC_ChrgnCntctLsNegScb_C DFC_CtlMsk2.DFC_ChrgnCntctLsNegScg_C DFC_CtlMsk2.DFC_ChrgnCntctLsPosOl_C DFC_CtlMsk2.DFC_ChrgnCntctLsPosOt_C DFC_CtlMsk2.DFC_ChrgnCntctLsPosScb_C DFC_CtlMsk2.DFC_ChrgnCntctLsPosScg_C DFC_CtlMsk2.DFC_ChrgnCntctUnUsed_C DFC_DisblMsk2.DFC_ChrgnCntctHsOt_C DFC_DisblMsk2.DFC_ChrgnCntctHsScb_C DFC_DisblMsk2.DFC_ChrgnCntctHsScg_C DFC_DisblMsk2.DFC_ChrgnCntctLsNegOl_C DFC_DisblMsk2.DFC_ChrgnCntctLsNegOt_C DFC_DisblMsk2.DFC_ChrgnCntctLsNegScb_C DFC_DisblMsk2.DFC_ChrgnCntctLsNegScg_C DFC_DisblMsk2.DFC_ChrgnCntctLsPosOl_C DFC_DisblMsk2.DFC_ChrgnCntctLsPosOt_C DFC_DisblMsk2.DFC_ChrgnCntctLsPosScb_C DFC_DisblMsk2.DFC_ChrgnCntctLsPosScg_C DFC_DisblMsk2.DFC_ChrgnCntctUnUsed_C /end DEF_CHARACTERISTIC
 /begin IN_MEASUREMENT ChrgCntct_flgCntctNeg ChrgCntct_flgCntctPos ChrgCntct_st DcChrgnRlyNegPosn_st DcChrgnRlyPosPosn_st DevLib_stPwrStgEnaCond /end IN_MEASUREMENT
 /begin OUT_MEASUREMENT ChrgnCntct_flgHsActr ChrgnCntct_flgLsNegActr ChrgnCntct_flgLsPosActr ChrgrRly_stDcCntctActNeg ChrgrRly_stDcCntctActPos ChrgrRly_stEem DDRC_St.DFC_ChrgnCntctHsOt DDRC_St.DFC_ChrgnCntctHsScb DDRC_St.DFC_ChrgnCntctHsScg DDRC_St.DFC_ChrgnCntctLsNegOl DDRC_St.DFC_ChrgnCntctLsNegOt DDRC_St.DFC_ChrgnCntctLsNegScb DDRC_St.DFC_ChrgnCntctLsNegScg DDRC_St.DFC_ChrgnCntctLsPosOl DDRC_St.DFC_ChrgnCntctLsPosOt DDRC_St.DFC_ChrgnCntctLsPosScb DDRC_St.DFC_ChrgnCntctLsPosScg DDRC_St.DFC_ChrgnCntctUnUsed DFC_st.DFC_ChrgnCntctHsOt DFC_st.DFC_ChrgnCntctHsScb DFC_st.DFC_ChrgnCntctHsScg DFC_st.DFC_ChrgnCntctLsNegOl DFC_st.DFC_ChrgnCntctLsNegOt DFC_st.DFC_ChrgnCntctLsNegScb DFC_st.DFC_ChrgnCntctLsNegScg DFC_st.DFC_ChrgnCntctLsPosOl DFC_st.DFC_ChrgnCntctLsPosOt DFC_st.DFC_ChrgnCntctLsPosScb DFC_st.DFC_ChrgnCntctLsPosScg DFC_st.DFC_ChrgnCntctUnUsed DINH_nrActvInhReas.FId_ChrgnCntctPsFlt DINH_nrActvInhReas.FId_ChrgrRlyDcActNegErr DINH_nrActvInhReas.FId_ChrgrRlyDcActPosErr DINH_stFId.FId_ChrgnCntctPsFlt DINH_stFId.FId_ChrgrRlyDcActNegErr DINH_stFId.FId_ChrgrRlyDcActPosErr /end OUT_MEASUREMENT
 /begin LOC_MEASUREMENT ChrgnCntct_DigOutPrmStructHs.tiBtwTstSCB_C ChrgnCntct_DigOutPrmStructHs.tiBtwTstOT_C ChrgnCntct_DigOutPrmStructHs.numTstMax_C ChrgnCntct_DigOutPrmStructLsNeg.tiBtwTstSCB_C ChrgnCntct_DigOutPrmStructLsNeg.tiBtwTstOT_C ChrgnCntct_DigOutPrmStructLsNeg.numTstMax_C ChrgnCntct_DigOutPrmStructLsPos.tiBtwTstSCB_C ChrgnCntct_DigOutPrmStructLsPos.tiBtwTstOT_C ChrgnCntct_DigOutPrmStructLsPos.numTstMax_C ChrgnCntct_DigOutStatStructHs.tmrTBtwTst ChrgnCntct_DigOutStatStructHs.ctTstDne ChrgnCntct_DigOutStatStructHs.stPrevTstRslt ChrgnCntct_DigOutStatStructLsNeg.tmrTBtwTst ChrgnCntct_DigOutStatStructLsNeg.ctTstDne ChrgnCntct_DigOutStatStructLsNeg.stPrevTstRslt ChrgnCntct_DigOutStatStructLsPos.tmrTBtwTst ChrgnCntct_DigOutStatStructLsPos.ctTstDne ChrgnCntct_DigOutStatStructLsPos.stPrevTstRslt ChrgnCntct_flgCntctNegAts ChrgnCntct_flgCntctPosAts ChrgnCntct_flgPsActvnDisad ChrgnCntct_flgPsDiagDisad ChrgnCntct_flgPsDisad ChrgnCntct_flgScbLocnActv ChrgnCntct_flgScgLocnActv ChrgnCntct_stErrNeg ChrgnCntct_stErrPos ChrgnCntct_stHsErrInfo ChrgnCntct_stLsNegErrInfo ChrgnCntct_stLsPosErrInfo ChrgnCntct_stReq ChrgnCntct_tiStTmrDiag /end LOC_MEASUREMENT
 FUNCTION_VERSION "5516.3.0" /end FUNCTION
/begin FUNCTION ChrgPlgDcVal_VD "5500.1.0  Physical values during DC charging."
 /begin DEF_CHARACTERISTIC ChgrPlug_iDcReplcmt_C ChgrPlug_maskIDcRlyInvldSq_C ChgrPlug_maskUDcRlyInvldSq_C ChgrPlug_uDcReplcmt_C /end DEF_CHARACTERISTIC
 /begin IN_MEASUREMENT ComChrgn_flgFltIDcRly ComChrgn_flgFltUDcRly ComChrgn_iDcRly ComChrgn_iDcRly_Sq ComChrgn_uDcRly ComChrgn_uDcRly_Sq /end IN_MEASUREMENT
 /begin OUT_MEASUREMENT ChgrPlug_iDc ChgrPlug_iDc_Sq ChgrPlug_uDc ChgrPlug_uDc_Sq /end OUT_MEASUREMENT
 FUNCTION_VERSION "5500.1.0" /end FUNCTION
/begin FUNCTION ChrgPlgLock_VD "5501.3.0  Locking and unlocking of electrical plug."
 /begin DEF_CHARACTERISTIC ChgrPlug_cntrTryClsng_C ChgrPlug_cntrTryOpng_C ChgrPlug_ratPlgLockClsng_C ChgrPlug_ratPlgLockOff_C ChgrPlug_ratPlgLockOpng_C ChgrPlug_tiPlgLockClsng_C ChgrPlug_tiPlgLockOff_C ChgrPlug_tiPlgLockOpng_C ChgrPlug_tiPlgLockPwrOn_C DFC_CtlMsk2.DFC_ChgrPlugLockPinByndClsd_C DFC_CtlMsk2.DFC_ChgrPlugLockPinMoveWoCmd_C DFC_CtlMsk2.DFC_ChgrPlugLockPinStuckInClsd_C DFC_CtlMsk2.DFC_ChgrPlugLockPinStuckInOpen_C DFC_DisblMsk2.DFC_ChgrPlugLockPinByndClsd_C DFC_DisblMsk2.DFC_ChgrPlugLockPinMoveWoCmd_C DFC_DisblMsk2.DFC_ChgrPlugLockPinStuckInClsd_C DFC_DisblMsk2.DFC_ChgrPlugLockPinStuckInOpen_C /end DEF_CHARACTERISTIC
 /begin IN_MEASUREMENT ChgrPlug_stPxPCcs ChrgPlg_stPlgLockCmd IntlckChrgPlgPosn_st IntlckChrgPlg_rActr IntlckChrgPlg_stHbrOLDiagExtReq /end IN_MEASUREMENT
 /begin OUT_MEASUREMENT ChgrPlug_stPlgLock DFC_st.DFC_ChgrPlugLockPinByndClsd DFC_st.DFC_ChgrPlugLockPinMoveWoCmd DFC_st.DFC_ChgrPlugLockPinStuckInClsd DFC_st.DFC_ChgrPlugLockPinStuckInOpen DINH_nrActvInhReas.FId_ChgrPlugLockActrErr DINH_nrActvInhReas.FId_ChgrPlugLockSnsrErr DINH_stFId.FId_ChgrPlugLockActrErr DINH_stFId.FId_ChgrPlugLockSnsrErr /end OUT_MEASUREMENT
 /begin LOC_MEASUREMENT ChgrPlug_cntrPlgLockActrActvn ChgrPlug_stPlgLockStMac ChgrPlug_tiPlgLock /end LOC_MEASUREMENT
 FUNCTION_VERSION "5501.3.0" /end FUNCTION
/begin FUNCTION ChrgPlgPltSwt_VD "5501.4.0  Switch S2 which signals readiness for power transfer."
 /begin DEF_CHARACTERISTIC ChgrPlug_rCtpSwtClsd_C ChgrPlug_rCtpSwtOpen_C ChgrPlug_tiCtpSwtStDeb_C ChgrPlug_tiCtpSwtTog_C ChgrPlug_uConHiLimClsdReq_C ChgrPlug_uConHiLimOpenReq_C ChgrPlug_uConLoLimClsdReq_C ChgrPlug_uConLoLimOpenReq_C ChgrPlug_uDiagHiLimClsdReq_C ChgrPlug_uDiagHiLimOpenReq_C ChgrPlug_uDiagLoLimClsdReq_C ChgrPlug_uDiagLoLimOpenReq_C DFC_CtlMsk2.DFC_ChgrPlugCtpSwtStuckClsd_C DFC_CtlMsk2.DFC_ChgrPlugCtpSwtStuckOpen_C DFC_DisblMsk2.DFC_ChgrPlugCtpSwtStuckClsd_C DFC_DisblMsk2.DFC_ChgrPlugCtpSwtStuckOpen_C /end DEF_CHARACTERISTIC
 /begin IN_MEASUREMENT ChgrPlug_stCtpDetd ChrgFlow_flgCtrlPltSwtReq ChrgFlow_nrTogCtrlPltSwtReq CtPSwtActr_r CtPSwtDiag_uSens_f UCtP_uSens_f /end IN_MEASUREMENT
 /begin OUT_MEASUREMENT ChgrPlug_flgCtpSwtTogActv ChgrPlug_flgCtPSwtVld DFC_st.DFC_ChgrPlugCtpSwtStuckClsd DFC_st.DFC_ChgrPlugCtpSwtStuckOpen DINH_nrActvInhReas.FId_ChgrPlugCtpSwtSnsrActrErr DINH_stFId.FId_ChgrPlugCtpSwtSnsrActrErr /end OUT_MEASUREMENT
 /begin LOC_MEASUREMENT ChgrPlug_cntrCtpSwtTog ChgrPlug_flgCtpSwtActr ChgrPlug_flgCtpSwtTogReq ChgrPlug_stCtpSwtDebd ChgrPlug_stCtpSwtNotDebd /end LOC_MEASUREMENT
 FUNCTION_VERSION "5501.4.0" /end FUNCTION
/begin FUNCTION ChrgPlgPlt_VD "5501.3.0  Control Pilot line for communication between EV supply equipment and vControl Pilot line for communication between EV supply equipment and vehicle."
 /begin DEF_CHARACTERISTIC ChgrPlug_iCtpLimMpgCcs2_T ChgrPlug_rCtpVldFrqHiThdCcs2_C ChgrPlug_rCtpVldFrqLoThdCcs2_C ChgrPlug_stCtpIntMpgCcs2_T ChgrPlug_stUCtpIntMpgCcs2_T ChgrPlug_tiDebStCtp_C ChgrPlug_tiPT1ICtpLim_C DFC_CtlMsk2.DFC_ChgrPlugCtpCarrFrqErr_C DFC_CtlMsk2.DFC_ChgrPlugCtpUErrHi_C DFC_DisblMsk2.DFC_ChgrPlugCtpCarrFrqErr_C DFC_DisblMsk2.DFC_ChgrPlugCtpUErrHi_C /end DEF_CHARACTERISTIC
 /begin IN_MEASUREMENT CtpCarrFrq_rAct_f PwmCtP_rDtyCycRaw_f UCtP_uSens_f /end IN_MEASUREMENT
 /begin OUT_MEASUREMENT ChgrPlug_flgDigComRqrd ChgrPlug_iCtPLim ChgrPlug_stCtP ChgrPlug_stCtpDetd DFC_st.DFC_ChgrPlugCtpCarrFrqErr DFC_st.DFC_ChgrPlugCtpUErrHi DINH_nrActvInhReas.FId_ChrgPlugCtpDetnErr DINH_stFId.FId_ChrgPlugCtpDetnErr /end OUT_MEASUREMENT
 /begin LOC_MEASUREMENT ChgrPlug_stCtpInt ChgrPlug_stCtpIntUnfild /end LOC_MEASUREMENT
 FUNCTION_VERSION "5501.3.0" /end FUNCTION
/begin FUNCTION ChrgPlgT_VD "5500.5.0  Temperature of plug and inlet." /begin IN_MEASUREMENT DcChrgrIntkT2_t_f DcChrgrIntkT_t_f /end IN_MEASUREMENT
 /begin OUT_MEASUREMENT ChgrPlug_stTPinCcsDc ChgrPlug_tPinCcsDc DINH_nrActvInhReas.FId_ChgrPlugTPinDcErr DINH_stFId.FId_ChgrPlugTPinDcErr /end OUT_MEASUREMENT
 FUNCTION_VERSION "5500.5.0" /end FUNCTION
/begin FUNCTION ChrgPlg_Ctrl "5500.9.0  Charge Plug Control" /begin DEF_CHARACTERISTIC ChrgPlg_flgMplPlgStopEna_C ChrgPlg_tiPlgLockReqDly_C /end DEF_CHARACTERISTIC
 /begin IN_MEASUREMENT ChrgMod_stChrgnReq ChrgMod_stMod ChrgPlg_flgChrgnStopReqCcs ChrgPlg_stCcs ChrgPlg_stIntlck ChrgPlg_stTMon /end IN_MEASUREMENT
 /begin OUT_MEASUREMENT ChrgPlg_flgChrgnStopReq ChrgPlg_flgMplPlgDetd ChrgPlg_flgPlgLockReq ChrgPlg_stChrgn ChrgPlg_stPlg /end OUT_MEASUREMENT
 /begin LOC_MEASUREMENT ChrgPlg_flgPlgLockReqTmp /end LOC_MEASUREMENT
 FUNCTION_VERSION "5500.9.0" /end FUNCTION
/begin FUNCTION ChrgPlg_Intlck "5500.7.0  Charge Plug Locking and Unlocking"
 /begin DEF_CHARACTERISTIC ChrgPlg_iAcMaxRelsPlg_C ChrgPlg_maskRelsPlgIGridSq_C ChrgPlg_maskRelsPlgUDcSq_C ChrgPlg_maskRelsPlgUGridSq_C ChrgPlg_prmIntlck.tiCmdAckdTout_C ChrgPlg_prmIntlck.tiLockPlg_C ChrgPlg_prmIntlck.tiPlgDetn_C ChrgPlg_prmIntlck.tiRelckPlg_C ChrgPlg_prmIntlck.tiUnlckPlgAc_C ChrgPlg_prmIntlck.tiUnlckPlgDc_C ChrgPlg_prmIntlck.tiWaitUIntkLowr_C ChrgPlg_tiDebUIntkLockPlg_C ChrgPlg_tiDebUIntkRelsPlg_C ChrgPlg_tiLockDebUnpl_C ChrgPlg_uAcMaxRelsPlg_C ChrgPlg_uDcMaxRelsPlg_C DFC_CtlMsk2.DFC_ChrgPlgIntlckFaild_C DFC_DisblMsk2.DFC_ChrgPlgIntlckFaild_C /end DEF_CHARACTERISTIC
 /begin IN_MEASUREMENT ChgrPlug_stCtP ChgrPlug_stPlgLock ChgrPlug_stPxPCcs ChgrPlug_uDc ChgrPlug_uDc_Sq ChrgCIL_stHmiReq ChrgMod_stMod ChrgPlg_flgPlgLockReq ChrgPlg_stCcs ChrgrVal_iGrid ChrgrVal_iGrid_Sq ChrgrVal_uGrid ChrgrVal_uGrid_Sq /end IN_MEASUREMENT
 /begin OUT_MEASUREMENT ChrgPlg_flgRdyForShdwn ChrgPlg_stIntlck ChrgPlg_stPlgLockCmd DFC_st.DFC_ChrgPlgIntlckFaild /end OUT_MEASUREMENT
 /begin LOC_MEASUREMENT ChrgPlg_flgUIntkLockPlg ChrgPlg_flgUIntkRelsPlg ChrgPlg_Intlck_StMac.flgAutoUnlckDone ChrgPlg_Intlck_StMac.flgDlyRelck ChrgPlg_Intlck_StMac.flgDynLockReq ChrgPlg_Intlck_StMac.flgDynUnlckReq ChrgPlg_Intlck_StMac.flgIniReqDone ChrgPlg_Intlck_StMac.sm ChrgPlg_Intlck_StMac.tiCmdAckdTout ChrgPlg_Intlck_StMac.tiTmr ChrgPlg_Intlck_StMac.tiTmrUnlck ChrgPlg_LockgFailr_StMac.sm ChrgPlg_LockgFailr_StMac.tiTmr /end LOC_MEASUREMENT
 FUNCTION_VERSION "5500.7.0" /end FUNCTION
/begin FUNCTION ChrgPlg_StCcs "5610.1.0  Charge Plug State CCS"
 /begin DEF_CHARACTERISTIC DDRC_DurDeb.ChrgPlg_tiLiveCntctHzrdCcsDebOk_C DDRC_DurDeb.ChrgPlg_tiLiveCntctHzrdCcsDebDef_C DDRC_DurDeb.ChrgPlg_tiProxPltImpsDebOk_C DDRC_DurDeb.ChrgPlg_tiProxPltImpsDebDef_C DFC_CtlMsk2.DFC_ChrgPlgLiveCntctHzrdCcs_C DFC_CtlMsk2.DFC_ChrgPlgProxPltImps_C DFC_DisblMsk2.DFC_ChrgPlgLiveCntctHzrdCcs_C DFC_DisblMsk2.DFC_ChrgPlgProxPltImps_C /end DEF_CHARACTERISTIC
 /begin IN_MEASUREMENT ChgrPlug_stCtP ChgrPlug_stPxPCcs /end IN_MEASUREMENT
 /begin OUT_MEASUREMENT ChrgPlg_flgChrgnStopReqCcs ChrgPlg_stCcs DDRC_St.DFC_ChrgPlgLiveCntctHzrdCcs DDRC_St.DFC_ChrgPlgProxPltImps DFC_st.DFC_ChrgPlgLiveCntctHzrdCcs DFC_st.DFC_ChrgPlgProxPltImps DINH_nrActvInhReas.FId_ChrgPlgChrgrRlyWlddCcs DINH_stFId.FId_ChrgPlgChrgrRlyWlddCcs /end OUT_MEASUREMENT
 FUNCTION_VERSION "5610.1.0" /end FUNCTION
/begin FUNCTION ChrgPlg_TMon "5500.6.0  Charge Plug Temperature Monitoring"
 /begin DEF_CHARACTERISTIC ChrgPlg_facDernICcsDc_T ChrgPlg_facDernIDfl_C ChrgPlg_tDfl_C ChrgPlg_tPinCcsDcMax_C DDRC_DurDeb.ChrgPlg_tiTHiCcsDcDebOk_C DDRC_DurDeb.ChrgPlg_tiTHiCcsDcDebDef_C DFC_CtlMsk2.DFC_ChrgPlgTHiCcsDc_C DFC_DisblMsk2.DFC_ChrgPlgTHiCcsDc_C /end DEF_CHARACTERISTIC
 /begin IN_MEASUREMENT ChgrPlug_stTPinCcsDc ChgrPlug_tPinCcsDc ChrgMod_stMod /end IN_MEASUREMENT
 /begin OUT_MEASUREMENT ChrgPlg_facDernI ChrgPlg_stTMon ChrgPlg_tPin DDRC_St.DFC_ChrgPlgTHiCcsDc DFC_st.DFC_ChrgPlgTHiCcsDc /end OUT_MEASUREMENT
 FUNCTION_VERSION "5500.6.0" /end FUNCTION
/begin FUNCTION ChrgrCtrl_VD "5501.0.0  Charger Control Virtual Driver" /begin DEF_CHARACTERISTIC ChrgrSt_stChrgnReqMpg_T ChrgrSt_stStrtVal_C /end DEF_CHARACTERISTIC /begin IN_MEASUREMENT ChrgMod_stChrgnReq ChrgMod_stMod /end IN_MEASUREMENT /begin OUT_MEASUREMENT ChrgrSt_stChrgnEna /end OUT_MEASUREMENT /begin LOC_MEASUREMENT ChrgrSt_stChrgnReq /end LOC_MEASUREMENT FUNCTION_VERSION "5501.0.0" /end FUNCTION
/begin FUNCTION ChrgrIntVal_VD "5501.0.0  Charger Internal Values Virtual Driver"
 /begin DEF_CHARACTERISTIC ChrgrVal_iGridDft_C ChrgrVal_iOutDft_C ChrgrVal_maskComChrgrInvldSq_C ChrgrVal_maskComChrgrVldSq_C ChrgrVal_tDft_C ChrgrVal_uAcActPhaThd_C ChrgrVal_uGridDft_C ChrgrVal_uOutDft_C /end DEF_CHARACTERISTIC
 /begin IN_MEASUREMENT ComChrgr_iAcMax ComChrgr_iAcMax_Sq ComChrgr_iDcHvAct ComChrgr_iDcHvAct_Sq ComChrgr_tChrgrMaxAct ComChrgr_tChrgrMaxAct_Sq ComChrgr_uAcActL1 ComChrgr_uAcActL1_Sq ComChrgr_uAcActL2 ComChrgr_uAcActL2_Sq ComChrgr_uAcActL3 ComChrgr_uAcActL3_Sq ComChrgr_uDcHvAct ComChrgr_uDcHvAct_Sq /end IN_MEASUREMENT
 /begin OUT_MEASUREMENT ChrgrVal_iGrid ChrgrVal_iGrid_Sq ChrgrVal_iOut ChrgrVal_iOut_Sq ChrgrVal_nrAcPha ChrgrVal_nrAcPha_Sq ChrgrVal_t ChrgrVal_t_Sq ChrgrVal_uGrid ChrgrVal_uGrid_Sq ChrgrVal_uOut ChrgrVal_uOut_Sq /end OUT_MEASUREMENT
 FUNCTION_VERSION "5501.0.0" /end FUNCTION
/begin FUNCTION ChrgrPlgProxPlt_VD "5501.6.0  Proximity Pilot"
 /begin DEF_CHARACTERISTIC ChgrPlug_iCblLimCcsVal1_C ChgrPlug_iCblLimCcsVal2_C ChgrPlug_iCblLimCcsVal3_C ChgrPlug_iCblLimCcsVal4_C ChgrPlug_iCblLimCcsVal5_C ChgrPlug_iCblLimCcsValErr_C ChgrPlug_maskNrAcPhaVldSq_C ChgrPlug_stPxpIntMpgCcs2_T ChgrPlug_tiDebPxp1StErr_C ChgrPlug_tiDebPxp1StOk_C DFC_CtlMsk2.DFC_ChgrPlugPxp1SrcErr_C DFC_DisblMsk2.DFC_ChgrPlugPxp1SrcErr_C /end DEF_CHARACTERISTIC
 /begin IN_MEASUREMENT ChrgrVal_nrAcPha ChrgrVal_nrAcPha_Sq UPxP1_u_f /end IN_MEASUREMENT
 /begin OUT_MEASUREMENT ChgrPlug_iCblLimCcs ChgrPlug_stPxPCcs DFC_st.DFC_ChgrPlugPxp1SrcErr DINH_nrActvInhReas.FId_ChgrPlugPxp1InhbDiagSrc DINH_stFId.FId_ChgrPlugPxp1InhbDiagSrc /end OUT_MEASUREMENT
 /begin LOC_MEASUREMENT ChgrPlug_stPxp1Int ChgrPlug_stPxp1IntDebd ChgrPlug_stStMacPxp1 /end LOC_MEASUREMENT
 FUNCTION_VERSION "5501.6.0" /end FUNCTION
/begin FUNCTION ChrgrReqdVal_VD "5501.1.0  Requested Values for Charger - Virtual Driver"
 /begin IN_MEASUREMENT AcExtChrgr_iChrgnLimMaxAc ChrgMod_iChrgnReq ChrgMod_uChrgnReq /end IN_MEASUREMENT
 /begin OUT_MEASUREMENT ChrgrVal_iChrgrDes ChrgrVal_iGridLimMax ChrgrVal_uHvMax /end OUT_MEASUREMENT
 FUNCTION_VERSION "5501.1.0" /end FUNCTION
/begin FUNCTION ChrgrSt_VD "5501.1.0  Charger Status Virtual Driver"
 /begin DEF_CHARACTERISTIC ChrgrSt_maskChrgrErrSq_C ChrgrSt_maskStChrgrSq_C ChrgrSt_stChrgn_M DFC_CtlMsk2.DFC_ChrgrStErr_C DFC_DisblMsk2.DFC_ChrgrStErr_C /end DEF_CHARACTERISTIC
 /begin IN_MEASUREMENT ChrgMod_stChrgnReq ChrgMod_stMod ComChrgr_flgChrgrErr ComChrgr_flgChrgrErr_Sq ComChrgr_stChrgr ComChrgr_stChrgr_Sq /end IN_MEASUREMENT
 /begin OUT_MEASUREMENT ChrgrSt_stChrgn ChrgrSt_stEem DFC_st.DFC_ChrgrStErr /end OUT_MEASUREMENT
 /begin LOC_MEASUREMENT ChrgrSt_flgChrgrErrComVld ChrgrSt_flgChrgrOrComErr ChrgrSt_stChrgnReqInt ChrgrSt_stChrgrMpg /end LOC_MEASUREMENT
 FUNCTION_VERSION "5501.1.0" /end FUNCTION
/begin FUNCTION ChrgSdl_TiCalcn "5500.6.0  Charge time calculation"
 /begin DEF_CHARACTERISTIC ChrgSdl_facCvLut_T ChrgSdl_iCcLut_M ChrgSdl_iPre_C ChrgSdl_ratCcEndThd_C ChrgSdl_ratCcStrtLut_M ChrgSdl_tiCvLut_M /end DEF_CHARACTERISTIC
 /begin IN_MEASUREMENT ChrgMod_iChrgnMaxAvl ChrgMod_iChrgnReq ChrgMod_ratSocChrgnStop ChrgMod_stChrgn ChrgMod_stMod HvBatt_iActMeasd HvBatt_qTotCp HvBatt_ratSoc /end IN_MEASUREMENT
 /begin OUT_MEASUREMENT ChrgSdl_stTiCalcn ChrgSdl_tiCcRmn ChrgSdl_tiElpd ChrgSdl_tiRmn /end OUT_MEASUREMENT
 /begin LOC_MEASUREMENT ChrgSdl_facCvCorrn ChrgSdl_facDeltaCc ChrgSdl_facDeltaCp ChrgSdl_flgThdUpd ChrgSdl_iCc ChrgSdl_iCcLut ChrgSdl_iChrgnMaxAvlPrv ChrgSdl_iCv ChrgSdl_qTot ChrgSdl_ratCcEnd ChrgSdl_ratCcStrt ChrgSdl_ratCvEnd ChrgSdl_ratCvStrt ChrgSdl_ratDeltaCv ChrgSdl_ratPreEnd ChrgSdl_ratSocChrgnStopPrv ChrgSdl_stTiCalcnPrv ChrgSdl_tiCc ChrgSdl_tiCv ChrgSdl_tiCvCorrn ChrgSdl_tiCvLut ChrgSdl_tiPre /end LOC_MEASUREMENT
 FUNCTION_VERSION "5500.6.0" /end FUNCTION
/begin FUNCTION ChrgSys_Ctrl "5500.3.0  System performance control during charging - ECU activation request and network management"
 /begin DEF_CHARACTERISTIC ChrgSys_flgProlgPostDrive_C ChrgSys_tiDlyProlgWaitComReq_C ChrgSys_tiProlgWaitPlugDetn_C ChrgSys_tiProlMaxWoChrgnEnad_C /end DEF_CHARACTERISTIC
 /begin IN_MEASUREMENT ChrgMod_stChrgn ChrgPlg_stPlg SyC_stSub /end IN_MEASUREMENT
 /begin OUT_MEASUREMENT ChrgSys_flgChrgNmComReq /end OUT_MEASUREMENT
 /begin LOC_MEASUREMENT ChrgSys_flgProlgPostDrive ChrgSys_flgProlgWait ChrgSys_tiProlgWoChrgnEnad /end LOC_MEASUREMENT
 FUNCTION_VERSION "5500.3.0" /end FUNCTION
/begin FUNCTION CmbdChrgnSys_StCndDc "5610.2.0  Combined Charging System - State conditions DC"
 /begin DEF_CHARACTERISTIC CmbdChrgnSys_flgAllwdDrvModNeutPosn_C CmbdChrgnSys_iBattActLoCcsDc_C CmbdChrgnSys_iBattReqLoCcsDc_C CmbdChrgnSys_maskPlgUDcSq_C CmbdChrgnSys_ratSocTarCcsDc_C CmbdChrgnSys_tiDebPrecFinshd_C CmbdChrgnSys_tiDlyActILoCcsDc_C CmbdChrgnSys_uMaxPrecFinshd_C /end DEF_CHARACTERISTIC
 /begin IN_MEASUREMENT ChgrPlug_flgCtPSwtVld ChgrPlug_flgDigComRqrd ChgrPlug_stCtP ChgrPlug_uDc ChgrPlug_uDc_Sq ChrgCIL_stHmiReq ChrgCntct_st ChrgMod_stMod ChrgPlg_flgChrgnStopReq ChrgPlg_stChrgn ChrgPlg_stIntlck DcChrgnCtrl_stChrgn DcChrgnCtrl_stChrgnCntctReq DcChrgnCtrl_stChrgnReq DrvMod_stPosn HLCCcs_flgChrgnStopReq HLCCcs_st HLCCcs_stEvseCmpblty HLCCcs_stEvseDcIso HvBatt_flgChrgTarRea HvBatt_iActMeasd HvBatt_iReqToChrgr HvBatt_ratSoc HvBatt_stFlt HvBatt_uActMeasd VehCoorn_st /end IN_MEASUREMENT
 /begin OUT_MEASUREMENT CmbdChrgnSys_flgCritErrCcsDc CmbdChrgnSys_flgMnrErrCcsDc CmbdChrgnSys_flgPrecFinshdCcsDc CmbdChrgnSys_flgStopReqCcsDc CmbdChrgnSys_flgStrtPndCcsDc CmbdChrgnSys_ratSocTarCcsDc CmbdChrgnSys_stEvErrCodCcsDc DINH_nrActvInhReas.FId_CcsDcStopChrgn DINH_nrActvInhReas.FId_CcsDcStopChrgnIDftl DINH_nrActvInhReas.FId_CmbdChrgnSysCntctErr DINH_stFId.FId_CcsDcStopChrgn DINH_stFId.FId_CcsDcStopChrgnIDftl DINH_stFId.FId_CmbdChrgnSysCntctErr /end OUT_MEASUREMENT
 FUNCTION_VERSION "5610.2.0" /end FUNCTION
/begin FUNCTION CmbdChrgnSys_UICalcnDc "5610.0.0  Combined Charging System - Voltage and Current Calculation DC"
 /begin DEF_CHARACTERISTIC CmbdChrgnSys_diBattExddNeg_C CmbdChrgnSys_diBattExddPos_C CmbdChrgnSys_diOutExddNeg_C CmbdChrgnSys_diOutExddPos_C CmbdChrgnSys_facDmdExcddTolr_C CmbdChrgnSys_facHvBattExcddTolr_C CmbdChrgnSys_facIEvseDcRglnTolr_C CmbdChrgnSys_facUEvseDcRglnTolr_C CmbdChrgnSys_flgAuxUnitLoadHiEna_C CmbdChrgnSys_flgAuxUnitLoadLoEna_C CmbdChrgnSys_flgEvseITolrDi_C CmbdChrgnSys_iAuxHiDeTolr_C CmbdChrgnSys_iAuxLoDeTolr_C CmbdChrgnSys_iAuxUnitLoadMax_C CmbdChrgnSys_iChrgnLimMax_C CmbdChrgnSys_iDmdExcddTolr_C CmbdChrgnSys_iEvseDcRglnTolr_C CmbdChrgnSys_iHvBattExcddTolr_C CmbdChrgnSys_iPlgDeTolr_C CmbdChrgnSys_iTolSwtThd_C CmbdChrgnSys_tiDlyIDmd_C CmbdChrgnSys_tiDlyIReq_C CmbdChrgnSys_uDeTolr_C CmbdChrgnSys_uPlgDeTolr_C CmbdChrgnSys_uTarExcddTolr_C DDRC_DurDeb.CmbdChrgnSys_tiIBattExcddDebOk_C DDRC_DurDeb.CmbdChrgnSys_tiIBattExcddDebDef_C DDRC_DurDeb.CmbdChrgnSys_tiIEvseOutDeDebOk_C DDRC_DurDeb.CmbdChrgnSys_tiIEvseOutDeDebDef_C DDRC_DurDeb.CmbdChrgnSys_tiIOutDeDebOk_C DDRC_DurDeb.CmbdChrgnSys_tiIOutDeDebDef_C DDRC_DurDeb.CmbdChrgnSys_tiIOutExcddDebOk_C DDRC_DurDeb.CmbdChrgnSys_tiIOutExcddDebDef_C DDRC_DurDeb.CmbdChrgnSys_tiUOutDeDebOk_C DDRC_DurDeb.CmbdChrgnSys_tiUOutDeDebDef_C DDRC_DurDeb.CmbdChrgnSys_tiUOutExcddDebOk_C DDRC_DurDeb.CmbdChrgnSys_tiUOutExcddDebDef_C DDRC_RatDeb.CmbdChrgnSys_tiIBattExcddUDRat_C DDRC_RatDeb.CmbdChrgnSys_tiIEvseOutDeUDRat_C DDRC_RatDeb.CmbdChrgnSys_tiIOutDeUDRat_C DDRC_RatDeb.CmbdChrgnSys_tiIOutExcddUDRat_C DDRC_RatDeb.CmbdChrgnSys_tiUOutDeUDRat_C DDRC_RatDeb.CmbdChrgnSys_tiUOutExcddUDRat_C DFC_CtlMsk2.DFC_CcsDcIBattExcdd_C DFC_CtlMsk2.DFC_CcsDcIEvseOutDe_C DFC_CtlMsk2.DFC_CcsDcIOutDe_C DFC_CtlMsk2.DFC_CcsDcIOutExcdd_C DFC_CtlMsk2.DFC_CcsDcUOutDe_C DFC_CtlMsk2.DFC_CcsDcUOutExcdd_C DFC_DisblMsk2.DFC_CcsDcIBattExcdd_C DFC_DisblMsk2.DFC_CcsDcIEvseOutDe_C DFC_DisblMsk2.DFC_CcsDcIOutDe_C DFC_DisblMsk2.DFC_CcsDcIOutExcdd_C DFC_DisblMsk2.DFC_CcsDcUOutDe_C DFC_DisblMsk2.DFC_CcsDcUOutExcdd_C /end DEF_CHARACTERISTIC
 /begin IN_MEASUREMENT ChgrPlug_iDc ChgrPlug_uDc ChrgMod_stMod ChrgPlg_facDernI DcChrgnCtrl_stChrgn DcChrgnCtrl_stChrgnReq Eem_pwrAuxUnitLoad Eem_pwrAuxUnitLoadHi Eem_pwrAuxUnitLoadLo Eem_pwrBascAuxUnitLoad HLCCcs_iEvseDcMax HLCCcs_iEvseDcMin HLCCcs_iEvseDcPrsnt HLCCcs_iEvseDcRglnTolr HLCCcs_pwrAvlDcMax HLCCcs_uEvseDcMax HLCCcs_uEvseDcPrsnt HvBatt_iActMeasd HvBatt_iMaxExtChrg HvBatt_iReqToChrgr HvBatt_uActMeasd HvBatt_uMaxLim HvBatt_uNomChrgn /end IN_MEASUREMENT
 /begin OUT_MEASUREMENT CmbdChrgnSys_iDmdCcsDc CmbdChrgnSys_iEvMax CmbdChrgnSys_iMaxAvlCcsDc CmbdChrgnSys_pwrOutCcsDc CmbdChrgnSys_uTarCcsDc DDRC_St.DFC_CcsDcIBattExcdd DDRC_St.DFC_CcsDcIEvseOutDe DDRC_St.DFC_CcsDcIOutDe DDRC_St.DFC_CcsDcIOutExcdd DDRC_St.DFC_CcsDcUOutDe DDRC_St.DFC_CcsDcUOutExcdd DFC_st.DFC_CcsDcIBattExcdd DFC_st.DFC_CcsDcIEvseOutDe DFC_st.DFC_CcsDcIOutDe DFC_st.DFC_CcsDcIOutExcdd DFC_st.DFC_CcsDcUOutDe DFC_st.DFC_CcsDcUOutExcdd /end OUT_MEASUREMENT
 /begin LOC_MEASUREMENT CmbdChrgnSys_flgAuxHiLim CmbdChrgnSys_flgAuxLoLim CmbdChrgnSys_iAuxUnitLoad CmbdChrgnSys_iAuxUnitLoadHi CmbdChrgnSys_iBattReq CmbdChrgnSys_iDmdCcsDcDlyd CmbdChrgnSys_iDmdCcsLoc CmbdChrgnSys_iDmdExcddTolr CmbdChrgnSys_iDmdLimCcsDc CmbdChrgnSys_iEvseAvlMax CmbdChrgnSys_iHvBattExcddTolr CmbdChrgnSys_iHvBattLim CmbdChrgnSys_iReq CmbdChrgnSys_iReqToChrgrDlyd CmbdChrgnSys_iTolr CmbdChrgnSys_uEvseOutDeTolr CmbdChrgnSys_uMinSeln /end LOC_MEASUREMENT
 FUNCTION_VERSION "5610.0.0" /end FUNCTION
/begin FUNCTION CodeGen "1.31.0    ASCET Automotive System Library Interface" FUNCTION_VERSION "1.31.0" /end FUNCTION
/begin FUNCTION CodeGen_Simulink "1.18.0    Code generator component for Simulink Coder" FUNCTION_VERSION "1.18.0" /end FUNCTION
/begin FUNCTION CoElM_StM "1400.0.0  Coordinator E_Maschine"
 /begin DEF_CHARACTERISTIC CoElM_ModSelcn01_I.ElM_flgSwtSetStby_C CoElM_ModSelcn01_I.ElM_nActThdStby_C CoElM_ModSelcn01_I.ElM_nThdStby_C CoElM_ModSelcn01_I.ElM_tiStbyToD_C CoElM_ModSelcn01_I.ElM_tqThdStby_C CoElM_ModSelcn01_I.OffsCal_StM_I.ELM_flgOffsCalByIvtrAllwd_C CoElM_ModSelcn01_I.OffsCal_StM_I.ELM_flgOffsCalEna_C CoElM_ModSelcn01_I.OffsCal_StM_I.ELM_flgToutActv_C CoElM_ModSelcn01_I.OffsCal_StM_I.ElM_maskFlgReqDiagVldSq_C CoElM_ModSelcn01_I.OffsCal_StM_I.ElM_nMaxThdOffsCal_C CoElM_ModSelcn01_I.OffsCal_StM_I.ElM_nMinThdOffsCal_C CoElM_ModSelcn01_I.OffsCal_StM_I.ElM_tiOffsCalTout_C CoElM_SM01_I.ElM_tiWaitShtDwn_C DFC_CtlMsk2.DFC_CoElMOffsCalibActv01_C DFC_DisblMsk2.DFC_CoElMOffsCalibActv01_C /end DEF_CHARACTERISTIC
 /begin IN_MEASUREMENT ComEmac_flgReqDiag01 ComEmac_flgReqDiag01_Sq ElM_stEem01 ElM_stOperModAct01 Emac_nActPhy01 PT_nDesEm01 PT_stOperModeDesEm01 PT_tqDesEmac01 T15_st VehCoorn_st /end IN_MEASUREMENT
 /begin OUT_MEASUREMENT CoElM_flgCalibActv01 DFC_st.DFC_CoElMOffsCalibActv01 DINH_nrActvInhReas.FId_CoElMDSQCanEMS01 DINH_nrActvInhReas.FId_CoElMErr01 DINH_stFId.FId_CoElMDSQCanEMS01 DINH_stFId.FId_CoElMErr01 ElM_stOffsCal01 Emac_stLogl01 /end OUT_MEASUREMENT
 /begin LOC_MEASUREMENT CoElM_flgTstOffsCalEna01 CoElM_ModSelcn01_I.ComEmac_flgReqDiag CoElM_ModSelcn01_I.ComEmac_flgReqDiag_Sq CoElM_ModSelcn01_I.ElM_bFIdCoElMErr CoElM_ModSelcn01_I.ElM_flgCalActv CoElM_ModSelcn01_I.ElM_stEem CoElM_ModSelcn01_I.ElM_stModeDes CoElM_ModSelcn01_I.ElM_stOffsCal CoElM_ModSelcn01_I.ElM_stOffsCalSt CoElM_ModSelcn01_I.ElM_stOperModAct CoElM_ModSelcn01_I.PT_nDesEm CoElM_ModSelcn01_I.PT_stOperModeDesEm CoElM_ModSelcn01_I.PT_tqDesEmac CoElM_ModSelcn01_I.flgSetStby CoElM_ModSelcn01_I.stPTElM0 CoElM_ModSelcn01_I.stPTElM1 CoElM_ModSelcn01_I.stPTElM2 CoElM_ModSelcn01_I.stPTElM3 CoElM_ModSelcn01_I.OffsCal_StM_I.ComEmac_flgReqDiag CoElM_ModSelcn01_I.OffsCal_StM_I.ComEmac_flgReqDiagEF CoElM_ModSelcn01_I.OffsCal_StM_I.Emac_nActPhy CoElM_ModSelcn01_I.OffsCal_StM_I.sm CoElM_SM01_I.EMS_stCANDSQ CoElM_SM01_I.ElM_stModeDes CoElM_SM01_I.Emac_stLogl CoElM_SM01_I.VehCoorn_st CoElM_SM01_I.sm CoELM_stAvsRetVal01 CoElM_stTstrReq01 ElM_flgT15EdgFall ElM_flgT15EdgRisng ElM_stModeDes01 ElM_stOffsCalSt01 ElM_stOffsCalTstr01 /end LOC_MEASUREMENT
 FUNCTION_VERSION "1400.0.0" /end FUNCTION
/begin FUNCTION ComCIL_Adapt "850.3.0   Interface adapter for the Communication Customer Interface Layer"
 /begin IN_MEASUREMENT Com_bReFogRlySt_CAN Com_stHvacBlwrFront Com_stHvacKnobPosn Com_stReFogReq /end IN_MEASUREMENT
 /begin OUT_MEASUREMENT Com_bReFogRlySt Com_stHvacBlwrFront_CAN Com_stHvacKnobPosn_CAN Com_stReFogReq_CAN /end OUT_MEASUREMENT
 FUNCTION_VERSION "850.3.0" /end FUNCTION
/begin FUNCTION ComCIL_MonSt "850.2.0   CAN Status Data monitoring Status"
 /begin DEF_CHARACTERISTIC Com_DiagMonStsByp_C Com_tiDiagOff_C Com_tiDiagOn_C Com_tiGunCntInfoWkuOff_C Com_tiGunCntInfoWkuOn_C Com_tiHvBattRchrgWkuOff_C Com_tiHvBattRchrgWkuOn_C Com_tiImmoUnlockWkuOff_C Com_tiImmoUnlockWkuOn_C Com_tiInfoReqPtlWkuOff_C Com_tiInfoReqPtlWkuOn_C Com_tiPostOperationWkuOff_C Com_tiPostOperationWkuOn_C Com_tiPreCondElecWkuOff_C Com_tiPreCondElecWkuOn_C Com_tiRemoteChargingWkuOff_C Com_tiRemoteChargingWkuOn_C Com_tiRemUnlckWkuOff_C Com_tiRemUnlckWkuOn_C /end DEF_CHARACTERISTIC
 /begin IN_MEASUREMENT Com_bGunCntInfoWkuReq Com_bHvBattRchrgWkuReq Com_bImmoUnlockWkuReq Com_bInfoReqPtlWkuReq Com_bPostOperationWkuReq Com_bPreCondElecWkuReq Com_bRemUnlckWkuReq Com_bStpDlyHMIWkuReq Com_stChrgnSpstReq rba_SyC_bWkuMain /end IN_MEASUREMENT
 /begin OUT_MEASUREMENT Com_bDiagMonSts_DCDC_OBC Com_bDiagMonSts_eBCCM Com_bDiagMonSts_eCOMP Com_bDiagMonSts_HVBAT Com_bDiagMonSts_INV Com_bDiagMonSts_PDU Com_bGunCntInfoWku_DCDCOBC Com_bGunCntInfoWku_eBCCM Com_bGunCntInfoWku_HVBAT Com_bGunCntInfoWku_PDU Com_bHvBattRchrgWku_DCDCOBC Com_bHvBattRchrgWku_eBCCM Com_bHvBattRchrgWku_HVBAT Com_bHvBattRchrgWku_PDU Com_bImmoUnlockWku_eBCCM Com_bImmoUnlockWku_INV Com_bInfoReqPtlWkuReq_eBCCM Com_bInfoReqPtlWku_HVBAT Com_bMainWkuDiagMonSts Com_bPostOperationWku_DCDCOBC Com_bPostOperationWku_eBCCM Com_bPostOperationWku_HVBAT Com_bPostOperationWku_INV Com_bPreCondElecWku_DCDCOBC Com_bPreCondElecWku_eBCCM Com_bPreCondElecWku_eCOMP Com_bPreCondElecWku_HVBAT Com_bPtlWkuDiagMonSts_DCDC_OBC Com_bPtlWkuDiagMonSts_eBCCM Com_bPtlWkuDiagMonSts_eCOMP Com_bPtlWkuDiagMonSts_HVBAT Com_bPtlWkuDiagMonSts_INV Com_bPtlWkuDiagMonSts_PDU Com_bRemoteChargingWku_DCDCOBC Com_bRemoteChargingWku_eBCCM Com_bRemoteChargingWku_HVBAT Com_bRemoteChargingWku_PDU Com_bRemUnlckWkuReq_eBCCM Com_tiDiagOff_Cntr Com_tiDiagOn_Cntr Com_tiGunCntInfoWkuOff_Cntr Com_tiGunCntInfoWkuOn_Cntr Com_tiHvBattRchrgWkuOff_Cntr Com_tiHvBattRchrgWkuOn_Cntr Com_tiImmoUnlockWkuOff_Cntr Com_tiImmoUnlockWkuOn_Cntr Com_tiInfoReqPtlWkuOff_Cntr Com_tiInfoReqPtlWkuOn_Cntr Com_tiPostOperationWkuOff_Cntr Com_tiPostOperationWkuOn_Cntr Com_tiPreCondElecWkuOff_Cntr Com_tiPreCondElecWkuOn_Cntr Com_tiRemoteChargingWkuOff_Cntr Com_tiRemoteChargingWkuOn_Cntr Com_tiRemUnlckWkuOff_Cntr Com_tiRemUnlckWkuOn_Cntr /end OUT_MEASUREMENT
 FUNCTION_VERSION "850.2.0" /end FUNCTION
/begin FUNCTION Common "3.3.0     central header file" FUNCTION_VERSION "3.3.0" /end FUNCTION
/begin FUNCTION CommonCELPrj "30059.0.0 header file for CELPrj package" FUNCTION_VERSION "30059.0.0" /end FUNCTION
/begin FUNCTION ComScl_Appl "850.3.0   Application of ComScl Layer" /begin DEF_CHARACTERISTIC ChkCntr_Enable_C /end DEF_CHARACTERISTIC /begin REF_CHARACTERISTIC Ext_ctClcProcMax_C Ext_ctClcProcMin_C /end REF_CHARACTERISTIC /begin IN_MEASUREMENT ComM_stComModeCANHSN1 ComM_stComModeCANHSN3 /end IN_MEASUREMENT /begin OUT_MEASUREMENT Ext_bMonRunHVAC_PANELtoEVCU /end OUT_MEASUREMENT FUNCTION_VERSION "850.3.0" /end FUNCTION
/begin COMPU_METHOD B_TRUE "" TAB_VERB "%6.3" "" COMPU_TAB_REF B_TRUE /end COMPU_METHOD
/begin COMPU_VTAB B_TRUE "" TAB_VERB 2 0 "FALSE" 1 "TRUE" /end COMPU_VTAB
/begin COMPU_METHOD ChgrPlug_stPlgLockStMac_VERB "" TAB_VERB "%6.3" "" COMPU_TAB_REF ChgrPlug_stPlgLockStMac_VERB /end COMPU_METHOD
/begin COMPU_VTAB ChgrPlug_stPlgLockStMac_VERB "" TAB_VERB 17 0 "ChgrPlug_stPlgLockStMac_ENUM_PowerOn" 1 "ChgrPlug_stPlgLockStMac_ENUM_Unlocking" 2 "ChgrPlug_stPlgLockStMac_ENUM_Unlocked" 3 "ChgrPlug_stPlgLockStMac_ENUM_Unlocked_WaitCmd" 4 "ChgrPlug_stPlgLockStMac_ENUM_Unlocking_Wait" 5 "ChgrPlug_stPlgLockStMac_ENUM_Locking_Start" 6 "ChgrPlug_stPlgLockStMac_ENUM_Locking_Continued" 7 "ChgrPlug_stPlgLockStMac_ENUM_Locked" 8 "ChgrPlug_stPlgLockStMac_ENUM_Locking_Wait" 9 "ChgrPlug_stPlgLockStMac_ENUM_Error_Actuator" 10 "ChgrPlug_stPlgLockStMac_ENUM_Error_Sensor_Start" 11 "ChgrPlug_stPlgLockStMac_ENUM_Error_Sensor_WaitCmd" 12 "ChgrPlug_stPlgLockStMac_ENUM_Error_Sensor_Unlocking" 13 "ChgrPlug_stPlgLockStMac_ENUM_Error_Sensor_Locking" 14 "ChgrPlug_stPlgLockStMac_ENUM_Error_DesAct" 15 "ChgrPlug_stPlgLockStMac_ENUM_Error_Healed" 16 "ChgrPlug_stPlgLockStMac_ENUM_Error_Healed_WaitCmd" /end COMPU_VTAB
/begin COMPU_METHOD ChrgCtrl_stChrgn_VERB "" TAB_VERB "%6.3" "" COMPU_TAB_REF ChrgCtrl_stChrgn_VERB /end COMPU_METHOD
/begin COMPU_VTAB ChrgCtrl_stChrgn_VERB "" TAB_VERB 7 0 "CHRGCTRL_INI" 1 "CHRGCTRL_PREP" 2 "CHRGCTRL_CHRGN" 3 "CHRGCTRL_STOP" 4 "CHRGCTRL_FINSH" 5 "CHRGCTRL_CRITERR" 6 "CHRGCTRL_MNRERR" /end COMPU_VTAB
/begin COMPU_METHOD ChrgCtrl_stEvCcsErrCod_VERB "" TAB_VERB "%6.3" "" COMPU_TAB_REF ChrgCtrl_stEvCcsErrCod_VERB /end COMPU_METHOD
/begin COMPU_VTAB ChrgCtrl_stEvCcsErrCod_VERB "" TAB_VERB 9 0 "CMBDCHRGNSYS_EVERRCOD_NOERR" 2 "CMBDCHRGNSYS_EVERRCOD_TBATT" 3 "CMBDCHRGNSYS_EVERRCOD_GEAR" 4 "CMBDCHRGNSYS_EVERRCOD_PLGLOCK" 7 "CMBDCHRGNSYS_EVERRCOD_BATT" 8 "CMBDCHRGNSYS_EVERRCOD_IDFTL" 9 "CMBDCHRGNSYS_EVERRCOD_UBATT" 13 "CMBDCHRGNSYS_EVERRCOD_NOTCMPBL" 14 "CMBDCHRGNSYS_EVERRCOD_OTHFLT" /end COMPU_VTAB
/begin COMPU_METHOD ChrgIf_stIntlck_VERB "" TAB_VERB "%6.3" "" COMPU_TAB_REF ChrgIf_stIntlck_VERB /end COMPU_METHOD
/begin COMPU_VTAB ChrgIf_stIntlck_VERB "" TAB_VERB 6 0 "CHRGPLG_INTLCK_INI" 1 "CHRGPLG_INTLCK_UNLCKD" 2 "CHRGPLG_INTLCK_NOTAVL" 3 "CHRGPLG_INTLCK_LOCKDELEC" 4 "CHRGPLG_INTLCK_LOCKDMECL" 9 "CHRGPLG_INTLCK_ERR" /end COMPU_VTAB
/begin COMPU_METHOD ChrgIf_stPlgLockCmd_VERB "" TAB_VERB "%6.3" "" COMPU_TAB_REF ChrgIf_stPlgLockCmd_VERB /end COMPU_METHOD
/begin COMPU_VTAB ChrgIf_stPlgLockCmd_VERB "" TAB_VERB 3 0 "CHRGPLG_INTLCK_LOCKREQ" 1 "CHRGPLG_INTLCK_UNLCKREQ" 2 "CHRGPLG_INTLCK_STYREQ" /end COMPU_VTAB
/begin COMPU_METHOD ChrgIf_stPlg_VERB "" TAB_VERB "%6.3" "" COMPU_TAB_REF ChrgIf_stPlg_VERB /end COMPU_METHOD
/begin COMPU_VTAB ChrgIf_stPlg_VERB "" TAB_VERB 3 0 "CHRGPLG_UNPLGD" 1 "CHRGPLG_PTLPLGD" 2 "CHRGPLG_PLGD" /end COMPU_VTAB
/begin COMPU_METHOD ChrgIf_stTMon_VERB "" TAB_VERB "%6.3" "" COMPU_TAB_REF ChrgIf_stTMon_VERB /end COMPU_METHOD
/begin COMPU_VTAB ChrgIf_stTMon_VERB "" TAB_VERB 5 0 "CHRGPLG_TMON_INI" 1 "CHRGPLG_TMON_OK" 2 "CHRGPLG_TMON_NOTAVL" 3 "CHRGPLG_TMON_MNRERR" 4 "CHRGPLG_TMON_CRITERR" /end COMPU_VTAB
/begin COMPU_METHOD ChrgPlg_Intlck_StMac_sm_VERB "" TAB_VERB "%6.3" "" COMPU_TAB_REF ChrgPlg_Intlck_StMac_sm_VERB /end COMPU_METHOD
/begin COMPU_VTAB ChrgPlg_Intlck_StMac_sm_VERB "" TAB_VERB 17 0 "Intlck_UnplIni" 1 "Intlck_ChrgnChkCmd" 10 "Intlck_PlgdUnlck" 11 "Intlck_UnplChkSt" 12 "Intlck_UnplUnlck" 13 "Intlck_Chrgn" 14 "Intlck_ChrgnActv" 15 "Intlck_Plgd" 16 "Intlck_UnPlgd" 2 "Intlck_ChrgnChkUnlck" 3 "Intlck_ChrgnFinshd" 4 "Intlck_ChrgnLockChk" 5 "Intlck_ChrgnLockCmd" 6 "Intlck_ChrgnNotAvl" 7 "Intlck_ChrgnUnlck" 8 "Intlck_PlgdChkSt" 9 "Intlck_PlgdLock" /end COMPU_VTAB
/begin COMPU_METHOD ChrgPlg_LockgFailr_StMac_sm_VERB "" TAB_VERB "%6.3" "" COMPU_TAB_REF ChrgPlg_LockgFailr_StMac_sm_VERB /end COMPU_METHOD
/begin COMPU_VTAB ChrgPlg_LockgFailr_StMac_sm_VERB "" TAB_VERB 4 0 "IntlckLockgFailr_Ini" 1 "IntlckLockgFailr_ChkUnpl" 2 "IntlckLockgFailr_Err" 3 "IntlckLockgFailr_Lockd" /end COMPU_VTAB
/begin COMPU_METHOD ChrgSdl_stTiCalcn_VERB "" TAB_VERB "%6.3" "" COMPU_TAB_REF ChrgSdl_stTiCalcn_VERB /end COMPU_METHOD
/begin COMPU_VTAB ChrgSdl_stTiCalcn_VERB "" TAB_VERB 6 0 "CHRGSDL_TICALCN_IDLE" 1 "CHRGSDL_TICALCN_INI" 2 "CHRGSDL_TICALCN_PRE" 3 "CHRGSDL_TICALCN_CC" 4 "CHRGSDL_TICALCN_CV" 5 "CHRGSDL_TICALCN_CMPL" /end COMPU_VTAB
/begin COMPU_METHOD CoElM_SM_sm_VERB "" TAB_VERB "%6.3" "" COMPU_TAB_REF CoElM_SM_sm_VERB /end COMPU_METHOD
/begin COMPU_VTAB CoElM_SM_sm_VERB "" TAB_VERB 3 0 "Ini" 1 "Operation" 2 "Start_SM" /end COMPU_VTAB
/begin COMPU_METHOD COOLTTIN_TYPAVL_SC_Compu "" TAB_VERB "%6.3" "" COMPU_TAB_REF COOLTTIN_TYPAVL_SC_Compu /end COMPU_METHOD
/begin COMPU_VTAB COOLTTIN_TYPAVL_SC_Compu "" TAB_VERB 2 0 "False" 1 "True" /end COMPU_VTAB
/begin COMPU_METHOD COOLTTOUT_TYPAVL_SY_Compu "" TAB_VERB "%6.3" "" COMPU_TAB_REF COOLTTOUT_TYPAVL_SY_Compu /end COMPU_METHOD
/begin COMPU_VTAB COOLTTOUT_TYPAVL_SY_Compu "" TAB_VERB 2 0 "False" 1 "True" /end COMPU_VTAB
/begin COMPU_METHOD COOLTTRADROUT_TYPAVL_SC_Compu "" TAB_VERB "%6.3" "" COMPU_TAB_REF COOLTTRADROUT_TYPAVL_SC_Compu /end COMPU_METHOD
/begin COMPU_VTAB COOLTTRADROUT_TYPAVL_SC_Compu "" TAB_VERB 2 0 "False" 1 "True" /end COMPU_VTAB
/begin COMPU_METHOD COOPCLSTRCORE_SC_Compu "" TAB_VERB "%6.3" "" COMPU_TAB_REF COOPCLSTRCORE_SC_Compu /end COMPU_METHOD
/begin COMPU_VTAB COOPCLSTRCORE_SC_Compu "" TAB_VERB 10 0 "Core0" 1 "Core1" 2 "Core2" 3 "Core3" 4 "Core4" 5 "Core5" 6 "Core6" 7 "Core7" 8 "Core8" 9 "Core9" /end COMPU_VTAB
/begin COMPU_METHOD COOPRGNBRKACTV_SC_Compu "" TAB_VERB "%6.3" "" COMPU_TAB_REF COOPRGNBRKACTV_SC_Compu /end COMPU_METHOD
/begin COMPU_VTAB COOPRGNBRKACTV_SC_Compu "" TAB_VERB 2 0 "False" 1 "True" /end COMPU_VTAB
/begin COMPU_METHOD CppFacCylVol "" RAT_FUNC "%7.6" "-" COEFFS 0 32768 0 0 0 1 /end COMPU_METHOD
/begin COMPU_METHOD CppOfsFact "" RAT_FUNC "%6.4" "-" COEFFS 0 256 0 0 0 1 /end COMPU_METHOD
/begin COMPU_METHOD CPUDEVICE_SC_Compu "" TAB_VERB "%6.3" "" COMPU_TAB_REF CPUDEVICE_SC_Compu /end COMPU_METHOD
/begin COMPU_VTAB CPUDEVICE_SC_Compu "" TAB_VERB 10 0 "None" 1 "Device1" 2 "Device2" 3 "Device3" 4 "Device4" 5 "Device5" 13 "Device3+" 14 "Device4+" 15 "Device5+" 16 "Device5_28" /end COMPU_VTAB
/begin COMPU_METHOD CPUVENDOR_SC_Compu "" TAB_VERB "%6.3" "" COMPU_TAB_REF CPUVENDOR_SC_Compu /end COMPU_METHOD
/begin COMPU_VTAB CPUVENDOR_SC_Compu "" TAB_VERB 4 0 "None" 1 "IFX" 2 "JDP" 3 "ST" /end COMPU_VTAB
/begin COMPU_METHOD CRCSP_TYPAVL_SC_Compu "" TAB_VERB "%6.3" "" COMPU_TAB_REF CRCSP_TYPAVL_SC_Compu /end COMPU_METHOD
/begin COMPU_VTAB CRCSP_TYPAVL_SC_Compu "" TAB_VERB 2 0 "False" 1 "True" /end COMPU_VTAB
/begin COMPU_METHOD CRCTL_SY_Compu "" TAB_VERB "%6.3" "" COMPU_TAB_REF CRCTL_SY_Compu /end COMPU_METHOD
/begin COMPU_VTAB CRCTL_SY_Compu "" TAB_VERB 2 0 "FALSE" 1 "TRUE" /end COMPU_VTAB
/begin COMPU_METHOD CRKCSPABSLT_TYPAVL_SY_Compu "" TAB_VERB "%6.3" "" COMPU_TAB_REF CRKCSPABSLT_TYPAVL_SY_Compu /end COMPU_METHOD
/begin COMPU_VTAB CRKCSPABSLT_TYPAVL_SY_Compu "" TAB_VERB 2 0 "False" 1 "True" /end COMPU_VTAB
/begin COMPU_METHOD CSSWTIFTYP_SC_Compu "" TAB_VERB "%6.3" "" COMPU_TAB_REF CSSWTIFTYP_SC_Compu /end COMPU_METHOD
/begin COMPU_VTAB CSSWTIFTYP_SC_Compu "" TAB_VERB 7 0 "CSSWTIFTYP_NON" 1 "CSSWTIFTYP_DIG" 2 "CSSWTIFTYP_ADC" 3 "CSSWTIFTYP_MISC" 4 "CSSWTIFTYP_BUS" 5 "CSSWTIFTYP_BUS_DIG" 6 "CSSWTIFTYP_BUS_ADC" /end COMPU_VTAB
/begin COMPU_METHOD CTEGRCLRDS_TYPAVL_SC_Compu "" TAB_VERB "%6.3" "" COMPU_TAB_REF CTEGRCLRDS_TYPAVL_SC_Compu /end COMPU_METHOD
/begin COMPU_VTAB CTEGRCLRDS_TYPAVL_SC_Compu "" TAB_VERB 2 0 "False" 1 "True" /end COMPU_VTAB
/begin COMPU_METHOD CTEGRCLRLPUS_TYPAVL_SC_Compu "" TAB_VERB "%6.3" "" COMPU_TAB_REF CTEGRCLRLPUS_TYPAVL_SC_Compu /end COMPU_METHOD
/begin COMPU_VTAB CTEGRCLRLPUS_TYPAVL_SC_Compu "" TAB_VERB 2 0 "False" 1 "True" /end COMPU_VTAB
/begin COMPU_METHOD CTEGRCLRUS_TYPAVL_SY_Compu "" TAB_VERB "%6.3" "" COMPU_TAB_REF CTEGRCLRUS_TYPAVL_SY_Compu /end COMPU_METHOD
/begin COMPU_VTAB CTEGRCLRUS_TYPAVL_SY_Compu "" TAB_VERB 2 0 "0" 1 "1" /end COMPU_VTAB
/begin COMPU_METHOD CTEVCHRGRDS_TYPAVL_SY_Compu "" TAB_VERB "%6.3" "" COMPU_TAB_REF CTEVCHRGRDS_TYPAVL_SY_Compu /end COMPU_METHOD
/begin COMPU_VTAB CTEVCHRGRDS_TYPAVL_SY_Compu "" TAB_VERB 2 0 "False" 1 "True" /end COMPU_VTAB
/begin COMPU_METHOD CTEVEMDS_TYPAVL_SY_Compu "" TAB_VERB "%6.3" "" COMPU_TAB_REF CTEVEMDS_TYPAVL_SY_Compu /end COMPU_METHOD
/begin COMPU_VTAB CTEVEMDS_TYPAVL_SY_Compu "" TAB_VERB 2 0 "False" 1 "True" /end COMPU_VTAB
/begin COMPU_METHOD CTEVHTRDS_TYPAVL_SC_Compu "" TAB_VERB "%6.3" "" COMPU_TAB_REF CTEVHTRDS_TYPAVL_SC_Compu /end COMPU_METHOD
/begin COMPU_VTAB CTEVHTRDS_TYPAVL_SC_Compu "" TAB_VERB 2 0 "False" 1 "True" /end COMPU_VTAB
/begin COMPU_METHOD CTEVHTREXCHGDS_TYPAVL_SC_Compu "" TAB_VERB "%6.3" "" COMPU_TAB_REF CTEVHTREXCHGDS_TYPAVL_SC_Compu /end COMPU_METHOD
/begin COMPU_VTAB CTEVHTREXCHGDS_TYPAVL_SC_Compu "" TAB_VERB 2 0 "False" 1 "True" /end COMPU_VTAB
/begin COMPU_METHOD CTEVHTRUS_TYPAVL_SC_Compu "" TAB_VERB "%6.3" "" COMPU_TAB_REF CTEVHTRUS_TYPAVL_SC_Compu /end COMPU_METHOD
/begin COMPU_VTAB CTEVHTRUS_TYPAVL_SC_Compu "" TAB_VERB 2 0 "False" 1 "True" /end COMPU_VTAB
/begin COMPU_METHOD CTEVINVRUS_TYPAVL_SY_Compu "" TAB_VERB "%6.3" "" COMPU_TAB_REF CTEVINVRUS_TYPAVL_SY_Compu /end COMPU_METHOD
/begin COMPU_VTAB CTEVINVRUS_TYPAVL_SY_Compu "" TAB_VERB 2 0 "False" 1 "True" /end COMPU_VTAB
/begin COMPU_METHOD CTEVLEDS_TYPAVL_SY_Compu "" TAB_VERB "%6.3" "" COMPU_TAB_REF CTEVLEDS_TYPAVL_SY_Compu /end COMPU_METHOD
/begin COMPU_VTAB CTEVLEDS_TYPAVL_SY_Compu "" TAB_VERB 2 0 "False" 1 "True" /end COMPU_VTAB
/begin COMPU_METHOD CTPFRQ_TYPAVL_SC_Compu "" TAB_VERB "%6.3" "" COMPU_TAB_REF CTPFRQ_TYPAVL_SC_Compu /end COMPU_METHOD
/begin COMPU_VTAB CTPFRQ_TYPAVL_SC_Compu "" TAB_VERB 2 0 "FALSE" 1 "TRUE" /end COMPU_VTAB
/begin COMPU_METHOD CTPSWTACTR_TYPAVL_SC_Compu "" TAB_VERB "%6.3" "" COMPU_TAB_REF CTPSWTACTR_TYPAVL_SC_Compu /end COMPU_METHOD
/begin COMPU_VTAB CTPSWTACTR_TYPAVL_SC_Compu "" TAB_VERB 2 0 "False" 1 "True" /end COMPU_VTAB
/begin COMPU_METHOD CTPSWTDIAG_TYPAVL_SC_Compu "" TAB_VERB "%6.3" "" COMPU_TAB_REF CTPSWTDIAG_TYPAVL_SC_Compu /end COMPU_METHOD
/begin COMPU_VTAB CTPSWTDIAG_TYPAVL_SC_Compu "" TAB_VERB 2 0 "False" 1 "True" /end COMPU_VTAB
/begin COMPU_METHOD CubMtrPerHr "" RAT_FUNC "%6.3" "m^3/h" COEFFS 0 10 0 0 0 1 /end COMPU_METHOD
/begin COMPU_METHOD Curr "" RAT_FUNC "%6.2" "mA" COEFFS 0 1 0 0 0 1 /end COMPU_METHOD
/begin COMPU_METHOD CY326_SC_Compu "" TAB_VERB "%6.3" "" COMPU_TAB_REF CY326_SC_Compu /end COMPU_METHOD
/begin COMPU_VTAB CY326_SC_Compu "" TAB_VERB 3 0 "No CY326" 1 "One CY326" 2 "Two CY326" /end COMPU_VTAB
/begin COMPU_METHOD CY327_SY_Compu "" TAB_VERB "%6.3" "" COMPU_TAB_REF CY327_SY_Compu /end COMPU_METHOD
/begin COMPU_VTAB CY327_SY_Compu "" TAB_VERB 3 0 "No CY327" 1 "One CY327" 2 "Two CY327" /end COMPU_VTAB
/begin COMPU_METHOD CY329_SC_Compu "" TAB_VERB "%6.3" "" COMPU_TAB_REF CY329_SC_Compu /end COMPU_METHOD
/begin COMPU_VTAB CY329_SC_Compu "" TAB_VERB 4 0 "No CY329" 1 "One CY329" 2 "Two CY329" 3 "Three CY329" /end COMPU_VTAB
/begin COMPU_METHOD CylHtRls "" RAT_FUNC "%6.3" "J" COEFFS 0 4 0 0 0 1 /end COMPU_METHOD
/begin COMPU_METHOD CylHtRlsRate "" RAT_FUNC "%6.4" "J/AgCA" COEFFS 0 64 0 0 0 1 /end COMPU_METHOD
/begin COMPU_METHOD CylinderVolumeCpp "" RAT_FUNC "%9.8" "m^3" COEFFS 0 1000000 0 0 0 1 /end COMPU_METHOD
/begin COMPU_METHOD CylK1 "" RAT_FUNC "%6.4" "10^-5m^3/AgCA" COEFFS 0 128 0 0 0 1 /end COMPU_METHOD
/begin COMPU_METHOD CylK2 "" RAT_FUNC "%7.6" "-" COEFFS 0 16384 0 0 0 1 /end COMPU_METHOD
/begin COMPU_METHOD CylPres "" RAT_FUNC "%6.4" "bar" COEFFS 0 128 0 0 0 1 /end COMPU_METHOD
/begin COMPU_METHOD CYL_MAX_Compu "" RAT_FUNC "%6.2" "" COEFFS 0 1 0 0 0 1 /end COMPU_METHOD
/begin COMPU_METHOD DCCHRGNRLYNEGPOSN_TYPAVL_SC_Compu "" TAB_VERB "%6.3" "" COMPU_TAB_REF DCCHRGNRLYNEGPOSN_TYPAVL_SC_Compu /end COMPU_METHOD
/begin COMPU_VTAB DCCHRGNRLYNEGPOSN_TYPAVL_SC_Compu "" TAB_VERB 2 0 "False" 1 "True" /end COMPU_VTAB
/begin COMPU_METHOD DCCHRGNRLYNEG_TYPAVL_SC_Compu "" TAB_VERB "%6.3" "" COMPU_TAB_REF DCCHRGNRLYNEG_TYPAVL_SC_Compu /end COMPU_METHOD
/begin COMPU_VTAB DCCHRGNRLYNEG_TYPAVL_SC_Compu "" TAB_VERB 2 0 "FALSE" 1 "TRUE" /end COMPU_VTAB
/begin COMPU_METHOD DCCHRGNRLYPOSPOSN_TYPAVL_SC_Compu "" TAB_VERB "%6.3" "" COMPU_TAB_REF DCCHRGNRLYPOSPOSN_TYPAVL_SC_Compu /end COMPU_METHOD
/begin COMPU_VTAB DCCHRGNRLYPOSPOSN_TYPAVL_SC_Compu "" TAB_VERB 2 0 "False" 1 "True" /end COMPU_VTAB
/begin COMPU_METHOD DCCHRGNRLYPOS_TYPAVL_SC_Compu "" TAB_VERB "%6.3" "" COMPU_TAB_REF DCCHRGNRLYPOS_TYPAVL_SC_Compu /end COMPU_METHOD
/begin COMPU_VTAB DCCHRGNRLYPOS_TYPAVL_SC_Compu "" TAB_VERB 2 0 "FALSE" 1 "TRUE" /end COMPU_VTAB
/begin COMPU_METHOD DCCHRGNRLY_TYPAVL_SC_Compu "" TAB_VERB "%6.3" "" COMPU_TAB_REF DCCHRGNRLY_TYPAVL_SC_Compu /end COMPU_METHOD
/begin COMPU_VTAB DCCHRGNRLY_TYPAVL_SC_Compu "" TAB_VERB 2 0 "DCRLY_HW_NOTAVL" 1 "DCRLY_HW_AVL" /end COMPU_VTAB
/begin COMPU_METHOD DCCHRGRINTKT2_TYPAVL_SC_Compu "" TAB_VERB "%6.3" "" COMPU_TAB_REF DCCHRGRINTKT2_TYPAVL_SC_Compu /end COMPU_METHOD
/begin COMPU_VTAB DCCHRGRINTKT2_TYPAVL_SC_Compu "" TAB_VERB 2 0 "False" 1 "True" /end COMPU_VTAB
/begin COMPU_METHOD DDRCTime_ms "" RAT_FUNC "%6.1" "ms" COEFFS 0 1 0 0 0 10 /end COMPU_METHOD
/begin COMPU_METHOD DDRC_Ratio "" TAB_VERB "%6.3" "-" COMPU_TAB_REF DDRC_Ratio /end COMPU_METHOD
/begin COMPU_VTAB DDRC_Ratio "" TAB_VERB 4 1 "Ratio1" 2 "Ratio2" 3 "Ratio3" 4 "Ratio4" /end COMPU_VTAB
/begin COMPU_METHOD DFC_OneToOne "" RAT_FUNC "%6.2" "-" COEFFS 0 1 0 0 0 1 /end COMPU_METHOD
/begin COMPU_METHOD DFES_OneToOne "" RAT_FUNC "%6.2" "-" COEFFS 0 1 0 0 0 1 /end COMPU_METHOD
/begin COMPU_METHOD DINH_ct_Compu "" RAT_FUNC "%6.0" "" COEFFS 0 -1 4096 0 0 1 /end COMPU_METHOD
/begin COMPU_METHOD nmot_q1 "" RAT_FUNC "%6.2" "1/min" COEFFS 0 1 0 0 0 1 /end COMPU_METHOD
/begin COMPU_METHOD OffCal_StM_sm_VERB "" TAB_VERB "%6.3" "" COMPU_TAB_REF OffCal_StM_sm_VERB /end COMPU_METHOD
/begin COMPU_VTAB OffCal_StM_sm_VERB "" TAB_VERB 5 0 "A_Init" 1 "A_calibration" 2 "A_failure" 3 "A_ready_for_calibration" 4 "A_success" /end COMPU_VTAB
/begin COMPU_METHOD OneToOne "" RAT_FUNC "%6.2" "-" COEFFS 0 1 0 0 0 1 /end COMPU_METHOD
/begin COMPU_METHOD Prc "" RAT_FUNC "%6.4" "%" COEFFS 0 81.92 0 0 0 1 /end COMPU_METHOD
/begin COMPU_METHOD q1 "" RAT_FUNC "%6.2" "-" COEFFS 0 1 0 0 0 1 /end COMPU_METHOD
/begin COMPU_METHOD RBPtCel_di_0p1_1 "" RAT_FUNC "%6.3" "A/s" COEFFS 0 10 0 0 0 1 /end COMPU_METHOD
/begin COMPU_METHOD RBPtCel_fac_0p01_1 "" RAT_FUNC "%6.4" "-" COEFFS 0 100 0 0 0 1 /end COMPU_METHOD
/begin COMPU_METHOD RBPtCel_i_0p03125_1 "" RAT_FUNC "%6.4" "A" COEFFS 0 32 0 0 0 1 /end COMPU_METHOD
/begin COMPU_METHOD RBPtCel_i_0p1_1 "" RAT_FUNC "%6.3" "A" COEFFS 0 10 0 0 0 1 /end COMPU_METHOD
/begin COMPU_METHOD RBPtCel_Perc_0p01_1 "" RAT_FUNC "%6.4" "%" COEFFS 0 100 0 0 0 1 /end COMPU_METHOD
/begin COMPU_METHOD RBPtCel_pwr_25p0_1 "" RAT_FUNC "%6.1" "W" COEFFS 0 1 0 0 0 25 /end COMPU_METHOD
/begin COMPU_METHOD RBPtCel_q_0p125_1 "" RAT_FUNC "%6.3" "Ah" COEFFS 0 8 0 0 0 1 /end COMPU_METHOD
/begin COMPU_METHOD RBPtCel_ti_0p001_2 "" RAT_FUNC "%6.5" "s" COEFFS 0 1000 0 0 0 1 /end COMPU_METHOD
/begin COMPU_METHOD RBPtCel_ti_0p01_1 "" RAT_FUNC "%6.4" "s" COEFFS 0 100 0 0 0 1 /end COMPU_METHOD
/begin COMPU_METHOD RBPtCel_ti_0p1_1 "" RAT_FUNC "%6.3" "s" COEFFS 0 10 0 0 0 1 /end COMPU_METHOD
/begin COMPU_METHOD RBPtCel_ti_1p0_2 "" RAT_FUNC "%6.2" "s" COEFFS 0 1 0 0 0 1 /end COMPU_METHOD
/begin COMPU_METHOD RBPtCel_t_0p1_3 "" RAT_FUNC "%6.3" "Deg C" COEFFS 0 10 0 0 0 1 /end COMPU_METHOD
/begin COMPU_METHOD RBPtCel_u_0p001_1 "" RAT_FUNC "%6.5" "V" COEFFS 0 1000 0 0 0 1 /end COMPU_METHOD
/begin COMPU_METHOD RBPtCel_u_0p01_1 "" RAT_FUNC "%6.4" "V" COEFFS 0 100 0 0 0 1 /end COMPU_METHOD
/begin COMPU_METHOD RBPtCel_u_0p1_1 "" RAT_FUNC "%6.3" "V" COEFFS 0 10 0 0 0 1 /end COMPU_METHOD
/begin COMPU_METHOD RBPtEChrDv_stCtP_VERB "" TAB_VERB "%6.3" "" COMPU_TAB_REF RBPtEChrDv_stCtP_VERB /end COMPU_METHOD
/begin COMPU_VTAB RBPtEChrDv_stCtP_VERB "" TAB_VERB 10 0 "ERROR" 1 "IMPLAUSIBLE" 2 "B1" 3 "B2" 4 "C1" 5 "C2" 6 "D1" 7 "D2" 8 "X1" 9 "X2" /end COMPU_VTAB
/begin COMPU_METHOD RBPtEChrDv_stPlgLock_VERB "" TAB_VERB "%6.3" "" COMPU_TAB_REF RBPtEChrDv_stPlgLock_VERB /end COMPU_METHOD
/begin COMPU_VTAB RBPtEChrDv_stPlgLock_VERB "" TAB_VERB 5 0 "OPEN" 1 "PENDING" 2 "CLOSED" 3 "CLOSED_LIMIT" 9 "ERROR" /end COMPU_VTAB
/begin COMPU_METHOD RBPtEChrDv_stPxP_VERB "" TAB_VERB "%6.3" "" COMPU_TAB_REF RBPtEChrDv_stPxP_VERB /end COMPU_METHOD
/begin COMPU_VTAB RBPtEChrDv_stPxP_VERB "" TAB_VERB 5 0 "UNPLUGGED" 1 "PLUGGED" 3 "S3_PRESSED" 4 "ERROR" 5 "INI" /end COMPU_VTAB
/begin COMPU_METHOD RBPtEChrDv_stTPin_VERB "" TAB_VERB "%6.3" "" COMPU_TAB_REF RBPtEChrDv_stTPin_VERB /end COMPU_METHOD
/begin COMPU_VTAB RBPtEChrDv_stTPin_VERB "" TAB_VERB 4 0 "INI" 1 "VALID" 2 "ERROR" 3 "IMPLAUSIBLE" /end COMPU_VTAB
/begin COMPU_METHOD RBPtElTrac_stEmOperMod_VERB "" TAB_VERB "%6.3" "" COMPU_TAB_REF RBPtElTrac_stEmOperMod_VERB /end COMPU_METHOD
/begin COMPU_VTAB RBPtElTrac_stEmOperMod_VERB "" TAB_VERB 19 0 "INI" 1 "PRERUN" 2 "STANDBY" 3 "ENG_STRT" 4 "TORQUE_CTRL" 5 "SPEED_CTRL" 6 "OFFSET_CALIB" 7 "U_CTRL" 8 "I_CTRL" 9 "IDLE_CTRL" 10 "ISO_MON" 15 "HILLHOLD" 20 "FREEWHL" 21 "ACTV_SC" 27 "DISCHARGE" 28 "SHUTDOWN" 29 "OFF" 30 "EMGY_SHTDWN" 31 "FAILURE" /end COMPU_VTAB
/begin COMPU_METHOD SigQly_COMPU_VERB "" TAB_VERB "%6.3" "" COMPU_TAB_REF SigQly_COMPU_VERB /end COMPU_METHOD
/begin COMPU_VTAB SigQly_COMPU_VERB "" TAB_VERB 16 0 "SIGQLY_NOTCALC" 1 "SIGQLY_INIT" 2 "SIGQLY_OK" 3 "SIGQLY_MODEL" 4 "SIGQLY_REPLACEMENT" 5 "SIGQLY_FROZEN" 6 "SIGQLY_INVALID" 7 "SIGQLY_RESERVED_7" 8 "SIGQLY_RESERVED_8" 9 "SIGQLY_RESERVED_9" 10 "SIGQLY_RESERVED_10" 11 "SIGQLY_RESERVED_11" 12 "SIGQLY_RESERVED_12" 13 "SIGQLY_RESERVED_13" 14 "SIGQLY_RESERVED_14" 15 "SIGQLY_RESERVED_15" /end COMPU_VTAB
/begin COMPU_METHOD SrvB_SWTmrS16 "" RAT_FUNC "%6.2" "-" COEFFS 0 1 0 0 0 1 /end COMPU_METHOD
/begin COMPU_METHOD TimeDelay_s "" RAT_FUNC "%6.1" "s" COEFFS 0 0 1 0 0.00023283064365387 0 /end COMPU_METHOD
/begin COMPU_METHOD Time_Dt "" RAT_FUNC "%9.8" "s" COEFFS 0 1000000 0 0 0 1 /end COMPU_METHOD
/begin COMPU_METHOD Time_ms "" RAT_FUNC "%6.1" "ms" COEFFS 0 0.1 0 0 0 1 /end COMPU_METHOD
/begin COMPU_METHOD Time_s "" RAT_FUNC "%6.4" "s" COEFFS 0 100 0 0 0 1 /end COMPU_METHOD
/begin COMPU_METHOD Trq "" RAT_FUNC "%6.3" "Nm" COEFFS 0 10 0 0 0 1 /end COMPU_METHOD
/begin COMPU_METHOD t_q0p005 "" RAT_FUNC "%6.4" "s" COEFFS 0 1000 0 0 0 5 /end COMPU_METHOD
/begin RECORD_LAYOUT RB_Curve_S16_S16 NO_AXIS_PTS_X 1 SWORD AXIS_PTS_X 2 SWORD INDEX_INCR DIRECT FNC_VALUES 3 SWORD COLUMN_DIR DIRECT /end RECORD_LAYOUT
/begin RECORD_LAYOUT RB_Curve_S16_S8_sao NO_AXIS_PTS_X 1 SWORD AXIS_PTS_X 2 SWORD INDEX_INCR DIRECT FNC_VALUES 3 SBYTE COLUMN_DIR DIRECT STATIC_ADDRESS_OFFSETS /end RECORD_LAYOUT
/begin RECORD_LAYOUT RB_Curve_S16_U8_sao NO_AXIS_PTS_X 1 SWORD AXIS_PTS_X 2 SWORD INDEX_INCR DIRECT FNC_VALUES 3 UBYTE COLUMN_DIR DIRECT STATIC_ADDRESS_OFFSETS /end RECORD_LAYOUT
/begin RECORD_LAYOUT RB_Curve_U8_U8 NO_AXIS_PTS_X 1 UBYTE AXIS_PTS_X 2 UBYTE INDEX_INCR DIRECT FNC_VALUES 3 UBYTE COLUMN_DIR DIRECT /end RECORD_LAYOUT
/begin RECORD_LAYOUT RB_Map_S16S16_S16 NO_AXIS_PTS_X 1 SWORD NO_AXIS_PTS_Y 2 SWORD AXIS_PTS_X 3 SWORD INDEX_INCR DIRECT AXIS_PTS_Y 4 SWORD INDEX_INCR DIRECT FNC_VALUES 5 SWORD COLUMN_DIR DIRECT /end RECORD_LAYOUT
/begin RECORD_LAYOUT RB_Map_S16S16_S32_sao NO_AXIS_PTS_X 1 SWORD NO_AXIS_PTS_Y 2 SWORD AXIS_PTS_X 3 SWORD INDEX_INCR DIRECT AXIS_PTS_Y 4 SWORD INDEX_INCR DIRECT FNC_VALUES 5 SLONG COLUMN_DIR DIRECT STATIC_ADDRESS_OFFSETS /end RECORD_LAYOUT
/begin RECORD_LAYOUT RB_Map_U8U8_U8 NO_AXIS_PTS_X 1 UBYTE NO_AXIS_PTS_Y 2 UBYTE AXIS_PTS_X 3 UBYTE INDEX_INCR DIRECT AXIS_PTS_Y 4 UBYTE INDEX_INCR DIRECT FNC_VALUES 5 UBYTE COLUMN_DIR DIRECT /end RECORD_LAYOUT
/begin RECORD_LAYOUT RB_Val_Wboolean FNC_VALUES 1 UBYTE COLUMN_DIR DIRECT /end RECORD_LAYOUT
/begin RECORD_LAYOUT RB_Val_Ws16 FNC_VALUES 1 SWORD COLUMN_DIR DIRECT /end RECORD_LAYOUT
/begin RECORD_LAYOUT RB_Val_Ws32 FNC_VALUES 1 SLONG COLUMN_DIR DIRECT /end RECORD_LAYOUT
/begin RECORD_LAYOUT RB_Val_Ws8 FNC_VALUES 1 SBYTE COLUMN_DIR DIRECT /end RECORD_LAYOUT
/begin RECORD_LAYOUT RB_Val_Wu16 FNC_VALUES 1 UWORD COLUMN_DIR DIRECT /end RECORD_LAYOUT
/begin RECORD_LAYOUT RB_Val_Wu32 FNC_VALUES 1 ULONG COLUMN_DIR DIRECT /end RECORD_LAYOUT
/begin RECORD_LAYOUT RB_Val_Wu8 FNC_VALUES 1 UBYTE COLUMN_DIR DIRECT /end RECORD_LAYOUT
/begin RECORD_LAYOUT Val_Ws16 FNC_VALUES 1 SWORD COLUMN_DIR DIRECT /end RECORD_LAYOUT
/begin RECORD_LAYOUT Val_Ws32 FNC_VALUES 1 SLONG COLUMN_DIR DIRECT /end RECORD_LAYOUT
/begin RECORD_LAYOUT Val_Wu16 FNC_VALUES 1 UWORD COLUMN_DIR DIRECT /end RECORD_LAYOUT
/begin RECORD_LAYOUT Val_Wu8 FNC_VALUES 1 UBYTE COLUMN_DIR DIRECT /end RECORD_LAYOUT
/end MODULE
/end PROJECT

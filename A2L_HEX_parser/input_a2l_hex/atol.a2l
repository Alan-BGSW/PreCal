ASAP2_VERSION 1 70
/begin PROJECT MDG1C "VC1CP091_STLA_N_D061I3"
/begin HEADER "" VERSION "VC1CP091_STLA_N_D061I3" PROJECT_NO MDG1C /end HEADER
/begin MODULE DIM ""
/begin MOD_COMMON "" BYTE_ORDER MSB_LAST ALIGNMENT_BYTE 1 ALIGNMENT_WORD 2 ALIGNMENT_LONG 4 ALIGNMENT_INT64 4 ALIGNMENT_FLOAT32_IEEE 4 ALIGNMENT_FLOAT64_IEEE 4 DATA_SIZE 32 /end MOD_COMMON
/begin CHARACTERISTIC DDRC_DurDeb.DrvStblt_tiOpnDebOk_C "" VALUE 0x80240CF0 Val_Wu16 655350.0 DDRCTime_ms 0.00 655350.0 FORMAT "%8.1" /end CHARACTERISTIC
/begin CHARACTERISTIC DDRC_DurDeb.DrvStblt_tiOpnDebDef_C "" VALUE 0x80240CF2 Val_Wu16 655350.0 DDRCTime_ms 0.00 655350.0 FORMAT "%8.1" /end CHARACTERISTIC
/begin CHARACTERISTIC DDRC_DurDeb.Ebs_tiEbsSnsrStDebOk_C "" VALUE 0x80240CF4 Val_Wu16 655350.0 DDRCTime_ms 0.00 655350.0 FORMAT "%8.1" /end CHARACTERISTIC
/begin CHARACTERISTIC DDRC_DurDeb.Ebs_tiEbsSnsrStDebDef_C "" VALUE 0x80240CF6 Val_Wu16 655350.0 DDRCTime_ms 0.00 655350.0 FORMAT "%8.1" /end CHARACTERISTIC
/begin CHARACTERISTIC DDRC_DurDeb.Ebs_tiLvBattSocDiagLoDebOk_C "" VALUE 0x80240CF8 Val_Wu16 655350.0 DDRCTime_ms 0.00 655350.0 FORMAT "%8.1" /end CHARACTERISTIC
/begin CHARACTERISTIC DDRC_DurDeb.Ebs_tiLvBattSocDiagLoDebDef_C "" VALUE 0x80240CFA Val_Wu16 655350.0 DDRCTime_ms 0.00 655350.0 FORMAT "%8.1" /end CHARACTERISTIC
/begin CHARACTERISTIC DDRC_DurDeb.Ebs_tiLvBattUDiagFltLvl1DebOk_C "" VALUE 0x80240CFC Val_Wu16 655350.0 DDRCTime_ms 0.00 655350.0 FORMAT "%8.1" /end CHARACTERISTIC
/begin CHARACTERISTIC DDRC_DurDeb.Ebs_tiLvBattUDiagFltLvl1DebDef_C "" VALUE 0x80240CFE Val_Wu16 655350.0 DDRCTime_ms 0.00 655350.0 FORMAT "%8.1" /end CHARACTERISTIC
/begin CHARACTERISTIC DDRC_DurDeb.Ebs_tiLvBattUDiagFltLvl2DebOk_C "" VALUE 0x80240D00 Val_Wu16 655350.0 DDRCTime_ms 0.00 655350.0 FORMAT "%8.1" /end CHARACTERISTIC
/begin CHARACTERISTIC DDRC_DurDeb.Ebs_tiLvBattUDiagFltLvl2DebDef_C "" VALUE 0x80240D02 Val_Wu16 655350.0 DDRCTime_ms 0.00 655350.0 FORMAT "%8.1" /end CHARACTERISTIC
/begin CHARACTERISTIC DDRC_DurDeb.Ebs_tiLvBattUDiagLoDebOk_C "" VALUE 0x80240D04 Val_Wu16 655350.0 DDRCTime_ms 0.00 655350.0 FORMAT "%8.1" /end CHARACTERISTIC
/begin CHARACTERISTIC DDRC_DurDeb.Ebs_tiLvBattUDiagLoDebDef_C "" VALUE 0x80240D06 Val_Wu16 655350.0 DDRCTime_ms 0.00 655350.0 FORMAT "%8.1" /end CHARACTERISTIC
/begin CHARACTERISTIC DDRC_DurDeb.Ebs_tiLvBusUDiagDiOperDebOk_C "" VALUE 0x80240D08 Val_Wu16 655350.0 DDRCTime_ms 0.00 655350.0 FORMAT "%8.1" /end CHARACTERISTIC
/begin CHARACTERISTIC DDRC_DurDeb.Ebs_tiLvBusUDiagDiOperDebDef_C "" VALUE 0x80240D0A Val_Wu16 655350.0 DDRCTime_ms 0.00 655350.0 FORMAT "%8.1" /end CHARACTERISTIC
/begin CHARACTERISTIC DDRC_DurDeb.Ebs_tiSofASILErrDebOk_C "" VALUE 0x80240D0C Val_Wu16 655350.0 DDRCTime_ms 0.00 655350.0 FORMAT "%8.1" /end CHARACTERISTIC
/begin CHARACTERISTIC DDRC_DurDeb.Ebs_tiSofASILErrDebDef_C "" VALUE 0x80240D0E Val_Wu16 655350.0 DDRCTime_ms 0.00 655350.0 FORMAT "%8.1" /end CHARACTERISTIC
/begin CHARACTERISTIC DDRC_DurDeb.ElM_tiActvDchaFailrDebOk_C "" VALUE 0x8024129C Val_Wu16 655350.0 DDRCTime_ms 0.00 655350.0 FORMAT "%8.1" /end CHARACTERISTIC
/begin CHARACTERISTIC DDRC_DurDeb.ElM_tiActvDchaFailrDebDef_C "" VALUE 0x8024129E Val_Wu16 655350.0 DDRCTime_ms 0.00 655350.0 FORMAT "%8.1" /end CHARACTERISTIC
/begin CHARACTERISTIC DDRC_DurDeb.ElM_tiFbdnInvtrModDrv01DebOk_C "" VALUE 0x802412A4 Val_Wu16 655350.0 DDRCTime_ms 0.00 655350.0 FORMAT "%8.1" /end CHARACTERISTIC
/begin CHARACTERISTIC DDRC_DurDeb.ElM_tiFbdnInvtrModDrv01DebDef_C "" VALUE 0x802412A6 Val_Wu16 655350.0 DDRCTime_ms 0.00 655350.0 FORMAT "%8.1" /end CHARACTERISTIC
/begin CHARACTERISTIC DDRC_DurDeb.ElM_tiIsoMonPlausyFltDebOk_C "" VALUE 0x802412B0 Val_Wu16 655350.0 DDRCTime_ms 0.00 655350.0 FORMAT "%8.1" /end CHARACTERISTIC
/begin CHARACTERISTIC DDRC_DurDeb.ElM_tiIsoMonPlausyFltDebDef_C "" VALUE 0x802412B2 Val_Wu16 655350.0 DDRCTime_ms 0.00 655350.0 FORMAT "%8.1" /end CHARACTERISTIC
/begin CHARACTERISTIC DDRC_DurDeb.ElM_tiOverSpdNeg01DebOk_C "" VALUE 0x802412C8 Val_Wu16 655350.0 DDRCTime_ms 0.00 655350.0 FORMAT "%8.1" /end CHARACTERISTIC
/begin CHARACTERISTIC DDRC_DurDeb.ElM_tiOverSpdNeg01DebDef_C "" VALUE 0x802412CA Val_Wu16 655350.0 DDRCTime_ms 0.00 655350.0 FORMAT "%8.1" /end CHARACTERISTIC
/begin CHARACTERISTIC DDRC_DurDeb.ElM_tiOverSpdPos01DebOk_C "" VALUE 0x802412CC Val_Wu16 655350.0 DDRCTime_ms 0.00 655350.0 FORMAT "%8.1" /end CHARACTERISTIC
/begin CHARACTERISTIC DDRC_DurDeb.ElM_tiOverSpdPos01DebDef_C "" VALUE 0x802412CE Val_Wu16 655350.0 DDRCTime_ms 0.00 655350.0 FORMAT "%8.1" /end CHARACTERISTIC
/begin CHARACTERISTIC DDRC_DurDeb.ElM_tiOverTqNeg01DebOk_C "" VALUE 0x802412D0 Val_Wu16 655350.0 DDRCTime_ms 0.00 655350.0 FORMAT "%8.1" /end CHARACTERISTIC
/begin CHARACTERISTIC DDRC_DurDeb.ElM_tiOverTqNeg01DebDef_C "" VALUE 0x802412D2 Val_Wu16 655350.0 DDRCTime_ms 0.00 655350.0 FORMAT "%8.1" /end CHARACTERISTIC
/begin CHARACTERISTIC DDRC_DurDeb.ElM_tiOverTqPos01DebOk_C "" VALUE 0x802412D4 Val_Wu16 655350.0 DDRCTime_ms 0.00 655350.0 FORMAT "%8.1" /end CHARACTERISTIC
/begin CHARACTERISTIC DDRC_DurDeb.ElM_tiOverTqPos01DebDef_C "" VALUE 0x802412D6 Val_Wu16 655350.0 DDRCTime_ms 0.00 655350.0 FORMAT "%8.1" /end CHARACTERISTIC
/begin CHARACTERISTIC DFC_CtlMsk2.DFC_DrvStbltOpn_C "" VALUE 0x80241360 Val_Wu8 255.0 DFES_OneToOne 0.00 255.0 FORMAT "%5.1" /end CHARACTERISTIC
/begin CHARACTERISTIC DFC_CtlMsk2.DFC_EbsLvBattSocDiagLo_C "" VALUE 0x80241363 Val_Wu8 255.0 DFES_OneToOne 0.00 255.0 FORMAT "%5.1" /end CHARACTERISTIC
/begin CHARACTERISTIC DFC_CtlMsk2.DFC_EbsLvBattUDiagDiOper_C "" VALUE 0x80241364 Val_Wu8 255.0 DFES_OneToOne 0.00 255.0 FORMAT "%5.1" /end CHARACTERISTIC
/begin CHARACTERISTIC DFC_CtlMsk2.DFC_EbsLvBattUDiagFltLvl1_C "" VALUE 0x80241365 Val_Wu8 255.0 DFES_OneToOne 0.00 255.0 FORMAT "%5.1" /end CHARACTERISTIC
/begin CHARACTERISTIC DFC_CtlMsk2.DFC_EbsLvBattUDiagFltLvl2_C "" VALUE 0x80241366 Val_Wu8 255.0 DFES_OneToOne 0.00 255.0 FORMAT "%5.1" /end CHARACTERISTIC
/begin CHARACTERISTIC DFC_CtlMsk2.DFC_EbsLvBattUDiagLo_C "" VALUE 0x80241367 Val_Wu8 255.0 DFES_OneToOne 0.00 255.0 FORMAT "%5.1" /end CHARACTERISTIC
/begin CHARACTERISTIC DFC_CtlMsk2.DFC_EbsSnsrSt_C "" VALUE 0x80241368 Val_Wu8 255.0 DFES_OneToOne 0.00 255.0 FORMAT "%5.1" /end CHARACTERISTIC
/begin CHARACTERISTIC DFC_CtlMsk2.DFC_EbsSofASILErr_C "" VALUE 0x80241369 Val_Wu8 255.0 DFES_OneToOne 0.00 255.0 FORMAT "%5.1" /end CHARACTERISTIC
/begin CHARACTERISTIC DFC_CtlMsk2.DFC_ElMActvDchaFailr_C "" VALUE 0x80241579 Val_Wu8 255.0 DFES_OneToOne 0.00 255.0 FORMAT "%5.1" /end CHARACTERISTIC
/begin CHARACTERISTIC DFC_CtlMsk2.DFC_ElMFbdnIvtrModDrv01_C "" VALUE 0x8024157B Val_Wu8 255.0 DFES_OneToOne 0.00 255.0 FORMAT "%5.1" /end CHARACTERISTIC
/begin CHARACTERISTIC DFC_CtlMsk2.DFC_ElMIsoMonPlausyFlt_C "" VALUE 0x8024157E Val_Wu8 255.0 DFES_OneToOne 0.00 255.0 FORMAT "%5.1" /end CHARACTERISTIC
/begin CHARACTERISTIC DFC_CtlMsk2.DFC_ElMOverSpdNeg01_C "" VALUE 0x80241584 Val_Wu8 255.0 DFES_OneToOne 0.00 255.0 FORMAT "%5.1" /end CHARACTERISTIC
/begin CHARACTERISTIC DFC_CtlMsk2.DFC_ElMOverSpdPos01_C "" VALUE 0x80241585 Val_Wu8 255.0 DFES_OneToOne 0.00 255.0 FORMAT "%5.1" /end CHARACTERISTIC
/begin CHARACTERISTIC DFC_CtlMsk2.DFC_ElMOverTqNeg01_C "" VALUE 0x80241586 Val_Wu8 255.0 DFES_OneToOne 0.00 255.0 FORMAT "%5.1" /end CHARACTERISTIC
/begin CHARACTERISTIC DFC_CtlMsk2.DFC_ElMOverTqPos01_C "" VALUE 0x80241587 Val_Wu8 255.0 DFES_OneToOne 0.00 255.0 FORMAT "%5.1" /end CHARACTERISTIC
/begin CHARACTERISTIC DFC_CtlMsk2.DFC_EemDcdcPrecSpdInhb_C "" VALUE 0x8024159A Val_Wu8 255.0 DFES_OneToOne 0.00 255.0 FORMAT "%5.1" /end CHARACTERISTIC
/begin CHARACTERISTIC DFC_CtlMsk2.DFC_EChrDvPlinCntrThdExcdd_C "" VALUE 0x802415EE Val_Wu8 255.0 DFES_OneToOne 0.00 255.0 FORMAT "%5.1" /end CHARACTERISTIC
/begin CHARACTERISTIC DFC_CtlMsk2.DFC_EemDiagCtctrClsTout_C "" VALUE 0x802415EF Val_Wu8 255.0 DFES_OneToOne 0.00 255.0 FORMAT "%5.1" /end CHARACTERISTIC
/begin CHARACTERISTIC DFC_CtlMsk2.DFC_EemDiagDcdcOffTOut_C "" VALUE 0x802415F0 Val_Wu8 255.0 DFES_OneToOne 0.00 255.0 FORMAT "%5.1" /end CHARACTERISTIC
/begin CHARACTERISTIC DFC_CtlMsk2.DFC_EemDiagHvCnsrOffTOut_C "" VALUE 0x802415F1 Val_Wu8 255.0 DFES_OneToOne 0.00 255.0 FORMAT "%5.1" /end CHARACTERISTIC
/begin CHARACTERISTIC DFC_CtlMsk2.DFC_EemDiagHvbOffTOut_C "" VALUE 0x802415F2 Val_Wu8 255.0 DFES_OneToOne 0.00 255.0 FORMAT "%5.1" /end CHARACTERISTIC
/begin CHARACTERISTIC DFC_CtlMsk2.DFC_SWReset_0_C "" VALUE 0x802416A3 Val_Wu8 255.0 DFES_OneToOne 0.00 255.0 FORMAT "%5.1" /end CHARACTERISTIC
/begin CHARACTERISTIC DFC_CtlMsk2.DFC_SWReset_1_C "" VALUE 0x802416A4 Val_Wu8 255.0 DFES_OneToOne 0.00 255.0 FORMAT "%5.1" /end CHARACTERISTIC
/begin CHARACTERISTIC DFC_CtlMsk2.DFC_SWReset_2_C "" VALUE 0x802416A5 Val_Wu8 255.0 DFES_OneToOne 0.00 255.0 FORMAT "%5.1" /end CHARACTERISTIC
/begin CHARACTERISTIC DFC_DisblMsk2.DFC_DrvStbltOpn_C "" VALUE 0x80248BA6 Val_Wu16 65535.00 DFES_OneToOne 0.00 65535.00 FORMAT "%8.2" /end CHARACTERISTIC
/begin CHARACTERISTIC DFC_DisblMsk2.DFC_EbsLvBattSocDiagLo_C "" VALUE 0x80248BAC Val_Wu16 65535.00 DFES_OneToOne 0.00 65535.00 FORMAT "%8.2" /end CHARACTERISTIC
/begin CHARACTERISTIC DFC_DisblMsk2.DFC_EbsLvBattUDiagDiOper_C "" VALUE 0x80248BAE Val_Wu16 65535.00 DFES_OneToOne 0.00 65535.00 FORMAT "%8.2" /end CHARACTERISTIC
/begin CHARACTERISTIC DFC_DisblMsk2.DFC_EbsLvBattUDiagFltLvl1_C "" VALUE 0x80248BB0 Val_Wu16 65535.00 DFES_OneToOne 0.00 65535.00 FORMAT "%8.2" /end CHARACTERISTIC
/begin CHARACTERISTIC DFC_DisblMsk2.DFC_EbsLvBattUDiagFltLvl2_C "" VALUE 0x80248BB2 Val_Wu16 65535.00 DFES_OneToOne 0.00 65535.00 FORMAT "%8.2" /end CHARACTERISTIC
/begin CHARACTERISTIC DFC_DisblMsk2.DFC_EbsLvBattUDiagLo_C "" VALUE 0x80248BB4 Val_Wu16 65535.00 DFES_OneToOne 0.00 65535.00 FORMAT "%8.2" /end CHARACTERISTIC
/begin CHARACTERISTIC DFC_DisblMsk2.DFC_EbsSnsrSt_C "" VALUE 0x80248BB6 Val_Wu16 65535.00 DFES_OneToOne 0.00 65535.00 FORMAT "%8.2" /end CHARACTERISTIC
/begin CHARACTERISTIC DFC_DisblMsk2.DFC_EbsSofASILErr_C "" VALUE 0x80248BB8 Val_Wu16 65535.00 DFES_OneToOne 0.00 65535.00 FORMAT "%8.2" /end CHARACTERISTIC
/begin CHARACTERISTIC DFC_DisblMsk2.DFC_ElMActvDchaFailr_C "" VALUE 0x80248FD8 Val_Wu16 65535.00 DFES_OneToOne 0.00 65535.00 FORMAT "%8.2" /end CHARACTERISTIC
/begin CHARACTERISTIC DFC_DisblMsk2.DFC_ElMFbdnIvtrModDrv01_C "" VALUE 0x80248FDC Val_Wu16 65535.00 DFES_OneToOne 0.00 65535.00 FORMAT "%8.2" /end CHARACTERISTIC
/begin CHARACTERISTIC DFC_DisblMsk2.DFC_ElMIsoMonPlausyFlt_C "" VALUE 0x80248FE2 Val_Wu16 65535.00 DFES_OneToOne 0.00 65535.00 FORMAT "%8.2" /end CHARACTERISTIC
/begin CHARACTERISTIC DFC_DisblMsk2.DFC_ElMOverSpdNeg01_C "" VALUE 0x80248FEE Val_Wu16 65535.00 DFES_OneToOne 0.00 65535.00 FORMAT "%8.2" /end CHARACTERISTIC
/begin CHARACTERISTIC DFC_DisblMsk2.DFC_ElMOverSpdPos01_C "" VALUE 0x80248FF0 Val_Wu16 65535.00 DFES_OneToOne 0.00 65535.00 FORMAT "%8.2" /end CHARACTERISTIC
/begin CHARACTERISTIC DFC_DisblMsk2.DFC_ElMOverTqNeg01_C "" VALUE 0x80248FF2 Val_Wu16 65535.00 DFES_OneToOne 0.00 65535.00 FORMAT "%8.2" /end CHARACTERISTIC
/begin CHARACTERISTIC DFC_DisblMsk2.DFC_ElMOverTqPos01_C "" VALUE 0x80248FF4 Val_Wu16 65535.00 DFES_OneToOne 0.00 65535.00 FORMAT "%8.2" /end CHARACTERISTIC
/begin CHARACTERISTIC DFC_DisblMsk2.DFC_EemDcdcPrecSpdInhb_C "" VALUE 0x8024901A Val_Wu16 65535.00 DFES_OneToOne 0.00 65535.00 FORMAT "%8.2" /end CHARACTERISTIC
/begin CHARACTERISTIC DFC_DisblMsk2.DFC_EChrDvPlinCntrThdExcdd_C "" VALUE 0x802490C2 Val_Wu16 65535.00 DFES_OneToOne 0.00 65535.00 FORMAT "%8.2" /end CHARACTERISTIC
/begin CHARACTERISTIC DFC_DisblMsk2.DFC_EemDiagCtctrClsTout_C "" VALUE 0x802490C4 Val_Wu16 65535.00 DFES_OneToOne 0.00 65535.00 FORMAT "%8.2" /end CHARACTERISTIC
/begin CHARACTERISTIC DFC_DisblMsk2.DFC_EemDiagDcdcOffTOut_C "" VALUE 0x802490C6 Val_Wu16 65535.00 DFES_OneToOne 0.00 65535.00 FORMAT "%8.2" /end CHARACTERISTIC
/begin CHARACTERISTIC DFC_DisblMsk2.DFC_EemDiagHvCnsrOffTOut_C "" VALUE 0x802490C8 Val_Wu16 65535.00 DFES_OneToOne 0.00 65535.00 FORMAT "%8.2" /end CHARACTERISTIC
/begin CHARACTERISTIC DFC_DisblMsk2.DFC_EemDiagHvbOffTOut_C "" VALUE 0x802490CA Val_Wu16 65535.00 DFES_OneToOne 0.00 65535.00 FORMAT "%8.2" /end CHARACTERISTIC
/begin CHARACTERISTIC DFC_DisblMsk2.DFC_SWReset_0_C "" VALUE 0x8024922C Val_Wu16 65535.00 DFES_OneToOne 0.00 65535.00 FORMAT "%8.2" /end CHARACTERISTIC
/begin CHARACTERISTIC DFC_DisblMsk2.DFC_SWReset_1_C "" VALUE 0x8024922E Val_Wu16 65535.00 DFES_OneToOne 0.00 65535.00 FORMAT "%8.2" /end CHARACTERISTIC
/begin CHARACTERISTIC DFC_DisblMsk2.DFC_SWReset_2_C "" VALUE 0x80249230 Val_Wu16 65535.00 DFES_OneToOne 0.00 65535.00 FORMAT "%8.2" /end CHARACTERISTIC
/begin CHARACTERISTIC DrvStblt_bOpnRepl_C "Default calibration value for status of driver seat belt in case of error" VALUE 0x8024E6E8 Val_Wu8 1.000 OneToOne 0.00 1.000 FORMAT "%5.3" EXTENDED_LIMITS 0.00 255.0 /end CHARACTERISTIC
/begin CHARACTERISTIC DrvStblt_tiHiLoComDrvStblt_C "Delay parameter for high to low transition for debouncing the Driver seatbelt switch status from CAN" VALUE 0x8024E6E4 Val_Ws16 655350.0 TimeDeb -327680.0 327670.0 FORMAT "%8.1" /end CHARACTERISTIC
/begin CHARACTERISTIC DrvStblt_tiLoHiComDrvStblt_C "Delay parameter for low to high transition for debouncing the Driver seatbelt switch status from CAN" VALUE 0x8024E6E6 Val_Ws16 655350.0 TimeDeb -327680.0 327670.0 FORMAT "%8.1" /end CHARACTERISTIC
/begin CHARACTERISTIC DSMAUX_WucDet_pEnvMin_C "Maximum elevation represented by minimum air pressure" VALUE 0x80248A08 Val_Ws16 65535.00 Pres_hPa -32768.00 32767.00 FORMAT "%8.2" /end CHARACTERISTIC
/begin CHARACTERISTIC DSMAUX_WucDet_rAPPMax_C "Maximum accelerator pedal position for idle detection" VALUE 0x80248A0A Val_Ws16 799.9878 Prc -400.0000 399.9878 FORMAT "%8.4" /end CHARACTERISTIC
/begin CHARACTERISTIC DSMAUX_WucDet_tEnvMin_C "Minimum ambient temperature" VALUE 0x80248A0C Val_Ws16 6553.500 Temp_Cels -3549.940 3003.560 FORMAT "%8.3" /end CHARACTERISTIC
/begin CHARACTERISTIC DSMAUX_WucDet_tiIdlMin_C "Minimum operation time in idle state" VALUE 0x80248A0E Val_Ws16 6553.500 DSMAUX_ti100ms -3276.800 3276.700 FORMAT "%8.3" /end CHARACTERISTIC
/begin CHARACTERISTIC DSMAUX_WucDet_tiOpMin_C "Minimum operation time" VALUE 0x80248A10 Val_Ws16 6553.500 DSMAUX_ti100ms -3276.800 3276.700 FORMAT "%8.3" /end CHARACTERISTIC
/begin CHARACTERISTIC DSMAUX_WucDet_tiVehSpdMin_C "Minimum operation time above 25 miles per hour" VALUE 0x80248A12 Val_Ws16 6553.500 DSMAUX_ti100ms -3276.800 3276.700 FORMAT "%8.3" /end CHARACTERISTIC
/begin CHARACTERISTIC DSMAUX_WucDet_vVehIdlMax_C "Maximum vehicle speed for idle detection" VALUE 0x80248A14 Val_Ws16 655.3500 Vel -327.6800 327.6700 FORMAT "%8.4" /end CHARACTERISTIC
/begin CHARACTERISTIC DSMAUX_WucDet_vVehMin_C "Minimum vehicle speed" VALUE 0x80248A16 Val_Ws16 655.3500 Vel -327.6800 327.6700 FORMAT "%8.4" /end CHARACTERISTIC
/begin CHARACTERISTIC DSMAUX_xClearMode_C "clear mode for clear trigger" VALUE 0x80248A18 Val_Wu16 964.000000000 DFC_Verb 0.00 964.000000000 FORMAT "%13.9" /end CHARACTERISTIC
/begin CHARACTERISTIC DSMAUX_xClearTrg_C "clear trigger to delete diagnostic information" VALUE 0x80248A1A Val_Wu8 255.0 DFC_OneToOne 0.00 255.0 FORMAT "%5.1" /end CHARACTERISTIC
/begin CHARACTERISTIC DSMAUX_xClrRtTrg_C "Clear trigger for DSM Reinit runtime measurement-Resets maximum reinit duration." VALUE 0x80248A1B Val_Wu8 255.0 DFC_OneToOne 0.00 255.0 FORMAT "%5.1" /end CHARACTERISTIC
/begin CHARACTERISTIC DSMRdy_Grp.FlSys_CA "" VAL_BLK 0x8024D176 ValA_Wu16 964.000000000 DFC_Verb 0.00 964.000000000 FORMAT "%13.9" MATRIX_DIM 15 /end CHARACTERISTIC
/begin CHARACTERISTIC DSMRdy_Grp.Cat_CA "" VAL_BLK 0x8024D1B2 ValA_Wu16 964.000000000 DFC_Verb 0.00 964.000000000 FORMAT "%13.9" MATRIX_DIM 15 /end CHARACTERISTIC
/begin CHARACTERISTIC DSMRdy_Grp.HtCat_CA "" VAL_BLK 0x8024D1D0 ValA_Wu16 964.000000000 DFC_Verb 0.00 964.000000000 FORMAT "%13.9" MATRIX_DIM 15 /end CHARACTERISTIC
/begin CHARACTERISTIC DSMRdy_Grp.EvpSys_CA "" VAL_BLK 0x8024D1EE ValA_Wu16 964.000000000 DFC_Verb 0.00 964.000000000 FORMAT "%13.9" MATRIX_DIM 15 /end CHARACTERISTIC
/begin CHARACTERISTIC DSMRdy_Grp.SecAirSys_CA "" VAL_BLK 0x8024D20C ValA_Wu16 964.000000000 DFC_Verb 0.00 964.000000000 FORMAT "%13.9" MATRIX_DIM 15 /end CHARACTERISTIC
/begin CHARACTERISTIC DSMRdy_Grp.O2Sens_CA "" VAL_BLK 0x8024D248 ValA_Wu16 964.000000000 DFC_Verb 0.00 964.000000000 FORMAT "%13.9" MATRIX_DIM 15 /end CHARACTERISTIC
/begin CHARACTERISTIC DSMRdy_Grp.O2SensHt_CA "" VAL_BLK 0x8024D266 ValA_Wu16 964.000000000 DFC_Verb 0.00 964.000000000 FORMAT "%13.9" MATRIX_DIM 15 /end CHARACTERISTIC
/begin CHARACTERISTIC DSMRdy_Grp.EGR_CA "" VAL_BLK 0x8024D284 ValA_Wu16 964.000000000 DFC_Verb 0.00 964.000000000 FORMAT "%13.9" MATRIX_DIM 15 /end CHARACTERISTIC
/begin CHARACTERISTIC DSMRdy_X.PID1ForceLowMsk_C "" VALUE 0x80248A1C Val_Wu32 4294967295.00 DSMRdy_OneToOne 0.00 4294967295.00 FORMAT "%13.2" /end CHARACTERISTIC
/begin CHARACTERISTIC DSMRdy_X.PID1ForceHighMsk_C "" VALUE 0x80248A20 Val_Wu32 4294967295.00 DSMRdy_OneToOne 0.00 4294967295.00 FORMAT "%13.2" /end CHARACTERISTIC
/begin CHARACTERISTIC DSMRdy_X.PID41ForceLowMsk_C "" VALUE 0x80248A24 Val_Wu32 4294967295.00 DSMRdy_OneToOne 0.00 4294967295.00 FORMAT "%13.2" /end CHARACTERISTIC
/begin CHARACTERISTIC DSMRdy_X.PID41ForceHighMsk_C "" VALUE 0x80248A28 Val_Wu32 4294967295.00 DSMRdy_OneToOne 0.00 4294967295.00 FORMAT "%13.2" /end CHARACTERISTIC
/begin CHARACTERISTIC DSM_tiComNetNormModeTurnOffDly_C "Turn-off delay time to reset the bit, When the Com_stNMStM enters COM_NORMALMODE state" VALUE 0x8025BB0C Val_Ws32 2147483.00000 DSMAppl_TrnOffDly_Compu 0.00 2147483.00000 FORMAT "%13.5" EXTENDED_LIMITS -2147483.64800 2147483.64700 /end CHARACTERISTIC
/begin CHARACTERISTIC DSM_tiHiBattTurnOffDly_C "Turn-off delay time to reset the bit for High battery voltage disable condition after the battery voltage decreases to an lower threshold." VALUE 0x8025BB10 Val_Ws32 2147483.00000 DSMAppl_TrnOffDly_Compu 0.00 2147483.00000 FORMAT "%13.5" EXTENDED_LIMITS -2147483.64800 2147483.64700 /end CHARACTERISTIC
/begin CHARACTERISTIC DSM_tiLoBattTurnOffDly_C "Turn-off delay time to reset the bit for low battery voltage disable condition after the battery voltage increases to an upper threshold." VALUE 0x8025BB14 Val_Ws32 2147483.00000 DSMAppl_TrnOffDly_Compu 0.00 2147483.00000 FORMAT "%13.5" EXTENDED_LIMITS -2147483.64800 2147483.64700 /end CHARACTERISTIC
/begin CHARACTERISTIC DSM_tiPostDrvTurnOffDly_C "Turn-off delay time to reset the bit, When the SyC_stSub leaves the SYC_POSTDRIVE State." VALUE 0x8025BB18 Val_Ws32 2147483.00000 DSMAppl_TrnOffDly_Compu 0.00 2147483.00000 FORMAT "%13.5" EXTENDED_LIMITS -2147483.64800 2147483.64700 /end CHARACTERISTIC
/begin CHARACTERISTIC DSM_tiPreDrvNormModeTurnOffDly_C "Turn-off delay time to reset the bit, When the SyC_stSub leaves the SYC_PREDRIVE State or When Com_stNMStM enters" VALUE 0x8025BB1C Val_Ws32 2147483.00000 DSMAppl_TrnOffDly_Compu 0.00 2147483.00000 FORMAT "%13.5" EXTENDED_LIMITS -2147483.64800 2147483.64700 /end CHARACTERISTIC
/begin CHARACTERISTIC DSM_tiPreDrvShdwnTurnOffDly_C "Turn-off delay time to reset the bit, When the SyC_stSub leaves the SYC_PREDRIVE State during Shut-off." VALUE 0x8025BB20 Val_Ws32 2147483.00000 DSMAppl_TrnOffDly_Compu 0.00 2147483.00000 FORMAT "%13.5" EXTENDED_LIMITS -2147483.64800 2147483.64700 /end CHARACTERISTIC
/begin CHARACTERISTIC DSM_tiPreDrvWakeupTurnOffDly_C "Turn-off delay time to reset the bit, When the SyC_stSub leaves the SYC_PREDRIVE State during Wake-up." VALUE 0x8025BB24 Val_Ws32 2147483.00000 DSMAppl_TrnOffDly_Compu 0.00 2147483.00000 FORMAT "%13.5" EXTENDED_LIMITS -2147483.64800 2147483.64700 /end CHARACTERISTIC
/begin CHARACTERISTIC DSM_tiPwtstateTurnOffDly_C "Turn-off delay for Powertrain state" VALUE 0x8025BB28 Val_Ws32 2147483.00000 DSMAppl_TrnOffDly_Compu 0.00 2147483.00000 FORMAT "%13.5" EXTENDED_LIMITS -2147483.64800 2147483.64700 /end CHARACTERISTIC
/begin CHARACTERISTIC DSM_tiT15RisngTurnOffDly_C "Turn-off delay time to reset the bit, When the T15_st rising edge is detected." VALUE 0x8025BB2C Val_Ws32 2147483.00000 DSMAppl_TrnOffDly_Compu 0.00 2147483.00000 FORMAT "%13.5" EXTENDED_LIMITS -2147483.64800 2147483.64700 /end CHARACTERISTIC
/begin CHARACTERISTIC DSM_tiVehStChrgnTurnOffDly_C "Turn-off delay time to reset the bit, When the VehCoorn_st leaves the VEHCOORN_CHRG State." VALUE 0x8025BB30 Val_Ws32 2147483.00000 DSMAppl_TrnOffDly_Compu 0.00 2147483.00000 FORMAT "%13.5" EXTENDED_LIMITS -2147483.64800 2147483.64700 /end CHARACTERISTIC
/begin CHARACTERISTIC DSM_uHighBattHysHi_C "Right switching point of the hysteresis to disable DFC monitoring incase of high battery voltage" VALUE 0x8025BB34 Val_Ws16 1310700. Volt_Batt -655360.0 655340.0 FORMAT "%8.1" /end CHARACTERISTIC
/begin CHARACTERISTIC DSM_uHighBattHysLo_C "Left switching point of the hysteresis to reset the disable condition due to high battery voltage" VALUE 0x8025BB36 Val_Ws16 1310700. Volt_Batt -655360.0 655340.0 FORMAT "%8.1" /end CHARACTERISTIC
/begin CHARACTERISTIC DSM_uLowBattHysHi_C "Right switching point of the hysteresis for resetting the voltage disable condition due to low battery voltage" VALUE 0x8025BB38 Val_Ws16 1310700. Volt_Batt -655360.0 655340.0 FORMAT "%8.1" /end CHARACTERISTIC
/begin CHARACTERISTIC DSM_uLowBattHysLo_C "Left switching point of the hysteresis to disable DFC monitoring incase of low battery voltage" VALUE 0x8025BB3A Val_Ws16 1310700. Volt_Batt -655360.0 655340.0 FORMAT "%8.1" /end CHARACTERISTIC
/begin CHARACTERISTIC Ebs_flgBattSocSeln_C "Calibration to select the SOC interface" VALUE 0x802503A4 RB_Val_Wu8 1.00000000000 B_TRUE 0.00 1.00000000000 FORMAT "%13.11" /end CHARACTERISTIC
/begin CHARACTERISTIC Ebs_flgBattTSeln_C "Calibration to select the battery temperature interface" VALUE 0x802503A5 RB_Val_Wboolean 1.00000000000 B_TRUE 0.00 1.00000000000 FORMAT "%13.11" /end CHARACTERISTIC
/begin CHARACTERISTIC Ebs_flgStSohRedQlyInvld_C "The calibration sets the signal quality of the battery state of health statu" VALUE 0x802503A6 RB_Val_Wu8 1.00000000000 B_TRUE 0.00 1.00000000000 FORMAT "%13.11" /end CHARACTERISTIC
/begin CHARACTERISTIC Ebs_iBattRepl_C "Replacement current value for test" VALUE 0x802503A8 RB_Val_Ws16 655.3500 Curr_A -327.6800 327.6700 FORMAT "%8.4" /end CHARACTERISTIC
/begin CHARACTERISTIC Ebs_iS16MaxLim_C "Max limit for S16 Curr_A" VALUE 0x802503AC RB_Val_Ws32 63999.0234375 Curr_mA_q0p9765625_COMPU -32000.0000000 31999.0234375 FORMAT "%13.7" EXTENDED_LIMITS -2097152000.00 2097151999.02 /end CHARACTERISTIC
/begin CHARACTERISTIC Ebs_iS16MinLim_C "Min limit for S16 Curr_A" VALUE 0x802503B0 RB_Val_Ws32 63999.0234375 Curr_mA_q0p9765625_COMPU -32000.0000000 31999.0234375 FORMAT "%13.7" EXTENDED_LIMITS -2097152000.00 2097151999.02 /end CHARACTERISTIC
/begin CHARACTERISTIC Ebs_maskBattSigFltSq_C "Calibration mask to select the validity of battery signals for deciding low battery fault" VALUE 0x802503B4 RB_Val_Wu16 65535.00 OneToOne 0.00 65535.00 FORMAT "%8.2" /end CHARACTERISTIC
/begin CHARACTERISTIC Ebs_qSohRepl_C "Replacement SOH value for test" VALUE 0x802503B6 RB_Val_Ws16 8191.875 ElecChrg_Ah_q0p125_COMPU -4096.000 4095.875 FORMAT "%8.3" /end CHARACTERISTIC
/begin CHARACTERISTIC Ebs_ratSocLvBattLo_C "Threshold for 12 V battery SOC below which the battery is diagnosed as battery low for opera- tion." VALUE 0x802503B8 RB_Val_Wu8 255.0 rel_q1 0.00 255.0 FORMAT "%5.1" /end CHARACTERISTIC
/begin CHARACTERISTIC Ebs_ratSocRepl_C "Replacement SOC value for test" VALUE 0x802503B9 RB_Val_Wu8 255.0 rel_q1 0.00 255.0 FORMAT "%5.1" /end CHARACTERISTIC
/begin CHARACTERISTIC Ebs_ratSohBattRepl_C "Value for test of SOH" VALUE 0x802503BA RB_Val_Ws16 799.9878 Prc -400.0000 399.9878 FORMAT "%8.4" /end CHARACTERISTIC
/begin CHARACTERISTIC Ebs_stErrMsk_C "Mask to select quality state error in Battery sensor" VALUE 0x802503BC RB_Val_Wu8 255.0 OneToOne 0.00 255.0 FORMAT "%5.1" /end CHARACTERISTIC
/begin CHARACTERISTIC Ebs_swtCtl_C "Switch for testing" VALUE 0x802503BD RB_Val_Wu8 255.0 OneToOne 0.00 255.0 FORMAT "%5.1" /end CHARACTERISTIC
/begin CHARACTERISTIC Ebs_tBattRepl_C "Replacement temperature value for test" VALUE 0x802503BE RB_Val_Ws16 65535.00 SCR_TEMP_CELS_float -32768.00 32767.00 FORMAT "%8.2" /end CHARACTERISTIC
/begin CHARACTERISTIC Ebs_tiSocFil_C "T1 filter time for SOC" VALUE 0x802503C0 RB_Val_Ws32 4294.9672940000000 TimeDelay_s 0.0000020000000 4294.9672959999998 FORMAT "%19.14" EXTENDED_LIMITS 0.000002000000001 4294.9672959999998 /end CHARACTERISTIC
/begin CHARACTERISTIC Ebs_tiSohFil_C "T1 filter time for SOH" VALUE 0x802503C4 RB_Val_Ws32 4294.9672940000000 TimeDelay_s 0.0000020000000 4294.9672959999998 FORMAT "%19.14" EXTENDED_LIMITS 0.000002000000001 4294.9672959999998 /end CHARACTERISTIC
/begin CHARACTERISTIC Ebs_tiTBattFil_C "T1 filter time for battery temperature" VALUE 0x802503C8 RB_Val_Ws32 4294.9672940000000 TimeDelay_s 0.0000020000000 4294.9672959999998 FORMAT "%19.14" EXTENDED_LIMITS 0.000002000000001 4294.9672959999998 /end CHARACTERISTIC
/begin CHARACTERISTIC Ebs_tiTLvBattFil_C "T1 filter time for low voltage battery temperature" VALUE 0x802503CC RB_Val_Ws32 4294.9672940000000 TimeDelay_s 0.0000020000000 4294.9672959999998 FORMAT "%19.14" EXTENDED_LIMITS 0.000002000000001 4294.9672959999998 /end CHARACTERISTIC
/begin CHARACTERISTIC Ebs_tiUBattFil_C "T1 filter time for battery voltage" VALUE 0x802503D0 RB_Val_Ws32 4294.9672940000000 TimeDelay_s 0.0000020000000 4294.9672959999998 FORMAT "%19.14" EXTENDED_LIMITS 0.000002000000001 4294.9672959999998 /end CHARACTERISTIC
/begin CHARACTERISTIC Ebs_tLvBattFilIni_C "Parameter to initialize the LV battery temperature filter" VALUE 0x802503D4 RB_Val_Ws16 6553.500 Temp_Cels -3549.940 3003.560 FORMAT "%8.3" /end CHARACTERISTIC
/begin CHARACTERISTIC Ebs_tLvBattRepl_C "Replacement value for LV battery temperature" VALUE 0x802503D6 RB_Val_Ws16 6553.500 Temp_Cels -3549.940 3003.560 FORMAT "%8.3" /end CHARACTERISTIC
/begin CHARACTERISTIC Ebs_uBattRepl_C "Replacement voltage value for test" VALUE 0x802503D8 RB_Val_Ws16 63999.02 U_mV_q0p9765625_COMPU -32000.00 31999.02 FORMAT "%8.2" /end CHARACTERISTIC
/begin CHARACTERISTIC Ebs_uBattSofAsilMinRmn_C "Minimum voltage threshold for LV to be in SOF" VALUE 0x802503DA RB_Val_Wu16 4095.938 spg_q0p0625_V 0.00 4095.938 FORMAT "%8.3" /end CHARACTERISTIC
/begin CHARACTERISTIC Ebs_uFildLvBattFltDiOper_C "Threshold for 12 V battery voltage below which the battery is diagnosed as disable drivability o- peration" VALUE 0x802503DC RB_Val_Ws16 63999.02 U_mV_q0p9765625_COMPU -32000.00 31999.02 FORMAT "%8.2" /end CHARACTERISTIC
/begin CHARACTERISTIC Ebs_uFildLvBattFltLvl1_C "Threshold for 12 V battery voltage below which the battery is diagnosed as fault level 1 (service warning) operation." VALUE 0x802503DE RB_Val_Ws16 63999.02 U_mV_q0p9765625_COMPU -32000.00 31999.02 FORMAT "%8.2" /end CHARACTERISTIC
/begin CHARACTERISTIC Ebs_uFildLvBattFltLvl2_C "Threshold for 12 V battery voltage below which the battery is diagnosed as fault level 2 (stop warning) operation" VALUE 0x802503E0 RB_Val_Ws16 63999.02 U_mV_q0p9765625_COMPU -32000.00 31999.02 FORMAT "%8.2" /end CHARACTERISTIC
/begin CHARACTERISTIC Ebs_uFildLvBattLoHeal_C "Threshold for 12 V battery voltage above which the battery is OK for operation" VALUE 0x802503E2 RB_Val_Ws16 63999.02 U_mV_q0p9765625_COMPU -32000.00 31999.02 FORMAT "%8.2" /end CHARACTERISTIC
/begin CHARACTERISTIC Ebs_uFildLvBattLo_C "Threshold for 12 V battery voltage below which the battery is diagnosed as battery low for operation." VALUE 0x802503E4 RB_Val_Ws16 63999.02 U_mV_q0p9765625_COMPU -32000.00 31999.02 FORMAT "%8.2" /end CHARACTERISTIC
/begin CHARACTERISTIC Ebs_uLvBattFltDiOper_C "Threshold for 12 V battery voltage in case of voltage from EBS is invalid, below which the battery is diagnosed as disable drivability o- peration" VALUE 0x802503E6 RB_Val_Ws16 1310700. Volt_Batt -655360.0 655340.0 FORMAT "%8.1" /end CHARACTERISTIC
/begin CHARACTERISTIC Ebs_uLvBattFltLvl1_C "Threshold for 12 V battery voltage in case of voltage from EBS is invalid, below which the battery is diagnosed as fault level 1 (service warning) operation" VALUE 0x802503E8 RB_Val_Ws16 1310700. Volt_Batt -655360.0 655340.0 FORMAT "%8.1" /end CHARACTERISTIC
/begin CHARACTERISTIC Ebs_uLvBattFltLvl2_C "Threshold for 12 V battery voltage in case of voltage from EBS is invalid, below which the battery is diagnosed as fault level 2 (service warning) operation" VALUE 0x802503EA RB_Val_Ws16 1310700. Volt_Batt -655360.0 655340.0 FORMAT "%8.1" /end CHARACTERISTIC
/begin CHARACTERISTIC Ebs_uLvBattLoHeal_C "Threshold for 12 V battery voltage in case of voltage from EBS is invalid, above which the battery is diagnosed as OK for operation" VALUE 0x802503EC RB_Val_Ws16 1310700. Volt_Batt -655360.0 655340.0 FORMAT "%8.1" /end CHARACTERISTIC
/begin CHARACTERISTIC Ebs_uLvBattLo_C "Threshold for 12 V battery voltage in case of voltage from EBS is invalid, below which the battery is diagnosed as battery low for operation." VALUE 0x802503EE RB_Val_Ws16 1310700. Volt_Batt -655360.0 655340.0 FORMAT "%8.1" /end CHARACTERISTIC
/begin CHARACTERISTIC Ebs_uSofAsilErr_T "Curve parameter to determine the remaining voltage in LV for SOF" CURVE 0x802503F0 RB_Curve_U16_S16_sao 4095.938 spg_q0p0625_V -2048.000 2047.938 FORMAT "%8.3"
 /begin AXIS_DESCR STD_AXIS Com_stSofASILErr OneToOne 16 0.00 255.0000 FORMAT "%8.4" EXTENDED_LIMITS 0.00 65535.00 DEPOSIT ABSOLUTE /end AXIS_DESCR
/end CHARACTERISTIC
/begin CHARACTERISTIC Ebs_uSofFild_C "Calibration value for voltage drop while cranking" VALUE 0x80250432 RB_Val_Ws16 4095.938 spg_q0p0625_V -2048.000 2047.938 FORMAT "%8.3" /end CHARACTERISTIC
/begin CHARACTERISTIC EChrDv_cntPlinThd_C "Calibration for proximity pilot plug-in counter threshold" VALUE 0x80250360 RB_Val_Wu16 65535.00 OneToOne 0.00 65535.00 FORMAT "%8.2" /end CHARACTERISTIC
/begin CHARACTERISTIC EChrDv_tiCtpAndPxpDetnWakeup_C "Calibration for control pilot line wake up signal duration" VALUE 0x80250362 RB_Val_Wu16 655.3500 Time_s 0.00 655.3500 FORMAT "%8.4" /end CHARACTERISTIC
/begin CHARACTERISTIC EChrDv_tiCtpAndPxpDetn_C "Calibration for control pilot line pulse duration" VALUE 0x80250364 RB_Val_Wu16 655.3500 Time_s 0.00 655.3500 FORMAT "%8.4" /end CHARACTERISTIC
/begin CHARACTERISTIC EChrDv_tiPxpDetnWakeup_C "Calibration for proximity pilot line wake up signal duration" VALUE 0x80250366 RB_Val_Wu16 655.3500 Time_s 0.00 655.3500 FORMAT "%8.4" /end CHARACTERISTIC
/begin CHARACTERISTIC EChrDv_tiPxpDetn_C "Calibration for proximity pilot line pulse duration" VALUE 0x80250368 RB_Val_Wu16 655.3500 Time_s 0.00 655.3500 FORMAT "%8.4" /end CHARACTERISTIC
/begin CHARACTERISTIC EEM_chBatt_C "calibration value for battery charge" VALUE 0x80250434 RB_Val_Ws16 32767.50 Ch_Ah_q0p5_COMPU -16384.00 16383.50 FORMAT "%8.2" /end CHARACTERISTIC
/begin CHARACTERISTIC Eem_flgChngOfMndInOpng_C "Enables Change of Mind (T15 off-on) while BMS is in opening main switch." VALUE 0x80250448 RB_Val_Wboolean 1.00000000000 B_TRUE 0.00 1.00000000000 FORMAT "%13.11" /end CHARACTERISTIC
/begin CHARACTERISTIC Eem_flgFatalExWait_C "Enable wait for customer acknowledge in case of fatal fault." VALUE 0x80250449 RB_Val_Wboolean 1.00000000000 B_TRUE 0.00 1.00000000000 FORMAT "%13.11" /end CHARACTERISTIC
/begin CHARACTERISTIC Eem_maskComEmacUDcLnk01Sq_C "Calibration mask to determine the Electrical machine DC link01 voltage validity" VALUE 0x8025044A RB_Val_Wu16 65535.00 OneToOne 0.00 65535.00 FORMAT "%8.2" /end CHARACTERISTIC
/begin CHARACTERISTIC Eem_maskComStHvbCntctSq_C "Calibration mask to determine HV battery contactor state validity" VALUE 0x8025044C RB_Val_Wu16 65535.00 OneToOne 0.00 65535.00 FORMAT "%8.2" /end CHARACTERISTIC
/begin CHARACTERISTIC Eem_maskDcdcUHvActSq_C "Calibration mask to determine the actual HV voltage of Dcdc validity" VALUE 0x8025044E RB_Val_Wu16 65535.00 OneToOne 0.00 65535.00 FORMAT "%8.2" /end CHARACTERISTIC
/begin CHARACTERISTIC Eem_maskpwrMaxDchaContnsSq_C "Calibration mask for the HvBatt_pwrMaxDchaContns_Sq" VALUE 0x80250442 RB_Val_Wu16 65535.00 OneToOne 0.00 65535.00 FORMAT "%8.2" /end CHARACTERISTIC
/begin CHARACTERISTIC Eem_nr2OffSelector_T "Condition based on HV consumer state" CURVE 0x80250450 RB_Curve_U8_U8 255.0 OneToOne 0.00 255.0 FORMAT "%5.1"
 /begin AXIS_DESCR STD_AXIS NO_INPUT_QUANTITY OneToOne 8 0.00 255.0 FORMAT "%5.1" DEPOSIT ABSOLUTE /end AXIS_DESCR
/end CHARACTERISTIC
/begin CHARACTERISTIC Eem_nrOffSelector_T "Condition based on HV consumer state" CURVE 0x80250461 RB_Curve_U8_U8 255.0 OneToOne 0.00 255.0 FORMAT "%5.1"
 /begin AXIS_DESCR STD_AXIS NO_INPUT_QUANTITY OneToOne 8 0.00 255.0 FORMAT "%5.1" DEPOSIT ABSOLUTE /end AXIS_DESCR
/end CHARACTERISTIC
/begin CHARACTERISTIC Eem_nrPreSelector_T "Condition based on HV consumer state" CURVE 0x80250472 RB_Curve_U8_U8 255.0 OneToOne 0.00 255.0 FORMAT "%5.1"
 /begin AXIS_DESCR STD_AXIS NO_INPUT_QUANTITY OneToOne 8 0.00 255.0 FORMAT "%5.1" DEPOSIT ABSOLUTE /end AXIS_DESCR
/end CHARACTERISTIC
/begin CHARACTERISTIC Eem_pwrBascAuxUnitLoad_C "Calibrated base auxilliary load" VALUE 0x80250438 RB_Val_Ws16 1638375. RBPtCel_pwr_25p0_1 -819200.0 819175.0 FORMAT "%8.1" /end CHARACTERISTIC
/begin CHARACTERISTIC Eem_pwrHvBattLimDcdc_C "HV battery power threshold for DCDC on" VALUE 0x80250444 RB_Val_Ws16 1638375. RBPtCel_pwr_25p0_1 -819200.0 819175.0 FORMAT "%8.1" /end CHARACTERISTIC
/begin CHARACTERISTIC Eem_tiToutCtctrCls_C "time out for closing contactor" VALUE 0x8025043A RB_Val_Ws16 655.3500 Time_s -327.6800 327.6700 FORMAT "%8.4" /end CHARACTERISTIC
/begin CHARACTERISTIC Eem_tiToutDcdc_C "Timeout for DCDC off after command OFF" VALUE 0x8025043C RB_Val_Ws16 655.3500 Time_s -327.6800 327.6700 FORMAT "%8.4" /end CHARACTERISTIC
/begin CHARACTERISTIC Eem_tiToutHvb_C "Timeout for HV off after command OFF and discharge of HV grid" VALUE 0x8025043E RB_Val_Ws16 655.3500 Time_s -327.6800 327.6700 FORMAT "%8.4" /end CHARACTERISTIC
/begin CHARACTERISTIC Eem_tiToutHvCnsr_C "Timeout for all HV consumer off and ready to switch off HV" VALUE 0x80250440 RB_Val_Ws16 655.3500 Time_s -327.6800 327.6700 FORMAT "%8.4" /end CHARACTERISTIC
/begin CHARACTERISTIC Eem_uDcdcHvLimLo_C "Low voltage limit of DCDC working range" VALUE 0x80250484 RB_Val_Ws16 2047.969 Volt_V_q0p03125_COMPU -1024.000 1023.969 FORMAT "%8.3" /end CHARACTERISTIC
/begin CHARACTERISTIC Eem_uDcdcHvLimSafe_C "HV voltage low enougth to be safe" VALUE 0x80250486 RB_Val_Ws16 60.00000 Volt_V_q0p03125_COMPU 0.00 60.00000 FORMAT "%8.5" EXTENDED_LIMITS -1024.000 1023.969 /end CHARACTERISTIC
/begin CHARACTERISTIC Eem_vActvDchaThd_C "Threshold vehicle velocity for active discharge" VALUE 0x80250488 RB_Val_Ws16 655.3500 Vel -327.6800 327.6700 FORMAT "%8.4" /end CHARACTERISTIC
/begin CHARACTERISTIC Eem_vVehLimDcdc_C "Vehicle speed threshold for DCDC immideatly on" VALUE 0x80250446 RB_Val_Ws16 655.3500 Vel -327.6800 327.6700 FORMAT "%8.4" /end CHARACTERISTIC
/begin CHARACTERISTIC ElM_ChkPlaus01_I.ElM_flgHillHldPlausChkEnad_C "Plausibility check for E Machine 1 / Calibration flag to enable Hill Hold Plausibility check diagnosis." VALUE 0x80250650 RB_Val_Wboolean 1.00000000000 B_TRUE 0.00 1.00000000000 FORMAT "%13.11" /end CHARACTERISTIC
/begin CHARACTERISTIC ElM_ChkPlaus01_I.ElM_maskHillHldVldSq_C "Plausibility check for E Machine 1 / Calibratable mask for detecting Com_flgHillHldActvdLoc_Sq validity" VALUE 0x80250652 RB_Val_Wu16 65535.00 OneToOne 0.00 65535.00 FORMAT "%8.2" /end CHARACTERISTIC
/begin CHARACTERISTIC ElM_ChkPlaus01_I.ElM_maskstModVldSq_C "Plausibility check for E Machine 1 / Calibration mask for state of emachine Com sq signal" VALUE 0x80250654 RB_Val_Wu16 65535.00 OneToOne 0.00 65535.00 FORMAT "%8.2" /end CHARACTERISTIC
/begin CHARACTERISTIC ElM_ChkPlaus01_I.ElM_nOverSpdNegThd_C "Plausibility check for E Machine 1 / Negative Over speed threshold for E Machine" VALUE 0x80250656 RB_Val_Ws16 32767.00 nmot_q1 -32768.00 -1.00 FORMAT "%8.2" EXTENDED_LIMITS -32768.00 32767.00 /end CHARACTERISTIC
/begin CHARACTERISTIC ElM_ChkPlaus01_I.ElM_nOverSpdPosThd_C "Plausibility check for E Machine 1 / Positive Over speed threshold for E Machine" VALUE 0x80250658 RB_Val_Ws16 32766.00 nmot_q1 1.00 32767.00 FORMAT "%8.2" EXTENDED_LIMITS -32768.00 32767.00 /end CHARACTERISTIC
/begin CHARACTERISTIC ElM_ChkPlaus01_I.ElM_stFbdnIvtrModDrv_T "Plausibility check for E Machine 1 / Calibration table for definition of forbidden inverter modes during vehicle coordinator drive" CURVE 0x8025065A RB_Curve_U8_U8 255.0 OneToOne 0.00 255.0 FORMAT "%5.1"
 /begin AXIS_DESCR STD_AXIS NO_INPUT_QUANTITY OneToOne 16 0.00 255.0 FORMAT "%5.1" DEPOSIT ABSOLUTE /end AXIS_DESCR
/end CHARACTERISTIC
/begin CHARACTERISTIC ElM_ChkPlaus01_I.ElM_tqOverNegThd_C "Plausibility check for E Machine 1 / Negative Over torque threshold for E Machine" VALUE 0x8025067C RB_Val_Ws16 3276.700 Trq -3276.800 -0.100 FORMAT "%8.3" EXTENDED_LIMITS -3276.800 3276.700 /end CHARACTERISTIC
/begin CHARACTERISTIC ElM_ChkPlaus01_I.ElM_tqOverPosThd_C "Plausibility check for E Machine 1 / Positve Over torque threshold for E Machine" VALUE 0x8025067E RB_Val_Ws16 3276.600 Trq 0.100 3276.700 FORMAT "%8.3" EXTENDED_LIMITS -3276.800 3276.700 /end CHARACTERISTIC
/begin CHARACTERISTIC ElM_flgEnaFrbdnQdrLockgOddAxle_C "Switch to enable forbidden quadrant locking to odd axles" VALUE 0x8025048C RB_Val_Wu8 1.00000000000 B_TRUE 0.00 1.00000000000 FORMAT "%13.11" /end CHARACTERISTIC
/begin CHARACTERISTIC ElM_flgEnaQdrMpgOddAxle_C "Switch to enable quadrant mapping to odd axles" VALUE 0x8025048D RB_Val_Wu8 1.00000000000 B_TRUE 0.00 1.00000000000 FORMAT "%13.11" /end CHARACTERISTIC
/begin CHARACTERISTIC ElM_flgSwtIvtDirEm01_C "Switch to invert direction of rotation of e-machine 01." VALUE 0x8025048E RB_Val_Wu8 1.00000000000 B_TRUE 0.00 1.00000000000 FORMAT "%13.11" /end CHARACTERISTIC
/begin CHARACTERISTIC ElM_maskActvDchaPlausVldSq_C "Calibration mask for Active discharge response signal quality" VALUE 0x80250648 RB_Val_Wu16 65535.00 OneToOne 0.00 65535.00 FORMAT "%8.2" /end CHARACTERISTIC
/begin CHARACTERISTIC ElM_maskIsoMonSwtReqPlausVldSq_C "Calibration mask for Insulation Monitoring Acknowledge Switch signal quality" VALUE 0x8025064A RB_Val_Wu16 65535.00 OneToOne 0.00 65535.00 FORMAT "%8.2" /end CHARACTERISTIC
/begin CHARACTERISTIC ElM_stActvDchaCmpl_C "Calibration for Active discharge response completed" VALUE 0x8025064C RB_Val_Wu8 255.0 OneToOne 0.00 255.0 FORMAT "%5.1" /end CHARACTERISTIC
/begin CHARACTERISTIC ElM_stActvDchaInProgs_C "Calibration for Active discharge response in progress" VALUE 0x8025064D RB_Val_Wu8 255.0 OneToOne 0.00 255.0 FORMAT "%5.1" /end CHARACTERISTIC
/begin CHARACTERISTIC ElM_stActvDchaNotActv_C "Calibration for Active discharge response not active" VALUE 0x8025064E RB_Val_Wu8 255.0 OneToOne 0.00 255.0 FORMAT "%5.1" /end CHARACTERISTIC
/begin CHARACTERISTIC ElM_stIsoMonSwtFlt_C "Calibration for insulation monitoring switch status" VALUE 0x8025064F RB_Val_Wu8 255.0 OneToOne 0.00 255.0 FORMAT "%5.1" /end CHARACTERISTIC
/begin CHARACTERISTIC Emac_EngGen01_I.ElM_maskComEmacInvldSq_C "Class for supply of e-machine values, e-machine 01 / Mask to select the bits that correspond to signal quality of Init, Notcalc, Replacement and Invalid for e-machine" VALUE 0x80250494 RB_Val_Wu16 65535.00 OneToOne 0.00 65535.00 FORMAT "%8.2" /end CHARACTERISTIC
/begin CHARACTERISTIC Emac_EngGen01_I.ElM_nrSmplAvrgFlt_C "Class for supply of e-machine values, e-machine 01 / Number of samples of moving average filter of e-machine-speed" VALUE 0x80250496 RB_Val_Wu8 19.00 OneToOne 1.00 20.00 FORMAT "%5.2" EXTENDED_LIMITS 0.00 255.0 /end CHARACTERISTIC
/begin CHARACTERISTIC Emac_EngGen01_I.ElM_pwrActDft_C "Class for supply of e-machine values, e-machine 01 / Default value in case of ComEmac_uDcLnk or ComEmac_iDcLnk is Invalid" VALUE 0x80250498 RB_Val_Ws16 1048560. leist_q16_W -524288.0 524272.0 FORMAT "%8.1" /end CHARACTERISTIC
/begin CHARACTERISTIC Emac_EngGen01_I.ElM_pwrActMeclDft_C "Class for supply of e-machine values, e-machine 01 / Default value in case of ComEmac_nAct or ComEmac_tqAct is Invalid." VALUE 0x8025049A RB_Val_Ws16 1048560. leist_q16_W -524288.0 524272.0 FORMAT "%8.1" /end CHARACTERISTIC
/begin CHARACTERISTIC Emac_EngGen01_I.ElM_pwrLossAbsltDft_C "Class for supply of e-machine values, e-machine 01 / Default value in case of ComEmac_uDcLnk or ComEmac_iDcLnk or ComEmac_nAct or ComEmac_tqAct is Invalid" VALUE 0x8025049C RB_Val_Ws16 1048560. leist_q16_W -524288.0 524272.0 FORMAT "%8.1" /end CHARACTERISTIC
/begin CHARACTERISTIC Emac_EngGen01_I.ElM_rPrdcTActRtr_C "Class for supply of e-machine values, e-machine 01 / Prediction current rotor temperature" VALUE 0x8025049E RB_Val_Ws16 2.000031 PSC_Fact -1.000031 1.000000 FORMAT "%8.6" /end CHARACTERISTIC
/begin CHARACTERISTIC Emac_EngGen01_I.ElM_rPrdcTActSttr_C "Class for supply of e-machine values, e-machine 01 / Ratio prediction current stator temperature" VALUE 0x802504A0 RB_Val_Ws16 2.000031 PSC_Fact -1.000031 1.000000 FORMAT "%8.6" /end CHARACTERISTIC
/begin CHARACTERISTIC Emac_EngGen01_I.ElM_rRelTActInv_CUR "Class for supply of e-machine values, e-machine 01 / Ratio relativ current inverter temperature" CURVE 0x802504A2 RB_Curve_S16_S16 2.000031 PSC_Fact -1.000031 1.000000 FORMAT "%8.6"
 /begin AXIS_DESCR STD_AXIS Emac_EngGen01_I.ComEmac_tInvr Temp_Cels 8 -3549.940 3003.560 FORMAT "%8.3" DEPOSIT ABSOLUTE /end AXIS_DESCR
/end CHARACTERISTIC
/begin CHARACTERISTIC Emac_EngGen01_I.ElM_rRelTActRtr_CUR "Class for supply of e-machine values, e-machine 01 / Ratio relative current rotor temperature" CURVE 0x802504C4 RB_Curve_S16_S16 2.000031 PSC_Fact -1.000031 1.000000 FORMAT "%8.6"
 /begin AXIS_DESCR STD_AXIS Emac_EngGen01_I.ComEmac_tRtr Temp_Cels 8 -3549.940 3003.560 FORMAT "%8.3" DEPOSIT ABSOLUTE /end AXIS_DESCR
/end CHARACTERISTIC
/begin CHARACTERISTIC Emac_EngGen01_I.ElM_rRelTActSttr_CUR "Class for supply of e-machine values, e-machine 01 / Ratio relative current stator temperature" CURVE 0x802504E6 RB_Curve_S16_S16 2.000031 PSC_Fact -1.000031 1.000000 FORMAT "%8.6"
 /begin AXIS_DESCR STD_AXIS Emac_EngGen01_I.ComEmac_tMac Temp_Cels 8 -3549.940 3003.560 FORMAT "%8.3" DEPOSIT ABSOLUTE /end AXIS_DESCR
/end CHARACTERISTIC
/begin CHARACTERISTIC Emac_EngGen01_I.ElM_stDstCActvApp_C "Class for supply of e-machine values, e-machine 01 / disturbance control active" VALUE 0x80250508 RB_Val_Wboolean 1.00000000000 B_TRUE 0.00 1.00000000000 FORMAT "%13.11" /end CHARACTERISTIC
/begin CHARACTERISTIC Emac_EngGen01_I.ElM_stTrqWoAntiRuckelApp_C "Class for supply of e-machine values, e-machine 01 / Switch for machine with or without disturbance control" VALUE 0x80250509 RB_Val_Wboolean 1.00000000000 B_TRUE 0.00 1.00000000000 FORMAT "%13.11" /end CHARACTERISTIC
/begin CHARACTERISTIC Emac_EngGen01_I.ElM_swtEffMapVal_C "Class for supply of e-machine values, e-machine 01 / Select map or value for efficiency of e-machine." VALUE 0x8025050A RB_Val_Wboolean 1.00000000000 B_TRUE 0.00 1.00000000000 FORMAT "%13.11" /end CHARACTERISTIC
/begin CHARACTERISTIC Emac_EngGen01_I.ElM_tDft_C "Class for supply of e-machine values, e-machine 01 / Default value in case of ComEmac_tMac or ComEmac_tRtr is Invalid" VALUE 0x8025050C RB_Val_Ws16 6553.500 Temp_Cels -3549.940 3003.560 FORMAT "%8.3" /end CHARACTERISTIC
/begin CHARACTERISTIC Emac_EngGen01_I.ElM_tLimnTqDft_C "Class for supply of e-machine values, e-machine 01 / Default value in case of ComEmac_tMac or ComEmac_tRtr or ComEmac_tIvtrCoolt or ComEmac_tInvr is Invalid" VALUE 0x8025050E RB_Val_Ws16 6553.500 Temp_Cels -3549.940 3003.560 FORMAT "%8.3" /end CHARACTERISTIC
/begin CHARACTERISTIC Emac_EngGen01_I.ElM_tiNActPhyFlt_C "Class for supply of e-machine values, e-machine 01 / PT2 filter time constant for e-machine-speed" VALUE 0x80250510 RB_Val_Ws32 4294.9672940000000 TimeDelay_s 0.0000020000000 4294.9672959999998 FORMAT "%19.14" EXTENDED_LIMITS 0.000002000000001 4294.9672959999998 /end CHARACTERISTIC
/begin CHARACTERISTIC Emac_EngGen01_I.Elm_flgInvrMotGenrTqLim_C "Class for supply of e-machine values, e-machine 01 / Calibration to select Type 2 Inverter limits that provides generator-limit (value = 0 Nm) and motor-limit (value = 0 Nm). If set to 0, then Type 1 inverter limits that provides Min-limit (value always = 0 Nm) and Max-limit (value always = 0 Nm is selected" VALUE 0x80250514 RB_Val_Wboolean 1.00000000000 B_TRUE 0.00 1.00000000000 FORMAT "%13.11" /end CHARACTERISTIC
/begin CHARACTERISTIC Emac_EngGen01_I.Emac_facEff_C "Class for supply of e-machine values, e-machine 01 / Efficiency of e-machine" VALUE 0x80250516 RB_Val_Ws16 2.000031 PSC_Fact -1.000031 1.000000 FORMAT "%8.6" /end CHARACTERISTIC
/begin CHARACTERISTIC Emac_EngGen01_I.Emac_facEff_M "Class for supply of e-machine values, e-machine 01 / Efficiency map of e-machine based on speed and torque." MAP 0x80250518 RB_Map_S16S16_S16 2.000031 PSC_Fact -1.000031 1.000000 FORMAT "%8.6"
 /begin AXIS_DESCR STD_AXIS Emac_EngGen01_I.Emac_nAct nmot_q1 8 -32768.00 32767.00 FORMAT "%8.2" DEPOSIT ABSOLUTE /end AXIS_DESCR
 /begin AXIS_DESCR STD_AXIS Emac_EngGen01_I.Emac_tqAct Trq 15 -3276.800 3276.700 FORMAT "%8.3" DEPOSIT ABSOLUTE /end AXIS_DESCR
/end CHARACTERISTIC
/begin CHARACTERISTIC Emac_EngGen01_I.Emac_tqAbsltMaxDft_C "Class for supply of e-machine values, e-machine 01 / Default value in case of ComEmac_tqAbsltMax or ComEmac_tqAbsltMin is Invalid." VALUE 0x8025063A RB_Val_Ws16 6553.500 Trq -3276.800 3276.700 FORMAT "%8.3" /end CHARACTERISTIC
/begin CHARACTERISTIC Emac_EngGen01_I.Emac_tqAbsltMinDft_C "Class for supply of e-machine values, e-machine 01 / Default value in case of ComEmac_tqAbsltMax or ComEmac_tqAbsltMin is Invalid." VALUE 0x8025063C RB_Val_Ws16 6553.500 Trq -3276.800 3276.700 FORMAT "%8.3" /end CHARACTERISTIC
/begin CHARACTERISTIC Emac_EngGen01_I.ElM_IvtrTqAbsltLimStM_I.tiIvtrTqLimDeb_C "Class for supply of e-machine values, e-machine 01 / State machine instance see ElM_IvtrTqAbsltLimStM / debounce time for the tranision from StandyBy to Operation (SpdCtl or TrqCtl or Offset Angle Calibration)" VALUE 0x80250644 RB_Val_Ws32 4294.96729500 Time_Dt -2147.48364800 2147.48364700 FORMAT "%13.8" /end CHARACTERISTIC
/begin MEASUREMENT ChgrPlug_flgPxpAndCtpDetn "Status flag for control pilot line wake up signal" UBYTE B_TRUE 1 100 0.00 1.00000000000 BIT_MASK 0x1 FORMAT "%13.11" ECU_ADDRESS 0x600234DF
 /begin IF_DATA XCPplus 0x0102
  /begin DAQ_EVENT VARIABLE /end DAQ_EVENT
 /end IF_DATA
/end MEASUREMENT
/begin MEASUREMENT ChgrPlug_flgPxpAndCtpDetnPls "Status flag for control pilot line pulse" UBYTE B_TRUE 1 100 0.00 1.00000000000 BIT_MASK 0x1 FORMAT "%13.11" ECU_ADDRESS 0x600234DE
 /begin IF_DATA XCPplus 0x0102
  /begin DAQ_EVENT VARIABLE /end DAQ_EVENT
 /end IF_DATA
/end MEASUREMENT
/begin MEASUREMENT ChgrPlug_flgPxpDetn "Status flag for proximity pilot line wake up signal" UBYTE B_TRUE 1 100 0.00 1.00000000000 BIT_MASK 0x1 FORMAT "%13.11" ECU_ADDRESS 0x600234DD
 /begin IF_DATA XCPplus 0x0102
  /begin DAQ_EVENT VARIABLE /end DAQ_EVENT
 /end IF_DATA
/end MEASUREMENT
/begin MEASUREMENT ChgrPlug_flgPxpDetnPls "Status flag for proximity pilot line pulse" UBYTE B_TRUE 1 100 0.00 1.00000000000 BIT_MASK 0x1 FORMAT "%13.11" ECU_ADDRESS 0x600234DC
 /begin IF_DATA XCPplus 0x0102
  /begin DAQ_EVENT VARIABLE /end DAQ_EVENT
 /end IF_DATA
/end MEASUREMENT
/begin MEASUREMENT DDRC_St.DFC_DrvStbltOpn "" ULONG DFC_OneToOne 1 100 0.00 536870911.000 BIT_MASK 0x1fffffff FORMAT "%13.3" ECU_ADDRESS 0x6001C37C /end MEASUREMENT
/begin MEASUREMENT DDRC_St.DFC_EbsLvBattSocDiagLo "" ULONG DFC_OneToOne 1 100 0.00 536870911.000 BIT_MASK 0x1fffffff FORMAT "%13.3" ECU_ADDRESS 0x6001C388 /end MEASUREMENT
/begin MEASUREMENT DDRC_St.DFC_EbsLvBattUDiagDiOper "" ULONG DFC_OneToOne 1 100 0.00 536870911.000 BIT_MASK 0x1fffffff FORMAT "%13.3" ECU_ADDRESS 0x6001C38C /end MEASUREMENT
/begin MEASUREMENT DDRC_St.DFC_EbsLvBattUDiagFltLvl1 "" ULONG DFC_OneToOne 1 100 0.00 536870911.000 BIT_MASK 0x1fffffff FORMAT "%13.3" ECU_ADDRESS 0x6001C390 /end MEASUREMENT
/begin MEASUREMENT DDRC_St.DFC_EbsLvBattUDiagFltLvl2 "" ULONG DFC_OneToOne 1 100 0.00 536870911.000 BIT_MASK 0x1fffffff FORMAT "%13.3" ECU_ADDRESS 0x6001C394 /end MEASUREMENT
/begin MEASUREMENT DDRC_St.DFC_EbsLvBattUDiagLo "" ULONG DFC_OneToOne 1 100 0.00 536870911.000 BIT_MASK 0x1fffffff FORMAT "%13.3" ECU_ADDRESS 0x6001C398 /end MEASUREMENT
/begin MEASUREMENT DDRC_St.DFC_EbsSnsrSt "" ULONG DFC_OneToOne 1 100 0.00 536870911.000 BIT_MASK 0x1fffffff FORMAT "%13.3" ECU_ADDRESS 0x6001C39C /end MEASUREMENT
/begin MEASUREMENT DDRC_St.DFC_EbsSofASILErr "" ULONG DFC_OneToOne 1 100 0.00 536870911.000 BIT_MASK 0x1fffffff FORMAT "%13.3" ECU_ADDRESS 0x6001C3A0 /end MEASUREMENT
/begin MEASUREMENT DDRC_St.DFC_ElMActvDchaFailr "" UWORD DFC_OneToOne 1 100 0.00 8191.000 BIT_MASK 0x1fff FORMAT "%8.3" ECU_ADDRESS 0x60022008 /end MEASUREMENT
/begin MEASUREMENT DDRC_St.DFC_ElMFbdnIvtrModDrv01 "" UWORD DFC_OneToOne 1 100 0.00 8191.000 BIT_MASK 0x1fff FORMAT "%8.3" ECU_ADDRESS 0x6002200C /end MEASUREMENT
/begin MEASUREMENT DDRC_St.DFC_ElMIsoMonPlausyFlt "" UWORD DFC_OneToOne 1 100 0.00 8191.000 BIT_MASK 0x1fff FORMAT "%8.3" ECU_ADDRESS 0x60022012 /end MEASUREMENT
/begin MEASUREMENT DDRC_St.DFC_ElMOverSpdNeg01 "" UWORD DFC_OneToOne 1 100 0.00 8191.000 BIT_MASK 0x1fff FORMAT "%8.3" ECU_ADDRESS 0x6002201E /end MEASUREMENT
/begin MEASUREMENT DDRC_St.DFC_ElMOverSpdPos01 "" UWORD DFC_OneToOne 1 100 0.00 8191.000 BIT_MASK 0x1fff FORMAT "%8.3" ECU_ADDRESS 0x60022020 /end MEASUREMENT
/begin MEASUREMENT DDRC_St.DFC_ElMOverTqNeg01 "" UWORD DFC_OneToOne 1 100 0.00 8191.000 BIT_MASK 0x1fff FORMAT "%8.3" ECU_ADDRESS 0x60022022 /end MEASUREMENT
/begin MEASUREMENT DDRC_St.DFC_ElMOverTqPos01 "" UWORD DFC_OneToOne 1 100 0.00 8191.000 BIT_MASK 0x1fff FORMAT "%8.3" ECU_ADDRESS 0x60022024 /end MEASUREMENT
/begin MEASUREMENT Dem_BswErrorBufferWriteCounter "Write access counter" UWORD OneToOne 1 100 0.00 65535.00 FORMAT "%8.2" ECU_ADDRESS 0x700030D0 /end MEASUREMENT
/begin MEASUREMENT Dem_BswErrorBufferWriteIndex "Write index for pre init buffer" UWORD OneToOne 1 100 0.00 65535.00 FORMAT "%8.2" ECU_ADDRESS 0x700030D2 /end MEASUREMENT
/begin MEASUREMENT Dem_PTOSt "Current PTO active status reported to Dem" UBYTE OneToOne 1 100 0.00 255.0 BIT_MASK 0x1 FORMAT "%5.1" ECU_ADDRESS 0x700041AC /end MEASUREMENT
/begin MEASUREMENT Dem_stInit "Initialization state of Dem" UBYTE OneToOne 1 100 0.00 255.0 FORMAT "%5.1" ECU_ADDRESS 0x700041CB /end MEASUREMENT
/begin MEASUREMENT DFC_idxDfcTrans "Index of Dfc that is last processed during transition" UWORD OneToOne 1 100 0.00 65535.00 FORMAT "%8.2" MATRIX_DIM 1 ECU_ADDRESS 0x60021BEC /end MEASUREMENT
/begin MEASUREMENT DFC_st.DFC_DrvStbltOpn "" UBYTE DFC_OneToOne 1 100 0.00 255.0 FORMAT "%5.1" ECU_ADDRESS 0x60034A42 /end MEASUREMENT
/begin MEASUREMENT DFC_st.DFC_EbsLvBattSocDiagLo "" UBYTE DFC_OneToOne 1 100 0.00 255.0 FORMAT "%5.1" ECU_ADDRESS 0x60034A45 /end MEASUREMENT
/begin MEASUREMENT DFC_st.DFC_EbsLvBattUDiagDiOper "" UBYTE DFC_OneToOne 1 100 0.00 255.0 FORMAT "%5.1" ECU_ADDRESS 0x60034A46 /end MEASUREMENT
/begin MEASUREMENT DFC_st.DFC_EbsLvBattUDiagFltLvl1 "" UBYTE DFC_OneToOne 1 100 0.00 255.0 FORMAT "%5.1" ECU_ADDRESS 0x60034A47 /end MEASUREMENT
/begin MEASUREMENT DFC_st.DFC_EbsLvBattUDiagFltLvl2 "" UBYTE DFC_OneToOne 1 100 0.00 255.0 FORMAT "%5.1" ECU_ADDRESS 0x60034A48 /end MEASUREMENT
/begin MEASUREMENT DFC_st.DFC_EbsLvBattUDiagLo "" UBYTE DFC_OneToOne 1 100 0.00 255.0 FORMAT "%5.1" ECU_ADDRESS 0x60034A49 /end MEASUREMENT
/begin MEASUREMENT DFC_st.DFC_EbsSnsrSt "" UBYTE DFC_OneToOne 1 100 0.00 255.0 FORMAT "%5.1" ECU_ADDRESS 0x60034A4A /end MEASUREMENT
/begin MEASUREMENT DFC_st.DFC_EbsSofASILErr "" UBYTE DFC_OneToOne 1 100 0.00 255.0 FORMAT "%5.1" ECU_ADDRESS 0x60034A4B /end MEASUREMENT
/begin MEASUREMENT DFC_st.DFC_ElMActvDchaFailr "" UBYTE DFC_OneToOne 1 100 0.00 255.0 FORMAT "%5.1" ECU_ADDRESS 0x60034C5B /end MEASUREMENT
/begin MEASUREMENT DFC_st.DFC_ElMFbdnIvtrModDrv01 "" UBYTE DFC_OneToOne 1 100 0.00 255.0 FORMAT "%5.1" ECU_ADDRESS 0x60034C5D /end MEASUREMENT
/begin MEASUREMENT DFC_st.DFC_ElMIsoMonPlausyFlt "" UBYTE DFC_OneToOne 1 100 0.00 255.0 FORMAT "%5.1" ECU_ADDRESS 0x60034C60 /end MEASUREMENT
/begin MEASUREMENT DFC_st.DFC_ElMOverSpdNeg01 "" UBYTE DFC_OneToOne 1 100 0.00 255.0 FORMAT "%5.1" ECU_ADDRESS 0x60034C66 /end MEASUREMENT
/begin MEASUREMENT DFC_st.DFC_ElMOverSpdPos01 "" UBYTE DFC_OneToOne 1 100 0.00 255.0 FORMAT "%5.1" ECU_ADDRESS 0x60034C67 /end MEASUREMENT
/begin MEASUREMENT DFC_st.DFC_ElMOverTqNeg01 "" UBYTE DFC_OneToOne 1 100 0.00 255.0 FORMAT "%5.1" ECU_ADDRESS 0x60034C68 /end MEASUREMENT
/begin MEASUREMENT DFC_st.DFC_ElMOverTqPos01 "" UBYTE DFC_OneToOne 1 100 0.00 255.0 FORMAT "%5.1" ECU_ADDRESS 0x60034C69 /end MEASUREMENT
/begin MEASUREMENT DFC_st.DFC_EemDcdcPrecSpdInhb "" UBYTE DFC_OneToOne 1 100 0.00 255.0 FORMAT "%5.1" ECU_ADDRESS 0x60034C7C /end MEASUREMENT
/begin MEASUREMENT DFC_st.DFC_EChrDvPlinCntrThdExcdd "" UBYTE DFC_OneToOne 1 100 0.00 255.0 FORMAT "%5.1" ECU_ADDRESS 0x60034CD0 /end MEASUREMENT
/begin MEASUREMENT DFC_st.DFC_EemDiagCtctrClsTout "" UBYTE DFC_OneToOne 1 100 0.00 255.0 FORMAT "%5.1" ECU_ADDRESS 0x60034CD1 /end MEASUREMENT
/begin MEASUREMENT DFC_st.DFC_EemDiagDcdcOffTOut "" UBYTE DFC_OneToOne 1 100 0.00 255.0 FORMAT "%5.1" ECU_ADDRESS 0x60034CD2 /end MEASUREMENT
/begin MEASUREMENT DFC_st.DFC_EemDiagHvCnsrOffTOut "" UBYTE DFC_OneToOne 1 100 0.00 255.0 FORMAT "%5.1" ECU_ADDRESS 0x60034CD3 /end MEASUREMENT
/begin MEASUREMENT DFC_st.DFC_EemDiagHvbOffTOut "" UBYTE DFC_OneToOne 1 100 0.00 255.0 FORMAT "%5.1" ECU_ADDRESS 0x60034CD4 /end MEASUREMENT
/begin MEASUREMENT DFC_st.DFC_SWReset_0 "" UBYTE DFC_OneToOne 1 100 0.00 255.0 FORMAT "%5.1" ECU_ADDRESS 0x60034D85 /end MEASUREMENT
/begin MEASUREMENT DFC_st.DFC_SWReset_1 "" UBYTE DFC_OneToOne 1 100 0.00 255.0 FORMAT "%5.1" ECU_ADDRESS 0x60034D86 /end MEASUREMENT
/begin MEASUREMENT DFC_st.DFC_SWReset_2 "" UBYTE DFC_OneToOne 1 100 0.00 255.0 FORMAT "%5.1" ECU_ADDRESS 0x60034D87 /end MEASUREMENT
/begin MEASUREMENT DINH_nrActvInhReas.FId_DSMAUXWucVrnt5 "" UWORD DINH_ct_Compu 1 100 -4095.000 4096.000 BIT_MASK 0x1fff FORMAT "%8.3" ECU_ADDRESS 0x60021408 /end MEASUREMENT
/begin MEASUREMENT DINH_nrActvInhReas.FId_DrvStbltCANSigFault "" UWORD DINH_ct_Compu 1 100 -4095.000 4096.000 BIT_MASK 0x1fff FORMAT "%8.3" ECU_ADDRESS 0x60021434 /end MEASUREMENT
/begin MEASUREMENT DINH_nrActvInhReas.FId_EbsLinErr "" UWORD DINH_ct_Compu 1 100 -4095.000 4096.000 BIT_MASK 0x1fff FORMAT "%8.3" ECU_ADDRESS 0x6002143C /end MEASUREMENT
/begin MEASUREMENT DINH_nrActvInhReas.FId_EemDcdcPrecErr "" UWORD DINH_ct_Compu 1 100 -4095.000 4096.000 BIT_MASK 0x1fff FORMAT "%8.3" ECU_ADDRESS 0x6002143E /end MEASUREMENT
/begin MEASUREMENT DINH_nrActvInhReas.FId_EemDcdcUHVAct "" UWORD DINH_ct_Compu 1 100 -4095.000 4096.000 BIT_MASK 0x1fff FORMAT "%8.3" ECU_ADDRESS 0x60021440 /end MEASUREMENT
/begin MEASUREMENT DINH_nrActvInhReas.FId_EemFltHvDcha "" UWORD DINH_ct_Compu 1 100 -4095.000 4096.000 BIT_MASK 0x1fff FORMAT "%8.3" ECU_ADDRESS 0x60021442 /end MEASUREMENT
/begin MEASUREMENT DINH_nrActvInhReas.FId_EemFstHvShdwn "" UWORD DINH_ct_Compu 1 100 -4095.000 4096.000 BIT_MASK 0x1fff FORMAT "%8.3" ECU_ADDRESS 0x60021444 /end MEASUREMENT
/begin MEASUREMENT DINH_nrActvInhReas.FId_EemHvBattMod "" UWORD DINH_ct_Compu 1 100 -4095.000 4096.000 BIT_MASK 0x1fff FORMAT "%8.3" ECU_ADDRESS 0x60021446 /end MEASUREMENT
/begin MEASUREMENT DINH_nrActvInhReas.FId_EemHvOffTout "" UWORD DINH_ct_Compu 1 100 -4095.000 4096.000 BIT_MASK 0x1fff FORMAT "%8.3" ECU_ADDRESS 0x60021448 /end MEASUREMENT
/begin MEASUREMENT DINH_nrActvInhReas.FId_EemHvShdwn "" UWORD DINH_ct_Compu 1 100 -4095.000 4096.000 BIT_MASK 0x1fff FORMAT "%8.3" ECU_ADDRESS 0x6002144A /end MEASUREMENT
/begin MEASUREMENT DINH_nrActvInhReas.FId_EemNoHvStrtup "" UWORD DINH_ct_Compu 1 100 -4095.000 4096.000 BIT_MASK 0x1fff FORMAT "%8.3" ECU_ADDRESS 0x6002144C /end MEASUREMENT
/begin MEASUREMENT DINH_nrActvInhReas.FId_ElMnLim01 "" UWORD DINH_ct_Compu 1 100 -4095.000 4096.000 BIT_MASK 0x1fff FORMAT "%8.3" ECU_ADDRESS 0x60021450 /end MEASUREMENT
/begin MEASUREMENT DINH_nrActvInhReas.FId_EmacUDcLnk01 "" UWORD DINH_ct_Compu 1 100 -4095.000 4096.000 BIT_MASK 0x1fff FORMAT "%8.3" ECU_ADDRESS 0x60021466 /end MEASUREMENT
/begin MEASUREMENT DINH_stFId.FId_DSMAUXWucVrnt5 "" UWORD DFC_OneToOne 1 100 0.00 65535.00 FORMAT "%8.2" ECU_ADDRESS 0x60021408 /end MEASUREMENT
/begin MEASUREMENT DINH_stFId.FId_DrvStbltCANSigFault "" UWORD DFC_OneToOne 1 100 0.00 65535.00 FORMAT "%8.2" ECU_ADDRESS 0x60021434 /end MEASUREMENT
/begin MEASUREMENT DINH_stFId.FId_EbsLinErr "" UWORD DFC_OneToOne 1 100 0.00 65535.00 FORMAT "%8.2" ECU_ADDRESS 0x6002143C /end MEASUREMENT
/begin MEASUREMENT DINH_stFId.FId_EemDcdcPrecErr "" UWORD DFC_OneToOne 1 100 0.00 65535.00 FORMAT "%8.2" ECU_ADDRESS 0x6002143E /end MEASUREMENT
/begin MEASUREMENT DINH_stFId.FId_EemDcdcUHVAct "" UWORD DFC_OneToOne 1 100 0.00 65535.00 FORMAT "%8.2" ECU_ADDRESS 0x60021440 /end MEASUREMENT
/begin MEASUREMENT DINH_stFId.FId_EemFltHvDcha "" UWORD DFC_OneToOne 1 100 0.00 65535.00 FORMAT "%8.2" ECU_ADDRESS 0x60021442 /end MEASUREMENT
/begin MEASUREMENT DINH_stFId.FId_EemFstHvShdwn "" UWORD DFC_OneToOne 1 100 0.00 65535.00 FORMAT "%8.2" ECU_ADDRESS 0x60021444 /end MEASUREMENT
/begin MEASUREMENT DINH_stFId.FId_EemHvBattMod "" UWORD DFC_OneToOne 1 100 0.00 65535.00 FORMAT "%8.2" ECU_ADDRESS 0x60021446 /end MEASUREMENT
/begin MEASUREMENT DINH_stFId.FId_EemHvOffTout "" UWORD DFC_OneToOne 1 100 0.00 65535.00 FORMAT "%8.2" ECU_ADDRESS 0x60021448 /end MEASUREMENT
/begin MEASUREMENT DINH_stFId.FId_EemHvShdwn "" UWORD DFC_OneToOne 1 100 0.00 65535.00 FORMAT "%8.2" ECU_ADDRESS 0x6002144A /end MEASUREMENT
/begin MEASUREMENT DINH_stFId.FId_EemNoHvStrtup "" UWORD DFC_OneToOne 1 100 0.00 65535.00 FORMAT "%8.2" ECU_ADDRESS 0x6002144C /end MEASUREMENT
/begin MEASUREMENT DINH_stFId.FId_ElMnLim01 "" UWORD DFC_OneToOne 1 100 0.00 65535.00 FORMAT "%8.2" ECU_ADDRESS 0x60021450 /end MEASUREMENT
/begin MEASUREMENT DINH_stFId.FId_EmacUDcLnk01 "" UWORD DFC_OneToOne 1 100 0.00 65535.00 FORMAT "%8.2" ECU_ADDRESS 0x60021466 /end MEASUREMENT
/begin MEASUREMENT DrvStblt_bFault "Status to indicate fault, if error in driver seat belt CAN signal" UBYTE OneToOne 1 100 0.00 1.000 BIT_MASK 0x1 FORMAT "%5.3" ECU_ADDRESS 0x6002388E
 /begin IF_DATA XCPplus 0x0102
  /begin DAQ_EVENT VARIABLE /end DAQ_EVENT
 /end IF_DATA
/end MEASUREMENT
/begin MEASUREMENT DrvStblt_bOpn "Status if driver seat belt buckle open" UBYTE OneToOne 1 100 0.00 1.000 BIT_MASK 0x1 FORMAT "%5.3" ECU_ADDRESS 0x6002388D
 /begin IF_DATA XCPplus 0x0102
  /begin DAQ_EVENT VARIABLE /end DAQ_EVENT
 /end IF_DATA
/end MEASUREMENT
/begin MEASUREMENT DrvStblt_bOpnLoc "Intermediate message for status of driverseat belt open" UBYTE OneToOne 1 100 0.00 1.000 BIT_MASK 0x1 FORMAT "%5.3" ECU_ADDRESS 0x6002388C
 /begin IF_DATA XCPplus 0x0102
  /begin DAQ_EVENT VARIABLE /end DAQ_EVENT
 /end IF_DATA
/end MEASUREMENT
/begin MEASUREMENT DSMAUX_altWucCond "variable to detec the alternative warm up cycle detection condition" UBYTE OneToOne 1 100 0.00 255.0 FORMAT "%5.1" ECU_ADDRESS 0x6003406A /end MEASUREMENT
/begin MEASUREMENT DSMAUX_ctObdDCy "Number of OBD driving cycle since diagnostic trouble codes cleared" UWORD OneToOne 1 100 0.00 65535.00 FORMAT "%8.2" ECU_ADDRESS 0x60035E58 /end MEASUREMENT
/begin MEASUREMENT DSMAUX_ctObdDCy_msg "Number of OBD driving cycle since diagnostic trouble codes cleared" UWORD OneToOne 1 100 0.00 65535.00 FORMAT "%8.2" ECU_ADDRESS 0x6001F9BC
 /begin IF_DATA XCPplus 0x0102
  /begin DAQ_EVENT VARIABLE /end DAQ_EVENT
 /end IF_DATA
/end MEASUREMENT
/begin MEASUREMENT DSMAUX_ctWUC "Number of warm-ups since diagnostic trouble codes cleared" UBYTE OneToOne 1 100 0.00 255.0 FORMAT "%5.1" ECU_ADDRESS 0x6003494E /end MEASUREMENT
/begin MEASUREMENT DSMAUX_ctWUC_msg "Number of warm-ups since diagnostic trouble codes cleared" UBYTE OneToOne 1 100 0.00 255.0 FORMAT "%5.1" ECU_ADDRESS 0x60023450
 /begin IF_DATA XCPplus 0x0102
  /begin DAQ_EVENT VARIABLE /end DAQ_EVENT
 /end IF_DATA
/end MEASUREMENT
/begin MEASUREMENT DSMAUX_DTRG.DTRG_Time200ms "" UBYTE DFC_OneToOne 1 100 0.00 255.0 FORMAT "%5.1" ECU_ADDRESS 0x60035DD2 /end MEASUREMENT
/begin MEASUREMENT DSMAUX_DTRG.DTRG_AlwaysTrue "" UBYTE DFC_OneToOne 1 100 0.00 255.0 FORMAT "%5.1" ECU_ADDRESS 0x60035DD3 /end MEASUREMENT
/begin MEASUREMENT DSMAUX_DTRG.DTRG_DrivingCycleFLC "" UBYTE DFC_OneToOne 1 100 0.00 255.0 FORMAT "%5.1" ECU_ADDRESS 0x60035DD4 /end MEASUREMENT
/begin MEASUREMENT DSMAUX_DTRG.DTRG_DrivingCycleHLC "" UBYTE DFC_OneToOne 1 100 0.00 255.0 FORMAT "%5.1" ECU_ADDRESS 0x60035DD5 /end MEASUREMENT
/begin MEASUREMENT DSMAUX_DTRG.DTRG_NoTrigger "" UBYTE DFC_OneToOne 1 100 0.00 255.0 FORMAT "%5.1" ECU_ADDRESS 0x60035DD6 /end MEASUREMENT
/begin MEASUREMENT DSMAUX_DTRG.DTRG_WarmUpCycle "" UBYTE DFC_OneToOne 1 100 0.00 255.0 FORMAT "%5.1" ECU_ADDRESS 0x60035DD7 /end MEASUREMENT
/begin MEASUREMENT DSMAUX_flgReiniTaskRunning "Flag indicates whether DSM reinit task is running" UBYTE OneToOne 1 100 0.00 255.0 BIT_MASK 0x1 FORMAT "%5.1" ECU_ADDRESS 0x6002498A
 /begin IF_DATA XCPplus 0x0102
  /begin DAQ_EVENT VARIABLE /end DAQ_EVENT
 /end IF_DATA
/end MEASUREMENT
/begin MEASUREMENT DSMAUX_stClrTaskFin "End flag for OS_DSM_Clear_Task run" UBYTE OneToOne 1 100 0.00 255.0 FORMAT "%5.1" ECU_ADDRESS 0x6002465D /end MEASUREMENT
/begin MEASUREMENT DSMAUX_stDCy "Status OBD driving cycle" UBYTE DSMAUX_stDCyVerb 1 100 0.00 3.00000000000 FORMAT "%13.11" ECU_ADDRESS 0x60035E56
 /begin IF_DATA XCPplus 0x0102
  /begin DAQ_EVENT VARIABLE /end DAQ_EVENT
 /end IF_DATA
/end MEASUREMENT
/begin MEASUREMENT DSMAUX_stDCy_msg "Status OBD driving cycle" UBYTE DSMAUX_stDCyVerb 1 100 0.00 3.00000000000 FORMAT "%13.11" ECU_ADDRESS 0x6002344F
 /begin IF_DATA XCPplus 0x0102
  /begin DAQ_EVENT VARIABLE /end DAQ_EVENT
 /end IF_DATA
/end MEASUREMENT
/begin MEASUREMENT DSMAUX_stDsmClrActv "Indicator of a running DSM clear procedure" UBYTE B_TRUE 1 100 0.00 1.00000000000 BIT_MASK 0x1 FORMAT "%13.11" ECU_ADDRESS 0x6002389D
 /begin IF_DATA XCPplus 0x0102
  /begin DAQ_EVENT VARIABLE /end DAQ_EVENT
 /end IF_DATA
/end MEASUREMENT
/begin MEASUREMENT DSMAUX_stStrtEnd "Condition normal engine operation was attained" UBYTE OneToOne 1 100 0.00 255.0 BIT_MASK 0x1 FORMAT "%5.1" ECU_ADDRESS 0x60024986 /end MEASUREMENT
/begin MEASUREMENT DSMAUX_stTranGlbJob "Current transition job" UBYTE OneToOne 1 100 0.00 255.0 FORMAT "%5.1" ECU_ADDRESS 0x6002465E
 /begin IF_DATA XCPplus 0x0102
  /begin DAQ_EVENT VARIABLE /end DAQ_EVENT
 /end IF_DATA
/end MEASUREMENT
/begin MEASUREMENT DSMAUX_stTranReq "Queue of transition request" UBYTE OneToOne 1 100 0.00 255.0 FORMAT "%5.1" MATRIX_DIM 3 ECU_ADDRESS 0x60034060 /end MEASUREMENT
/begin MEASUREMENT DSMAUX_tClntStrt "coolant temperature at start" SWORD Temp_Cels 1 100 -3549.940 3003.560 FORMAT "%8.3" ECU_ADDRESS 0x60022A5E /end MEASUREMENT
/begin MEASUREMENT DSMAUX_tiEngOpCum "cumulative time since engine start" UWORD DSMAUX_ti100ms 1 100 0.00 6553.500 FORMAT "%8.3" ECU_ADDRESS 0x60034066 /end MEASUREMENT
/begin MEASUREMENT DSMAUX_tiIdl "continuous vehicle operation at idle" UWORD DSMAUX_ti100ms 1 100 0.00 6553.500 FORMAT "%8.3" ECU_ADDRESS 0x60034064 /end MEASUREMENT
/begin MEASUREMENT DSMAUX_tiLastReini "Runtime duration of most recent DSM Reinit" ULONG OneToOne 1 100 0.00 4294967295.00 FORMAT "%13.2" ECU_ADDRESS 0x6001CAC8 /end MEASUREMENT
/begin MEASUREMENT DSMAUX_tiMaxReini "Maximum runtime duration recorded for DSM Reinit" ULONG OneToOne 1 100 0.00 4294967295.00 FORMAT "%13.2" ECU_ADDRESS 0x60035E5C /end MEASUREMENT
/begin MEASUREMENT DSMAUX_tiVehSpdCum "cumulative vehicle operation at or above 25 miles per hour" UWORD DSMAUX_ti100ms 1 100 0.00 6553.500 FORMAT "%8.3" ECU_ADDRESS 0x60034068 /end MEASUREMENT
/begin MEASUREMENT DSMDur_ctPID21h "counter for distance travelled while MIL is activated" ULONG DSMDUR_10m_Counter 1 100 0.00 42949672.9500 FORMAT "%13.4" ECU_ADDRESS 0x60034944 /end MEASUREMENT
/begin MEASUREMENT DSMDur_ctPID31h "counter for distance since diagnostic trouble codes cleared" ULONG DSMDUR_10m_Counter 1 100 0.00 42949672.9500 FORMAT "%13.4" ECU_ADDRESS 0x60034940 /end MEASUREMENT
/begin MEASUREMENT DSMDur_lRef10m "distance where next 10m increment will be counted" SLONG OneToOne 1 100 -2147483648.00 2147483647.00 FORMAT "%13.2" ECU_ADDRESS 0x6001CAD0 /end MEASUREMENT
/begin MEASUREMENT DSMDur_stPID21h "state of the counter for distance travelled while MIL is activated" UBYTE DSMDur_StDispl_Verb 1 100 0.00 2.00000000000 FORMAT "%13.11" ECU_ADDRESS 0x60035E60 /end MEASUREMENT
/begin MEASUREMENT DSMDur_stWUCLst "warm up cycle reached" UBYTE OneToOne 1 100 0.00 255.0 FORMAT "%5.1" ECU_ADDRESS 0x60034063 /end MEASUREMENT
/begin MEASUREMENT DSMRdy_stGrpRdy "Readiness calculation, ready status" UWORD DSMRdy_OneToOne 1 100 0.00 65535.00 FORMAT "%8.2" ECU_ADDRESS 0x60035E6C /end MEASUREMENT
/begin MEASUREMENT DSMRdy_stGrpRdyDFES "Readiness calculation, ready status from DFES status" UWORD DSMRdy_OneToOne 1 100 0.00 65535.00 FORMAT "%8.2" ECU_ADDRESS 0x60021BF0 /end MEASUREMENT
/begin MEASUREMENT DSMRdy_stGrpRdyScan "Readiness calculation, ready status from check scanning" UWORD DSMRdy_OneToOne 1 100 0.00 65535.00 FORMAT "%8.2" ECU_ADDRESS 0x60021BF2 /end MEASUREMENT
/begin MEASUREMENT DSMRdy_stGrpSup "Readiness calculation, supported status" UWORD DSMRdy_OneToOne 1 100 0.00 65535.00 FORMAT "%8.2" ECU_ADDRESS 0x60021BEE /end MEASUREMENT
/begin MEASUREMENT DSMRdy_xPId1 "Readiness calculation, result for PID01" ULONG DSMRdy_OneToOne 1 100 0.00 4294967295.00 FORMAT "%13.2" ECU_ADDRESS 0x600009C8 /end MEASUREMENT
/begin MEASUREMENT DSM_DisblMode_mp "Actual disable mode to prevent error memory entries (provided by DSM configuration)" UWORD OneToOne 1 100 0.00 65535.00 FORMAT "%8.2" ECU_ADDRESS 0x70006990 /end MEASUREMENT
/begin MEASUREMENT DSM_pEnv "DSM internal variable to store the copy of the Environment pressure" SWORD Pres_hPa 1 100 -32768.00 32767.00 FORMAT "%8.2" ECU_ADDRESS 0x60021BE6 /end MEASUREMENT
/begin MEASUREMENT DSM_rAPP "DSM internal variable to store the copy of the Standardized accelerator pedal position" SWORD Prc 1 100 -400.0000 399.9878 FORMAT "%8.4" ECU_ADDRESS 0x60021BEA /end MEASUREMENT
/begin MEASUREMENT DSM_stFadeOut "Conditions for suppressing fault code memory entries (bit coded)" UWORD OneToOne 1 100 0.00 65535.00 FORMAT "%8.2" ECU_ADDRESS 0x6001FC9E
 /begin IF_DATA XCPplus 0x0102
  /begin DAQ_EVENT VARIABLE /end DAQ_EVENT
 /end IF_DATA
/end MEASUREMENT
/begin MEASUREMENT DSM_stPostDrive "Status of DSM postdrive control" UBYTE OneToOne 1 100 0.00 255.0 FORMAT "%5.1" ECU_ADDRESS 0x6002465C
 /begin IF_DATA XCPplus 0x0102
  /begin DAQ_EVENT VARIABLE /end DAQ_EVENT
 /end IF_DATA
/end MEASUREMENT
/begin MEASUREMENT DSM_stReInit "Status of reinitialization in DSM after cancelled postdrive" UBYTE OneToOne 1 100 0.00 255.0 FORMAT "%5.1" ECU_ADDRESS 0x6002498B /end MEASUREMENT
/begin MEASUREMENT DSM_stStrEnd "OBD Ready for Driving status" UBYTE OneToOne 1 100 0.00 1.000 BIT_MASK 0x1 FORMAT "%5.3" ECU_ADDRESS 0x60024659 /end MEASUREMENT
/begin MEASUREMENT DSM_tEnv "DSM internal variable to store the copy of the Temperature of environment air" SWORD Temp_Cels 1 100 -3549.940 3003.560 FORMAT "%8.3" ECU_ADDRESS 0x60021BE4 /end MEASUREMENT
/begin MEASUREMENT DSM_TripChgAndClrFinshd "Message to indicate completion of clear triggered by DSM after initialization" UBYTE OneToOne 1 100 0.00 255.0 BIT_MASK 0x1 FORMAT "%5.1" ECU_ADDRESS 0x6002389B
 /begin IF_DATA XCPplus 0x0102
  /begin DAQ_EVENT VARIABLE /end DAQ_EVENT
 /end IF_DATA
/end MEASUREMENT
/begin MEASUREMENT DSM_TripChgFinshd "Trip change of DSM (Diagnostic System Management) finished" UBYTE OneToOne 1 100 0.00 255.0 BIT_MASK 0x1 FORMAT "%5.1" ECU_ADDRESS 0x6002389A
 /begin IF_DATA XCPplus 0x0102
  /begin DAQ_EVENT VARIABLE /end DAQ_EVENT
 /end IF_DATA
/end MEASUREMENT
/begin MEASUREMENT DSM_vVeh "DSM internal variable to store the copy of the Vehicle speed" SWORD Vel 1 100 -327.6800 327.6700 FORMAT "%8.4" ECU_ADDRESS 0x60021BE8 /end MEASUREMENT
/begin MEASUREMENT Ebs_flgRst "EBS after reset" UBYTE B_TRUE 1 100 0.00 1.00000000000 BIT_MASK 0x1 FORMAT "%13.11" ECU_ADDRESS 0x600234A3
 /begin IF_DATA XCPplus 0x0102
  /begin DAQ_EVENT VARIABLE /end DAQ_EVENT
 /end IF_DATA
/end MEASUREMENT
/begin MEASUREMENT Ebs_flgTestPlsReq "Test pulse request" UBYTE B_TRUE 1 100 0.00 1.00000000000 BIT_MASK 0x1 FORMAT "%13.11" ECU_ADDRESS 0x600234A2
 /begin IF_DATA XCPplus 0x0102
  /begin DAQ_EVENT VARIABLE /end DAQ_EVENT
 /end IF_DATA
/end MEASUREMENT
/begin MEASUREMENT Ebs_flgUSofAsilErr "Flag to indicate SOF ASIl voltage error" UBYTE B_TRUE 1 100 0.00 1.00000000000 BIT_MASK 0x1 FORMAT "%13.11" ECU_ADDRESS 0x60023163
 /begin IF_DATA XCPplus 0x0102
  /begin DAQ_EVENT VARIABLE /end DAQ_EVENT
 /end IF_DATA
/end MEASUREMENT
/begin MEASUREMENT Ebs_iBattFild "Sensor value battery current" SWORD Curr_A 1 100 -327.6800 327.6700 FORMAT "%8.4" ECU_ADDRESS 0x6001FB88
 /begin IF_DATA XCPplus 0x0102
  /begin DAQ_EVENT VARIABLE /end DAQ_EVENT
 /end IF_DATA
/end MEASUREMENT
/begin MEASUREMENT Ebs_iBattFild_Sq "signal quality of sensor value of battery current" UBYTE SigQly_COMPU_VERB 1 100 0.00 15.0000000000 FORMAT "%13.10" ECU_ADDRESS 0x600235B2
 /begin IF_DATA XCPplus 0x0102
  /begin DAQ_EVENT VARIABLE /end DAQ_EVENT
 /end IF_DATA
/end MEASUREMENT
/begin MEASUREMENT Ebs_qSohFild "Sensor value SOH (State of health)" SWORD ElecChrg_Ah_q0p125_COMPU 1 100 -4096.000 4095.875 FORMAT "%8.3" ECU_ADDRESS 0x6001FB86
 /begin IF_DATA XCPplus 0x0102
  /begin DAQ_EVENT VARIABLE /end DAQ_EVENT
 /end IF_DATA
/end MEASUREMENT
/begin MEASUREMENT Ebs_qSohFild_Sq "signal quality of the sensor value of soh(state of health) with respect to charge capacity" UBYTE SigQly_COMPU_VERB 1 100 0.00 15.0000000000 FORMAT "%13.10" ECU_ADDRESS 0x600235B1
 /begin IF_DATA XCPplus 0x0102
  /begin DAQ_EVENT VARIABLE /end DAQ_EVENT
 /end IF_DATA
/end MEASUREMENT
/begin MEASUREMENT Ebs_ratSocFild "Sensor value SOC (State of charge)" UBYTE rel_q1 1 100 0.00 255.0 FORMAT "%5.1" ECU_ADDRESS 0x600235B0
 /begin IF_DATA XCPplus 0x0102
  /begin DAQ_EVENT VARIABLE /end DAQ_EVENT
 /end IF_DATA
/end MEASUREMENT
/begin MEASUREMENT Ebs_ratSocFild_Sq "signal quality of the sensor value of SOC(state of charge)" UBYTE SigQly_COMPU_VERB 1 100 0.00 15.0000000000 FORMAT "%13.10" ECU_ADDRESS 0x600235AF
 /begin IF_DATA XCPplus 0x0102
  /begin DAQ_EVENT VARIABLE /end DAQ_EVENT
 /end IF_DATA
/end MEASUREMENT
/begin MEASUREMENT Ebs_ratSohFild "Sensor value SOH (State of health)" SWORD Prc 1 100 -400.0000 399.9878 FORMAT "%8.4" ECU_ADDRESS 0x6001FB84
 /begin IF_DATA XCPplus 0x0102
  /begin DAQ_EVENT VARIABLE /end DAQ_EVENT
 /end IF_DATA
/end MEASUREMENT
/begin MEASUREMENT Ebs_ratSohFild_Sq "signal quality of the ratio of sensor value of soh(state of health)" UBYTE SigQly_COMPU_VERB 1 100 0.00 15.0000000000 FORMAT "%13.10" ECU_ADDRESS 0x600235AE
 /begin IF_DATA XCPplus 0x0102
  /begin DAQ_EVENT VARIABLE /end DAQ_EVENT
 /end IF_DATA
/end MEASUREMENT
/begin MEASUREMENT Ebs_stDcdcULimReq "DCDC converter voltage limit request" UBYTE OneToOne 1 100 0.00 3.000 FORMAT "%5.3" ECU_ADDRESS 0x600235AD
 /begin IF_DATA XCPplus 0x0102
  /begin DAQ_EVENT VARIABLE /end DAQ_EVENT
 /end IF_DATA
/end MEASUREMENT
/begin MEASUREMENT Ebs_stDcdcULimReq_Sq "DCDC converter voltage limit request signal quality" UBYTE SigQly_COMPU_VERB 1 100 0.00 15.0000000000 FORMAT "%13.10" ECU_ADDRESS 0x600235AC
 /begin IF_DATA XCPplus 0x0102
  /begin DAQ_EVENT VARIABLE /end DAQ_EVENT
 /end IF_DATA
/end MEASUREMENT
/begin MEASUREMENT Ebs_stErr "Sensor values not valid (Initialisation, communication fault, measurement error)" UBYTE OneToOne 1 100 0.00 255.0 FORMAT "%5.1" ECU_ADDRESS 0x600235AB
 /begin IF_DATA XCPplus 0x0102
  /begin DAQ_EVENT VARIABLE /end DAQ_EVENT
 /end IF_DATA
/end MEASUREMENT
/begin MEASUREMENT Ebs_tBattFild "Temperature from battery sensor after modeling" SWORD SCR_TEMP_CELS_float 1 100 -32768.00 32767.00 FORMAT "%8.2" ECU_ADDRESS 0x6001FB82
 /begin IF_DATA XCPplus 0x0102
  /begin DAQ_EVENT VARIABLE /end DAQ_EVENT
 /end IF_DATA
/end MEASUREMENT
/begin MEASUREMENT Ebs_tBattFild_Sq "signal quality of temperature from battery sensor after modeling" UBYTE SigQly_COMPU_VERB 1 100 0.00 15.0000000000 FORMAT "%13.10" ECU_ADDRESS 0x600235AA
 /begin IF_DATA XCPplus 0x0102
  /begin DAQ_EVENT VARIABLE /end DAQ_EVENT
 /end IF_DATA
/end MEASUREMENT
/begin MEASUREMENT Ebs_tLvBatt "LV battery temperature" SWORD Temp_Cels 1 100 -3549.940 3003.560 FORMAT "%8.3" ECU_ADDRESS 0x6001FB80
 /begin IF_DATA XCPplus 0x0102
  /begin DAQ_EVENT VARIABLE /end DAQ_EVENT
 /end IF_DATA
/end MEASUREMENT
/begin MEASUREMENT Ebs_tLvBatt_Sq "signal quality of LV battery temperature" UBYTE SigQly_COMPU_VERB 1 100 0.00 15.0000000000 FORMAT "%13.10" ECU_ADDRESS 0x600235A9
 /begin IF_DATA XCPplus 0x0102
  /begin DAQ_EVENT VARIABLE /end DAQ_EVENT
 /end IF_DATA
/end MEASUREMENT
/begin MEASUREMENT Ebs_uBattFild "Sensor value battery voltage" SWORD U_mV_q0p9765625_COMPU 1 100 -32000.00 31999.02 FORMAT "%8.2" ECU_ADDRESS 0x6001FB7E
 /begin IF_DATA XCPplus 0x0102
  /begin DAQ_EVENT VARIABLE /end DAQ_EVENT
 /end IF_DATA
/end MEASUREMENT
/begin MEASUREMENT Ebs_uBattFild_Sq "signal quality of sensor value of battery voltage" UBYTE SigQly_COMPU_VERB 1 100 0.00 15.0000000000 FORMAT "%13.10" ECU_ADDRESS 0x600235A8
 /begin IF_DATA XCPplus 0x0102
  /begin DAQ_EVENT VARIABLE /end DAQ_EVENT
 /end IF_DATA
/end MEASUREMENT
/begin MEASUREMENT Ebs_uSofAsilRmn "Reamining Voltage in LV for safety state" SWORD spg_q0p0625_V 1 100 -2048.000 2047.938 FORMAT "%8.3" ECU_ADDRESS 0x6001F4E4
 /begin IF_DATA XCPplus 0x0102
  /begin DAQ_EVENT VARIABLE /end DAQ_EVENT
 /end IF_DATA
/end MEASUREMENT
/begin MEASUREMENT Ebs_uSofFild "Estimated supply voltage drop while cranking" SWORD spg_q0p0625_V 1 100 -2048.000 2047.938 FORMAT "%8.3" ECU_ADDRESS 0x6001FB7C
 /begin IF_DATA XCPplus 0x0102
  /begin DAQ_EVENT VARIABLE /end DAQ_EVENT
 /end IF_DATA
/end MEASUREMENT
/begin MEASUREMENT EChrDv_cntPlin "Proximity pilot plug-in counter value" UWORD OneToOne 1 100 0.00 65535.00 FORMAT "%8.2" ECU_ADDRESS 0x6001FA38
 /begin IF_DATA XCPplus 0x0102
  /begin DAQ_EVENT VARIABLE /end DAQ_EVENT
 /end IF_DATA
/end MEASUREMENT
/begin MEASUREMENT EChrDv_cntPlinValAvs "Proximity pilot plug-in count set via AVS" UWORD OneToOne 1 100 0.00 65535.00 FORMAT "%8.2" ECU_ADDRESS 0x6001F4E2
 /begin IF_DATA XCPplus 0x0102
  /begin DAQ_EVENT VARIABLE /end DAQ_EVENT
 /end IF_DATA
/end MEASUREMENT
/begin MEASUREMENT EChrDv_flgCtpAndPxpDetn "Status flag for proximity and control pilot line detection" UBYTE B_TRUE 1 100 0.00 1.00000000000 BIT_MASK 0x1 FORMAT "%13.11" ECU_ADDRESS 0x60023162
 /begin IF_DATA XCPplus 0x0102
  /begin DAQ_EVENT VARIABLE /end DAQ_EVENT
 /end IF_DATA
/end MEASUREMENT
/begin MEASUREMENT EChrDv_flgCtpDetn "Status flag for control pilot line detection" UBYTE B_TRUE 1 100 0.00 1.00000000000 BIT_MASK 0x1 FORMAT "%13.11" ECU_ADDRESS 0x60023161
 /begin IF_DATA XCPplus 0x0102
  /begin DAQ_EVENT VARIABLE /end DAQ_EVENT
 /end IF_DATA
/end MEASUREMENT
/begin MEASUREMENT EChrDv_flgPlinCntrThdExcdd "Status flag for plug-in counter threshold exceeded" UBYTE B_TRUE 1 100 0.00 1.00000000000 BIT_MASK 0x1 FORMAT "%13.11" ECU_ADDRESS 0x600234A4
 /begin IF_DATA XCPplus 0x0102
  /begin DAQ_EVENT VARIABLE /end DAQ_EVENT
 /end IF_DATA
/end MEASUREMENT
/begin MEASUREMENT EChrDv_flgPxpDetn "Status flag for proximity pilot line detection" UBYTE B_TRUE 1 100 0.00 1.00000000000 BIT_MASK 0x1 FORMAT "%13.11" ECU_ADDRESS 0x60023160
 /begin IF_DATA XCPplus 0x0102
  /begin DAQ_EVENT VARIABLE /end DAQ_EVENT
 /end IF_DATA
/end MEASUREMENT
/begin MEASUREMENT EChrDv_stSetAvs "Avs set status" UBYTE B_TRUE 1 100 0.00 1.00000000000 BIT_MASK 0x1 FORMAT "%13.11" ECU_ADDRESS 0x6002315F
 /begin IF_DATA XCPplus 0x0102
  /begin DAQ_EVENT VARIABLE /end DAQ_EVENT
 /end IF_DATA
/end MEASUREMENT
/begin MEASUREMENT EEM_chBatt "battery charge (SOF)" SWORD Ch_Ah_q0p5_COMPU 1 100 -16384.00 16383.50 FORMAT "%8.2" ECU_ADDRESS 0x6001FB8A
 /begin IF_DATA XCPplus 0x0102
  /begin DAQ_EVENT VARIABLE /end DAQ_EVENT
 /end IF_DATA
/end MEASUREMENT
/begin MEASUREMENT Eem_flgFatalEx "Fatal fault of HV component detected" UBYTE B_TRUE 1 100 0.00 1.00000000000 BIT_MASK 0x1 FORMAT "%13.11" ECU_ADDRESS 0x6002315E
 /begin IF_DATA XCPplus 0x0102
  /begin DAQ_EVENT VARIABLE /end DAQ_EVENT
 /end IF_DATA
/end MEASUREMENT
/begin MEASUREMENT Eem_flgFltHvDchaReq "Flag to request HV discharge in case of fault" UBYTE B_TRUE 1 100 0.00 1.00000000000 BIT_MASK 0x1 FORMAT "%13.11" ECU_ADDRESS 0x600234A1
 /begin IF_DATA XCPplus 0x0102
  /begin DAQ_EVENT VARIABLE /end DAQ_EVENT
 /end IF_DATA
/end MEASUREMENT
/begin MEASUREMENT Eem_flgFltMaiSwtOff "Local HV battery switch of by internal BMS fault" UBYTE B_TRUE 1 100 0.00 1.00000000000 BIT_MASK 0x1 FORMAT "%13.11" ECU_ADDRESS 0x6002315D
 /begin IF_DATA XCPplus 0x0102
  /begin DAQ_EVENT VARIABLE /end DAQ_EVENT
 /end IF_DATA
/end MEASUREMENT
/begin MEASUREMENT Eem_flgFstHvShdwn "Triggers fast shut-down of HV supply" UBYTE B_TRUE 1 100 0.00 1.00000000000 BIT_MASK 0x1 FORMAT "%13.11" ECU_ADDRESS 0x600234A0
 /begin IF_DATA XCPplus 0x0102
  /begin DAQ_EVENT VARIABLE /end DAQ_EVENT
 /end IF_DATA
/end MEASUREMENT
/begin MEASUREMENT Eem_flgHvDchaReq "Indication of HV discharge request in HV shut-down" UBYTE B_TRUE 1 100 0.00 1.00000000000 BIT_MASK 0x1 FORMAT "%13.11" ECU_ADDRESS 0x6002349F
 /begin IF_DATA XCPplus 0x0102
  /begin DAQ_EVENT VARIABLE /end DAQ_EVENT
 /end IF_DATA
/end MEASUREMENT
/begin MEASUREMENT Eem_flgHvDchaReqLoc "Local copy of Eem_flgHvDchaReq" UBYTE B_TRUE 1 100 0.00 1.00000000000 BIT_MASK 0x1 FORMAT "%13.11" ECU_ADDRESS 0x6002315C
 /begin IF_DATA XCPplus 0x0102
  /begin DAQ_EVENT VARIABLE /end DAQ_EVENT
 /end IF_DATA
/end MEASUREMENT
/begin MEASUREMENT Eem_flgHVOffTout "HV grid Shut down time out" UBYTE B_TRUE 1 100 0.00 1.00000000000 BIT_MASK 0x1 FORMAT "%13.11" ECU_ADDRESS 0x6002315B
 /begin IF_DATA XCPplus 0x0102
  /begin DAQ_EVENT VARIABLE /end DAQ_EVENT
 /end IF_DATA
/end MEASUREMENT
/begin MEASUREMENT Eem_flgHvShdwn "Triggers shut-down of HV supply" UBYTE B_TRUE 1 100 0.00 1.00000000000 BIT_MASK 0x1 FORMAT "%13.11" ECU_ADDRESS 0x6002315A
 /begin IF_DATA XCPplus 0x0102
  /begin DAQ_EVENT VARIABLE /end DAQ_EVENT
 /end IF_DATA
/end MEASUREMENT
/begin MEASUREMENT Eem_flgHvShdwnFlt "HV shut-down based on a fault condition" UBYTE B_TRUE 1 100 0.00 1.00000000000 BIT_MASK 0x1 FORMAT "%13.11" ECU_ADDRESS 0x6002349E
 /begin IF_DATA XCPplus 0x0102
  /begin DAQ_EVENT VARIABLE /end DAQ_EVENT
 /end IF_DATA
/end MEASUREMENT
/begin MEASUREMENT Eem_flgNoHvStrtup "Internal flag for no HV start-up allowed" UBYTE B_TRUE 1 100 0.00 1.00000000000 BIT_MASK 0x1 FORMAT "%13.11" ECU_ADDRESS 0x60023159
 /begin IF_DATA XCPplus 0x0102
  /begin DAQ_EVENT VARIABLE /end DAQ_EVENT
 /end IF_DATA
/end MEASUREMENT
/begin MEASUREMENT Eem_flgOffHvOn "MP for load state" UBYTE B_TRUE 1 100 0.00 1.00000000000 BIT_MASK 0x1 FORMAT "%13.11" ECU_ADDRESS 0x60023158
 /begin IF_DATA XCPplus 0x0102
  /begin DAQ_EVENT VARIABLE /end DAQ_EVENT
 /end IF_DATA
/end MEASUREMENT
/begin MEASUREMENT Eem_flgPreHvOn "MP for load state" UBYTE B_TRUE 1 100 0.00 1.00000000000 BIT_MASK 0x1 FORMAT "%13.11" ECU_ADDRESS 0x60023157
 /begin IF_DATA XCPplus 0x0102
  /begin DAQ_EVENT VARIABLE /end DAQ_EVENT
 /end IF_DATA
/end MEASUREMENT
/begin MEASUREMENT Eem_flgProlgEcuActvPost "Eem flag indicating prolong post drive active" UBYTE B_TRUE 1 100 0.00 1.00000000000 BIT_MASK 0x1 FORMAT "%13.11" ECU_ADDRESS 0x6002349D
 /begin IF_DATA XCPplus 0x0102
  /begin DAQ_EVENT VARIABLE /end DAQ_EVENT
 /end IF_DATA
/end MEASUREMENT
/begin MEASUREMENT Eem_flgProlgEcuActvPre "Eem flag indicating prolong pre drive active" UBYTE B_TRUE 1 100 0.00 1.00000000000 BIT_MASK 0x1 FORMAT "%13.11" ECU_ADDRESS 0x6002349C
 /begin IF_DATA XCPplus 0x0102
  /begin DAQ_EVENT VARIABLE /end DAQ_EVENT
 /end IF_DATA
/end MEASUREMENT
/begin MEASUREMENT Eem_flgSetMaiSwtHvBattClsd "Message to switch on HV battery" UBYTE B_TRUE 1 100 0.00 1.00000000000 BIT_MASK 0x1 FORMAT "%13.11" ECU_ADDRESS 0x600347EA
 /begin IF_DATA XCPplus 0x0102
  /begin DAQ_EVENT VARIABLE /end DAQ_EVENT
 /end IF_DATA
/end MEASUREMENT
/begin MEASUREMENT Eem_flgSetMaiSwtHvBattClsdLoc "Local variable to switch on HV battery" UBYTE B_TRUE 1 100 0.00 1.00000000000 BIT_MASK 0x1 FORMAT "%13.11" ECU_ADDRESS 0x600347E0
 /begin IF_DATA XCPplus 0x0102
  /begin DAQ_EVENT VARIABLE /end DAQ_EVENT
 /end IF_DATA
/end MEASUREMENT
/begin MEASUREMENT Eem_pwrAuxUnitLoad "Auxilliary load (Nebenaggregate)" SWORD RBPtCel_pwr_25p0_1 1 100 -819200.0 819175.0 FORMAT "%8.1" ECU_ADDRESS 0x6001FB7A
 /begin IF_DATA XCPplus 0x0102
  /begin DAQ_EVENT VARIABLE /end DAQ_EVENT
 /end IF_DATA
/end MEASUREMENT
/begin MEASUREMENT Eem_pwrAuxUnitLoadHi "Maximum of auxiliary load" SWORD RBPtCel_pwr_25p0_1 1 100 -819200.0 819175.0 FORMAT "%8.1" ECU_ADDRESS 0x6001FB78
 /begin IF_DATA XCPplus 0x0102
  /begin DAQ_EVENT VARIABLE /end DAQ_EVENT
 /end IF_DATA
/end MEASUREMENT
/begin MEASUREMENT Eem_pwrAuxUnitLoadLo "Minimum of auxiliary load" SWORD RBPtCel_pwr_25p0_1 1 100 -819200.0 819175.0 FORMAT "%8.1" ECU_ADDRESS 0x6001FB76
 /begin IF_DATA XCPplus 0x0102
  /begin DAQ_EVENT VARIABLE /end DAQ_EVENT
 /end IF_DATA
/end MEASUREMENT
/begin MEASUREMENT Eem_pwrBascAuxUnitLoad "Base auxilliary load" SWORD RBPtCel_pwr_25p0_1 1 100 -819200.0 819175.0 FORMAT "%8.1" ECU_ADDRESS 0x6001FB74
 /begin IF_DATA XCPplus 0x0102
  /begin DAQ_EVENT VARIABLE /end DAQ_EVENT
 /end IF_DATA
/end MEASUREMENT
/begin MEASUREMENT EEM_stBattChAc "Accuracy state of the battery charge" UBYTE OneToOne 1 100 0.00 255.0 FORMAT "%5.1" ECU_ADDRESS 0x600235B3
 /begin IF_DATA XCPplus 0x0102
  /begin DAQ_EVENT VARIABLE /end DAQ_EVENT
 /end IF_DATA
/end MEASUREMENT
/begin MEASUREMENT Eem_stDesDcdc "Desired mode of the DCDC" UBYTE OneToOne 1 100 0.00 255.0 FORMAT "%5.1" ECU_ADDRESS 0x600235A7
 /begin IF_DATA XCPplus 0x0102
  /begin DAQ_EVENT VARIABLE /end DAQ_EVENT
 /end IF_DATA
/end MEASUREMENT
/begin MEASUREMENT Eem_stHv "State of HV system" UBYTE OneToOne 1 100 0.00 255.0 FORMAT "%5.1" ECU_ADDRESS 0x600235A6
 /begin IF_DATA XCPplus 0x0102
  /begin DAQ_EVENT VARIABLE /end DAQ_EVENT
 /end IF_DATA
/end MEASUREMENT
/begin MEASUREMENT Eem_stHvLoc "Local state of HV system" UBYTE OneToOne 1 100 0.00 255.0 FORMAT "%5.1" ECU_ADDRESS 0x600347EB
 /begin IF_DATA XCPplus 0x0102
  /begin DAQ_EVENT VARIABLE /end DAQ_EVENT
 /end IF_DATA
/end MEASUREMENT
/begin MEASUREMENT Eem_tiSt "timer for Eem States" SWORD Time_s 1 100 -327.6800 327.6700 FORMAT "%8.4" ECU_ADDRESS 0x6001F4E0
 /begin IF_DATA XCPplus 0x0102
  /begin DAQ_EVENT VARIABLE /end DAQ_EVENT
 /end IF_DATA
/end MEASUREMENT
/begin MEASUREMENT ElM_flgEnaFrbdnQdrLockgOddAxles "Flag for forbidden quadrant locking status of odd axles" UBYTE B_TRUE 1 100 0.00 1.00000000000 BIT_MASK 0x1 FORMAT "%13.11" ECU_ADDRESS 0x6002349B
 /begin IF_DATA XCPplus 0x0102
  /begin DAQ_EVENT VARIABLE /end DAQ_EVENT
 /end IF_DATA
/end MEASUREMENT
/begin MEASUREMENT ElM_flgEnaQdrMpgOddAxles "Flag for quadrant mapping status of odd axles" UBYTE B_TRUE 1 100 0.00 1.00000000000 BIT_MASK 0x1 FORMAT "%13.11" ECU_ADDRESS 0x6002349A
 /begin IF_DATA XCPplus 0x0102
  /begin DAQ_EVENT VARIABLE /end DAQ_EVENT
 /end IF_DATA
/end MEASUREMENT
/begin MEASUREMENT ElM_flgGearMpgActv "Gear mapping (reverse gear) active" UBYTE B_TRUE 1 100 0.00 1.00000000000 BIT_MASK 0x1 FORMAT "%13.11" ECU_ADDRESS 0x60023499
 /begin IF_DATA XCPplus 0x0102
  /begin DAQ_EVENT VARIABLE /end DAQ_EVENT
 /end IF_DATA
/end MEASUREMENT
/begin MEASUREMENT ElM_flgSwtIvtDirEm01 "Switch to invert direction of rotation of e-machine 01." UBYTE B_TRUE 1 100 0.00 1.00000000000 BIT_MASK 0x1 FORMAT "%13.11" ECU_ADDRESS 0x60023498
 /begin IF_DATA XCPplus 0x0102
  /begin DAQ_EVENT VARIABLE /end DAQ_EVENT
 /end IF_DATA
/end MEASUREMENT
/begin MEASUREMENT ElM_t01 "Temperature of e-machine 01" SWORD Temp_Cels 1 100 -3549.940 3003.560 FORMAT "%8.3" ECU_ADDRESS 0x6001FB66
 /begin IF_DATA XCPplus 0x0102
  /begin DAQ_EVENT VARIABLE /end DAQ_EVENT
 /end IF_DATA
/end MEASUREMENT
/begin MEASUREMENT ElM_t01_Sq "Signal quality for Temperature of e-machine 01" UBYTE SigQly_COMPU_VERB 1 100 0.00 15.0000000000 FORMAT "%13.10" ECU_ADDRESS 0x6002359D
 /begin IF_DATA XCPplus 0x0102
  /begin DAQ_EVENT VARIABLE /end DAQ_EVENT
 /end IF_DATA
/end MEASUREMENT
/begin MEASUREMENT ElM_tIvtr01 "Inverter temperature of e-machine 01" SWORD Temp_Cels 1 100 -3549.940 3003.560 FORMAT "%8.3" ECU_ADDRESS 0x6001FB64
 /begin IF_DATA XCPplus 0x0102
  /begin DAQ_EVENT VARIABLE /end DAQ_EVENT
 /end IF_DATA
/end MEASUREMENT
/begin MEASUREMENT ElM_tIvtr01_Sq "Signal quality for Inverter temperature, e-machine 01" UBYTE SigQly_COMPU_VERB 1 100 0.00 15.0000000000 FORMAT "%13.10" ECU_ADDRESS 0x6002359C
 /begin IF_DATA XCPplus 0x0102
  /begin DAQ_EVENT VARIABLE /end DAQ_EVENT
 /end IF_DATA
/end MEASUREMENT
/begin MEASUREMENT ElM_tIvtrCoolt01 "Coolant temperature of inverter 01." SWORD Temp_Cels 1 100 -3549.940 3003.560 FORMAT "%8.3" ECU_ADDRESS 0x6001FB62
 /begin IF_DATA XCPplus 0x0102
  /begin DAQ_EVENT VARIABLE /end DAQ_EVENT
 /end IF_DATA
/end MEASUREMENT
/begin MEASUREMENT ElM_tIvtrCoolt01_Sq "Signal quality for Coolant temperature of inverter, e-machine 01" UBYTE SigQly_COMPU_VERB 1 100 0.00 15.0000000000 FORMAT "%13.10" ECU_ADDRESS 0x6002359B
 /begin IF_DATA XCPplus 0x0102
  /begin DAQ_EVENT VARIABLE /end DAQ_EVENT
 /end IF_DATA
/end MEASUREMENT
/begin MEASUREMENT ElM_tLimnTq01 "Torque limitation due to temperature of e machine 01" SWORD Temp_Cels 1 100 -3549.940 3003.560 FORMAT "%8.3" ECU_ADDRESS 0x6001FB60
 /begin IF_DATA XCPplus 0x0102
  /begin DAQ_EVENT VARIABLE /end DAQ_EVENT
 /end IF_DATA
/end MEASUREMENT
/begin MEASUREMENT ElM_tLimnTq01_Sq "Signal quality for Torque limitation due to temperature, e-machine 01" UBYTE SigQly_COMPU_VERB 1 100 0.00 15.0000000000 FORMAT "%13.10" ECU_ADDRESS 0x6002359A
 /begin IF_DATA XCPplus 0x0102
  /begin DAQ_EVENT VARIABLE /end DAQ_EVENT
 /end IF_DATA
/end MEASUREMENT
/begin MEASUREMENT Emac_EngGen01_I.ComEmac_flgActvdDsbcCtl "Class for supply of e-machine values, e-machine 01 / Surge damping control is active at e-machine" UBYTE B_TRUE 1 100 0.00 1.00000000000 BIT_MASK 0x1 FORMAT "%13.11" ECU_ADDRESS 0x60000904
 /begin IF_DATA XCPplus 0x0102
  /begin DAQ_EVENT VARIABLE /end DAQ_EVENT
 /end IF_DATA
/end MEASUREMENT
/begin MEASUREMENT Emac_EngGen01_I.ComEmac_iDcLnk "Class for supply of e-machine values, e-machine 01 / DC link current of e-machine" SWORD Curr_A_q0p03125_COMPU 1 100 -1024.000 1023.969 FORMAT "%8.3" ECU_ADDRESS 0x60000906
 /begin IF_DATA XCPplus 0x0102
  /begin DAQ_EVENT VARIABLE /end DAQ_EVENT
 /end IF_DATA
/end MEASUREMENT
/begin MEASUREMENT Emac_EngGen01_I.ComEmac_iDcLnk_Sq "Class for supply of e-machine values, e-machine 01 / Signal quality for DC link current" UBYTE SigQly_COMPU_VERB 1 100 0.00 15.0000000000 FORMAT "%13.10" ECU_ADDRESS 0x60000908
 /begin IF_DATA XCPplus 0x0102
  /begin DAQ_EVENT VARIABLE /end DAQ_EVENT
 /end IF_DATA
/end MEASUREMENT
/begin MEASUREMENT Emac_EngGen01_I.ComEmac_nAct "Class for supply of e-machine values, e-machine 01 / Actual engine speed of e-machine" SWORD nmot_q1 1 100 -32768.00 32767.00 FORMAT "%8.2" ECU_ADDRESS 0x6000090A
 /begin IF_DATA XCPplus 0x0102
  /begin DAQ_EVENT VARIABLE /end DAQ_EVENT
 /end IF_DATA
/end MEASUREMENT
/begin MEASUREMENT Emac_EngGen01_I.ComEmac_nAct_Sq "Class for supply of e-machine values, e-machine 01 / Signal quality for Actual engine speed of e-machine" UBYTE SigQly_COMPU_VERB 1 100 0.00 15.0000000000 FORMAT "%13.10" ECU_ADDRESS 0x6000090C
 /begin IF_DATA XCPplus 0x0102
  /begin DAQ_EVENT VARIABLE /end DAQ_EVENT
 /end IF_DATA
/end MEASUREMENT
/begin MEASUREMENT Emac_EngGen01_I.ComEmac_tInvr "Class for supply of e-machine values, e-machine 01 / Inverter temperature of e-machine" SWORD Temp_Cels 1 100 -3549.940 3003.560 FORMAT "%8.3" ECU_ADDRESS 0x6000090E
 /begin IF_DATA XCPplus 0x0102
  /begin DAQ_EVENT VARIABLE /end DAQ_EVENT
 /end IF_DATA
/end MEASUREMENT
/begin MEASUREMENT Emac_EngGen01_I.ComEmac_tInvr_Sq "Class for supply of e-machine values, e-machine 01 / Signal quality for Inverter temperature of e-machine" UBYTE SigQly_COMPU_VERB 1 100 0.00 15.0000000000 FORMAT "%13.10" ECU_ADDRESS 0x60000910
 /begin IF_DATA XCPplus 0x0102
  /begin DAQ_EVENT VARIABLE /end DAQ_EVENT
 /end IF_DATA
/end MEASUREMENT
/begin MEASUREMENT Emac_EngGen01_I.ComEmac_tIvtrCoolt "Class for supply of e-machine values, e-machine 01 / coolant temperature of inverter" SWORD Temp_Cels 1 100 -3549.940 3003.560 FORMAT "%8.3" ECU_ADDRESS 0x60000912
 /begin IF_DATA XCPplus 0x0102
  /begin DAQ_EVENT VARIABLE /end DAQ_EVENT
 /end IF_DATA
/end MEASUREMENT
/begin MEASUREMENT Emac_EngGen01_I.ComEmac_tIvtrCoolt_Sq "Class for supply of e-machine values, e-machine 01 / Signal quality for Coolant temperature of inverter" UBYTE SigQly_COMPU_VERB 1 100 0.00 15.0000000000 FORMAT "%13.10" ECU_ADDRESS 0x60000914
 /begin IF_DATA XCPplus 0x0102
  /begin DAQ_EVENT VARIABLE /end DAQ_EVENT
 /end IF_DATA
/end MEASUREMENT
/begin MEASUREMENT Emac_EngGen01_I.ComEmac_tMac "Class for supply of e-machine values, e-machine 01 / Stator temperature of e-machine" SWORD Temp_Cels 1 100 -3549.940 3003.560 FORMAT "%8.3" ECU_ADDRESS 0x60000916
 /begin IF_DATA XCPplus 0x0102
  /begin DAQ_EVENT VARIABLE /end DAQ_EVENT
 /end IF_DATA
/end MEASUREMENT
/begin MEASUREMENT Emac_EngGen01_I.ComEmac_tMac_Sq "Class for supply of e-machine values, e-machine 01 / Signal quality for Stator temperature of e-machine" UBYTE SigQly_COMPU_VERB 1 100 0.00 15.0000000000 FORMAT "%13.10" ECU_ADDRESS 0x60000918
 /begin IF_DATA XCPplus 0x0102
  /begin DAQ_EVENT VARIABLE /end DAQ_EVENT
 /end IF_DATA
/end MEASUREMENT
/begin MEASUREMENT Emac_EngGen01_I.ComEmac_tRtr "Class for supply of e-machine values, e-machine 01 / Rotor temperature of e-machine" SWORD Temp_Cels 1 100 -3549.940 3003.560 FORMAT "%8.3" ECU_ADDRESS 0x6000091A
 /begin IF_DATA XCPplus 0x0102
  /begin DAQ_EVENT VARIABLE /end DAQ_EVENT
 /end IF_DATA
/end MEASUREMENT
/begin MEASUREMENT Emac_EngGen01_I.ComEmac_tRtr_Sq "Class for supply of e-machine values, e-machine 01 / Signal quality for Rotor temperature of e-machine" UBYTE SigQly_COMPU_VERB 1 100 0.00 15.0000000000 FORMAT "%13.10" ECU_ADDRESS 0x6000091C
 /begin IF_DATA XCPplus 0x0102
  /begin DAQ_EVENT VARIABLE /end DAQ_EVENT
 /end IF_DATA
/end MEASUREMENT
/begin MEASUREMENT Emac_EngGen01_I.ComEmac_tqAbsltMax "Class for supply of e-machine values, e-machine 01 / Maximum absolute torque of e-machine" SWORD Trq 1 100 -3276.800 3276.700 FORMAT "%8.3" ECU_ADDRESS 0x6000091E
 /begin IF_DATA XCPplus 0x0102
  /begin DAQ_EVENT VARIABLE /end DAQ_EVENT
 /end IF_DATA
/end MEASUREMENT
/begin MEASUREMENT Emac_EngGen01_I.ComEmac_tqAbsltMax_Sq "Class for supply of e-machine values, e-machine 01 / Signal quality for maximum absolute torque limit of e-machine" UBYTE SigQly_COMPU_VERB 1 100 0.00 15.0000000000 FORMAT "%13.10" ECU_ADDRESS 0x60000920
 /begin IF_DATA XCPplus 0x0102
  /begin DAQ_EVENT VARIABLE /end DAQ_EVENT
 /end IF_DATA
/end MEASUREMENT
/begin MEASUREMENT Emac_EngGen01_I.ComEmac_tqAbsltMin "Class for supply of e-machine values, e-machine 01 / Minimum absolute torque of e-machine" SWORD Trq 1 100 -3276.800 3276.700 FORMAT "%8.3" ECU_ADDRESS 0x60000922
 /begin IF_DATA XCPplus 0x0102
  /begin DAQ_EVENT VARIABLE /end DAQ_EVENT
 /end IF_DATA
/end MEASUREMENT
/begin MEASUREMENT Emac_EngGen01_I.ComEmac_tqAbsltMin_Sq "Class for supply of e-machine values, e-machine 01 / Signal quality for minimum absolute torque limit of e-machine" UBYTE SigQly_COMPU_VERB 1 100 0.00 15.0000000000 FORMAT "%13.10" ECU_ADDRESS 0x60000924
 /begin IF_DATA XCPplus 0x0102
  /begin DAQ_EVENT VARIABLE /end DAQ_EVENT
 /end IF_DATA
/end MEASUREMENT
/begin MEASUREMENT Emac_EngGen01_I.ComEmac_tqAct "Class for supply of e-machine values, e-machine 01 / Actual torque of e-machine" SWORD Trq 1 100 -3276.800 3276.700 FORMAT "%8.3" ECU_ADDRESS 0x60000926
 /begin IF_DATA XCPplus 0x0102
  /begin DAQ_EVENT VARIABLE /end DAQ_EVENT
 /end IF_DATA
/end MEASUREMENT
/begin MEASUREMENT Emac_EngGen01_I.ComEmac_tqActWoDsbcCtl "Class for supply of e-machine values, e-machine 01 / Actual torque without disturbance control" SWORD Trq 1 100 -3276.800 3276.700 FORMAT "%8.3" ECU_ADDRESS 0x60000928
 /begin IF_DATA XCPplus 0x0102
  /begin DAQ_EVENT VARIABLE /end DAQ_EVENT
 /end IF_DATA
/end MEASUREMENT
/begin MEASUREMENT Emac_EngGen01_I.ComEmac_tqActWoDsbcCtl_Sq "Class for supply of e-machine values, e-machine 01 / Signal quality for actual torque without disturbance control" UBYTE SigQly_COMPU_VERB 1 100 0.00 15.0000000000 FORMAT "%13.10" ECU_ADDRESS 0x6000092A
 /begin IF_DATA XCPplus 0x0102
  /begin DAQ_EVENT VARIABLE /end DAQ_EVENT
 /end IF_DATA
/end MEASUREMENT
/begin MEASUREMENT Emac_EngGen01_I.ComEmac_tqAct_Sq "Class for supply of e-machine values, e-machine 01 / Signal quality for Actual torque of e-machine" UBYTE SigQly_COMPU_VERB 1 100 0.00 15.0000000000 FORMAT "%13.10" ECU_ADDRESS 0x6000092B
 /begin IF_DATA XCPplus 0x0102
  /begin DAQ_EVENT VARIABLE /end DAQ_EVENT
 /end IF_DATA
/end MEASUREMENT
/begin MEASUREMENT Emac_EngGen01_I.ComEmac_uDcLnk "Class for supply of e-machine values, e-machine 01 / Actual DC link voltage of e-machine" SWORD Volt_V_q0p03125_COMPU 1 100 -1024.000 1023.969 FORMAT "%8.3" ECU_ADDRESS 0x6000092C
 /begin IF_DATA XCPplus 0x0102
  /begin DAQ_EVENT VARIABLE /end DAQ_EVENT
 /end IF_DATA
/end MEASUREMENT
/begin MEASUREMENT Emac_EngGen01_I.ComEmac_uDcLnk_Sq "Class for supply of e-machine values, e-machine 01 / Signal quality for Actual DC link voltage of e-machine" UBYTE SigQly_COMPU_VERB 1 100 0.00 15.0000000000 FORMAT "%13.10" ECU_ADDRESS 0x6000092E
 /begin IF_DATA XCPplus 0x0102
  /begin DAQ_EVENT VARIABLE /end DAQ_EVENT
 /end IF_DATA
/end MEASUREMENT
/begin MEASUREMENT Emac_EngGen01_I.ElM_flgEnaFrbdnQdrLockg "Class for supply of e-machine values, e-machine 01 / Flag for the forbidden quadrant locking status" UBYTE B_TRUE 1 100 0.00 1.00000000000 BIT_MASK 0x1 FORMAT "%13.11" ECU_ADDRESS 0x6000092F
 /begin IF_DATA XCPplus 0x0102
  /begin DAQ_EVENT VARIABLE /end DAQ_EVENT
 /end IF_DATA
/end MEASUREMENT
/begin MEASUREMENT Emac_EngGen01_I.ElM_flgEnaQdrMpg "Class for supply of e-machine values, e-machine 01 / Flag for the quadrant mapping status" UBYTE B_TRUE 1 100 0.00 1.00000000000 BIT_MASK 0x1 FORMAT "%13.11" ECU_ADDRESS 0x60000930
 /begin IF_DATA XCPplus 0x0102
  /begin DAQ_EVENT VARIABLE /end DAQ_EVENT
 /end IF_DATA
/end MEASUREMENT
/begin MEASUREMENT Emac_EngGen01_I.ElM_flgSwtIvtDirEm "Class for supply of e-machine values, e-machine 01 / Switch to invert direction of rotation of e-machine." UBYTE B_TRUE 1 100 0.00 1.00000000000 BIT_MASK 0x1 FORMAT "%13.11" ECU_ADDRESS 0x60000931
 /begin IF_DATA XCPplus 0x0102
  /begin DAQ_EVENT VARIABLE /end DAQ_EVENT
 /end IF_DATA
/end MEASUREMENT
/begin MEASUREMENT Emac_EngGen01_I.ElM_idxnActAry "Class for supply of e-machine values, e-machine 01 / Actual array-index of e-machine-speed-samples" UBYTE OneToOne 1 100 0.00 255.0 FORMAT "%5.1" ECU_ADDRESS 0x60000932
 /begin IF_DATA XCPplus 0x0102
  /begin DAQ_EVENT VARIABLE /end DAQ_EVENT
 /end IF_DATA
/end MEASUREMENT
/begin MEASUREMENT Emac_EngGen01_I.ElM_idxnActAvrg "Class for supply of e-machine values, e-machine 01 / Index array" UBYTE OneToOne 1 100 0.00 255.0 FORMAT "%5.1" ECU_ADDRESS 0x60000933
 /begin IF_DATA XCPplus 0x0102
  /begin DAQ_EVENT VARIABLE /end DAQ_EVENT
 /end IF_DATA
/end MEASUREMENT
/begin MEASUREMENT Emac_EngGen01_I.ElM_idxnAvrg "Class for supply of e-machine values, e-machine 01 / Index of updated values in array of e-machine-speed-samples" UBYTE OneToOne 1 100 0.00 255.0 FORMAT "%5.1" ECU_ADDRESS 0x60000934
 /begin IF_DATA XCPplus 0x0102
  /begin DAQ_EVENT VARIABLE /end DAQ_EVENT
 /end IF_DATA
/end MEASUREMENT
/begin MEASUREMENT Emac_EngGen01_I.ElM_nActAvrg "Class for supply of e-machine values, e-machine 01 / E-machine-speed filtered by moving average filter" SWORD nmot_q1 1 100 -32768.00 32767.00 FORMAT "%8.2" ECU_ADDRESS 0x60000936
 /begin IF_DATA XCPplus 0x0102
  /begin DAQ_EVENT VARIABLE /end DAQ_EVENT
 /end IF_DATA
/end MEASUREMENT
/begin MEASUREMENT Emac_EngGen01_I.ElM_nActAvrgPT1 "Class for supply of e-machine values, e-machine 01 / PT1 filtered e-machine-speed past moving average filter" SWORD nmot_q1 1 100 -32768.00 32767.00 FORMAT "%8.2" ECU_ADDRESS 0x60000938
 /begin IF_DATA XCPplus 0x0102
  /begin DAQ_EVENT VARIABLE /end DAQ_EVENT
 /end IF_DATA
/end MEASUREMENT
/begin MEASUREMENT Emac_EngGen01_I.ElM_nActSum "Class for supply of e-machine values, e-machine 01 / sum of previous actual speed" SLONG nmot_q1 1 100 -2147483648.00 2147483647.00 FORMAT "%13.2" ECU_ADDRESS 0x6000093C
 /begin IF_DATA XCPplus 0x0102
  /begin DAQ_EVENT VARIABLE /end DAQ_EVENT
 /end IF_DATA
/end MEASUREMENT
/begin MEASUREMENT Emac_EngGen01_I.ElM_nrSmplArr "Class for supply of e-machine values, e-machine 01 / Samples-Array of moving average filter of e-machine-speed" SWORD nmot_q1 1 100 -32768.00 32767.00 FORMAT "%8.2" MATRIX_DIM 20 ECU_ADDRESS 0x60000940
 /begin IF_DATA XCPplus 0x0102
  /begin DAQ_EVENT VARIABLE /end DAQ_EVENT
 /end IF_DATA
/end MEASUREMENT
/begin MEASUREMENT Emac_EngGen01_I.ElM_stOperModAct "Class for supply of e-machine values, e-machine 01 / actual operation mode of inverter" UBYTE RBPtElTrac_stEmOperMod_VERB 1 100 0.00 31.0000000000 FORMAT "%13.10" ECU_ADDRESS 0x60000968
 /begin IF_DATA XCPplus 0x0102
  /begin DAQ_EVENT VARIABLE /end DAQ_EVENT
 /end IF_DATA
/end MEASUREMENT
/begin MEASUREMENT Emac_EngGen01_I.ElM_t "Class for supply of e-machine values, e-machine 01 / temperature of e-machine" SWORD Temp_Cels 1 100 -3549.940 3003.560 FORMAT "%8.3" ECU_ADDRESS 0x6000096A
 /begin IF_DATA XCPplus 0x0102
  /begin DAQ_EVENT VARIABLE /end DAQ_EVENT
 /end IF_DATA
/end MEASUREMENT
/begin MEASUREMENT Emac_EngGen01_I.ElM_tIvtr "Class for supply of e-machine values, e-machine 01 / temperature of inverter" SWORD Temp_Cels 1 100 -3549.940 3003.560 FORMAT "%8.3" ECU_ADDRESS 0x6000096C
 /begin IF_DATA XCPplus 0x0102
  /begin DAQ_EVENT VARIABLE /end DAQ_EVENT
 /end IF_DATA
/end MEASUREMENT
/begin MEASUREMENT Emac_EngGen01_I.ElM_tIvtrCoolt "Class for supply of e-machine values, e-machine 01 / coolant temperature of inverter" SWORD Temp_Cels 1 100 -3549.940 3003.560 FORMAT "%8.3" ECU_ADDRESS 0x6000096E
 /begin IF_DATA XCPplus 0x0102
  /begin DAQ_EVENT VARIABLE /end DAQ_EVENT
 /end IF_DATA
/end MEASUREMENT
/begin MEASUREMENT Emac_EngGen01_I.ElM_tIvtrCoolt_Sq "Class for supply of e-machine values, e-machine 01 / Signal quality for Coolant temperature of inverter" UBYTE SigQly_COMPU_VERB 1 100 0.00 15.0000000000 FORMAT "%13.10" ECU_ADDRESS 0x60000970
 /begin IF_DATA XCPplus 0x0102
  /begin DAQ_EVENT VARIABLE /end DAQ_EVENT
 /end IF_DATA
/end MEASUREMENT
/begin MEASUREMENT Emac_EngGen01_I.ElM_tIvtr_Sq "Class for supply of e-machine values, e-machine 01 / Signal quality for Inverter temperature of e-machine" UBYTE SigQly_COMPU_VERB 1 100 0.00 15.0000000000 FORMAT "%13.10" ECU_ADDRESS 0x60000971
 /begin IF_DATA XCPplus 0x0102
  /begin DAQ_EVENT VARIABLE /end DAQ_EVENT
 /end IF_DATA
/end MEASUREMENT
/begin MEASUREMENT Emac_EngGen01_I.ElM_tLimnTq "Class for supply of e-machine values, e-machine 01 / Torque limitation due to temperature" SWORD Temp_Cels 1 100 -3549.940 3003.560 FORMAT "%8.3" ECU_ADDRESS 0x60000972
 /begin IF_DATA XCPplus 0x0102
  /begin DAQ_EVENT VARIABLE /end DAQ_EVENT
 /end IF_DATA
/end MEASUREMENT
/begin MEASUREMENT Emac_EngGen01_I.ElM_tLimnTq_Sq "Class for supply of e-machine values, e-machine 01 / Signal quality for torque limitation due to temperature of e-machine" UBYTE SigQly_COMPU_VERB 1 100 0.00 15.0000000000 FORMAT "%13.10" ECU_ADDRESS 0x60000974
 /begin IF_DATA XCPplus 0x0102
  /begin DAQ_EVENT VARIABLE /end DAQ_EVENT
 /end IF_DATA
/end MEASUREMENT
/begin MEASUREMENT Emac_EngGen01_I.ElM_t_Sq "Class for supply of e-machine values, e-machine 01 / Signal quality for Temperature of e-machine" UBYTE SigQly_COMPU_VERB 1 100 0.00 15.0000000000 FORMAT "%13.10" ECU_ADDRESS 0x60000975
 /begin IF_DATA XCPplus 0x0102
  /begin DAQ_EVENT VARIABLE /end DAQ_EVENT
 /end IF_DATA
/end MEASUREMENT
/begin MEASUREMENT Emac_EngGen01_I.Elm_flgRollgBack "Class for supply of e-machine values, e-machine 01 / Detection of rolling against desired direction" UBYTE B_TRUE 1 100 0.00 1.00000000000 BIT_MASK 0x1 FORMAT "%13.11" ECU_ADDRESS 0x60000976
 /begin IF_DATA XCPplus 0x0102
  /begin DAQ_EVENT VARIABLE /end DAQ_EVENT
 /end IF_DATA
/end MEASUREMENT
/begin MEASUREMENT Emac_EngGen01_I.Elm_flgSignMpgActv "Class for supply of e-machine values, e-machine 01 / Detection of 4 quadrant mapping active along with invert direction of e-machine" UBYTE B_TRUE 1 100 0.00 1.00000000000 BIT_MASK 0x1 FORMAT "%13.11" ECU_ADDRESS 0x60000977
 /begin IF_DATA XCPplus 0x0102
  /begin DAQ_EVENT VARIABLE /end DAQ_EVENT
 /end IF_DATA
/end MEASUREMENT
/begin MEASUREMENT Emac_EngGen01_I.Emac_facEff "Class for supply of e-machine values, e-machine 01 / Efficiency of e-machine" SWORD PSC_Fact 1 100 -1.000031 1.000000 FORMAT "%8.6" ECU_ADDRESS 0x60000978
 /begin IF_DATA XCPplus 0x0102
  /begin DAQ_EVENT VARIABLE /end DAQ_EVENT
 /end IF_DATA
/end MEASUREMENT
/begin MEASUREMENT Emac_EngGen01_I.Emac_flgDsbcCtlActvd "Class for supply of e-machine values, e-machine 01 / Surge damping control is active at e-machine" UBYTE B_TRUE 1 100 0.00 1.00000000000 BIT_MASK 0x1 FORMAT "%13.11" ECU_ADDRESS 0x6000097A
 /begin IF_DATA XCPplus 0x0102
  /begin DAQ_EVENT VARIABLE /end DAQ_EVENT
 /end IF_DATA
/end MEASUREMENT
/begin MEASUREMENT Emac_EngGen01_I.Emac_flgGearMpgActv "Class for supply of e-machine values, e-machine 01 / gear mapping active" UBYTE B_TRUE 1 100 0.00 1.00000000000 BIT_MASK 0x1 FORMAT "%13.11" ECU_ADDRESS 0x6000097B
 /begin IF_DATA XCPplus 0x0102
  /begin DAQ_EVENT VARIABLE /end DAQ_EVENT
 /end IF_DATA
/end MEASUREMENT
/begin MEASUREMENT Emac_EngGen01_I.Emac_iDcLnk "Class for supply of e-machine values, e-machine 01 / DC link current of e-machine" SWORD Curr_A_q0p03125_COMPU 1 100 -1024.000 1023.969 FORMAT "%8.3" ECU_ADDRESS 0x6000097C
 /begin IF_DATA XCPplus 0x0102
  /begin DAQ_EVENT VARIABLE /end DAQ_EVENT
 /end IF_DATA
/end MEASUREMENT
/begin MEASUREMENT Emac_EngGen01_I.Emac_iDcLnk_Sq "Class for supply of e-machine values, e-machine 01 / Signal quality for DC link current" UBYTE SigQly_COMPU_VERB 1 100 0.00 15.0000000000 FORMAT "%13.10" ECU_ADDRESS 0x6000097E
 /begin IF_DATA XCPplus 0x0102
  /begin DAQ_EVENT VARIABLE /end DAQ_EVENT
 /end IF_DATA
/end MEASUREMENT
/begin MEASUREMENT Emac_EngGen01_I.Emac_nAct "Class for supply of e-machine values, e-machine 01 / Actual engine speed of e-machine" SWORD nmot_q1 1 100 -32768.00 32767.00 FORMAT "%8.2" ECU_ADDRESS 0x60000980
 /begin IF_DATA XCPplus 0x0102
  /begin DAQ_EVENT VARIABLE /end DAQ_EVENT
 /end IF_DATA
/end MEASUREMENT
/begin MEASUREMENT Emac_EngGen01_I.Emac_nActPhy "Class for supply of e-machine values, e-machine 01 / actual speed of e-machine" SWORD nmot_q1 1 100 -32768.00 32767.00 FORMAT "%8.2" ECU_ADDRESS 0x60000982
 /begin IF_DATA XCPplus 0x0102
  /begin DAQ_EVENT VARIABLE /end DAQ_EVENT
 /end IF_DATA
/end MEASUREMENT
/begin MEASUREMENT Emac_EngGen01_I.Emac_nActPhy_Sq "Class for supply of e-machine values, e-machine 01 / Signal qualifier for actual speed of e-machine" UBYTE SigQly_COMPU_VERB 1 100 0.00 15.0000000000 FORMAT "%13.10" ECU_ADDRESS 0x60000984
 /begin IF_DATA XCPplus 0x0102
  /begin DAQ_EVENT VARIABLE /end DAQ_EVENT
 /end IF_DATA
/end MEASUREMENT
/begin MEASUREMENT Emac_EngGen01_I.Emac_nAct_Sq "Class for supply of e-machine values, e-machine 01 / Signal quality for Actual engine speed of e-machine" UBYTE SigQly_COMPU_VERB 1 100 0.00 15.0000000000 FORMAT "%13.10" ECU_ADDRESS 0x60000985
 /begin IF_DATA XCPplus 0x0102
  /begin DAQ_EVENT VARIABLE /end DAQ_EVENT
 /end IF_DATA
/end MEASUREMENT
/begin MEASUREMENT Emac_EngGen01_I.Emac_pwrAct "Class for supply of e-machine values, e-machine 01 / Actual power of e-machine" SWORD leist_q16_W 1 100 -524288.0 524272.0 FORMAT "%8.1" ECU_ADDRESS 0x60000986
 /begin IF_DATA XCPplus 0x0102
  /begin DAQ_EVENT VARIABLE /end DAQ_EVENT
 /end IF_DATA
/end MEASUREMENT
/begin MEASUREMENT Emac_EngGen01_I.Emac_pwrActMecl "Class for supply of e-machine values, e-machine 01 / Actual mechanical power of e-machine" SWORD leist_q16_W 1 100 -524288.0 524272.0 FORMAT "%8.1" ECU_ADDRESS 0x60000988
 /begin IF_DATA XCPplus 0x0102
  /begin DAQ_EVENT VARIABLE /end DAQ_EVENT
 /end IF_DATA
/end MEASUREMENT
/begin MEASUREMENT Emac_EngGen01_I.Emac_pwrActMecl_Sq "Class for supply of e-machine values, e-machine 01 / Signal quality for actual mechanical power of e-machine" UBYTE SigQly_COMPU_VERB 1 100 0.00 15.0000000000 FORMAT "%13.10" ECU_ADDRESS 0x6000098A
 /begin IF_DATA XCPplus 0x0102
  /begin DAQ_EVENT VARIABLE /end DAQ_EVENT
 /end IF_DATA
/end MEASUREMENT
/begin MEASUREMENT Emac_EngGen01_I.Emac_pwrAct_Sq "Class for supply of e-machine values, e-machine 01 / Signal Quality for Actual Power of e-machine" UBYTE SigQly_COMPU_VERB 1 100 0.00 15.0000000000 FORMAT "%13.10" ECU_ADDRESS 0x6000098B
 /begin IF_DATA XCPplus 0x0102
  /begin DAQ_EVENT VARIABLE /end DAQ_EVENT
 /end IF_DATA
/end MEASUREMENT
/begin MEASUREMENT Emac_EngGen01_I.Emac_pwrLossAbslt "Class for supply of e-machine values, e-machine 01 / power loss of inverter and e-machine, abs. value" SWORD leist_q16_W 1 100 -524288.0 524272.0 FORMAT "%8.1" ECU_ADDRESS 0x6000098C
 /begin IF_DATA XCPplus 0x0102
  /begin DAQ_EVENT VARIABLE /end DAQ_EVENT
 /end IF_DATA
/end MEASUREMENT
/begin MEASUREMENT Emac_EngGen01_I.Emac_pwrLossAbslt_Sq "Class for supply of e-machine values, e-machine 01 / Signal quality for power loss of inverter and e-machine, abs. value01" UBYTE SigQly_COMPU_VERB 1 100 0.00 15.0000000000 FORMAT "%13.10" ECU_ADDRESS 0x6000098E
 /begin IF_DATA XCPplus 0x0102
  /begin DAQ_EVENT VARIABLE /end DAQ_EVENT
 /end IF_DATA
/end MEASUREMENT
/begin MEASUREMENT Emac_EngGen01_I.Emac_ratTEstimnInvr "Class for supply of e-machine values, e-machine 01 / Estimated relative inverter load (temerature) of e-machine" SWORD PSC_Fact 1 100 -1.000031 1.000000 FORMAT "%8.6" ECU_ADDRESS 0x60000990
 /begin IF_DATA XCPplus 0x0102
  /begin DAQ_EVENT VARIABLE /end DAQ_EVENT
 /end IF_DATA
/end MEASUREMENT
/begin MEASUREMENT Emac_EngGen01_I.Emac_ratTEstimnInvr_Sq "Class for supply of e-machine values, e-machine 01 / Signal quality for estimated inverter temperature of e-machine" UBYTE SigQly_COMPU_VERB 1 100 0.00 15.0000000000 FORMAT "%13.10" ECU_ADDRESS 0x60000992
 /begin IF_DATA XCPplus 0x0102
  /begin DAQ_EVENT VARIABLE /end DAQ_EVENT
 /end IF_DATA
/end MEASUREMENT
/begin MEASUREMENT Emac_EngGen01_I.Emac_ratTEstimnMac "Class for supply of e-machine values, e-machine 01 / Estimated relative machine load (temerature) of e-machine" SWORD PSC_Fact 1 100 -1.000031 1.000000 FORMAT "%8.6" ECU_ADDRESS 0x60000994
 /begin IF_DATA XCPplus 0x0102
  /begin DAQ_EVENT VARIABLE /end DAQ_EVENT
 /end IF_DATA
/end MEASUREMENT
/begin MEASUREMENT Emac_EngGen01_I.Emac_tqAbsltMax "Class for supply of e-machine values, e-machine 01 / Maximum absolute torque of e-machine" SWORD Trq 1 100 -3276.800 3276.700 FORMAT "%8.3" ECU_ADDRESS 0x60000996
 /begin IF_DATA XCPplus 0x0102
  /begin DAQ_EVENT VARIABLE /end DAQ_EVENT
 /end IF_DATA
/end MEASUREMENT
/begin MEASUREMENT Emac_EngGen01_I.Emac_tqAbsltMax_Sq "Class for supply of e-machine values, e-machine 01 / Signal quality for maximum absolute torque limit of e-machine" UBYTE SigQly_COMPU_VERB 1 100 0.00 15.0000000000 FORMAT "%13.10" ECU_ADDRESS 0x60000998
 /begin IF_DATA XCPplus 0x0102
  /begin DAQ_EVENT VARIABLE /end DAQ_EVENT
 /end IF_DATA
/end MEASUREMENT
/begin MEASUREMENT Emac_EngGen01_I.Emac_tqAbsltMin "Class for supply of e-machine values, e-machine 01 / Minimum absolute torque of e-machine" SWORD Trq 1 100 -3276.800 3276.700 FORMAT "%8.3" ECU_ADDRESS 0x6000099A
 /begin IF_DATA XCPplus 0x0102
  /begin DAQ_EVENT VARIABLE /end DAQ_EVENT
 /end IF_DATA
/end MEASUREMENT
/begin MEASUREMENT Emac_EngGen01_I.Emac_tqAbsltMin_Sq "Class for supply of e-machine values, e-machine 01 / Signal quality for minimum absolute torque limit of e-machine" UBYTE SigQly_COMPU_VERB 1 100 0.00 15.0000000000 FORMAT "%13.10" ECU_ADDRESS 0x6000099C
 /begin IF_DATA XCPplus 0x0102
  /begin DAQ_EVENT VARIABLE /end DAQ_EVENT
 /end IF_DATA
/end MEASUREMENT
/begin MEASUREMENT Emac_EngGen01_I.Emac_tqAct "Class for supply of e-machine values, e-machine 01 / Actual torque of e-machine" SWORD Trq 1 100 -3276.800 3276.700 FORMAT "%8.3" ECU_ADDRESS 0x6000099E
 /begin IF_DATA XCPplus 0x0102
  /begin DAQ_EVENT VARIABLE /end DAQ_EVENT
 /end IF_DATA
/end MEASUREMENT
/begin MEASUREMENT Emac_EngGen01_I.Emac_tqActWoDsbcCtl "Class for supply of e-machine values, e-machine 01 / Actual torque without disturbance control" SWORD Trq 1 100 -3276.800 3276.700 FORMAT "%8.3" ECU_ADDRESS 0x600009A0
 /begin IF_DATA XCPplus 0x0102
  /begin DAQ_EVENT VARIABLE /end DAQ_EVENT
 /end IF_DATA
/end MEASUREMENT
/begin MEASUREMENT Emac_EngGen01_I.Emac_tqActWoDsbcCtl_Sq "Class for supply of e-machine values, e-machine 01 / Signal quality for actual torque without disturbance control" UBYTE SigQly_COMPU_VERB 1 100 0.00 15.0000000000 FORMAT "%13.10" ECU_ADDRESS 0x600009A2
 /begin IF_DATA XCPplus 0x0102
  /begin DAQ_EVENT VARIABLE /end DAQ_EVENT
 /end IF_DATA
/end MEASUREMENT
/begin MEASUREMENT Emac_EngGen01_I.Emac_tqAct_Sq "Class for supply of e-machine values, e-machine 01 / Signal quality for Actual torque of e-machine" UBYTE SigQly_COMPU_VERB 1 100 0.00 15.0000000000 FORMAT "%13.10" ECU_ADDRESS 0x600009A3
 /begin IF_DATA XCPplus 0x0102
  /begin DAQ_EVENT VARIABLE /end DAQ_EVENT
 /end IF_DATA
/end MEASUREMENT
/begin MEASUREMENT Emac_EngGen01_I.Emac_tqEngMax "Class for supply of e-machine values, e-machine 01 / Maximum absolute torque of e-machine" SWORD Trq 1 100 -3276.800 3276.700 FORMAT "%8.3" ECU_ADDRESS 0x600009A4
 /begin IF_DATA XCPplus 0x0102
  /begin DAQ_EVENT VARIABLE /end DAQ_EVENT
 /end IF_DATA
/end MEASUREMENT
/begin MEASUREMENT Emac_EngGen01_I.Emac_tqEngMax_Sq "Class for supply of e-machine values, e-machine 01 / Signal quality for maximum absolute torque of e-machine" UBYTE SigQly_COMPU_VERB 1 100 0.00 15.0000000000 FORMAT "%13.10" ECU_ADDRESS 0x600009A6
 /begin IF_DATA XCPplus 0x0102
  /begin DAQ_EVENT VARIABLE /end DAQ_EVENT
 /end IF_DATA
/end MEASUREMENT
/begin MEASUREMENT Emac_EngGen01_I.Emac_tqEngMin "Class for supply of e-machine values, e-machine 01 / Minimum absolute torque of e-machine" SWORD Trq 1 100 -3276.800 3276.700 FORMAT "%8.3" ECU_ADDRESS 0x600009A8
 /begin IF_DATA XCPplus 0x0102
  /begin DAQ_EVENT VARIABLE /end DAQ_EVENT
 /end IF_DATA
/end MEASUREMENT
/begin MEASUREMENT Emac_EngGen01_I.Emac_tqEngMin_Sq "Class for supply of e-machine values, e-machine 01 / Signal quality for minimum absolute torque, e-machine" UBYTE SigQly_COMPU_VERB 1 100 0.00 15.0000000000 FORMAT "%13.10" ECU_ADDRESS 0x600009AA
 /begin IF_DATA XCPplus 0x0102
  /begin DAQ_EVENT VARIABLE /end DAQ_EVENT
 /end IF_DATA
/end MEASUREMENT
/begin MEASUREMENT Emac_EngGen01_I.Emac_uDcLnk "Class for supply of e-machine values, e-machine 01 / DC link voltage of e-machine" SWORD Volt_V_q0p03125_COMPU 1 100 -1024.000 1023.969 FORMAT "%8.3" ECU_ADDRESS 0x600009AC
 /begin IF_DATA XCPplus 0x0102
  /begin DAQ_EVENT VARIABLE /end DAQ_EVENT
 /end IF_DATA
/end MEASUREMENT
/begin MEASUREMENT Emac_EngGen01_I.Emac_uDcLnk_Sq "Class for supply of e-machine values, e-machine 01 / Signal quality for DC link voltage of e-machine" UBYTE SigQly_COMPU_VERB 1 100 0.00 15.0000000000 FORMAT "%13.10" ECU_ADDRESS 0x600009AE
 /begin IF_DATA XCPplus 0x0102
  /begin DAQ_EVENT VARIABLE /end DAQ_EVENT
 /end IF_DATA
/end MEASUREMENT
/begin MEASUREMENT Emac_EngGen01_I.PT_tqDesEmac "Class for supply of e-machine values, e-machine 01 / Local reprasentation of desired torque of E Motor" SWORD Trq 1 100 -3276.800 3276.700 FORMAT "%8.3" ECU_ADDRESS 0x600009B0
 /begin IF_DATA XCPplus 0x0102
  /begin DAQ_EVENT VARIABLE /end DAQ_EVENT
 /end IF_DATA
/end MEASUREMENT
/begin MEASUREMENT Emac_EngGen01_I.ElM_IvtrTqAbsltLimStM_I.sm "Class for supply of e-machine values, e-machine 01 / State machine instance see ElM_IvtrTqAbsltLimStM / state machine enumation of its states" UBYTE ElM_IvtrTqAbsltLimStM_sm_VERB 1 100 0.00 2.00000000000 FORMAT "%13.11" ECU_ADDRESS 0x600009BB
 /begin IF_DATA XCPplus 0x0102
  /begin DAQ_EVENT VARIABLE /end DAQ_EVENT
 /end IF_DATA
/end MEASUREMENT
/begin MEASUREMENT Emac_facEff01 "Efficiency e-machine 01" SWORD PSC_Fact 1 100 -1.000031 1.000000 FORMAT "%8.6" ECU_ADDRESS 0x6001FB28
 /begin IF_DATA XCPplus 0x0102
  /begin DAQ_EVENT VARIABLE /end DAQ_EVENT
 /end IF_DATA
/end MEASUREMENT
/begin MEASUREMENT Emac_flgDsbcCtlActvd01 "Surge damping control is active, e-machine 01" UBYTE B_TRUE 1 100 0.00 1.00000000000 BIT_MASK 0x1 FORMAT "%13.11" ECU_ADDRESS 0x60023496
 /begin IF_DATA XCPplus 0x0102
  /begin DAQ_EVENT VARIABLE /end DAQ_EVENT
 /end IF_DATA
/end MEASUREMENT
/begin MEASUREMENT Emac_iDcLnk01 "DC link current" SWORD Curr_A_q0p03125_COMPU 1 100 -1024.000 1023.969 FORMAT "%8.3" ECU_ADDRESS 0x6001FB22
 /begin IF_DATA XCPplus 0x0102
  /begin DAQ_EVENT VARIABLE /end DAQ_EVENT
 /end IF_DATA
/end MEASUREMENT
/begin MEASUREMENT Emac_iDcLnk01_Sq "Signal quality for DC link current, e-machine 01" UBYTE SigQly_COMPU_VERB 1 100 0.00 15.0000000000 FORMAT "%13.10" ECU_ADDRESS 0x60023589
 /begin IF_DATA XCPplus 0x0102
  /begin DAQ_EVENT VARIABLE /end DAQ_EVENT
 /end IF_DATA
/end MEASUREMENT
/begin MEASUREMENT Emac_nAct01 "Actual engine speed, e-machine 01 (gear-lever-mapped)" SWORD nmot_q1 1 100 -32768.00 32767.00 FORMAT "%8.2" ECU_ADDRESS 0x6001FB20
 /begin IF_DATA XCPplus 0x0102
  /begin DAQ_EVENT VARIABLE /end DAQ_EVENT
 /end IF_DATA
/end MEASUREMENT
/begin MEASUREMENT Emac_nAct01_Sq "Signal quality for actual engine speed, e-machine 01" UBYTE SigQly_COMPU_VERB 1 100 0.00 15.0000000000 FORMAT "%13.10" ECU_ADDRESS 0x60023588
 /begin IF_DATA XCPplus 0x0102
  /begin DAQ_EVENT VARIABLE /end DAQ_EVENT
 /end IF_DATA
/end MEASUREMENT
/begin MEASUREMENT Emac_nActPhy01 "actual speed of e-machine 01" SWORD nmot_q1 1 100 -32768.00 32767.00 FORMAT "%8.2" ECU_ADDRESS 0x6001FB1E
 /begin IF_DATA XCPplus 0x0102
  /begin DAQ_EVENT VARIABLE /end DAQ_EVENT
 /end IF_DATA
/end MEASUREMENT
/begin MEASUREMENT Emac_nActPhy01_Sq "Signal qualifier for actual speed of e-machine 01" UBYTE SigQly_COMPU_VERB 1 100 0.00 15.0000000000 FORMAT "%13.10" ECU_ADDRESS 0x60023587
 /begin IF_DATA XCPplus 0x0102
  /begin DAQ_EVENT VARIABLE /end DAQ_EVENT
 /end IF_DATA
/end MEASUREMENT
/begin MEASUREMENT Emac_pwrAct01 "Actual power, e-machine 01" SWORD leist_q16_W 1 100 -524288.0 524272.0 FORMAT "%8.1" ECU_ADDRESS 0x6001FB18
 /begin IF_DATA XCPplus 0x0102
  /begin DAQ_EVENT VARIABLE /end DAQ_EVENT
 /end IF_DATA
/end MEASUREMENT
/begin MEASUREMENT Emac_pwrAct01_Sq "Signal Quality of EMachine 1 Actual Power" UBYTE SigQly_COMPU_VERB 1 100 0.00 15.0000000000 FORMAT "%13.10" ECU_ADDRESS 0x60023586
 /begin IF_DATA XCPplus 0x0102
  /begin DAQ_EVENT VARIABLE /end DAQ_EVENT
 /end IF_DATA
/end MEASUREMENT
/begin MEASUREMENT Emac_pwrActMecl01 "Actual mechanical power of e-machine 01" SWORD leist_q16_W 1 100 -524288.0 524272.0 FORMAT "%8.1" ECU_ADDRESS 0x6001FB16
 /begin IF_DATA XCPplus 0x0102
  /begin DAQ_EVENT VARIABLE /end DAQ_EVENT
 /end IF_DATA
/end MEASUREMENT
/begin MEASUREMENT Emac_pwrActMecl01_Sq "Signal quality for actual mechanical power, e-machine 01" UBYTE SigQly_COMPU_VERB 1 100 0.00 15.0000000000 FORMAT "%13.10" ECU_ADDRESS 0x60023585
 /begin IF_DATA XCPplus 0x0102
  /begin DAQ_EVENT VARIABLE /end DAQ_EVENT
 /end IF_DATA
/end MEASUREMENT
/begin MEASUREMENT Emac_pwrLossAbslt01 "power loss of inverter and e-machine, abs. value01" SWORD leist_q16_W 1 100 -524288.0 524272.0 FORMAT "%8.1" ECU_ADDRESS 0x6001FB14
 /begin IF_DATA XCPplus 0x0102
  /begin DAQ_EVENT VARIABLE /end DAQ_EVENT
 /end IF_DATA
/end MEASUREMENT
/begin MEASUREMENT Emac_pwrLossAbslt01_Sq "Signal quality for power loss of inverter01 and e-machine01, abs. value01" UBYTE SigQly_COMPU_VERB 1 100 0.00 15.0000000000 FORMAT "%13.10" ECU_ADDRESS 0x60023584
 /begin IF_DATA XCPplus 0x0102
  /begin DAQ_EVENT VARIABLE /end DAQ_EVENT
 /end IF_DATA
/end MEASUREMENT
/begin MEASUREMENT Emac_ratTEstimnInvr01 "Estimated inverter temperature (Emac 1)" SWORD PSC_Fact 1 100 -1.000031 1.000000 FORMAT "%8.6" ECU_ADDRESS 0x6001FB12
 /begin IF_DATA XCPplus 0x0102
  /begin DAQ_EVENT VARIABLE /end DAQ_EVENT
 /end IF_DATA
/end MEASUREMENT
/begin MEASUREMENT Emac_ratTEstimnInvr01_Sq "Signal quality for estimated inverter temperature, e-machine 01" UBYTE SigQly_COMPU_VERB 1 100 0.00 15.0000000000 FORMAT "%13.10" ECU_ADDRESS 0x60023583
 /begin IF_DATA XCPplus 0x0102
  /begin DAQ_EVENT VARIABLE /end DAQ_EVENT
 /end IF_DATA
/end MEASUREMENT
/begin MEASUREMENT Emac_ratTEstimnMac01 "Estimated load index for electric engine (Emac 1)" SWORD PSC_Fact 1 100 -1.000031 1.000000 FORMAT "%8.6" ECU_ADDRESS 0x6001FB10
 /begin IF_DATA XCPplus 0x0102
  /begin DAQ_EVENT VARIABLE /end DAQ_EVENT
 /end IF_DATA
/end MEASUREMENT
/begin MEASUREMENT Emac_tqAbsltMax01 "Maximum absolute torque, e-machine 01" SWORD Trq 1 100 -3276.800 3276.700 FORMAT "%8.3" ECU_ADDRESS 0x6001FB0E
 /begin IF_DATA XCPplus 0x0102
  /begin DAQ_EVENT VARIABLE /end DAQ_EVENT
 /end IF_DATA
/end MEASUREMENT
/begin MEASUREMENT Emac_tqAbsltMax01_Sq "Signal quality for maximum absolute torque limit, e-machine 01" UBYTE SigQly_COMPU_VERB 1 100 0.00 15.0000000000 FORMAT "%13.10" ECU_ADDRESS 0x60023580
 /begin IF_DATA XCPplus 0x0102
  /begin DAQ_EVENT VARIABLE /end DAQ_EVENT
 /end IF_DATA
/end MEASUREMENT
/begin MEASUREMENT Emac_tqAbsltMin01 "Minimum absolute torque, e-machine 01" SWORD Trq 1 100 -3276.800 3276.700 FORMAT "%8.3" ECU_ADDRESS 0x6001FB0C
 /begin IF_DATA XCPplus 0x0102
  /begin DAQ_EVENT VARIABLE /end DAQ_EVENT
 /end IF_DATA
/end MEASUREMENT
/begin MEASUREMENT Emac_tqAbsltMin01_Sq "Signal quality for minimum absolute torque limit, e-machine 01" UBYTE SigQly_COMPU_VERB 1 100 0.00 15.0000000000 FORMAT "%13.10" ECU_ADDRESS 0x6002357F
 /begin IF_DATA XCPplus 0x0102
  /begin DAQ_EVENT VARIABLE /end DAQ_EVENT
 /end IF_DATA
/end MEASUREMENT
/begin MEASUREMENT Emac_tqAct01 "Actual torque e-machine 01 (gear-lever-mapped)" SWORD Trq 1 100 -3276.800 3276.700 FORMAT "%8.3" ECU_ADDRESS 0x6001FB0A
 /begin IF_DATA XCPplus 0x0102
  /begin DAQ_EVENT VARIABLE /end DAQ_EVENT
 /end IF_DATA
/end MEASUREMENT
/begin MEASUREMENT Emac_tqAct01_Sq "Signal quality for Actual torque, e-machine 01" UBYTE SigQly_COMPU_VERB 1 100 0.00 15.0000000000 FORMAT "%13.10" ECU_ADDRESS 0x6002357E
 /begin IF_DATA XCPplus 0x0102
  /begin DAQ_EVENT VARIABLE /end DAQ_EVENT
 /end IF_DATA
/end MEASUREMENT
/begin MEASUREMENT Emac_tqActWoDsbcCtl01 "Actual torque without disturbance control" SWORD Trq 1 100 -3276.800 3276.700 FORMAT "%8.3" ECU_ADDRESS 0x6001FB08
 /begin IF_DATA XCPplus 0x0102
  /begin DAQ_EVENT VARIABLE /end DAQ_EVENT
 /end IF_DATA
/end MEASUREMENT
/begin MEASUREMENT Emac_tqActWoDsbcCtl01_Sq "Signal quality for actual torque without disturbance control, e-machine 01" UBYTE SigQly_COMPU_VERB 1 100 0.00 15.0000000000 FORMAT "%13.10" ECU_ADDRESS 0x6002357D
 /begin IF_DATA XCPplus 0x0102
  /begin DAQ_EVENT VARIABLE /end DAQ_EVENT
 /end IF_DATA
/end MEASUREMENT
/begin MEASUREMENT Emac_tqEngMax01 "Maximum absolute torque, e-machine 01" SWORD Trq 1 100 -3276.800 3276.700 FORMAT "%8.3" ECU_ADDRESS 0x6001FB04
 /begin IF_DATA XCPplus 0x0102
  /begin DAQ_EVENT VARIABLE /end DAQ_EVENT
 /end IF_DATA
/end MEASUREMENT
/begin MEASUREMENT Emac_tqEngMax01_Sq "Signal quality for maximum absolute torque, e-machine 01" UBYTE SigQly_COMPU_VERB 1 100 0.00 15.0000000000 FORMAT "%13.10" ECU_ADDRESS 0x6002357C
 /begin IF_DATA XCPplus 0x0102
  /begin DAQ_EVENT VARIABLE /end DAQ_EVENT
 /end IF_DATA
/end MEASUREMENT
/begin MEASUREMENT Emac_tqEngMin01 "Minimum absolute torque, e-machine 01" SWORD Trq 1 100 -3276.800 3276.700 FORMAT "%8.3" ECU_ADDRESS 0x6001FB02
 /begin IF_DATA XCPplus 0x0102
  /begin DAQ_EVENT VARIABLE /end DAQ_EVENT
 /end IF_DATA
/end MEASUREMENT
/begin MEASUREMENT Emac_tqEngMin01_Sq "Signal quality for minimum absolute torque, e-machine 01" UBYTE SigQly_COMPU_VERB 1 100 0.00 15.0000000000 FORMAT "%13.10" ECU_ADDRESS 0x6002357B
 /begin IF_DATA XCPplus 0x0102
  /begin DAQ_EVENT VARIABLE /end DAQ_EVENT
 /end IF_DATA
/end MEASUREMENT
/begin MEASUREMENT Emac_uDcLnk01 "DC link voltage" SWORD Volt_V_q0p03125_COMPU 1 100 -1024.000 1023.969 FORMAT "%8.3" ECU_ADDRESS 0x6001FAF8
 /begin IF_DATA XCPplus 0x0102
  /begin DAQ_EVENT VARIABLE /end DAQ_EVENT
 /end IF_DATA
/end MEASUREMENT
/begin MEASUREMENT Emac_uDcLnk01_Sq "Signal quality for DC link voltage, e-machine 01" UBYTE SigQly_COMPU_VERB 1 100 0.00 15.0000000000 FORMAT "%13.10" ECU_ADDRESS 0x6002357A
 /begin IF_DATA XCPplus 0x0102
  /begin DAQ_EVENT VARIABLE /end DAQ_EVENT
 /end IF_DATA
/end MEASUREMENT
/begin FUNCTION DrvStblt_DD "1.4.0     Driver Seatbelt Device Driver" /begin DEF_CHARACTERISTIC DrvStblt_tiHiLoComDrvStblt_C DrvStblt_tiLoHiComDrvStblt_C /end DEF_CHARACTERISTIC /begin IN_MEASUREMENT Com_stDrvStblt /end IN_MEASUREMENT
 /begin OUT_MEASUREMENT DINH_nrActvInhReas.FId_DrvStbltCANSigFault DINH_stFId.FId_DrvStbltCANSigFault DrvStblt_bFault DrvStblt_bOpnLoc /end OUT_MEASUREMENT
 FUNCTION_VERSION "1.4.0" /end FUNCTION
/begin FUNCTION DrvStblt_VD "1.3.0     Driver Seatbelt Virtual Driver"
 /begin DEF_CHARACTERISTIC DDRC_DurDeb.DrvStblt_tiOpnDebOk_C DDRC_DurDeb.DrvStblt_tiOpnDebDef_C DFC_CtlMsk2.DFC_DrvStbltOpn_C DFC_DisblMsk2.DFC_DrvStbltOpn_C DrvStblt_bOpnRepl_C /end DEF_CHARACTERISTIC
 /begin IN_MEASUREMENT DrvStblt_bFault DrvStblt_bOpnLoc /end IN_MEASUREMENT
 /begin OUT_MEASUREMENT DDRC_St.DFC_DrvStbltOpn DFC_st.DFC_DrvStbltOpn DrvStblt_bOpn /end OUT_MEASUREMENT
 FUNCTION_VERSION "1.3.0" /end FUNCTION
/begin FUNCTION DSCHED_Cal "2.0.0     Diagnostic Scheduler Calibration" FUNCTION_VERSION "2.0.0" /end FUNCTION
/begin FUNCTION DSCHED_Eval "30002.2.0 Diagnostic Scheduler Evaluation" FUNCTION_VERSION "30002.2.0" /end FUNCTION
/begin FUNCTION DSM2AUTOSAR "30000.62.0AUTOSAR Layer to DSM"
 /begin IN_MEASUREMENT Dem_disableEventStatusUpdateGroup DFES_stErrLamp DFES_stOutstate /end IN_MEASUREMENT
 /begin LOC_MEASUREMENT Dem_BswErrorBufferWriteCounter Dem_BswErrorBufferWriteIndex Dem_PTOSt Dem_stInit /end LOC_MEASUREMENT
 FUNCTION_VERSION "30000.62.0" /end FUNCTION
/begin FUNCTION DSMAppl_FadeOut "30150.0.0 DSM Fade Out Conditions"
 /begin DEF_CHARACTERISTIC DSM_tiComNetNormModeTurnOffDly_C DSM_tiHiBattTurnOffDly_C DSM_tiLoBattTurnOffDly_C DSM_tiPostDrvTurnOffDly_C DSM_tiPreDrvNormModeTurnOffDly_C DSM_tiPreDrvShdwnTurnOffDly_C DSM_tiPreDrvWakeupTurnOffDly_C DSM_tiPwtstateTurnOffDly_C DSM_tiT15RisngTurnOffDly_C DSM_tiVehStChrgnTurnOffDly_C DSM_uHighBattHysHi_C DSM_uHighBattHysLo_C DSM_uLowBattHysHi_C DSM_uLowBattHysLo_C /end DEF_CHARACTERISTIC
 /begin IN_MEASUREMENT BattU_u Com_stNMStM CoPtFH_stPwt SyC_stSub SyC_stSubOld T15_st VehCoorn_flgChrgReq /end IN_MEASUREMENT
 /begin OUT_MEASUREMENT DSM_stFadeOut /end OUT_MEASUREMENT
 FUNCTION_VERSION "30150.0.0" /end FUNCTION
/begin FUNCTION DSMAux "30000.52.0DSM Auxiliary"
 /begin DEF_CHARACTERISTIC DSMAUX_WucDet_pEnvMin_C DSMAUX_WucDet_rAPPMax_C DSMAUX_WucDet_tEnvMin_C DSMAUX_WucDet_tiIdlMin_C DSMAUX_WucDet_tiOpMin_C DSMAUX_WucDet_tiVehSpdMin_C DSMAUX_WucDet_vVehIdlMax_C DSMAUX_WucDet_vVehMin_C DSMAUX_xClearMode_C DSMAUX_xClearTrg_C DSMAUX_xClrRtTrg_C /end DEF_CHARACTERISTIC
 /begin IN_MEASUREMENT SyC_ctPostDrvLeave SyC_stSub /end IN_MEASUREMENT
 /begin OUT_MEASUREMENT DINH_nrActvInhReas.FId_DSMAUXWucVrnt5 DINH_stFId.FId_DSMAUXWucVrnt5 DSMAUX_ctObdDCy_msg DSMAUX_ctWUC DSMAUX_ctWUC_msg DSMAUX_DTRG.DTRG_Time200ms DSMAUX_DTRG.DTRG_AlwaysTrue DSMAUX_DTRG.DTRG_DrivingCycleFLC DSMAUX_DTRG.DTRG_DrivingCycleHLC DSMAUX_DTRG.DTRG_NoTrigger DSMAUX_DTRG.DTRG_WarmUpCycle DSMAUX_stDCy DSMAUX_stDCy_msg DSMAUX_stDsmClrActv DSM_TripChgAndClrFinshd DSM_TripChgFinshd /end OUT_MEASUREMENT
 /begin LOC_MEASUREMENT DFC_idxDfcTrans DSMAUX_altWucCond DSMAUX_ctObdDCy DSMAUX_flgReiniTaskRunning DSMAUX_stClrTaskFin DSMAUX_stStrtEnd DSMAUX_stTranGlbJob DSMAUX_stTranReq DSMAUX_tClntStrt DSMAUX_tiEngOpCum DSMAUX_tiIdl DSMAUX_tiLastReini DSMAUX_tiMaxReini DSMAUX_tiVehSpdCum DSM_stPostDrive DSM_stReInit /end LOC_MEASUREMENT
 FUNCTION_VERSION "30000.52.0" /end FUNCTION
/begin FUNCTION DSMDur "30000.14.0DSM Duration Counters" /begin OUT_MEASUREMENT DSMDur_ctPID21h DSMDur_ctPID31h /end OUT_MEASUREMENT /begin LOC_MEASUREMENT DSMDur_lRef10m DSMDur_stPID21h DSMDur_stWUCLst /end LOC_MEASUREMENT FUNCTION_VERSION "30000.14.0" /end FUNCTION
/begin FUNCTION DSMRdy "30000.22.0DSM Readiness"
 /begin DEF_CHARACTERISTIC DSMRdy_Grp.FlSys_CA DSMRdy_Grp.Cat_CA DSMRdy_Grp.HtCat_CA DSMRdy_Grp.EvpSys_CA DSMRdy_Grp.SecAirSys_CA DSMRdy_Grp.O2Sens_CA DSMRdy_Grp.O2SensHt_CA DSMRdy_Grp.EGR_CA DSMRdy_X.PID1ForceLowMsk_C DSMRdy_X.PID1ForceHighMsk_C DSMRdy_X.PID41ForceLowMsk_C DSMRdy_X.PID41ForceHighMsk_C /end DEF_CHARACTERISTIC
 /begin OUT_MEASUREMENT DSMRdy_xPId1 /end OUT_MEASUREMENT
 /begin LOC_MEASUREMENT DSMRdy_stGrpRdy DSMRdy_stGrpRdyDFES DSMRdy_stGrpRdyScan DSMRdy_stGrpSup /end LOC_MEASUREMENT
 FUNCTION_VERSION "30000.22.0" /end FUNCTION
/begin FUNCTION DSM_Conf "30150.3.0 DSM Kernel configuration"
 /begin DEF_CHARACTERISTIC DFC_CtlMsk2.DFC_SWReset_0_C DFC_CtlMsk2.DFC_SWReset_1_C DFC_CtlMsk2.DFC_SWReset_2_C DFC_DisblMsk2.DFC_SWReset_0_C DFC_DisblMsk2.DFC_SWReset_1_C DFC_DisblMsk2.DFC_SWReset_2_C /end DEF_CHARACTERISTIC
 /begin IN_MEASUREMENT APP_r CoPtFH_stPwt DSM_stFadeOut EnvP_p EnvT_t VehV_v /end IN_MEASUREMENT
 /begin OUT_MEASUREMENT DFC_st.DFC_SWReset_0 DFC_st.DFC_SWReset_1 DFC_st.DFC_SWReset_2 /end OUT_MEASUREMENT
 /begin LOC_MEASUREMENT DSM_DisblMode_mp DSM_pEnv DSM_rAPP DSM_stStrEnd DSM_tEnv DSM_vVeh /end LOC_MEASUREMENT
 FUNCTION_VERSION "30150.3.0" /end FUNCTION
/begin FUNCTION DSM_DTRCompu "1.26.0    DSM DTR computation methods" FUNCTION_VERSION "1.26.0" /end FUNCTION
/begin FUNCTION DSQ "30000.10.0Diagnostic Signal Quality" FUNCTION_VERSION "30000.10.0" /end FUNCTION
/begin FUNCTION DTR "30001.1.0 Diagnostic Test Results for Service 0x06" FUNCTION_VERSION "30001.1.0" /end FUNCTION
/begin FUNCTION Ebs_VD "1400.3.0  virtual driver Electrical Battery Sensor"
 /begin DEF_CHARACTERISTIC DDRC_DurDeb.Ebs_tiEbsSnsrStDebOk_C DDRC_DurDeb.Ebs_tiEbsSnsrStDebDef_C DDRC_DurDeb.Ebs_tiLvBattSocDiagLoDebOk_C DDRC_DurDeb.Ebs_tiLvBattSocDiagLoDebDef_C DDRC_DurDeb.Ebs_tiLvBattUDiagFltLvl1DebOk_C DDRC_DurDeb.Ebs_tiLvBattUDiagFltLvl1DebDef_C DDRC_DurDeb.Ebs_tiLvBattUDiagFltLvl2DebOk_C DDRC_DurDeb.Ebs_tiLvBattUDiagFltLvl2DebDef_C DDRC_DurDeb.Ebs_tiLvBattUDiagLoDebOk_C DDRC_DurDeb.Ebs_tiLvBattUDiagLoDebDef_C DDRC_DurDeb.Ebs_tiLvBusUDiagDiOperDebOk_C DDRC_DurDeb.Ebs_tiLvBusUDiagDiOperDebDef_C DDRC_DurDeb.Ebs_tiSofASILErrDebOk_C DDRC_DurDeb.Ebs_tiSofASILErrDebDef_C DFC_CtlMsk2.DFC_EbsLvBattSocDiagLo_C DFC_CtlMsk2.DFC_EbsLvBattUDiagDiOper_C DFC_CtlMsk2.DFC_EbsLvBattUDiagFltLvl1_C DFC_CtlMsk2.DFC_EbsLvBattUDiagFltLvl2_C DFC_CtlMsk2.DFC_EbsLvBattUDiagLo_C DFC_CtlMsk2.DFC_EbsSnsrSt_C DFC_CtlMsk2.DFC_EbsSofASILErr_C DFC_DisblMsk2.DFC_EbsLvBattSocDiagLo_C DFC_DisblMsk2.DFC_EbsLvBattUDiagDiOper_C DFC_DisblMsk2.DFC_EbsLvBattUDiagFltLvl1_C DFC_DisblMsk2.DFC_EbsLvBattUDiagFltLvl2_C DFC_DisblMsk2.DFC_EbsLvBattUDiagLo_C DFC_DisblMsk2.DFC_EbsSnsrSt_C DFC_DisblMsk2.DFC_EbsSofASILErr_C Ebs_flgBattSocSeln_C Ebs_flgBattTSeln_C Ebs_flgStSohRedQlyInvld_C Ebs_iBattRepl_C Ebs_iS16MaxLim_C Ebs_iS16MinLim_C Ebs_maskBattSigFltSq_C Ebs_qSohRepl_C Ebs_ratSocLvBattLo_C Ebs_ratSocRepl_C Ebs_ratSohBattRepl_C Ebs_stErrMsk_C Ebs_swtCtl_C Ebs_tBattRepl_C Ebs_tiSocFil_C Ebs_tiSohFil_C Ebs_tiTBattFil_C Ebs_tiTLvBattFil_C Ebs_tiUBattFil_C Ebs_tLvBattFilIni_C Ebs_tLvBattRepl_C Ebs_uBattRepl_C Ebs_uBattSofAsilMinRmn_C Ebs_uFildLvBattFltDiOper_C Ebs_uFildLvBattFltLvl1_C Ebs_uFildLvBattFltLvl2_C Ebs_uFildLvBattLoHeal_C Ebs_uFildLvBattLo_C Ebs_uLvBattFltDiOper_C Ebs_uLvBattFltLvl1_C Ebs_uLvBattFltLvl2_C Ebs_uLvBattLoHeal_C Ebs_uLvBattLo_C Ebs_uSofAsilErr_T Ebs_uSofFild_C EEM_chBatt_C /end DEF_CHARACTERISTIC
 /begin IN_MEASUREMENT BattU_u BattU_u_Sq Com_bEbsComErr Com_bErrClb Com_bErrIdn Com_bInCstnc Com_iBattEBS Com_qSoh Com_ratSoc Com_ratSocLvBatt Com_ratSoh Com_stDcdcULimReq Com_stDcdcULimReq_Sq Com_stI Com_stIRng Com_stSoc Com_stSofASILErr Com_stSoh Com_stT Com_stU Com_tBattEBS Com_tLvBatt Com_uBattEBS Com_uSofASIL /end IN_MEASUREMENT
 /begin OUT_MEASUREMENT DDRC_St.DFC_EbsLvBattSocDiagLo DDRC_St.DFC_EbsLvBattUDiagDiOper DDRC_St.DFC_EbsLvBattUDiagFltLvl1 DDRC_St.DFC_EbsLvBattUDiagFltLvl2 DDRC_St.DFC_EbsLvBattUDiagLo DDRC_St.DFC_EbsSnsrSt DDRC_St.DFC_EbsSofASILErr DFC_st.DFC_EbsLvBattSocDiagLo DFC_st.DFC_EbsLvBattUDiagDiOper DFC_st.DFC_EbsLvBattUDiagFltLvl1 DFC_st.DFC_EbsLvBattUDiagFltLvl2 DFC_st.DFC_EbsLvBattUDiagLo DFC_st.DFC_EbsSnsrSt DFC_st.DFC_EbsSofASILErr DINH_nrActvInhReas.FId_EbsLinErr DINH_stFId.FId_EbsLinErr Ebs_flgRst Ebs_flgTestPlsReq Ebs_iBattFild Ebs_iBattFild_Sq Ebs_qSohFild Ebs_qSohFild_Sq Ebs_ratSocFild Ebs_ratSocFild_Sq Ebs_ratSohFild Ebs_ratSohFild_Sq Ebs_stDcdcULimReq Ebs_stDcdcULimReq_Sq Ebs_stErr Ebs_tBattFild Ebs_tBattFild_Sq Ebs_tLvBatt Ebs_tLvBatt_Sq Ebs_uBattFild Ebs_uBattFild_Sq Ebs_uSofFild EEM_chBatt EEM_stBattChAc /end OUT_MEASUREMENT
 /begin LOC_MEASUREMENT Ebs_flgUSofAsilErr Ebs_uSofAsilRmn /end LOC_MEASUREMENT
 FUNCTION_VERSION "1400.3.0" /end FUNCTION
/begin FUNCTION EChrDv_Adpr "5516.3.0  Interface adapter for electrical charging devices"
 /begin DEF_CHARACTERISTIC DFC_CtlMsk2.DFC_EChrDvPlinCntrThdExcdd_C DFC_DisblMsk2.DFC_EChrDvPlinCntrThdExcdd_C EChrDv_cntPlinThd_C EChrDv_tiCtpAndPxpDetnWakeup_C EChrDv_tiCtpAndPxpDetn_C EChrDv_tiPxpDetnWakeup_C EChrDv_tiPxpDetn_C /end DEF_CHARACTERISTIC
 /begin IN_MEASUREMENT ChgrPlug_stCtpDetd ChgrPlug_stPxPCcs ChrgMod_flgChrgnRetry SWAdp_flgChrgNmComReq /end IN_MEASUREMENT
 /begin OUT_MEASUREMENT ChgrPlug_flgPxpAndCtpDetn ChgrPlug_flgPxpAndCtpDetnPls ChgrPlug_flgPxpDetn ChgrPlug_flgPxpDetnPls DFC_st.DFC_EChrDvPlinCntrThdExcdd EChrDv_cntPlin /end OUT_MEASUREMENT
 /begin LOC_MEASUREMENT EChrDv_cntPlinValAvs EChrDv_flgCtpAndPxpDetn EChrDv_flgCtpDetn EChrDv_flgPlinCntrThdExcdd EChrDv_flgPxpDetn EChrDv_stSetAvs /end LOC_MEASUREMENT
 FUNCTION_VERSION "5516.3.0" /end FUNCTION
/begin FUNCTION EChrDv_GlbDef "5500.3.0  Global definitions for BC EChrDv" FUNCTION_VERSION "5500.3.0" /end FUNCTION
/begin FUNCTION Eem_ChrgrSuprt "1.1.0     Charger Support" /begin DEF_CHARACTERISTIC Eem_pwrBascAuxUnitLoad_C /end DEF_CHARACTERISTIC /begin IN_MEASUREMENT HvGrid_pwrAcsyAct HvGrid_pwrAcsyCalc /end IN_MEASUREMENT
 /begin OUT_MEASUREMENT Eem_pwrAuxUnitLoad Eem_pwrAuxUnitLoadHi Eem_pwrAuxUnitLoadLo Eem_pwrBascAuxUnitLoad /end OUT_MEASUREMENT
 FUNCTION_VERSION "1.1.0" /end FUNCTION
/begin FUNCTION Eem_Diag "1.1.0     Diagnosis for electrical energy management"
 /begin DEF_CHARACTERISTIC DFC_CtlMsk2.DFC_EemDiagCtctrClsTout_C DFC_CtlMsk2.DFC_EemDiagDcdcOffTOut_C DFC_CtlMsk2.DFC_EemDiagHvCnsrOffTOut_C DFC_CtlMsk2.DFC_EemDiagHvbOffTOut_C DFC_DisblMsk2.DFC_EemDiagCtctrClsTout_C DFC_DisblMsk2.DFC_EemDiagDcdcOffTOut_C DFC_DisblMsk2.DFC_EemDiagHvCnsrOffTOut_C DFC_DisblMsk2.DFC_EemDiagHvbOffTOut_C Eem_tiToutCtctrCls_C Eem_tiToutDcdc_C Eem_tiToutHvb_C Eem_tiToutHvCnsr_C /end DEF_CHARACTERISTIC
 /begin IN_MEASUREMENT Eem_stHvLoc /end IN_MEASUREMENT
 /begin OUT_MEASUREMENT DFC_st.DFC_EemDiagCtctrClsTout DFC_st.DFC_EemDiagDcdcOffTOut DFC_st.DFC_EemDiagHvCnsrOffTOut DFC_st.DFC_EemDiagHvbOffTOut /end OUT_MEASUREMENT
 /begin LOC_MEASUREMENT Eem_tiSt /end LOC_MEASUREMENT
 FUNCTION_VERSION "1.1.0" /end FUNCTION
/begin FUNCTION Eem_ProlgEcuActv "1400.0.0  Prolonge Ecu Active" /begin IN_MEASUREMENT Eem_stHv SyC_stSub /end IN_MEASUREMENT /begin OUT_MEASUREMENT Eem_flgProlgEcuActvPost Eem_flgProlgEcuActvPre /end OUT_MEASUREMENT FUNCTION_VERSION "1400.0.0" /end FUNCTION
/begin FUNCTION Eem_StDcdcCtrlr "2.3.0     Dcdc State controller"
 /begin DEF_CHARACTERISTIC DFC_CtlMsk2.DFC_EemDcdcPrecSpdInhb_C DFC_DisblMsk2.DFC_EemDcdcPrecSpdInhb_C Eem_maskpwrMaxDchaContnsSq_C Eem_pwrHvBattLimDcdc_C Eem_vVehLimDcdc_C /end DEF_CHARACTERISTIC
 /begin IN_MEASUREMENT Eem_stHvLoc HvBatt_pwrMaxDchaContns HvBatt_pwrMaxDchaContns_Sq HvGrid_pwrAcsyCalc VehV_v /end IN_MEASUREMENT
 /begin OUT_MEASUREMENT DFC_st.DFC_EemDcdcPrecSpdInhb DINH_nrActvInhReas.FId_EemDcdcPrecErr DINH_stFId.FId_EemDcdcPrecErr Eem_stDesDcdc /end OUT_MEASUREMENT
 FUNCTION_VERSION "2.3.0" /end FUNCTION
/begin FUNCTION Eem_StMac "1400.3.0  State engine to steer electrical energie management"
 /begin DEF_CHARACTERISTIC Eem_flgChngOfMndInOpng_C Eem_flgFatalExWait_C Eem_maskComEmacUDcLnk01Sq_C Eem_maskComStHvbCntctSq_C Eem_maskDcdcUHvActSq_C Eem_nr2OffSelector_T Eem_nrOffSelector_T Eem_nrPreSelector_T Eem_uDcdcHvLimLo_C Eem_uDcdcHvLimSafe_C Eem_vActvDchaThd_C /end DEF_CHARACTERISTIC
 /begin IN_MEASUREMENT ComEmac_uDcLnk01_Sq Com_stHvbCntct_Sq Dcdc_stEem Dcdc_uHvAct Dcdc_uHvAct_Sq ElM_stEem01 ElSS_stEem03 ElSS_stEem04 ElSS_stEem05 ElSS_stEem06 ElSS_stEem07 ElSS_stEem08 Emac_uDcLnk01 HvBatt_flgHvActvnEnad HvBatt_stMaiSwtAct T15_st VehCoorn_st VehV_v /end IN_MEASUREMENT
 /begin OUT_MEASUREMENT DINH_nrActvInhReas.FId_EemDcdcUHVAct DINH_nrActvInhReas.FId_EemFltHvDcha DINH_nrActvInhReas.FId_EemFstHvShdwn DINH_nrActvInhReas.FId_EemHvBattMod DINH_nrActvInhReas.FId_EemHvOffTout DINH_nrActvInhReas.FId_EemHvShdwn DINH_nrActvInhReas.FId_EemNoHvStrtup DINH_nrActvInhReas.FId_EmacUDcLnk01 DINH_stFId.FId_EemDcdcUHVAct DINH_stFId.FId_EemFltHvDcha DINH_stFId.FId_EemFstHvShdwn DINH_stFId.FId_EemHvBattMod DINH_stFId.FId_EemHvOffTout DINH_stFId.FId_EemHvShdwn DINH_stFId.FId_EemNoHvStrtup DINH_stFId.FId_EmacUDcLnk01 Eem_flgFltHvDchaReq Eem_flgFstHvShdwn Eem_flgHvDchaReq Eem_flgHvShdwnFlt Eem_flgSetMaiSwtHvBattClsd Eem_stHv Eem_stHvLoc /end OUT_MEASUREMENT
 /begin LOC_MEASUREMENT Eem_flgFatalEx Eem_flgFltMaiSwtOff Eem_flgHvDchaReqLoc Eem_flgHVOffTout Eem_flgHvShdwn Eem_flgNoHvStrtup Eem_flgOffHvOn Eem_flgPreHvOn Eem_flgSetMaiSwtHvBattClsdLoc /end LOC_MEASUREMENT
 FUNCTION_VERSION "1400.3.0" /end FUNCTION
/begin FUNCTION ElM_Engine "1400.0.0  Handling of electrical machine"
 /begin DEF_CHARACTERISTIC ElM_flgEnaFrbdnQdrLockgOddAxle_C ElM_flgEnaQdrMpgOddAxle_C ElM_flgSwtIvtDirEm01_C Emac_EngGen01_I.ElM_maskComEmacInvldSq_C Emac_EngGen01_I.ElM_nrSmplAvrgFlt_C Emac_EngGen01_I.ElM_pwrActDft_C Emac_EngGen01_I.ElM_pwrActMeclDft_C Emac_EngGen01_I.ElM_pwrLossAbsltDft_C Emac_EngGen01_I.ElM_rPrdcTActRtr_C Emac_EngGen01_I.ElM_rPrdcTActSttr_C Emac_EngGen01_I.ElM_rRelTActInv_CUR Emac_EngGen01_I.ElM_rRelTActRtr_CUR Emac_EngGen01_I.ElM_rRelTActSttr_CUR Emac_EngGen01_I.ElM_stDstCActvApp_C Emac_EngGen01_I.ElM_stTrqWoAntiRuckelApp_C Emac_EngGen01_I.ElM_swtEffMapVal_C Emac_EngGen01_I.ElM_tDft_C Emac_EngGen01_I.ElM_tLimnTqDft_C Emac_EngGen01_I.ElM_tiNActPhyFlt_C Emac_EngGen01_I.Elm_flgInvrMotGenrTqLim_C Emac_EngGen01_I.Emac_facEff_C Emac_EngGen01_I.Emac_facEff_M Emac_EngGen01_I.Emac_tqAbsltMaxDft_C Emac_EngGen01_I.Emac_tqAbsltMinDft_C Emac_EngGen01_I.ElM_IvtrTqAbsltLimStM_I.tiIvtrTqLimDeb_C /end DEF_CHARACTERISTIC
 /begin IN_MEASUREMENT ComEmac_flgActvdDsbcCtl01 ComEmac_iDcLnk01 ComEmac_iDcLnk01_Sq ComEmac_nAct01 ComEmac_nAct01_Sq ComEmac_tInvr01 ComEmac_tInvr01_Sq ComEmac_tIvtrCoolt01 ComEmac_tIvtrCoolt01_Sq ComEmac_tMac01 ComEmac_tMac01_Sq ComEmac_tqAbsltMax01 ComEmac_tqAbsltMax01_Sq ComEmac_tqAbsltMin01 ComEmac_tqAbsltMin01_Sq ComEmac_tqAct01 ComEmac_tqAct01_Sq ComEmac_tqActWoDsbcCtl01 ComEmac_tqActWoDsbcCtl01_Sq ComEmac_tRtr01 ComEmac_tRtr01_Sq ComEmac_uDcLnk01 ComEmac_uDcLnk01_Sq DrvMod_stPosn ElM_stOperModAct01 PT_tqDesEmac01 /end IN_MEASUREMENT
 /begin OUT_MEASUREMENT DINH_nrActvInhReas.FId_ElMnLim01 DINH_stFId.FId_ElMnLim01 ElM_flgEnaFrbdnQdrLockgOddAxles ElM_flgEnaQdrMpgOddAxles ElM_flgGearMpgActv ElM_flgSwtIvtDirEm01 ElM_t01 ElM_t01_Sq ElM_tIvtr01 ElM_tIvtr01_Sq ElM_tIvtrCoolt01 ElM_tIvtrCoolt01_Sq ElM_tLimnTq01 ElM_tLimnTq01_Sq Emac_facEff01 Emac_flgDsbcCtlActvd01 Emac_iDcLnk01 Emac_iDcLnk01_Sq Emac_nAct01 Emac_nAct01_Sq Emac_nActPhy01 Emac_nActPhy01_Sq Emac_pwrAct01 Emac_pwrAct01_Sq Emac_pwrActMecl01 Emac_pwrActMecl01_Sq Emac_pwrLossAbslt01 Emac_pwrLossAbslt01_Sq Emac_ratTEstimnInvr01 Emac_ratTEstimnInvr01_Sq Emac_ratTEstimnMac01 Emac_tqAbsltMax01 Emac_tqAbsltMax01_Sq Emac_tqAbsltMin01 Emac_tqAbsltMin01_Sq Emac_tqAct01 Emac_tqAct01_Sq Emac_tqActWoDsbcCtl01 Emac_tqActWoDsbcCtl01_Sq Emac_tqEngMax01 Emac_tqEngMax01_Sq Emac_tqEngMin01 Emac_tqEngMin01_Sq Emac_uDcLnk01 Emac_uDcLnk01_Sq /end OUT_MEASUREMENT
 /begin LOC_MEASUREMENT Emac_EngGen01_I.ComEmac_flgActvdDsbcCtl Emac_EngGen01_I.ComEmac_iDcLnk Emac_EngGen01_I.ComEmac_iDcLnk_Sq Emac_EngGen01_I.ComEmac_nAct Emac_EngGen01_I.ComEmac_nAct_Sq Emac_EngGen01_I.ComEmac_tInvr Emac_EngGen01_I.ComEmac_tInvr_Sq Emac_EngGen01_I.ComEmac_tIvtrCoolt Emac_EngGen01_I.ComEmac_tIvtrCoolt_Sq Emac_EngGen01_I.ComEmac_tMac Emac_EngGen01_I.ComEmac_tMac_Sq Emac_EngGen01_I.ComEmac_tRtr Emac_EngGen01_I.ComEmac_tRtr_Sq Emac_EngGen01_I.ComEmac_tqAbsltMax Emac_EngGen01_I.ComEmac_tqAbsltMax_Sq Emac_EngGen01_I.ComEmac_tqAbsltMin Emac_EngGen01_I.ComEmac_tqAbsltMin_Sq Emac_EngGen01_I.ComEmac_tqAct Emac_EngGen01_I.ComEmac_tqActWoDsbcCtl Emac_EngGen01_I.ComEmac_tqActWoDsbcCtl_Sq Emac_EngGen01_I.ComEmac_tqAct_Sq Emac_EngGen01_I.ComEmac_uDcLnk Emac_EngGen01_I.ComEmac_uDcLnk_Sq Emac_EngGen01_I.ElM_flgEnaFrbdnQdrLockg Emac_EngGen01_I.ElM_flgEnaQdrMpg Emac_EngGen01_I.ElM_flgSwtIvtDirEm Emac_EngGen01_I.ElM_idxnActAry Emac_EngGen01_I.ElM_idxnActAvrg Emac_EngGen01_I.ElM_idxnAvrg Emac_EngGen01_I.ElM_nActAvrg Emac_EngGen01_I.ElM_nActAvrgPT1 Emac_EngGen01_I.ElM_nActSum Emac_EngGen01_I.ElM_nrSmplArr Emac_EngGen01_I.ElM_stOperModAct Emac_EngGen01_I.ElM_t Emac_EngGen01_I.ElM_tIvtr Emac_EngGen01_I.ElM_tIvtrCoolt Emac_EngGen01_I.ElM_tIvtrCoolt_Sq Emac_EngGen01_I.ElM_tIvtr_Sq Emac_EngGen01_I.ElM_tLimnTq Emac_EngGen01_I.ElM_tLimnTq_Sq Emac_EngGen01_I.ElM_t_Sq Emac_EngGen01_I.Elm_flgRollgBack Emac_EngGen01_I.Elm_flgSignMpgActv Emac_EngGen01_I.Emac_facEff Emac_EngGen01_I.Emac_flgDsbcCtlActvd Emac_EngGen01_I.Emac_flgGearMpgActv Emac_EngGen01_I.Emac_iDcLnk Emac_EngGen01_I.Emac_iDcLnk_Sq Emac_EngGen01_I.Emac_nAct Emac_EngGen01_I.Emac_nActPhy Emac_EngGen01_I.Emac_nActPhy_Sq Emac_EngGen01_I.Emac_nAct_Sq Emac_EngGen01_I.Emac_pwrAct Emac_EngGen01_I.Emac_pwrActMecl Emac_EngGen01_I.Emac_pwrActMecl_Sq Emac_EngGen01_I.Emac_pwrAct_Sq Emac_EngGen01_I.Emac_pwrLossAbslt Emac_EngGen01_I.Emac_pwrLossAbslt_Sq Emac_EngGen01_I.Emac_ratTEstimnInvr Emac_EngGen01_I.Emac_ratTEstimnInvr_Sq Emac_EngGen01_I.Emac_ratTEstimnMac Emac_EngGen01_I.Emac_tqAbsltMax Emac_EngGen01_I.Emac_tqAbsltMax_Sq Emac_EngGen01_I.Emac_tqAbsltMin Emac_EngGen01_I.Emac_tqAbsltMin_Sq Emac_EngGen01_I.Emac_tqAct Emac_EngGen01_I.Emac_tqActWoDsbcCtl Emac_EngGen01_I.Emac_tqActWoDsbcCtl_Sq Emac_EngGen01_I.Emac_tqAct_Sq Emac_EngGen01_I.Emac_tqEngMax Emac_EngGen01_I.Emac_tqEngMax_Sq Emac_EngGen01_I.Emac_tqEngMin Emac_EngGen01_I.Emac_tqEngMin_Sq Emac_EngGen01_I.Emac_uDcLnk Emac_EngGen01_I.Emac_uDcLnk_Sq Emac_EngGen01_I.PT_tqDesEmac Emac_EngGen01_I.ElM_IvtrTqAbsltLimStM_I.sm /end LOC_MEASUREMENT
 FUNCTION_VERSION "1400.0.0" /end FUNCTION
/begin FUNCTION ElM_PlausChk "1400.3.0  Plausibilisation and treatment of errors for the E-Drive"
 /begin DEF_CHARACTERISTIC DDRC_DurDeb.ElM_tiActvDchaFailrDebOk_C DDRC_DurDeb.ElM_tiActvDchaFailrDebDef_C DDRC_DurDeb.ElM_tiFbdnInvtrModDrv01DebOk_C DDRC_DurDeb.ElM_tiFbdnInvtrModDrv01DebDef_C DDRC_DurDeb.ElM_tiIsoMonPlausyFltDebOk_C DDRC_DurDeb.ElM_tiIsoMonPlausyFltDebDef_C DDRC_DurDeb.ElM_tiOverSpdNeg01DebOk_C DDRC_DurDeb.ElM_tiOverSpdNeg01DebDef_C DDRC_DurDeb.ElM_tiOverSpdPos01DebOk_C DDRC_DurDeb.ElM_tiOverSpdPos01DebDef_C DDRC_DurDeb.ElM_tiOverTqNeg01DebOk_C DDRC_DurDeb.ElM_tiOverTqNeg01DebDef_C DDRC_DurDeb.ElM_tiOverTqPos01DebOk_C DDRC_DurDeb.ElM_tiOverTqPos01DebDef_C DFC_CtlMsk2.DFC_ElMActvDchaFailr_C DFC_CtlMsk2.DFC_ElMFbdnIvtrModDrv01_C DFC_CtlMsk2.DFC_ElMIsoMonPlausyFlt_C DFC_CtlMsk2.DFC_ElMOverSpdNeg01_C DFC_CtlMsk2.DFC_ElMOverSpdPos01_C DFC_CtlMsk2.DFC_ElMOverTqNeg01_C DFC_CtlMsk2.DFC_ElMOverTqPos01_C DFC_DisblMsk2.DFC_ElMActvDchaFailr_C DFC_DisblMsk2.DFC_ElMFbdnIvtrModDrv01_C DFC_DisblMsk2.DFC_ElMIsoMonPlausyFlt_C DFC_DisblMsk2.DFC_ElMOverSpdNeg01_C DFC_DisblMsk2.DFC_ElMOverSpdPos01_C DFC_DisblMsk2.DFC_ElMOverTqNeg01_C DFC_DisblMsk2.DFC_ElMOverTqPos01_C ElM_ChkPlaus01_I.ElM_flgHillHldPlausChkEnad_C ElM_ChkPlaus01_I.ElM_maskHillHldVldSq_C ElM_ChkPlaus01_I.ElM_maskstModVldSq_C ElM_ChkPlaus01_I.ElM_nOverSpdNegThd_C ElM_ChkPlaus01_I.ElM_nOverSpdPosThd_C ElM_ChkPlaus01_I.ElM_stFbdnIvtrModDrv_T ElM_ChkPlaus01_I.ElM_tqOverNegThd_C ElM_ChkPlaus01_I.ElM_tqOverPosThd_C ElM_maskActvDchaPlausVldSq_C ElM_maskIsoMonSwtReqPlausVldSq_C ElM_stActvDchaCmpl_C ElM_stActvDchaInProgs_C ElM_stActvDchaNotActv_C ElM_stIsoMonSwtFlt_C /end DEF_CHARACTERISTIC
 /begin IN_MEASUREMENT ComEmac_stActvDcha ComEmac_stActvDcha_Sq ComEmac_stIsoMonSwtAck ComEmac_stIsoMonSwtAck_Sq ComEmac_stMod01 ComEmac_stMod01_Sq ComEmac_tqAct01 Com_flgHillHldActvd Com_flgHillHldActvd_Sq ElM_stDesEemInt01 Emac_nActPhy01 Emac_stIsoMonSwtReq Emac_tqDesCom01 VehCoorn_st /end IN_MEASUREMENT
 /begin OUT_MEASUREMENT DDRC_St.DFC_ElMActvDchaFailr DDRC_St.DFC_ElMFbdnIvtrModDrv01 DDRC_St.DFC_ElMIsoMonPlausyFlt DDRC_St.DFC_ElMOverSpdNeg01 DDRC_St.DFC_ElMOverSpdPos01 DDRC_St.DFC_ElMOverTqNeg01 DDRC_St.DFC_ElMOverTqPos01 DFC_st.DFC_ElMActvDchaFailr DFC_st.DFC_ElMFbdnIvtrModDrv01 DFC_st.DFC_ElMIsoMonPlausyFlt DFC_st.DFC_ElMOverSpdNeg01 DFC_st.DFC_ElMOverSpdPos01 DFC_st.DFC_ElMOverTqNeg01 DFC_st.DFC_ElMOverTqPos01 /end OUT_MEASUREMENT
 FUNCTION_VERSION "1400.3.0" /end FUNCTION
/begin COMPU_METHOD B_TRUE "" TAB_VERB "%6.3" "" COMPU_TAB_REF B_TRUE /end COMPU_METHOD
/begin COMPU_VTAB B_TRUE "" TAB_VERB 2 0 "FALSE" 1 "TRUE" /end COMPU_VTAB
/begin COMPU_METHOD Ch_Ah_q0p5_COMPU "" RAT_FUNC "%6.3" "Ah" COEFFS 0 2 0 0 0 1 /end COMPU_METHOD
/begin COMPU_METHOD Curr_A "" RAT_FUNC "%6.4" "A" COEFFS 0 100 0 0 0 1 /end COMPU_METHOD
/begin COMPU_METHOD Curr_A_q0p03125_COMPU "" RAT_FUNC "%6.4" "A" COEFFS 0 32 0 0 0 1 /end COMPU_METHOD
/begin COMPU_METHOD Curr_mA_q0p9765625_COMPU "" RAT_FUNC "%6.2" "mA" COEFFS 0 1.024 0 0 0 1 /end COMPU_METHOD
/begin COMPU_METHOD DDRCTime_ms "" RAT_FUNC "%6.1" "ms" COEFFS 0 1 0 0 0 10 /end COMPU_METHOD
/begin COMPU_METHOD DFC_OneToOne "" RAT_FUNC "%6.2" "-" COEFFS 0 1 0 0 0 1 /end COMPU_METHOD
/begin COMPU_METHOD DFC_Verb "" TAB_VERB "%6.3" "-" COMPU_TAB_REF DFC_Verb /end COMPU_METHOD
/begin COMPU_VTAB DFC_Verb "" TAB_VERB 965 0 "DFC_Unused" 2 "DFC_AbgHiSigFlt" 3 "DFC_AbgIntPatFlt" 4 "DFC_AbgLoSigFlt" 5 "DFC_AbgUnkwnErrSigFlt" 580 "DFC_AcChrgrIntkTPhysRngHi" 581 "DFC_AcChrgrIntkTPhysRngLo" 734 "DFC_AcChrgrIntkTSRCMax" 501 "DFC_AcChrgrIntkTSRCMin" 582 "DFC_AcChrgrIntkTSRCOpn" 735 "DFC_AcChrgrIntkTTmpErr" 493 "DFC_ACCmprFltLvl1" 494 "DFC_ACCmprFltLvl2" 495 "DFC_ACCmprFltLvl3" 496 "DFC_ACCmprFltLvl4" 1 "DFC_ACCmprFltLvlRes" 497 "DFC_ACCmprHiPFlt" 498 "DFC_ACCmprInvldCmprSt" 499 "DFC_ACCmprInvldElecActPwr" 500 "DFC_ACCmprLoPFlt" 6 "DFC_AcExtChrgrIBattExcdd" 7 "DFC_AcExtChrgrIInExcdd" 8 "DFC_AcExtChrgrIOutDe" 9 "DFC_AcExtChrgrIOutExcdd" 10 "DFC_AcExtChrgrUOutDe" 736 "DFC_AcFlt" 11 "DFC_AdpActvDChaFailr" 12 "DFC_AirbcuFlt" 13 "DFC_Airbg" 14 "DFC_AirbgCan" 15 "DFC_AirbgCanHWPlaus" 16 "DFC_AirbgHWCanPlaus" 17 "DFC_AirbgMnr" 19 "DFC_AirbgPerdRngFlt" 18 "DFC_AirbgPerHi" 737 "DFC_AppAllSnsrDfct" 502 "DFC_BattUBMaxBatt" 503 "DFC_BattUBMaxNoBatt" 504 "DFC_BattUBMinBatt" 505 "DFC_BattUBMinNoBatt" 738 "DFC_BattUPwrFail" 506 "DFC_BattUSRCMax" 507 "DFC_BattUSRCMin" 20 "DFC_BlowrRlyErr" 739 "DFC_BrkBstBkupOvrn" 508 "DFC_BrkBstPHiCautionDfct" 509 "DFC_BrkBstPHiWarnDfct" 517 "DFC_BrkBstPhyRngChkMax" 518 "DFC_BrkBstPhyRngChkMin" 21 "DFC_BrkBstPmpActtnDfct" 22 "DFC_BrkBstPmpDeactvnDfct" 519 "DFC_BrkBstPmpHsScb" 520 "DFC_BrkBstPmpHsScg" 521 "DFC_BrkBstPmpLsOl" 522 "DFC_BrkBstPmpLsScb" 523 "DFC_BrkBstPmpLsScg" 740 "DFC_BrkBstPmpOvld" 676 "DFC_BrkBstPmpPlausGenn" 181 "DFC_BrkBstPmpPLeakDfct" 510 "DFC_BrkBstPSnsr12PlausDfct" 511 "DFC_BrkBstPSnsr1Scb" 512 "DFC_BrkBstPSnsr1Scg" 513 "DFC_BrkBstPSnsr2Scb" 514 "DFC_BrkBstPSnsr2Scg" 515 "DFC_BrkBstPSnsrMax" 516 "DFC_BrkBstPSnsrMin" 741 "DFC_BrkPlausChk" 23 "DFC_BrkSwtFlt" 713 "DFC_CAN_E_TIMEOUT" 708 "DFC_CANSM_E_BUS_OFF_NETWORK_HSN1_CAN" 709 "DFC_CANSM_E_BUS_OFF_NETWORK_HSN3_CAN" 710 "DFC_CANSM_E_BUS_OFF_NETWORK_HSN4_CAN" 711 "DFC_CANSM_E_BUS_OFF_NETWORK_XCP_CAN" 712 "DFC_CANTRCV_E_NO_TRCV_CONTROL_0" 24 "DFC_CbnHeatgHeatrHsScb" 25 "DFC_CbnHeatgHeatrHsScg" 26 "DFC_CbnHeatgHeatrLsOl" 27 "DFC_CbnHeatgHeatrLsScb" 28 "DFC_CbnHeatgHeatrLsScg" 524 "DFC_CbnHeatgHeatrRlyOpend" 525 "DFC_CbnHeatgHeatrRlyWldd" 29 "DFC_CbnHeatgHeatrUnUsed" 742 "DFC_CbnHeatgSwtTmpErr" 677 "DFC_CbnHeatrRlyLfLoWarn" 526 "DFC_CcsDcIBattExcdd" 527 "DFC_CcsDcIEvseOutDe" 528 "DFC_CcsDcIOutDe" 529 "DFC_CcsDcIOutExcdd" 530 "DFC_CcsDcUOutDe" 531 "DFC_CcsDcUOutExcdd" 532 "DFC_CcsPwrLineChpRstOL" 533 "DFC_CcsPwrLineChpRstOvrTemp" 534 "DFC_CcsPwrLineChpRstSCB" 535 "DFC_CcsPwrLineChpRstSCG" 536 "DFC_CcsPwrLineChpVccEnaOL" 537 "DFC_CcsPwrLineChpVccEnaOvrTemp" 538 "DFC_CcsPwrLineChpVccEnaSCB" 539 "DFC_CcsPwrLineChpVccEnaSCG" 583 "DFC_CcsPwrLineChpVccPhysRngHi" 584 "DFC_CcsPwrLineChpVccPhysRngLo" 743 "DFC_CcsPwrLineChpVccSRCMax" 540 "DFC_CcsPwrLineChpVccSRCMin" 585 "DFC_CcsPwrLineChpVccSRCOpn" 744 "DFC_CcsPwrLineChpVccTmpErr" 586 "DFC_CcsPwrLineComChpTPhysRngHi" 587 "DFC_CcsPwrLineComChpTPhysRngLo" 745 "DFC_CcsPwrLineComChpTSRCMax" 541 "DFC_CcsPwrLineComChpTSRCMin" 588 "DFC_CcsPwrLineComChpTSRCOpn" 746 "DFC_CcsPwrLineComChpTTmpErr" 747 "DFC_ChgrPlugCtpCarrFrqErr" 748 "DFC_ChgrPlugCtpSwtStuckClsd" 749 "DFC_ChgrPlugCtpSwtStuckOpen" 750 "DFC_ChgrPlugCtpUErrHi" 678 "DFC_ChgrPlugLockPinByndClsd" 679 "DFC_ChgrPlugLockPinMoveWoCmd" 680 "DFC_ChgrPlugLockPinStuckInClsd" 681 "DFC_ChgrPlugLockPinStuckInOpen" 751 "DFC_ChgrPlugPxp1SrcErr" 752 "DFC_ChrgCntctAllWldd" 753 "DFC_ChrgCntctNegOperErr" 754 "DFC_ChrgCntctNegOperWarn" 755 "DFC_ChrgCntctNegWldd" 756 "DFC_ChrgCntctPosOperErr" 757 "DFC_ChrgCntctPosOperWarn" 758 "DFC_ChrgCntctPosWldd" 759 "DFC_ChrgCntctStuckOpen" 30 "DFC_ChrgnCntctHsOt" 31 "DFC_ChrgnCntctHsScb" 32 "DFC_ChrgnCntctHsScg" 33 "DFC_ChrgnCntctLsNegOl" 34 "DFC_ChrgnCntctLsNegOt" 35 "DFC_ChrgnCntctLsNegScb" 36 "DFC_ChrgnCntctLsNegScg" 37 "DFC_ChrgnCntctLsPosOl" 38 "DFC_ChrgnCntctLsPosOt" 39 "DFC_ChrgnCntctLsPosScb" 40 "DFC_ChrgnCntctLsPosScg" 41 "DFC_ChrgnCntctUnUsed" 761 "DFC_ChrgnUnplRqrd" 760 "DFC_ChrgPlgIntlckFaild" 650 "DFC_ChrgPlgLiveCntctHzrdCcs" 651 "DFC_ChrgPlgProxPltImps" 652 "DFC_ChrgPlgTHiCcsDc" 682 "DFC_ChrgrStErr" 762 "DFC_CoElMOffsCalibActv01" 182 "DFC_Com082hTooShort" 183 "DFC_Com092hTooShort" 184 "DFC_Com205hAbsent" 185 "DFC_Com205hChecksum" 186 "DFC_Com205hCounter" 187 "DFC_Com205hTooShort" 188 "DFC_Com217hAbsent" 189 "DFC_Com217hChecksum" 190 "DFC_Com217hCounter" 191 "DFC_Com217hTooShort" 192 "DFC_Com227hAbsent" 193 "DFC_Com227hTooShort" 194 "DFC_Com237hAbsent" 195 "DFC_Com237hChecksum" 196 "DFC_Com237hCounter" 197 "DFC_Com237hTooShort" 198 "DFC_Com259hAbsent" 199 "DFC_Com259hChecksum" 200 "DFC_Com259hCounter" 201 "DFC_Com259hTooShort" 202 "DFC_Com26hAbsent" 203 "DFC_Com26hTooShort" 204 "DFC_Com273hAbsent" 205 "DFC_Com273hChecksum" 206 "DFC_Com273hCounter" 207 "DFC_Com273hTooShort" 208 "DFC_Com275hAbsent" 209 "DFC_Com275hChecksum" 210 "DFC_Com275hCounter" 211 "DFC_Com275hTooShort" 212 "DFC_Com283hAbsent" 213 "DFC_Com283hTooShort" 214 "DFC_Com285hAbsent" 215 "DFC_Com285hChecksum" 216 "DFC_Com285hCounter" 217 "DFC_Com285hTooShort" 218 "DFC_Com293hAbsent" 219 "DFC_Com293hChecksum" 220 "DFC_Com293hCounter" 221 "DFC_Com293hTooShort" 222 "DFC_Com308hAbsent" 223 "DFC_Com308hChecksum" 224 "DFC_Com308hCounter" 225 "DFC_Com308hTooShort" 226 "DFC_Com318hAbsent" 227 "DFC_Com318hChecksum" 228 "DFC_Com318hCounter" 229 "DFC_Com318hTooShort" 230 "DFC_Com325hAbsent" 231 "DFC_Com325hChecksum" 232 "DFC_Com325hCounter" 233 "DFC_Com325hTooShort" 234 "DFC_Com335hAbsent" 235 "DFC_Com335hChecksum" 236 "DFC_Com335hCounter" 237 "DFC_Com335hTooShort" 238 "DFC_Com351hAbsent" 239 "DFC_Com351hTooShort" 240 "DFC_Com38DhAbsent" 241 "DFC_Com38DhChecksum" 242 "DFC_Com38DhCounter" 243 "DFC_Com38DhTooShort" 244 "DFC_Com412hAbsent" 245 "DFC_Com412hChecksum" 246 "DFC_Com412hCounter" 247 "DFC_Com412hTooShort" 248 "DFC_Com427hAbsent" 249 "DFC_Com427hTooShort" 250 "DFC_Com432hAbsent" 251 "DFC_Com432hChecksum" 252 "DFC_Com432hCounter" 253 "DFC_Com432hTooShort" 254 "DFC_Com435hAbsent" 255 "DFC_Com435hTooShort" 256 "DFC_Com442hAbsent" 257 "DFC_Com442hTooShort" 258 "DFC_Com453hAbsent" 259 "DFC_Com453hTooShort" 260 "DFC_Com455hAbsent" 261 "DFC_Com455hTooShort" 262 "DFC_Com463hAbsent" 263 "DFC_Com463hTooShort" 264 "DFC_Com473hAbsent" 265 "DFC_Com473hTooShort" 266 "DFC_Com47BhAbsent" 267 "DFC_Com47BhTooShort" 268 "DFC_Com48BhAbsent" 269 "DFC_Com48BhTooShort" 270 "DFC_Com497hTooShort" 271 "DFC_Com4F2hAbsent" 272 "DFC_Com4F2hChecksum" 273 "DFC_Com4F2hCounter" 274 "DFC_Com4F2hTooShort" 275 "DFC_Com50DhAbsent" 276 "DFC_Com50DhTooShort" 277 "DFC_Com535hAbsent" 278 "DFC_Com535hTooShort" 279 "DFC_Com543hAbsent" 280 "DFC_Com543hTooShort" 281 "DFC_Com552hAbsent" 282 "DFC_Com552hTooShort" 283 "DFC_Com583hAbsent" 284 "DFC_Com583hTooShort" 285 "DFC_Com592hAbsent" 286 "DFC_Com592hChecksum" 287 "DFC_Com592hCounter" 288 "DFC_Com592hTooShort" 289 "DFC_Com595hAbsent" 290 "DFC_Com595hChecksum" 291 "DFC_Com595hCounter" 292 "DFC_Com595hTooShort" 293 "DFC_Com5B2hAbsent" 294 "DFC_Com5B2hTooShort" 295 "DFC_Com5B5hAbsent" 296 "DFC_Com5B5hChecksum" 297 "DFC_Com5B5hCounter" 298 "DFC_Com5B5hTooShort" 299 "DFC_Com5C7hTooShort" 300 "DFC_Com5E7hAbsent" 301 "DFC_Com5E7hTooShort" 302 "DFC_Com635hTooShort" 303 "DFC_Com645hTooShort" 304 "DFC_Com663hAbsent" 305 "DFC_Com663hTooShort" 306 "DFC_Com665hAbsent" 307 "DFC_Com665hTooShort" 308 "DFC_Com675hAbsent" 309 "DFC_Com675hTooShort" 42 "DFC_ComBrkMai" 43 "DFC_ComChrgrEVCont" 44 "DFC_ComChrgrEVtBlink" 45 "DFC_ComChrgrMstBlink" 46 "DFC_ComChrgrMstCont" 47 "DFC_ComChrgrSVSBlink" 48 "DFC_ComChrgrSVSCont" 49 "DFC_ComDcdcEVBlink" 50 "DFC_ComDcdcEVCont" 51 "DFC_ComDcdcFltLvl2" 52 "DFC_ComDcdcFltLvl3" 53 "DFC_ComDcdcFltLvl4" 54 "DFC_ComDcdcFltLvl5" 55 "DFC_ComDcdcFltLvlRes" 56 "DFC_ComDcdcMstBlink" 57 "DFC_ComDcdcMstCont" 58 "DFC_ComDcdcSVSBlink" 59 "DFC_ComDcdcSVSCont" 60 "DFC_ComElMIIvtrFltLvl2" 61 "DFC_ComElMIIvtrFltLvl3" 62 "DFC_ComElMIIvtrFltLvl4" 63 "DFC_ComElMIIvtrFltLvl5" 64 "DFC_ComElMIIvtrFltLvlRes" 65 "DFC_ComEmacEVBlink" 66 "DFC_ComEmacEVCont" 67 "DFC_ComEmacMstCont" 68 "DFC_ComEmacMsttBlink" 69 "DFC_ComEmacSVSBlink" 70 "DFC_ComEmacSVSCont" 92 "DFC_ComflgCurMeasmtErr" 93 "DFC_ComflgCurMeasmtSysErr" 94 "DFC_ComflgCurMeasmtVld" 95 "DFC_ComflgCurRngErr" 96 "DFC_ComflgTPcbMeasmtErr" 97 "DFC_ComflgTPcbMeasmtVld" 98 "DFC_ComflgTPcbRngErr" 99 "DFC_ComflgTPcbSysErr" 100 "DFC_ComflgTShntMeasmtErr" 101 "DFC_ComflgTShntMeasmtVld" 102 "DFC_ComflgTShntRngErr" 103 "DFC_ComflgTShntSysErr" 104 "DFC_ComflgVoltMeasmtErr" 105 "DFC_ComflgVoltMeasmtSysErr" 106 "DFC_ComflgVoltMeasmtVld" 107 "DFC_ComflgVoltRngErr" 310 "DFC_ComFrbd_205h_HVBAT_PACK_CURRENT" 311 "DFC_ComFrbd_205h_HVBAT_SOC_DISPLAY" 312 "DFC_ComFrbd_205h_HVBAT_VOLTAGE" 313 "DFC_ComFrbd_217h_INV_DC_BUS_VOLTAGE" 314 "DFC_ComFrbd_217h_INV_MTR_ACTUAL_TRQ" 315 "DFC_ComFrbd_217h_INV_MTR_SPEED" 316 "DFC_ComFrbd_217h_INV_MTR_TRQ" 317 "DFC_ComFrbd_227h_INV_DC_CURRENT" 318 "DFC_ComFrbd_227h_INV_MOTORING_PEAK_TRQ" 319 "DFC_ComFrbd_227h_INV_MTR_INST_INPUT_POWER" 320 "DFC_ComFrbd_227h_INV_REGEN_PEAK_TRQ" 321 "DFC_ComFrbd_237h_INV_ACTIVE_DISCHARGE_STATUS" 322 "DFC_ComFrbd_237h_INV_CTRL_MODE_ACK" 323 "DFC_ComFrbd_237h_INV_EV_WARNING" 324 "DFC_ComFrbd_237h_INV_FAULT_LEVEL" 325 "DFC_ComFrbd_237h_INV_MASTER_STOP" 326 "DFC_ComFrbd_237h_INV_SERVICE_DUE" 327 "DFC_ComFrbd_237h_INV_STAB_MIN_TRQ" 328 "DFC_ComFrbd_259h_TGLM_FAILURE_STATE" 329 "DFC_ComFrbd_259h_TGLM_MODE_PUSH" 330 "DFC_ComFrbd_259h_TOGGLE_MONOSTABLE_POS" 331 "DFC_ComFrbd_273h_OBC_outputpower_capability" 332 "DFC_ComFrbd_275h_HVBAT_DISCHARGE_30S_AVAILABLE_CURRENT" 333 "DFC_ComFrbd_275h_HVBAT_DISCHARGE_30S_AVAILABLE_POWER" 334 "DFC_ComFrbd_283h_DCDC_IN_CURRENT" 335 "DFC_ComFrbd_283h_DCDC_IN_VOLTAGE" 336 "DFC_ComFrbd_283h_DCDC_OUT_CURRENT" 337 "DFC_ComFrbd_283h_DCDC_OUT_VOLTAGE" 338 "DFC_ComFrbd_285h_HVBAT_REGEN_CHG_30S_CURRENT_LIMIT" 339 "DFC_ComFrbd_285h_HVBAT_REGEN_CHRG_30S_POWER_LIMIT" 340 "DFC_ComFrbd_293h_DCDC_outputpower_capability" 341 "DFC_ComFrbd_325h_HVBAT_INSULATION_RESISTANCE" 342 "DFC_ComFrbd_325h_HVBAT_TEMPERATURE" 343 "DFC_ComFrbd_335h_HVBAT_CHRG_CONTINUOUS_CURR_MAX" 344 "DFC_ComFrbd_335h_HVBAT_CHRG_COTINUOUS_CURR_REQ" 345 "DFC_ComFrbd_335h_HVBAT_CHRG_MAX_VOLT" 346 "DFC_ComFrbd_335h_HVBAT_DC_BUS_VOLTAGE" 347 "DFC_ComFrbd_427h_INV_OP_MODE" 348 "DFC_ComFrbd_427h_INV_PERMISIBLE_TORQUE" 349 "DFC_ComFrbd_435h_HVBAT_MAX_CELL_VOLT" 350 "DFC_ComFrbd_435h_HVBAT_MAX_CELL_VOLT_NUM" 351 "DFC_ComFrbd_435h_HVBAT_MAX_SENSOR_TEMP" 352 "DFC_ComFrbd_435h_HVBAT_MIN_CELL_VOLT" 353 "DFC_ComFrbd_435h_HVBAT_MIN_CELL_VOLT_NUM" 354 "DFC_ComFrbd_453h_OBC_IN_CURRENT" 355 "DFC_ComFrbd_453h_OBC_IN_VOLTAGE" 356 "DFC_ComFrbd_453h_OBC_IP_POWER" 357 "DFC_ComFrbd_455h_HVBAT_NOMINAL_VOLTAGE" 358 "DFC_ComFrbd_463h_OBC_OUT_CURRENT" 359 "DFC_ComFrbd_463h_OBC_OUT_VOLTAGE" 360 "DFC_ComFrbd_463h_OBC_TEMPERATURE" 361 "DFC_ComFrbd_473h_DCDC_Coolant_Temperature" 362 "DFC_ComFrbd_473h_DCDC_TEMPERATURE" 363 "DFC_ComFrbd_47Bh_eCOMP_BusBarCurrent" 364 "DFC_ComFrbd_47Bh_eCOMP_BusBarVoltage" 365 "DFC_ComFrbd_47Bh_eCOMP_CompressorSpeed" 366 "DFC_ComFrbd_47Bh_eCOMP_IGBT_Temp" 367 "DFC_ComFrbd_47Bh_eCOMP_PeakPhaCurrent" 368 "DFC_ComFrbd_47Bh_eCOMP_Power_consumption" 369 "DFC_ComFrbd_48Bh_eCOMP_Fault_Level" 370 "DFC_ComFrbd_4F2h_VALEUR_SOC_ETENDUE" 371 "DFC_ComFrbd_535h_HV_BATT_TEMP_AVG" 374 "DFC_ComFrbd_543h_HV_BATT_SOH_RES" 372 "DFC_ComFrbd_543h_HVBAT_RESTBATTENERGY" 373 "DFC_ComFrbd_543h_HVBAT_SOH" 375 "DFC_ComFrbd_592h_IBATT_1" 376 "DFC_ComFrbd_592h_IBATT_2" 377 "DFC_ComFrbd_592h_IBATT_3" 378 "DFC_ComFrbd_592h_TEMP_BATT" 379 "DFC_ComFrbd_592h_U_BATT_BECB" 380 "DFC_ComFrbd_595h_HVBAT_TIME_TO_CHRG_80" 381 "DFC_ComFrbd_5B2h_TEMP_AIR_EXT" 382 "DFC_ComFrbd_635h_HVBAT_NEG_CONT_COUNT_SEG1" 383 "DFC_ComFrbd_635h_HVBAT_NEG_CONT_COUNT_SEG3" 384 "DFC_ComFrbd_635h_HVBAT_NEG_CONT_COUNT_SEG4" 385 "DFC_ComFrbd_635h_HVBAT_PST_CONT_COUNT_SEG1" 386 "DFC_ComFrbd_635h_HVBAT_PST_CONT_COUNT_SEG3" 387 "DFC_ComFrbd_635h_HVBAT_PST_CONT_COUNT_SEG4" 388 "DFC_ComFrbd_645h_HVBAT_PRECHRGE_CONT_COUNT_SEG1" 389 "DFC_ComFrbd_645h_HVBAT_PRECHRGE_CONT_COUNT_SEG2" 390 "DFC_ComFrbd_675h_HVBAT_REMAININGBATTCAPACITY" 71 "DFC_ComGunCntInfoWkuReq" 72 "DFC_ComHillHldFlt" 683 "DFC_ComHSN1BusOff" 578 "DFC_ComHSN1CANMute" 684 "DFC_ComHSN3BusOff" 579 "DFC_ComHSN3CANMute" 73 "DFC_ComHvBattRchrgWkuReq" 74 "DFC_ComHvbFltLvl2" 75 "DFC_ComHvbFltLvl3" 76 "DFC_ComHvbFltLvl4" 77 "DFC_ComHvbFltLvl5" 78 "DFC_ComHvbFltLvlRes" 79 "DFC_ComHvbMstBlink" 80 "DFC_ComHvbMstCont" 81 "DFC_ComImmoUnlockWkuReq" 82 "DFC_ComInfoReqPtlWkuReq" 391 "DFC_ComInvld_205h_HVBAT_CHARGING_STATUS" 392 "DFC_ComInvld_205h_HVBAT_PACK_CURRENT" 393 "DFC_ComInvld_205h_HVBAT_SOC_DISPLAY" 394 "DFC_ComInvld_205h_HVBAT_VOLTAGE" 395 "DFC_ComInvld_217h_INV_DC_BUS_VOLTAGE" 396 "DFC_ComInvld_217h_INV_MTR_ACTUAL_TRQ" 397 "DFC_ComInvld_217h_INV_MTR_SPEED" 398 "DFC_ComInvld_217h_INV_MTR_TRQ" 399 "DFC_ComInvld_227h_INV_DC_CURRENT" 400 "DFC_ComInvld_227h_INV_MOTORING_PEAK_TRQ" 401 "DFC_ComInvld_227h_INV_MTR_INST_INPUT_POWER" 402 "DFC_ComInvld_227h_INV_REGEN_PEAK_TRQ" 403 "DFC_ComInvld_237h_INV_ACTIVE_DISCHARGE_STATUS" 404 "DFC_ComInvld_237h_INV_FAULT_LEVEL" 405 "DFC_ComInvld_237h_INV_STAB_MIN_TRQ" 406 "DFC_ComInvld_259h_TGLM_MODE_PUSH" 407 "DFC_ComInvld_259h_TOGGLE_MONOSTABLE_POS" 408 "DFC_ComInvld_26h_AC_SWITCH_REQ" 409 "DFC_ComInvld_26h_BLOWER_POSITION" 410 "DFC_ComInvld_26h_EVAP_SENSOR_FAULT" 411 "DFC_ComInvld_26h_EVAP_SENSOR_VALUE" 412 "DFC_ComInvld_26h_POTENTIOMETER_FAULT" 413 "DFC_ComInvld_26h_REAR_DEFOG_REQ" 414 "DFC_ComInvld_26h_TEMP_POSITION" 415 "DFC_ComInvld_273h_OBC_FAULT_LEVEL" 416 "DFC_ComInvld_273h_OBC_outputpower_capability" 417 "DFC_ComInvld_275h_HVBAT_DISCHARGE_30S_AVAILABLE_CURRENT" 418 "DFC_ComInvld_275h_HVBAT_DISCHARGE_30S_AVAILABLE_POWER" 419 "DFC_ComInvld_283h_DCDC_IN_CURRENT" 420 "DFC_ComInvld_283h_DCDC_IN_VOLTAGE" 421 "DFC_ComInvld_283h_DCDC_OUT_CURRENT" 422 "DFC_ComInvld_283h_DCDC_OUT_VOLTAGE" 423 "DFC_ComInvld_285h_HVBAT_REGEN_CHG_30S_CURRENT_LIMIT" 424 "DFC_ComInvld_285h_HVBAT_REGEN_CHRG_30S_POWER_LIMIT" 425 "DFC_ComInvld_293h_DCDC_FAULT_LEVEL" 426 "DFC_ComInvld_293h_DCDC_outputpower_capability" 427 "DFC_ComInvld_325h_HVBAT_EPLUG_STATUS" 428 "DFC_ComInvld_325h_HVBAT_HVIL_STS" 429 "DFC_ComInvld_325h_HVBAT_INSULATION_FAULT" 430 "DFC_ComInvld_325h_HVBAT_INSULATION_RESISTANCE" 431 "DFC_ComInvld_325h_HVBAT_TEMPERATURE" 432 "DFC_ComInvld_335h_HVBAT_CHRG_CONTINUOUS_CURR_MAX" 433 "DFC_ComInvld_335h_HVBAT_CHRG_COTINUOUS_CURR_REQ" 434 "DFC_ComInvld_335h_HVBAT_CHRG_MAX_VOLT" 435 "DFC_ComInvld_335h_HVBAT_DC_BUS_VOLTAGE" 436 "DFC_ComInvld_38Dh_VITESSE_VEHICULE_ROUES" 437 "DFC_ComInvld_38Dh_VVH_INDISP" 438 "DFC_ComInvld_427h_INV_COOLANT_TEMP" 439 "DFC_ComInvld_427h_INV_MOTOR_TEMP" 440 "DFC_ComInvld_427h_INV_OP_MODE" 441 "DFC_ComInvld_427h_INV_PERMISIBLE_TORQUE" 442 "DFC_ComInvld_427h_INV_TEMP" 443 "DFC_ComInvld_432h_REVEIL_PRINCIPAL" 444 "DFC_ComInvld_435h_HVBAT_MAX_CELL_VOLT" 445 "DFC_ComInvld_435h_HVBAT_MAX_CELL_VOLT_NUM" 446 "DFC_ComInvld_435h_HVBAT_MAX_SENSOR_TEMP" 447 "DFC_ComInvld_435h_HVBAT_MIN_CELL_VOLT" 448 "DFC_ComInvld_435h_HVBAT_MIN_CELL_VOLT_NUM" 449 "DFC_ComInvld_442h_BCCM_BLOWER_RELAY_STS" 450 "DFC_ComInvld_453h_OBC_IN_CURRENT" 451 "DFC_ComInvld_453h_OBC_IN_VOLTAGE" 452 "DFC_ComInvld_453h_OBC_IP_POWER" 453 "DFC_ComInvld_455h_HVBAT_NOMINAL_VOLTAGE" 454 "DFC_ComInvld_463h_OBC_OUT_CURRENT" 455 "DFC_ComInvld_463h_OBC_OUT_VOLTAGE" 456 "DFC_ComInvld_463h_OBC_TEMPERATURE" 457 "DFC_ComInvld_473h_DCDC_Coolant_Temperature" 458 "DFC_ComInvld_473h_DCDC_TEMPERATURE" 459 "DFC_ComInvld_47Bh_eCOMP_BusBarCurrent" 460 "DFC_ComInvld_47Bh_eCOMP_BusBarVoltage" 461 "DFC_ComInvld_47Bh_eCOMP_CompressorSpeed" 462 "DFC_ComInvld_47Bh_eCOMP_IGBT_Temp" 463 "DFC_ComInvld_47Bh_eCOMP_PeakPhaCurrent" 464 "DFC_ComInvld_47Bh_eCOMP_Power_consumption" 465 "DFC_ComInvld_4F2h_STATUS_SOC" 466 "DFC_ComInvld_4F2h_TEMP_BATT_STATUS" 467 "DFC_ComInvld_4F2h_VALEUR_SOC_ETENDUE" 468 "DFC_ComInvld_535h_HV_BATT_TEMP_AVG" 471 "DFC_ComInvld_543h_HV_BATT_SOH_RES" 469 "DFC_ComInvld_543h_HVBAT_RESTBATTENERGY" 470 "DFC_ComInvld_543h_HVBAT_SOH" 472 "DFC_ComInvld_552h_CPT_TEMPOREL" 473 "DFC_ComInvld_552h_KILOMETRAGE" 474 "DFC_ComInvld_583h_HV_BATT_DISCONT_CSE_OPEN" 475 "DFC_ComInvld_592h_CALIBRE_IBATT" 476 "DFC_ComInvld_592h_IBATT_1" 477 "DFC_ComInvld_592h_IBATT_2" 478 "DFC_ComInvld_592h_IBATT_3" 479 "DFC_ComInvld_592h_TEMP_BATT" 480 "DFC_ComInvld_592h_U_BATT_BECB" 481 "DFC_ComInvld_595h_HVBAT_TIME_TO_CHRG_80" 482 "DFC_ComInvld_5B2h_TEMP_AIR_EXT" 483 "DFC_ComInvld_5B5h_HVBAT_THERMAL_RUNAWAY" 484 "DFC_ComInvld_635h_HVBAT_NEG_CONT_COUNT_SEG1" 485 "DFC_ComInvld_635h_HVBAT_NEG_CONT_COUNT_SEG3" 486 "DFC_ComInvld_635h_HVBAT_NEG_CONT_COUNT_SEG4" 487 "DFC_ComInvld_635h_HVBAT_PST_CONT_COUNT_SEG1" 488 "DFC_ComInvld_635h_HVBAT_PST_CONT_COUNT_SEG3" 489 "DFC_ComInvld_635h_HVBAT_PST_CONT_COUNT_SEG4" 490 "DFC_ComInvld_645h_HVBAT_PRECHRGE_CONT_COUNT_SEG1" 491 "DFC_ComInvld_645h_HVBAT_PRECHRGE_CONT_COUNT_SEG2" 492 "DFC_ComInvld_675h_HVBAT_REMAININGBATTCAPACITY" 714 "DFC_COMM_E_NET_START_IND_CHANNEL_0" 715 "DFC_COMM_E_NET_START_IND_CHANNEL_1" 716 "DFC_COMM_E_NET_START_IND_CHANNEL_2" 717 "DFC_COMM_E_NET_START_IND_CHANNEL_3" 718 "DFC_COMM_E_NET_START_IND_CHANNEL_4" 719 "DFC_COMM_E_NET_START_IND_CHANNEL_5" 83 "DFC_ComOBCFltLvl2" 84 "DFC_ComOBCFltLvl3" 85 "DFC_ComOBCFltLvl4" 86 "DFC_ComOBCFltLvl5" 87 "DFC_ComOBCFltLvlRes" 88 "DFC_ComPostOperationWkuReq" 89 "DFC_ComPreCondElecWkuReq" 90 "DFC_ComRemUnlckWkuReq" 91 "DFC_ComStpDlyHMIWkuReq" 685 "DFC_ComVCInval" 108 "DFC_CrashEveOcc" 592 "DFC_CtpCarrFrqPhysRngHi" 593 "DFC_CtpCarrFrqPhysRngLo" 594 "DFC_CtpCarrFrqSRCMax" 547 "DFC_CtpCarrFrqSRCMin" 765 "DFC_CtpCarrFrqTmpErr" 542 "DFC_CtPSwtActrOL" 543 "DFC_CtPSwtActrOvrTemp" 544 "DFC_CtPSwtActrSCB" 545 "DFC_CtPSwtActrSCG" 589 "DFC_CtPSwtDiagPhysRngHi" 590 "DFC_CtPSwtDiagPhysRngLo" 763 "DFC_CtPSwtDiagSRCMax" 546 "DFC_CtPSwtDiagSRCMin" 591 "DFC_CtPSwtDiagSRCOpn" 764 "DFC_CtPSwtDiagTmpErr" 595 "DFC_DcChrgrIntkT2PhysRngHi" 596 "DFC_DcChrgrIntkT2PhysRngLo" 766 "DFC_DcChrgrIntkT2SRCMax" 548 "DFC_DcChrgrIntkT2SRCMin" 597 "DFC_DcChrgrIntkT2SRCOpn" 767 "DFC_DcChrgrIntkT2TmpErr" 598 "DFC_DcChrgrIntkTPhysRngHi" 599 "DFC_DcChrgrIntkTPhysRngLo" 768 "DFC_DcChrgrIntkTSRCMax" 549 "DFC_DcChrgrIntkTSRCMin" 600 "DFC_DcChrgrIntkTSRCOpn" 769 "DFC_DcChrgrIntkTTmpErr" 109 "DFC_DcdcFwdModStuck" 110 "DFC_DcdcLvUDifMaxFlt" 111 "DFC_DcdcOffModStuck" 112 "DFC_DcdcOperModFailr" 113 "DFC_DcdcPrecModStuck" 550 "DFC_DevLibBattUHi" 551 "DFC_DevLibBattULo" 114 "DFC_DrvDoorOpn" 115 "DFC_DrvModPosnDfct" 116 "DFC_DrvStbltOpn" 119 "DFC_EbsLvBattSocDiagLo" 120 "DFC_EbsLvBattUDiagDiOper" 121 "DFC_EbsLvBattUDiagFltLvl1" 122 "DFC_EbsLvBattUDiagFltLvl2" 123 "DFC_EbsLvBattUDiagLo" 124 "DFC_EbsSnsrSt" 125 "DFC_EbsSofASILErr" 770 "DFC_EChrDvPlinCntrThdExcdd" 686 "DFC_EemDcdcPrecSpdInhb" 771 "DFC_EemDiagCtctrClsTout" 772 "DFC_EemDiagDcdcOffTOut" 774 "DFC_EemDiagHvbOffTOut" 773 "DFC_EemDiagHvCnsrOffTOut" 653 "DFC_ElMActvDchaFailr" 654 "DFC_ElMActvDchaFlt" 655 "DFC_ElMFbdnIvtrModDrv01" 656 "DFC_ElMImobAuthent" 657 "DFC_ElMIsoMonFlt" 658 "DFC_ElMIsoMonPlausyFlt" 659 "DFC_ElMIvtrCooltT01" 660 "DFC_ElMIvtrEmgyShtDwn01" 661 "DFC_ElMIvtrFailr01" 662 "DFC_ElMIvtrIntlck01" 663 "DFC_ElMIvtrTErr01" 664 "DFC_ElMOverSpdNeg01" 665 "DFC_ElMOverSpdPos01" 666 "DFC_ElMOverTqNeg01" 667 "DFC_ElMOverTqPos01" 668 "DFC_ElMPwrAuthn" 669 "DFC_ElMSpdErr01" 670 "DFC_ElMSvs01" 126 "DFC_ElTSPtSysLimDrvErr" 127 "DFC_ElTSPtSysLimRgnErr" 552 "DFC_EmWakeupSigOL" 553 "DFC_EmWakeupSigOvrTemp" 554 "DFC_EmWakeupSigSCB" 555 "DFC_EmWakeupSigSCG" 117 "DFC_ETogFailrLvl3" 118 "DFC_ETogFailrLvl4" 178 "DFC_eTogFailrLvlRes" 687 "DFC_ExpPwrLatch" 556 "DFC_Fan1OL" 557 "DFC_Fan1OvrTemp" 558 "DFC_Fan1SCB" 601 "DFC_Fan1SCG" 688 "DFC_FanMaxOvrd" 559 "DFC_FanRlySCB" 560 "DFC_FanRlySCG" 602 "DFC_FanSpdPhysRngHi" 603 "DFC_FanSpdPhysRngLo" 775 "DFC_FanSpdSRCMax" 561 "DFC_FanSpdSRCMin" 604 "DFC_FanSpdSRCOpn" 776 "DFC_FanSpdTmpErr" 179 "DFC_flgBrkMaiDiag" 605 "DFC_FreonPPhysRngHi" 606 "DFC_FreonPPhysRngLo" 777 "DFC_FreonPSRCMax" 562 "DFC_FreonPSRCMin" 607 "DFC_FreonPSRCOpn" 778 "DFC_FreonPTmpErr" 608 "DFC_HeatrCoreTPhysRngHi" 609 "DFC_HeatrCoreTPhysRngLo" 779 "DFC_HeatrCoreTSRCMax" 564 "DFC_HeatrCoreTSRCMin" 610 "DFC_HeatrCoreTSRCOpn" 780 "DFC_HeatrCoreTTmpErr" 128 "DFC_HLCCcsFwDwnl" 689 "DFC_HLCCcsGnrlComErr" 563 "DFC_HLCCcsPLnCChipTHi" 782 "DFC_HvacBlwrFrntFlt" 783 "DFC_HvacEvapElecFlt" 784 "DFC_HvacEvapElecFltGnd" 785 "DFC_HvacKnobPosnFlt" 129 "DFC_HvBattChrgPwrMax" 130 "DFC_HvBattCrashDetd" 131 "DFC_HvBattDchaPwrMax" 132 "DFC_HvBattEmgyOff" 133 "DFC_HvBattEmgyOffIntlck" 134 "DFC_HvBattEmgyOffReq" 135 "DFC_HvBattFltMod" 138 "DFC_HvBattIninTout" 139 "DFC_HvBattIntlckSt" 136 "DFC_HvBattIReqToChrgrErr" 137 "DFC_HvBattIReqToChrgrIni" 140 "DFC_HvBattIsoFlt" 141 "DFC_HvBattLimdPwr" 142 "DFC_HvBattMaiSwtClsngFlt" 143 "DFC_HvBattMaiSwtFlt" 144 "DFC_HvBattMaiSwtOpen" 145 "DFC_HvBattMaiSwtOpngFlt" 146 "DFC_HvBattMaiSwtWldd" 147 "DFC_HvBattNegCntctrCntErr" 148 "DFC_HvBattOperModChrgPlausy" 149 "DFC_HvBattOverTDern" 150 "DFC_HvBattPosCntctrCntErr" 151 "DFC_HvBattPrecCntctrCntErr" 152 "DFC_HvBattPwrDistbnTDern" 153 "DFC_HvBattPwrDistbnTInhbn" 154 "DFC_HvBattRatRSohErr" 155 "DFC_HvBattRatSohErr" 156 "DFC_HvBattSngIsoWarn" 157 "DFC_HvBattSrvPlgDiscnct" 160 "DFC_HvBattUnderTDern" 158 "DFC_HvBattUNomChrgnErr" 159 "DFC_HvBattUNomChrgnIni" 161 "DFC_HvbEVLmpBlink" 162 "DFC_HvbEVLmpCont" 163 "DFC_HvbSVSBlink" 164 "DFC_HvbSVSCont" 781 "DFC_HvGridSocMinLim" 611 "DFC_HvGridUMaxSftyLim" 612 "DFC_HvGridUMinSftyLim" 613 "DFC_HvGridUPlausy" 165 "DFC_InmLINBusBlk" 690 "DFC_InmLINNodeHVACPanelAbsnt" 614 "DFC_IntlckChrgPlgHBrgOpnLd" 615 "DFC_IntlckChrgPlgHBrgOvrCurr" 616 "DFC_IntlckChrgPlgHBrgOvrTemp" 617 "DFC_IntlckChrgPlgHBrgShCirBatt1" 618 "DFC_IntlckChrgPlgHBrgShCirBatt2" 619 "DFC_IntlckChrgPlgHBrgShCirGnd1" 620 "DFC_IntlckChrgPlgHBrgShCirGnd2" 621 "DFC_IntlckChrgPlgHBrgShCirOvrLd" 622 "DFC_IntlckChrgPlgHBrgTempOvrCurr" 623 "DFC_IntlckChrgPlgHBrgUndrVltg" 624 "DFC_IntlckChrgPlgPosnRngFlt" 625 "DFC_IntlckChrgPlgPosnSrcMax" 626 "DFC_IntlckChrgPlgPosnSrcMin" 786 "DFC_InvBinID" 787 "DFC_InvCalID" 788 "DFC_InvErotan" 789 "DFC_InvVinID" 720 "DFC_LIN_E_TIMEOUT" 884 "DFC_MoCADCNTPBnk1" 885 "DFC_MoCADCTestVoltBnk1" 886 "DFC_MoCSOPICO" 887 "DFC_MoFAccr" 888 "DFC_MoFCbnPreCdngOvrheat" 889 "DFC_MoFCbnPreCdngTmrExpi" 890 "DFC_MoFEvMngtBms" 891 "DFC_MoFEvMngtDcdc" 892 "DFC_MoFEvMngtEm01" 893 "DFC_MoFEvMngtEm01BrkgToZr" 894 "DFC_MoFEvMngtEm01EngSpd" 895 "DFC_MoFEvMngtEm02EngSpd" 896 "DFC_MoFEvMngtEm02Lvl1" 897 "DFC_MoFEvMngtEm02Lvl2" 898 "DFC_MoFExtCptAuxCpt" 899 "DFC_MoFExtCptVacPmpErr" 900 "DFC_MoFTqPtdAxle" 901 "DFC_MoFTqPtdAxleSec" 902 "DFC_MoFTqPtdEmPtRels" 903 "DFC_MoFTqPtdEmPtRelsSec" 904 "DFC_MoFTqPtdEmSign" 905 "DFC_MoFTqPtdEmSignSec" 906 "DFC_MoFTqPtdEmTq" 907 "DFC_MoFTqPtdEmTqSec" 908 "DFC_MoFTqPtdVeh" 909 "DFC_MoFVarPostBldSel" 917 "DFC_MonEgyChrgnCoorr_AcChrgnWoMofRels" 918 "DFC_MonEgyChrgnCoorr_ChrgnAbortIgr" 919 "DFC_MonEgyChrgnCoorr_DcCntctFailr" 920 "DFC_MonEgyChrgnCoorr_ExtChrgnShtOffReq" 921 "DFC_MonEgyChrgnCoorr_ImpsChrgnMod" 922 "DFC_MonEgyChrgnCoorr_ImpsChrgnPrms" 923 "DFC_MonEgyChrgnCoorr_ImpsUDcIntk" 924 "DFC_MonEgyChrgnCoorr_PlgLockMovmt" 925 "DFC_MonEgyChrgnCoorr_VehCrashDetn" 926 "DFC_MonEgyChrgnErrReactn_SftySwt" 927 "DFC_MonEgyChrgnInlet_CcsPlgCtp" 928 "DFC_MonEgyChrgnInlet_CcsPlgCtpPwm" 929 "DFC_MonEgyChrgnInlet_CcsPlgLockCtrlImpsAtmpt" 930 "DFC_MonEgyChrgnInlet_CcsPlgLockSnsrSigRngChk" 931 "DFC_MonEgyChrgnInlet_CcsPlgLockStImps" 932 "DFC_MonEgyChrgnInlet_CcsPlgPxp" 933 "DFC_MonEgyChrgnT_Snsr1GrdtChk" 934 "DFC_MonEgyChrgnT_Snsr1SigRngChk" 935 "DFC_MonEgyChrgnT_Snsr2GrdtChk" 936 "DFC_MonEgyChrgnT_Snsr2SigRngChk" 937 "DFC_MonEgyChrgnT_SnsrDif" 910 "DFC_MoSysCtrlReIni" 790 "DFC_MOXEMM_SMU_ALM0_0" 791 "DFC_MOXEMM_SMU_ALM0_1" 792 "DFC_MOXEMM_SMU_ALM0_10" 793 "DFC_MOXEMM_SMU_ALM0_11" 794 "DFC_MOXEMM_SMU_ALM0_13" 795 "DFC_MOXEMM_SMU_ALM0_14" 796 "DFC_MOXEMM_SMU_ALM0_2" 797 "DFC_MOXEMM_SMU_ALM0_22" 798 "DFC_MOXEMM_SMU_ALM0_23" 799 "DFC_MOXEMM_SMU_ALM0_4" 800 "DFC_MOXEMM_SMU_ALM0_5" 801 "DFC_MOXEMM_SMU_ALM0_7" 802 "DFC_MOXEMM_SMU_ALM0_8" 803 "DFC_MOXEMM_SMU_ALM10_16" 804 "DFC_MOXEMM_SMU_ALM10_17" 805 "DFC_MOXEMM_SMU_ALM10_21" 806 "DFC_MOXEMM_SMU_ALM11_0" 807 "DFC_MOXEMM_SMU_ALM11_1" 808 "DFC_MOXEMM_SMU_ALM11_2" 809 "DFC_MOXEMM_SMU_ALM11_3" 810 "DFC_MOXEMM_SMU_ALM11_4" 811 "DFC_MOXEMM_SMU_ALM11_5" 812 "DFC_MOXEMM_SMU_ALM11_8" 813 "DFC_MOXEMM_SMU_ALM11_9" 814 "DFC_MOXEMM_SMU_ALM1_0" 815 "DFC_MOXEMM_SMU_ALM1_1" 816 "DFC_MOXEMM_SMU_ALM1_10" 817 "DFC_MOXEMM_SMU_ALM1_11" 818 "DFC_MOXEMM_SMU_ALM1_13" 819 "DFC_MOXEMM_SMU_ALM1_14" 820 "DFC_MOXEMM_SMU_ALM1_2" 821 "DFC_MOXEMM_SMU_ALM1_22" 822 "DFC_MOXEMM_SMU_ALM1_23" 823 "DFC_MOXEMM_SMU_ALM1_4" 824 "DFC_MOXEMM_SMU_ALM1_5" 825 "DFC_MOXEMM_SMU_ALM1_7" 826 "DFC_MOXEMM_SMU_ALM1_8" 827 "DFC_MOXEMM_SMU_ALM21_0" 828 "DFC_MOXEMM_SMU_ALM21_16" 829 "DFC_MOXEMM_SMU_ALM21_3" 830 "DFC_MOXEMM_SMU_ALM2_1" 831 "DFC_MOXEMM_SMU_ALM2_10" 832 "DFC_MOXEMM_SMU_ALM2_11" 833 "DFC_MOXEMM_SMU_ALM2_13" 834 "DFC_MOXEMM_SMU_ALM2_14" 835 "DFC_MOXEMM_SMU_ALM2_22" 836 "DFC_MOXEMM_SMU_ALM2_23" 837 "DFC_MOXEMM_SMU_ALM2_4" 838 "DFC_MOXEMM_SMU_ALM2_5" 839 "DFC_MOXEMM_SMU_ALM2_7" 840 "DFC_MOXEMM_SMU_ALM2_8" 841 "DFC_MOXEMM_SMU_ALM6_0" 842 "DFC_MOXEMM_SMU_ALM6_11" 843 "DFC_MOXEMM_SMU_ALM6_12" 844 "DFC_MOXEMM_SMU_ALM6_14" 845 "DFC_MOXEMM_SMU_ALM6_15" 846 "DFC_MOXEMM_SMU_ALM6_17" 847 "DFC_MOXEMM_SMU_ALM6_18" 848 "DFC_MOXEMM_SMU_ALM6_20" 849 "DFC_MOXEMM_SMU_ALM6_21" 850 "DFC_MOXEMM_SMU_ALM6_25" 851 "DFC_MOXEMM_SMU_ALM6_4" 852 "DFC_MOXEMM_SMU_ALM6_5" 853 "DFC_MOXEMM_SMU_ALM6_7" 854 "DFC_MOXEMM_SMU_ALM6_8" 855 "DFC_MOXEMM_SMU_ALM7_1" 856 "DFC_MOXEMM_SMU_ALM7_12" 857 "DFC_MOXEMM_SMU_ALM7_13" 858 "DFC_MOXEMM_SMU_ALM7_14" 859 "DFC_MOXEMM_SMU_ALM7_15" 860 "DFC_MOXEMM_SMU_ALM7_16" 861 "DFC_MOXEMM_SMU_ALM7_17" 862 "DFC_MOXEMM_SMU_ALM7_2" 863 "DFC_MOXEMM_SMU_ALM7_20" 864 "DFC_MOXEMM_SMU_ALM7_25" 865 "DFC_MOXEMM_SMU_ALM7_26" 866 "DFC_MOXEMM_SMU_ALM7_28" 867 "DFC_MOXEMM_SMU_ALM7_29" 868 "DFC_MOXEMM_SMU_ALM7_30" 869 "DFC_MOXEMM_SMU_ALM7_31" 870 "DFC_MOXEMM_SMU_ALM8_0" 871 "DFC_MOXEMM_SMU_ALM8_1" 872 "DFC_MOXEMM_SMU_ALM8_10" 873 "DFC_MOXEMM_SMU_ALM8_11" 874 "DFC_MOXEMM_SMU_ALM8_12" 875 "DFC_MOXEMM_SMU_ALM8_16" 876 "DFC_MOXEMM_SMU_ALM8_18" 877 "DFC_MOXEMM_SMU_ALM8_2" 878 "DFC_MOXEMM_SMU_ALM8_3" 879 "DFC_MOXEMM_SMU_ALM8_31" 880 "DFC_MOXEMM_SMU_ALM8_4" 881 "DFC_MOXEMM_SMU_ALM9_0" 882 "DFC_MOXEMM_SMU_ALM9_15" 883 "DFC_MOXEMM_SMU_ALM9_3" 911 "DFC_MoXEMMHwLTMCUFW" 912 "DFC_MoXEMMHwLTMonBIST" 913 "DFC_MoXEMMHwLTRegMonTest" 914 "DFC_MoXEMMHwLTStbySMUAlvTest" 915 "DFC_MoXEMMHwLTTempSens" 916 "DFC_MoXEMMHwLTUCBCfg" 693 "DFC_MRlyOL" 694 "DFC_MRlySCB" 695 "DFC_MRlySCG" 938 "DFC_OCWDAABEActv" 939 "DFC_OCWDACom" 940 "DFC_OCWDAErrPin" 941 "DFC_OCWDAOvrVltg" 166 "DFC_PDUProgmFailr" 671 "DFC_PEnvCcMax" 672 "DFC_PEnvCcMin" 673 "DFC_PEnvRngChkMax" 674 "DFC_PEnvRngChkMin" 167 "DFC_PEnvSigRngMax" 168 "DFC_PEnvSigRngMin" 675 "DFC_PEnvSnsrPlaus" 169 "DFC_PLnCChpDeactvnFaild" 170 "DFC_PrkgBrkFailr" 171 "DFC_PtSysLimErr" 942 "DFC_PUmax" 627 "DFC_PwmCtPPhysRngHi" 628 "DFC_PwmCtPPhysRngLo" 629 "DFC_PwmCtPSRCMax" 565 "DFC_PwmCtPSRCMin" 943 "DFC_PwmCtPTmpErr" 630 "DFC_PwrDistbnUnitTPhysRngHi" 631 "DFC_PwrDistbnUnitTPhysRngLo" 944 "DFC_PwrDistbnUnitTSRCMax" 566 "DFC_PwrDistbnUnitTSRCMin" 632 "DFC_PwrDistbnUnitTSRCOpn" 945 "DFC_PwrDistbnUnitTTmpErr" 172 "DFC_PwrMaxDchaShoLo" 721 "DFC_rba_EcuCtrl_TOMaxProlg" 722 "DFC_rba_EcuCtrl_TOMaxShutDwn" 727 "DFC_RBA_IOEXTLIB_KEEPALIVE_DRV" 728 "DFC_RBA_IOEXTLIB_KEEPALIVE_INI" 729 "DFC_rba_IoSigRtc_StopCounter" 731 "DFC_rba_MemDiag_MemReadErr" 732 "DFC_rba_MemDiag_MemWrErr" 730 "DFC_rba_MRly_Diag_Stk_Event" 723 "DFC_rba_MultiStackTrace_Threshold" 724 "DFC_rba_SyC_CustStates_Degraded_disord_Event" 725 "DFC_rba_SyC_CustStates_Degraded_incst_Event" 726 "DFC_rba_SyC_CustStates_TransNoWakReq_Event" 733 "DFC_rba_SyC_IrrSwOffTrigEngRun_Event" 691 "DFC_ResetRcvNotAllwd" 645 "DFC_SCtPmp1DiagGrdKey1" 646 "DFC_SCtPmp1DiagGrdKey2" 647 "DFC_SCtPmp1DiagGrdKey3" 648 "DFC_SCtPmp1DiagGrdKey4" 649 "DFC_SCtPmp1DiagGrdKey5" 946 "DFC_SCtPmp1DiagGrdKeyErr" 173 "DFC_SCtPmp1FailSafeNotSuc" 567 "DFC_SCtPmp1OL" 568 "DFC_SCtPmp1OvrTemp" 569 "DFC_SCtPmp1SCB" 174 "DFC_SCtPmp1SCG" 570 "DFC_SCtPmpRlyOL" 571 "DFC_SCtPmpRlyOvrTemp" 572 "DFC_SCtPmpRlySCB" 633 "DFC_SCtPmpRlySCG" 954 "DFC_Sia_InvldCode" 955 "DFC_Sia_InvldKey" 956 "DFC_Sia_NoRespUCx" 957 "DFC_Sia_TprotRttp" 573 "DFC_SpplCooltPmpRlyOL" 574 "DFC_SpplCooltPmpRlyOvrTemp" 575 "DFC_SpplCooltPmpRlySCB" 634 "DFC_SpplCooltPmpRlySCG" 947 "DFC_SRCHighAPP1" 948 "DFC_SRCHighAPP2" 949 "DFC_SRCLowAPP1" 950 "DFC_SRCLowAPP2" 696 "DFC_SSpMon1" 697 "DFC_SSpMon1OV" 698 "DFC_SSpMon1SCG" 699 "DFC_SSpMon1UV" 700 "DFC_SSpMon2" 701 "DFC_SSpMon2OV" 702 "DFC_SSpMon2SCG" 703 "DFC_SSpMon2UV" 704 "DFC_SSpMon3" 705 "DFC_SSpMon3OV" 706 "DFC_SSpMon3SCG" 707 "DFC_SSpMon3UV" 180 "DFC_stHvbIsoMeasmtRes" 958 "DFC_StrtUpEvStandStillDeactvn" 951 "DFC_SWReset_0" 952 "DFC_SWReset_1" 953 "DFC_SWReset_2" 959 "DFC_SyncAPP" 692 "DFC_TelltlCooltPlaus" 635 "DFC_UCtPPhysRngHi" 636 "DFC_UCtPPhysRngLo" 960 "DFC_UCtPSRCMax" 576 "DFC_UCtPSRCMin" 637 "DFC_UCtPSRCOpn" 961 "DFC_UCtPTmpErr" 638 "DFC_UPxP1PhysRngHi" 639 "DFC_UPxP1PhysRngLo" 962 "DFC_UPxP1SRCMax" 577 "DFC_UPxP1SRCMin" 640 "DFC_UPxP1SRCOpn" 963 "DFC_UPxP1TmpErr" 175 "DFC_VehCoornDrvrNotPrsnt" 176 "DFC_VehVCanAvl" 177 "DFC_VehVCanErr" 964 "DFC_VehVObd" 641 "DFC_VehVPhysRngHi" 642 "DFC_VehVPhysRngLo" 643 "DFC_VehVSigCan" 644 "DFC_VehVSigCanSafe" DEFAULT_VALUE "---" /end COMPU_VTAB
/begin COMPU_METHOD DFES_OneToOne "" RAT_FUNC "%6.2" "-" COEFFS 0 1 0 0 0 1 /end COMPU_METHOD
/begin COMPU_METHOD DINH_ct_Compu "" RAT_FUNC "%6.0" "" COEFFS 0 -1 4096 0 0 1 /end COMPU_METHOD
/begin COMPU_METHOD DSMAppl_TrnOffDly_Compu "" RAT_FUNC "%6.5" "ms" COEFFS 0 1000 0 0 0 1 /end COMPU_METHOD
/begin COMPU_METHOD DSMAUX_stDCyVerb "" TAB_VERB "%6.3" "-" COMPU_TAB_REF DSMAUX_stDCyVerb /end COMPU_METHOD
/begin COMPU_VTAB DSMAUX_stDCyVerb "" TAB_VERB 4 0 "DCy_New" 1 "DCy_Qualified" 2 "DCy_KeyOnCyc" 3 "DCy_Completed" /end COMPU_VTAB
/begin COMPU_METHOD DSMAUX_ti100ms "" RAT_FUNC "%6.3" "s" COEFFS 0 10 0 0 0 1 /end COMPU_METHOD
/begin COMPU_METHOD DSMDUR_10m_Counter "" RAT_FUNC "%6.4" "km" COEFFS 0 100 0 0 0 1 /end COMPU_METHOD
/begin COMPU_METHOD DSMDur_StDispl_Verb "" TAB_VERB "%6.3" "-" COMPU_TAB_REF DSMDur_StDispl_Verb /end COMPU_METHOD
/begin COMPU_VTAB DSMDur_StDispl_Verb "" TAB_VERB 3 0 "NotEnabled" 1 "CountingEnabled" 2 "ResetCondition" /end COMPU_VTAB
/begin COMPU_METHOD DSMRdy_OneToOne "" RAT_FUNC "%6.2" "-" COEFFS 0 1 0 0 0 1 /end COMPU_METHOD
/begin COMPU_METHOD ElecChrg_Ah_q0p125_COMPU "" RAT_FUNC "%6.3" "Ah" COEFFS 0 8 0 0 0 1 /end COMPU_METHOD
/begin COMPU_METHOD ElM_IvtrTqAbsltLimStM_sm_VERB "" TAB_VERB "%6.3" "" COMPU_TAB_REF ElM_IvtrTqAbsltLimStM_sm_VERB /end COMPU_METHOD
/begin COMPU_VTAB ElM_IvtrTqAbsltLimStM_sm_VERB "" TAB_VERB 3 0 "A_Init" 1 "A_Operation" 2 "A_Standby" /end COMPU_VTAB
/begin COMPU_METHOD FacReactVel_COMPU "" RAT_FUNC "%6.2" "mol/s/m" COEFFS 0 1 0 0 0 1 /end COMPU_METHOD
/begin COMPU_METHOD FacReactVel_q100p0_COMPU "" RAT_FUNC "%6.0" "mol/s/m" COEFFS 0 0.01 0 0 0 1 /end COMPU_METHOD
/begin COMPU_METHOD Fact0002 "" RAT_FUNC "%6.5" "-" COEFFS 0 5000 0 0 0 1 /end COMPU_METHOD
/begin COMPU_METHOD Fact1 "" RAT_FUNC "%6.4" "-" COEFFS 0 128 0 0 0 1 /end COMPU_METHOD
/begin COMPU_METHOD Fact10 "" RAT_FUNC "%13.12" "-" COEFFS 0 10000000000 0 0 0 1 /end COMPU_METHOD
/begin COMPU_METHOD Fact16384_COMPU "" RAT_FUNC "%7.6" "%/hPa" COEFFS 0 16384 0 0 0 1 /end COMPU_METHOD
/begin COMPU_METHOD Fact255_COMPU "" RAT_FUNC "%6.4" "-" COEFFS 0 255 0 0 0 1 /end COMPU_METHOD
/begin COMPU_METHOD Fact256 "" RAT_FUNC "%6.4" "-" COEFFS 0 256 0 0 0 1 /end COMPU_METHOD
/begin COMPU_METHOD Fact3 "" RAT_FUNC "%6.4" "-" COEFFS 0 100 0 0 0 1 /end COMPU_METHOD
/begin COMPU_METHOD Fact4 "" RAT_FUNC "%6.4" "-" COEFFS 0 20 0 0 0 1 /end COMPU_METHOD
/begin COMPU_METHOD Fact5 "" RAT_FUNC "%6.3" "-" COEFFS 0 2 0 0 0 1 /end COMPU_METHOD
/begin COMPU_METHOD Fact6 "" RAT_FUNC "%6.4" "-" COEFFS 0 500 0 0 0 1 /end COMPU_METHOD
/begin COMPU_METHOD Fact7 "" RAT_FUNC "%10.9" "-" COEFFS 0 10000000 0 0 0 1 /end COMPU_METHOD
/begin COMPU_METHOD Fact8 "" RAT_FUNC "%11.10" "-" COEFFS 0 100000000 0 0 0 1 /end COMPU_METHOD
/begin COMPU_METHOD Fact9 "" RAT_FUNC "%6.5" "-" COEFFS 0 5000 0 0 0 1 /end COMPU_METHOD
/begin COMPU_METHOD FactFine "" RAT_FUNC "%9.8" "-" COEFFS 0 1000000 0 0 0 1 /end COMPU_METHOD
/begin COMPU_METHOD FactLow1 "" RAT_FUNC "%6.4" "-" COEFFS 0 25 0 0 0 1 /end COMPU_METHOD
/begin COMPU_METHOD FactRev "" RAT_FUNC "%6.3" "-" COEFFS 0 10 0 0 0 1 /end COMPU_METHOD
/begin COMPU_METHOD Fact_10000 "" RAT_FUNC "%7.6" "-" COEFFS 0 10000 0 0 0 1 /end COMPU_METHOD
/begin COMPU_METHOD Fact_2pwr11 "" RAT_FUNC "%6.5" "-" COEFFS 0 2048 0 0 0 1 /end COMPU_METHOD
/begin COMPU_METHOD Fact_EGT "" RAT_FUNC "%6.5" "-" COEFFS 0 1000 0 0 0 1 /end COMPU_METHOD
/begin COMPU_METHOD Fact_NSC "" RAT_FUNC "%6.5" "-" COEFFS 0 1000 0 0 0 1 /end COMPU_METHOD
/begin COMPU_METHOD Fact_NSCEff "" RAT_FUNC "%7.6" "-" COEFFS 0 10000 0 0 0 1 /end COMPU_METHOD
/begin COMPU_METHOD Fact_q0p001 "" RAT_FUNC "%6.5" "-" COEFFS 0 1000 0 0 0 1 /end COMPU_METHOD
/begin COMPU_METHOD Fact_q0p1_COMPU "" RAT_FUNC "%6.3" "-" COEFFS 0 10 0 0 0 1 /end COMPU_METHOD
/begin COMPU_METHOD Fact_q6554p0_COMPU "" RAT_FUNC "%7.0" "-" COEFFS 0 0.000152578577967653 0 0 0 1 /end COMPU_METHOD
/begin COMPU_METHOD Fact_SOx1 "" RAT_FUNC "%9.8" "-" COEFFS 0 1000000 0 0 0 1 /end COMPU_METHOD
/begin COMPU_METHOD Fact_VolNSC "" RAT_FUNC "%9.8" "-" COEFFS 0 1000000 0 0 0 1 /end COMPU_METHOD
/begin COMPU_METHOD Fac_q0p0001_COMPU "" RAT_FUNC "%7.6" "-" COEFFS 0 10000 0 0 0 1 /end COMPU_METHOD
/begin COMPU_METHOD fak_q0p002441_sm1 "" RAT_FUNC "%6.4" "1/s" COEFFS 0 65536 0 0 0 160 /end COMPU_METHOD
/begin COMPU_METHOD fak_sw_b5 "" RAT_FUNC "%6.5" "-" COEFFS 0 65536 0 0 0 10 /end COMPU_METHOD
/begin COMPU_METHOD fak_uw_b8 "" RAT_FUNC "%6.5" "-" COEFFS 0 65536 0 0 0 8 /end COMPU_METHOD
/begin COMPU_METHOD FAN1_TYPAVL_SC_Compu "" TAB_VERB "%6.3" "" COMPU_TAB_REF FAN1_TYPAVL_SC_Compu /end COMPU_METHOD
/begin COMPU_VTAB FAN1_TYPAVL_SC_Compu "" TAB_VERB 2 0 "FALSE" 1 "TRUE" /end COMPU_VTAB
/begin COMPU_METHOD FANRLY1POSN_TYPAVL_SC_Compu "" TAB_VERB "%6.3" "" COMPU_TAB_REF FANRLY1POSN_TYPAVL_SC_Compu /end COMPU_METHOD
/begin COMPU_VTAB FANRLY1POSN_TYPAVL_SC_Compu "" TAB_VERB 2 0 "False" 1 "True" /end COMPU_VTAB
/begin COMPU_METHOD FANRLY1_TYPAVL_SC_Compu "" TAB_VERB "%6.3" "" COMPU_TAB_REF FANRLY1_TYPAVL_SC_Compu /end COMPU_METHOD
/begin COMPU_VTAB FANRLY1_TYPAVL_SC_Compu "" TAB_VERB 2 0 "False" 1 "True" /end COMPU_VTAB
/begin COMPU_METHOD FANSPD_TYPAVL_SC_Compu "" TAB_VERB "%6.3" "" COMPU_TAB_REF FANSPD_TYPAVL_SC_Compu /end COMPU_METHOD
/begin COMPU_VTAB FANSPD_TYPAVL_SC_Compu "" TAB_VERB 2 0 "False" 1 "True" /end COMPU_VTAB
/begin COMPU_METHOD FlConsum_l "" RAT_FUNC "%6.5" "l" COEFFS 0 1000 0 0 0 1 /end COMPU_METHOD
/begin COMPU_METHOD FlConsum_l_h "" RAT_FUNC "%6.4" "l/h" COEFFS 0 100 0 0 0 1 /end COMPU_METHOD
/begin COMPU_METHOD leist_q16_W "" RAT_FUNC "%6.1" "W" COEFFS 0 1 0 0 0 16 /end COMPU_METHOD
/begin COMPU_METHOD nmot_q1 "" RAT_FUNC "%6.2" "1/min" COEFFS 0 1 0 0 0 1 /end COMPU_METHOD
/begin COMPU_METHOD OneToOne "" RAT_FUNC "%6.2" "-" COEFFS 0 1 0 0 0 1 /end COMPU_METHOD
/begin COMPU_METHOD Prc "" RAT_FUNC "%6.4" "%" COEFFS 0 81.92 0 0 0 1 /end COMPU_METHOD
/begin COMPU_METHOD Pres_hPa "" RAT_FUNC "%6.2" "hPa" COEFFS 0 1 0 0 0 1 /end COMPU_METHOD
/begin COMPU_METHOD PSC_Fact "" RAT_FUNC "%7.6" "-" COEFFS 0 32767 0 0 0 1 /end COMPU_METHOD
/begin COMPU_METHOD RBPtCel_pwr_25p0_1 "" RAT_FUNC "%6.1" "W" COEFFS 0 1 0 0 0 25 /end COMPU_METHOD
/begin COMPU_METHOD RBPtElTrac_stEmOperMod_VERB "" TAB_VERB "%6.3" "" COMPU_TAB_REF RBPtElTrac_stEmOperMod_VERB /end COMPU_METHOD
/begin COMPU_VTAB RBPtElTrac_stEmOperMod_VERB "" TAB_VERB 19 0 "INI" 1 "PRERUN" 2 "STANDBY" 3 "ENG_STRT" 4 "TORQUE_CTRL" 5 "SPEED_CTRL" 6 "OFFSET_CALIB" 7 "U_CTRL" 8 "I_CTRL" 9 "IDLE_CTRL" 10 "ISO_MON" 15 "HILLHOLD" 20 "FREEWHL" 21 "ACTV_SC" 27 "DISCHARGE" 28 "SHUTDOWN" 29 "OFF" 30 "EMGY_SHTDWN" 31 "FAILURE" /end COMPU_VTAB
/begin COMPU_METHOD rel_q1 "" RAT_FUNC "%6.2" "%" COEFFS 0 1 0 0 0 1 /end COMPU_METHOD
/begin COMPU_METHOD SCR_TEMP_CELS_float "" RAT_FUNC "%6.2" "deg C" COEFFS 0 1 0 0 0 1 /end COMPU_METHOD
/begin COMPU_METHOD SigQly_COMPU_VERB "" TAB_VERB "%6.3" "" COMPU_TAB_REF SigQly_COMPU_VERB /end COMPU_METHOD
/begin COMPU_VTAB SigQly_COMPU_VERB "" TAB_VERB 16 0 "SIGQLY_NOTCALC" 1 "SIGQLY_INIT" 2 "SIGQLY_OK" 3 "SIGQLY_MODEL" 4 "SIGQLY_REPLACEMENT" 5 "SIGQLY_FROZEN" 6 "SIGQLY_INVALID" 7 "SIGQLY_RESERVED_7" 8 "SIGQLY_RESERVED_8" 9 "SIGQLY_RESERVED_9" 10 "SIGQLY_RESERVED_10" 11 "SIGQLY_RESERVED_11" 12 "SIGQLY_RESERVED_12" 13 "SIGQLY_RESERVED_13" 14 "SIGQLY_RESERVED_14" 15 "SIGQLY_RESERVED_15" /end COMPU_VTAB
/begin COMPU_METHOD spg_q0p0625_V "" RAT_FUNC "%6.4" "V" COEFFS 0 16 0 0 0 1 /end COMPU_METHOD
/begin COMPU_METHOD Temp_Cels "" RAT_FUNC "%6.1" "deg C" COEFFS 0 10 2731.4 0 0 1 /end COMPU_METHOD
/begin COMPU_METHOD TimeDeb "" RAT_FUNC "%6.1" "ms" COEFFS 0 0.1 0 0 0 1 /end COMPU_METHOD
/begin COMPU_METHOD TimeDelay_s "" RAT_FUNC "%6.1" "s" COEFFS 0 0 1 0 0.00023283064365387 0 /end COMPU_METHOD
/begin COMPU_METHOD Time_Dt "" RAT_FUNC "%9.8" "s" COEFFS 0 1000000 0 0 0 1 /end COMPU_METHOD
/begin COMPU_METHOD Time_s "" RAT_FUNC "%6.4" "s" COEFFS 0 100 0 0 0 1 /end COMPU_METHOD
/begin COMPU_METHOD Trq "" RAT_FUNC "%6.3" "Nm" COEFFS 0 10 0 0 0 1 /end COMPU_METHOD
/begin COMPU_METHOD U_mV_q0p9765625_COMPU "" RAT_FUNC "%6.2" "mV" COEFFS 0 1.024 0 0 0 1 /end COMPU_METHOD
/begin COMPU_METHOD Vel "" RAT_FUNC "%6.4" "km/h" COEFFS 0 100 0 0 0 1 /end COMPU_METHOD
/begin COMPU_METHOD Volt_Batt "" RAT_FUNC "%6.1" "mV" COEFFS 0 0.05 0 0 0 1 /end COMPU_METHOD
/begin COMPU_METHOD Volt_V_q0p03125_COMPU "" RAT_FUNC "%6.4" "V" COEFFS 0 32 0 0 0 1 /end COMPU_METHOD
/begin RECORD_LAYOUT RB_Curve_S16_S16 NO_AXIS_PTS_X 1 SWORD AXIS_PTS_X 2 SWORD INDEX_INCR DIRECT FNC_VALUES 3 SWORD COLUMN_DIR DIRECT /end RECORD_LAYOUT
/begin RECORD_LAYOUT RB_Curve_U16_S16_sao NO_AXIS_PTS_X 1 UWORD AXIS_PTS_X 2 UWORD INDEX_INCR DIRECT FNC_VALUES 3 SWORD COLUMN_DIR DIRECT STATIC_ADDRESS_OFFSETS /end RECORD_LAYOUT
/begin RECORD_LAYOUT RB_Curve_U8_U8 NO_AXIS_PTS_X 1 UBYTE AXIS_PTS_X 2 UBYTE INDEX_INCR DIRECT FNC_VALUES 3 UBYTE COLUMN_DIR DIRECT /end RECORD_LAYOUT
/begin RECORD_LAYOUT RB_Map_S16S16_S16 NO_AXIS_PTS_X 1 SWORD NO_AXIS_PTS_Y 2 SWORD AXIS_PTS_X 3 SWORD INDEX_INCR DIRECT AXIS_PTS_Y 4 SWORD INDEX_INCR DIRECT FNC_VALUES 5 SWORD COLUMN_DIR DIRECT /end RECORD_LAYOUT
/begin RECORD_LAYOUT RB_Val_Wboolean FNC_VALUES 1 UBYTE COLUMN_DIR DIRECT /end RECORD_LAYOUT
/begin RECORD_LAYOUT RB_Val_Ws16 FNC_VALUES 1 SWORD COLUMN_DIR DIRECT /end RECORD_LAYOUT
/begin RECORD_LAYOUT RB_Val_Ws32 FNC_VALUES 1 SLONG COLUMN_DIR DIRECT /end RECORD_LAYOUT
/begin RECORD_LAYOUT RB_Val_Wu16 FNC_VALUES 1 UWORD COLUMN_DIR DIRECT /end RECORD_LAYOUT
/begin RECORD_LAYOUT RB_Val_Wu8 FNC_VALUES 1 UBYTE COLUMN_DIR DIRECT /end RECORD_LAYOUT
/begin RECORD_LAYOUT ValA_Wu16 FNC_VALUES 1 UWORD COLUMN_DIR DIRECT /end RECORD_LAYOUT
/begin RECORD_LAYOUT Val_Ws16 FNC_VALUES 1 SWORD COLUMN_DIR DIRECT /end RECORD_LAYOUT
/begin RECORD_LAYOUT Val_Ws32 FNC_VALUES 1 SLONG COLUMN_DIR DIRECT /end RECORD_LAYOUT
/begin RECORD_LAYOUT Val_Wu16 FNC_VALUES 1 UWORD COLUMN_DIR DIRECT /end RECORD_LAYOUT
/begin RECORD_LAYOUT Val_Wu32 FNC_VALUES 1 ULONG COLUMN_DIR DIRECT /end RECORD_LAYOUT
/begin RECORD_LAYOUT Val_Wu8 FNC_VALUES 1 UBYTE COLUMN_DIR DIRECT /end RECORD_LAYOUT
/end MODULE
/end PROJECT

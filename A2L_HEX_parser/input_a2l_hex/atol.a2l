ASAP2_VERSION 1 70
/begin PROJECT MDG1C "VC1CP091_STLA_N_D061I3"
/begin HEADER "" VERSION "VC1CP091_STLA_N_D061I3" PROJECT_NO MDG1C /end HEADER
/begin MODULE DIM ""
/begin MOD_COMMON "" BYTE_ORDER MSB_LAST ALIGNMENT_BYTE 1 ALIGNMENT_WORD 2 ALIGNMENT_LONG 4 ALIGNMENT_INT64 4 ALIGNMENT_FLOAT32_IEEE 4 ALIGNMENT_FLOAT64_IEEE 4 DATA_SIZE 32 /end MOD_COMMON
/begin CHARACTERISTIC DFC_CtlMsk2.DFC_MoFExtCptVacPmpErr_C "" VALUE 0x8024166F Val_Wu8 255.0 DFES_OneToOne 0.00 255.0 FORMAT "%5.1" /end CHARACTERISTIC
/begin CHARACTERISTIC DFC_DisblMsk2.DFC_MoFExtCptVacPmpErr_C "" VALUE 0x802491C4 Val_Wu16 65535.00 DFES_OneToOne 0.00 65535.00 FORMAT "%8.2" /end CHARACTERISTIC
/begin CHARACTERISTIC MoFExtCpt_cntrDebPVacp_C "Number of cycles are debounced for pump request" VALUE 0x8026D394 Val_Wu16 65535.00 OneToOne 0.00 65535.00 FORMAT "%8.2" /end CHARACTERISTIC
/begin CHARACTERISTIC MoFExtCpt_cntrDlyVacPSnsrTest_C "Delay counter limit sensor test" VALUE 0x8026CCC6 Val_Wu8 255.0 OneToOne 0.00 255.0 FORMAT "%5.1" /end CHARACTERISTIC
/begin CHARACTERISTIC MoFExtCpt_cntrVacPmpDebErrHiLo_C "Debounce counter limit High-Low" VALUE 0x8026CCC7 Val_Wu8 255.0 OneToOne 0.00 255.0 FORMAT "%5.1" /end CHARACTERISTIC
/begin CHARACTERISTIC MoFExtCpt_cntrVacPmpDebErrLoHi_C "Debounce counter limit Low-High" VALUE 0x8026CCC8 Val_Wu8 255.0 OneToOne 0.00 255.0 FORMAT "%5.1" /end CHARACTERISTIC
/begin CHARACTERISTIC MoFExtCpt_cntrVacPmpDebSRC1HiLo_C "Number of cycles should be debounced for the raw sensor valu" VALUE 0x8026CCC9 Val_Wu8 255.0 OneToOne 0.00 255.0 FORMAT "%5.1" /end CHARACTERISTIC
/begin CHARACTERISTIC MoFExtCpt_cntrVacPmpDebSRC1LoHi_C "Number of cycles should be debounced for the raw sensor valu" VALUE 0x8026CCCA Val_Wu8 255.0 OneToOne 0.00 255.0 FORMAT "%5.1" /end CHARACTERISTIC
/begin CHARACTERISTIC MoFExtCpt_cntrVacPmpDebSRC2HiLo_C "Number of cycles should be debounced for the raw sensor valu" VALUE 0x8026CCCB Val_Wu8 255.0 OneToOne 0.00 255.0 FORMAT "%5.1" /end CHARACTERISTIC
/begin CHARACTERISTIC MoFExtCpt_cntrVacPmpDebSRC2LoHi_C "Number of cycles should be debounced for the raw sensor valu" VALUE 0x8026CCCC Val_Wu8 255.0 OneToOne 0.00 255.0 FORMAT "%5.1" /end CHARACTERISTIC
/begin CHARACTERISTIC MoFExtCpt_cntrVacPmpDfcSet_C "Delay counter set diagnostics" VALUE 0x8026CCCD Val_Wu8 255.0 OneToOne 0.00 255.0 FORMAT "%5.1" /end CHARACTERISTIC
/begin CHARACTERISTIC MoFExtCpt_cntrVacPmpDlyDfcRst_C "Delay counter reset diagnostics" VALUE 0x802513B8 RB_Val_Wu8 255.0 OneToOne 0.00 255.0 FORMAT "%5.1" /end CHARACTERISTIC
/begin CHARACTERISTIC MoFExtCpt_cntrVacPmpDlyPmpTest_C "Delay counter pump test" VALUE 0x8026CCCE Val_Wu8 255.0 OneToOne 0.00 255.0 FORMAT "%5.1" /end CHARACTERISTIC
/begin CHARACTERISTIC MoFExtCpt_cntrVacPSnsrDebErrHiLo_C "Debounce counter limit High-Low stuck sensor" VALUE 0x8026CCCF Val_Wu8 255.0 OneToOne 0.00 255.0 FORMAT "%5.1" /end CHARACTERISTIC
/begin CHARACTERISTIC MoFExtCpt_cntrVacPSnsrDebErrLoHi_C "Debounce counter limit Low-High stuck sensor" VALUE 0x8026CCD0 Val_Wu8 255.0 OneToOne 0.00 255.0 FORMAT "%5.1" /end CHARACTERISTIC
/begin CHARACTERISTIC MoFExtCpt_cntrVacPSnsrPlauTest_C "Calibration for the vaccum pump plausability" VALUE 0x8026CCD1 Val_Wu8 255.0 OneToOne 0.00 255.0 FORMAT "%5.1" /end CHARACTERISTIC
/begin CHARACTERISTIC MoFExtCpt_facCnvnSlopDig_C "Calibration for Adjusting the SPI raw value into Pressure value." VALUE 0x8026D396 Val_Wu16 0.9999847 fak_uw_b1 0.00 0.9999847 FORMAT "%9.7" /end CHARACTERISTIC
/begin CHARACTERISTIC MoFExtCpt_facMaxDynChk_C "Calibration for Maximum Factor value for dynamic range check." VALUE 0x8026CCD2 Val_Wu8 2.550 fak_uw_q0p01 0.00 2.550 FORMAT "%5.3" /end CHARACTERISTIC
/begin CHARACTERISTIC MoFExtCpt_facMinDynChk_C "Calibration for Minimum Factor value for dynamic range check." VALUE 0x8026CCD3 Val_Wu8 2.550 fak_uw_q0p01 0.00 2.550 FORMAT "%5.3" /end CHARACTERISTIC
/begin CHARACTERISTIC MoFExtCpt_flgAdcCnvrSel_C "Calibration to select between 2 options to read ADC value" VALUE 0x8026CCD4 Val_Wu8 1.00000000000 B_TRUE 0.00 1.00000000000 FORMAT "%13.11" /end CHARACTERISTIC
/begin CHARACTERISTIC MoFExtCpt_flgEnaEnvPSnsr_C "The varibale is used either to select Environment pressure or Calibarted pressure" VALUE 0x8026CCD5 Val_Wu8 1.00000000000 B_TRUE 0.00 1.00000000000 FORMAT "%13.11" /end CHARACTERISTIC
/begin CHARACTERISTIC MoFExtCpt_flgEnaEnvPSpi_C "Calibration to switch in Level1 and Level2 update" VALUE 0x8026CCD6 Val_Wu8 1.00000000000 B_TRUE 0.00 1.00000000000 FORMAT "%13.11" /end CHARACTERISTIC
/begin CHARACTERISTIC MoFExtCpt_numCycVacPmpEfcDebErrHiLo_C "number of cycles for healing the error" VALUE 0x8026CCD7 Val_Wu8 254.0 OneToOne 1.0 255.0 FORMAT "%5.1" EXTENDED_LIMITS 0.00 255.0 /end CHARACTERISTIC
/begin CHARACTERISTIC MoFExtCpt_numCycVacPmpEfcDebErrLoHi_C "number of cycles for setting the error" VALUE 0x8026CCD8 Val_Wu8 254.0 OneToOne 1.0 255.0 FORMAT "%5.1" EXTENDED_LIMITS 0.00 255.0 /end CHARACTERISTIC
/begin CHARACTERISTIC MoFExtCpt_pCnvnOffs_C "Calibration Offset for the pressure value conversion." VALUE 0x8026D398 Val_Wu16 2559.961 p_q0p039 0.00 2559.961 FORMAT "%8.3" /end CHARACTERISTIC
/begin CHARACTERISTIC MoFExtCpt_pDiffVacPmpMin_C "Lower Limit Differential Pressure for Function Test" VALUE 0x8026D39A Val_Ws16 65535.00 RBPtCel_p_1p0_1 -32768.00 32767.00 FORMAT "%8.2" /end CHARACTERISTIC
/begin CHARACTERISTIC MoFExtCpt_pEnv_C "Environmental Pressure" VALUE 0x8026D39C Val_Ws16 65535.00 RBPtCel_p_1p0_1 -32768.00 32767.00 FORMAT "%8.2" /end CHARACTERISTIC
/begin CHARACTERISTIC MoFExtCpt_pMaxSigRngChk_C "Calibration for Maximum range check for signal." VALUE 0x8026D39E Val_Wu16 2559.961 p_q0p039 0.00 2559.961 FORMAT "%8.3" /end CHARACTERISTIC
/begin CHARACTERISTIC MoFExtCpt_pMinSigRngChk_C "Calibration for minimum range check for signal." VALUE 0x8026D3A0 Val_Wu16 2559.961 p_q0p039 0.00 2559.961 FORMAT "%8.3" /end CHARACTERISTIC
/begin CHARACTERISTIC MoFExtCpt_pSnsrThdPMax_C "threshold pressure for vacuum pressure" VALUE 0x8026D3A2 Val_Ws16 65535.00 RBPtCel_p_1p0_1 -32768.00 32767.00 FORMAT "%8.2" /end CHARACTERISTIC
/begin CHARACTERISTIC MoFExtCpt_pThdEnvPBasdPmpReqOff_T "Curve for vacuum pressure of pump start" CURVE 0x8026D3A4 Mo_DataCurveSstS16WS16 65535.00 RBPtCel_p_1p0_1 -32768.00 32767.00 FORMAT "%8.2"
 /begin AXIS_DESCR STD_AXIS NO_INPUT_QUANTITY RBPtCel_p_1p0_1 5 -32768.00 32767.00 FORMAT "%8.2" DEPOSIT ABSOLUTE /end AXIS_DESCR
/end CHARACTERISTIC
/begin CHARACTERISTIC MoFExtCpt_pThdEnvPBasdPmpReqOn_T "Curve for vacuum pressure of pump stop" CURVE 0x8026D3BA Mo_DataCurveSstS16WS16 65535.00 RBPtCel_p_1p0_1 -32768.00 32767.00 FORMAT "%8.2"
 /begin AXIS_DESCR STD_AXIS NO_INPUT_QUANTITY RBPtCel_p_1p0_1 5 -32768.00 32767.00 FORMAT "%8.2" DEPOSIT ABSOLUTE /end AXIS_DESCR
/end CHARACTERISTIC
/begin CHARACTERISTIC MoFExtCpt_pThdPmpReqOff_M "Map of Vehicle speed and Environment pressure for pump stop" MAP 0x8026D3D0 Map_Xs16Ys16Ws16 65535.00 RBPtCel_p_1p0_1 -32768.00 32767.00 FORMAT "%8.2"
 /begin AXIS_DESCR STD_AXIS NO_INPUT_QUANTITY RBPtCel_p_1p0_1 5 -32768.00 32767.00 FORMAT "%8.2" DEPOSIT ABSOLUTE /end AXIS_DESCR
 /begin AXIS_DESCR STD_AXIS MoFBas_vVeh vel_q0p01 8 -327.6800 327.6700 FORMAT "%8.4" DEPOSIT ABSOLUTE /end AXIS_DESCR
/end CHARACTERISTIC
/begin CHARACTERISTIC MoFExtCpt_pThdPmpReqOn_M "Map of Vehicle and Environment pressure for pump start" MAP 0x8026D43E Map_Xs16Ys16Ws16 65535.00 RBPtCel_p_1p0_1 -32768.00 32767.00 FORMAT "%8.2"
 /begin AXIS_DESCR STD_AXIS NO_INPUT_QUANTITY RBPtCel_p_1p0_1 5 -32768.00 32767.00 FORMAT "%8.2" DEPOSIT ABSOLUTE /end AXIS_DESCR
 /begin AXIS_DESCR STD_AXIS MoFBas_vVeh vel_q0p01 8 -327.6800 327.6700 FORMAT "%8.4" DEPOSIT ABSOLUTE /end AXIS_DESCR
/end CHARACTERISTIC
/begin CHARACTERISTIC MoFExtCpt_pVacPCnvnFrmUSnsr1_T "Conversion Table Voltage to Pressure for sensor 1" CURVE 0x8026D4AC Mo_DataCurveSstS16WS16 65535.00 RBPtCel_p_1p0_1 -32768.00 32767.00 FORMAT "%8.2"
 /begin AXIS_DESCR STD_AXIS MoFExtCpt_uVacPRaw1 RBPtCel_u_0p2_1 6 -6553.600 6553.400 FORMAT "%8.3" DEPOSIT ABSOLUTE /end AXIS_DESCR
/end CHARACTERISTIC
/begin CHARACTERISTIC MoFExtCpt_pVacPCnvnFrmUSnsr2_T "Conversion Table Voltage to Pressure for sensor 2" CURVE 0x8026D4C6 Mo_DataCurveSstS16WS16 65535.00 RBPtCel_p_1p0_1 -32768.00 32767.00 FORMAT "%8.2"
 /begin AXIS_DESCR STD_AXIS MoFExtCpt_uVacPRaw2 RBPtCel_u_0p2_1 6 -6553.600 6553.400 FORMAT "%8.3" DEPOSIT ABSOLUTE /end AXIS_DESCR
/end CHARACTERISTIC
/begin CHARACTERISTIC MoFExtCpt_pVacPmpTestDif_M "Map Parameter for MoFExtCpt_pVacPmpTestDif" MAP 0x8026D4E0 Map_Xs16Ys16Ws16 65535.00 RBPtCel_p_1p0_1 -32768.00 32767.00 FORMAT "%8.2"
 /begin AXIS_DESCR STD_AXIS MoFExtCpt_pSampleVacPmp RBPtCel_p_1p0_1 6 -32768.00 32767.00 FORMAT "%8.2" DEPOSIT ABSOLUTE /end AXIS_DESCR
 /begin AXIS_DESCR STD_AXIS NO_INPUT_QUANTITY p_q0p039 6 0.00 2559.961 FORMAT "%8.3" DEPOSIT ABSOLUTE /end AXIS_DESCR
/end CHARACTERISTIC
/begin CHARACTERISTIC MoFExtCpt_pVacPUnfildSfty_C "Calibration value for filtered value when there is an error in filter 1 2" VALUE 0x8026D544 Val_Ws16 65535.00 RBPtCel_p_1p0_1 -32768.00 32767.00 FORMAT "%8.2" /end CHARACTERISTIC
/begin CHARACTERISTIC MoFExtCpt_pVacSensrTestDif_C "Minimal change in pressure during sensor test" VALUE 0x8026D546 Val_Ws16 65535.00 RBPtCel_p_1p0_1 -32768.00 32767.00 FORMAT "%8.2" /end CHARACTERISTIC
/begin CHARACTERISTIC MoFExtCpt_pVacSensrUnfildAbsltDifMax_C "Calibration for maximum filtered value" VALUE 0x8026D548 Val_Ws16 65535.00 RBPtCel_p_1p0_1 -32768.00 32767.00 FORMAT "%8.2" /end CHARACTERISTIC
/begin CHARACTERISTIC MoFExtCpt_stBrkBstPFlt_C "Calibration for caution status" VALUE 0x8026CCD9 Val_Wu8 255.0 OneToOne 0.00 255.0 FORMAT "%5.1" /end CHARACTERISTIC
/begin CHARACTERISTIC MoFExtCpt_stMstWrnLmp_C "Calibration for warning lamp" VALUE 0x8026CCDA Val_Wu8 255.0 OneToOne 0.00 255.0 FORMAT "%5.1" /end CHARACTERISTIC
/begin CHARACTERISTIC MoFExtCpt_stPwtActv_C "Calibrationvariable for power train status" VALUE 0x8026CCDB Val_Wu8 15.0000000000 CoPtFH_stPwt_VERB 0.00 15.0000000000 FORMAT "%13.10" /end CHARACTERISTIC
/begin CHARACTERISTIC MoFExtCpt_stSelVacPmpUnfild_C "Calibration for filtered value" VALUE 0x8026CCDC Val_Wu8 5.000 OneToOne 0.00 5.000 FORMAT "%5.3" EXTENDED_LIMITS 0.00 255.0 /end CHARACTERISTIC
/begin CHARACTERISTIC MoFExtCpt_swtVacPmpErr_C "Selection which Errors set an DFC" VALUE 0x8026CCDD Val_Wu8 255.0 OneToOne 0.00 255.0 FORMAT "%5.1" /end CHARACTERISTIC
/begin CHARACTERISTIC MoFExtCpt_swtVacPmpTestSeln_C "Selection of performed tests" VALUE 0x8026CCDE Val_Wu8 255.0 OneToOne 0.00 255.0 FORMAT "%5.1" /end CHARACTERISTIC
/begin CHARACTERISTIC MoFExtCpt_tiVacPFil_C "Time Constant of Filter" VALUE 0x8026D54A Val_Wu16 655.34000000000003 zk10msxs_uw_b655p36PT1 0.01000000000000 655.35000000000002 FORMAT "%19.14" EXTENDED_LIMITS 0.00000015259022 655.35000000000002 /end CHARACTERISTIC
/begin CHARACTERISTIC MoFExtCpt_uAdcCnvrMask_C "Calibration to mask 12bits in ADC raw value" VALUE 0x8026D54C Val_Ws16 65535.00 OneToOne -32768.00 32767.00 FORMAT "%8.2" /end CHARACTERISTIC
/begin CHARACTERISTIC MoFExtCpt_uAdcCnvrShift_C "Calibration to right adjust the 12bits in raw ADC value" VALUE 0x8026D54E Val_Wu16 65535.00 OneToOne 0.00 65535.00 FORMAT "%8.2" /end CHARACTERISTIC
/begin CHARACTERISTIC MoFExtCpt_uVacPHiThd_C "Upper Threshold of Voltage Range" VALUE 0x8026D550 Val_Ws16 13107.00 RBPtCel_u_0p2_1 -6553.600 6553.400 FORMAT "%8.3" /end CHARACTERISTIC
/begin CHARACTERISTIC MoFExtCpt_uVacPLoThd_C "Lower Threshold of Voltage Range" VALUE 0x8026D552 Val_Ws16 13107.00 RBPtCel_u_0p2_1 -6553.600 6553.400 FORMAT "%8.3" /end CHARACTERISTIC
/begin CHARACTERISTIC MoFFrm_DataApplSigRx_MoFFrm_flgBrkRaw.divFac_C "Apllication value for signal MoFFrm_flgBrkRaw / Signal divisor." VALUE 0x802700D4 Val_Wu32 4294967295.00 OneToOne 0.00 4294967295.00 FORMAT "%13.2" /end CHARACTERISTIC
/begin CHARACTERISTIC MoFFrm_DataApplSigRx_MoFFrm_flgBrkRaw.mulFac_C "Apllication value for signal MoFFrm_flgBrkRaw / Signal multiplier" VALUE 0x802700D8 Val_Wu32 4294967295.00 OneToOne 0.00 4294967295.00 FORMAT "%13.2" /end CHARACTERISTIC
/begin CHARACTERISTIC MoFFrm_DataApplSigRx_MoFFrm_flgBrkRaw.offsFac_C "Apllication value for signal MoFFrm_flgBrkRaw / Signal offset" VALUE 0x802700DC Val_Ws32 4294967295.00 OneToOne -2147483648.00 2147483647.00 FORMAT "%13.2" /end CHARACTERISTIC
/begin CHARACTERISTIC MoFFrm_DataApplSigRx_MoFFrm_flgDcChrgnVoltMeasmtErr.divFac_C "MoFFrm_flgDcChrgnVoltMeasmtErr data / Signal divisor." VALUE 0x802700E0 Val_Wu32 4294967295.00 OneToOne 0.00 4294967295.00 FORMAT "%13.2" /end CHARACTERISTIC
/begin CHARACTERISTIC MoFFrm_DataApplSigRx_MoFFrm_flgDcChrgnVoltMeasmtErr.mulFac_C "MoFFrm_flgDcChrgnVoltMeasmtErr data / Signal multiplier" VALUE 0x802700E4 Val_Wu32 4294967295.00 OneToOne 0.00 4294967295.00 FORMAT "%13.2" /end CHARACTERISTIC
/begin CHARACTERISTIC MoFFrm_DataApplSigRx_MoFFrm_flgDcChrgnVoltMeasmtErr.offsFac_C "MoFFrm_flgDcChrgnVoltMeasmtErr data / Signal offset" VALUE 0x802700E8 Val_Ws32 4294967295.00 OneToOne -2147483648.00 2147483647.00 FORMAT "%13.2" /end CHARACTERISTIC
/begin CHARACTERISTIC MoFFrm_DataApplSigRx_MoFFrm_flgDcChrgnVoltMeasmtSysErr.divFac_C "MoFFrm_flgDcChrgnVoltMeasmtSysErr data / Signal divisor." VALUE 0x802700EC Val_Wu32 4294967295.00 OneToOne 0.00 4294967295.00 FORMAT "%13.2" /end CHARACTERISTIC
/begin CHARACTERISTIC MoFFrm_DataApplSigRx_MoFFrm_flgDcChrgnVoltMeasmtSysErr.mulFac_C "MoFFrm_flgDcChrgnVoltMeasmtSysErr data / Signal multiplier" VALUE 0x802700F0 Val_Wu32 4294967295.00 OneToOne 0.00 4294967295.00 FORMAT "%13.2" /end CHARACTERISTIC
/begin CHARACTERISTIC MoFFrm_DataApplSigRx_MoFFrm_flgDcChrgnVoltMeasmtSysErr.offsFac_C "MoFFrm_flgDcChrgnVoltMeasmtSysErr data / Signal offset" VALUE 0x802700F4 Val_Ws32 4294967295.00 OneToOne -2147483648.00 2147483647.00 FORMAT "%13.2" /end CHARACTERISTIC
/begin CHARACTERISTIC MoFFrm_DataApplSigRx_MoFFrm_flgDcChrgnVoltMeasmtVld.divFac_C "MoFFrm_flgDcChrgnVoltMeasmtVld data / Signal divisor." VALUE 0x802700F8 Val_Wu32 4294967295.00 OneToOne 0.00 4294967295.00 FORMAT "%13.2" /end CHARACTERISTIC
/begin CHARACTERISTIC MoFFrm_DataApplSigRx_MoFFrm_flgDcChrgnVoltMeasmtVld.mulFac_C "MoFFrm_flgDcChrgnVoltMeasmtVld data / Signal multiplier" VALUE 0x802700FC Val_Wu32 4294967295.00 OneToOne 0.00 4294967295.00 FORMAT "%13.2" /end CHARACTERISTIC
/begin CHARACTERISTIC MoFFrm_DataApplSigRx_MoFFrm_flgDcChrgnVoltMeasmtVld.offsFac_C "MoFFrm_flgDcChrgnVoltMeasmtVld data / Signal offset" VALUE 0x80270100 Val_Ws32 4294967295.00 OneToOne -2147483648.00 2147483647.00 FORMAT "%13.2" /end CHARACTERISTIC
/begin CHARACTERISTIC MoFFrm_DataApplSigRx_MoFFrm_flgDcChrgnVoltRngErr.divFac_C "MoFFrm_flgDcChrgnVoltRngErr data / Signal divisor." VALUE 0x80270104 Val_Wu32 4294967295.00 OneToOne 0.00 4294967295.00 FORMAT "%13.2" /end CHARACTERISTIC
/begin CHARACTERISTIC MoFFrm_DataApplSigRx_MoFFrm_flgDcChrgnVoltRngErr.mulFac_C "MoFFrm_flgDcChrgnVoltRngErr data / Signal multiplier" VALUE 0x80270108 Val_Wu32 4294967295.00 OneToOne 0.00 4294967295.00 FORMAT "%13.2" /end CHARACTERISTIC
/begin CHARACTERISTIC MoFFrm_DataApplSigRx_MoFFrm_flgDcChrgnVoltRngErr.offsFac_C "MoFFrm_flgDcChrgnVoltRngErr data / Signal offset" VALUE 0x8027010C Val_Ws32 4294967295.00 OneToOne -2147483648.00 2147483647.00 FORMAT "%13.2" /end CHARACTERISTIC
/begin CHARACTERISTIC MoFFrm_DataApplSigRx_MoFFrm_flgDrvrDoorOpen.divFac_C "Application value for MoFFrm_flgDrvrDoorOpen signal / Signal divisor." VALUE 0x80270110 Val_Wu32 4294967295.00 OneToOne 0.00 4294967295.00 FORMAT "%13.2" /end CHARACTERISTIC
/begin CHARACTERISTIC MoFFrm_DataApplSigRx_MoFFrm_flgDrvrDoorOpen.mulFac_C "Application value for MoFFrm_flgDrvrDoorOpen signal / Signal multiplier" VALUE 0x80270114 Val_Wu32 4294967295.00 OneToOne 0.00 4294967295.00 FORMAT "%13.2" /end CHARACTERISTIC
/begin CHARACTERISTIC MoFFrm_DataApplSigRx_MoFFrm_flgDrvrDoorOpen.offsFac_C "Application value for MoFFrm_flgDrvrDoorOpen signal / Signal offset" VALUE 0x80270118 Val_Ws32 4294967295.00 OneToOne -2147483648.00 2147483647.00 FORMAT "%13.2" /end CHARACTERISTIC
/begin CHARACTERISTIC MoFFrm_DataApplSigRx_MoFFrm_flgPreCdngWakeup.divFac_C "MoFFrm_Rx / Signal divisor." VALUE 0x8027011C Val_Wu32 4294967295.00 OneToOne 0.00 4294967295.00 FORMAT "%13.2" /end CHARACTERISTIC
/begin CHARACTERISTIC MoFFrm_DataApplSigRx_MoFFrm_flgPreCdngWakeup.mulFac_C "MoFFrm_Rx / Signal multiplier" VALUE 0x80270120 Val_Wu32 4294967295.00 OneToOne 0.00 4294967295.00 FORMAT "%13.2" /end CHARACTERISTIC
/begin CHARACTERISTIC MoFFrm_DataApplSigRx_MoFFrm_flgPreCdngWakeup.offsFac_C "MoFFrm_Rx / Signal offset" VALUE 0x80270124 Val_Ws32 4294967295.00 OneToOne -2147483648.00 2147483647.00 FORMAT "%13.2" /end CHARACTERISTIC
/begin CHARACTERISTIC MoFFrm_DataApplSigRx_MoFFrm_flgRgnInhbn.divFac_C "Application value for MoFFrm_flgRgnInhbn signal / Signal divisor." VALUE 0x80270128 Val_Wu32 4294967295.00 OneToOne 0.00 4294967295.00 FORMAT "%13.2" /end CHARACTERISTIC
/begin CHARACTERISTIC MoFFrm_DataApplSigRx_MoFFrm_flgRgnInhbn.mulFac_C "Application value for MoFFrm_flgRgnInhbn signal / Signal multiplier" VALUE 0x8027012C Val_Wu32 4294967295.00 OneToOne 0.00 4294967295.00 FORMAT "%13.2" /end CHARACTERISTIC
/begin CHARACTERISTIC MoFFrm_DataApplSigRx_MoFFrm_flgRgnInhbn.offsFac_C "Application value for MoFFrm_flgRgnInhbn signal / Signal offset" VALUE 0x80270130 Val_Ws32 4294967295.00 OneToOne -2147483648.00 2147483647.00 FORMAT "%13.2" /end CHARACTERISTIC
/begin CHARACTERISTIC MoFFrm_DataApplSigRx_MoFFrm_flgVehHldActv.divFac_C "Application value for MoFFrm_flgVehHldActv / Signal divisor." VALUE 0x80270134 Val_Wu32 4294967295.00 OneToOne 0.00 4294967295.00 FORMAT "%13.2" /end CHARACTERISTIC
/begin CHARACTERISTIC MoFFrm_DataApplSigRx_MoFFrm_flgVehHldActv.mulFac_C "Application value for MoFFrm_flgVehHldActv / Signal multiplier" VALUE 0x80270138 Val_Wu32 4294967295.00 OneToOne 0.00 4294967295.00 FORMAT "%13.2" /end CHARACTERISTIC
/begin CHARACTERISTIC MoFFrm_DataApplSigRx_MoFFrm_flgVehHldActv.offsFac_C "Application value for MoFFrm_flgVehHldActv / Signal offset" VALUE 0x8027013C Val_Ws32 4294967295.00 OneToOne -2147483648.00 2147483647.00 FORMAT "%13.2" /end CHARACTERISTIC
/begin CHARACTERISTIC MoFFrm_DataApplSigRx_MoFFrm_nEm01CANRaw.divFac_C "Structure instance of signal MoFFrm_nEm01CANRaw / Signal divisor." VALUE 0x80270140 Val_Wu32 4294967295.00 OneToOne 0.00 4294967295.00 FORMAT "%13.2" /end CHARACTERISTIC
/begin CHARACTERISTIC MoFFrm_DataApplSigRx_MoFFrm_nEm01CANRaw.mulFac_C "Structure instance of signal MoFFrm_nEm01CANRaw / Signal multiplier" VALUE 0x80270144 Val_Wu32 4294967295.00 OneToOne 0.00 4294967295.00 FORMAT "%13.2" /end CHARACTERISTIC
/begin CHARACTERISTIC MoFFrm_DataApplSigRx_MoFFrm_nEm01CANRaw.offsFac_C "Structure instance of signal MoFFrm_nEm01CANRaw / Signal offset" VALUE 0x80270148 Val_Ws32 4294967295.00 OneToOne -2147483648.00 2147483647.00 FORMAT "%13.2" /end CHARACTERISTIC
/begin CHARACTERISTIC MoFFrm_DataApplSigRx_MoFFrm_stCplCrash.divFac_C "MoFFrm_stCplCrash data / Signal divisor." VALUE 0x8027014C Val_Wu32 4294967295.00 OneToOne 0.00 4294967295.00 FORMAT "%13.2" /end CHARACTERISTIC
/begin CHARACTERISTIC MoFFrm_DataApplSigRx_MoFFrm_stCplCrash.mulFac_C "MoFFrm_stCplCrash data / Signal multiplier" VALUE 0x80270150 Val_Wu32 4294967295.00 OneToOne 0.00 4294967295.00 FORMAT "%13.2" /end CHARACTERISTIC
/begin CHARACTERISTIC MoFFrm_DataApplSigRx_MoFFrm_stCplCrash.offsFac_C "MoFFrm_stCplCrash data / Signal offset" VALUE 0x80270154 Val_Ws32 4294967295.00 OneToOne -2147483648.00 2147483647.00 FORMAT "%13.2" /end CHARACTERISTIC
/begin CHARACTERISTIC MoFFrm_DataApplSigRx_MoFFrm_stCrash.divFac_C "Structure instance of signal MoFFrm_stCrash / Signal divisor." VALUE 0x80270158 Val_Wu32 4294967295.00 OneToOne 0.00 4294967295.00 FORMAT "%13.2" /end CHARACTERISTIC
/begin CHARACTERISTIC MoFFrm_DataApplSigRx_MoFFrm_stCrash.mulFac_C "Structure instance of signal MoFFrm_stCrash / Signal multiplier" VALUE 0x8027015C Val_Wu32 4294967295.00 OneToOne 0.00 4294967295.00 FORMAT "%13.2" /end CHARACTERISTIC
/begin CHARACTERISTIC MoFFrm_DataApplSigRx_MoFFrm_stCrash.offsFac_C "Structure instance of signal MoFFrm_stCrash / Signal offset" VALUE 0x80270160 Val_Ws32 4294967295.00 OneToOne -2147483648.00 2147483647.00 FORMAT "%13.2" /end CHARACTERISTIC
/begin CHARACTERISTIC MoFFrm_DataApplSigRx_MoFFrm_stDcdcErr.divFac_C "Structure instance of signal MoFFrm_stDcdcErr / Signal divisor." VALUE 0x80270164 Val_Wu32 4294967295.00 OneToOne 0.00 4294967295.00 FORMAT "%13.2" /end CHARACTERISTIC
/begin CHARACTERISTIC MoFFrm_DataApplSigRx_MoFFrm_stDcdcErr.mulFac_C "Structure instance of signal MoFFrm_stDcdcErr / Signal multiplier" VALUE 0x80270168 Val_Wu32 4294967295.00 OneToOne 0.00 4294967295.00 FORMAT "%13.2" /end CHARACTERISTIC
/begin CHARACTERISTIC MoFFrm_DataApplSigRx_MoFFrm_stDcdcErr.offsFac_C "Structure instance of signal MoFFrm_stDcdcErr / Signal offset" VALUE 0x8027016C Val_Ws32 4294967295.00 OneToOne -2147483648.00 2147483647.00 FORMAT "%13.2" /end CHARACTERISTIC
/begin CHARACTERISTIC MoFFrm_DataApplSigRx_MoFFrm_stDrvrSeatBlt.divFac_C "Application value for MoFFrm_stDrvrSeatBlt signal / Signal divisor." VALUE 0x80270170 Val_Wu32 4294967295.00 OneToOne 0.00 4294967295.00 FORMAT "%13.2" /end CHARACTERISTIC
/begin CHARACTERISTIC MoFFrm_DataApplSigRx_MoFFrm_stDrvrSeatBlt.mulFac_C "Application value for MoFFrm_stDrvrSeatBlt signal / Signal multiplier" VALUE 0x80270174 Val_Wu32 4294967295.00 OneToOne 0.00 4294967295.00 FORMAT "%13.2" /end CHARACTERISTIC
/begin CHARACTERISTIC MoFFrm_DataApplSigRx_MoFFrm_stDrvrSeatBlt.offsFac_C "Application value for MoFFrm_stDrvrSeatBlt signal / Signal offset" VALUE 0x80270178 Val_Ws32 4294967295.00 OneToOne -2147483648.00 2147483647.00 FORMAT "%13.2" /end CHARACTERISTIC
/begin CHARACTERISTIC MoFFrm_DataApplSigRx_MoFFrm_stESMFailr.divFac_C "Application value for MoFFrm_stESMFailr signal / Signal divisor." VALUE 0x8027017C Val_Wu32 4294967295.00 OneToOne 0.00 4294967295.00 FORMAT "%13.2" /end CHARACTERISTIC
/begin CHARACTERISTIC MoFFrm_DataApplSigRx_MoFFrm_stESMFailr.mulFac_C "Application value for MoFFrm_stESMFailr signal / Signal multiplier" VALUE 0x80270180 Val_Wu32 4294967295.00 OneToOne 0.00 4294967295.00 FORMAT "%13.2" /end CHARACTERISTIC
/begin CHARACTERISTIC MoFFrm_DataApplSigRx_MoFFrm_stESMFailr.offsFac_C "Application value for MoFFrm_stESMFailr signal / Signal offset" VALUE 0x80270184 Val_Ws32 4294967295.00 OneToOne -2147483648.00 2147483647.00 FORMAT "%13.2" /end CHARACTERISTIC
/begin CHARACTERISTIC MoFFrm_DataApplSigRx_MoFFrm_stGearNum.divFac_C "Application value for MoFFrm_stGearNum / Signal divisor." VALUE 0x80270188 Val_Wu32 4294967295.00 OneToOne 0.00 4294967295.00 FORMAT "%13.2" /end CHARACTERISTIC
/begin CHARACTERISTIC MoFFrm_DataApplSigRx_MoFFrm_stGearNum.mulFac_C "Application value for MoFFrm_stGearNum / Signal multiplier" VALUE 0x8027018C Val_Wu32 4294967295.00 OneToOne 0.00 4294967295.00 FORMAT "%13.2" /end CHARACTERISTIC
/begin CHARACTERISTIC MoFFrm_DataApplSigRx_MoFFrm_stGearNum.offsFac_C "Application value for MoFFrm_stGearNum / Signal offset" VALUE 0x80270190 Val_Ws32 4294967295.00 OneToOne -2147483648.00 2147483647.00 FORMAT "%13.2" /end CHARACTERISTIC
/begin CHARACTERISTIC MoFFrm_DataApplSigRx_MoFFrm_stHvbCnctn.divFac_C "MoFFrm_stHvbCnctn / Signal divisor." VALUE 0x802701A0 Val_Wu32 4294967295.00 OneToOne 0.00 4294967295.00 FORMAT "%13.2" /end CHARACTERISTIC
/begin CHARACTERISTIC MoFFrm_DataApplSigRx_MoFFrm_stHvbCnctn.mulFac_C "MoFFrm_stHvbCnctn / Signal multiplier" VALUE 0x802701A4 Val_Wu32 4294967295.00 OneToOne 0.00 4294967295.00 FORMAT "%13.2" /end CHARACTERISTIC
/begin CHARACTERISTIC MoFFrm_DataApplSigRx_MoFFrm_stHvbCnctn.offsFac_C "MoFFrm_stHvbCnctn / Signal offset" VALUE 0x802701A8 Val_Ws32 4294967295.00 OneToOne -2147483648.00 2147483647.00 FORMAT "%13.2" /end CHARACTERISTIC
/begin CHARACTERISTIC MoFFrm_DataApplSigRx_MoFFrm_stHvbFltLvl.divFac_C "MoFFrm_stHvbFltLvl / Signal divisor." VALUE 0x802701AC Val_Wu32 4294967295.00 OneToOne 0.00 4294967295.00 FORMAT "%13.2" /end CHARACTERISTIC
/begin CHARACTERISTIC MoFFrm_DataApplSigRx_MoFFrm_stHvbFltLvl.mulFac_C "MoFFrm_stHvbFltLvl / Signal multiplier" VALUE 0x802701B0 Val_Wu32 4294967295.00 OneToOne 0.00 4294967295.00 FORMAT "%13.2" /end CHARACTERISTIC
/begin CHARACTERISTIC MoFFrm_DataApplSigRx_MoFFrm_stHvbFltLvl.offsFac_C "MoFFrm_stHvbFltLvl / Signal offset" VALUE 0x802701B4 Val_Ws32 4294967295.00 OneToOne -2147483648.00 2147483647.00 FORMAT "%13.2" /end CHARACTERISTIC
/begin CHARACTERISTIC MoFFrm_DataApplSigRx_MoFFrm_stHvIntlck.divFac_C "Structure instance of signal MoFFrm_stHvIntlck / Signal divisor." VALUE 0x80270194 Val_Wu32 4294967295.00 OneToOne 0.00 4294967295.00 FORMAT "%13.2" /end CHARACTERISTIC
/begin CHARACTERISTIC MoFFrm_DataApplSigRx_MoFFrm_stHvIntlck.mulFac_C "Structure instance of signal MoFFrm_stHvIntlck / Signal multiplier" VALUE 0x80270198 Val_Wu32 4294967295.00 OneToOne 0.00 4294967295.00 FORMAT "%13.2" /end CHARACTERISTIC
/begin CHARACTERISTIC MoFFrm_DataApplSigRx_MoFFrm_stHvIntlck.offsFac_C "Structure instance of signal MoFFrm_stHvIntlck / Signal offset" VALUE 0x8027019C Val_Ws32 4294967295.00 OneToOne -2147483648.00 2147483647.00 FORMAT "%13.2" /end CHARACTERISTIC
/begin CHARACTERISTIC MoFFrm_DataApplSigRx_MoFFrm_stIIvtrFltLvl01.divFac_C "Structure instance of signal MoFFrm_stIIvtrFltLvl01;MoFFrm_Lib_ApplSig / Signal divisor." VALUE 0x802701B8 Val_Wu32 4294967295.00 OneToOne 0.00 4294967295.00 FORMAT "%13.2" /end CHARACTERISTIC
/begin CHARACTERISTIC MoFFrm_DataApplSigRx_MoFFrm_stIIvtrFltLvl01.mulFac_C "Structure instance of signal MoFFrm_stIIvtrFltLvl01;MoFFrm_Lib_ApplSig / Signal multiplier" VALUE 0x802701BC Val_Wu32 4294967295.00 OneToOne 0.00 4294967295.00 FORMAT "%13.2" /end CHARACTERISTIC
/begin CHARACTERISTIC MoFFrm_DataApplSigRx_MoFFrm_stIIvtrFltLvl01.offsFac_C "Structure instance of signal MoFFrm_stIIvtrFltLvl01;MoFFrm_Lib_ApplSig / Signal offset" VALUE 0x802701C0 Val_Ws32 4294967295.00 OneToOne -2147483648.00 2147483647.00 FORMAT "%13.2" /end CHARACTERISTIC
/begin CHARACTERISTIC MoFFrm_DataApplSigRx_MoFFrm_stIvtrOpMod01.divFac_C "Application value for / Signal divisor." VALUE 0x802701C4 Val_Wu32 4294967295.00 OneToOne 0.00 4294967295.00 FORMAT "%13.2" /end CHARACTERISTIC
/begin CHARACTERISTIC MoFFrm_DataApplSigRx_MoFFrm_stIvtrOpMod01.mulFac_C "Application value for / Signal multiplier" VALUE 0x802701C8 Val_Wu32 4294967295.00 OneToOne 0.00 4294967295.00 FORMAT "%13.2" /end CHARACTERISTIC
/begin CHARACTERISTIC MoFFrm_DataApplSigRx_MoFFrm_stIvtrOpMod01.offsFac_C "Application value for / Signal offset" VALUE 0x802701CC Val_Ws32 4294967295.00 OneToOne -2147483648.00 2147483647.00 FORMAT "%13.2" /end CHARACTERISTIC
/begin CHARACTERISTIC MoFFrm_DataApplSigRx_MoFFrm_stPrkgBrkSwt.divFac_C "Application value for MoFFrm_stPrkgBrkSwt signal / Signal divisor." VALUE 0x802701D0 Val_Wu32 4294967295.00 OneToOne 0.00 4294967295.00 FORMAT "%13.2" /end CHARACTERISTIC
/begin CHARACTERISTIC MoFFrm_DataApplSigRx_MoFFrm_stPrkgBrkSwt.mulFac_C "Application value for MoFFrm_stPrkgBrkSwt signal / Signal multiplier" VALUE 0x802701D4 Val_Wu32 4294967295.00 OneToOne 0.00 4294967295.00 FORMAT "%13.2" /end CHARACTERISTIC
/begin CHARACTERISTIC MoFFrm_DataApplSigRx_MoFFrm_stPrkgBrkSwt.offsFac_C "Application value for MoFFrm_stPrkgBrkSwt signal / Signal offset" VALUE 0x802701D8 Val_Ws32 4294967295.00 OneToOne -2147483648.00 2147483647.00 FORMAT "%13.2" /end CHARACTERISTIC
/begin CHARACTERISTIC MoFFrm_DataApplSigRx_MoFFrm_tqAct01.divFac_C "Application value for MoFFrm_tqAct01 signal / Signal divisor." VALUE 0x802701DC Val_Wu32 4294967295.00 OneToOne 0.00 4294967295.00 FORMAT "%13.2" /end CHARACTERISTIC
/begin CHARACTERISTIC MoFFrm_DataApplSigRx_MoFFrm_tqAct01.mulFac_C "Application value for MoFFrm_tqAct01 signal / Signal multiplier" VALUE 0x802701E0 Val_Wu32 4294967295.00 OneToOne 0.00 4294967295.00 FORMAT "%13.2" /end CHARACTERISTIC
/begin CHARACTERISTIC MoFFrm_DataApplSigRx_MoFFrm_tqAct01.offsFac_C "Application value for MoFFrm_tqAct01 signal / Signal offset" VALUE 0x802701E4 Val_Ws32 4294967295.00 OneToOne -2147483648.00 2147483647.00 FORMAT "%13.2" /end CHARACTERISTIC
/begin CHARACTERISTIC MoFFrm_DataApplSigRx_MoFFrm_uDcChrgn.divFac_C "Application value for MoFFrm_uDcChrgn signal / Signal divisor." VALUE 0x802701E8 Val_Wu32 4294967295.00 OneToOne 0.00 4294967295.00 FORMAT "%13.2" /end CHARACTERISTIC
/begin CHARACTERISTIC MoFFrm_DataApplSigRx_MoFFrm_uDcChrgn.mulFac_C "Application value for MoFFrm_uDcChrgn signal / Signal multiplier" VALUE 0x802701EC Val_Wu32 4294967295.00 OneToOne 0.00 4294967295.00 FORMAT "%13.2" /end CHARACTERISTIC
/begin CHARACTERISTIC MoFFrm_DataApplSigRx_MoFFrm_uDcChrgn.offsFac_C "Application value for MoFFrm_uDcChrgn signal / Signal offset" VALUE 0x802701F0 Val_Ws32 4294967295.00 OneToOne -2147483648.00 2147483647.00 FORMAT "%13.2" /end CHARACTERISTIC
/begin CHARACTERISTIC MoFFrm_DataApplSigRx_MoFFrm_uDcdcHvAct.divFac_C " / Signal divisor." VALUE 0x80270200 Val_Wu32 4294967295.00 OneToOne 0.00 4294967295.00 FORMAT "%13.2" /end CHARACTERISTIC
/begin CHARACTERISTIC MoFFrm_DataApplSigRx_MoFFrm_uDcdcHvAct.mulFac_C " / Signal multiplier" VALUE 0x80270204 Val_Wu32 4294967295.00 OneToOne 0.00 4294967295.00 FORMAT "%13.2" /end CHARACTERISTIC
/begin CHARACTERISTIC MoFFrm_DataApplSigRx_MoFFrm_uDcdcHvAct.offsFac_C " / Signal offset" VALUE 0x80270208 Val_Ws32 4294967295.00 OneToOne -2147483648.00 2147483647.00 FORMAT "%13.2" /end CHARACTERISTIC
/begin CHARACTERISTIC MoFFrm_DataApplSigRx_MoFFrm_uDcLnk01.divFac_C " / Signal divisor." VALUE 0x802701F4 Val_Wu32 4294967295.00 OneToOne 0.00 4294967295.00 FORMAT "%13.2" /end CHARACTERISTIC
/begin CHARACTERISTIC MoFFrm_DataApplSigRx_MoFFrm_uDcLnk01.mulFac_C " / Signal multiplier" VALUE 0x802701F8 Val_Wu32 4294967295.00 OneToOne 0.00 4294967295.00 FORMAT "%13.2" /end CHARACTERISTIC
/begin CHARACTERISTIC MoFFrm_DataApplSigRx_MoFFrm_uDcLnk01.offsFac_C " / Signal offset" VALUE 0x802701FC Val_Ws32 4294967295.00 OneToOne -2147483648.00 2147483647.00 FORMAT "%13.2" /end CHARACTERISTIC
/begin CHARACTERISTIC MoFFrm_DataApplSigRx_MoFFrm_vVeh.divFac_C "Quantization factor (Mul,Div,offset) for signal VITESSE_VEHICULE_ROUES / Signal divisor." VALUE 0x8027020C Val_Wu32 4294967295.00 OneToOne 0.00 4294967295.00 FORMAT "%13.2" /end CHARACTERISTIC
/begin CHARACTERISTIC MoFFrm_DataApplSigRx_MoFFrm_vVeh.mulFac_C "Quantization factor (Mul,Div,offset) for signal VITESSE_VEHICULE_ROUES / Signal multiplier" VALUE 0x80270210 Val_Wu32 4294967295.00 OneToOne 0.00 4294967295.00 FORMAT "%13.2" /end CHARACTERISTIC
/begin CHARACTERISTIC MoFFrm_DataApplSigRx_MoFFrm_vVeh.offsFac_C "Quantization factor (Mul,Div,offset) for signal VITESSE_VEHICULE_ROUES / Signal offset" VALUE 0x80270214 Val_Ws32 4294967295.00 OneToOne -2147483648.00 2147483647.00 FORMAT "%13.2" /end CHARACTERISTIC
/begin CHARACTERISTIC MoFFrm_DataNetInfoSigRx_CONTACT_FREIN1.bytOrder_C "Network signal configuration for CONTACT_FREIN1 / Signal byte order" VALUE 0x80270218 Val_Wu8 1.000 OneToOne 0.00 1.000 FORMAT "%5.3" EXTENDED_LIMITS 0.00 255.0 /end CHARACTERISTIC
/begin CHARACTERISTIC MoFFrm_DataNetInfoSigRx_CONTACT_FREIN1.posnStrtBit_C "Network signal configuration for CONTACT_FREIN1 / signal start bit position" VALUE 0x8027021A Val_Wu16 65535.00 OneToOne 0.00 65535.00 FORMAT "%8.2" /end CHARACTERISTIC
/begin CHARACTERISTIC MoFFrm_DataNetInfoSigRx_CONTACT_FREIN1.sigLen_C "Network signal configuration for CONTACT_FREIN1 / signal length (bits)" VALUE 0x8027021C Val_Wu8 31.00 OneToOne 1.00 32.00 FORMAT "%5.2" EXTENDED_LIMITS 0.00 255.0 /end CHARACTERISTIC
/begin CHARACTERISTIC MoFFrm_DataNetInfoSigRx_CONTACT_FREIN_PRK.bytOrder_C "Data PDu Structure for CONTACT_FREIN_PRK / Signal byte order" VALUE 0x8027021E Val_Wu8 1.000 OneToOne 0.00 1.000 FORMAT "%5.3" EXTENDED_LIMITS 0.00 255.0 /end CHARACTERISTIC
/begin CHARACTERISTIC MoFFrm_DataNetInfoSigRx_CONTACT_FREIN_PRK.posnStrtBit_C "Data PDu Structure for CONTACT_FREIN_PRK / signal start bit position" VALUE 0x80270220 Val_Wu16 65535.00 OneToOne 0.00 65535.00 FORMAT "%8.2" /end CHARACTERISTIC
/begin CHARACTERISTIC MoFFrm_DataNetInfoSigRx_CONTACT_FREIN_PRK.sigLen_C "Data PDu Structure for CONTACT_FREIN_PRK / signal length (bits)" VALUE 0x80270222 Val_Wu8 31.00 OneToOne 1.00 32.00 FORMAT "%5.2" EXTENDED_LIMITS 0.00 255.0 /end CHARACTERISTIC
/begin CHARACTERISTIC MoFFrm_DataNetInfoSigRx_CRASH_AIRBAG.bytOrder_C "Data PDu Structure for CRASH_AIRBAG / Signal byte order" VALUE 0x80270224 Val_Wu8 1.000 OneToOne 0.00 1.000 FORMAT "%5.3" EXTENDED_LIMITS 0.00 255.0 /end CHARACTERISTIC
/begin CHARACTERISTIC MoFFrm_DataNetInfoSigRx_CRASH_AIRBAG.posnStrtBit_C "Data PDu Structure for CRASH_AIRBAG / signal start bit position" VALUE 0x80270226 Val_Wu16 65535.00 OneToOne 0.00 65535.00 FORMAT "%8.2" /end CHARACTERISTIC
/begin CHARACTERISTIC MoFFrm_DataNetInfoSigRx_CRASH_AIRBAG.sigLen_C "Data PDu Structure for CRASH_AIRBAG / signal length (bits)" VALUE 0x80270228 Val_Wu8 31.00 OneToOne 1.00 32.00 FORMAT "%5.2" EXTENDED_LIMITS 0.00 255.0 /end CHARACTERISTIC
/begin CHARACTERISTIC MoFFrm_DataNetInfoSigRx_CRASH_AIRBAG_COMPLI.bytOrder_C "CRASH_AIRBAG_COMPLI data / Signal byte order" VALUE 0x8027022A Val_Wu8 1.000 OneToOne 0.00 1.000 FORMAT "%5.3" EXTENDED_LIMITS 0.00 255.0 /end CHARACTERISTIC
/begin CHARACTERISTIC MoFFrm_DataNetInfoSigRx_CRASH_AIRBAG_COMPLI.posnStrtBit_C "CRASH_AIRBAG_COMPLI data / signal start bit position" VALUE 0x8027022C Val_Wu16 65535.00 OneToOne 0.00 65535.00 FORMAT "%8.2" /end CHARACTERISTIC
/begin CHARACTERISTIC MoFFrm_DataNetInfoSigRx_CRASH_AIRBAG_COMPLI.sigLen_C "CRASH_AIRBAG_COMPLI data / signal length (bits)" VALUE 0x8027022E Val_Wu8 31.00 OneToOne 1.00 32.00 FORMAT "%5.2" EXTENDED_LIMITS 0.00 255.0 /end CHARACTERISTIC
/begin CHARACTERISTIC MoFFrm_DataNetInfoSigRx_DCDC_FAULT_LEVEL.bytOrder_C "Data PDu Structure for DCDC_FAULT_LEVEL / Signal byte order" VALUE 0x80270230 Val_Wu8 1.000 OneToOne 0.00 1.000 FORMAT "%5.3" EXTENDED_LIMITS 0.00 255.0 /end CHARACTERISTIC
/begin CHARACTERISTIC MoFFrm_DataNetInfoSigRx_DCDC_FAULT_LEVEL.posnStrtBit_C "Data PDu Structure for DCDC_FAULT_LEVEL / signal start bit position" VALUE 0x80270232 Val_Wu16 65535.00 OneToOne 0.00 65535.00 FORMAT "%8.2" /end CHARACTERISTIC
/begin CHARACTERISTIC MoFFrm_Lib_CRC16H1021Tab_CA "Calibration array used for checksum calculation with H1021 as first element" VAL_BLK 0x8026D554 ValA_Wu16 65535.00 OneToOne 0.00 65535.00 FORMAT "%8.2" READ_ONLY MATRIX_DIM 256 /end CHARACTERISTIC
/begin CHARACTERISTIC MoFFrm_Lib_CRC82FHTab_CA "Calibration array used for checksum calculation with 2F as first element" VAL_BLK 0x8026CCE2 ValA_Wu8 255.0 OneToOne 0.00 255.0 FORMAT "%5.1" READ_ONLY MATRIX_DIM 256 /end CHARACTERISTIC
/begin CHARACTERISTIC MoFFrm_Lib_CRC8H1DTab_CA "Calibration array used for checksum calculation with 1D as first element" VAL_BLK 0x8026CDE2 ValA_Wu8 255.0 OneToOne 0.00 255.0 FORMAT "%5.1" READ_ONLY MATRIX_DIM 256 /end CHARACTERISTIC
/begin CHARACTERISTIC MoFFrm_Lib_DataApplSigInstance.divFac_C "Structure variable of data application signal / Signal divisor." VALUE 0x80270074 Val_Wu32 4294967295.00 OneToOne 0.00 4294967295.00 FORMAT "%13.2" /end CHARACTERISTIC
/begin CHARACTERISTIC MoFFrm_Lib_DataApplSigInstance.mulFac_C "Structure variable of data application signal / Signal multiplier" VALUE 0x80270078 Val_Wu32 4294967295.00 OneToOne 0.00 4294967295.00 FORMAT "%13.2" /end CHARACTERISTIC
/begin CHARACTERISTIC MoFFrm_Lib_DataApplSigInstance.offsFac_C "Structure variable of data application signal / Signal offset" VALUE 0x8027007C Val_Ws32 4294967295.00 OneToOne -2147483648.00 2147483647.00 FORMAT "%13.2" /end CHARACTERISTIC
/begin CHARACTERISTIC MoFFrm_Lib_DataNetInfoSigInstance.bytOrder_C "Structure variable of data network signal / Signal byte order" VALUE 0x80270080 Val_Wu8 1.000 OneToOne 0.00 1.000 FORMAT "%5.3" EXTENDED_LIMITS 0.00 255.0 /end CHARACTERISTIC
/begin CHARACTERISTIC MoFFrm_Lib_DataNetInfoSigInstance.posnStrtBit_C "Structure variable of data network signal / signal start bit position" VALUE 0x80270082 Val_Wu16 65535.00 OneToOne 0.00 65535.00 FORMAT "%8.2" /end CHARACTERISTIC
/begin CHARACTERISTIC MoFFrm_Lib_DataNetInfoSigInstance.sigLen_C "Structure variable of data network signal / signal length (bits)" VALUE 0x80270084 Val_Wu8 31.00 OneToOne 1.00 32.00 FORMAT "%5.2" EXTENDED_LIMITS 0.00 255.0 /end CHARACTERISTIC
/begin CHARACTERISTIC MoFFrm_Lib_DataPduRxInstance.bufLen_C "Structure variable for Rx PDU / parameter to indicate the buffer length of the receiving PDU" VALUE 0x80270090 Val_Wu8 255.0 OneToOne 0.00 255.0 FORMAT "%5.1" /end CHARACTERISTIC
/begin CHARACTERISTIC MoFFrm_Lib_DataPduRxInstance.bytOrderAlvCntr_C "Structure variable for Rx PDU / Alive counter calibration of RX Data Pdu" VALUE 0x80270091 Val_Wu8 1.000 OneToOne 0.00 1.000 FORMAT "%5.3" EXTENDED_LIMITS 0.00 255.0 /end CHARACTERISTIC
/begin CHARACTERISTIC MoFFrm_Lib_DataPduRxInstance.bytOrderCrc_C "Structure variable for Rx PDU / CRC calibration of RX Data Pdu" VALUE 0x80270092 Val_Wu8 1.000 OneToOne 0.00 1.000 FORMAT "%5.3" EXTENDED_LIMITS 0.00 255.0 /end CHARACTERISTIC
/begin CHARACTERISTIC MoFFrm_Lib_DataPduRxInstance.chksEndVal_C "Structure variable for Rx PDU / Calibration to indicate the XOR value in a checksum logic." VALUE 0x80270094 Val_Wu16 65535.00 OneToOne 0.00 65535.00 FORMAT "%8.2" /end CHARACTERISTIC
/begin CHARACTERISTIC MoFFrm_Lib_DataPduRxInstance.chksStrtVal_C "Structure variable for Rx PDU / Calibration to indicate the initial value in a checksum logic." VALUE 0x80270096 Val_Wu16 65535.00 OneToOne 0.00 65535.00 FORMAT "%8.2" /end CHARACTERISTIC
/begin CHARACTERISTIC MoFFrm_Lib_DataPduRxInstance.cntrAlvErrDeb_C "Structure variable for Rx PDU / Alive counter debounce error calibration of RX Data Pdu" VALUE 0x80270098 Val_Wu16 65535.00 OneToOne 0.00 65535.00 FORMAT "%8.2" /end CHARACTERISTIC
/begin CHARACTERISTIC MoFFrm_Lib_DataPduRxInstance.cntrCrcErrDeb_C "Structure variable for Rx PDU / Alive counter debounce error calibration of RX Data Pdu" VALUE 0x8027009A Val_Wu16 65535.00 OneToOne 0.00 65535.00 FORMAT "%8.2" /end CHARACTERISTIC
/begin CHARACTERISTIC MoFFrm_Lib_DataPduRxInstance.cntrMaxAlvDif_C "Structure variable for Rx PDU / Complement of Counter cyclic calibration of RX Data Pdu" VALUE 0x8027009C Val_Wu8 255.0 OneToOne 0.00 255.0 FORMAT "%5.1" /end CHARACTERISTIC
/begin CHARACTERISTIC MoFFrm_Lib_DataPduRxInstance.cntrTiOutDeb_C "Structure variable for Rx PDU / Counter time out debounce calibration of Rx data PDU" VALUE 0x8027009E Val_Wu16 65535.00 OneToOne 0.00 65535.00 FORMAT "%8.2" /end CHARACTERISTIC
/begin CHARACTERISTIC MoFFrm_Lib_DataPduRxInstance.crcId_C "Structure variable for Rx PDU / CRC ID of Rx data PDU" VALUE 0x802700A0 Val_Wu32 4294967295.00 OneToOne 0.00 4294967295.00 FORMAT "%13.2" /end CHARACTERISTIC
/begin CHARACTERISTIC MoFFrm_Lib_DataPduRxInstance.cycTi_C "Structure variable for Rx PDU / cycle time from bus matrix" VALUE 0x802700A4 Val_Wu16 65535.00 OneToOne 0.00 65535.00 FORMAT "%8.2" /end CHARACTERISTIC
/begin CHARACTERISTIC MoFFrm_Lib_DataPduRxInstance.diChks_C "Structure variable for Rx PDU / parameter to enable or disable manipulation of various checks" VALUE 0x802700A6 Val_Wu8 255.0 OneToOne 0.00 255.0 FORMAT "%5.1" /end CHARACTERISTIC
/begin CHARACTERISTIC MoFFrm_Lib_DataPduRxInstance.evalType_C "Structure variable for Rx PDU / evaluation type" VALUE 0x802700A7 Val_Wu8 255.0 OneToOne 0.00 255.0 FORMAT "%5.1" /end CHARACTERISTIC
/begin CHARACTERISTIC MoFFrm_Lib_DataPduRxInstance.maskAlvCntr_C "Structure variable for Rx PDU / Alive counter start bit position of Rx data PDU" VALUE 0x802700A8 Val_Wu8 255.0 OneToOne 0.00 255.0 FORMAT "%5.1" /end CHARACTERISTIC
/begin CHARACTERISTIC MoFFrm_Lib_DataPduRxInstance.posnAlvCntrStrtBit_C "Structure variable for Rx PDU / Alive counter start bit calibration of of Data PDU Rx" VALUE 0x802700AA Val_Wu16 65535.00 OneToOne 0.00 65535.00 FORMAT "%8.2" /end CHARACTERISTIC
/begin CHARACTERISTIC MoFFrm_Lib_DataPduRxInstance.posnCrcCalcEndByte_C "Structure variable for Rx PDU / End byte of CRC calculation position of Data PDU Rx" VALUE 0x802700AC Val_Wu8 255.0 OneToOne 0.00 255.0 FORMAT "%5.1" /end CHARACTERISTIC
/begin CHARACTERISTIC MoFFrm_Lib_DataPduRxInstance.posnCrcCalcStrtByte_C "Structure variable for Rx PDU / Start byte of CRC calculation position of Data PDU Rx" VALUE 0x802700AD Val_Wu8 255.0 OneToOne 0.00 255.0 FORMAT "%5.1" /end CHARACTERISTIC
/begin CHARACTERISTIC MoFFrm_Lib_DataPduRxInstance.posnCrcStrtBit_C "Structure variable for Rx PDU / CRC start bit position of Rx data PDU" VALUE 0x802700AE Val_Wu16 65535.00 OneToOne 0.00 65535.00 FORMAT "%8.2" /end CHARACTERISTIC
/begin CHARACTERISTIC MoFFrm_Lib_DataPduRxInstance.sigLenAlvCntr_C "Structure variable for Rx PDU / Alive counter signal length of Rx data PDU" VALUE 0x802700B0 Val_Wu8 31.00 OneToOne 1.00 32.00 FORMAT "%5.2" EXTENDED_LIMITS 0.00 255.0 /end CHARACTERISTIC
/begin CHARACTERISTIC MoFFrm_Lib_DataPduRxInstance.sigLenCrc_C "Structure variable for Rx PDU / CRC calibration signal length of Rx data PDU" VALUE 0x802700B1 Val_Wu8 31.00 OneToOne 1.00 32.00 FORMAT "%5.2" EXTENDED_LIMITS 0.00 255.0 /end CHARACTERISTIC
/begin CHARACTERISTIC MoFFrm_Lib_DataPduTxInstance.bufLen_C "Structure variable for Tx PDU / Buffer length of the transmission PDU" VALUE 0x802700BC Val_Wu8 255.0 OneToOne 0.00 255.0 FORMAT "%5.1" /end CHARACTERISTIC
/begin CHARACTERISTIC MoFFrm_Lib_DataPduTxInstance.bytOrderAlvCntr_C "Structure variable for Tx PDU / Alive counter byte order" VALUE 0x802700BD Val_Wu8 1.000 OneToOne 0.00 1.000 FORMAT "%5.3" EXTENDED_LIMITS 0.00 255.0 /end CHARACTERISTIC
/begin CHARACTERISTIC MoFFrm_Lib_DataPduTxInstance.bytOrderCrc_C "Structure variable for Tx PDU / CRC byte order" VALUE 0x802700BE Val_Wu8 1.000 OneToOne 0.00 1.000 FORMAT "%5.3" EXTENDED_LIMITS 0.00 255.0 /end CHARACTERISTIC
/begin CHARACTERISTIC MoFFrm_Lib_DataPduTxInstance.chksEndVal_C "Structure variable for Tx PDU / Calibration to indicate the XOR value in a checksum logic." VALUE 0x802700C0 Val_Wu16 65535.00 OneToOne 0.00 65535.00 FORMAT "%8.2" /end CHARACTERISTIC
/begin CHARACTERISTIC MoFFrm_Lib_DataPduTxInstance.chksStrtVal_C "Structure variable for Tx PDU / Calibration to indicate the initial value in a checksum logic." VALUE 0x802700C2 Val_Wu16 65535.00 OneToOne 0.00 65535.00 FORMAT "%8.2" /end CHARACTERISTIC
/begin CHARACTERISTIC MoFFrm_Lib_DataPduTxInstance.crcId_C "Structure variable for Tx PDU / CRC iD calibration of Tx data PDU" VALUE 0x802700C4 Val_Wu32 4294967295.00 OneToOne 0.00 4294967295.00 FORMAT "%13.2" /end CHARACTERISTIC
/begin CHARACTERISTIC MoFFrm_Lib_DataPduTxInstance.evalType_C "Structure variable for Tx PDU / evaluation type of the Tx message" VALUE 0x802700C8 Val_Wu8 255.0 OneToOne 0.00 255.0 FORMAT "%5.1" /end CHARACTERISTIC
/begin CHARACTERISTIC MoFFrm_Lib_DataPduTxInstance.posnAlvCntrStrtBit_C "Structure variable for Tx PDU / alive counter start bit position" VALUE 0x802700CA Val_Wu16 65535.00 OneToOne 0.00 65535.00 FORMAT "%8.2" /end CHARACTERISTIC
/begin CHARACTERISTIC MoFFrm_Lib_DataPduTxInstance.posnCrcCalcEndByte_C "Structure variable for Tx PDU / Start byte of CRC calculation position of Data PDU Tx" VALUE 0x802700CC Val_Wu8 255.0 OneToOne 0.00 255.0 FORMAT "%5.1" /end CHARACTERISTIC
/begin CHARACTERISTIC MoFFrm_Lib_DataPduTxInstance.posnCrcCalcStrtByte_C "Structure variable for Tx PDU / Start byte of CRC calculation position of Data PDU Tx" VALUE 0x802700CD Val_Wu8 255.0 OneToOne 0.00 255.0 FORMAT "%5.1" /end CHARACTERISTIC
/begin CHARACTERISTIC MoFFrm_Lib_DataPduTxInstance.posnCrcStrtBit_C "Structure variable for Tx PDU / CRC start bit position" VALUE 0x802700CE Val_Wu16 65535.00 OneToOne 0.00 65535.00 FORMAT "%8.2" /end CHARACTERISTIC
/begin CHARACTERISTIC MoFFrm_Lib_DataPduTxInstance.sigLenAlvCntr_C "Structure variable for Tx PDU / alive counter signal length" VALUE 0x802700D0 Val_Wu8 31.00 OneToOne 1.00 32.00 FORMAT "%5.2" EXTENDED_LIMITS 0.00 255.0 /end CHARACTERISTIC
/begin CHARACTERISTIC MoFFrm_Lib_DataPduTxInstance.sigLenCrc_C "Structure variable for Tx PDU / CRC signal length" VALUE 0x802700D1 Val_Wu8 31.00 OneToOne 1.00 32.00 FORMAT "%5.2" EXTENDED_LIMITS 0.00 255.0 /end CHARACTERISTIC
/begin CHARACTERISTIC MoFxtCpt_stSwtCfgBrkstPFlt_C "Calibration for varible MoFExtCpt_stBrkBstPFlt" VALUE 0x8026CCDF Val_Wu8 255.0 OneToOne 0.00 255.0 FORMAT "%5.1" /end CHARACTERISTIC
/begin CHARACTERISTIC MoFxtCpt_stSwtCfgMstWrnLmp_C "Calibration for variable MoFExtCpt_stMstWrnLmp" VALUE 0x8026CCE0 Val_Wu8 255.0 OneToOne 0.00 255.0 FORMAT "%5.1" /end CHARACTERISTIC
/begin MEASUREMENT DFC_st.DFC_MoFExtCptVacPmpErr "" UBYTE DFC_OneToOne 1 100 0.00 255.0 FORMAT "%5.1" ECU_ADDRESS 0x60034D51 /end MEASUREMENT
/begin MEASUREMENT DINH_nrActvInhReas.FId_VacPmpErr "" UWORD DINH_ct_Compu 1 100 -4095.000 4096.000 BIT_MASK 0x1fff FORMAT "%8.3" ECU_ADDRESS 0x60021592 /end MEASUREMENT
/begin MEASUREMENT DINH_stFId.FId_VacPmpErr "" UWORD DFC_OneToOne 1 100 0.00 65535.00 FORMAT "%8.2" ECU_ADDRESS 0x60021592 /end MEASUREMENT
/begin MEASUREMENT MoFExtCptVacPmp_bbLoc1Cpl "Complement for MoFExtCptVacPmp_bbLoc1" UBYTE OneToOne 1 100 0.00 255.0 FORMAT "%5.1" ECU_ADDRESS 0x6002BE96
 /begin IF_DATA XCPplus 0x0102
  /begin DAQ_EVENT VARIABLE /end DAQ_EVENT
 /end IF_DATA
/end MEASUREMENT
/begin MEASUREMENT MoFExtCptVacPmp_bbLoc2Cpl "Complement for MoFExtCptVacPmp_bbLoc2" UBYTE OneToOne 1 100 0.00 255.0 FORMAT "%5.1" ECU_ADDRESS 0x6002BE95
 /begin IF_DATA XCPplus 0x0102
  /begin DAQ_EVENT VARIABLE /end DAQ_EVENT
 /end IF_DATA
/end MEASUREMENT
/begin MEASUREMENT MoFExtCptVacPmp_bbLoc3Cpl "Complement for MoFExtCptVacPmp_bbLoc3" UBYTE OneToOne 1 100 0.00 255.0 FORMAT "%5.1" ECU_ADDRESS 0x6002BE94
 /begin IF_DATA XCPplus 0x0102
  /begin DAQ_EVENT VARIABLE /end DAQ_EVENT
 /end IF_DATA
/end MEASUREMENT
/begin MEASUREMENT MoFExtCptVacPmp_bbLocCpl "Complement for MoFExtCptVacPmp_bbLoc" UBYTE OneToOne 1 100 0.00 255.0 FORMAT "%5.1" ECU_ADDRESS 0x6002BE93
 /begin IF_DATA XCPplus 0x0102
  /begin DAQ_EVENT VARIABLE /end DAQ_EVENT
 /end IF_DATA
/end MEASUREMENT
/begin MEASUREMENT MoFExtCptVacPmp_bbOutCpl "Compliment" UBYTE OneToOne 1 100 0.00 255.0 FORMAT "%5.1" ECU_ADDRESS 0x6002BE92
 /begin IF_DATA XCPplus 0x0102
  /begin DAQ_EVENT VARIABLE /end DAQ_EVENT
 /end IF_DATA
/end MEASUREMENT
/begin MEASUREMENT MoFExtCpt_bNormPmpReq "Variable which stores the pump request" UBYTE B_TRUE 1 100 0.00 1.00000000000 BIT_MASK 0x4 FORMAT "%13.11" ECU_ADDRESS 0x6002C8E0
 /begin IF_DATA XCPplus 0x0102
  /begin DAQ_EVENT VARIABLE /end DAQ_EVENT
 /end IF_DATA
/end MEASUREMENT
/begin MEASUREMENT MoFExtCpt_bPmpActvnCondEn "store the output of powertrain staus" UBYTE B_TRUE 1 100 0.00 1.00000000000 BIT_MASK 0x8 FORMAT "%13.11" ECU_ADDRESS 0x6002C8E0
 /begin IF_DATA XCPplus 0x0102
  /begin DAQ_EVENT VARIABLE /end DAQ_EVENT
 /end IF_DATA
/end MEASUREMENT
/begin MEASUREMENT MoFExtCpt_cntrDebPVacp "Debounce counter for the pump request" UWORD OneToOne 1 100 0.00 65535.00 FORMAT "%8.2" ECU_ADDRESS 0x6002C8C6
 /begin IF_DATA XCPplus 0x0102
  /begin DAQ_EVENT VARIABLE /end DAQ_EVENT
 /end IF_DATA
/end MEASUREMENT
/begin MEASUREMENT MoFExtCpt_cntrDebPVacpCpl "Complimnet of varible MoFExtCpt_cntrDebPVacp" UWORD OneToOne 1 100 0.00 65535.00 FORMAT "%8.2" ECU_ADDRESS 0x6002BE74
 /begin IF_DATA XCPplus 0x0102
  /begin DAQ_EVENT VARIABLE /end DAQ_EVENT
 /end IF_DATA
/end MEASUREMENT
/begin MEASUREMENT MoFExtCpt_cntrDebVacPmpActvnErr "Debounce counter pump activation" UBYTE OneToOne 1 100 0.00 255.0 FORMAT "%5.1" ECU_ADDRESS 0x6002C8DE
 /begin IF_DATA XCPplus 0x0102
  /begin DAQ_EVENT VARIABLE /end DAQ_EVENT
 /end IF_DATA
/end MEASUREMENT
/begin MEASUREMENT MoFExtCpt_cntrDebVacPmpActvnErrCpl "Complement for MoFExtCpt_cntrDebVacPmpActvnErr" UBYTE OneToOne 1 100 0.00 255.0 FORMAT "%5.1" ECU_ADDRESS 0x6002BE91
 /begin IF_DATA XCPplus 0x0102
  /begin DAQ_EVENT VARIABLE /end DAQ_EVENT
 /end IF_DATA
/end MEASUREMENT
/begin MEASUREMENT MoFExtCpt_cntrDlyVacPmpTest "Turn on delay counter for Pump function test" UBYTE OneToOne 1 100 0.00 255.0 FORMAT "%5.1" ECU_ADDRESS 0x6002C8DD
 /begin IF_DATA XCPplus 0x0102
  /begin DAQ_EVENT VARIABLE /end DAQ_EVENT
 /end IF_DATA
/end MEASUREMENT
/begin MEASUREMENT MoFExtCpt_cntrDlyVacPmpTestCpl "Complement of MoFExtCpt_cntrDlyVacPmpTest" UBYTE OneToOne 1 100 0.00 255.0 FORMAT "%5.1" ECU_ADDRESS 0x6002BE90
 /begin IF_DATA XCPplus 0x0102
  /begin DAQ_EVENT VARIABLE /end DAQ_EVENT
 /end IF_DATA
/end MEASUREMENT
/begin MEASUREMENT MoFExtCpt_cntrDlyVacPSnsrTest "Turn on delay counter for sensor stuck fault" UBYTE OneToOne 1 100 0.00 255.0 FORMAT "%5.1" ECU_ADDRESS 0x6002C8DC
 /begin IF_DATA XCPplus 0x0102
  /begin DAQ_EVENT VARIABLE /end DAQ_EVENT
 /end IF_DATA
/end MEASUREMENT
/begin MEASUREMENT MoFExtCpt_cntrDlyVacPSnsrTestCpl "Complement of MoFExtCpt_cntrDlyVacPSnsrTest" UBYTE OneToOne 1 100 0.00 255.0 FORMAT "%5.1" ECU_ADDRESS 0x6002BE8F
 /begin IF_DATA XCPplus 0x0102
  /begin DAQ_EVENT VARIABLE /end DAQ_EVENT
 /end IF_DATA
/end MEASUREMENT
/begin MEASUREMENT MoFExtCpt_cntrVacPmpDebDfcSet "Debounce counter set Diagnostics" UBYTE OneToOne 1 100 0.00 255.0 FORMAT "%5.1" ECU_ADDRESS 0x6002C8DB
 /begin IF_DATA XCPplus 0x0102
  /begin DAQ_EVENT VARIABLE /end DAQ_EVENT
 /end IF_DATA
/end MEASUREMENT
/begin MEASUREMENT MoFExtCpt_cntrVacPmpDebDfcSetCpl "Complement MoFExtCpt_cntrVacPmpDebDfcSet" UBYTE OneToOne 1 100 0.00 255.0 FORMAT "%5.1" ECU_ADDRESS 0x6002BE8E
 /begin IF_DATA XCPplus 0x0102
  /begin DAQ_EVENT VARIABLE /end DAQ_EVENT
 /end IF_DATA
/end MEASUREMENT
/begin MEASUREMENT MoFExtCpt_cntrVacPmpDebEfcErr "Debounce Counter Pump Effectiveness error" UBYTE OneToOne 1 100 0.00 255.0 FORMAT "%5.1" ECU_ADDRESS 0x6002C8DA
 /begin IF_DATA XCPplus 0x0102
  /begin DAQ_EVENT VARIABLE /end DAQ_EVENT
 /end IF_DATA
/end MEASUREMENT
/begin MEASUREMENT MoFExtCpt_cntrVacPmpDebEfcErrCpl "Complement MoFExtCpt_cntrVacPmpDebEfcErr" UBYTE OneToOne 1 100 0.00 255.0 FORMAT "%5.1" ECU_ADDRESS 0x6002BE8D
 /begin IF_DATA XCPplus 0x0102
  /begin DAQ_EVENT VARIABLE /end DAQ_EVENT
 /end IF_DATA
/end MEASUREMENT
/begin MEASUREMENT MoFExtCpt_cntrVacPmpDebHiPErr "Debounce counter High Pressure" UBYTE OneToOne 1 100 0.00 255.0 FORMAT "%5.1" ECU_ADDRESS 0x6002C8D9
 /begin IF_DATA XCPplus 0x0102
  /begin DAQ_EVENT VARIABLE /end DAQ_EVENT
 /end IF_DATA
/end MEASUREMENT
/begin MEASUREMENT MoFExtCpt_cntrVacPmpDebHiPErrCpl "Complement MoFExtCpt_cntrVacPmpDebHiPErr" UBYTE OneToOne 1 100 0.00 255.0 FORMAT "%5.1" ECU_ADDRESS 0x6002BE8C
 /begin IF_DATA XCPplus 0x0102
  /begin DAQ_EVENT VARIABLE /end DAQ_EVENT
 /end IF_DATA
/end MEASUREMENT
/begin MEASUREMENT MoFExtCpt_cntrVacPmpDebSRC1Err "Debounce counter of SRC 1" UBYTE OneToOne 1 100 0.00 255.0 FORMAT "%5.1" ECU_ADDRESS 0x6002C8D8
 /begin IF_DATA XCPplus 0x0102
  /begin DAQ_EVENT VARIABLE /end DAQ_EVENT
 /end IF_DATA
/end MEASUREMENT
/begin MEASUREMENT MoFExtCpt_cntrVacPmpDebSRC1ErrCpl "Compliment of variable MoFExtCpt_cntrVacPmpDebSRC1Err" UBYTE OneToOne 1 100 0.00 255.0 FORMAT "%5.1" ECU_ADDRESS 0x6002BE8B
 /begin IF_DATA XCPplus 0x0102
  /begin DAQ_EVENT VARIABLE /end DAQ_EVENT
 /end IF_DATA
/end MEASUREMENT
/begin MEASUREMENT MoFExtCpt_cntrVacPmpDebSRC2Err "Debounce counter of SRC 2" UBYTE OneToOne 1 100 0.00 255.0 FORMAT "%5.1" ECU_ADDRESS 0x6002C8D7
 /begin IF_DATA XCPplus 0x0102
  /begin DAQ_EVENT VARIABLE /end DAQ_EVENT
 /end IF_DATA
/end MEASUREMENT
/begin MEASUREMENT MoFExtCpt_cntrVacPmpDebSRC2ErrCpl "Compliment of variable MoFExtCpt_cntrVacPmpDebSRC2Err" UBYTE OneToOne 1 100 0.00 255.0 FORMAT "%5.1" ECU_ADDRESS 0x6002BE8A
 /begin IF_DATA XCPplus 0x0102
  /begin DAQ_EVENT VARIABLE /end DAQ_EVENT
 /end IF_DATA
/end MEASUREMENT
/begin MEASUREMENT MoFExtCpt_cntrVacPmpDfcRst "DFC counter for ExtCpt" UBYTE OneToOne 1 100 0.00 255.0 FORMAT "%5.1" ECU_ADDRESS 0x60023121
 /begin IF_DATA XCPplus 0x0102
  /begin DAQ_EVENT VARIABLE /end DAQ_EVENT
 /end IF_DATA
/end MEASUREMENT
/begin MEASUREMENT MoFExtCpt_cntrVacPmpEfcDebErrHiLo "Error counter for healing the error" UBYTE OneToOne 1 100 0.00 255.0 FORMAT "%5.1" ECU_ADDRESS 0x6002C8D6
 /begin IF_DATA XCPplus 0x0102
  /begin DAQ_EVENT VARIABLE /end DAQ_EVENT
 /end IF_DATA
/end MEASUREMENT
/begin MEASUREMENT MoFExtCpt_cntrVacPmpEfcDebErrHiLoCpl "Complement for error counter for healing the error" UBYTE OneToOne 1 100 0.00 255.0 FORMAT "%5.1" ECU_ADDRESS 0x6002BE89
 /begin IF_DATA XCPplus 0x0102
  /begin DAQ_EVENT VARIABLE /end DAQ_EVENT
 /end IF_DATA
/end MEASUREMENT
/begin MEASUREMENT MoFExtCpt_cntrVacPmpEfcDebErrLoHi "Error counter for setting the error" UBYTE OneToOne 1 100 0.00 255.0 FORMAT "%5.1" ECU_ADDRESS 0x6002C8D5
 /begin IF_DATA XCPplus 0x0102
  /begin DAQ_EVENT VARIABLE /end DAQ_EVENT
 /end IF_DATA
/end MEASUREMENT
/begin MEASUREMENT MoFExtCpt_cntrVacPmpEfcDebErrLoHiCpl "Complement for error counter for setting the error" UBYTE OneToOne 1 100 0.00 255.0 FORMAT "%5.1" ECU_ADDRESS 0x6002BE88
 /begin IF_DATA XCPplus 0x0102
  /begin DAQ_EVENT VARIABLE /end DAQ_EVENT
 /end IF_DATA
/end MEASUREMENT
/begin MEASUREMENT MoFExtCpt_cntrVacPmpPlauTest "Counter variable for vaccum pump plausability" UBYTE OneToOne 1 100 0.00 255.0 FORMAT "%5.1" ECU_ADDRESS 0x6002C8D4
 /begin IF_DATA XCPplus 0x0102
  /begin DAQ_EVENT VARIABLE /end DAQ_EVENT
 /end IF_DATA
/end MEASUREMENT
/begin MEASUREMENT MoFExtCpt_cntrVacPmpPlauTestCpl "Compliment of the variable MoFExtCpt_cntrVacPmpPlauTest" UBYTE OneToOne 1 100 0.00 255.0 FORMAT "%5.1" ECU_ADDRESS 0x6002BE87
 /begin IF_DATA XCPplus 0x0102
  /begin DAQ_EVENT VARIABLE /end DAQ_EVENT
 /end IF_DATA
/end MEASUREMENT
/begin MEASUREMENT MoFExtCpt_cntrVacPSensrDebErr "Debounce counter stuck sensor" UBYTE OneToOne 1 100 0.00 255.0 FORMAT "%5.1" ECU_ADDRESS 0x6002C8D3
 /begin IF_DATA XCPplus 0x0102
  /begin DAQ_EVENT VARIABLE /end DAQ_EVENT
 /end IF_DATA
/end MEASUREMENT
/begin MEASUREMENT MoFExtCpt_cntrVacPSensrDebErrCpl "Complement MoFExtCpt_cntrVacPSensrDebErr" UBYTE OneToOne 1 100 0.00 255.0 FORMAT "%5.1" ECU_ADDRESS 0x6002BE86
 /begin IF_DATA XCPplus 0x0102
  /begin DAQ_EVENT VARIABLE /end DAQ_EVENT
 /end IF_DATA
/end MEASUREMENT
/begin MEASUREMENT MoFExtCpt_flgBrkOld "Old Value Brake pressed" UBYTE B_TRUE 1 100 0.00 1.00000000000 BIT_MASK 0x40 FORMAT "%13.11" ECU_ADDRESS 0x6002C8E2
 /begin IF_DATA XCPplus 0x0102
  /begin DAQ_EVENT VARIABLE /end DAQ_EVENT
 /end IF_DATA
/end MEASUREMENT
/begin MEASUREMENT MoFExtCpt_flgEnvPSnsr "Flag is set if SPI pin reads is OK" UBYTE B_TRUE 1 100 0.00 1.00000000000 BIT_MASK 0x10 FORMAT "%13.11" ECU_ADDRESS 0x6002C8E0
 /begin IF_DATA XCPplus 0x0102
  /begin DAQ_EVENT VARIABLE /end DAQ_EVENT
 /end IF_DATA
/end MEASUREMENT
/begin MEASUREMENT MoFExtCpt_flgHiVacPErr "High Pressure Error" UBYTE B_TRUE 1 100 0.00 1.00000000000 BIT_MASK 0x2 FORMAT "%13.11" ECU_ADDRESS 0x6002C8E1
 /begin IF_DATA XCPplus 0x0102
  /begin DAQ_EVENT VARIABLE /end DAQ_EVENT
 /end IF_DATA
/end MEASUREMENT
/begin MEASUREMENT MoFExtCpt_flgHiVacPErrDeb "Debounced High Pressure Error" UBYTE B_TRUE 1 100 0.00 1.00000000000 BIT_MASK 0x2 FORMAT "%13.11" ECU_ADDRESS 0x6002C8CA
 /begin IF_DATA XCPplus 0x0102
  /begin DAQ_EVENT VARIABLE /end DAQ_EVENT
 /end IF_DATA
/end MEASUREMENT
/begin MEASUREMENT MoFExtCpt_flgHys "it store the output of hystersis block" UBYTE B_TRUE 1 100 0.00 1.00000000000 BIT_MASK 0x20 FORMAT "%13.11" ECU_ADDRESS 0x6002C8E0
 /begin IF_DATA XCPplus 0x0102
  /begin DAQ_EVENT VARIABLE /end DAQ_EVENT
 /end IF_DATA
/end MEASUREMENT
/begin MEASUREMENT MoFExtCpt_flgNoPmpReq "During Test Pump wasnt activated" UBYTE B_TRUE 1 100 0.00 1.00000000000 BIT_MASK 0x4 FORMAT "%13.11" ECU_ADDRESS 0x6002C8DF
 /begin IF_DATA XCPplus 0x0102
  /begin DAQ_EVENT VARIABLE /end DAQ_EVENT
 /end IF_DATA
/end MEASUREMENT
/begin MEASUREMENT MoFExtCpt_flgNotBrkDlyd "Delayed value of brake not pressed" UBYTE B_TRUE 1 100 0.00 1.00000000000 BIT_MASK 0x10 FORMAT "%13.11" ECU_ADDRESS 0x6002C8E2
 /begin IF_DATA XCPplus 0x0102
  /begin DAQ_EVENT VARIABLE /end DAQ_EVENT
 /end IF_DATA
/end MEASUREMENT
/begin MEASUREMENT MoFExtCpt_flgNotBrkDlydOld "Previous Value of MoFExtCpt_flgNotBrkDlyd" UBYTE B_TRUE 1 100 0.00 1.00000000000 BIT_MASK 0x20 FORMAT "%13.11" ECU_ADDRESS 0x6002C8E2
 /begin IF_DATA XCPplus 0x0102
  /begin DAQ_EVENT VARIABLE /end DAQ_EVENT
 /end IF_DATA
/end MEASUREMENT
/begin MEASUREMENT MoFExtCpt_flgPmpReq "flag for pump request" UBYTE B_TRUE 1 100 0.00 1.00000000000 BIT_MASK 0x40 FORMAT "%13.11" ECU_ADDRESS 0x6002C8DF
 /begin IF_DATA XCPplus 0x0102
  /begin DAQ_EVENT VARIABLE /end DAQ_EVENT
 /end IF_DATA
/end MEASUREMENT
/begin MEASUREMENT MoFExtCpt_flgPmpRly "Store the relay status" UBYTE B_TRUE 1 100 0.00 1.00000000000 BIT_MASK 0x20 FORMAT "%13.11" ECU_ADDRESS 0x6002C8DF
 /begin IF_DATA XCPplus 0x0102
  /begin DAQ_EVENT VARIABLE /end DAQ_EVENT
 /end IF_DATA
/end MEASUREMENT
/begin MEASUREMENT MoFExtCpt_flgVacPAdcErr1 "variable store the status of sensor value" UBYTE B_TRUE 1 100 0.00 1.00000000000 BIT_MASK 0x1 FORMAT "%13.11" ECU_ADDRESS 0x6002C8E1
 /begin IF_DATA XCPplus 0x0102
  /begin DAQ_EVENT VARIABLE /end DAQ_EVENT
 /end IF_DATA
/end MEASUREMENT
/begin MEASUREMENT MoFExtCpt_flgVacPAdcErr2 "variable store the status of sensor value" UBYTE B_TRUE 1 100 0.00 1.00000000000 BIT_MASK 0x80 FORMAT "%13.11" ECU_ADDRESS 0x6002C8DF
 /begin IF_DATA XCPplus 0x0102
  /begin DAQ_EVENT VARIABLE /end DAQ_EVENT
 /end IF_DATA
/end MEASUREMENT
/begin MEASUREMENT MoFExtCpt_flgVacPmpActvnErr "Pump Activation Error" UBYTE B_TRUE 1 100 0.00 1.00000000000 BIT_MASK 0x4 FORMAT "%13.11" ECU_ADDRESS 0x6002C8E1
 /begin IF_DATA XCPplus 0x0102
  /begin DAQ_EVENT VARIABLE /end DAQ_EVENT
 /end IF_DATA
/end MEASUREMENT
/begin MEASUREMENT MoFExtCpt_flgVacPmpActvnErrDeb "Debounced Pump Activation Error" UBYTE B_TRUE 1 100 0.00 1.00000000000 BIT_MASK 0x4 FORMAT "%13.11" ECU_ADDRESS 0x6002C8CA
 /begin IF_DATA XCPplus 0x0102
  /begin DAQ_EVENT VARIABLE /end DAQ_EVENT
 /end IF_DATA
/end MEASUREMENT
/begin MEASUREMENT MoFExtCpt_flgVacPmpClr "Clear Diagnosis" UBYTE B_TRUE 1 100 0.00 1.00000000000 BIT_MASK 0x1 FORMAT "%13.11" ECU_ADDRESS 0x6002C8E2
 /begin IF_DATA XCPplus 0x0102
  /begin DAQ_EVENT VARIABLE /end DAQ_EVENT
 /end IF_DATA
/end MEASUREMENT
/begin MEASUREMENT MoFExtCpt_flgVacPmpEfcErr "Pump Effectiveness Error" UBYTE B_TRUE 1 100 0.00 1.00000000000 BIT_MASK 0x8 FORMAT "%13.11" ECU_ADDRESS 0x6002C8E1
 /begin IF_DATA XCPplus 0x0102
  /begin DAQ_EVENT VARIABLE /end DAQ_EVENT
 /end IF_DATA
/end MEASUREMENT
/begin MEASUREMENT MoFExtCpt_flgVacPmpEfcErrDeb "Debounced Pump Effectiveness Error" UBYTE B_TRUE 1 100 0.00 1.00000000000 BIT_MASK 0x8 FORMAT "%13.11" ECU_ADDRESS 0x6002C8CA
 /begin IF_DATA XCPplus 0x0102
  /begin DAQ_EVENT VARIABLE /end DAQ_EVENT
 /end IF_DATA
/end MEASUREMENT
/begin MEASUREMENT MoFExtCpt_flgVacPmpErr "Pump System Error" UBYTE B_TRUE 1 100 0.00 1.00000000000 BIT_MASK 0x1 FORMAT "%13.11" ECU_ADDRESS 0x6002C8CA
 /begin IF_DATA XCPplus 0x0102
  /begin DAQ_EVENT VARIABLE /end DAQ_EVENT
 /end IF_DATA
/end MEASUREMENT
/begin MEASUREMENT MoFExtCpt_flgVacPmpIrrvErrMsg "Message set diagnostics" UBYTE B_TRUE 1 100 0.00 1.00000000000 BIT_MASK 0x1 FORMAT "%13.11" ECU_ADDRESS 0x7000023A
 /begin IF_DATA XCPplus 0x0102
  /begin DAQ_EVENT VARIABLE /end DAQ_EVENT
 /end IF_DATA
/end MEASUREMENT
/begin MEASUREMENT MoFExtCpt_flgVacPmpLvl1Err "Error found in Lvl 1" UBYTE B_TRUE 1 100 0.00 1.00000000000 BIT_MASK 0x2 FORMAT "%13.11" ECU_ADDRESS 0x6002C8DF
 /begin IF_DATA XCPplus 0x0102
  /begin DAQ_EVENT VARIABLE /end DAQ_EVENT
 /end IF_DATA
/end MEASUREMENT
/begin MEASUREMENT MoFExtCpt_flgVacPmpPlauErr "Variable store the plausibility error status" UBYTE B_TRUE 1 100 0.00 1.00000000000 BIT_MASK 0x10 FORMAT "%13.11" ECU_ADDRESS 0x6002C8CA
 /begin IF_DATA XCPplus 0x0102
  /begin DAQ_EVENT VARIABLE /end DAQ_EVENT
 /end IF_DATA
/end MEASUREMENT
/begin MEASUREMENT MoFExtCpt_flgVacPmpSrcErr "Signal Range Error" UBYTE B_TRUE 1 100 0.00 1.00000000000 BIT_MASK 0x20 FORMAT "%13.11" ECU_ADDRESS 0x6002C8CA
 /begin IF_DATA XCPplus 0x0102
  /begin DAQ_EVENT VARIABLE /end DAQ_EVENT
 /end IF_DATA
/end MEASUREMENT
/begin MEASUREMENT MoFExtCpt_flgVacPmpSrcErr1 "Variable store the vaccum pump sensor 1 error status" UBYTE B_TRUE 1 100 0.00 1.00000000000 BIT_MASK 0x1 FORMAT "%13.11" ECU_ADDRESS 0x6002C8E0
 /begin IF_DATA XCPplus 0x0102
  /begin DAQ_EVENT VARIABLE /end DAQ_EVENT
 /end IF_DATA
/end MEASUREMENT
/begin MEASUREMENT MoFExtCpt_flgVacPmpSrcErr2 "Variable store the vaccum pump sensor 2 error status" UBYTE B_TRUE 1 100 0.00 1.00000000000 BIT_MASK 0x2 FORMAT "%13.11" ECU_ADDRESS 0x6002C8E0
 /begin IF_DATA XCPplus 0x0102
  /begin DAQ_EVENT VARIABLE /end DAQ_EVENT
 /end IF_DATA
/end MEASUREMENT
/begin MEASUREMENT MoFExtCpt_flgVacPmpTestCfmStrtd "Vaccump Pump Function Confirmed test start flag" UBYTE B_TRUE 1 100 0.00 1.00000000000 BIT_MASK 0x4 FORMAT "%13.11" ECU_ADDRESS 0x6002C8E2
 /begin IF_DATA XCPplus 0x0102
  /begin DAQ_EVENT VARIABLE /end DAQ_EVENT
 /end IF_DATA
/end MEASUREMENT
/begin MEASUREMENT MoFExtCpt_flgVacPmpTestCfmStrtdOld "Vaccump Pump Function Confirmed test start previous flag value" UBYTE B_TRUE 1 100 0.00 1.00000000000 BIT_MASK 0x8 FORMAT "%13.11" ECU_ADDRESS 0x6002C8E2
 /begin IF_DATA XCPplus 0x0102
  /begin DAQ_EVENT VARIABLE /end DAQ_EVENT
 /end IF_DATA
/end MEASUREMENT
/begin MEASUREMENT MoFExtCpt_flgVacPmpTestFinshd "Test time is finished" UBYTE B_TRUE 1 100 0.00 1.00000000000 BIT_MASK 0x20 FORMAT "%13.11" ECU_ADDRESS 0x6002C8E1
 /begin IF_DATA XCPplus 0x0102
  /begin DAQ_EVENT VARIABLE /end DAQ_EVENT
 /end IF_DATA
/end MEASUREMENT
/begin MEASUREMENT MoFExtCpt_flgVacPmpTestStrt "Pump Test begun" UBYTE B_TRUE 1 100 0.00 1.00000000000 BIT_MASK 0x80 FORMAT "%13.11" ECU_ADDRESS 0x6002C8E1
 /begin IF_DATA XCPplus 0x0102
  /begin DAQ_EVENT VARIABLE /end DAQ_EVENT
 /end IF_DATA
/end MEASUREMENT
/begin MEASUREMENT MoFExtCpt_flgVacPmpTestStrtOld "Old Value for MoFExtCpt_flgPmpTestStrt" UBYTE B_TRUE 1 100 0.00 1.00000000000 BIT_MASK 0x2 FORMAT "%13.11" ECU_ADDRESS 0x6002C8E2
 /begin IF_DATA XCPplus 0x0102
  /begin DAQ_EVENT VARIABLE /end DAQ_EVENT
 /end IF_DATA
/end MEASUREMENT
/begin MEASUREMENT MoFExtCpt_flgVacPmpTstMsg "Reset Diagnostics" UBYTE B_TRUE 1 100 0.00 1.00000000000 BIT_MASK 0x1 FORMAT "%13.11" ECU_ADDRESS 0x70000239
 /begin IF_DATA XCPplus 0x0102
  /begin DAQ_EVENT VARIABLE /end DAQ_EVENT
 /end IF_DATA
/end MEASUREMENT
/begin MEASUREMENT MoFExtCpt_flgVacPSnsrStuckErr "Stuck sensor error" UBYTE B_TRUE 1 100 0.00 1.00000000000 BIT_MASK 0x80 FORMAT "%13.11" ECU_ADDRESS 0x6002C8E2
 /begin IF_DATA XCPplus 0x0102
  /begin DAQ_EVENT VARIABLE /end DAQ_EVENT
 /end IF_DATA
/end MEASUREMENT
/begin MEASUREMENT MoFExtCpt_flgVacPSnsrStuckErrDeb "Debounced Stuck sensor error" UBYTE B_TRUE 1 100 0.00 1.00000000000 BIT_MASK 0x40 FORMAT "%13.11" ECU_ADDRESS 0x6002C8CA
 /begin IF_DATA XCPplus 0x0102
  /begin DAQ_EVENT VARIABLE /end DAQ_EVENT
 /end IF_DATA
/end MEASUREMENT
/begin MEASUREMENT MoFExtCpt_flgVacPSnsrTestFinshd "Sensor test is finished" UBYTE B_TRUE 1 100 0.00 1.00000000000 BIT_MASK 0x1 FORMAT "%13.11" ECU_ADDRESS 0x6002C8DF
 /begin IF_DATA XCPplus 0x0102
  /begin DAQ_EVENT VARIABLE /end DAQ_EVENT
 /end IF_DATA
/end MEASUREMENT
/begin MEASUREMENT MoFExtCpt_pEnvPUpd "Updated pressure value after all the range check" UWORD p_q0p039 1 100 0.00 2559.961 FORMAT "%8.3" ECU_ADDRESS 0x6002C8C4
 /begin IF_DATA XCPplus 0x0102
  /begin DAQ_EVENT VARIABLE /end DAQ_EVENT
 /end IF_DATA
/end MEASUREMENT
/begin MEASUREMENT MoFExtCpt_pEnvPUpdCpl "Complement of MoFExtCpt_pEnvPUpd" UWORD OneToOne 1 100 0.00 65535.00 FORMAT "%8.2" ECU_ADDRESS 0x6002BE72
 /begin IF_DATA XCPplus 0x0102
  /begin DAQ_EVENT VARIABLE /end DAQ_EVENT
 /end IF_DATA
/end MEASUREMENT
/begin MEASUREMENT MoFExtCpt_PEnv_p "Environment pressure" UWORD p_q0p039 1 100 0.00 2559.961 FORMAT "%8.3" ECU_ADDRESS 0x6002C8C2
 /begin IF_DATA XCPplus 0x0102
  /begin DAQ_EVENT VARIABLE /end DAQ_EVENT
 /end IF_DATA
/end MEASUREMENT
/begin MEASUREMENT MoFExtCpt_PEnv_pCpl "Compliment variable of MoFExtCpt_PEnv_p" UWORD OneToOne 1 100 0.00 65535.00 FORMAT "%8.2" ECU_ADDRESS 0x6002BE70
 /begin IF_DATA XCPplus 0x0102
  /begin DAQ_EVENT VARIABLE /end DAQ_EVENT
 /end IF_DATA
/end MEASUREMENT
/begin MEASUREMENT MoFExtCpt_pRawEnvP "Raw Environment Pressure value" UWORD p_q0p039 1 100 0.00 2559.961 FORMAT "%8.3" ECU_ADDRESS 0x6002C8C0
 /begin IF_DATA XCPplus 0x0102
  /begin DAQ_EVENT VARIABLE /end DAQ_EVENT
 /end IF_DATA
/end MEASUREMENT
/begin MEASUREMENT MoFExtCpt_pRawEnvPCpl "Complement of MoFExtCpt_pRawEnvP" UWORD OneToOne 1 100 0.00 65535.00 FORMAT "%8.2" ECU_ADDRESS 0x6002BE6E
 /begin IF_DATA XCPplus 0x0102
  /begin DAQ_EVENT VARIABLE /end DAQ_EVENT
 /end IF_DATA
/end MEASUREMENT
/begin MEASUREMENT MoFExtCpt_pRel "Related pressure" SWORD RBPtCel_p_1p0_1 1 100 -32768.00 32767.00 FORMAT "%8.2" ECU_ADDRESS 0x6002C8BE
 /begin IF_DATA XCPplus 0x0102
  /begin DAQ_EVENT VARIABLE /end DAQ_EVENT
 /end IF_DATA
/end MEASUREMENT
/begin MEASUREMENT MoFExtCpt_pRelCpl "Compliment varible of MoFExtCpt_pRel" UWORD OneToOne 1 100 0.00 65535.00 FORMAT "%8.2" ECU_ADDRESS 0x6002BE6C
 /begin IF_DATA XCPplus 0x0102
  /begin DAQ_EVENT VARIABLE /end DAQ_EVENT
 /end IF_DATA
/end MEASUREMENT
/begin MEASUREMENT MoFExtCpt_pSampleVacPmp "Sampled Pressure at pump Test Start" SWORD RBPtCel_p_1p0_1 1 100 -32768.00 32767.00 FORMAT "%8.2" ECU_ADDRESS 0x6002C8BC
 /begin IF_DATA XCPplus 0x0102
  /begin DAQ_EVENT VARIABLE /end DAQ_EVENT
 /end IF_DATA
/end MEASUREMENT
/begin MEASUREMENT MoFExtCpt_pSampleVacPmpCpl "Complement MoFExtCpt_pSampleVacPmp" UWORD OneToOne 1 100 0.00 65535.00 FORMAT "%8.2" ECU_ADDRESS 0x6002BE6A
 /begin IF_DATA XCPplus 0x0102
  /begin DAQ_EVENT VARIABLE /end DAQ_EVENT
 /end IF_DATA
/end MEASUREMENT
/begin MEASUREMENT MoFExtCpt_pSampleVacPSensr "Sampled Pressure at sensor Test Start" SWORD RBPtCel_p_1p0_1 1 100 -32768.00 32767.00 FORMAT "%8.2" ECU_ADDRESS 0x6002C8BA
 /begin IF_DATA XCPplus 0x0102
  /begin DAQ_EVENT VARIABLE /end DAQ_EVENT
 /end IF_DATA
/end MEASUREMENT
/begin MEASUREMENT MoFExtCpt_pSampleVacPSensrCpl "Doppelablage MoFExtCpt_pSampleVacPSensr" UWORD OneToOne 1 100 0.00 65535.00 FORMAT "%8.2" ECU_ADDRESS 0x6002BE68
 /begin IF_DATA XCPplus 0x0102
  /begin DAQ_EVENT VARIABLE /end DAQ_EVENT
 /end IF_DATA
/end MEASUREMENT
/begin MEASUREMENT MoFExtCpt_pSpiSnsrCnvrVal "Converted SPI Sensor value" UWORD p_q0p039 1 100 0.00 2559.961 FORMAT "%8.3" ECU_ADDRESS 0x6002C8B8
 /begin IF_DATA XCPplus 0x0102
  /begin DAQ_EVENT VARIABLE /end DAQ_EVENT
 /end IF_DATA
/end MEASUREMENT
/begin MEASUREMENT MoFExtCpt_pSpiSnsrCnvrValCpl "Complement for MoFExtCpt_pSpiSnsrCnvrVal" UWORD OneToOne 1 100 0.00 65535.00 FORMAT "%8.2" ECU_ADDRESS 0x6002BE66
 /begin IF_DATA XCPplus 0x0102
  /begin DAQ_EVENT VARIABLE /end DAQ_EVENT
 /end IF_DATA
/end MEASUREMENT
/begin MEASUREMENT MoFExtCpt_pSpiSnsrVal "SPI sensor value" ULONG OneToOne 1 100 0.00 4294967295.00 FORMAT "%13.2" ECU_ADDRESS 0x6002BE78 /end MEASUREMENT
/begin MEASUREMENT MoFExtCpt_pThdPmpReqOff "Threshold pressure of Vaccum pump stop" SWORD RBPtCel_p_1p0_1 1 100 -32768.00 32767.00 FORMAT "%8.2" ECU_ADDRESS 0x6002C8B6
 /begin IF_DATA XCPplus 0x0102
  /begin DAQ_EVENT VARIABLE /end DAQ_EVENT
 /end IF_DATA
/end MEASUREMENT
/begin MEASUREMENT MoFExtCpt_pThdPmpReqOffCpl "Compliment variable of MoFExtCpt_pThdPmpReqOff" UWORD OneToOne 1 100 0.00 65535.00 FORMAT "%8.2" ECU_ADDRESS 0x6002BE64
 /begin IF_DATA XCPplus 0x0102
  /begin DAQ_EVENT VARIABLE /end DAQ_EVENT
 /end IF_DATA
/end MEASUREMENT
/begin MEASUREMENT MoFExtCpt_pThdPmpReqOn "Threshold pressure of Vaccum pump start" SWORD RBPtCel_p_1p0_1 1 100 -32768.00 32767.00 FORMAT "%8.2" ECU_ADDRESS 0x6002C8B4
 /begin IF_DATA XCPplus 0x0102
  /begin DAQ_EVENT VARIABLE /end DAQ_EVENT
 /end IF_DATA
/end MEASUREMENT
/begin MEASUREMENT MoFExtCpt_pThdPmpReqOnCpl "Compliment variable of MoFExtCpt_pThdPmpReqOn" UWORD OneToOne 1 100 0.00 65535.00 FORMAT "%8.2" ECU_ADDRESS 0x6002BE62
 /begin IF_DATA XCPplus 0x0102
  /begin DAQ_EVENT VARIABLE /end DAQ_EVENT
 /end IF_DATA
/end MEASUREMENT
/begin MEASUREMENT MoFExtCpt_ptrVacPmpFil "Pointer to Control Variable for the Filter" UWORD OneToOne 1 100 0.00 65535.00 FORMAT "%8.2" ECU_ADDRESS 0x6002C8B2
 /begin IF_DATA XCPplus 0x0102
  /begin DAQ_EVENT VARIABLE /end DAQ_EVENT
 /end IF_DATA
/end MEASUREMENT
/begin MEASUREMENT MoFExtCpt_ptrVacPmpFilCpl "Complement MoFExtCpt_ptrVacPmpFil" UWORD OneToOne 1 100 0.00 65535.00 FORMAT "%8.2" ECU_ADDRESS 0x6002BE60
 /begin IF_DATA XCPplus 0x0102
  /begin DAQ_EVENT VARIABLE /end DAQ_EVENT
 /end IF_DATA
/end MEASUREMENT
/begin MEASUREMENT MoFExtCpt_pVacPFild "Filtered Differential Pressure" SWORD RBPtCel_p_1p0_1 1 100 -32768.00 32767.00 FORMAT "%8.2" ECU_ADDRESS 0x6002C8B0
 /begin IF_DATA XCPplus 0x0102
  /begin DAQ_EVENT VARIABLE /end DAQ_EVENT
 /end IF_DATA
/end MEASUREMENT
/begin MEASUREMENT MoFExtCpt_pVacPFildAbslt "Filtered Absolute Pressure" SWORD RBPtCel_p_1p0_1 1 100 -32768.00 32767.00 FORMAT "%8.2" ECU_ADDRESS 0x6002C8AE
 /begin IF_DATA XCPplus 0x0102
  /begin DAQ_EVENT VARIABLE /end DAQ_EVENT
 /end IF_DATA
/end MEASUREMENT
/begin MEASUREMENT MoFExtCpt_pVacPFildAbsltCpl "Complement MoFExtCpt_pVacPFildAbslt" UWORD OneToOne 1 100 0.00 65535.00 FORMAT "%8.2" ECU_ADDRESS 0x6002BE5E
 /begin IF_DATA XCPplus 0x0102
  /begin DAQ_EVENT VARIABLE /end DAQ_EVENT
 /end IF_DATA
/end MEASUREMENT
/begin MEASUREMENT MoFExtCpt_pVacPFildCpl "Complement MoFExtCpt_pVacPFild" UWORD OneToOne 1 100 0.00 65535.00 FORMAT "%8.2" ECU_ADDRESS 0x6002BE5C
 /begin IF_DATA XCPplus 0x0102
  /begin DAQ_EVENT VARIABLE /end DAQ_EVENT
 /end IF_DATA
/end MEASUREMENT
/begin MEASUREMENT MoFExtCpt_pVacPUnfild "Differential Pressure before Filtering" SWORD RBPtCel_p_1p0_1 1 100 -32768.00 32767.00 FORMAT "%8.2" ECU_ADDRESS 0x6002C8AC
 /begin IF_DATA XCPplus 0x0102
  /begin DAQ_EVENT VARIABLE /end DAQ_EVENT
 /end IF_DATA
/end MEASUREMENT
/begin MEASUREMENT MoFExtCpt_pVacPUnfild1 "variable store the filtered value of pressure" SWORD RBPtCel_p_1p0_1 1 100 -32768.00 32767.00 FORMAT "%8.2" ECU_ADDRESS 0x6002C8AA
 /begin IF_DATA XCPplus 0x0102
  /begin DAQ_EVENT VARIABLE /end DAQ_EVENT
 /end IF_DATA
/end MEASUREMENT
/begin MEASUREMENT MoFExtCpt_pVacPUnfild1Cpl "compliment of MoFExtCpt_pVacPUnfild1" UWORD OneToOne 1 100 0.00 65535.00 FORMAT "%8.2" ECU_ADDRESS 0x6002BE5A
 /begin IF_DATA XCPplus 0x0102
  /begin DAQ_EVENT VARIABLE /end DAQ_EVENT
 /end IF_DATA
/end MEASUREMENT
/begin MEASUREMENT MoFExtCpt_pVacPUnfild2 "variable store the absolute filtered value of pressure" SWORD RBPtCel_p_1p0_1 1 100 -32768.00 32767.00 FORMAT "%8.2" ECU_ADDRESS 0x6002C8A8
 /begin IF_DATA XCPplus 0x0102
  /begin DAQ_EVENT VARIABLE /end DAQ_EVENT
 /end IF_DATA
/end MEASUREMENT
/begin MEASUREMENT MoFExtCpt_pVacPUnfild2Cpl "compliment of MoFExtCpt_pVacPUnfild2" UWORD OneToOne 1 100 0.00 65535.00 FORMAT "%8.2" ECU_ADDRESS 0x6002BE58
 /begin IF_DATA XCPplus 0x0102
  /begin DAQ_EVENT VARIABLE /end DAQ_EVENT
 /end IF_DATA
/end MEASUREMENT
/begin MEASUREMENT MoFExtCpt_pVacPUnfildAbslt "Absolute Pressure before Filtering" SWORD RBPtCel_p_1p0_1 1 100 -32768.00 32767.00 FORMAT "%8.2" ECU_ADDRESS 0x6002C8A6
 /begin IF_DATA XCPplus 0x0102
  /begin DAQ_EVENT VARIABLE /end DAQ_EVENT
 /end IF_DATA
/end MEASUREMENT
/begin MEASUREMENT MoFExtCpt_pVacPUnfildAbsltCpl "Complement MoFExtCpt_pVacPUnfildAbslt" UWORD OneToOne 1 100 0.00 65535.00 FORMAT "%8.2" ECU_ADDRESS 0x6002BE56
 /begin IF_DATA XCPplus 0x0102
  /begin DAQ_EVENT VARIABLE /end DAQ_EVENT
 /end IF_DATA
/end MEASUREMENT
/begin MEASUREMENT MoFExtCpt_pVacPUnfildAbsltDiff "Variable store the pressure value of filter1 and filtered 2" SWORD RBPtCel_p_1p0_1 1 100 -32768.00 32767.00 FORMAT "%8.2" ECU_ADDRESS 0x6002C8A4
 /begin IF_DATA XCPplus 0x0102
  /begin DAQ_EVENT VARIABLE /end DAQ_EVENT
 /end IF_DATA
/end MEASUREMENT
/begin MEASUREMENT MoFExtCpt_pVacPUnfildAbsltDiffCpl "Complimnet of MoFExtCpt_pVacPUnfildAbsltDiff" UWORD OneToOne 1 100 0.00 65535.00 FORMAT "%8.2" ECU_ADDRESS 0x6002BE54
 /begin IF_DATA XCPplus 0x0102
  /begin DAQ_EVENT VARIABLE /end DAQ_EVENT
 /end IF_DATA
/end MEASUREMENT
/begin MEASUREMENT MoFExtCpt_pVacPUnfildCpl "Complement MoFExtCpt_pVacPUnfild" UWORD OneToOne 1 100 0.00 65535.00 FORMAT "%8.2" ECU_ADDRESS 0x6002BE52
 /begin IF_DATA XCPplus 0x0102
  /begin DAQ_EVENT VARIABLE /end DAQ_EVENT
 /end IF_DATA
/end MEASUREMENT
/begin MEASUREMENT MoFExtCpt_pVacPUnfildSens1 "variable store the filtered value of pressure" SWORD RBPtCel_p_1p0_1 1 100 -32768.00 32767.00 FORMAT "%8.2" ECU_ADDRESS 0x6002C8A2
 /begin IF_DATA XCPplus 0x0102
  /begin DAQ_EVENT VARIABLE /end DAQ_EVENT
 /end IF_DATA
/end MEASUREMENT
/begin MEASUREMENT MoFExtCpt_pVacPUnfildSens1Cpl "compliment of MoFExtCpt_pVacPUnfildSens1" UWORD OneToOne 1 100 0.00 65535.00 FORMAT "%8.2" ECU_ADDRESS 0x6002BE50
 /begin IF_DATA XCPplus 0x0102
  /begin DAQ_EVENT VARIABLE /end DAQ_EVENT
 /end IF_DATA
/end MEASUREMENT
/begin MEASUREMENT MoFExtCpt_pVacPUnfildSens2 "variable store the filtered value of pressure" SWORD RBPtCel_p_1p0_1 1 100 -32768.00 32767.00 FORMAT "%8.2" ECU_ADDRESS 0x6002C8A0
 /begin IF_DATA XCPplus 0x0102
  /begin DAQ_EVENT VARIABLE /end DAQ_EVENT
 /end IF_DATA
/end MEASUREMENT
/begin MEASUREMENT MoFExtCpt_pVacPUnfildSens2Cpl "compliment of MoFExtCpt_pVacPUnfildSens2" UWORD OneToOne 1 100 0.00 65535.00 FORMAT "%8.2" ECU_ADDRESS 0x6002BE4E
 /begin IF_DATA XCPplus 0x0102
  /begin DAQ_EVENT VARIABLE /end DAQ_EVENT
 /end IF_DATA
/end MEASUREMENT
/begin MEASUREMENT MoFExtCpt_stBrkBstPFlt "Stores the error status of vacuum pump" UBYTE OneToOne 1 100 0.00 255.0 FORMAT "%5.1" ECU_ADDRESS 0x6002C8C9
 /begin IF_DATA XCPplus 0x0102
  /begin DAQ_EVENT VARIABLE /end DAQ_EVENT
 /end IF_DATA
/end MEASUREMENT
/begin MEASUREMENT MoFExtCpt_stBrkBstPFltCpl "Compliment variable of MoFExtCpt_stBrkBstPFlt" UBYTE OneToOne 1 100 0.00 255.0 FORMAT "%5.1" ECU_ADDRESS 0x6002BE85
 /begin IF_DATA XCPplus 0x0102
  /begin DAQ_EVENT VARIABLE /end DAQ_EVENT
 /end IF_DATA
/end MEASUREMENT
/begin MEASUREMENT MoFExtCpt_stDebHiVacPErr "Debouncing State for High Pressure Error" UBYTE OneToOne 1 100 0.00 255.0 FORMAT "%5.1" ECU_ADDRESS 0x6002C8D2
 /begin IF_DATA XCPplus 0x0102
  /begin DAQ_EVENT VARIABLE /end DAQ_EVENT
 /end IF_DATA
/end MEASUREMENT
/begin MEASUREMENT MoFExtCpt_stDebHiVacPErrCpl "Complement MoFExtCpt_stDebHiVacPErr" UBYTE OneToOne 1 100 0.00 255.0 FORMAT "%5.1" ECU_ADDRESS 0x6002BE84
 /begin IF_DATA XCPplus 0x0102
  /begin DAQ_EVENT VARIABLE /end DAQ_EVENT
 /end IF_DATA
/end MEASUREMENT
/begin MEASUREMENT MoFExtCpt_stDebVacPmpEfcErr "Debouncing State for Pump Effectiveness Error" UBYTE OneToOne 1 100 0.00 255.0 FORMAT "%5.1" ECU_ADDRESS 0x6002C8D1
 /begin IF_DATA XCPplus 0x0102
  /begin DAQ_EVENT VARIABLE /end DAQ_EVENT
 /end IF_DATA
/end MEASUREMENT
/begin MEASUREMENT MoFExtCpt_stDebVacPmpEfcErrCpl "Complement MoFExtCpt_stDebVacPmpEfcErr" UBYTE OneToOne 1 100 0.00 255.0 FORMAT "%5.1" ECU_ADDRESS 0x6002BE83
 /begin IF_DATA XCPplus 0x0102
  /begin DAQ_EVENT VARIABLE /end DAQ_EVENT
 /end IF_DATA
/end MEASUREMENT
/begin MEASUREMENT MoFExtCpt_stDebVacPSnsrErr "Debouncing state for sensor stuck error" UBYTE OneToOne 1 100 0.00 255.0 FORMAT "%5.1" ECU_ADDRESS 0x6002C8D0
 /begin IF_DATA XCPplus 0x0102
  /begin DAQ_EVENT VARIABLE /end DAQ_EVENT
 /end IF_DATA
/end MEASUREMENT
/begin MEASUREMENT MoFExtCpt_stDebVacPSnsrErrCpl "MoFExtCpt_stDebVacPSnsrErr" UBYTE OneToOne 1 100 0.00 255.0 FORMAT "%5.1" ECU_ADDRESS 0x6002BE82
 /begin IF_DATA XCPplus 0x0102
  /begin DAQ_EVENT VARIABLE /end DAQ_EVENT
 /end IF_DATA
/end MEASUREMENT
/begin MEASUREMENT MoFExtCpt_stMstWrnLmp "Stores the error status of vacuum pump" UBYTE OneToOne 1 100 0.00 255.0 FORMAT "%5.1" ECU_ADDRESS 0x6002C8C8
 /begin IF_DATA XCPplus 0x0102
  /begin DAQ_EVENT VARIABLE /end DAQ_EVENT
 /end IF_DATA
/end MEASUREMENT
/begin MEASUREMENT MoFExtCpt_stMstWrnLmpCpl "Compliment variable of MoFExtCpt_stMstWrnLmp" UBYTE OneToOne 1 100 0.00 255.0 FORMAT "%5.1" ECU_ADDRESS 0x6002BE81
 /begin IF_DATA XCPplus 0x0102
  /begin DAQ_EVENT VARIABLE /end DAQ_EVENT
 /end IF_DATA
/end MEASUREMENT
/begin MEASUREMENT MoFExtCpt_stPwt "Powertrain status" UBYTE CoPtFH_stPwt_VERB 1 100 0.00 15.0000000000 FORMAT "%13.10" ECU_ADDRESS 0x6002C8CF
 /begin IF_DATA XCPplus 0x0102
  /begin DAQ_EVENT VARIABLE /end DAQ_EVENT
 /end IF_DATA
/end MEASUREMENT
/begin MEASUREMENT MoFExtCpt_stPwtCpl "Compliment variable of MoFExtCpt_stPwt" UBYTE OneToOne 1 100 0.00 255.0 FORMAT "%5.1" ECU_ADDRESS 0x6002BE80
 /begin IF_DATA XCPplus 0x0102
  /begin DAQ_EVENT VARIABLE /end DAQ_EVENT
 /end IF_DATA
/end MEASUREMENT
/begin MEASUREMENT MoFExtCpt_stVacDebPmpActvnErr "Debouncing State for Pump Activation" UBYTE OneToOne 1 100 0.00 255.0 FORMAT "%5.1" ECU_ADDRESS 0x6002C8CE
 /begin IF_DATA XCPplus 0x0102
  /begin DAQ_EVENT VARIABLE /end DAQ_EVENT
 /end IF_DATA
/end MEASUREMENT
/begin MEASUREMENT MoFExtCpt_stVacDebPmpActvnErrCpl "Complement MoFExtCpt_stVacDebPmpActvnErr" UBYTE OneToOne 1 100 0.00 255.0 FORMAT "%5.1" ECU_ADDRESS 0x6002BE7F
 /begin IF_DATA XCPplus 0x0102
  /begin DAQ_EVENT VARIABLE /end DAQ_EVENT
 /end IF_DATA
/end MEASUREMENT
/begin MEASUREMENT MoFExtCpt_stVacPmpDebSRC1 "Debounce counter for sensor 1" UBYTE OneToOne 1 100 0.00 255.0 FORMAT "%5.1" ECU_ADDRESS 0x6002C8CD
 /begin IF_DATA XCPplus 0x0102
  /begin DAQ_EVENT VARIABLE /end DAQ_EVENT
 /end IF_DATA
/end MEASUREMENT
/begin MEASUREMENT MoFExtCpt_stVacPmpDebSRC1Cpl "Compliment of MoFExtCpt_stVacPmpDebSRC1" UBYTE OneToOne 1 100 0.00 255.0 FORMAT "%5.1" ECU_ADDRESS 0x6002BE7E
 /begin IF_DATA XCPplus 0x0102
  /begin DAQ_EVENT VARIABLE /end DAQ_EVENT
 /end IF_DATA
/end MEASUREMENT
/begin MEASUREMENT MoFExtCpt_stVacPmpDebSRC2 "Debounce counter for sensor 2" UBYTE OneToOne 1 100 0.00 255.0 FORMAT "%5.1" ECU_ADDRESS 0x6002C8CC
 /begin IF_DATA XCPplus 0x0102
  /begin DAQ_EVENT VARIABLE /end DAQ_EVENT
 /end IF_DATA
/end MEASUREMENT
/begin MEASUREMENT MoFExtCpt_stVacPmpDebSRC2Cpl "Compliment of MoFExtCpt_stVacPmpDebSRC2" UBYTE OneToOne 1 100 0.00 255.0 FORMAT "%5.1" ECU_ADDRESS 0x6002BE7D
 /begin IF_DATA XCPplus 0x0102
  /begin DAQ_EVENT VARIABLE /end DAQ_EVENT
 /end IF_DATA
/end MEASUREMENT
/begin MEASUREMENT MoFExtCpt_stVacPmpErr "Collected Error state" UBYTE OneToOne 1 100 0.00 255.0 FORMAT "%5.1" ECU_ADDRESS 0x6002C8CB
 /begin IF_DATA XCPplus 0x0102
  /begin DAQ_EVENT VARIABLE /end DAQ_EVENT
 /end IF_DATA
/end MEASUREMENT
/begin MEASUREMENT MoFExtCpt_stVacPmpErrCpl "Complement of MoFExtCpt_stVacPmpErr" UBYTE OneToOne 1 100 0.00 255.0 FORMAT "%5.1" ECU_ADDRESS 0x6002BE7C
 /begin IF_DATA XCPplus 0x0102
  /begin DAQ_EVENT VARIABLE /end DAQ_EVENT
 /end IF_DATA
/end MEASUREMENT
/begin MEASUREMENT MoFExtCpt_uAdcRaw1Msg "Variable to read Raw ADC1 value" SWORD OneToOne 1 100 -32768.00 32767.00 FORMAT "%8.2" ECU_ADDRESS 0x6001FA7A
 /begin IF_DATA XCPplus 0x0102
  /begin DAQ_EVENT VARIABLE /end DAQ_EVENT
 /end IF_DATA
/end MEASUREMENT
/begin MEASUREMENT MoFExtCpt_uAdcRaw2Msg "Variable to read Raw ADC2 value" SWORD OneToOne 1 100 -32768.00 32767.00 FORMAT "%8.2" ECU_ADDRESS 0x6001FA78
 /begin IF_DATA XCPplus 0x0102
  /begin DAQ_EVENT VARIABLE /end DAQ_EVENT
 /end IF_DATA
/end MEASUREMENT
/begin MEASUREMENT MoFExtCpt_uVacPRaw1 "Pump sensor 1 Value" SWORD RBPtCel_u_0p2_1 1 100 -6553.600 6553.400 FORMAT "%8.3" ECU_ADDRESS 0x6002C89E
 /begin IF_DATA XCPplus 0x0102
  /begin DAQ_EVENT VARIABLE /end DAQ_EVENT
 /end IF_DATA
/end MEASUREMENT
/begin MEASUREMENT MoFExtCpt_uVacPRaw1Cpl "Compliment of variable MofExtCpt_uVacPRaw1" UWORD OneToOne 1 100 0.00 65535.00 FORMAT "%8.2" ECU_ADDRESS 0x6002BE4C
 /begin IF_DATA XCPplus 0x0102
  /begin DAQ_EVENT VARIABLE /end DAQ_EVENT
 /end IF_DATA
/end MEASUREMENT
/begin MEASUREMENT MoFExtCpt_uVacPRaw2 "Pump Sensor 2 value" SWORD RBPtCel_u_0p2_1 1 100 -6553.600 6553.400 FORMAT "%8.3" ECU_ADDRESS 0x6002C89C
 /begin IF_DATA XCPplus 0x0102
  /begin DAQ_EVENT VARIABLE /end DAQ_EVENT
 /end IF_DATA
/end MEASUREMENT
/begin MEASUREMENT MoFExtCpt_uVacPRaw2Cpl "Compliment of variable MofExtCpt_uVacPRaw2" UWORD OneToOne 1 100 0.00 65535.00 FORMAT "%8.2" ECU_ADDRESS 0x6002BE4A
 /begin IF_DATA XCPplus 0x0102
  /begin DAQ_EVENT VARIABLE /end DAQ_EVENT
 /end IF_DATA
/end MEASUREMENT
/begin MEASUREMENT MoFFrmRx_bbMoFFrm_flgBrkRawCpl "Complement of bit base MoFFrmRx_bbMoFFrm_flgBrkRawCpl" UBYTE OneToOne 1 100 0.00 255.0 FORMAT "%5.1" ECU_ADDRESS 0x6002BE34 /end MEASUREMENT
/begin MEASUREMENT MoFFrmRx_bbMoFFrm_flgDcChrgnVoltMeasmtErrCpl "MoFFrm_flgDcChrgnVoltMeasmtErr complement" UBYTE OneToOne 1 100 0.00 255.0 FORMAT "%5.1" ECU_ADDRESS 0x6002BE33 /end MEASUREMENT
/begin MEASUREMENT MoFFrmRx_bbMoFFrm_flgDcChrgnVoltMeasmtSysErrCpl "MoFFrm_flgDcChrgnVoltMeasmtSysErr complement" UBYTE OneToOne 1 100 0.00 255.0 FORMAT "%5.1" ECU_ADDRESS 0x6002BE32 /end MEASUREMENT
/begin MEASUREMENT MoFFrmRx_bbMoFFrm_flgDcChrgnVoltMeasmtVldCpl "MoFFrm_flgDcChrgnVoltMeasmtVld complement" UBYTE OneToOne 1 100 0.00 255.0 FORMAT "%5.1" ECU_ADDRESS 0x6002BE31 /end MEASUREMENT
/begin MEASUREMENT MoFFrmRx_bbMoFFrm_flgDcChrgnVoltRngErrCpl "MoFFrm_flgDcChrgnVoltRngErr complement" UBYTE OneToOne 1 100 0.00 255.0 FORMAT "%5.1" ECU_ADDRESS 0x6002BE30 /end MEASUREMENT
/begin MEASUREMENT MoFFrmRx_bbMoFFrm_flgDrvrDoorOpenCpl "Structure Complement for MoFFrm_flgDrvrDoorOpen" UBYTE OneToOne 1 100 0.00 255.0 FORMAT "%5.1" ECU_ADDRESS 0x6002BE2F /end MEASUREMENT
/begin MEASUREMENT MoFFrmRx_bbMoFFrm_flgPreCdngWakeupCpl "MoFFrm_Rx" UBYTE OneToOne 1 100 0.00 255.0 FORMAT "%5.1" ECU_ADDRESS 0x6002BE2E /end MEASUREMENT
/begin MEASUREMENT MoFFrmRx_bbMoFFrm_flgRgnInhbnCpl "Structure Complement for MoFFrm_flgRgnInhbn" UBYTE OneToOne 1 100 0.00 255.0 FORMAT "%5.1" ECU_ADDRESS 0x6002BE2D /end MEASUREMENT
/begin MEASUREMENT MoFFrmRx_bbMoFFrm_flgVehHldActvCpl "Complement structure for MoFFrm_flgVehHldActv" UBYTE OneToOne 1 100 0.00 255.0 FORMAT "%5.1" ECU_ADDRESS 0x6002BE2C /end MEASUREMENT
/begin MEASUREMENT MoFFrm_flgBrkRaw "Brake pressed status received from i-Booster vial CAN" UBYTE B_TRUE 1 100 0.00 1.00000000000 BIT_MASK 0x1 FORMAT "%13.11" ECU_ADDRESS 0x6002C864
 /begin IF_DATA XCPplus 0x0102
  /begin DAQ_EVENT VARIABLE /end DAQ_EVENT
 /end IF_DATA
/end MEASUREMENT
/begin MEASUREMENT MoFFrm_flgBrkRawQlfr "Qualifier for Brake pedal switch" UBYTE OneToOne 1 100 0.00 255.0 FORMAT "%5.1" ECU_ADDRESS 0x6002C85B
 /begin IF_DATA XCPplus 0x0102
  /begin DAQ_EVENT VARIABLE /end DAQ_EVENT
 /end IF_DATA
/end MEASUREMENT
/begin MEASUREMENT MoFFrm_flgBrkRawQlfrCpl "Qualifier Complement of Brake pedal switch" UBYTE OneToOne 1 100 0.00 255.0 FORMAT "%5.1" ECU_ADDRESS 0x6002BE2B
 /begin IF_DATA XCPplus 0x0102
  /begin DAQ_EVENT VARIABLE /end DAQ_EVENT
 /end IF_DATA
/end MEASUREMENT
/begin MEASUREMENT MoFFrm_flgDcChrgnVoltMeasmtErr "MoFFrm_flgDcChrgnVoltMeasmtErr signal" UBYTE B_TRUE 1 100 0.00 1.00000000000 BIT_MASK 0x1 FORMAT "%13.11" ECU_ADDRESS 0x6002C863
 /begin IF_DATA XCPplus 0x0102
  /begin DAQ_EVENT VARIABLE /end DAQ_EVENT
 /end IF_DATA
/end MEASUREMENT
/begin MEASUREMENT MoFFrm_flgDcChrgnVoltMeasmtSysErr "MoFFrm_flgDcChrgnVoltMeasmtSysErr sig" UBYTE B_TRUE 1 100 0.00 1.00000000000 BIT_MASK 0x1 FORMAT "%13.11" ECU_ADDRESS 0x6002C862
 /begin IF_DATA XCPplus 0x0102
  /begin DAQ_EVENT VARIABLE /end DAQ_EVENT
 /end IF_DATA
/end MEASUREMENT
/begin MEASUREMENT MoFFrm_flgDcChrgnVoltMeasmtVld "MoFFrm_flgDcChrgnVoltMeasmtVld sig" UBYTE B_TRUE 1 100 0.00 1.00000000000 BIT_MASK 0x1 FORMAT "%13.11" ECU_ADDRESS 0x6002C861
 /begin IF_DATA XCPplus 0x0102
  /begin DAQ_EVENT VARIABLE /end DAQ_EVENT
 /end IF_DATA
/end MEASUREMENT
/begin MEASUREMENT MoFFrm_flgDcChrgnVoltRngErr "MoFFrm_flgDcChrgnVoltRngErr sig" UBYTE B_TRUE 1 100 0.00 1.00000000000 BIT_MASK 0x1 FORMAT "%13.11" ECU_ADDRESS 0x6002C860
 /begin IF_DATA XCPplus 0x0102
  /begin DAQ_EVENT VARIABLE /end DAQ_EVENT
 /end IF_DATA
/end MEASUREMENT
/begin MEASUREMENT MoFFrm_flgDrvrDoorOpen "Driver Door Open Status Authenticated in function monitoring" UBYTE B_TRUE 1 100 0.00 1.00000000000 BIT_MASK 0x1 FORMAT "%13.11" ECU_ADDRESS 0x6002C85F
 /begin IF_DATA XCPplus 0x0102
  /begin DAQ_EVENT VARIABLE /end DAQ_EVENT
 /end IF_DATA
/end MEASUREMENT
/begin MEASUREMENT MoFFrm_flgDrvrDoorOpenQlfr "Qualifier for MoFFrm_flgDrvrDoorOpen" UBYTE OneToOne 1 100 0.00 255.0 FORMAT "%5.1" ECU_ADDRESS 0x6002C85A
 /begin IF_DATA XCPplus 0x0102
  /begin DAQ_EVENT VARIABLE /end DAQ_EVENT
 /end IF_DATA
/end MEASUREMENT
/begin MEASUREMENT MoFFrm_flgDrvrDoorOpenQlfrCpl "Qualifier Complement for Driver door status" UBYTE OneToOne 1 100 0.00 255.0 FORMAT "%5.1" ECU_ADDRESS 0x6002BE2A
 /begin IF_DATA XCPplus 0x0102
  /begin DAQ_EVENT VARIABLE /end DAQ_EVENT
 /end IF_DATA
/end MEASUREMENT
/begin MEASUREMENT MoFFrm_flgPreCdngWakeup "CAN Input for Cabin Preconditioning" UBYTE B_TRUE 1 100 0.00 1.00000000000 BIT_MASK 0x1 FORMAT "%13.11" ECU_ADDRESS 0x6002C85E
 /begin IF_DATA XCPplus 0x0102
  /begin DAQ_EVENT VARIABLE /end DAQ_EVENT
 /end IF_DATA
/end MEASUREMENT
/begin MEASUREMENT MoFFrm_flgPreCdngWakeupQlfr "MoFFrm_Rx" UBYTE OneToOne 1 100 0.00 255.0 FORMAT "%5.1" ECU_ADDRESS 0x6002C859
 /begin IF_DATA XCPplus 0x0102
  /begin DAQ_EVENT VARIABLE /end DAQ_EVENT
 /end IF_DATA
/end MEASUREMENT
/begin MEASUREMENT MoFFrm_flgPreCdngWakeupQlfrCpl "MoFFrm_Rx" UBYTE OneToOne 1 100 0.00 255.0 FORMAT "%5.1" ECU_ADDRESS 0x6002BE29
 /begin IF_DATA XCPplus 0x0102
  /begin DAQ_EVENT VARIABLE /end DAQ_EVENT
 /end IF_DATA
/end MEASUREMENT
/begin MEASUREMENT MoFFrm_flgRgnInhbn "Regen inhibit flag" UBYTE B_TRUE 1 100 0.00 1.00000000000 BIT_MASK 0x1 FORMAT "%13.11" ECU_ADDRESS 0x6002C85D
 /begin IF_DATA XCPplus 0x0102
  /begin DAQ_EVENT VARIABLE /end DAQ_EVENT
 /end IF_DATA
/end MEASUREMENT
/begin MEASUREMENT MoFFrm_flgRgnInhbnQlfr "Qualifier for ABS in regulation" UBYTE OneToOne 1 100 0.00 255.0 FORMAT "%5.1" ECU_ADDRESS 0x6002C858
 /begin IF_DATA XCPplus 0x0102
  /begin DAQ_EVENT VARIABLE /end DAQ_EVENT
 /end IF_DATA
/end MEASUREMENT
/begin MEASUREMENT MoFFrm_flgRgnInhbnQlfrCpl "Qualifier Complement of ABS in regulation" UBYTE OneToOne 1 100 0.00 255.0 FORMAT "%5.1" ECU_ADDRESS 0x6002BE28
 /begin IF_DATA XCPplus 0x0102
  /begin DAQ_EVENT VARIABLE /end DAQ_EVENT
 /end IF_DATA
/end MEASUREMENT
/begin MEASUREMENT MoFFrm_flgVehHldActv "Vehicle hold status active." UBYTE B_TRUE 1 100 0.00 1.00000000000 BIT_MASK 0x1 FORMAT "%13.11" ECU_ADDRESS 0x6002C85C
 /begin IF_DATA XCPplus 0x0102
  /begin DAQ_EVENT VARIABLE /end DAQ_EVENT
 /end IF_DATA
/end MEASUREMENT
/begin MEASUREMENT MoFFrm_flgVehHldActvQlfr "Qualifier of Hill Hold Status" UBYTE OneToOne 1 100 0.00 255.0 FORMAT "%5.1" ECU_ADDRESS 0x6002C857
 /begin IF_DATA XCPplus 0x0102
  /begin DAQ_EVENT VARIABLE /end DAQ_EVENT
 /end IF_DATA
/end MEASUREMENT
/begin MEASUREMENT MoFFrm_flgVehHldActvQlfrCpl "Qualifier Complement of Hill Hold Status" UBYTE OneToOne 1 100 0.00 255.0 FORMAT "%5.1" ECU_ADDRESS 0x6002BE27
 /begin IF_DATA XCPplus 0x0102
  /begin DAQ_EVENT VARIABLE /end DAQ_EVENT
 /end IF_DATA
/end MEASUREMENT
/begin MEASUREMENT MoFFrm_Lib_DataPduRxInstance.cntrAlvErrDeb "Structure variable for Rx PDU / Alive counter debounce error calibration of RX Data Pdu" UWORD OneToOne 1 100 0.00 65535.00 FORMAT "%8.2" ECU_ADDRESS 0x6002C888 /end MEASUREMENT
/begin MEASUREMENT MoFFrm_Lib_DataPduRxInstance.cntrAlvErrDebCpl "Structure variable for Rx PDU / complement of alive counter debounce error calibration of RX Data Pdu" UWORD OneToOne 1 100 0.00 65535.00 FORMAT "%8.2" ECU_ADDRESS 0x6002BE3C /end MEASUREMENT
/begin MEASUREMENT MoFFrm_Lib_DataPduRxInstance.cntrAlvOld "Structure variable for Rx PDU / old alive counter calibration of RX Data Pdu" UBYTE OneToOne 1 100 0.00 255.0 FORMAT "%5.1" ECU_ADDRESS 0x6002C88A /end MEASUREMENT
/begin MEASUREMENT MoFFrm_Lib_DataPduRxInstance.cntrAlvOldCpl "Structure variable for Rx PDU / Complement of old Alive counter calibration of RX Data Pdu" UBYTE OneToOne 1 100 0.00 255.0 FORMAT "%5.1" ECU_ADDRESS 0x6002BE3E /end MEASUREMENT
/begin MEASUREMENT MoFFrm_Lib_DataPduRxInstance.cntrCrcErrDeb "Structure variable for Rx PDU / Alive counter error debounce calibration of RX Data Pdu" UWORD OneToOne 1 100 0.00 65535.00 FORMAT "%8.2" ECU_ADDRESS 0x6002C88C /end MEASUREMENT
/begin MEASUREMENT MoFFrm_Lib_DataPduRxInstance.cntrCrcErrDebCpl "Structure variable for Rx PDU / Complement of old Alive counter calibration of RX Data Pdu" UWORD OneToOne 1 100 0.00 65535.00 FORMAT "%8.2" ECU_ADDRESS 0x6002BE40 /end MEASUREMENT
/begin MEASUREMENT MoFFrm_Lib_DataPduRxInstance.cntrCycTi "Structure variable for Rx PDU / Alive counter debounce error calibration of RX Data Pdu" UWORD OneToOne 1 100 0.00 65535.00 FORMAT "%8.2" ECU_ADDRESS 0x6002C88E /end MEASUREMENT
/begin MEASUREMENT MoFFrm_Lib_DataPduRxInstance.cntrCycTiCpl "Structure variable for Rx PDU / Counter cyclic calibration of RX Data Pdu" UWORD OneToOne 1 100 0.00 65535.00 FORMAT "%8.2" ECU_ADDRESS 0x6002BE42 /end MEASUREMENT
/begin MEASUREMENT MoFFrm_Lib_DataPduRxInstance.cntrTiOutDeb "Structure variable for Rx PDU / Counter time out debounce of Rx data PDU" UWORD OneToOne 1 100 0.00 65535.00 FORMAT "%8.2" ECU_ADDRESS 0x6002C890 /end MEASUREMENT
/begin MEASUREMENT MoFFrm_Lib_DataPduRxInstance.cntrTiOutDebCpl "Structure variable for Rx PDU / Complement of Counter time out debounce of Rx data PDU" UWORD OneToOne 1 100 0.00 65535.00 FORMAT "%8.2" ECU_ADDRESS 0x6002BE44 /end MEASUREMENT
/begin MEASUREMENT MoFFrm_Lib_DataPduRxInstance.crcData "Structure variable for Rx PDU / CRC data of Rx data PDU" UWORD OneToOne 1 100 0.00 65535.00 FORMAT "%8.2" ECU_ADDRESS 0x6002C892 /end MEASUREMENT
/begin MEASUREMENT MoFFrm_Lib_DataPduRxInstance.crcDataCpl "Structure variable for Rx PDU / Comlement of CRC data of Rx data PDU" UWORD OneToOne 1 100 0.00 65535.00 FORMAT "%8.2" ECU_ADDRESS 0x6002BE46 /end MEASUREMENT
/begin MEASUREMENT MoFFrm_Lib_DataPduRxInstance.flgPduUpd "Structure variable for Rx PDU / PDU update flag" UBYTE B_TRUE 1 100 0.00 1.00000000000 BIT_MASK 0x1 FORMAT "%13.11" ECU_ADDRESS 0x6002C894 /end MEASUREMENT
/begin MEASUREMENT MoFFrm_Lib_DataPduRxInstance.flgPduUpdCpl "Structure variable for Rx PDU / complement of PDU update flag" UBYTE B_TRUE 1 100 0.00 1.00000000000 BIT_MASK 0x1 FORMAT "%13.11" ECU_ADDRESS 0x6002BE48 /end MEASUREMENT
/begin MEASUREMENT MoFFrm_Lib_DataPduTxInstance.cntrAlvOld "Structure variable for Tx PDU / old alive counter" UBYTE OneToOne 1 100 0.00 255.0 FORMAT "%5.1" ECU_ADDRESS 0x6002C882 /end MEASUREMENT
/begin MEASUREMENT MoFFrm_Lib_DataPduTxInstance.cntrAlvOldCpl "Structure variable for Tx PDU / complement of oold alive counter" UBYTE OneToOne 1 100 0.00 255.0 FORMAT "%5.1" ECU_ADDRESS 0x6002BE36 /end MEASUREMENT
/begin MEASUREMENT MoFFrm_Lib_DataPduTxInstance.crcData "Structure variable for Tx PDU / crc data" UWORD OneToOne 1 100 0.00 65535.00 FORMAT "%8.2" ECU_ADDRESS 0x6002C884 /end MEASUREMENT
/begin MEASUREMENT MoFFrm_Lib_DataPduTxInstance.crcDataCpl "Structure variable for Tx PDU / complement of crc data" UWORD OneToOne 1 100 0.00 65535.00 FORMAT "%8.2" ECU_ADDRESS 0x6002BE38 /end MEASUREMENT
/begin MEASUREMENT MoFFrm_Lib_DataPduTxInstance.flgAswTrigTx "Structure variable for Tx PDU / ASW Tx trigger flag" UBYTE B_TRUE 1 100 0.00 1.00000000000 BIT_MASK 0x1 FORMAT "%13.11" ECU_ADDRESS 0x6002C886 /end MEASUREMENT
/begin MEASUREMENT MoFFrm_Lib_DataPduTxInstance.flgAswTrigTxCpl "Structure variable for Tx PDU / complement of ASW Tx trigger flag" UBYTE B_TRUE 1 100 0.00 1.00000000000 BIT_MASK 0x1 FORMAT "%13.11" ECU_ADDRESS 0x6002BE3A /end MEASUREMENT
/begin MEASUREMENT MoFFrm_nEm01CANRaw "raw e-machine speed received via CAN" SWORD RBPtCel_n_1p0_1 1 100 -32768.00 32767.00 FORMAT "%8.2" ECU_ADDRESS 0x6002C818
 /begin IF_DATA XCPplus 0x0102
  /begin DAQ_EVENT VARIABLE /end DAQ_EVENT
 /end IF_DATA
/end MEASUREMENT
/begin MEASUREMENT MoFFrm_nEm01CANRawCpl "RAM data redundancy for MoFFrm_nEm01CANRaw" UWORD OneToOne 1 100 0.00 65535.00 FORMAT "%8.2" ECU_ADDRESS 0x6002BDF4
 /begin IF_DATA XCPplus 0x0102
  /begin DAQ_EVENT VARIABLE /end DAQ_EVENT
 /end IF_DATA
/end MEASUREMENT
/begin MEASUREMENT MoFFrm_nEm01CANRawQlfr "signal qualifier for e machine speed" UBYTE OneToOne 1 100 0.00 255.0 FORMAT "%5.1" ECU_ADDRESS 0x6002C856
 /begin IF_DATA XCPplus 0x0102
  /begin DAQ_EVENT VARIABLE /end DAQ_EVENT
 /end IF_DATA
/end MEASUREMENT
/begin MEASUREMENT MoFFrm_nEm01CANRawQlfrCpl "RAM data redundancy for MoFFrm_nEm01CANRawQlfr" UBYTE OneToOne 1 100 0.00 255.0 FORMAT "%5.1" ECU_ADDRESS 0x6002BE26
 /begin IF_DATA XCPplus 0x0102
  /begin DAQ_EVENT VARIABLE /end DAQ_EVENT
 /end IF_DATA
/end MEASUREMENT
/begin MEASUREMENT MoFFrm_Rx_DataPdu_DCDC_283h.cntrAlvErrDeb " / Alive counter debounce error calibration of RX Data Pdu" UWORD OneToOne 1 100 0.00 65535.00 FORMAT "%8.2" ECU_ADDRESS 0x6002C800 /end MEASUREMENT
/begin MEASUREMENT MoFFrm_Rx_DataPdu_DCDC_283h.cntrAlvErrDebCpl " / complement of alive counter debounce error calibration of RX Data Pdu" UWORD OneToOne 1 100 0.00 65535.00 FORMAT "%8.2" ECU_ADDRESS 0x6002BDDC /end MEASUREMENT
/begin MEASUREMENT MoFFrm_Rx_DataPdu_DCDC_283h.cntrAlvOld " / old alive counter calibration of RX Data Pdu" UBYTE OneToOne 1 100 0.00 255.0 FORMAT "%5.1" ECU_ADDRESS 0x6002C802 /end MEASUREMENT
/begin MEASUREMENT MoFFrm_Rx_DataPdu_DCDC_283h.cntrAlvOldCpl " / Complement of old Alive counter calibration of RX Data Pdu" UBYTE OneToOne 1 100 0.00 255.0 FORMAT "%5.1" ECU_ADDRESS 0x6002BDDE /end MEASUREMENT
/begin MEASUREMENT MoFFrm_Rx_DataPdu_DCDC_283h.cntrCrcErrDeb " / Alive counter error debounce calibration of RX Data Pdu" UWORD OneToOne 1 100 0.00 65535.00 FORMAT "%8.2" ECU_ADDRESS 0x6002C804 /end MEASUREMENT
/begin MEASUREMENT MoFFrm_Rx_DataPdu_DCDC_283h.cntrCrcErrDebCpl " / Complement of old Alive counter calibration of RX Data Pdu" UWORD OneToOne 1 100 0.00 65535.00 FORMAT "%8.2" ECU_ADDRESS 0x6002BDE0 /end MEASUREMENT
/begin MEASUREMENT MoFFrm_Rx_DataPdu_DCDC_283h.cntrCycTi " / Alive counter debounce error calibration of RX Data Pdu" UWORD OneToOne 1 100 0.00 65535.00 FORMAT "%8.2" ECU_ADDRESS 0x6002C806 /end MEASUREMENT
/begin MEASUREMENT MoFFrm_Rx_DataPdu_DCDC_283h.cntrCycTiCpl " / Counter cyclic calibration of RX Data Pdu" UWORD OneToOne 1 100 0.00 65535.00 FORMAT "%8.2" ECU_ADDRESS 0x6002BDE2 /end MEASUREMENT
/begin MEASUREMENT MoFFrm_Rx_DataPdu_DCDC_283h.cntrTiOutDeb " / Counter time out debounce of Rx data PDU" UWORD OneToOne 1 100 0.00 65535.00 FORMAT "%8.2" ECU_ADDRESS 0x6002C808 /end MEASUREMENT
/begin MEASUREMENT MoFFrm_Rx_DataPdu_DCDC_283h.cntrTiOutDebCpl " / Complement of Counter time out debounce of Rx data PDU" UWORD OneToOne 1 100 0.00 65535.00 FORMAT "%8.2" ECU_ADDRESS 0x6002BDE4 /end MEASUREMENT
/begin MEASUREMENT MoFFrm_Rx_DataPdu_DCDC_283h.crcData " / CRC data of Rx data PDU" UWORD OneToOne 1 100 0.00 65535.00 FORMAT "%8.2" ECU_ADDRESS 0x6002C80A /end MEASUREMENT
/begin MEASUREMENT MoFFrm_Rx_DataPdu_DCDC_283h.crcDataCpl " / Comlement of CRC data of Rx data PDU" UWORD OneToOne 1 100 0.00 65535.00 FORMAT "%8.2" ECU_ADDRESS 0x6002BDE6 /end MEASUREMENT
/begin MEASUREMENT MoFFrm_Rx_DataPdu_DCDC_283h.flgPduUpd " / PDU update flag" UBYTE B_TRUE 1 100 0.00 1.00000000000 BIT_MASK 0x1 FORMAT "%13.11" ECU_ADDRESS 0x6002C80C /end MEASUREMENT
/begin MEASUREMENT MoFFrm_Rx_DataPdu_DCDC_283h.flgPduUpdCpl " / complement of PDU update flag" UBYTE B_TRUE 1 100 0.00 1.00000000000 BIT_MASK 0x1 FORMAT "%13.11" ECU_ADDRESS 0x6002BDE8 /end MEASUREMENT
/begin MEASUREMENT MoFFrm_Rx_DataPdu_DCDC_293h.cntrAlvErrDeb "Data PDu Structure for DCDC_293h / Alive counter debounce error calibration of RX Data Pdu" UWORD OneToOne 1 100 0.00 65535.00 FORMAT "%8.2" ECU_ADDRESS 0x6002C7F2 /end MEASUREMENT
/begin MEASUREMENT MoFFrm_Rx_DataPdu_DCDC_293h.cntrAlvErrDebCpl "Data PDu Structure for DCDC_293h / complement of alive counter debounce error calibration of RX Data Pdu" UWORD OneToOne 1 100 0.00 65535.00 FORMAT "%8.2" ECU_ADDRESS 0x6002BDCE /end MEASUREMENT
/begin MEASUREMENT MoFFrm_Rx_DataPdu_DCDC_293h.cntrAlvOld "Data PDu Structure for DCDC_293h / old alive counter calibration of RX Data Pdu" UBYTE OneToOne 1 100 0.00 255.0 FORMAT "%5.1" ECU_ADDRESS 0x6002C7F4 /end MEASUREMENT
/begin MEASUREMENT MoFFrm_Rx_DataPdu_DCDC_293h.cntrAlvOldCpl "Data PDu Structure for DCDC_293h / Complement of old Alive counter calibration of RX Data Pdu" UBYTE OneToOne 1 100 0.00 255.0 FORMAT "%5.1" ECU_ADDRESS 0x6002BDD0 /end MEASUREMENT
/begin MEASUREMENT MoFFrm_Rx_DataPdu_DCDC_293h.cntrCrcErrDeb "Data PDu Structure for DCDC_293h / Alive counter error debounce calibration of RX Data Pdu" UWORD OneToOne 1 100 0.00 65535.00 FORMAT "%8.2" ECU_ADDRESS 0x6002C7F6 /end MEASUREMENT
/begin MEASUREMENT MoFFrm_Rx_DataPdu_DCDC_293h.cntrCrcErrDebCpl "Data PDu Structure for DCDC_293h / Complement of old Alive counter calibration of RX Data Pdu" UWORD OneToOne 1 100 0.00 65535.00 FORMAT "%8.2" ECU_ADDRESS 0x6002BDD2 /end MEASUREMENT
/begin MEASUREMENT MoFFrm_Rx_DataPdu_DCDC_293h.cntrCycTi "Data PDu Structure for DCDC_293h / Alive counter debounce error calibration of RX Data Pdu" UWORD OneToOne 1 100 0.00 65535.00 FORMAT "%8.2" ECU_ADDRESS 0x6002C7F8 /end MEASUREMENT
/begin MEASUREMENT MoFFrm_Rx_DataPdu_DCDC_293h.cntrCycTiCpl "Data PDu Structure for DCDC_293h / Counter cyclic calibration of RX Data Pdu" UWORD OneToOne 1 100 0.00 65535.00 FORMAT "%8.2" ECU_ADDRESS 0x6002BDD4 /end MEASUREMENT
/begin MEASUREMENT MoFFrm_Rx_DataPdu_DCDC_293h.cntrTiOutDeb "Data PDu Structure for DCDC_293h / Counter time out debounce of Rx data PDU" UWORD OneToOne 1 100 0.00 65535.00 FORMAT "%8.2" ECU_ADDRESS 0x6002C7FA /end MEASUREMENT
/begin MEASUREMENT MoFFrm_Rx_DataPdu_DCDC_293h.cntrTiOutDebCpl "Data PDu Structure for DCDC_293h / Complement of Counter time out debounce of Rx data PDU" UWORD OneToOne 1 100 0.00 65535.00 FORMAT "%8.2" ECU_ADDRESS 0x6002BDD6 /end MEASUREMENT
/begin MEASUREMENT MoFFrm_Rx_DataPdu_DCDC_293h.crcData "Data PDu Structure for DCDC_293h / CRC data of Rx data PDU" UWORD OneToOne 1 100 0.00 65535.00 FORMAT "%8.2" ECU_ADDRESS 0x6002C7FC /end MEASUREMENT
/begin MEASUREMENT MoFFrm_Rx_DataPdu_DCDC_293h.crcDataCpl "Data PDu Structure for DCDC_293h / Comlement of CRC data of Rx data PDU" UWORD OneToOne 1 100 0.00 65535.00 FORMAT "%8.2" ECU_ADDRESS 0x6002BDD8 /end MEASUREMENT
/begin MEASUREMENT MoFFrm_Rx_DataPdu_DCDC_293h.flgPduUpd "Data PDu Structure for DCDC_293h / PDU update flag" UBYTE B_TRUE 1 100 0.00 1.00000000000 BIT_MASK 0x1 FORMAT "%13.11" ECU_ADDRESS 0x6002C7FE /end MEASUREMENT
/begin MEASUREMENT MoFFrm_Rx_DataPdu_DCDC_293h.flgPduUpdCpl "Data PDu Structure for DCDC_293h / complement of PDU update flag" UBYTE B_TRUE 1 100 0.00 1.00000000000 BIT_MASK 0x1 FORMAT "%13.11" ECU_ADDRESS 0x6002BDDA /end MEASUREMENT
/begin MEASUREMENT MoFFrm_Rx_DataPdu_HS3_AUTO_GEARBOX_SWITCH_STATUS.cntrAlvErrDeb "Data PDu Structure for HS3_AUTO_GEARBOX_SWITCH_STATUS / Alive counter debounce error calibration of RX Data Pdu" UWORD OneToOne 1 100 0.00 65535.00 FORMAT "%8.2" ECU_ADDRESS 0x6002C7E4 /end MEASUREMENT
/begin MEASUREMENT MoFFrm_Rx_DataPdu_HS3_AUTO_GEARBOX_SWITCH_STATUS.cntrAlvErrDebCpl "Data PDu Structure for HS3_AUTO_GEARBOX_SWITCH_STATUS / complement of alive counter debounce error calibration of RX Data Pdu" UWORD OneToOne 1 100 0.00 65535.00 FORMAT "%8.2" ECU_ADDRESS 0x6002BDC0 /end MEASUREMENT
/begin MEASUREMENT MoFFrm_Rx_DataPdu_HS3_AUTO_GEARBOX_SWITCH_STATUS.cntrAlvOld "Data PDu Structure for HS3_AUTO_GEARBOX_SWITCH_STATUS / old alive counter calibration of RX Data Pdu" UBYTE OneToOne 1 100 0.00 255.0 FORMAT "%5.1" ECU_ADDRESS 0x6002C7E6 /end MEASUREMENT
/begin MEASUREMENT MoFFrm_Rx_DataPdu_HS3_AUTO_GEARBOX_SWITCH_STATUS.cntrAlvOldCpl "Data PDu Structure for HS3_AUTO_GEARBOX_SWITCH_STATUS / Complement of old Alive counter calibration of RX Data Pdu" UBYTE OneToOne 1 100 0.00 255.0 FORMAT "%5.1" ECU_ADDRESS 0x6002BDC2 /end MEASUREMENT
/begin MEASUREMENT MoFFrm_Rx_DataPdu_HS3_AUTO_GEARBOX_SWITCH_STATUS.cntrCrcErrDeb "Data PDu Structure for HS3_AUTO_GEARBOX_SWITCH_STATUS / Alive counter error debounce calibration of RX Data Pdu" UWORD OneToOne 1 100 0.00 65535.00 FORMAT "%8.2" ECU_ADDRESS 0x6002C7E8 /end MEASUREMENT
/begin MEASUREMENT MoFFrm_Rx_DataPdu_HS3_AUTO_GEARBOX_SWITCH_STATUS.cntrCrcErrDebCpl "Data PDu Structure for HS3_AUTO_GEARBOX_SWITCH_STATUS / Complement of old Alive counter calibration of RX Data Pdu" UWORD OneToOne 1 100 0.00 65535.00 FORMAT "%8.2" ECU_ADDRESS 0x6002BDC4 /end MEASUREMENT
/begin MEASUREMENT MoFFrm_Rx_DataPdu_HS3_AUTO_GEARBOX_SWITCH_STATUS.cntrCycTi "Data PDu Structure for HS3_AUTO_GEARBOX_SWITCH_STATUS / Alive counter debounce error calibration of RX Data Pdu" UWORD OneToOne 1 100 0.00 65535.00 FORMAT "%8.2" ECU_ADDRESS 0x6002C7EA /end MEASUREMENT
/begin MEASUREMENT MoFFrm_Rx_DataPdu_HS3_AUTO_GEARBOX_SWITCH_STATUS.cntrCycTiCpl "Data PDu Structure for HS3_AUTO_GEARBOX_SWITCH_STATUS / Counter cyclic calibration of RX Data Pdu" UWORD OneToOne 1 100 0.00 65535.00 FORMAT "%8.2" ECU_ADDRESS 0x6002BDC6 /end MEASUREMENT
/begin MEASUREMENT MoFFrm_Rx_DataPdu_HS3_AUTO_GEARBOX_SWITCH_STATUS.cntrTiOutDeb "Data PDu Structure for HS3_AUTO_GEARBOX_SWITCH_STATUS / Counter time out debounce of Rx data PDU" UWORD OneToOne 1 100 0.00 65535.00 FORMAT "%8.2" ECU_ADDRESS 0x6002C7EC /end MEASUREMENT
/begin MEASUREMENT MoFFrm_Rx_DataPdu_HS3_AUTO_GEARBOX_SWITCH_STATUS.cntrTiOutDebCpl "Data PDu Structure for HS3_AUTO_GEARBOX_SWITCH_STATUS / Complement of Counter time out debounce of Rx data PDU" UWORD OneToOne 1 100 0.00 65535.00 FORMAT "%8.2" ECU_ADDRESS 0x6002BDC8 /end MEASUREMENT
/begin MEASUREMENT MoFFrm_Rx_DataPdu_HS3_AUTO_GEARBOX_SWITCH_STATUS.crcData "Data PDu Structure for HS3_AUTO_GEARBOX_SWITCH_STATUS / CRC data of Rx data PDU" UWORD OneToOne 1 100 0.00 65535.00 FORMAT "%8.2" ECU_ADDRESS 0x6002C7EE /end MEASUREMENT
/begin MEASUREMENT MoFFrm_Rx_DataPdu_HS3_AUTO_GEARBOX_SWITCH_STATUS.crcDataCpl "Data PDu Structure for HS3_AUTO_GEARBOX_SWITCH_STATUS / Comlement of CRC data of Rx data PDU" UWORD OneToOne 1 100 0.00 65535.00 FORMAT "%8.2" ECU_ADDRESS 0x6002BDCA /end MEASUREMENT
/begin MEASUREMENT MoFFrm_Rx_DataPdu_HS3_AUTO_GEARBOX_SWITCH_STATUS.flgPduUpd "Data PDu Structure for HS3_AUTO_GEARBOX_SWITCH_STATUS / PDU update flag" UBYTE B_TRUE 1 100 0.00 1.00000000000 BIT_MASK 0x1 FORMAT "%13.11" ECU_ADDRESS 0x6002C7F0 /end MEASUREMENT
/begin MEASUREMENT MoFFrm_Rx_DataPdu_HS3_AUTO_GEARBOX_SWITCH_STATUS.flgPduUpdCpl "Data PDu Structure for HS3_AUTO_GEARBOX_SWITCH_STATUS / complement of PDU update flag" UBYTE B_TRUE 1 100 0.00 1.00000000000 BIT_MASK 0x1 FORMAT "%13.11" ECU_ADDRESS 0x6002BDCC /end MEASUREMENT
/begin MEASUREMENT MoFFrm_Rx_DataPdu_HVBAT_205h.cntrAlvErrDeb "MoFFrm_Rx_DataPdu_HVBAT_205h / Alive counter debounce error calibration of RX Data Pdu" UWORD OneToOne 1 100 0.00 65535.00 FORMAT "%8.2" ECU_ADDRESS 0x6002C7D6 /end MEASUREMENT
/begin MEASUREMENT MoFFrm_Rx_DataPdu_HVBAT_205h.cntrAlvErrDebCpl "MoFFrm_Rx_DataPdu_HVBAT_205h / complement of alive counter debounce error calibration of RX Data Pdu" UWORD OneToOne 1 100 0.00 65535.00 FORMAT "%8.2" ECU_ADDRESS 0x6002BDB2 /end MEASUREMENT
/begin MEASUREMENT MoFFrm_Rx_DataPdu_HVBAT_205h.cntrAlvOld "MoFFrm_Rx_DataPdu_HVBAT_205h / old alive counter calibration of RX Data Pdu" UBYTE OneToOne 1 100 0.00 255.0 FORMAT "%5.1" ECU_ADDRESS 0x6002C7D8 /end MEASUREMENT
/begin MEASUREMENT MoFFrm_Rx_DataPdu_HVBAT_205h.cntrAlvOldCpl "MoFFrm_Rx_DataPdu_HVBAT_205h / Complement of old Alive counter calibration of RX Data Pdu" UBYTE OneToOne 1 100 0.00 255.0 FORMAT "%5.1" ECU_ADDRESS 0x6002BDB4 /end MEASUREMENT
/begin MEASUREMENT MoFFrm_Rx_DataPdu_HVBAT_205h.cntrCrcErrDeb "MoFFrm_Rx_DataPdu_HVBAT_205h / Alive counter error debounce calibration of RX Data Pdu" UWORD OneToOne 1 100 0.00 65535.00 FORMAT "%8.2" ECU_ADDRESS 0x6002C7DA /end MEASUREMENT
/begin MEASUREMENT MoFFrm_Rx_DataPdu_HVBAT_205h.cntrCrcErrDebCpl "MoFFrm_Rx_DataPdu_HVBAT_205h / Complement of old Alive counter calibration of RX Data Pdu" UWORD OneToOne 1 100 0.00 65535.00 FORMAT "%8.2" ECU_ADDRESS 0x6002BDB6 /end MEASUREMENT
/begin MEASUREMENT MoFFrm_Rx_DataPdu_HVBAT_205h.cntrCycTi "MoFFrm_Rx_DataPdu_HVBAT_205h / Alive counter debounce error calibration of RX Data Pdu" UWORD OneToOne 1 100 0.00 65535.00 FORMAT "%8.2" ECU_ADDRESS 0x6002C7DC /end MEASUREMENT
/begin MEASUREMENT MoFFrm_Rx_DataPdu_HVBAT_205h.cntrCycTiCpl "MoFFrm_Rx_DataPdu_HVBAT_205h / Counter cyclic calibration of RX Data Pdu" UWORD OneToOne 1 100 0.00 65535.00 FORMAT "%8.2" ECU_ADDRESS 0x6002BDB8 /end MEASUREMENT
/begin MEASUREMENT MoFFrm_Rx_DataPdu_HVBAT_205h.cntrTiOutDeb "MoFFrm_Rx_DataPdu_HVBAT_205h / Counter time out debounce of Rx data PDU" UWORD OneToOne 1 100 0.00 65535.00 FORMAT "%8.2" ECU_ADDRESS 0x6002C7DE /end MEASUREMENT
/begin MEASUREMENT MoFFrm_Rx_DataPdu_HVBAT_205h.cntrTiOutDebCpl "MoFFrm_Rx_DataPdu_HVBAT_205h / Complement of Counter time out debounce of Rx data PDU" UWORD OneToOne 1 100 0.00 65535.00 FORMAT "%8.2" ECU_ADDRESS 0x6002BDBA /end MEASUREMENT
/begin MEASUREMENT MoFFrm_Rx_DataPdu_HVBAT_205h.crcData "MoFFrm_Rx_DataPdu_HVBAT_205h / CRC data of Rx data PDU" UWORD OneToOne 1 100 0.00 65535.00 FORMAT "%8.2" ECU_ADDRESS 0x6002C7E0 /end MEASUREMENT
/begin MEASUREMENT MoFFrm_Rx_DataPdu_HVBAT_205h.crcDataCpl "MoFFrm_Rx_DataPdu_HVBAT_205h / Comlement of CRC data of Rx data PDU" UWORD OneToOne 1 100 0.00 65535.00 FORMAT "%8.2" ECU_ADDRESS 0x6002BDBC /end MEASUREMENT
/begin MEASUREMENT MoFFrm_Rx_DataPdu_HVBAT_205h.flgPduUpd "MoFFrm_Rx_DataPdu_HVBAT_205h / PDU update flag" UBYTE B_TRUE 1 100 0.00 1.00000000000 BIT_MASK 0x1 FORMAT "%13.11" ECU_ADDRESS 0x6002C7E2 /end MEASUREMENT
/begin MEASUREMENT MoFFrm_Rx_DataPdu_HVBAT_205h.flgPduUpdCpl "MoFFrm_Rx_DataPdu_HVBAT_205h / complement of PDU update flag" UBYTE B_TRUE 1 100 0.00 1.00000000000 BIT_MASK 0x1 FORMAT "%13.11" ECU_ADDRESS 0x6002BDBE /end MEASUREMENT
/begin MEASUREMENT MoFFrm_Rx_DataPdu_HVBAT_325h.cntrAlvErrDeb "Data PDu Structure for HVBAT_325h / Alive counter debounce error calibration of RX Data Pdu" UWORD OneToOne 1 100 0.00 65535.00 FORMAT "%8.2" ECU_ADDRESS 0x6002C7C8 /end MEASUREMENT
/begin MEASUREMENT MoFFrm_Rx_DataPdu_HVBAT_325h.cntrAlvErrDebCpl "Data PDu Structure for HVBAT_325h / complement of alive counter debounce error calibration of RX Data Pdu" UWORD OneToOne 1 100 0.00 65535.00 FORMAT "%8.2" ECU_ADDRESS 0x6002BDA4 /end MEASUREMENT
/begin MEASUREMENT MoFFrm_Rx_DataPdu_HVBAT_325h.cntrAlvOld "Data PDu Structure for HVBAT_325h / old alive counter calibration of RX Data Pdu" UBYTE OneToOne 1 100 0.00 255.0 FORMAT "%5.1" ECU_ADDRESS 0x6002C7CA /end MEASUREMENT
/begin MEASUREMENT MoFFrm_Rx_DataPdu_HVBAT_325h.cntrAlvOldCpl "Data PDu Structure for HVBAT_325h / Complement of old Alive counter calibration of RX Data Pdu" UBYTE OneToOne 1 100 0.00 255.0 FORMAT "%5.1" ECU_ADDRESS 0x6002BDA6 /end MEASUREMENT
/begin MEASUREMENT MoFFrm_Rx_DataPdu_HVBAT_325h.cntrCrcErrDeb "Data PDu Structure for HVBAT_325h / Alive counter error debounce calibration of RX Data Pdu" UWORD OneToOne 1 100 0.00 65535.00 FORMAT "%8.2" ECU_ADDRESS 0x6002C7CC /end MEASUREMENT
/begin MEASUREMENT MoFFrm_Rx_DataPdu_HVBAT_325h.cntrCrcErrDebCpl "Data PDu Structure for HVBAT_325h / Complement of old Alive counter calibration of RX Data Pdu" UWORD OneToOne 1 100 0.00 65535.00 FORMAT "%8.2" ECU_ADDRESS 0x6002BDA8 /end MEASUREMENT
/begin MEASUREMENT MoFFrm_Rx_DataPdu_HVBAT_325h.cntrCycTi "Data PDu Structure for HVBAT_325h / Alive counter debounce error calibration of RX Data Pdu" UWORD OneToOne 1 100 0.00 65535.00 FORMAT "%8.2" ECU_ADDRESS 0x6002C7CE /end MEASUREMENT
/begin MEASUREMENT MoFFrm_Rx_DataPdu_HVBAT_325h.cntrCycTiCpl "Data PDu Structure for HVBAT_325h / Counter cyclic calibration of RX Data Pdu" UWORD OneToOne 1 100 0.00 65535.00 FORMAT "%8.2" ECU_ADDRESS 0x6002BDAA /end MEASUREMENT
/begin MEASUREMENT MoFFrm_Rx_DataPdu_HVBAT_325h.cntrTiOutDeb "Data PDu Structure for HVBAT_325h / Counter time out debounce of Rx data PDU" UWORD OneToOne 1 100 0.00 65535.00 FORMAT "%8.2" ECU_ADDRESS 0x6002C7D0 /end MEASUREMENT
/begin MEASUREMENT MoFFrm_Rx_DataPdu_HVBAT_325h.cntrTiOutDebCpl "Data PDu Structure for HVBAT_325h / Complement of Counter time out debounce of Rx data PDU" UWORD OneToOne 1 100 0.00 65535.00 FORMAT "%8.2" ECU_ADDRESS 0x6002BDAC /end MEASUREMENT
/begin MEASUREMENT MoFFrm_Rx_DataPdu_HVBAT_325h.crcData "Data PDu Structure for HVBAT_325h / CRC data of Rx data PDU" UWORD OneToOne 1 100 0.00 65535.00 FORMAT "%8.2" ECU_ADDRESS 0x6002C7D2 /end MEASUREMENT
/begin MEASUREMENT MoFFrm_Rx_DataPdu_HVBAT_325h.crcDataCpl "Data PDu Structure for HVBAT_325h / Comlement of CRC data of Rx data PDU" UWORD OneToOne 1 100 0.00 65535.00 FORMAT "%8.2" ECU_ADDRESS 0x6002BDAE /end MEASUREMENT
/begin MEASUREMENT MoFFrm_Rx_DataPdu_HVBAT_325h.flgPduUpd "Data PDu Structure for HVBAT_325h / PDU update flag" UBYTE B_TRUE 1 100 0.00 1.00000000000 BIT_MASK 0x1 FORMAT "%13.11" ECU_ADDRESS 0x6002C7D4 /end MEASUREMENT
/begin MEASUREMENT MoFFrm_Rx_DataPdu_HVBAT_325h.flgPduUpdCpl "Data PDu Structure for HVBAT_325h / complement of PDU update flag" UBYTE B_TRUE 1 100 0.00 1.00000000000 BIT_MASK 0x1 FORMAT "%13.11" ECU_ADDRESS 0x6002BDB0 /end MEASUREMENT
/begin MEASUREMENT MoFFrm_Rx_DataPdu_INV_217h.cntrAlvErrDeb "Data PDu Structure for INV_217h / Alive counter debounce error calibration of RX Data Pdu" UWORD OneToOne 1 100 0.00 65535.00 FORMAT "%8.2" ECU_ADDRESS 0x6002C7BA /end MEASUREMENT
/begin MEASUREMENT MoFFrm_Rx_DataPdu_INV_217h.cntrAlvErrDebCpl "Data PDu Structure for INV_217h / complement of alive counter debounce error calibration of RX Data Pdu" UWORD OneToOne 1 100 0.00 65535.00 FORMAT "%8.2" ECU_ADDRESS 0x6002BD96 /end MEASUREMENT
/begin MEASUREMENT MoFFrm_Rx_DataPdu_INV_217h.cntrAlvOld "Data PDu Structure for INV_217h / old alive counter calibration of RX Data Pdu" UBYTE OneToOne 1 100 0.00 255.0 FORMAT "%5.1" ECU_ADDRESS 0x6002C7BC /end MEASUREMENT
/begin MEASUREMENT MoFFrm_Rx_DataPdu_INV_217h.cntrAlvOldCpl "Data PDu Structure for INV_217h / Complement of old Alive counter calibration of RX Data Pdu" UBYTE OneToOne 1 100 0.00 255.0 FORMAT "%5.1" ECU_ADDRESS 0x6002BD98 /end MEASUREMENT
/begin MEASUREMENT MoFFrm_Rx_DataPdu_INV_217h.cntrCrcErrDeb "Data PDu Structure for INV_217h / Alive counter error debounce calibration of RX Data Pdu" UWORD OneToOne 1 100 0.00 65535.00 FORMAT "%8.2" ECU_ADDRESS 0x6002C7BE /end MEASUREMENT
/begin MEASUREMENT MoFFrm_Rx_DataPdu_INV_217h.cntrCrcErrDebCpl "Data PDu Structure for INV_217h / Complement of old Alive counter calibration of RX Data Pdu" UWORD OneToOne 1 100 0.00 65535.00 FORMAT "%8.2" ECU_ADDRESS 0x6002BD9A /end MEASUREMENT
/begin MEASUREMENT MoFFrm_Rx_DataPdu_INV_217h.cntrCycTi "Data PDu Structure for INV_217h / Alive counter debounce error calibration of RX Data Pdu" UWORD OneToOne 1 100 0.00 65535.00 FORMAT "%8.2" ECU_ADDRESS 0x6002C7C0 /end MEASUREMENT
/begin MEASUREMENT MoFFrm_Rx_DataPdu_INV_217h.cntrCycTiCpl "Data PDu Structure for INV_217h / Counter cyclic calibration of RX Data Pdu" UWORD OneToOne 1 100 0.00 65535.00 FORMAT "%8.2" ECU_ADDRESS 0x6002BD9C /end MEASUREMENT
/begin MEASUREMENT MoFFrm_Rx_DataPdu_INV_217h.cntrTiOutDeb "Data PDu Structure for INV_217h / Counter time out debounce of Rx data PDU" UWORD OneToOne 1 100 0.00 65535.00 FORMAT "%8.2" ECU_ADDRESS 0x6002C7C2 /end MEASUREMENT
/begin MEASUREMENT MoFFrm_Rx_DataPdu_INV_217h.cntrTiOutDebCpl "Data PDu Structure for INV_217h / Complement of Counter time out debounce of Rx data PDU" UWORD OneToOne 1 100 0.00 65535.00 FORMAT "%8.2" ECU_ADDRESS 0x6002BD9E /end MEASUREMENT
/begin MEASUREMENT MoFFrm_Rx_DataPdu_INV_217h.crcData "Data PDu Structure for INV_217h / CRC data of Rx data PDU" UWORD OneToOne 1 100 0.00 65535.00 FORMAT "%8.2" ECU_ADDRESS 0x6002C7C4 /end MEASUREMENT
/begin MEASUREMENT MoFFrm_Rx_DataPdu_INV_217h.crcDataCpl "Data PDu Structure for INV_217h / Comlement of CRC data of Rx data PDU" UWORD OneToOne 1 100 0.00 65535.00 FORMAT "%8.2" ECU_ADDRESS 0x6002BDA0 /end MEASUREMENT
/begin MEASUREMENT MoFFrm_Rx_DataPdu_INV_217h.flgPduUpd "Data PDu Structure for INV_217h / PDU update flag" UBYTE B_TRUE 1 100 0.00 1.00000000000 BIT_MASK 0x1 FORMAT "%13.11" ECU_ADDRESS 0x6002C7C6 /end MEASUREMENT
/begin MEASUREMENT MoFFrm_Rx_DataPdu_INV_217h.flgPduUpdCpl "Data PDu Structure for INV_217h / complement of PDU update flag" UBYTE B_TRUE 1 100 0.00 1.00000000000 BIT_MASK 0x1 FORMAT "%13.11" ECU_ADDRESS 0x6002BDA2 /end MEASUREMENT
/begin MEASUREMENT MoFFrm_Rx_DataPdu_INV_237.cntrAlvErrDeb "Data PDu Structure for INV_237 / Alive counter debounce error calibration of RX Data Pdu" UWORD OneToOne 1 100 0.00 65535.00 FORMAT "%8.2" ECU_ADDRESS 0x6002C7AC /end MEASUREMENT
/begin MEASUREMENT MoFFrm_Rx_DataPdu_INV_237.cntrAlvErrDebCpl "Data PDu Structure for INV_237 / complement of alive counter debounce error calibration of RX Data Pdu" UWORD OneToOne 1 100 0.00 65535.00 FORMAT "%8.2" ECU_ADDRESS 0x6002BD88 /end MEASUREMENT
/begin MEASUREMENT MoFFrm_Rx_DataPdu_INV_237.cntrAlvOld "Data PDu Structure for INV_237 / old alive counter calibration of RX Data Pdu" UBYTE OneToOne 1 100 0.00 255.0 FORMAT "%5.1" ECU_ADDRESS 0x6002C7AE /end MEASUREMENT
/begin MEASUREMENT MoFFrm_Rx_DataPdu_INV_237.cntrAlvOldCpl "Data PDu Structure for INV_237 / Complement of old Alive counter calibration of RX Data Pdu" UBYTE OneToOne 1 100 0.00 255.0 FORMAT "%5.1" ECU_ADDRESS 0x6002BD8A /end MEASUREMENT
/begin MEASUREMENT MoFFrm_Rx_DataPdu_INV_237.cntrCrcErrDeb "Data PDu Structure for INV_237 / Alive counter error debounce calibration of RX Data Pdu" UWORD OneToOne 1 100 0.00 65535.00 FORMAT "%8.2" ECU_ADDRESS 0x6002C7B0 /end MEASUREMENT
/begin MEASUREMENT MoFFrm_Rx_DataPdu_INV_237.cntrCrcErrDebCpl "Data PDu Structure for INV_237 / Complement of old Alive counter calibration of RX Data Pdu" UWORD OneToOne 1 100 0.00 65535.00 FORMAT "%8.2" ECU_ADDRESS 0x6002BD8C /end MEASUREMENT
/begin MEASUREMENT MoFFrm_Rx_DataPdu_INV_237.cntrCycTi "Data PDu Structure for INV_237 / Alive counter debounce error calibration of RX Data Pdu" UWORD OneToOne 1 100 0.00 65535.00 FORMAT "%8.2" ECU_ADDRESS 0x6002C7B2 /end MEASUREMENT
/begin MEASUREMENT MoFFrm_Rx_DataPdu_INV_237.cntrCycTiCpl "Data PDu Structure for INV_237 / Counter cyclic calibration of RX Data Pdu" UWORD OneToOne 1 100 0.00 65535.00 FORMAT "%8.2" ECU_ADDRESS 0x6002BD8E /end MEASUREMENT
/begin MEASUREMENT MoFFrm_Rx_DataPdu_INV_237.cntrTiOutDeb "Data PDu Structure for INV_237 / Counter time out debounce of Rx data PDU" UWORD OneToOne 1 100 0.00 65535.00 FORMAT "%8.2" ECU_ADDRESS 0x6002C7B4 /end MEASUREMENT
/begin MEASUREMENT MoFFrm_Rx_DataPdu_INV_237.cntrTiOutDebCpl "Data PDu Structure for INV_237 / Complement of Counter time out debounce of Rx data PDU" UWORD OneToOne 1 100 0.00 65535.00 FORMAT "%8.2" ECU_ADDRESS 0x6002BD90 /end MEASUREMENT
/begin MEASUREMENT MoFFrm_Rx_DataPdu_INV_237.crcData "Data PDu Structure for INV_237 / CRC data of Rx data PDU" UWORD OneToOne 1 100 0.00 65535.00 FORMAT "%8.2" ECU_ADDRESS 0x6002C7B6 /end MEASUREMENT
/begin MEASUREMENT MoFFrm_Rx_DataPdu_INV_237.crcDataCpl "Data PDu Structure for INV_237 / Comlement of CRC data of Rx data PDU" UWORD OneToOne 1 100 0.00 65535.00 FORMAT "%8.2" ECU_ADDRESS 0x6002BD92 /end MEASUREMENT
/begin MEASUREMENT MoFFrm_Rx_DataPdu_INV_237.flgPduUpd "Data PDu Structure for INV_237 / PDU update flag" UBYTE B_TRUE 1 100 0.00 1.00000000000 BIT_MASK 0x1 FORMAT "%13.11" ECU_ADDRESS 0x6002C7B8 /end MEASUREMENT
/begin MEASUREMENT MoFFrm_Rx_DataPdu_INV_237.flgPduUpdCpl "Data PDu Structure for INV_237 / complement of PDU update flag" UBYTE B_TRUE 1 100 0.00 1.00000000000 BIT_MASK 0x1 FORMAT "%13.11" ECU_ADDRESS 0x6002BD94 /end MEASUREMENT
/begin MEASUREMENT MoFFrm_Rx_DataPdu_INV_427h.cntrAlvErrDeb "Data PDu Structure for INV_427h / Alive counter debounce error calibration of RX Data Pdu" UWORD OneToOne 1 100 0.00 65535.00 FORMAT "%8.2" ECU_ADDRESS 0x6002C79E /end MEASUREMENT
/begin MEASUREMENT MoFFrm_Rx_DataPdu_INV_427h.cntrAlvErrDebCpl "Data PDu Structure for INV_427h / complement of alive counter debounce error calibration of RX Data Pdu" UWORD OneToOne 1 100 0.00 65535.00 FORMAT "%8.2" ECU_ADDRESS 0x6002BD7A /end MEASUREMENT
/begin MEASUREMENT MoFFrm_Rx_DataPdu_INV_427h.cntrAlvOld "Data PDu Structure for INV_427h / old alive counter calibration of RX Data Pdu" UBYTE OneToOne 1 100 0.00 255.0 FORMAT "%5.1" ECU_ADDRESS 0x6002C7A0 /end MEASUREMENT
/begin MEASUREMENT MoFFrm_Rx_DataPdu_INV_427h.cntrAlvOldCpl "Data PDu Structure for INV_427h / Complement of old Alive counter calibration of RX Data Pdu" UBYTE OneToOne 1 100 0.00 255.0 FORMAT "%5.1" ECU_ADDRESS 0x6002BD7C /end MEASUREMENT
/begin MEASUREMENT MoFFrm_Rx_DataPdu_INV_427h.cntrCrcErrDeb "Data PDu Structure for INV_427h / Alive counter error debounce calibration of RX Data Pdu" UWORD OneToOne 1 100 0.00 65535.00 FORMAT "%8.2" ECU_ADDRESS 0x6002C7A2 /end MEASUREMENT
/begin MEASUREMENT MoFFrm_Rx_DataPdu_INV_427h.cntrCrcErrDebCpl "Data PDu Structure for INV_427h / Complement of old Alive counter calibration of RX Data Pdu" UWORD OneToOne 1 100 0.00 65535.00 FORMAT "%8.2" ECU_ADDRESS 0x6002BD7E /end MEASUREMENT
/begin MEASUREMENT MoFFrm_Rx_DataPdu_INV_427h.cntrCycTi "Data PDu Structure for INV_427h / Alive counter debounce error calibration of RX Data Pdu" UWORD OneToOne 1 100 0.00 65535.00 FORMAT "%8.2" ECU_ADDRESS 0x6002C7A4 /end MEASUREMENT
/begin MEASUREMENT MoFFrm_Rx_DataPdu_INV_427h.cntrCycTiCpl "Data PDu Structure for INV_427h / Counter cyclic calibration of RX Data Pdu" UWORD OneToOne 1 100 0.00 65535.00 FORMAT "%8.2" ECU_ADDRESS 0x6002BD80 /end MEASUREMENT
/begin MEASUREMENT MoFFrm_Rx_DataPdu_INV_427h.cntrTiOutDeb "Data PDu Structure for INV_427h / Counter time out debounce of Rx data PDU" UWORD OneToOne 1 100 0.00 65535.00 FORMAT "%8.2" ECU_ADDRESS 0x6002C7A6 /end MEASUREMENT
/begin MEASUREMENT MoFFrm_Rx_DataPdu_INV_427h.cntrTiOutDebCpl "Data PDu Structure for INV_427h / Complement of Counter time out debounce of Rx data PDU" UWORD OneToOne 1 100 0.00 65535.00 FORMAT "%8.2" ECU_ADDRESS 0x6002BD82 /end MEASUREMENT
/begin MEASUREMENT MoFFrm_Rx_DataPdu_INV_427h.crcData "Data PDu Structure for INV_427h / CRC data of Rx data PDU" UWORD OneToOne 1 100 0.00 65535.00 FORMAT "%8.2" ECU_ADDRESS 0x6002C7A8 /end MEASUREMENT
/begin MEASUREMENT MoFFrm_Rx_DataPdu_INV_427h.crcDataCpl "Data PDu Structure for INV_427h / Comlement of CRC data of Rx data PDU" UWORD OneToOne 1 100 0.00 65535.00 FORMAT "%8.2" ECU_ADDRESS 0x6002BD84 /end MEASUREMENT
/begin MEASUREMENT MoFFrm_Rx_DataPdu_INV_427h.flgPduUpd "Data PDu Structure for INV_427h / PDU update flag" UBYTE B_TRUE 1 100 0.00 1.00000000000 BIT_MASK 0x1 FORMAT "%13.11" ECU_ADDRESS 0x6002C7AA /end MEASUREMENT
/begin MEASUREMENT MoFFrm_Rx_DataPdu_INV_427h.flgPduUpdCpl "Data PDu Structure for INV_427h / complement of PDU update flag" UBYTE B_TRUE 1 100 0.00 1.00000000000 BIT_MASK 0x1 FORMAT "%13.11" ECU_ADDRESS 0x6002BD86 /end MEASUREMENT
/begin MEASUREMENT MoFFrm_Rx_DataPdu_IS_DAT_ABR_50Dh.cntrAlvErrDeb "Data PDu Structure for IS_DAT_ABR_50Dh / Alive counter debounce error calibration of RX Data Pdu" UWORD OneToOne 1 100 0.00 65535.00 FORMAT "%8.2" ECU_ADDRESS 0x6002C790 /end MEASUREMENT
/begin MEASUREMENT MoFFrm_Rx_DataPdu_IS_DAT_ABR_50Dh.cntrAlvErrDebCpl "Data PDu Structure for IS_DAT_ABR_50Dh / complement of alive counter debounce error calibration of RX Data Pdu" UWORD OneToOne 1 100 0.00 65535.00 FORMAT "%8.2" ECU_ADDRESS 0x6002BD6C /end MEASUREMENT
/begin MEASUREMENT MoFFrm_Rx_DataPdu_IS_DAT_ABR_50Dh.cntrAlvOld "Data PDu Structure for IS_DAT_ABR_50Dh / old alive counter calibration of RX Data Pdu" UBYTE OneToOne 1 100 0.00 255.0 FORMAT "%5.1" ECU_ADDRESS 0x6002C792 /end MEASUREMENT
/begin MEASUREMENT MoFFrm_Rx_DataPdu_IS_DAT_ABR_50Dh.cntrAlvOldCpl "Data PDu Structure for IS_DAT_ABR_50Dh / Complement of old Alive counter calibration of RX Data Pdu" UBYTE OneToOne 1 100 0.00 255.0 FORMAT "%5.1" ECU_ADDRESS 0x6002BD6E /end MEASUREMENT
/begin MEASUREMENT MoFFrm_Rx_DataPdu_IS_DAT_ABR_50Dh.cntrCrcErrDeb "Data PDu Structure for IS_DAT_ABR_50Dh / Alive counter error debounce calibration of RX Data Pdu" UWORD OneToOne 1 100 0.00 65535.00 FORMAT "%8.2" ECU_ADDRESS 0x6002C794 /end MEASUREMENT
/begin MEASUREMENT MoFFrm_Rx_DataPdu_IS_DAT_ABR_50Dh.cntrCrcErrDebCpl "Data PDu Structure for IS_DAT_ABR_50Dh / Complement of old Alive counter calibration of RX Data Pdu" UWORD OneToOne 1 100 0.00 65535.00 FORMAT "%8.2" ECU_ADDRESS 0x6002BD70 /end MEASUREMENT
/begin MEASUREMENT MoFFrm_Rx_DataPdu_IS_DAT_ABR_50Dh.cntrCycTi "Data PDu Structure for IS_DAT_ABR_50Dh / Alive counter debounce error calibration of RX Data Pdu" UWORD OneToOne 1 100 0.00 65535.00 FORMAT "%8.2" ECU_ADDRESS 0x6002C796 /end MEASUREMENT
/begin MEASUREMENT MoFFrm_Rx_DataPdu_IS_DAT_ABR_50Dh.cntrCycTiCpl "Data PDu Structure for IS_DAT_ABR_50Dh / Counter cyclic calibration of RX Data Pdu" UWORD OneToOne 1 100 0.00 65535.00 FORMAT "%8.2" ECU_ADDRESS 0x6002BD72 /end MEASUREMENT
/begin MEASUREMENT MoFFrm_Rx_DataPdu_IS_DAT_ABR_50Dh.cntrTiOutDeb "Data PDu Structure for IS_DAT_ABR_50Dh / Counter time out debounce of Rx data PDU" UWORD OneToOne 1 100 0.00 65535.00 FORMAT "%8.2" ECU_ADDRESS 0x6002C798 /end MEASUREMENT
/begin MEASUREMENT MoFFrm_Rx_DataPdu_IS_DAT_ABR_50Dh.cntrTiOutDebCpl "Data PDu Structure for IS_DAT_ABR_50Dh / Complement of Counter time out debounce of Rx data PDU" UWORD OneToOne 1 100 0.00 65535.00 FORMAT "%8.2" ECU_ADDRESS 0x6002BD74 /end MEASUREMENT
/begin MEASUREMENT MoFFrm_Rx_DataPdu_IS_DAT_ABR_50Dh.crcData "Data PDu Structure for IS_DAT_ABR_50Dh / CRC data of Rx data PDU" UWORD OneToOne 1 100 0.00 65535.00 FORMAT "%8.2" ECU_ADDRESS 0x6002C79A /end MEASUREMENT
/begin MEASUREMENT MoFFrm_Rx_DataPdu_IS_DAT_ABR_50Dh.crcDataCpl "Data PDu Structure for IS_DAT_ABR_50Dh / Comlement of CRC data of Rx data PDU" UWORD OneToOne 1 100 0.00 65535.00 FORMAT "%8.2" ECU_ADDRESS 0x6002BD76 /end MEASUREMENT
/begin MEASUREMENT MoFFrm_Rx_DataPdu_IS_DAT_ABR_50Dh.flgPduUpd "Data PDu Structure for IS_DAT_ABR_50Dh / PDU update flag" UBYTE B_TRUE 1 100 0.00 1.00000000000 BIT_MASK 0x1 FORMAT "%13.11" ECU_ADDRESS 0x6002C79C /end MEASUREMENT
/begin MEASUREMENT MoFFrm_Rx_DataPdu_IS_DAT_ABR_50Dh.flgPduUpdCpl "Data PDu Structure for IS_DAT_ABR_50Dh / complement of PDU update flag" UBYTE B_TRUE 1 100 0.00 1.00000000000 BIT_MASK 0x1 FORMAT "%13.11" ECU_ADDRESS 0x6002BD78 /end MEASUREMENT
/begin MEASUREMENT MoFFrm_Rx_DataPdu_IS_DAT_BSI_412h.cntrAlvErrDeb "Data PDu Structure forIS_DAT_BSI_412h / Alive counter debounce error calibration of RX Data Pdu" UWORD OneToOne 1 100 0.00 65535.00 FORMAT "%8.2" ECU_ADDRESS 0x6002C782 /end MEASUREMENT
/begin MEASUREMENT MoFFrm_Rx_DataPdu_IS_DAT_BSI_412h.cntrAlvErrDebCpl "Data PDu Structure forIS_DAT_BSI_412h / complement of alive counter debounce error calibration of RX Data Pdu" UWORD OneToOne 1 100 0.00 65535.00 FORMAT "%8.2" ECU_ADDRESS 0x6002BD5E /end MEASUREMENT
/begin MEASUREMENT MoFFrm_Rx_DataPdu_IS_DAT_BSI_412h.cntrAlvOld "Data PDu Structure forIS_DAT_BSI_412h / old alive counter calibration of RX Data Pdu" UBYTE OneToOne 1 100 0.00 255.0 FORMAT "%5.1" ECU_ADDRESS 0x6002C784 /end MEASUREMENT
/begin MEASUREMENT MoFFrm_Rx_DataPdu_IS_DAT_BSI_412h.cntrAlvOldCpl "Data PDu Structure forIS_DAT_BSI_412h / Complement of old Alive counter calibration of RX Data Pdu" UBYTE OneToOne 1 100 0.00 255.0 FORMAT "%5.1" ECU_ADDRESS 0x6002BD60 /end MEASUREMENT
/begin MEASUREMENT MoFFrm_Rx_DataPdu_IS_DAT_BSI_412h.cntrCrcErrDeb "Data PDu Structure forIS_DAT_BSI_412h / Alive counter error debounce calibration of RX Data Pdu" UWORD OneToOne 1 100 0.00 65535.00 FORMAT "%8.2" ECU_ADDRESS 0x6002C786 /end MEASUREMENT
/begin MEASUREMENT MoFFrm_Rx_DataPdu_IS_DAT_BSI_412h.cntrCrcErrDebCpl "Data PDu Structure forIS_DAT_BSI_412h / Complement of old Alive counter calibration of RX Data Pdu" UWORD OneToOne 1 100 0.00 65535.00 FORMAT "%8.2" ECU_ADDRESS 0x6002BD62 /end MEASUREMENT
/begin MEASUREMENT MoFFrm_Rx_DataPdu_IS_DAT_BSI_412h.cntrCycTi "Data PDu Structure forIS_DAT_BSI_412h / Alive counter debounce error calibration of RX Data Pdu" UWORD OneToOne 1 100 0.00 65535.00 FORMAT "%8.2" ECU_ADDRESS 0x6002C788 /end MEASUREMENT
/begin MEASUREMENT MoFFrm_Rx_DataPdu_IS_DAT_BSI_412h.cntrCycTiCpl "Data PDu Structure forIS_DAT_BSI_412h / Counter cyclic calibration of RX Data Pdu" UWORD OneToOne 1 100 0.00 65535.00 FORMAT "%8.2" ECU_ADDRESS 0x6002BD64 /end MEASUREMENT
/begin MEASUREMENT MoFFrm_Rx_DataPdu_IS_DAT_BSI_412h.cntrTiOutDeb "Data PDu Structure forIS_DAT_BSI_412h / Counter time out debounce of Rx data PDU" UWORD OneToOne 1 100 0.00 65535.00 FORMAT "%8.2" ECU_ADDRESS 0x6002C78A /end MEASUREMENT
/begin MEASUREMENT MoFFrm_Rx_DataPdu_IS_DAT_BSI_412h.cntrTiOutDebCpl "Data PDu Structure forIS_DAT_BSI_412h / Complement of Counter time out debounce of Rx data PDU" UWORD OneToOne 1 100 0.00 65535.00 FORMAT "%8.2" ECU_ADDRESS 0x6002BD66 /end MEASUREMENT
/begin MEASUREMENT MoFFrm_Rx_DataPdu_IS_DAT_BSI_412h.crcData "Data PDu Structure forIS_DAT_BSI_412h / CRC data of Rx data PDU" UWORD OneToOne 1 100 0.00 65535.00 FORMAT "%8.2" ECU_ADDRESS 0x6002C78C /end MEASUREMENT
/begin MEASUREMENT MoFFrm_Rx_DataPdu_IS_DAT_BSI_412h.crcDataCpl "Data PDu Structure forIS_DAT_BSI_412h / Comlement of CRC data of Rx data PDU" UWORD OneToOne 1 100 0.00 65535.00 FORMAT "%8.2" ECU_ADDRESS 0x6002BD68 /end MEASUREMENT
/begin MEASUREMENT MoFFrm_Rx_DataPdu_IS_DAT_BSI_412h.flgPduUpd "Data PDu Structure forIS_DAT_BSI_412h / PDU update flag" UBYTE B_TRUE 1 100 0.00 1.00000000000 BIT_MASK 0x1 FORMAT "%13.11" ECU_ADDRESS 0x6002C78E /end MEASUREMENT
/begin MEASUREMENT MoFFrm_Rx_DataPdu_IS_DAT_BSI_412h.flgPduUpdCpl "Data PDu Structure forIS_DAT_BSI_412h / complement of PDU update flag" UBYTE B_TRUE 1 100 0.00 1.00000000000 BIT_MASK 0x1 FORMAT "%13.11" ECU_ADDRESS 0x6002BD6A /end MEASUREMENT
/begin MEASUREMENT MoFFrm_Rx_DataPdu_IS_DYN_ABR_38Dh.cntrAlvErrDeb "Data PDu Structure for IS_DYN_ABR_38Dh / Alive counter debounce error calibration of RX Data Pdu" UWORD OneToOne 1 100 0.00 65535.00 FORMAT "%8.2" ECU_ADDRESS 0x6002C774 /end MEASUREMENT
/begin MEASUREMENT MoFFrm_Rx_DataPdu_IS_DYN_ABR_38Dh.cntrAlvErrDebCpl "Data PDu Structure for IS_DYN_ABR_38Dh / complement of alive counter debounce error calibration of RX Data Pdu" UWORD OneToOne 1 100 0.00 65535.00 FORMAT "%8.2" ECU_ADDRESS 0x6002BD50 /end MEASUREMENT
/begin MEASUREMENT MoFFrm_Rx_DataPdu_IS_DYN_ABR_38Dh.cntrAlvOld "Data PDu Structure for IS_DYN_ABR_38Dh / old alive counter calibration of RX Data Pdu" UBYTE OneToOne 1 100 0.00 255.0 FORMAT "%5.1" ECU_ADDRESS 0x6002C776 /end MEASUREMENT
/begin MEASUREMENT MoFFrm_Rx_DataPdu_IS_DYN_ABR_38Dh.cntrAlvOldCpl "Data PDu Structure for IS_DYN_ABR_38Dh / Complement of old Alive counter calibration of RX Data Pdu" UBYTE OneToOne 1 100 0.00 255.0 FORMAT "%5.1" ECU_ADDRESS 0x6002BD52 /end MEASUREMENT
/begin MEASUREMENT MoFFrm_Rx_DataPdu_IS_DYN_ABR_38Dh.cntrCrcErrDeb "Data PDu Structure for IS_DYN_ABR_38Dh / Alive counter error debounce calibration of RX Data Pdu" UWORD OneToOne 1 100 0.00 65535.00 FORMAT "%8.2" ECU_ADDRESS 0x6002C778 /end MEASUREMENT
/begin MEASUREMENT MoFFrm_Rx_DataPdu_IS_DYN_ABR_38Dh.cntrCrcErrDebCpl "Data PDu Structure for IS_DYN_ABR_38Dh / Complement of old Alive counter calibration of RX Data Pdu" UWORD OneToOne 1 100 0.00 65535.00 FORMAT "%8.2" ECU_ADDRESS 0x6002BD54 /end MEASUREMENT
/begin MEASUREMENT MoFFrm_Rx_DataPdu_IS_DYN_ABR_38Dh.cntrCycTi "Data PDu Structure for IS_DYN_ABR_38Dh / Alive counter debounce error calibration of RX Data Pdu" UWORD OneToOne 1 100 0.00 65535.00 FORMAT "%8.2" ECU_ADDRESS 0x6002C77A /end MEASUREMENT
/begin MEASUREMENT MoFFrm_Rx_DataPdu_IS_DYN_ABR_38Dh.cntrCycTiCpl "Data PDu Structure for IS_DYN_ABR_38Dh / Counter cyclic calibration of RX Data Pdu" UWORD OneToOne 1 100 0.00 65535.00 FORMAT "%8.2" ECU_ADDRESS 0x6002BD56 /end MEASUREMENT
/begin MEASUREMENT MoFFrm_Rx_DataPdu_IS_DYN_ABR_38Dh.cntrTiOutDeb "Data PDu Structure for IS_DYN_ABR_38Dh / Counter time out debounce of Rx data PDU" UWORD OneToOne 1 100 0.00 65535.00 FORMAT "%8.2" ECU_ADDRESS 0x6002C77C /end MEASUREMENT
/begin MEASUREMENT MoFFrm_Rx_DataPdu_IS_DYN_ABR_38Dh.cntrTiOutDebCpl "Data PDu Structure for IS_DYN_ABR_38Dh / Complement of Counter time out debounce of Rx data PDU" UWORD OneToOne 1 100 0.00 65535.00 FORMAT "%8.2" ECU_ADDRESS 0x6002BD58 /end MEASUREMENT
/begin MEASUREMENT MoFFrm_Rx_DataPdu_IS_DYN_ABR_38Dh.crcData "Data PDu Structure for IS_DYN_ABR_38Dh / CRC data of Rx data PDU" UWORD OneToOne 1 100 0.00 65535.00 FORMAT "%8.2" ECU_ADDRESS 0x6002C77E /end MEASUREMENT
/begin MEASUREMENT MoFFrm_Rx_DataPdu_IS_DYN_ABR_38Dh.crcDataCpl "Data PDu Structure for IS_DYN_ABR_38Dh / Comlement of CRC data of Rx data PDU" UWORD OneToOne 1 100 0.00 65535.00 FORMAT "%8.2" ECU_ADDRESS 0x6002BD5A /end MEASUREMENT
/begin MEASUREMENT MoFFrm_Rx_DataPdu_IS_DYN_ABR_38Dh.flgPduUpd "Data PDu Structure for IS_DYN_ABR_38Dh / PDU update flag" UBYTE B_TRUE 1 100 0.00 1.00000000000 BIT_MASK 0x1 FORMAT "%13.11" ECU_ADDRESS 0x6002C780 /end MEASUREMENT
/begin MEASUREMENT MoFFrm_Rx_DataPdu_IS_DYN_ABR_38Dh.flgPduUpdCpl "Data PDu Structure for IS_DYN_ABR_38Dh / complement of PDU update flag" UBYTE B_TRUE 1 100 0.00 1.00000000000 BIT_MASK 0x1 FORMAT "%13.11" ECU_ADDRESS 0x6002BD5C /end MEASUREMENT
/begin MEASUREMENT MoFFrm_Rx_DataPdu_PDU_BusVoltages_308.cntrAlvErrDeb "Data PDu Structure for PDU_BusVoltages_308 / Alive counter debounce error calibration of RX Data Pdu" UWORD OneToOne 1 100 0.00 65535.00 FORMAT "%8.2" ECU_ADDRESS 0x6002C766 /end MEASUREMENT
/begin MEASUREMENT MoFFrm_Rx_DataPdu_PDU_BusVoltages_308.cntrAlvErrDebCpl "Data PDu Structure for PDU_BusVoltages_308 / complement of alive counter debounce error calibration of RX Data Pdu" UWORD OneToOne 1 100 0.00 65535.00 FORMAT "%8.2" ECU_ADDRESS 0x6002BD42 /end MEASUREMENT
/begin MEASUREMENT MoFFrm_Rx_DataPdu_PDU_BusVoltages_308.cntrAlvOld "Data PDu Structure for PDU_BusVoltages_308 / old alive counter calibration of RX Data Pdu" UBYTE OneToOne 1 100 0.00 255.0 FORMAT "%5.1" ECU_ADDRESS 0x6002C768 /end MEASUREMENT
/begin MEASUREMENT MoFFrm_Rx_DataPdu_PDU_BusVoltages_308.cntrAlvOldCpl "Data PDu Structure for PDU_BusVoltages_308 / Complement of old Alive counter calibration of RX Data Pdu" UBYTE OneToOne 1 100 0.00 255.0 FORMAT "%5.1" ECU_ADDRESS 0x6002BD44 /end MEASUREMENT
/begin MEASUREMENT MoFFrm_Rx_DataPdu_PDU_BusVoltages_308.cntrCrcErrDeb "Data PDu Structure for PDU_BusVoltages_308 / Alive counter error debounce calibration of RX Data Pdu" UWORD OneToOne 1 100 0.00 65535.00 FORMAT "%8.2" ECU_ADDRESS 0x6002C76A /end MEASUREMENT
/begin MEASUREMENT MoFFrm_Rx_DataPdu_PDU_BusVoltages_308.cntrCrcErrDebCpl "Data PDu Structure for PDU_BusVoltages_308 / Complement of old Alive counter calibration of RX Data Pdu" UWORD OneToOne 1 100 0.00 65535.00 FORMAT "%8.2" ECU_ADDRESS 0x6002BD46 /end MEASUREMENT
/begin MEASUREMENT MoFFrm_Rx_DataPdu_PDU_BusVoltages_308.cntrCycTi "Data PDu Structure for PDU_BusVoltages_308 / Alive counter debounce error calibration of RX Data Pdu" UWORD OneToOne 1 100 0.00 65535.00 FORMAT "%8.2" ECU_ADDRESS 0x6002C76C /end MEASUREMENT
/begin MEASUREMENT MoFFrm_Rx_DataPdu_PDU_BusVoltages_308.cntrCycTiCpl "Data PDu Structure for PDU_BusVoltages_308 / Counter cyclic calibration of RX Data Pdu" UWORD OneToOne 1 100 0.00 65535.00 FORMAT "%8.2" ECU_ADDRESS 0x6002BD48 /end MEASUREMENT
/begin MEASUREMENT MoFFrm_Rx_DataPdu_PDU_BusVoltages_308.cntrTiOutDeb "Data PDu Structure for PDU_BusVoltages_308 / Counter time out debounce of Rx data PDU" UWORD OneToOne 1 100 0.00 65535.00 FORMAT "%8.2" ECU_ADDRESS 0x6002C76E /end MEASUREMENT
/begin MEASUREMENT MoFFrm_Rx_DataPdu_PDU_BusVoltages_308.cntrTiOutDebCpl "Data PDu Structure for PDU_BusVoltages_308 / Complement of Counter time out debounce of Rx data PDU" UWORD OneToOne 1 100 0.00 65535.00 FORMAT "%8.2" ECU_ADDRESS 0x6002BD4A /end MEASUREMENT
/begin MEASUREMENT MoFFrm_Rx_DataPdu_PDU_BusVoltages_308.crcData "Data PDu Structure for PDU_BusVoltages_308 / CRC data of Rx data PDU" UWORD OneToOne 1 100 0.00 65535.00 FORMAT "%8.2" ECU_ADDRESS 0x6002C770 /end MEASUREMENT
/begin MEASUREMENT MoFFrm_Rx_DataPdu_PDU_BusVoltages_308.crcDataCpl "Data PDu Structure for PDU_BusVoltages_308 / Comlement of CRC data of Rx data PDU" UWORD OneToOne 1 100 0.00 65535.00 FORMAT "%8.2" ECU_ADDRESS 0x6002BD4C /end MEASUREMENT
/begin MEASUREMENT MoFFrm_Rx_DataPdu_PDU_BusVoltages_308.flgPduUpd "Data PDu Structure for PDU_BusVoltages_308 / PDU update flag" UBYTE B_TRUE 1 100 0.00 1.00000000000 BIT_MASK 0x1 FORMAT "%13.11" ECU_ADDRESS 0x6002C772 /end MEASUREMENT
/begin MEASUREMENT MoFFrm_Rx_DataPdu_PDU_BusVoltages_308.flgPduUpdCpl "Data PDu Structure for PDU_BusVoltages_308 / complement of PDU update flag" UBYTE B_TRUE 1 100 0.00 1.00000000000 BIT_MASK 0x1 FORMAT "%13.11" ECU_ADDRESS 0x6002BD4E /end MEASUREMENT
/begin MEASUREMENT MoFFrm_Rx_DataPdu_VCU_AIRBAG_351h.cntrAlvErrDeb "Data PDu Structure for VCU_AIRBAG_351h / Alive counter debounce error calibration of RX Data Pdu" UWORD OneToOne 1 100 0.00 65535.00 FORMAT "%8.2" ECU_ADDRESS 0x6002C758 /end MEASUREMENT
/begin MEASUREMENT MoFFrm_Rx_DataPdu_VCU_AIRBAG_351h.cntrAlvErrDebCpl "Data PDu Structure for VCU_AIRBAG_351h / complement of alive counter debounce error calibration of RX Data Pdu" UWORD OneToOne 1 100 0.00 65535.00 FORMAT "%8.2" ECU_ADDRESS 0x6002BD34 /end MEASUREMENT
/begin MEASUREMENT MoFFrm_Rx_DataPdu_VCU_AIRBAG_351h.cntrAlvOld "Data PDu Structure for VCU_AIRBAG_351h / old alive counter calibration of RX Data Pdu" UBYTE OneToOne 1 100 0.00 255.0 FORMAT "%5.1" ECU_ADDRESS 0x6002C75A /end MEASUREMENT
/begin MEASUREMENT MoFFrm_Rx_DataPdu_VCU_AIRBAG_351h.cntrAlvOldCpl "Data PDu Structure for VCU_AIRBAG_351h / Complement of old Alive counter calibration of RX Data Pdu" UBYTE OneToOne 1 100 0.00 255.0 FORMAT "%5.1" ECU_ADDRESS 0x6002BD36 /end MEASUREMENT
/begin MEASUREMENT MoFFrm_Rx_DataPdu_VCU_AIRBAG_351h.cntrCrcErrDeb "Data PDu Structure for VCU_AIRBAG_351h / Alive counter error debounce calibration of RX Data Pdu" UWORD OneToOne 1 100 0.00 65535.00 FORMAT "%8.2" ECU_ADDRESS 0x6002C75C /end MEASUREMENT
/begin MEASUREMENT MoFFrm_Rx_DataPdu_VCU_AIRBAG_351h.cntrCrcErrDebCpl "Data PDu Structure for VCU_AIRBAG_351h / Complement of old Alive counter calibration of RX Data Pdu" UWORD OneToOne 1 100 0.00 65535.00 FORMAT "%8.2" ECU_ADDRESS 0x6002BD38 /end MEASUREMENT
/begin MEASUREMENT MoFFrm_Rx_DataPdu_VCU_AIRBAG_351h.cntrCycTi "Data PDu Structure for VCU_AIRBAG_351h / Alive counter debounce error calibration of RX Data Pdu" UWORD OneToOne 1 100 0.00 65535.00 FORMAT "%8.2" ECU_ADDRESS 0x6002C75E /end MEASUREMENT
/begin MEASUREMENT MoFFrm_Rx_DataPdu_VCU_AIRBAG_351h.cntrCycTiCpl "Data PDu Structure for VCU_AIRBAG_351h / Counter cyclic calibration of RX Data Pdu" UWORD OneToOne 1 100 0.00 65535.00 FORMAT "%8.2" ECU_ADDRESS 0x6002BD3A /end MEASUREMENT
/begin MEASUREMENT MoFFrm_Rx_DataPdu_VCU_AIRBAG_351h.cntrTiOutDeb "Data PDu Structure for VCU_AIRBAG_351h / Counter time out debounce of Rx data PDU" UWORD OneToOne 1 100 0.00 65535.00 FORMAT "%8.2" ECU_ADDRESS 0x6002C760 /end MEASUREMENT
/begin MEASUREMENT MoFFrm_Rx_DataPdu_VCU_AIRBAG_351h.cntrTiOutDebCpl "Data PDu Structure for VCU_AIRBAG_351h / Complement of Counter time out debounce of Rx data PDU" UWORD OneToOne 1 100 0.00 65535.00 FORMAT "%8.2" ECU_ADDRESS 0x6002BD3C /end MEASUREMENT
/begin MEASUREMENT MoFFrm_Rx_DataPdu_VCU_AIRBAG_351h.crcData "Data PDu Structure for VCU_AIRBAG_351h / CRC data of Rx data PDU" UWORD OneToOne 1 100 0.00 65535.00 FORMAT "%8.2" ECU_ADDRESS 0x6002C762 /end MEASUREMENT
/begin MEASUREMENT MoFFrm_Rx_DataPdu_VCU_AIRBAG_351h.crcDataCpl "Data PDu Structure for VCU_AIRBAG_351h / Comlement of CRC data of Rx data PDU" UWORD OneToOne 1 100 0.00 65535.00 FORMAT "%8.2" ECU_ADDRESS 0x6002BD3E /end MEASUREMENT
/begin MEASUREMENT MoFFrm_Rx_DataPdu_VCU_AIRBAG_351h.flgPduUpd "Data PDu Structure for VCU_AIRBAG_351h / PDU update flag" UBYTE B_TRUE 1 100 0.00 1.00000000000 BIT_MASK 0x1 FORMAT "%13.11" ECU_ADDRESS 0x6002C764 /end MEASUREMENT
/begin MEASUREMENT MoFFrm_Rx_DataPdu_VCU_AIRBAG_351h.flgPduUpdCpl "Data PDu Structure for VCU_AIRBAG_351h / complement of PDU update flag" UBYTE B_TRUE 1 100 0.00 1.00000000000 BIT_MASK 0x1 FORMAT "%13.11" ECU_ADDRESS 0x6002BD40 /end MEASUREMENT
/begin MEASUREMENT MoFFrm_Rx_DataPdu_VCU_eBCCM_432h.cntrAlvErrDeb "MoFFrm_Rx / Alive counter debounce error calibration of RX Data Pdu" UWORD OneToOne 1 100 0.00 65535.00 FORMAT "%8.2" ECU_ADDRESS 0x6002C74A /end MEASUREMENT
/begin MEASUREMENT MoFFrm_Rx_DataPdu_VCU_eBCCM_432h.cntrAlvErrDebCpl "MoFFrm_Rx / complement of alive counter debounce error calibration of RX Data Pdu" UWORD OneToOne 1 100 0.00 65535.00 FORMAT "%8.2" ECU_ADDRESS 0x6002BD26 /end MEASUREMENT
/begin MEASUREMENT MoFFrm_Rx_DataPdu_VCU_eBCCM_432h.cntrAlvOld "MoFFrm_Rx / old alive counter calibration of RX Data Pdu" UBYTE OneToOne 1 100 0.00 255.0 FORMAT "%5.1" ECU_ADDRESS 0x6002C74C /end MEASUREMENT
/begin MEASUREMENT MoFFrm_Rx_DataPdu_VCU_eBCCM_432h.cntrAlvOldCpl "MoFFrm_Rx / Complement of old Alive counter calibration of RX Data Pdu" UBYTE OneToOne 1 100 0.00 255.0 FORMAT "%5.1" ECU_ADDRESS 0x6002BD28 /end MEASUREMENT
/begin MEASUREMENT MoFFrm_Rx_DataPdu_VCU_eBCCM_432h.cntrCrcErrDeb "MoFFrm_Rx / Alive counter error debounce calibration of RX Data Pdu" UWORD OneToOne 1 100 0.00 65535.00 FORMAT "%8.2" ECU_ADDRESS 0x6002C74E /end MEASUREMENT
/begin MEASUREMENT MoFFrm_Rx_DataPdu_VCU_eBCCM_432h.cntrCrcErrDebCpl "MoFFrm_Rx / Complement of old Alive counter calibration of RX Data Pdu" UWORD OneToOne 1 100 0.00 65535.00 FORMAT "%8.2" ECU_ADDRESS 0x6002BD2A /end MEASUREMENT
/begin MEASUREMENT MoFFrm_Rx_DataPdu_VCU_eBCCM_432h.cntrCycTi "MoFFrm_Rx / Alive counter debounce error calibration of RX Data Pdu" UWORD OneToOne 1 100 0.00 65535.00 FORMAT "%8.2" ECU_ADDRESS 0x6002C750 /end MEASUREMENT
/begin MEASUREMENT MoFFrm_Rx_DataPdu_VCU_eBCCM_432h.cntrCycTiCpl "MoFFrm_Rx / Counter cyclic calibration of RX Data Pdu" UWORD OneToOne 1 100 0.00 65535.00 FORMAT "%8.2" ECU_ADDRESS 0x6002BD2C /end MEASUREMENT
/begin MEASUREMENT MoFFrm_Rx_DataPdu_VCU_eBCCM_432h.cntrTiOutDeb "MoFFrm_Rx / Counter time out debounce of Rx data PDU" UWORD OneToOne 1 100 0.00 65535.00 FORMAT "%8.2" ECU_ADDRESS 0x6002C752 /end MEASUREMENT
/begin MEASUREMENT MoFFrm_Rx_DataPdu_VCU_eBCCM_432h.cntrTiOutDebCpl "MoFFrm_Rx / Complement of Counter time out debounce of Rx data PDU" UWORD OneToOne 1 100 0.00 65535.00 FORMAT "%8.2" ECU_ADDRESS 0x6002BD2E /end MEASUREMENT
/begin MEASUREMENT MoFFrm_Rx_DataPdu_VCU_eBCCM_432h.crcData "MoFFrm_Rx / CRC data of Rx data PDU" UWORD OneToOne 1 100 0.00 65535.00 FORMAT "%8.2" ECU_ADDRESS 0x6002C754 /end MEASUREMENT
/begin MEASUREMENT MoFFrm_Rx_DataPdu_VCU_eBCCM_432h.crcDataCpl "MoFFrm_Rx / Comlement of CRC data of Rx data PDU" UWORD OneToOne 1 100 0.00 65535.00 FORMAT "%8.2" ECU_ADDRESS 0x6002BD30 /end MEASUREMENT
/begin MEASUREMENT MoFFrm_Rx_DataPdu_VCU_eBCCM_432h.flgPduUpd "MoFFrm_Rx / PDU update flag" UBYTE B_TRUE 1 100 0.00 1.00000000000 BIT_MASK 0x1 FORMAT "%13.11" ECU_ADDRESS 0x6002C756 /end MEASUREMENT
/begin MEASUREMENT MoFFrm_Rx_DataPdu_VCU_eBCCM_432h.flgPduUpdCpl "MoFFrm_Rx / complement of PDU update flag" UBYTE B_TRUE 1 100 0.00 1.00000000000 BIT_MASK 0x1 FORMAT "%13.11" ECU_ADDRESS 0x6002BD32 /end MEASUREMENT
/begin MEASUREMENT MoFFrm_Rx_mirrBuf "Mirror buffer for CAN for RX internal caculation" UBYTE OneToOne 1 100 0.00 255.0 FORMAT "%5.1" MATRIX_DIM 8 ECU_ADDRESS 0x6002C87A
 /begin IF_DATA XCPplus 0x0102
  /begin DAQ_EVENT VARIABLE /end DAQ_EVENT
 /end IF_DATA
/end MEASUREMENT
/begin MEASUREMENT MoFFrm_Rx_rawCONTACT_FREIN1 "Raw Variable for CONTACT_FREIN1" UBYTE OneToOne 1 100 0.00 255.0 FORMAT "%5.1" ECU_ADDRESS 0x6002C879
 /begin IF_DATA XCPplus 0x0102
  /begin DAQ_EVENT VARIABLE /end DAQ_EVENT
 /end IF_DATA
/end MEASUREMENT
/begin MEASUREMENT MoFFrm_Rx_rawCONTACT_FREIN_PRK "Raw value for PDU CONTACT_FREIN_PRK" UBYTE OneToOne 1 100 0.00 255.0 FORMAT "%5.1" ECU_ADDRESS 0x6002C878
 /begin IF_DATA XCPplus 0x0102
  /begin DAQ_EVENT VARIABLE /end DAQ_EVENT
 /end IF_DATA
/end MEASUREMENT
/begin MEASUREMENT MoFFrm_Rx_rawCRASH_AIRBAG "Raw value for PDU CRASH_AIRBAG" UBYTE OneToOne 1 100 0.00 255.0 FORMAT "%5.1" ECU_ADDRESS 0x6002C877
 /begin IF_DATA XCPplus 0x0102
  /begin DAQ_EVENT VARIABLE /end DAQ_EVENT
 /end IF_DATA
/end MEASUREMENT
/begin MEASUREMENT MoFFrm_Rx_rawCRASH_AIRBAG_COMPLI "CRASH_AIRBAG_COMPLI ra data" UBYTE OneToOne 1 100 0.00 255.0 FORMAT "%5.1" ECU_ADDRESS 0x6002C876
 /begin IF_DATA XCPplus 0x0102
  /begin DAQ_EVENT VARIABLE /end DAQ_EVENT
 /end IF_DATA
/end MEASUREMENT
/begin MEASUREMENT MoFFrm_Rx_rawDCDC_FAULT_LEVEL "Raw value for PDU DCDC_FAULT_LEVEL" UBYTE OneToOne 1 100 0.00 255.0 FORMAT "%5.1" ECU_ADDRESS 0x6002C875
 /begin IF_DATA XCPplus 0x0102
  /begin DAQ_EVENT VARIABLE /end DAQ_EVENT
 /end IF_DATA
/end MEASUREMENT
/begin MEASUREMENT MoFFrm_Rx_rawDCDC_IN_VOLTAGE "" UWORD OneToOne 1 100 0.00 65535.00 FORMAT "%8.2" ECU_ADDRESS 0x6002C824
 /begin IF_DATA XCPplus 0x0102
  /begin DAQ_EVENT VARIABLE /end DAQ_EVENT
 /end IF_DATA
/end MEASUREMENT
/begin MEASUREMENT MoFFrm_Rx_rawDRIVER_DOOR_INFO "Raw value for PDU DRIVER_DOOR_INFO" UBYTE OneToOne 1 100 0.00 255.0 FORMAT "%5.1" ECU_ADDRESS 0x6002C874
 /begin IF_DATA XCPplus 0x0102
  /begin DAQ_EVENT VARIABLE /end DAQ_EVENT
 /end IF_DATA
/end MEASUREMENT
/begin MEASUREMENT MoFFrm_Rx_rawDRV_INFO_DRVR_SEAT_BELT "Raw value for PDU DRV_INFO_DRVR_SEAT_BELT" UBYTE OneToOne 1 100 0.00 255.0 FORMAT "%5.1" ECU_ADDRESS 0x6002C873
 /begin IF_DATA XCPplus 0x0102
  /begin DAQ_EVENT VARIABLE /end DAQ_EVENT
 /end IF_DATA
/end MEASUREMENT
/begin MEASUREMENT MoFFrm_Rx_rawHVBAT_CONNECT_STS "Raw value of signal HVBAT_CONNECT_STS" UBYTE OneToOne 1 100 0.00 255.0 FORMAT "%5.1" ECU_ADDRESS 0x6002C872
 /begin IF_DATA XCPplus 0x0102
  /begin DAQ_EVENT VARIABLE /end DAQ_EVENT
 /end IF_DATA
/end MEASUREMENT
/begin MEASUREMENT MoFFrm_Rx_rawHVBAT_FAULT "Raw value of signal HVBAT_FAULT" UBYTE OneToOne 1 100 0.00 255.0 FORMAT "%5.1" ECU_ADDRESS 0x6002C871
 /begin IF_DATA XCPplus 0x0102
  /begin DAQ_EVENT VARIABLE /end DAQ_EVENT
 /end IF_DATA
/end MEASUREMENT
/begin MEASUREMENT MoFFrm_Rx_rawHVBAT_HVIL_STS "Raw value for PDU HVBAT_HVIL_STS" UBYTE OneToOne 1 100 0.00 255.0 FORMAT "%5.1" ECU_ADDRESS 0x6002C870
 /begin IF_DATA XCPplus 0x0102
  /begin DAQ_EVENT VARIABLE /end DAQ_EVENT
 /end IF_DATA
/end MEASUREMENT
/begin MEASUREMENT MoFFrm_Rx_rawINV_DC_BUS_VOLTAGE "" UWORD OneToOne 1 100 0.00 65535.00 FORMAT "%8.2" ECU_ADDRESS 0x6002C822
 /begin IF_DATA XCPplus 0x0102
  /begin DAQ_EVENT VARIABLE /end DAQ_EVENT
 /end IF_DATA
/end MEASUREMENT
/begin MEASUREMENT MoFFrm_Rx_rawINV_FAULT_LEVEL "Raw value of signal INV_FAULT_LEVEL" UBYTE OneToOne 1 100 0.00 255.0 FORMAT "%5.1" ECU_ADDRESS 0x6002C86F
 /begin IF_DATA XCPplus 0x0102
  /begin DAQ_EVENT VARIABLE /end DAQ_EVENT
 /end IF_DATA
/end MEASUREMENT
/begin MEASUREMENT MoFFrm_Rx_rawINV_HILLHOLD_STATUS "Raw value for PDU INV_HILLHOLD_STATUS" UBYTE OneToOne 1 100 0.00 255.0 FORMAT "%5.1" ECU_ADDRESS 0x6002C86E
 /begin IF_DATA XCPplus 0x0102
  /begin DAQ_EVENT VARIABLE /end DAQ_EVENT
 /end IF_DATA
/end MEASUREMENT
/begin MEASUREMENT MoFFrm_Rx_rawINV_MTR_ACTUAL_TRQ "Raw value for PDU INV_MTR_ACTUAL_TRQ" SWORD OneToOne 1 100 -32768.00 32767.00 FORMAT "%8.2" ECU_ADDRESS 0x6002C820
 /begin IF_DATA XCPplus 0x0102
  /begin DAQ_EVENT VARIABLE /end DAQ_EVENT
 /end IF_DATA
/end MEASUREMENT
/begin MEASUREMENT MoFFrm_Rx_rawINV_MTR_SPEED "Raw value for PDU INV_MTR_SPEED" SWORD OneToOne 1 100 -32768.00 32767.00 FORMAT "%8.2" ECU_ADDRESS 0x6002C81E
 /begin IF_DATA XCPplus 0x0102
  /begin DAQ_EVENT VARIABLE /end DAQ_EVENT
 /end IF_DATA
/end MEASUREMENT
/begin MEASUREMENT MoFFrm_Rx_rawINV_OP_MODE "Raw value for PDU INV_OP_MODE" UBYTE OneToOne 1 100 0.00 255.0 FORMAT "%5.1" ECU_ADDRESS 0x6002C86D
 /begin IF_DATA XCPplus 0x0102
  /begin DAQ_EVENT VARIABLE /end DAQ_EVENT
 /end IF_DATA
/end MEASUREMENT
/begin MEASUREMENT MoFFrm_Rx_rawPDU_FlgUBus_ActErr "PDU_FlgUBus_ActErrdata" UBYTE OneToOne 1 100 0.00 255.0 FORMAT "%5.1" ECU_ADDRESS 0x6002C86C
 /begin IF_DATA XCPplus 0x0102
  /begin DAQ_EVENT VARIABLE /end DAQ_EVENT
 /end IF_DATA
/end MEASUREMENT
/begin MEASUREMENT MoFFrm_Rx_rawPDU_FlgUBus_OnceErr "PDU_FlgUBus_OnceErr raw" UBYTE OneToOne 1 100 0.00 255.0 FORMAT "%5.1" ECU_ADDRESS 0x6002C86B
 /begin IF_DATA XCPplus 0x0102
  /begin DAQ_EVENT VARIABLE /end DAQ_EVENT
 /end IF_DATA
/end MEASUREMENT
/begin MEASUREMENT MoFFrm_Rx_rawPDU_FlgUBus_Reliable "PDU_FlgUBus_Reliable raw" UBYTE OneToOne 1 100 0.00 255.0 FORMAT "%5.1" ECU_ADDRESS 0x6002C86A
 /begin IF_DATA XCPplus 0x0102
  /begin DAQ_EVENT VARIABLE /end DAQ_EVENT
 /end IF_DATA
/end MEASUREMENT
/begin MEASUREMENT MoFFrm_Rx_rawPDU_FlgUBus_SysErr "PDU_FlgUBus_SysErr raw" UBYTE OneToOne 1 100 0.00 255.0 FORMAT "%5.1" ECU_ADDRESS 0x6002C869
 /begin IF_DATA XCPplus 0x0102
  /begin DAQ_EVENT VARIABLE /end DAQ_EVENT
 /end IF_DATA
/end MEASUREMENT
/begin MEASUREMENT MoFFrm_Rx_rawPDU_UBus_V "Raw value for PDU PDU_UBus_V" SWORD OneToOne 1 100 -32768.00 32767.00 FORMAT "%8.2" ECU_ADDRESS 0x6002C81C
 /begin IF_DATA XCPplus 0x0102
  /begin DAQ_EVENT VARIABLE /end DAQ_EVENT
 /end IF_DATA
/end MEASUREMENT
/begin MEASUREMENT MoFFrm_Rx_rawPRECOND_ELEC_WAKEUP "MoFFrm_Rx" UBYTE OneToOne 1 100 0.00 255.0 FORMAT "%5.1" ECU_ADDRESS 0x6002C868
 /begin IF_DATA XCPplus 0x0102
  /begin DAQ_EVENT VARIABLE /end DAQ_EVENT
 /end IF_DATA
/end MEASUREMENT
/begin MEASUREMENT MoFFrm_Rx_rawREGUL_ABR "Raw value for PDU REGUL_ABR" UBYTE OneToOne 1 100 0.00 255.0 FORMAT "%5.1" ECU_ADDRESS 0x6002C867
 /begin IF_DATA XCPplus 0x0102
  /begin DAQ_EVENT VARIABLE /end DAQ_EVENT
 /end IF_DATA
/end MEASUREMENT
/begin MEASUREMENT MoFFrm_Rx_rawTGLM_FAILURE_STATE "Raw value for PDU TGLM_FAILURE_STATE" UBYTE OneToOne 1 100 0.00 255.0 FORMAT "%5.1" ECU_ADDRESS 0x6002C866
 /begin IF_DATA XCPplus 0x0102
  /begin DAQ_EVENT VARIABLE /end DAQ_EVENT
 /end IF_DATA
/end MEASUREMENT
/begin MEASUREMENT MoFFrm_Rx_rawTOGGLE_MONOSTABLE_POS "Raw value for PDU TOGGLE_MONOSTABLE_POS" UBYTE OneToOne 1 100 0.00 255.0 FORMAT "%5.1" ECU_ADDRESS 0x6002C865
 /begin IF_DATA XCPplus 0x0102
  /begin DAQ_EVENT VARIABLE /end DAQ_EVENT
 /end IF_DATA
/end MEASUREMENT
/begin MEASUREMENT MoFFrm_Rx_rawVITESSE_VEHICULE_ROUES "Raw variable for VITESSE_VEHICULE_ROUES" UWORD OneToOne 1 100 0.00 65535.00 FORMAT "%8.2" ECU_ADDRESS 0x6002C81A
 /begin IF_DATA XCPplus 0x0102
  /begin DAQ_EVENT VARIABLE /end DAQ_EVENT
 /end IF_DATA
/end MEASUREMENT
/begin MEASUREMENT MoFFrm_Rx_stPdu_DCDC_283h "" UBYTE OneToOne 1 100 0.00 255.0 FORMAT "%5.1" ECU_ADDRESS 0x6002C855 /end MEASUREMENT
/begin MEASUREMENT MoFFrm_Rx_stPdu_DCDC_283hCpl "" UBYTE OneToOne 1 100 0.00 255.0 FORMAT "%5.1" ECU_ADDRESS 0x6002BE25 /end MEASUREMENT
/begin MEASUREMENT MoFFrm_Rx_stPdu_DCDC_293h "Data Frame for DCDC_293h" UBYTE OneToOne 1 100 0.00 255.0 FORMAT "%5.1" ECU_ADDRESS 0x6002C854 /end MEASUREMENT
/begin MEASUREMENT MoFFrm_Rx_stPdu_DCDC_293hCpl "Data Frame Complement for DCDC_293h" UBYTE OneToOne 1 100 0.00 255.0 FORMAT "%5.1" ECU_ADDRESS 0x6002BE24 /end MEASUREMENT
/begin MEASUREMENT MoFFrm_Rx_stPdu_HS3_AUTO_GEARBOX_SWITCH_STATUS "Data Frame for HS3_AUTO_GEARBOX_SWITCH_STATUS" UBYTE OneToOne 1 100 0.00 255.0 FORMAT "%5.1" ECU_ADDRESS 0x6002C853 /end MEASUREMENT
/begin MEASUREMENT MoFFrm_Rx_stPdu_HS3_AUTO_GEARBOX_SWITCH_STATUSCpl "Data Frame Complement for HS3_AUTO_GEARBOX_SWITCH_STATUS" UBYTE OneToOne 1 100 0.00 255.0 FORMAT "%5.1" ECU_ADDRESS 0x6002BE23 /end MEASUREMENT
/begin MEASUREMENT MoFFrm_Rx_stPdu_HVBAT_205h "Status variable of PDU HVBAT_205h" UBYTE OneToOne 1 100 0.00 255.0 FORMAT "%5.1" ECU_ADDRESS 0x6002C852 /end MEASUREMENT
/begin MEASUREMENT MoFFrm_Rx_stPdu_HVBAT_205hCpl "Complement variable of MoFFrm_Rx_stPdu_HVBAT_205h" UBYTE OneToOne 1 100 0.00 255.0 FORMAT "%5.1" ECU_ADDRESS 0x6002BE22 /end MEASUREMENT
/begin MEASUREMENT MoFFrm_Rx_stPdu_HVBAT_325h "Data Frame for HVBAT_325h" UBYTE OneToOne 1 100 0.00 255.0 FORMAT "%5.1" ECU_ADDRESS 0x6002C851 /end MEASUREMENT
/begin MEASUREMENT MoFFrm_Rx_stPdu_HVBAT_325hCpl "Data Frame Complement for HVBAT_325h" UBYTE OneToOne 1 100 0.00 255.0 FORMAT "%5.1" ECU_ADDRESS 0x6002BE21 /end MEASUREMENT
/begin MEASUREMENT MoFFrm_Rx_stPdu_INV_217h "Data Frame for INV_217h" UBYTE OneToOne 1 100 0.00 255.0 FORMAT "%5.1" ECU_ADDRESS 0x6002C850 /end MEASUREMENT
/begin MEASUREMENT MoFFrm_Rx_stPdu_INV_217hCpl "Data Frame Complement for INV_217h" UBYTE OneToOne 1 100 0.00 255.0 FORMAT "%5.1" ECU_ADDRESS 0x6002BE20 /end MEASUREMENT
/begin MEASUREMENT MoFFrm_Rx_stPdu_INV_237 "Data Frame for INV_237" UBYTE OneToOne 1 100 0.00 255.0 FORMAT "%5.1" ECU_ADDRESS 0x6002C84F /end MEASUREMENT
/begin MEASUREMENT MoFFrm_Rx_stPdu_INV_237Cpl "Data Frame Complement for INV_237" UBYTE OneToOne 1 100 0.00 255.0 FORMAT "%5.1" ECU_ADDRESS 0x6002BE1F /end MEASUREMENT
/begin MEASUREMENT MoFFrm_Rx_stPdu_INV_427h "Data Frame for INV_427h" UBYTE OneToOne 1 100 0.00 255.0 FORMAT "%5.1" ECU_ADDRESS 0x6002C84E /end MEASUREMENT
/begin MEASUREMENT MoFFrm_Rx_stPdu_INV_427hCpl "Data Frame Complement for INV_427h" UBYTE OneToOne 1 100 0.00 255.0 FORMAT "%5.1" ECU_ADDRESS 0x6002BE1E /end MEASUREMENT
/begin MEASUREMENT MoFFrm_Rx_stPdu_IS_DAT_ABR_50Dh "Data Frame for IS_DAT_ABR_50Dh" UBYTE OneToOne 1 100 0.00 255.0 FORMAT "%5.1" ECU_ADDRESS 0x6002C84D /end MEASUREMENT
/begin MEASUREMENT MoFFrm_Rx_stPdu_IS_DAT_ABR_50DhCpl "Data Frame Complement for IS_DAT_ABR_50Dh" UBYTE OneToOne 1 100 0.00 255.0 FORMAT "%5.1" ECU_ADDRESS 0x6002BE1D /end MEASUREMENT
/begin MEASUREMENT MoFFrm_Rx_stPdu_IS_DAT_BSI_412h "Data Frame for IS_DAT_BSI_412h" UBYTE OneToOne 1 100 0.00 255.0 FORMAT "%5.1" ECU_ADDRESS 0x6002C84C /end MEASUREMENT
/begin MEASUREMENT MoFFrm_Rx_stPdu_IS_DAT_BSI_412hCpl "Data Frame Complement for IS_DAT_BSI_412h" UBYTE OneToOne 1 100 0.00 255.0 FORMAT "%5.1" ECU_ADDRESS 0x6002BE1C /end MEASUREMENT
/begin MEASUREMENT MoFFrm_Rx_stPdu_IS_DYN_ABR_38Dh "Data Frame for IS_DYN_ABR_38Dh" UBYTE OneToOne 1 100 0.00 255.0 FORMAT "%5.1" ECU_ADDRESS 0x6002C84B /end MEASUREMENT
/begin MEASUREMENT MoFFrm_Rx_stPdu_IS_DYN_ABR_38DhCpl "Data Frame Complement for IS_DYN_ABR_38Dh" UBYTE OneToOne 1 100 0.00 255.0 FORMAT "%5.1" ECU_ADDRESS 0x6002BE1B /end MEASUREMENT
/begin MEASUREMENT MoFFrm_Rx_stPdu_PDU_BusVoltages_308 "Data Frame for PDU_BusVoltages_308" UBYTE OneToOne 1 100 0.00 255.0 FORMAT "%5.1" ECU_ADDRESS 0x6002C84A /end MEASUREMENT
/begin MEASUREMENT MoFFrm_Rx_stPdu_PDU_BusVoltages_308Cpl "Data Frame Complement for PDU_BusVoltages_308" UBYTE OneToOne 1 100 0.00 255.0 FORMAT "%5.1" ECU_ADDRESS 0x6002BE1A /end MEASUREMENT
/begin MEASUREMENT MoFFrm_Rx_stPdu_VCU_AIRBAG_351h "Data Frame for VCU_AIRBAG_351h" UBYTE OneToOne 1 100 0.00 255.0 FORMAT "%5.1" ECU_ADDRESS 0x6002C849 /end MEASUREMENT
/begin MEASUREMENT MoFFrm_Rx_stPdu_VCU_AIRBAG_351hCpl "Data Frame Complement for VCU_AIRBAG_351h" UBYTE OneToOne 1 100 0.00 255.0 FORMAT "%5.1" ECU_ADDRESS 0x6002BE19 /end MEASUREMENT
/begin MEASUREMENT MoFFrm_Rx_stPdu_VCU_eBCCM_432h "MoFFrm_Rx" UBYTE OneToOne 1 100 0.00 255.0 FORMAT "%5.1" ECU_ADDRESS 0x6002C848 /end MEASUREMENT
/begin MEASUREMENT MoFFrm_Rx_stPdu_VCU_eBCCM_432hCpl "MoFFrm_Rx" UBYTE OneToOne 1 100 0.00 255.0 FORMAT "%5.1" ECU_ADDRESS 0x6002BE18 /end MEASUREMENT
/begin MEASUREMENT MoFFrm_stCplCrash "Complement CAN signal of CRASH signal" UBYTE OneToOne 1 100 0.00 255.0 FORMAT "%5.1" ECU_ADDRESS 0x6002C847
 /begin IF_DATA XCPplus 0x0102
  /begin DAQ_EVENT VARIABLE /end DAQ_EVENT
 /end IF_DATA
/end MEASUREMENT
/begin MEASUREMENT MoFFrm_stCplCrashCpl "MoFFrm_stCplCrash complement" UBYTE OneToOne 1 100 0.00 255.0 FORMAT "%5.1" ECU_ADDRESS 0x6002BE17
 /begin IF_DATA XCPplus 0x0102
  /begin DAQ_EVENT VARIABLE /end DAQ_EVENT
 /end IF_DATA
/end MEASUREMENT
/begin MEASUREMENT MoFFrm_stCplCrashQlfr "MoFFrm_stCplCrash qualifier" UBYTE OneToOne 1 100 0.00 255.0 FORMAT "%5.1" ECU_ADDRESS 0x6002C846
 /begin IF_DATA XCPplus 0x0102
  /begin DAQ_EVENT VARIABLE /end DAQ_EVENT
 /end IF_DATA
/end MEASUREMENT
/begin MEASUREMENT MoFFrm_stCplCrashQlfrCpl "MoFFrm_stCplCrash qualifier complement" UBYTE OneToOne 1 100 0.00 255.0 FORMAT "%5.1" ECU_ADDRESS 0x6002BE16
 /begin IF_DATA XCPplus 0x0102
  /begin DAQ_EVENT VARIABLE /end DAQ_EVENT
 /end IF_DATA
/end MEASUREMENT
/begin MEASUREMENT MoFFrm_stCrash "CAN Crash Signal" UBYTE OneToOne 1 100 0.00 255.0 FORMAT "%5.1" ECU_ADDRESS 0x6002C845
 /begin IF_DATA XCPplus 0x0102
  /begin DAQ_EVENT VARIABLE /end DAQ_EVENT
 /end IF_DATA
/end MEASUREMENT
/begin MEASUREMENT MoFFrm_stCrashCpl "RAM Data Redundancy MoFFrm_stCrash" UBYTE OneToOne 1 100 0.00 255.0 FORMAT "%5.1" ECU_ADDRESS 0x6002BE15
 /begin IF_DATA XCPplus 0x0102
  /begin DAQ_EVENT VARIABLE /end DAQ_EVENT
 /end IF_DATA
/end MEASUREMENT
/begin MEASUREMENT MoFFrm_stCrashQlfr "Qualifier for MoFFrm_stCrash" UBYTE OneToOne 1 100 0.00 255.0 FORMAT "%5.1" ECU_ADDRESS 0x6002C844
 /begin IF_DATA XCPplus 0x0102
  /begin DAQ_EVENT VARIABLE /end DAQ_EVENT
 /end IF_DATA
/end MEASUREMENT
/begin MEASUREMENT MoFFrm_stCrashQlfrCpl "RAM Data Redundancy MoFFrm_stCrashQlfr" UBYTE OneToOne 1 100 0.00 255.0 FORMAT "%5.1" ECU_ADDRESS 0x6002BE14
 /begin IF_DATA XCPplus 0x0102
  /begin DAQ_EVENT VARIABLE /end DAQ_EVENT
 /end IF_DATA
/end MEASUREMENT
/begin MEASUREMENT MoFFrm_stDcdcErr "DCDC error state" ULONG OneToOne 1 100 0.00 4294967295.00 FORMAT "%13.2" ECU_ADDRESS 0x6002C828
 /begin IF_DATA XCPplus 0x0102
  /begin DAQ_EVENT VARIABLE /end DAQ_EVENT
 /end IF_DATA
/end MEASUREMENT
/begin MEASUREMENT MoFFrm_stDcdcErrCpl "Complement variable of MoFFrm_stDcdcErr" ULONG OneToOne 1 100 0.00 4294967295.00 FORMAT "%13.2" ECU_ADDRESS 0x6002BDF8
 /begin IF_DATA XCPplus 0x0102
  /begin DAQ_EVENT VARIABLE /end DAQ_EVENT
 /end IF_DATA
/end MEASUREMENT
/begin MEASUREMENT MoFFrm_stDcdcErrQlfr "Signal qualifier variable of MoFFrm_stDcdcErrQlfr" UBYTE OneToOne 1 100 0.00 255.0 FORMAT "%5.1" ECU_ADDRESS 0x6002C843
 /begin IF_DATA XCPplus 0x0102
  /begin DAQ_EVENT VARIABLE /end DAQ_EVENT
 /end IF_DATA
/end MEASUREMENT
/begin MEASUREMENT MoFFrm_stDcdcErrQlfrCpl "Complement variable of MoFFrm_stDcdcErrQlfr" UBYTE OneToOne 1 100 0.00 255.0 FORMAT "%5.1" ECU_ADDRESS 0x6002BE13
 /begin IF_DATA XCPplus 0x0102
  /begin DAQ_EVENT VARIABLE /end DAQ_EVENT
 /end IF_DATA
/end MEASUREMENT
/begin MEASUREMENT MoFFrm_stDrvrSeatBlt "Driver seat belt status" UBYTE OneToOne 1 100 0.00 255.0 FORMAT "%5.1" ECU_ADDRESS 0x6002C842
 /begin IF_DATA XCPplus 0x0102
  /begin DAQ_EVENT VARIABLE /end DAQ_EVENT
 /end IF_DATA
/end MEASUREMENT
/begin MEASUREMENT MoFFrm_stDrvrSeatBltCpl "Complement of Driver seat belt status" UBYTE OneToOne 1 100 0.00 255.0 FORMAT "%5.1" ECU_ADDRESS 0x6002BE12
 /begin IF_DATA XCPplus 0x0102
  /begin DAQ_EVENT VARIABLE /end DAQ_EVENT
 /end IF_DATA
/end MEASUREMENT
/begin MEASUREMENT MoFFrm_stDrvrSeatBltQlfr "Qualifier for Driver seat belt status" UBYTE OneToOne 1 100 0.00 255.0 FORMAT "%5.1" ECU_ADDRESS 0x6002C841
 /begin IF_DATA XCPplus 0x0102
  /begin DAQ_EVENT VARIABLE /end DAQ_EVENT
 /end IF_DATA
/end MEASUREMENT
/begin MEASUREMENT MoFFrm_stDrvrSeatBltQlfrCpl "Qualifier Complement of Driver seat belt status" UBYTE OneToOne 1 100 0.00 255.0 FORMAT "%5.1" ECU_ADDRESS 0x6002BE11
 /begin IF_DATA XCPplus 0x0102
  /begin DAQ_EVENT VARIABLE /end DAQ_EVENT
 /end IF_DATA
/end MEASUREMENT
/begin MEASUREMENT MoFFrm_stESMFailr "ESM failure" UBYTE OneToOne 1 100 0.00 255.0 FORMAT "%5.1" ECU_ADDRESS 0x6002C840
 /begin IF_DATA XCPplus 0x0102
  /begin DAQ_EVENT VARIABLE /end DAQ_EVENT
 /end IF_DATA
/end MEASUREMENT
/begin MEASUREMENT MoFFrm_stESMFailrCpl "Complement of ESM failure" UBYTE OneToOne 1 100 0.00 255.0 FORMAT "%5.1" ECU_ADDRESS 0x6002BE10
 /begin IF_DATA XCPplus 0x0102
  /begin DAQ_EVENT VARIABLE /end DAQ_EVENT
 /end IF_DATA
/end MEASUREMENT
/begin MEASUREMENT MoFFrm_stESMFailrQlfr "Qualifier for ESM failure" UBYTE OneToOne 1 100 0.00 255.0 FORMAT "%5.1" ECU_ADDRESS 0x6002C83F
 /begin IF_DATA XCPplus 0x0102
  /begin DAQ_EVENT VARIABLE /end DAQ_EVENT
 /end IF_DATA
/end MEASUREMENT
/begin MEASUREMENT MoFFrm_stESMFailrQlfrCpl "Qualifier Complement for ESM failure" UBYTE OneToOne 1 100 0.00 255.0 FORMAT "%5.1" ECU_ADDRESS 0x6002BE0F
 /begin IF_DATA XCPplus 0x0102
  /begin DAQ_EVENT VARIABLE /end DAQ_EVENT
 /end IF_DATA
/end MEASUREMENT
/begin MEASUREMENT MoFFrm_stGearNum "Gear lever position from function level" UBYTE OneToOne 1 100 0.00 255.0 FORMAT "%5.1" ECU_ADDRESS 0x6002C83E
 /begin IF_DATA XCPplus 0x0102
  /begin DAQ_EVENT VARIABLE /end DAQ_EVENT
 /end IF_DATA
/end MEASUREMENT
/begin MEASUREMENT MoFFrm_stGearNumCpl "Complement for MoFFrm_stGearNum" UBYTE OneToOne 1 100 0.00 255.0 FORMAT "%5.1" ECU_ADDRESS 0x6002BE0E
 /begin IF_DATA XCPplus 0x0102
  /begin DAQ_EVENT VARIABLE /end DAQ_EVENT
 /end IF_DATA
/end MEASUREMENT
/begin MEASUREMENT MoFFrm_stGearNumQlfr "Gear lever position qualifier" UBYTE OneToOne 1 100 0.00 255.0 FORMAT "%5.1" ECU_ADDRESS 0x6002C83D
 /begin IF_DATA XCPplus 0x0102
  /begin DAQ_EVENT VARIABLE /end DAQ_EVENT
 /end IF_DATA
/end MEASUREMENT
/begin MEASUREMENT MoFFrm_stGearNumQlfrCpl "Complement for MoFFrm_stGearNumQlfr" UBYTE OneToOne 1 100 0.00 255.0 FORMAT "%5.1" ECU_ADDRESS 0x6002BE0D
 /begin IF_DATA XCPplus 0x0102
  /begin DAQ_EVENT VARIABLE /end DAQ_EVENT
 /end IF_DATA
/end MEASUREMENT
/begin MEASUREMENT MoFFrm_stHvbCnctn "MoFFrm_stHvbCnctn" UBYTE OneToOne 1 100 0.00 255.0 FORMAT "%5.1" ECU_ADDRESS 0x6002C83C
 /begin IF_DATA XCPplus 0x0102
  /begin DAQ_EVENT VARIABLE /end DAQ_EVENT
 /end IF_DATA
/end MEASUREMENT
/begin MEASUREMENT MoFFrm_stHvbCnctnCpl "Complement variable of MoFFrm_stHvbCnctn" UBYTE OneToOne 1 100 0.00 255.0 FORMAT "%5.1" ECU_ADDRESS 0x6002BE0C
 /begin IF_DATA XCPplus 0x0102
  /begin DAQ_EVENT VARIABLE /end DAQ_EVENT
 /end IF_DATA
/end MEASUREMENT
/begin MEASUREMENT MoFFrm_stHvbCnctnQlfr "Signal qualifier variable of MoFFrm_stHvbCnctn" UBYTE OneToOne 1 100 0.00 255.0 FORMAT "%5.1" ECU_ADDRESS 0x6002C83B
 /begin IF_DATA XCPplus 0x0102
  /begin DAQ_EVENT VARIABLE /end DAQ_EVENT
 /end IF_DATA
/end MEASUREMENT
/begin MEASUREMENT MoFFrm_stHvbCnctnQlfrCpl "Complement variable of MoFFrm_stHvbCnctnQlfr" UBYTE OneToOne 1 100 0.00 255.0 FORMAT "%5.1" ECU_ADDRESS 0x6002BE0B
 /begin IF_DATA XCPplus 0x0102
  /begin DAQ_EVENT VARIABLE /end DAQ_EVENT
 /end IF_DATA
/end MEASUREMENT
/begin MEASUREMENT MoFFrm_stHvbFltLvl "MoFFrm_stHvbFltLvl" UBYTE OneToOne 1 100 0.00 255.0 FORMAT "%5.1" ECU_ADDRESS 0x6002C83A
 /begin IF_DATA XCPplus 0x0102
  /begin DAQ_EVENT VARIABLE /end DAQ_EVENT
 /end IF_DATA
/end MEASUREMENT
/begin MEASUREMENT MoFFrm_stHvbFltLvlCpl "Complement variable of MoFFrm_stHvbFltLvl" UBYTE OneToOne 1 100 0.00 255.0 FORMAT "%5.1" ECU_ADDRESS 0x6002BE0A
 /begin IF_DATA XCPplus 0x0102
  /begin DAQ_EVENT VARIABLE /end DAQ_EVENT
 /end IF_DATA
/end MEASUREMENT
/begin MEASUREMENT MoFFrm_stHvbFltLvlQlfr "Signal qualifier variable of MoFFrm_stHvbFltLvl" UBYTE OneToOne 1 100 0.00 255.0 FORMAT "%5.1" ECU_ADDRESS 0x6002C839
 /begin IF_DATA XCPplus 0x0102
  /begin DAQ_EVENT VARIABLE /end DAQ_EVENT
 /end IF_DATA
/end MEASUREMENT
/begin MEASUREMENT MoFFrm_stHvbFltLvlQlfrCpl "Complement variable of MoFFrm_stHvbFltLvlQlfr" UBYTE OneToOne 1 100 0.00 255.0 FORMAT "%5.1" ECU_ADDRESS 0x6002BE09
 /begin IF_DATA XCPplus 0x0102
  /begin DAQ_EVENT VARIABLE /end DAQ_EVENT
 /end IF_DATA
/end MEASUREMENT
/begin MEASUREMENT MoFFrm_stHvIntlck "High Voltage Inter lock state" UBYTE OneToOne 1 100 0.00 255.0 FORMAT "%5.1" ECU_ADDRESS 0x6002C838
 /begin IF_DATA XCPplus 0x0102
  /begin DAQ_EVENT VARIABLE /end DAQ_EVENT
 /end IF_DATA
/end MEASUREMENT
/begin MEASUREMENT MoFFrm_stHvIntlckCpl "Complement of MoFFrm_stHvIntlck" UBYTE OneToOne 1 100 0.00 255.0 FORMAT "%5.1" ECU_ADDRESS 0x6002BE08
 /begin IF_DATA XCPplus 0x0102
  /begin DAQ_EVENT VARIABLE /end DAQ_EVENT
 /end IF_DATA
/end MEASUREMENT
/begin MEASUREMENT MoFFrm_stHvIntlckQlfr "Signal qualifier variable of MoFFrm_stHvIntlckQlfr" UBYTE OneToOne 1 100 0.00 255.0 FORMAT "%5.1" ECU_ADDRESS 0x6002C837
 /begin IF_DATA XCPplus 0x0102
  /begin DAQ_EVENT VARIABLE /end DAQ_EVENT
 /end IF_DATA
/end MEASUREMENT
/begin MEASUREMENT MoFFrm_stHvIntlckQlfrCpl "Complement variable of MoFFrm_stHvIntlckQlfr" UBYTE OneToOne 1 100 0.00 255.0 FORMAT "%5.1" ECU_ADDRESS 0x6002BE07
 /begin IF_DATA XCPplus 0x0102
  /begin DAQ_EVENT VARIABLE /end DAQ_EVENT
 /end IF_DATA
/end MEASUREMENT
/begin MEASUREMENT MoFFrm_stIIvtrFltLvl01 "Inverter fault level" UBYTE OneToOne 1 100 0.00 255.0 FORMAT "%5.1" ECU_ADDRESS 0x6002C836
 /begin IF_DATA XCPplus 0x0102
  /begin DAQ_EVENT VARIABLE /end DAQ_EVENT
 /end IF_DATA
/end MEASUREMENT
/begin MEASUREMENT MoFFrm_stIIvtrFltLvl01Cpl "Complement variable of MoFFrm_stIIvtrFltLvl01" UBYTE OneToOne 1 100 0.00 255.0 FORMAT "%5.1" ECU_ADDRESS 0x6002BE06
 /begin IF_DATA XCPplus 0x0102
  /begin DAQ_EVENT VARIABLE /end DAQ_EVENT
 /end IF_DATA
/end MEASUREMENT
/begin MEASUREMENT MoFFrm_stIIvtrFltLvl01Qlfr "Signal qualifier variable of MoFFrm_stIIvtrFltLvl01" UBYTE OneToOne 1 100 0.00 255.0 FORMAT "%5.1" ECU_ADDRESS 0x6002C835
 /begin IF_DATA XCPplus 0x0102
  /begin DAQ_EVENT VARIABLE /end DAQ_EVENT
 /end IF_DATA
/end MEASUREMENT
/begin MEASUREMENT MoFFrm_stIIvtrFltLvl01QlfrCpl "Complement variable of MoFFrm_stIIvtrFltLvl01Qlfr" UBYTE OneToOne 1 100 0.00 255.0 FORMAT "%5.1" ECU_ADDRESS 0x6002BE05
 /begin IF_DATA XCPplus 0x0102
  /begin DAQ_EVENT VARIABLE /end DAQ_EVENT
 /end IF_DATA
/end MEASUREMENT
/begin MEASUREMENT MoFFrm_stIvtrOpMod01 "INV Internal Operating Mode" UBYTE OneToOne 1 100 0.00 255.0 FORMAT "%5.1" ECU_ADDRESS 0x6002C834
 /begin IF_DATA XCPplus 0x0102
  /begin DAQ_EVENT VARIABLE /end DAQ_EVENT
 /end IF_DATA
/end MEASUREMENT
/begin MEASUREMENT MoFFrm_stIvtrOpMod01Cpl "Complement of INV Internal Operating Mode" UBYTE OneToOne 1 100 0.00 255.0 FORMAT "%5.1" ECU_ADDRESS 0x6002BE04
 /begin IF_DATA XCPplus 0x0102
  /begin DAQ_EVENT VARIABLE /end DAQ_EVENT
 /end IF_DATA
/end MEASUREMENT
/begin MEASUREMENT MoFFrm_stIvtrOpMod01Qlfr "Qualifier for INV Internal Operating Mode" UBYTE OneToOne 1 100 0.00 255.0 FORMAT "%5.1" ECU_ADDRESS 0x6002C833
 /begin IF_DATA XCPplus 0x0102
  /begin DAQ_EVENT VARIABLE /end DAQ_EVENT
 /end IF_DATA
/end MEASUREMENT
/begin MEASUREMENT MoFFrm_stIvtrOpMod01QlfrCpl "Qualifier Complement of INV Internal Operating Mode" UBYTE OneToOne 1 100 0.00 255.0 FORMAT "%5.1" ECU_ADDRESS 0x6002BE03
 /begin IF_DATA XCPplus 0x0102
  /begin DAQ_EVENT VARIABLE /end DAQ_EVENT
 /end IF_DATA
/end MEASUREMENT
/begin MEASUREMENT MoFFrm_stPrkgBrkSwt "Parking brake switch" UBYTE OneToOne 1 100 0.00 255.0 FORMAT "%5.1" ECU_ADDRESS 0x6002C832
 /begin IF_DATA XCPplus 0x0102
  /begin DAQ_EVENT VARIABLE /end DAQ_EVENT
 /end IF_DATA
/end MEASUREMENT
/begin MEASUREMENT MoFFrm_stPrkgBrkSwtCpl "Complement of Parking brake switch" UBYTE OneToOne 1 100 0.00 255.0 FORMAT "%5.1" ECU_ADDRESS 0x6002BE02
 /begin IF_DATA XCPplus 0x0102
  /begin DAQ_EVENT VARIABLE /end DAQ_EVENT
 /end IF_DATA
/end MEASUREMENT
/begin MEASUREMENT MoFFrm_stPrkgBrkSwtQlfr "Qualifier for Parking brake switch" UBYTE OneToOne 1 100 0.00 255.0 FORMAT "%5.1" ECU_ADDRESS 0x6002C831
 /begin IF_DATA XCPplus 0x0102
  /begin DAQ_EVENT VARIABLE /end DAQ_EVENT
 /end IF_DATA
/end MEASUREMENT
/begin MEASUREMENT MoFFrm_stPrkgBrkSwtQlfrCpl "Qualifier Complement of Parking brake switch" UBYTE OneToOne 1 100 0.00 255.0 FORMAT "%5.1" ECU_ADDRESS 0x6002BE01
 /begin IF_DATA XCPplus 0x0102
  /begin DAQ_EVENT VARIABLE /end DAQ_EVENT
 /end IF_DATA
/end MEASUREMENT
/begin MEASUREMENT MoFFrm_tqAct01 "Actual Torque at Motor" SWORD RBPtCel_tq_0p1_1 1 100 -3276.800 3276.700 FORMAT "%8.3" ECU_ADDRESS 0x6002C816
 /begin IF_DATA XCPplus 0x0102
  /begin DAQ_EVENT VARIABLE /end DAQ_EVENT
 /end IF_DATA
/end MEASUREMENT
/begin MEASUREMENT MoFFrm_tqAct01Cpl "Complement for Actual Torque at Motor" UWORD OneToOne 1 100 0.00 65535.00 FORMAT "%8.2" ECU_ADDRESS 0x6002BDF2
 /begin IF_DATA XCPplus 0x0102
  /begin DAQ_EVENT VARIABLE /end DAQ_EVENT
 /end IF_DATA
/end MEASUREMENT
/begin MEASUREMENT MoFFrm_tqAct01Qlfr "Qualifier for Actual Torque at Motor" UBYTE OneToOne 1 100 0.00 255.0 FORMAT "%5.1" ECU_ADDRESS 0x6002C830
 /begin IF_DATA XCPplus 0x0102
  /begin DAQ_EVENT VARIABLE /end DAQ_EVENT
 /end IF_DATA
/end MEASUREMENT
/begin MEASUREMENT MoFFrm_tqAct01QlfrCpl "Qualifier Complement of Actual Torque at Motor" UBYTE OneToOne 1 100 0.00 255.0 FORMAT "%5.1" ECU_ADDRESS 0x6002BE00
 /begin IF_DATA XCPplus 0x0102
  /begin DAQ_EVENT VARIABLE /end DAQ_EVENT
 /end IF_DATA
/end MEASUREMENT
/begin MEASUREMENT MoFFrm_uDcChrgn "bus positive voltage" SWORD RBPtCel_u_0p1_1 1 100 -3276.800 3276.700 FORMAT "%8.3" ECU_ADDRESS 0x6002C814
 /begin IF_DATA XCPplus 0x0102
  /begin DAQ_EVENT VARIABLE /end DAQ_EVENT
 /end IF_DATA
/end MEASUREMENT
/begin MEASUREMENT MoFFrm_uDcChrgnCpl "Qualifier for PDU_BusVoltages_308bus positive voltage" UWORD OneToOne 1 100 0.00 65535.00 FORMAT "%8.2" ECU_ADDRESS 0x6002BDF0
 /begin IF_DATA XCPplus 0x0102
  /begin DAQ_EVENT VARIABLE /end DAQ_EVENT
 /end IF_DATA
/end MEASUREMENT
/begin MEASUREMENT MoFFrm_uDcChrgnQlfr "Qualifier for bus positive voltage" UBYTE OneToOne 1 100 0.00 255.0 FORMAT "%5.1" ECU_ADDRESS 0x6002C82F
 /begin IF_DATA XCPplus 0x0102
  /begin DAQ_EVENT VARIABLE /end DAQ_EVENT
 /end IF_DATA
/end MEASUREMENT
/begin MEASUREMENT MoFFrm_uDcChrgnQlfrCpl "Qualifier Complement for bus positive voltage" UBYTE OneToOne 1 100 0.00 255.0 FORMAT "%5.1" ECU_ADDRESS 0x6002BDFF
 /begin IF_DATA XCPplus 0x0102
  /begin DAQ_EVENT VARIABLE /end DAQ_EVENT
 /end IF_DATA
/end MEASUREMENT
/begin MEASUREMENT MoFFrm_uDcdcHvAct "" UWORD RBPtCel_u_1p0_1 1 100 0.00 65535.00 FORMAT "%8.2" ECU_ADDRESS 0x6002C812
 /begin IF_DATA XCPplus 0x0102
  /begin DAQ_EVENT VARIABLE /end DAQ_EVENT
 /end IF_DATA
/end MEASUREMENT
/begin MEASUREMENT MoFFrm_uDcdcHvActCpl "" UWORD OneToOne 1 100 0.00 65535.00 FORMAT "%8.2" ECU_ADDRESS 0x6002BDEE
 /begin IF_DATA XCPplus 0x0102
  /begin DAQ_EVENT VARIABLE /end DAQ_EVENT
 /end IF_DATA
/end MEASUREMENT
/begin MEASUREMENT MoFFrm_uDcdcHvActQlfr "" UBYTE OneToOne 1 100 0.00 255.0 FORMAT "%5.1" ECU_ADDRESS 0x6002C82E
 /begin IF_DATA XCPplus 0x0102
  /begin DAQ_EVENT VARIABLE /end DAQ_EVENT
 /end IF_DATA
/end MEASUREMENT
/begin MEASUREMENT MoFFrm_uDcdcHvActQlfrCpl "" UBYTE OneToOne 1 100 0.00 255.0 FORMAT "%5.1" ECU_ADDRESS 0x6002BDFE
 /begin IF_DATA XCPplus 0x0102
  /begin DAQ_EVENT VARIABLE /end DAQ_EVENT
 /end IF_DATA
/end MEASUREMENT
/begin MEASUREMENT MoFFrm_uDcLnk01 "" UWORD RBPtCel_u_1p0_1 1 100 0.00 65535.00 FORMAT "%8.2" ECU_ADDRESS 0x6002C810
 /begin IF_DATA XCPplus 0x0102
  /begin DAQ_EVENT VARIABLE /end DAQ_EVENT
 /end IF_DATA
/end MEASUREMENT
/begin MEASUREMENT MoFFrm_uDcLnk01Cpl "" UWORD OneToOne 1 100 0.00 65535.00 FORMAT "%8.2" ECU_ADDRESS 0x6002BDEC
 /begin IF_DATA XCPplus 0x0102
  /begin DAQ_EVENT VARIABLE /end DAQ_EVENT
 /end IF_DATA
/end MEASUREMENT
/begin MEASUREMENT MoFFrm_uDcLnk01Qlfr "" UBYTE OneToOne 1 100 0.00 255.0 FORMAT "%5.1" ECU_ADDRESS 0x6002C82D
 /begin IF_DATA XCPplus 0x0102
  /begin DAQ_EVENT VARIABLE /end DAQ_EVENT
 /end IF_DATA
/end MEASUREMENT
/begin MEASUREMENT MoFFrm_uDcLnk01QlfrCpl "" UBYTE OneToOne 1 100 0.00 255.0 FORMAT "%5.1" ECU_ADDRESS 0x6002BDFD
 /begin IF_DATA XCPplus 0x0102
  /begin DAQ_EVENT VARIABLE /end DAQ_EVENT
 /end IF_DATA
/end MEASUREMENT
/begin MEASUREMENT MoFFrm_vVeh "Vehicle speed over CAN" UWORD RBPtCel_v_0p01_1 1 100 0.00 655.3500 FORMAT "%8.4" ECU_ADDRESS 0x6002C80E
 /begin IF_DATA XCPplus 0x0102
  /begin DAQ_EVENT VARIABLE /end DAQ_EVENT
 /end IF_DATA
/end MEASUREMENT
/begin MEASUREMENT MoFFrm_vVehCpl "Complement variable" UWORD OneToOne 1 100 0.00 65535.00 FORMAT "%8.2" ECU_ADDRESS 0x6002BDEA
 /begin IF_DATA XCPplus 0x0102
  /begin DAQ_EVENT VARIABLE /end DAQ_EVENT
 /end IF_DATA
/end MEASUREMENT
/begin MEASUREMENT MoFFrm_vVehQlfr "Qualifier for Vehicle speed" UBYTE OneToOne 1 100 0.00 255.0 FORMAT "%5.1" ECU_ADDRESS 0x6002C82C
 /begin IF_DATA XCPplus 0x0102
  /begin DAQ_EVENT VARIABLE /end DAQ_EVENT
 /end IF_DATA
/end MEASUREMENT
/begin MEASUREMENT MoFFrm_vVehQlfrCpl "complement variable" UBYTE OneToOne 1 100 0.00 255.0 FORMAT "%5.1" ECU_ADDRESS 0x6002BDFC
 /begin IF_DATA XCPplus 0x0102
  /begin DAQ_EVENT VARIABLE /end DAQ_EVENT
 /end IF_DATA
/end MEASUREMENT
/begin FUNCTION MoFExtCpt_VacPmp "2.5.0     Function monitoring Vacuum pump"
 /begin DEF_CHARACTERISTIC DFC_CtlMsk2.DFC_MoFExtCptVacPmpErr_C DFC_DisblMsk2.DFC_MoFExtCptVacPmpErr_C MoFExtCpt_cntrDebPVacp_C MoFExtCpt_cntrDlyVacPSnsrTest_C MoFExtCpt_cntrVacPmpDebErrHiLo_C MoFExtCpt_cntrVacPmpDebErrLoHi_C MoFExtCpt_cntrVacPmpDebSRC1HiLo_C MoFExtCpt_cntrVacPmpDebSRC1LoHi_C MoFExtCpt_cntrVacPmpDebSRC2HiLo_C MoFExtCpt_cntrVacPmpDebSRC2LoHi_C MoFExtCpt_cntrVacPmpDfcSet_C MoFExtCpt_cntrVacPmpDlyDfcRst_C MoFExtCpt_cntrVacPmpDlyPmpTest_C MoFExtCpt_cntrVacPSnsrDebErrHiLo_C MoFExtCpt_cntrVacPSnsrDebErrLoHi_C MoFExtCpt_cntrVacPSnsrPlauTest_C MoFExtCpt_facCnvnSlopDig_C MoFExtCpt_facMaxDynChk_C MoFExtCpt_facMinDynChk_C MoFExtCpt_flgAdcCnvrSel_C MoFExtCpt_flgEnaEnvPSnsr_C MoFExtCpt_flgEnaEnvPSpi_C MoFExtCpt_numCycVacPmpEfcDebErrHiLo_C MoFExtCpt_numCycVacPmpEfcDebErrLoHi_C MoFExtCpt_pCnvnOffs_C MoFExtCpt_pDiffVacPmpMin_C MoFExtCpt_pEnv_C MoFExtCpt_pMaxSigRngChk_C MoFExtCpt_pMinSigRngChk_C MoFExtCpt_pSnsrThdPMax_C MoFExtCpt_pThdEnvPBasdPmpReqOff_T MoFExtCpt_pThdEnvPBasdPmpReqOn_T MoFExtCpt_pThdPmpReqOff_M MoFExtCpt_pThdPmpReqOn_M MoFExtCpt_pVacPCnvnFrmUSnsr1_T MoFExtCpt_pVacPCnvnFrmUSnsr2_T MoFExtCpt_pVacPmpTestDif_M MoFExtCpt_pVacPUnfildSfty_C MoFExtCpt_pVacSensrTestDif_C MoFExtCpt_pVacSensrUnfildAbsltDifMax_C MoFExtCpt_stBrkBstPFlt_C MoFExtCpt_stMstWrnLmp_C MoFExtCpt_stPwtActv_C MoFExtCpt_stSelVacPmpUnfild_C MoFExtCpt_swtVacPmpErr_C MoFExtCpt_swtVacPmpTestSeln_C MoFExtCpt_tiVacPFil_C MoFExtCpt_uAdcCnvrMask_C MoFExtCpt_uAdcCnvrShift_C MoFExtCpt_uVacPHiThd_C MoFExtCpt_uVacPLoThd_C MoFxtCpt_stSwtCfgBrkstPFlt_C MoFxtCpt_stSwtCfgMstWrnLmp_C /end DEF_CHARACTERISTIC
 /begin IN_MEASUREMENT BrkBst_bPmpReq Com_stBrkBstPFlt Com_stMstWrnLmp CoPtFH_stPwt MoCADC_bDef MoFBas_vVeh MoFBrk_flgBrkApp MoFFrm_vVehQlfr Mo_stCplChk Mo_stMoC Mo_stMoCCpl PEnv_p /end IN_MEASUREMENT
 /begin OUT_MEASUREMENT DFC_st.DFC_MoFExtCptVacPmpErr DINH_nrActvInhReas.FId_VacPmpErr DINH_stFId.FId_VacPmpErr MoFExtCpt_flgHiVacPErrDeb MoFExtCpt_flgVacPmpActvnErrDeb MoFExtCpt_flgVacPmpEfcErrDeb MoFExtCpt_flgVacPmpErr MoFExtCpt_flgVacPmpIrrvErrMsg MoFExtCpt_flgVacPmpPlauErr MoFExtCpt_flgVacPmpSrcErr MoFExtCpt_flgVacPmpTstMsg MoFExtCpt_flgVacPSnsrStuckErrDeb MoFExtCpt_stBrkBstPFlt MoFExtCpt_stMstWrnLmp /end OUT_MEASUREMENT
 /begin LOC_MEASUREMENT MoFExtCptVacPmp_bbLoc1Cpl MoFExtCptVacPmp_bbLoc2Cpl MoFExtCptVacPmp_bbLoc3Cpl MoFExtCptVacPmp_bbLocCpl MoFExtCptVacPmp_bbOutCpl MoFExtCpt_bNormPmpReq MoFExtCpt_bPmpActvnCondEn MoFExtCpt_cntrDebPVacp MoFExtCpt_cntrDebPVacpCpl MoFExtCpt_cntrDebVacPmpActvnErr MoFExtCpt_cntrDebVacPmpActvnErrCpl MoFExtCpt_cntrDlyVacPmpTest MoFExtCpt_cntrDlyVacPmpTestCpl MoFExtCpt_cntrDlyVacPSnsrTest MoFExtCpt_cntrDlyVacPSnsrTestCpl MoFExtCpt_cntrVacPmpDebDfcSet MoFExtCpt_cntrVacPmpDebDfcSetCpl MoFExtCpt_cntrVacPmpDebEfcErr MoFExtCpt_cntrVacPmpDebEfcErrCpl MoFExtCpt_cntrVacPmpDebHiPErr MoFExtCpt_cntrVacPmpDebHiPErrCpl MoFExtCpt_cntrVacPmpDebSRC1Err MoFExtCpt_cntrVacPmpDebSRC1ErrCpl MoFExtCpt_cntrVacPmpDebSRC2Err MoFExtCpt_cntrVacPmpDebSRC2ErrCpl MoFExtCpt_cntrVacPmpDfcRst MoFExtCpt_cntrVacPmpEfcDebErrHiLo MoFExtCpt_cntrVacPmpEfcDebErrHiLoCpl MoFExtCpt_cntrVacPmpEfcDebErrLoHi MoFExtCpt_cntrVacPmpEfcDebErrLoHiCpl MoFExtCpt_cntrVacPmpPlauTest MoFExtCpt_cntrVacPmpPlauTestCpl MoFExtCpt_cntrVacPSensrDebErr MoFExtCpt_cntrVacPSensrDebErrCpl MoFExtCpt_flgBrkOld MoFExtCpt_flgEnvPSnsr MoFExtCpt_flgHiVacPErr MoFExtCpt_flgHys MoFExtCpt_flgNoPmpReq MoFExtCpt_flgNotBrkDlyd MoFExtCpt_flgNotBrkDlydOld MoFExtCpt_flgPmpReq MoFExtCpt_flgPmpRly MoFExtCpt_flgVacPAdcErr1 MoFExtCpt_flgVacPAdcErr2 MoFExtCpt_flgVacPmpActvnErr MoFExtCpt_flgVacPmpClr MoFExtCpt_flgVacPmpEfcErr MoFExtCpt_flgVacPmpLvl1Err MoFExtCpt_flgVacPmpSrcErr1 MoFExtCpt_flgVacPmpSrcErr2 MoFExtCpt_flgVacPmpTestCfmStrtd MoFExtCpt_flgVacPmpTestCfmStrtdOld MoFExtCpt_flgVacPmpTestFinshd MoFExtCpt_flgVacPmpTestStrt MoFExtCpt_flgVacPmpTestStrtOld MoFExtCpt_flgVacPSnsrStuckErr MoFExtCpt_flgVacPSnsrTestFinshd MoFExtCpt_pEnvPUpd MoFExtCpt_pEnvPUpdCpl MoFExtCpt_PEnv_p MoFExtCpt_PEnv_pCpl MoFExtCpt_pRawEnvP MoFExtCpt_pRawEnvPCpl MoFExtCpt_pRel MoFExtCpt_pRelCpl MoFExtCpt_pSampleVacPmp MoFExtCpt_pSampleVacPmpCpl MoFExtCpt_pSampleVacPSensr MoFExtCpt_pSampleVacPSensrCpl MoFExtCpt_pSpiSnsrCnvrVal MoFExtCpt_pSpiSnsrCnvrValCpl MoFExtCpt_pSpiSnsrVal MoFExtCpt_pThdPmpReqOff MoFExtCpt_pThdPmpReqOffCpl MoFExtCpt_pThdPmpReqOn MoFExtCpt_pThdPmpReqOnCpl MoFExtCpt_ptrVacPmpFil MoFExtCpt_ptrVacPmpFilCpl MoFExtCpt_pVacPFild MoFExtCpt_pVacPFildAbslt MoFExtCpt_pVacPFildAbsltCpl MoFExtCpt_pVacPFildCpl MoFExtCpt_pVacPUnfild MoFExtCpt_pVacPUnfild1 MoFExtCpt_pVacPUnfild1Cpl MoFExtCpt_pVacPUnfild2 MoFExtCpt_pVacPUnfild2Cpl MoFExtCpt_pVacPUnfildAbslt MoFExtCpt_pVacPUnfildAbsltCpl MoFExtCpt_pVacPUnfildAbsltDiff MoFExtCpt_pVacPUnfildAbsltDiffCpl MoFExtCpt_pVacPUnfildCpl MoFExtCpt_pVacPUnfildSens1 MoFExtCpt_pVacPUnfildSens1Cpl MoFExtCpt_pVacPUnfildSens2 MoFExtCpt_pVacPUnfildSens2Cpl MoFExtCpt_stBrkBstPFltCpl MoFExtCpt_stDebHiVacPErr MoFExtCpt_stDebHiVacPErrCpl MoFExtCpt_stDebVacPmpEfcErr MoFExtCpt_stDebVacPmpEfcErrCpl MoFExtCpt_stDebVacPSnsrErr MoFExtCpt_stDebVacPSnsrErrCpl MoFExtCpt_stMstWrnLmpCpl MoFExtCpt_stPwt MoFExtCpt_stPwtCpl MoFExtCpt_stVacDebPmpActvnErr MoFExtCpt_stVacDebPmpActvnErrCpl MoFExtCpt_stVacPmpDebSRC1 MoFExtCpt_stVacPmpDebSRC1Cpl MoFExtCpt_stVacPmpDebSRC2 MoFExtCpt_stVacPmpDebSRC2Cpl MoFExtCpt_stVacPmpErr MoFExtCpt_stVacPmpErrCpl MoFExtCpt_uAdcRaw1Msg MoFExtCpt_uAdcRaw2Msg MoFExtCpt_uVacPRaw1 MoFExtCpt_uVacPRaw1Cpl MoFExtCpt_uVacPRaw2 MoFExtCpt_uVacPRaw2Cpl /end LOC_MEASUREMENT
 FUNCTION_VERSION "2.5.0" /end FUNCTION
/begin FUNCTION MoFFrm_Lib "64.0.0    Function Monitoring: Library for Flexray sending and receiving"
 /begin DEF_CHARACTERISTIC MoFFrm_Lib_CRC16H1021Tab_CA MoFFrm_Lib_CRC82FHTab_CA MoFFrm_Lib_CRC8H1DTab_CA MoFFrm_Lib_DataApplSigInstance.divFac_C MoFFrm_Lib_DataApplSigInstance.mulFac_C MoFFrm_Lib_DataApplSigInstance.offsFac_C MoFFrm_Lib_DataNetInfoSigInstance.bytOrder_C MoFFrm_Lib_DataNetInfoSigInstance.posnStrtBit_C MoFFrm_Lib_DataNetInfoSigInstance.sigLen_C MoFFrm_Lib_DataPduRxInstance.bufLen_C MoFFrm_Lib_DataPduRxInstance.bytOrderAlvCntr_C MoFFrm_Lib_DataPduRxInstance.bytOrderCrc_C MoFFrm_Lib_DataPduRxInstance.chksEndVal_C MoFFrm_Lib_DataPduRxInstance.chksStrtVal_C MoFFrm_Lib_DataPduRxInstance.cntrAlvErrDeb_C MoFFrm_Lib_DataPduRxInstance.cntrCrcErrDeb_C MoFFrm_Lib_DataPduRxInstance.cntrMaxAlvDif_C MoFFrm_Lib_DataPduRxInstance.cntrTiOutDeb_C MoFFrm_Lib_DataPduRxInstance.crcId_C MoFFrm_Lib_DataPduRxInstance.cycTi_C MoFFrm_Lib_DataPduRxInstance.diChks_C MoFFrm_Lib_DataPduRxInstance.evalType_C MoFFrm_Lib_DataPduRxInstance.maskAlvCntr_C MoFFrm_Lib_DataPduRxInstance.posnAlvCntrStrtBit_C MoFFrm_Lib_DataPduRxInstance.posnCrcCalcEndByte_C MoFFrm_Lib_DataPduRxInstance.posnCrcCalcStrtByte_C MoFFrm_Lib_DataPduRxInstance.posnCrcStrtBit_C MoFFrm_Lib_DataPduRxInstance.sigLenAlvCntr_C MoFFrm_Lib_DataPduRxInstance.sigLenCrc_C MoFFrm_Lib_DataPduTxInstance.bufLen_C MoFFrm_Lib_DataPduTxInstance.bytOrderAlvCntr_C MoFFrm_Lib_DataPduTxInstance.bytOrderCrc_C MoFFrm_Lib_DataPduTxInstance.chksEndVal_C MoFFrm_Lib_DataPduTxInstance.chksStrtVal_C MoFFrm_Lib_DataPduTxInstance.crcId_C MoFFrm_Lib_DataPduTxInstance.evalType_C MoFFrm_Lib_DataPduTxInstance.posnAlvCntrStrtBit_C MoFFrm_Lib_DataPduTxInstance.posnCrcCalcEndByte_C MoFFrm_Lib_DataPduTxInstance.posnCrcCalcStrtByte_C MoFFrm_Lib_DataPduTxInstance.posnCrcStrtBit_C MoFFrm_Lib_DataPduTxInstance.sigLenAlvCntr_C MoFFrm_Lib_DataPduTxInstance.sigLenCrc_C /end DEF_CHARACTERISTIC
 /begin IN_MEASUREMENT Mo_stCplChk Mo_stMoC Mo_stMoCCpl /end IN_MEASUREMENT
 /begin OUT_MEASUREMENT MoFFrm_Lib_DataPduRxInstance.cntrAlvErrDeb MoFFrm_Lib_DataPduRxInstance.cntrAlvErrDebCpl MoFFrm_Lib_DataPduRxInstance.cntrAlvOld MoFFrm_Lib_DataPduRxInstance.cntrAlvOldCpl MoFFrm_Lib_DataPduRxInstance.cntrCrcErrDeb MoFFrm_Lib_DataPduRxInstance.cntrCrcErrDebCpl MoFFrm_Lib_DataPduRxInstance.cntrCycTi MoFFrm_Lib_DataPduRxInstance.cntrCycTiCpl MoFFrm_Lib_DataPduRxInstance.cntrTiOutDeb MoFFrm_Lib_DataPduRxInstance.cntrTiOutDebCpl MoFFrm_Lib_DataPduRxInstance.crcData MoFFrm_Lib_DataPduRxInstance.crcDataCpl MoFFrm_Lib_DataPduRxInstance.flgPduUpd MoFFrm_Lib_DataPduRxInstance.flgPduUpdCpl MoFFrm_Lib_DataPduTxInstance.cntrAlvOld MoFFrm_Lib_DataPduTxInstance.cntrAlvOldCpl MoFFrm_Lib_DataPduTxInstance.crcData MoFFrm_Lib_DataPduTxInstance.crcDataCpl MoFFrm_Lib_DataPduTxInstance.flgAswTrigTx MoFFrm_Lib_DataPduTxInstance.flgAswTrigTxCpl /end OUT_MEASUREMENT
 FUNCTION_VERSION "64.0.0" /end FUNCTION
/begin FUNCTION MoFFrm_Rx "1000.4.0  Function Monitoring: Frame Manager - Received Messages"
 /begin DEF_CHARACTERISTIC MoFFrm_DataApplSigRx_MoFFrm_flgBrkRaw.divFac_C MoFFrm_DataApplSigRx_MoFFrm_flgBrkRaw.mulFac_C MoFFrm_DataApplSigRx_MoFFrm_flgBrkRaw.offsFac_C MoFFrm_DataApplSigRx_MoFFrm_flgDcChrgnVoltMeasmtErr.divFac_C MoFFrm_DataApplSigRx_MoFFrm_flgDcChrgnVoltMeasmtErr.mulFac_C MoFFrm_DataApplSigRx_MoFFrm_flgDcChrgnVoltMeasmtErr.offsFac_C MoFFrm_DataApplSigRx_MoFFrm_flgDcChrgnVoltMeasmtSysErr.divFac_C MoFFrm_DataApplSigRx_MoFFrm_flgDcChrgnVoltMeasmtSysErr.mulFac_C MoFFrm_DataApplSigRx_MoFFrm_flgDcChrgnVoltMeasmtSysErr.offsFac_C MoFFrm_DataApplSigRx_MoFFrm_flgDcChrgnVoltMeasmtVld.divFac_C MoFFrm_DataApplSigRx_MoFFrm_flgDcChrgnVoltMeasmtVld.mulFac_C MoFFrm_DataApplSigRx_MoFFrm_flgDcChrgnVoltMeasmtVld.offsFac_C MoFFrm_DataApplSigRx_MoFFrm_flgDcChrgnVoltRngErr.divFac_C MoFFrm_DataApplSigRx_MoFFrm_flgDcChrgnVoltRngErr.mulFac_C MoFFrm_DataApplSigRx_MoFFrm_flgDcChrgnVoltRngErr.offsFac_C MoFFrm_DataApplSigRx_MoFFrm_flgDrvrDoorOpen.divFac_C MoFFrm_DataApplSigRx_MoFFrm_flgDrvrDoorOpen.mulFac_C MoFFrm_DataApplSigRx_MoFFrm_flgDrvrDoorOpen.offsFac_C MoFFrm_DataApplSigRx_MoFFrm_flgPreCdngWakeup.divFac_C MoFFrm_DataApplSigRx_MoFFrm_flgPreCdngWakeup.mulFac_C MoFFrm_DataApplSigRx_MoFFrm_flgPreCdngWakeup.offsFac_C MoFFrm_DataApplSigRx_MoFFrm_flgRgnInhbn.divFac_C MoFFrm_DataApplSigRx_MoFFrm_flgRgnInhbn.mulFac_C MoFFrm_DataApplSigRx_MoFFrm_flgRgnInhbn.offsFac_C MoFFrm_DataApplSigRx_MoFFrm_flgVehHldActv.divFac_C MoFFrm_DataApplSigRx_MoFFrm_flgVehHldActv.mulFac_C MoFFrm_DataApplSigRx_MoFFrm_flgVehHldActv.offsFac_C MoFFrm_DataApplSigRx_MoFFrm_nEm01CANRaw.divFac_C MoFFrm_DataApplSigRx_MoFFrm_nEm01CANRaw.mulFac_C MoFFrm_DataApplSigRx_MoFFrm_nEm01CANRaw.offsFac_C MoFFrm_DataApplSigRx_MoFFrm_stCplCrash.divFac_C MoFFrm_DataApplSigRx_MoFFrm_stCplCrash.mulFac_C MoFFrm_DataApplSigRx_MoFFrm_stCplCrash.offsFac_C MoFFrm_DataApplSigRx_MoFFrm_stCrash.divFac_C MoFFrm_DataApplSigRx_MoFFrm_stCrash.mulFac_C MoFFrm_DataApplSigRx_MoFFrm_stCrash.offsFac_C MoFFrm_DataApplSigRx_MoFFrm_stDcdcErr.divFac_C MoFFrm_DataApplSigRx_MoFFrm_stDcdcErr.mulFac_C MoFFrm_DataApplSigRx_MoFFrm_stDcdcErr.offsFac_C MoFFrm_DataApplSigRx_MoFFrm_stDrvrSeatBlt.divFac_C MoFFrm_DataApplSigRx_MoFFrm_stDrvrSeatBlt.mulFac_C MoFFrm_DataApplSigRx_MoFFrm_stDrvrSeatBlt.offsFac_C MoFFrm_DataApplSigRx_MoFFrm_stESMFailr.divFac_C MoFFrm_DataApplSigRx_MoFFrm_stESMFailr.mulFac_C MoFFrm_DataApplSigRx_MoFFrm_stESMFailr.offsFac_C MoFFrm_DataApplSigRx_MoFFrm_stGearNum.divFac_C MoFFrm_DataApplSigRx_MoFFrm_stGearNum.mulFac_C MoFFrm_DataApplSigRx_MoFFrm_stGearNum.offsFac_C MoFFrm_DataApplSigRx_MoFFrm_stHvbCnctn.divFac_C MoFFrm_DataApplSigRx_MoFFrm_stHvbCnctn.mulFac_C MoFFrm_DataApplSigRx_MoFFrm_stHvbCnctn.offsFac_C MoFFrm_DataApplSigRx_MoFFrm_stHvbFltLvl.divFac_C MoFFrm_DataApplSigRx_MoFFrm_stHvbFltLvl.mulFac_C MoFFrm_DataApplSigRx_MoFFrm_stHvbFltLvl.offsFac_C MoFFrm_DataApplSigRx_MoFFrm_stHvIntlck.divFac_C MoFFrm_DataApplSigRx_MoFFrm_stHvIntlck.mulFac_C MoFFrm_DataApplSigRx_MoFFrm_stHvIntlck.offsFac_C MoFFrm_DataApplSigRx_MoFFrm_stIIvtrFltLvl01.divFac_C MoFFrm_DataApplSigRx_MoFFrm_stIIvtrFltLvl01.mulFac_C MoFFrm_DataApplSigRx_MoFFrm_stIIvtrFltLvl01.offsFac_C MoFFrm_DataApplSigRx_MoFFrm_stIvtrOpMod01.divFac_C MoFFrm_DataApplSigRx_MoFFrm_stIvtrOpMod01.mulFac_C MoFFrm_DataApplSigRx_MoFFrm_stIvtrOpMod01.offsFac_C MoFFrm_DataApplSigRx_MoFFrm_stPrkgBrkSwt.divFac_C MoFFrm_DataApplSigRx_MoFFrm_stPrkgBrkSwt.mulFac_C MoFFrm_DataApplSigRx_MoFFrm_stPrkgBrkSwt.offsFac_C MoFFrm_DataApplSigRx_MoFFrm_tqAct01.divFac_C MoFFrm_DataApplSigRx_MoFFrm_tqAct01.mulFac_C MoFFrm_DataApplSigRx_MoFFrm_tqAct01.offsFac_C MoFFrm_DataApplSigRx_MoFFrm_uDcChrgn.divFac_C MoFFrm_DataApplSigRx_MoFFrm_uDcChrgn.mulFac_C MoFFrm_DataApplSigRx_MoFFrm_uDcChrgn.offsFac_C MoFFrm_DataApplSigRx_MoFFrm_uDcdcHvAct.divFac_C MoFFrm_DataApplSigRx_MoFFrm_uDcdcHvAct.mulFac_C MoFFrm_DataApplSigRx_MoFFrm_uDcdcHvAct.offsFac_C MoFFrm_DataApplSigRx_MoFFrm_uDcLnk01.divFac_C MoFFrm_DataApplSigRx_MoFFrm_uDcLnk01.mulFac_C MoFFrm_DataApplSigRx_MoFFrm_uDcLnk01.offsFac_C MoFFrm_DataApplSigRx_MoFFrm_vVeh.divFac_C MoFFrm_DataApplSigRx_MoFFrm_vVeh.mulFac_C MoFFrm_DataApplSigRx_MoFFrm_vVeh.offsFac_C MoFFrm_DataNetInfoSigRx_CONTACT_FREIN1.bytOrder_C MoFFrm_DataNetInfoSigRx_CONTACT_FREIN1.posnStrtBit_C MoFFrm_DataNetInfoSigRx_CONTACT_FREIN1.sigLen_C MoFFrm_DataNetInfoSigRx_CONTACT_FREIN_PRK.bytOrder_C MoFFrm_DataNetInfoSigRx_CONTACT_FREIN_PRK.posnStrtBit_C MoFFrm_DataNetInfoSigRx_CONTACT_FREIN_PRK.sigLen_C MoFFrm_DataNetInfoSigRx_CRASH_AIRBAG.bytOrder_C MoFFrm_DataNetInfoSigRx_CRASH_AIRBAG.posnStrtBit_C MoFFrm_DataNetInfoSigRx_CRASH_AIRBAG.sigLen_C MoFFrm_DataNetInfoSigRx_CRASH_AIRBAG_COMPLI.bytOrder_C MoFFrm_DataNetInfoSigRx_CRASH_AIRBAG_COMPLI.posnStrtBit_C MoFFrm_DataNetInfoSigRx_CRASH_AIRBAG_COMPLI.sigLen_C MoFFrm_DataNetInfoSigRx_DCDC_FAULT_LEVEL.bytOrder_C MoFFrm_DataNetInfoSigRx_DCDC_FAULT_LEVEL.posnStrtBit_C /end DEF_CHARACTERISTIC
 /begin IN_MEASUREMENT MoXFrm_Buf_DCDC_283h MoXFrm_Buf_DCDC_293h MoXFrm_Buf_HS3_AUTO_GEARBOX_SWITCH_STATUS MoXFrm_Buf_HVBAT_205h MoXFrm_Buf_HVBAT_325h MoXFrm_Buf_INV_217h MoXFrm_Buf_INV_237 MoXFrm_Buf_INV_427h MoXFrm_Buf_IS_DAT_ABR_50Dh MoXFrm_Buf_IS_DAT_BSI_412h MoXFrm_Buf_IS_DYN_ABR_38Dh MoXFrm_Buf_PDU_BusVoltages_308 MoXFrm_Buf_VCU_AIRBAG_351h MoXFrm_Buf_VCU_eBCCM_432h MoXFrm_flgUpdDCDC_283h MoXFrm_flgUpdDCDC_293h MoXFrm_flgUpdHS3_AUTO_GEARBOX_SWITCH_STATUS MoXFrm_flgUpdHVBAT_205h MoXFrm_flgUpdHVBAT_325h MoXFrm_flgUpdINV_217h MoXFrm_flgUpdINV_237 MoXFrm_flgUpdINV_427h MoXFrm_flgUpdIS_DAT_ABR_50Dh MoXFrm_flgUpdIS_DAT_BSI_412h MoXFrm_flgUpdIS_DYN_ABR_38Dh MoXFrm_flgUpdPDU_BusVoltages_308 MoXFrm_flgUpdVCU_AIRBAG_351h MoXFrm_flgUpdVCU_eBCCM_432h Mo_stCplChk Mo_stMoC Mo_stMoCCpl /end IN_MEASUREMENT
 /begin OUT_MEASUREMENT MoFFrm_flgBrkRaw MoFFrm_flgBrkRawQlfr MoFFrm_flgDcChrgnVoltMeasmtErr MoFFrm_flgDcChrgnVoltMeasmtSysErr MoFFrm_flgDcChrgnVoltMeasmtVld MoFFrm_flgDcChrgnVoltRngErr MoFFrm_flgDrvrDoorOpen MoFFrm_flgDrvrDoorOpenQlfr MoFFrm_flgPreCdngWakeup MoFFrm_flgPreCdngWakeupQlfr MoFFrm_flgRgnInhbn MoFFrm_flgRgnInhbnQlfr MoFFrm_flgVehHldActv MoFFrm_flgVehHldActvQlfr MoFFrm_nEm01CANRaw MoFFrm_nEm01CANRawQlfr MoFFrm_Rx_stPdu_DCDC_283h MoFFrm_Rx_stPdu_DCDC_293h MoFFrm_Rx_stPdu_HS3_AUTO_GEARBOX_SWITCH_STATUS MoFFrm_Rx_stPdu_HVBAT_205h MoFFrm_Rx_stPdu_HVBAT_325h MoFFrm_Rx_stPdu_INV_217h MoFFrm_Rx_stPdu_INV_237 MoFFrm_Rx_stPdu_INV_427h MoFFrm_Rx_stPdu_IS_DAT_ABR_50Dh MoFFrm_Rx_stPdu_IS_DAT_BSI_412h MoFFrm_Rx_stPdu_IS_DYN_ABR_38Dh MoFFrm_Rx_stPdu_PDU_BusVoltages_308 MoFFrm_Rx_stPdu_VCU_AIRBAG_351h MoFFrm_Rx_stPdu_VCU_eBCCM_432h MoFFrm_stCplCrash MoFFrm_stCplCrashQlfr MoFFrm_stCrash MoFFrm_stCrashQlfr MoFFrm_stDcdcErr MoFFrm_stDcdcErrQlfr MoFFrm_stDrvrSeatBlt MoFFrm_stDrvrSeatBltQlfr MoFFrm_stESMFailr MoFFrm_stESMFailrQlfr MoFFrm_stGearNum MoFFrm_stGearNumQlfr MoFFrm_stHvbCnctn MoFFrm_stHvbCnctnQlfr MoFFrm_stHvbFltLvl MoFFrm_stHvbFltLvlQlfr MoFFrm_stHvIntlck MoFFrm_stHvIntlckQlfr MoFFrm_stIIvtrFltLvl01 MoFFrm_stIIvtrFltLvl01Qlfr MoFFrm_stIvtrOpMod01 MoFFrm_stIvtrOpMod01Qlfr MoFFrm_stPrkgBrkSwt MoFFrm_stPrkgBrkSwtQlfr MoFFrm_tqAct01 MoFFrm_tqAct01Qlfr MoFFrm_uDcChrgn MoFFrm_uDcChrgnQlfr MoFFrm_uDcdcHvAct MoFFrm_uDcdcHvActQlfr MoFFrm_uDcLnk01 MoFFrm_uDcLnk01Qlfr MoFFrm_vVeh MoFFrm_vVehQlfr /end OUT_MEASUREMENT
 /begin LOC_MEASUREMENT MoFFrmRx_bbMoFFrm_flgBrkRawCpl MoFFrmRx_bbMoFFrm_flgDcChrgnVoltMeasmtErrCpl MoFFrmRx_bbMoFFrm_flgDcChrgnVoltMeasmtSysErrCpl MoFFrmRx_bbMoFFrm_flgDcChrgnVoltMeasmtVldCpl MoFFrmRx_bbMoFFrm_flgDcChrgnVoltRngErrCpl MoFFrmRx_bbMoFFrm_flgDrvrDoorOpenCpl MoFFrmRx_bbMoFFrm_flgPreCdngWakeupCpl MoFFrmRx_bbMoFFrm_flgRgnInhbnCpl MoFFrmRx_bbMoFFrm_flgVehHldActvCpl MoFFrm_flgBrkRawQlfrCpl MoFFrm_flgDrvrDoorOpenQlfrCpl MoFFrm_flgPreCdngWakeupQlfrCpl MoFFrm_flgRgnInhbnQlfrCpl MoFFrm_flgVehHldActvQlfrCpl MoFFrm_nEm01CANRawCpl MoFFrm_nEm01CANRawQlfrCpl MoFFrm_Rx_DataPdu_DCDC_283h.cntrAlvErrDeb MoFFrm_Rx_DataPdu_DCDC_283h.cntrAlvErrDebCpl MoFFrm_Rx_DataPdu_DCDC_283h.cntrAlvOld MoFFrm_Rx_DataPdu_DCDC_283h.cntrAlvOldCpl MoFFrm_Rx_DataPdu_DCDC_283h.cntrCrcErrDeb MoFFrm_Rx_DataPdu_DCDC_283h.cntrCrcErrDebCpl MoFFrm_Rx_DataPdu_DCDC_283h.cntrCycTi MoFFrm_Rx_DataPdu_DCDC_283h.cntrCycTiCpl MoFFrm_Rx_DataPdu_DCDC_283h.cntrTiOutDeb MoFFrm_Rx_DataPdu_DCDC_283h.cntrTiOutDebCpl MoFFrm_Rx_DataPdu_DCDC_283h.crcData MoFFrm_Rx_DataPdu_DCDC_283h.crcDataCpl MoFFrm_Rx_DataPdu_DCDC_283h.flgPduUpd MoFFrm_Rx_DataPdu_DCDC_283h.flgPduUpdCpl MoFFrm_Rx_DataPdu_DCDC_293h.cntrAlvErrDeb MoFFrm_Rx_DataPdu_DCDC_293h.cntrAlvErrDebCpl MoFFrm_Rx_DataPdu_DCDC_293h.cntrAlvOld MoFFrm_Rx_DataPdu_DCDC_293h.cntrAlvOldCpl MoFFrm_Rx_DataPdu_DCDC_293h.cntrCrcErrDeb MoFFrm_Rx_DataPdu_DCDC_293h.cntrCrcErrDebCpl MoFFrm_Rx_DataPdu_DCDC_293h.cntrCycTi MoFFrm_Rx_DataPdu_DCDC_293h.cntrCycTiCpl MoFFrm_Rx_DataPdu_DCDC_293h.cntrTiOutDeb MoFFrm_Rx_DataPdu_DCDC_293h.cntrTiOutDebCpl MoFFrm_Rx_DataPdu_DCDC_293h.crcData MoFFrm_Rx_DataPdu_DCDC_293h.crcDataCpl MoFFrm_Rx_DataPdu_DCDC_293h.flgPduUpd MoFFrm_Rx_DataPdu_DCDC_293h.flgPduUpdCpl MoFFrm_Rx_DataPdu_HS3_AUTO_GEARBOX_SWITCH_STATUS.cntrAlvErrDeb MoFFrm_Rx_DataPdu_HS3_AUTO_GEARBOX_SWITCH_STATUS.cntrAlvErrDebCpl MoFFrm_Rx_DataPdu_HS3_AUTO_GEARBOX_SWITCH_STATUS.cntrAlvOld MoFFrm_Rx_DataPdu_HS3_AUTO_GEARBOX_SWITCH_STATUS.cntrAlvOldCpl MoFFrm_Rx_DataPdu_HS3_AUTO_GEARBOX_SWITCH_STATUS.cntrCrcErrDeb MoFFrm_Rx_DataPdu_HS3_AUTO_GEARBOX_SWITCH_STATUS.cntrCrcErrDebCpl MoFFrm_Rx_DataPdu_HS3_AUTO_GEARBOX_SWITCH_STATUS.cntrCycTi MoFFrm_Rx_DataPdu_HS3_AUTO_GEARBOX_SWITCH_STATUS.cntrCycTiCpl MoFFrm_Rx_DataPdu_HS3_AUTO_GEARBOX_SWITCH_STATUS.cntrTiOutDeb MoFFrm_Rx_DataPdu_HS3_AUTO_GEARBOX_SWITCH_STATUS.cntrTiOutDebCpl MoFFrm_Rx_DataPdu_HS3_AUTO_GEARBOX_SWITCH_STATUS.crcData MoFFrm_Rx_DataPdu_HS3_AUTO_GEARBOX_SWITCH_STATUS.crcDataCpl MoFFrm_Rx_DataPdu_HS3_AUTO_GEARBOX_SWITCH_STATUS.flgPduUpd MoFFrm_Rx_DataPdu_HS3_AUTO_GEARBOX_SWITCH_STATUS.flgPduUpdCpl MoFFrm_Rx_DataPdu_HVBAT_205h.cntrAlvErrDeb MoFFrm_Rx_DataPdu_HVBAT_205h.cntrAlvErrDebCpl MoFFrm_Rx_DataPdu_HVBAT_205h.cntrAlvOld MoFFrm_Rx_DataPdu_HVBAT_205h.cntrAlvOldCpl MoFFrm_Rx_DataPdu_HVBAT_205h.cntrCrcErrDeb MoFFrm_Rx_DataPdu_HVBAT_205h.cntrCrcErrDebCpl MoFFrm_Rx_DataPdu_HVBAT_205h.cntrCycTi MoFFrm_Rx_DataPdu_HVBAT_205h.cntrCycTiCpl MoFFrm_Rx_DataPdu_HVBAT_205h.cntrTiOutDeb MoFFrm_Rx_DataPdu_HVBAT_205h.cntrTiOutDebCpl MoFFrm_Rx_DataPdu_HVBAT_205h.crcData MoFFrm_Rx_DataPdu_HVBAT_205h.crcDataCpl MoFFrm_Rx_DataPdu_HVBAT_205h.flgPduUpd MoFFrm_Rx_DataPdu_HVBAT_205h.flgPduUpdCpl MoFFrm_Rx_DataPdu_HVBAT_325h.cntrAlvErrDeb MoFFrm_Rx_DataPdu_HVBAT_325h.cntrAlvErrDebCpl MoFFrm_Rx_DataPdu_HVBAT_325h.cntrAlvOld MoFFrm_Rx_DataPdu_HVBAT_325h.cntrAlvOldCpl MoFFrm_Rx_DataPdu_HVBAT_325h.cntrCrcErrDeb MoFFrm_Rx_DataPdu_HVBAT_325h.cntrCrcErrDebCpl MoFFrm_Rx_DataPdu_HVBAT_325h.cntrCycTi MoFFrm_Rx_DataPdu_HVBAT_325h.cntrCycTiCpl MoFFrm_Rx_DataPdu_HVBAT_325h.cntrTiOutDeb MoFFrm_Rx_DataPdu_HVBAT_325h.cntrTiOutDebCpl MoFFrm_Rx_DataPdu_HVBAT_325h.crcData MoFFrm_Rx_DataPdu_HVBAT_325h.crcDataCpl MoFFrm_Rx_DataPdu_HVBAT_325h.flgPduUpd MoFFrm_Rx_DataPdu_HVBAT_325h.flgPduUpdCpl MoFFrm_Rx_DataPdu_INV_217h.cntrAlvErrDeb MoFFrm_Rx_DataPdu_INV_217h.cntrAlvErrDebCpl MoFFrm_Rx_DataPdu_INV_217h.cntrAlvOld MoFFrm_Rx_DataPdu_INV_217h.cntrAlvOldCpl MoFFrm_Rx_DataPdu_INV_217h.cntrCrcErrDeb MoFFrm_Rx_DataPdu_INV_217h.cntrCrcErrDebCpl MoFFrm_Rx_DataPdu_INV_217h.cntrCycTi MoFFrm_Rx_DataPdu_INV_217h.cntrCycTiCpl MoFFrm_Rx_DataPdu_INV_217h.cntrTiOutDeb MoFFrm_Rx_DataPdu_INV_217h.cntrTiOutDebCpl MoFFrm_Rx_DataPdu_INV_217h.crcData MoFFrm_Rx_DataPdu_INV_217h.crcDataCpl MoFFrm_Rx_DataPdu_INV_217h.flgPduUpd MoFFrm_Rx_DataPdu_INV_217h.flgPduUpdCpl MoFFrm_Rx_DataPdu_INV_237.cntrAlvErrDeb MoFFrm_Rx_DataPdu_INV_237.cntrAlvErrDebCpl MoFFrm_Rx_DataPdu_INV_237.cntrAlvOld MoFFrm_Rx_DataPdu_INV_237.cntrAlvOldCpl MoFFrm_Rx_DataPdu_INV_237.cntrCrcErrDeb MoFFrm_Rx_DataPdu_INV_237.cntrCrcErrDebCpl MoFFrm_Rx_DataPdu_INV_237.cntrCycTi MoFFrm_Rx_DataPdu_INV_237.cntrCycTiCpl MoFFrm_Rx_DataPdu_INV_237.cntrTiOutDeb MoFFrm_Rx_DataPdu_INV_237.cntrTiOutDebCpl MoFFrm_Rx_DataPdu_INV_237.crcData MoFFrm_Rx_DataPdu_INV_237.crcDataCpl MoFFrm_Rx_DataPdu_INV_237.flgPduUpd MoFFrm_Rx_DataPdu_INV_237.flgPduUpdCpl MoFFrm_Rx_DataPdu_INV_427h.cntrAlvErrDeb MoFFrm_Rx_DataPdu_INV_427h.cntrAlvErrDebCpl MoFFrm_Rx_DataPdu_INV_427h.cntrAlvOld MoFFrm_Rx_DataPdu_INV_427h.cntrAlvOldCpl MoFFrm_Rx_DataPdu_INV_427h.cntrCrcErrDeb MoFFrm_Rx_DataPdu_INV_427h.cntrCrcErrDebCpl MoFFrm_Rx_DataPdu_INV_427h.cntrCycTi MoFFrm_Rx_DataPdu_INV_427h.cntrCycTiCpl MoFFrm_Rx_DataPdu_INV_427h.cntrTiOutDeb MoFFrm_Rx_DataPdu_INV_427h.cntrTiOutDebCpl MoFFrm_Rx_DataPdu_INV_427h.crcData MoFFrm_Rx_DataPdu_INV_427h.crcDataCpl MoFFrm_Rx_DataPdu_INV_427h.flgPduUpd MoFFrm_Rx_DataPdu_INV_427h.flgPduUpdCpl MoFFrm_Rx_DataPdu_IS_DAT_ABR_50Dh.cntrAlvErrDeb MoFFrm_Rx_DataPdu_IS_DAT_ABR_50Dh.cntrAlvErrDebCpl MoFFrm_Rx_DataPdu_IS_DAT_ABR_50Dh.cntrAlvOld MoFFrm_Rx_DataPdu_IS_DAT_ABR_50Dh.cntrAlvOldCpl MoFFrm_Rx_DataPdu_IS_DAT_ABR_50Dh.cntrCrcErrDeb MoFFrm_Rx_DataPdu_IS_DAT_ABR_50Dh.cntrCrcErrDebCpl MoFFrm_Rx_DataPdu_IS_DAT_ABR_50Dh.cntrCycTi MoFFrm_Rx_DataPdu_IS_DAT_ABR_50Dh.cntrCycTiCpl MoFFrm_Rx_DataPdu_IS_DAT_ABR_50Dh.cntrTiOutDeb MoFFrm_Rx_DataPdu_IS_DAT_ABR_50Dh.cntrTiOutDebCpl MoFFrm_Rx_DataPdu_IS_DAT_ABR_50Dh.crcData MoFFrm_Rx_DataPdu_IS_DAT_ABR_50Dh.crcDataCpl MoFFrm_Rx_DataPdu_IS_DAT_ABR_50Dh.flgPduUpd MoFFrm_Rx_DataPdu_IS_DAT_ABR_50Dh.flgPduUpdCpl MoFFrm_Rx_DataPdu_IS_DAT_BSI_412h.cntrAlvErrDeb MoFFrm_Rx_DataPdu_IS_DAT_BSI_412h.cntrAlvErrDebCpl MoFFrm_Rx_DataPdu_IS_DAT_BSI_412h.cntrAlvOld MoFFrm_Rx_DataPdu_IS_DAT_BSI_412h.cntrAlvOldCpl MoFFrm_Rx_DataPdu_IS_DAT_BSI_412h.cntrCrcErrDeb MoFFrm_Rx_DataPdu_IS_DAT_BSI_412h.cntrCrcErrDebCpl MoFFrm_Rx_DataPdu_IS_DAT_BSI_412h.cntrCycTi MoFFrm_Rx_DataPdu_IS_DAT_BSI_412h.cntrCycTiCpl MoFFrm_Rx_DataPdu_IS_DAT_BSI_412h.cntrTiOutDeb MoFFrm_Rx_DataPdu_IS_DAT_BSI_412h.cntrTiOutDebCpl MoFFrm_Rx_DataPdu_IS_DAT_BSI_412h.crcData MoFFrm_Rx_DataPdu_IS_DAT_BSI_412h.crcDataCpl MoFFrm_Rx_DataPdu_IS_DAT_BSI_412h.flgPduUpd MoFFrm_Rx_DataPdu_IS_DAT_BSI_412h.flgPduUpdCpl MoFFrm_Rx_DataPdu_IS_DYN_ABR_38Dh.cntrAlvErrDeb MoFFrm_Rx_DataPdu_IS_DYN_ABR_38Dh.cntrAlvErrDebCpl MoFFrm_Rx_DataPdu_IS_DYN_ABR_38Dh.cntrAlvOld MoFFrm_Rx_DataPdu_IS_DYN_ABR_38Dh.cntrAlvOldCpl MoFFrm_Rx_DataPdu_IS_DYN_ABR_38Dh.cntrCrcErrDeb MoFFrm_Rx_DataPdu_IS_DYN_ABR_38Dh.cntrCrcErrDebCpl MoFFrm_Rx_DataPdu_IS_DYN_ABR_38Dh.cntrCycTi MoFFrm_Rx_DataPdu_IS_DYN_ABR_38Dh.cntrCycTiCpl MoFFrm_Rx_DataPdu_IS_DYN_ABR_38Dh.cntrTiOutDeb MoFFrm_Rx_DataPdu_IS_DYN_ABR_38Dh.cntrTiOutDebCpl MoFFrm_Rx_DataPdu_IS_DYN_ABR_38Dh.crcData MoFFrm_Rx_DataPdu_IS_DYN_ABR_38Dh.crcDataCpl MoFFrm_Rx_DataPdu_IS_DYN_ABR_38Dh.flgPduUpd MoFFrm_Rx_DataPdu_IS_DYN_ABR_38Dh.flgPduUpdCpl MoFFrm_Rx_DataPdu_PDU_BusVoltages_308.cntrAlvErrDeb MoFFrm_Rx_DataPdu_PDU_BusVoltages_308.cntrAlvErrDebCpl MoFFrm_Rx_DataPdu_PDU_BusVoltages_308.cntrAlvOld MoFFrm_Rx_DataPdu_PDU_BusVoltages_308.cntrAlvOldCpl MoFFrm_Rx_DataPdu_PDU_BusVoltages_308.cntrCrcErrDeb MoFFrm_Rx_DataPdu_PDU_BusVoltages_308.cntrCrcErrDebCpl MoFFrm_Rx_DataPdu_PDU_BusVoltages_308.cntrCycTi MoFFrm_Rx_DataPdu_PDU_BusVoltages_308.cntrCycTiCpl MoFFrm_Rx_DataPdu_PDU_BusVoltages_308.cntrTiOutDeb MoFFrm_Rx_DataPdu_PDU_BusVoltages_308.cntrTiOutDebCpl MoFFrm_Rx_DataPdu_PDU_BusVoltages_308.crcData MoFFrm_Rx_DataPdu_PDU_BusVoltages_308.crcDataCpl MoFFrm_Rx_DataPdu_PDU_BusVoltages_308.flgPduUpd MoFFrm_Rx_DataPdu_PDU_BusVoltages_308.flgPduUpdCpl MoFFrm_Rx_DataPdu_VCU_AIRBAG_351h.cntrAlvErrDeb MoFFrm_Rx_DataPdu_VCU_AIRBAG_351h.cntrAlvErrDebCpl MoFFrm_Rx_DataPdu_VCU_AIRBAG_351h.cntrAlvOld MoFFrm_Rx_DataPdu_VCU_AIRBAG_351h.cntrAlvOldCpl MoFFrm_Rx_DataPdu_VCU_AIRBAG_351h.cntrCrcErrDeb MoFFrm_Rx_DataPdu_VCU_AIRBAG_351h.cntrCrcErrDebCpl MoFFrm_Rx_DataPdu_VCU_AIRBAG_351h.cntrCycTi MoFFrm_Rx_DataPdu_VCU_AIRBAG_351h.cntrCycTiCpl MoFFrm_Rx_DataPdu_VCU_AIRBAG_351h.cntrTiOutDeb MoFFrm_Rx_DataPdu_VCU_AIRBAG_351h.cntrTiOutDebCpl MoFFrm_Rx_DataPdu_VCU_AIRBAG_351h.crcData MoFFrm_Rx_DataPdu_VCU_AIRBAG_351h.crcDataCpl MoFFrm_Rx_DataPdu_VCU_AIRBAG_351h.flgPduUpd MoFFrm_Rx_DataPdu_VCU_AIRBAG_351h.flgPduUpdCpl MoFFrm_Rx_DataPdu_VCU_eBCCM_432h.cntrAlvErrDeb MoFFrm_Rx_DataPdu_VCU_eBCCM_432h.cntrAlvErrDebCpl MoFFrm_Rx_DataPdu_VCU_eBCCM_432h.cntrAlvOld MoFFrm_Rx_DataPdu_VCU_eBCCM_432h.cntrAlvOldCpl MoFFrm_Rx_DataPdu_VCU_eBCCM_432h.cntrCrcErrDeb MoFFrm_Rx_DataPdu_VCU_eBCCM_432h.cntrCrcErrDebCpl MoFFrm_Rx_DataPdu_VCU_eBCCM_432h.cntrCycTi MoFFrm_Rx_DataPdu_VCU_eBCCM_432h.cntrCycTiCpl MoFFrm_Rx_DataPdu_VCU_eBCCM_432h.cntrTiOutDeb MoFFrm_Rx_DataPdu_VCU_eBCCM_432h.cntrTiOutDebCpl MoFFrm_Rx_DataPdu_VCU_eBCCM_432h.crcData MoFFrm_Rx_DataPdu_VCU_eBCCM_432h.crcDataCpl MoFFrm_Rx_DataPdu_VCU_eBCCM_432h.flgPduUpd MoFFrm_Rx_DataPdu_VCU_eBCCM_432h.flgPduUpdCpl MoFFrm_Rx_mirrBuf MoFFrm_Rx_rawCONTACT_FREIN1 MoFFrm_Rx_rawCONTACT_FREIN_PRK MoFFrm_Rx_rawCRASH_AIRBAG MoFFrm_Rx_rawCRASH_AIRBAG_COMPLI MoFFrm_Rx_rawDCDC_FAULT_LEVEL MoFFrm_Rx_rawDCDC_IN_VOLTAGE MoFFrm_Rx_rawDRIVER_DOOR_INFO MoFFrm_Rx_rawDRV_INFO_DRVR_SEAT_BELT MoFFrm_Rx_rawHVBAT_CONNECT_STS MoFFrm_Rx_rawHVBAT_FAULT MoFFrm_Rx_rawHVBAT_HVIL_STS MoFFrm_Rx_rawINV_DC_BUS_VOLTAGE MoFFrm_Rx_rawINV_FAULT_LEVEL MoFFrm_Rx_rawINV_HILLHOLD_STATUS MoFFrm_Rx_rawINV_MTR_ACTUAL_TRQ MoFFrm_Rx_rawINV_MTR_SPEED MoFFrm_Rx_rawINV_OP_MODE MoFFrm_Rx_rawPDU_FlgUBus_ActErr MoFFrm_Rx_rawPDU_FlgUBus_OnceErr MoFFrm_Rx_rawPDU_FlgUBus_Reliable MoFFrm_Rx_rawPDU_FlgUBus_SysErr MoFFrm_Rx_rawPDU_UBus_V MoFFrm_Rx_rawPRECOND_ELEC_WAKEUP MoFFrm_Rx_rawREGUL_ABR MoFFrm_Rx_rawTGLM_FAILURE_STATE MoFFrm_Rx_rawTOGGLE_MONOSTABLE_POS MoFFrm_Rx_rawVITESSE_VEHICULE_ROUES MoFFrm_Rx_stPdu_DCDC_283hCpl MoFFrm_Rx_stPdu_DCDC_293hCpl MoFFrm_Rx_stPdu_HS3_AUTO_GEARBOX_SWITCH_STATUSCpl MoFFrm_Rx_stPdu_HVBAT_205hCpl MoFFrm_Rx_stPdu_HVBAT_325hCpl MoFFrm_Rx_stPdu_INV_217hCpl MoFFrm_Rx_stPdu_INV_237Cpl MoFFrm_Rx_stPdu_INV_427hCpl MoFFrm_Rx_stPdu_IS_DAT_ABR_50DhCpl MoFFrm_Rx_stPdu_IS_DAT_BSI_412hCpl MoFFrm_Rx_stPdu_IS_DYN_ABR_38DhCpl MoFFrm_Rx_stPdu_PDU_BusVoltages_308Cpl MoFFrm_Rx_stPdu_VCU_AIRBAG_351hCpl MoFFrm_Rx_stPdu_VCU_eBCCM_432hCpl MoFFrm_stCplCrashCpl MoFFrm_stCplCrashQlfrCpl MoFFrm_stCrashCpl MoFFrm_stCrashQlfrCpl MoFFrm_stDcdcErrCpl MoFFrm_stDcdcErrQlfrCpl MoFFrm_stDrvrSeatBltCpl MoFFrm_stDrvrSeatBltQlfrCpl MoFFrm_stESMFailrCpl MoFFrm_stESMFailrQlfrCpl MoFFrm_stGearNumCpl MoFFrm_stGearNumQlfrCpl MoFFrm_stHvbCnctnCpl MoFFrm_stHvbCnctnQlfrCpl MoFFrm_stHvbFltLvlCpl MoFFrm_stHvbFltLvlQlfrCpl MoFFrm_stHvIntlckCpl MoFFrm_stHvIntlckQlfrCpl MoFFrm_stIIvtrFltLvl01Cpl MoFFrm_stIIvtrFltLvl01QlfrCpl MoFFrm_stIvtrOpMod01Cpl MoFFrm_stIvtrOpMod01QlfrCpl MoFFrm_stPrkgBrkSwtCpl MoFFrm_stPrkgBrkSwtQlfrCpl MoFFrm_tqAct01Cpl MoFFrm_tqAct01QlfrCpl MoFFrm_uDcChrgnCpl MoFFrm_uDcChrgnQlfrCpl MoFFrm_uDcdcHvActCpl MoFFrm_uDcdcHvActQlfrCpl MoFFrm_uDcLnk01Cpl MoFFrm_uDcLnk01QlfrCpl MoFFrm_vVehCpl MoFFrm_vVehQlfrCpl /end LOC_MEASUREMENT
 FUNCTION_VERSION "1000.4.0" /end FUNCTION
/begin COMPU_METHOD B_TRUE "" TAB_VERB "%6.3" "" COMPU_TAB_REF B_TRUE /end COMPU_METHOD
/begin COMPU_VTAB B_TRUE "" TAB_VERB 2 0 "FALSE" 1 "TRUE" /end COMPU_VTAB
/begin COMPU_METHOD CoPtFH_stPwt_VERB "" TAB_VERB "%6.3" "" COMPU_TAB_REF CoPtFH_stPwt_VERB /end COMPU_METHOD
/begin COMPU_VTAB CoPtFH_stPwt_VERB "" TAB_VERB 16 0 "GMP inactif" 1 "Reserve" 2 "Reserve1" 3 "Reserve2" 4 "Activation GMP" 5 "Reserve3" 6 "Reserve4" 7 "Reserve5" 8 "GMP actif" 9 "Reserve6" 10 "Desactivation_GMP" 11 "Reserve7" 12 "Maintien_post_desactivation_GMP" 13 "Reserve8" 14 "GMP_au_repos" 15 "Reserve9" /end COMPU_VTAB
/begin COMPU_METHOD DFC_OneToOne "" RAT_FUNC "%6.2" "-" COEFFS 0 1 0 0 0 1 /end COMPU_METHOD
/begin COMPU_METHOD DFES_OneToOne "" RAT_FUNC "%6.2" "-" COEFFS 0 1 0 0 0 1 /end COMPU_METHOD
/begin COMPU_METHOD DINH_ct_Compu "" RAT_FUNC "%6.0" "" COEFFS 0 -1 4096 0 0 1 /end COMPU_METHOD
/begin COMPU_METHOD fak_uw_b1 "" RAT_FUNC "%7.6" "-" COEFFS 0 65536 0 0 0 1 /end COMPU_METHOD
/begin COMPU_METHOD fak_uw_q0p01 "" RAT_FUNC "%6.4" "-" COEFFS 0 1 0 0 0 0.01 /end COMPU_METHOD
/begin COMPU_METHOD OneToOne "" RAT_FUNC "%6.2" "-" COEFFS 0 1 0 0 0 1 /end COMPU_METHOD
/begin COMPU_METHOD PPFLTDIFF_TYPTWINFLW_SC_Compu "" TAB_VERB "%6.3" "" COMPU_TAB_REF PPFLTDIFF_TYPTWINFLW_SC_Compu /end COMPU_METHOD
/begin COMPU_VTAB PPFLTDIFF_TYPTWINFLW_SC_Compu "" TAB_VERB 2 0 "False" 1 "True" /end COMPU_VTAB
/begin COMPU_METHOD PPFLTDS_TYPAVL_SC_Compu "" TAB_VERB "%6.3" "" COMPU_TAB_REF PPFLTDS_TYPAVL_SC_Compu /end COMPU_METHOD
/begin COMPU_VTAB PPFLTDS_TYPAVL_SC_Compu "" TAB_VERB 2 0 "False" 1 "True" /end COMPU_VTAB
/begin COMPU_METHOD PPFLTUS_TYPAVL_SY_Compu "" TAB_VERB "%6.3" "" COMPU_TAB_REF PPFLTUS_TYPAVL_SY_Compu /end COMPU_METHOD
/begin COMPU_VTAB PPFLTUS_TYPAVL_SY_Compu "" TAB_VERB 2 0 "False" 1 "True" /end COMPU_VTAB
/begin COMPU_METHOD p_q0p039 "" RAT_FUNC "%6.4" "hPa" COEFFS 0 256 0 0 0 10 /end COMPU_METHOD
/begin COMPU_METHOD RBPtCel_n_1p0_1 "" RAT_FUNC "%6.2" "rpm" COEFFS 0 1 0 0 0 1 /end COMPU_METHOD
/begin COMPU_METHOD RBPtCel_p_1p0_1 "" RAT_FUNC "%6.2" "hPa" COEFFS 0 1 0 0 0 1 /end COMPU_METHOD
/begin COMPU_METHOD RBPtCel_tq_0p1_1 "" RAT_FUNC "%6.3" "Nm" COEFFS 0 10 0 0 0 1 /end COMPU_METHOD
/begin COMPU_METHOD RBPtCel_u_0p1_1 "" RAT_FUNC "%6.3" "V" COEFFS 0 10 0 0 0 1 /end COMPU_METHOD
/begin COMPU_METHOD RBPtCel_u_0p2_1 "" RAT_FUNC "%6.3" "mV" COEFFS 0 5 0 0 0 1 /end COMPU_METHOD
/begin COMPU_METHOD RBPtCel_u_1p0_1 "" RAT_FUNC "%6.2" "V" COEFFS 0 1 0 0 0 1 /end COMPU_METHOD
/begin COMPU_METHOD RBPtCel_v_0p01_1 "" RAT_FUNC "%6.4" "km/h" COEFFS 0 100 0 0 0 1 /end COMPU_METHOD
/begin COMPU_METHOD vel_q0p01 "" RAT_FUNC "%6.4" "km/h" COEFFS 0 100 0 0 0 1 /end COMPU_METHOD
/begin COMPU_METHOD zk10msxs_uw_b655p36PT1 "" RAT_FUNC "%6.2" "s" COEFFS 0 0 65536 0 100 1 /end COMPU_METHOD
/begin RECORD_LAYOUT Map_Xs16Ys16Ws16 NO_AXIS_PTS_X 1 SWORD NO_AXIS_PTS_Y 2 SWORD AXIS_PTS_X 3 SWORD INDEX_INCR DIRECT AXIS_PTS_Y 4 SWORD INDEX_INCR DIRECT FNC_VALUES 5 SWORD COLUMN_DIR DIRECT /end RECORD_LAYOUT
/begin RECORD_LAYOUT Mo_DataCurveSstS16WS16 NO_AXIS_PTS_X 1 SWORD AXIS_PTS_X 2 SWORD INDEX_INCR DIRECT FNC_VALUES 3 SWORD COLUMN_DIR DIRECT /end RECORD_LAYOUT
/begin RECORD_LAYOUT RB_Val_Wu8 FNC_VALUES 1 UBYTE COLUMN_DIR DIRECT /end RECORD_LAYOUT
/begin RECORD_LAYOUT ValA_Wu16 FNC_VALUES 1 UWORD COLUMN_DIR DIRECT /end RECORD_LAYOUT
/begin RECORD_LAYOUT ValA_Wu8 FNC_VALUES 1 UBYTE COLUMN_DIR DIRECT /end RECORD_LAYOUT
/begin RECORD_LAYOUT Val_Ws16 FNC_VALUES 1 SWORD COLUMN_DIR DIRECT /end RECORD_LAYOUT
/begin RECORD_LAYOUT Val_Ws32 FNC_VALUES 1 SLONG COLUMN_DIR DIRECT /end RECORD_LAYOUT
/begin RECORD_LAYOUT Val_Wu16 FNC_VALUES 1 UWORD COLUMN_DIR DIRECT /end RECORD_LAYOUT
/begin RECORD_LAYOUT Val_Wu32 FNC_VALUES 1 ULONG COLUMN_DIR DIRECT /end RECORD_LAYOUT
/begin RECORD_LAYOUT Val_Wu8 FNC_VALUES 1 UBYTE COLUMN_DIR DIRECT /end RECORD_LAYOUT
/end MODULE
/end PROJECT

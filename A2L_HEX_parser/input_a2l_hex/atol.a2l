ASAP2_VERSION 1 70
/begin PROJECT MDG1C "VC1CP091_STLA_N_D061I3"
/begin HEADER "" VERSION "VC1CP091_STLA_N_D061I3" PROJECT_NO MDG1C /end HEADER
/begin MODULE DIM ""
/begin MOD_COMMON "" BYTE_ORDER MSB_LAST ALIGNMENT_BYTE 1 ALIGNMENT_WORD 2 ALIGNMENT_LONG 4 ALIGNMENT_INT64 4 ALIGNMENT_FLOAT32_IEEE 4 ALIGNMENT_FLOAT64_IEEE 4 DATA_SIZE 32 /end MOD_COMMON
/begin CHARACTERISTIC DFC_CtlMsk2.DFC_MoCSOPICO_C "" VALUE 0x80241662 Val_Wu8 255.0 DFES_OneToOne 0.00 255.0 FORMAT "%5.1" /end CHARACTERISTIC
/begin CHARACTERISTIC DFC_CtlMsk2.DFC_MoFAccr_C "" VALUE 0x80241663 Val_Wu8 255.0 DFES_OneToOne 0.00 255.0 FORMAT "%5.1" /end CHARACTERISTIC
/begin CHARACTERISTIC DFC_CtlMsk2.DFC_MoFCbnPreCdngOvrheat_C "" VALUE 0x80241664 Val_Wu8 255.0 DFES_OneToOne 0.00 255.0 FORMAT "%5.1" /end CHARACTERISTIC
/begin CHARACTERISTIC DFC_CtlMsk2.DFC_MoFCbnPreCdngTmrExpi_C "" VALUE 0x80241665 Val_Wu8 255.0 DFES_OneToOne 0.00 255.0 FORMAT "%5.1" /end CHARACTERISTIC
/begin CHARACTERISTIC DFC_DisblMsk2.DFC_MoCSOPICO_C "" VALUE 0x802491AA Val_Wu16 65535.00 DFES_OneToOne 0.00 65535.00 FORMAT "%8.2" /end CHARACTERISTIC
/begin CHARACTERISTIC DFC_DisblMsk2.DFC_MoFAccr_C "" VALUE 0x802491AC Val_Wu16 65535.00 DFES_OneToOne 0.00 65535.00 FORMAT "%8.2" /end CHARACTERISTIC
/begin CHARACTERISTIC DFC_DisblMsk2.DFC_MoFCbnPreCdngOvrheat_C "" VALUE 0x802491AE Val_Wu16 65535.00 DFES_OneToOne 0.00 65535.00 FORMAT "%8.2" /end CHARACTERISTIC
/begin CHARACTERISTIC DFC_DisblMsk2.DFC_MoFCbnPreCdngTmrExpi_C "" VALUE 0x802491B0 Val_Wu16 65535.00 DFES_OneToOne 0.00 65535.00 FORMAT "%8.2" /end CHARACTERISTIC
/begin CHARACTERISTIC MoCSOP_cntrDebCtrlLinesActvThd_C "Debounce level to determine a robust calibration of debounce counter for control lines active during positive test" VALUE 0x80270612 Val_Wu8 255.0 dez 0.00 255.0 FORMAT "%5.1" /end CHARACTERISTIC
/begin CHARACTERISTIC MoCSOP_cntrFrMacroTicEnd_C "Synchronisation of FlexRay Shutoff Path Test with specified MacroTick (Slot-End)" VALUE 0x8026D24A Val_Wu16 65535.00 dez 0.00 65535.00 FORMAT "%8.2" /end CHARACTERISTIC
/begin CHARACTERISTIC MoCSOP_cntrFrMacroTicStrt_C "Synchronisation of FlexRay Shutoff Path Test with specified MacroTick (Slot-Start)" VALUE 0x8026D24C Val_Wu16 65535.00 dez 0.00 65535.00 FORMAT "%8.2" /end CHARACTERISTIC
/begin CHARACTERISTIC MoCSOP_ctDebCANFrTest_C "Debounce counter for the maximum timeout deviation in the CAN and FlexRay test" VALUE 0x8026CBFE Val_Wu8 255.0 dez 0.00 255.0 FORMAT "%5.1" /end CHARACTERISTIC
/begin CHARACTERISTIC MoCSOP_ctDebSOPTst_C "Maximum duration of the power stages shut-off path test" VALUE 0x8026D24E Val_Wu16 65535.00 dez 0.00 65535.00 FORMAT "%8.2" /end CHARACTERISTIC
/begin CHARACTERISTIC MoCSOP_ctDebSycDrv_C "Maximum number of debounce count to confirm the Syc_stSub state to support secure engine off feature" VALUE 0x8026CBFF Val_Wu8 255.0 dez 0.00 255.0 FORMAT "%5.1" /end CHARACTERISTIC
/begin CHARACTERISTIC MoCSOP_ctRstCANFrTest_C "Limit of resets executed in CANFR shut off path test" VALUE 0x8026CC00 Val_Wu8 255.0 dez 0.00 255.0 FORMAT "%5.1" /end CHARACTERISTIC
/begin CHARACTERISTIC MoCSOP_ctRst_C "limit of resets executed in shut off path test" VALUE 0x8026CC01 Val_Wu8 255.0 dez 0.00 255.0 FORMAT "%5.1" /end CHARACTERISTIC
/begin CHARACTERISTIC MoCSOP_nEngMaxOVLthDisbl_C "Maximum engine speed for activating the overvoltage latch in the VDD5 monitoring hardware" VALUE 0x8026D250 Val_Ws16 32767.50 EngN -16384.00 16383.50 FORMAT "%8.2" /end CHARACTERISTIC
/begin CHARACTERISTIC MoCSOP_stCANErrReac_CW "codeword for activating the error reaction CAN-driver-disabling" VALUE 0x8026CC02 Val_Wu8 255.0 dez 0.00 255.0 FORMAT "%5.1" /end CHARACTERISTIC
/begin CHARACTERISTIC MoCSOP_stCANTestActv_CW "Test label for ECU-MST purpose for CANFR test" VALUE 0x80270613 Val_Wu8 1.000 dez 0.00 1.000 FORMAT "%5.3" EXTENDED_LIMITS 0.00 255.0 /end CHARACTERISTIC
/begin CHARACTERISTIC MoCSOP_stErrReactnERPN_CA "Includes the error reaction type based on the error combinations of ERPN-Errorpin path" VAL_BLK 0x8026CC03 ValA_Wu8 2.00000000000 MoCSOP_stErrReactnERPN_CA_Compu 0.00 2.00000000000 FORMAT "%13.11" MATRIX_DIM 4 /end CHARACTERISTIC
/begin CHARACTERISTIC MoCSOP_stErrReactn_CA "Includes the error reaction type based on the error combinations of InjVlv and PVMT shut off paths" VAL_BLK 0x8026CC07 ValA_Wu8 2.00000000000 MoCSOP_stErrReactn_CA_Compu 0.00 2.00000000000 FORMAT "%13.11" MATRIX_DIM 16 /end CHARACTERISTIC
/begin CHARACTERISTIC MoCSOP_stMMErrReac_CW "code word for activating the fault reaction MM reset" VALUE 0x8026CC17 Val_Wu8 255.0 dez 0.00 255.0 FORMAT "%5.1" /end CHARACTERISTIC
/begin CHARACTERISTIC MoCSOP_stOVErrReactn_C "Error reaction for an error in overvoltage test" VALUE 0x8026CC18 Val_Wu8 1.00000000000 MoCSOP_stOVErrReactn_C_Compu 1.00000000000 2.00000000000 FORMAT "%13.11" /end CHARACTERISTIC
/begin CHARACTERISTIC MoCSOP_stReqCANFrTest_C "Calibration to decide for the execution of CANFR test" VALUE 0x8026CC19 Val_Wu8 255.0 dez 0.00 255.0 FORMAT "%5.1" /end CHARACTERISTIC
/begin CHARACTERISTIC MoCSOP_stSWResetDem_CW "Status-Bit for Software-Reset demand in case of shut-off path test error" VALUE 0x8026CC1A Val_Wu8 255.0 dez 0.00 255.0 FORMAT "%5.1" /end CHARACTERISTIC
/begin CHARACTERISTIC MoCSOP_stTestActv_CW "Codeword to activate MFT and check the error reaction from shut off path test" VALUE 0x80270614 Val_Wu8 1.000 dez 0.00 1.000 FORMAT "%5.3" EXTENDED_LIMITS 0.00 255.0 /end CHARACTERISTIC
/begin CHARACTERISTIC MoCSOP_swtAlwysPsTest_C "Switch to select repetition of power stage SOP test in case of broken after run" VALUE 0x8026CC1B Val_Wu8 1.000 dez 0.00 1.000 FORMAT "%5.3" EXTENDED_LIMITS 0.00 255.0 /end CHARACTERISTIC
/begin CHARACTERISTIC MoCSOP_swtRepFaildPESTest_C "Switch to repeat the complete MoCSOP test in case of an aborted after-run if there was an error in previous CAN-FR, Injection Control lines test" VALUE 0x8026CC1C Val_Wu8 1.000 dez 0.00 1.000 FORMAT "%5.3" EXTENDED_LIMITS 0.00 255.0 /end CHARACTERISTIC
/begin CHARACTERISTIC MoFAccr_cntrDeb_C "Error time for pedal signals which are implausible to each other during the monitoring" VALUE 0x8026CC20 Val_Wu8 255.0 OneToOne 0.00 255.0 FORMAT "%5.1" /end CHARACTERISTIC
/begin CHARACTERISTIC MoFAccr_cntrTestAccr_C "Counter limit for setting test flag in diagnosis MoFAccr in function monitoring" VALUE 0x80270616 Val_Wu8 255.0 OneToOne 0.00 255.0 FORMAT "%5.1" /end CHARACTERISTIC
/begin CHARACTERISTIC MoFAccr_drLimpMax_C "Calibration for maximum positive ramping of accelerator pedal during limp-home mode" VALUE 0x8026D288 Val_Wu16 39999.39 PrcPerSec 0.00 39999.39 FORMAT "%8.2" /end CHARACTERISTIC
/begin CHARACTERISTIC MoFAccr_drLimPos_C "Calibration for positive ramping of accelerator pedal" VALUE 0x8026D252 Val_Ws16 39999.39 PrcPerSec -20000.00 19999.39 FORMAT "%8.2" /end CHARACTERISTIC
/begin CHARACTERISTIC MoFAccr_rAccrMaxLimp_C "Maximum relative accelerator pedal value allowed during limp home mode" VALUE 0x8026D28A Val_Wu16 399.9878 Prc 0.00 399.9878 FORMAT "%8.4" EXTENDED_LIMITS 0.00 799.9878 /end CHARACTERISTIC
/begin CHARACTERISTIC MoFAccr_rLnrAlgnmnt_T "Offset accelerator pedal value based on vehicle speed" CURVE 0x8026D254 Mo_DataCurveSstS16WS16 799.9878 Prc -400.0000 399.9878 FORMAT "%8.4"
 /begin AXIS_DESCR STD_AXIS MoFBas_vVehSignd Vel 8 -327.6800 327.6700 FORMAT "%8.4" DEPOSIT ABSOLUTE /end AXIS_DESCR
/end CHARACTERISTIC
/begin CHARACTERISTIC MoFAccr_swtL1AlgnmntActv_C "Switch to configure level-1 and level-2 accelerator pedal value alignment" VALUE 0x8026CC1E Val_Wu8 1.000 OneToOne 0.00 1.000 FORMAT "%5.3" EXTENDED_LIMITS 0.00 255.0 /end CHARACTERISTIC
/begin CHARACTERISTIC MoFAccr_swtMinSel_C "Switch to enable Minimum value selection between APP1 and APP2" VALUE 0x8026CC21 Val_Wu8 1.00000000000 B_TRUE 0.00 1.00000000000 FORMAT "%13.11" /end CHARACTERISTIC
/begin CHARACTERISTIC MoFAccr_swtPedlSeln_C "Calibration switch to select accelerator pedal sensor signal" VALUE 0x8026CC22 Val_Wu8 1.00000000000 B_TRUE 0.00 1.00000000000 FORMAT "%13.11" /end CHARACTERISTIC
/begin CHARACTERISTIC MoFAccr_uAccr1SrcMax_C "Maximum voltage threshold for Signal Range Check on ADC-signal APP1" VALUE 0x8026D276 Val_Wu16 319.9951 spg_q0p00488 0.00 319.9951 FORMAT "%8.4" /end CHARACTERISTIC
/begin CHARACTERISTIC MoFAccr_uAccr1SrcMin_C "Minimum voltage threshold for Signal Range Check on ADC-signal APP1" VALUE 0x8026D278 Val_Wu16 319.9951 spg_q0p00488 0.00 319.9951 FORMAT "%8.4" /end CHARACTERISTIC
/begin CHARACTERISTIC MoFAccr_uAccr2SrcMax_C "Maximum voltage threshold for Signal Range Check on ADC-signal APP2" VALUE 0x8026D27A Val_Wu16 319.9951 spg_q0p00488 0.00 319.9951 FORMAT "%8.4" /end CHARACTERISTIC
/begin CHARACTERISTIC MoFAccr_uAccr2SrcMin_C "Minimum voltage threshold for Signal Range Check on ADC-signal APP2" VALUE 0x8026D27C Val_Wu16 319.9951 spg_q0p00488 0.00 319.9951 FORMAT "%8.4" /end CHARACTERISTIC
/begin CHARACTERISTIC MoFAccr_uAccrMaxLimp_C "Maximum value for the Acceleration pedal signal during Limp-home in function monitoring" VALUE 0x8026CC23 Val_Wu8 4.980 spg_q0p0195 0.00 4.980 FORMAT "%5.3" /end CHARACTERISTIC
/begin CHARACTERISTIC MoFAccr_uAccrMax_C "Maximum value for the Acceleration pedal signal in function monitoring" VALUE 0x8026CC24 Val_Wu8 4.980 spg_q0p0195 0.00 4.980 FORMAT "%5.3" /end CHARACTERISTIC
/begin CHARACTERISTIC MoFAccr_uAccrMinLimp_C "Minimum value for the Acceleration pedal signal during Limp-home in function monitoring" VALUE 0x8026CC25 Val_Wu8 4.980 spg_q0p0195 0.00 4.980 FORMAT "%5.3" /end CHARACTERISTIC
/begin CHARACTERISTIC MoFAccr_uAccrMin_C "Minimum value for the Acceleration pedal signal in function monitoring" VALUE 0x8026CC26 Val_Wu8 4.980 spg_q0p0195 0.00 4.980 FORMAT "%5.3" /end CHARACTERISTIC
/begin CHARACTERISTIC MoFAccr_uFullLoad_C "Full throttle- set value- threshold" VALUE 0x8026D27E Val_Wu16 319.9951 spg_q0p00488 0.00 319.9951 FORMAT "%8.4" /end CHARACTERISTIC
/begin CHARACTERISTIC MoFAccr_uLoLim_C "Lower threshold of the APP voltages for plausibility test" VALUE 0x8026D280 Val_Wu16 319.9951 spg_q0p00488 0.00 319.9951 FORMAT "%8.4" /end CHARACTERISTIC
/begin CHARACTERISTIC MoFAccr_uMaxDiffFullLoad_C "Maximum permitted difference between the accelerator pedal signals above the full throttle threshold" VALUE 0x8026D282 Val_Wu16 319.9951 spg_q0p00488 0.00 319.9951 FORMAT "%8.4" /end CHARACTERISTIC
/begin CHARACTERISTIC MoFAccr_uMaxDiffPtlLoad_C "Maximum permitted difference between the accelerator pedal signals beneath full throttle threshold" VALUE 0x8026D284 Val_Wu16 319.9951 spg_q0p00488 0.00 319.9951 FORMAT "%8.4" /end CHARACTERISTIC
/begin CHARACTERISTIC MoFAccr_uVirtZrPntLimpOffs_C "Calibration offset for virtual zero point when limp home is present" VALUE 0x8026D286 Val_Ws16 319.9951 spg_q0p00488 -160.0000 159.9951 FORMAT "%8.4" /end CHARACTERISTIC
/begin CHARACTERISTIC MoFBas_flgFwdMntdMot_C "Flag for forward mounted motor" VALUE 0x8026CC2A Val_Wu8 1.00000000000 B_TRUE 0.00 1.00000000000 FORMAT "%13.11" /end CHARACTERISTIC
/begin CHARACTERISTIC MoFBas_flgVehSpdSrcSeln_C "Selection of Raw vehicle Speed either from CAN or E-Machine Speed" VALUE 0x8026CC2B Val_Wu8 1.00000000000 B_TRUE 0.00 1.00000000000 FORMAT "%13.11" /end CHARACTERISTIC
/begin CHARACTERISTIC MoFBas_lenWhlCircum_C "Wheel circumference" VALUE 0x8026D28C Val_Ws16 65.53500 Length_fine -32.76800 32.76700 FORMAT "%8.5" /end CHARACTERISTIC
/begin CHARACTERISTIC MoFBas_ratSecTqTot_C "Secondary Total torque ratio including differential torque" VALUE 0x8026D28E Val_Ws16 327.6600 TransR 0.0100 327.6700 FORMAT "%8.4" EXTENDED_LIMITS -327.6800 327.6700 /end CHARACTERISTIC
/begin CHARACTERISTIC MoFBas_ratTqTot_C "Total torque ratio including differential torque" VALUE 0x8026D290 Val_Ws16 327.6600 TransR 0.0100 327.6700 FORMAT "%8.4" EXTENDED_LIMITS -327.6800 327.6700 /end CHARACTERISTIC
/begin CHARACTERISTIC MoFBas_stActvCrash_C "Configuration of the starting edge for the dury cycle calculation of the crash signal" VALUE 0x8026CC28 Val_Wu8 1.00000000000 B_TRUE 0.00 1.00000000000 FORMAT "%13.11" /end CHARACTERISTIC
/begin CHARACTERISTIC MoFBas_tiVPT1_C "Filter time constant vehicle velocity in function monitoring" VALUE 0x8026D292 Val_Wu16 655.34000000 zk10msxs_uw_b655p36PT1 0.01000000 655.35000000 FORMAT "%12.8" EXTENDED_LIMITS 0.000000152590219 655.35000000 /end CHARACTERISTIC
/begin CHARACTERISTIC MoFBas_vVehDfctVal_C "Default vehicle velocity in case of CAN errors" VALUE 0x8026D294 Val_Ws16 655.3500 Vel -327.6800 327.6700 FORMAT "%8.4" /end CHARACTERISTIC
/begin CHARACTERISTIC MoFBas_vVehMax_C "Maximum vehicle velocity" VALUE 0x8026D296 Val_Ws16 655.3500 Vel -327.6800 327.6700 FORMAT "%8.4" /end CHARACTERISTIC
/begin CHARACTERISTIC MoFBas_vVehMin_C "Minimum vehicle velocity" VALUE 0x8026D298 Val_Ws16 655.3500 Vel -327.6800 327.6700 FORMAT "%8.4" /end CHARACTERISTIC
/begin CHARACTERISTIC MoFBas_vVehRawOffs_C "Offset for the filtered vehicle speed" VALUE 0x8026D29A Val_Ws16 655.3500 Vel -327.6800 327.6700 FORMAT "%8.4" /end CHARACTERISTIC
/begin CHARACTERISTIC MoFBrk_cntrBrkErrDebHiLo_C "Max Debounce Counter to Clear Brake Error status after both brake signal is read" VALUE 0x8026D29C Val_Wu16 65535.00 OneToOne 0.00 65535.00 FORMAT "%8.2" /end CHARACTERISTIC
/begin CHARACTERISTIC MoFBrk_cntrBrkErrDebLoHi_C "Max Debounce Counter to Set Brake Error status after both brake signal is read" VALUE 0x8026D29E Val_Wu16 65535.00 OneToOne 0.00 65535.00 FORMAT "%8.2" /end CHARACTERISTIC
/begin CHARACTERISTIC MoFBrk_cntrBrkRedDebHiLo_C "Counter Calibration for Brake Redundancy Debounce High to Low" VALUE 0x8026CC2C Val_Wu8 255.0 OneToOne 0.00 255.0 FORMAT "%5.1" /end CHARACTERISTIC
/begin CHARACTERISTIC MoFBrk_cntrBrkRedDebLoHi_C "Counter Calibration for Brake Redundancy Debounce Low to High" VALUE 0x8026CC2D Val_Wu8 255.0 OneToOne 0.00 255.0 FORMAT "%5.1" /end CHARACTERISTIC
/begin CHARACTERISTIC MoFBrk_flgBrkDfct_C "Defect value in case of CAN error is present" VALUE 0x8026CC2E Val_Wu8 1.00000000000 B_TRUE 0.00 1.00000000000 FORMAT "%13.11" /end CHARACTERISTIC
/begin CHARACTERISTIC MoFCbnPreCdng_cntrPreHeatDioFltCfm_C "Counter for PreHeat Dio Fault Confirm" VALUE 0x8026CC30 Val_Wu8 255.0 OneToOne 0.00 255.0 FORMAT "%5.1" /end CHARACTERISTIC
/begin CHARACTERISTIC MoFCbnPreCdng_cntrPreHeatDioFltHeal_C "Counter for PreHeat Dio Fault Heal" VALUE 0x8026CC31 Val_Wu8 255.0 OneToOne 0.00 255.0 FORMAT "%5.1" /end CHARACTERISTIC
/begin CHARACTERISTIC MoFCbnPreCdng_cntrStopHeatrDeb_C "Debounce calibration to clear the DFC when the error condition doesnot pertains." VALUE 0x8026CC32 Val_Wu8 255.0 OneToOne 0.00 255.0 FORMAT "%5.1" /end CHARACTERISTIC
/begin CHARACTERISTIC MoFCbnPreCdng_cntrTmrExpiDeb_C "Debounce calibration to clear the DFC when the error condition doesnot pertains." VALUE 0x8026CC33 Val_Wu8 255.0 OneToOne 0.00 255.0 FORMAT "%5.1" /end CHARACTERISTIC
/begin CHARACTERISTIC MoFCbnPreCdng_DataDebErrReactn_I.cntErrDebMax_C "Class instance for Error Reaction / Calibratable debounce count for class DataDeb with error reaction." VALUE 0x8026FFAC Val_Wu16 65535.00 OneToOne 0.00 65535.00 FORMAT "%8.2" /end CHARACTERISTIC
/begin CHARACTERISTIC MoFCbnPreCdng_DataDebErrReactn_I.stCfgErrHndlg_C "Class instance for Error Reaction / Calibratable error handling configuration class DataDeb with error reaction." VALUE 0x8026FFAE Val_Wu8 255.0 OneToOne 0.00 255.0 FORMAT "%5.1" /end CHARACTERISTIC
/begin CHARACTERISTIC MoFCbnPreCdng_DataDebErrReactn_I.stCfgErrReactn_C "Class instance for Error Reaction / Calibratable parameter for error reaction class DataDeb with error reaction." VALUE 0x8026FFAF Val_Wu8 255.0 OneToOne 0.00 255.0 FORMAT "%5.1" /end CHARACTERISTIC
/begin CHARACTERISTIC MoFCbnPreCdng_DataDebErrReactn_I_1.cntErrDebMax_C "Error Reaction class instance / Calibratable debounce count for class DataDeb with error reaction." VALUE 0x8026FFB8 Val_Wu16 65535.00 OneToOne 0.00 65535.00 FORMAT "%8.2" /end CHARACTERISTIC
/begin CHARACTERISTIC MoFCbnPreCdng_DataDebErrReactn_I_1.stCfgErrHndlg_C "Error Reaction class instance / Calibratable error handling configuration class DataDeb with error reaction." VALUE 0x8026FFBA Val_Wu8 255.0 OneToOne 0.00 255.0 FORMAT "%5.1" /end CHARACTERISTIC
/begin CHARACTERISTIC MoFCbnPreCdng_DataDebErrReactn_I_1.stCfgErrReactn_C "Error Reaction class instance / Calibratable parameter for error reaction class DataDeb with error reaction." VALUE 0x8026FFBB Val_Wu8 255.0 OneToOne 0.00 255.0 FORMAT "%5.1" /end CHARACTERISTIC
/begin CHARACTERISTIC MoFCbnPreCdng_DataDebErrReactn_I_2.cntErrDebMax_C "Error Reactioln Class instance / Calibratable debounce count for class DataDeb with error reaction." VALUE 0x8026FFC4 Val_Wu16 65535.00 OneToOne 0.00 65535.00 FORMAT "%8.2" /end CHARACTERISTIC
/begin CHARACTERISTIC MoFCbnPreCdng_DataDebErrReactn_I_2.stCfgErrHndlg_C "Error Reactioln Class instance / Calibratable error handling configuration class DataDeb with error reaction." VALUE 0x8026FFC6 Val_Wu8 255.0 OneToOne 0.00 255.0 FORMAT "%5.1" /end CHARACTERISTIC
/begin CHARACTERISTIC MoFCbnPreCdng_DataDebErrReactn_I_2.stCfgErrReactn_C "Error Reactioln Class instance / Calibratable parameter for error reaction class DataDeb with error reaction." VALUE 0x8026FFC7 Val_Wu8 255.0 OneToOne 0.00 255.0 FORMAT "%5.1" /end CHARACTERISTIC
/begin CHARACTERISTIC MoFCbnPreCdng_tmrPreHeatElpd_C "Calibration for PreConditioning Timer Expried" VALUE 0x8026D018 Val_Wu32 4294967295.00 OneToOne 0.00 4294967295.00 FORMAT "%13.2" /end CHARACTERISTIC
/begin CHARACTERISTIC MoFDrvrAssc_cntrBrkDly_C "Calibration limit for the brake pressed delay" VALUE 0x8026CC34 Val_Wu8 255.0 OneToOne 0.00 255.0 FORMAT "%5.1" /end CHARACTERISTIC
/begin CHARACTERISTIC MoFDrvrAssc_flgCrsCtrlEnad_C "calibratable paramter indicating cruise control is enabled" VALUE 0x8026CC35 Val_Wu8 1.00000000000 B_TRUE 0.00 1.00000000000 FORMAT "%13.11" /end CHARACTERISTIC
/begin CHARACTERISTIC MoFDrvrAssc_tqPtdCrsCtrlLowrLim_T "curve to determine lower limit for cruise control torque" CURVE 0x8026D2A0 Mo_DataCurveSstS16WS16 104856.0 TrqPrp -52428.80 52427.20 FORMAT "%8.2"
 /begin AXIS_DESCR STD_AXIS MoFBas_vVehSignd vel_q0p01 4 -327.6800 327.6700 FORMAT "%8.4" DEPOSIT ABSOLUTE /end AXIS_DESCR
/end CHARACTERISTIC
/begin CHARACTERISTIC MoFDrvrAssc_tqPtdCrsCtrlUpprLim_T "curve to determine upper limit for cruise control torque" CURVE 0x8026D2B2 Mo_DataCurveSstS16WS16 104856.0 TrqPrp -52428.80 52427.20 FORMAT "%8.2"
 /begin AXIS_DESCR STD_AXIS MoFBas_vVehSignd vel_q0p01 4 -327.6800 327.6700 FORMAT "%8.4" DEPOSIT ABSOLUTE /end AXIS_DESCR
/end CHARACTERISTIC
/begin CHARACTERISTIC MoFDrvrAssc_vVehSpdThres_C "Vehicle speed threshold for the cruise control monitoring" VALUE 0x8026D2C4 Val_Ws16 655.3500 vel_q0p01 -327.6800 327.6700 FORMAT "%8.4" /end CHARACTERISTIC
/begin CHARACTERISTIC MoFEmgyOff_AcuFltSeln_C "Calibration is used for the selection of ACUFAULT or MAJOR Crash" VALUE 0x8026CC36 Val_Wu8 1.00000000000 B_TRUE 0.00 1.00000000000 FORMAT "%13.11" /end CHARACTERISTIC
/begin CHARACTERISTIC MoFEmgyOff_cntrCrashCANInvldDeb_C "Number of cycles the raw CAN Crash Signal invalid value is debounced" VALUE 0x8026CC37 Val_Wu8 255.0 OneToOne 0.00 255.0 FORMAT "%5.1" /end CHARACTERISTIC
/begin CHARACTERISTIC MoFEmgyOff_cntrMajorCrashCANRawDeb_C "Number of cycles the raw CAN signal is debounced before Major Crash signal is accepted" VALUE 0x8026CC38 Val_Wu8 255.0 OneToOne 0.00 255.0 FORMAT "%5.1" /end CHARACTERISTIC
/begin CHARACTERISTIC MoFEmgyOff_cntrMnrCrashCANRawDeb_C "Number of cycles the raw CAN signal is debounced before Minor Crash signal is accepted" VALUE 0x8026CC39 Val_Wu8 255.0 OneToOne 0.00 255.0 FORMAT "%5.1" /end CHARACTERISTIC
/begin CHARACTERISTIC MoFEmgyOff_cntrNoCrashCANRawDeb_C "Number of cycles the raw CAN signal is debounced before No Crash signal is accepted" VALUE 0x8026CC3A Val_Wu8 255.0 OneToOne 0.00 255.0 FORMAT "%5.1" /end CHARACTERISTIC
/begin CHARACTERISTIC MoFEmgyOff_frqCrashMax_C "Maximum frequency for a valid crash signal" VALUE 0x8026D2C6 Val_Wu16 6553.500 freq_q0p1 0.00 6553.500 FORMAT "%8.3" /end CHARACTERISTIC
/begin CHARACTERISTIC MoFEmgyOff_frqCrashMin_C "Minimum frequency for a valid crash signal" VALUE 0x8026D2C8 Val_Wu16 6553.500 freq_q0p1 0.00 6553.500 FORMAT "%8.3" /end CHARACTERISTIC
/begin CHARACTERISTIC MoFEmgyOff_ratPwmCrashMax_C "Maximum duty cycle for vaild Pwm Crash" VALUE 0x8026D2CA Val_Ws16 655.3500 DtyCyc -327.6800 327.6700 FORMAT "%8.4" /end CHARACTERISTIC
/begin CHARACTERISTIC MoFEmgyOff_ratPwmCrashMin_C "Minimum duty cycle for vaild Pwm Crash" VALUE 0x8026D2CC Val_Ws16 655.3500 DtyCyc -327.6800 327.6700 FORMAT "%8.4" /end CHARACTERISTIC
/begin CHARACTERISTIC MoFEmgyOff_ratPWMNoCrashMax_C "Maximum duty cycle for vaild No Crash" VALUE 0x8026D2CE Val_Ws16 655.3500 DtyCyc -327.6800 327.6700 FORMAT "%8.4" /end CHARACTERISTIC
/begin CHARACTERISTIC MoFEmgyOff_ratPWMNoCrashMin_C "Minimum duty cycle for vaild No Crash" VALUE 0x8026D2D0 Val_Ws16 655.3500 DtyCyc -327.6800 327.6700 FORMAT "%8.4" /end CHARACTERISTIC
/begin CHARACTERISTIC MoFEmgyOff_stCrashUpd_C "Crash status during Postdrive" VALUE 0x8026CC3B Val_Wu8 255.0 OneToOne 0.00 255.0 FORMAT "%5.1" /end CHARACTERISTIC
/begin CHARACTERISTIC MoFEmgyOff_tiInvldDeb_C "debounce threshold for the invalid stauts of the crash signal" VALUE 0x8026CC3C Val_Wu8 2.550 t_q0p01 0.00 2.550 FORMAT "%5.3" /end CHARACTERISTIC
/begin CHARACTERISTIC MoFEmgyOff_tiPWMCrashCfmdDeb_C "Debounce time for confirmed Pwm crash" VALUE 0x8026CC3D Val_Wu8 2.550 t_q0p01 0.00 2.550 FORMAT "%5.3" /end CHARACTERISTIC
/begin CHARACTERISTIC MoFEmgyOff_tiPWMCrashRprtDeb_C "Debounce time for reported Pwm crash" VALUE 0x8026CC3E Val_Wu8 2.550 t_q0p01 0.00 2.550 FORMAT "%5.3" /end CHARACTERISTIC
/begin CHARACTERISTIC MoFEmgyOff_tiT15On_C "debounce threshold terminal 15 on in function monitoring" VALUE 0x8026D2D2 Val_Wu16 655.3500 t_q0p01 0.00 655.3500 FORMAT "%8.4" /end CHARACTERISTIC
/begin CHARACTERISTIC MoFEmgyOff_vVeh_C "Vehicle speed below which ACU will be in OFF state in Postdrive" VALUE 0x8026D2D4 Val_Ws16 655.3500 Vel -327.6800 327.6700 FORMAT "%8.4" /end CHARACTERISTIC
/begin CHARACTERISTIC MoFErrHndlg_Lib_DataDebErrReactn_I.cntErrDebMax_C "Class for DataDeb with error reaction / Calibratable debounce count for class DataDeb with error reaction." VALUE 0x8026FFD0 Val_Wu16 65535.00 OneToOne 0.00 65535.00 FORMAT "%8.2" /end CHARACTERISTIC
/begin CHARACTERISTIC MoFErrHndlg_Lib_DataDebErrReactn_I.stCfgErrHndlg_C "Class for DataDeb with error reaction / Calibratable error handling configuration class DataDeb with error reaction." VALUE 0x8026FFD2 Val_Wu8 255.0 OneToOne 0.00 255.0 FORMAT "%5.1" /end CHARACTERISTIC
/begin CHARACTERISTIC MoFErrHndlg_Lib_DataDebErrReactn_I.stCfgErrReactn_C "Class for DataDeb with error reaction / Calibratable parameter for error reaction class DataDeb with error reaction." VALUE 0x8026FFD3 Val_Wu8 255.0 OneToOne 0.00 255.0 FORMAT "%5.1" /end CHARACTERISTIC
/begin CHARACTERISTIC MoFErrHndlg_Lib_DataDeb_I.cntErrDebMax_C "Class for DataDeb / Calibratable debounce count in class DataDeb." VALUE 0x8026FFDC Val_Wu16 65535.00 OneToOne 0.00 65535.00 FORMAT "%8.2" /end CHARACTERISTIC
/begin CHARACTERISTIC MoFErrHndlg_Lib_DataErrReactn_I.stCfgErrHndlg_C "Class for error reaction / Calibration parameter for configutation of error handling in class error reaction." VALUE 0x8026FFE8 Val_Wu8 255.0 OneToOne 0.00 255.0 FORMAT "%5.1" /end CHARACTERISTIC
/begin CHARACTERISTIC MoFErrHndlg_Lib_DataErrReactn_I.stCfgErrReactn_C "Class for error reaction / Calibration of error reaction in class error reaction." VALUE 0x8026FFE9 Val_Wu8 255.0 OneToOne 0.00 255.0 FORMAT "%5.1" /end CHARACTERISTIC
/begin CHARACTERISTIC MoFErrHndlg_Lib_DataUpDwnDebErrReactn_I.cntErrDebMax_C "Class for DataUpDownDeb with error reaction / Calibratable debounce count fro debouncing in class DataUpDownDeb with error reaction." VALUE 0x8026FFF4 Val_Wu16 65535.00 OneToOne 0.00 65535.00 FORMAT "%8.2" /end CHARACTERISTIC
/begin CHARACTERISTIC MoFErrHndlg_Lib_DataUpDwnDebErrReactn_I.cntrErrDwnStepSize_C "Class for DataUpDownDeb with error reaction / Calibratable decrement in counter in class DataUpDownDeb with error reaction." VALUE 0x8026FFF6 Val_Wu8 255.0 OneToOne 0.00 255.0 FORMAT "%5.1" /end CHARACTERISTIC
/begin CHARACTERISTIC MoFErrHndlg_Lib_DataUpDwnDebErrReactn_I.cntrErrUpStepSize_C "Class for DataUpDownDeb with error reaction / Calibratable increment in counter in class DataUpDownDeb with error reaction." VALUE 0x8026FFF7 Val_Wu8 255.0 OneToOne 0.00 255.0 FORMAT "%5.1" /end CHARACTERISTIC
/begin CHARACTERISTIC MoFErrHndlg_Lib_DataUpDwnDebErrReactn_I.stCfgErrHndlg_C "Class for DataUpDownDeb with error reaction / Calibration parameter for configutation of error handling in class DataUpDownDeb with error reaction." VALUE 0x8026FFF8 Val_Wu8 255.0 OneToOne 0.00 255.0 FORMAT "%5.1" /end CHARACTERISTIC
/begin CHARACTERISTIC MoFErrHndlg_Lib_DataUpDwnDebErrReactn_I.stCfgErrReactn_C "Class for DataUpDownDeb with error reaction / Calibration of error reaction in class DataUpDownDeb with error reaction." VALUE 0x8026FFF9 Val_Wu8 255.0 OneToOne 0.00 255.0 FORMAT "%5.1" /end CHARACTERISTIC
/begin CHARACTERISTIC MoFErrHndlg_Lib_DataUpDwnDeb_I.cntErrDebMax_C "Class for DataUpDownDeb / Calibratable debounce count fro debouncing in class DataUpDownDeb." VALUE 0x80270004 Val_Wu16 65535.00 OneToOne 0.00 65535.00 FORMAT "%8.2" /end CHARACTERISTIC
/begin CHARACTERISTIC MoFErrHndlg_Lib_DataUpDwnDeb_I.cntrErrDwnStepSize_C "Class for DataUpDownDeb / Calibratable decrement in counter in class DataUpDownDeb." VALUE 0x80270006 Val_Wu8 255.0 OneToOne 0.00 255.0 FORMAT "%5.1" /end CHARACTERISTIC
/begin CHARACTERISTIC MoFErrHndlg_Lib_DataUpDwnDeb_I.cntrErrUpStepSize_C "Class for DataUpDownDeb / Calibratable increment in counter in class DataUpDownDeb." VALUE 0x80270007 Val_Wu8 255.0 OneToOne 0.00 255.0 FORMAT "%5.1" /end CHARACTERISTIC
/begin CHARACTERISTIC MoFErrHndlg_stCfgErrHndlgAccrInp_C "Switch Error Handling Accr Error" VALUE 0x8026CC40 Val_Wu8 31.00 OneToOne 0.00 31.00 FORMAT "%5.2" EXTENDED_LIMITS 0.00 255.0 /end CHARACTERISTIC
/begin CHARACTERISTIC MoFErrHndlg_stCfgErrHndlgAdcSop_C "Switch Error Handling adc or sop error" VALUE 0x8026CC41 Val_Wu8 31.00 OneToOne 0.00 31.00 FORMAT "%5.2" EXTENDED_LIMITS 0.00 255.0 /end CHARACTERISTIC
/begin CHARACTERISTIC MoFErrHndlg_stCfgErrHndlgAxleComp_C "Switch Error Handling Torque Compare Error Axle Level" VALUE 0x8026CC42 Val_Wu8 31.00 OneToOne 0.00 31.00 FORMAT "%5.2" EXTENDED_LIMITS 0.00 255.0 /end CHARACTERISTIC
/begin CHARACTERISTIC MoFErrHndlg_stCfgErrHndlgEmComp_C "Switch Error Handling Torque Compare Error E.-Maschine Level" VALUE 0x8026CC43 Val_Wu8 31.00 OneToOne 0.00 31.00 FORMAT "%5.2" EXTENDED_LIMITS 0.00 255.0 /end CHARACTERISTIC
/begin CHARACTERISTIC MoFErrHndlg_stCfgErrHndlgPostBldSel_C "Switch Error Handling PostBldSel Error" VALUE 0x8026CC44 Val_Wu8 31.00 OneToOne 0.00 31.00 FORMAT "%5.2" EXTENDED_LIMITS 0.00 255.0 /end CHARACTERISTIC
/begin CHARACTERISTIC MoFErrHndlg_stCfgErrHndlgPtRels_C "Switch Error Handling Powertrain Release Error" VALUE 0x8026CC45 Val_Wu8 31.00 OneToOne 0.00 31.00 FORMAT "%5.2" EXTENDED_LIMITS 0.00 255.0 /end CHARACTERISTIC
/begin CHARACTERISTIC MoFErrHndlg_stCfgErrHndlgSecAxleComp_C "Switch Error Handling Torque Compare Error Secondary Axle Level" VALUE 0x8026CC46 Val_Wu8 31.00 OneToOne 0.00 31.00 FORMAT "%5.2" EXTENDED_LIMITS 0.00 255.0 /end CHARACTERISTIC
/begin CHARACTERISTIC MoFErrHndlg_stCfgErrHndlgSecEmComp_C "Switch Error Handling Torque Compare Error Secondary E.-Maschine Level" VALUE 0x8026CC47 Val_Wu8 31.00 OneToOne 0.00 31.00 FORMAT "%5.2" EXTENDED_LIMITS 0.00 255.0 /end CHARACTERISTIC
/begin CHARACTERISTIC MoFErrHndlg_stCfgErrHndlgSecPtRels_C "Switch Error Handling Secondary Powertrain Release Error" VALUE 0x8026CC48 Val_Wu8 31.00 OneToOne 0.00 31.00 FORMAT "%5.2" EXTENDED_LIMITS 0.00 255.0 /end CHARACTERISTIC
/begin CHARACTERISTIC MoFErrHndlg_stCfgErrHndlgVehComp_C "Switch Error Handling Torque Compare Error Vehicle Level" VALUE 0x8026CC49 Val_Wu8 31.00 OneToOne 0.00 31.00 FORMAT "%5.2" EXTENDED_LIMITS 0.00 255.0 /end CHARACTERISTIC
/begin CHARACTERISTIC MoFErrHndlg_stCfgErrReactnAccrInp_C "Switch Error Reaction Accr-Error" VALUE 0x8026CC4A Val_Wu8 255.0 OneToOne 0.00 255.0 FORMAT "%5.1" /end CHARACTERISTIC
/begin CHARACTERISTIC MoFErrHndlg_stCfgErrReactnAdcSop_C "Switch Error Reaction Adc or Sop Error" VALUE 0x8026CC4B Val_Wu8 255.0 OneToOne 0.00 255.0 FORMAT "%5.1" /end CHARACTERISTIC
/begin CHARACTERISTIC MoFErrHndlg_stCfgErrReactnAxleCompRe_C "Switch Error Reaction Torque Compare Error Axle Level in R" VALUE 0x8026CC4C Val_Wu8 0.00 OneToOne 2.000 2.000 FORMAT "%5.3" EXTENDED_LIMITS 0.00 255.0 /end CHARACTERISTIC
/begin CHARACTERISTIC MoFErrHndlg_stCfgErrReactnAxleComp_C "Switch Error Reaction Torque Compare Error Axle Level" VALUE 0x8026CC4D Val_Wu8 255.0 OneToOne 0.00 255.0 FORMAT "%5.1" /end CHARACTERISTIC
/begin CHARACTERISTIC MoFErrHndlg_stCfgErrReactnEmCompRe_C "Switch Error Reaction Torque Compare Error EM Level in R" VALUE 0x8026CC4E Val_Wu8 0.00 OneToOne 2.000 2.000 FORMAT "%5.3" EXTENDED_LIMITS 0.00 255.0 /end CHARACTERISTIC
/begin CHARACTERISTIC MoFErrHndlg_stCfgErrReactnEmComp_C "Switch Error Reaction Torque Compare Error EM Level" VALUE 0x8026CC4F Val_Wu8 255.0 OneToOne 0.00 255.0 FORMAT "%5.1" /end CHARACTERISTIC
/begin CHARACTERISTIC MoFErrHndlg_stCfgErrReactnEmSignComp_C "Switch Error Reaction Torque Sign Error" VALUE 0x8026CC50 Val_Wu8 0.00 OneToOne 2.000 2.000 FORMAT "%5.3" EXTENDED_LIMITS 0.00 255.0 /end CHARACTERISTIC
/begin CHARACTERISTIC MoFErrHndlg_stCfgErrReactnPostBldSel_C "Switch Error Reaction PostBldSel" VALUE 0x8026CC51 Val_Wu8 255.0 OneToOne 0.00 255.0 FORMAT "%5.1" /end CHARACTERISTIC
/begin CHARACTERISTIC MoFErrHndlg_stCfgErrReactnPtRels_C "Switch Error Reaction Powertrain Release" VALUE 0x8026CC52 Val_Wu8 255.0 OneToOne 0.00 255.0 FORMAT "%5.1" /end CHARACTERISTIC
/begin CHARACTERISTIC MoFErrHndlg_stCfgErrReactnSecAxleCompRe_C "Switch Error Reaction Torque Compare Error Secondary Axle Level in Reverse" VALUE 0x8026CC53 Val_Wu8 0.00 OneToOne 2.000 2.000 FORMAT "%5.3" EXTENDED_LIMITS 0.00 255.0 /end CHARACTERISTIC
/begin CHARACTERISTIC MoFErrHndlg_stCfgErrReactnSecAxleComp_C "Switch Error Reaction Torque Compare Error Secondary Axle Level" VALUE 0x8026CC54 Val_Wu8 255.0 OneToOne 0.00 255.0 FORMAT "%5.1" /end CHARACTERISTIC
/begin CHARACTERISTIC MoFErrHndlg_stCfgErrReactnSecEmCompRe_C "Switch Error Reaction Torque Compare Error Secondary EM Level in Reverse" VALUE 0x8026CC55 Val_Wu8 0.00 OneToOne 2.000 2.000 FORMAT "%5.3" EXTENDED_LIMITS 0.00 255.0 /end CHARACTERISTIC
/begin CHARACTERISTIC MoFErrHndlg_stCfgErrReactnSecEmComp_C "Switch Error Reaction Torque Compare Error Secondary EM Level" VALUE 0x8026CC56 Val_Wu8 255.0 OneToOne 0.00 255.0 FORMAT "%5.1" /end CHARACTERISTIC
/begin CHARACTERISTIC MoFErrHndlg_stCfgErrReactnSecEmSignComp_C "Switch Error Reaction Torque Secondary EM Sign Error" VALUE 0x8026CC57 Val_Wu8 255.0 OneToOne 0.00 255.0 FORMAT "%5.1" /end CHARACTERISTIC
/begin CHARACTERISTIC MoFErrHndlg_stCfgErrReactnSecPtRels_C "Switch Error Reaction Secondary Powertrain Release" VALUE 0x8026CC58 Val_Wu8 255.0 OneToOne 0.00 255.0 FORMAT "%5.1" /end CHARACTERISTIC
/begin CHARACTERISTIC MoFErrHndlg_stCfgErrReactnVehCompRe_C "Switch Error Reaction Torque Compare Error Vehicle Level in R" VALUE 0x8026CC59 Val_Wu8 0.00 OneToOne 2.000 2.000 FORMAT "%5.3" EXTENDED_LIMITS 0.00 255.0 /end CHARACTERISTIC
/begin CHARACTERISTIC MoFErrHndlg_stCfgErrReactnVehComp_C "Switch Error Reaction Torque Compare Error Vehicle Level" VALUE 0x8026CC5A Val_Wu8 255.0 OneToOne 0.00 255.0 FORMAT "%5.1" /end CHARACTERISTIC
/begin CHARACTERISTIC MoFErrHndlg_swtErrReactn_C "Parameter to enable or disabe error reaction" VALUE 0x8026CC5B Val_Wu8 255.0 OneToOne 0.00 255.0 FORMAT "%5.1" /end CHARACTERISTIC
/begin CHARACTERISTIC MoFEscAssc_stEMPrsntCfg_C "Calibration switch to configure the existing EM in the system for ESC intervention." VALUE 0x8026CC5C Val_Wu8 255.0 OneToOne 0.00 255.0 FORMAT "%5.1" /end CHARACTERISTIC
/begin CHARACTERISTIC MoFEscAssc_stErrIrrvEM02_C "Calibration to make errors irreversible for secondary axle" VALUE 0x8026CC5D Val_Wu8 255.0 OneToOne 0.00 255.0 FORMAT "%5.1" /end CHARACTERISTIC
/begin CHARACTERISTIC MoFEscAssc_stErrIrrv_C "Calibration to make errors irreversible" VALUE 0x8026CC5E Val_Wu8 255.0 OneToOne 0.00 255.0 FORMAT "%5.1" /end CHARACTERISTIC
/begin CHARACTERISTIC MoFEscAssc_swtCnvrtWhlEM02_C "Software switch for deactivation of drivetrain ratio in the calculation of ESP interventions for secondary axle" VALUE 0x8026CC5F Val_Wu8 255.0 OneToOne 0.00 255.0 FORMAT "%5.1" /end CHARACTERISTIC
/begin CHARACTERISTIC MoFEscAssc_swtCnvrtWhl_C "Software switch for deactivation of drivetrain ratio in the calculation of ESP interventions" VALUE 0x8026CC60 Val_Wu8 255.0 OneToOne 0.00 255.0 FORMAT "%5.1" /end CHARACTERISTIC
/begin CHARACTERISTIC MoFEscAssc_tqDecDmdDft_C "Default value for EM01 TCS intervention." VALUE 0x8026D01C Val_Ws32 429496729.500 TrqPrpHigh -214748364.800 214748364.700 FORMAT "%13.3" /end CHARACTERISTIC
/begin CHARACTERISTIC MoFEscAssc_tqDecDmdEM02Dft_C "Default value for EM02 TCS intervention." VALUE 0x8026D020 Val_Ws32 429496729.500 TrqPrpHigh -214748364.800 214748364.700 FORMAT "%13.3" /end CHARACTERISTIC
/begin CHARACTERISTIC MoFEscAssc_tqDecDmdEM02Max_C "Maximum allowed decreasing ESC torque demand for EM02." VALUE 0x8026D024 Val_Ws32 429496729.500 TrqPrpHigh -214748364.800 214748364.700 FORMAT "%13.3" /end CHARACTERISTIC
/begin CHARACTERISTIC MoFEscAssc_tqDecDmdEM02Min_C "Minimum allowed decreasing ESP torque demand for EM02." VALUE 0x8026D028 Val_Ws32 429496729.500 TrqPrpHigh -214748364.800 214748364.700 FORMAT "%13.3" /end CHARACTERISTIC
/begin CHARACTERISTIC MoFEscAssc_tqDecDmdMax_C "Maximum allowed decreasing ESP torque demand for EM01." VALUE 0x8026D02C Val_Ws32 429496729.500 TrqPrpHigh -214748364.800 214748364.700 FORMAT "%13.3" /end CHARACTERISTIC
/begin CHARACTERISTIC MoFEscAssc_tqDecDmdMin_C "Minimum allowed decreasing ESP torque demand for EM01." VALUE 0x8026D030 Val_Ws32 429496729.500 TrqPrpHigh -214748364.800 214748364.700 FORMAT "%13.3" /end CHARACTERISTIC
/begin CHARACTERISTIC MoFEscAssc_tqIncDmdDft_C "Default value for EM01 DCS intervention." VALUE 0x8026D034 Val_Ws32 429496729.500 TrqPrpHigh -214748364.800 214748364.700 FORMAT "%13.3" /end CHARACTERISTIC
/begin CHARACTERISTIC MoFEscAssc_tqIncDmdEM02Dft_C "Default value for EM02 DCS intervention." VALUE 0x8026D038 Val_Ws32 429496729.500 TrqPrpHigh -214748364.800 214748364.700 FORMAT "%13.3" /end CHARACTERISTIC
/begin CHARACTERISTIC MoFEscAssc_tqIncDmdEM02Max_C "Maximum allowed increasing ESP torque demand for EM02." VALUE 0x8026D03C Val_Ws32 429496729.500 TrqPrpHigh -214748364.800 214748364.700 FORMAT "%13.3" /end CHARACTERISTIC
/begin CHARACTERISTIC MoFEscAssc_tqIncDmdEM02Min_C "Minimum allowed increasing ESP torque demand for EM02." VALUE 0x8026D040 Val_Ws32 429496729.500 TrqPrpHigh -214748364.800 214748364.700 FORMAT "%13.3" /end CHARACTERISTIC
/begin CHARACTERISTIC MoFEscAssc_tqIncDmdMax_C "Maximum allowed increasing ESP torque demand for EM01." VALUE 0x8026D044 Val_Ws32 429496729.500 TrqPrpHigh -214748364.800 214748364.700 FORMAT "%13.3" /end CHARACTERISTIC
/begin CHARACTERISTIC MoFEscAssc_tqIncDmdMin_C "Minimum allowed increasing ESP torque demand for EM01." VALUE 0x8026D048 Val_Ws32 429496729.500 TrqPrpHigh -214748364.800 214748364.700 FORMAT "%13.3" /end CHARACTERISTIC
/begin MEASUREMENT DFC_st.DFC_MoCSOPICO "" UBYTE DFC_OneToOne 1 100 0.00 255.0 FORMAT "%5.1" ECU_ADDRESS 0x60034D44 /end MEASUREMENT
/begin MEASUREMENT DFC_st.DFC_MoFAccr "" UBYTE DFC_OneToOne 1 100 0.00 255.0 FORMAT "%5.1" ECU_ADDRESS 0x60034D45 /end MEASUREMENT
/begin MEASUREMENT DFC_st.DFC_MoFCbnPreCdngOvrheat "" UBYTE DFC_OneToOne 1 100 0.00 255.0 FORMAT "%5.1" ECU_ADDRESS 0x60034D46 /end MEASUREMENT
/begin MEASUREMENT DFC_st.DFC_MoFCbnPreCdngTmrExpi "" UBYTE DFC_OneToOne 1 100 0.00 255.0 FORMAT "%5.1" ECU_ADDRESS 0x60034D47 /end MEASUREMENT
/begin MEASUREMENT MoCSOP_cntrDebErrPinActv "debounce counter for active error pin during positive and overvoltage test" UBYTE OneToOne 1 100 0.00 255.0 FORMAT "%5.1" ECU_ADDRESS 0x6002C0B6
 /begin IF_DATA XCPplus 0x0102
  /begin DAQ_EVENT VARIABLE /end DAQ_EVENT
 /end IF_DATA
/end MEASUREMENT
/begin MEASUREMENT MoCSOP_cntrDebErrPinActvCpl "Complement of debounce counter for active error pin during positive and overvoltage test" UBYTE OneToOne 1 100 0.00 255.0 FORMAT "%5.1" ECU_ADDRESS 0x6002C0B5
 /begin IF_DATA XCPplus 0x0102
  /begin DAQ_EVENT VARIABLE /end DAQ_EVENT
 /end IF_DATA
/end MEASUREMENT
/begin MEASUREMENT MoCSOP_cntrDebExtErrPinEveActv "Debounce counter for error in disabling of external error pin event" UBYTE OneToOne 1 100 0.00 255.0 FORMAT "%5.1" ECU_ADDRESS 0x6002C0B4
 /begin IF_DATA XCPplus 0x0102
  /begin DAQ_EVENT VARIABLE /end DAQ_EVENT
 /end IF_DATA
/end MEASUREMENT
/begin MEASUREMENT MoCSOP_cntrDebExtErrPinEveActvCpl "Complement of debounce counter for error in disabling of external error pin event" UBYTE OneToOne 1 100 0.00 255.0 FORMAT "%5.1" ECU_ADDRESS 0x6002C0B3
 /begin IF_DATA XCPplus 0x0102
  /begin DAQ_EVENT VARIABLE /end DAQ_EVENT
 /end IF_DATA
/end MEASUREMENT
/begin MEASUREMENT MoCSOP_cntrDebExtErrPinEveActv_MP "Measurement Array for debounce counter for error in disabling of external error pin event" UBYTE OneToOne 1 100 0.00 255.0 FORMAT "%5.1" MATRIX_DIM 25 ECU_ADDRESS 0x70006BE8 /end MEASUREMENT
/begin MEASUREMENT MoCSOP_cntrDebSycDrv "Debounce counter for the delay required in reading the injection power stages" UBYTE OneToOne 1 100 0.00 255.0 FORMAT "%5.1" ECU_ADDRESS 0x6002C0B2 /end MEASUREMENT
/begin MEASUREMENT MoCSOP_cntrDebSycDrvCpl "Double storage of MoCSOP_cntrDebSycDrv" UBYTE OneToOne 1 100 0.00 255.0 FORMAT "%5.1" ECU_ADDRESS 0x6002C0B1 /end MEASUREMENT
/begin MEASUREMENT MoCSOP_cntrSignalSwtDelay "Counter to debounce the delay required in reading the feedback line status" UBYTE OneToOne 1 100 0.00 255.0 FORMAT "%5.1" ECU_ADDRESS 0x6002C0B0
 /begin IF_DATA XCPplus 0x0102
  /begin DAQ_EVENT VARIABLE /end DAQ_EVENT
 /end IF_DATA
/end MEASUREMENT
/begin MEASUREMENT MoCSOP_cntrSignalSwtDelayCpl "Double storage of MoCSOP_cntrSignalSwtDelay" UBYTE OneToOne 1 100 0.00 255.0 FORMAT "%5.1" ECU_ADDRESS 0x6002C0AF
 /begin IF_DATA XCPplus 0x0102
  /begin DAQ_EVENT VARIABLE /end DAQ_EVENT
 /end IF_DATA
/end MEASUREMENT
/begin MEASUREMENT MoCSOP_ctBusErr "error counter for communication bus error between FC and other ASICS like power stage ASIC, Monitoring module etc" UBYTE OneToOne 1 100 0.00 255.0 FORMAT "%5.1" ECU_ADDRESS 0x6002C0AE
 /begin IF_DATA XCPplus 0x0102
  /begin DAQ_EVENT VARIABLE /end DAQ_EVENT
 /end IF_DATA
/end MEASUREMENT
/begin MEASUREMENT MoCSOP_ctBusErr_MP "Measurement point of error counter for communication bus error between FC and other ASICS like power stage ASIC, Monitoring module etc" UBYTE OneToOne 1 100 0.00 255.0 FORMAT "%5.1" MATRIX_DIM 25 ECU_ADDRESS 0x70006BCF /end MEASUREMENT
/begin MEASUREMENT MoCSOP_ctCANFrIdx "Index for MoCSOPs measurement point arrays for CANFR test" UBYTE OneToOne 1 100 0.00 255.0 FORMAT "%5.1" ECU_ADDRESS 0x6002C0AD /end MEASUREMENT
/begin MEASUREMENT MoCSOP_ctDebCANFrTest "timeout error counter in CAN and FlexRay test" UBYTE OneToOne 1 100 0.00 255.0 FORMAT "%5.1" ECU_ADDRESS 0x6002C0AC /end MEASUREMENT
/begin MEASUREMENT MoCSOP_ctDebCANFrTestCpl "complement of the timeout error counter in CAN and FlexRay test" UBYTE OneToOne 1 100 0.00 255.0 FORMAT "%5.1" ECU_ADDRESS 0x6002C0AB /end MEASUREMENT
/begin MEASUREMENT MoCSOP_ctDebSOPTst "Number of repetitions of shut-off path test (implementation of a time monitoring)" UWORD OneToOne 1 100 0.00 65535.00 FORMAT "%8.2" ECU_ADDRESS 0x6002C072
 /begin IF_DATA XCPplus 0x0102
  /begin DAQ_EVENT VARIABLE /end DAQ_EVENT
 /end IF_DATA
/end MEASUREMENT
/begin MEASUREMENT MoCSOP_ctDebSOPTstCpl "Complement copy of MoCSOP_ctDebSOPTst" UWORD OneToOne 1 100 0.00 65535.00 FORMAT "%8.2" ECU_ADDRESS 0x6002C070 /end MEASUREMENT
/begin MEASUREMENT MoCSOP_ctErrMM "Copy of the error counter from the monitoring module in function controller" UBYTE OneToOne 1 100 0.00 255.0 FORMAT "%5.1" ECU_ADDRESS 0x6002C08A
 /begin IF_DATA XCPplus 0x0102
  /begin DAQ_EVENT VARIABLE /end DAQ_EVENT
 /end IF_DATA
/end MEASUREMENT
/begin MEASUREMENT MoCSOP_ctErrMM_mp "Array copy of MoCSOP_ctErrMM in 2,2ms- Raster" UBYTE OneToOne 1 100 0.00 255.0 FORMAT "%5.1" MATRIX_DIM 25 ECU_ADDRESS 0x70006BB6 /end MEASUREMENT
/begin MEASUREMENT MoCSOP_ctErrOSTimeout "error counter handling Alarm Task period" UBYTE OneToOne 1 100 0.00 255.0 FORMAT "%5.1" ECU_ADDRESS 0x6002C0AA
 /begin IF_DATA XCPplus 0x0102
  /begin DAQ_EVENT VARIABLE /end DAQ_EVENT
 /end IF_DATA
/end MEASUREMENT
/begin MEASUREMENT MoCSOP_ctIdx "Index for MoCSOPs measurement point arrays (for full measurements without data loss with an INCA 10ms raster, though a 2.2 ms alarm task raster =gt; 5 or 4 entries10ms ). Shows the last written index position." UBYTE OneToOne 1 100 0.00 255.0 FORMAT "%5.1" ECU_ADDRESS 0x6002C0A9
 /begin IF_DATA XCPplus 0x0102
  /begin DAQ_EVENT VARIABLE /end DAQ_EVENT
 /end IF_DATA
/end MEASUREMENT
/begin MEASUREMENT MoCSOP_ctRespOffsetTst "Counter used for test purpose in time of response" UWORD OneToOne 1 100 0.00 65535.00 FORMAT "%8.2" ECU_ADDRESS 0x6002C06E /end MEASUREMENT
/begin MEASUREMENT MoCSOP_ctRst "number of resets executed in shut off path test" UBYTE OneToOne 1 100 0.00 255.0 FORMAT "%5.1" ECU_ADDRESS 0x600347D7
 /begin IF_DATA XCPplus 0x0102
  /begin DAQ_EVENT VARIABLE /end DAQ_EVENT
 /end IF_DATA
/end MEASUREMENT
/begin MEASUREMENT MoCSOP_ctRstCANFrTest "No of Resets executed for CANFR test" UBYTE OneToOne 1 100 0.00 255.0 FORMAT "%5.1" ECU_ADDRESS 0x600347D6
 /begin IF_DATA XCPplus 0x0102
  /begin DAQ_EVENT VARIABLE /end DAQ_EVENT
 /end IF_DATA
/end MEASUREMENT
/begin MEASUREMENT MoCSOP_ctRstCANFrTestCpl "complement number of resets executed in CANFR shut off path test" UBYTE OneToOne 1 100 0.00 255.0 FORMAT "%5.1" ECU_ADDRESS 0x600347D5
 /begin IF_DATA XCPplus 0x0102
  /begin DAQ_EVENT VARIABLE /end DAQ_EVENT
 /end IF_DATA
/end MEASUREMENT
/begin MEASUREMENT MoCSOP_ctRstCpl "complement number of resets executed in shut off path test" UBYTE OneToOne 1 100 0.00 255.0 FORMAT "%5.1" ECU_ADDRESS 0x600347D4
 /begin IF_DATA XCPplus 0x0102
  /begin DAQ_EVENT VARIABLE /end DAQ_EVENT
 /end IF_DATA
/end MEASUREMENT
/begin MEASUREMENT MoCSOP_flgErrPinActvd "Flag to indicate if error pin is activated during Error Pin negative test" UBYTE OneToOne 1 100 0.00 255.0 FORMAT "%5.1" ECU_ADDRESS 0x6002C0A8
 /begin IF_DATA XCPplus 0x0102
  /begin DAQ_EVENT VARIABLE /end DAQ_EVENT
 /end IF_DATA
/end MEASUREMENT
/begin MEASUREMENT MoCSOP_flgErrPinActvdCpl "Double storage for MoCSOP_flgErrPinActvd" UBYTE OneToOne 1 100 0.00 255.0 FORMAT "%5.1" ECU_ADDRESS 0x6002C0A7
 /begin IF_DATA XCPplus 0x0102
  /begin DAQ_EVENT VARIABLE /end DAQ_EVENT
 /end IF_DATA
/end MEASUREMENT
/begin MEASUREMENT MoCSOP_flgReqSOPTest "Flag to indicate that a request to execute shuit off path test is present" UBYTE OneToOne 1 100 0.00 255.0 FORMAT "%5.1" ECU_ADDRESS 0x6002CAB8
 /begin IF_DATA XCPplus 0x0102
  /begin DAQ_EVENT VARIABLE /end DAQ_EVENT
 /end IF_DATA
/end MEASUREMENT
/begin MEASUREMENT MoCSOP_flgReqSOPTestCpl "Complement of request to execute SOP test variable" UBYTE OneToOne 1 100 0.00 255.0 FORMAT "%5.1" ECU_ADDRESS 0x6002C0A6
 /begin IF_DATA XCPplus 0x0102
  /begin DAQ_EVENT VARIABLE /end DAQ_EVENT
 /end IF_DATA
/end MEASUREMENT
/begin MEASUREMENT MoCSOP_flgT15RisngEdge "Flag to detect the T15_st rising edge" UBYTE OneToOne 1 100 0.00 255.0 FORMAT "%5.1" ECU_ADDRESS 0x6002CAB7
 /begin IF_DATA XCPplus 0x0102
  /begin DAQ_EVENT VARIABLE /end DAQ_EVENT
 /end IF_DATA
/end MEASUREMENT
/begin MEASUREMENT MoCSOP_flgT15RisngEdgeCpl "Complement of T15 rising edge variable" UBYTE OneToOne 1 100 0.00 255.0 FORMAT "%5.1" ECU_ADDRESS 0x6002C0A5
 /begin IF_DATA XCPplus 0x0102
  /begin DAQ_EVENT VARIABLE /end DAQ_EVENT
 /end IF_DATA
/end MEASUREMENT
/begin MEASUREMENT MoCSOP_st "status of the shut-down path test" UWORD OneToOne 1 100 0.00 65535.00 FORMAT "%8.2" ECU_ADDRESS 0x600347CC
 /begin IF_DATA XCPplus 0x0102
  /begin DAQ_EVENT VARIABLE /end DAQ_EVENT
 /end IF_DATA
/end MEASUREMENT
/begin MEASUREMENT MoCSOP_stActMsg "copy of the status variable for synchronizing shut off path test and query-/response communication" UBYTE dez 1 100 0.00 255.0 FORMAT "%5.1" ECU_ADDRESS 0x7000142B
 /begin IF_DATA XCPplus 0x0102
  /begin DAQ_EVENT VARIABLE /end DAQ_EVENT
 /end IF_DATA
/end MEASUREMENT
/begin MEASUREMENT MoCSOP_stActvMsg "Information for level 1, 2: Shut-off path test is on or WDA-line is active (injections disabled)" UBYTE dez 1 100 0.00 255.0 FORMAT "%5.1" ECU_ADDRESS 0x7000142A
 /begin IF_DATA XCPplus 0x0102
  /begin DAQ_EVENT VARIABLE /end DAQ_EVENT
 /end IF_DATA
/end MEASUREMENT
/begin MEASUREMENT MoCSOP_stBusErr "status variable for communication bus error between FC and other ASICS like power stage ASIC, Monitoring module etc" UWORD OneToOne 1 100 0.00 65535.00 FORMAT "%8.2" ECU_ADDRESS 0x6002C06C /end MEASUREMENT
/begin MEASUREMENT MoCSOP_stBusErr_MP "Measurement point for status variable for communication bus error between FC and other ASICS like power stage ASIC, Monitoring module etc" UWORD OneToOne 1 100 0.00 65535.00 FORMAT "%8.2" MATRIX_DIM 25 ECU_ADDRESS 0x7000694E /end MEASUREMENT
/begin MEASUREMENT MoCSOP_stCANFrTest "CANFR test status" UBYTE OneToOne 1 100 0.00 255.0 FORMAT "%5.1" ECU_ADDRESS 0x6002C089 /end MEASUREMENT
/begin MEASUREMENT MoCSOP_stCANFrTestCpl "Complement of status of CANFR test status" UBYTE OneToOne 1 100 0.00 255.0 FORMAT "%5.1" ECU_ADDRESS 0x6002C0A4 /end MEASUREMENT
/begin MEASUREMENT MoCSOP_stCANFrTestErr "Error status of CANFR test" UBYTE OneToOne 1 100 0.00 255.0 FORMAT "%5.1" ECU_ADDRESS 0x6002C0A3 /end MEASUREMENT
/begin MEASUREMENT MoCSOP_stCANFrTestErrReas "Reason for CAN-FR shut off path test failure" UBYTE OneToOne 1 100 0.00 255.0 FORMAT "%5.1" ECU_ADDRESS 0x600347D3 /end MEASUREMENT
/begin MEASUREMENT MoCSOP_stCANFrTestErrReasCpl "Complement of reason for CAN-FR shut off path test failure" UBYTE OneToOne 1 100 0.00 255.0 FORMAT "%5.1" ECU_ADDRESS 0x600347D2 /end MEASUREMENT
/begin MEASUREMENT MoCSOP_stCANFrTestState "status of state machine check CANFR test" UBYTE OneToOne 1 100 0.00 255.0 FORMAT "%5.1" ECU_ADDRESS 0x6002C0A2 /end MEASUREMENT
/begin MEASUREMENT MoCSOP_stCANFrTestStateCpl "Complement of MoCSOP_stCANFrTestState" UBYTE OneToOne 1 100 0.00 255.0 FORMAT "%5.1" ECU_ADDRESS 0x6002C0A1 /end MEASUREMENT
/begin MEASUREMENT MoCSOP_stCanTdi "Status bit for activation or deactivation of the CAN_TDI shut off path during an active WDA line" UBYTE B_TRUE 1 100 0.00 1.00000000000 BIT_MASK 0x1 FORMAT "%13.11" ECU_ADDRESS 0x6002C0A0 /end MEASUREMENT
/begin MEASUREMENT MoCSOP_stCANTestState_mp "measurement-array for displaying the actual state of the state machine during the CAN test" UBYTE MoCSOP_stCANFrTestState_mp_Compu 1 100 0.00 12.0000000000 FORMAT "%13.10" MATRIX_DIM 12 ECU_ADDRESS 0x70006BAA /end MEASUREMENT
/begin MEASUREMENT MoCSOP_stCheckState "status state machine check power stages" UBYTE MoCSOP_stCheckStateCY329_mp_Compu 1 100 0.00 18.0000000000 FORMAT "%13.10" ECU_ADDRESS 0x6002C09F
 /begin IF_DATA XCPplus 0x0102
  /begin DAQ_EVENT VARIABLE /end DAQ_EVENT
 /end IF_DATA
/end MEASUREMENT
/begin MEASUREMENT MoCSOP_stCheckStateCpl "Complement of MoCSOP_stCheckState" UBYTE OneToOne 1 100 0.00 255.0 FORMAT "%5.1" ECU_ADDRESS 0x6002C09E
 /begin IF_DATA XCPplus 0x0102
  /begin DAQ_EVENT VARIABLE /end DAQ_EVENT
 /end IF_DATA
/end MEASUREMENT
/begin MEASUREMENT MoCSOP_stCheckState_mp "State variable indicates which MoCSOP step is executed" UBYTE MoCSOP_stCheckStateCY329_mp_Compu 1 100 0.00 18.0000000000 FORMAT "%13.10" MATRIX_DIM 25 ECU_ADDRESS 0x70006B91 /end MEASUREMENT
/begin MEASUREMENT MoCSOP_stComActv "status for communication from MoCCOM active" UBYTE OneToOne 1 100 0.00 255.0 FORMAT "%5.1" ECU_ADDRESS 0x6002C088
 /begin IF_DATA XCPplus 0x0102
  /begin DAQ_EVENT VARIABLE /end DAQ_EVENT
 /end IF_DATA
/end MEASUREMENT
/begin MEASUREMENT MoCSOP_stComActvCpl "RAM data redundancy for MoCSOP_stComActv" UBYTE OneToOne 1 100 0.00 255.0 FORMAT "%5.1" ECU_ADDRESS 0x6002C087
 /begin IF_DATA XCPplus 0x0102
  /begin DAQ_EVENT VARIABLE /end DAQ_EVENT
 /end IF_DATA
/end MEASUREMENT
/begin MEASUREMENT MoCSOP_stComTrcvOld "Array to hold the STB pin status of the transceivers before the Com shut off path test" ULONG OneToOne 1 100 0.00 4294967295.00 FORMAT "%13.2" MATRIX_DIM 4 ECU_ADDRESS 0x6002C074 /end MEASUREMENT
/begin MEASUREMENT MoCSOP_stCpl "RAM data redundancy for MoCSOP_st" UWORD OneToOne 1 100 0.00 65535.00 FORMAT "%8.2" ECU_ADDRESS 0x600347CE
 /begin IF_DATA XCPplus 0x0102
  /begin DAQ_EVENT VARIABLE /end DAQ_EVENT
 /end IF_DATA
/end MEASUREMENT
/begin MEASUREMENT MoCSOP_stDia "diagnose status of the shut-down path test" UBYTE OneToOne 1 100 0.00 255.0 FORMAT "%5.1" ECU_ADDRESS 0x6002C09D
 /begin IF_DATA XCPplus 0x0102
  /begin DAQ_EVENT VARIABLE /end DAQ_EVENT
 /end IF_DATA
/end MEASUREMENT
/begin MEASUREMENT MoCSOP_stDiaCpl "RAM data redundancy for MoCSOP_stDia" UBYTE OneToOne 1 100 0.00 255.0 FORMAT "%5.1" ECU_ADDRESS 0x6002C09C
 /begin IF_DATA XCPplus 0x0102
  /begin DAQ_EVENT VARIABLE /end DAQ_EVENT
 /end IF_DATA
/end MEASUREMENT
/begin MEASUREMENT MoCSOP_stDiaERPN "diagnose status of the CY329 specific shut off path tests" UBYTE OneToOne 1 100 0.00 255.0 FORMAT "%5.1" ECU_ADDRESS 0x6002C09B
 /begin IF_DATA XCPplus 0x0102
  /begin DAQ_EVENT VARIABLE /end DAQ_EVENT
 /end IF_DATA
/end MEASUREMENT
/begin MEASUREMENT MoCSOP_stDiaERPNCpl "Complement for diagnose status of the CY329 specific shut off path tests" UBYTE OneToOne 1 100 0.00 255.0 FORMAT "%5.1" ECU_ADDRESS 0x6002C09A
 /begin IF_DATA XCPplus 0x0102
  /begin DAQ_EVENT VARIABLE /end DAQ_EVENT
 /end IF_DATA
/end MEASUREMENT
/begin MEASUREMENT MoCSOP_stEmmState_MP "Measurement Array for EMM state" UBYTE MoCSOP_stEmmStateIFX_MP_Compu 1 100 0.00 32.0000000000 FORMAT "%13.10" MATRIX_DIM 25 ECU_ADDRESS 0x70006B78 /end MEASUREMENT
/begin MEASUREMENT MoCSOP_stErr "contains the state of the communication via SPI-subsystem to the monitoring module" UBYTE OneToOne 1 100 0.00 255.0 FORMAT "%5.1" ECU_ADDRESS 0x6002C099 /end MEASUREMENT
/begin MEASUREMENT MoCSOP_stErrPinActvnReq "Status for the activation of the error pin in the FlexRay or CAN test, if the WDA line was not active during the test." UBYTE OneToOne 1 100 0.00 255.0 FORMAT "%5.1" ECU_ADDRESS 0x6002C098 /end MEASUREMENT
/begin MEASUREMENT MoCSOP_stErrPin_MP "Measurement point with the actual error pin status" UBYTE MoCSOP_stErrPin_MP_Compu 1 100 0.00 1.00000000000 FORMAT "%13.11" MATRIX_DIM 25 ECU_ADDRESS 0x70006B5F /end MEASUREMENT
/begin MEASUREMENT MoCSOP_stErrReactn "Status which error reaction type will be executed" UBYTE OneToOne 1 100 0.00 255.0 FORMAT "%5.1" ECU_ADDRESS 0x6002C097 /end MEASUREMENT
/begin MEASUREMENT MoCSOP_stErrReactnERPN "Status to indicate which error reaction type will be triggered for CY329 specific shut off path tests" UBYTE OneToOne 1 100 0.00 255.0 FORMAT "%5.1" ECU_ADDRESS 0x6002C096 /end MEASUREMENT
/begin MEASUREMENT MoCSOP_stInhbStrtCdn "Status to start shut-off path test interupted due to inhibit line active condition" UBYTE OneToOne 1 100 0.00 255.0 FORMAT "%5.1" ECU_ADDRESS 0x6002CAB6
 /begin IF_DATA XCPplus 0x0102
  /begin DAQ_EVENT VARIABLE /end DAQ_EVENT
 /end IF_DATA
/end MEASUREMENT
/begin MEASUREMENT MoCSOP_stOvl "Status variable for CJ945 overvoltage detection latch" UBYTE dez 1 100 0.00 255.0 FORMAT "%5.1" ECU_ADDRESS 0x70001429
 /begin IF_DATA XCPplus 0x0102
  /begin DAQ_EVENT VARIABLE /end DAQ_EVENT
 /end IF_DATA
/end MEASUREMENT
/begin MEASUREMENT MoCSOP_stOvlCpl "Double storage of the status variable for CJ945 overvoltage detection latch" UBYTE dez 1 100 0.00 255.0 FORMAT "%5.1" ECU_ADDRESS 0x70001428
 /begin IF_DATA XCPplus 0x0102
  /begin DAQ_EVENT VARIABLE /end DAQ_EVENT
 /end IF_DATA
/end MEASUREMENT
/begin MEASUREMENT MoCSOP_stOVTstStatusEval "Overvoltage test evaluation status" UBYTE OneToOne 1 100 0.00 255.0 FORMAT "%5.1" ECU_ADDRESS 0x6002C095
 /begin IF_DATA XCPplus 0x0102
  /begin DAQ_EVENT VARIABLE /end DAQ_EVENT
 /end IF_DATA
/end MEASUREMENT
/begin MEASUREMENT MoCSOP_stOVTstStatusEvalCpl "Complement variable for overvoltage test evaluation status" UBYTE OneToOne 1 100 0.00 255.0 FORMAT "%5.1" ECU_ADDRESS 0x6002C094
 /begin IF_DATA XCPplus 0x0102
  /begin DAQ_EVENT VARIABLE /end DAQ_EVENT
 /end IF_DATA
/end MEASUREMENT
/begin MEASUREMENT MoCSOP_stPVMTUnderTest "PVMT signal which is under test during overvoltage test" UBYTE OneToOne 1 100 0.00 255.0 FORMAT "%5.1" ECU_ADDRESS 0x6002C093
 /begin IF_DATA XCPplus 0x0102
  /begin DAQ_EVENT VARIABLE /end DAQ_EVENT
 /end IF_DATA
/end MEASUREMENT
/begin MEASUREMENT MoCSOP_stRdy "Status variable for synchronisation from shut-off path test and query/response communication (test is done completely)" UBYTE OneToOne 1 100 0.00 255.0 FORMAT "%5.1" ECU_ADDRESS 0x600347D1
 /begin IF_DATA XCPplus 0x0102
  /begin DAQ_EVENT VARIABLE /end DAQ_EVENT
 /end IF_DATA
/end MEASUREMENT
/begin MEASUREMENT MoCSOP_stRdyCan "indicates that the CAN test was executed" UBYTE OneToOne 1 100 0.00 255.0 FORMAT "%5.1" ECU_ADDRESS 0x6002C086 /end MEASUREMENT
/begin MEASUREMENT MoCSOP_stRdyCanCpl "Complement of MoCSOP_stRdyCan" UBYTE OneToOne 1 100 0.00 255.0 FORMAT "%5.1" ECU_ADDRESS 0x6002C092 /end MEASUREMENT
/begin MEASUREMENT MoCSOP_stRdyCpl "Double storage for status variable for synchronisation from shut-off path test and query/response communication" UBYTE OneToOne 1 100 0.00 255.0 FORMAT "%5.1" ECU_ADDRESS 0x600347D0
 /begin IF_DATA XCPplus 0x0102
  /begin DAQ_EVENT VARIABLE /end DAQ_EVENT
 /end IF_DATA
/end MEASUREMENT
/begin MEASUREMENT MoCSOP_stRdyFr "Indicates whether the FlexRay test was executed" UBYTE OneToOne 1 100 0.00 255.0 FORMAT "%5.1" ECU_ADDRESS 0x6002C085 /end MEASUREMENT
/begin MEASUREMENT MoCSOP_stRdyFrCpl "Complement of MoCSOP_stRdyFr" UBYTE OneToOne 1 100 0.00 255.0 FORMAT "%5.1" ECU_ADDRESS 0x6002C091 /end MEASUREMENT
/begin MEASUREMENT MoCSOP_stRdyInj "Indicates that the Injection control lines test was executed" UBYTE OneToOne 1 100 0.00 255.0 FORMAT "%5.1" ECU_ADDRESS 0x6002C084 /end MEASUREMENT
/begin MEASUREMENT MoCSOP_stRdyInjCpl "Complement of MoCSOP_stRdyInj" UBYTE OneToOne 1 100 0.00 255.0 FORMAT "%5.1" ECU_ADDRESS 0x6002C090 /end MEASUREMENT
/begin MEASUREMENT MoCSOP_stRdyMsg "information for level 1,2 about status of synchronizing shut off path test and query-/resonse-communication" UBYTE OneToOne 1 100 0.00 255.0 FORMAT "%5.1" ECU_ADDRESS 0x6002378F
 /begin IF_DATA XCPplus 0x0102
  /begin DAQ_EVENT VARIABLE /end DAQ_EVENT
 /end IF_DATA
/end MEASUREMENT
/begin MEASUREMENT MoCSOP_stReqPSStatus "Status of request power stage function" UBYTE OneToOne 1 100 0.00 255.0 FORMAT "%5.1" ECU_ADDRESS 0x6002C08F
 /begin IF_DATA XCPplus 0x0102
  /begin DAQ_EVENT VARIABLE /end DAQ_EVENT
 /end IF_DATA
/end MEASUREMENT
/begin MEASUREMENT MoCSOP_stReqPSStatusBusErr "Status of bus error in request powerstage status function" UBYTE OneToOne 1 100 0.00 255.0 FORMAT "%5.1" ECU_ADDRESS 0x6002C08E
 /begin IF_DATA XCPplus 0x0102
  /begin DAQ_EVENT VARIABLE /end DAQ_EVENT
 /end IF_DATA
/end MEASUREMENT
/begin MEASUREMENT MoCSOP_stReqSOPTest "Status to indicate the external request for shut off path test" UBYTE OneToOne 1 100 0.00 255.0 FORMAT "%5.1" ECU_ADDRESS 0x6002C08D
 /begin IF_DATA XCPplus 0x0102
  /begin DAQ_EVENT VARIABLE /end DAQ_EVENT
 /end IF_DATA
/end MEASUREMENT
/begin MEASUREMENT MoCSOP_stReqSOPTestCpl "Complement of Status to indicate the external request for shut off path test" UBYTE OneToOne 1 100 0.00 255.0 FORMAT "%5.1" ECU_ADDRESS 0x6002C08C
 /begin IF_DATA XCPplus 0x0102
  /begin DAQ_EVENT VARIABLE /end DAQ_EVENT
 /end IF_DATA
/end MEASUREMENT
/begin MEASUREMENT MoCSOP_stT15Old "Variable to update the T15_st status" UBYTE OneToOne 1 100 0.00 255.0 FORMAT "%5.1" ECU_ADDRESS 0x6002CAB5
 /begin IF_DATA XCPplus 0x0102
  /begin DAQ_EVENT VARIABLE /end DAQ_EVENT
 /end IF_DATA
/end MEASUREMENT
/begin MEASUREMENT MoCSOP_stT15OldCpl "Complement of MoCSOP_stT15Old" UBYTE OneToOne 1 100 0.00 255.0 FORMAT "%5.1" ECU_ADDRESS 0x6002C08B
 /begin IF_DATA XCPplus 0x0102
  /begin DAQ_EVENT VARIABLE /end DAQ_EVENT
 /end IF_DATA
/end MEASUREMENT
/begin MEASUREMENT MoCSOP_tiCanTest_MP "Actual time which was needed for the execution of the CAN test itself" ULONG MoCSOP_Time_us 1 100 0.00 4294967295.00 FORMAT "%13.2" ECU_ADDRESS 0x70006834 /end MEASUREMENT
/begin MEASUREMENT MoExe_ctCyc "10 ms counter to generate scheduling for monitoring" UBYTE OneToOne 1 100 0.00 255.0 FORMAT "%5.1" ECU_ADDRESS 0x6002CAB4 /end MEASUREMENT
/begin MEASUREMENT MoExe_ctCycCpl "Complement variable for MoExe_ctCyc" UBYTE OneToOne 1 100 0.00 255.0 FORMAT "%5.1" ECU_ADDRESS 0x6002C048 /end MEASUREMENT
/begin MEASUREMENT MoFAccrBrkPlaus_bbLoc2Cpl "byte to save local bits for complement checking" UBYTE OneToOne 1 100 0.00 255.0 FORMAT "%5.1" ECU_ADDRESS 0x6002C047
 /begin IF_DATA XCPplus 0x0102
  /begin DAQ_EVENT VARIABLE /end DAQ_EVENT
 /end IF_DATA
/end MEASUREMENT
/begin MEASUREMENT MoFAccrInp_bbLocCpl "RAM redundancy check for MoFAccrInp_bbLoc" UBYTE OneToOne 1 100 0.00 255.0 FORMAT "%5.1" ECU_ADDRESS 0x6002C040
 /begin IF_DATA XCPplus 0x0102
  /begin DAQ_EVENT VARIABLE /end DAQ_EVENT
 /end IF_DATA
/end MEASUREMENT
/begin MEASUREMENT MoFAccr_cntrDeb "Debounce counter for Error time for pedal signals which are implausible to each other during the monitoring" UBYTE OneToOne 1 100 0.00 255.0 FORMAT "%5.1" ECU_ADDRESS 0x6002CAAB
 /begin IF_DATA XCPplus 0x0102
  /begin DAQ_EVENT VARIABLE /end DAQ_EVENT
 /end IF_DATA
/end MEASUREMENT
/begin MEASUREMENT MoFAccr_cntrDebCpl "RAM redundancy check for MoFAccr_cntrDeb" UBYTE OneToOne 1 100 0.00 255.0 FORMAT "%5.1" ECU_ADDRESS 0x6002C03F
 /begin IF_DATA XCPplus 0x0102
  /begin DAQ_EVENT VARIABLE /end DAQ_EVENT
 /end IF_DATA
/end MEASUREMENT
/begin MEASUREMENT MoFAccr_cntrTestAccr "counter of testflag in diagnosis for monitoring of accelerator pedal position in function monitoring" UBYTE OneToOne 1 100 0.00 255.0 FORMAT "%5.1" ECU_ADDRESS 0x60023129
 /begin IF_DATA XCPplus 0x0102
  /begin DAQ_EVENT VARIABLE /end DAQ_EVENT
 /end IF_DATA
/end MEASUREMENT
/begin MEASUREMENT MoFAccr_flgAdcErr1 "Error while reading ADC value for APP1 in level 2" UBYTE B_TRUE 1 100 0.00 1.00000000000 BIT_MASK 0x8 FORMAT "%13.11" ECU_ADDRESS 0x6002CAAC
 /begin IF_DATA XCPplus 0x0102
  /begin DAQ_EVENT VARIABLE /end DAQ_EVENT
 /end IF_DATA
/end MEASUREMENT
/begin MEASUREMENT MoFAccr_flgAdcErr2 "Error while reading ADC value for APP2 in level 2" UBYTE B_TRUE 1 100 0.00 1.00000000000 BIT_MASK 0x10 FORMAT "%13.11" ECU_ADDRESS 0x6002CAAC
 /begin IF_DATA XCPplus 0x0102
  /begin DAQ_EVENT VARIABLE /end DAQ_EVENT
 /end IF_DATA
/end MEASUREMENT
/begin MEASUREMENT MoFAccr_flgBrkOvrdAccrFallEdge "Flag for falling edge of brake override accelerator" UBYTE B_TRUE 1 100 0.00 1.00000000000 BIT_MASK 0x4 FORMAT "%13.11" ECU_ADDRESS 0x6002CAB3
 /begin IF_DATA XCPplus 0x0102
  /begin DAQ_EVENT VARIABLE /end DAQ_EVENT
 /end IF_DATA
/end MEASUREMENT
/begin MEASUREMENT MoFAccr_flgBrkOvrdAccrPrev "Flag for brake override accelerator in previous raster" UBYTE B_TRUE 1 100 0.00 1.00000000000 BIT_MASK 0x2 FORMAT "%13.11" ECU_ADDRESS 0x6002CAB3
 /begin IF_DATA XCPplus 0x0102
  /begin DAQ_EVENT VARIABLE /end DAQ_EVENT
 /end IF_DATA
/end MEASUREMENT
/begin MEASUREMENT MoFAccr_flgClr "Diagnosis fault clear bit for the diagnosis monitoring" UBYTE B_TRUE 1 100 0.00 1.00000000000 BIT_MASK 0x1 FORMAT "%13.11" ECU_ADDRESS 0x70000134
 /begin IF_DATA XCPplus 0x0102
  /begin DAQ_EVENT VARIABLE /end DAQ_EVENT
 /end IF_DATA
/end MEASUREMENT
/begin MEASUREMENT MoFAccr_flgExtErr "Flag indicates the external error status of the accelerator pedal for the function monitoring" UBYTE B_TRUE 1 100 0.00 1.00000000000 BIT_MASK 0x2 FORMAT "%13.11" ECU_ADDRESS 0x6002CAAC
 /begin IF_DATA XCPplus 0x0102
  /begin DAQ_EVENT VARIABLE /end DAQ_EVENT
 /end IF_DATA
/end MEASUREMENT
/begin MEASUREMENT MoFAccr_flgIrrvErrMsg "Irreversible error status for level1 in function monitoring" UBYTE B_TRUE 1 100 0.00 1.00000000000 BIT_MASK 0x1 FORMAT "%13.11" ECU_ADDRESS 0x7000024E
 /begin IF_DATA XCPplus 0x0102
  /begin DAQ_EVENT VARIABLE /end DAQ_EVENT
 /end IF_DATA
/end MEASUREMENT
/begin MEASUREMENT MoFAccr_flgNTPRel "Flag for extension of the no load test pulse (NTP)" UBYTE B_TRUE 1 100 0.00 1.00000000000 BIT_MASK 0x4 FORMAT "%13.11" ECU_ADDRESS 0x6002CAAC
 /begin IF_DATA XCPplus 0x0102
  /begin DAQ_EVENT VARIABLE /end DAQ_EVENT
 /end IF_DATA
/end MEASUREMENT
/begin MEASUREMENT MoFAccr_flgPlausErr "Plausibility error of the accelerator pedal signals in function monitoring" UBYTE B_TRUE 1 100 0.00 1.00000000000 BIT_MASK 0x1 FORMAT "%13.11" ECU_ADDRESS 0x6002CAAC
 /begin IF_DATA XCPplus 0x0102
  /begin DAQ_EVENT VARIABLE /end DAQ_EVENT
 /end IF_DATA
/end MEASUREMENT
/begin MEASUREMENT MoFAccr_flgrPosRmp "Flag for positive ramping of accelerator pedal position" UBYTE B_TRUE 1 100 0.00 1.00000000000 BIT_MASK 0x1 FORMAT "%13.11" ECU_ADDRESS 0x6002CAB3
 /begin IF_DATA XCPplus 0x0102
  /begin DAQ_EVENT VARIABLE /end DAQ_EVENT
 /end IF_DATA
/end MEASUREMENT
/begin MEASUREMENT MoFAccr_flgSigRngChkErr "signal range check failed for accelerator pedal sensor failed" UBYTE B_TRUE 1 100 0.00 1.00000000000 BIT_MASK 0x20 FORMAT "%13.11" ECU_ADDRESS 0x6002CAAC
 /begin IF_DATA XCPplus 0x0102
  /begin DAQ_EVENT VARIABLE /end DAQ_EVENT
 /end IF_DATA
/end MEASUREMENT
/begin MEASUREMENT MoFAccr_flgSyncnChkErr "Synchronization check of accelerator pedal failed" UBYTE B_TRUE 1 100 0.00 1.00000000000 BIT_MASK 0x40 FORMAT "%13.11" ECU_ADDRESS 0x6002CAAC
 /begin IF_DATA XCPplus 0x0102
  /begin DAQ_EVENT VARIABLE /end DAQ_EVENT
 /end IF_DATA
/end MEASUREMENT
/begin MEASUREMENT MoFAccr_flgTestMsg "status of tested flag for App Diagnosis monitoring" UBYTE B_TRUE 1 100 0.00 1.00000000000 BIT_MASK 0x1 FORMAT "%13.11" ECU_ADDRESS 0x7000024D
 /begin IF_DATA XCPplus 0x0102
  /begin DAQ_EVENT VARIABLE /end DAQ_EVENT
 /end IF_DATA
/end MEASUREMENT
/begin MEASUREMENT MoFAccr_ratAccr "Accelerator pedal position in function monitoring" SWORD Prc 1 100 -400.0000 399.9878 FORMAT "%8.4" ECU_ADDRESS 0x6002CAAE
 /begin IF_DATA XCPplus 0x0102
  /begin DAQ_EVENT VARIABLE /end DAQ_EVENT
 /end IF_DATA
/end MEASUREMENT
/begin MEASUREMENT MoFAccr_ratAccrCpl "RAM data redundancy for MoFAccr_ratAccr" UWORD OneToOne 1 100 0.00 65535.00 FORMAT "%8.2" ECU_ADDRESS 0x6002C044
 /begin IF_DATA XCPplus 0x0102
  /begin DAQ_EVENT VARIABLE /end DAQ_EVENT
 /end IF_DATA
/end MEASUREMENT
/begin MEASUREMENT MoFAccr_rLnr "linearized accelerator pedal position" SWORD Prc 1 100 -400.0000 399.9878 FORMAT "%8.4" ECU_ADDRESS 0x6002CAA0
 /begin IF_DATA XCPplus 0x0102
  /begin DAQ_EVENT VARIABLE /end DAQ_EVENT
 /end IF_DATA
/end MEASUREMENT
/begin MEASUREMENT MoFAccr_rLnrCpl "Complement of accelerator pedal position" UWORD OneToOne 1 100 0.00 65535.00 FORMAT "%8.2" ECU_ADDRESS 0x6002C034
 /begin IF_DATA XCPplus 0x0102
  /begin DAQ_EVENT VARIABLE /end DAQ_EVENT
 /end IF_DATA
/end MEASUREMENT
/begin MEASUREMENT MoFAccr_rLnrUnAlgnd "Unaligned relative acclerator pedal value" SWORD Prc 1 100 -400.0000 399.9878 FORMAT "%8.4" ECU_ADDRESS 0x6002CAB0
 /begin IF_DATA XCPplus 0x0102
  /begin DAQ_EVENT VARIABLE /end DAQ_EVENT
 /end IF_DATA
/end MEASUREMENT
/begin MEASUREMENT MoFAccr_rLnrUnAlgndCpl "Unaligned relative acclerator pedal value complement" UWORD OneToOne 1 100 0.00 65535.00 FORMAT "%8.2" ECU_ADDRESS 0x6002C042
 /begin IF_DATA XCPplus 0x0102
  /begin DAQ_EVENT VARIABLE /end DAQ_EVENT
 /end IF_DATA
/end MEASUREMENT
/begin MEASUREMENT MoFAccr_rLnrUnfild "Unfiltered calculated relative accelerator pedal position" SWORD Prc 1 100 -400.0000 399.9878 FORMAT "%8.4" ECU_ADDRESS 0x6002CA9E
 /begin IF_DATA XCPplus 0x0102
  /begin DAQ_EVENT VARIABLE /end DAQ_EVENT
 /end IF_DATA
/end MEASUREMENT
/begin MEASUREMENT MoFAccr_rLnrUnfildCpl "Unfiltered calculated relative accelerator pedal position complement" UWORD OneToOne 1 100 0.00 65535.00 FORMAT "%8.2" ECU_ADDRESS 0x6002C032
 /begin IF_DATA XCPplus 0x0102
  /begin DAQ_EVENT VARIABLE /end DAQ_EVENT
 /end IF_DATA
/end MEASUREMENT
/begin MEASUREMENT MoFAccr_stAccrMsg "State of APP signal in monitoring" UBYTE OneToOne 1 100 0.00 255.0 FORMAT "%5.1" ECU_ADDRESS 0x6002352D
 /begin IF_DATA XCPplus 0x0102
  /begin DAQ_EVENT VARIABLE /end DAQ_EVENT
 /end IF_DATA
/end MEASUREMENT
/begin MEASUREMENT MoFAccr_stErrInp "Status of error information in acceleartion monitoring" UBYTE OneToOne 1 100 0.00 255.0 FORMAT "%5.1" ECU_ADDRESS 0x6002CAAA
 /begin IF_DATA XCPplus 0x0102
  /begin DAQ_EVENT VARIABLE /end DAQ_EVENT
 /end IF_DATA
/end MEASUREMENT
/begin MEASUREMENT MoFAccr_stErrInpCpl "RAM redundancy check for MoFAccr_stErrInp" UBYTE OneToOne 1 100 0.00 255.0 FORMAT "%5.1" ECU_ADDRESS 0x6002C03E
 /begin IF_DATA XCPplus 0x0102
  /begin DAQ_EVENT VARIABLE /end DAQ_EVENT
 /end IF_DATA
/end MEASUREMENT
/begin MEASUREMENT MoFAccr_stLimpMsg "Info for level 1: Error reaction from level 2 is requested" UBYTE OneToOne 1 100 0.00 255.0 FORMAT "%5.1" ECU_ADDRESS 0x6002352C
 /begin IF_DATA XCPplus 0x0102
  /begin DAQ_EVENT VARIABLE /end DAQ_EVENT
 /end IF_DATA
/end MEASUREMENT
/begin MEASUREMENT MoFAccr_strPosRmp "Status for positive ramping" UBYTE OneToOne 1 100 0.00 255.0 FORMAT "%5.1" ECU_ADDRESS 0x6002CAB2
 /begin IF_DATA XCPplus 0x0102
  /begin DAQ_EVENT VARIABLE /end DAQ_EVENT
 /end IF_DATA
/end MEASUREMENT
/begin MEASUREMENT MoFAccr_strPosRmpCpl "Status for positive ramping complement" UBYTE OneToOne 1 100 0.00 255.0 FORMAT "%5.1" ECU_ADDRESS 0x6002C046
 /begin IF_DATA XCPplus 0x0102
  /begin DAQ_EVENT VARIABLE /end DAQ_EVENT
 /end IF_DATA
/end MEASUREMENT
/begin MEASUREMENT MoFAccr_stSigSrc "Status of the Gas pedals in Level2" UBYTE OneToOne 1 100 0.00 255.0 FORMAT "%5.1" ECU_ADDRESS 0x6002CAA9
 /begin IF_DATA XCPplus 0x0102
  /begin DAQ_EVENT VARIABLE /end DAQ_EVENT
 /end IF_DATA
/end MEASUREMENT
/begin MEASUREMENT MoFAccr_stSigSrcCpl "RAM redundancy check for MoFAccr_stSigSrc" UBYTE OneToOne 1 100 0.00 255.0 FORMAT "%5.1" ECU_ADDRESS 0x6002C03D
 /begin IF_DATA XCPplus 0x0102
  /begin DAQ_EVENT VARIABLE /end DAQ_EVENT
 /end IF_DATA
/end MEASUREMENT
/begin MEASUREMENT MoFAccr_uAccr "Accelerator pedal sensor signal in Function monitoring" UBYTE spg_q0p0195 1 100 0.00 4.980 FORMAT "%5.3" ECU_ADDRESS 0x6002CAA8
 /begin IF_DATA XCPplus 0x0102
  /begin DAQ_EVENT VARIABLE /end DAQ_EVENT
 /end IF_DATA
/end MEASUREMENT
/begin MEASUREMENT MoFAccr_uAccr1 "Current voltage at Signal 1 from accelerator pedal" UWORD spg_q0p00488 1 100 0.00 319.9951 FORMAT "%8.4" ECU_ADDRESS 0x6002CAA6
 /begin IF_DATA XCPplus 0x0102
  /begin DAQ_EVENT VARIABLE /end DAQ_EVENT
 /end IF_DATA
/end MEASUREMENT
/begin MEASUREMENT MoFAccr_uAccr1Cpl "RAM redundancy check for MoFAccr_uAccr1" UWORD OneToOne 1 100 0.00 65535.00 FORMAT "%8.2" ECU_ADDRESS 0x6002C03A
 /begin IF_DATA XCPplus 0x0102
  /begin DAQ_EVENT VARIABLE /end DAQ_EVENT
 /end IF_DATA
/end MEASUREMENT
/begin MEASUREMENT MoFAccr_uAccr2 "Current voltage at Signal 2 from accelerator pedal" UWORD spg_q0p00488 1 100 0.00 319.9951 FORMAT "%8.4" ECU_ADDRESS 0x6002CAA4
 /begin IF_DATA XCPplus 0x0102
  /begin DAQ_EVENT VARIABLE /end DAQ_EVENT
 /end IF_DATA
/end MEASUREMENT
/begin MEASUREMENT MoFAccr_uAccr2Cpl "RAM redundancy check for MoFAccr_uAccr2" UWORD OneToOne 1 100 0.00 65535.00 FORMAT "%8.2" ECU_ADDRESS 0x6002C038
 /begin IF_DATA XCPplus 0x0102
  /begin DAQ_EVENT VARIABLE /end DAQ_EVENT
 /end IF_DATA
/end MEASUREMENT
/begin MEASUREMENT MoFAccr_uAccrCpl "RAM redundancy check for MoFAccr_uAccr" UBYTE OneToOne 1 100 0.00 255.0 FORMAT "%5.1" ECU_ADDRESS 0x6002C03C
 /begin IF_DATA XCPplus 0x0102
  /begin DAQ_EVENT VARIABLE /end DAQ_EVENT
 /end IF_DATA
/end MEASUREMENT
/begin MEASUREMENT MoFAccr_uVirtZrPnt "Vitrual zero point voltage" UWORD spg_q0p00488 1 100 0.00 319.9951 FORMAT "%8.4" ECU_ADDRESS 0x6002CAA2
 /begin IF_DATA XCPplus 0x0102
  /begin DAQ_EVENT VARIABLE /end DAQ_EVENT
 /end IF_DATA
/end MEASUREMENT
/begin MEASUREMENT MoFAccr_uVirtZrPntCpl "Complement of virtual zero point voltage" UWORD OneToOne 1 100 0.00 65535.00 FORMAT "%8.2" ECU_ADDRESS 0x6002C036
 /begin IF_DATA XCPplus 0x0102
  /begin DAQ_EVENT VARIABLE /end DAQ_EVENT
 /end IF_DATA
/end MEASUREMENT
/begin MEASUREMENT MoFAPP_stAPPMsg "State of APP signal in monitoring" UBYTE OneToOne 1 100 0.00 255.0 FORMAT "%5.1" ECU_ADDRESS 0x6002352E
 /begin IF_DATA XCPplus 0x0102
  /begin DAQ_EVENT VARIABLE /end DAQ_EVENT
 /end IF_DATA
/end MEASUREMENT
/begin MEASUREMENT MoFBasInp_bbOutCpl "Complement of MoFBasInp_bbOut" UBYTE OneToOne 1 100 0.00 255.0 FORMAT "%5.1" ECU_ADDRESS 0x6002C030 /end MEASUREMENT
/begin MEASUREMENT MoFBasVehSpd_bbOutCpl "MoFBas_VehSpd out Bit Base for complement check" UBYTE OneToOne 1 100 0.00 255.0 FORMAT "%5.1" ECU_ADDRESS 0x6002C02A
 /begin IF_DATA XCPplus 0x0102
  /begin DAQ_EVENT VARIABLE /end DAQ_EVENT
 /end IF_DATA
/end MEASUREMENT
/begin MEASUREMENT MoFBas_flgErrVSig "common vehicle velocity error message" UBYTE B_TRUE 1 100 0.00 1.00000000000 BIT_MASK 0x1 FORMAT "%13.11" ECU_ADDRESS 0x6002CA8E
 /begin IF_DATA XCPplus 0x0102
  /begin DAQ_EVENT VARIABLE /end DAQ_EVENT
 /end IF_DATA
/end MEASUREMENT
/begin MEASUREMENT MoFBas_flgT15 "T15 signal in function monitoring" UBYTE B_TRUE 1 100 0.00 1.00000000000 BIT_MASK 0x2 FORMAT "%13.11" ECU_ADDRESS 0x6002CA9C
 /begin IF_DATA XCPplus 0x0102
  /begin DAQ_EVENT VARIABLE /end DAQ_EVENT
 /end IF_DATA
/end MEASUREMENT
/begin MEASUREMENT MoFBas_flgT50 "T50 signal in function monitoring" UBYTE B_TRUE 1 100 0.00 1.00000000000 BIT_MASK 0x1 FORMAT "%13.11" ECU_ADDRESS 0x6002CA9C
 /begin IF_DATA XCPplus 0x0102
  /begin DAQ_EVENT VARIABLE /end DAQ_EVENT
 /end IF_DATA
/end MEASUREMENT
/begin MEASUREMENT MoFBas_frqCrash "Frequency of the PWM Crash signal in L2" UWORD freq_q0p1 1 100 0.00 6553.500 FORMAT "%8.3" ECU_ADDRESS 0x6002CA92
 /begin IF_DATA XCPplus 0x0102
  /begin DAQ_EVENT VARIABLE /end DAQ_EVENT
 /end IF_DATA
/end MEASUREMENT
/begin MEASUREMENT MoFBas_frqCrashCpl "Complement of MoFBas_frqCrash" UWORD OneToOne 1 100 0.00 65535.00 FORMAT "%8.2" ECU_ADDRESS 0x6002C02E
 /begin IF_DATA XCPplus 0x0102
  /begin DAQ_EVENT VARIABLE /end DAQ_EVENT
 /end IF_DATA
/end MEASUREMENT
/begin MEASUREMENT MoFBas_numCrashCalcdChks "Calculated checksum for the PWM aquisition of the crash signal" ULONG OneToOne 1 100 0.00 4294967295.00 FORMAT "%13.2" ECU_ADDRESS 0x6002CA98
 /begin IF_DATA XCPplus 0x0102
  /begin DAQ_EVENT VARIABLE /end DAQ_EVENT
 /end IF_DATA
/end MEASUREMENT
/begin MEASUREMENT MoFBas_numCrashChks "Compare value for the checksum of the PWM aquisition of the crash signal" ULONG OneToOne 1 100 0.00 4294967295.00 FORMAT "%13.2" ECU_ADDRESS 0x6002CA94
 /begin IF_DATA XCPplus 0x0102
  /begin DAQ_EVENT VARIABLE /end DAQ_EVENT
 /end IF_DATA
/end MEASUREMENT
/begin MEASUREMENT MoFBas_ratPwmCrash "Dutycycle of the PWM Crash signal in L2" SWORD DtyCyc 1 100 -327.6800 327.6700 FORMAT "%8.4" ECU_ADDRESS 0x6002CA90
 /begin IF_DATA XCPplus 0x0102
  /begin DAQ_EVENT VARIABLE /end DAQ_EVENT
 /end IF_DATA
/end MEASUREMENT
/begin MEASUREMENT MoFBas_ratPwmCrashCpl "Complement of MoFBas_ratPwmCrash" UWORD OneToOne 1 100 0.00 65535.00 FORMAT "%8.2" ECU_ADDRESS 0x6002C02C
 /begin IF_DATA XCPplus 0x0102
  /begin DAQ_EVENT VARIABLE /end DAQ_EVENT
 /end IF_DATA
/end MEASUREMENT
/begin MEASUREMENT MoFBas_stCrashSig "tatus of the PWM aquisition of the crash signal" UBYTE OneToOne 1 100 0.00 255.0 FORMAT "%5.1" ECU_ADDRESS 0x6002CA9D
 /begin IF_DATA XCPplus 0x0102
  /begin DAQ_EVENT VARIABLE /end DAQ_EVENT
 /end IF_DATA
/end MEASUREMENT
/begin MEASUREMENT MoFBas_vVeh "Vehicle velocity in function monitoring" SWORD Vel 1 100 -327.6800 327.6700 FORMAT "%8.4" ECU_ADDRESS 0x6002CA80
 /begin IF_DATA XCPplus 0x0102
  /begin DAQ_EVENT VARIABLE /end DAQ_EVENT
 /end IF_DATA
/end MEASUREMENT
/begin MEASUREMENT MoFBas_vVehCpl "RAM data redudancy of MoFBas_vVeh" UWORD OneToOne 1 100 0.00 65535.00 FORMAT "%8.2" ECU_ADDRESS 0x6002C028
 /begin IF_DATA XCPplus 0x0102
  /begin DAQ_EVENT VARIABLE /end DAQ_EVENT
 /end IF_DATA
/end MEASUREMENT
/begin MEASUREMENT MoFBas_vVehRaw "Unfiltered vehicle velocity" SWORD Vel 1 100 -327.6800 327.6700 FORMAT "%8.4" ECU_ADDRESS 0x6002CA7E
 /begin IF_DATA XCPplus 0x0102
  /begin DAQ_EVENT VARIABLE /end DAQ_EVENT
 /end IF_DATA
/end MEASUREMENT
/begin MEASUREMENT MoFBas_vVehRawAbs "Absolute value of unfiltered vehicle velocity" SWORD Vel 1 100 -327.6800 327.6700 FORMAT "%8.4" ECU_ADDRESS 0x6002CA8C
 /begin IF_DATA XCPplus 0x0102
  /begin DAQ_EVENT VARIABLE /end DAQ_EVENT
 /end IF_DATA
/end MEASUREMENT
/begin MEASUREMENT MoFBas_vVehRawAbsCpl "RAM data redundancy for MoFBas_vVehRawAbs" UWORD OneToOne 1 100 0.00 65535.00 FORMAT "%8.2" ECU_ADDRESS 0x6002C026
 /begin IF_DATA XCPplus 0x0102
  /begin DAQ_EVENT VARIABLE /end DAQ_EVENT
 /end IF_DATA
/end MEASUREMENT
/begin MEASUREMENT MoFBas_vVehRawCpl "RAM data redundancy for MoFBas_vVehRaw" UWORD OneToOne 1 100 0.00 65535.00 FORMAT "%8.2" ECU_ADDRESS 0x6002C024
 /begin IF_DATA XCPplus 0x0102
  /begin DAQ_EVENT VARIABLE /end DAQ_EVENT
 /end IF_DATA
/end MEASUREMENT
/begin MEASUREMENT MoFBas_vVehRawFltr "Filtered value of MoFBas_vVehRaw" SWORD Vel 1 100 -327.6800 327.6700 FORMAT "%8.4" ECU_ADDRESS 0x6002CA8A
 /begin IF_DATA XCPplus 0x0102
  /begin DAQ_EVENT VARIABLE /end DAQ_EVENT
 /end IF_DATA
/end MEASUREMENT
/begin MEASUREMENT MoFBas_vVehRawFltrCpl "RAM data redundancy" UWORD OneToOne 1 100 0.00 65535.00 FORMAT "%8.2" ECU_ADDRESS 0x6002C022
 /begin IF_DATA XCPplus 0x0102
  /begin DAQ_EVENT VARIABLE /end DAQ_EVENT
 /end IF_DATA
/end MEASUREMENT
/begin MEASUREMENT MoFBas_vVehRawMax "Maximum safe value of the vehicle speed" SWORD Vel 1 100 -327.6800 327.6700 FORMAT "%8.4" ECU_ADDRESS 0x6002CA88
 /begin IF_DATA XCPplus 0x0102
  /begin DAQ_EVENT VARIABLE /end DAQ_EVENT
 /end IF_DATA
/end MEASUREMENT
/begin MEASUREMENT MoFBas_vVehRawMaxCpl "RAM data redundancy" UWORD OneToOne 1 100 0.00 65535.00 FORMAT "%8.2" ECU_ADDRESS 0x6002C020
 /begin IF_DATA XCPplus 0x0102
  /begin DAQ_EVENT VARIABLE /end DAQ_EVENT
 /end IF_DATA
/end MEASUREMENT
/begin MEASUREMENT MoFBas_vVehRawMin "Minimum safe value of vehicle speed" SWORD Vel 1 100 -327.6800 327.6700 FORMAT "%8.4" ECU_ADDRESS 0x6002CA86
 /begin IF_DATA XCPplus 0x0102
  /begin DAQ_EVENT VARIABLE /end DAQ_EVENT
 /end IF_DATA
/end MEASUREMENT
/begin MEASUREMENT MoFBas_vVehRawMinCpl "RAM data redundancy" UWORD OneToOne 1 100 0.00 65535.00 FORMAT "%8.2" ECU_ADDRESS 0x6002C01E
 /begin IF_DATA XCPplus 0x0102
  /begin DAQ_EVENT VARIABLE /end DAQ_EVENT
 /end IF_DATA
/end MEASUREMENT
/begin MEASUREMENT MoFBas_vVehSignd "Signed vehicle velocity in function monitoring" SWORD Vel 1 100 -327.6800 327.6700 FORMAT "%8.4" ECU_ADDRESS 0x6002CA7C
 /begin IF_DATA XCPplus 0x0102
  /begin DAQ_EVENT VARIABLE /end DAQ_EVENT
 /end IF_DATA
/end MEASUREMENT
/begin MEASUREMENT MoFBas_vVehSigndCpl "RAM data redundancy for MoFBas_vVehSignd" UWORD OneToOne 1 100 0.00 65535.00 FORMAT "%8.2" ECU_ADDRESS 0x6002C01C
 /begin IF_DATA XCPplus 0x0102
  /begin DAQ_EVENT VARIABLE /end DAQ_EVENT
 /end IF_DATA
/end MEASUREMENT
/begin MEASUREMENT MoFBas_vVehSigndFltHi "HIgher word used by Signed Vehicle Speed Filtering" SWORD Vel 1 100 -327.6800 327.6700 FORMAT "%8.4" ECU_ADDRESS 0x6002CA84
 /begin IF_DATA XCPplus 0x0102
  /begin DAQ_EVENT VARIABLE /end DAQ_EVENT
 /end IF_DATA
/end MEASUREMENT
/begin MEASUREMENT MoFBas_vVehSigndFltHiCpl "Complement of Higher word used by Signed Vehicle Speed Filtering" UWORD OneToOne 1 100 0.00 65535.00 FORMAT "%8.2" ECU_ADDRESS 0x6002C01A
 /begin IF_DATA XCPplus 0x0102
  /begin DAQ_EVENT VARIABLE /end DAQ_EVENT
 /end IF_DATA
/end MEASUREMENT
/begin MEASUREMENT MoFBas_vVehSigndFltLo "Lower word used by Signed Vehicle Speed Filtering" UWORD OneToOne 1 100 0.00 65535.00 FORMAT "%8.2" ECU_ADDRESS 0x6002CA82
 /begin IF_DATA XCPplus 0x0102
  /begin DAQ_EVENT VARIABLE /end DAQ_EVENT
 /end IF_DATA
/end MEASUREMENT
/begin MEASUREMENT MoFBas_vVehSigndFltLoCpl "Complement of Lower word used by Signed Vehicle Speed Filtering" UWORD OneToOne 1 100 0.00 65535.00 FORMAT "%8.2" ECU_ADDRESS 0x6002C018
 /begin IF_DATA XCPplus 0x0102
  /begin DAQ_EVENT VARIABLE /end DAQ_EVENT
 /end IF_DATA
/end MEASUREMENT
/begin MEASUREMENT MoFBrkInp_bbLocCpl "RAM data redundancy for MoFBrkInp_bbLoc" UBYTE OneToOne 1 100 0.00 255.0 FORMAT "%5.1" ECU_ADDRESS 0x6002C012
 /begin IF_DATA XCPplus 0x0102
  /begin DAQ_EVENT VARIABLE /end DAQ_EVENT
 /end IF_DATA
/end MEASUREMENT
/begin MEASUREMENT MoFBrkInp_bbOutCpl "RAM data redundancy for MoFBrkInp_bbOut" UBYTE OneToOne 1 100 0.00 255.0 FORMAT "%5.1" ECU_ADDRESS 0x6002C011
 /begin IF_DATA XCPplus 0x0102
  /begin DAQ_EVENT VARIABLE /end DAQ_EVENT
 /end IF_DATA
/end MEASUREMENT
/begin MEASUREMENT MoFBrk_cntrBrkErrDeb "Debounce counter for delay of Break light and Break Pedal invalid information in function monitoring" UWORD OneToOne 1 100 0.00 65535.00 FORMAT "%8.2" ECU_ADDRESS 0x6002CA70
 /begin IF_DATA XCPplus 0x0102
  /begin DAQ_EVENT VARIABLE /end DAQ_EVENT
 /end IF_DATA
/end MEASUREMENT
/begin MEASUREMENT MoFBrk_cntrBrkErrDebCpl "RAM data redundancy for MoFBrk_cntrBrkErrDeb" UWORD OneToOne 1 100 0.00 65535.00 FORMAT "%8.2" ECU_ADDRESS 0x6002C00C
 /begin IF_DATA XCPplus 0x0102
  /begin DAQ_EVENT VARIABLE /end DAQ_EVENT
 /end IF_DATA
/end MEASUREMENT
/begin MEASUREMENT MoFBrk_cntrBrkRedDeb "Counter Variable of Brake redundancy debounce" UBYTE OneToOne 1 100 0.00 255.0 FORMAT "%5.1" ECU_ADDRESS 0x6002CA75
 /begin IF_DATA XCPplus 0x0102
  /begin DAQ_EVENT VARIABLE /end DAQ_EVENT
 /end IF_DATA
/end MEASUREMENT
/begin MEASUREMENT MoFBrk_cntrBrkRedDebCpl "Complement for MoFBrk_cntrBrkRedDeb" UBYTE OneToOne 1 100 0.00 255.0 FORMAT "%5.1" ECU_ADDRESS 0x6002C010
 /begin IF_DATA XCPplus 0x0102
  /begin DAQ_EVENT VARIABLE /end DAQ_EVENT
 /end IF_DATA
/end MEASUREMENT
/begin MEASUREMENT MoFBrk_flgBrkApp "Brake pressed signal for APP in funcion monitoring" UBYTE B_TRUE 1 100 0.00 1.00000000000 BIT_MASK 0x1 FORMAT "%13.11" ECU_ADDRESS 0x6002CA72
 /begin IF_DATA XCPplus 0x0102
  /begin DAQ_EVENT VARIABLE /end DAQ_EVENT
 /end IF_DATA
/end MEASUREMENT
/begin MEASUREMENT MoFBrk_flgBrkErr "Break error status in function monitoring" UBYTE B_TRUE 1 100 0.00 1.00000000000 BIT_MASK 0x2 FORMAT "%13.11" ECU_ADDRESS 0x6002CA72
 /begin IF_DATA XCPplus 0x0102
  /begin DAQ_EVENT VARIABLE /end DAQ_EVENT
 /end IF_DATA
/end MEASUREMENT
/begin MEASUREMENT MoFBrk_flgBrkMai "main brake status: main brake pedal pressed" UBYTE B_TRUE 1 100 0.00 1.00000000000 BIT_MASK 0x4 FORMAT "%13.11" ECU_ADDRESS 0x6002CA72
 /begin IF_DATA XCPplus 0x0102
  /begin DAQ_EVENT VARIABLE /end DAQ_EVENT
 /end IF_DATA
/end MEASUREMENT
/begin MEASUREMENT MoFBrk_flgBrkPsblPsd "Brake pedal possibly pressed" UBYTE B_TRUE 1 100 0.00 1.00000000000 BIT_MASK 0x8 FORMAT "%13.11" ECU_ADDRESS 0x6002CA72
 /begin IF_DATA XCPplus 0x0102
  /begin DAQ_EVENT VARIABLE /end DAQ_EVENT
 /end IF_DATA
/end MEASUREMENT
/begin MEASUREMENT MoFBrk_flgBrkPsd "Brake surely pressed status" UBYTE B_TRUE 1 100 0.00 1.00000000000 BIT_MASK 0x10 FORMAT "%13.11" ECU_ADDRESS 0x6002CA72
 /begin IF_DATA XCPplus 0x0102
  /begin DAQ_EVENT VARIABLE /end DAQ_EVENT
 /end IF_DATA
/end MEASUREMENT
/begin MEASUREMENT MoFBrk_flgBrkRdnt "redundant brake status: brake pedal pressed" UBYTE B_TRUE 1 100 0.00 1.00000000000 BIT_MASK 0x20 FORMAT "%13.11" ECU_ADDRESS 0x6002CA72
 /begin IF_DATA XCPplus 0x0102
  /begin DAQ_EVENT VARIABLE /end DAQ_EVENT
 /end IF_DATA
/end MEASUREMENT
/begin MEASUREMENT MoFBrk_flgBrkRdntDIO "Redundant Brake status from DIO" UBYTE B_TRUE 1 100 0.00 1.00000000000 BIT_MASK 0x40 FORMAT "%13.11" ECU_ADDRESS 0x6002CA76
 /begin IF_DATA XCPplus 0x0102
  /begin DAQ_EVENT VARIABLE /end DAQ_EVENT
 /end IF_DATA
/end MEASUREMENT
/begin MEASUREMENT MoFBrk_flgBrkSafe "Safe brake signal - both brakes are activated" UBYTE B_TRUE 1 100 0.00 1.00000000000 BIT_MASK 0x40 FORMAT "%13.11" ECU_ADDRESS 0x6002CA72
 /begin IF_DATA XCPplus 0x0102
  /begin DAQ_EVENT VARIABLE /end DAQ_EVENT
 /end IF_DATA
/end MEASUREMENT
/begin MEASUREMENT MoFBrk_flgCfmdAlvErr "Confirmed alive counter error in received CAN frame" UBYTE B_TRUE 1 100 0.00 1.00000000000 BIT_MASK 0x1 FORMAT "%13.11" ECU_ADDRESS 0x6002CA76
 /begin IF_DATA XCPplus 0x0102
  /begin DAQ_EVENT VARIABLE /end DAQ_EVENT
 /end IF_DATA
/end MEASUREMENT
/begin MEASUREMENT MoFBrk_flgCfmdChksErr "Confirmed checksum error in received CAN frame" UBYTE B_TRUE 1 100 0.00 1.00000000000 BIT_MASK 0x2 FORMAT "%13.11" ECU_ADDRESS 0x6002CA76
 /begin IF_DATA XCPplus 0x0102
  /begin DAQ_EVENT VARIABLE /end DAQ_EVENT
 /end IF_DATA
/end MEASUREMENT
/begin MEASUREMENT MoFBrk_flgCfmdToutErr "Confirmed timeout error in received CAN frame" UBYTE B_TRUE 1 100 0.00 1.00000000000 BIT_MASK 0x4 FORMAT "%13.11" ECU_ADDRESS 0x6002CA76
 /begin IF_DATA XCPplus 0x0102
  /begin DAQ_EVENT VARIABLE /end DAQ_EVENT
 /end IF_DATA
/end MEASUREMENT
/begin MEASUREMENT MoFBrk_flgTmpAlvFErr "Temporary alive counter error in received CAN frame" UBYTE B_TRUE 1 100 0.00 1.00000000000 BIT_MASK 0x8 FORMAT "%13.11" ECU_ADDRESS 0x6002CA76
 /begin IF_DATA XCPplus 0x0102
  /begin DAQ_EVENT VARIABLE /end DAQ_EVENT
 /end IF_DATA
/end MEASUREMENT
/begin MEASUREMENT MoFBrk_flgTmpChksErr "Temporary checksum error in received CAN frame" UBYTE B_TRUE 1 100 0.00 1.00000000000 BIT_MASK 0x10 FORMAT "%13.11" ECU_ADDRESS 0x6002CA76
 /begin IF_DATA XCPplus 0x0102
  /begin DAQ_EVENT VARIABLE /end DAQ_EVENT
 /end IF_DATA
/end MEASUREMENT
/begin MEASUREMENT MoFBrk_flgTmpToutErr "Temporary timeout error in received CAN frame" UBYTE B_TRUE 1 100 0.00 1.00000000000 BIT_MASK 0x20 FORMAT "%13.11" ECU_ADDRESS 0x6002CA76
 /begin IF_DATA XCPplus 0x0102
  /begin DAQ_EVENT VARIABLE /end DAQ_EVENT
 /end IF_DATA
/end MEASUREMENT
/begin MEASUREMENT MoFBrk_stBrkErrDeb "Debounced Brake error state" UBYTE OneToOne 1 100 0.00 255.0 FORMAT "%5.1" ECU_ADDRESS 0x6002CA74
 /begin IF_DATA XCPplus 0x0102
  /begin DAQ_EVENT VARIABLE /end DAQ_EVENT
 /end IF_DATA
/end MEASUREMENT
/begin MEASUREMENT MoFBrk_stBrkErrDebCpl "Complement storage for Debounced Brake error state" UBYTE OneToOne 1 100 0.00 255.0 FORMAT "%5.1" ECU_ADDRESS 0x6002C00F
 /begin IF_DATA XCPplus 0x0102
  /begin DAQ_EVENT VARIABLE /end DAQ_EVENT
 /end IF_DATA
/end MEASUREMENT
/begin MEASUREMENT MoFBrk_stBrkRedDeb "State variable of Brake Redundant Debounce" UBYTE OneToOne 1 100 0.00 255.0 FORMAT "%5.1" ECU_ADDRESS 0x6002CA73
 /begin IF_DATA XCPplus 0x0102
  /begin DAQ_EVENT VARIABLE /end DAQ_EVENT
 /end IF_DATA
/end MEASUREMENT
/begin MEASUREMENT MoFBrk_stBrkRedDebCpl "Complement for MoFBrk_stBrkRedDeb" UBYTE OneToOne 1 100 0.00 255.0 FORMAT "%5.1" ECU_ADDRESS 0x6002C00E
 /begin IF_DATA XCPplus 0x0102
  /begin DAQ_EVENT VARIABLE /end DAQ_EVENT
 /end IF_DATA
/end MEASUREMENT
/begin MEASUREMENT MoFCbnPreCdng_bbLocCpl "Complement" UBYTE OneToOne 1 100 0.00 255.0 FORMAT "%5.1" ECU_ADDRESS 0x6002C00B
 /begin IF_DATA XCPplus 0x0102
  /begin DAQ_EVENT VARIABLE /end DAQ_EVENT
 /end IF_DATA
/end MEASUREMENT
/begin MEASUREMENT MoFCbnPreCdng_bbOutCpl "Complement" UBYTE OneToOne 1 100 0.00 255.0 FORMAT "%5.1" ECU_ADDRESS 0x6002C00A
 /begin IF_DATA XCPplus 0x0102
  /begin DAQ_EVENT VARIABLE /end DAQ_EVENT
 /end IF_DATA
/end MEASUREMENT
/begin MEASUREMENT MoFCbnPreCdng_cntrPreHeatDio "Debounce counter for DIO" UBYTE OneToOne 1 100 0.00 255.0 FORMAT "%5.1" ECU_ADDRESS 0x6002CA6E
 /begin IF_DATA XCPplus 0x0102
  /begin DAQ_EVENT VARIABLE /end DAQ_EVENT
 /end IF_DATA
/end MEASUREMENT
/begin MEASUREMENT MoFCbnPreCdng_cntrPreHeatDioCpl "Complement" UBYTE OneToOne 1 100 0.00 255.0 FORMAT "%5.1" ECU_ADDRESS 0x6002C009
 /begin IF_DATA XCPplus 0x0102
  /begin DAQ_EVENT VARIABLE /end DAQ_EVENT
 /end IF_DATA
/end MEASUREMENT
/begin MEASUREMENT MoFCbnPreCdng_cntrPreHeatInct "Counter for Pre Heating" ULONG OneToOne 1 100 0.00 4294967295.00 FORMAT "%13.2" ECU_ADDRESS 0x6002CA68
 /begin IF_DATA XCPplus 0x0102
  /begin DAQ_EVENT VARIABLE /end DAQ_EVENT
 /end IF_DATA
/end MEASUREMENT
/begin MEASUREMENT MoFCbnPreCdng_cntrPreHeatInctCpl "Complement" ULONG OneToOne 1 100 0.00 4294967295.00 FORMAT "%13.2" ECU_ADDRESS 0x6002C004
 /begin IF_DATA XCPplus 0x0102
  /begin DAQ_EVENT VARIABLE /end DAQ_EVENT
 /end IF_DATA
/end MEASUREMENT
/begin MEASUREMENT MoFCbnPreCdng_cntrStopHeatrDeb "Debounce counter used for checking error condition clearing DFC" UBYTE OneToOne 1 100 0.00 255.0 FORMAT "%5.1" ECU_ADDRESS 0x60023128
 /begin IF_DATA XCPplus 0x0102
  /begin DAQ_EVENT VARIABLE /end DAQ_EVENT
 /end IF_DATA
/end MEASUREMENT
/begin MEASUREMENT MoFCbnPreCdng_cntrTmrExpiDeb "Debounce counter used for checking error condition clearing DFC" UBYTE OneToOne 1 100 0.00 255.0 FORMAT "%5.1" ECU_ADDRESS 0x60023127
 /begin IF_DATA XCPplus 0x0102
  /begin DAQ_EVENT VARIABLE /end DAQ_EVENT
 /end IF_DATA
/end MEASUREMENT
/begin MEASUREMENT MoFCbnPreCdng_DataDebErrReactn_I.cntErrDeb "Class instance for Error Reaction / Debounce count in class DataDeb with error reaction." UWORD OneToOne 1 100 0.00 65535.00 FORMAT "%8.2" ECU_ADDRESS 0x6002CA60
 /begin IF_DATA XCPplus 0x0102
  /begin DAQ_EVENT VARIABLE /end DAQ_EVENT
 /end IF_DATA
/end MEASUREMENT
/begin MEASUREMENT MoFCbnPreCdng_DataDebErrReactn_I.cntErrDebCpl "Class instance for Error Reaction / Complement for debounce count for class DataDeb with error reaction." UWORD OneToOne 1 100 0.00 65535.00 FORMAT "%8.2" ECU_ADDRESS 0x6002C000
 /begin IF_DATA XCPplus 0x0102
  /begin DAQ_EVENT VARIABLE /end DAQ_EVENT
 /end IF_DATA
/end MEASUREMENT
/begin MEASUREMENT MoFCbnPreCdng_DataDebErrReactn_I.stErrDeb "Class instance for Error Reaction / Status of debounced error in class DataDeb with error reaction." UBYTE OneToOne 1 100 0.00 255.0 FORMAT "%5.1" ECU_ADDRESS 0x6002CA62
 /begin IF_DATA XCPplus 0x0102
  /begin DAQ_EVENT VARIABLE /end DAQ_EVENT
 /end IF_DATA
/end MEASUREMENT
/begin MEASUREMENT MoFCbnPreCdng_DataDebErrReactn_I.stErrDebCpl "Class instance for Error Reaction / Complement for status of debounced error in class DataDeb with error reaction." UBYTE OneToOne 1 100 0.00 255.0 FORMAT "%5.1" ECU_ADDRESS 0x6002C002
 /begin IF_DATA XCPplus 0x0102
  /begin DAQ_EVENT VARIABLE /end DAQ_EVENT
 /end IF_DATA
/end MEASUREMENT
/begin MEASUREMENT MoFCbnPreCdng_DataDebErrReactn_I.stErrLockRels "Class instance for Error Reaction / Status of lock release class DataDeb with error reaction." UBYTE OneToOne 1 100 0.00 255.0 FORMAT "%5.1" ECU_ADDRESS 0x6002CA63
 /begin IF_DATA XCPplus 0x0102
  /begin DAQ_EVENT VARIABLE /end DAQ_EVENT
 /end IF_DATA
/end MEASUREMENT
/begin MEASUREMENT MoFCbnPreCdng_DataDebErrReactn_I.stErrLockRelsCpl "Class instance for Error Reaction / Complement for Status of lock release class DataDeb with error reaction." UBYTE OneToOne 1 100 0.00 255.0 FORMAT "%5.1" ECU_ADDRESS 0x6002C003
 /begin IF_DATA XCPplus 0x0102
  /begin DAQ_EVENT VARIABLE /end DAQ_EVENT
 /end IF_DATA
/end MEASUREMENT
/begin MEASUREMENT MoFCbnPreCdng_DataDebErrReactn_I.stErrReactn "Class instance for Error Reaction / Status of error reaction in class DataDeb with error reaction." UBYTE OneToOne 1 100 0.00 255.0 FORMAT "%5.1" ECU_ADDRESS 0x6002CA64
 /begin IF_DATA XCPplus 0x0102
  /begin DAQ_EVENT VARIABLE /end DAQ_EVENT
 /end IF_DATA
/end MEASUREMENT
/begin MEASUREMENT MoFCbnPreCdng_DataDebErrReactn_I_1.cntErrDeb "Error Reaction class instance / Debounce count in class DataDeb with error reaction." UWORD OneToOne 1 100 0.00 65535.00 FORMAT "%8.2" ECU_ADDRESS 0x6002CA5A /end MEASUREMENT
/begin MEASUREMENT MoFCbnPreCdng_DataDebErrReactn_I_1.cntErrDebCpl "Error Reaction class instance / Complement for debounce count for class DataDeb with error reaction." UWORD OneToOne 1 100 0.00 65535.00 FORMAT "%8.2" ECU_ADDRESS 0x6002BFFC /end MEASUREMENT
/begin MEASUREMENT MoFCbnPreCdng_DataDebErrReactn_I_1.stErrDeb "Error Reaction class instance / Status of debounced error in class DataDeb with error reaction." UBYTE OneToOne 1 100 0.00 255.0 FORMAT "%5.1" ECU_ADDRESS 0x6002CA5C /end MEASUREMENT
/begin MEASUREMENT MoFCbnPreCdng_DataDebErrReactn_I_1.stErrDebCpl "Error Reaction class instance / Complement for status of debounced error in class DataDeb with error reaction." UBYTE OneToOne 1 100 0.00 255.0 FORMAT "%5.1" ECU_ADDRESS 0x6002BFFE /end MEASUREMENT
/begin MEASUREMENT MoFCbnPreCdng_DataDebErrReactn_I_1.stErrLockRels "Error Reaction class instance / Status of lock release class DataDeb with error reaction." UBYTE OneToOne 1 100 0.00 255.0 FORMAT "%5.1" ECU_ADDRESS 0x6002CA5D /end MEASUREMENT
/begin MEASUREMENT MoFCbnPreCdng_DataDebErrReactn_I_1.stErrLockRelsCpl "Error Reaction class instance / Complement for Status of lock release class DataDeb with error reaction." UBYTE OneToOne 1 100 0.00 255.0 FORMAT "%5.1" ECU_ADDRESS 0x6002BFFF /end MEASUREMENT
/begin MEASUREMENT MoFCbnPreCdng_DataDebErrReactn_I_1.stErrReactn "Error Reaction class instance / Status of error reaction in class DataDeb with error reaction." UBYTE OneToOne 1 100 0.00 255.0 FORMAT "%5.1" ECU_ADDRESS 0x6002CA5E /end MEASUREMENT
/begin MEASUREMENT MoFCbnPreCdng_DataDebErrReactn_I_2.cntErrDeb "Error Reactioln Class instance / Debounce count in class DataDeb with error reaction." UWORD OneToOne 1 100 0.00 65535.00 FORMAT "%8.2" ECU_ADDRESS 0x6002CA54 /end MEASUREMENT
/begin MEASUREMENT MoFCbnPreCdng_DataDebErrReactn_I_2.cntErrDebCpl "Error Reactioln Class instance / Complement for debounce count for class DataDeb with error reaction." UWORD OneToOne 1 100 0.00 65535.00 FORMAT "%8.2" ECU_ADDRESS 0x6002BFF8 /end MEASUREMENT
/begin MEASUREMENT MoFCbnPreCdng_DataDebErrReactn_I_2.stErrDeb "Error Reactioln Class instance / Status of debounced error in class DataDeb with error reaction." UBYTE OneToOne 1 100 0.00 255.0 FORMAT "%5.1" ECU_ADDRESS 0x6002CA56 /end MEASUREMENT
/begin MEASUREMENT MoFCbnPreCdng_DataDebErrReactn_I_2.stErrDebCpl "Error Reactioln Class instance / Complement for status of debounced error in class DataDeb with error reaction." UBYTE OneToOne 1 100 0.00 255.0 FORMAT "%5.1" ECU_ADDRESS 0x6002BFFA /end MEASUREMENT
/begin MEASUREMENT MoFCbnPreCdng_DataDebErrReactn_I_2.stErrLockRels "Error Reactioln Class instance / Status of lock release class DataDeb with error reaction." UBYTE OneToOne 1 100 0.00 255.0 FORMAT "%5.1" ECU_ADDRESS 0x6002CA57 /end MEASUREMENT
/begin MEASUREMENT MoFCbnPreCdng_DataDebErrReactn_I_2.stErrLockRelsCpl "Error Reactioln Class instance / Complement for Status of lock release class DataDeb with error reaction." UBYTE OneToOne 1 100 0.00 255.0 FORMAT "%5.1" ECU_ADDRESS 0x6002BFFB /end MEASUREMENT
/begin MEASUREMENT MoFCbnPreCdng_DataDebErrReactn_I_2.stErrReactn "Error Reactioln Class instance / Status of error reaction in class DataDeb with error reaction." UBYTE OneToOne 1 100 0.00 255.0 FORMAT "%5.1" ECU_ADDRESS 0x6002CA58 /end MEASUREMENT
/begin MEASUREMENT MoFCbnPreCdng_flgOvrheatClr "Flag is cleared in no error condition" UBYTE B_TRUE 1 100 0.00 1.00000000000 BIT_MASK 0x1 FORMAT "%13.11" ECU_ADDRESS 0x70000133
 /begin IF_DATA XCPplus 0x0102
  /begin DAQ_EVENT VARIABLE /end DAQ_EVENT
 /end IF_DATA
/end MEASUREMENT
/begin MEASUREMENT MoFCbnPreCdng_flgPreHeatCanCfm "Flag for Pre Heater from CAN confirmed" UBYTE B_TRUE 1 100 0.00 1.00000000000 BIT_MASK 0x1 FORMAT "%13.11" ECU_ADDRESS 0x6002CA6F
 /begin IF_DATA XCPplus 0x0102
  /begin DAQ_EVENT VARIABLE /end DAQ_EVENT
 /end IF_DATA
/end MEASUREMENT
/begin MEASUREMENT MoFCbnPreCdng_flgPreHeatCanCfmMsg "Message variable for L1" UBYTE B_TRUE 1 100 0.00 1.00000000000 BIT_MASK 0x1 FORMAT "%13.11" ECU_ADDRESS 0x7000024C
 /begin IF_DATA XCPplus 0x0102
  /begin DAQ_EVENT VARIABLE /end DAQ_EVENT
 /end IF_DATA
/end MEASUREMENT
/begin MEASUREMENT MoFCbnPreCdng_flgPreHeatDioCfm "Flag for Pre Heater from DIO Pin" UBYTE B_TRUE 1 100 0.00 1.00000000000 BIT_MASK 0x2 FORMAT "%13.11" ECU_ADDRESS 0x6002CA6F
 /begin IF_DATA XCPplus 0x0102
  /begin DAQ_EVENT VARIABLE /end DAQ_EVENT
 /end IF_DATA
/end MEASUREMENT
/begin MEASUREMENT MoFCbnPreCdng_flgPreHeatDioCfmMsg "Message variable for L1" UBYTE B_TRUE 1 100 0.00 1.00000000000 BIT_MASK 0x1 FORMAT "%13.11" ECU_ADDRESS 0x7000024B
 /begin IF_DATA XCPplus 0x0102
  /begin DAQ_EVENT VARIABLE /end DAQ_EVENT
 /end IF_DATA
/end MEASUREMENT
/begin MEASUREMENT MoFCbnPreCdng_flgPreHeatDioChk "PreHeat DIO PIN is set" UBYTE B_TRUE 1 100 0.00 1.00000000000 BIT_MASK 0x8 FORMAT "%13.11" ECU_ADDRESS 0x6002CA6F
 /begin IF_DATA XCPplus 0x0102
  /begin DAQ_EVENT VARIABLE /end DAQ_EVENT
 /end IF_DATA
/end MEASUREMENT
/begin MEASUREMENT MoFCbnPreCdng_flgStopHeatr "Cabin Preconditioning monitoring confirmed from CAN or DIO" UBYTE B_TRUE 1 100 0.00 1.00000000000 BIT_MASK 0x1 FORMAT "%13.11" ECU_ADDRESS 0x6002CA6C
 /begin IF_DATA XCPplus 0x0102
  /begin DAQ_EVENT VARIABLE /end DAQ_EVENT
 /end IF_DATA
/end MEASUREMENT
/begin MEASUREMENT MoFCbnPreCdng_flgStopHeatrIrrvErrMsg "PTC Heater flag set for functional level" UBYTE B_TRUE 1 100 0.00 1.00000000000 BIT_MASK 0x1 FORMAT "%13.11" ECU_ADDRESS 0x7000024A
 /begin IF_DATA XCPplus 0x0102
  /begin DAQ_EVENT VARIABLE /end DAQ_EVENT
 /end IF_DATA
/end MEASUREMENT
/begin MEASUREMENT MoFCbnPreCdng_flgTmrExpiClr "Flag is cleared in no error condition" UBYTE B_TRUE 1 100 0.00 1.00000000000 BIT_MASK 0x1 FORMAT "%13.11" ECU_ADDRESS 0x70000132
 /begin IF_DATA XCPplus 0x0102
  /begin DAQ_EVENT VARIABLE /end DAQ_EVENT
 /end IF_DATA
/end MEASUREMENT
/begin MEASUREMENT MoFCbnPreCdng_flgWakeupOld "Retain the CAN input to check for edge rising" UBYTE B_TRUE 1 100 0.00 1.00000000000 BIT_MASK 0x4 FORMAT "%13.11" ECU_ADDRESS 0x6002CA6F
 /begin IF_DATA XCPplus 0x0102
  /begin DAQ_EVENT VARIABLE /end DAQ_EVENT
 /end IF_DATA
/end MEASUREMENT
/begin MEASUREMENT MoFCbnPreCdng_stPreHeatDioDeb "Debounce for the Preheat DIO PIN" UBYTE OneToOne 1 100 0.00 255.0 FORMAT "%5.1" ECU_ADDRESS 0x6002CA6D
 /begin IF_DATA XCPplus 0x0102
  /begin DAQ_EVENT VARIABLE /end DAQ_EVENT
 /end IF_DATA
/end MEASUREMENT
/begin MEASUREMENT MoFCbnPreCdng_stPreHeatDioDebCpl "Complement" UBYTE OneToOne 1 100 0.00 255.0 FORMAT "%5.1" ECU_ADDRESS 0x6002C008
 /begin IF_DATA XCPplus 0x0102
  /begin DAQ_EVENT VARIABLE /end DAQ_EVENT
 /end IF_DATA
/end MEASUREMENT
/begin MEASUREMENT MoFDrvrAsscCrsCtrl_bbLocCpl "RAM data redundancy of MoFDrvrAsscCrsCtrl_bbLoc" UBYTE OneToOne 1 100 0.00 255.0 FORMAT "%5.1" ECU_ADDRESS 0x6002BFF7
 /begin IF_DATA XCPplus 0x0102
  /begin DAQ_EVENT VARIABLE /end DAQ_EVENT
 /end IF_DATA
/end MEASUREMENT
/begin MEASUREMENT MoFDrvrAsscCrsCtrl_bbOutCpl "Complement of Export bitbase for MoFDrvrAsscCrsCtrl" UBYTE OneToOne 1 100 0.00 255.0 FORMAT "%5.1" ECU_ADDRESS 0x6002BFF6
 /begin IF_DATA XCPplus 0x0102
  /begin DAQ_EVENT VARIABLE /end DAQ_EVENT
 /end IF_DATA
/end MEASUREMENT
/begin MEASUREMENT MoFDrvrAssc_cntrBrkDly "De-bounce counter for the brake pressed delay" UBYTE OneToOne 1 100 0.00 255.0 FORMAT "%5.1" ECU_ADDRESS 0x6002CA52
 /begin IF_DATA XCPplus 0x0102
  /begin DAQ_EVENT VARIABLE /end DAQ_EVENT
 /end IF_DATA
/end MEASUREMENT
/begin MEASUREMENT MoFDrvrAssc_cntrBrkDlyCpl "RAM data redundancy of MoFDrvrAssc_cntrBrkDly" UBYTE OneToOne 1 100 0.00 255.0 FORMAT "%5.1" ECU_ADDRESS 0x6002BFF5
 /begin IF_DATA XCPplus 0x0102
  /begin DAQ_EVENT VARIABLE /end DAQ_EVENT
 /end IF_DATA
/end MEASUREMENT
/begin MEASUREMENT MoFDrvrAssc_flgBrkPsd "Flag to indicate the status of brake pressed" UBYTE B_TRUE 1 100 0.00 1.00000000000 BIT_MASK 0x1 FORMAT "%13.11" ECU_ADDRESS 0x6002CA53
 /begin IF_DATA XCPplus 0x0102
  /begin DAQ_EVENT VARIABLE /end DAQ_EVENT
 /end IF_DATA
/end MEASUREMENT
/begin MEASUREMENT MoFDrvrAssc_flgCrsCtrlActv "flag indicating cruise control is active" UBYTE B_TRUE 1 100 0.00 1.00000000000 BIT_MASK 0x1 FORMAT "%13.11" ECU_ADDRESS 0x6002CA50
 /begin IF_DATA XCPplus 0x0102
  /begin DAQ_EVENT VARIABLE /end DAQ_EVENT
 /end IF_DATA
/end MEASUREMENT
/begin MEASUREMENT MoFDrvrAssc_flgCrsCtrlOld "Flag to indicate the old value of the cruise control status from function level" UBYTE B_TRUE 1 100 0.00 1.00000000000 BIT_MASK 0x4 FORMAT "%13.11" ECU_ADDRESS 0x6002CA53
 /begin IF_DATA XCPplus 0x0102
  /begin DAQ_EVENT VARIABLE /end DAQ_EVENT
 /end IF_DATA
/end MEASUREMENT
/begin MEASUREMENT MoFDrvrAssc_flgCrsCtrlPtdMsg "Message to level1: Intervention of cruise control governor permitted in function monitoring" UBYTE B_TRUE 1 100 0.00 1.00000000000 BIT_MASK 0x1 FORMAT "%13.11" ECU_ADDRESS 0x70000249
 /begin IF_DATA XCPplus 0x0102
  /begin DAQ_EVENT VARIABLE /end DAQ_EVENT
 /end IF_DATA
/end MEASUREMENT
/begin MEASUREMENT MoFDrvrAssc_flgCrsCtrlRlsd "Cruise control release status for the function monitoring" UBYTE B_TRUE 1 100 0.00 1.00000000000 BIT_MASK 0x2 FORMAT "%13.11" ECU_ADDRESS 0x6002CA53
 /begin IF_DATA XCPplus 0x0102
  /begin DAQ_EVENT VARIABLE /end DAQ_EVENT
 /end IF_DATA
/end MEASUREMENT
/begin MEASUREMENT MoFDrvrAssc_flgVehSpdRlsd "Cruise control release from the function level" UBYTE B_TRUE 1 100 0.00 1.00000000000 BIT_MASK 0x8 FORMAT "%13.11" ECU_ADDRESS 0x6002CA53
 /begin IF_DATA XCPplus 0x0102
  /begin DAQ_EVENT VARIABLE /end DAQ_EVENT
 /end IF_DATA
/end MEASUREMENT
/begin MEASUREMENT MoFDrvrAssc_ptrSRFF "Pointer to store the old value of flip-flop" UBYTE OneToOne 1 100 0.00 255.0 FORMAT "%5.1" ECU_ADDRESS 0x6002CA51
 /begin IF_DATA XCPplus 0x0102
  /begin DAQ_EVENT VARIABLE /end DAQ_EVENT
 /end IF_DATA
/end MEASUREMENT
/begin MEASUREMENT MoFDrvrAssc_ptrSRFFCpl "RAM data redundancy of MoFDrvrAssc_ptrSRFF" UBYTE OneToOne 1 100 0.00 255.0 FORMAT "%5.1" ECU_ADDRESS 0x6002BFF4
 /begin IF_DATA XCPplus 0x0102
  /begin DAQ_EVENT VARIABLE /end DAQ_EVENT
 /end IF_DATA
/end MEASUREMENT
/begin MEASUREMENT MoFDrvrAssc_tqCrsCtrl "Cruise control torque in function monitoring" SLONG TrqPrpHigh 1 100 -214748364.800 214748364.700 FORMAT "%13.3" ECU_ADDRESS 0x6002CA4C
 /begin IF_DATA XCPplus 0x0102
  /begin DAQ_EVENT VARIABLE /end DAQ_EVENT
 /end IF_DATA
/end MEASUREMENT
/begin MEASUREMENT MoFDrvrAssc_tqCrsCtrlCpl "RAM data redundancy of MoFDrvrAssc_tqCrsCtrl" ULONG OneToOne 1 100 0.00 4294967295.00 FORMAT "%13.2" ECU_ADDRESS 0x6002BFF0
 /begin IF_DATA XCPplus 0x0102
  /begin DAQ_EVENT VARIABLE /end DAQ_EVENT
 /end IF_DATA
/end MEASUREMENT
/begin MEASUREMENT MoFDrvrAssc_tqPtdCrsCtrlLowrLim "lower torque limit for cruise control torque calculated by a curve" SWORD TrqPrp 1 100 -52428.80 52427.20 FORMAT "%8.2" ECU_ADDRESS 0x6002CA4A
 /begin IF_DATA XCPplus 0x0102
  /begin DAQ_EVENT VARIABLE /end DAQ_EVENT
 /end IF_DATA
/end MEASUREMENT
/begin MEASUREMENT MoFDrvrAssc_tqPtdCrsCtrlLowrLimCpl "complement of lower torque limit for cruise control torque calculated by a curve" UWORD OneToOne 1 100 0.00 65535.00 FORMAT "%8.2" ECU_ADDRESS 0x6002BFEC
 /begin IF_DATA XCPplus 0x0102
  /begin DAQ_EVENT VARIABLE /end DAQ_EVENT
 /end IF_DATA
/end MEASUREMENT
/begin MEASUREMENT MoFDrvrAssc_tqPtdCrsCtrlUpprLim "upper torque limit for cruise control torque calculated by a curve" SWORD TrqPrp 1 100 -52428.80 52427.20 FORMAT "%8.2" ECU_ADDRESS 0x6002CA48
 /begin IF_DATA XCPplus 0x0102
  /begin DAQ_EVENT VARIABLE /end DAQ_EVENT
 /end IF_DATA
/end MEASUREMENT
/begin MEASUREMENT MoFDrvrAssc_tqPtdCrsCtrlUpprLimCpl "complement of upper torque limit for cruise control torque calculated by a curve" UWORD OneToOne 1 100 0.00 65535.00 FORMAT "%8.2" ECU_ADDRESS 0x6002BFEA
 /begin IF_DATA XCPplus 0x0102
  /begin DAQ_EVENT VARIABLE /end DAQ_EVENT
 /end IF_DATA
/end MEASUREMENT
/begin MEASUREMENT MoFEmgyOffEmac_bbLoc1Cpl "Double storage for MoFEmgyOffEmac_bbLoc1" UBYTE OneToOne 1 100 0.00 255.0 FORMAT "%5.1" ECU_ADDRESS 0x600347CA
 /begin IF_DATA XCPplus 0x0102
  /begin DAQ_EVENT VARIABLE /end DAQ_EVENT
 /end IF_DATA
/end MEASUREMENT
/begin MEASUREMENT MoFEmgyOffEmac_bbLoc2Cpl "Double storage for MoFEmgyOffEmac_bbLoc2" UBYTE OneToOne 1 100 0.00 255.0 FORMAT "%5.1" ECU_ADDRESS 0x6002BFE9
 /begin IF_DATA XCPplus 0x0102
  /begin DAQ_EVENT VARIABLE /end DAQ_EVENT
 /end IF_DATA
/end MEASUREMENT
/begin MEASUREMENT MoFEmgyOff_cntrCrashCANInvldDeb "Debounce Counter CAN Crash Signal Invalid Value" UBYTE OneToOne 1 100 0.00 255.0 FORMAT "%5.1" ECU_ADDRESS 0x6002CA46
 /begin IF_DATA XCPplus 0x0102
  /begin DAQ_EVENT VARIABLE /end DAQ_EVENT
 /end IF_DATA
/end MEASUREMENT
/begin MEASUREMENT MoFEmgyOff_cntrCrashCANInvldDebCpl "RAM Data Redundancy MoFEmgyOff_cntrCrashCANInvldDeb" UBYTE OneToOne 1 100 0.00 255.0 FORMAT "%5.1" ECU_ADDRESS 0x6002BFE8
 /begin IF_DATA XCPplus 0x0102
  /begin DAQ_EVENT VARIABLE /end DAQ_EVENT
 /end IF_DATA
/end MEASUREMENT
/begin MEASUREMENT MoFEmgyOff_cntrMajorCrashCanRawDeb "Debounce counter for Major Signal" UBYTE OneToOne 1 100 0.00 255.0 FORMAT "%5.1" ECU_ADDRESS 0x6002CA45
 /begin IF_DATA XCPplus 0x0102
  /begin DAQ_EVENT VARIABLE /end DAQ_EVENT
 /end IF_DATA
/end MEASUREMENT
/begin MEASUREMENT MoFEmgyOff_cntrMajorCrashCanRawDebCpl "Compliment of this MoFEmgyOff_cntrMajorCrashCanRawDeb" UBYTE OneToOne 1 100 0.00 255.0 FORMAT "%5.1" ECU_ADDRESS 0x6002BFE7
 /begin IF_DATA XCPplus 0x0102
  /begin DAQ_EVENT VARIABLE /end DAQ_EVENT
 /end IF_DATA
/end MEASUREMENT
/begin MEASUREMENT MoFEmgyOff_cntrMnrCrashCanRawDeb "Debounce counter for Minor Crash Signal" UBYTE OneToOne 1 100 0.00 255.0 FORMAT "%5.1" ECU_ADDRESS 0x6002CA44
 /begin IF_DATA XCPplus 0x0102
  /begin DAQ_EVENT VARIABLE /end DAQ_EVENT
 /end IF_DATA
/end MEASUREMENT
/begin MEASUREMENT MoFEmgyOff_cntrMnrCrashCanRawDebCpl "Compliment of this MoFEmgyOff_cntrMnrCrashCanRawDeb" UBYTE OneToOne 1 100 0.00 255.0 FORMAT "%5.1" ECU_ADDRESS 0x6002BFE6
 /begin IF_DATA XCPplus 0x0102
  /begin DAQ_EVENT VARIABLE /end DAQ_EVENT
 /end IF_DATA
/end MEASUREMENT
/begin MEASUREMENT MoFEmgyOff_cntrNoCrashCanRawDeb "Debounce counter for No Crash Signal" UBYTE OneToOne 1 100 0.00 255.0 FORMAT "%5.1" ECU_ADDRESS 0x6002CA43
 /begin IF_DATA XCPplus 0x0102
  /begin DAQ_EVENT VARIABLE /end DAQ_EVENT
 /end IF_DATA
/end MEASUREMENT
/begin MEASUREMENT MoFEmgyOff_cntrNoCrashCanRawDebCpl "Compliment of this MoFEmgyOff_cntrNoCrashCanRawDeb" UBYTE OneToOne 1 100 0.00 255.0 FORMAT "%5.1" ECU_ADDRESS 0x6002BFE5
 /begin IF_DATA XCPplus 0x0102
  /begin DAQ_EVENT VARIABLE /end DAQ_EVENT
 /end IF_DATA
/end MEASUREMENT
/begin MEASUREMENT MoFEmgyOff_flgCrashCANErr "Flag Crash Signal: debounced CAN Error" UBYTE B_TRUE 1 100 0.00 1.00000000000 BIT_MASK 0x2 FORMAT "%13.11" ECU_ADDRESS 0x6002CA47
 /begin IF_DATA XCPplus 0x0102
  /begin DAQ_EVENT VARIABLE /end DAQ_EVENT
 /end IF_DATA
/end MEASUREMENT
/begin MEASUREMENT MoFEmgyOff_flgCrashInvldVal "Flag Crash Signal: invalid CAN value" UBYTE B_TRUE 1 100 0.00 1.00000000000 BIT_MASK 0x4 FORMAT "%13.11" ECU_ADDRESS 0x6002CA47
 /begin IF_DATA XCPplus 0x0102
  /begin DAQ_EVENT VARIABLE /end DAQ_EVENT
 /end IF_DATA
/end MEASUREMENT
/begin MEASUREMENT MoFEmgyOff_flgInvldLoc "Flag for an invalid crash signal in function monitoring" UBYTE B_TRUE 1 100 0.00 1.00000000000 BIT_MASK 0x2 FORMAT "%13.11" ECU_ADDRESS 0x600347CB
 /begin IF_DATA XCPplus 0x0102
  /begin DAQ_EVENT VARIABLE /end DAQ_EVENT
 /end IF_DATA
/end MEASUREMENT
/begin MEASUREMENT MoFEmgyOff_flgInvldLocDebd "Flag for a debounced invalid crash signal in function monitoring" UBYTE B_TRUE 1 100 0.00 1.00000000000 BIT_MASK 0x4 FORMAT "%13.11" ECU_ADDRESS 0x600347CB
 /begin IF_DATA XCPplus 0x0102
  /begin DAQ_EVENT VARIABLE /end DAQ_EVENT
 /end IF_DATA
/end MEASUREMENT
/begin MEASUREMENT MoFEmgyOff_flgMajorCrash "Store the status of Major Crash" UBYTE B_TRUE 1 100 0.00 1.00000000000 BIT_MASK 0x8 FORMAT "%13.11" ECU_ADDRESS 0x6002CA47
 /begin IF_DATA XCPplus 0x0102
  /begin DAQ_EVENT VARIABLE /end DAQ_EVENT
 /end IF_DATA
/end MEASUREMENT
/begin MEASUREMENT MoFEmgyOff_flgMnrCrash "Store the status of Minor Crash" UBYTE B_TRUE 1 100 0.00 1.00000000000 BIT_MASK 0x10 FORMAT "%13.11" ECU_ADDRESS 0x6002CA47
 /begin IF_DATA XCPplus 0x0102
  /begin DAQ_EVENT VARIABLE /end DAQ_EVENT
 /end IF_DATA
/end MEASUREMENT
/begin MEASUREMENT MoFEmgyOff_flgNoCrash "Store the status of No Crash" UBYTE B_TRUE 1 100 0.00 1.00000000000 BIT_MASK 0x20 FORMAT "%13.11" ECU_ADDRESS 0x6002CA47
 /begin IF_DATA XCPplus 0x0102
  /begin DAQ_EVENT VARIABLE /end DAQ_EVENT
 /end IF_DATA
/end MEASUREMENT
/begin MEASUREMENT MoFEmgyOff_flgOkLoc "Flag for an Ok crash signal in function monitoring" UBYTE B_TRUE 1 100 0.00 1.00000000000 BIT_MASK 0x1 FORMAT "%13.11" ECU_ADDRESS 0x600347CB
 /begin IF_DATA XCPplus 0x0102
  /begin DAQ_EVENT VARIABLE /end DAQ_EVENT
 /end IF_DATA
/end MEASUREMENT
/begin MEASUREMENT MoFEmgyOff_flgPwmCrash "Store the status of Pwm Crash" UBYTE B_TRUE 1 100 0.00 1.00000000000 BIT_MASK 0x8 FORMAT "%13.11" ECU_ADDRESS 0x600347CB
 /begin IF_DATA XCPplus 0x0102
  /begin DAQ_EVENT VARIABLE /end DAQ_EVENT
 /end IF_DATA
/end MEASUREMENT
/begin MEASUREMENT MoFEmgyOff_flgPWMCrashCfmd "Store the status of Confirmed Pwm crash signal" UBYTE B_TRUE 1 100 0.00 1.00000000000 BIT_MASK 0x20 FORMAT "%13.11" ECU_ADDRESS 0x600347CB
 /begin IF_DATA XCPplus 0x0102
  /begin DAQ_EVENT VARIABLE /end DAQ_EVENT
 /end IF_DATA
/end MEASUREMENT
/begin MEASUREMENT MoFEmgyOff_flgPWMCrashLocDebd "Confirmed debounced pwm crash signal" UBYTE B_TRUE 1 100 0.00 1.00000000000 BIT_MASK 0x10 FORMAT "%13.11" ECU_ADDRESS 0x600347CB
 /begin IF_DATA XCPplus 0x0102
  /begin DAQ_EVENT VARIABLE /end DAQ_EVENT
 /end IF_DATA
/end MEASUREMENT
/begin MEASUREMENT MoFEmgyOff_flgPWMCrashRprt "Store the status of reported Pwm crash signal" UBYTE B_TRUE 1 100 0.00 1.00000000000 BIT_MASK 0x40 FORMAT "%13.11" ECU_ADDRESS 0x600347CB
 /begin IF_DATA XCPplus 0x0102
  /begin DAQ_EVENT VARIABLE /end DAQ_EVENT
 /end IF_DATA
/end MEASUREMENT
/begin MEASUREMENT MoFEmgyOff_flgT15Old "Old value of T15 in function monitoring" UBYTE B_TRUE 1 100 0.00 1.00000000000 BIT_MASK 0x80 FORMAT "%13.11" ECU_ADDRESS 0x600347CB
 /begin IF_DATA XCPplus 0x0102
  /begin DAQ_EVENT VARIABLE /end DAQ_EVENT
 /end IF_DATA
/end MEASUREMENT
/begin MEASUREMENT MoFEmgyOff_stActrTest "Status of the actuator test in level 2" UBYTE OneToOne 1 100 0.00 255.0 FORMAT "%5.1" ECU_ADDRESS 0x6002CA3F
 /begin IF_DATA XCPplus 0x0102
  /begin DAQ_EVENT VARIABLE /end DAQ_EVENT
 /end IF_DATA
/end MEASUREMENT
/begin MEASUREMENT MoFEmgyOff_stActrTestCpl "RAM data redundancy of MoFEmgyOff_stActrTest" UBYTE OneToOne 1 100 0.00 255.0 FORMAT "%5.1" ECU_ADDRESS 0x6002BFE4
 /begin IF_DATA XCPplus 0x0102
  /begin DAQ_EVENT VARIABLE /end DAQ_EVENT
 /end IF_DATA
/end MEASUREMENT
/begin MEASUREMENT MoFEmgyOff_stCrash "Status of the crash signal in level 2" UBYTE OneToOne 1 100 0.00 255.0 FORMAT "%5.1" ECU_ADDRESS 0x6002CA3E
 /begin IF_DATA XCPplus 0x0102
  /begin DAQ_EVENT VARIABLE /end DAQ_EVENT
 /end IF_DATA
/end MEASUREMENT
/begin MEASUREMENT MoFEmgyOff_stCrashCANRawLstVld "Last valid CAN Crash status before transmission error" UBYTE OneToOne 1 100 0.00 255.0 FORMAT "%5.1" ECU_ADDRESS 0x6002CA42
 /begin IF_DATA XCPplus 0x0102
  /begin DAQ_EVENT VARIABLE /end DAQ_EVENT
 /end IF_DATA
/end MEASUREMENT
/begin MEASUREMENT MoFEmgyOff_stCrashCANRawLstVldCpl "RAM Data Redundancy MoFEmgyOff_stCrashCANRawLstVld" UBYTE OneToOne 1 100 0.00 255.0 FORMAT "%5.1" ECU_ADDRESS 0x6002BFE3
 /begin IF_DATA XCPplus 0x0102
  /begin DAQ_EVENT VARIABLE /end DAQ_EVENT
 /end IF_DATA
/end MEASUREMENT
/begin MEASUREMENT MoFEmgyOff_stCrashCpl "RAM data redundancy of MoFEmgyOff_stCrash" UBYTE OneToOne 1 100 0.00 255.0 FORMAT "%5.1" ECU_ADDRESS 0x6002BFE2
 /begin IF_DATA XCPplus 0x0102
  /begin DAQ_EVENT VARIABLE /end DAQ_EVENT
 /end IF_DATA
/end MEASUREMENT
/begin MEASUREMENT MoFEmgyOff_stCrashMsg "Crash Signal Handshake for Level 1" UBYTE OneToOne 1 100 0.00 255.0 FORMAT "%5.1" ECU_ADDRESS 0x6002352B
 /begin IF_DATA XCPplus 0x0102
  /begin DAQ_EVENT VARIABLE /end DAQ_EVENT
 /end IF_DATA
/end MEASUREMENT
/begin MEASUREMENT MoFEmgyOff_tiInvldDeb "debounce counter for invalid crash signal in function monitoring" UBYTE t_q0p01 1 100 0.00 2.550 FORMAT "%5.3" ECU_ADDRESS 0x6002CA41
 /begin IF_DATA XCPplus 0x0102
  /begin DAQ_EVENT VARIABLE /end DAQ_EVENT
 /end IF_DATA
/end MEASUREMENT
/begin MEASUREMENT MoFEmgyOff_tiInvldDebCpl "RAM data redundancy of MoFEmgyOff_tiInvldDeb" UBYTE OneToOne 1 100 0.00 255.0 FORMAT "%5.1" ECU_ADDRESS 0x6002BFE1
 /begin IF_DATA XCPplus 0x0102
  /begin DAQ_EVENT VARIABLE /end DAQ_EVENT
 /end IF_DATA
/end MEASUREMENT
/begin MEASUREMENT MoFEmgyOff_tiPWMCrashDeb "Debounce counter for Pwm crash" UBYTE t_q0p01 1 100 0.00 2.550 FORMAT "%5.3" ECU_ADDRESS 0x6002CA40
 /begin IF_DATA XCPplus 0x0102
  /begin DAQ_EVENT VARIABLE /end DAQ_EVENT
 /end IF_DATA
/end MEASUREMENT
/begin MEASUREMENT MoFEmgyOff_tiPWMCrashDebCpl "Compliment of this MoFEmgyOff_tiPWMCrashDeb" UBYTE OneToOne 1 100 0.00 255.0 FORMAT "%5.1" ECU_ADDRESS 0x6002BFE0
 /begin IF_DATA XCPplus 0x0102
  /begin DAQ_EVENT VARIABLE /end DAQ_EVENT
 /end IF_DATA
/end MEASUREMENT
/begin MEASUREMENT MoFEmgyOff_tiT15On "debounce time terminal 15 on in function monitoring" UWORD t_q0p01 1 100 0.00 655.3500 FORMAT "%8.4" ECU_ADDRESS 0x600347C8
 /begin IF_DATA XCPplus 0x0102
  /begin DAQ_EVENT VARIABLE /end DAQ_EVENT
 /end IF_DATA
/end MEASUREMENT
/begin MEASUREMENT MoFEmgyOff_tiT15OnCpl "RAM data redundancy of MoFEmgyOff_tiT15On" UWORD OneToOne 1 100 0.00 65535.00 FORMAT "%8.2" ECU_ADDRESS 0x600347C6
 /begin IF_DATA XCPplus 0x0102
  /begin DAQ_EVENT VARIABLE /end DAQ_EVENT
 /end IF_DATA
/end MEASUREMENT
/begin MEASUREMENT MoFErrHndlg_Lib_DataDebErrReactn_I.cntErrDeb "Class for DataDeb with error reaction / Debounce count in class DataDeb with error reaction." UWORD OneToOne 1 100 0.00 65535.00 FORMAT "%8.2" ECU_ADDRESS 0x6002CA38 /end MEASUREMENT
/begin MEASUREMENT MoFErrHndlg_Lib_DataDebErrReactn_I.cntErrDebCpl "Class for DataDeb with error reaction / Complement for debounce count for class DataDeb with error reaction." UWORD OneToOne 1 100 0.00 65535.00 FORMAT "%8.2" ECU_ADDRESS 0x6002BFDC /end MEASUREMENT
/begin MEASUREMENT MoFErrHndlg_Lib_DataDebErrReactn_I.stErrDeb "Class for DataDeb with error reaction / Status of debounced error in class DataDeb with error reaction." UBYTE OneToOne 1 100 0.00 255.0 FORMAT "%5.1" ECU_ADDRESS 0x6002CA3A /end MEASUREMENT
/begin MEASUREMENT MoFErrHndlg_Lib_DataDebErrReactn_I.stErrDebCpl "Class for DataDeb with error reaction / Complement for status of debounced error in class DataDeb with error reaction." UBYTE OneToOne 1 100 0.00 255.0 FORMAT "%5.1" ECU_ADDRESS 0x6002BFDE /end MEASUREMENT
/begin MEASUREMENT MoFErrHndlg_Lib_DataDebErrReactn_I.stErrLockRels "Class for DataDeb with error reaction / Status of lock release class DataDeb with error reaction." UBYTE OneToOne 1 100 0.00 255.0 FORMAT "%5.1" ECU_ADDRESS 0x6002CA3B /end MEASUREMENT
/begin MEASUREMENT MoFErrHndlg_Lib_DataDebErrReactn_I.stErrLockRelsCpl "Class for DataDeb with error reaction / Complement for Status of lock release class DataDeb with error reaction." UBYTE OneToOne 1 100 0.00 255.0 FORMAT "%5.1" ECU_ADDRESS 0x6002BFDF /end MEASUREMENT
/begin MEASUREMENT MoFErrHndlg_Lib_DataDebErrReactn_I.stErrReactn "Class for DataDeb with error reaction / Status of error reaction in class DataDeb with error reaction." UBYTE OneToOne 1 100 0.00 255.0 FORMAT "%5.1" ECU_ADDRESS 0x6002CA3C /end MEASUREMENT
/begin MEASUREMENT MoFErrHndlg_Lib_DataDeb_I.cntErrDeb "Class for DataDeb / Debounce count in class DataDeb." UWORD OneToOne 1 100 0.00 65535.00 FORMAT "%8.2" ECU_ADDRESS 0x6002CA34 /end MEASUREMENT
/begin MEASUREMENT MoFErrHndlg_Lib_DataDeb_I.cntErrDebCpl "Class for DataDeb / Complement for Debounce countin class DataDeb." UWORD OneToOne 1 100 0.00 65535.00 FORMAT "%8.2" ECU_ADDRESS 0x6002BFDA /end MEASUREMENT
/begin MEASUREMENT MoFErrHndlg_Lib_DataDeb_I.stErrDeb "Class for DataDeb / Status of debounced error in class DataDeb." UBYTE OneToOne 1 100 0.00 255.0 FORMAT "%5.1" ECU_ADDRESS 0x6002CA36 /end MEASUREMENT
/begin MEASUREMENT MoFErrHndlg_Lib_DataErrReactn_I.stErrLockRels "Class for error reaction / Status of lock release in class error reaction." UBYTE OneToOne 1 100 0.00 255.0 FORMAT "%5.1" ECU_ADDRESS 0x6002CA32 /end MEASUREMENT
/begin MEASUREMENT MoFErrHndlg_Lib_DataErrReactn_I.stErrLockRelsCpl "Class for error reaction / Complement for status of lock release in class error reaction." UBYTE OneToOne 1 100 0.00 255.0 FORMAT "%5.1" ECU_ADDRESS 0x6002BFD8 /end MEASUREMENT
/begin MEASUREMENT MoFErrHndlg_Lib_DataErrReactn_I.stErrReactn "Class for error reaction / Status of error reaction in class error reaction." UBYTE OneToOne 1 100 0.00 255.0 FORMAT "%5.1" ECU_ADDRESS 0x6002CA33 /end MEASUREMENT
/begin MEASUREMENT MoFErrHndlg_Lib_DataUpDwnDebErrReactn_I.cntErrDeb "Class for DataUpDownDeb with error reaction / Debounce count in class DataUpDownDeb with error reaction." UWORD OneToOne 1 100 0.00 65535.00 FORMAT "%8.2" ECU_ADDRESS 0x6002CA2C /end MEASUREMENT
/begin MEASUREMENT MoFErrHndlg_Lib_DataUpDwnDebErrReactn_I.cntErrDebCpl "Class for DataUpDownDeb with error reaction / Complement for Debounce count in class DataUpDownDeb with error reaction." UWORD OneToOne 1 100 0.00 65535.00 FORMAT "%8.2" ECU_ADDRESS 0x6002BFD4 /end MEASUREMENT
/begin MEASUREMENT MoFErrHndlg_Lib_DataUpDwnDebErrReactn_I.stErrDeb "Class for DataUpDownDeb with error reaction / Status of debounced error in class DataUpDownDeb with error reaction." UBYTE OneToOne 1 100 0.00 255.0 FORMAT "%5.1" ECU_ADDRESS 0x6002CA2E /end MEASUREMENT
/begin MEASUREMENT MoFErrHndlg_Lib_DataUpDwnDebErrReactn_I.stErrDebCpl "Class for DataUpDownDeb with error reaction / Complement for Status of debounced error in class DataUpDownDeb with error reaction." UBYTE OneToOne 1 100 0.00 255.0 FORMAT "%5.1" ECU_ADDRESS 0x6002BFD6 /end MEASUREMENT
/begin MEASUREMENT MoFErrHndlg_Lib_DataUpDwnDebErrReactn_I.stErrLockRels "Class for DataUpDownDeb with error reaction / Status of lock release in class DataUpDownDeb with error reaction." UBYTE OneToOne 1 100 0.00 255.0 FORMAT "%5.1" ECU_ADDRESS 0x6002CA2F /end MEASUREMENT
/begin MEASUREMENT MoFErrHndlg_Lib_DataUpDwnDebErrReactn_I.stErrLockRelsCpl "Class for DataUpDownDeb with error reaction / Complement for Status of lock release in class DataUpDownDeb with error reaction." UBYTE OneToOne 1 100 0.00 255.0 FORMAT "%5.1" ECU_ADDRESS 0x6002BFD7 /end MEASUREMENT
/begin MEASUREMENT MoFErrHndlg_Lib_DataUpDwnDebErrReactn_I.stErrReactn "Class for DataUpDownDeb with error reaction / Status of error reaction in class DataUpDownDeb with error reaction." UBYTE OneToOne 1 100 0.00 255.0 FORMAT "%5.1" ECU_ADDRESS 0x6002CA30 /end MEASUREMENT
/begin MEASUREMENT MoFErrHndlg_Lib_DataUpDwnDeb_I.cntErrDeb "Class for DataUpDownDeb / Debounce count in class DataUpDownDeb." UWORD OneToOne 1 100 0.00 65535.00 FORMAT "%8.2" ECU_ADDRESS 0x6002CA28 /end MEASUREMENT
/begin MEASUREMENT MoFErrHndlg_Lib_DataUpDwnDeb_I.cntErrDebCpl "Class for DataUpDownDeb / Complement for Debounce count in class DataUpDownDeb." UWORD OneToOne 1 100 0.00 65535.00 FORMAT "%8.2" ECU_ADDRESS 0x6002BFD0 /end MEASUREMENT
/begin MEASUREMENT MoFErrHndlg_Lib_DataUpDwnDeb_I.stErrDeb "Class for DataUpDownDeb / Status of debounced error in class DataUpDownDeb." UBYTE OneToOne 1 100 0.00 255.0 FORMAT "%5.1" ECU_ADDRESS 0x6002CA2A /end MEASUREMENT
/begin MEASUREMENT MoFErrHndlg_Lib_DataUpDwnDeb_I.stErrDebCpl "Class for DataUpDownDeb / Complement for status of debounced error in class DataUpDownDeb." UBYTE OneToOne 1 100 0.00 255.0 FORMAT "%5.1" ECU_ADDRESS 0x6002BFD2 /end MEASUREMENT
/begin MEASUREMENT MoFErrHndlg_Reactn_Cls_AccrInpCpl_I.MoFErrHndlg_stErrLockRlsCpl "Cpl MoFErrHndlg_Reactn_Cls_AccrInp_I / Cpl MoFErrHndlg_stErrLockRls" UBYTE OneToOne 1 100 0.00 255.0 FORMAT "%5.1" ECU_ADDRESS 0x6002BFCA
 /begin IF_DATA XCPplus 0x0102
  /begin DAQ_EVENT VARIABLE /end DAQ_EVENT
 /end IF_DATA
/end MEASUREMENT
/begin MEASUREMENT MoFErrHndlg_Reactn_Cls_AccrInpCpl_I.MoFErrHndlg_stErrReacCpl "Cpl MoFErrHndlg_Reactn_Cls_AccrInp_I / Cpl MoFErrHndlg_stErrReac" UBYTE OneToOne 1 100 0.00 255.0 FORMAT "%5.1" ECU_ADDRESS 0x6002BFCB
 /begin IF_DATA XCPplus 0x0102
  /begin DAQ_EVENT VARIABLE /end DAQ_EVENT
 /end IF_DATA
/end MEASUREMENT
/begin MEASUREMENT MoFErrHndlg_Reactn_Cls_AccrInp_I.MoFErrHndlg_stErrLockRls "Class Instance Error Reaction Accelaration Pedal Error / Status Error Lock" UBYTE OneToOne 1 100 0.00 255.0 FORMAT "%5.1" ECU_ADDRESS 0x6002CA22
 /begin IF_DATA XCPplus 0x0102
  /begin DAQ_EVENT VARIABLE /end DAQ_EVENT
 /end IF_DATA
/end MEASUREMENT
/begin MEASUREMENT MoFErrHndlg_Reactn_Cls_AccrInp_I.MoFErrHndlg_stErrReac "Class Instance Error Reaction Accelaration Pedal Error / Status Error Reaction" UBYTE OneToOne 1 100 0.00 255.0 FORMAT "%5.1" ECU_ADDRESS 0x6002CA23
 /begin IF_DATA XCPplus 0x0102
  /begin DAQ_EVENT VARIABLE /end DAQ_EVENT
 /end IF_DATA
/end MEASUREMENT
/begin MEASUREMENT MoFErrHndlg_Reactn_Cls_ADC_SOPCpl_I.MoFErrHndlg_stErrLockRlsCpl "Cpl of MoFErrHndlg_Reactn_Cls_ADC_SOP_I / Cpl MoFErrHndlg_stErrLockRls" UBYTE OneToOne 1 100 0.00 255.0 FORMAT "%5.1" ECU_ADDRESS 0x6002BFCC
 /begin IF_DATA XCPplus 0x0102
  /begin DAQ_EVENT VARIABLE /end DAQ_EVENT
 /end IF_DATA
/end MEASUREMENT
/begin MEASUREMENT MoFErrHndlg_Reactn_Cls_ADC_SOPCpl_I.MoFErrHndlg_stErrReacCpl "Cpl of MoFErrHndlg_Reactn_Cls_ADC_SOP_I / Cpl MoFErrHndlg_stErrReac" UBYTE OneToOne 1 100 0.00 255.0 FORMAT "%5.1" ECU_ADDRESS 0x6002BFCD
 /begin IF_DATA XCPplus 0x0102
  /begin DAQ_EVENT VARIABLE /end DAQ_EVENT
 /end IF_DATA
/end MEASUREMENT
/begin MEASUREMENT MoFErrHndlg_Reactn_Cls_ADC_SOP_I.MoFErrHndlg_stErrLockRls "Class Instance Error Reaction ADC SOP Error / Status Error Lock" UBYTE OneToOne 1 100 0.00 255.0 FORMAT "%5.1" ECU_ADDRESS 0x6002CA24
 /begin IF_DATA XCPplus 0x0102
  /begin DAQ_EVENT VARIABLE /end DAQ_EVENT
 /end IF_DATA
/end MEASUREMENT
/begin MEASUREMENT MoFErrHndlg_Reactn_Cls_ADC_SOP_I.MoFErrHndlg_stErrReac "Class Instance Error Reaction ADC SOP Error / Status Error Reaction" UBYTE OneToOne 1 100 0.00 255.0 FORMAT "%5.1" ECU_ADDRESS 0x6002CA25
 /begin IF_DATA XCPplus 0x0102
  /begin DAQ_EVENT VARIABLE /end DAQ_EVENT
 /end IF_DATA
/end MEASUREMENT
/begin MEASUREMENT MoFErrHndlg_Reactn_Cls_AxleCompCpl_I.MoFErrHndlg_stErrLockRlsCpl "Cpl MoFErrHndlg_Reactn_Cls_AccrInp_I / Cpl MoFErrHndlg_stErrLockRls" UBYTE OneToOne 1 100 0.00 255.0 FORMAT "%5.1" ECU_ADDRESS 0x6002BFC8
 /begin IF_DATA XCPplus 0x0102
  /begin DAQ_EVENT VARIABLE /end DAQ_EVENT
 /end IF_DATA
/end MEASUREMENT
/begin MEASUREMENT MoFErrHndlg_Reactn_Cls_AxleCompCpl_I.MoFErrHndlg_stErrReacCpl "Cpl MoFErrHndlg_Reactn_Cls_AccrInp_I / Cpl MoFErrHndlg_stErrReac" UBYTE OneToOne 1 100 0.00 255.0 FORMAT "%5.1" ECU_ADDRESS 0x6002BFC9
 /begin IF_DATA XCPplus 0x0102
  /begin DAQ_EVENT VARIABLE /end DAQ_EVENT
 /end IF_DATA
/end MEASUREMENT
/begin MEASUREMENT MoFErrHndlg_Reactn_Cls_AxleComp_I.MoFErrHndlg_stErrLockRls "Class Instance Torque Compare Error Axel Level / Status Error Lock" UBYTE OneToOne 1 100 0.00 255.0 FORMAT "%5.1" ECU_ADDRESS 0x6002CA20
 /begin IF_DATA XCPplus 0x0102
  /begin DAQ_EVENT VARIABLE /end DAQ_EVENT
 /end IF_DATA
/end MEASUREMENT
/begin MEASUREMENT MoFErrHndlg_Reactn_Cls_AxleComp_I.MoFErrHndlg_stErrReac "Class Instance Torque Compare Error Axel Level / Status Error Reaction" UBYTE OneToOne 1 100 0.00 255.0 FORMAT "%5.1" ECU_ADDRESS 0x6002CA21
 /begin IF_DATA XCPplus 0x0102
  /begin DAQ_EVENT VARIABLE /end DAQ_EVENT
 /end IF_DATA
/end MEASUREMENT
/begin MEASUREMENT MoFErrHndlg_Reactn_Cls_EmCompCpl_I.MoFErrHndlg_stErrLockRlsCpl "CPL MoFErrHndlg_Reactn_Cls_EmComp_I / Cpl MoFErrHndlg_stErrLockRls" UBYTE OneToOne 1 100 0.00 255.0 FORMAT "%5.1" ECU_ADDRESS 0x6002BFC6
 /begin IF_DATA XCPplus 0x0102
  /begin DAQ_EVENT VARIABLE /end DAQ_EVENT
 /end IF_DATA
/end MEASUREMENT
/begin MEASUREMENT MoFErrHndlg_Reactn_Cls_EmCompCpl_I.MoFErrHndlg_stErrReacCpl "CPL MoFErrHndlg_Reactn_Cls_EmComp_I / Cpl MoFErrHndlg_stErrReac" UBYTE OneToOne 1 100 0.00 255.0 FORMAT "%5.1" ECU_ADDRESS 0x6002BFC7
 /begin IF_DATA XCPplus 0x0102
  /begin DAQ_EVENT VARIABLE /end DAQ_EVENT
 /end IF_DATA
/end MEASUREMENT
/begin MEASUREMENT MoFErrHndlg_Reactn_Cls_EmComp_I.MoFErrHndlg_stErrLockRls "Class Instance Torque Compare Error E-Maschine Level / Status Error Lock" UBYTE OneToOne 1 100 0.00 255.0 FORMAT "%5.1" ECU_ADDRESS 0x6002CA1E
 /begin IF_DATA XCPplus 0x0102
  /begin DAQ_EVENT VARIABLE /end DAQ_EVENT
 /end IF_DATA
/end MEASUREMENT
/begin MEASUREMENT MoFErrHndlg_Reactn_Cls_EmComp_I.MoFErrHndlg_stErrReac "Class Instance Torque Compare Error E-Maschine Level / Status Error Reaction" UBYTE OneToOne 1 100 0.00 255.0 FORMAT "%5.1" ECU_ADDRESS 0x6002CA1F
 /begin IF_DATA XCPplus 0x0102
  /begin DAQ_EVENT VARIABLE /end DAQ_EVENT
 /end IF_DATA
/end MEASUREMENT
/begin MEASUREMENT MoFErrHndlg_Reactn_Cls_EmSignCompCpl_I.MoFErrHndlg_stErrLockRlsCpl "Cpl MoFErrHndlg_Reactn_Cls_EmSignComp_I / Cpl MoFErrHndlg_stErrLockRls" UBYTE OneToOne 1 100 0.00 255.0 FORMAT "%5.1" ECU_ADDRESS 0x6002BFC4
 /begin IF_DATA XCPplus 0x0102
  /begin DAQ_EVENT VARIABLE /end DAQ_EVENT
 /end IF_DATA
/end MEASUREMENT
/begin MEASUREMENT MoFErrHndlg_Reactn_Cls_EmSignCompCpl_I.MoFErrHndlg_stErrReacCpl "Cpl MoFErrHndlg_Reactn_Cls_EmSignComp_I / Cpl MoFErrHndlg_stErrReac" UBYTE OneToOne 1 100 0.00 255.0 FORMAT "%5.1" ECU_ADDRESS 0x6002BFC5
 /begin IF_DATA XCPplus 0x0102
  /begin DAQ_EVENT VARIABLE /end DAQ_EVENT
 /end IF_DATA
/end MEASUREMENT
/begin MEASUREMENT MoFErrHndlg_Reactn_Cls_EmSignComp_I.MoFErrHndlg_stErrLockRls "Class Instance Torque Sign Error / Status Error Lock" UBYTE OneToOne 1 100 0.00 255.0 FORMAT "%5.1" ECU_ADDRESS 0x6002CA1C
 /begin IF_DATA XCPplus 0x0102
  /begin DAQ_EVENT VARIABLE /end DAQ_EVENT
 /end IF_DATA
/end MEASUREMENT
/begin MEASUREMENT MoFErrHndlg_Reactn_Cls_EmSignComp_I.MoFErrHndlg_stErrReac "Class Instance Torque Sign Error / Status Error Reaction" UBYTE OneToOne 1 100 0.00 255.0 FORMAT "%5.1" ECU_ADDRESS 0x6002CA1D
 /begin IF_DATA XCPplus 0x0102
  /begin DAQ_EVENT VARIABLE /end DAQ_EVENT
 /end IF_DATA
/end MEASUREMENT
/begin MEASUREMENT MoFErrHndlg_Reactn_Cls_PostBldSelCpl_I.MoFErrHndlg_stErrLockRlsCpl "Cpl MoFErrHndlg_Reactn_Cls_PostBldSel_I / Cpl MoFErrHndlg_stErrLockRls" UBYTE OneToOne 1 100 0.00 255.0 FORMAT "%5.1" ECU_ADDRESS 0x6002BFC2
 /begin IF_DATA XCPplus 0x0102
  /begin DAQ_EVENT VARIABLE /end DAQ_EVENT
 /end IF_DATA
/end MEASUREMENT
/begin MEASUREMENT MoFErrHndlg_Reactn_Cls_PostBldSelCpl_I.MoFErrHndlg_stErrReacCpl "Cpl MoFErrHndlg_Reactn_Cls_PostBldSel_I / Cpl MoFErrHndlg_stErrReac" UBYTE OneToOne 1 100 0.00 255.0 FORMAT "%5.1" ECU_ADDRESS 0x6002BFC3
 /begin IF_DATA XCPplus 0x0102
  /begin DAQ_EVENT VARIABLE /end DAQ_EVENT
 /end IF_DATA
/end MEASUREMENT
/begin MEASUREMENT MoFErrHndlg_Reactn_Cls_PostBldSel_I.MoFErrHndlg_stErrLockRls "Class Instance PostBldSel Error / Status Error Lock" UBYTE OneToOne 1 100 0.00 255.0 FORMAT "%5.1" ECU_ADDRESS 0x6002CA1A
 /begin IF_DATA XCPplus 0x0102
  /begin DAQ_EVENT VARIABLE /end DAQ_EVENT
 /end IF_DATA
/end MEASUREMENT
/begin MEASUREMENT MoFErrHndlg_Reactn_Cls_PostBldSel_I.MoFErrHndlg_stErrReac "Class Instance PostBldSel Error / Status Error Reaction" UBYTE OneToOne 1 100 0.00 255.0 FORMAT "%5.1" ECU_ADDRESS 0x6002CA1B
 /begin IF_DATA XCPplus 0x0102
  /begin DAQ_EVENT VARIABLE /end DAQ_EVENT
 /end IF_DATA
/end MEASUREMENT
/begin MEASUREMENT MoFErrHndlg_Reactn_Cls_PtRelsCpl_I.MoFErrHndlg_stErrLockRlsCpl "CPL of MoFErrHndlg_Reactn_Cls_PtRels_I / Cpl MoFErrHndlg_stErrLockRls" UBYTE OneToOne 1 100 0.00 255.0 FORMAT "%5.1" ECU_ADDRESS 0x6002BFC0
 /begin IF_DATA XCPplus 0x0102
  /begin DAQ_EVENT VARIABLE /end DAQ_EVENT
 /end IF_DATA
/end MEASUREMENT
/begin MEASUREMENT MoFErrHndlg_Reactn_Cls_PtRelsCpl_I.MoFErrHndlg_stErrReacCpl "CPL of MoFErrHndlg_Reactn_Cls_PtRels_I / Cpl MoFErrHndlg_stErrReac" UBYTE OneToOne 1 100 0.00 255.0 FORMAT "%5.1" ECU_ADDRESS 0x6002BFC1
 /begin IF_DATA XCPplus 0x0102
  /begin DAQ_EVENT VARIABLE /end DAQ_EVENT
 /end IF_DATA
/end MEASUREMENT
/begin MEASUREMENT MoFErrHndlg_Reactn_Cls_PtRels_I.MoFErrHndlg_stErrLockRls "Class Instance Power Train Release Error / Status Error Lock" UBYTE OneToOne 1 100 0.00 255.0 FORMAT "%5.1" ECU_ADDRESS 0x6002CA18
 /begin IF_DATA XCPplus 0x0102
  /begin DAQ_EVENT VARIABLE /end DAQ_EVENT
 /end IF_DATA
/end MEASUREMENT
/begin MEASUREMENT MoFErrHndlg_Reactn_Cls_PtRels_I.MoFErrHndlg_stErrReac "Class Instance Power Train Release Error / Status Error Reaction" UBYTE OneToOne 1 100 0.00 255.0 FORMAT "%5.1" ECU_ADDRESS 0x6002CA19
 /begin IF_DATA XCPplus 0x0102
  /begin DAQ_EVENT VARIABLE /end DAQ_EVENT
 /end IF_DATA
/end MEASUREMENT
/begin MEASUREMENT MoFErrHndlg_Reactn_Cls_SecAxleCompCpl_I.MoFErrHndlg_stErrLockRlsCpl "Complement for MoFErrHndlg_Reactn_Cls_SecAxleComp_I / Cpl MoFErrHndlg_stErrLockRls" UBYTE OneToOne 1 100 0.00 255.0 FORMAT "%5.1" ECU_ADDRESS 0x6002BFBE
 /begin IF_DATA XCPplus 0x0102
  /begin DAQ_EVENT VARIABLE /end DAQ_EVENT
 /end IF_DATA
/end MEASUREMENT
/begin MEASUREMENT MoFErrHndlg_Reactn_Cls_SecAxleCompCpl_I.MoFErrHndlg_stErrReacCpl "Complement for MoFErrHndlg_Reactn_Cls_SecAxleComp_I / Cpl MoFErrHndlg_stErrReac" UBYTE OneToOne 1 100 0.00 255.0 FORMAT "%5.1" ECU_ADDRESS 0x6002BFBF
 /begin IF_DATA XCPplus 0x0102
  /begin DAQ_EVENT VARIABLE /end DAQ_EVENT
 /end IF_DATA
/end MEASUREMENT
/begin MEASUREMENT MoFErrHndlg_Reactn_Cls_SecAxleComp_I.MoFErrHndlg_stErrLockRls "Class Instance Torque Compare Error Secondary Axel Level / Status Error Lock" UBYTE OneToOne 1 100 0.00 255.0 FORMAT "%5.1" ECU_ADDRESS 0x6002CA16
 /begin IF_DATA XCPplus 0x0102
  /begin DAQ_EVENT VARIABLE /end DAQ_EVENT
 /end IF_DATA
/end MEASUREMENT
/begin MEASUREMENT MoFErrHndlg_Reactn_Cls_SecAxleComp_I.MoFErrHndlg_stErrReac "Class Instance Torque Compare Error Secondary Axel Level / Status Error Reaction" UBYTE OneToOne 1 100 0.00 255.0 FORMAT "%5.1" ECU_ADDRESS 0x6002CA17
 /begin IF_DATA XCPplus 0x0102
  /begin DAQ_EVENT VARIABLE /end DAQ_EVENT
 /end IF_DATA
/end MEASUREMENT
/begin MEASUREMENT MoFErrHndlg_Reactn_Cls_SecEmCompCpl_I.MoFErrHndlg_stErrLockRlsCpl "Complement for MoFErrHndlg_Reactn_Cls_SecEmComp_I / Cpl MoFErrHndlg_stErrLockRls" UBYTE OneToOne 1 100 0.00 255.0 FORMAT "%5.1" ECU_ADDRESS 0x6002BFBC
 /begin IF_DATA XCPplus 0x0102
  /begin DAQ_EVENT VARIABLE /end DAQ_EVENT
 /end IF_DATA
/end MEASUREMENT
/begin MEASUREMENT MoFErrHndlg_Reactn_Cls_SecEmCompCpl_I.MoFErrHndlg_stErrReacCpl "Complement for MoFErrHndlg_Reactn_Cls_SecEmComp_I / Cpl MoFErrHndlg_stErrReac" UBYTE OneToOne 1 100 0.00 255.0 FORMAT "%5.1" ECU_ADDRESS 0x6002BFBD
 /begin IF_DATA XCPplus 0x0102
  /begin DAQ_EVENT VARIABLE /end DAQ_EVENT
 /end IF_DATA
/end MEASUREMENT
/begin MEASUREMENT MoFErrHndlg_Reactn_Cls_SecEmComp_I.MoFErrHndlg_stErrLockRls "Class Instance Torque Compare Error Secondary E-Maschine Level / Status Error Lock" UBYTE OneToOne 1 100 0.00 255.0 FORMAT "%5.1" ECU_ADDRESS 0x6002CA14
 /begin IF_DATA XCPplus 0x0102
  /begin DAQ_EVENT VARIABLE /end DAQ_EVENT
 /end IF_DATA
/end MEASUREMENT
/begin MEASUREMENT MoFErrHndlg_Reactn_Cls_SecEmComp_I.MoFErrHndlg_stErrReac "Class Instance Torque Compare Error Secondary E-Maschine Level / Status Error Reaction" UBYTE OneToOne 1 100 0.00 255.0 FORMAT "%5.1" ECU_ADDRESS 0x6002CA15
 /begin IF_DATA XCPplus 0x0102
  /begin DAQ_EVENT VARIABLE /end DAQ_EVENT
 /end IF_DATA
/end MEASUREMENT
/begin MEASUREMENT MoFErrHndlg_Reactn_Cls_SecEmSignCompCpl_I.MoFErrHndlg_stErrLockRlsCpl "Complement for MoFErrHndlg_Reactn_Cls_SecEmSignComp_I / Cpl MoFErrHndlg_stErrLockRls" UBYTE OneToOne 1 100 0.00 255.0 FORMAT "%5.1" ECU_ADDRESS 0x6002BFBA
 /begin IF_DATA XCPplus 0x0102
  /begin DAQ_EVENT VARIABLE /end DAQ_EVENT
 /end IF_DATA
/end MEASUREMENT
/begin MEASUREMENT MoFErrHndlg_Reactn_Cls_SecEmSignCompCpl_I.MoFErrHndlg_stErrReacCpl "Complement for MoFErrHndlg_Reactn_Cls_SecEmSignComp_I / Cpl MoFErrHndlg_stErrReac" UBYTE OneToOne 1 100 0.00 255.0 FORMAT "%5.1" ECU_ADDRESS 0x6002BFBB
 /begin IF_DATA XCPplus 0x0102
  /begin DAQ_EVENT VARIABLE /end DAQ_EVENT
 /end IF_DATA
/end MEASUREMENT
/begin MEASUREMENT MoFErrHndlg_Reactn_Cls_SecEmSignComp_I.MoFErrHndlg_stErrLockRls "Class Instance Torque Secondary Sign Error / Status Error Lock" UBYTE OneToOne 1 100 0.00 255.0 FORMAT "%5.1" ECU_ADDRESS 0x6002CA12
 /begin IF_DATA XCPplus 0x0102
  /begin DAQ_EVENT VARIABLE /end DAQ_EVENT
 /end IF_DATA
/end MEASUREMENT
/begin MEASUREMENT MoFErrHndlg_Reactn_Cls_SecEmSignComp_I.MoFErrHndlg_stErrReac "Class Instance Torque Secondary Sign Error / Status Error Reaction" UBYTE OneToOne 1 100 0.00 255.0 FORMAT "%5.1" ECU_ADDRESS 0x6002CA13
 /begin IF_DATA XCPplus 0x0102
  /begin DAQ_EVENT VARIABLE /end DAQ_EVENT
 /end IF_DATA
/end MEASUREMENT
/begin MEASUREMENT MoFErrHndlg_Reactn_Cls_SecPtRelsCpl_I.MoFErrHndlg_stErrLockRlsCpl "Complement for MoFErrHndlg_Reactn_Cls_SecPtRels_I / Cpl MoFErrHndlg_stErrLockRls" UBYTE OneToOne 1 100 0.00 255.0 FORMAT "%5.1" ECU_ADDRESS 0x6002BFB8
 /begin IF_DATA XCPplus 0x0102
  /begin DAQ_EVENT VARIABLE /end DAQ_EVENT
 /end IF_DATA
/end MEASUREMENT
/begin MEASUREMENT MoFErrHndlg_Reactn_Cls_SecPtRelsCpl_I.MoFErrHndlg_stErrReacCpl "Complement for MoFErrHndlg_Reactn_Cls_SecPtRels_I / Cpl MoFErrHndlg_stErrReac" UBYTE OneToOne 1 100 0.00 255.0 FORMAT "%5.1" ECU_ADDRESS 0x6002BFB9
 /begin IF_DATA XCPplus 0x0102
  /begin DAQ_EVENT VARIABLE /end DAQ_EVENT
 /end IF_DATA
/end MEASUREMENT
/begin MEASUREMENT MoFErrHndlg_Reactn_Cls_SecPtRels_I.MoFErrHndlg_stErrLockRls "Class Instance Secondary Power Train Release Error / Status Error Lock" UBYTE OneToOne 1 100 0.00 255.0 FORMAT "%5.1" ECU_ADDRESS 0x6002CA10
 /begin IF_DATA XCPplus 0x0102
  /begin DAQ_EVENT VARIABLE /end DAQ_EVENT
 /end IF_DATA
/end MEASUREMENT
/begin MEASUREMENT MoFErrHndlg_Reactn_Cls_SecPtRels_I.MoFErrHndlg_stErrReac "Class Instance Secondary Power Train Release Error / Status Error Reaction" UBYTE OneToOne 1 100 0.00 255.0 FORMAT "%5.1" ECU_ADDRESS 0x6002CA11
 /begin IF_DATA XCPplus 0x0102
  /begin DAQ_EVENT VARIABLE /end DAQ_EVENT
 /end IF_DATA
/end MEASUREMENT
/begin MEASUREMENT MoFErrHndlg_Reactn_Cls_VehCompCpl_I.MoFErrHndlg_stErrLockRlsCpl "Cpl MoFErrHndlg_Reactn_Cls_VehComp_I / Cpl MoFErrHndlg_stErrLockRls" UBYTE OneToOne 1 100 0.00 255.0 FORMAT "%5.1" ECU_ADDRESS 0x6002BFB6
 /begin IF_DATA XCPplus 0x0102
  /begin DAQ_EVENT VARIABLE /end DAQ_EVENT
 /end IF_DATA
/end MEASUREMENT
/begin MEASUREMENT MoFErrHndlg_Reactn_Cls_VehCompCpl_I.MoFErrHndlg_stErrReacCpl "Cpl MoFErrHndlg_Reactn_Cls_VehComp_I / Cpl MoFErrHndlg_stErrReac" UBYTE OneToOne 1 100 0.00 255.0 FORMAT "%5.1" ECU_ADDRESS 0x6002BFB7
 /begin IF_DATA XCPplus 0x0102
  /begin DAQ_EVENT VARIABLE /end DAQ_EVENT
 /end IF_DATA
/end MEASUREMENT
/begin MEASUREMENT MoFErrHndlg_Reactn_Cls_VehComp_I.MoFErrHndlg_stErrLockRls "Class Instance Torque Compare Error Vehicle Level / Status Error Lock" UBYTE OneToOne 1 100 0.00 255.0 FORMAT "%5.1" ECU_ADDRESS 0x6002CA0E
 /begin IF_DATA XCPplus 0x0102
  /begin DAQ_EVENT VARIABLE /end DAQ_EVENT
 /end IF_DATA
/end MEASUREMENT
/begin MEASUREMENT MoFErrHndlg_Reactn_Cls_VehComp_I.MoFErrHndlg_stErrReac "Class Instance Torque Compare Error Vehicle Level / Status Error Reaction" UBYTE OneToOne 1 100 0.00 255.0 FORMAT "%5.1" ECU_ADDRESS 0x6002CA0F
 /begin IF_DATA XCPplus 0x0102
  /begin DAQ_EVENT VARIABLE /end DAQ_EVENT
 /end IF_DATA
/end MEASUREMENT
/begin MEASUREMENT MoFErrHndlg_stErrReactn "Status of Error Reaction" UBYTE OneToOne 1 100 0.00 255.0 FORMAT "%5.1" ECU_ADDRESS 0x6002CA27
 /begin IF_DATA XCPplus 0x0102
  /begin DAQ_EVENT VARIABLE /end DAQ_EVENT
 /end IF_DATA
/end MEASUREMENT
/begin MEASUREMENT MoFErrHndlg_stErrReactnCpl "Cpl of Status Error Reaction" UBYTE OneToOne 1 100 0.00 255.0 FORMAT "%5.1" ECU_ADDRESS 0x6002BFCF
 /begin IF_DATA XCPplus 0x0102
  /begin DAQ_EVENT VARIABLE /end DAQ_EVENT
 /end IF_DATA
/end MEASUREMENT
/begin MEASUREMENT MoFErrHndlg_stErrReactnMsg "global Error State of L2 to L1" UBYTE OneToOne 1 100 0.00 255.0 FORMAT "%5.1" ECU_ADDRESS 0x6002352A
 /begin IF_DATA XCPplus 0x0102
  /begin DAQ_EVENT VARIABLE /end DAQ_EVENT
 /end IF_DATA
/end MEASUREMENT
/begin MEASUREMENT MoFErrHndlg_stErrReactnTmp "status of error reaction" UBYTE OneToOne 1 100 0.00 255.0 FORMAT "%5.1" ECU_ADDRESS 0x6002CA26
 /begin IF_DATA XCPplus 0x0102
  /begin DAQ_EVENT VARIABLE /end DAQ_EVENT
 /end IF_DATA
/end MEASUREMENT
/begin MEASUREMENT MoFErrHndlg_stErrReactnTmpCpl "complement for status of error reaction" UBYTE OneToOne 1 100 0.00 255.0 FORMAT "%5.1" ECU_ADDRESS 0x6002BFCE
 /begin IF_DATA XCPplus 0x0102
  /begin DAQ_EVENT VARIABLE /end DAQ_EVENT
 /end IF_DATA
/end MEASUREMENT
/begin MEASUREMENT MoFEscAsscEsc_bbLoc1Cpl "complement byte for gahtering the local bits in MoFEscAssc_Esc" UBYTE OneToOne 1 100 0.00 255.0 FORMAT "%5.1" ECU_ADDRESS 0x6002BFB5
 /begin IF_DATA XCPplus 0x0102
  /begin DAQ_EVENT VARIABLE /end DAQ_EVENT
 /end IF_DATA
/end MEASUREMENT
/begin MEASUREMENT MoFEscAsscEsc_bbOut1Cpl "complement byte of complement check byte for exported bits" UBYTE OneToOne 1 100 0.00 255.0 FORMAT "%5.1" ECU_ADDRESS 0x6002BFB4
 /begin IF_DATA XCPplus 0x0102
  /begin DAQ_EVENT VARIABLE /end DAQ_EVENT
 /end IF_DATA
/end MEASUREMENT
/begin MEASUREMENT MoFEscAssc_flgCANErr "CAN error flag for EM01 From ESC" UBYTE B_TRUE 1 100 0.00 1.00000000000 BIT_MASK 0x1 FORMAT "%13.11" ECU_ADDRESS 0x6002CA0D
 /begin IF_DATA XCPplus 0x0102
  /begin DAQ_EVENT VARIABLE /end DAQ_EVENT
 /end IF_DATA
/end MEASUREMENT
/begin MEASUREMENT MoFEscAssc_flgEM02CANErr "CAN error flag for EM02 From ESC" UBYTE B_TRUE 1 100 0.00 1.00000000000 BIT_MASK 0x2 FORMAT "%13.11" ECU_ADDRESS 0x6002CA0D
 /begin IF_DATA XCPplus 0x0102
  /begin DAQ_EVENT VARIABLE /end DAQ_EVENT
 /end IF_DATA
/end MEASUREMENT
/begin MEASUREMENT MoFEscAssc_flgEscCANErr "flag to indicate CAN transmision error for ESC intervention" UBYTE B_TRUE 1 100 0.00 1.00000000000 BIT_MASK 0x1 FORMAT "%13.11" ECU_ADDRESS 0x6002CA0C
 /begin IF_DATA XCPplus 0x0102
  /begin DAQ_EVENT VARIABLE /end DAQ_EVENT
 /end IF_DATA
/end MEASUREMENT
/begin MEASUREMENT MoFEscAssc_flgEscDCSPtd01Msg "Message to Level 1: DCS-Intervention from ESC permitted" UBYTE B_TRUE 1 100 0.00 1.00000000000 BIT_MASK 0x1 FORMAT "%13.11" ECU_ADDRESS 0x70000248
 /begin IF_DATA XCPplus 0x0102
  /begin DAQ_EVENT VARIABLE /end DAQ_EVENT
 /end IF_DATA
/end MEASUREMENT
/begin MEASUREMENT MoFEscAssc_flgEscDCSPtd02Msg "Message to Level 1: DCS-Intervention from ESC permitted" UBYTE B_TRUE 1 100 0.00 1.00000000000 BIT_MASK 0x1 FORMAT "%13.11" ECU_ADDRESS 0x70000247
 /begin IF_DATA XCPplus 0x0102
  /begin DAQ_EVENT VARIABLE /end DAQ_EVENT
 /end IF_DATA
/end MEASUREMENT
/begin MEASUREMENT MoFEscAssc_flgEscEM02MsgErr "message error flag of ESC for secondary axle" UBYTE B_TRUE 1 100 0.00 1.00000000000 BIT_MASK 0x4 FORMAT "%13.11" ECU_ADDRESS 0x6002CA0D
 /begin IF_DATA XCPplus 0x0102
  /begin DAQ_EVENT VARIABLE /end DAQ_EVENT
 /end IF_DATA
/end MEASUREMENT
/begin MEASUREMENT MoFEscAssc_flgEscMsgErr "message error flag of ESC for Primary axle" UBYTE B_TRUE 1 100 0.00 1.00000000000 BIT_MASK 0x8 FORMAT "%13.11" ECU_ADDRESS 0x6002CA0D
 /begin IF_DATA XCPplus 0x0102
  /begin DAQ_EVENT VARIABLE /end DAQ_EVENT
 /end IF_DATA
/end MEASUREMENT
/begin MEASUREMENT MoFEscAssc_flgEscTCSPtd01Msg "Message to Level 1: TCS-Intervention from ESC permitted" UBYTE B_TRUE 1 100 0.00 1.00000000000 BIT_MASK 0x1 FORMAT "%13.11" ECU_ADDRESS 0x70000246
 /begin IF_DATA XCPplus 0x0102
  /begin DAQ_EVENT VARIABLE /end DAQ_EVENT
 /end IF_DATA
/end MEASUREMENT
/begin MEASUREMENT MoFEscAssc_flgEscTCSPtd02Msg "Message to Level 1: TCS-Intervention from ESC permitted" UBYTE B_TRUE 1 100 0.00 1.00000000000 BIT_MASK 0x1 FORMAT "%13.11" ECU_ADDRESS 0x70000245
 /begin IF_DATA XCPplus 0x0102
  /begin DAQ_EVENT VARIABLE /end DAQ_EVENT
 /end IF_DATA
/end MEASUREMENT
/begin MEASUREMENT MoFEscAssc_tqDecCalcd "decreasing ESC torque" SLONG TrqPrpHigh 1 100 -214748364.800 214748364.700 FORMAT "%13.3" ECU_ADDRESS 0x6002CA08
 /begin IF_DATA XCPplus 0x0102
  /begin DAQ_EVENT VARIABLE /end DAQ_EVENT
 /end IF_DATA
/end MEASUREMENT
/begin MEASUREMENT MoFEscAssc_tqDecCalcdCpl "complement of decreasing ESC torque" ULONG OneToOne 1 100 0.00 4294967295.00 FORMAT "%13.2" ECU_ADDRESS 0x6002BFB0
 /begin IF_DATA XCPplus 0x0102
  /begin DAQ_EVENT VARIABLE /end DAQ_EVENT
 /end IF_DATA
/end MEASUREMENT
/begin MEASUREMENT MoFEscAssc_tqDecCalcdEM02 "decreasing ESC torque for secondary axle" SLONG TrqPrpHigh 1 100 -214748364.800 214748364.700 FORMAT "%13.3" ECU_ADDRESS 0x6002CA04
 /begin IF_DATA XCPplus 0x0102
  /begin DAQ_EVENT VARIABLE /end DAQ_EVENT
 /end IF_DATA
/end MEASUREMENT
/begin MEASUREMENT MoFEscAssc_tqDecCalcdEM02Cpl "complement decreasing ESC torque for secondary axle" ULONG OneToOne 1 100 0.00 4294967295.00 FORMAT "%13.2" ECU_ADDRESS 0x6002BFAC
 /begin IF_DATA XCPplus 0x0102
  /begin DAQ_EVENT VARIABLE /end DAQ_EVENT
 /end IF_DATA
/end MEASUREMENT
/begin MEASUREMENT MoFEscAssc_tqEscDCS01 "DCS Torque Request from Esc for EM01 in function monitoring" SLONG TrqPrpHigh 1 100 -214748364.800 214748364.700 FORMAT "%13.3" ECU_ADDRESS 0x6002C9F8
 /begin IF_DATA XCPplus 0x0102
  /begin DAQ_EVENT VARIABLE /end DAQ_EVENT
 /end IF_DATA
/end MEASUREMENT
/begin MEASUREMENT MoFEscAssc_tqEscDCS01Cpl "RAM data redundancy of MoFEscAssc_tqEscDCS01" ULONG OneToOne 1 100 0.00 4294967295.00 FORMAT "%13.2" ECU_ADDRESS 0x6002BFA8
 /begin IF_DATA XCPplus 0x0102
  /begin DAQ_EVENT VARIABLE /end DAQ_EVENT
 /end IF_DATA
/end MEASUREMENT
/begin MEASUREMENT MoFEscAssc_tqEscDCS02 "DCS Torque Request from Esc for EM02 in function monitoring" SLONG TrqPrpHigh 1 100 -214748364.800 214748364.700 FORMAT "%13.3" ECU_ADDRESS 0x6002C9F4
 /begin IF_DATA XCPplus 0x0102
  /begin DAQ_EVENT VARIABLE /end DAQ_EVENT
 /end IF_DATA
/end MEASUREMENT
/begin MEASUREMENT MoFEscAssc_tqEscDCS02Cpl "RAM data redundancy of MoFEscAssc_tqEscDCS02" ULONG OneToOne 1 100 0.00 4294967295.00 FORMAT "%13.2" ECU_ADDRESS 0x6002BFA4
 /begin IF_DATA XCPplus 0x0102
  /begin DAQ_EVENT VARIABLE /end DAQ_EVENT
 /end IF_DATA
/end MEASUREMENT
/begin MEASUREMENT MoFEscAssc_tqEscTCS01 "TCS Torque Request from Esc for EM01 in function monitoring" SLONG TrqPrpHigh 1 100 -214748364.800 214748364.700 FORMAT "%13.3" ECU_ADDRESS 0x6002C9F0
 /begin IF_DATA XCPplus 0x0102
  /begin DAQ_EVENT VARIABLE /end DAQ_EVENT
 /end IF_DATA
/end MEASUREMENT
/begin MEASUREMENT MoFEscAssc_tqEscTCS01Cpl "RAM data redundancy of MoFEscAssc_tqEscTCS01" ULONG OneToOne 1 100 0.00 4294967295.00 FORMAT "%13.2" ECU_ADDRESS 0x6002BFA0
 /begin IF_DATA XCPplus 0x0102
  /begin DAQ_EVENT VARIABLE /end DAQ_EVENT
 /end IF_DATA
/end MEASUREMENT
/begin MEASUREMENT MoFEscAssc_tqEscTCS02 "TCS Torque Request from Esc for EM02 in function monitoring" SLONG TrqPrpHigh 1 100 -214748364.800 214748364.700 FORMAT "%13.3" ECU_ADDRESS 0x6002C9EC
 /begin IF_DATA XCPplus 0x0102
  /begin DAQ_EVENT VARIABLE /end DAQ_EVENT
 /end IF_DATA
/end MEASUREMENT
/begin MEASUREMENT MoFEscAssc_tqEscTCS02Cpl "RAM data redundancy of MoFEscAssc_tqEscTCS02" ULONG OneToOne 1 100 0.00 4294967295.00 FORMAT "%13.2" ECU_ADDRESS 0x6002BF9C
 /begin IF_DATA XCPplus 0x0102
  /begin DAQ_EVENT VARIABLE /end DAQ_EVENT
 /end IF_DATA
/end MEASUREMENT
/begin MEASUREMENT MoFEscAssc_tqIncCalcd "increasing ESC torque" SLONG TrqPrpHigh 1 100 -214748364.800 214748364.700 FORMAT "%13.3" ECU_ADDRESS 0x6002CA00
 /begin IF_DATA XCPplus 0x0102
  /begin DAQ_EVENT VARIABLE /end DAQ_EVENT
 /end IF_DATA
/end MEASUREMENT
/begin MEASUREMENT MoFEscAssc_tqIncCalcdCpl "complement of increasing ESC torque" ULONG OneToOne 1 100 0.00 4294967295.00 FORMAT "%13.2" ECU_ADDRESS 0x6002BF98
 /begin IF_DATA XCPplus 0x0102
  /begin DAQ_EVENT VARIABLE /end DAQ_EVENT
 /end IF_DATA
/end MEASUREMENT
/begin MEASUREMENT MoFEscAssc_tqIncCalcdEM02 "increasing ESC torque for secondary axle" SLONG TrqPrpHigh 1 100 -214748364.800 214748364.700 FORMAT "%13.3" ECU_ADDRESS 0x6002C9FC
 /begin IF_DATA XCPplus 0x0102
  /begin DAQ_EVENT VARIABLE /end DAQ_EVENT
 /end IF_DATA
/end MEASUREMENT
/begin MEASUREMENT MoFEscAssc_tqIncCalcdEM02Cpl "complement increasing ESC torque for secondary axle" ULONG OneToOne 1 100 0.00 4294967295.00 FORMAT "%13.2" ECU_ADDRESS 0x6002BF94
 /begin IF_DATA XCPplus 0x0102
  /begin DAQ_EVENT VARIABLE /end DAQ_EVENT
 /end IF_DATA
/end MEASUREMENT
/begin MEASUREMENT MonVehV_stSpdQlfr "Vehicle Velocity Qualifier" UWORD OneToOne 1 100 0.00 65535.00 FORMAT "%8.2" ECU_ADDRESS 0x6002CA7A
 /begin IF_DATA XCPplus 0x0102
  /begin DAQ_EVENT VARIABLE /end DAQ_EVENT
 /end IF_DATA
/end MEASUREMENT
/begin MEASUREMENT MonVehV_stSpdQlfrCpl "Compliment of MonVehv_stSpdQlfr" UWORD OneToOne 1 100 0.00 65535.00 FORMAT "%8.2" ECU_ADDRESS 0x6002C016
 /begin IF_DATA XCPplus 0x0102
  /begin DAQ_EVENT VARIABLE /end DAQ_EVENT
 /end IF_DATA
/end MEASUREMENT
/begin MEASUREMENT MonVehV_vSpd "Vehicle Velocity" SWORD Vel 1 100 -327.6800 327.6700 FORMAT "%8.4" ECU_ADDRESS 0x6002CA78
 /begin IF_DATA XCPplus 0x0102
  /begin DAQ_EVENT VARIABLE /end DAQ_EVENT
 /end IF_DATA
/end MEASUREMENT
/begin MEASUREMENT MonVehV_vSpdCpl "Compliment of MonVehV_vSpd" UWORD OneToOne 1 100 0.00 65535.00 FORMAT "%8.2" ECU_ADDRESS 0x6002C014
 /begin IF_DATA XCPplus 0x0102
  /begin DAQ_EVENT VARIABLE /end DAQ_EVENT
 /end IF_DATA
/end MEASUREMENT
/begin MEASUREMENT Mo_flgIrrvErrSOPMsg "Irreversible error bit of shut-off path test" UBYTE B_TRUE 1 100 0.00 1.00000000000 BIT_MASK 0x1 FORMAT "%13.11" ECU_ADDRESS 0x60023887
 /begin IF_DATA XCPplus 0x0102
  /begin DAQ_EVENT VARIABLE /end DAQ_EVENT
 /end IF_DATA
/end MEASUREMENT
/begin FUNCTION MoCSOP_Co "81.29.0   Microcontroller Monitoring: Shut-off path test"
 /begin DEF_CHARACTERISTIC DFC_CtlMsk2.DFC_MoCSOPICO_C DFC_DisblMsk2.DFC_MoCSOPICO_C MoCSOP_cntrDebCtrlLinesActvThd_C MoCSOP_cntrFrMacroTicEnd_C MoCSOP_cntrFrMacroTicStrt_C MoCSOP_ctDebCANFrTest_C MoCSOP_ctDebSOPTst_C MoCSOP_ctDebSycDrv_C MoCSOP_ctRstCANFrTest_C MoCSOP_ctRst_C MoCSOP_nEngMaxOVLthDisbl_C MoCSOP_stCANErrReac_CW MoCSOP_stCANTestActv_CW MoCSOP_stErrReactnERPN_CA MoCSOP_stErrReactn_CA MoCSOP_stMMErrReac_CW MoCSOP_stOVErrReactn_C MoCSOP_stReqCANFrTest_C MoCSOP_stSWResetDem_CW MoCSOP_stTestActv_CW MoCSOP_swtAlwysPsTest_C MoCSOP_swtRepFaildPESTest_C /end DEF_CHARACTERISTIC
 /begin IN_MEASUREMENT Epm_nEng MoGlbl_vblStructCpl.Mo_stCplChk MoGlbl_vblStructCpl.Mo_stMoCCpl Mo_stMoF Mo_stMoFCpl T15_st /end IN_MEASUREMENT
 /begin OUT_MEASUREMENT DFC_st.DFC_MoCSOPICO MoCSOP_ctErrMM MoCSOP_st MoCSOP_stActMsg MoCSOP_stActvMsg MoCSOP_stCANFrTest MoCSOP_stComActv MoCSOP_stComActvCpl MoCSOP_stOvl MoCSOP_stRdy MoCSOP_stRdyCan MoCSOP_stRdyCpl MoCSOP_stRdyFr MoCSOP_stRdyInj MoCSOP_stRdyMsg /end OUT_MEASUREMENT
 /begin LOC_MEASUREMENT MoCSOP_cntrDebErrPinActv MoCSOP_cntrDebErrPinActvCpl MoCSOP_cntrDebExtErrPinEveActv MoCSOP_cntrDebExtErrPinEveActvCpl MoCSOP_cntrDebExtErrPinEveActv_MP MoCSOP_cntrDebSycDrv MoCSOP_cntrDebSycDrvCpl MoCSOP_cntrSignalSwtDelay MoCSOP_cntrSignalSwtDelayCpl MoCSOP_ctBusErr MoCSOP_ctBusErr_MP MoCSOP_ctCANFrIdx MoCSOP_ctDebCANFrTest MoCSOP_ctDebCANFrTestCpl MoCSOP_ctDebSOPTst MoCSOP_ctDebSOPTstCpl MoCSOP_ctErrMM_mp MoCSOP_ctErrOSTimeout MoCSOP_ctIdx MoCSOP_ctRespOffsetTst MoCSOP_ctRst MoCSOP_ctRstCANFrTest MoCSOP_ctRstCANFrTestCpl MoCSOP_ctRstCpl MoCSOP_flgErrPinActvd MoCSOP_flgErrPinActvdCpl MoCSOP_flgReqSOPTest MoCSOP_flgReqSOPTestCpl MoCSOP_flgT15RisngEdge MoCSOP_flgT15RisngEdgeCpl MoCSOP_stBusErr MoCSOP_stBusErr_MP MoCSOP_stCANFrTestCpl MoCSOP_stCANFrTestErr MoCSOP_stCANFrTestErrReas MoCSOP_stCANFrTestErrReasCpl MoCSOP_stCANFrTestState MoCSOP_stCANFrTestStateCpl MoCSOP_stCanTdi MoCSOP_stCANTestState_mp MoCSOP_stCheckState MoCSOP_stCheckStateCpl MoCSOP_stCheckState_mp MoCSOP_stComTrcvOld MoCSOP_stCpl MoCSOP_stDia MoCSOP_stDiaCpl MoCSOP_stDiaERPN MoCSOP_stDiaERPNCpl MoCSOP_stEmmState_MP MoCSOP_stErr MoCSOP_stErrPinActvnReq MoCSOP_stErrPin_MP MoCSOP_stErrReactn MoCSOP_stErrReactnERPN MoCSOP_stInhbStrtCdn MoCSOP_stOvlCpl MoCSOP_stOVTstStatusEval MoCSOP_stOVTstStatusEvalCpl MoCSOP_stPVMTUnderTest MoCSOP_stRdyCanCpl MoCSOP_stRdyFrCpl MoCSOP_stRdyInjCpl MoCSOP_stReqPSStatus MoCSOP_stReqPSStatusBusErr MoCSOP_stReqSOPTest MoCSOP_stReqSOPTestCpl MoCSOP_stT15Old MoCSOP_stT15OldCpl MoCSOP_tiCanTest_MP Mo_flgIrrvErrSOPMsg /end LOC_MEASUREMENT
 FUNCTION_VERSION "81.29.0" /end FUNCTION
/begin FUNCTION MoExe_Co "749.3.0   Monitoring: Execution control" /begin OUT_MEASUREMENT MoExe_ctCyc MoExe_ctCycCpl /end OUT_MEASUREMENT FUNCTION_VERSION "749.3.0" /end FUNCTION
/begin FUNCTION MoFAccr_BrkPlaus "5.1.0     Function monitoring Accelerator brake plausibilization"
 /begin DEF_CHARACTERISTIC MoFAccr_drLimPos_C MoFAccr_rLnrAlgnmnt_T MoFAccr_swtL1AlgnmntActv_C /end DEF_CHARACTERISTIC
 /begin IN_MEASUREMENT APP_bPlaBrk APP_r MoFAccr_rLnr MoFAccr_stSigSrc MoFBas_vVehSignd MoFTqPtdVeh_ratVirtZrPnt Mo_stCplChk Mo_stMoC Mo_stMoCCpl /end IN_MEASUREMENT
 /begin OUT_MEASUREMENT MoFAccr_ratAccr /end OUT_MEASUREMENT
 /begin LOC_MEASUREMENT MoFAccrBrkPlaus_bbLoc2Cpl MoFAccr_flgBrkOvrdAccrFallEdge MoFAccr_flgBrkOvrdAccrPrev MoFAccr_flgrPosRmp MoFAccr_ratAccrCpl MoFAccr_rLnrUnAlgnd MoFAccr_rLnrUnAlgndCpl MoFAccr_strPosRmp MoFAccr_strPosRmpCpl /end LOC_MEASUREMENT
 FUNCTION_VERSION "5.1.0" /end FUNCTION
/begin FUNCTION MoFAccr_Inp "12.0.1    Function monitoring Accelerator pedal position"
 /begin DEF_CHARACTERISTIC DFC_CtlMsk2.DFC_MoFAccr_C DFC_DisblMsk2.DFC_MoFAccr_C MoFAccr_cntrDeb_C MoFAccr_cntrTestAccr_C MoFAccr_swtMinSel_C MoFAccr_swtPedlSeln_C MoFAccr_uAccr1SrcMax_C MoFAccr_uAccr1SrcMin_C MoFAccr_uAccr2SrcMax_C MoFAccr_uAccr2SrcMin_C MoFAccr_uAccrMaxLimp_C MoFAccr_uAccrMax_C MoFAccr_uAccrMinLimp_C MoFAccr_uAccrMin_C MoFAccr_uFullLoad_C MoFAccr_uLoLim_C MoFAccr_uMaxDiffFullLoad_C MoFAccr_uMaxDiffPtlLoad_C MoFAccr_uVirtZrPntLimpOffs_C /end DEF_CHARACTERISTIC
 /begin IN_MEASUREMENT APP_stSigSrc MoCADC_bDef MoCADC_bNTPActv MoFBrk_flgBrkPsblPsd MoFTqPtdVeh_ratVirtZrPnt Mo_stCplChk Mo_stMoC Mo_stMoCCpl /end IN_MEASUREMENT
 /begin OUT_MEASUREMENT DFC_st.DFC_MoFAccr MoFAccr_flgIrrvErrMsg MoFAccr_flgTestMsg MoFAccr_stAccrMsg MoFAccr_stErrInp MoFAccr_stLimpMsg MoFAccr_stSigSrc MoFAccr_uAccr MoFAPP_stAPPMsg /end OUT_MEASUREMENT
 /begin LOC_MEASUREMENT MoFAccrInp_bbLocCpl MoFAccr_cntrDeb MoFAccr_cntrDebCpl MoFAccr_cntrTestAccr MoFAccr_flgAdcErr1 MoFAccr_flgAdcErr2 MoFAccr_flgClr MoFAccr_flgExtErr MoFAccr_flgNTPRel MoFAccr_flgPlausErr MoFAccr_flgSigRngChkErr MoFAccr_flgSyncnChkErr MoFAccr_stErrInpCpl MoFAccr_stSigSrcCpl MoFAccr_uAccr1 MoFAccr_uAccr1Cpl MoFAccr_uAccr2 MoFAccr_uAccr2Cpl MoFAccr_uAccrCpl MoFAccr_uVirtZrPnt MoFAccr_uVirtZrPntCpl /end LOC_MEASUREMENT
 FUNCTION_VERSION "12.0.1" /end FUNCTION
/begin FUNCTION MoFAccr_Rat "5.1.0     Function monitoring Relative accelerator pedal position" /begin DEF_CHARACTERISTIC MoFAccr_drLimpMax_C MoFAccr_rAccrMaxLimp_C /end DEF_CHARACTERISTIC
 /begin REF_CHARACTERISTIC MoFAccr_uAccrMaxLimp_C MoFAccr_uAccrMax_C MoFAccr_uAccrMinLimp_C MoFAccr_uAccrMin_C /end REF_CHARACTERISTIC
 /begin IN_MEASUREMENT MoFAccr_stSigSrc MoFAccr_uAccr Mo_stCplChk Mo_stMoC Mo_stMoCCpl /end IN_MEASUREMENT
 /begin OUT_MEASUREMENT MoFAccr_rLnr MoFAccr_rLnrUnfild /end OUT_MEASUREMENT
 /begin LOC_MEASUREMENT MoFAccr_rLnrCpl MoFAccr_rLnrUnfildCpl /end LOC_MEASUREMENT
 FUNCTION_VERSION "5.1.0" /end FUNCTION
/begin FUNCTION MoFBas_Inp "6.3.0     Function monitoring Input signals" /begin DEF_CHARACTERISTIC MoFBas_stActvCrash_C /end DEF_CHARACTERISTIC /begin IN_MEASUREMENT Mo_stCplChk Mo_stMoC Mo_stMoCCpl T15_st T50_st /end IN_MEASUREMENT
 /begin OUT_MEASUREMENT MoFBas_flgT15 MoFBas_flgT50 MoFBas_frqCrash MoFBas_ratPwmCrash /end OUT_MEASUREMENT
 /begin LOC_MEASUREMENT MoFBasInp_bbOutCpl MoFBas_frqCrashCpl MoFBas_numCrashCalcdChks MoFBas_numCrashChks MoFBas_ratPwmCrashCpl MoFBas_stCrashSig /end LOC_MEASUREMENT
 FUNCTION_VERSION "6.3.0" /end FUNCTION
/begin FUNCTION MoFBas_VehSpd "15.0.0    Function monitoring Vehicle speed"
 /begin DEF_CHARACTERISTIC MoFBas_flgFwdMntdMot_C MoFBas_flgVehSpdSrcSeln_C MoFBas_lenWhlCircum_C MoFBas_ratSecTqTot_C MoFBas_ratTqTot_C MoFBas_tiVPT1_C MoFBas_vVehDfctVal_C MoFBas_vVehMax_C MoFBas_vVehMin_C MoFBas_vVehRawOffs_C /end DEF_CHARACTERISTIC
 /begin REF_CHARACTERISTIC MoFEvMngt_swtDiEM01_C MoFEvMngt_swtDiEM02_C /end REF_CHARACTERISTIC
 /begin IN_MEASUREMENT MoFEvMngt_nEmPhy01 MoFEvMngt_nEmPhy02 MoFEvMngt_stErrEmSig MoFEvMngt_stErrEmSig02 MoFFrm_vVeh MoFFrm_vVehQlfr Mo_stCplChk Mo_stMoC Mo_stMoCCpl VehV_vSign /end IN_MEASUREMENT
 /begin OUT_MEASUREMENT MoFBas_flgErrVSig MoFBas_vVeh MoFBas_vVehRaw MoFBas_vVehSignd MonVehV_stSpdQlfr MonVehV_vSpd /end OUT_MEASUREMENT
 /begin LOC_MEASUREMENT MoFBasVehSpd_bbOutCpl MoFBas_vVehCpl MoFBas_vVehRawAbs MoFBas_vVehRawAbsCpl MoFBas_vVehRawCpl MoFBas_vVehRawFltr MoFBas_vVehRawFltrCpl MoFBas_vVehRawMax MoFBas_vVehRawMaxCpl MoFBas_vVehRawMin MoFBas_vVehRawMinCpl MoFBas_vVehSigndCpl MoFBas_vVehSigndFltHi MoFBas_vVehSigndFltHiCpl MoFBas_vVehSigndFltLo MoFBas_vVehSigndFltLoCpl MonVehV_stSpdQlfrCpl MonVehV_vSpdCpl /end LOC_MEASUREMENT
 FUNCTION_VERSION "15.0.0" /end FUNCTION
/begin FUNCTION MoFBrk_Inp "21.2.0    Function monitoring Brake"
 /begin DEF_CHARACTERISTIC MoFBrk_cntrBrkErrDebHiLo_C MoFBrk_cntrBrkErrDebLoHi_C MoFBrk_cntrBrkRedDebHiLo_C MoFBrk_cntrBrkRedDebLoHi_C MoFBrk_flgBrkDfct_C /end DEF_CHARACTERISTIC
 /begin IN_MEASUREMENT MoFFrm_flgBrkRaw MoFFrm_flgBrkRawQlfr MoFFrm_stBrkQlyFacRaw Mo_stCplChk Mo_stMoC Mo_stMoCCpl /end IN_MEASUREMENT
 /begin OUT_MEASUREMENT MoFBrk_flgBrkApp MoFBrk_flgBrkErr MoFBrk_flgBrkMai MoFBrk_flgBrkPsblPsd MoFBrk_flgBrkPsd MoFBrk_flgBrkRdnt MoFBrk_flgBrkSafe /end OUT_MEASUREMENT
 /begin LOC_MEASUREMENT MoFBrkInp_bbLocCpl MoFBrkInp_bbOutCpl MoFBrk_cntrBrkErrDeb MoFBrk_cntrBrkErrDebCpl MoFBrk_cntrBrkRedDeb MoFBrk_cntrBrkRedDebCpl MoFBrk_flgBrkRdntDIO MoFBrk_flgCfmdAlvErr MoFBrk_flgCfmdChksErr MoFBrk_flgCfmdToutErr MoFBrk_flgTmpAlvFErr MoFBrk_flgTmpChksErr MoFBrk_flgTmpToutErr MoFBrk_stBrkErrDeb MoFBrk_stBrkErrDebCpl MoFBrk_stBrkRedDeb MoFBrk_stBrkRedDebCpl /end LOC_MEASUREMENT
 FUNCTION_VERSION "21.2.0" /end FUNCTION
/begin FUNCTION MoFCbnPreCdng_Co "14.0.0    Functional Safety: Cabin pre-conditioning."
 /begin DEF_CHARACTERISTIC DFC_CtlMsk2.DFC_MoFCbnPreCdngOvrheat_C DFC_CtlMsk2.DFC_MoFCbnPreCdngTmrExpi_C DFC_DisblMsk2.DFC_MoFCbnPreCdngOvrheat_C DFC_DisblMsk2.DFC_MoFCbnPreCdngTmrExpi_C MoFCbnPreCdng_cntrPreHeatDioFltCfm_C MoFCbnPreCdng_cntrPreHeatDioFltHeal_C MoFCbnPreCdng_cntrStopHeatrDeb_C MoFCbnPreCdng_cntrTmrExpiDeb_C MoFCbnPreCdng_DataDebErrReactn_I.cntErrDebMax_C MoFCbnPreCdng_DataDebErrReactn_I.stCfgErrHndlg_C MoFCbnPreCdng_DataDebErrReactn_I.stCfgErrReactn_C MoFCbnPreCdng_DataDebErrReactn_I_1.cntErrDebMax_C MoFCbnPreCdng_DataDebErrReactn_I_1.stCfgErrHndlg_C MoFCbnPreCdng_DataDebErrReactn_I_1.stCfgErrReactn_C MoFCbnPreCdng_DataDebErrReactn_I_2.cntErrDebMax_C MoFCbnPreCdng_DataDebErrReactn_I_2.stCfgErrHndlg_C MoFCbnPreCdng_DataDebErrReactn_I_2.stCfgErrReactn_C MoFCbnPreCdng_tmrPreHeatElpd_C /end DEF_CHARACTERISTIC
 /begin IN_MEASUREMENT MoFFrm_flgPreCdngWakeup Mo_stCplChk Mo_stMoC Mo_stMoCCpl /end IN_MEASUREMENT
 /begin OUT_MEASUREMENT DFC_st.DFC_MoFCbnPreCdngOvrheat DFC_st.DFC_MoFCbnPreCdngTmrExpi MoFCbnPreCdng_flgPreHeatCanCfmMsg MoFCbnPreCdng_flgPreHeatDioCfmMsg MoFCbnPreCdng_flgStopHeatr MoFCbnPreCdng_flgStopHeatrIrrvErrMsg /end OUT_MEASUREMENT
 /begin LOC_MEASUREMENT MoFCbnPreCdng_bbLocCpl MoFCbnPreCdng_bbOutCpl MoFCbnPreCdng_cntrPreHeatDio MoFCbnPreCdng_cntrPreHeatDioCpl MoFCbnPreCdng_cntrPreHeatInct MoFCbnPreCdng_cntrPreHeatInctCpl MoFCbnPreCdng_cntrStopHeatrDeb MoFCbnPreCdng_cntrTmrExpiDeb MoFCbnPreCdng_DataDebErrReactn_I.cntErrDeb MoFCbnPreCdng_DataDebErrReactn_I.cntErrDebCpl MoFCbnPreCdng_DataDebErrReactn_I.stErrDeb MoFCbnPreCdng_DataDebErrReactn_I.stErrDebCpl MoFCbnPreCdng_DataDebErrReactn_I.stErrLockRels MoFCbnPreCdng_DataDebErrReactn_I.stErrLockRelsCpl MoFCbnPreCdng_DataDebErrReactn_I.stErrReactn MoFCbnPreCdng_DataDebErrReactn_I_1.cntErrDeb MoFCbnPreCdng_DataDebErrReactn_I_1.cntErrDebCpl MoFCbnPreCdng_DataDebErrReactn_I_1.stErrDeb MoFCbnPreCdng_DataDebErrReactn_I_1.stErrDebCpl MoFCbnPreCdng_DataDebErrReactn_I_1.stErrLockRels MoFCbnPreCdng_DataDebErrReactn_I_1.stErrLockRelsCpl MoFCbnPreCdng_DataDebErrReactn_I_1.stErrReactn MoFCbnPreCdng_DataDebErrReactn_I_2.cntErrDeb MoFCbnPreCdng_DataDebErrReactn_I_2.cntErrDebCpl MoFCbnPreCdng_DataDebErrReactn_I_2.stErrDeb MoFCbnPreCdng_DataDebErrReactn_I_2.stErrDebCpl MoFCbnPreCdng_DataDebErrReactn_I_2.stErrLockRels MoFCbnPreCdng_DataDebErrReactn_I_2.stErrLockRelsCpl MoFCbnPreCdng_DataDebErrReactn_I_2.stErrReactn MoFCbnPreCdng_flgOvrheatClr MoFCbnPreCdng_flgPreHeatCanCfm MoFCbnPreCdng_flgPreHeatDioCfm MoFCbnPreCdng_flgPreHeatDioChk MoFCbnPreCdng_flgTmrExpiClr MoFCbnPreCdng_flgWakeupOld MoFCbnPreCdng_stPreHeatDioDeb MoFCbnPreCdng_stPreHeatDioDebCpl /end LOC_MEASUREMENT
 FUNCTION_VERSION "14.0.0" /end FUNCTION
/begin FUNCTION MoFDrvrAssc_CrsCtrl "4.1.0     Function monitoring Cruise control"
 /begin DEF_CHARACTERISTIC MoFDrvrAssc_cntrBrkDly_C MoFDrvrAssc_flgCrsCtrlEnad_C MoFDrvrAssc_tqPtdCrsCtrlLowrLim_T MoFDrvrAssc_tqPtdCrsCtrlUpprLim_T MoFDrvrAssc_vVehSpdThres_C /end DEF_CHARACTERISTIC
 /begin IN_MEASUREMENT CoVMD_stReqCrCtl CoVMD_trqCrCtl MoFBas_flgErrVSig MoFBas_vVehSignd MoFBrk_flgBrkErr MoFBrk_flgBrkMai MoFBrk_flgBrkRdnt Mo_stCplChk Mo_stMoC Mo_stMoCCpl /end IN_MEASUREMENT
 /begin OUT_MEASUREMENT MoFDrvrAssc_flgCrsCtrlActv MoFDrvrAssc_flgCrsCtrlPtdMsg MoFDrvrAssc_tqCrsCtrl /end OUT_MEASUREMENT
 /begin LOC_MEASUREMENT MoFDrvrAsscCrsCtrl_bbLocCpl MoFDrvrAsscCrsCtrl_bbOutCpl MoFDrvrAssc_cntrBrkDly MoFDrvrAssc_cntrBrkDlyCpl MoFDrvrAssc_flgBrkPsd MoFDrvrAssc_flgCrsCtrlOld MoFDrvrAssc_flgCrsCtrlRlsd MoFDrvrAssc_flgVehSpdRlsd MoFDrvrAssc_ptrSRFF MoFDrvrAssc_ptrSRFFCpl MoFDrvrAssc_tqCrsCtrlCpl MoFDrvrAssc_tqPtdCrsCtrlLowrLim MoFDrvrAssc_tqPtdCrsCtrlLowrLimCpl MoFDrvrAssc_tqPtdCrsCtrlUpprLim MoFDrvrAssc_tqPtdCrsCtrlUpprLimCpl /end LOC_MEASUREMENT
 FUNCTION_VERSION "4.1.0" /end FUNCTION
/begin FUNCTION MoFEmgyOff_Emac "8.2.0     Function Monitoring: Emergency off electric machine"
 /begin DEF_CHARACTERISTIC MoFEmgyOff_AcuFltSeln_C MoFEmgyOff_cntrCrashCANInvldDeb_C MoFEmgyOff_cntrMajorCrashCANRawDeb_C MoFEmgyOff_cntrMnrCrashCANRawDeb_C MoFEmgyOff_cntrNoCrashCANRawDeb_C MoFEmgyOff_frqCrashMax_C MoFEmgyOff_frqCrashMin_C MoFEmgyOff_ratPwmCrashMax_C MoFEmgyOff_ratPwmCrashMin_C MoFEmgyOff_ratPWMNoCrashMax_C MoFEmgyOff_ratPWMNoCrashMin_C MoFEmgyOff_stCrashUpd_C MoFEmgyOff_tiInvldDeb_C MoFEmgyOff_tiPWMCrashCfmdDeb_C MoFEmgyOff_tiPWMCrashRprtDeb_C MoFEmgyOff_tiT15On_C MoFEmgyOff_vVeh_C /end DEF_CHARACTERISTIC
 /begin IN_MEASUREMENT Airbg_stCrash MoFBas_flgT15 MoFBas_frqCrash MoFBas_ratPwmCrash MoFBas_vVeh MoFFrm_stCplCrash MoFFrm_stCrash Mo_stCplChk Mo_stMoC Mo_stMoCCpl SyC_stSub /end IN_MEASUREMENT
 /begin OUT_MEASUREMENT MoFEmgyOff_stActrTest MoFEmgyOff_stCrash MoFEmgyOff_stCrashMsg /end OUT_MEASUREMENT
 /begin LOC_MEASUREMENT MoFEmgyOffEmac_bbLoc1Cpl MoFEmgyOffEmac_bbLoc2Cpl MoFEmgyOff_cntrCrashCANInvldDeb MoFEmgyOff_cntrCrashCANInvldDebCpl MoFEmgyOff_cntrMajorCrashCanRawDeb MoFEmgyOff_cntrMajorCrashCanRawDebCpl MoFEmgyOff_cntrMnrCrashCanRawDeb MoFEmgyOff_cntrMnrCrashCanRawDebCpl MoFEmgyOff_cntrNoCrashCanRawDeb MoFEmgyOff_cntrNoCrashCanRawDebCpl MoFEmgyOff_flgCrashCANErr MoFEmgyOff_flgCrashInvldVal MoFEmgyOff_flgInvldLoc MoFEmgyOff_flgInvldLocDebd MoFEmgyOff_flgMajorCrash MoFEmgyOff_flgMnrCrash MoFEmgyOff_flgNoCrash MoFEmgyOff_flgOkLoc MoFEmgyOff_flgPwmCrash MoFEmgyOff_flgPWMCrashCfmd MoFEmgyOff_flgPWMCrashLocDebd MoFEmgyOff_flgPWMCrashRprt MoFEmgyOff_flgT15Old MoFEmgyOff_stActrTestCpl MoFEmgyOff_stCrashCANRawLstVld MoFEmgyOff_stCrashCANRawLstVldCpl MoFEmgyOff_stCrashCpl MoFEmgyOff_tiInvldDeb MoFEmgyOff_tiInvldDebCpl MoFEmgyOff_tiPWMCrashDeb MoFEmgyOff_tiPWMCrashDebCpl MoFEmgyOff_tiT15On MoFEmgyOff_tiT15OnCpl /end LOC_MEASUREMENT
 FUNCTION_VERSION "8.2.0" /end FUNCTION
/begin FUNCTION MoFErrHndlg_Lib "1.1.0     Functional Safety Library for Error Handling"
 /begin DEF_CHARACTERISTIC MoFErrHndlg_Lib_DataDebErrReactn_I.cntErrDebMax_C MoFErrHndlg_Lib_DataDebErrReactn_I.stCfgErrHndlg_C MoFErrHndlg_Lib_DataDebErrReactn_I.stCfgErrReactn_C MoFErrHndlg_Lib_DataDeb_I.cntErrDebMax_C MoFErrHndlg_Lib_DataErrReactn_I.stCfgErrHndlg_C MoFErrHndlg_Lib_DataErrReactn_I.stCfgErrReactn_C MoFErrHndlg_Lib_DataUpDwnDebErrReactn_I.cntErrDebMax_C MoFErrHndlg_Lib_DataUpDwnDebErrReactn_I.cntrErrDwnStepSize_C MoFErrHndlg_Lib_DataUpDwnDebErrReactn_I.cntrErrUpStepSize_C MoFErrHndlg_Lib_DataUpDwnDebErrReactn_I.stCfgErrHndlg_C MoFErrHndlg_Lib_DataUpDwnDebErrReactn_I.stCfgErrReactn_C MoFErrHndlg_Lib_DataUpDwnDeb_I.cntErrDebMax_C MoFErrHndlg_Lib_DataUpDwnDeb_I.cntrErrDwnStepSize_C MoFErrHndlg_Lib_DataUpDwnDeb_I.cntrErrUpStepSize_C /end DEF_CHARACTERISTIC
 /begin LOC_MEASUREMENT MoFErrHndlg_Lib_DataDebErrReactn_I.cntErrDeb MoFErrHndlg_Lib_DataDebErrReactn_I.cntErrDebCpl MoFErrHndlg_Lib_DataDebErrReactn_I.stErrDeb MoFErrHndlg_Lib_DataDebErrReactn_I.stErrDebCpl MoFErrHndlg_Lib_DataDebErrReactn_I.stErrLockRels MoFErrHndlg_Lib_DataDebErrReactn_I.stErrLockRelsCpl MoFErrHndlg_Lib_DataDebErrReactn_I.stErrReactn MoFErrHndlg_Lib_DataDeb_I.cntErrDeb MoFErrHndlg_Lib_DataDeb_I.cntErrDebCpl MoFErrHndlg_Lib_DataDeb_I.stErrDeb MoFErrHndlg_Lib_DataErrReactn_I.stErrLockRels MoFErrHndlg_Lib_DataErrReactn_I.stErrLockRelsCpl MoFErrHndlg_Lib_DataErrReactn_I.stErrReactn MoFErrHndlg_Lib_DataUpDwnDebErrReactn_I.cntErrDeb MoFErrHndlg_Lib_DataUpDwnDebErrReactn_I.cntErrDebCpl MoFErrHndlg_Lib_DataUpDwnDebErrReactn_I.stErrDeb MoFErrHndlg_Lib_DataUpDwnDebErrReactn_I.stErrDebCpl MoFErrHndlg_Lib_DataUpDwnDebErrReactn_I.stErrLockRels MoFErrHndlg_Lib_DataUpDwnDebErrReactn_I.stErrLockRelsCpl MoFErrHndlg_Lib_DataUpDwnDebErrReactn_I.stErrReactn MoFErrHndlg_Lib_DataUpDwnDeb_I.cntErrDeb MoFErrHndlg_Lib_DataUpDwnDeb_I.cntErrDebCpl MoFErrHndlg_Lib_DataUpDwnDeb_I.stErrDeb MoFErrHndlg_Lib_DataUpDwnDeb_I.stErrDebCpl /end LOC_MEASUREMENT
 FUNCTION_VERSION "1.1.0" /end FUNCTION
/begin FUNCTION MoFErrHndlg_Reactn "7.5.0     Function monitoring Fault reactions"
 /begin DEF_CHARACTERISTIC MoFErrHndlg_stCfgErrHndlgAccrInp_C MoFErrHndlg_stCfgErrHndlgAdcSop_C MoFErrHndlg_stCfgErrHndlgAxleComp_C MoFErrHndlg_stCfgErrHndlgEmComp_C MoFErrHndlg_stCfgErrHndlgPostBldSel_C MoFErrHndlg_stCfgErrHndlgPtRels_C MoFErrHndlg_stCfgErrHndlgSecAxleComp_C MoFErrHndlg_stCfgErrHndlgSecEmComp_C MoFErrHndlg_stCfgErrHndlgSecPtRels_C MoFErrHndlg_stCfgErrHndlgVehComp_C MoFErrHndlg_stCfgErrReactnAccrInp_C MoFErrHndlg_stCfgErrReactnAdcSop_C MoFErrHndlg_stCfgErrReactnAxleCompRe_C MoFErrHndlg_stCfgErrReactnAxleComp_C MoFErrHndlg_stCfgErrReactnEmCompRe_C MoFErrHndlg_stCfgErrReactnEmComp_C MoFErrHndlg_stCfgErrReactnEmSignComp_C MoFErrHndlg_stCfgErrReactnPostBldSel_C MoFErrHndlg_stCfgErrReactnPtRels_C MoFErrHndlg_stCfgErrReactnSecAxleCompRe_C MoFErrHndlg_stCfgErrReactnSecAxleComp_C MoFErrHndlg_stCfgErrReactnSecEmCompRe_C MoFErrHndlg_stCfgErrReactnSecEmComp_C MoFErrHndlg_stCfgErrReactnSecEmSignComp_C MoFErrHndlg_stCfgErrReactnSecPtRels_C MoFErrHndlg_stCfgErrReactnVehCompRe_C MoFErrHndlg_stCfgErrReactnVehComp_C MoFErrHndlg_swtErrReactn_C /end DEF_CHARACTERISTIC
 /begin IN_MEASUREMENT MoFAccr_stErrInp MoFTqPtdAxleSec_stErrTqComp MoFTqPtdAxle_stErrTqComp MoFTqPtdEmSec_stErrPtRels MoFTqPtdEmSec_stErrSignComp MoFTqPtdEmSec_stErrTqComp MoFTqPtdEm_stErrPtRels MoFTqPtdEm_stErrSignComp MoFTqPtdEm_stErrTqComp MoFTqPtdVeh_stErrTqComp MoFTrsmAssc_flgGearLvrRe Mo_stCplChk Mo_stMoC Mo_stMoCCpl Mo_stMoF /end IN_MEASUREMENT
 /begin OUT_MEASUREMENT MoFErrHndlg_stErrReactn MoFErrHndlg_stErrReactnMsg MoFErrHndlg_stErrReactnTmp MoFErrHndlg_stErrReactnTmpCpl /end OUT_MEASUREMENT
 /begin LOC_MEASUREMENT MoFErrHndlg_Reactn_Cls_AccrInpCpl_I.MoFErrHndlg_stErrLockRlsCpl MoFErrHndlg_Reactn_Cls_AccrInpCpl_I.MoFErrHndlg_stErrReacCpl MoFErrHndlg_Reactn_Cls_AccrInp_I.MoFErrHndlg_stErrLockRls MoFErrHndlg_Reactn_Cls_AccrInp_I.MoFErrHndlg_stErrReac MoFErrHndlg_Reactn_Cls_ADC_SOPCpl_I.MoFErrHndlg_stErrLockRlsCpl MoFErrHndlg_Reactn_Cls_ADC_SOPCpl_I.MoFErrHndlg_stErrReacCpl MoFErrHndlg_Reactn_Cls_ADC_SOP_I.MoFErrHndlg_stErrLockRls MoFErrHndlg_Reactn_Cls_ADC_SOP_I.MoFErrHndlg_stErrReac MoFErrHndlg_Reactn_Cls_AxleCompCpl_I.MoFErrHndlg_stErrLockRlsCpl MoFErrHndlg_Reactn_Cls_AxleCompCpl_I.MoFErrHndlg_stErrReacCpl MoFErrHndlg_Reactn_Cls_AxleComp_I.MoFErrHndlg_stErrLockRls MoFErrHndlg_Reactn_Cls_AxleComp_I.MoFErrHndlg_stErrReac MoFErrHndlg_Reactn_Cls_EmCompCpl_I.MoFErrHndlg_stErrLockRlsCpl MoFErrHndlg_Reactn_Cls_EmCompCpl_I.MoFErrHndlg_stErrReacCpl MoFErrHndlg_Reactn_Cls_EmComp_I.MoFErrHndlg_stErrLockRls MoFErrHndlg_Reactn_Cls_EmComp_I.MoFErrHndlg_stErrReac MoFErrHndlg_Reactn_Cls_EmSignCompCpl_I.MoFErrHndlg_stErrLockRlsCpl MoFErrHndlg_Reactn_Cls_EmSignCompCpl_I.MoFErrHndlg_stErrReacCpl MoFErrHndlg_Reactn_Cls_EmSignComp_I.MoFErrHndlg_stErrLockRls MoFErrHndlg_Reactn_Cls_EmSignComp_I.MoFErrHndlg_stErrReac MoFErrHndlg_Reactn_Cls_PostBldSelCpl_I.MoFErrHndlg_stErrLockRlsCpl MoFErrHndlg_Reactn_Cls_PostBldSelCpl_I.MoFErrHndlg_stErrReacCpl MoFErrHndlg_Reactn_Cls_PostBldSel_I.MoFErrHndlg_stErrLockRls MoFErrHndlg_Reactn_Cls_PostBldSel_I.MoFErrHndlg_stErrReac MoFErrHndlg_Reactn_Cls_PtRelsCpl_I.MoFErrHndlg_stErrLockRlsCpl MoFErrHndlg_Reactn_Cls_PtRelsCpl_I.MoFErrHndlg_stErrReacCpl MoFErrHndlg_Reactn_Cls_PtRels_I.MoFErrHndlg_stErrLockRls MoFErrHndlg_Reactn_Cls_PtRels_I.MoFErrHndlg_stErrReac MoFErrHndlg_Reactn_Cls_SecAxleCompCpl_I.MoFErrHndlg_stErrLockRlsCpl MoFErrHndlg_Reactn_Cls_SecAxleCompCpl_I.MoFErrHndlg_stErrReacCpl MoFErrHndlg_Reactn_Cls_SecAxleComp_I.MoFErrHndlg_stErrLockRls MoFErrHndlg_Reactn_Cls_SecAxleComp_I.MoFErrHndlg_stErrReac MoFErrHndlg_Reactn_Cls_SecEmCompCpl_I.MoFErrHndlg_stErrLockRlsCpl MoFErrHndlg_Reactn_Cls_SecEmCompCpl_I.MoFErrHndlg_stErrReacCpl MoFErrHndlg_Reactn_Cls_SecEmComp_I.MoFErrHndlg_stErrLockRls MoFErrHndlg_Reactn_Cls_SecEmComp_I.MoFErrHndlg_stErrReac MoFErrHndlg_Reactn_Cls_SecEmSignCompCpl_I.MoFErrHndlg_stErrLockRlsCpl MoFErrHndlg_Reactn_Cls_SecEmSignCompCpl_I.MoFErrHndlg_stErrReacCpl MoFErrHndlg_Reactn_Cls_SecEmSignComp_I.MoFErrHndlg_stErrLockRls MoFErrHndlg_Reactn_Cls_SecEmSignComp_I.MoFErrHndlg_stErrReac MoFErrHndlg_Reactn_Cls_SecPtRelsCpl_I.MoFErrHndlg_stErrLockRlsCpl MoFErrHndlg_Reactn_Cls_SecPtRelsCpl_I.MoFErrHndlg_stErrReacCpl MoFErrHndlg_Reactn_Cls_SecPtRels_I.MoFErrHndlg_stErrLockRls MoFErrHndlg_Reactn_Cls_SecPtRels_I.MoFErrHndlg_stErrReac MoFErrHndlg_Reactn_Cls_VehCompCpl_I.MoFErrHndlg_stErrLockRlsCpl MoFErrHndlg_Reactn_Cls_VehCompCpl_I.MoFErrHndlg_stErrReacCpl MoFErrHndlg_Reactn_Cls_VehComp_I.MoFErrHndlg_stErrLockRls MoFErrHndlg_Reactn_Cls_VehComp_I.MoFErrHndlg_stErrReac MoFErrHndlg_stErrReactnCpl /end LOC_MEASUREMENT
 FUNCTION_VERSION "7.5.0" /end FUNCTION
/begin FUNCTION MoFEscAssc_Esc "8.3.0     Function monitoring ESC intervention"
 /begin DEF_CHARACTERISTIC MoFEscAssc_stEMPrsntCfg_C MoFEscAssc_stErrIrrvEM02_C MoFEscAssc_stErrIrrv_C MoFEscAssc_swtCnvrtWhlEM02_C MoFEscAssc_swtCnvrtWhl_C MoFEscAssc_tqDecDmdDft_C MoFEscAssc_tqDecDmdEM02Dft_C MoFEscAssc_tqDecDmdEM02Max_C MoFEscAssc_tqDecDmdEM02Min_C MoFEscAssc_tqDecDmdMax_C MoFEscAssc_tqDecDmdMin_C MoFEscAssc_tqIncDmdDft_C MoFEscAssc_tqIncDmdEM02Dft_C MoFEscAssc_tqIncDmdEM02Max_C MoFEscAssc_tqIncDmdEM02Min_C MoFEscAssc_tqIncDmdMax_C MoFEscAssc_tqIncDmdMin_C /end DEF_CHARACTERISTIC
 /begin IN_MEASUREMENT MoFFrm_flgDecTqDmdActv MoFFrm_flgDecTqDmdEM02Actv MoFFrm_flgIncTqDmdActv MoFFrm_flgIncTqDmdEM02Actv MoFFrm_tqDecTqDmd MoFFrm_tqDecTqDmdEM02 MoFFrm_tqIncTqDmd MoFFrm_tqIncTqDmdEM02 MoFFrm_tqIncTqDmdEM02Qlfr MoFFrm_tqIncTqDmdQlfr MoFPtSt_ratPT MoFPtSt_ratSecPT Mo_stCplChk Mo_stMoC Mo_stMoCCpl /end IN_MEASUREMENT
 /begin OUT_MEASUREMENT MoFEscAssc_flgEscCANErr MoFEscAssc_flgEscDCSPtd01Msg MoFEscAssc_flgEscDCSPtd02Msg MoFEscAssc_flgEscTCSPtd01Msg MoFEscAssc_flgEscTCSPtd02Msg MoFEscAssc_tqEscDCS01 MoFEscAssc_tqEscDCS02 MoFEscAssc_tqEscTCS01 MoFEscAssc_tqEscTCS02 /end OUT_MEASUREMENT
 /begin LOC_MEASUREMENT MoFEscAsscEsc_bbLoc1Cpl MoFEscAsscEsc_bbOut1Cpl MoFEscAssc_flgCANErr MoFEscAssc_flgEM02CANErr MoFEscAssc_flgEscEM02MsgErr MoFEscAssc_flgEscMsgErr MoFEscAssc_tqDecCalcd MoFEscAssc_tqDecCalcdCpl MoFEscAssc_tqDecCalcdEM02 MoFEscAssc_tqDecCalcdEM02Cpl MoFEscAssc_tqEscDCS01Cpl MoFEscAssc_tqEscDCS02Cpl MoFEscAssc_tqEscTCS01Cpl MoFEscAssc_tqEscTCS02Cpl MoFEscAssc_tqIncCalcd MoFEscAssc_tqIncCalcdCpl MoFEscAssc_tqIncCalcdEM02 MoFEscAssc_tqIncCalcdEM02Cpl /end LOC_MEASUREMENT
 FUNCTION_VERSION "8.3.0" /end FUNCTION
/begin COMPU_METHOD B_TRUE "" TAB_VERB "%6.3" "" COMPU_TAB_REF B_TRUE /end COMPU_METHOD
/begin COMPU_VTAB B_TRUE "" TAB_VERB 2 0 "FALSE" 1 "TRUE" /end COMPU_VTAB
/begin COMPU_METHOD dez "" RAT_FUNC "%6.2" "" COEFFS 0 1 0 0 0 1 /end COMPU_METHOD
/begin COMPU_METHOD DFC_OneToOne "" RAT_FUNC "%6.2" "-" COEFFS 0 1 0 0 0 1 /end COMPU_METHOD
/begin COMPU_METHOD DFES_OneToOne "" RAT_FUNC "%6.2" "-" COEFFS 0 1 0 0 0 1 /end COMPU_METHOD
/begin COMPU_METHOD DtyCyc "" RAT_FUNC "%6.4" "%" COEFFS 0 100 0 0 0 1 /end COMPU_METHOD
/begin COMPU_METHOD EngN "" RAT_FUNC "%6.3" "rpm" COEFFS 0 2 0 0 0 1 /end COMPU_METHOD
/begin COMPU_METHOD freq_q0p1 "" RAT_FUNC "%6.3" "1/s" COEFFS 0 1 0 0 0 0.1 /end COMPU_METHOD
/begin COMPU_METHOD Length_fine "" RAT_FUNC "%6.5" "m" COEFFS 0 1000 0 0 0 1 /end COMPU_METHOD
/begin COMPU_METHOD MoCSOP_stCANFrTestState_mp_Compu "" TAB_VERB "%6.3" "" COMPU_TAB_REF MoCSOP_stCANFrTestState_mp_Compu /end COMPU_METHOD
/begin COMPU_VTAB MoCSOP_stCANFrTestState_mp_Compu "" TAB_VERB 13 0 "-" 1 "STEP_WAITFORPROTSTATE" 2 "STEP_WAITFORSTART" 3 "STEP_1" 4 "STEP_2" 5 "STEP_3" 6 "STEP_4" 7 "STEP_5" 8 "STEP_6" 9 "STEP_7" 10 "STEP_8" 11 "STEP_ERROR" 12 "STEP_FINISH" /end COMPU_VTAB
/begin COMPU_METHOD MoCSOP_stCheckStateCY329_mp_Compu "" TAB_VERB "%6.3" "" COMPU_TAB_REF MoCSOP_stCheckStateCY329_mp_Compu /end COMPU_METHOD
/begin COMPU_VTAB MoCSOP_stCheckStateCY329_mp_Compu "" TAB_VERB 19 0 "-" 1 "MOCSOP_CO_OUT_OF_DRIVE" 2 "MOCSOP_CO_POSITIVE_TEST_PREP" 3 "MOCSOP_CO_POSITIVE_TEST_DIA" 4 "MOCSOP_CO_WDA_TEST_PREP" 5 "MOCSOP_CO_WDA_TEST_DIA" 6 "MOCSOP_CO_MM2ERRSWITCH_TEST_PREP" 7 "MOCSOP_CO_MM2ERRSWITCH_TEST_DIA" 8 "MOCSOP_CO_ERRPIN_TEST_PREP" 9 "MOCSOP_CO_ERRPIN_TEST_DIA" 10 "MOCSOP_CO_ERR2WDASWITCH_TEST_PREP" 11 "MOCSOP_CO_ERR2WDASWITCH_TEST_DIA" 12 "MOCSOP_CO_OVERVOLTAGE_TEST_PREP" 13 "MOCSOP_CO_OVERVOLTAGE_TEST_DIA" 14 "MOCSOP_CO_POSITIVE_TEST_OVERVOLTAGE_PREP" 15 "MOCSOP_CO_POSITIVE_TEST_OVERVOLTAGE_DIA" 16 "MOCSOP_CO_ERR_CHECK" 17 "MOCSOP_CO_ERR_REACTION" 18 "MOCSOP_CO_TO_MOCCOM" /end COMPU_VTAB
/begin COMPU_METHOD MoCSOP_stEmmStateIFX_MP_Compu "" TAB_VERB "%6.3" "" COMPU_TAB_REF MoCSOP_stEmmStateIFX_MP_Compu /end COMPU_METHOD
/begin COMPU_VTAB MoCSOP_stEmmStateIFX_MP_Compu "" TAB_VERB 4 0 "SSM_START" 1 "SSM_RUN" 2 "SSM_FAULT" 32 "STATE_ERROR" /end COMPU_VTAB
/begin COMPU_METHOD MoCSOP_stErrPin_MP_Compu "" TAB_VERB "%6.3" "" COMPU_TAB_REF MoCSOP_stErrPin_MP_Compu /end COMPU_METHOD
/begin COMPU_VTAB MoCSOP_stErrPin_MP_Compu "" TAB_VERB 2 0 "ERRPIN_ACTIVE" 1 "ERRPIN_NOT_ACTIVE" /end COMPU_VTAB
/begin COMPU_METHOD MoCSOP_stErrReactnERPN_CA_Compu "" TAB_VERB "%6.3" "" COMPU_TAB_REF MoCSOP_stErrReactnERPN_CA_Compu /end COMPU_METHOD
/begin COMPU_VTAB MoCSOP_stErrReactnERPN_CA_Compu "" TAB_VERB 3 0 "MOCSOP_CO_REACTN_NORMAL_RUN" 1 "MOCSOP_CO_REACTN_ICO" 2 "MOCSOP_CO_REACTN_RESETLOOP" /end COMPU_VTAB
/begin COMPU_METHOD MoCSOP_stErrReactn_CA_Compu "" TAB_VERB "%6.3" "" COMPU_TAB_REF MoCSOP_stErrReactn_CA_Compu /end COMPU_METHOD
/begin COMPU_VTAB MoCSOP_stErrReactn_CA_Compu "" TAB_VERB 3 0 "MOCSOP_CO_REACTN_NORMAL_RUN" 1 "MOCSOP_CO_REACTN_ICO" 2 "MOCSOP_CO_REACTN_RESETLOOP" /end COMPU_VTAB
/begin COMPU_METHOD MoCSOP_stOVErrReactn_C_Compu "" TAB_VERB "%6.3" "" COMPU_TAB_REF MoCSOP_stOVErrReactn_C_Compu /end COMPU_METHOD
/begin COMPU_VTAB MoCSOP_stOVErrReactn_C_Compu "" TAB_VERB 2 1 "MOCSOP_CO_REACTN_ICO" 2 "MOCSOP_CO_REACTN_RESETLOOP" /end COMPU_VTAB
/begin COMPU_METHOD MoCSOP_Time_us "" RAT_FUNC "%6.2" "us" COEFFS 0 1 0 0 0 1 /end COMPU_METHOD
/begin COMPU_METHOD OneToOne "" RAT_FUNC "%6.2" "-" COEFFS 0 1 0 0 0 1 /end COMPU_METHOD
/begin COMPU_METHOD PENVSNSRTYP_SC_Compu "" TAB_VERB "%6.3" "" COMPU_TAB_REF PENVSNSRTYP_SC_Compu /end COMPU_METHOD
/begin COMPU_VTAB PENVSNSRTYP_SC_Compu "" TAB_VERB 4 0 "ANA" 1 "SPI" 2 "CAN" 3 "Selectable" /end COMPU_VTAB
/begin COMPU_METHOD Period "" RAT_FUNC "%6.3" "ms" COEFFS 0 10 0 0 0 1 /end COMPU_METHOD
/begin COMPU_METHOD PERMSPLYSYS_SY_Compu "" TAB_VERB "%6.3" "" COMPU_TAB_REF PERMSPLYSYS_SY_Compu /end COMPU_METHOD
/begin COMPU_VTAB PERMSPLYSYS_SY_Compu "" TAB_VERB 2 0 "non-permanently supplied system" 1 "permanently supplied system" /end COMPU_VTAB
/begin COMPU_METHOD Per_Dur "" RAT_FUNC "%6.2" "usec" COEFFS 0 1 0 0 0 1 /end COMPU_METHOD
/begin COMPU_METHOD PEXHMNFLD_TYPAVL_SC_Compu "" TAB_VERB "%6.3" "" COMPU_TAB_REF PEXHMNFLD_TYPAVL_SC_Compu /end COMPU_METHOD
/begin COMPU_VTAB PEXHMNFLD_TYPAVL_SC_Compu "" TAB_VERB 2 0 "False" 1 "True" /end COMPU_VTAB
/begin COMPU_METHOD PFltPOpPrcPerSec_COMPU "" RAT_FUNC "%6.3" "%/s" COEFFS 0 10 0 0 0 1 /end COMPU_METHOD
/begin COMPU_METHOD PiIClb_InjMassS32 "" RAT_FUNC "%9.8" "mg/hub" COEFFS 0 6553600 0 0 0 1 /end COMPU_METHOD
/begin COMPU_METHOD PINTKVUS_SNSR1PRSNT_SC_Compu "" TAB_VERB "%6.3" "" COMPU_TAB_REF PINTKVUS_SNSR1PRSNT_SC_Compu /end COMPU_METHOD
/begin COMPU_VTAB PINTKVUS_SNSR1PRSNT_SC_Compu "" TAB_VERB 2 0 "False" 1 "True" /end COMPU_VTAB
/begin COMPU_METHOD PINTKVUS_TYPAVL_SY_Compu "" TAB_VERB "%6.3" "" COMPU_TAB_REF PINTKVUS_TYPAVL_SY_Compu /end COMPU_METHOD
/begin COMPU_VTAB PINTKVUS_TYPAVL_SY_Compu "" TAB_VERB 2 0 "False" 1 "True" /end COMPU_VTAB
/begin COMPU_METHOD PMaxCtlKi "" RAT_FUNC "%6.4" "deg CrS/(bar*s)" COEFFS 0 763.549741510925 0 0 0 1 /end COMPU_METHOD
/begin COMPU_METHOD PMaxCtlKp "" RAT_FUNC "%7.6" "deg CrS/bar" COEFFS 0 11650.8444444416 0 0 0 1 /end COMPU_METHOD
/begin COMPU_METHOD PMaxCtlKp_8 "" RAT_FUNC "%6.5" "deg CrS/bar" COEFFS 0 1456.3555555552 0 0 0 1 /end COMPU_METHOD
/begin COMPU_METHOD PmpQnt "" RAT_FUNC "%6.3" "mm^3/rev" COEFFS 0 10 0 0 0 1 /end COMPU_METHOD
/begin COMPU_METHOD POFFSADPN_SC_Compu "" TAB_VERB "%6.3" "" COMPU_TAB_REF POFFSADPN_SC_Compu /end COMPU_METHOD
/begin COMPU_VTAB POFFSADPN_SC_Compu "" TAB_VERB 2 0 "False" 1 "True" /end COMPU_VTAB
/begin COMPU_METHOD POILVT_TYPAVL_SC_Compu "" TAB_VERB "%6.3" "" COMPU_TAB_REF POILVT_TYPAVL_SC_Compu /end COMPU_METHOD
/begin COMPU_VTAB POILVT_TYPAVL_SC_Compu "" TAB_VERB 2 0 "False" 1 "True" /end COMPU_VTAB
/begin COMPU_METHOD PosMCAirKi "" RAT_FUNC "%6.4" "(mg/str)/(%*s)" COEFFS 0 214.7483648 0 0 0 1 /end COMPU_METHOD
/begin COMPU_METHOD PosMCAirKp "" RAT_FUNC "%6.5" "(mg/str)/%" COEFFS 0 3276.8 0 0 0 1 /end COMPU_METHOD
/begin COMPU_METHOD PosMCAir_AMPC2Rat "" RAT_FUNC "%6.4" "1/mg/str" COEFFS 0 128 0 0 0 1 /end COMPU_METHOD
/begin COMPU_METHOD PosMCKd "" RAT_FUNC "%8.7" "%/AgCA" COEFFS 0 144000.000000035 0 0 0 1 /end COMPU_METHOD
/begin COMPU_METHOD PosMCKd_4 "" RAT_FUNC "%7.6" "%/AgCA" COEFFS 0 36000.0000000088 0 0 0 1 /end COMPU_METHOD
/begin COMPU_METHOD PosMCKi "" RAT_FUNC "%6.5" "%/(AgCA*s)" COEFFS 0 4718.59200000115 0 0 0 1 /end COMPU_METHOD
/begin COMPU_METHOD PosMCKi_2 "" RAT_FUNC "%6.5" "%/(AgCA*s)" COEFFS 0 2359.29600000058 0 0 0 1 /end COMPU_METHOD
/begin COMPU_METHOD PosMCKp "" RAT_FUNC "%7.6" "%/AgCA" COEFFS 0 72000.0000000176 0 0 0 1 /end COMPU_METHOD
/begin COMPU_METHOD Prc "" RAT_FUNC "%6.4" "%" COEFFS 0 81.92 0 0 0 1 /end COMPU_METHOD
/begin COMPU_METHOD PrcPerSec "" RAT_FUNC "%6.3" "%/s" COEFFS 0 1.6384 0 0 0 1 /end COMPU_METHOD
/begin COMPU_METHOD spg_q0p00488 "" RAT_FUNC "%6.4" "V" COEFFS 0 1024 0 0 0 5 /end COMPU_METHOD
/begin COMPU_METHOD spg_q0p0195 "" RAT_FUNC "%6.4" "V" COEFFS 0 256 0 0 0 5 /end COMPU_METHOD
/begin COMPU_METHOD TransR "" RAT_FUNC "%6.4" "-" COEFFS 0 100 0 0 0 1 /end COMPU_METHOD
/begin COMPU_METHOD TrqPrp "" RAT_FUNC "%6.2" "Nm" COEFFS 0 0.625 0 0 0 1 /end COMPU_METHOD
/begin COMPU_METHOD TrqPrpHigh "" RAT_FUNC "%6.3" "Nm" COEFFS 0 10 0 0 0 1 /end COMPU_METHOD
/begin COMPU_METHOD t_q0p01 "" RAT_FUNC "%6.4" "s" COEFFS 0 100 0 0 0 1 /end COMPU_METHOD
/begin COMPU_METHOD Vel "" RAT_FUNC "%6.4" "km/h" COEFFS 0 100 0 0 0 1 /end COMPU_METHOD
/begin COMPU_METHOD vel_q0p01 "" RAT_FUNC "%6.4" "km/h" COEFFS 0 100 0 0 0 1 /end COMPU_METHOD
/begin COMPU_METHOD zk10msxs_uw_b655p36PT1 "" RAT_FUNC "%6.2" "s" COEFFS 0 0 65536 0 100 1 /end COMPU_METHOD
/begin RECORD_LAYOUT Mo_DataCurveSstS16WS16 NO_AXIS_PTS_X 1 SWORD AXIS_PTS_X 2 SWORD INDEX_INCR DIRECT FNC_VALUES 3 SWORD COLUMN_DIR DIRECT /end RECORD_LAYOUT
/begin RECORD_LAYOUT ValA_Wu8 FNC_VALUES 1 UBYTE COLUMN_DIR DIRECT /end RECORD_LAYOUT
/begin RECORD_LAYOUT Val_Ws16 FNC_VALUES 1 SWORD COLUMN_DIR DIRECT /end RECORD_LAYOUT
/begin RECORD_LAYOUT Val_Ws32 FNC_VALUES 1 SLONG COLUMN_DIR DIRECT /end RECORD_LAYOUT
/begin RECORD_LAYOUT Val_Wu16 FNC_VALUES 1 UWORD COLUMN_DIR DIRECT /end RECORD_LAYOUT
/begin RECORD_LAYOUT Val_Wu32 FNC_VALUES 1 ULONG COLUMN_DIR DIRECT /end RECORD_LAYOUT
/begin RECORD_LAYOUT Val_Wu8 FNC_VALUES 1 UBYTE COLUMN_DIR DIRECT /end RECORD_LAYOUT
/end MODULE
/end PROJECT

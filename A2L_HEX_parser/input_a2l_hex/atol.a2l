ASAP2_VERSION 1 70
/begin PROJECT MDG1C "VC1CP091_STLA_N_D061I3"
/begin HEADER "" VERSION "VC1CP091_STLA_N_D061I3" PROJECT_NO MDG1C /end HEADER
/begin MODULE DIM ""
/begin MOD_COMMON "" BYTE_ORDER MSB_LAST ALIGNMENT_BYTE 1 ALIGNMENT_WORD 2 ALIGNMENT_LONG 4 ALIGNMENT_INT64 4 ALIGNMENT_FLOAT32_IEEE 4 ALIGNMENT_FLOAT64_IEEE 4 DATA_SIZE 32 /end MOD_COMMON
/begin MEASUREMENT DINH_DSQSrv7Vis "" UWORD OneToOne 1 100 0.00 65535.00 FORMAT "%8.2" MATRIX_DIM 1 ECU_ADDRESS 0x600229C8 /end MEASUREMENT
/begin MEASUREMENT DINH_FIdSrv7Vis "" UWORD OneToOne 1 100 0.00 65535.00 FORMAT "%8.2" MATRIX_DIM 72 ECU_ADDRESS 0x600229CA /end MEASUREMENT
/begin MEASUREMENT DINH_nrActvInhReas.FId_Fan1PsSwtOff "" UWORD DINH_ct_Compu 1 100 -4095.000 4096.000 BIT_MASK 0x1fff FORMAT "%8.3" ECU_ADDRESS 0x60021472 /end MEASUREMENT
/begin MEASUREMENT DINH_nrActvInhReas.FId_InhibitAlways "" UWORD DINH_ct_Compu 1 100 -4095.000 4096.000 BIT_MASK 0x1fff FORMAT "%8.3" ECU_ADDRESS 0x600214E4 /end MEASUREMENT
/begin MEASUREMENT DINH_nrActvInhReas.FId_InhibitNever "" UWORD DINH_ct_Compu 1 100 -4095.000 4096.000 BIT_MASK 0x1fff FORMAT "%8.3" ECU_ADDRESS 0x600214E6 /end MEASUREMENT
/begin MEASUREMENT DINH_nrActvInhReas.FId_IntlckChrgPlgHbrgOLErr "" UWORD DINH_ct_Compu 1 100 -4095.000 4096.000 BIT_MASK 0x1fff FORMAT "%8.3" ECU_ADDRESS 0x600214EC /end MEASUREMENT
/begin MEASUREMENT DINH_nrActvInhReas.FId_IntlckChrgPlgPsSwtOff "" UWORD DINH_ct_Compu 1 100 -4095.000 4096.000 BIT_MASK 0x1fff FORMAT "%8.3" ECU_ADDRESS 0x600214F2 /end MEASUREMENT
/begin MEASUREMENT DINH_nrActvInhReas.FId_IntlckChrgPlg_VehvErr "" UWORD DINH_ct_Compu 1 100 -4095.000 4096.000 BIT_MASK 0x1fff FORMAT "%8.3" ECU_ADDRESS 0x600214F6 /end MEASUREMENT
/begin MEASUREMENT DINH_nrActvInhReas.FId_SCtPmp1PsSwtOff "" UWORD DINH_ct_Compu 1 100 -4095.000 4096.000 BIT_MASK 0x1fff FORMAT "%8.3" ECU_ADDRESS 0x60021540 /end MEASUREMENT
/begin MEASUREMENT DINH_nrActvInhReas.FId_SCtPmp1_VehvErr "" UWORD DINH_ct_Compu 1 100 -4095.000 4096.000 BIT_MASK 0x1fff FORMAT "%8.3" ECU_ADDRESS 0x60021548 /end MEASUREMENT
/begin MEASUREMENT DINH_nrActvInhReas.FId_SCtPmpRlyPsSwtOff "" UWORD DINH_ct_Compu 1 100 -4095.000 4096.000 BIT_MASK 0x1fff FORMAT "%8.3" ECU_ADDRESS 0x60021550 /end MEASUREMENT
/begin MEASUREMENT DINH_nrActvInhReas.FId_SpplCooltPmpRlyPsSwtOff "" UWORD DINH_ct_Compu 1 100 -4095.000 4096.000 BIT_MASK 0x1fff FORMAT "%8.3" ECU_ADDRESS 0x6002155E /end MEASUREMENT
/begin MEASUREMENT DINH_stClctFId_mp "" UWORD DFC_OneToOne 1 100 0.00 65535.00 FORMAT "%8.2" MATRIX_DIM 72 ECU_ADDRESS 0x700069A6 /end MEASUREMENT
/begin MEASUREMENT DINH_stFId.FId_Unused "" UWORD DFC_OneToOne 1 100 0.00 65535.00 FORMAT "%8.2" ECU_ADDRESS 0x600212F2 /end MEASUREMENT
/begin MEASUREMENT DINH_stFId.FId_Fan1PsSwtOff "" UWORD DFC_OneToOne 1 100 0.00 65535.00 FORMAT "%8.2" ECU_ADDRESS 0x60021472 /end MEASUREMENT
/begin MEASUREMENT DINH_stFId.FId_InhibitAlways "" UWORD DFC_OneToOne 1 100 0.00 65535.00 FORMAT "%8.2" ECU_ADDRESS 0x600214E4 /end MEASUREMENT
/begin MEASUREMENT DINH_stFId.FId_InhibitNever "" UWORD DFC_OneToOne 1 100 0.00 65535.00 FORMAT "%8.2" ECU_ADDRESS 0x600214E6 /end MEASUREMENT
/begin MEASUREMENT DINH_stFId.FId_IntlckChrgPlgHbrgOLErr "" UWORD DFC_OneToOne 1 100 0.00 65535.00 FORMAT "%8.2" ECU_ADDRESS 0x600214EC /end MEASUREMENT
/begin MEASUREMENT DINH_stFId.FId_IntlckChrgPlgPsSwtOff "" UWORD DFC_OneToOne 1 100 0.00 65535.00 FORMAT "%8.2" ECU_ADDRESS 0x600214F2 /end MEASUREMENT
/begin MEASUREMENT DINH_stFId.FId_IntlckChrgPlg_VehvErr "" UWORD DFC_OneToOne 1 100 0.00 65535.00 FORMAT "%8.2" ECU_ADDRESS 0x600214F6 /end MEASUREMENT
/begin MEASUREMENT DINH_stFId.FId_SCtPmp1PsSwtOff "" UWORD DFC_OneToOne 1 100 0.00 65535.00 FORMAT "%8.2" ECU_ADDRESS 0x60021540 /end MEASUREMENT
/begin MEASUREMENT DINH_stFId.FId_SCtPmp1_VehvErr "" UWORD DFC_OneToOne 1 100 0.00 65535.00 FORMAT "%8.2" ECU_ADDRESS 0x60021548 /end MEASUREMENT
/begin MEASUREMENT DINH_stFId.FId_SCtPmpRlyPsSwtOff "" UWORD DFC_OneToOne 1 100 0.00 65535.00 FORMAT "%8.2" ECU_ADDRESS 0x60021550 /end MEASUREMENT
/begin MEASUREMENT DINH_stFId.FId_SpplCooltPmpRlyPsSwtOff "" UWORD DFC_OneToOne 1 100 0.00 65535.00 FORMAT "%8.2" ECU_ADDRESS 0x6002155E /end MEASUREMENT
/begin MEASUREMENT DINH_stMod7VisyCmpl "status of the first completed calculation of mode7 visibility" UBYTE OneToOne 1 100 0.00 255.0 BIT_MASK 0x1 FORMAT "%5.1" ECU_ADDRESS 0x6002497F /end MEASUREMENT
/begin MEASUREMENT DINH_xFIDObsvInh_mp "" UWORD DFCDSQ_Verb 1 100 0.00 65535.0000000 FORMAT "%13.7" MATRIX_DIM 5 ECU_ADDRESS 0x7000699C /end MEASUREMENT
/begin MEASUREMENT DINH_xFIDObsvRls_mp "" UWORD DFCDSQ_Verb 1 100 0.00 65535.0000000 FORMAT "%13.7" MATRIX_DIM 5 ECU_ADDRESS 0x70006992 /end MEASUREMENT
/begin MEASUREMENT DINH_xWhy.FId_Unused "" UWORD DFCDSQ_Verb 1 100 0.00 65535.0000000 FORMAT "%13.7" ECU_ADDRESS 0x600220B6 /end MEASUREMENT
/begin MEASUREMENT DINH_xWhy.FID_ElTSPwrChrgnOutErr "" UWORD DFCDSQ_Verb 1 100 0.00 65535.0000000 FORMAT "%13.7" ECU_ADDRESS 0x600220B8 /end MEASUREMENT
/begin MEASUREMENT DINH_xWhy.FID_ElTSPwrInActErr "" UWORD DFCDSQ_Verb 1 100 0.00 65535.0000000 FORMAT "%13.7" ECU_ADDRESS 0x600220BA /end MEASUREMENT
/begin MEASUREMENT DINH_xWhy.FId_ACCmprFltPDiagEnad "" UWORD DFCDSQ_Verb 1 100 0.00 65535.0000000 FORMAT "%13.7" ECU_ADDRESS 0x600220BC /end MEASUREMENT
/begin MEASUREMENT DINH_xWhy.FId_ACCmprInpErr "" UWORD DFCDSQ_Verb 1 100 0.00 65535.0000000 FORMAT "%13.7" ECU_ADDRESS 0x600220BE /end MEASUREMENT
/begin MEASUREMENT DINH_xWhy.FId_ACpAC "" UWORD DFCDSQ_Verb 1 100 0.00 65535.0000000 FORMAT "%13.7" ECU_ADDRESS 0x600220C0 /end MEASUREMENT
/begin MEASUREMENT DINH_xWhy.FId_APP1SigPath "" UWORD DFCDSQ_Verb 1 100 0.00 65535.0000000 FORMAT "%13.7" ECU_ADDRESS 0x600220C2 /end MEASUREMENT
/begin MEASUREMENT DINH_xWhy.FId_APP2SigPath "" UWORD DFCDSQ_Verb 1 100 0.00 65535.0000000 FORMAT "%13.7" ECU_ADDRESS 0x600220C4 /end MEASUREMENT
/begin MEASUREMENT DINH_xWhy.FId_APPBrkErr "" UWORD DFCDSQ_Verb 1 100 0.00 65535.0000000 FORMAT "%13.7" ECU_ADDRESS 0x600220C6 /end MEASUREMENT
/begin MEASUREMENT DINH_xWhy.FId_APPVehVErr "" UWORD DFCDSQ_Verb 1 100 0.00 65535.0000000 FORMAT "%13.7" ECU_ADDRESS 0x600220C8 /end MEASUREMENT
/begin MEASUREMENT DINH_xWhy.FId_AcChrgrIntkTEnhdSRCMax "" UWORD DFCDSQ_Verb 1 100 0.00 65535.0000000 FORMAT "%13.7" ECU_ADDRESS 0x600220CA /end MEASUREMENT
/begin MEASUREMENT DINH_xWhy.FId_AcChrgrIntkTFrzVal "" UWORD DFCDSQ_Verb 1 100 0.00 65535.0000000 FORMAT "%13.7" ECU_ADDRESS 0x600220CC /end MEASUREMENT
/begin MEASUREMENT DINH_xWhy.FId_AcChrgrIntkTPhysRng "" UWORD DFCDSQ_Verb 1 100 0.00 65535.0000000 FORMAT "%13.7" ECU_ADDRESS 0x600220CE /end MEASUREMENT
/begin MEASUREMENT DINH_xWhy.FId_AcChrgrIntkTRplVal "" UWORD DFCDSQ_Verb 1 100 0.00 65535.0000000 FORMAT "%13.7" ECU_ADDRESS 0x600220D0 /end MEASUREMENT
/begin MEASUREMENT DINH_xWhy.FId_AcChrgrIntkTSSpMon "" UWORD DFCDSQ_Verb 1 100 0.00 65535.0000000 FORMAT "%13.7" ECU_ADDRESS 0x600220D2 /end MEASUREMENT
/begin MEASUREMENT DINH_xWhy.FId_AcChrgrIntkTTmpErrCnt "" UWORD DFCDSQ_Verb 1 100 0.00 65535.0000000 FORMAT "%13.7" ECU_ADDRESS 0x600220D4 /end MEASUREMENT
/begin MEASUREMENT DINH_xWhy.FId_AcExtChrgrChrgn "" UWORD DFCDSQ_Verb 1 100 0.00 65535.0000000 FORMAT "%13.7" ECU_ADDRESS 0x600220D6 /end MEASUREMENT
/begin MEASUREMENT DINH_xWhy.FId_Airbg2MED "" UWORD DFCDSQ_Verb 1 100 0.00 65535.0000000 FORMAT "%13.7" ECU_ADDRESS 0x600220D8 /end MEASUREMENT
/begin MEASUREMENT DINH_xWhy.FId_AirbgAVSstCrash "" UWORD DFCDSQ_Verb 1 100 0.00 65535.0000000 FORMAT "%13.7" ECU_ADDRESS 0x600220DA /end MEASUREMENT
/begin MEASUREMENT DINH_xWhy.FId_AirbgCan "" UWORD DFCDSQ_Verb 1 100 0.00 65535.0000000 FORMAT "%13.7" ECU_ADDRESS 0x600220DC /end MEASUREMENT
/begin MEASUREMENT DINH_xWhy.FId_AirbgHw "" UWORD DFCDSQ_Verb 1 100 0.00 65535.0000000 FORMAT "%13.7" ECU_ADDRESS 0x600220DE /end MEASUREMENT
/begin MEASUREMENT DINH_xWhy.FId_AirbgInpSigErr "" UWORD DFCDSQ_Verb 1 100 0.00 65535.0000000 FORMAT "%13.7" ECU_ADDRESS 0x600220E0 /end MEASUREMENT
/begin MEASUREMENT DINH_xWhy.FId_AirbgPWMErr "" UWORD DFCDSQ_Verb 1 100 0.00 65535.0000000 FORMAT "%13.7" ECU_ADDRESS 0x600220E2 /end MEASUREMENT
/begin MEASUREMENT DINH_xWhy.FId_AirbgPwmSrcErr "" UWORD DFCDSQ_Verb 1 100 0.00 65535.0000000 FORMAT "%13.7" ECU_ADDRESS 0x600220E4 /end MEASUREMENT
/begin MEASUREMENT DINH_xWhy.FId_BattUDiagEna "" UWORD DFCDSQ_Verb 1 100 0.00 65535.0000000 FORMAT "%13.7" ECU_ADDRESS 0x600220E6 /end MEASUREMENT
/begin MEASUREMENT DINH_xWhy.FId_BattUInvalid "" UWORD DFCDSQ_Verb 1 100 0.00 65535.0000000 FORMAT "%13.7" ECU_ADDRESS 0x600220E8 /end MEASUREMENT
/begin MEASUREMENT DINH_xWhy.FId_BattUReplcmt "" UWORD DFCDSQ_Verb 1 100 0.00 65535.0000000 FORMAT "%13.7" ECU_ADDRESS 0x600220EA /end MEASUREMENT
/begin MEASUREMENT DINH_xWhy.FId_BattUVehVVld "" UWORD DFCDSQ_Verb 1 100 0.00 65535.0000000 FORMAT "%13.7" ECU_ADDRESS 0x600220EC /end MEASUREMENT
/begin MEASUREMENT DINH_xWhy.FId_BlwrComErr "" UWORD DFCDSQ_Verb 1 100 0.00 65535.0000000 FORMAT "%13.7" ECU_ADDRESS 0x600220EE /end MEASUREMENT
/begin MEASUREMENT DINH_xWhy.FId_BrkBstBrkSt "" UWORD DFCDSQ_Verb 1 100 0.00 65535.0000000 FORMAT "%13.7" ECU_ADDRESS 0x600220F0 /end MEASUREMENT
/begin MEASUREMENT DINH_xWhy.FId_BrkBstP "" UWORD DFCDSQ_Verb 1 100 0.00 65535.0000000 FORMAT "%13.7" ECU_ADDRESS 0x600220F2 /end MEASUREMENT
/begin MEASUREMENT DINH_xWhy.FId_BrkBstPEnaPrc "" UWORD DFCDSQ_Verb 1 100 0.00 65535.0000000 FORMAT "%13.7" ECU_ADDRESS 0x600220F4 /end MEASUREMENT
/begin MEASUREMENT DINH_xWhy.FId_BrkBstPFrzVal "" UWORD DFCDSQ_Verb 1 100 0.00 65535.0000000 FORMAT "%13.7" ECU_ADDRESS 0x600220F6 /end MEASUREMENT
/begin MEASUREMENT DINH_xWhy.FId_BrkBstPPlaus12FrznDfct "" UWORD DFCDSQ_Verb 1 100 0.00 65535.0000000 FORMAT "%13.7" ECU_ADDRESS 0x600220F8 /end MEASUREMENT
/begin MEASUREMENT DINH_xWhy.FId_BrkBstPPlaus12ReplcmtDfct "" UWORD DFCDSQ_Verb 1 100 0.00 65535.0000000 FORMAT "%13.7" ECU_ADDRESS 0x600220FA /end MEASUREMENT
/begin MEASUREMENT DINH_xWhy.FId_BrkBstPReplVal "" UWORD DFCDSQ_Verb 1 100 0.00 65535.0000000 FORMAT "%13.7" ECU_ADDRESS 0x600220FC /end MEASUREMENT
/begin MEASUREMENT DINH_xWhy.FId_BrkBstPSnsr1FrzDfct "" UWORD DFCDSQ_Verb 1 100 0.00 65535.0000000 FORMAT "%13.7" ECU_ADDRESS 0x600220FE /end MEASUREMENT
/begin MEASUREMENT DINH_xWhy.FId_BrkBstPSnsr1ReplcmtDfct "" UWORD DFCDSQ_Verb 1 100 0.00 65535.0000000 FORMAT "%13.7" ECU_ADDRESS 0x60022100 /end MEASUREMENT
/begin MEASUREMENT DINH_xWhy.FId_BrkBstPSnsr1SplyDfct "" UWORD DFCDSQ_Verb 1 100 0.00 65535.0000000 FORMAT "%13.7" ECU_ADDRESS 0x60022102 /end MEASUREMENT
/begin MEASUREMENT DINH_xWhy.FId_BrkBstPSnsr2FrzDfct "" UWORD DFCDSQ_Verb 1 100 0.00 65535.0000000 FORMAT "%13.7" ECU_ADDRESS 0x60022104 /end MEASUREMENT
/begin MEASUREMENT DINH_xWhy.FId_BrkBstPSnsr2ReplcmtDfct "" UWORD DFCDSQ_Verb 1 100 0.00 65535.0000000 FORMAT "%13.7" ECU_ADDRESS 0x60022106 /end MEASUREMENT
/begin MEASUREMENT DINH_xWhy.FId_BrkBstPSnsr2SplyDfct "" UWORD DFCDSQ_Verb 1 100 0.00 65535.0000000 FORMAT "%13.7" ECU_ADDRESS 0x60022108 /end MEASUREMENT
/begin MEASUREMENT DINH_xWhy.FId_BrkBstPmpActtnDiagEnad "" UWORD DFCDSQ_Verb 1 100 0.00 65535.0000000 FORMAT "%13.7" ECU_ADDRESS 0x6002210A /end MEASUREMENT
/begin MEASUREMENT DINH_xWhy.FId_BrkBstPmpDeactvnDiagEnad "" UWORD DFCDSQ_Verb 1 100 0.00 65535.0000000 FORMAT "%13.7" ECU_ADDRESS 0x6002210C /end MEASUREMENT
/begin MEASUREMENT DINH_xWhy.FId_BrkBstPmpLeakDiagEnad "" UWORD DFCDSQ_Verb 1 100 0.00 65535.0000000 FORMAT "%13.7" ECU_ADDRESS 0x6002210E /end MEASUREMENT
/begin MEASUREMENT DINH_xWhy.FId_BrkBstPmpM1Err "" UWORD DFCDSQ_Verb 1 100 0.00 65535.0000000 FORMAT "%13.7" ECU_ADDRESS 0x60022110 /end MEASUREMENT
/begin MEASUREMENT DINH_xWhy.FId_BrkBstPmpM2Err "" UWORD DFCDSQ_Verb 1 100 0.00 65535.0000000 FORMAT "%13.7" ECU_ADDRESS 0x60022112 /end MEASUREMENT
/begin MEASUREMENT DINH_xWhy.FId_BrkBstPmpScgLsErr "" UWORD DFCDSQ_Verb 1 100 0.00 65535.0000000 FORMAT "%13.7" ECU_ADDRESS 0x60022114 /end MEASUREMENT
/begin MEASUREMENT DINH_xWhy.FId_BrkBstPmpVacChkEna "" UWORD DFCDSQ_Verb 1 100 0.00 65535.0000000 FORMAT "%13.7" ECU_ADDRESS 0x60022116 /end MEASUREMENT
/begin MEASUREMENT DINH_xWhy.FId_BrkBstTst "" UWORD DFCDSQ_Verb 1 100 0.00 65535.0000000 FORMAT "%13.7" ECU_ADDRESS 0x60022118 /end MEASUREMENT
/begin MEASUREMENT DINH_xWhy.FId_BrkPlaus1Ena "" UWORD DFCDSQ_Verb 1 100 0.00 65535.0000000 FORMAT "%13.7" ECU_ADDRESS 0x6002211A /end MEASUREMENT
/begin MEASUREMENT DINH_xWhy.FId_BrkPresAlrt "" UWORD DFCDSQ_Verb 1 100 0.00 65535.0000000 FORMAT "%13.7" ECU_ADDRESS 0x6002211C /end MEASUREMENT
/begin MEASUREMENT DINH_xWhy.FId_BrkSigMaiCanFrzVal "" UWORD DFCDSQ_Verb 1 100 0.00 65535.0000000 FORMAT "%13.7" ECU_ADDRESS 0x6002211E /end MEASUREMENT
/begin MEASUREMENT DINH_xWhy.FId_BrkSigMaiCanReplVal "" UWORD DFCDSQ_Verb 1 100 0.00 65535.0000000 FORMAT "%13.7" ECU_ADDRESS 0x60022120 /end MEASUREMENT
/begin MEASUREMENT DINH_xWhy.FId_BrkStMnFinalDfct "" UWORD DFCDSQ_Verb 1 100 0.00 65535.0000000 FORMAT "%13.7" ECU_ADDRESS 0x60022122 /end MEASUREMENT
/begin MEASUREMENT DINH_xWhy.FId_BrkStMnPrelDfct "" UWORD DFCDSQ_Verb 1 100 0.00 65535.0000000 FORMAT "%13.7" ECU_ADDRESS 0x60022124 /end MEASUREMENT
/begin MEASUREMENT DINH_xWhy.FId_BrkStRdntFinalDfct "" UWORD DFCDSQ_Verb 1 100 0.00 65535.0000000 FORMAT "%13.7" ECU_ADDRESS 0x60022126 /end MEASUREMENT
/begin MEASUREMENT DINH_xWhy.FId_BrkStRdntPrelDfct "" UWORD DFCDSQ_Verb 1 100 0.00 65535.0000000 FORMAT "%13.7" ECU_ADDRESS 0x60022128 /end MEASUREMENT
/begin MEASUREMENT DINH_xWhy.FId_CanEifVehSpdVld "" UWORD DFCDSQ_Verb 1 100 0.00 65535.0000000 FORMAT "%13.7" ECU_ADDRESS 0x6002212A /end MEASUREMENT
/begin MEASUREMENT DINH_xWhy.FId_CbnHeatgHeatrPsFlt "" UWORD DFCDSQ_Verb 1 100 0.00 65535.0000000 FORMAT "%13.7" ECU_ADDRESS 0x6002212C /end MEASUREMENT
/begin MEASUREMENT DINH_xWhy.FId_CbnHeatgHeatrRlyDiagEnad "" UWORD DFCDSQ_Verb 1 100 0.00 65535.0000000 FORMAT "%13.7" ECU_ADDRESS 0x6002212E /end MEASUREMENT
/begin MEASUREMENT DINH_xWhy.FId_CbnHeatgSwtFrzVal "" UWORD DFCDSQ_Verb 1 100 0.00 65535.0000000 FORMAT "%13.7" ECU_ADDRESS 0x60022130 /end MEASUREMENT
/begin MEASUREMENT DINH_xWhy.FId_CbnHeatgSwtRplVal "" UWORD DFCDSQ_Verb 1 100 0.00 65535.0000000 FORMAT "%13.7" ECU_ADDRESS 0x60022132 /end MEASUREMENT
/begin MEASUREMENT DINH_xWhy.FId_CbnHeatgSwtTmpErrCnt "" UWORD DFCDSQ_Verb 1 100 0.00 65535.0000000 FORMAT "%13.7" ECU_ADDRESS 0x60022134 /end MEASUREMENT
/begin MEASUREMENT DINH_xWhy.FId_CcsDcStopChrgn "" UWORD DFCDSQ_Verb 1 100 0.00 65535.0000000 FORMAT "%13.7" ECU_ADDRESS 0x60022136 /end MEASUREMENT
/begin MEASUREMENT DINH_xWhy.FId_CcsDcStopChrgnIDftl "" UWORD DFCDSQ_Verb 1 100 0.00 65535.0000000 FORMAT "%13.7" ECU_ADDRESS 0x60022138 /end MEASUREMENT
/begin MEASUREMENT DINH_xWhy.FId_CcsPwrLineChpRstMonOff "" UWORD DFCDSQ_Verb 1 100 0.00 65535.0000000 FORMAT "%13.7" ECU_ADDRESS 0x6002213A /end MEASUREMENT
/begin MEASUREMENT DINH_xWhy.FId_CcsPwrLineChpRstOff "" UWORD DFCDSQ_Verb 1 100 0.00 65535.0000000 FORMAT "%13.7" ECU_ADDRESS 0x6002213C /end MEASUREMENT
/begin MEASUREMENT DINH_xWhy.FId_CcsPwrLineChpRstPsOff "" UWORD DFCDSQ_Verb 1 100 0.00 65535.0000000 FORMAT "%13.7" ECU_ADDRESS 0x6002213E /end MEASUREMENT
/begin MEASUREMENT DINH_xWhy.FId_CcsPwrLineChpRstSnsr "" UWORD DFCDSQ_Verb 1 100 0.00 65535.0000000 FORMAT "%13.7" ECU_ADDRESS 0x60022140 /end MEASUREMENT
/begin MEASUREMENT DINH_xWhy.FId_CcsPwrLineChpVccEnaMonOff "" UWORD DFCDSQ_Verb 1 100 0.00 65535.0000000 FORMAT "%13.7" ECU_ADDRESS 0x60022142 /end MEASUREMENT
/begin MEASUREMENT DINH_xWhy.FId_CcsPwrLineChpVccEnaOff "" UWORD DFCDSQ_Verb 1 100 0.00 65535.0000000 FORMAT "%13.7" ECU_ADDRESS 0x60022144 /end MEASUREMENT
/begin MEASUREMENT DINH_xWhy.FId_CcsPwrLineChpVccEnaPsOff "" UWORD DFCDSQ_Verb 1 100 0.00 65535.0000000 FORMAT "%13.7" ECU_ADDRESS 0x60022146 /end MEASUREMENT
/begin MEASUREMENT DINH_xWhy.FId_CcsPwrLineChpVccEnaSnsr "" UWORD DFCDSQ_Verb 1 100 0.00 65535.0000000 FORMAT "%13.7" ECU_ADDRESS 0x60022148 /end MEASUREMENT
/begin MEASUREMENT DINH_xWhy.FId_CcsPwrLineChpVccEnhdSRCMax "" UWORD DFCDSQ_Verb 1 100 0.00 65535.0000000 FORMAT "%13.7" ECU_ADDRESS 0x6002214A /end MEASUREMENT
/begin MEASUREMENT DINH_xWhy.FId_CcsPwrLineChpVccFrzVal "" UWORD DFCDSQ_Verb 1 100 0.00 65535.0000000 FORMAT "%13.7" ECU_ADDRESS 0x6002214C /end MEASUREMENT
/begin MEASUREMENT DINH_xWhy.FId_CcsPwrLineChpVccPhysRng "" UWORD DFCDSQ_Verb 1 100 0.00 65535.0000000 FORMAT "%13.7" ECU_ADDRESS 0x6002214E /end MEASUREMENT
/begin MEASUREMENT DINH_xWhy.FId_CcsPwrLineChpVccRplVal "" UWORD DFCDSQ_Verb 1 100 0.00 65535.0000000 FORMAT "%13.7" ECU_ADDRESS 0x60022150 /end MEASUREMENT
/begin MEASUREMENT DINH_xWhy.FId_CcsPwrLineChpVccSSpMon "" UWORD DFCDSQ_Verb 1 100 0.00 65535.0000000 FORMAT "%13.7" ECU_ADDRESS 0x60022152 /end MEASUREMENT
/begin MEASUREMENT DINH_xWhy.FId_CcsPwrLineChpVccTmpErrCnt "" UWORD DFCDSQ_Verb 1 100 0.00 65535.0000000 FORMAT "%13.7" ECU_ADDRESS 0x60022154 /end MEASUREMENT
/begin MEASUREMENT DINH_xWhy.FId_CcsPwrLineComChpTEnhdSRCMax "" UWORD DFCDSQ_Verb 1 100 0.00 65535.0000000 FORMAT "%13.7" ECU_ADDRESS 0x60022156 /end MEASUREMENT
/begin MEASUREMENT DINH_xWhy.FId_CcsPwrLineComChpTFrzVal "" UWORD DFCDSQ_Verb 1 100 0.00 65535.0000000 FORMAT "%13.7" ECU_ADDRESS 0x60022158 /end MEASUREMENT
/begin MEASUREMENT DINH_xWhy.FId_CcsPwrLineComChpTPhysRng "" UWORD DFCDSQ_Verb 1 100 0.00 65535.0000000 FORMAT "%13.7" ECU_ADDRESS 0x6002215A /end MEASUREMENT
/begin MEASUREMENT DINH_xWhy.FId_CcsPwrLineComChpTRplVal "" UWORD DFCDSQ_Verb 1 100 0.00 65535.0000000 FORMAT "%13.7" ECU_ADDRESS 0x6002215C /end MEASUREMENT
/begin MEASUREMENT DINH_xWhy.FId_CcsPwrLineComChpTSSpMon "" UWORD DFCDSQ_Verb 1 100 0.00 65535.0000000 FORMAT "%13.7" ECU_ADDRESS 0x6002215E /end MEASUREMENT
/begin MEASUREMENT DINH_xWhy.FId_CcsPwrLineComChpTTmpErrCnt "" UWORD DFCDSQ_Verb 1 100 0.00 65535.0000000 FORMAT "%13.7" ECU_ADDRESS 0x60022160 /end MEASUREMENT
/begin MEASUREMENT DINH_xWhy.FId_ChgrPlugCtpSwtSnsrActrErr "" UWORD DFCDSQ_Verb 1 100 0.00 65535.0000000 FORMAT "%13.7" ECU_ADDRESS 0x60022162 /end MEASUREMENT
/begin MEASUREMENT DINH_xWhy.FId_ChgrPlugLockActrErr "" UWORD DFCDSQ_Verb 1 100 0.00 65535.0000000 FORMAT "%13.7" ECU_ADDRESS 0x60022164 /end MEASUREMENT
/begin MEASUREMENT DINH_xWhy.FId_ChgrPlugLockSnsrErr "" UWORD DFCDSQ_Verb 1 100 0.00 65535.0000000 FORMAT "%13.7" ECU_ADDRESS 0x60022166 /end MEASUREMENT
/begin MEASUREMENT DINH_xWhy.FId_ChgrPlugPxp1InhbDiagSrc "" UWORD DFCDSQ_Verb 1 100 0.00 65535.0000000 FORMAT "%13.7" ECU_ADDRESS 0x60022168 /end MEASUREMENT
/begin MEASUREMENT DINH_xWhy.FId_ChgrPlugTPinDcErr "" UWORD DFCDSQ_Verb 1 100 0.00 65535.0000000 FORMAT "%13.7" ECU_ADDRESS 0x6002216A /end MEASUREMENT
/begin MEASUREMENT DINH_xWhy.FId_ChrgPlgChrgrRlyWlddCcs "" UWORD DFCDSQ_Verb 1 100 0.00 65535.0000000 FORMAT "%13.7" ECU_ADDRESS 0x6002216C /end MEASUREMENT
/begin MEASUREMENT DINH_xWhy.FId_ChrgPlugCtpDetnErr "" UWORD DFCDSQ_Verb 1 100 0.00 65535.0000000 FORMAT "%13.7" ECU_ADDRESS 0x6002216E /end MEASUREMENT
/begin MEASUREMENT DINH_xWhy.FId_ChrgnCntctPsFlt "" UWORD DFCDSQ_Verb 1 100 0.00 65535.0000000 FORMAT "%13.7" ECU_ADDRESS 0x60022170 /end MEASUREMENT
/begin MEASUREMENT DINH_xWhy.FId_ChrgnLmpChrgnFlt "" UWORD DFCDSQ_Verb 1 100 0.00 65535.0000000 FORMAT "%13.7" ECU_ADDRESS 0x60022172 /end MEASUREMENT
/begin MEASUREMENT DINH_xWhy.FId_ChrgnLmpNoChrgn "" UWORD DFCDSQ_Verb 1 100 0.00 65535.0000000 FORMAT "%13.7" ECU_ADDRESS 0x60022174 /end MEASUREMENT
/begin MEASUREMENT DINH_xWhy.FId_ChrgnUnplRqrd "" UWORD DFCDSQ_Verb 1 100 0.00 65535.0000000 FORMAT "%13.7" ECU_ADDRESS 0x60022176 /end MEASUREMENT
/begin MEASUREMENT DINH_xWhy.FId_ChrgrRlyDcActNegErr "" UWORD DFCDSQ_Verb 1 100 0.00 65535.0000000 FORMAT "%13.7" ECU_ADDRESS 0x60022178 /end MEASUREMENT
/begin MEASUREMENT DINH_xWhy.FId_ChrgrRlyDcActPosErr "" UWORD DFCDSQ_Verb 1 100 0.00 65535.0000000 FORMAT "%13.7" ECU_ADDRESS 0x6002217A /end MEASUREMENT
/begin MEASUREMENT DINH_xWhy.FId_CmbdChrgnSysCntctErr "" UWORD DFCDSQ_Verb 1 100 0.00 65535.0000000 FORMAT "%13.7" ECU_ADDRESS 0x6002217C /end MEASUREMENT
/begin MEASUREMENT DINH_xWhy.FId_CoElMDSQCanEMS01 "" UWORD DFCDSQ_Verb 1 100 0.00 65535.0000000 FORMAT "%13.7" ECU_ADDRESS 0x6002217E /end MEASUREMENT
/begin MEASUREMENT DINH_xWhy.FId_CoElMErr01 "" UWORD DFCDSQ_Verb 1 100 0.00 65535.0000000 FORMAT "%13.7" ECU_ADDRESS 0x60022180 /end MEASUREMENT
/begin MEASUREMENT DINH_xWhy.FId_CoPOMLimdPrpnHmi "" UWORD DFCDSQ_Verb 1 100 0.00 65535.0000000 FORMAT "%13.7" ECU_ADDRESS 0x60022182 /end MEASUREMENT
/begin MEASUREMENT DINH_xWhy.FId_CoPOMMaxLimFltDetnPrim "" UWORD DFCDSQ_Verb 1 100 0.00 65535.0000000 FORMAT "%13.7" ECU_ADDRESS 0x60022184 /end MEASUREMENT
/begin MEASUREMENT DINH_xWhy.FId_CoPOMMinLimFltDetnPrim "" UWORD DFCDSQ_Verb 1 100 0.00 65535.0000000 FORMAT "%13.7" ECU_ADDRESS 0x60022186 /end MEASUREMENT
/begin MEASUREMENT DINH_xWhy.FId_CoPOMNoPrpnHmi "" UWORD DFCDSQ_Verb 1 100 0.00 65535.0000000 FORMAT "%13.7" ECU_ADDRESS 0x60022188 /end MEASUREMENT
/begin MEASUREMENT DINH_xWhy.FId_CoPOMRecupPwrRednHmi "" UWORD DFCDSQ_Verb 1 100 0.00 65535.0000000 FORMAT "%13.7" ECU_ADDRESS 0x6002218A /end MEASUREMENT
/begin MEASUREMENT DINH_xWhy.FId_CoPOMRgnInhbnPrim "" UWORD DFCDSQ_Verb 1 100 0.00 65535.0000000 FORMAT "%13.7" ECU_ADDRESS 0x6002218C /end MEASUREMENT
/begin MEASUREMENT DINH_xWhy.FId_CoVMEvSysCptMaxErrPrim01 "" UWORD DFCDSQ_Verb 1 100 0.00 65535.0000000 FORMAT "%13.7" ECU_ADDRESS 0x6002218E /end MEASUREMENT
/begin MEASUREMENT DINH_xWhy.FId_CoVMEvSysCptMaxErrPrim02 "" UWORD DFCDSQ_Verb 1 100 0.00 65535.0000000 FORMAT "%13.7" ECU_ADDRESS 0x60022190 /end MEASUREMENT
/begin MEASUREMENT DINH_xWhy.FId_CoVMEvSysCptMaxErrPrim03 "" UWORD DFCDSQ_Verb 1 100 0.00 65535.0000000 FORMAT "%13.7" ECU_ADDRESS 0x60022192 /end MEASUREMENT
/begin MEASUREMENT DINH_xWhy.FId_CoVMEvSysCptMaxErrPrim04 "" UWORD DFCDSQ_Verb 1 100 0.00 65535.0000000 FORMAT "%13.7" ECU_ADDRESS 0x60022194 /end MEASUREMENT
/begin MEASUREMENT DINH_xWhy.FId_CoVMEvSysCptMaxErrPrim05 "" UWORD DFCDSQ_Verb 1 100 0.00 65535.0000000 FORMAT "%13.7" ECU_ADDRESS 0x60022196 /end MEASUREMENT
/begin MEASUREMENT DINH_xWhy.FId_CoVMEvSysCptMinErrPrim01 "" UWORD DFCDSQ_Verb 1 100 0.00 65535.0000000 FORMAT "%13.7" ECU_ADDRESS 0x60022198 /end MEASUREMENT
/begin MEASUREMENT DINH_xWhy.FId_CoVMEvSysCptMinErrPrim02 "" UWORD DFCDSQ_Verb 1 100 0.00 65535.0000000 FORMAT "%13.7" ECU_ADDRESS 0x6002219A /end MEASUREMENT
/begin MEASUREMENT DINH_xWhy.FId_CoVMEvSysCptMinErrPrim03 "" UWORD DFCDSQ_Verb 1 100 0.00 65535.0000000 FORMAT "%13.7" ECU_ADDRESS 0x6002219C /end MEASUREMENT
/begin MEASUREMENT DINH_xWhy.FId_CoVMEvVehVVld "" UWORD DFCDSQ_Verb 1 100 0.00 65535.0000000 FORMAT "%13.7" ECU_ADDRESS 0x6002219E /end MEASUREMENT
/begin MEASUREMENT DINH_xWhy.FId_ComHillHldFrmErr "" UWORD DFCDSQ_Verb 1 100 0.00 65535.0000000 FORMAT "%13.7" ECU_ADDRESS 0x600221A0 /end MEASUREMENT
/begin MEASUREMENT DINH_xWhy.FId_Com_stMainWkuInvld "" UWORD DFCDSQ_Verb 1 100 0.00 65535.0000000 FORMAT "%13.7" ECU_ADDRESS 0x600221A2 /end MEASUREMENT
/begin MEASUREMENT DINH_xWhy.FId_CtPSwtActrMonOff "" UWORD DFCDSQ_Verb 1 100 0.00 65535.0000000 FORMAT "%13.7" ECU_ADDRESS 0x600221A4 /end MEASUREMENT
/begin MEASUREMENT DINH_xWhy.FId_CtPSwtActrOff "" UWORD DFCDSQ_Verb 1 100 0.00 65535.0000000 FORMAT "%13.7" ECU_ADDRESS 0x600221A6 /end MEASUREMENT
/begin MEASUREMENT DINH_xWhy.FId_CtPSwtActrPsOff "" UWORD DFCDSQ_Verb 1 100 0.00 65535.0000000 FORMAT "%13.7" ECU_ADDRESS 0x600221A8 /end MEASUREMENT
/begin MEASUREMENT DINH_xWhy.FId_CtPSwtActrSnsr "" UWORD DFCDSQ_Verb 1 100 0.00 65535.0000000 FORMAT "%13.7" ECU_ADDRESS 0x600221AA /end MEASUREMENT
/begin MEASUREMENT DINH_xWhy.FId_CtPSwtDiagEnhdSRCMax "" UWORD DFCDSQ_Verb 1 100 0.00 65535.0000000 FORMAT "%13.7" ECU_ADDRESS 0x600221AC /end MEASUREMENT
/begin MEASUREMENT DINH_xWhy.FId_CtPSwtDiagFrzVal "" UWORD DFCDSQ_Verb 1 100 0.00 65535.0000000 FORMAT "%13.7" ECU_ADDRESS 0x600221AE /end MEASUREMENT
/begin MEASUREMENT DINH_xWhy.FId_CtPSwtDiagPhysRng "" UWORD DFCDSQ_Verb 1 100 0.00 65535.0000000 FORMAT "%13.7" ECU_ADDRESS 0x600221B0 /end MEASUREMENT
/begin MEASUREMENT DINH_xWhy.FId_CtPSwtDiagRplVal "" UWORD DFCDSQ_Verb 1 100 0.00 65535.0000000 FORMAT "%13.7" ECU_ADDRESS 0x600221B2 /end MEASUREMENT
/begin MEASUREMENT DINH_xWhy.FId_CtPSwtDiagSSpMon "" UWORD DFCDSQ_Verb 1 100 0.00 65535.0000000 FORMAT "%13.7" ECU_ADDRESS 0x600221B4 /end MEASUREMENT
/begin MEASUREMENT DINH_xWhy.FId_CtPSwtDiagTmpErrCnt "" UWORD DFCDSQ_Verb 1 100 0.00 65535.0000000 FORMAT "%13.7" ECU_ADDRESS 0x600221B6 /end MEASUREMENT
/begin MEASUREMENT DINH_xWhy.FId_CtpCarrFrqFrzVal "" UWORD DFCDSQ_Verb 1 100 0.00 65535.0000000 FORMAT "%13.7" ECU_ADDRESS 0x600221B8 /end MEASUREMENT
/begin MEASUREMENT DINH_xWhy.FId_CtpCarrFrqPhysRng "" UWORD DFCDSQ_Verb 1 100 0.00 65535.0000000 FORMAT "%13.7" ECU_ADDRESS 0x600221BA /end MEASUREMENT
/begin MEASUREMENT DINH_xWhy.FId_CtpCarrFrqRplVal "" UWORD DFCDSQ_Verb 1 100 0.00 65535.0000000 FORMAT "%13.7" ECU_ADDRESS 0x600221BC /end MEASUREMENT
/begin MEASUREMENT DINH_xWhy.FId_CtpCarrFrqSSpMon "" UWORD DFCDSQ_Verb 1 100 0.00 65535.0000000 FORMAT "%13.7" ECU_ADDRESS 0x600221BE /end MEASUREMENT
/begin MEASUREMENT DINH_xWhy.FId_CtpCarrFrqTmpErrCnt "" UWORD DFCDSQ_Verb 1 100 0.00 65535.0000000 FORMAT "%13.7" ECU_ADDRESS 0x600221C0 /end MEASUREMENT
/begin MEASUREMENT DINH_xWhy.FId_DELibAcChrgrIntkT "" UWORD DFCDSQ_Verb 1 100 0.00 65535.0000000 FORMAT "%13.7" ECU_ADDRESS 0x600221C2 /end MEASUREMENT
/begin MEASUREMENT DINH_xWhy.FId_DELibDcChrgrIntkT "" UWORD DFCDSQ_Verb 1 100 0.00 65535.0000000 FORMAT "%13.7" ECU_ADDRESS 0x600221C4 /end MEASUREMENT
/begin MEASUREMENT DINH_xWhy.FId_DELibEnvP "" UWORD DFCDSQ_Verb 1 100 0.00 65535.0000000 FORMAT "%13.7" ECU_ADDRESS 0x600221C6 /end MEASUREMENT
/begin MEASUREMENT DINH_xWhy.FId_DELibEnvT "" UWORD DFCDSQ_Verb 1 100 0.00 65535.0000000 FORMAT "%13.7" ECU_ADDRESS 0x600221C8 /end MEASUREMENT
/begin MEASUREMENT DINH_xWhy.FId_DELibHeatrCoreT "" UWORD DFCDSQ_Verb 1 100 0.00 65535.0000000 FORMAT "%13.7" ECU_ADDRESS 0x600221CA /end MEASUREMENT
/begin MEASUREMENT DINH_xWhy.FId_DSMAUXWucVrnt5 "" UWORD DFCDSQ_Verb 1 100 0.00 65535.0000000 FORMAT "%13.7" ECU_ADDRESS 0x600221CC /end MEASUREMENT
/begin MEASUREMENT DINH_xWhy.FId_DcChrgnCtrlChrgPrmExch "" UWORD DFCDSQ_Verb 1 100 0.00 65535.0000000 FORMAT "%13.7" ECU_ADDRESS 0x600221CE /end MEASUREMENT
/begin MEASUREMENT DINH_xWhy.FId_DcChrgrIntkT2EnhdSRCMax "" UWORD DFCDSQ_Verb 1 100 0.00 65535.0000000 FORMAT "%13.7" ECU_ADDRESS 0x600221D0 /end MEASUREMENT
/begin MEASUREMENT DINH_xWhy.FId_DcChrgrIntkT2FrzVal "" UWORD DFCDSQ_Verb 1 100 0.00 65535.0000000 FORMAT "%13.7" ECU_ADDRESS 0x600221D2 /end MEASUREMENT
/begin MEASUREMENT DINH_xWhy.FId_DcChrgrIntkT2PhysRng "" UWORD DFCDSQ_Verb 1 100 0.00 65535.0000000 FORMAT "%13.7" ECU_ADDRESS 0x600221D4 /end MEASUREMENT
/begin MEASUREMENT DINH_xWhy.FId_DcChrgrIntkT2RplVal "" UWORD DFCDSQ_Verb 1 100 0.00 65535.0000000 FORMAT "%13.7" ECU_ADDRESS 0x600221D6 /end MEASUREMENT
/begin MEASUREMENT DINH_xWhy.FId_DcChrgrIntkT2SSpMon "" UWORD DFCDSQ_Verb 1 100 0.00 65535.0000000 FORMAT "%13.7" ECU_ADDRESS 0x600221D8 /end MEASUREMENT
/begin MEASUREMENT DINH_xWhy.FId_DcChrgrIntkT2TmpErrCnt "" UWORD DFCDSQ_Verb 1 100 0.00 65535.0000000 FORMAT "%13.7" ECU_ADDRESS 0x600221DA /end MEASUREMENT
/begin MEASUREMENT DINH_xWhy.FId_DcChrgrIntkTEnhdSRCMax "" UWORD DFCDSQ_Verb 1 100 0.00 65535.0000000 FORMAT "%13.7" ECU_ADDRESS 0x600221DC /end MEASUREMENT
/begin MEASUREMENT DINH_xWhy.FId_DcChrgrIntkTFrzVal "" UWORD DFCDSQ_Verb 1 100 0.00 65535.0000000 FORMAT "%13.7" ECU_ADDRESS 0x600221DE /end MEASUREMENT
/begin MEASUREMENT DINH_xWhy.FId_DcChrgrIntkTPhysRng "" UWORD DFCDSQ_Verb 1 100 0.00 65535.0000000 FORMAT "%13.7" ECU_ADDRESS 0x600221E0 /end MEASUREMENT
/begin MEASUREMENT DINH_xWhy.FId_DcChrgrIntkTRplVal "" UWORD DFCDSQ_Verb 1 100 0.00 65535.0000000 FORMAT "%13.7" ECU_ADDRESS 0x600221E2 /end MEASUREMENT
/begin MEASUREMENT DINH_xWhy.FId_DcChrgrIntkTSSpMon "" UWORD DFCDSQ_Verb 1 100 0.00 65535.0000000 FORMAT "%13.7" ECU_ADDRESS 0x600221E4 /end MEASUREMENT
/begin MEASUREMENT DINH_xWhy.FId_DcChrgrIntkTTmpErrCnt "" UWORD DFCDSQ_Verb 1 100 0.00 65535.0000000 FORMAT "%13.7" ECU_ADDRESS 0x600221E6 /end MEASUREMENT
/begin MEASUREMENT DINH_xWhy.FId_DcdcDesOperModFwd "" UWORD DFCDSQ_Verb 1 100 0.00 65535.0000000 FORMAT "%13.7" ECU_ADDRESS 0x600221E8 /end MEASUREMENT
/begin MEASUREMENT DINH_xWhy.FId_DcdcPwrLoadMngtMaxPred "" UWORD DFCDSQ_Verb 1 100 0.00 65535.0000000 FORMAT "%13.7" ECU_ADDRESS 0x600221EA /end MEASUREMENT
/begin MEASUREMENT DINH_xWhy.FId_DcdcUDesLvGrid "" UWORD DFCDSQ_Verb 1 100 0.00 65535.0000000 FORMAT "%13.7" ECU_ADDRESS 0x600221EC /end MEASUREMENT
/begin MEASUREMENT DINH_xWhy.FId_DcmDspUDSStPwrLatch "" UWORD DFCDSQ_Verb 1 100 0.00 65535.0000000 FORMAT "%13.7" ECU_ADDRESS 0x600221EE /end MEASUREMENT
/begin MEASUREMENT DINH_xWhy.FId_DrvDoorCANSigFault "" UWORD DFCDSQ_Verb 1 100 0.00 65535.0000000 FORMAT "%13.7" ECU_ADDRESS 0x600221F0 /end MEASUREMENT
/begin MEASUREMENT DINH_xWhy.FId_DrvInfoEgyAvlErr "" UWORD DFCDSQ_Verb 1 100 0.00 65535.0000000 FORMAT "%13.7" ECU_ADDRESS 0x600221F2 /end MEASUREMENT
/begin MEASUREMENT DINH_xWhy.FId_DrvModPosnApp "" UWORD DFCDSQ_Verb 1 100 0.00 65535.0000000 FORMAT "%13.7" ECU_ADDRESS 0x600221F4 /end MEASUREMENT
/begin MEASUREMENT DINH_xWhy.FId_DrvPrgSwtEna "" UWORD DFCDSQ_Verb 1 100 0.00 65535.0000000 FORMAT "%13.7" ECU_ADDRESS 0x600221F6 /end MEASUREMENT
/begin MEASUREMENT DINH_xWhy.FId_DrvStbltCANSigFault "" UWORD DFCDSQ_Verb 1 100 0.00 65535.0000000 FORMAT "%13.7" ECU_ADDRESS 0x600221F8 /end MEASUREMENT
/begin MEASUREMENT DINH_xWhy.FId_EBDLmpSig "" UWORD DFCDSQ_Verb 1 100 0.00 65535.0000000 FORMAT "%13.7" ECU_ADDRESS 0x600221FA /end MEASUREMENT
/begin MEASUREMENT DINH_xWhy.FId_EVLmpBlnkIllmn "" UWORD DFCDSQ_Verb 1 100 0.00 65535.0000000 FORMAT "%13.7" ECU_ADDRESS 0x600221FC /end MEASUREMENT
/begin MEASUREMENT DINH_xWhy.FId_EVLmpContIllmn "" UWORD DFCDSQ_Verb 1 100 0.00 65535.0000000 FORMAT "%13.7" ECU_ADDRESS 0x600221FE /end MEASUREMENT
/begin MEASUREMENT DINH_xWhy.FId_EbsLinErr "" UWORD DFCDSQ_Verb 1 100 0.00 65535.0000000 FORMAT "%13.7" ECU_ADDRESS 0x60022200 /end MEASUREMENT
/begin MEASUREMENT DINH_xWhy.FId_EemDcdcPrecErr "" UWORD DFCDSQ_Verb 1 100 0.00 65535.0000000 FORMAT "%13.7" ECU_ADDRESS 0x60022202 /end MEASUREMENT
/begin MEASUREMENT DINH_xWhy.FId_EemDcdcUHVAct "" UWORD DFCDSQ_Verb 1 100 0.00 65535.0000000 FORMAT "%13.7" ECU_ADDRESS 0x60022204 /end MEASUREMENT
/begin MEASUREMENT DINH_xWhy.FId_EemFltHvDcha "" UWORD DFCDSQ_Verb 1 100 0.00 65535.0000000 FORMAT "%13.7" ECU_ADDRESS 0x60022206 /end MEASUREMENT
/begin MEASUREMENT DINH_xWhy.FId_EemFstHvShdwn "" UWORD DFCDSQ_Verb 1 100 0.00 65535.0000000 FORMAT "%13.7" ECU_ADDRESS 0x60022208 /end MEASUREMENT
/begin MEASUREMENT DINH_xWhy.FId_EemHvBattMod "" UWORD DFCDSQ_Verb 1 100 0.00 65535.0000000 FORMAT "%13.7" ECU_ADDRESS 0x6002220A /end MEASUREMENT
/begin MEASUREMENT DINH_xWhy.FId_EemHvOffTout "" UWORD DFCDSQ_Verb 1 100 0.00 65535.0000000 FORMAT "%13.7" ECU_ADDRESS 0x6002220C /end MEASUREMENT
/begin MEASUREMENT DINH_xWhy.FId_EemHvShdwn "" UWORD DFCDSQ_Verb 1 100 0.00 65535.0000000 FORMAT "%13.7" ECU_ADDRESS 0x6002220E /end MEASUREMENT
/begin MEASUREMENT DINH_xWhy.FId_EemNoHvStrtup "" UWORD DFCDSQ_Verb 1 100 0.00 65535.0000000 FORMAT "%13.7" ECU_ADDRESS 0x60022210 /end MEASUREMENT
/begin MEASUREMENT DINH_xWhy.FId_ElMNoPrp01 "" UWORD DFCDSQ_Verb 1 100 0.00 65535.0000000 FORMAT "%13.7" ECU_ADDRESS 0x60022212 /end MEASUREMENT
/begin MEASUREMENT DINH_xWhy.FId_ElMnLim01 "" UWORD DFCDSQ_Verb 1 100 0.00 65535.0000000 FORMAT "%13.7" ECU_ADDRESS 0x60022214 /end MEASUREMENT
/begin MEASUREMENT DINH_xWhy.FId_ElMtrqLim01 "" UWORD DFCDSQ_Verb 1 100 0.00 65535.0000000 FORMAT "%13.7" ECU_ADDRESS 0x60022216 /end MEASUREMENT
/begin MEASUREMENT DINH_xWhy.FId_ElSSACCmprUFlt "" UWORD DFCDSQ_Verb 1 100 0.00 65535.0000000 FORMAT "%13.7" ECU_ADDRESS 0x60022218 /end MEASUREMENT
/begin MEASUREMENT DINH_xWhy.FId_ElSSCabAirHtUFlt "" UWORD DFCDSQ_Verb 1 100 0.00 65535.0000000 FORMAT "%13.7" ECU_ADDRESS 0x6002221A /end MEASUREMENT
/begin MEASUREMENT DINH_xWhy.FId_ElSSHvReqEna "" UWORD DFCDSQ_Verb 1 100 0.00 65535.0000000 FORMAT "%13.7" ECU_ADDRESS 0x6002221C /end MEASUREMENT
/begin MEASUREMENT DINH_xWhy.FId_ElSSUHvDcBus "" UWORD DFCDSQ_Verb 1 100 0.00 65535.0000000 FORMAT "%13.7" ECU_ADDRESS 0x6002221E /end MEASUREMENT
/begin MEASUREMENT DINH_xWhy.FId_ElTSHvIntlck "" UWORD DFCDSQ_Verb 1 100 0.00 65535.0000000 FORMAT "%13.7" ECU_ADDRESS 0x60022220 /end MEASUREMENT
/begin MEASUREMENT DINH_xWhy.FId_EmWakeupSigMonOff "" UWORD DFCDSQ_Verb 1 100 0.00 65535.0000000 FORMAT "%13.7" ECU_ADDRESS 0x60022222 /end MEASUREMENT
/begin MEASUREMENT DINH_xWhy.FId_EmWakeupSigOff "" UWORD DFCDSQ_Verb 1 100 0.00 65535.0000000 FORMAT "%13.7" ECU_ADDRESS 0x60022224 /end MEASUREMENT
/begin MEASUREMENT DINH_xWhy.FId_EmWakeupSigPsOff "" UWORD DFCDSQ_Verb 1 100 0.00 65535.0000000 FORMAT "%13.7" ECU_ADDRESS 0x60022226 /end MEASUREMENT
/begin MEASUREMENT DINH_xWhy.FId_EmWakeupSigSnsr "" UWORD DFCDSQ_Verb 1 100 0.00 65535.0000000 FORMAT "%13.7" ECU_ADDRESS 0x60022228 /end MEASUREMENT
/begin MEASUREMENT DINH_xWhy.FId_EmacUDcLnk01 "" UWORD DFCDSQ_Verb 1 100 0.00 65535.0000000 FORMAT "%13.7" ECU_ADDRESS 0x6002222A /end MEASUREMENT
/begin MEASUREMENT DINH_xWhy.FId_EvThermLTClgDmdErr "" UWORD DFCDSQ_Verb 1 100 0.00 65535.0000000 FORMAT "%13.7" ECU_ADDRESS 0x6002222C /end MEASUREMENT
/begin MEASUREMENT DINH_xWhy.FId_EvThermMTClgDmdErr "" UWORD DFCDSQ_Verb 1 100 0.00 65535.0000000 FORMAT "%13.7" ECU_ADDRESS 0x6002222E /end MEASUREMENT
/begin MEASUREMENT DINH_xWhy.FId_Fan1ActrOff "" UWORD DFCDSQ_Verb 1 100 0.00 65535.0000000 FORMAT "%13.7" ECU_ADDRESS 0x60022230 /end MEASUREMENT
/begin MEASUREMENT DINH_xWhy.FId_Fan1Mon "" UWORD DFCDSQ_Verb 1 100 0.00 65535.0000000 FORMAT "%13.7" ECU_ADDRESS 0x60022232 /end MEASUREMENT
/begin MEASUREMENT DINH_xWhy.FId_Fan1Off "" UWORD DFCDSQ_Verb 1 100 0.00 65535.0000000 FORMAT "%13.7" ECU_ADDRESS 0x60022234 /end MEASUREMENT
/begin MEASUREMENT DINH_xWhy.FId_Fan1PsSwtOff "" UWORD DFCDSQ_Verb 1 100 0.00 65535.0000000 FORMAT "%13.7" ECU_ADDRESS 0x60022236 /end MEASUREMENT
/begin MEASUREMENT DINH_xWhy.FId_Fan1PwrStg "" UWORD DFCDSQ_Verb 1 100 0.00 65535.0000000 FORMAT "%13.7" ECU_ADDRESS 0x60022238 /end MEASUREMENT
/begin MEASUREMENT DINH_xWhy.FId_FanCtlFan1Err "" UWORD DFCDSQ_Verb 1 100 0.00 65535.0000000 FORMAT "%13.7" ECU_ADDRESS 0x6002223A /end MEASUREMENT
/begin MEASUREMENT DINH_xWhy.FId_FanRlyDiagEnad "" UWORD DFCDSQ_Verb 1 100 0.00 65535.0000000 FORMAT "%13.7" ECU_ADDRESS 0x6002223C /end MEASUREMENT
/begin MEASUREMENT DINH_xWhy.FId_FanSpdEnhdSRCMax "" UWORD DFCDSQ_Verb 1 100 0.00 65535.0000000 FORMAT "%13.7" ECU_ADDRESS 0x6002223E /end MEASUREMENT
/begin MEASUREMENT DINH_xWhy.FId_FanSpdFrzVal "" UWORD DFCDSQ_Verb 1 100 0.00 65535.0000000 FORMAT "%13.7" ECU_ADDRESS 0x60022240 /end MEASUREMENT
/begin MEASUREMENT DINH_xWhy.FId_FanSpdPhysRng "" UWORD DFCDSQ_Verb 1 100 0.00 65535.0000000 FORMAT "%13.7" ECU_ADDRESS 0x60022242 /end MEASUREMENT
/begin MEASUREMENT DINH_xWhy.FId_FanSpdRplVal "" UWORD DFCDSQ_Verb 1 100 0.00 65535.0000000 FORMAT "%13.7" ECU_ADDRESS 0x60022244 /end MEASUREMENT
/begin MEASUREMENT DINH_xWhy.FId_FanSpdSSpMon "" UWORD DFCDSQ_Verb 1 100 0.00 65535.0000000 FORMAT "%13.7" ECU_ADDRESS 0x60022246 /end MEASUREMENT
/begin MEASUREMENT DINH_xWhy.FId_FanSpdTmpErrCnt "" UWORD DFCDSQ_Verb 1 100 0.00 65535.0000000 FORMAT "%13.7" ECU_ADDRESS 0x60022248 /end MEASUREMENT
/begin MEASUREMENT DINH_xWhy.FId_FansFacCor "" UWORD DFCDSQ_Verb 1 100 0.00 65535.0000000 FORMAT "%13.7" ECU_ADDRESS 0x6002224A /end MEASUREMENT
/begin MEASUREMENT DINH_xWhy.FId_FiMFID_rba_MRly_Diag_Stk "" UWORD DFCDSQ_Verb 1 100 0.00 65535.0000000 FORMAT "%13.7" ECU_ADDRESS 0x6002224C /end MEASUREMENT
/begin MEASUREMENT DINH_xWhy.FId_FiMFID_test "" UWORD DFCDSQ_Verb 1 100 0.00 65535.0000000 FORMAT "%13.7" ECU_ADDRESS 0x6002224E /end MEASUREMENT
/begin MEASUREMENT DINH_xWhy.FId_FreonPEnhdSRCMax "" UWORD DFCDSQ_Verb 1 100 0.00 65535.0000000 FORMAT "%13.7" ECU_ADDRESS 0x60022250 /end MEASUREMENT
/begin MEASUREMENT DINH_xWhy.FId_FreonPFrzVal "" UWORD DFCDSQ_Verb 1 100 0.00 65535.0000000 FORMAT "%13.7" ECU_ADDRESS 0x60022252 /end MEASUREMENT
/begin MEASUREMENT DINH_xWhy.FId_FreonPPhysRng "" UWORD DFCDSQ_Verb 1 100 0.00 65535.0000000 FORMAT "%13.7" ECU_ADDRESS 0x60022254 /end MEASUREMENT
/begin MEASUREMENT DINH_xWhy.FId_FreonPRplVal "" UWORD DFCDSQ_Verb 1 100 0.00 65535.0000000 FORMAT "%13.7" ECU_ADDRESS 0x60022256 /end MEASUREMENT
/begin MEASUREMENT DINH_xWhy.FId_FreonPSSpMon "" UWORD DFCDSQ_Verb 1 100 0.00 65535.0000000 FORMAT "%13.7" ECU_ADDRESS 0x60022258 /end MEASUREMENT
/begin MEASUREMENT DINH_xWhy.FId_FreonPTmpErrCnt "" UWORD DFCDSQ_Verb 1 100 0.00 65535.0000000 FORMAT "%13.7" ECU_ADDRESS 0x6002225A /end MEASUREMENT
/begin MEASUREMENT DINH_xWhy.FId_GlbDaLSumvXPtd "" UWORD DFCDSQ_Verb 1 100 0.00 65535.0000000 FORMAT "%13.7" ECU_ADDRESS 0x6002225C /end MEASUREMENT
/begin MEASUREMENT DINH_xWhy.FId_HLCCcs_CoornPLnCChipTHi "" UWORD DFCDSQ_Verb 1 100 0.00 65535.0000000 FORMAT "%13.7" ECU_ADDRESS 0x6002225E /end MEASUREMENT
/begin MEASUREMENT DINH_xWhy.FId_HLCCcs_CoornPLnCChpT "" UWORD DFCDSQ_Verb 1 100 0.00 65535.0000000 FORMAT "%13.7" ECU_ADDRESS 0x60022260 /end MEASUREMENT
/begin MEASUREMENT DINH_xWhy.FId_HeatrCoreTEnhdSRCMax "" UWORD DFCDSQ_Verb 1 100 0.00 65535.0000000 FORMAT "%13.7" ECU_ADDRESS 0x60022262 /end MEASUREMENT
/begin MEASUREMENT DINH_xWhy.FId_HeatrCoreTFrzVal "" UWORD DFCDSQ_Verb 1 100 0.00 65535.0000000 FORMAT "%13.7" ECU_ADDRESS 0x60022264 /end MEASUREMENT
/begin MEASUREMENT DINH_xWhy.FId_HeatrCoreTPhysRng "" UWORD DFCDSQ_Verb 1 100 0.00 65535.0000000 FORMAT "%13.7" ECU_ADDRESS 0x60022266 /end MEASUREMENT
/begin MEASUREMENT DINH_xWhy.FId_HeatrCoreTRplVal "" UWORD DFCDSQ_Verb 1 100 0.00 65535.0000000 FORMAT "%13.7" ECU_ADDRESS 0x60022268 /end MEASUREMENT
/begin MEASUREMENT DINH_xWhy.FId_HeatrCoreTSSpMon "" UWORD DFCDSQ_Verb 1 100 0.00 65535.0000000 FORMAT "%13.7" ECU_ADDRESS 0x6002226A /end MEASUREMENT
/begin MEASUREMENT DINH_xWhy.FId_HeatrCoreTTmpErrCnt "" UWORD DFCDSQ_Verb 1 100 0.00 65535.0000000 FORMAT "%13.7" ECU_ADDRESS 0x6002226C /end MEASUREMENT
/begin MEASUREMENT DINH_xWhy.FId_HvBattChrgLvl3DernFlt "" UWORD DFCDSQ_Verb 1 100 0.00 65535.0000000 FORMAT "%13.7" ECU_ADDRESS 0x6002226E /end MEASUREMENT
/begin MEASUREMENT DINH_xWhy.FId_HvBattDchaLvl3DernFlt "" UWORD DFCDSQ_Verb 1 100 0.00 65535.0000000 FORMAT "%13.7" ECU_ADDRESS 0x60022270 /end MEASUREMENT
/begin MEASUREMENT DINH_xWhy.FId_HvBattDesChrgIDern "" UWORD DFCDSQ_Verb 1 100 0.00 65535.0000000 FORMAT "%13.7" ECU_ADDRESS 0x60022272 /end MEASUREMENT
/begin MEASUREMENT DINH_xWhy.FId_HvBattMaiSwtDiagEna "" UWORD DFCDSQ_Verb 1 100 0.00 65535.0000000 FORMAT "%13.7" ECU_ADDRESS 0x60022274 /end MEASUREMENT
/begin MEASUREMENT DINH_xWhy.FId_HvBattMaxPwrBusTDern "" UWORD DFCDSQ_Verb 1 100 0.00 65535.0000000 FORMAT "%13.7" ECU_ADDRESS 0x60022276 /end MEASUREMENT
/begin MEASUREMENT DINH_xWhy.FId_HvBattNegCntctrCnt "" UWORD DFCDSQ_Verb 1 100 0.00 65535.0000000 FORMAT "%13.7" ECU_ADDRESS 0x60022278 /end MEASUREMENT
/begin MEASUREMENT DINH_xWhy.FId_HvBattPosCntctrCnt "" UWORD DFCDSQ_Verb 1 100 0.00 65535.0000000 FORMAT "%13.7" ECU_ADDRESS 0x6002227A /end MEASUREMENT
/begin MEASUREMENT DINH_xWhy.FId_HvBattPrecCntctrCnt "" UWORD DFCDSQ_Verb 1 100 0.00 65535.0000000 FORMAT "%13.7" ECU_ADDRESS 0x6002227C /end MEASUREMENT
/begin MEASUREMENT DINH_xWhy.FId_HvBattPwrDistbnTDern "" UWORD DFCDSQ_Verb 1 100 0.00 65535.0000000 FORMAT "%13.7" ECU_ADDRESS 0x6002227E /end MEASUREMENT
/begin MEASUREMENT DINH_xWhy.FId_HvBattPwrDistbnTInhbn "" UWORD DFCDSQ_Verb 1 100 0.00 65535.0000000 FORMAT "%13.7" ECU_ADDRESS 0x60022280 /end MEASUREMENT
/begin MEASUREMENT DINH_xWhy.FId_HvBattRatRSoh "" UWORD DFCDSQ_Verb 1 100 0.00 65535.0000000 FORMAT "%13.7" ECU_ADDRESS 0x60022282 /end MEASUREMENT
/begin MEASUREMENT DINH_xWhy.FId_HvBattRatSoh "" UWORD DFCDSQ_Verb 1 100 0.00 65535.0000000 FORMAT "%13.7" ECU_ADDRESS 0x60022284 /end MEASUREMENT
/begin MEASUREMENT DINH_xWhy.FId_HvGridAuxPwr01 "" UWORD DFCDSQ_Verb 1 100 0.00 65535.0000000 FORMAT "%13.7" ECU_ADDRESS 0x60022286 /end MEASUREMENT
/begin MEASUREMENT DINH_xWhy.FId_HvGridAuxPwr02 "" UWORD DFCDSQ_Verb 1 100 0.00 65535.0000000 FORMAT "%13.7" ECU_ADDRESS 0x60022288 /end MEASUREMENT
/begin MEASUREMENT DINH_xWhy.FId_HvGridAuxPwr03 "" UWORD DFCDSQ_Verb 1 100 0.00 65535.0000000 FORMAT "%13.7" ECU_ADDRESS 0x6002228A /end MEASUREMENT
/begin MEASUREMENT DINH_xWhy.FId_HvGridAuxPwr04 "" UWORD DFCDSQ_Verb 1 100 0.00 65535.0000000 FORMAT "%13.7" ECU_ADDRESS 0x6002228C /end MEASUREMENT
/begin MEASUREMENT DINH_xWhy.FId_HvGridDcdcPwr "" UWORD DFCDSQ_Verb 1 100 0.00 65535.0000000 FORMAT "%13.7" ECU_ADDRESS 0x6002228E /end MEASUREMENT
/begin MEASUREMENT DINH_xWhy.FId_HvGridDcdcUSftyErr "" UWORD DFCDSQ_Verb 1 100 0.00 65535.0000000 FORMAT "%13.7" ECU_ADDRESS 0x60022290 /end MEASUREMENT
/begin MEASUREMENT DINH_xWhy.FId_HvGridElM01USftyErr "" UWORD DFCDSQ_Verb 1 100 0.00 65535.0000000 FORMAT "%13.7" ECU_ADDRESS 0x60022292 /end MEASUREMENT
/begin MEASUREMENT DINH_xWhy.FId_HvGridHvBattSftyLimErr "" UWORD DFCDSQ_Verb 1 100 0.00 65535.0000000 FORMAT "%13.7" ECU_ADDRESS 0x60022294 /end MEASUREMENT
/begin MEASUREMENT DINH_xWhy.FId_HvGridMaiSwtErr "" UWORD DFCDSQ_Verb 1 100 0.00 65535.0000000 FORMAT "%13.7" ECU_ADDRESS 0x60022296 /end MEASUREMENT
/begin MEASUREMENT DINH_xWhy.FId_HvGridPwrMaxChrgContnsErr "" UWORD DFCDSQ_Verb 1 100 0.00 65535.0000000 FORMAT "%13.7" ECU_ADDRESS 0x60022298 /end MEASUREMENT
/begin MEASUREMENT DINH_xWhy.FId_HvGridPwrMaxChrgShoErr "" UWORD DFCDSQ_Verb 1 100 0.00 65535.0000000 FORMAT "%13.7" ECU_ADDRESS 0x6002229A /end MEASUREMENT
/begin MEASUREMENT DINH_xWhy.FId_HvGridPwrMaxDchaContnsErr "" UWORD DFCDSQ_Verb 1 100 0.00 65535.0000000 FORMAT "%13.7" ECU_ADDRESS 0x6002229C /end MEASUREMENT
/begin MEASUREMENT DINH_xWhy.FId_HvGridPwrMaxDchaShoErr "" UWORD DFCDSQ_Verb 1 100 0.00 65535.0000000 FORMAT "%13.7" ECU_ADDRESS 0x6002229E /end MEASUREMENT
/begin MEASUREMENT DINH_xWhy.FId_HvacHmiFlt "" UWORD DFCDSQ_Verb 1 100 0.00 65535.0000000 FORMAT "%13.7" ECU_ADDRESS 0x600222A0 /end MEASUREMENT
/begin MEASUREMENT DINH_xWhy.FId_HvacModCoolgFlt "" UWORD DFCDSQ_Verb 1 100 0.00 65535.0000000 FORMAT "%13.7" ECU_ADDRESS 0x600222A2 /end MEASUREMENT
/begin MEASUREMENT DINH_xWhy.FId_HvacModHeatgFlt "" UWORD DFCDSQ_Verb 1 100 0.00 65535.0000000 FORMAT "%13.7" ECU_ADDRESS 0x600222A4 /end MEASUREMENT
/begin MEASUREMENT DINH_xWhy.FId_HvacPtcHeatrErr "" UWORD DFCDSQ_Verb 1 100 0.00 65535.0000000 FORMAT "%13.7" ECU_ADDRESS 0x600222A6 /end MEASUREMENT
/begin MEASUREMENT DINH_xWhy.FId_InhibitAlways "" UWORD DFCDSQ_Verb 1 100 0.00 65535.0000000 FORMAT "%13.7" ECU_ADDRESS 0x600222A8 /end MEASUREMENT
/begin MEASUREMENT DINH_xWhy.FId_InhibitNever "" UWORD DFCDSQ_Verb 1 100 0.00 65535.0000000 FORMAT "%13.7" ECU_ADDRESS 0x600222AA /end MEASUREMENT
/begin MEASUREMENT DINH_xWhy.FId_IntlckChrgPlgActrOff "" UWORD DFCDSQ_Verb 1 100 0.00 65535.0000000 FORMAT "%13.7" ECU_ADDRESS 0x600222AC /end MEASUREMENT
/begin MEASUREMENT DINH_xWhy.FId_IntlckChrgPlgHbrdgNotTstd "" UWORD DFCDSQ_Verb 1 100 0.00 65535.0000000 FORMAT "%13.7" ECU_ADDRESS 0x600222AE /end MEASUREMENT
/begin MEASUREMENT DINH_xWhy.FId_IntlckChrgPlgHbrgOLErr "" UWORD DFCDSQ_Verb 1 100 0.00 65535.0000000 FORMAT "%13.7" ECU_ADDRESS 0x600222B0 /end MEASUREMENT
/begin MEASUREMENT DINH_xWhy.FId_IntlckChrgPlgMon "" UWORD DFCDSQ_Verb 1 100 0.00 65535.0000000 FORMAT "%13.7" ECU_ADDRESS 0x600222B2 /end MEASUREMENT
/begin MEASUREMENT DINH_xWhy.FId_IntlckChrgPlgPosnAdcInvld "" UWORD DFCDSQ_Verb 1 100 0.00 65535.0000000 FORMAT "%13.7" ECU_ADDRESS 0x600222B4 /end MEASUREMENT
/begin MEASUREMENT DINH_xWhy.FId_IntlckChrgPlgPsSwtOff "" UWORD DFCDSQ_Verb 1 100 0.00 65535.0000000 FORMAT "%13.7" ECU_ADDRESS 0x600222B6 /end MEASUREMENT
/begin MEASUREMENT DINH_xWhy.FId_IntlckChrgPlgPwrStg "" UWORD DFCDSQ_Verb 1 100 0.00 65535.0000000 FORMAT "%13.7" ECU_ADDRESS 0x600222B8 /end MEASUREMENT
/begin MEASUREMENT DINH_xWhy.FId_IntlckChrgPlg_VehvErr "" UWORD DFCDSQ_Verb 1 100 0.00 65535.0000000 FORMAT "%13.7" ECU_ADDRESS 0x600222BA /end MEASUREMENT
/begin MEASUREMENT DINH_xWhy.FId_LvGridSocErr "" UWORD DFCDSQ_Verb 1 100 0.00 65535.0000000 FORMAT "%13.7" ECU_ADDRESS 0x600222BC /end MEASUREMENT
/begin MEASUREMENT DINH_xWhy.FId_LvGridTErr "" UWORD DFCDSQ_Verb 1 100 0.00 65535.0000000 FORMAT "%13.7" ECU_ADDRESS 0x600222BE /end MEASUREMENT
/begin MEASUREMENT DINH_xWhy.FId_LvGridTestPlsReq "" UWORD DFCDSQ_Verb 1 100 0.00 65535.0000000 FORMAT "%13.7" ECU_ADDRESS 0x600222C0 /end MEASUREMENT
/begin MEASUREMENT DINH_xWhy.FId_LvGridUErr "" UWORD DFCDSQ_Verb 1 100 0.00 65535.0000000 FORMAT "%13.7" ECU_ADDRESS 0x600222C2 /end MEASUREMENT
/begin MEASUREMENT DINH_xWhy.FId_MedTPmpFlt "" UWORD DFCDSQ_Verb 1 100 0.00 65535.0000000 FORMAT "%13.7" ECU_ADDRESS 0x600222C4 /end MEASUREMENT
/begin MEASUREMENT DINH_xWhy.FId_MedTPmpPwrCtrlRly "" UWORD DFCDSQ_Verb 1 100 0.00 65535.0000000 FORMAT "%13.7" ECU_ADDRESS 0x600222C6 /end MEASUREMENT
/begin MEASUREMENT DINH_xWhy.FId_MstWrnLmpBlink "" UWORD DFCDSQ_Verb 1 100 0.00 65535.0000000 FORMAT "%13.7" ECU_ADDRESS 0x600222C8 /end MEASUREMENT
/begin MEASUREMENT DINH_xWhy.FId_MstWrnLmpChime "" UWORD DFCDSQ_Verb 1 100 0.00 65535.0000000 FORMAT "%13.7" ECU_ADDRESS 0x600222CA /end MEASUREMENT
/begin MEASUREMENT DINH_xWhy.FId_MstWrnLmpContIllmn "" UWORD DFCDSQ_Verb 1 100 0.00 65535.0000000 FORMAT "%13.7" ECU_ADDRESS 0x600222CC /end MEASUREMENT
/begin MEASUREMENT DINH_xWhy.FId_PEnvCc "" UWORD DFCDSQ_Verb 1 100 0.00 65535.0000000 FORMAT "%13.7" ECU_ADDRESS 0x600222CE /end MEASUREMENT
/begin MEASUREMENT DINH_xWhy.FId_PEnvEnaBndMdl "" UWORD DFCDSQ_Verb 1 100 0.00 65535.0000000 FORMAT "%13.7" ECU_ADDRESS 0x600222D0 /end MEASUREMENT
/begin MEASUREMENT DINH_xWhy.FId_PEnvMeasVld "" UWORD DFCDSQ_Verb 1 100 0.00 65535.0000000 FORMAT "%13.7" ECU_ADDRESS 0x600222D2 /end MEASUREMENT
/begin MEASUREMENT DINH_xWhy.FId_PEnvPlaus "" UWORD DFCDSQ_Verb 1 100 0.00 65535.0000000 FORMAT "%13.7" ECU_ADDRESS 0x600222D4 /end MEASUREMENT
/begin MEASUREMENT DINH_xWhy.FId_PEnvPrc "" UWORD DFCDSQ_Verb 1 100 0.00 65535.0000000 FORMAT "%13.7" ECU_ADDRESS 0x600222D6 /end MEASUREMENT
/begin MEASUREMENT DINH_xWhy.FId_PEnvRefSnsr "" UWORD DFCDSQ_Verb 1 100 0.00 65535.0000000 FORMAT "%13.7" ECU_ADDRESS 0x600222D8 /end MEASUREMENT
/begin MEASUREMENT DINH_xWhy.FId_PEnvSigRngVld "" UWORD DFCDSQ_Verb 1 100 0.00 65535.0000000 FORMAT "%13.7" ECU_ADDRESS 0x600222DA /end MEASUREMENT
/begin MEASUREMENT DINH_xWhy.FId_PEnvSnsrPlaus "" UWORD DFCDSQ_Verb 1 100 0.00 65535.0000000 FORMAT "%13.7" ECU_ADDRESS 0x600222DC /end MEASUREMENT
/begin MEASUREMENT DINH_xWhy.FId_PerfLimnActvLmpBlink "" UWORD DFCDSQ_Verb 1 100 0.00 65535.0000000 FORMAT "%13.7" ECU_ADDRESS 0x600222DE /end MEASUREMENT
/begin MEASUREMENT DINH_xWhy.FId_PerfLimnActvLmpCont "" UWORD DFCDSQ_Verb 1 100 0.00 65535.0000000 FORMAT "%13.7" ECU_ADDRESS 0x600222E0 /end MEASUREMENT
/begin MEASUREMENT DINH_xWhy.FId_PerfLimnActvLmpContNoChime "" UWORD DFCDSQ_Verb 1 100 0.00 65535.0000000 FORMAT "%13.7" ECU_ADDRESS 0x600222E2 /end MEASUREMENT
/begin MEASUREMENT DINH_xWhy.FId_PwmCtPFrzVal "" UWORD DFCDSQ_Verb 1 100 0.00 65535.0000000 FORMAT "%13.7" ECU_ADDRESS 0x600222E4 /end MEASUREMENT
/begin MEASUREMENT DINH_xWhy.FId_PwmCtPPhysRng "" UWORD DFCDSQ_Verb 1 100 0.00 65535.0000000 FORMAT "%13.7" ECU_ADDRESS 0x600222E6 /end MEASUREMENT
/begin MEASUREMENT DINH_xWhy.FId_PwmCtPRplVal "" UWORD DFCDSQ_Verb 1 100 0.00 65535.0000000 FORMAT "%13.7" ECU_ADDRESS 0x600222E8 /end MEASUREMENT
/begin MEASUREMENT DINH_xWhy.FId_PwmCtPSSpMon "" UWORD DFCDSQ_Verb 1 100 0.00 65535.0000000 FORMAT "%13.7" ECU_ADDRESS 0x600222EA /end MEASUREMENT
/begin MEASUREMENT DINH_xWhy.FId_PwmCtPTmpErrCnt "" UWORD DFCDSQ_Verb 1 100 0.00 65535.0000000 FORMAT "%13.7" ECU_ADDRESS 0x600222EC /end MEASUREMENT
/begin MEASUREMENT DINH_xWhy.FId_PwrDistbnUnitTEnhdSRCMax "" UWORD DFCDSQ_Verb 1 100 0.00 65535.0000000 FORMAT "%13.7" ECU_ADDRESS 0x600222EE /end MEASUREMENT
/begin MEASUREMENT DINH_xWhy.FId_PwrDistbnUnitTFrzVal "" UWORD DFCDSQ_Verb 1 100 0.00 65535.0000000 FORMAT "%13.7" ECU_ADDRESS 0x600222F0 /end MEASUREMENT
/begin MEASUREMENT DINH_xWhy.FId_PwrDistbnUnitTPhysRng "" UWORD DFCDSQ_Verb 1 100 0.00 65535.0000000 FORMAT "%13.7" ECU_ADDRESS 0x600222F2 /end MEASUREMENT
/begin MEASUREMENT DINH_xWhy.FId_PwrDistbnUnitTRplVal "" UWORD DFCDSQ_Verb 1 100 0.00 65535.0000000 FORMAT "%13.7" ECU_ADDRESS 0x600222F4 /end MEASUREMENT
/begin MEASUREMENT DINH_xWhy.FId_PwrDistbnUnitTSSpMon "" UWORD DFCDSQ_Verb 1 100 0.00 65535.0000000 FORMAT "%13.7" ECU_ADDRESS 0x600222F6 /end MEASUREMENT
/begin MEASUREMENT DINH_xWhy.FId_PwrDistbnUnitTTmpErrCnt "" UWORD DFCDSQ_Verb 1 100 0.00 65535.0000000 FORMAT "%13.7" ECU_ADDRESS 0x600222F8 /end MEASUREMENT
/begin MEASUREMENT DINH_xWhy.FId_SCtPmp1ActrOff "" UWORD DFCDSQ_Verb 1 100 0.00 65535.0000000 FORMAT "%13.7" ECU_ADDRESS 0x600222FA /end MEASUREMENT
/begin MEASUREMENT DINH_xWhy.FId_SCtPmp1CircErr "" UWORD DFCDSQ_Verb 1 100 0.00 65535.0000000 FORMAT "%13.7" ECU_ADDRESS 0x600222FC /end MEASUREMENT
/begin MEASUREMENT DINH_xWhy.FId_SCtPmp1Mon "" UWORD DFCDSQ_Verb 1 100 0.00 65535.0000000 FORMAT "%13.7" ECU_ADDRESS 0x600222FE /end MEASUREMENT
/begin MEASUREMENT DINH_xWhy.FId_SCtPmp1Off "" UWORD DFCDSQ_Verb 1 100 0.00 65535.0000000 FORMAT "%13.7" ECU_ADDRESS 0x60022300 /end MEASUREMENT
/begin MEASUREMENT DINH_xWhy.FId_SCtPmp1PsErr "" UWORD DFCDSQ_Verb 1 100 0.00 65535.0000000 FORMAT "%13.7" ECU_ADDRESS 0x60022302 /end MEASUREMENT
/begin MEASUREMENT DINH_xWhy.FId_SCtPmp1PsSwtOff "" UWORD DFCDSQ_Verb 1 100 0.00 65535.0000000 FORMAT "%13.7" ECU_ADDRESS 0x60022304 /end MEASUREMENT
/begin MEASUREMENT DINH_xWhy.FId_SCtPmp1PwrStg "" UWORD DFCDSQ_Verb 1 100 0.00 65535.0000000 FORMAT "%13.7" ECU_ADDRESS 0x60022306 /end MEASUREMENT
/begin MEASUREMENT DINH_xWhy.FId_SCtPmp1QlySensFrzn "" UWORD DFCDSQ_Verb 1 100 0.00 65535.0000000 FORMAT "%13.7" ECU_ADDRESS 0x60022308 /end MEASUREMENT
/begin MEASUREMENT DINH_xWhy.FId_SCtPmp1QlySensRplVal "" UWORD DFCDSQ_Verb 1 100 0.00 65535.0000000 FORMAT "%13.7" ECU_ADDRESS 0x6002230A /end MEASUREMENT
/begin MEASUREMENT DINH_xWhy.FId_SCtPmp1_VehvErr "" UWORD DFCDSQ_Verb 1 100 0.00 65535.0000000 FORMAT "%13.7" ECU_ADDRESS 0x6002230C /end MEASUREMENT
/begin MEASUREMENT DINH_xWhy.FId_SCtPmpRlyActrOff "" UWORD DFCDSQ_Verb 1 100 0.00 65535.0000000 FORMAT "%13.7" ECU_ADDRESS 0x6002230E /end MEASUREMENT
/begin MEASUREMENT DINH_xWhy.FId_SCtPmpRlyMon "" UWORD DFCDSQ_Verb 1 100 0.00 65535.0000000 FORMAT "%13.7" ECU_ADDRESS 0x60022310 /end MEASUREMENT
/begin MEASUREMENT DINH_xWhy.FId_SCtPmpRlyOff "" UWORD DFCDSQ_Verb 1 100 0.00 65535.0000000 FORMAT "%13.7" ECU_ADDRESS 0x60022312 /end MEASUREMENT
/begin MEASUREMENT DINH_xWhy.FId_SCtPmpRlyPsSwtOff "" UWORD DFCDSQ_Verb 1 100 0.00 65535.0000000 FORMAT "%13.7" ECU_ADDRESS 0x60022314 /end MEASUREMENT
/begin MEASUREMENT DINH_xWhy.FId_SCtPmpRlyPwrStg "" UWORD DFCDSQ_Verb 1 100 0.00 65535.0000000 FORMAT "%13.7" ECU_ADDRESS 0x60022316 /end MEASUREMENT
/begin MEASUREMENT DINH_xWhy.FId_SVSWrnLmpBlnkIllmn "" UWORD DFCDSQ_Verb 1 100 0.00 65535.0000000 FORMAT "%13.7" ECU_ADDRESS 0x60022318 /end MEASUREMENT
/begin MEASUREMENT DINH_xWhy.FId_SVSWrnLmpContIllmn "" UWORD DFCDSQ_Verb 1 100 0.00 65535.0000000 FORMAT "%13.7" ECU_ADDRESS 0x6002231A /end MEASUREMENT
/begin MEASUREMENT DINH_xWhy.FId_SpplCooltPmpRlyActrOff "" UWORD DFCDSQ_Verb 1 100 0.00 65535.0000000 FORMAT "%13.7" ECU_ADDRESS 0x6002231C /end MEASUREMENT
/begin MEASUREMENT DINH_xWhy.FId_SpplCooltPmpRlyMon "" UWORD DFCDSQ_Verb 1 100 0.00 65535.0000000 FORMAT "%13.7" ECU_ADDRESS 0x6002231E /end MEASUREMENT
/begin MEASUREMENT DINH_xWhy.FId_SpplCooltPmpRlyOff "" UWORD DFCDSQ_Verb 1 100 0.00 65535.0000000 FORMAT "%13.7" ECU_ADDRESS 0x60022320 /end MEASUREMENT
/begin MEASUREMENT DINH_xWhy.FId_SpplCooltPmpRlyPsSwtOff "" UWORD DFCDSQ_Verb 1 100 0.00 65535.0000000 FORMAT "%13.7" ECU_ADDRESS 0x60022322 /end MEASUREMENT
/begin MEASUREMENT DINH_xWhy.FId_SpplCooltPmpRlyPwrStg "" UWORD DFCDSQ_Verb 1 100 0.00 65535.0000000 FORMAT "%13.7" ECU_ADDRESS 0x60022324 /end MEASUREMENT
/begin MEASUREMENT DINH_xWhy.FId_StrtUpEvDrvAwy "" UWORD DFCDSQ_Verb 1 100 0.00 65535.0000000 FORMAT "%13.7" ECU_ADDRESS 0x60022326 /end MEASUREMENT
/begin MEASUREMENT DINH_xWhy.FId_TelltlCooltTErr "" UWORD DFCDSQ_Verb 1 100 0.00 65535.0000000 FORMAT "%13.7" ECU_ADDRESS 0x60022328 /end MEASUREMENT
/begin MEASUREMENT DINH_xWhy.FId_TelltlCooltTMon "" UWORD DFCDSQ_Verb 1 100 0.00 65535.0000000 FORMAT "%13.7" ECU_ADDRESS 0x6002232A /end MEASUREMENT
/begin MEASUREMENT DINH_xWhy.FId_ThermHvacPreCdngFlt "" UWORD DFCDSQ_Verb 1 100 0.00 65535.0000000 FORMAT "%13.7" ECU_ADDRESS 0x6002232C /end MEASUREMENT
/begin MEASUREMENT DINH_xWhy.FId_ThermModCritErr "" UWORD DFCDSQ_Verb 1 100 0.00 65535.0000000 FORMAT "%13.7" ECU_ADDRESS 0x6002232E /end MEASUREMENT
/begin MEASUREMENT DINH_xWhy.FId_UCtPEnhdSRCMax "" UWORD DFCDSQ_Verb 1 100 0.00 65535.0000000 FORMAT "%13.7" ECU_ADDRESS 0x60022330 /end MEASUREMENT
/begin MEASUREMENT DINH_xWhy.FId_UCtPFrzVal "" UWORD DFCDSQ_Verb 1 100 0.00 65535.0000000 FORMAT "%13.7" ECU_ADDRESS 0x60022332 /end MEASUREMENT
/begin MEASUREMENT DINH_xWhy.FId_UCtPPhysRng "" UWORD DFCDSQ_Verb 1 100 0.00 65535.0000000 FORMAT "%13.7" ECU_ADDRESS 0x60022334 /end MEASUREMENT
/begin MEASUREMENT DINH_xWhy.FId_UCtPRplVal "" UWORD DFCDSQ_Verb 1 100 0.00 65535.0000000 FORMAT "%13.7" ECU_ADDRESS 0x60022336 /end MEASUREMENT
/begin MEASUREMENT DINH_xWhy.FId_UCtPSSpMon "" UWORD DFCDSQ_Verb 1 100 0.00 65535.0000000 FORMAT "%13.7" ECU_ADDRESS 0x60022338 /end MEASUREMENT
/begin MEASUREMENT DINH_xWhy.FId_UCtPTmpErrCnt "" UWORD DFCDSQ_Verb 1 100 0.00 65535.0000000 FORMAT "%13.7" ECU_ADDRESS 0x6002233A /end MEASUREMENT
/begin MEASUREMENT DINH_xWhy.FId_UPxP1EnhdSRCMax "" UWORD DFCDSQ_Verb 1 100 0.00 65535.0000000 FORMAT "%13.7" ECU_ADDRESS 0x6002233C /end MEASUREMENT
/begin MEASUREMENT DINH_xWhy.FId_UPxP1FrzVal "" UWORD DFCDSQ_Verb 1 100 0.00 65535.0000000 FORMAT "%13.7" ECU_ADDRESS 0x6002233E /end MEASUREMENT
/begin MEASUREMENT DINH_xWhy.FId_UPxP1PhysRng "" UWORD DFCDSQ_Verb 1 100 0.00 65535.0000000 FORMAT "%13.7" ECU_ADDRESS 0x60022340 /end MEASUREMENT
/begin MEASUREMENT DINH_xWhy.FId_UPxP1RplVal "" UWORD DFCDSQ_Verb 1 100 0.00 65535.0000000 FORMAT "%13.7" ECU_ADDRESS 0x60022342 /end MEASUREMENT
/begin MEASUREMENT DINH_xWhy.FId_UPxP1SSpMon "" UWORD DFCDSQ_Verb 1 100 0.00 65535.0000000 FORMAT "%13.7" ECU_ADDRESS 0x60022344 /end MEASUREMENT
/begin MEASUREMENT DINH_xWhy.FId_UPxP1TmpErrCnt "" UWORD DFCDSQ_Verb 1 100 0.00 65535.0000000 FORMAT "%13.7" ECU_ADDRESS 0x60022346 /end MEASUREMENT
/begin MEASUREMENT DINH_xWhy.FId_VMSIEvBrkFlt "" UWORD DFCDSQ_Verb 1 100 0.00 65535.0000000 FORMAT "%13.7" ECU_ADDRESS 0x60022348 /end MEASUREMENT
/begin MEASUREMENT DINH_xWhy.FId_VMSIEvDCSRampShOff01 "" UWORD DFCDSQ_Verb 1 100 0.00 65535.0000000 FORMAT "%13.7" ECU_ADDRESS 0x6002234A /end MEASUREMENT
/begin MEASUREMENT DINH_xWhy.FId_VMSIEvDCSShOff01 "" UWORD DFCDSQ_Verb 1 100 0.00 65535.0000000 FORMAT "%13.7" ECU_ADDRESS 0x6002234C /end MEASUREMENT
/begin MEASUREMENT DINH_xWhy.FId_VMSIEvTCSRampShOff01 "" UWORD DFCDSQ_Verb 1 100 0.00 65535.0000000 FORMAT "%13.7" ECU_ADDRESS 0x6002234E /end MEASUREMENT
/begin MEASUREMENT DINH_xWhy.FId_VMSIEvTCSShOff01 "" UWORD DFCDSQ_Verb 1 100 0.00 65535.0000000 FORMAT "%13.7" ECU_ADDRESS 0x60022350 /end MEASUREMENT
/begin MEASUREMENT DINH_xWhy.FId_VMSIEvTVRampShOff01 "" UWORD DFCDSQ_Verb 1 100 0.00 65535.0000000 FORMAT "%13.7" ECU_ADDRESS 0x60022352 /end MEASUREMENT
/begin MEASUREMENT DINH_xWhy.FId_VMSIEvTVShOff01 "" UWORD DFCDSQ_Verb 1 100 0.00 65535.0000000 FORMAT "%13.7" ECU_ADDRESS 0x60022354 /end MEASUREMENT
/begin MEASUREMENT DINH_xWhy.FId_VacPmpErr "" UWORD DFCDSQ_Verb 1 100 0.00 65535.0000000 FORMAT "%13.7" ECU_ADDRESS 0x60022356 /end MEASUREMENT
/begin MEASUREMENT DINH_xWhy.FId_VehCoornAuxAvrgEnvT "" UWORD DFCDSQ_Verb 1 100 0.00 65535.0000000 FORMAT "%13.7" ECU_ADDRESS 0x60022358 /end MEASUREMENT
/begin MEASUREMENT DINH_xWhy.FId_VehCoornAuxAvrgPwr "" UWORD DFCDSQ_Verb 1 100 0.00 65535.0000000 FORMAT "%13.7" ECU_ADDRESS 0x6002235A /end MEASUREMENT
/begin MEASUREMENT DINH_xWhy.FId_VehCoornAuxAvrgT "" UWORD DFCDSQ_Verb 1 100 0.00 65535.0000000 FORMAT "%13.7" ECU_ADDRESS 0x6002235C /end MEASUREMENT
/begin MEASUREMENT DINH_xWhy.FId_VehCoornAuxAvrgVehV "" UWORD DFCDSQ_Verb 1 100 0.00 65535.0000000 FORMAT "%13.7" ECU_ADDRESS 0x6002235E /end MEASUREMENT
/begin MEASUREMENT DINH_xWhy.FId_VehCoornDstRngPrdcDispDft "" UWORD DFCDSQ_Verb 1 100 0.00 65535.0000000 FORMAT "%13.7" ECU_ADDRESS 0x60022360 /end MEASUREMENT
/begin MEASUREMENT DINH_xWhy.FId_VehCoornEgyRmn "" UWORD DFCDSQ_Verb 1 100 0.00 65535.0000000 FORMAT "%13.7" ECU_ADDRESS 0x60022362 /end MEASUREMENT
/begin MEASUREMENT DINH_xWhy.FId_VehCoornErrExclChrg "" UWORD DFCDSQ_Verb 1 100 0.00 65535.0000000 FORMAT "%13.7" ECU_ADDRESS 0x60022364 /end MEASUREMENT
/begin MEASUREMENT DINH_xWhy.FId_VehCoornErrExclDrv "" UWORD DFCDSQ_Verb 1 100 0.00 65535.0000000 FORMAT "%13.7" ECU_ADDRESS 0x60022366 /end MEASUREMENT
/begin MEASUREMENT DINH_xWhy.FId_VehCoornHVErr "" UWORD DFCDSQ_Verb 1 100 0.00 65535.0000000 FORMAT "%13.7" ECU_ADDRESS 0x60022368 /end MEASUREMENT
/begin MEASUREMENT DINH_xWhy.FId_VehCoornHvReq "" UWORD DFCDSQ_Verb 1 100 0.00 65535.0000000 FORMAT "%13.7" ECU_ADDRESS 0x6002236A /end MEASUREMENT
/begin MEASUREMENT DINH_xWhy.FId_VehCoornImobTrqInhbn "" UWORD DFCDSQ_Verb 1 100 0.00 65535.0000000 FORMAT "%13.7" ECU_ADDRESS 0x6002236C /end MEASUREMENT
/begin MEASUREMENT DINH_xWhy.FId_VehCoornPrpAvrg "" UWORD DFCDSQ_Verb 1 100 0.00 65535.0000000 FORMAT "%13.7" ECU_ADDRESS 0x6002236E /end MEASUREMENT
/begin MEASUREMENT DINH_xWhy.FId_VehCoornRngPrdcAuxPwr "" UWORD DFCDSQ_Verb 1 100 0.00 65535.0000000 FORMAT "%13.7" ECU_ADDRESS 0x60022370 /end MEASUREMENT
/begin MEASUREMENT DINH_xWhy.FId_VehCoornSigQualVehV "" UWORD DFCDSQ_Verb 1 100 0.00 65535.0000000 FORMAT "%13.7" ECU_ADDRESS 0x60022372 /end MEASUREMENT
/begin MEASUREMENT DINH_xWhy.FId_VehVCANFrzVal "" UWORD DFCDSQ_Verb 1 100 0.00 65535.0000000 FORMAT "%13.7" ECU_ADDRESS 0x60022374 /end MEASUREMENT
/begin MEASUREMENT DINH_xWhy.FId_VehVCANReplVal "" UWORD DFCDSQ_Verb 1 100 0.00 65535.0000000 FORMAT "%13.7" ECU_ADDRESS 0x60022376 /end MEASUREMENT
/begin MEASUREMENT DINH_xWhy.FId_VehVCanSafeFrzVal "" UWORD DFCDSQ_Verb 1 100 0.00 65535.0000000 FORMAT "%13.7" ECU_ADDRESS 0x60022378 /end MEASUREMENT
/begin MEASUREMENT DINH_xWhy.FId_VehVCanSafeReplVal "" UWORD DFCDSQ_Verb 1 100 0.00 65535.0000000 FORMAT "%13.7" ECU_ADDRESS 0x6002237A /end MEASUREMENT
/begin MEASUREMENT DINH_xWhy.FId_VehVFrzVal "" UWORD DFCDSQ_Verb 1 100 0.00 65535.0000000 FORMAT "%13.7" ECU_ADDRESS 0x6002237C /end MEASUREMENT
/begin MEASUREMENT DINH_xWhy.FId_VehVNActPhy01Dfct "" UWORD DFCDSQ_Verb 1 100 0.00 65535.0000000 FORMAT "%13.7" ECU_ADDRESS 0x6002237E /end MEASUREMENT
/begin MEASUREMENT DINH_xWhy.FId_VehVReplVal "" UWORD DFCDSQ_Verb 1 100 0.00 65535.0000000 FORMAT "%13.7" ECU_ADDRESS 0x60022380 /end MEASUREMENT
/begin MEASUREMENT DINH_xWhy.FId_VehVSigCan "" UWORD DFCDSQ_Verb 1 100 0.00 65535.0000000 FORMAT "%13.7" ECU_ADDRESS 0x60022382 /end MEASUREMENT
/begin MEASUREMENT DINH_xWhy.FId_VehVSigCanSafe "" UWORD DFCDSQ_Verb 1 100 0.00 65535.0000000 FORMAT "%13.7" ECU_ADDRESS 0x60022384 /end MEASUREMENT
/begin MEASUREMENT DINH_xWhy.FId_WtrPmp1Err "" UWORD DFCDSQ_Verb 1 100 0.00 65535.0000000 FORMAT "%13.7" ECU_ADDRESS 0x60022386 /end MEASUREMENT
/begin MEASUREMENT DINH_xWhy.FId_bInhCanEif_HVBAT_NGTV_CONTACTOR_STS "" UWORD DFCDSQ_Verb 1 100 0.00 65535.0000000 FORMAT "%13.7" ECU_ADDRESS 0x60022388 /end MEASUREMENT
/begin MEASUREMENT DINH_xWhy.FId_bInhCanEif_HVBAT_PRECHRG_CONTACTOR_STS "" UWORD DFCDSQ_Verb 1 100 0.00 65535.0000000 FORMAT "%13.7" ECU_ADDRESS 0x6002238A /end MEASUREMENT
/begin MEASUREMENT DINH_xWhy.FId_bInhCanEif_HVBAT_PSTV_CONTACTOR_STS "" UWORD DFCDSQ_Verb 1 100 0.00 65535.0000000 FORMAT "%13.7" ECU_ADDRESS 0x6002238C /end MEASUREMENT
/begin MEASUREMENT DINH_xWhy.FId_bInhCanEif_VCU_eBCCM_432h "" UWORD DFCDSQ_Verb 1 100 0.00 65535.0000000 FORMAT "%13.7" ECU_ADDRESS 0x6002238E /end MEASUREMENT
/begin MEASUREMENT DINH_xWhy.FId_bInhCdtSpdVehImmo "" UWORD DFCDSQ_Verb 1 100 0.00 65535.0000000 FORMAT "%13.7" ECU_ADDRESS 0x60022390 /end MEASUREMENT
/begin MEASUREMENT DINH_xWhy.FId_bInhComGw_Com_BMS_REMAININGBATTCAPACITY "" UWORD DFCDSQ_Verb 1 100 0.00 65535.0000000 FORMAT "%13.7" ECU_ADDRESS 0x60022392 /end MEASUREMENT
/begin MEASUREMENT DINH_xWhy.FId_bInhComGw_Com_CONTACT_FREIN_PRK "" UWORD DFCDSQ_Verb 1 100 0.00 65535.0000000 FORMAT "%13.7" ECU_ADDRESS 0x60022394 /end MEASUREMENT
/begin MEASUREMENT DINH_xWhy.FId_bInhComGw_Com_DCDC_IP_POWER "" UWORD DFCDSQ_Verb 1 100 0.00 65535.0000000 FORMAT "%13.7" ECU_ADDRESS 0x60022396 /end MEASUREMENT
/begin MEASUREMENT DINH_xWhy.FId_bInhComGw_Com_HVBAT_ALERT_LOW_BATT_ENERGY "" UWORD DFCDSQ_Verb 1 100 0.00 65535.0000000 FORMAT "%13.7" ECU_ADDRESS 0x60022398 /end MEASUREMENT
/begin MEASUREMENT DINH_xWhy.FId_bInhComGw_Com_HVBAT_CHARGING_STATUS "" UWORD DFCDSQ_Verb 1 100 0.00 65535.0000000 FORMAT "%13.7" ECU_ADDRESS 0x6002239A /end MEASUREMENT
/begin MEASUREMENT DINH_xWhy.FId_bInhComGw_Com_HVBAT_SOC "" UWORD DFCDSQ_Verb 1 100 0.00 65535.0000000 FORMAT "%13.7" ECU_ADDRESS 0x6002239C /end MEASUREMENT
/begin MEASUREMENT DINH_xWhy.FId_bInhComGw_Com_HVBAT_TEMPERATURE "" UWORD DFCDSQ_Verb 1 100 0.00 65535.0000000 FORMAT "%13.7" ECU_ADDRESS 0x6002239E /end MEASUREMENT
/begin MEASUREMENT DINH_xWhy.FId_bInhComGw_Com_HVBAT_THERMAL_RUNAWAY "" UWORD DFCDSQ_Verb 1 100 0.00 65535.0000000 FORMAT "%13.7" ECU_ADDRESS 0x600223A0 /end MEASUREMENT
/begin MEASUREMENT DINH_xWhy.FId_bInhComGw_Com_HV_BATT_CELL_VOLT_MAX "" UWORD DFCDSQ_Verb 1 100 0.00 65535.0000000 FORMAT "%13.7" ECU_ADDRESS 0x600223A2 /end MEASUREMENT
/begin MEASUREMENT DINH_xWhy.FId_bInhComGw_Com_HV_BATT_CELL_VOLT_MIN "" UWORD DFCDSQ_Verb 1 100 0.00 65535.0000000 FORMAT "%13.7" ECU_ADDRESS 0x600223A4 /end MEASUREMENT
/begin MEASUREMENT DINH_xWhy.FId_bInhComGw_Com_HV_BATT_INSULATION_RESISTANCE "" UWORD DFCDSQ_Verb 1 100 0.00 65535.0000000 FORMAT "%13.7" ECU_ADDRESS 0x600223A6 /end MEASUREMENT
/begin MEASUREMENT DINH_xWhy.FId_bInhComGw_Com_HV_BATT_INSUL_FAILURE "" UWORD DFCDSQ_Verb 1 100 0.00 65535.0000000 FORMAT "%13.7" ECU_ADDRESS 0x600223A8 /end MEASUREMENT
/begin MEASUREMENT DINH_xWhy.FId_bInhComGw_Com_HV_BATT_INTERLOCK_LINE "" UWORD DFCDSQ_Verb 1 100 0.00 65535.0000000 FORMAT "%13.7" ECU_ADDRESS 0x600223AA /end MEASUREMENT
/begin MEASUREMENT DINH_xWhy.FId_bInhComGw_Com_HV_BATT_MIN_VOLT_WARN "" UWORD DFCDSQ_Verb 1 100 0.00 65535.0000000 FORMAT "%13.7" ECU_ADDRESS 0x600223AC /end MEASUREMENT
/begin MEASUREMENT DINH_xWhy.FId_bInhComGw_Com_HV_BATT_NB_CELL_VOLT_MAX "" UWORD DFCDSQ_Verb 1 100 0.00 65535.0000000 FORMAT "%13.7" ECU_ADDRESS 0x600223AE /end MEASUREMENT
/begin MEASUREMENT DINH_xWhy.FId_bInhComGw_Com_HV_BATT_NB_CELL_VOLT_MIN "" UWORD DFCDSQ_Verb 1 100 0.00 65535.0000000 FORMAT "%13.7" ECU_ADDRESS 0x600223B0 /end MEASUREMENT
/begin MEASUREMENT DINH_xWhy.FId_bInhComGw_Com_HV_BATT_SOC "" UWORD DFCDSQ_Verb 1 100 0.00 65535.0000000 FORMAT "%13.7" ECU_ADDRESS 0x600223B2 /end MEASUREMENT
/begin MEASUREMENT DINH_xWhy.FId_bInhComGw_Com_HV_BATT_SOC_5C3 "" UWORD DFCDSQ_Verb 1 100 0.00 65535.0000000 FORMAT "%13.7" ECU_ADDRESS 0x600223B4 /end MEASUREMENT
/begin MEASUREMENT DINH_xWhy.FId_bInhComGw_Com_HV_BATT_SOH_CAPA "" UWORD DFCDSQ_Verb 1 100 0.00 65535.0000000 FORMAT "%13.7" ECU_ADDRESS 0x600223B6 /end MEASUREMENT
/begin MEASUREMENT DINH_xWhy.FId_bInhComGw_Com_HV_BATT_SOH_RES "" UWORD DFCDSQ_Verb 1 100 0.00 65535.0000000 FORMAT "%13.7" ECU_ADDRESS 0x600223B8 /end MEASUREMENT
/begin MEASUREMENT DINH_xWhy.FId_bInhComGw_Com_HV_BATT_TEMP_AVG "" UWORD DFCDSQ_Verb 1 100 0.00 65535.0000000 FORMAT "%13.7" ECU_ADDRESS 0x600223BA /end MEASUREMENT
/begin MEASUREMENT DINH_xWhy.FId_bInhComGw_Com_INV_MTR_INST_INPUT_POWER "" UWORD DFCDSQ_Verb 1 100 0.00 65535.0000000 FORMAT "%13.7" ECU_ADDRESS 0x600223BC /end MEASUREMENT
/begin FUNCTION DINH "30000.25.0Diagnostic Inhibit Handler"
 /begin IN_MEASUREMENT DINH_nrActvInhReas.FId_HeatrCoreTEnhdSRCMax DINH_nrActvInhReas.FId_HeatrCoreTFrzVal DINH_nrActvInhReas.FId_HeatrCoreTPhysRng DINH_nrActvInhReas.FId_HeatrCoreTRplVal DINH_nrActvInhReas.FId_HeatrCoreTSSpMon DINH_nrActvInhReas.FId_HeatrCoreTTmpErrCnt DINH_nrActvInhReas.FId_HvBattChrgLvl3DernFlt DINH_nrActvInhReas.FId_HvBattDchaLvl3DernFlt DINH_nrActvInhReas.FId_HvBattDesChrgIDern DINH_nrActvInhReas.FId_HvBattMaiSwtDiagEna DINH_nrActvInhReas.FId_HvBattMaxPwrBusTDern DINH_nrActvInhReas.FId_HvBattNegCntctrCnt DINH_nrActvInhReas.FId_HvBattPosCntctrCnt DINH_nrActvInhReas.FId_HvBattPrecCntctrCnt DINH_nrActvInhReas.FId_HvBattPwrDistbnTDern DINH_nrActvInhReas.FId_HvBattPwrDistbnTInhbn DINH_nrActvInhReas.FId_HvBattRatRSoh DINH_nrActvInhReas.FId_HvBattRatSoh DINH_nrActvInhReas.FId_HvGridAuxPwr01 DINH_nrActvInhReas.FId_HvGridAuxPwr02 DINH_nrActvInhReas.FId_HvGridAuxPwr03 DINH_nrActvInhReas.FId_HvGridAuxPwr04 DINH_nrActvInhReas.FId_HvGridDcdcPwr DINH_nrActvInhReas.FId_HvGridDcdcUSftyErr DINH_nrActvInhReas.FId_HvGridElM01USftyErr DINH_nrActvInhReas.FId_HvGridHvBattSftyLimErr DINH_nrActvInhReas.FId_HvGridMaiSwtErr DINH_nrActvInhReas.FId_HvGridPwrMaxChrgContnsErr DINH_nrActvInhReas.FId_HvGridPwrMaxChrgShoErr DINH_nrActvInhReas.FId_HvGridPwrMaxDchaContnsErr DINH_nrActvInhReas.FId_HvGridPwrMaxDchaShoErr DINH_nrActvInhReas.FId_HvacHmiFlt DINH_nrActvInhReas.FId_HvacModCoolgFlt DINH_nrActvInhReas.FId_HvacModHeatgFlt DINH_nrActvInhReas.FId_HvacPtcHeatrErr DINH_nrActvInhReas.FId_IntlckChrgPlgActrOff DINH_nrActvInhReas.FId_IntlckChrgPlgHbrdgNotTstd DINH_nrActvInhReas.FId_IntlckChrgPlgMon DINH_nrActvInhReas.FId_IntlckChrgPlgPosnAdcInvld DINH_nrActvInhReas.FId_IntlckChrgPlgPwrStg DINH_nrActvInhReas.FId_LvGridSocErr DINH_nrActvInhReas.FId_LvGridTErr DINH_nrActvInhReas.FId_LvGridTestPlsReq DINH_nrActvInhReas.FId_LvGridUErr DINH_nrActvInhReas.FId_MedTPmpFlt DINH_nrActvInhReas.FId_MedTPmpPwrCtrlRly DINH_nrActvInhReas.FId_MstWrnLmpBlink DINH_nrActvInhReas.FId_MstWrnLmpChime DINH_nrActvInhReas.FId_MstWrnLmpContIllmn DINH_nrActvInhReas.FId_PEnvCc DINH_nrActvInhReas.FId_PEnvEnaBndMdl DINH_nrActvInhReas.FId_PEnvMeasVld DINH_nrActvInhReas.FId_PEnvPlaus DINH_nrActvInhReas.FId_PEnvPrc DINH_nrActvInhReas.FId_PEnvRefSnsr DINH_nrActvInhReas.FId_PEnvSigRngVld DINH_nrActvInhReas.FId_PEnvSnsrPlaus DINH_nrActvInhReas.FId_PerfLimnActvLmpBlink DINH_nrActvInhReas.FId_PerfLimnActvLmpCont DINH_nrActvInhReas.FId_PerfLimnActvLmpContNoChime DINH_nrActvInhReas.FId_PwmCtPFrzVal DINH_nrActvInhReas.FId_PwmCtPPhysRng DINH_nrActvInhReas.FId_PwmCtPRplVal DINH_nrActvInhReas.FId_PwmCtPSSpMon DINH_nrActvInhReas.FId_PwmCtPTmpErrCnt DINH_nrActvInhReas.FId_PwrDistbnUnitTEnhdSRCMax DINH_nrActvInhReas.FId_PwrDistbnUnitTFrzVal DINH_nrActvInhReas.FId_PwrDistbnUnitTPhysRng DINH_nrActvInhReas.FId_PwrDistbnUnitTRplVal DINH_nrActvInhReas.FId_PwrDistbnUnitTSSpMon DINH_nrActvInhReas.FId_PwrDistbnUnitTTmpErrCnt DINH_nrActvInhReas.FId_SCtPmp1ActrOff DINH_nrActvInhReas.FId_SCtPmp1CircErr DINH_nrActvInhReas.FId_SCtPmp1Mon DINH_nrActvInhReas.FId_SCtPmp1Off DINH_nrActvInhReas.FId_SCtPmp1PsErr DINH_nrActvInhReas.FId_SCtPmp1PwrStg DINH_nrActvInhReas.FId_SCtPmp1QlySensFrzn DINH_nrActvInhReas.FId_SCtPmp1QlySensRplVal DINH_nrActvInhReas.FId_SCtPmpRlyActrOff DINH_nrActvInhReas.FId_SCtPmpRlyMon DINH_nrActvInhReas.FId_SCtPmpRlyOff DINH_nrActvInhReas.FId_SCtPmpRlyPwrStg DINH_nrActvInhReas.FId_SVSWrnLmpBlnkIllmn DINH_nrActvInhReas.FId_SVSWrnLmpContIllmn DINH_nrActvInhReas.FId_SpplCooltPmpRlyActrOff DINH_nrActvInhReas.FId_SpplCooltPmpRlyMon DINH_nrActvInhReas.FId_SpplCooltPmpRlyOff DINH_nrActvInhReas.FId_SpplCooltPmpRlyPwrStg DINH_nrActvInhReas.FId_StrtUpEvDrvAwy DINH_nrActvInhReas.FId_TelltlCooltTErr DINH_nrActvInhReas.FId_TelltlCooltTMon DINH_nrActvInhReas.FId_ThermHvacPreCdngFlt DINH_nrActvInhReas.FId_ThermModCritErr DINH_nrActvInhReas.FId_UCtPEnhdSRCMax DINH_nrActvInhReas.FId_UCtPFrzVal DINH_nrActvInhReas.FId_UCtPPhysRng DINH_nrActvInhReas.FId_UCtPRplVal DINH_nrActvInhReas.FId_UCtPSSpMon DINH_nrActvInhReas.FId_UCtPTmpErrCnt DINH_nrActvInhReas.FId_UPxP1EnhdSRCMax DINH_nrActvInhReas.FId_UPxP1FrzVal DINH_nrActvInhReas.FId_UPxP1PhysRng DINH_nrActvInhReas.FId_UPxP1RplVal DINH_nrActvInhReas.FId_UPxP1SSpMon DINH_nrActvInhReas.FId_UPxP1TmpErrCnt DINH_nrActvInhReas.FId_VMSIEvBrkFlt DINH_nrActvInhReas.FId_VMSIEvDCSRampShOff01 DINH_nrActvInhReas.FId_VMSIEvDCSShOff01 DINH_nrActvInhReas.FId_VMSIEvTCSRampShOff01 DINH_nrActvInhReas.FId_VMSIEvTCSShOff01 DINH_nrActvInhReas.FId_VMSIEvTVRampShOff01 DINH_nrActvInhReas.FId_VMSIEvTVShOff01 DINH_nrActvInhReas.FId_VacPmpErr DINH_nrActvInhReas.FId_VehCoornAuxAvrgEnvT DINH_nrActvInhReas.FId_VehCoornAuxAvrgPwr DINH_nrActvInhReas.FId_VehCoornAuxAvrgT DINH_nrActvInhReas.FId_VehCoornAuxAvrgVehV DINH_nrActvInhReas.FId_VehCoornDstRngPrdcDispDft DINH_nrActvInhReas.FId_VehCoornEgyRmn DINH_nrActvInhReas.FId_VehCoornErrExclChrg DINH_nrActvInhReas.FId_VehCoornErrExclDrv DINH_nrActvInhReas.FId_VehCoornHVErr DINH_nrActvInhReas.FId_VehCoornHvReq DINH_nrActvInhReas.FId_VehCoornImobTrqInhbn DINH_nrActvInhReas.FId_VehCoornPrpAvrg DINH_nrActvInhReas.FId_VehCoornRngPrdcAuxPwr DINH_nrActvInhReas.FId_VehCoornSigQualVehV DINH_nrActvInhReas.FId_VehVCANFrzVal DINH_nrActvInhReas.FId_VehVCANReplVal DINH_nrActvInhReas.FId_VehVCanSafeFrzVal DINH_nrActvInhReas.FId_VehVCanSafeReplVal DINH_nrActvInhReas.FId_VehVFrzVal DINH_nrActvInhReas.FId_VehVNActPhy01Dfct DINH_nrActvInhReas.FId_VehVReplVal DINH_nrActvInhReas.FId_VehVSigCan DINH_nrActvInhReas.FId_VehVSigCanSafe DINH_nrActvInhReas.FId_WtrPmp1Err DINH_nrActvInhReas.FId_bInhCanEif_HVBAT_NGTV_CONTACTOR_STS DINH_nrActvInhReas.FId_bInhCanEif_HVBAT_PRECHRG_CONTACTOR_STS DINH_nrActvInhReas.FId_bInhCanEif_HVBAT_PSTV_CONTACTOR_STS DINH_nrActvInhReas.FId_bInhCanEif_VCU_eBCCM_432h DINH_nrActvInhReas.FId_bInhCdtSpdVehImmo DINH_nrActvInhReas.FId_bInhComGw_Com_BMS_REMAININGBATTCAPACITY DINH_nrActvInhReas.FId_bInhComGw_Com_CONTACT_FREIN_PRK DINH_nrActvInhReas.FId_bInhComGw_Com_DCDC_IP_POWER DINH_nrActvInhReas.FId_bInhComGw_Com_HVBAT_ALERT_LOW_BATT_ENERGY DINH_nrActvInhReas.FId_bInhComGw_Com_HVBAT_CHARGING_STATUS DINH_nrActvInhReas.FId_bInhComGw_Com_HVBAT_SOC DINH_nrActvInhReas.FId_bInhComGw_Com_HVBAT_TEMPERATURE DINH_nrActvInhReas.FId_bInhComGw_Com_HVBAT_THERMAL_RUNAWAY DINH_nrActvInhReas.FId_bInhComGw_Com_HV_BATT_CELL_VOLT_MAX DINH_nrActvInhReas.FId_bInhComGw_Com_HV_BATT_CELL_VOLT_MIN DINH_nrActvInhReas.FId_bInhComGw_Com_HV_BATT_INSULATION_RESISTANCE DINH_nrActvInhReas.FId_bInhComGw_Com_HV_BATT_INSUL_FAILURE DINH_nrActvInhReas.FId_bInhComGw_Com_HV_BATT_INTERLOCK_LINE DINH_nrActvInhReas.FId_bInhComGw_Com_HV_BATT_MIN_VOLT_WARN DINH_nrActvInhReas.FId_bInhComGw_Com_HV_BATT_NB_CELL_VOLT_MAX DINH_nrActvInhReas.FId_bInhComGw_Com_HV_BATT_NB_CELL_VOLT_MIN DINH_nrActvInhReas.FId_bInhComGw_Com_HV_BATT_SOC DINH_nrActvInhReas.FId_bInhComGw_Com_HV_BATT_SOC_5C3 DINH_nrActvInhReas.FId_bInhComGw_Com_HV_BATT_SOH_CAPA DINH_nrActvInhReas.FId_bInhComGw_Com_HV_BATT_SOH_RES DINH_nrActvInhReas.FId_bInhComGw_Com_HV_BATT_TEMP_AVG DINH_nrActvInhReas.FId_bInhComGw_Com_INV_MTR_INST_INPUT_POWER DINH_nrActvInhReas.FId_bInhComGw_Com_PEM_ENGINE_RPM DINH_nrActvInhReas.FId_bInhComGw_Com_PEM_ESTIM_TRQ DINH_nrActvInhReas.FId_bInhComGw_Com_PEM_INVERTER_TEMP DINH_nrActvInhReas.FId_bInhComGw_Com_PEM_INVERTOR_ALERT_TEMP DINH_nrActvInhReas.FId_bInhComGw_Com_PEM_OVERTEMP_FAILURE DINH_nrActvInhReas.FId_bInhComGw_Com_PEM_STATOR_TEMP DINH_nrActvInhReas.FId_bInhComGw_Com_VITESSE_VEHICULE_ROUES DINH_nrActvInhReas.FId_bInhComGw_Com_VVH_INDISP DINH_nrActvInhReas.FId_bInhComGw_Com_eCOMP_Power_consumption DINH_nrActvInhReas.FId_bInhComGw_MAIN_RELAY_ACTUATION_COUNTER DINH_nrActvInhReas.FId_bInhComGw_TIME_HV_BATT_OVER_TEMPERATURE DINH_nrActvInhReas.FId_bInhComGw_TOTAL_HV_BATT_POS_QTY_CURR DINH_nrActvInhReas.FId_bInhDiag_CLUSTER_5E7 DINH_nrActvInhReas.FId_bInhDiag_CONTEXTE_1_5B2 DINH_nrActvInhReas.FId_bInhDiag_DAT3_BSI_4F2h DINH_nrActvInhReas.FId_bInhDiag_DCDC_283h DINH_nrActvInhReas.FId_bInhDiag_DCDC_293h DINH_nrActvInhReas.FId_bInhDiag_DCDC_473h DINH_nrActvInhReas.FId_bInhDiag_DCDC_663h DINH_nrActvInhReas.FId_bInhDiag_HS3_AUTO_GEARBOX_SWITCH_STATUS DINH_nrActvInhReas.FId_bInhDiag_HVAC_PANEL_26h DINH_nrActvInhReas.FId_bInhDiag_HVBAT_205h DINH_nrActvInhReas.FId_bInhDiag_HVBAT_275h DINH_nrActvInhReas.FId_bInhDiag_HVBAT_285h DINH_nrActvInhReas.FId_bInhDiag_HVBAT_325h DINH_nrActvInhReas.FId_bInhDiag_HVBAT_335h DINH_nrActvInhReas.FId_bInhDiag_HVBAT_455h DINH_nrActvInhReas.FId_bInhDiag_HVBAT_535 DINH_nrActvInhReas.FId_bInhDiag_HVBAT_595h DINH_nrActvInhReas.FId_bInhDiag_HVBAT_635h DINH_nrActvInhReas.FId_bInhDiag_HVBAT_645h DINH_nrActvInhReas.FId_bInhDiag_HVBAT_665h DINH_nrActvInhReas.FId_bInhDiag_HVBAT_675h DINH_nrActvInhReas.FId_bInhDiag_HVBAT_THERMAL_5B5 DINH_nrActvInhReas.FId_bInhDiag_HVBAT_VCU_435h DINH_nrActvInhReas.FId_bInhDiag_HVBAT_VCU_543 DINH_nrActvInhReas.FId_bInhDiag_HVBAT_VCU_583 DINH_nrActvInhReas.FId_bInhDiag_INV_217h DINH_nrActvInhReas.FId_bInhDiag_INV_227h DINH_nrActvInhReas.FId_bInhDiag_INV_237 DINH_nrActvInhReas.FId_bInhDiag_INV_427h DINH_nrActvInhReas.FId_bInhDiag_INV_497h DINH_nrActvInhReas.FId_bInhDiag_INV_IMMO_5C7 DINH_nrActvInhReas.FId_bInhDiag_IS_DAT6_BSI_592h DINH_nrActvInhReas.FId_bInhDiag_IS_DAT_ABR_50Dh DINH_nrActvInhReas.FId_bInhDiag_IS_DAT_BSI_412h DINH_nrActvInhReas.FId_bInhDiag_IS_DYN_ABR_38Dh DINH_nrActvInhReas.FId_bInhDiag_IS_INTE_ELECTRON_BSI_092h DINH_nrActvInhReas.FId_bInhDiag_OBC_273h DINH_nrActvInhReas.FId_bInhDiag_OBC_453h DINH_nrActvInhReas.FId_bInhDiag_OBC_463h DINH_nrActvInhReas.FId_bInhDiag_PDU_BusVoltages_308 DINH_nrActvInhReas.FId_bInhDiag_PDU_Current_318 DINH_nrActvInhReas.FId_bInhDiag_SC_INFO_BCCM_442h DINH_nrActvInhReas.FId_bInhDiag_VCU_AIRBAG_351h DINH_nrActvInhReas.FId_bInhDiag_VCU_eBCCM_432h DINH_nrActvInhReas.FId_bInhDiag_VCU_eBCCM_552h DINH_nrActvInhReas.FId_bInhDiag_eBCCM_082h DINH_nrActvInhReas.FId_bInhDiag_eCOMP_Information_47B DINH_nrActvInhReas.FId_bInhDiag_eCOMP_Information_48B DINH_nrActvInhReas.FId_bInhFrbd_ComChrgr_iAcMax DINH_nrActvInhReas.FId_bInhFrbd_ComChrgr_iDcHvAct DINH_nrActvInhReas.FId_bInhFrbd_ComChrgr_pwrInAct DINH_nrActvInhReas.FId_bInhFrbd_ComChrgr_pwrOutpCpby DINH_nrActvInhReas.FId_bInhFrbd_ComChrgr_tChrgrMaxAct DINH_nrActvInhReas.FId_bInhFrbd_ComChrgr_uAcActL1 DINH_nrActvInhReas.FId_bInhFrbd_ComChrgr_uDcHvAct DINH_nrActvInhReas.FId_bInhFrbd_ComEmac_iDcLnk01 DINH_nrActvInhReas.FId_bInhFrbd_ComEmac_nAct01 DINH_nrActvInhReas.FId_bInhFrbd_ComEmac_pwrInstnsInpRx DINH_nrActvInhReas.FId_bInhFrbd_ComEmac_stActvDcha DINH_nrActvInhReas.FId_bInhFrbd_ComEmac_stEVLmp DINH_nrActvInhReas.FId_bInhFrbd_ComEmac_stIvtrOpMod01 DINH_nrActvInhReas.FId_bInhFrbd_ComEmac_stMod01Rx DINH_nrActvInhReas.FId_bInhFrbd_ComEmac_stMstWrnLmp DINH_nrActvInhReas.FId_bInhFrbd_ComEmac_stSVSLmp DINH_nrActvInhReas.FId_bInhFrbd_ComEmac_tqAbsltMax01 DINH_nrActvInhReas.FId_bInhFrbd_ComEmac_tqAbsltMaxRx01 DINH_nrActvInhReas.FId_bInhFrbd_ComEmac_tqAbsltMin01 DINH_nrActvInhReas.FId_bInhFrbd_ComEmac_tqAbsltMinRx01 DINH_nrActvInhReas.FId_bInhFrbd_ComEmac_tqAckd01 DINH_nrActvInhReas.FId_bInhFrbd_ComEmac_tqAct01 DINH_nrActvInhReas.FId_bInhFrbd_ComEmac_tqPtd01 DINH_nrActvInhReas.FId_bInhFrbd_ComEmac_tqStabnMin DINH_nrActvInhReas.FId_bInhFrbd_ComEmac_uDcLnk01 DINH_nrActvInhReas.FId_bInhFrbd_Com_HvbMaxSnsrTempRx DINH_nrActvInhReas.FId_bInhFrbd_Com_ctHvbNegCntctrSeg1 DINH_nrActvInhReas.FId_bInhFrbd_Com_ctHvbNegCntctrSeg3 DINH_nrActvInhReas.FId_bInhFrbd_Com_ctHvbNegCntctrSeg4 DINH_nrActvInhReas.FId_bInhFrbd_Com_ctHvbPosCntctrSeg1 DINH_nrActvInhReas.FId_bInhFrbd_Com_ctHvbPosCntctrSeg3 DINH_nrActvInhReas.FId_bInhFrbd_Com_ctHvbPosCntctrSeg4 DINH_nrActvInhReas.FId_bInhFrbd_Com_ctHvbPrecCntctrSeg1 DINH_nrActvInhReas.FId_bInhFrbd_Com_ctHvbPrecCntctrSeg2 DINH_nrActvInhReas.FId_bInhFrbd_Com_egyHvbAvl_fRx DINH_nrActvInhReas.FId_bInhFrbd_Com_flgEcoNormReqRx DINH_nrActvInhReas.FId_bInhFrbd_Com_iBattEBS1Rx DINH_nrActvInhReas.FId_bInhFrbd_Com_iBattEBS2Rx DINH_nrActvInhReas.FId_bInhFrbd_Com_iBattEBS3Rx DINH_nrActvInhReas.FId_bInhFrbd_Com_iDcdcHvActRvsn1 DINH_nrActvInhReas.FId_bInhFrbd_Com_iDcdcLvActRvsn1 DINH_nrActvInhReas.FId_bInhFrbd_Com_iElCmprHvAct DINH_nrActvInhReas.FId_bInhFrbd_Com_iElCmprPeakPha DINH_nrActvInhReas.FId_bInhFrbd_Com_iHvbActRx DINH_nrActvInhReas.FId_bInhFrbd_Com_iHvbChrgMaxSho DINH_nrActvInhReas.FId_bInhFrbd_Com_iHvbDchaMaxSho DINH_nrActvInhReas.FId_bInhFrbd_Com_iHvbDes DINH_nrActvInhReas.FId_bInhFrbd_Com_iHvbNomChrgn DINH_nrActvInhReas.FId_bInhFrbd_Com_nElCmprActl DINH_nrActvInhReas.FId_bInhFrbd_Com_nrSerMaxCell DINH_nrActvInhReas.FId_bInhFrbd_Com_nrSerMinCell DINH_nrActvInhReas.FId_bInhFrbd_Com_pwrDcdcOutpCpby DINH_nrActvInhReas.FId_bInhFrbd_Com_pwrElCmprActl DINH_nrActvInhReas.FId_bInhFrbd_Com_pwrMaxChrgSho DINH_nrActvInhReas.FId_bInhFrbd_Com_pwrMaxDchaSho DINH_nrActvInhReas.FId_bInhFrbd_Com_qHvbTotCpRx DINH_nrActvInhReas.FId_bInhFrbd_Com_rHvbIsoMeasmt DINH_nrActvInhReas.FId_bInhFrbd_Com_ratHvbSoc DINH_nrActvInhReas.FId_bInhFrbd_Com_ratHvbSoh DINH_nrActvInhReas.FId_bInhFrbd_Com_ratRHvbSoh DINH_nrActvInhReas.FId_bInhFrbd_Com_ratSocLvBatt DINH_nrActvInhReas.FId_bInhFrbd_Com_stElCmprFltLvl DINH_nrActvInhReas.FId_bInhFrbd_Com_stGearLvrPos DINH_nrActvInhReas.FId_bInhFrbd_Com_stIIvtrFltLvl01 DINH_nrActvInhReas.FId_bInhFrbd_Com_steTogFailrLvl DINH_nrActvInhReas.FId_bInhFrbd_Com_tDcdcAct DINH_nrActvInhReas.FId_bInhFrbd_Com_tDcdcInltCoolt DINH_nrActvInhReas.FId_bInhFrbd_Com_tElCmprActl DINH_nrActvInhReas.FId_bInhFrbd_Com_tEnvT DINH_nrActvInhReas.FId_bInhFrbd_Com_tHvbAct DINH_nrActvInhReas.FId_bInhFrbd_Com_tHvbMax DINH_nrActvInhReas.FId_bInhFrbd_Com_tLvBatt DINH_nrActvInhReas.FId_bInhFrbd_Com_tiHvbChrgnHalfRx DINH_nrActvInhReas.FId_bInhFrbd_Com_uBattEBSRx DINH_nrActvInhReas.FId_bInhFrbd_Com_uDcdcHvAct DINH_nrActvInhReas.FId_bInhFrbd_Com_uDcdcLvAct DINH_nrActvInhReas.FId_bInhFrbd_Com_uElCmprHvAct DINH_nrActvInhReas.FId_bInhFrbd_Com_uHvbAct DINH_nrActvInhReas.FId_bInhFrbd_Com_uHvbDcBus DINH_nrActvInhReas.FId_bInhFrbd_Com_uHvbLimHi DINH_nrActvInhReas.FId_bInhFrbd_Com_uHvbMaxCell DINH_nrActvInhReas.FId_bInhFrbd_Com_uHvbMinCell DINH_nrActvInhReas.FId_bInhFrbd_Com_uHvbNomChrgn DINH_nrActvInhReas.FId_bInhInvld_ComChrgr_flgChrgrErrLvl DINH_nrActvInhReas.FId_bInhInvld_ComChrgr_iAcMax DINH_nrActvInhReas.FId_bInhInvld_ComChrgr_iDcHvAct DINH_nrActvInhReas.FId_bInhInvld_ComChrgr_pwrInAct DINH_nrActvInhReas.FId_bInhInvld_ComChrgr_pwrOutpCpby DINH_nrActvInhReas.FId_bInhInvld_ComChrgr_tChrgrMaxAct DINH_nrActvInhReas.FId_bInhInvld_ComChrgr_uAcActL1 DINH_nrActvInhReas.FId_bInhInvld_ComChrgr_uDcHvAct DINH_nrActvInhReas.FId_bInhInvld_ComEmac_iDcLnk01 DINH_nrActvInhReas.FId_bInhInvld_ComEmac_nAct01 DINH_nrActvInhReas.FId_bInhInvld_ComEmac_pwrInstnsInpRx DINH_nrActvInhReas.FId_bInhInvld_ComEmac_stActvDcha DINH_nrActvInhReas.FId_bInhInvld_ComEmac_stIvtrOpMod01 DINH_nrActvInhReas.FId_bInhInvld_ComEmac_tInvr01 DINH_nrActvInhReas.FId_bInhInvld_ComEmac_tIvtrCooltIn01 DINH_nrActvInhReas.FId_bInhInvld_ComEmac_tMac01 DINH_nrActvInhReas.FId_bInhInvld_ComEmac_tqAbsltMax01 DINH_nrActvInhReas.FId_bInhInvld_ComEmac_tqAbsltMaxRx01 DINH_nrActvInhReas.FId_bInhInvld_ComEmac_tqAbsltMin01 DINH_nrActvInhReas.FId_bInhInvld_ComEmac_tqAbsltMinRx01 DINH_nrActvInhReas.FId_bInhInvld_ComEmac_tqAckd01 DINH_nrActvInhReas.FId_bInhInvld_ComEmac_tqAct01 DINH_nrActvInhReas.FId_bInhInvld_ComEmac_tqPtd01 DINH_nrActvInhReas.FId_bInhInvld_ComEmac_tqStabnMin DINH_nrActvInhReas.FId_bInhInvld_ComEmac_uDcLnk01 DINH_nrActvInhReas.FId_bInhInvld_Com_HvbMaxSnsrTempRx DINH_nrActvInhReas.FId_bInhInvld_Com_ctHvbNegCntctrSeg1 DINH_nrActvInhReas.FId_bInhInvld_Com_ctHvbNegCntctrSeg3 DINH_nrActvInhReas.FId_bInhInvld_Com_ctHvbNegCntctrSeg4 DINH_nrActvInhReas.FId_bInhInvld_Com_ctHvbPosCntctrSeg1 DINH_nrActvInhReas.FId_bInhInvld_Com_ctHvbPosCntctrSeg3 DINH_nrActvInhReas.FId_bInhInvld_Com_ctHvbPosCntctrSeg4 DINH_nrActvInhReas.FId_bInhInvld_Com_ctHvbPrecCntctrSeg1 DINH_nrActvInhReas.FId_bInhInvld_Com_ctHvbPrecCntctrSeg2 DINH_nrActvInhReas.FId_bInhInvld_Com_egyHvbAvl_fRx DINH_nrActvInhReas.FId_bInhInvld_Com_flgEcoNormReqRx DINH_nrActvInhReas.FId_bInhInvld_Com_flgVehSpdAvl DINH_nrActvInhReas.FId_bInhInvld_Com_iBattEBS1Rx DINH_nrActvInhReas.FId_bInhInvld_Com_iBattEBS2Rx DINH_nrActvInhReas.FId_bInhInvld_Com_iBattEBS3Rx DINH_nrActvInhReas.FId_bInhInvld_Com_iDcdcHvActRvsn1 DINH_nrActvInhReas.FId_bInhInvld_Com_iDcdcLvActRvsn1 DINH_nrActvInhReas.FId_bInhInvld_Com_iElCmprHvAct DINH_nrActvInhReas.FId_bInhInvld_Com_iElCmprPeakPha DINH_nrActvInhReas.FId_bInhInvld_Com_iHvbActRx DINH_nrActvInhReas.FId_bInhInvld_Com_iHvbChrgMaxSho DINH_nrActvInhReas.FId_bInhInvld_Com_iHvbDchaMaxSho DINH_nrActvInhReas.FId_bInhInvld_Com_iHvbDes DINH_nrActvInhReas.FId_bInhInvld_Com_iHvbNomChrgn DINH_nrActvInhReas.FId_bInhInvld_Com_lDstGlbDa DINH_nrActvInhReas.FId_bInhInvld_Com_lTotOdometer DINH_nrActvInhReas.FId_bInhInvld_Com_nElCmprActl DINH_nrActvInhReas.FId_bInhInvld_Com_nrSerMaxCell DINH_nrActvInhReas.FId_bInhInvld_Com_nrSerMinCell DINH_nrActvInhReas.FId_bInhInvld_Com_pwrDcdcOutpCpby DINH_nrActvInhReas.FId_bInhInvld_Com_pwrElCmprActl DINH_nrActvInhReas.FId_bInhInvld_Com_pwrMaxChrgSho DINH_nrActvInhReas.FId_bInhInvld_Com_pwrMaxDchaSho DINH_nrActvInhReas.FId_bInhInvld_Com_qHvbTotCpRx DINH_nrActvInhReas.FId_bInhInvld_Com_rHvbIsoMeasmt DINH_nrActvInhReas.FId_bInhInvld_Com_ratHvbSoc DINH_nrActvInhReas.FId_bInhInvld_Com_ratHvbSoh DINH_nrActvInhReas.FId_bInhInvld_Com_ratRHvbSoh DINH_nrActvInhReas.FId_bInhInvld_Com_ratSocLvBatt DINH_nrActvInhReas.FId_bInhInvld_Com_stAC DINH_nrActvInhReas.FId_bInhInvld_Com_stAlrtThermRunAwy DINH_nrActvInhReas.FId_bInhInvld_Com_stBlowrRly DINH_nrActvInhReas.FId_bInhInvld_Com_stDcdcFltLvl DINH_nrActvInhReas.FId_bInhInvld_Com_stEvapTFlt DINH_nrActvInhReas.FId_bInhInvld_Com_stGearLvrPos DINH_nrActvInhReas.FId_bInhInvld_Com_stHvacBlwrFront DINH_nrActvInhReas.FId_bInhInvld_Com_stHvacKnobPosn DINH_nrActvInhReas.FId_bInhInvld_Com_stHvacPanPotiFlt DINH_nrActvInhReas.FId_bInhInvld_Com_stHvbChrgn DINH_nrActvInhReas.FId_bInhInvld_Com_stHvbDiscnctReas DINH_nrActvInhReas.FId_bInhInvld_Com_stHvbIntlckRx DINH_nrActvInhReas.FId_bInhInvld_Com_stHvbIsoFltRx DINH_nrActvInhReas.FId_bInhInvld_Com_stHvbSrvPlgRx DINH_nrActvInhReas.FId_bInhInvld_Com_stIBattEBS DINH_nrActvInhReas.FId_bInhInvld_Com_stIIvtrFltLvl01 DINH_nrActvInhReas.FId_bInhInvld_Com_stMainWkuReq DINH_nrActvInhReas.FId_bInhInvld_Com_stReFogReq DINH_nrActvInhReas.FId_bInhInvld_Com_stSocRx DINH_nrActvInhReas.FId_bInhInvld_Com_stT DINH_nrActvInhReas.FId_bInhInvld_Com_tDcdcAct DINH_nrActvInhReas.FId_bInhInvld_Com_tDcdcInltCoolt DINH_nrActvInhReas.FId_bInhInvld_Com_tElCmprActl DINH_nrActvInhReas.FId_bInhInvld_Com_tEnvT DINH_nrActvInhReas.FId_bInhInvld_Com_tEvapT DINH_nrActvInhReas.FId_bInhInvld_Com_tHvbAct DINH_nrActvInhReas.FId_bInhInvld_Com_tHvbMax DINH_nrActvInhReas.FId_bInhInvld_Com_tLvBatt DINH_nrActvInhReas.FId_bInhInvld_Com_tiCurVehTmr DINH_nrActvInhReas.FId_bInhInvld_Com_tiHvbChrgnHalfRx DINH_nrActvInhReas.FId_bInhInvld_Com_uBattEBSRx DINH_nrActvInhReas.FId_bInhInvld_Com_uDcdcHvAct DINH_nrActvInhReas.FId_bInhInvld_Com_uDcdcLvAct DINH_nrActvInhReas.FId_bInhInvld_Com_uElCmprHvAct DINH_nrActvInhReas.FId_bInhInvld_Com_uHvbAct DINH_nrActvInhReas.FId_bInhInvld_Com_uHvbDcBus DINH_nrActvInhReas.FId_bInhInvld_Com_uHvbLimHi DINH_nrActvInhReas.FId_bInhInvld_Com_uHvbMaxCell DINH_nrActvInhReas.FId_bInhInvld_Com_uHvbMinCell DINH_nrActvInhReas.FId_bInhInvld_Com_uHvbNomChrgn DINH_nrActvInhReas.FId_bInhInvld_Com_vVeh DINH_nrActvInhReas.FId_bInh_ACCmpr_pwrLimMax DINH_nrActvInhReas.FId_bInh_ACCtl_flgCmprEna DINH_nrActvInhReas.FId_bInh_ACCtl_nCmprSpdReq DINH_nrActvInhReas.FId_bInh_APP_rInp DINH_nrActvInhReas.FId_bInh_BattId_numOrganNature1 DINH_nrActvInhReas.FId_bInh_BattId_numOrganNature2 DINH_nrActvInhReas.FId_bInh_BattId_numOrganRef1 DINH_nrActvInhReas.FId_bInh_BattId_numOrganRef2 DINH_nrActvInhReas.FId_bInh_BattId_numOrganRef3 DINH_nrActvInhReas.FId_bInh_BattId_numOrganRef4 DINH_nrActvInhReas.FId_bInh_BattId_numSerl1 DINH_nrActvInhReas.FId_bInh_BattId_numSerl2 DINH_nrActvInhReas.FId_bInh_BattId_numSerl3 DINH_nrActvInhReas.FId_bInh_BattId_numSerl4 DINH_nrActvInhReas.FId_bInh_BattId_numSerl5 DINH_nrActvInhReas.FId_bInh_BattId_numSerl6 DINH_nrActvInhReas.FId_bInh_BattId_numSerl7 DINH_nrActvInhReas.FId_bInh_Brk_stRed DINH_nrActvInhReas.FId_bInh_CbnHeatgHeatr_cntrRlyLf DINH_nrActvInhReas.FId_bInh_ChgrPlug_stPlgLockTx DINH_nrActvInhReas.FId_bInh_ChrgCntct_nrNegCntctElpdOper DINH_nrActvInhReas.FId_bInh_ChrgCntct_nrPosCntctElpdOper DINH_nrActvInhReas.FId_bInh_ChrgrRly_stRlyDes DINH_nrActvInhReas.FId_bInh_ChrgrVal_iChrgrDes DINH_nrActvInhReas.FId_bInh_ChrgrVal_iGridLimMax DINH_nrActvInhReas.FId_bInh_ChrgrVal_uHvMax DINH_nrActvInhReas.FId_bInh_CoDrvPITh_stEPSModeReq DINH_nrActvInhReas.FId_bInh_CoPtFH_stPwt DINH_nrActvInhReas.FId_bInh_ComChrg_stMod DINH_nrActvInhReas.FId_bInh_ComChrgn_iDcRly_Sq_Frz DINH_nrActvInhReas.FId_bInh_ComChrgn_uDcRly_Sq_Frz DINH_nrActvInhReas.FId_bInh_ComChrgr_flgChrgrErr_Sq_Frz DINH_nrActvInhReas.FId_bInh_ComChrgr_iAcMax_Sq_Frz DINH_nrActvInhReas.FId_bInh_ComChrgr_iDcHvAct_Sq_Frz DINH_nrActvInhReas.FId_bInh_ComChrgr_pwrInAct_Sq_Frz DINH_nrActvInhReas.FId_bInh_ComChrgr_stChrgnEna DINH_nrActvInhReas.FId_bInh_ComChrgr_stChrgr_Sq_Frz DINH_nrActvInhReas.FId_bInh_ComChrgr_tChrgrMaxAct_Sq_Frz DINH_nrActvInhReas.FId_bInh_ComChrgr_uAcActL1_Sq_Frz DINH_nrActvInhReas.FId_bInh_ComChrgr_uDcHvAct_Sq_Frz DINH_nrActvInhReas.FId_bInh_ComEmac_flgSvsReq01_Sq_Frz DINH_nrActvInhReas.FId_bInh_ComEmac_tIvtrCoolt01_Sq_Frz DINH_nrActvInhReas.FId_bInh_Com_25h_B1b0 DINH_nrActvInhReas.FId_bInh_Com_25h_B1b2 DINH_nrActvInhReas.FId_bInh_Com_25h_B1b4 DINH_nrActvInhReas.FId_bInh_Com_25h_B1b6 DINH_nrActvInhReas.FId_bInh_Com_HvbMaxSnsrTempTx DINH_nrActvInhReas.FId_bInh_Com_TogLedDrv DINH_nrActvInhReas.FId_bInh_Com_TogLedMod DINH_nrActvInhReas.FId_bInh_Com_TogLedNeut DINH_nrActvInhReas.FId_bInh_Com_TogLedRvs DINH_nrActvInhReas.FId_bInh_Com_bAcLedReq DINH_nrActvInhReas.FId_bInh_Com_bDiagMuxCAN DINH_nrActvInhReas.FId_bInh_Com_bGunCntInfoWkuReq DINH_nrActvInhReas.FId_bInh_Com_bHvBattRchrgWkuReq DINH_nrActvInhReas.FId_bInh_Com_bPostOperationWkuReq DINH_nrActvInhReas.FId_bInh_Com_bReFogRlySt DINH_nrActvInhReas.FId_bInh_Com_flgBlowrAuthn DINH_nrActvInhReas.FId_bInh_Com_flgBlowrRlyCtrl DINH_nrActvInhReas.FId_bInh_Com_flgBrkAlrt DINH_nrActvInhReas.FId_bInh_Com_flgDrvAwy DINH_nrActvInhReas.FId_bInh_Com_flgVehSpdQly DINH_nrActvInhReas.FId_bInh_Com_iDcdcHvActRvsn1_Sq_Frz DINH_nrActvInhReas.FId_bInh_Com_iDcdcLvActRvsn1_Sq_Frz DINH_nrActvInhReas.FId_bInh_Com_iElCmprHvAct_Sq_Frz DINH_nrActvInhReas.FId_bInh_Com_iHvbActTx DINH_nrActvInhReas.FId_bInh_Com_nElCmprActlTx DINH_nrActvInhReas.FId_bInh_Com_nIvtrMotAct01 DINH_nrActvInhReas.FId_bInh_Com_noEditCal DINH_nrActvInhReas.FId_bInh_Com_noEditSw DINH_nrActvInhReas.FId_bInh_Com_noVerSysDay DINH_nrActvInhReas.FId_bInh_Com_noVersAdp DINH_nrActvInhReas.FId_bInh_Com_noVersSw DINH_nrActvInhReas.FId_bInh_Com_noVersSys DINH_nrActvInhReas.FId_bInh_Com_noVersSysMnth DINH_nrActvInhReas.FId_bInh_Com_noVersSysYr DINH_nrActvInhReas.FId_bInh_Com_ratHvbSoh_Sq_Frz DINH_nrActvInhReas.FId_bInh_Com_stACTx DINH_nrActvInhReas.FId_bInh_Com_stBrk DINH_nrActvInhReas.FId_bInh_Com_stBrkBstPFlt DINH_nrActvInhReas.FId_bInh_Com_stBrkCntctIndcn DINH_nrActvInhReas.FId_bInh_Com_stChrgPlg DINH_nrActvInhReas.FId_bInh_Com_stChrgPlgChrgn DINH_nrActvInhReas.FId_bInh_Com_stClstrStopIndcn DINH_nrActvInhReas.FId_bInh_Com_stCmdHvBattCntctr DINH_nrActvInhReas.FId_bInh_Com_stCmdOffsEM01 DINH_nrActvInhReas.FId_bInh_Com_stDcdcOperModAct_Sq_Frz DINH_nrActvInhReas.FId_bInh_Com_stDrvAwyDi DINH_nrActvInhReas.FId_bInh_Com_stDrvModPosn DINH_nrActvInhReas.FId_bInh_Com_stEVLmp DINH_nrActvInhReas.FId_bInh_Com_stElCmprStatTx DINH_nrActvInhReas.FId_bInh_Com_stElMDesEem DINH_nrActvInhReas.FId_bInh_Com_stHvBattOperModDes DINH_nrActvInhReas.FId_bInh_Com_stHvacBlwrFront_CAN DINH_nrActvInhReas.FId_bInh_Com_stHvacKnobPosn_CAN DINH_nrActvInhReas.FId_bInh_Com_stMstWrnLmp DINH_nrActvInhReas.FId_bInh_Com_stNwCmdLIN DINH_nrActvInhReas.FId_bInh_Com_stPwrLimnLmp DINH_nrActvInhReas.FId_bInh_Com_stReFogReq_CAN DINH_nrActvInhReas.FId_bInh_Com_stSrvLmp DINH_nrActvInhReas.FId_bInh_Com_stVehCoorn DINH_nrActvInhReas.FId_bInh_Com_tDcdcAct_Sq_Frz DINH_nrActvInhReas.FId_bInh_Com_tDcdcInltCoolt_Sq DINH_nrActvInhReas.FId_bInh_Com_tqMotLimMax DINH_nrActvInhReas.FId_bInh_Com_uDcdcHvAct_Sq_Frz DINH_nrActvInhReas.FId_bInh_Com_uDcdcLvAct_Sq_Frz DINH_nrActvInhReas.FId_bInh_Com_uHvbActTx DINH_nrActvInhReas.FId_bInh_Com_valEepOffsEM01 DINH_nrActvInhReas.FId_bInh_DcChrgnRly_ctMaxOperCyc DINH_nrActvInhReas.FId_bInh_Dcdc_flgDesLvGridULim DINH_nrActvInhReas.FId_bInh_Dcdc_iLimLvGrid DINH_nrActvInhReas.FId_bInh_Dcdc_stDesDcdc DINH_nrActvInhReas.FId_bInh_Dcdc_uDesLvGrid DINH_nrActvInhReas.FId_bInh_DrvInfo_wTotTripEgy DINH_nrActvInhReas.FId_bInh_EChrDv_cntPlin DINH_nrActvInhReas.FId_bInh_Eem_flgFstHvShdwn DINH_nrActvInhReas.FId_bInh_ElM_stDesEem01 DINH_nrActvInhReas.FId_bInh_ElTS_egyTotChrgCyc DINH_nrActvInhReas.FId_bInh_ElTS_ratEmPowChrgn DINH_nrActvInhReas.FId_bInh_ElTS_ratEmPowDcha DINH_nrActvInhReas.FId_bInh_ElTS_stChrgCyc DINH_nrActvInhReas.FId_bInh_Emac_stIsoMonSwtReq DINH_nrActvInhReas.FId_bInh_Emac_tqDesCom01 DINH_nrActvInhReas.FId_bInh_Ext_bSyncGPC DINH_nrActvInhReas.FId_bInh_HvBatt_flgIsoMeasmtDiReq DINH_nrActvInhReas.FId_bInh_HvBatt_ratSoc DINH_nrActvInhReas.FId_bInh_HvGrid_pwrMaxDcdc DINH_nrActvInhReas.FId_bInh_HvacPtc_stElHeatr DINH_nrActvInhReas.FId_bInh_Pdu_CLUSTER_5E7_Frz DINH_nrActvInhReas.FId_bInh_Pdu_CLUSTER_5E7_Rcf DINH_nrActvInhReas.FId_bInh_Pdu_CONTEXTE_1_5B2_Frz DINH_nrActvInhReas.FId_bInh_Pdu_CONTEXTE_1_5B2_Rcf DINH_nrActvInhReas.FId_bInh_Pdu_Com_pwrMaxChrgSho_Sq_Frz DINH_nrActvInhReas.FId_bInh_Pdu_Com_pwrMaxDchaSho_Sq_Frz DINH_nrActvInhReas.FId_bInh_Pdu_DAT3_BSI_4F2h_Frz DINH_nrActvInhReas.FId_bInh_Pdu_DAT3_BSI_4F2h_Rcf DINH_nrActvInhReas.FId_bInh_Pdu_DCDC_283h_Frz DINH_nrActvInhReas.FId_bInh_Pdu_DCDC_283h_Rcf DINH_nrActvInhReas.FId_bInh_Pdu_DCDC_293h_Frz DINH_nrActvInhReas.FId_bInh_Pdu_DCDC_293h_Rcf DINH_nrActvInhReas.FId_bInh_Pdu_DCDC_473h_Frz DINH_nrActvInhReas.FId_bInh_Pdu_DCDC_473h_Rcf DINH_nrActvInhReas.FId_bInh_Pdu_DCDC_663h_Frz DINH_nrActvInhReas.FId_bInh_Pdu_DCDC_663h_Rcf DINH_nrActvInhReas.FId_bInh_Pdu_HS3_AUTO_GEARBOX_SWITCH_STATUS_Frz DINH_nrActvInhReas.FId_bInh_Pdu_HS3_AUTO_GEARBOX_SWITCH_STATUS_Rcf DINH_nrActvInhReas.FId_bInh_Pdu_HVAC_PANEL_26h_Frz DINH_nrActvInhReas.FId_bInh_Pdu_HVAC_PANEL_26h_Rcf DINH_nrActvInhReas.FId_bInh_Pdu_HVBAT_205h_Frz DINH_nrActvInhReas.FId_bInh_Pdu_HVBAT_205h_Rcf DINH_nrActvInhReas.FId_bInh_Pdu_HVBAT_275h_Frz DINH_nrActvInhReas.FId_bInh_Pdu_HVBAT_275h_Rcf DINH_nrActvInhReas.FId_bInh_Pdu_HVBAT_285h_Frz DINH_nrActvInhReas.FId_bInh_Pdu_HVBAT_285h_Rcf DINH_nrActvInhReas.FId_bInh_Pdu_HVBAT_325h_Frz DINH_nrActvInhReas.FId_bInh_Pdu_HVBAT_325h_Rcf DINH_nrActvInhReas.FId_bInh_Pdu_HVBAT_335h_Frz DINH_nrActvInhReas.FId_bInh_Pdu_HVBAT_335h_Rcf DINH_nrActvInhReas.FId_bInh_Pdu_HVBAT_455h_Frz DINH_nrActvInhReas.FId_bInh_Pdu_HVBAT_455h_Rcf DINH_nrActvInhReas.FId_bInh_Pdu_HVBAT_535_Frz DINH_nrActvInhReas.FId_bInh_Pdu_HVBAT_535_Rcf DINH_nrActvInhReas.FId_bInh_Pdu_HVBAT_595h_Frz DINH_nrActvInhReas.FId_bInh_Pdu_HVBAT_595h_Rcf DINH_nrActvInhReas.FId_bInh_Pdu_HVBAT_635h_Frz DINH_nrActvInhReas.FId_bInh_Pdu_HVBAT_635h_Rcf DINH_nrActvInhReas.FId_bInh_Pdu_HVBAT_645h_Frz DINH_nrActvInhReas.FId_bInh_Pdu_HVBAT_645h_Rcf DINH_nrActvInhReas.FId_bInh_Pdu_HVBAT_665h_Frz DINH_nrActvInhReas.FId_bInh_Pdu_HVBAT_665h_Rcf DINH_nrActvInhReas.FId_bInh_Pdu_HVBAT_675h_Frz DINH_nrActvInhReas.FId_bInh_Pdu_HVBAT_675h_Rcf DINH_nrActvInhReas.FId_bInh_Pdu_HVBAT_THERMAL_5B5_Frz DINH_nrActvInhReas.FId_bInh_Pdu_HVBAT_THERMAL_5B5_Rcf DINH_nrActvInhReas.FId_bInh_Pdu_HVBAT_VCU_435h_Frz DINH_nrActvInhReas.FId_bInh_Pdu_HVBAT_VCU_435h_Rcf DINH_nrActvInhReas.FId_bInh_Pdu_HVBAT_VCU_543_Frz DINH_nrActvInhReas.FId_bInh_Pdu_HVBAT_VCU_543_Rcf DINH_nrActvInhReas.FId_bInh_Pdu_HVBAT_VCU_583_Frz DINH_nrActvInhReas.FId_bInh_Pdu_HVBAT_VCU_583_Rcf DINH_nrActvInhReas.FId_bInh_Pdu_INV_217h_Frz DINH_nrActvInhReas.FId_bInh_Pdu_INV_217h_Rcf DINH_nrActvInhReas.FId_bInh_Pdu_INV_227h_Frz DINH_nrActvInhReas.FId_bInh_Pdu_INV_227h_Rcf DINH_nrActvInhReas.FId_bInh_Pdu_INV_237_Frz DINH_nrActvInhReas.FId_bInh_Pdu_INV_237_Rcf DINH_nrActvInhReas.FId_bInh_Pdu_INV_427h_Frz DINH_nrActvInhReas.FId_bInh_Pdu_INV_427h_Rcf DINH_nrActvInhReas.FId_bInh_Pdu_INV_497h_Frz DINH_nrActvInhReas.FId_bInh_Pdu_INV_497h_Rcf DINH_nrActvInhReas.FId_bInh_Pdu_INV_IMMO_5C7_Frz DINH_nrActvInhReas.FId_bInh_Pdu_INV_IMMO_5C7_Rcf DINH_nrActvInhReas.FId_bInh_Pdu_IS_DAT6_BSI_592h_Frz DINH_nrActvInhReas.FId_bInh_Pdu_IS_DAT6_BSI_592h_Rcf DINH_nrActvInhReas.FId_bInh_Pdu_IS_DAT_ABR_50Dh_Frz DINH_nrActvInhReas.FId_bInh_Pdu_IS_DAT_ABR_50Dh_Rcf DINH_nrActvInhReas.FId_bInh_Pdu_IS_DAT_BSI_412h_Frz DINH_nrActvInhReas.FId_bInh_Pdu_IS_DAT_BSI_412h_Rcf DINH_nrActvInhReas.FId_bInh_Pdu_IS_DYN_ABR_38Dh_Frz DINH_nrActvInhReas.FId_bInh_Pdu_IS_DYN_ABR_38Dh_Rcf DINH_nrActvInhReas.FId_bInh_Pdu_IS_INTE_ELECTRON_BSI_092h_Frz DINH_nrActvInhReas.FId_bInh_Pdu_IS_INTE_ELECTRON_BSI_092h_Rcf DINH_nrActvInhReas.FId_bInh_Pdu_OBC_273h_Frz DINH_nrActvInhReas.FId_bInh_Pdu_OBC_273h_Rcf DINH_nrActvInhReas.FId_bInh_Pdu_OBC_453h_Frz DINH_nrActvInhReas.FId_bInh_Pdu_OBC_453h_Rcf DINH_nrActvInhReas.FId_bInh_Pdu_OBC_463h_Frz DINH_nrActvInhReas.FId_bInh_Pdu_OBC_463h_Rcf DINH_nrActvInhReas.FId_bInh_Pdu_PDU_BusVoltages_308_Frz DINH_nrActvInhReas.FId_bInh_Pdu_PDU_BusVoltages_308_Rcf DINH_nrActvInhReas.FId_bInh_Pdu_PDU_Current_318_Frz DINH_nrActvInhReas.FId_bInh_Pdu_PDU_Current_318_Rcf DINH_nrActvInhReas.FId_bInh_Pdu_SC_INFO_BCCM_442h_Frz DINH_nrActvInhReas.FId_bInh_Pdu_SC_INFO_BCCM_442h_Rcf DINH_nrActvInhReas.FId_bInh_Pdu_VCU_AIRBAG_351h_Frz DINH_nrActvInhReas.FId_bInh_Pdu_VCU_AIRBAG_351h_Rcf DINH_nrActvInhReas.FId_bInh_Pdu_VCU_AIRBAG_fault_Frz DINH_nrActvInhReas.FId_bInh_Pdu_VCU_eBCCM_432h_Frz DINH_nrActvInhReas.FId_bInh_Pdu_VCU_eBCCM_432h_Rcf DINH_nrActvInhReas.FId_bInh_Pdu_VCU_eBCCM_552h_Frz DINH_nrActvInhReas.FId_bInh_Pdu_VCU_eBCCM_552h_Rcf DINH_nrActvInhReas.FId_bInh_Pdu_eBCCM_082h_Frz DINH_nrActvInhReas.FId_bInh_Pdu_eBCCM_082h_Rcf DINH_nrActvInhReas.FId_bInh_Pdu_eCOMP_Information_47B_Frz DINH_nrActvInhReas.FId_bInh_Pdu_eCOMP_Information_47B_Rcf DINH_nrActvInhReas.FId_bInh_Pdu_eCOMP_Information_48B_Frz DINH_nrActvInhReas.FId_bInh_Pdu_eCOMP_Information_48B_Rcf DINH_nrActvInhReas.FId_bInh_Sig205h_Com_iHvbActRx_Frz DINH_nrActvInhReas.FId_bInh_Sig205h_Com_iHvbActRx_Rcf DINH_nrActvInhReas.FId_bInh_Sig205h_Com_ratHvbSoc_Frz DINH_nrActvInhReas.FId_bInh_Sig205h_Com_ratHvbSoc_Rcf DINH_nrActvInhReas.FId_bInh_Sig205h_Com_stHvbChrgn_Frz DINH_nrActvInhReas.FId_bInh_Sig205h_Com_stHvbChrgn_Rcf DINH_nrActvInhReas.FId_bInh_Sig205h_Com_uHvbAct_Frz DINH_nrActvInhReas.FId_bInh_Sig205h_Com_uHvbAct_Rcf DINH_nrActvInhReas.FId_bInh_Sig217h_ComEmac_nAct01_Frz DINH_nrActvInhReas.FId_bInh_Sig217h_ComEmac_nAct01_Rcf DINH_nrActvInhReas.FId_bInh_Sig217h_ComEmac_tqAckd01_Frz DINH_nrActvInhReas.FId_bInh_Sig217h_ComEmac_tqAckd01_Rcf DINH_nrActvInhReas.FId_bInh_Sig217h_ComEmac_tqAct01_Frz DINH_nrActvInhReas.FId_bInh_Sig217h_ComEmac_tqAct01_Rcf DINH_nrActvInhReas.FId_bInh_Sig217h_ComEmac_uDcLnk01_Frz DINH_nrActvInhReas.FId_bInh_Sig217h_ComEmac_uDcLnk01_Rcf DINH_nrActvInhReas.FId_bInh_Sig227h_ComEmac_iDcLnk01_Frz DINH_nrActvInhReas.FId_bInh_Sig227h_ComEmac_iDcLnk01_Rcf DINH_nrActvInhReas.FId_bInh_Sig227h_ComEmac_pwrInstnsInpRx_Frz DINH_nrActvInhReas.FId_bInh_Sig227h_ComEmac_pwrInstnsInpRx_Rcf DINH_nrActvInhReas.FId_bInh_Sig227h_ComEmac_tqAbsltMax01_Frz DINH_nrActvInhReas.FId_bInh_Sig227h_ComEmac_tqAbsltMax01_Rcf DINH_nrActvInhReas.FId_bInh_Sig227h_ComEmac_tqAbsltMaxRx01_Frz DINH_nrActvInhReas.FId_bInh_Sig227h_ComEmac_tqAbsltMaxRx01_Rcf DINH_nrActvInhReas.FId_bInh_Sig227h_ComEmac_tqAbsltMin01_Frz DINH_nrActvInhReas.FId_bInh_Sig227h_ComEmac_tqAbsltMin01_Rcf DINH_nrActvInhReas.FId_bInh_Sig227h_ComEmac_tqAbsltMinRx01_Frz DINH_nrActvInhReas.FId_bInh_Sig227h_ComEmac_tqAbsltMinRx01_Rcf DINH_nrActvInhReas.FId_bInh_Sig237h_ComEmac_stActvDcha_Frz DINH_nrActvInhReas.FId_bInh_Sig237h_ComEmac_stActvDcha_Rcf DINH_nrActvInhReas.FId_bInh_Sig237h_ComEmac_stEVLmp_Frz DINH_nrActvInhReas.FId_bInh_Sig237h_ComEmac_stEVLmp_Rcf DINH_nrActvInhReas.FId_bInh_Sig237h_ComEmac_stMod01Rx_Frz DINH_nrActvInhReas.FId_bInh_Sig237h_ComEmac_stMod01Rx_Rcf DINH_nrActvInhReas.FId_bInh_Sig237h_ComEmac_stMstWrnLmp_Frz DINH_nrActvInhReas.FId_bInh_Sig237h_ComEmac_stMstWrnLmp_Rcf DINH_nrActvInhReas.FId_bInh_Sig237h_ComEmac_stSVSLmp_Frz DINH_nrActvInhReas.FId_bInh_Sig237h_ComEmac_stSVSLmp_Rcf DINH_nrActvInhReas.FId_bInh_Sig237h_ComEmac_tqStabnMin_Frz DINH_nrActvInhReas.FId_bInh_Sig237h_ComEmac_tqStabnMin_Rcf DINH_nrActvInhReas.FId_bInh_Sig237h_Com_stIIvtrFltLvl01_Frz DINH_nrActvInhReas.FId_bInh_Sig237h_Com_stIIvtrFltLvl01_Rcf DINH_nrActvInhReas.FId_bInh_Sig259hFlt DINH_nrActvInhReas.FId_bInh_Sig259h_Com_flgEcoNormReqRx_Frz DINH_nrActvInhReas.FId_bInh_Sig259h_Com_flgEcoNormReqRx_Rcf DINH_nrActvInhReas.FId_bInh_Sig259h_Com_stGearLvrPos_Frz DINH_nrActvInhReas.FId_bInh_Sig259h_Com_stGearLvrPos_Rcf DINH_nrActvInhReas.FId_bInh_Sig259h_Com_steTogFailrLvl_Frz DINH_nrActvInhReas.FId_bInh_Sig259h_Com_steTogFailrLvl_Rcf DINH_nrActvInhReas.FId_bInh_Sig26h_Com_stAC_Frz DINH_nrActvInhReas.FId_bInh_Sig26h_Com_stAC_Rcf DINH_nrActvInhReas.FId_bInh_Sig26h_Com_stEvapTFlt_Frz DINH_nrActvInhReas.FId_bInh_Sig26h_Com_stEvapTFlt_Rcf DINH_nrActvInhReas.FId_bInh_Sig26h_Com_stHvacBlwrFront_Frz DINH_nrActvInhReas.FId_bInh_Sig26h_Com_stHvacBlwrFront_Rcf DINH_nrActvInhReas.FId_bInh_Sig26h_Com_stHvacKnobPosn_Frz DINH_nrActvInhReas.FId_bInh_Sig26h_Com_stHvacKnobPosn_Rcf DINH_nrActvInhReas.FId_bInh_Sig26h_Com_stHvacPanPotiFlt_Frz DINH_nrActvInhReas.FId_bInh_Sig26h_Com_stHvacPanPotiFlt_Rcf DINH_nrActvInhReas.FId_bInh_Sig26h_Com_stReFogReq_Frz DINH_nrActvInhReas.FId_bInh_Sig26h_Com_stReFogReq_Rcf DINH_nrActvInhReas.FId_bInh_Sig26h_Com_tEvapT_Frz DINH_nrActvInhReas.FId_bInh_Sig26h_Com_tEvapT_Rcf DINH_nrActvInhReas.FId_bInh_Sig273h_ComChrgr_flgChrgrErrLvl_Frz DINH_nrActvInhReas.FId_bInh_Sig273h_ComChrgr_flgChrgrErrLvl_Rcf DINH_nrActvInhReas.FId_bInh_Sig273h_ComChrgr_pwrOutpCpby_Frz DINH_nrActvInhReas.FId_bInh_Sig273h_ComChrgr_pwrOutpCpby_Rcf DINH_nrActvInhReas.FId_bInh_Sig275h_Com_iHvbDchaMaxSho_Frz DINH_nrActvInhReas.FId_bInh_Sig275h_Com_iHvbDchaMaxSho_Rcf DINH_nrActvInhReas.FId_bInh_Sig275h_Com_pwrMaxDchaSho_Frz DINH_nrActvInhReas.FId_bInh_Sig275h_Com_pwrMaxDchaSho_Rcf DINH_nrActvInhReas.FId_bInh_Sig283h_Com_iDcdcHvActRvsn1_Frz DINH_nrActvInhReas.FId_bInh_Sig283h_Com_iDcdcHvActRvsn1_Rcf DINH_nrActvInhReas.FId_bInh_Sig283h_Com_iDcdcLvActRvsn1_Frz DINH_nrActvInhReas.FId_bInh_Sig283h_Com_iDcdcLvActRvsn1_Rcf DINH_nrActvInhReas.FId_bInh_Sig283h_Com_uDcdcHvAct_Frz DINH_nrActvInhReas.FId_bInh_Sig283h_Com_uDcdcHvAct_Rcf DINH_nrActvInhReas.FId_bInh_Sig283h_Com_uDcdcLvAct_Frz DINH_nrActvInhReas.FId_bInh_Sig283h_Com_uDcdcLvAct_Rcf DINH_nrActvInhReas.FId_bInh_Sig285h_Com_iHvbChrgMaxSho_Frz DINH_nrActvInhReas.FId_bInh_Sig285h_Com_iHvbChrgMaxSho_Rcf DINH_nrActvInhReas.FId_bInh_Sig285h_Com_pwrMaxChrgSho_Frz DINH_nrActvInhReas.FId_bInh_Sig285h_Com_pwrMaxChrgSho_Rcf DINH_nrActvInhReas.FId_bInh_Sig293h_Com_pwrDcdcOutpCpby_Frz DINH_nrActvInhReas.FId_bInh_Sig293h_Com_pwrDcdcOutpCpby_Rcf DINH_nrActvInhReas.FId_bInh_Sig293h_Com_stDcdcFltLvl_Frz DINH_nrActvInhReas.FId_bInh_Sig293h_Com_stDcdcFltLvl_Rcf DINH_nrActvInhReas.FId_bInh_Sig325h_Com_rHvbIsoMeasmt_Frz DINH_nrActvInhReas.FId_bInh_Sig325h_Com_rHvbIsoMeasmt_Rcf DINH_nrActvInhReas.FId_bInh_Sig325h_Com_stHvbIntlckRx_Frz DINH_nrActvInhReas.FId_bInh_Sig325h_Com_stHvbIntlckRx_Rcf DINH_nrActvInhReas.FId_bInh_Sig325h_Com_stHvbIsoFltRx_Frz DINH_nrActvInhReas.FId_bInh_Sig325h_Com_stHvbIsoFltRx_Rcf DINH_nrActvInhReas.FId_bInh_Sig325h_Com_stHvbSrvPlgRx_Frz DINH_nrActvInhReas.FId_bInh_Sig325h_Com_stHvbSrvPlgRx_Rcf DINH_nrActvInhReas.FId_bInh_Sig325h_Com_tHvbMax_Frz DINH_nrActvInhReas.FId_bInh_Sig325h_Com_tHvbMax_Rcf DINH_nrActvInhReas.FId_bInh_Sig335h_Com_iHvbDes_Frz DINH_nrActvInhReas.FId_bInh_Sig335h_Com_iHvbDes_Rcf DINH_nrActvInhReas.FId_bInh_Sig335h_Com_iHvbNomChrgn_Frz DINH_nrActvInhReas.FId_bInh_Sig335h_Com_iHvbNomChrgn_Rcf DINH_nrActvInhReas.FId_bInh_Sig335h_Com_uHvbDcBus_Frz DINH_nrActvInhReas.FId_bInh_Sig335h_Com_uHvbDcBus_Rcf DINH_nrActvInhReas.FId_bInh_Sig335h_Com_uHvbLimHi_Frz DINH_nrActvInhReas.FId_bInh_Sig335h_Com_uHvbLimHi_Rcf DINH_nrActvInhReas.FId_bInh_Sig38Dh_Com_flgVehSpdAvl_Frz DINH_nrActvInhReas.FId_bInh_Sig38Dh_Com_flgVehSpdAvl_Rcf DINH_nrActvInhReas.FId_bInh_Sig38Dh_Com_vVeh_Frz DINH_nrActvInhReas.FId_bInh_Sig38Dh_Com_vVeh_Rcf DINH_nrActvInhReas.FId_bInh_Sig427h_ComEmac_stIvtrOpMod01_Frz DINH_nrActvInhReas.FId_bInh_Sig427h_ComEmac_stIvtrOpMod01_Rcf DINH_nrActvInhReas.FId_bInh_Sig427h_ComEmac_tInvr01_Frz DINH_nrActvInhReas.FId_bInh_Sig427h_ComEmac_tInvr01_Rcf DINH_nrActvInhReas.FId_bInh_Sig427h_ComEmac_tIvtrCooltIn01_Frz DINH_nrActvInhReas.FId_bInh_Sig427h_ComEmac_tIvtrCooltIn01_Rcf DINH_nrActvInhReas.FId_bInh_Sig427h_ComEmac_tMac01_Frz DINH_nrActvInhReas.FId_bInh_Sig427h_ComEmac_tMac01_Rcf DINH_nrActvInhReas.FId_bInh_Sig427h_ComEmac_tqPtd01_Frz DINH_nrActvInhReas.FId_bInh_Sig427h_ComEmac_tqPtd01_Rcf DINH_nrActvInhReas.FId_bInh_Sig432h_Com_stMainWkuReq_Frz DINH_nrActvInhReas.FId_bInh_Sig432h_Com_stMainWkuReq_Rcf DINH_nrActvInhReas.FId_bInh_Sig435h_Com_HvbMaxSnsrTempRx_Frz DINH_nrActvInhReas.FId_bInh_Sig435h_Com_HvbMaxSnsrTempRx_Rcf DINH_nrActvInhReas.FId_bInh_Sig435h_Com_nrSerMaxCell_Frz DINH_nrActvInhReas.FId_bInh_Sig435h_Com_nrSerMaxCell_Rcf DINH_nrActvInhReas.FId_bInh_Sig435h_Com_nrSerMinCell_Frz DINH_nrActvInhReas.FId_bInh_Sig435h_Com_nrSerMinCell_Rcf DINH_nrActvInhReas.FId_bInh_Sig435h_Com_uHvbMaxCell_Frz DINH_nrActvInhReas.FId_bInh_Sig435h_Com_uHvbMaxCell_Rcf DINH_nrActvInhReas.FId_bInh_Sig435h_Com_uHvbMinCell_Frz DINH_nrActvInhReas.FId_bInh_Sig435h_Com_uHvbMinCell_Rcf DINH_nrActvInhReas.FId_bInh_Sig442h_Com_stBlowrRly_Frz DINH_nrActvInhReas.FId_bInh_Sig442h_Com_stBlowrRly_Rcf DINH_nrActvInhReas.FId_bInh_Sig453h_ComChrgr_iAcMax_Frz DINH_nrActvInhReas.FId_bInh_Sig453h_ComChrgr_iAcMax_Rcf DINH_nrActvInhReas.FId_bInh_Sig453h_ComChrgr_pwrInAct_Frz DINH_nrActvInhReas.FId_bInh_Sig453h_ComChrgr_pwrInAct_Rcf DINH_nrActvInhReas.FId_bInh_Sig453h_ComChrgr_uAcActL1_Frz DINH_nrActvInhReas.FId_bInh_Sig453h_ComChrgr_uAcActL1_Rcf DINH_nrActvInhReas.FId_bInh_Sig455h_Com_uHvbNomChrgn_Frz DINH_nrActvInhReas.FId_bInh_Sig455h_Com_uHvbNomChrgn_Rcf DINH_nrActvInhReas.FId_bInh_Sig463h_ComChrgr_iDcHvAct_Frz DINH_nrActvInhReas.FId_bInh_Sig463h_ComChrgr_iDcHvAct_Rcf DINH_nrActvInhReas.FId_bInh_Sig463h_ComChrgr_tChrgrMaxAct_Frz DINH_nrActvInhReas.FId_bInh_Sig463h_ComChrgr_tChrgrMaxAct_Rcf DINH_nrActvInhReas.FId_bInh_Sig463h_ComChrgr_uDcHvAct_Frz DINH_nrActvInhReas.FId_bInh_Sig463h_ComChrgr_uDcHvAct_Rcf DINH_nrActvInhReas.FId_bInh_Sig473h_Com_tDcdcAct_Frz DINH_nrActvInhReas.FId_bInh_Sig473h_Com_tDcdcAct_Rcf DINH_nrActvInhReas.FId_bInh_Sig473h_Com_tDcdcInltCoolt_Frz DINH_nrActvInhReas.FId_bInh_Sig473h_Com_tDcdcInltCoolt_Rcf DINH_nrActvInhReas.FId_bInh_Sig47Bh_Com_iElCmprHvAct_Frz DINH_nrActvInhReas.FId_bInh_Sig47Bh_Com_iElCmprHvAct_Rcf DINH_nrActvInhReas.FId_bInh_Sig47Bh_Com_iElCmprPeakPha_Frz DINH_nrActvInhReas.FId_bInh_Sig47Bh_Com_iElCmprPeakPha_Rcf DINH_nrActvInhReas.FId_bInh_Sig47Bh_Com_nElCmprActl_Frz DINH_nrActvInhReas.FId_bInh_Sig47Bh_Com_nElCmprActl_Rcf DINH_nrActvInhReas.FId_bInh_Sig47Bh_Com_pwrElCmprActl_Frz DINH_nrActvInhReas.FId_bInh_Sig47Bh_Com_pwrElCmprActl_Rcf DINH_nrActvInhReas.FId_bInh_Sig47Bh_Com_tElCmprActl_Frz DINH_nrActvInhReas.FId_bInh_Sig47Bh_Com_tElCmprActl_Rcf DINH_nrActvInhReas.FId_bInh_Sig47Bh_Com_uElCmprHvAct_Frz DINH_nrActvInhReas.FId_bInh_Sig47Bh_Com_uElCmprHvAct_Rcf DINH_nrActvInhReas.FId_bInh_Sig48Bh_Com_stElCmprFltLvl_Frz DINH_nrActvInhReas.FId_bInh_Sig48Bh_Com_stElCmprFltLvl_Rcf DINH_nrActvInhReas.FId_bInh_Sig4F2h_Com_ratSocLvBatt_Frz DINH_nrActvInhReas.FId_bInh_Sig4F2h_Com_ratSocLvBatt_Rcf DINH_nrActvInhReas.FId_bInh_Sig4F2h_Com_stSocRx_Frz DINH_nrActvInhReas.FId_bInh_Sig4F2h_Com_stSocRx_Rcf DINH_nrActvInhReas.FId_bInh_Sig4F2h_Com_stT_Frz DINH_nrActvInhReas.FId_bInh_Sig4F2h_Com_stT_Rcf DINH_nrActvInhReas.FId_bInh_Sig535h_Com_tHvbAct_Frz DINH_nrActvInhReas.FId_bInh_Sig535h_Com_tHvbAct_Rcf DINH_nrActvInhReas.FId_bInh_Sig543h_Com_egyHvbAvl_fRx_Frz DINH_nrActvInhReas.FId_bInh_Sig543h_Com_egyHvbAvl_fRx_Rcf DINH_nrActvInhReas.FId_bInh_Sig543h_Com_ratHvbSoh_Frz DINH_nrActvInhReas.FId_bInh_Sig543h_Com_ratHvbSoh_Rcf DINH_nrActvInhReas.FId_bInh_Sig543h_Com_ratRHvbSoh_Frz DINH_nrActvInhReas.FId_bInh_Sig543h_Com_ratRHvbSoh_Rcf DINH_nrActvInhReas.FId_bInh_Sig552h_Com_lDstGlbDa_Frz DINH_nrActvInhReas.FId_bInh_Sig552h_Com_lDstGlbDa_Rcf DINH_nrActvInhReas.FId_bInh_Sig552h_Com_lTotOdometer_Frz DINH_nrActvInhReas.FId_bInh_Sig552h_Com_lTotOdometer_Rcf DINH_nrActvInhReas.FId_bInh_Sig552h_Com_tiCurVehTmr_Frz DINH_nrActvInhReas.FId_bInh_Sig552h_Com_tiCurVehTmr_Rcf DINH_nrActvInhReas.FId_bInh_Sig583h_Com_stHvbDiscnctReas_Frz DINH_nrActvInhReas.FId_bInh_Sig583h_Com_stHvbDiscnctReas_Rcf DINH_nrActvInhReas.FId_bInh_Sig592h_Com_iBattEBS1Rx_Frz DINH_nrActvInhReas.FId_bInh_Sig592h_Com_iBattEBS1Rx_Rcf DINH_nrActvInhReas.FId_bInh_Sig592h_Com_iBattEBS2Rx_Frz DINH_nrActvInhReas.FId_bInh_Sig592h_Com_iBattEBS2Rx_Rcf DINH_nrActvInhReas.FId_bInh_Sig592h_Com_iBattEBS3Rx_Frz DINH_nrActvInhReas.FId_bInh_Sig592h_Com_iBattEBS3Rx_Rcf DINH_nrActvInhReas.FId_bInh_Sig592h_Com_stIBattEBS_Frz DINH_nrActvInhReas.FId_bInh_Sig592h_Com_stIBattEBS_Rcf DINH_nrActvInhReas.FId_bInh_Sig592h_Com_tLvBatt_Frz DINH_nrActvInhReas.FId_bInh_Sig592h_Com_tLvBatt_Rcf DINH_nrActvInhReas.FId_bInh_Sig592h_Com_uBattEBSRx_Frz DINH_nrActvInhReas.FId_bInh_Sig592h_Com_uBattEBSRx_Rcf DINH_nrActvInhReas.FId_bInh_Sig595h_Com_tiHvbChrgnHalfRx_Frz DINH_nrActvInhReas.FId_bInh_Sig595h_Com_tiHvbChrgnHalfRx_Rcf DINH_nrActvInhReas.FId_bInh_Sig5B2h_Com_tEnvT_Frz DINH_nrActvInhReas.FId_bInh_Sig5B2h_Com_tEnvT_Rcf DINH_nrActvInhReas.FId_bInh_Sig5B5h_Com_stAlrtThermRunAwy_Frz DINH_nrActvInhReas.FId_bInh_Sig5B5h_Com_stAlrtThermRunAwy_Rcf DINH_nrActvInhReas.FId_bInh_Sig635h_Com_ctHvbNegCntctrSeg1_Frz DINH_nrActvInhReas.FId_bInh_Sig635h_Com_ctHvbNegCntctrSeg1_Rcf DINH_nrActvInhReas.FId_bInh_Sig635h_Com_ctHvbNegCntctrSeg3_Frz DINH_nrActvInhReas.FId_bInh_Sig635h_Com_ctHvbNegCntctrSeg3_Rcf DINH_nrActvInhReas.FId_bInh_Sig635h_Com_ctHvbNegCntctrSeg4_Frz DINH_nrActvInhReas.FId_bInh_Sig635h_Com_ctHvbNegCntctrSeg4_Rcf DINH_nrActvInhReas.FId_bInh_Sig635h_Com_ctHvbPosCntctrSeg1_Frz DINH_nrActvInhReas.FId_bInh_Sig635h_Com_ctHvbPosCntctrSeg1_Rcf DINH_nrActvInhReas.FId_bInh_Sig635h_Com_ctHvbPosCntctrSeg3_Frz DINH_nrActvInhReas.FId_bInh_Sig635h_Com_ctHvbPosCntctrSeg3_Rcf DINH_nrActvInhReas.FId_bInh_Sig635h_Com_ctHvbPosCntctrSeg4_Frz DINH_nrActvInhReas.FId_bInh_Sig635h_Com_ctHvbPosCntctrSeg4_Rcf DINH_nrActvInhReas.FId_bInh_Sig645h_Com_ctHvbPrecCntctrSeg1_Frz DINH_nrActvInhReas.FId_bInh_Sig645h_Com_ctHvbPrecCntctrSeg1_Rcf DINH_nrActvInhReas.FId_bInh_Sig645h_Com_ctHvbPrecCntctrSeg2_Frz DINH_nrActvInhReas.FId_bInh_Sig645h_Com_ctHvbPrecCntctrSeg2_Rcf DINH_nrActvInhReas.FId_bInh_Sig675h_Com_qHvbTotCpRx_Frz DINH_nrActvInhReas.FId_bInh_Sig675h_Com_qHvbTotCpRx_Rcf DINH_nrActvInhReas.FId_bInh_Sig_ComEmac_flgImobAuthent_Sq_Frz DINH_nrActvInhReas.FId_bInh_Sig_ComEmac_stIsoMonSwtAck_Sq_Frz DINH_nrActvInhReas.FId_bInh_Sig_ComEmac_stPwrAuthn_Sq_Frz DINH_nrActvInhReas.FId_bInh_Sig_Com_flgEcoNormReq_Frz DINH_nrActvInhReas.FId_bInh_Sig_Com_pwrMaxChrgSho_Sq_Frz DINH_nrActvInhReas.FId_bInh_Sig_Com_pwrMaxDchaSho_Sq_Frz DINH_nrActvInhReas.FId_bInh_Sig_Com_stDcdcULimReq_Sq_Frz DINH_nrActvInhReas.FId_bInh_Sig_Com_stGearLvrPos_Frz DINH_nrActvInhReas.FId_bInh_Sig_Com_stIgnkeyPos_Sq_Frz DINH_nrActvInhReas.FId_bInh_ThermHvac_stRemPrecndn DINH_nrActvInhReas.FId_bInh_VehCoorn_dstRngPrdcDispTx DINH_nrActvInhReas.FId_bInh_VehCoorn_wCnsTotWghtAvrgEffTripA DINH_nrActvInhReas.FId_bInh_VehCoorn_wCnsTotWghtAvrgEffTripB DINH_nrActvInhReas.FId_bInh_VehCoorn_wCnsTotWghtAvrgEffTx DINH_nrActvInhReas.FId_bInh_VehCoorn_wCnsTotWghtTripAvrgEffTx DINH_nrActvInhReas.FId_bInh_VehCoorn_wCnsWghtAvrgEffTripA DINH_nrActvInhReas.FId_bInh_VehCoorn_wCnsWghtAvrgEffTripB DINH_nrActvInhReas.FId_binnh_Sig_ComEmac_flgEmgyShtDwnReq01_Sq_Frz DINH_nrActvInhReas.FId_binnh_Sig_ComEmac_flgImobAuthent_Sq_Frz DINH_nrActvInhReas.FId_binnh_Sig_ComEmac_iDcLnk01_Sq_Frz DINH_nrActvInhReas.FId_binnh_Sig_ComEmac_nAct01_Sq_Frz DINH_nrActvInhReas.FId_binnh_Sig_ComEmac_stActvDcha_Sq_Frz DINH_nrActvInhReas.FId_binnh_Sig_ComEmac_stIsoMonSwtAck_Sq_Frz DINH_nrActvInhReas.FId_binnh_Sig_ComEmac_stMod01_Sq_Frz DINH_nrActvInhReas.FId_binnh_Sig_ComEmac_stPwrAuthn_Sq_Frz DINH_nrActvInhReas.FId_binnh_Sig_ComEmac_tInvr01_Sq_Frz DINH_nrActvInhReas.FId_binnh_Sig_ComEmac_tMac01_Sq_Frz DINH_nrActvInhReas.FId_binnh_Sig_ComEmac_tqAbsltMax01_Sq_Frz DINH_nrActvInhReas.FId_binnh_Sig_ComEmac_tqAbsltMin01_Sq_Frz DINH_nrActvInhReas.FId_binnh_Sig_ComEmac_tqAct01_Sq_Frz DINH_nrActvInhReas.FId_binnh_Sig_ComEmac_uDcLnk01_sq_Frz DINH_nrActvInhReas.FId_binnh_Sig_Com_egyHvbAvl_Sq_Frz DINH_nrActvInhReas.FId_binnh_Sig_Com_iHvbAct_Sq_Frz DINH_nrActvInhReas.FId_binnh_Sig_Com_iHvbChrgMaxSho_Sq_Frz DINH_nrActvInhReas.FId_binnh_Sig_Com_iHvbDchaMaxSho_Sq_Frz DINH_nrActvInhReas.FId_binnh_Sig_Com_iHvbDes_Sq_Frz DINH_nrActvInhReas.FId_binnh_Sig_Com_pwrDcdcOutpCpby_Sq_Frz DINH_nrActvInhReas.FId_binnh_Sig_Com_rHvbIsoMeasmt_Sq_Frz DINH_nrActvInhReas.FId_binnh_Sig_Com_ratHvbSoc_Sq_Frz DINH_nrActvInhReas.FId_binnh_Sig_Com_stDcdcULimReq_Sq_Frz DINH_nrActvInhReas.FId_binnh_Sig_Com_stHvbCntct_Sq_Frz DINH_nrActvInhReas.FId_binnh_Sig_Com_stHvbDernMaxT_Sq_Frz DINH_nrActvInhReas.FId_binnh_Sig_Com_stHvbDernMinT_Sq_Frz DINH_nrActvInhReas.FId_binnh_Sig_Com_stHvbFlt_Sq_Frz DINH_nrActvInhReas.FId_binnh_Sig_Com_stHvbIntlck_Sq_Frz DINH_nrActvInhReas.FId_binnh_Sig_Com_stHvbIsoFlt_Sq_Frz DINH_nrActvInhReas.FId_binnh_Sig_Com_stHvbMod_Sq_Frz DINH_nrActvInhReas.FId_binnh_Sig_Com_stHvbSrvPlg_Sq_Frz DINH_nrActvInhReas.FId_binnh_Sig_Com_tHvbAct_Sq_Frz DINH_nrActvInhReas.FId_binnh_Sig_Com_uElCmprHvAct_Sq_Frz DINH_nrActvInhReas.FId_binnh_Sig_Com_uHvbAct_Sq_Frz DINH_nrActvInhReas.FId_binnh_Sig_Com_uHvbDcBus_Sq_Frz DINH_nrActvInhReas.FId_binnh_Sig_Com_uHvbLimHi_Sq_Frz DINH_nrActvInhReas.FId_binnh_Sig_Com_uHvbNomChrgn_Sq_Frz DINH_stFId.FID_ElTSPwrChrgnOutErr DINH_stFId.FID_ElTSPwrInActErr DINH_stFId.FId_ACCmprFltPDiagEnad DINH_stFId.FId_ACCmprInpErr DINH_stFId.FId_ACpAC DINH_stFId.FId_APP1SigPath DINH_stFId.FId_APP2SigPath DINH_stFId.FId_APPBrkErr DINH_stFId.FId_APPVehVErr DINH_stFId.FId_AcChrgrIntkTEnhdSRCMax DINH_stFId.FId_AcChrgrIntkTFrzVal DINH_stFId.FId_AcChrgrIntkTPhysRng DINH_stFId.FId_AcChrgrIntkTRplVal DINH_stFId.FId_AcChrgrIntkTSSpMon DINH_stFId.FId_AcChrgrIntkTTmpErrCnt DINH_stFId.FId_AcExtChrgrChrgn DINH_stFId.FId_Airbg2MED DINH_stFId.FId_AirbgAVSstCrash DINH_stFId.FId_AirbgCan DINH_stFId.FId_AirbgHw DINH_stFId.FId_AirbgInpSigErr DINH_stFId.FId_AirbgPWMErr DINH_stFId.FId_AirbgPwmSrcErr DINH_stFId.FId_BattUDiagEna DINH_stFId.FId_BattUInvalid DINH_stFId.FId_BattUReplcmt DINH_stFId.FId_BattUVehVVld DINH_stFId.FId_BlwrComErr DINH_stFId.FId_BrkBstBrkSt DINH_stFId.FId_BrkBstP DINH_stFId.FId_BrkBstPEnaPrc DINH_stFId.FId_BrkBstPFrzVal DINH_stFId.FId_BrkBstPPlaus12FrznDfct DINH_stFId.FId_BrkBstPPlaus12ReplcmtDfct DINH_stFId.FId_BrkBstPReplVal DINH_stFId.FId_BrkBstPSnsr1FrzDfct DINH_stFId.FId_BrkBstPSnsr1ReplcmtDfct DINH_stFId.FId_BrkBstPSnsr1SplyDfct DINH_stFId.FId_BrkBstPSnsr2FrzDfct DINH_stFId.FId_BrkBstPSnsr2ReplcmtDfct DINH_stFId.FId_BrkBstPSnsr2SplyDfct DINH_stFId.FId_BrkBstPmpActtnDiagEnad DINH_stFId.FId_BrkBstPmpDeactvnDiagEnad DINH_stFId.FId_BrkBstPmpLeakDiagEnad DINH_stFId.FId_BrkBstPmpM1Err DINH_stFId.FId_BrkBstPmpM2Err DINH_stFId.FId_BrkBstPmpScgLsErr DINH_stFId.FId_BrkBstPmpVacChkEna DINH_stFId.FId_BrkBstTst DINH_stFId.FId_BrkPlaus1Ena DINH_stFId.FId_BrkPresAlrt DINH_stFId.FId_BrkSigMaiCanFrzVal DINH_stFId.FId_BrkSigMaiCanReplVal DINH_stFId.FId_BrkStMnFinalDfct DINH_stFId.FId_BrkStMnPrelDfct DINH_stFId.FId_BrkStRdntFinalDfct DINH_stFId.FId_BrkStRdntPrelDfct DINH_stFId.FId_CanEifVehSpdVld DINH_stFId.FId_CbnHeatgHeatrPsFlt DINH_stFId.FId_CbnHeatgHeatrRlyDiagEnad DINH_stFId.FId_CbnHeatgSwtFrzVal DINH_stFId.FId_CbnHeatgSwtRplVal DINH_stFId.FId_CbnHeatgSwtTmpErrCnt DINH_stFId.FId_CcsDcStopChrgn DINH_stFId.FId_CcsDcStopChrgnIDftl DINH_stFId.FId_CcsPwrLineChpRstMonOff DINH_stFId.FId_CcsPwrLineChpRstOff DINH_stFId.FId_CcsPwrLineChpRstPsOff DINH_stFId.FId_CcsPwrLineChpRstSnsr DINH_stFId.FId_CcsPwrLineChpVccEnaMonOff DINH_stFId.FId_CcsPwrLineChpVccEnaOff DINH_stFId.FId_CcsPwrLineChpVccEnaPsOff DINH_stFId.FId_CcsPwrLineChpVccEnaSnsr DINH_stFId.FId_CcsPwrLineChpVccEnhdSRCMax DINH_stFId.FId_CcsPwrLineChpVccFrzVal DINH_stFId.FId_CcsPwrLineChpVccPhysRng DINH_stFId.FId_CcsPwrLineChpVccRplVal DINH_stFId.FId_CcsPwrLineChpVccSSpMon DINH_stFId.FId_CcsPwrLineChpVccTmpErrCnt DINH_stFId.FId_CcsPwrLineComChpTEnhdSRCMax DINH_stFId.FId_CcsPwrLineComChpTFrzVal DINH_stFId.FId_CcsPwrLineComChpTPhysRng DINH_stFId.FId_CcsPwrLineComChpTRplVal DINH_stFId.FId_CcsPwrLineComChpTSSpMon DINH_stFId.FId_CcsPwrLineComChpTTmpErrCnt DINH_stFId.FId_ChgrPlugCtpSwtSnsrActrErr DINH_stFId.FId_ChgrPlugLockActrErr DINH_stFId.FId_ChgrPlugLockSnsrErr DINH_stFId.FId_ChgrPlugPxp1InhbDiagSrc DINH_stFId.FId_ChgrPlugTPinDcErr DINH_stFId.FId_ChrgPlgChrgrRlyWlddCcs DINH_stFId.FId_ChrgPlugCtpDetnErr DINH_stFId.FId_ChrgnCntctPsFlt DINH_stFId.FId_ChrgnLmpChrgnFlt DINH_stFId.FId_ChrgnLmpNoChrgn DINH_stFId.FId_ChrgnUnplRqrd DINH_stFId.FId_ChrgrRlyDcActNegErr DINH_stFId.FId_ChrgrRlyDcActPosErr DINH_stFId.FId_CmbdChrgnSysCntctErr DINH_stFId.FId_CoElMDSQCanEMS01 DINH_stFId.FId_CoElMErr01 DINH_stFId.FId_CoPOMLimdPrpnHmi DINH_stFId.FId_CoPOMMaxLimFltDetnPrim DINH_stFId.FId_CoPOMMinLimFltDetnPrim DINH_stFId.FId_CoPOMNoPrpnHmi DINH_stFId.FId_CoPOMRecupPwrRednHmi DINH_stFId.FId_CoPOMRgnInhbnPrim DINH_stFId.FId_CoVMEvSysCptMaxErrPrim01 DINH_stFId.FId_CoVMEvSysCptMaxErrPrim02 DINH_stFId.FId_CoVMEvSysCptMaxErrPrim03 DINH_stFId.FId_CoVMEvSysCptMaxErrPrim04 DINH_stFId.FId_CoVMEvSysCptMaxErrPrim05 DINH_stFId.FId_CoVMEvSysCptMinErrPrim01 DINH_stFId.FId_CoVMEvSysCptMinErrPrim02 DINH_stFId.FId_CoVMEvSysCptMinErrPrim03 DINH_stFId.FId_CoVMEvVehVVld DINH_stFId.FId_ComHillHldFrmErr DINH_stFId.FId_Com_stMainWkuInvld DINH_stFId.FId_CtPSwtActrMonOff DINH_stFId.FId_CtPSwtActrOff DINH_stFId.FId_CtPSwtActrPsOff DINH_stFId.FId_CtPSwtActrSnsr DINH_stFId.FId_CtPSwtDiagEnhdSRCMax DINH_stFId.FId_CtPSwtDiagFrzVal DINH_stFId.FId_CtPSwtDiagPhysRng DINH_stFId.FId_CtPSwtDiagRplVal DINH_stFId.FId_CtPSwtDiagSSpMon DINH_stFId.FId_CtPSwtDiagTmpErrCnt DINH_stFId.FId_CtpCarrFrqFrzVal DINH_stFId.FId_CtpCarrFrqPhysRng DINH_stFId.FId_CtpCarrFrqRplVal DINH_stFId.FId_CtpCarrFrqSSpMon DINH_stFId.FId_CtpCarrFrqTmpErrCnt DINH_stFId.FId_DELibAcChrgrIntkT DINH_stFId.FId_DELibDcChrgrIntkT DINH_stFId.FId_DELibEnvP DINH_stFId.FId_DELibEnvT DINH_stFId.FId_DELibHeatrCoreT DINH_stFId.FId_DSMAUXWucVrnt5 DINH_stFId.FId_DcChrgnCtrlChrgPrmExch DINH_stFId.FId_DcChrgrIntkT2EnhdSRCMax DINH_stFId.FId_DcChrgrIntkT2FrzVal DINH_stFId.FId_DcChrgrIntkT2PhysRng DINH_stFId.FId_DcChrgrIntkT2RplVal DINH_stFId.FId_DcChrgrIntkT2SSpMon DINH_stFId.FId_DcChrgrIntkT2TmpErrCnt DINH_stFId.FId_DcChrgrIntkTEnhdSRCMax DINH_stFId.FId_DcChrgrIntkTFrzVal DINH_stFId.FId_DcChrgrIntkTPhysRng DINH_stFId.FId_DcChrgrIntkTRplVal DINH_stFId.FId_DcChrgrIntkTSSpMon DINH_stFId.FId_DcChrgrIntkTTmpErrCnt DINH_stFId.FId_DcdcDesOperModFwd DINH_stFId.FId_DcdcPwrLoadMngtMaxPred DINH_stFId.FId_DcdcUDesLvGrid DINH_stFId.FId_DcmDspUDSStPwrLatch DINH_stFId.FId_DrvDoorCANSigFault DINH_stFId.FId_DrvInfoEgyAvlErr DINH_stFId.FId_DrvModPosnApp DINH_stFId.FId_DrvPrgSwtEna DINH_stFId.FId_DrvStbltCANSigFault DINH_stFId.FId_EBDLmpSig DINH_stFId.FId_EVLmpBlnkIllmn DINH_stFId.FId_EVLmpContIllmn DINH_stFId.FId_EbsLinErr DINH_stFId.FId_EemDcdcPrecErr DINH_stFId.FId_EemDcdcUHVAct DINH_stFId.FId_EemFltHvDcha DINH_stFId.FId_EemFstHvShdwn DINH_stFId.FId_EemHvBattMod DINH_stFId.FId_EemHvOffTout DINH_stFId.FId_EemHvShdwn DINH_stFId.FId_EemNoHvStrtup DINH_stFId.FId_ElMNoPrp01 DINH_stFId.FId_ElMnLim01 DINH_stFId.FId_ElMtrqLim01 DINH_stFId.FId_ElSSACCmprUFlt DINH_stFId.FId_ElSSCabAirHtUFlt DINH_stFId.FId_ElSSHvReqEna DINH_stFId.FId_ElSSUHvDcBus DINH_stFId.FId_ElTSHvIntlck DINH_stFId.FId_EmWakeupSigMonOff DINH_stFId.FId_EmWakeupSigOff DINH_stFId.FId_EmWakeupSigPsOff DINH_stFId.FId_EmWakeupSigSnsr DINH_stFId.FId_EmacUDcLnk01 DINH_stFId.FId_EvThermLTClgDmdErr DINH_stFId.FId_EvThermMTClgDmdErr DINH_stFId.FId_Fan1ActrOff DINH_stFId.FId_Fan1Mon DINH_stFId.FId_Fan1Off DINH_stFId.FId_Fan1PwrStg DINH_stFId.FId_FanCtlFan1Err DINH_stFId.FId_FanRlyDiagEnad DINH_stFId.FId_FanSpdEnhdSRCMax DINH_stFId.FId_FanSpdFrzVal DINH_stFId.FId_FanSpdPhysRng DINH_stFId.FId_FanSpdRplVal DINH_stFId.FId_FanSpdSSpMon DINH_stFId.FId_FanSpdTmpErrCnt DINH_stFId.FId_FansFacCor DINH_stFId.FId_FiMFID_rba_MRly_Diag_Stk DINH_stFId.FId_FiMFID_test DINH_stFId.FId_FreonPEnhdSRCMax DINH_stFId.FId_FreonPFrzVal DINH_stFId.FId_FreonPPhysRng DINH_stFId.FId_FreonPRplVal DINH_stFId.FId_FreonPSSpMon DINH_stFId.FId_FreonPTmpErrCnt DINH_stFId.FId_GlbDaLSumvXPtd DINH_stFId.FId_HLCCcs_CoornPLnCChipTHi DINH_stFId.FId_HLCCcs_CoornPLnCChpT DINH_stFId.FId_HeatrCoreTEnhdSRCMax DINH_stFId.FId_HeatrCoreTFrzVal DINH_stFId.FId_HeatrCoreTPhysRng DINH_stFId.FId_HeatrCoreTRplVal DINH_stFId.FId_HeatrCoreTSSpMon DINH_stFId.FId_HeatrCoreTTmpErrCnt DINH_stFId.FId_HvBattChrgLvl3DernFlt DINH_stFId.FId_HvBattDchaLvl3DernFlt DINH_stFId.FId_HvBattDesChrgIDern DINH_stFId.FId_HvBattMaiSwtDiagEna DINH_stFId.FId_HvBattMaxPwrBusTDern DINH_stFId.FId_HvBattNegCntctrCnt DINH_stFId.FId_HvBattPosCntctrCnt DINH_stFId.FId_HvBattPrecCntctrCnt DINH_stFId.FId_HvBattPwrDistbnTDern DINH_stFId.FId_HvBattPwrDistbnTInhbn DINH_stFId.FId_HvBattRatRSoh DINH_stFId.FId_HvBattRatSoh DINH_stFId.FId_HvGridAuxPwr01 DINH_stFId.FId_HvGridAuxPwr02 DINH_stFId.FId_HvGridAuxPwr03 DINH_stFId.FId_HvGridAuxPwr04 DINH_stFId.FId_HvGridDcdcPwr DINH_stFId.FId_HvGridDcdcUSftyErr DINH_stFId.FId_HvGridElM01USftyErr DINH_stFId.FId_HvGridHvBattSftyLimErr DINH_stFId.FId_HvGridMaiSwtErr DINH_stFId.FId_HvGridPwrMaxChrgContnsErr DINH_stFId.FId_HvGridPwrMaxChrgShoErr DINH_stFId.FId_HvGridPwrMaxDchaContnsErr DINH_stFId.FId_HvGridPwrMaxDchaShoErr DINH_stFId.FId_HvacHmiFlt DINH_stFId.FId_HvacModCoolgFlt DINH_stFId.FId_HvacModHeatgFlt DINH_stFId.FId_HvacPtcHeatrErr DINH_stFId.FId_IntlckChrgPlgActrOff DINH_stFId.FId_IntlckChrgPlgHbrdgNotTstd DINH_stFId.FId_IntlckChrgPlgMon DINH_stFId.FId_IntlckChrgPlgPosnAdcInvld DINH_stFId.FId_IntlckChrgPlgPwrStg DINH_stFId.FId_LvGridSocErr DINH_stFId.FId_LvGridTErr DINH_stFId.FId_LvGridTestPlsReq DINH_stFId.FId_LvGridUErr DINH_stFId.FId_MedTPmpFlt DINH_stFId.FId_MedTPmpPwrCtrlRly DINH_stFId.FId_MstWrnLmpBlink DINH_stFId.FId_MstWrnLmpChime DINH_stFId.FId_MstWrnLmpContIllmn DINH_stFId.FId_PEnvCc DINH_stFId.FId_PEnvEnaBndMdl DINH_stFId.FId_PEnvMeasVld DINH_stFId.FId_PEnvPlaus DINH_stFId.FId_PEnvPrc DINH_stFId.FId_PEnvRefSnsr DINH_stFId.FId_PEnvSigRngVld DINH_stFId.FId_PEnvSnsrPlaus DINH_stFId.FId_PerfLimnActvLmpBlink DINH_stFId.FId_PerfLimnActvLmpCont DINH_stFId.FId_PerfLimnActvLmpContNoChime DINH_stFId.FId_PwmCtPFrzVal DINH_stFId.FId_PwmCtPPhysRng DINH_stFId.FId_PwmCtPRplVal DINH_stFId.FId_PwmCtPSSpMon DINH_stFId.FId_PwmCtPTmpErrCnt DINH_stFId.FId_PwrDistbnUnitTEnhdSRCMax DINH_stFId.FId_PwrDistbnUnitTFrzVal DINH_stFId.FId_PwrDistbnUnitTPhysRng DINH_stFId.FId_PwrDistbnUnitTRplVal DINH_stFId.FId_PwrDistbnUnitTSSpMon DINH_stFId.FId_PwrDistbnUnitTTmpErrCnt DINH_stFId.FId_SCtPmp1ActrOff DINH_stFId.FId_SCtPmp1CircErr DINH_stFId.FId_SCtPmp1Mon DINH_stFId.FId_SCtPmp1Off DINH_stFId.FId_SCtPmp1PsErr DINH_stFId.FId_SCtPmp1PwrStg DINH_stFId.FId_SCtPmp1QlySensFrzn DINH_stFId.FId_SCtPmp1QlySensRplVal DINH_stFId.FId_SCtPmpRlyActrOff DINH_stFId.FId_SCtPmpRlyMon DINH_stFId.FId_SCtPmpRlyOff DINH_stFId.FId_SCtPmpRlyPwrStg DINH_stFId.FId_SVSWrnLmpBlnkIllmn DINH_stFId.FId_SVSWrnLmpContIllmn DINH_stFId.FId_SpplCooltPmpRlyActrOff DINH_stFId.FId_SpplCooltPmpRlyMon DINH_stFId.FId_SpplCooltPmpRlyOff DINH_stFId.FId_SpplCooltPmpRlyPwrStg DINH_stFId.FId_StrtUpEvDrvAwy DINH_stFId.FId_TelltlCooltTErr DINH_stFId.FId_TelltlCooltTMon DINH_stFId.FId_ThermHvacPreCdngFlt DINH_stFId.FId_ThermModCritErr DINH_stFId.FId_UCtPEnhdSRCMax DINH_stFId.FId_UCtPFrzVal DINH_stFId.FId_UCtPPhysRng DINH_stFId.FId_UCtPRplVal DINH_stFId.FId_UCtPSSpMon DINH_stFId.FId_UCtPTmpErrCnt DINH_stFId.FId_UPxP1EnhdSRCMax DINH_stFId.FId_UPxP1FrzVal DINH_stFId.FId_UPxP1PhysRng DINH_stFId.FId_UPxP1RplVal DINH_stFId.FId_UPxP1SSpMon DINH_stFId.FId_UPxP1TmpErrCnt DINH_stFId.FId_VMSIEvBrkFlt DINH_stFId.FId_VMSIEvDCSRampShOff01 DINH_stFId.FId_VMSIEvDCSShOff01 DINH_stFId.FId_VMSIEvTCSRampShOff01 DINH_stFId.FId_VMSIEvTCSShOff01 DINH_stFId.FId_VMSIEvTVRampShOff01 DINH_stFId.FId_VMSIEvTVShOff01 DINH_stFId.FId_VacPmpErr DINH_stFId.FId_VehCoornAuxAvrgEnvT DINH_stFId.FId_VehCoornAuxAvrgPwr DINH_stFId.FId_VehCoornAuxAvrgT DINH_stFId.FId_VehCoornAuxAvrgVehV DINH_stFId.FId_VehCoornDstRngPrdcDispDft DINH_stFId.FId_VehCoornEgyRmn DINH_stFId.FId_VehCoornErrExclChrg DINH_stFId.FId_VehCoornErrExclDrv DINH_stFId.FId_VehCoornHVErr DINH_stFId.FId_VehCoornHvReq DINH_stFId.FId_VehCoornImobTrqInhbn DINH_stFId.FId_VehCoornPrpAvrg DINH_stFId.FId_VehCoornRngPrdcAuxPwr DINH_stFId.FId_VehCoornSigQualVehV DINH_stFId.FId_VehVCANFrzVal DINH_stFId.FId_VehVCANReplVal DINH_stFId.FId_VehVCanSafeFrzVal DINH_stFId.FId_VehVCanSafeReplVal DINH_stFId.FId_VehVFrzVal DINH_stFId.FId_VehVNActPhy01Dfct DINH_stFId.FId_VehVReplVal DINH_stFId.FId_VehVSigCan DINH_stFId.FId_VehVSigCanSafe DINH_stFId.FId_WtrPmp1Err DINH_stFId.FId_bInhCanEif_HVBAT_NGTV_CONTACTOR_STS DINH_stFId.FId_bInhCanEif_HVBAT_PRECHRG_CONTACTOR_STS DINH_stFId.FId_bInhCanEif_HVBAT_PSTV_CONTACTOR_STS DINH_stFId.FId_bInhCanEif_VCU_eBCCM_432h DINH_stFId.FId_bInhCdtSpdVehImmo DINH_stFId.FId_bInhComGw_Com_BMS_REMAININGBATTCAPACITY DINH_stFId.FId_bInhComGw_Com_CONTACT_FREIN_PRK DINH_stFId.FId_bInhComGw_Com_DCDC_IP_POWER DINH_stFId.FId_bInhComGw_Com_HVBAT_ALERT_LOW_BATT_ENERGY DINH_stFId.FId_bInhComGw_Com_HVBAT_CHARGING_STATUS DINH_stFId.FId_bInhComGw_Com_HVBAT_SOC DINH_stFId.FId_bInhComGw_Com_HVBAT_TEMPERATURE DINH_stFId.FId_bInhComGw_Com_HVBAT_THERMAL_RUNAWAY DINH_stFId.FId_bInhComGw_Com_HV_BATT_CELL_VOLT_MAX DINH_stFId.FId_bInhComGw_Com_HV_BATT_CELL_VOLT_MIN DINH_stFId.FId_bInhComGw_Com_HV_BATT_INSULATION_RESISTANCE DINH_stFId.FId_bInhComGw_Com_HV_BATT_INSUL_FAILURE DINH_stFId.FId_bInhComGw_Com_HV_BATT_INTERLOCK_LINE DINH_stFId.FId_bInhComGw_Com_HV_BATT_MIN_VOLT_WARN DINH_stFId.FId_bInhComGw_Com_HV_BATT_NB_CELL_VOLT_MAX DINH_stFId.FId_bInhComGw_Com_HV_BATT_NB_CELL_VOLT_MIN DINH_stFId.FId_bInhComGw_Com_HV_BATT_SOC DINH_stFId.FId_bInhComGw_Com_HV_BATT_SOC_5C3 DINH_stFId.FId_bInhComGw_Com_HV_BATT_SOH_CAPA DINH_stFId.FId_bInhComGw_Com_HV_BATT_SOH_RES DINH_stFId.FId_bInhComGw_Com_HV_BATT_TEMP_AVG DINH_stFId.FId_bInhComGw_Com_INV_MTR_INST_INPUT_POWER DINH_stFId.FId_bInhComGw_Com_PEM_ENGINE_RPM DINH_stFId.FId_bInhComGw_Com_PEM_ESTIM_TRQ DINH_stFId.FId_bInhComGw_Com_PEM_INVERTER_TEMP DINH_stFId.FId_bInhComGw_Com_PEM_INVERTOR_ALERT_TEMP DINH_stFId.FId_bInhComGw_Com_PEM_OVERTEMP_FAILURE DINH_stFId.FId_bInhComGw_Com_PEM_STATOR_TEMP DINH_stFId.FId_bInhComGw_Com_VITESSE_VEHICULE_ROUES DINH_stFId.FId_bInhComGw_Com_VVH_INDISP DINH_stFId.FId_bInhComGw_Com_eCOMP_Power_consumption DINH_stFId.FId_bInhComGw_MAIN_RELAY_ACTUATION_COUNTER DINH_stFId.FId_bInhComGw_TIME_HV_BATT_OVER_TEMPERATURE DINH_stFId.FId_bInhComGw_TOTAL_HV_BATT_POS_QTY_CURR DINH_stFId.FId_bInhDiag_CLUSTER_5E7 DINH_stFId.FId_bInhDiag_CONTEXTE_1_5B2 DINH_stFId.FId_bInhDiag_DAT3_BSI_4F2h DINH_stFId.FId_bInhDiag_DCDC_283h DINH_stFId.FId_bInhDiag_DCDC_293h DINH_stFId.FId_bInhDiag_DCDC_473h DINH_stFId.FId_bInhDiag_DCDC_663h DINH_stFId.FId_bInhDiag_HS3_AUTO_GEARBOX_SWITCH_STATUS DINH_stFId.FId_bInhDiag_HVAC_PANEL_26h DINH_stFId.FId_bInhDiag_HVBAT_205h DINH_stFId.FId_bInhDiag_HVBAT_275h DINH_stFId.FId_bInhDiag_HVBAT_285h DINH_stFId.FId_bInhDiag_HVBAT_325h DINH_stFId.FId_bInhDiag_HVBAT_335h DINH_stFId.FId_bInhDiag_HVBAT_455h DINH_stFId.FId_bInhDiag_HVBAT_535 DINH_stFId.FId_bInhDiag_HVBAT_595h DINH_stFId.FId_bInhDiag_HVBAT_635h DINH_stFId.FId_bInhDiag_HVBAT_645h DINH_stFId.FId_bInhDiag_HVBAT_665h DINH_stFId.FId_bInhDiag_HVBAT_675h DINH_stFId.FId_bInhDiag_HVBAT_THERMAL_5B5 DINH_stFId.FId_bInhDiag_HVBAT_VCU_435h DINH_stFId.FId_bInhDiag_HVBAT_VCU_543 DINH_stFId.FId_bInhDiag_HVBAT_VCU_583 DINH_stFId.FId_bInhDiag_INV_217h DINH_stFId.FId_bInhDiag_INV_227h DINH_stFId.FId_bInhDiag_INV_237 DINH_stFId.FId_bInhDiag_INV_427h DINH_stFId.FId_bInhDiag_INV_497h DINH_stFId.FId_bInhDiag_INV_IMMO_5C7 DINH_stFId.FId_bInhDiag_IS_DAT6_BSI_592h DINH_stFId.FId_bInhDiag_IS_DAT_ABR_50Dh DINH_stFId.FId_bInhDiag_IS_DAT_BSI_412h DINH_stFId.FId_bInhDiag_IS_DYN_ABR_38Dh DINH_stFId.FId_bInhDiag_IS_INTE_ELECTRON_BSI_092h DINH_stFId.FId_bInhDiag_OBC_273h DINH_stFId.FId_bInhDiag_OBC_453h DINH_stFId.FId_bInhDiag_OBC_463h DINH_stFId.FId_bInhDiag_PDU_BusVoltages_308 DINH_stFId.FId_bInhDiag_PDU_Current_318 DINH_stFId.FId_bInhDiag_SC_INFO_BCCM_442h DINH_stFId.FId_bInhDiag_VCU_AIRBAG_351h DINH_stFId.FId_bInhDiag_VCU_eBCCM_432h DINH_stFId.FId_bInhDiag_VCU_eBCCM_552h DINH_stFId.FId_bInhDiag_eBCCM_082h DINH_stFId.FId_bInhDiag_eCOMP_Information_47B DINH_stFId.FId_bInhDiag_eCOMP_Information_48B DINH_stFId.FId_bInhFrbd_ComChrgr_iAcMax DINH_stFId.FId_bInhFrbd_ComChrgr_iDcHvAct DINH_stFId.FId_bInhFrbd_ComChrgr_pwrInAct DINH_stFId.FId_bInhFrbd_ComChrgr_pwrOutpCpby DINH_stFId.FId_bInhFrbd_ComChrgr_tChrgrMaxAct DINH_stFId.FId_bInhFrbd_ComChrgr_uAcActL1 DINH_stFId.FId_bInhFrbd_ComChrgr_uDcHvAct DINH_stFId.FId_bInhFrbd_ComEmac_iDcLnk01 DINH_stFId.FId_bInhFrbd_ComEmac_nAct01 DINH_stFId.FId_bInhFrbd_ComEmac_pwrInstnsInpRx DINH_stFId.FId_bInhFrbd_ComEmac_stActvDcha DINH_stFId.FId_bInhFrbd_ComEmac_stEVLmp DINH_stFId.FId_bInhFrbd_ComEmac_stIvtrOpMod01 DINH_stFId.FId_bInhFrbd_ComEmac_stMod01Rx DINH_stFId.FId_bInhFrbd_ComEmac_stMstWrnLmp DINH_stFId.FId_bInhFrbd_ComEmac_stSVSLmp DINH_stFId.FId_bInhFrbd_ComEmac_tqAbsltMax01 DINH_stFId.FId_bInhFrbd_ComEmac_tqAbsltMaxRx01 DINH_stFId.FId_bInhFrbd_ComEmac_tqAbsltMin01 DINH_stFId.FId_bInhFrbd_ComEmac_tqAbsltMinRx01 DINH_stFId.FId_bInhFrbd_ComEmac_tqAckd01 DINH_stFId.FId_bInhFrbd_ComEmac_tqAct01 DINH_stFId.FId_bInhFrbd_ComEmac_tqPtd01 DINH_stFId.FId_bInhFrbd_ComEmac_tqStabnMin DINH_stFId.FId_bInhFrbd_ComEmac_uDcLnk01 DINH_stFId.FId_bInhFrbd_Com_HvbMaxSnsrTempRx DINH_stFId.FId_bInhFrbd_Com_ctHvbNegCntctrSeg1 DINH_stFId.FId_bInhFrbd_Com_ctHvbNegCntctrSeg3 DINH_stFId.FId_bInhFrbd_Com_ctHvbNegCntctrSeg4 DINH_stFId.FId_bInhFrbd_Com_ctHvbPosCntctrSeg1 DINH_stFId.FId_bInhFrbd_Com_ctHvbPosCntctrSeg3 DINH_stFId.FId_bInhFrbd_Com_ctHvbPosCntctrSeg4 DINH_stFId.FId_bInhFrbd_Com_ctHvbPrecCntctrSeg1 DINH_stFId.FId_bInhFrbd_Com_ctHvbPrecCntctrSeg2 DINH_stFId.FId_bInhFrbd_Com_egyHvbAvl_fRx DINH_stFId.FId_bInhFrbd_Com_flgEcoNormReqRx DINH_stFId.FId_bInhFrbd_Com_iBattEBS1Rx DINH_stFId.FId_bInhFrbd_Com_iBattEBS2Rx DINH_stFId.FId_bInhFrbd_Com_iBattEBS3Rx DINH_stFId.FId_bInhFrbd_Com_iDcdcHvActRvsn1 DINH_stFId.FId_bInhFrbd_Com_iDcdcLvActRvsn1 DINH_stFId.FId_bInhFrbd_Com_iElCmprHvAct DINH_stFId.FId_bInhFrbd_Com_iElCmprPeakPha DINH_stFId.FId_bInhFrbd_Com_iHvbActRx DINH_stFId.FId_bInhFrbd_Com_iHvbChrgMaxSho DINH_stFId.FId_bInhFrbd_Com_iHvbDchaMaxSho DINH_stFId.FId_bInhFrbd_Com_iHvbDes DINH_stFId.FId_bInhFrbd_Com_iHvbNomChrgn DINH_stFId.FId_bInhFrbd_Com_nElCmprActl DINH_stFId.FId_bInhFrbd_Com_nrSerMaxCell DINH_stFId.FId_bInhFrbd_Com_nrSerMinCell DINH_stFId.FId_bInhFrbd_Com_pwrDcdcOutpCpby DINH_stFId.FId_bInhFrbd_Com_pwrElCmprActl DINH_stFId.FId_bInhFrbd_Com_pwrMaxChrgSho DINH_stFId.FId_bInhFrbd_Com_pwrMaxDchaSho DINH_stFId.FId_bInhFrbd_Com_qHvbTotCpRx DINH_stFId.FId_bInhFrbd_Com_rHvbIsoMeasmt DINH_stFId.FId_bInhFrbd_Com_ratHvbSoc DINH_stFId.FId_bInhFrbd_Com_ratHvbSoh DINH_stFId.FId_bInhFrbd_Com_ratRHvbSoh DINH_stFId.FId_bInhFrbd_Com_ratSocLvBatt DINH_stFId.FId_bInhFrbd_Com_stElCmprFltLvl DINH_stFId.FId_bInhFrbd_Com_stGearLvrPos DINH_stFId.FId_bInhFrbd_Com_stIIvtrFltLvl01 DINH_stFId.FId_bInhFrbd_Com_steTogFailrLvl DINH_stFId.FId_bInhFrbd_Com_tDcdcAct DINH_stFId.FId_bInhFrbd_Com_tDcdcInltCoolt DINH_stFId.FId_bInhFrbd_Com_tElCmprActl DINH_stFId.FId_bInhFrbd_Com_tEnvT DINH_stFId.FId_bInhFrbd_Com_tHvbAct DINH_stFId.FId_bInhFrbd_Com_tHvbMax DINH_stFId.FId_bInhFrbd_Com_tLvBatt DINH_stFId.FId_bInhFrbd_Com_tiHvbChrgnHalfRx DINH_stFId.FId_bInhFrbd_Com_uBattEBSRx DINH_stFId.FId_bInhFrbd_Com_uDcdcHvAct DINH_stFId.FId_bInhFrbd_Com_uDcdcLvAct DINH_stFId.FId_bInhFrbd_Com_uElCmprHvAct DINH_stFId.FId_bInhFrbd_Com_uHvbAct DINH_stFId.FId_bInhFrbd_Com_uHvbDcBus DINH_stFId.FId_bInhFrbd_Com_uHvbLimHi DINH_stFId.FId_bInhFrbd_Com_uHvbMaxCell DINH_stFId.FId_bInhFrbd_Com_uHvbMinCell DINH_stFId.FId_bInhFrbd_Com_uHvbNomChrgn DINH_stFId.FId_bInhInvld_ComChrgr_flgChrgrErrLvl DINH_stFId.FId_bInhInvld_ComChrgr_iAcMax DINH_stFId.FId_bInhInvld_ComChrgr_iDcHvAct DINH_stFId.FId_bInhInvld_ComChrgr_pwrInAct DINH_stFId.FId_bInhInvld_ComChrgr_pwrOutpCpby DINH_stFId.FId_bInhInvld_ComChrgr_tChrgrMaxAct DINH_stFId.FId_bInhInvld_ComChrgr_uAcActL1 DINH_stFId.FId_bInhInvld_ComChrgr_uDcHvAct DINH_stFId.FId_bInhInvld_ComEmac_iDcLnk01 DINH_stFId.FId_bInhInvld_ComEmac_nAct01 DINH_stFId.FId_bInhInvld_ComEmac_pwrInstnsInpRx DINH_stFId.FId_bInhInvld_ComEmac_stActvDcha DINH_stFId.FId_bInhInvld_ComEmac_stIvtrOpMod01 DINH_stFId.FId_bInhInvld_ComEmac_tInvr01 DINH_stFId.FId_bInhInvld_ComEmac_tIvtrCooltIn01 DINH_stFId.FId_bInhInvld_ComEmac_tMac01 DINH_stFId.FId_bInhInvld_ComEmac_tqAbsltMax01 DINH_stFId.FId_bInhInvld_ComEmac_tqAbsltMaxRx01 DINH_stFId.FId_bInhInvld_ComEmac_tqAbsltMin01 DINH_stFId.FId_bInhInvld_ComEmac_tqAbsltMinRx01 DINH_stFId.FId_bInhInvld_ComEmac_tqAckd01 DINH_stFId.FId_bInhInvld_ComEmac_tqAct01 DINH_stFId.FId_bInhInvld_ComEmac_tqPtd01 DINH_stFId.FId_bInhInvld_ComEmac_tqStabnMin DINH_stFId.FId_bInhInvld_ComEmac_uDcLnk01 DINH_stFId.FId_bInhInvld_Com_HvbMaxSnsrTempRx DINH_stFId.FId_bInhInvld_Com_ctHvbNegCntctrSeg1 DINH_stFId.FId_bInhInvld_Com_ctHvbNegCntctrSeg3 DINH_stFId.FId_bInhInvld_Com_ctHvbNegCntctrSeg4 DINH_stFId.FId_bInhInvld_Com_ctHvbPosCntctrSeg1 DINH_stFId.FId_bInhInvld_Com_ctHvbPosCntctrSeg3 DINH_stFId.FId_bInhInvld_Com_ctHvbPosCntctrSeg4 DINH_stFId.FId_bInhInvld_Com_ctHvbPrecCntctrSeg1 DINH_stFId.FId_bInhInvld_Com_ctHvbPrecCntctrSeg2 DINH_stFId.FId_bInhInvld_Com_egyHvbAvl_fRx DINH_stFId.FId_bInhInvld_Com_flgEcoNormReqRx DINH_stFId.FId_bInhInvld_Com_flgVehSpdAvl DINH_stFId.FId_bInhInvld_Com_iBattEBS1Rx DINH_stFId.FId_bInhInvld_Com_iBattEBS2Rx DINH_stFId.FId_bInhInvld_Com_iBattEBS3Rx DINH_stFId.FId_bInhInvld_Com_iDcdcHvActRvsn1 DINH_stFId.FId_bInhInvld_Com_iDcdcLvActRvsn1 DINH_stFId.FId_bInhInvld_Com_iElCmprHvAct DINH_stFId.FId_bInhInvld_Com_iElCmprPeakPha DINH_stFId.FId_bInhInvld_Com_iHvbActRx DINH_stFId.FId_bInhInvld_Com_iHvbChrgMaxSho DINH_stFId.FId_bInhInvld_Com_iHvbDchaMaxSho DINH_stFId.FId_bInhInvld_Com_iHvbDes DINH_stFId.FId_bInhInvld_Com_iHvbNomChrgn DINH_stFId.FId_bInhInvld_Com_lDstGlbDa DINH_stFId.FId_bInhInvld_Com_lTotOdometer DINH_stFId.FId_bInhInvld_Com_nElCmprActl DINH_stFId.FId_bInhInvld_Com_nrSerMaxCell DINH_stFId.FId_bInhInvld_Com_nrSerMinCell DINH_stFId.FId_bInhInvld_Com_pwrDcdcOutpCpby DINH_stFId.FId_bInhInvld_Com_pwrElCmprActl DINH_stFId.FId_bInhInvld_Com_pwrMaxChrgSho DINH_stFId.FId_bInhInvld_Com_pwrMaxDchaSho DINH_stFId.FId_bInhInvld_Com_qHvbTotCpRx DINH_stFId.FId_bInhInvld_Com_rHvbIsoMeasmt DINH_stFId.FId_bInhInvld_Com_ratHvbSoc DINH_stFId.FId_bInhInvld_Com_ratHvbSoh DINH_stFId.FId_bInhInvld_Com_ratRHvbSoh DINH_stFId.FId_bInhInvld_Com_ratSocLvBatt DINH_stFId.FId_bInhInvld_Com_stAC DINH_stFId.FId_bInhInvld_Com_stAlrtThermRunAwy DINH_stFId.FId_bInhInvld_Com_stBlowrRly DINH_stFId.FId_bInhInvld_Com_stDcdcFltLvl DINH_stFId.FId_bInhInvld_Com_stEvapTFlt DINH_stFId.FId_bInhInvld_Com_stGearLvrPos DINH_stFId.FId_bInhInvld_Com_stHvacBlwrFront DINH_stFId.FId_bInhInvld_Com_stHvacKnobPosn DINH_stFId.FId_bInhInvld_Com_stHvacPanPotiFlt DINH_stFId.FId_bInhInvld_Com_stHvbChrgn DINH_stFId.FId_bInhInvld_Com_stHvbDiscnctReas DINH_stFId.FId_bInhInvld_Com_stHvbIntlckRx DINH_stFId.FId_bInhInvld_Com_stHvbIsoFltRx DINH_stFId.FId_bInhInvld_Com_stHvbSrvPlgRx DINH_stFId.FId_bInhInvld_Com_stIBattEBS DINH_stFId.FId_bInhInvld_Com_stIIvtrFltLvl01 DINH_stFId.FId_bInhInvld_Com_stMainWkuReq DINH_stFId.FId_bInhInvld_Com_stReFogReq DINH_stFId.FId_bInhInvld_Com_stSocRx DINH_stFId.FId_bInhInvld_Com_stT DINH_stFId.FId_bInhInvld_Com_tDcdcAct DINH_stFId.FId_bInhInvld_Com_tDcdcInltCoolt DINH_stFId.FId_bInhInvld_Com_tElCmprActl DINH_stFId.FId_bInhInvld_Com_tEnvT DINH_stFId.FId_bInhInvld_Com_tEvapT DINH_stFId.FId_bInhInvld_Com_tHvbAct DINH_stFId.FId_bInhInvld_Com_tHvbMax DINH_stFId.FId_bInhInvld_Com_tLvBatt DINH_stFId.FId_bInhInvld_Com_tiCurVehTmr DINH_stFId.FId_bInhInvld_Com_tiHvbChrgnHalfRx DINH_stFId.FId_bInhInvld_Com_uBattEBSRx DINH_stFId.FId_bInhInvld_Com_uDcdcHvAct DINH_stFId.FId_bInhInvld_Com_uDcdcLvAct DINH_stFId.FId_bInhInvld_Com_uElCmprHvAct DINH_stFId.FId_bInhInvld_Com_uHvbAct DINH_stFId.FId_bInhInvld_Com_uHvbDcBus DINH_stFId.FId_bInhInvld_Com_uHvbLimHi DINH_stFId.FId_bInhInvld_Com_uHvbMaxCell DINH_stFId.FId_bInhInvld_Com_uHvbMinCell DINH_stFId.FId_bInhInvld_Com_uHvbNomChrgn DINH_stFId.FId_bInhInvld_Com_vVeh DINH_stFId.FId_bInh_ACCmpr_pwrLimMax DINH_stFId.FId_bInh_ACCtl_flgCmprEna DINH_stFId.FId_bInh_ACCtl_nCmprSpdReq DINH_stFId.FId_bInh_APP_rInp DINH_stFId.FId_bInh_BattId_numOrganNature1 DINH_stFId.FId_bInh_BattId_numOrganNature2 DINH_stFId.FId_bInh_BattId_numOrganRef1 DINH_stFId.FId_bInh_BattId_numOrganRef2 DINH_stFId.FId_bInh_BattId_numOrganRef3 DINH_stFId.FId_bInh_BattId_numOrganRef4 DINH_stFId.FId_bInh_BattId_numSerl1 DINH_stFId.FId_bInh_BattId_numSerl2 DINH_stFId.FId_bInh_BattId_numSerl3 DINH_stFId.FId_bInh_BattId_numSerl4 DINH_stFId.FId_bInh_BattId_numSerl5 DINH_stFId.FId_bInh_BattId_numSerl6 DINH_stFId.FId_bInh_BattId_numSerl7 DINH_stFId.FId_bInh_Brk_stRed DINH_stFId.FId_bInh_CbnHeatgHeatr_cntrRlyLf DINH_stFId.FId_bInh_ChgrPlug_stPlgLockTx DINH_stFId.FId_bInh_ChrgCntct_nrNegCntctElpdOper DINH_stFId.FId_bInh_ChrgCntct_nrPosCntctElpdOper DINH_stFId.FId_bInh_ChrgrRly_stRlyDes DINH_stFId.FId_bInh_ChrgrVal_iChrgrDes DINH_stFId.FId_bInh_ChrgrVal_iGridLimMax DINH_stFId.FId_bInh_ChrgrVal_uHvMax DINH_stFId.FId_bInh_CoDrvPITh_stEPSModeReq DINH_stFId.FId_bInh_CoPtFH_stPwt DINH_stFId.FId_bInh_ComChrg_stMod DINH_stFId.FId_bInh_ComChrgn_iDcRly_Sq_Frz DINH_stFId.FId_bInh_ComChrgn_uDcRly_Sq_Frz DINH_stFId.FId_bInh_ComChrgr_flgChrgrErr_Sq_Frz DINH_stFId.FId_bInh_ComChrgr_iAcMax_Sq_Frz DINH_stFId.FId_bInh_ComChrgr_iDcHvAct_Sq_Frz DINH_stFId.FId_bInh_ComChrgr_pwrInAct_Sq_Frz DINH_stFId.FId_bInh_ComChrgr_stChrgnEna DINH_stFId.FId_bInh_ComChrgr_stChrgr_Sq_Frz DINH_stFId.FId_bInh_ComChrgr_tChrgrMaxAct_Sq_Frz DINH_stFId.FId_bInh_ComChrgr_uAcActL1_Sq_Frz DINH_stFId.FId_bInh_ComChrgr_uDcHvAct_Sq_Frz DINH_stFId.FId_bInh_ComEmac_flgSvsReq01_Sq_Frz DINH_stFId.FId_bInh_ComEmac_tIvtrCoolt01_Sq_Frz DINH_stFId.FId_bInh_Com_25h_B1b0 DINH_stFId.FId_bInh_Com_25h_B1b2 DINH_stFId.FId_bInh_Com_25h_B1b4 DINH_stFId.FId_bInh_Com_25h_B1b6 DINH_stFId.FId_bInh_Com_HvbMaxSnsrTempTx DINH_stFId.FId_bInh_Com_TogLedDrv DINH_stFId.FId_bInh_Com_TogLedMod DINH_stFId.FId_bInh_Com_TogLedNeut DINH_stFId.FId_bInh_Com_TogLedRvs DINH_stFId.FId_bInh_Com_bAcLedReq DINH_stFId.FId_bInh_Com_bDiagMuxCAN DINH_stFId.FId_bInh_Com_bGunCntInfoWkuReq DINH_stFId.FId_bInh_Com_bHvBattRchrgWkuReq DINH_stFId.FId_bInh_Com_bPostOperationWkuReq DINH_stFId.FId_bInh_Com_bReFogRlySt DINH_stFId.FId_bInh_Com_flgBlowrAuthn DINH_stFId.FId_bInh_Com_flgBlowrRlyCtrl DINH_stFId.FId_bInh_Com_flgBrkAlrt DINH_stFId.FId_bInh_Com_flgDrvAwy DINH_stFId.FId_bInh_Com_flgVehSpdQly DINH_stFId.FId_bInh_Com_iDcdcHvActRvsn1_Sq_Frz DINH_stFId.FId_bInh_Com_iDcdcLvActRvsn1_Sq_Frz DINH_stFId.FId_bInh_Com_iElCmprHvAct_Sq_Frz DINH_stFId.FId_bInh_Com_iHvbActTx DINH_stFId.FId_bInh_Com_nElCmprActlTx DINH_stFId.FId_bInh_Com_nIvtrMotAct01 DINH_stFId.FId_bInh_Com_noEditCal DINH_stFId.FId_bInh_Com_noEditSw DINH_stFId.FId_bInh_Com_noVerSysDay DINH_stFId.FId_bInh_Com_noVersAdp DINH_stFId.FId_bInh_Com_noVersSw DINH_stFId.FId_bInh_Com_noVersSys DINH_stFId.FId_bInh_Com_noVersSysMnth DINH_stFId.FId_bInh_Com_noVersSysYr DINH_stFId.FId_bInh_Com_ratHvbSoh_Sq_Frz DINH_stFId.FId_bInh_Com_stACTx DINH_stFId.FId_bInh_Com_stBrk DINH_stFId.FId_bInh_Com_stBrkBstPFlt DINH_stFId.FId_bInh_Com_stBrkCntctIndcn DINH_stFId.FId_bInh_Com_stChrgPlg DINH_stFId.FId_bInh_Com_stChrgPlgChrgn DINH_stFId.FId_bInh_Com_stClstrStopIndcn DINH_stFId.FId_bInh_Com_stCmdHvBattCntctr DINH_stFId.FId_bInh_Com_stCmdOffsEM01 DINH_stFId.FId_bInh_Com_stDcdcOperModAct_Sq_Frz DINH_stFId.FId_bInh_Com_stDrvAwyDi DINH_stFId.FId_bInh_Com_stDrvModPosn DINH_stFId.FId_bInh_Com_stEVLmp DINH_stFId.FId_bInh_Com_stElCmprStatTx DINH_stFId.FId_bInh_Com_stElMDesEem DINH_stFId.FId_bInh_Com_stHvBattOperModDes DINH_stFId.FId_bInh_Com_stHvacBlwrFront_CAN DINH_stFId.FId_bInh_Com_stHvacKnobPosn_CAN DINH_stFId.FId_bInh_Com_stMstWrnLmp DINH_stFId.FId_bInh_Com_stNwCmdLIN DINH_stFId.FId_bInh_Com_stPwrLimnLmp DINH_stFId.FId_bInh_Com_stReFogReq_CAN DINH_stFId.FId_bInh_Com_stSrvLmp DINH_stFId.FId_bInh_Com_stVehCoorn DINH_stFId.FId_bInh_Com_tDcdcAct_Sq_Frz DINH_stFId.FId_bInh_Com_tDcdcInltCoolt_Sq DINH_stFId.FId_bInh_Com_tqMotLimMax DINH_stFId.FId_bInh_Com_uDcdcHvAct_Sq_Frz DINH_stFId.FId_bInh_Com_uDcdcLvAct_Sq_Frz DINH_stFId.FId_bInh_Com_uHvbActTx DINH_stFId.FId_bInh_Com_valEepOffsEM01 DINH_stFId.FId_bInh_DcChrgnRly_ctMaxOperCyc DINH_stFId.FId_bInh_Dcdc_flgDesLvGridULim DINH_stFId.FId_bInh_Dcdc_iLimLvGrid DINH_stFId.FId_bInh_Dcdc_stDesDcdc DINH_stFId.FId_bInh_Dcdc_uDesLvGrid DINH_stFId.FId_bInh_DrvInfo_wTotTripEgy DINH_stFId.FId_bInh_EChrDv_cntPlin DINH_stFId.FId_bInh_Eem_flgFstHvShdwn DINH_stFId.FId_bInh_ElM_stDesEem01 DINH_stFId.FId_bInh_ElTS_egyTotChrgCyc DINH_stFId.FId_bInh_ElTS_ratEmPowChrgn DINH_stFId.FId_bInh_ElTS_ratEmPowDcha DINH_stFId.FId_bInh_ElTS_stChrgCyc DINH_stFId.FId_bInh_Emac_stIsoMonSwtReq DINH_stFId.FId_bInh_Emac_tqDesCom01 DINH_stFId.FId_bInh_Ext_bSyncGPC DINH_stFId.FId_bInh_HvBatt_flgIsoMeasmtDiReq DINH_stFId.FId_bInh_HvBatt_ratSoc DINH_stFId.FId_bInh_HvGrid_pwrMaxDcdc DINH_stFId.FId_bInh_HvacPtc_stElHeatr DINH_stFId.FId_bInh_Pdu_CLUSTER_5E7_Frz DINH_stFId.FId_bInh_Pdu_CLUSTER_5E7_Rcf DINH_stFId.FId_bInh_Pdu_CONTEXTE_1_5B2_Frz DINH_stFId.FId_bInh_Pdu_CONTEXTE_1_5B2_Rcf DINH_stFId.FId_bInh_Pdu_Com_pwrMaxChrgSho_Sq_Frz DINH_stFId.FId_bInh_Pdu_Com_pwrMaxDchaSho_Sq_Frz DINH_stFId.FId_bInh_Pdu_DAT3_BSI_4F2h_Frz DINH_stFId.FId_bInh_Pdu_DAT3_BSI_4F2h_Rcf DINH_stFId.FId_bInh_Pdu_DCDC_283h_Frz DINH_stFId.FId_bInh_Pdu_DCDC_283h_Rcf DINH_stFId.FId_bInh_Pdu_DCDC_293h_Frz DINH_stFId.FId_bInh_Pdu_DCDC_293h_Rcf DINH_stFId.FId_bInh_Pdu_DCDC_473h_Frz DINH_stFId.FId_bInh_Pdu_DCDC_473h_Rcf DINH_stFId.FId_bInh_Pdu_DCDC_663h_Frz DINH_stFId.FId_bInh_Pdu_DCDC_663h_Rcf DINH_stFId.FId_bInh_Pdu_HS3_AUTO_GEARBOX_SWITCH_STATUS_Frz DINH_stFId.FId_bInh_Pdu_HS3_AUTO_GEARBOX_SWITCH_STATUS_Rcf DINH_stFId.FId_bInh_Pdu_HVAC_PANEL_26h_Frz DINH_stFId.FId_bInh_Pdu_HVAC_PANEL_26h_Rcf DINH_stFId.FId_bInh_Pdu_HVBAT_205h_Frz DINH_stFId.FId_bInh_Pdu_HVBAT_205h_Rcf DINH_stFId.FId_bInh_Pdu_HVBAT_275h_Frz DINH_stFId.FId_bInh_Pdu_HVBAT_275h_Rcf DINH_stFId.FId_bInh_Pdu_HVBAT_285h_Frz DINH_stFId.FId_bInh_Pdu_HVBAT_285h_Rcf DINH_stFId.FId_bInh_Pdu_HVBAT_325h_Frz DINH_stFId.FId_bInh_Pdu_HVBAT_325h_Rcf DINH_stFId.FId_bInh_Pdu_HVBAT_335h_Frz DINH_stFId.FId_bInh_Pdu_HVBAT_335h_Rcf DINH_stFId.FId_bInh_Pdu_HVBAT_455h_Frz DINH_stFId.FId_bInh_Pdu_HVBAT_455h_Rcf DINH_stFId.FId_bInh_Pdu_HVBAT_535_Frz DINH_stFId.FId_bInh_Pdu_HVBAT_535_Rcf DINH_stFId.FId_bInh_Pdu_HVBAT_595h_Frz DINH_stFId.FId_bInh_Pdu_HVBAT_595h_Rcf DINH_stFId.FId_bInh_Pdu_HVBAT_635h_Frz DINH_stFId.FId_bInh_Pdu_HVBAT_635h_Rcf DINH_stFId.FId_bInh_Pdu_HVBAT_645h_Frz DINH_stFId.FId_bInh_Pdu_HVBAT_645h_Rcf DINH_stFId.FId_bInh_Pdu_HVBAT_665h_Frz DINH_stFId.FId_bInh_Pdu_HVBAT_665h_Rcf DINH_stFId.FId_bInh_Pdu_HVBAT_675h_Frz DINH_stFId.FId_bInh_Pdu_HVBAT_675h_Rcf DINH_stFId.FId_bInh_Pdu_HVBAT_THERMAL_5B5_Frz DINH_stFId.FId_bInh_Pdu_HVBAT_THERMAL_5B5_Rcf DINH_stFId.FId_bInh_Pdu_HVBAT_VCU_435h_Frz DINH_stFId.FId_bInh_Pdu_HVBAT_VCU_435h_Rcf DINH_stFId.FId_bInh_Pdu_HVBAT_VCU_543_Frz DINH_stFId.FId_bInh_Pdu_HVBAT_VCU_543_Rcf DINH_stFId.FId_bInh_Pdu_HVBAT_VCU_583_Frz DINH_stFId.FId_bInh_Pdu_HVBAT_VCU_583_Rcf DINH_stFId.FId_bInh_Pdu_INV_217h_Frz DINH_stFId.FId_bInh_Pdu_INV_217h_Rcf DINH_stFId.FId_bInh_Pdu_INV_227h_Frz DINH_stFId.FId_bInh_Pdu_INV_227h_Rcf DINH_stFId.FId_bInh_Pdu_INV_237_Frz DINH_stFId.FId_bInh_Pdu_INV_237_Rcf DINH_stFId.FId_bInh_Pdu_INV_427h_Frz DINH_stFId.FId_bInh_Pdu_INV_427h_Rcf DINH_stFId.FId_bInh_Pdu_INV_497h_Frz DINH_stFId.FId_bInh_Pdu_INV_497h_Rcf DINH_stFId.FId_bInh_Pdu_INV_IMMO_5C7_Frz DINH_stFId.FId_bInh_Pdu_INV_IMMO_5C7_Rcf DINH_stFId.FId_bInh_Pdu_IS_DAT6_BSI_592h_Frz DINH_stFId.FId_bInh_Pdu_IS_DAT6_BSI_592h_Rcf DINH_stFId.FId_bInh_Pdu_IS_DAT_ABR_50Dh_Frz DINH_stFId.FId_bInh_Pdu_IS_DAT_ABR_50Dh_Rcf DINH_stFId.FId_bInh_Pdu_IS_DAT_BSI_412h_Frz DINH_stFId.FId_bInh_Pdu_IS_DAT_BSI_412h_Rcf DINH_stFId.FId_bInh_Pdu_IS_DYN_ABR_38Dh_Frz DINH_stFId.FId_bInh_Pdu_IS_DYN_ABR_38Dh_Rcf DINH_stFId.FId_bInh_Pdu_IS_INTE_ELECTRON_BSI_092h_Frz DINH_stFId.FId_bInh_Pdu_IS_INTE_ELECTRON_BSI_092h_Rcf DINH_stFId.FId_bInh_Pdu_OBC_273h_Frz DINH_stFId.FId_bInh_Pdu_OBC_273h_Rcf DINH_stFId.FId_bInh_Pdu_OBC_453h_Frz DINH_stFId.FId_bInh_Pdu_OBC_453h_Rcf DINH_stFId.FId_bInh_Pdu_OBC_463h_Frz DINH_stFId.FId_bInh_Pdu_OBC_463h_Rcf DINH_stFId.FId_bInh_Pdu_PDU_BusVoltages_308_Frz DINH_stFId.FId_bInh_Pdu_PDU_BusVoltages_308_Rcf DINH_stFId.FId_bInh_Pdu_PDU_Current_318_Frz DINH_stFId.FId_bInh_Pdu_PDU_Current_318_Rcf DINH_stFId.FId_bInh_Pdu_SC_INFO_BCCM_442h_Frz DINH_stFId.FId_bInh_Pdu_SC_INFO_BCCM_442h_Rcf DINH_stFId.FId_bInh_Pdu_VCU_AIRBAG_351h_Frz DINH_stFId.FId_bInh_Pdu_VCU_AIRBAG_351h_Rcf DINH_stFId.FId_bInh_Pdu_VCU_AIRBAG_fault_Frz DINH_stFId.FId_bInh_Pdu_VCU_eBCCM_432h_Frz DINH_stFId.FId_bInh_Pdu_VCU_eBCCM_432h_Rcf DINH_stFId.FId_bInh_Pdu_VCU_eBCCM_552h_Frz DINH_stFId.FId_bInh_Pdu_VCU_eBCCM_552h_Rcf DINH_stFId.FId_bInh_Pdu_eBCCM_082h_Frz DINH_stFId.FId_bInh_Pdu_eBCCM_082h_Rcf DINH_stFId.FId_bInh_Pdu_eCOMP_Information_47B_Frz DINH_stFId.FId_bInh_Pdu_eCOMP_Information_47B_Rcf DINH_stFId.FId_bInh_Pdu_eCOMP_Information_48B_Frz DINH_stFId.FId_bInh_Pdu_eCOMP_Information_48B_Rcf DINH_stFId.FId_bInh_Sig205h_Com_iHvbActRx_Frz DINH_stFId.FId_bInh_Sig205h_Com_iHvbActRx_Rcf DINH_stFId.FId_bInh_Sig205h_Com_ratHvbSoc_Frz DINH_stFId.FId_bInh_Sig205h_Com_ratHvbSoc_Rcf DINH_stFId.FId_bInh_Sig205h_Com_stHvbChrgn_Frz DINH_stFId.FId_bInh_Sig205h_Com_stHvbChrgn_Rcf DINH_stFId.FId_bInh_Sig205h_Com_uHvbAct_Frz DINH_stFId.FId_bInh_Sig205h_Com_uHvbAct_Rcf DINH_stFId.FId_bInh_Sig217h_ComEmac_nAct01_Frz DINH_stFId.FId_bInh_Sig217h_ComEmac_nAct01_Rcf DINH_stFId.FId_bInh_Sig217h_ComEmac_tqAckd01_Frz DINH_stFId.FId_bInh_Sig217h_ComEmac_tqAckd01_Rcf DINH_stFId.FId_bInh_Sig217h_ComEmac_tqAct01_Frz DINH_stFId.FId_bInh_Sig217h_ComEmac_tqAct01_Rcf DINH_stFId.FId_bInh_Sig217h_ComEmac_uDcLnk01_Frz DINH_stFId.FId_bInh_Sig217h_ComEmac_uDcLnk01_Rcf DINH_stFId.FId_bInh_Sig227h_ComEmac_iDcLnk01_Frz DINH_stFId.FId_bInh_Sig227h_ComEmac_iDcLnk01_Rcf DINH_stFId.FId_bInh_Sig227h_ComEmac_pwrInstnsInpRx_Frz DINH_stFId.FId_bInh_Sig227h_ComEmac_pwrInstnsInpRx_Rcf DINH_stFId.FId_bInh_Sig227h_ComEmac_tqAbsltMax01_Frz DINH_stFId.FId_bInh_Sig227h_ComEmac_tqAbsltMax01_Rcf DINH_stFId.FId_bInh_Sig227h_ComEmac_tqAbsltMaxRx01_Frz DINH_stFId.FId_bInh_Sig227h_ComEmac_tqAbsltMaxRx01_Rcf DINH_stFId.FId_bInh_Sig227h_ComEmac_tqAbsltMin01_Frz DINH_stFId.FId_bInh_Sig227h_ComEmac_tqAbsltMin01_Rcf DINH_stFId.FId_bInh_Sig227h_ComEmac_tqAbsltMinRx01_Frz DINH_stFId.FId_bInh_Sig227h_ComEmac_tqAbsltMinRx01_Rcf DINH_stFId.FId_bInh_Sig237h_ComEmac_stActvDcha_Frz DINH_stFId.FId_bInh_Sig237h_ComEmac_stActvDcha_Rcf DINH_stFId.FId_bInh_Sig237h_ComEmac_stEVLmp_Frz DINH_stFId.FId_bInh_Sig237h_ComEmac_stEVLmp_Rcf DINH_stFId.FId_bInh_Sig237h_ComEmac_stMod01Rx_Frz DINH_stFId.FId_bInh_Sig237h_ComEmac_stMod01Rx_Rcf DINH_stFId.FId_bInh_Sig237h_ComEmac_stMstWrnLmp_Frz DINH_stFId.FId_bInh_Sig237h_ComEmac_stMstWrnLmp_Rcf DINH_stFId.FId_bInh_Sig237h_ComEmac_stSVSLmp_Frz DINH_stFId.FId_bInh_Sig237h_ComEmac_stSVSLmp_Rcf DINH_stFId.FId_bInh_Sig237h_ComEmac_tqStabnMin_Frz DINH_stFId.FId_bInh_Sig237h_ComEmac_tqStabnMin_Rcf DINH_stFId.FId_bInh_Sig237h_Com_stIIvtrFltLvl01_Frz DINH_stFId.FId_bInh_Sig237h_Com_stIIvtrFltLvl01_Rcf DINH_stFId.FId_bInh_Sig259hFlt DINH_stFId.FId_bInh_Sig259h_Com_flgEcoNormReqRx_Frz DINH_stFId.FId_bInh_Sig259h_Com_flgEcoNormReqRx_Rcf DINH_stFId.FId_bInh_Sig259h_Com_stGearLvrPos_Frz DINH_stFId.FId_bInh_Sig259h_Com_stGearLvrPos_Rcf DINH_stFId.FId_bInh_Sig259h_Com_steTogFailrLvl_Frz DINH_stFId.FId_bInh_Sig259h_Com_steTogFailrLvl_Rcf DINH_stFId.FId_bInh_Sig26h_Com_stAC_Frz DINH_stFId.FId_bInh_Sig26h_Com_stAC_Rcf DINH_stFId.FId_bInh_Sig26h_Com_stEvapTFlt_Frz DINH_stFId.FId_bInh_Sig26h_Com_stEvapTFlt_Rcf DINH_stFId.FId_bInh_Sig26h_Com_stHvacBlwrFront_Frz DINH_stFId.FId_bInh_Sig26h_Com_stHvacBlwrFront_Rcf DINH_stFId.FId_bInh_Sig26h_Com_stHvacKnobPosn_Frz DINH_stFId.FId_bInh_Sig26h_Com_stHvacKnobPosn_Rcf DINH_stFId.FId_bInh_Sig26h_Com_stHvacPanPotiFlt_Frz DINH_stFId.FId_bInh_Sig26h_Com_stHvacPanPotiFlt_Rcf DINH_stFId.FId_bInh_Sig26h_Com_stReFogReq_Frz DINH_stFId.FId_bInh_Sig26h_Com_stReFogReq_Rcf DINH_stFId.FId_bInh_Sig26h_Com_tEvapT_Frz DINH_stFId.FId_bInh_Sig26h_Com_tEvapT_Rcf DINH_stFId.FId_bInh_Sig273h_ComChrgr_flgChrgrErrLvl_Frz DINH_stFId.FId_bInh_Sig273h_ComChrgr_flgChrgrErrLvl_Rcf DINH_stFId.FId_bInh_Sig273h_ComChrgr_pwrOutpCpby_Frz DINH_stFId.FId_bInh_Sig273h_ComChrgr_pwrOutpCpby_Rcf DINH_stFId.FId_bInh_Sig275h_Com_iHvbDchaMaxSho_Frz DINH_stFId.FId_bInh_Sig275h_Com_iHvbDchaMaxSho_Rcf DINH_stFId.FId_bInh_Sig275h_Com_pwrMaxDchaSho_Frz DINH_stFId.FId_bInh_Sig275h_Com_pwrMaxDchaSho_Rcf DINH_stFId.FId_bInh_Sig283h_Com_iDcdcHvActRvsn1_Frz DINH_stFId.FId_bInh_Sig283h_Com_iDcdcHvActRvsn1_Rcf DINH_stFId.FId_bInh_Sig283h_Com_iDcdcLvActRvsn1_Frz DINH_stFId.FId_bInh_Sig283h_Com_iDcdcLvActRvsn1_Rcf DINH_stFId.FId_bInh_Sig283h_Com_uDcdcHvAct_Frz DINH_stFId.FId_bInh_Sig283h_Com_uDcdcHvAct_Rcf DINH_stFId.FId_bInh_Sig283h_Com_uDcdcLvAct_Frz DINH_stFId.FId_bInh_Sig283h_Com_uDcdcLvAct_Rcf DINH_stFId.FId_bInh_Sig285h_Com_iHvbChrgMaxSho_Frz DINH_stFId.FId_bInh_Sig285h_Com_iHvbChrgMaxSho_Rcf DINH_stFId.FId_bInh_Sig285h_Com_pwrMaxChrgSho_Frz DINH_stFId.FId_bInh_Sig285h_Com_pwrMaxChrgSho_Rcf DINH_stFId.FId_bInh_Sig293h_Com_pwrDcdcOutpCpby_Frz DINH_stFId.FId_bInh_Sig293h_Com_pwrDcdcOutpCpby_Rcf DINH_stFId.FId_bInh_Sig293h_Com_stDcdcFltLvl_Frz DINH_stFId.FId_bInh_Sig293h_Com_stDcdcFltLvl_Rcf DINH_stFId.FId_bInh_Sig325h_Com_rHvbIsoMeasmt_Frz DINH_stFId.FId_bInh_Sig325h_Com_rHvbIsoMeasmt_Rcf DINH_stFId.FId_bInh_Sig325h_Com_stHvbIntlckRx_Frz DINH_stFId.FId_bInh_Sig325h_Com_stHvbIntlckRx_Rcf DINH_stFId.FId_bInh_Sig325h_Com_stHvbIsoFltRx_Frz DINH_stFId.FId_bInh_Sig325h_Com_stHvbIsoFltRx_Rcf DINH_stFId.FId_bInh_Sig325h_Com_stHvbSrvPlgRx_Frz DINH_stFId.FId_bInh_Sig325h_Com_stHvbSrvPlgRx_Rcf DINH_stFId.FId_bInh_Sig325h_Com_tHvbMax_Frz DINH_stFId.FId_bInh_Sig325h_Com_tHvbMax_Rcf DINH_stFId.FId_bInh_Sig335h_Com_iHvbDes_Frz DINH_stFId.FId_bInh_Sig335h_Com_iHvbDes_Rcf DINH_stFId.FId_bInh_Sig335h_Com_iHvbNomChrgn_Frz DINH_stFId.FId_bInh_Sig335h_Com_iHvbNomChrgn_Rcf DINH_stFId.FId_bInh_Sig335h_Com_uHvbDcBus_Frz DINH_stFId.FId_bInh_Sig335h_Com_uHvbDcBus_Rcf DINH_stFId.FId_bInh_Sig335h_Com_uHvbLimHi_Frz DINH_stFId.FId_bInh_Sig335h_Com_uHvbLimHi_Rcf DINH_stFId.FId_bInh_Sig38Dh_Com_flgVehSpdAvl_Frz DINH_stFId.FId_bInh_Sig38Dh_Com_flgVehSpdAvl_Rcf DINH_stFId.FId_bInh_Sig38Dh_Com_vVeh_Frz DINH_stFId.FId_bInh_Sig38Dh_Com_vVeh_Rcf DINH_stFId.FId_bInh_Sig427h_ComEmac_stIvtrOpMod01_Frz DINH_stFId.FId_bInh_Sig427h_ComEmac_stIvtrOpMod01_Rcf DINH_stFId.FId_bInh_Sig427h_ComEmac_tInvr01_Frz DINH_stFId.FId_bInh_Sig427h_ComEmac_tInvr01_Rcf DINH_stFId.FId_bInh_Sig427h_ComEmac_tIvtrCooltIn01_Frz DINH_stFId.FId_bInh_Sig427h_ComEmac_tIvtrCooltIn01_Rcf DINH_stFId.FId_bInh_Sig427h_ComEmac_tMac01_Frz DINH_stFId.FId_bInh_Sig427h_ComEmac_tMac01_Rcf DINH_stFId.FId_bInh_Sig427h_ComEmac_tqPtd01_Frz DINH_stFId.FId_bInh_Sig427h_ComEmac_tqPtd01_Rcf DINH_stFId.FId_bInh_Sig432h_Com_stMainWkuReq_Frz DINH_stFId.FId_bInh_Sig432h_Com_stMainWkuReq_Rcf DINH_stFId.FId_bInh_Sig435h_Com_HvbMaxSnsrTempRx_Frz DINH_stFId.FId_bInh_Sig435h_Com_HvbMaxSnsrTempRx_Rcf DINH_stFId.FId_bInh_Sig435h_Com_nrSerMaxCell_Frz DINH_stFId.FId_bInh_Sig435h_Com_nrSerMaxCell_Rcf DINH_stFId.FId_bInh_Sig435h_Com_nrSerMinCell_Frz DINH_stFId.FId_bInh_Sig435h_Com_nrSerMinCell_Rcf DINH_stFId.FId_bInh_Sig435h_Com_uHvbMaxCell_Frz DINH_stFId.FId_bInh_Sig435h_Com_uHvbMaxCell_Rcf DINH_stFId.FId_bInh_Sig435h_Com_uHvbMinCell_Frz DINH_stFId.FId_bInh_Sig435h_Com_uHvbMinCell_Rcf DINH_stFId.FId_bInh_Sig442h_Com_stBlowrRly_Frz DINH_stFId.FId_bInh_Sig442h_Com_stBlowrRly_Rcf DINH_stFId.FId_bInh_Sig453h_ComChrgr_iAcMax_Frz DINH_stFId.FId_bInh_Sig453h_ComChrgr_iAcMax_Rcf DINH_stFId.FId_bInh_Sig453h_ComChrgr_pwrInAct_Frz DINH_stFId.FId_bInh_Sig453h_ComChrgr_pwrInAct_Rcf DINH_stFId.FId_bInh_Sig453h_ComChrgr_uAcActL1_Frz DINH_stFId.FId_bInh_Sig453h_ComChrgr_uAcActL1_Rcf DINH_stFId.FId_bInh_Sig455h_Com_uHvbNomChrgn_Frz DINH_stFId.FId_bInh_Sig455h_Com_uHvbNomChrgn_Rcf DINH_stFId.FId_bInh_Sig463h_ComChrgr_iDcHvAct_Frz DINH_stFId.FId_bInh_Sig463h_ComChrgr_iDcHvAct_Rcf DINH_stFId.FId_bInh_Sig463h_ComChrgr_tChrgrMaxAct_Frz DINH_stFId.FId_bInh_Sig463h_ComChrgr_tChrgrMaxAct_Rcf DINH_stFId.FId_bInh_Sig463h_ComChrgr_uDcHvAct_Frz DINH_stFId.FId_bInh_Sig463h_ComChrgr_uDcHvAct_Rcf DINH_stFId.FId_bInh_Sig473h_Com_tDcdcAct_Frz DINH_stFId.FId_bInh_Sig473h_Com_tDcdcAct_Rcf DINH_stFId.FId_bInh_Sig473h_Com_tDcdcInltCoolt_Frz DINH_stFId.FId_bInh_Sig473h_Com_tDcdcInltCoolt_Rcf DINH_stFId.FId_bInh_Sig47Bh_Com_iElCmprHvAct_Frz DINH_stFId.FId_bInh_Sig47Bh_Com_iElCmprHvAct_Rcf DINH_stFId.FId_bInh_Sig47Bh_Com_iElCmprPeakPha_Frz DINH_stFId.FId_bInh_Sig47Bh_Com_iElCmprPeakPha_Rcf DINH_stFId.FId_bInh_Sig47Bh_Com_nElCmprActl_Frz DINH_stFId.FId_bInh_Sig47Bh_Com_nElCmprActl_Rcf DINH_stFId.FId_bInh_Sig47Bh_Com_pwrElCmprActl_Frz DINH_stFId.FId_bInh_Sig47Bh_Com_pwrElCmprActl_Rcf DINH_stFId.FId_bInh_Sig47Bh_Com_tElCmprActl_Frz DINH_stFId.FId_bInh_Sig47Bh_Com_tElCmprActl_Rcf DINH_stFId.FId_bInh_Sig47Bh_Com_uElCmprHvAct_Frz DINH_stFId.FId_bInh_Sig47Bh_Com_uElCmprHvAct_Rcf DINH_stFId.FId_bInh_Sig48Bh_Com_stElCmprFltLvl_Frz DINH_stFId.FId_bInh_Sig48Bh_Com_stElCmprFltLvl_Rcf DINH_stFId.FId_bInh_Sig4F2h_Com_ratSocLvBatt_Frz DINH_stFId.FId_bInh_Sig4F2h_Com_ratSocLvBatt_Rcf DINH_stFId.FId_bInh_Sig4F2h_Com_stSocRx_Frz DINH_stFId.FId_bInh_Sig4F2h_Com_stSocRx_Rcf DINH_stFId.FId_bInh_Sig4F2h_Com_stT_Frz DINH_stFId.FId_bInh_Sig4F2h_Com_stT_Rcf DINH_stFId.FId_bInh_Sig535h_Com_tHvbAct_Frz DINH_stFId.FId_bInh_Sig535h_Com_tHvbAct_Rcf DINH_stFId.FId_bInh_Sig543h_Com_egyHvbAvl_fRx_Frz DINH_stFId.FId_bInh_Sig543h_Com_egyHvbAvl_fRx_Rcf DINH_stFId.FId_bInh_Sig543h_Com_ratHvbSoh_Frz DINH_stFId.FId_bInh_Sig543h_Com_ratHvbSoh_Rcf DINH_stFId.FId_bInh_Sig543h_Com_ratRHvbSoh_Frz DINH_stFId.FId_bInh_Sig543h_Com_ratRHvbSoh_Rcf DINH_stFId.FId_bInh_Sig552h_Com_lDstGlbDa_Frz DINH_stFId.FId_bInh_Sig552h_Com_lDstGlbDa_Rcf DINH_stFId.FId_bInh_Sig552h_Com_lTotOdometer_Frz DINH_stFId.FId_bInh_Sig552h_Com_lTotOdometer_Rcf DINH_stFId.FId_bInh_Sig552h_Com_tiCurVehTmr_Frz DINH_stFId.FId_bInh_Sig552h_Com_tiCurVehTmr_Rcf DINH_stFId.FId_bInh_Sig583h_Com_stHvbDiscnctReas_Frz DINH_stFId.FId_bInh_Sig583h_Com_stHvbDiscnctReas_Rcf DINH_stFId.FId_bInh_Sig592h_Com_iBattEBS1Rx_Frz DINH_stFId.FId_bInh_Sig592h_Com_iBattEBS1Rx_Rcf DINH_stFId.FId_bInh_Sig592h_Com_iBattEBS2Rx_Frz DINH_stFId.FId_bInh_Sig592h_Com_iBattEBS2Rx_Rcf DINH_stFId.FId_bInh_Sig592h_Com_iBattEBS3Rx_Frz DINH_stFId.FId_bInh_Sig592h_Com_iBattEBS3Rx_Rcf DINH_stFId.FId_bInh_Sig592h_Com_stIBattEBS_Frz DINH_stFId.FId_bInh_Sig592h_Com_stIBattEBS_Rcf DINH_stFId.FId_bInh_Sig592h_Com_tLvBatt_Frz DINH_stFId.FId_bInh_Sig592h_Com_tLvBatt_Rcf DINH_stFId.FId_bInh_Sig592h_Com_uBattEBSRx_Frz DINH_stFId.FId_bInh_Sig592h_Com_uBattEBSRx_Rcf DINH_stFId.FId_bInh_Sig595h_Com_tiHvbChrgnHalfRx_Frz DINH_stFId.FId_bInh_Sig595h_Com_tiHvbChrgnHalfRx_Rcf DINH_stFId.FId_bInh_Sig5B2h_Com_tEnvT_Frz DINH_stFId.FId_bInh_Sig5B2h_Com_tEnvT_Rcf DINH_stFId.FId_bInh_Sig5B5h_Com_stAlrtThermRunAwy_Frz DINH_stFId.FId_bInh_Sig5B5h_Com_stAlrtThermRunAwy_Rcf DINH_stFId.FId_bInh_Sig635h_Com_ctHvbNegCntctrSeg1_Frz DINH_stFId.FId_bInh_Sig635h_Com_ctHvbNegCntctrSeg1_Rcf DINH_stFId.FId_bInh_Sig635h_Com_ctHvbNegCntctrSeg3_Frz DINH_stFId.FId_bInh_Sig635h_Com_ctHvbNegCntctrSeg3_Rcf DINH_stFId.FId_bInh_Sig635h_Com_ctHvbNegCntctrSeg4_Frz DINH_stFId.FId_bInh_Sig635h_Com_ctHvbNegCntctrSeg4_Rcf DINH_stFId.FId_bInh_Sig635h_Com_ctHvbPosCntctrSeg1_Frz DINH_stFId.FId_bInh_Sig635h_Com_ctHvbPosCntctrSeg1_Rcf DINH_stFId.FId_bInh_Sig635h_Com_ctHvbPosCntctrSeg3_Frz DINH_stFId.FId_bInh_Sig635h_Com_ctHvbPosCntctrSeg3_Rcf DINH_stFId.FId_bInh_Sig635h_Com_ctHvbPosCntctrSeg4_Frz DINH_stFId.FId_bInh_Sig635h_Com_ctHvbPosCntctrSeg4_Rcf DINH_stFId.FId_bInh_Sig645h_Com_ctHvbPrecCntctrSeg1_Frz DINH_stFId.FId_bInh_Sig645h_Com_ctHvbPrecCntctrSeg1_Rcf DINH_stFId.FId_bInh_Sig645h_Com_ctHvbPrecCntctrSeg2_Frz DINH_stFId.FId_bInh_Sig645h_Com_ctHvbPrecCntctrSeg2_Rcf DINH_stFId.FId_bInh_Sig675h_Com_qHvbTotCpRx_Frz DINH_stFId.FId_bInh_Sig675h_Com_qHvbTotCpRx_Rcf DINH_stFId.FId_bInh_Sig_ComEmac_flgImobAuthent_Sq_Frz DINH_stFId.FId_bInh_Sig_ComEmac_stIsoMonSwtAck_Sq_Frz DINH_stFId.FId_bInh_Sig_ComEmac_stPwrAuthn_Sq_Frz DINH_stFId.FId_bInh_Sig_Com_flgEcoNormReq_Frz DINH_stFId.FId_bInh_Sig_Com_pwrMaxChrgSho_Sq_Frz DINH_stFId.FId_bInh_Sig_Com_pwrMaxDchaSho_Sq_Frz DINH_stFId.FId_bInh_Sig_Com_stDcdcULimReq_Sq_Frz DINH_stFId.FId_bInh_Sig_Com_stGearLvrPos_Frz DINH_stFId.FId_bInh_Sig_Com_stIgnkeyPos_Sq_Frz DINH_stFId.FId_bInh_ThermHvac_stRemPrecndn DINH_stFId.FId_bInh_VehCoorn_dstRngPrdcDispTx DINH_stFId.FId_bInh_VehCoorn_wCnsTotWghtAvrgEffTripA DINH_stFId.FId_bInh_VehCoorn_wCnsTotWghtAvrgEffTripB DINH_stFId.FId_bInh_VehCoorn_wCnsTotWghtAvrgEffTx DINH_stFId.FId_bInh_VehCoorn_wCnsTotWghtTripAvrgEffTx DINH_stFId.FId_bInh_VehCoorn_wCnsWghtAvrgEffTripA DINH_stFId.FId_bInh_VehCoorn_wCnsWghtAvrgEffTripB DINH_stFId.FId_binnh_Sig_ComEmac_flgEmgyShtDwnReq01_Sq_Frz DINH_stFId.FId_binnh_Sig_ComEmac_flgImobAuthent_Sq_Frz DINH_stFId.FId_binnh_Sig_ComEmac_iDcLnk01_Sq_Frz DINH_stFId.FId_binnh_Sig_ComEmac_nAct01_Sq_Frz DINH_stFId.FId_binnh_Sig_ComEmac_stActvDcha_Sq_Frz DINH_stFId.FId_binnh_Sig_ComEmac_stIsoMonSwtAck_Sq_Frz DINH_stFId.FId_binnh_Sig_ComEmac_stMod01_Sq_Frz DINH_stFId.FId_binnh_Sig_ComEmac_stPwrAuthn_Sq_Frz DINH_stFId.FId_binnh_Sig_ComEmac_tInvr01_Sq_Frz DINH_stFId.FId_binnh_Sig_ComEmac_tMac01_Sq_Frz DINH_stFId.FId_binnh_Sig_ComEmac_tqAbsltMax01_Sq_Frz DINH_stFId.FId_binnh_Sig_ComEmac_tqAbsltMin01_Sq_Frz DINH_stFId.FId_binnh_Sig_ComEmac_tqAct01_Sq_Frz DINH_stFId.FId_binnh_Sig_ComEmac_uDcLnk01_sq_Frz DINH_stFId.FId_binnh_Sig_Com_egyHvbAvl_Sq_Frz DINH_stFId.FId_binnh_Sig_Com_iHvbAct_Sq_Frz DINH_stFId.FId_binnh_Sig_Com_iHvbChrgMaxSho_Sq_Frz DINH_stFId.FId_binnh_Sig_Com_iHvbDchaMaxSho_Sq_Frz DINH_stFId.FId_binnh_Sig_Com_iHvbDes_Sq_Frz DINH_stFId.FId_binnh_Sig_Com_pwrDcdcOutpCpby_Sq_Frz DINH_stFId.FId_binnh_Sig_Com_rHvbIsoMeasmt_Sq_Frz DINH_stFId.FId_binnh_Sig_Com_ratHvbSoc_Sq_Frz DINH_stFId.FId_binnh_Sig_Com_stDcdcULimReq_Sq_Frz DINH_stFId.FId_binnh_Sig_Com_stHvbCntct_Sq_Frz DINH_stFId.FId_binnh_Sig_Com_stHvbDernMaxT_Sq_Frz DINH_stFId.FId_binnh_Sig_Com_stHvbDernMinT_Sq_Frz DINH_stFId.FId_binnh_Sig_Com_stHvbFlt_Sq_Frz DINH_stFId.FId_binnh_Sig_Com_stHvbIntlck_Sq_Frz DINH_stFId.FId_binnh_Sig_Com_stHvbIsoFlt_Sq_Frz DINH_stFId.FId_binnh_Sig_Com_stHvbMod_Sq_Frz DINH_stFId.FId_binnh_Sig_Com_stHvbSrvPlg_Sq_Frz DINH_stFId.FId_binnh_Sig_Com_tHvbAct_Sq_Frz DINH_stFId.FId_binnh_Sig_Com_uElCmprHvAct_Sq_Frz DINH_stFId.FId_binnh_Sig_Com_uHvbAct_Sq_Frz DINH_stFId.FId_binnh_Sig_Com_uHvbDcBus_Sq_Frz DINH_stFId.FId_binnh_Sig_Com_uHvbLimHi_Sq_Frz DINH_stFId.FId_binnh_Sig_Com_uHvbNomChrgn_Sq_Frz /end IN_MEASUREMENT
 /begin LOC_MEASUREMENT DINH_DSQSrv7Vis DINH_FIdSrv7Vis DINH_nrActvInhReas.FId_Fan1PsSwtOff DINH_nrActvInhReas.FId_InhibitAlways DINH_nrActvInhReas.FId_InhibitNever DINH_nrActvInhReas.FId_IntlckChrgPlgHbrgOLErr DINH_nrActvInhReas.FId_IntlckChrgPlgPsSwtOff DINH_nrActvInhReas.FId_IntlckChrgPlg_VehvErr DINH_nrActvInhReas.FId_SCtPmp1PsSwtOff DINH_nrActvInhReas.FId_SCtPmp1_VehvErr DINH_nrActvInhReas.FId_SCtPmpRlyPsSwtOff DINH_nrActvInhReas.FId_SpplCooltPmpRlyPsSwtOff DINH_stClctFId_mp DINH_stFId.FId_Unused DINH_stFId.FId_Fan1PsSwtOff DINH_stFId.FId_InhibitAlways DINH_stFId.FId_InhibitNever DINH_stFId.FId_IntlckChrgPlgHbrgOLErr DINH_stFId.FId_IntlckChrgPlgPsSwtOff DINH_stFId.FId_IntlckChrgPlg_VehvErr DINH_stFId.FId_SCtPmp1PsSwtOff DINH_stFId.FId_SCtPmp1_VehvErr DINH_stFId.FId_SCtPmpRlyPsSwtOff DINH_stFId.FId_SpplCooltPmpRlyPsSwtOff DINH_stMod7VisyCmpl DINH_xFIDObsvInh_mp DINH_xFIDObsvRls_mp DINH_xWhy.FId_Unused DINH_xWhy.FID_ElTSPwrChrgnOutErr DINH_xWhy.FID_ElTSPwrInActErr DINH_xWhy.FId_ACCmprFltPDiagEnad DINH_xWhy.FId_ACCmprInpErr DINH_xWhy.FId_ACpAC DINH_xWhy.FId_APP1SigPath DINH_xWhy.FId_APP2SigPath DINH_xWhy.FId_APPBrkErr DINH_xWhy.FId_APPVehVErr DINH_xWhy.FId_AcChrgrIntkTEnhdSRCMax DINH_xWhy.FId_AcChrgrIntkTFrzVal DINH_xWhy.FId_AcChrgrIntkTPhysRng DINH_xWhy.FId_AcChrgrIntkTRplVal DINH_xWhy.FId_AcChrgrIntkTSSpMon DINH_xWhy.FId_AcChrgrIntkTTmpErrCnt DINH_xWhy.FId_AcExtChrgrChrgn DINH_xWhy.FId_Airbg2MED DINH_xWhy.FId_AirbgAVSstCrash DINH_xWhy.FId_AirbgCan DINH_xWhy.FId_AirbgHw DINH_xWhy.FId_AirbgInpSigErr DINH_xWhy.FId_AirbgPWMErr DINH_xWhy.FId_AirbgPwmSrcErr DINH_xWhy.FId_BattUDiagEna DINH_xWhy.FId_BattUInvalid DINH_xWhy.FId_BattUReplcmt DINH_xWhy.FId_BattUVehVVld DINH_xWhy.FId_BlwrComErr DINH_xWhy.FId_BrkBstBrkSt DINH_xWhy.FId_BrkBstP DINH_xWhy.FId_BrkBstPEnaPrc DINH_xWhy.FId_BrkBstPFrzVal DINH_xWhy.FId_BrkBstPPlaus12FrznDfct DINH_xWhy.FId_BrkBstPPlaus12ReplcmtDfct DINH_xWhy.FId_BrkBstPReplVal DINH_xWhy.FId_BrkBstPSnsr1FrzDfct DINH_xWhy.FId_BrkBstPSnsr1ReplcmtDfct DINH_xWhy.FId_BrkBstPSnsr1SplyDfct DINH_xWhy.FId_BrkBstPSnsr2FrzDfct DINH_xWhy.FId_BrkBstPSnsr2ReplcmtDfct DINH_xWhy.FId_BrkBstPSnsr2SplyDfct DINH_xWhy.FId_BrkBstPmpActtnDiagEnad DINH_xWhy.FId_BrkBstPmpDeactvnDiagEnad DINH_xWhy.FId_BrkBstPmpLeakDiagEnad DINH_xWhy.FId_BrkBstPmpM1Err DINH_xWhy.FId_BrkBstPmpM2Err DINH_xWhy.FId_BrkBstPmpScgLsErr DINH_xWhy.FId_BrkBstPmpVacChkEna DINH_xWhy.FId_BrkBstTst DINH_xWhy.FId_BrkPlaus1Ena DINH_xWhy.FId_BrkPresAlrt DINH_xWhy.FId_BrkSigMaiCanFrzVal DINH_xWhy.FId_BrkSigMaiCanReplVal DINH_xWhy.FId_BrkStMnFinalDfct DINH_xWhy.FId_BrkStMnPrelDfct DINH_xWhy.FId_BrkStRdntFinalDfct DINH_xWhy.FId_BrkStRdntPrelDfct DINH_xWhy.FId_CanEifVehSpdVld DINH_xWhy.FId_CbnHeatgHeatrPsFlt DINH_xWhy.FId_CbnHeatgHeatrRlyDiagEnad DINH_xWhy.FId_CbnHeatgSwtFrzVal DINH_xWhy.FId_CbnHeatgSwtRplVal DINH_xWhy.FId_CbnHeatgSwtTmpErrCnt DINH_xWhy.FId_CcsDcStopChrgn DINH_xWhy.FId_CcsDcStopChrgnIDftl DINH_xWhy.FId_CcsPwrLineChpRstMonOff DINH_xWhy.FId_CcsPwrLineChpRstOff DINH_xWhy.FId_CcsPwrLineChpRstPsOff DINH_xWhy.FId_CcsPwrLineChpRstSnsr DINH_xWhy.FId_CcsPwrLineChpVccEnaMonOff DINH_xWhy.FId_CcsPwrLineChpVccEnaOff DINH_xWhy.FId_CcsPwrLineChpVccEnaPsOff DINH_xWhy.FId_CcsPwrLineChpVccEnaSnsr DINH_xWhy.FId_CcsPwrLineChpVccEnhdSRCMax DINH_xWhy.FId_CcsPwrLineChpVccFrzVal DINH_xWhy.FId_CcsPwrLineChpVccPhysRng DINH_xWhy.FId_CcsPwrLineChpVccRplVal DINH_xWhy.FId_CcsPwrLineChpVccSSpMon DINH_xWhy.FId_CcsPwrLineChpVccTmpErrCnt DINH_xWhy.FId_CcsPwrLineComChpTEnhdSRCMax DINH_xWhy.FId_CcsPwrLineComChpTFrzVal DINH_xWhy.FId_CcsPwrLineComChpTPhysRng DINH_xWhy.FId_CcsPwrLineComChpTRplVal DINH_xWhy.FId_CcsPwrLineComChpTSSpMon DINH_xWhy.FId_CcsPwrLineComChpTTmpErrCnt DINH_xWhy.FId_ChgrPlugCtpSwtSnsrActrErr DINH_xWhy.FId_ChgrPlugLockActrErr DINH_xWhy.FId_ChgrPlugLockSnsrErr DINH_xWhy.FId_ChgrPlugPxp1InhbDiagSrc DINH_xWhy.FId_ChgrPlugTPinDcErr DINH_xWhy.FId_ChrgPlgChrgrRlyWlddCcs DINH_xWhy.FId_ChrgPlugCtpDetnErr DINH_xWhy.FId_ChrgnCntctPsFlt DINH_xWhy.FId_ChrgnLmpChrgnFlt DINH_xWhy.FId_ChrgnLmpNoChrgn DINH_xWhy.FId_ChrgnUnplRqrd DINH_xWhy.FId_ChrgrRlyDcActNegErr DINH_xWhy.FId_ChrgrRlyDcActPosErr DINH_xWhy.FId_CmbdChrgnSysCntctErr DINH_xWhy.FId_CoElMDSQCanEMS01 DINH_xWhy.FId_CoElMErr01 DINH_xWhy.FId_CoPOMLimdPrpnHmi DINH_xWhy.FId_CoPOMMaxLimFltDetnPrim DINH_xWhy.FId_CoPOMMinLimFltDetnPrim DINH_xWhy.FId_CoPOMNoPrpnHmi DINH_xWhy.FId_CoPOMRecupPwrRednHmi DINH_xWhy.FId_CoPOMRgnInhbnPrim DINH_xWhy.FId_CoVMEvSysCptMaxErrPrim01 DINH_xWhy.FId_CoVMEvSysCptMaxErrPrim02 DINH_xWhy.FId_CoVMEvSysCptMaxErrPrim03 DINH_xWhy.FId_CoVMEvSysCptMaxErrPrim04 DINH_xWhy.FId_CoVMEvSysCptMaxErrPrim05 DINH_xWhy.FId_CoVMEvSysCptMinErrPrim01 DINH_xWhy.FId_CoVMEvSysCptMinErrPrim02 DINH_xWhy.FId_CoVMEvSysCptMinErrPrim03 DINH_xWhy.FId_CoVMEvVehVVld DINH_xWhy.FId_ComHillHldFrmErr DINH_xWhy.FId_Com_stMainWkuInvld DINH_xWhy.FId_CtPSwtActrMonOff DINH_xWhy.FId_CtPSwtActrOff DINH_xWhy.FId_CtPSwtActrPsOff DINH_xWhy.FId_CtPSwtActrSnsr DINH_xWhy.FId_CtPSwtDiagEnhdSRCMax DINH_xWhy.FId_CtPSwtDiagFrzVal DINH_xWhy.FId_CtPSwtDiagPhysRng DINH_xWhy.FId_CtPSwtDiagRplVal DINH_xWhy.FId_CtPSwtDiagSSpMon DINH_xWhy.FId_CtPSwtDiagTmpErrCnt DINH_xWhy.FId_CtpCarrFrqFrzVal DINH_xWhy.FId_CtpCarrFrqPhysRng DINH_xWhy.FId_CtpCarrFrqRplVal DINH_xWhy.FId_CtpCarrFrqSSpMon DINH_xWhy.FId_CtpCarrFrqTmpErrCnt DINH_xWhy.FId_DELibAcChrgrIntkT DINH_xWhy.FId_DELibDcChrgrIntkT DINH_xWhy.FId_DELibEnvP DINH_xWhy.FId_DELibEnvT DINH_xWhy.FId_DELibHeatrCoreT DINH_xWhy.FId_DSMAUXWucVrnt5 DINH_xWhy.FId_DcChrgnCtrlChrgPrmExch DINH_xWhy.FId_DcChrgrIntkT2EnhdSRCMax DINH_xWhy.FId_DcChrgrIntkT2FrzVal DINH_xWhy.FId_DcChrgrIntkT2PhysRng DINH_xWhy.FId_DcChrgrIntkT2RplVal DINH_xWhy.FId_DcChrgrIntkT2SSpMon DINH_xWhy.FId_DcChrgrIntkT2TmpErrCnt DINH_xWhy.FId_DcChrgrIntkTEnhdSRCMax DINH_xWhy.FId_DcChrgrIntkTFrzVal DINH_xWhy.FId_DcChrgrIntkTPhysRng DINH_xWhy.FId_DcChrgrIntkTRplVal DINH_xWhy.FId_DcChrgrIntkTSSpMon DINH_xWhy.FId_DcChrgrIntkTTmpErrCnt DINH_xWhy.FId_DcdcDesOperModFwd DINH_xWhy.FId_DcdcPwrLoadMngtMaxPred DINH_xWhy.FId_DcdcUDesLvGrid DINH_xWhy.FId_DcmDspUDSStPwrLatch DINH_xWhy.FId_DrvDoorCANSigFault DINH_xWhy.FId_DrvInfoEgyAvlErr DINH_xWhy.FId_DrvModPosnApp DINH_xWhy.FId_DrvPrgSwtEna DINH_xWhy.FId_DrvStbltCANSigFault DINH_xWhy.FId_EBDLmpSig DINH_xWhy.FId_EVLmpBlnkIllmn DINH_xWhy.FId_EVLmpContIllmn DINH_xWhy.FId_EbsLinErr DINH_xWhy.FId_EemDcdcPrecErr DINH_xWhy.FId_EemDcdcUHVAct DINH_xWhy.FId_EemFltHvDcha DINH_xWhy.FId_EemFstHvShdwn DINH_xWhy.FId_EemHvBattMod DINH_xWhy.FId_EemHvOffTout DINH_xWhy.FId_EemHvShdwn DINH_xWhy.FId_EemNoHvStrtup DINH_xWhy.FId_ElMNoPrp01 DINH_xWhy.FId_ElMnLim01 DINH_xWhy.FId_ElMtrqLim01 DINH_xWhy.FId_ElSSACCmprUFlt DINH_xWhy.FId_ElSSCabAirHtUFlt DINH_xWhy.FId_ElSSHvReqEna DINH_xWhy.FId_ElSSUHvDcBus DINH_xWhy.FId_ElTSHvIntlck DINH_xWhy.FId_EmWakeupSigMonOff DINH_xWhy.FId_EmWakeupSigOff DINH_xWhy.FId_EmWakeupSigPsOff DINH_xWhy.FId_EmWakeupSigSnsr DINH_xWhy.FId_EmacUDcLnk01 DINH_xWhy.FId_EvThermLTClgDmdErr DINH_xWhy.FId_EvThermMTClgDmdErr DINH_xWhy.FId_Fan1ActrOff DINH_xWhy.FId_Fan1Mon DINH_xWhy.FId_Fan1Off DINH_xWhy.FId_Fan1PsSwtOff DINH_xWhy.FId_Fan1PwrStg DINH_xWhy.FId_FanCtlFan1Err DINH_xWhy.FId_FanRlyDiagEnad DINH_xWhy.FId_FanSpdEnhdSRCMax DINH_xWhy.FId_FanSpdFrzVal DINH_xWhy.FId_FanSpdPhysRng DINH_xWhy.FId_FanSpdRplVal DINH_xWhy.FId_FanSpdSSpMon DINH_xWhy.FId_FanSpdTmpErrCnt DINH_xWhy.FId_FansFacCor DINH_xWhy.FId_FiMFID_rba_MRly_Diag_Stk DINH_xWhy.FId_FiMFID_test DINH_xWhy.FId_FreonPEnhdSRCMax DINH_xWhy.FId_FreonPFrzVal DINH_xWhy.FId_FreonPPhysRng DINH_xWhy.FId_FreonPRplVal DINH_xWhy.FId_FreonPSSpMon DINH_xWhy.FId_FreonPTmpErrCnt DINH_xWhy.FId_GlbDaLSumvXPtd DINH_xWhy.FId_HLCCcs_CoornPLnCChipTHi DINH_xWhy.FId_HLCCcs_CoornPLnCChpT DINH_xWhy.FId_HeatrCoreTEnhdSRCMax DINH_xWhy.FId_HeatrCoreTFrzVal DINH_xWhy.FId_HeatrCoreTPhysRng DINH_xWhy.FId_HeatrCoreTRplVal DINH_xWhy.FId_HeatrCoreTSSpMon DINH_xWhy.FId_HeatrCoreTTmpErrCnt DINH_xWhy.FId_HvBattChrgLvl3DernFlt DINH_xWhy.FId_HvBattDchaLvl3DernFlt DINH_xWhy.FId_HvBattDesChrgIDern DINH_xWhy.FId_HvBattMaiSwtDiagEna DINH_xWhy.FId_HvBattMaxPwrBusTDern DINH_xWhy.FId_HvBattNegCntctrCnt DINH_xWhy.FId_HvBattPosCntctrCnt DINH_xWhy.FId_HvBattPrecCntctrCnt DINH_xWhy.FId_HvBattPwrDistbnTDern DINH_xWhy.FId_HvBattPwrDistbnTInhbn DINH_xWhy.FId_HvBattRatRSoh DINH_xWhy.FId_HvBattRatSoh DINH_xWhy.FId_HvGridAuxPwr01 DINH_xWhy.FId_HvGridAuxPwr02 DINH_xWhy.FId_HvGridAuxPwr03 DINH_xWhy.FId_HvGridAuxPwr04 DINH_xWhy.FId_HvGridDcdcPwr DINH_xWhy.FId_HvGridDcdcUSftyErr DINH_xWhy.FId_HvGridElM01USftyErr DINH_xWhy.FId_HvGridHvBattSftyLimErr DINH_xWhy.FId_HvGridMaiSwtErr DINH_xWhy.FId_HvGridPwrMaxChrgContnsErr DINH_xWhy.FId_HvGridPwrMaxChrgShoErr DINH_xWhy.FId_HvGridPwrMaxDchaContnsErr DINH_xWhy.FId_HvGridPwrMaxDchaShoErr DINH_xWhy.FId_HvacHmiFlt DINH_xWhy.FId_HvacModCoolgFlt DINH_xWhy.FId_HvacModHeatgFlt DINH_xWhy.FId_HvacPtcHeatrErr DINH_xWhy.FId_InhibitAlways DINH_xWhy.FId_InhibitNever DINH_xWhy.FId_IntlckChrgPlgActrOff DINH_xWhy.FId_IntlckChrgPlgHbrdgNotTstd DINH_xWhy.FId_IntlckChrgPlgHbrgOLErr DINH_xWhy.FId_IntlckChrgPlgMon DINH_xWhy.FId_IntlckChrgPlgPosnAdcInvld DINH_xWhy.FId_IntlckChrgPlgPsSwtOff DINH_xWhy.FId_IntlckChrgPlgPwrStg DINH_xWhy.FId_IntlckChrgPlg_VehvErr DINH_xWhy.FId_LvGridSocErr DINH_xWhy.FId_LvGridTErr DINH_xWhy.FId_LvGridTestPlsReq DINH_xWhy.FId_LvGridUErr DINH_xWhy.FId_MedTPmpFlt DINH_xWhy.FId_MedTPmpPwrCtrlRly DINH_xWhy.FId_MstWrnLmpBlink DINH_xWhy.FId_MstWrnLmpChime DINH_xWhy.FId_MstWrnLmpContIllmn DINH_xWhy.FId_PEnvCc DINH_xWhy.FId_PEnvEnaBndMdl DINH_xWhy.FId_PEnvMeasVld DINH_xWhy.FId_PEnvPlaus DINH_xWhy.FId_PEnvPrc DINH_xWhy.FId_PEnvRefSnsr DINH_xWhy.FId_PEnvSigRngVld DINH_xWhy.FId_PEnvSnsrPlaus DINH_xWhy.FId_PerfLimnActvLmpBlink DINH_xWhy.FId_PerfLimnActvLmpCont DINH_xWhy.FId_PerfLimnActvLmpContNoChime DINH_xWhy.FId_PwmCtPFrzVal DINH_xWhy.FId_PwmCtPPhysRng DINH_xWhy.FId_PwmCtPRplVal DINH_xWhy.FId_PwmCtPSSpMon DINH_xWhy.FId_PwmCtPTmpErrCnt DINH_xWhy.FId_PwrDistbnUnitTEnhdSRCMax DINH_xWhy.FId_PwrDistbnUnitTFrzVal DINH_xWhy.FId_PwrDistbnUnitTPhysRng DINH_xWhy.FId_PwrDistbnUnitTRplVal DINH_xWhy.FId_PwrDistbnUnitTSSpMon DINH_xWhy.FId_PwrDistbnUnitTTmpErrCnt DINH_xWhy.FId_SCtPmp1ActrOff DINH_xWhy.FId_SCtPmp1CircErr DINH_xWhy.FId_SCtPmp1Mon DINH_xWhy.FId_SCtPmp1Off DINH_xWhy.FId_SCtPmp1PsErr DINH_xWhy.FId_SCtPmp1PsSwtOff DINH_xWhy.FId_SCtPmp1PwrStg DINH_xWhy.FId_SCtPmp1QlySensFrzn DINH_xWhy.FId_SCtPmp1QlySensRplVal DINH_xWhy.FId_SCtPmp1_VehvErr DINH_xWhy.FId_SCtPmpRlyActrOff DINH_xWhy.FId_SCtPmpRlyMon DINH_xWhy.FId_SCtPmpRlyOff DINH_xWhy.FId_SCtPmpRlyPsSwtOff DINH_xWhy.FId_SCtPmpRlyPwrStg DINH_xWhy.FId_SVSWrnLmpBlnkIllmn DINH_xWhy.FId_SVSWrnLmpContIllmn DINH_xWhy.FId_SpplCooltPmpRlyActrOff DINH_xWhy.FId_SpplCooltPmpRlyMon DINH_xWhy.FId_SpplCooltPmpRlyOff DINH_xWhy.FId_SpplCooltPmpRlyPsSwtOff DINH_xWhy.FId_SpplCooltPmpRlyPwrStg DINH_xWhy.FId_StrtUpEvDrvAwy DINH_xWhy.FId_TelltlCooltTErr DINH_xWhy.FId_TelltlCooltTMon DINH_xWhy.FId_ThermHvacPreCdngFlt DINH_xWhy.FId_ThermModCritErr DINH_xWhy.FId_UCtPEnhdSRCMax DINH_xWhy.FId_UCtPFrzVal DINH_xWhy.FId_UCtPPhysRng DINH_xWhy.FId_UCtPRplVal DINH_xWhy.FId_UCtPSSpMon DINH_xWhy.FId_UCtPTmpErrCnt DINH_xWhy.FId_UPxP1EnhdSRCMax DINH_xWhy.FId_UPxP1FrzVal DINH_xWhy.FId_UPxP1PhysRng DINH_xWhy.FId_UPxP1RplVal DINH_xWhy.FId_UPxP1SSpMon DINH_xWhy.FId_UPxP1TmpErrCnt DINH_xWhy.FId_VMSIEvBrkFlt DINH_xWhy.FId_VMSIEvDCSRampShOff01 DINH_xWhy.FId_VMSIEvDCSShOff01 DINH_xWhy.FId_VMSIEvTCSRampShOff01 DINH_xWhy.FId_VMSIEvTCSShOff01 DINH_xWhy.FId_VMSIEvTVRampShOff01 DINH_xWhy.FId_VMSIEvTVShOff01 DINH_xWhy.FId_VacPmpErr DINH_xWhy.FId_VehCoornAuxAvrgEnvT DINH_xWhy.FId_VehCoornAuxAvrgPwr DINH_xWhy.FId_VehCoornAuxAvrgT DINH_xWhy.FId_VehCoornAuxAvrgVehV DINH_xWhy.FId_VehCoornDstRngPrdcDispDft DINH_xWhy.FId_VehCoornEgyRmn DINH_xWhy.FId_VehCoornErrExclChrg DINH_xWhy.FId_VehCoornErrExclDrv DINH_xWhy.FId_VehCoornHVErr DINH_xWhy.FId_VehCoornHvReq DINH_xWhy.FId_VehCoornImobTrqInhbn DINH_xWhy.FId_VehCoornPrpAvrg DINH_xWhy.FId_VehCoornRngPrdcAuxPwr DINH_xWhy.FId_VehCoornSigQualVehV DINH_xWhy.FId_VehVCANFrzVal DINH_xWhy.FId_VehVCANReplVal DINH_xWhy.FId_VehVCanSafeFrzVal DINH_xWhy.FId_VehVCanSafeReplVal DINH_xWhy.FId_VehVFrzVal DINH_xWhy.FId_VehVNActPhy01Dfct DINH_xWhy.FId_VehVReplVal DINH_xWhy.FId_VehVSigCan DINH_xWhy.FId_VehVSigCanSafe DINH_xWhy.FId_WtrPmp1Err DINH_xWhy.FId_bInhCanEif_HVBAT_NGTV_CONTACTOR_STS DINH_xWhy.FId_bInhCanEif_HVBAT_PRECHRG_CONTACTOR_STS DINH_xWhy.FId_bInhCanEif_HVBAT_PSTV_CONTACTOR_STS DINH_xWhy.FId_bInhCanEif_VCU_eBCCM_432h DINH_xWhy.FId_bInhCdtSpdVehImmo DINH_xWhy.FId_bInhComGw_Com_BMS_REMAININGBATTCAPACITY DINH_xWhy.FId_bInhComGw_Com_CONTACT_FREIN_PRK DINH_xWhy.FId_bInhComGw_Com_DCDC_IP_POWER DINH_xWhy.FId_bInhComGw_Com_HVBAT_ALERT_LOW_BATT_ENERGY DINH_xWhy.FId_bInhComGw_Com_HVBAT_CHARGING_STATUS DINH_xWhy.FId_bInhComGw_Com_HVBAT_SOC DINH_xWhy.FId_bInhComGw_Com_HVBAT_TEMPERATURE DINH_xWhy.FId_bInhComGw_Com_HVBAT_THERMAL_RUNAWAY DINH_xWhy.FId_bInhComGw_Com_HV_BATT_CELL_VOLT_MAX DINH_xWhy.FId_bInhComGw_Com_HV_BATT_CELL_VOLT_MIN DINH_xWhy.FId_bInhComGw_Com_HV_BATT_INSULATION_RESISTANCE DINH_xWhy.FId_bInhComGw_Com_HV_BATT_INSUL_FAILURE DINH_xWhy.FId_bInhComGw_Com_HV_BATT_INTERLOCK_LINE DINH_xWhy.FId_bInhComGw_Com_HV_BATT_MIN_VOLT_WARN DINH_xWhy.FId_bInhComGw_Com_HV_BATT_NB_CELL_VOLT_MAX DINH_xWhy.FId_bInhComGw_Com_HV_BATT_NB_CELL_VOLT_MIN DINH_xWhy.FId_bInhComGw_Com_HV_BATT_SOC DINH_xWhy.FId_bInhComGw_Com_HV_BATT_SOC_5C3 DINH_xWhy.FId_bInhComGw_Com_HV_BATT_SOH_CAPA DINH_xWhy.FId_bInhComGw_Com_HV_BATT_SOH_RES DINH_xWhy.FId_bInhComGw_Com_HV_BATT_TEMP_AVG DINH_xWhy.FId_bInhComGw_Com_INV_MTR_INST_INPUT_POWER /end LOC_MEASUREMENT
 FUNCTION_VERSION "30000.25.0" /end FUNCTION
/begin COMPU_METHOD DFCDSQ_Verb "" TAB_VERB "%6.3" "-" COMPU_TAB_REF DFCDSQ_Verb /end COMPU_METHOD
/begin COMPU_VTAB DFCDSQ_Verb "" TAB_VERB 971 0 "NoInhibit" 1 "DFC_ACCmprFltLvlRes" 2 "DFC_AbgHiSigFlt" 3 "DFC_AbgIntPatFlt" 4 "DFC_AbgLoSigFlt" 5 "DFC_AbgUnkwnErrSigFlt" 6 "DFC_AcExtChrgrIBattExcdd" 7 "DFC_AcExtChrgrIInExcdd" 8 "DFC_AcExtChrgrIOutDe" 9 "DFC_AcExtChrgrIOutExcdd" 10 "DFC_AcExtChrgrUOutDe" 11 "DFC_AdpActvDChaFailr" 12 "DFC_AirbcuFlt" 13 "DFC_Airbg" 14 "DFC_AirbgCan" 15 "DFC_AirbgCanHWPlaus" 16 "DFC_AirbgHWCanPlaus" 17 "DFC_AirbgMnr" 18 "DFC_AirbgPerHi" 19 "DFC_AirbgPerdRngFlt" 20 "DFC_BlowrRlyErr" 21 "DFC_BrkBstPmpActtnDfct" 22 "DFC_BrkBstPmpDeactvnDfct" 23 "DFC_BrkSwtFlt" 24 "DFC_CbnHeatgHeatrHsScb" 25 "DFC_CbnHeatgHeatrHsScg" 26 "DFC_CbnHeatgHeatrLsOl" 27 "DFC_CbnHeatgHeatrLsScb" 28 "DFC_CbnHeatgHeatrLsScg" 29 "DFC_CbnHeatgHeatrUnUsed" 30 "DFC_ChrgnCntctHsOt" 31 "DFC_ChrgnCntctHsScb" 32 "DFC_ChrgnCntctHsScg" 33 "DFC_ChrgnCntctLsNegOl" 34 "DFC_ChrgnCntctLsNegOt" 35 "DFC_ChrgnCntctLsNegScb" 36 "DFC_ChrgnCntctLsNegScg" 37 "DFC_ChrgnCntctLsPosOl" 38 "DFC_ChrgnCntctLsPosOt" 39 "DFC_ChrgnCntctLsPosScb" 40 "DFC_ChrgnCntctLsPosScg" 41 "DFC_ChrgnCntctUnUsed" 42 "DFC_ComBrkMai" 43 "DFC_ComChrgrEVCont" 44 "DFC_ComChrgrEVtBlink" 45 "DFC_ComChrgrMstBlink" 46 "DFC_ComChrgrMstCont" 47 "DFC_ComChrgrSVSBlink" 48 "DFC_ComChrgrSVSCont" 49 "DFC_ComDcdcEVBlink" 50 "DFC_ComDcdcEVCont" 51 "DFC_ComDcdcFltLvl2" 52 "DFC_ComDcdcFltLvl3" 53 "DFC_ComDcdcFltLvl4" 54 "DFC_ComDcdcFltLvl5" 55 "DFC_ComDcdcFltLvlRes" 56 "DFC_ComDcdcMstBlink" 57 "DFC_ComDcdcMstCont" 58 "DFC_ComDcdcSVSBlink" 59 "DFC_ComDcdcSVSCont" 60 "DFC_ComElMIIvtrFltLvl2" 61 "DFC_ComElMIIvtrFltLvl3" 62 "DFC_ComElMIIvtrFltLvl4" 63 "DFC_ComElMIIvtrFltLvl5" 64 "DFC_ComElMIIvtrFltLvlRes" 65 "DFC_ComEmacEVBlink" 66 "DFC_ComEmacEVCont" 67 "DFC_ComEmacMstCont" 68 "DFC_ComEmacMsttBlink" 69 "DFC_ComEmacSVSBlink" 70 "DFC_ComEmacSVSCont" 71 "DFC_ComGunCntInfoWkuReq" 72 "DFC_ComHillHldFlt" 73 "DFC_ComHvBattRchrgWkuReq" 74 "DFC_ComHvbFltLvl2" 75 "DFC_ComHvbFltLvl3" 76 "DFC_ComHvbFltLvl4" 77 "DFC_ComHvbFltLvl5" 78 "DFC_ComHvbFltLvlRes" 79 "DFC_ComHvbMstBlink" 80 "DFC_ComHvbMstCont" 81 "DFC_ComImmoUnlockWkuReq" 82 "DFC_ComInfoReqPtlWkuReq" 83 "DFC_ComOBCFltLvl2" 84 "DFC_ComOBCFltLvl3" 85 "DFC_ComOBCFltLvl4" 86 "DFC_ComOBCFltLvl5" 87 "DFC_ComOBCFltLvlRes" 88 "DFC_ComPostOperationWkuReq" 89 "DFC_ComPreCondElecWkuReq" 90 "DFC_ComRemUnlckWkuReq" 91 "DFC_ComStpDlyHMIWkuReq" 92 "DFC_ComflgCurMeasmtErr" 93 "DFC_ComflgCurMeasmtSysErr" 94 "DFC_ComflgCurMeasmtVld" 95 "DFC_ComflgCurRngErr" 96 "DFC_ComflgTPcbMeasmtErr" 97 "DFC_ComflgTPcbMeasmtVld" 98 "DFC_ComflgTPcbRngErr" 99 "DFC_ComflgTPcbSysErr" 100 "DFC_ComflgTShntMeasmtErr" 101 "DFC_ComflgTShntMeasmtVld" 102 "DFC_ComflgTShntRngErr" 103 "DFC_ComflgTShntSysErr" 104 "DFC_ComflgVoltMeasmtErr" 105 "DFC_ComflgVoltMeasmtSysErr" 106 "DFC_ComflgVoltMeasmtVld" 107 "DFC_ComflgVoltRngErr" 108 "DFC_CrashEveOcc" 109 "DFC_DcdcFwdModStuck" 110 "DFC_DcdcLvUDifMaxFlt" 111 "DFC_DcdcOffModStuck" 112 "DFC_DcdcOperModFailr" 113 "DFC_DcdcPrecModStuck" 114 "DFC_DrvDoorOpn" 115 "DFC_DrvModPosnDfct" 116 "DFC_DrvStbltOpn" 117 "DFC_ETogFailrLvl3" 118 "DFC_ETogFailrLvl4" 119 "DFC_EbsLvBattSocDiagLo" 120 "DFC_EbsLvBattUDiagDiOper" 121 "DFC_EbsLvBattUDiagFltLvl1" 122 "DFC_EbsLvBattUDiagFltLvl2" 123 "DFC_EbsLvBattUDiagLo" 124 "DFC_EbsSnsrSt" 125 "DFC_EbsSofASILErr" 126 "DFC_ElTSPtSysLimDrvErr" 127 "DFC_ElTSPtSysLimRgnErr" 128 "DFC_HLCCcsFwDwnl" 129 "DFC_HvBattChrgPwrMax" 130 "DFC_HvBattCrashDetd" 131 "DFC_HvBattDchaPwrMax" 132 "DFC_HvBattEmgyOff" 133 "DFC_HvBattEmgyOffIntlck" 134 "DFC_HvBattEmgyOffReq" 135 "DFC_HvBattFltMod" 136 "DFC_HvBattIReqToChrgrErr" 137 "DFC_HvBattIReqToChrgrIni" 138 "DFC_HvBattIninTout" 139 "DFC_HvBattIntlckSt" 140 "DFC_HvBattIsoFlt" 141 "DFC_HvBattLimdPwr" 142 "DFC_HvBattMaiSwtClsngFlt" 143 "DFC_HvBattMaiSwtFlt" 144 "DFC_HvBattMaiSwtOpen" 145 "DFC_HvBattMaiSwtOpngFlt" 146 "DFC_HvBattMaiSwtWldd" 147 "DFC_HvBattNegCntctrCntErr" 148 "DFC_HvBattOperModChrgPlausy" 149 "DFC_HvBattOverTDern" 150 "DFC_HvBattPosCntctrCntErr" 151 "DFC_HvBattPrecCntctrCntErr" 152 "DFC_HvBattPwrDistbnTDern" 153 "DFC_HvBattPwrDistbnTInhbn" 154 "DFC_HvBattRatRSohErr" 155 "DFC_HvBattRatSohErr" 156 "DFC_HvBattSngIsoWarn" 157 "DFC_HvBattSrvPlgDiscnct" 158 "DFC_HvBattUNomChrgnErr" 159 "DFC_HvBattUNomChrgnIni" 160 "DFC_HvBattUnderTDern" 161 "DFC_HvbEVLmpBlink" 162 "DFC_HvbEVLmpCont" 163 "DFC_HvbSVSBlink" 164 "DFC_HvbSVSCont" 165 "DFC_InmLINBusBlk" 166 "DFC_PDUProgmFailr" 167 "DFC_PEnvSigRngMax" 168 "DFC_PEnvSigRngMin" 169 "DFC_PLnCChpDeactvnFaild" 170 "DFC_PrkgBrkFailr" 171 "DFC_PtSysLimErr" 172 "DFC_PwrMaxDchaShoLo" 173 "DFC_SCtPmp1FailSafeNotSuc" 174 "DFC_SCtPmp1SCG" 175 "DFC_VehCoornDrvrNotPrsnt" 176 "DFC_VehVCanAvl" 177 "DFC_VehVCanErr" 178 "DFC_eTogFailrLvlRes" 179 "DFC_flgBrkMaiDiag" 180 "DFC_stHvbIsoMeasmtRes" 181 "DFC_BrkBstPmpPLeakDfct" 182 "DFC_Com082hTooShort" 183 "DFC_Com092hTooShort" 184 "DFC_Com205hAbsent" 185 "DFC_Com205hChecksum" 186 "DFC_Com205hCounter" 187 "DFC_Com205hTooShort" 188 "DFC_Com217hAbsent" 189 "DFC_Com217hChecksum" 190 "DFC_Com217hCounter" 191 "DFC_Com217hTooShort" 192 "DFC_Com227hAbsent" 193 "DFC_Com227hTooShort" 194 "DFC_Com237hAbsent" 195 "DFC_Com237hChecksum" 196 "DFC_Com237hCounter" 197 "DFC_Com237hTooShort" 198 "DFC_Com259hAbsent" 199 "DFC_Com259hChecksum" 200 "DFC_Com259hCounter" 201 "DFC_Com259hTooShort" 202 "DFC_Com26hAbsent" 203 "DFC_Com26hTooShort" 204 "DFC_Com273hAbsent" 205 "DFC_Com273hChecksum" 206 "DFC_Com273hCounter" 207 "DFC_Com273hTooShort" 208 "DFC_Com275hAbsent" 209 "DFC_Com275hChecksum" 210 "DFC_Com275hCounter" 211 "DFC_Com275hTooShort" 212 "DFC_Com283hAbsent" 213 "DFC_Com283hTooShort" 214 "DFC_Com285hAbsent" 215 "DFC_Com285hChecksum" 216 "DFC_Com285hCounter" 217 "DFC_Com285hTooShort" 218 "DFC_Com293hAbsent" 219 "DFC_Com293hChecksum" 220 "DFC_Com293hCounter" 221 "DFC_Com293hTooShort" 222 "DFC_Com308hAbsent" 223 "DFC_Com308hChecksum" 224 "DFC_Com308hCounter" 225 "DFC_Com308hTooShort" 226 "DFC_Com318hAbsent" 227 "DFC_Com318hChecksum" 228 "DFC_Com318hCounter" 229 "DFC_Com318hTooShort" 230 "DFC_Com325hAbsent" 231 "DFC_Com325hChecksum" 232 "DFC_Com325hCounter" 233 "DFC_Com325hTooShort" 234 "DFC_Com335hAbsent" 235 "DFC_Com335hChecksum" 236 "DFC_Com335hCounter" 237 "DFC_Com335hTooShort" 238 "DFC_Com351hAbsent" 239 "DFC_Com351hTooShort" 240 "DFC_Com38DhAbsent" 241 "DFC_Com38DhChecksum" 242 "DFC_Com38DhCounter" 243 "DFC_Com38DhTooShort" 244 "DFC_Com412hAbsent" 245 "DFC_Com412hChecksum" 246 "DFC_Com412hCounter" 247 "DFC_Com412hTooShort" 248 "DFC_Com427hAbsent" 249 "DFC_Com427hTooShort" 250 "DFC_Com432hAbsent" 251 "DFC_Com432hChecksum" 252 "DFC_Com432hCounter" 253 "DFC_Com432hTooShort" 254 "DFC_Com435hAbsent" 255 "DFC_Com435hTooShort" 256 "DFC_Com442hAbsent" 257 "DFC_Com442hTooShort" 258 "DFC_Com453hAbsent" 259 "DFC_Com453hTooShort" 260 "DFC_Com455hAbsent" 261 "DFC_Com455hTooShort" 262 "DFC_Com463hAbsent" 263 "DFC_Com463hTooShort" 264 "DFC_Com473hAbsent" 265 "DFC_Com473hTooShort" 266 "DFC_Com47BhAbsent" 267 "DFC_Com47BhTooShort" 268 "DFC_Com48BhAbsent" 269 "DFC_Com48BhTooShort" 270 "DFC_Com497hTooShort" 271 "DFC_Com4F2hAbsent" 272 "DFC_Com4F2hChecksum" 273 "DFC_Com4F2hCounter" 274 "DFC_Com4F2hTooShort" 275 "DFC_Com50DhAbsent" 276 "DFC_Com50DhTooShort" 277 "DFC_Com535hAbsent" 278 "DFC_Com535hTooShort" 279 "DFC_Com543hAbsent" 280 "DFC_Com543hTooShort" 281 "DFC_Com552hAbsent" 282 "DFC_Com552hTooShort" 283 "DFC_Com583hAbsent" 284 "DFC_Com583hTooShort" 285 "DFC_Com592hAbsent" 286 "DFC_Com592hChecksum" 287 "DFC_Com592hCounter" 288 "DFC_Com592hTooShort" 289 "DFC_Com595hAbsent" 290 "DFC_Com595hChecksum" 291 "DFC_Com595hCounter" 292 "DFC_Com595hTooShort" 293 "DFC_Com5B2hAbsent" 294 "DFC_Com5B2hTooShort" 295 "DFC_Com5B5hAbsent" 296 "DFC_Com5B5hChecksum" 297 "DFC_Com5B5hCounter" 298 "DFC_Com5B5hTooShort" 299 "DFC_Com5C7hTooShort" 300 "DFC_Com5E7hAbsent" 301 "DFC_Com5E7hTooShort" 302 "DFC_Com635hTooShort" 303 "DFC_Com645hTooShort" 304 "DFC_Com663hAbsent" 305 "DFC_Com663hTooShort" 306 "DFC_Com665hAbsent" 307 "DFC_Com665hTooShort" 308 "DFC_Com675hAbsent" 309 "DFC_Com675hTooShort" 310 "DFC_ComFrbd_205h_HVBAT_PACK_CURRENT" 311 "DFC_ComFrbd_205h_HVBAT_SOC_DISPLAY" 312 "DFC_ComFrbd_205h_HVBAT_VOLTAGE" 313 "DFC_ComFrbd_217h_INV_DC_BUS_VOLTAGE" 314 "DFC_ComFrbd_217h_INV_MTR_ACTUAL_TRQ" 315 "DFC_ComFrbd_217h_INV_MTR_SPEED" 316 "DFC_ComFrbd_217h_INV_MTR_TRQ" 317 "DFC_ComFrbd_227h_INV_DC_CURRENT" 318 "DFC_ComFrbd_227h_INV_MOTORING_PEAK_TRQ" 319 "DFC_ComFrbd_227h_INV_MTR_INST_INPUT_POWER" 320 "DFC_ComFrbd_227h_INV_REGEN_PEAK_TRQ" 321 "DFC_ComFrbd_237h_INV_ACTIVE_DISCHARGE_STATUS" 322 "DFC_ComFrbd_237h_INV_CTRL_MODE_ACK" 323 "DFC_ComFrbd_237h_INV_EV_WARNING" 324 "DFC_ComFrbd_237h_INV_FAULT_LEVEL" 325 "DFC_ComFrbd_237h_INV_MASTER_STOP" 326 "DFC_ComFrbd_237h_INV_SERVICE_DUE" 327 "DFC_ComFrbd_237h_INV_STAB_MIN_TRQ" 328 "DFC_ComFrbd_259h_TGLM_FAILURE_STATE" 329 "DFC_ComFrbd_259h_TGLM_MODE_PUSH" 330 "DFC_ComFrbd_259h_TOGGLE_MONOSTABLE_POS" 331 "DFC_ComFrbd_273h_OBC_outputpower_capability" 332 "DFC_ComFrbd_275h_HVBAT_DISCHARGE_30S_AVAILABLE_CURRENT" 333 "DFC_ComFrbd_275h_HVBAT_DISCHARGE_30S_AVAILABLE_POWER" 334 "DFC_ComFrbd_283h_DCDC_IN_CURRENT" 335 "DFC_ComFrbd_283h_DCDC_IN_VOLTAGE" 336 "DFC_ComFrbd_283h_DCDC_OUT_CURRENT" 337 "DFC_ComFrbd_283h_DCDC_OUT_VOLTAGE" 338 "DFC_ComFrbd_285h_HVBAT_REGEN_CHG_30S_CURRENT_LIMIT" 339 "DFC_ComFrbd_285h_HVBAT_REGEN_CHRG_30S_POWER_LIMIT" 340 "DFC_ComFrbd_293h_DCDC_outputpower_capability" 341 "DFC_ComFrbd_325h_HVBAT_INSULATION_RESISTANCE" 342 "DFC_ComFrbd_325h_HVBAT_TEMPERATURE" 343 "DFC_ComFrbd_335h_HVBAT_CHRG_CONTINUOUS_CURR_MAX" 344 "DFC_ComFrbd_335h_HVBAT_CHRG_COTINUOUS_CURR_REQ" 345 "DFC_ComFrbd_335h_HVBAT_CHRG_MAX_VOLT" 346 "DFC_ComFrbd_335h_HVBAT_DC_BUS_VOLTAGE" 347 "DFC_ComFrbd_427h_INV_OP_MODE" 348 "DFC_ComFrbd_427h_INV_PERMISIBLE_TORQUE" 349 "DFC_ComFrbd_435h_HVBAT_MAX_CELL_VOLT" 350 "DFC_ComFrbd_435h_HVBAT_MAX_CELL_VOLT_NUM" 351 "DFC_ComFrbd_435h_HVBAT_MAX_SENSOR_TEMP" 352 "DFC_ComFrbd_435h_HVBAT_MIN_CELL_VOLT" 353 "DFC_ComFrbd_435h_HVBAT_MIN_CELL_VOLT_NUM" 354 "DFC_ComFrbd_453h_OBC_IN_CURRENT" 355 "DFC_ComFrbd_453h_OBC_IN_VOLTAGE" 356 "DFC_ComFrbd_453h_OBC_IP_POWER" 357 "DFC_ComFrbd_455h_HVBAT_NOMINAL_VOLTAGE" 358 "DFC_ComFrbd_463h_OBC_OUT_CURRENT" 359 "DFC_ComFrbd_463h_OBC_OUT_VOLTAGE" 360 "DFC_ComFrbd_463h_OBC_TEMPERATURE" 361 "DFC_ComFrbd_473h_DCDC_Coolant_Temperature" 362 "DFC_ComFrbd_473h_DCDC_TEMPERATURE" 363 "DFC_ComFrbd_47Bh_eCOMP_BusBarCurrent" 364 "DFC_ComFrbd_47Bh_eCOMP_BusBarVoltage" 365 "DFC_ComFrbd_47Bh_eCOMP_CompressorSpeed" 366 "DFC_ComFrbd_47Bh_eCOMP_IGBT_Temp" 367 "DFC_ComFrbd_47Bh_eCOMP_PeakPhaCurrent" 368 "DFC_ComFrbd_47Bh_eCOMP_Power_consumption" 369 "DFC_ComFrbd_48Bh_eCOMP_Fault_Level" 370 "DFC_ComFrbd_4F2h_VALEUR_SOC_ETENDUE" 371 "DFC_ComFrbd_535h_HV_BATT_TEMP_AVG" 372 "DFC_ComFrbd_543h_HVBAT_RESTBATTENERGY" 373 "DFC_ComFrbd_543h_HVBAT_SOH" 374 "DFC_ComFrbd_543h_HV_BATT_SOH_RES" 375 "DFC_ComFrbd_592h_IBATT_1" 376 "DFC_ComFrbd_592h_IBATT_2" 377 "DFC_ComFrbd_592h_IBATT_3" 378 "DFC_ComFrbd_592h_TEMP_BATT" 379 "DFC_ComFrbd_592h_U_BATT_BECB" 380 "DFC_ComFrbd_595h_HVBAT_TIME_TO_CHRG_80" 381 "DFC_ComFrbd_5B2h_TEMP_AIR_EXT" 382 "DFC_ComFrbd_635h_HVBAT_NEG_CONT_COUNT_SEG1" 383 "DFC_ComFrbd_635h_HVBAT_NEG_CONT_COUNT_SEG3" 384 "DFC_ComFrbd_635h_HVBAT_NEG_CONT_COUNT_SEG4" 385 "DFC_ComFrbd_635h_HVBAT_PST_CONT_COUNT_SEG1" 386 "DFC_ComFrbd_635h_HVBAT_PST_CONT_COUNT_SEG3" 387 "DFC_ComFrbd_635h_HVBAT_PST_CONT_COUNT_SEG4" 388 "DFC_ComFrbd_645h_HVBAT_PRECHRGE_CONT_COUNT_SEG1" 389 "DFC_ComFrbd_645h_HVBAT_PRECHRGE_CONT_COUNT_SEG2" 390 "DFC_ComFrbd_675h_HVBAT_REMAININGBATTCAPACITY" 391 "DFC_ComInvld_205h_HVBAT_CHARGING_STATUS" 392 "DFC_ComInvld_205h_HVBAT_PACK_CURRENT" 393 "DFC_ComInvld_205h_HVBAT_SOC_DISPLAY" 394 "DFC_ComInvld_205h_HVBAT_VOLTAGE" 395 "DFC_ComInvld_217h_INV_DC_BUS_VOLTAGE" 396 "DFC_ComInvld_217h_INV_MTR_ACTUAL_TRQ" 397 "DFC_ComInvld_217h_INV_MTR_SPEED" 398 "DFC_ComInvld_217h_INV_MTR_TRQ" 399 "DFC_ComInvld_227h_INV_DC_CURRENT" 400 "DFC_ComInvld_227h_INV_MOTORING_PEAK_TRQ" 401 "DFC_ComInvld_227h_INV_MTR_INST_INPUT_POWER" 402 "DFC_ComInvld_227h_INV_REGEN_PEAK_TRQ" 403 "DFC_ComInvld_237h_INV_ACTIVE_DISCHARGE_STATUS" 404 "DFC_ComInvld_237h_INV_FAULT_LEVEL" 405 "DFC_ComInvld_237h_INV_STAB_MIN_TRQ" 406 "DFC_ComInvld_259h_TGLM_MODE_PUSH" 407 "DFC_ComInvld_259h_TOGGLE_MONOSTABLE_POS" 408 "DFC_ComInvld_26h_AC_SWITCH_REQ" 409 "DFC_ComInvld_26h_BLOWER_POSITION" 410 "DFC_ComInvld_26h_EVAP_SENSOR_FAULT" 411 "DFC_ComInvld_26h_EVAP_SENSOR_VALUE" 412 "DFC_ComInvld_26h_POTENTIOMETER_FAULT" 413 "DFC_ComInvld_26h_REAR_DEFOG_REQ" 414 "DFC_ComInvld_26h_TEMP_POSITION" 415 "DFC_ComInvld_273h_OBC_FAULT_LEVEL" 416 "DFC_ComInvld_273h_OBC_outputpower_capability" 417 "DFC_ComInvld_275h_HVBAT_DISCHARGE_30S_AVAILABLE_CURRENT" 418 "DFC_ComInvld_275h_HVBAT_DISCHARGE_30S_AVAILABLE_POWER" 419 "DFC_ComInvld_283h_DCDC_IN_CURRENT" 420 "DFC_ComInvld_283h_DCDC_IN_VOLTAGE" 421 "DFC_ComInvld_283h_DCDC_OUT_CURRENT" 422 "DFC_ComInvld_283h_DCDC_OUT_VOLTAGE" 423 "DFC_ComInvld_285h_HVBAT_REGEN_CHG_30S_CURRENT_LIMIT" 424 "DFC_ComInvld_285h_HVBAT_REGEN_CHRG_30S_POWER_LIMIT" 425 "DFC_ComInvld_293h_DCDC_FAULT_LEVEL" 426 "DFC_ComInvld_293h_DCDC_outputpower_capability" 427 "DFC_ComInvld_325h_HVBAT_EPLUG_STATUS" 428 "DFC_ComInvld_325h_HVBAT_HVIL_STS" 429 "DFC_ComInvld_325h_HVBAT_INSULATION_FAULT" 430 "DFC_ComInvld_325h_HVBAT_INSULATION_RESISTANCE" 431 "DFC_ComInvld_325h_HVBAT_TEMPERATURE" 432 "DFC_ComInvld_335h_HVBAT_CHRG_CONTINUOUS_CURR_MAX" 433 "DFC_ComInvld_335h_HVBAT_CHRG_COTINUOUS_CURR_REQ" 434 "DFC_ComInvld_335h_HVBAT_CHRG_MAX_VOLT" 435 "DFC_ComInvld_335h_HVBAT_DC_BUS_VOLTAGE" 436 "DFC_ComInvld_38Dh_VITESSE_VEHICULE_ROUES" 437 "DFC_ComInvld_38Dh_VVH_INDISP" 438 "DFC_ComInvld_427h_INV_COOLANT_TEMP" 439 "DFC_ComInvld_427h_INV_MOTOR_TEMP" 440 "DFC_ComInvld_427h_INV_OP_MODE" 441 "DFC_ComInvld_427h_INV_PERMISIBLE_TORQUE" 442 "DFC_ComInvld_427h_INV_TEMP" 443 "DFC_ComInvld_432h_REVEIL_PRINCIPAL" 444 "DFC_ComInvld_435h_HVBAT_MAX_CELL_VOLT" 445 "DFC_ComInvld_435h_HVBAT_MAX_CELL_VOLT_NUM" 446 "DFC_ComInvld_435h_HVBAT_MAX_SENSOR_TEMP" 447 "DFC_ComInvld_435h_HVBAT_MIN_CELL_VOLT" 448 "DFC_ComInvld_435h_HVBAT_MIN_CELL_VOLT_NUM" 449 "DFC_ComInvld_442h_BCCM_BLOWER_RELAY_STS" 450 "DFC_ComInvld_453h_OBC_IN_CURRENT" 451 "DFC_ComInvld_453h_OBC_IN_VOLTAGE" 452 "DFC_ComInvld_453h_OBC_IP_POWER" 453 "DFC_ComInvld_455h_HVBAT_NOMINAL_VOLTAGE" 454 "DFC_ComInvld_463h_OBC_OUT_CURRENT" 455 "DFC_ComInvld_463h_OBC_OUT_VOLTAGE" 456 "DFC_ComInvld_463h_OBC_TEMPERATURE" 457 "DFC_ComInvld_473h_DCDC_Coolant_Temperature" 458 "DFC_ComInvld_473h_DCDC_TEMPERATURE" 459 "DFC_ComInvld_47Bh_eCOMP_BusBarCurrent" 460 "DFC_ComInvld_47Bh_eCOMP_BusBarVoltage" 461 "DFC_ComInvld_47Bh_eCOMP_CompressorSpeed" 462 "DFC_ComInvld_47Bh_eCOMP_IGBT_Temp" 463 "DFC_ComInvld_47Bh_eCOMP_PeakPhaCurrent" 464 "DFC_ComInvld_47Bh_eCOMP_Power_consumption" 465 "DFC_ComInvld_4F2h_STATUS_SOC" 466 "DFC_ComInvld_4F2h_TEMP_BATT_STATUS" 467 "DFC_ComInvld_4F2h_VALEUR_SOC_ETENDUE" 468 "DFC_ComInvld_535h_HV_BATT_TEMP_AVG" 469 "DFC_ComInvld_543h_HVBAT_RESTBATTENERGY" 470 "DFC_ComInvld_543h_HVBAT_SOH" 471 "DFC_ComInvld_543h_HV_BATT_SOH_RES" 472 "DFC_ComInvld_552h_CPT_TEMPOREL" 473 "DFC_ComInvld_552h_KILOMETRAGE" 474 "DFC_ComInvld_583h_HV_BATT_DISCONT_CSE_OPEN" 475 "DFC_ComInvld_592h_CALIBRE_IBATT" 476 "DFC_ComInvld_592h_IBATT_1" 477 "DFC_ComInvld_592h_IBATT_2" 478 "DFC_ComInvld_592h_IBATT_3" 479 "DFC_ComInvld_592h_TEMP_BATT" 480 "DFC_ComInvld_592h_U_BATT_BECB" 481 "DFC_ComInvld_595h_HVBAT_TIME_TO_CHRG_80" 482 "DFC_ComInvld_5B2h_TEMP_AIR_EXT" 483 "DFC_ComInvld_5B5h_HVBAT_THERMAL_RUNAWAY" 484 "DFC_ComInvld_635h_HVBAT_NEG_CONT_COUNT_SEG1" 485 "DFC_ComInvld_635h_HVBAT_NEG_CONT_COUNT_SEG3" 486 "DFC_ComInvld_635h_HVBAT_NEG_CONT_COUNT_SEG4" 487 "DFC_ComInvld_635h_HVBAT_PST_CONT_COUNT_SEG1" 488 "DFC_ComInvld_635h_HVBAT_PST_CONT_COUNT_SEG3" 489 "DFC_ComInvld_635h_HVBAT_PST_CONT_COUNT_SEG4" 490 "DFC_ComInvld_645h_HVBAT_PRECHRGE_CONT_COUNT_SEG1" 491 "DFC_ComInvld_645h_HVBAT_PRECHRGE_CONT_COUNT_SEG2" 492 "DFC_ComInvld_675h_HVBAT_REMAININGBATTCAPACITY" 493 "DFC_ACCmprFltLvl1" 494 "DFC_ACCmprFltLvl2" 495 "DFC_ACCmprFltLvl3" 496 "DFC_ACCmprFltLvl4" 497 "DFC_ACCmprHiPFlt" 498 "DFC_ACCmprInvldCmprSt" 499 "DFC_ACCmprInvldElecActPwr" 500 "DFC_ACCmprLoPFlt" 501 "DFC_AcChrgrIntkTSRCMin" 502 "DFC_BattUBMaxBatt" 503 "DFC_BattUBMaxNoBatt" 504 "DFC_BattUBMinBatt" 505 "DFC_BattUBMinNoBatt" 506 "DFC_BattUSRCMax" 507 "DFC_BattUSRCMin" 508 "DFC_BrkBstPHiCautionDfct" 509 "DFC_BrkBstPHiWarnDfct" 510 "DFC_BrkBstPSnsr12PlausDfct" 511 "DFC_BrkBstPSnsr1Scb" 512 "DFC_BrkBstPSnsr1Scg" 513 "DFC_BrkBstPSnsr2Scb" 514 "DFC_BrkBstPSnsr2Scg" 515 "DFC_BrkBstPSnsrMax" 516 "DFC_BrkBstPSnsrMin" 517 "DFC_BrkBstPhyRngChkMax" 518 "DFC_BrkBstPhyRngChkMin" 519 "DFC_BrkBstPmpHsScb" 520 "DFC_BrkBstPmpHsScg" 521 "DFC_BrkBstPmpLsOl" 522 "DFC_BrkBstPmpLsScb" 523 "DFC_BrkBstPmpLsScg" 524 "DFC_CbnHeatgHeatrRlyOpend" 525 "DFC_CbnHeatgHeatrRlyWldd" 526 "DFC_CcsDcIBattExcdd" 527 "DFC_CcsDcIEvseOutDe" 528 "DFC_CcsDcIOutDe" 529 "DFC_CcsDcIOutExcdd" 530 "DFC_CcsDcUOutDe" 531 "DFC_CcsDcUOutExcdd" 532 "DFC_CcsPwrLineChpRstOL" 533 "DFC_CcsPwrLineChpRstOvrTemp" 534 "DFC_CcsPwrLineChpRstSCB" 535 "DFC_CcsPwrLineChpRstSCG" 536 "DFC_CcsPwrLineChpVccEnaOL" 537 "DFC_CcsPwrLineChpVccEnaOvrTemp" 538 "DFC_CcsPwrLineChpVccEnaSCB" 539 "DFC_CcsPwrLineChpVccEnaSCG" 540 "DFC_CcsPwrLineChpVccSRCMin" 541 "DFC_CcsPwrLineComChpTSRCMin" 542 "DFC_CtPSwtActrOL" 543 "DFC_CtPSwtActrOvrTemp" 544 "DFC_CtPSwtActrSCB" 545 "DFC_CtPSwtActrSCG" 546 "DFC_CtPSwtDiagSRCMin" 547 "DFC_CtpCarrFrqSRCMin" 548 "DFC_DcChrgrIntkT2SRCMin" 549 "DFC_DcChrgrIntkTSRCMin" 550 "DFC_DevLibBattUHi" 551 "DFC_DevLibBattULo" 552 "DFC_EmWakeupSigOL" 553 "DFC_EmWakeupSigOvrTemp" 554 "DFC_EmWakeupSigSCB" 555 "DFC_EmWakeupSigSCG" 556 "DFC_Fan1OL" 557 "DFC_Fan1OvrTemp" 558 "DFC_Fan1SCB" 559 "DFC_FanRlySCB" 560 "DFC_FanRlySCG" 561 "DFC_FanSpdSRCMin" 562 "DFC_FreonPSRCMin" 563 "DFC_HLCCcsPLnCChipTHi" 564 "DFC_HeatrCoreTSRCMin" 565 "DFC_PwmCtPSRCMin" 566 "DFC_PwrDistbnUnitTSRCMin" 567 "DFC_SCtPmp1OL" 568 "DFC_SCtPmp1OvrTemp" 569 "DFC_SCtPmp1SCB" 570 "DFC_SCtPmpRlyOL" 571 "DFC_SCtPmpRlyOvrTemp" 572 "DFC_SCtPmpRlySCB" 573 "DFC_SpplCooltPmpRlyOL" 574 "DFC_SpplCooltPmpRlyOvrTemp" 575 "DFC_SpplCooltPmpRlySCB" 576 "DFC_UCtPSRCMin" 577 "DFC_UPxP1SRCMin" 578 "DFC_ComHSN1CANMute" 579 "DFC_ComHSN3CANMute" 580 "DFC_AcChrgrIntkTPhysRngHi" 581 "DFC_AcChrgrIntkTPhysRngLo" 582 "DFC_AcChrgrIntkTSRCOpn" 583 "DFC_CcsPwrLineChpVccPhysRngHi" 584 "DFC_CcsPwrLineChpVccPhysRngLo" 585 "DFC_CcsPwrLineChpVccSRCOpn" 586 "DFC_CcsPwrLineComChpTPhysRngHi" 587 "DFC_CcsPwrLineComChpTPhysRngLo" 588 "DFC_CcsPwrLineComChpTSRCOpn" 589 "DFC_CtPSwtDiagPhysRngHi" 590 "DFC_CtPSwtDiagPhysRngLo" 591 "DFC_CtPSwtDiagSRCOpn" 592 "DFC_CtpCarrFrqPhysRngHi" 593 "DFC_CtpCarrFrqPhysRngLo" 594 "DFC_CtpCarrFrqSRCMax" 595 "DFC_DcChrgrIntkT2PhysRngHi" 596 "DFC_DcChrgrIntkT2PhysRngLo" 597 "DFC_DcChrgrIntkT2SRCOpn" 598 "DFC_DcChrgrIntkTPhysRngHi" 599 "DFC_DcChrgrIntkTPhysRngLo" 600 "DFC_DcChrgrIntkTSRCOpn" 601 "DFC_Fan1SCG" 602 "DFC_FanSpdPhysRngHi" 603 "DFC_FanSpdPhysRngLo" 604 "DFC_FanSpdSRCOpn" 605 "DFC_FreonPPhysRngHi" 606 "DFC_FreonPPhysRngLo" 607 "DFC_FreonPSRCOpn" 608 "DFC_HeatrCoreTPhysRngHi" 609 "DFC_HeatrCoreTPhysRngLo" 610 "DFC_HeatrCoreTSRCOpn" 611 "DFC_HvGridUMaxSftyLim" 612 "DFC_HvGridUMinSftyLim" 613 "DFC_HvGridUPlausy" 614 "DFC_IntlckChrgPlgHBrgOpnLd" 615 "DFC_IntlckChrgPlgHBrgOvrCurr" 616 "DFC_IntlckChrgPlgHBrgOvrTemp" 617 "DFC_IntlckChrgPlgHBrgShCirBatt1" 618 "DFC_IntlckChrgPlgHBrgShCirBatt2" 619 "DFC_IntlckChrgPlgHBrgShCirGnd1" 620 "DFC_IntlckChrgPlgHBrgShCirGnd2" 621 "DFC_IntlckChrgPlgHBrgShCirOvrLd" 622 "DFC_IntlckChrgPlgHBrgTempOvrCurr" 623 "DFC_IntlckChrgPlgHBrgUndrVltg" 624 "DFC_IntlckChrgPlgPosnRngFlt" 625 "DFC_IntlckChrgPlgPosnSrcMax" 626 "DFC_IntlckChrgPlgPosnSrcMin" 627 "DFC_PwmCtPPhysRngHi" 628 "DFC_PwmCtPPhysRngLo" 629 "DFC_PwmCtPSRCMax" 630 "DFC_PwrDistbnUnitTPhysRngHi" 631 "DFC_PwrDistbnUnitTPhysRngLo" 632 "DFC_PwrDistbnUnitTSRCOpn" 633 "DFC_SCtPmpRlySCG" 634 "DFC_SpplCooltPmpRlySCG" 635 "DFC_UCtPPhysRngHi" 636 "DFC_UCtPPhysRngLo" 637 "DFC_UCtPSRCOpn" 638 "DFC_UPxP1PhysRngHi" 639 "DFC_UPxP1PhysRngLo" 640 "DFC_UPxP1SRCOpn" 641 "DFC_VehVPhysRngHi" 642 "DFC_VehVPhysRngLo" 643 "DFC_VehVSigCan" 644 "DFC_VehVSigCanSafe" 645 "DFC_SCtPmp1DiagGrdKey1" 646 "DFC_SCtPmp1DiagGrdKey2" 647 "DFC_SCtPmp1DiagGrdKey3" 648 "DFC_SCtPmp1DiagGrdKey4" 649 "DFC_SCtPmp1DiagGrdKey5" 650 "DFC_ChrgPlgLiveCntctHzrdCcs" 651 "DFC_ChrgPlgProxPltImps" 652 "DFC_ChrgPlgTHiCcsDc" 653 "DFC_ElMActvDchaFailr" 654 "DFC_ElMActvDchaFlt" 655 "DFC_ElMFbdnIvtrModDrv01" 656 "DFC_ElMImobAuthent" 657 "DFC_ElMIsoMonFlt" 658 "DFC_ElMIsoMonPlausyFlt" 659 "DFC_ElMIvtrCooltT01" 660 "DFC_ElMIvtrEmgyShtDwn01" 661 "DFC_ElMIvtrFailr01" 662 "DFC_ElMIvtrIntlck01" 663 "DFC_ElMIvtrTErr01" 664 "DFC_ElMOverSpdNeg01" 665 "DFC_ElMOverSpdPos01" 666 "DFC_ElMOverTqNeg01" 667 "DFC_ElMOverTqPos01" 668 "DFC_ElMPwrAuthn" 669 "DFC_ElMSpdErr01" 670 "DFC_ElMSvs01" 671 "DFC_PEnvCcMax" 672 "DFC_PEnvCcMin" 673 "DFC_PEnvRngChkMax" 674 "DFC_PEnvRngChkMin" 675 "DFC_PEnvSnsrPlaus" 676 "DFC_BrkBstPmpPlausGenn" 677 "DFC_CbnHeatrRlyLfLoWarn" 678 "DFC_ChgrPlugLockPinByndClsd" 679 "DFC_ChgrPlugLockPinMoveWoCmd" 680 "DFC_ChgrPlugLockPinStuckInClsd" 681 "DFC_ChgrPlugLockPinStuckInOpen" 682 "DFC_ChrgrStErr" 683 "DFC_ComHSN1BusOff" 684 "DFC_ComHSN3BusOff" 685 "DFC_ComVCInval" 686 "DFC_EemDcdcPrecSpdInhb" 687 "DFC_ExpPwrLatch" 688 "DFC_FanMaxOvrd" 689 "DFC_HLCCcsGnrlComErr" 690 "DFC_InmLINNodeHVACPanelAbsnt" 691 "DFC_ResetRcvNotAllwd" 692 "DFC_TelltlCooltPlaus" 693 "DFC_MRlyOL" 694 "DFC_MRlySCB" 695 "DFC_MRlySCG" 696 "DFC_SSpMon1" 697 "DFC_SSpMon1OV" 698 "DFC_SSpMon1SCG" 699 "DFC_SSpMon1UV" 700 "DFC_SSpMon2" 701 "DFC_SSpMon2OV" 702 "DFC_SSpMon2SCG" 703 "DFC_SSpMon2UV" 704 "DFC_SSpMon3" 705 "DFC_SSpMon3OV" 706 "DFC_SSpMon3SCG" 707 "DFC_SSpMon3UV" 708 "DFC_CANSM_E_BUS_OFF_NETWORK_HSN1_CAN" 709 "DFC_CANSM_E_BUS_OFF_NETWORK_HSN3_CAN" 710 "DFC_CANSM_E_BUS_OFF_NETWORK_HSN4_CAN" 711 "DFC_CANSM_E_BUS_OFF_NETWORK_XCP_CAN" 712 "DFC_CANTRCV_E_NO_TRCV_CONTROL_0" 713 "DFC_CAN_E_TIMEOUT" 714 "DFC_COMM_E_NET_START_IND_CHANNEL_0" 715 "DFC_COMM_E_NET_START_IND_CHANNEL_1" 716 "DFC_COMM_E_NET_START_IND_CHANNEL_2" 717 "DFC_COMM_E_NET_START_IND_CHANNEL_3" 718 "DFC_COMM_E_NET_START_IND_CHANNEL_4" 719 "DFC_COMM_E_NET_START_IND_CHANNEL_5" 720 "DFC_LIN_E_TIMEOUT" 721 "DFC_rba_EcuCtrl_TOMaxProlg" 722 "DFC_rba_EcuCtrl_TOMaxShutDwn" 723 "DFC_rba_MultiStackTrace_Threshold" 724 "DFC_rba_SyC_CustStates_Degraded_disord_Event" 725 "DFC_rba_SyC_CustStates_Degraded_incst_Event" 726 "DFC_rba_SyC_CustStates_TransNoWakReq_Event" 727 "DFC_RBA_IOEXTLIB_KEEPALIVE_DRV" 728 "DFC_RBA_IOEXTLIB_KEEPALIVE_INI" 729 "DFC_rba_IoSigRtc_StopCounter" 730 "DFC_rba_MRly_Diag_Stk_Event" 731 "DFC_rba_MemDiag_MemReadErr" 732 "DFC_rba_MemDiag_MemWrErr" 733 "DFC_rba_SyC_IrrSwOffTrigEngRun_Event" 734 "DFC_AcChrgrIntkTSRCMax" 735 "DFC_AcChrgrIntkTTmpErr" 736 "DFC_AcFlt" 737 "DFC_AppAllSnsrDfct" 738 "DFC_BattUPwrFail" 739 "DFC_BrkBstBkupOvrn" 740 "DFC_BrkBstPmpOvld" 741 "DFC_BrkPlausChk" 742 "DFC_CbnHeatgSwtTmpErr" 743 "DFC_CcsPwrLineChpVccSRCMax" 744 "DFC_CcsPwrLineChpVccTmpErr" 745 "DFC_CcsPwrLineComChpTSRCMax" 746 "DFC_CcsPwrLineComChpTTmpErr" 747 "DFC_ChgrPlugCtpCarrFrqErr" 748 "DFC_ChgrPlugCtpSwtStuckClsd" 749 "DFC_ChgrPlugCtpSwtStuckOpen" 750 "DFC_ChgrPlugCtpUErrHi" 751 "DFC_ChgrPlugPxp1SrcErr" 752 "DFC_ChrgCntctAllWldd" 753 "DFC_ChrgCntctNegOperErr" 754 "DFC_ChrgCntctNegOperWarn" 755 "DFC_ChrgCntctNegWldd" 756 "DFC_ChrgCntctPosOperErr" 757 "DFC_ChrgCntctPosOperWarn" 758 "DFC_ChrgCntctPosWldd" 759 "DFC_ChrgCntctStuckOpen" 760 "DFC_ChrgPlgIntlckFaild" 761 "DFC_ChrgnUnplRqrd" 762 "DFC_CoElMOffsCalibActv01" 763 "DFC_CtPSwtDiagSRCMax" 764 "DFC_CtPSwtDiagTmpErr" 765 "DFC_CtpCarrFrqTmpErr" 766 "DFC_DcChrgrIntkT2SRCMax" 767 "DFC_DcChrgrIntkT2TmpErr" 768 "DFC_DcChrgrIntkTSRCMax" 769 "DFC_DcChrgrIntkTTmpErr" 770 "DFC_EChrDvPlinCntrThdExcdd" 771 "DFC_EemDiagCtctrClsTout" 772 "DFC_EemDiagDcdcOffTOut" 773 "DFC_EemDiagHvCnsrOffTOut" 774 "DFC_EemDiagHvbOffTOut" 775 "DFC_FanSpdSRCMax" 776 "DFC_FanSpdTmpErr" 777 "DFC_FreonPSRCMax" 778 "DFC_FreonPTmpErr" 779 "DFC_HeatrCoreTSRCMax" 780 "DFC_HeatrCoreTTmpErr" 781 "DFC_HvGridSocMinLim" 782 "DFC_HvacBlwrFrntFlt" 783 "DFC_HvacEvapElecFlt" 784 "DFC_HvacEvapElecFltGnd" 785 "DFC_HvacKnobPosnFlt" 786 "DFC_InvBinID" 787 "DFC_InvCalID" 788 "DFC_InvErotan" 789 "DFC_InvVinID" 790 "DFC_MOXEMM_SMU_ALM0_0" 791 "DFC_MOXEMM_SMU_ALM0_1" 792 "DFC_MOXEMM_SMU_ALM0_10" 793 "DFC_MOXEMM_SMU_ALM0_11" 794 "DFC_MOXEMM_SMU_ALM0_13" 795 "DFC_MOXEMM_SMU_ALM0_14" 796 "DFC_MOXEMM_SMU_ALM0_2" 797 "DFC_MOXEMM_SMU_ALM0_22" 798 "DFC_MOXEMM_SMU_ALM0_23" 799 "DFC_MOXEMM_SMU_ALM0_4" 800 "DFC_MOXEMM_SMU_ALM0_5" 801 "DFC_MOXEMM_SMU_ALM0_7" 802 "DFC_MOXEMM_SMU_ALM0_8" 803 "DFC_MOXEMM_SMU_ALM10_16" 804 "DFC_MOXEMM_SMU_ALM10_17" 805 "DFC_MOXEMM_SMU_ALM10_21" 806 "DFC_MOXEMM_SMU_ALM11_0" 807 "DFC_MOXEMM_SMU_ALM11_1" 808 "DFC_MOXEMM_SMU_ALM11_2" 809 "DFC_MOXEMM_SMU_ALM11_3" 810 "DFC_MOXEMM_SMU_ALM11_4" 811 "DFC_MOXEMM_SMU_ALM11_5" 812 "DFC_MOXEMM_SMU_ALM11_8" 813 "DFC_MOXEMM_SMU_ALM11_9" 814 "DFC_MOXEMM_SMU_ALM1_0" 815 "DFC_MOXEMM_SMU_ALM1_1" 816 "DFC_MOXEMM_SMU_ALM1_10" 817 "DFC_MOXEMM_SMU_ALM1_11" 818 "DFC_MOXEMM_SMU_ALM1_13" 819 "DFC_MOXEMM_SMU_ALM1_14" 820 "DFC_MOXEMM_SMU_ALM1_2" 821 "DFC_MOXEMM_SMU_ALM1_22" 822 "DFC_MOXEMM_SMU_ALM1_23" 823 "DFC_MOXEMM_SMU_ALM1_4" 824 "DFC_MOXEMM_SMU_ALM1_5" 825 "DFC_MOXEMM_SMU_ALM1_7" 826 "DFC_MOXEMM_SMU_ALM1_8" 827 "DFC_MOXEMM_SMU_ALM21_0" 828 "DFC_MOXEMM_SMU_ALM21_16" 829 "DFC_MOXEMM_SMU_ALM21_3" 830 "DFC_MOXEMM_SMU_ALM2_1" 831 "DFC_MOXEMM_SMU_ALM2_10" 832 "DFC_MOXEMM_SMU_ALM2_11" 833 "DFC_MOXEMM_SMU_ALM2_13" 834 "DFC_MOXEMM_SMU_ALM2_14" 835 "DFC_MOXEMM_SMU_ALM2_22" 836 "DFC_MOXEMM_SMU_ALM2_23" 837 "DFC_MOXEMM_SMU_ALM2_4" 838 "DFC_MOXEMM_SMU_ALM2_5" 839 "DFC_MOXEMM_SMU_ALM2_7" 840 "DFC_MOXEMM_SMU_ALM2_8" 841 "DFC_MOXEMM_SMU_ALM6_0" 842 "DFC_MOXEMM_SMU_ALM6_11" 843 "DFC_MOXEMM_SMU_ALM6_12" 844 "DFC_MOXEMM_SMU_ALM6_14" 845 "DFC_MOXEMM_SMU_ALM6_15" 846 "DFC_MOXEMM_SMU_ALM6_17" 847 "DFC_MOXEMM_SMU_ALM6_18" 848 "DFC_MOXEMM_SMU_ALM6_20" 849 "DFC_MOXEMM_SMU_ALM6_21" 850 "DFC_MOXEMM_SMU_ALM6_25" 851 "DFC_MOXEMM_SMU_ALM6_4" 852 "DFC_MOXEMM_SMU_ALM6_5" 853 "DFC_MOXEMM_SMU_ALM6_7" 854 "DFC_MOXEMM_SMU_ALM6_8" 855 "DFC_MOXEMM_SMU_ALM7_1" 856 "DFC_MOXEMM_SMU_ALM7_12" 857 "DFC_MOXEMM_SMU_ALM7_13" 858 "DFC_MOXEMM_SMU_ALM7_14" 859 "DFC_MOXEMM_SMU_ALM7_15" 860 "DFC_MOXEMM_SMU_ALM7_16" 861 "DFC_MOXEMM_SMU_ALM7_17" 862 "DFC_MOXEMM_SMU_ALM7_2" 863 "DFC_MOXEMM_SMU_ALM7_20" 864 "DFC_MOXEMM_SMU_ALM7_25" 865 "DFC_MOXEMM_SMU_ALM7_26" 866 "DFC_MOXEMM_SMU_ALM7_28" 867 "DFC_MOXEMM_SMU_ALM7_29" 868 "DFC_MOXEMM_SMU_ALM7_30" 869 "DFC_MOXEMM_SMU_ALM7_31" 870 "DFC_MOXEMM_SMU_ALM8_0" 871 "DFC_MOXEMM_SMU_ALM8_1" 872 "DFC_MOXEMM_SMU_ALM8_10" 873 "DFC_MOXEMM_SMU_ALM8_11" 874 "DFC_MOXEMM_SMU_ALM8_12" 875 "DFC_MOXEMM_SMU_ALM8_16" 876 "DFC_MOXEMM_SMU_ALM8_18" 877 "DFC_MOXEMM_SMU_ALM8_2" 878 "DFC_MOXEMM_SMU_ALM8_3" 879 "DFC_MOXEMM_SMU_ALM8_31" 880 "DFC_MOXEMM_SMU_ALM8_4" 881 "DFC_MOXEMM_SMU_ALM9_0" 882 "DFC_MOXEMM_SMU_ALM9_15" 883 "DFC_MOXEMM_SMU_ALM9_3" 884 "DFC_MoCADCNTPBnk1" 885 "DFC_MoCADCTestVoltBnk1" 886 "DFC_MoCSOPICO" 887 "DFC_MoFAccr" 888 "DFC_MoFCbnPreCdngOvrheat" 889 "DFC_MoFCbnPreCdngTmrExpi" 890 "DFC_MoFEvMngtBms" 891 "DFC_MoFEvMngtDcdc" 892 "DFC_MoFEvMngtEm01" 893 "DFC_MoFEvMngtEm01BrkgToZr" 894 "DFC_MoFEvMngtEm01EngSpd" 895 "DFC_MoFEvMngtEm02EngSpd" 896 "DFC_MoFEvMngtEm02Lvl1" 897 "DFC_MoFEvMngtEm02Lvl2" 898 "DFC_MoFExtCptAuxCpt" 899 "DFC_MoFExtCptVacPmpErr" 900 "DFC_MoFTqPtdAxle" 901 "DFC_MoFTqPtdAxleSec" 902 "DFC_MoFTqPtdEmPtRels" 903 "DFC_MoFTqPtdEmPtRelsSec" 904 "DFC_MoFTqPtdEmSign" 905 "DFC_MoFTqPtdEmSignSec" 906 "DFC_MoFTqPtdEmTq" 907 "DFC_MoFTqPtdEmTqSec" 908 "DFC_MoFTqPtdVeh" 909 "DFC_MoFVarPostBldSel" 910 "DFC_MoSysCtrlReIni" 911 "DFC_MoXEMMHwLTMCUFW" 912 "DFC_MoXEMMHwLTMonBIST" 913 "DFC_MoXEMMHwLTRegMonTest" 914 "DFC_MoXEMMHwLTStbySMUAlvTest" 915 "DFC_MoXEMMHwLTTempSens" 916 "DFC_MoXEMMHwLTUCBCfg" 917 "DFC_MonEgyChrgnCoorr_AcChrgnWoMofRels" 918 "DFC_MonEgyChrgnCoorr_ChrgnAbortIgr" 919 "DFC_MonEgyChrgnCoorr_DcCntctFailr" 920 "DFC_MonEgyChrgnCoorr_ExtChrgnShtOffReq" 921 "DFC_MonEgyChrgnCoorr_ImpsChrgnMod" 922 "DFC_MonEgyChrgnCoorr_ImpsChrgnPrms" 923 "DFC_MonEgyChrgnCoorr_ImpsUDcIntk" 924 "DFC_MonEgyChrgnCoorr_PlgLockMovmt" 925 "DFC_MonEgyChrgnCoorr_VehCrashDetn" 926 "DFC_MonEgyChrgnErrReactn_SftySwt" 927 "DFC_MonEgyChrgnInlet_CcsPlgCtp" 928 "DFC_MonEgyChrgnInlet_CcsPlgCtpPwm" 929 "DFC_MonEgyChrgnInlet_CcsPlgLockCtrlImpsAtmpt" 930 "DFC_MonEgyChrgnInlet_CcsPlgLockSnsrSigRngChk" 931 "DFC_MonEgyChrgnInlet_CcsPlgLockStImps" 932 "DFC_MonEgyChrgnInlet_CcsPlgPxp" 933 "DFC_MonEgyChrgnT_Snsr1GrdtChk" 934 "DFC_MonEgyChrgnT_Snsr1SigRngChk" 935 "DFC_MonEgyChrgnT_Snsr2GrdtChk" 936 "DFC_MonEgyChrgnT_Snsr2SigRngChk" 937 "DFC_MonEgyChrgnT_SnsrDif" 938 "DFC_OCWDAABEActv" 939 "DFC_OCWDACom" 940 "DFC_OCWDAErrPin" 941 "DFC_OCWDAOvrVltg" 942 "DFC_PUmax" 943 "DFC_PwmCtPTmpErr" 944 "DFC_PwrDistbnUnitTSRCMax" 945 "DFC_PwrDistbnUnitTTmpErr" 946 "DFC_SCtPmp1DiagGrdKeyErr" 947 "DFC_SRCHighAPP1" 948 "DFC_SRCHighAPP2" 949 "DFC_SRCLowAPP1" 950 "DFC_SRCLowAPP2" 951 "DFC_SWReset_0" 952 "DFC_SWReset_1" 953 "DFC_SWReset_2" 954 "DFC_Sia_InvldCode" 955 "DFC_Sia_InvldKey" 956 "DFC_Sia_NoRespUCx" 957 "DFC_Sia_TprotRttp" 958 "DFC_StrtUpEvStandStillDeactvn" 959 "DFC_SyncAPP" 960 "DFC_UCtPSRCMax" 961 "DFC_UCtPTmpErr" 962 "DFC_UPxP1SRCMax" 963 "DFC_UPxP1TmpErr" 964 "DFC_VehVObd" 965 "DSQ_ACCmprPwrConsol" 966 "DSQ_ACCmprUConsol" 967 "DSQ_BattU" 968 "DSQ_DSMInhibitAlways" 969 "DSQ_T15TurnOfDly" 65535 "Inhibited_Trip" DEFAULT_VALUE "---" /end COMPU_VTAB
/begin COMPU_METHOD DFC_OneToOne "" RAT_FUNC "%6.2" "-" COEFFS 0 1 0 0 0 1 /end COMPU_METHOD
/begin COMPU_METHOD DINH_ct_Compu "" RAT_FUNC "%6.0" "" COEFFS 0 -1 4096 0 0 1 /end COMPU_METHOD
/begin COMPU_METHOD OneToOne "" RAT_FUNC "%6.2" "-" COEFFS 0 1 0 0 0 1 /end COMPU_METHOD
/end MODULE
/end PROJECT

ASAP2_VERSION 1 70
/begin PROJECT MDG1C "VC1CP091_STLA_N_D061I3"
/begin HEADER "" VERSION "VC1CP091_STLA_N_D061I3" PROJECT_NO MDG1C /end HEADER
/begin MODULE DIM ""
/begin MOD_COMMON "" BYTE_ORDER MSB_LAST ALIGNMENT_BYTE 1 ALIGNMENT_WORD 2 ALIGNMENT_LONG 4 ALIGNMENT_INT64 4 ALIGNMENT_FLOAT32_IEEE 4 ALIGNMENT_FLOAT64_IEEE 4 DATA_SIZE 32 /end MOD_COMMON
/begin CHARACTERISTIC DFES_EnvRef.DFC_HvBattSrvPlgDiscnct_C "" VALUE 0x8024DACD Val_Wu8 29.0000000000 DFES_EnvTabVerb 0.00 29.0000000000 FORMAT "%13.10" /end CHARACTERISTIC
/begin CHARACTERISTIC DFES_EnvRef.DFC_HvBattUNomChrgnErr_C "" VALUE 0x8024DACE Val_Wu8 29.0000000000 DFES_EnvTabVerb 0.00 29.0000000000 FORMAT "%13.10" /end CHARACTERISTIC
/begin CHARACTERISTIC DFES_EnvRef.DFC_HvBattUNomChrgnIni_C "" VALUE 0x8024DACF Val_Wu8 29.0000000000 DFES_EnvTabVerb 0.00 29.0000000000 FORMAT "%13.10" /end CHARACTERISTIC
/begin CHARACTERISTIC DFES_EnvRef.DFC_HvBattUnderTDern_C "" VALUE 0x8024DAD0 Val_Wu8 29.0000000000 DFES_EnvTabVerb 0.00 29.0000000000 FORMAT "%13.10" /end CHARACTERISTIC
/begin CHARACTERISTIC DFES_EnvRef.DFC_HvbEVLmpBlink_C "" VALUE 0x8024DAD1 Val_Wu8 29.0000000000 DFES_EnvTabVerb 0.00 29.0000000000 FORMAT "%13.10" /end CHARACTERISTIC
/begin CHARACTERISTIC DFES_EnvRef.DFC_HvbEVLmpCont_C "" VALUE 0x8024DAD2 Val_Wu8 29.0000000000 DFES_EnvTabVerb 0.00 29.0000000000 FORMAT "%13.10" /end CHARACTERISTIC
/begin CHARACTERISTIC DFES_EnvRef.DFC_HvbSVSBlink_C "" VALUE 0x8024DAD3 Val_Wu8 29.0000000000 DFES_EnvTabVerb 0.00 29.0000000000 FORMAT "%13.10" /end CHARACTERISTIC
/begin CHARACTERISTIC DFES_EnvRef.DFC_HvbSVSCont_C "" VALUE 0x8024DAD4 Val_Wu8 29.0000000000 DFES_EnvTabVerb 0.00 29.0000000000 FORMAT "%13.10" /end CHARACTERISTIC
/begin CHARACTERISTIC DFES_EnvRef.DFC_InmLINBusBlk_C "" VALUE 0x8024DAD5 Val_Wu8 29.0000000000 DFES_EnvTabVerb 0.00 29.0000000000 FORMAT "%13.10" /end CHARACTERISTIC
/begin CHARACTERISTIC DFES_EnvRef.DFC_PDUProgmFailr_C "" VALUE 0x8024DAD6 Val_Wu8 29.0000000000 DFES_EnvTabVerb 0.00 29.0000000000 FORMAT "%13.10" /end CHARACTERISTIC
/begin CHARACTERISTIC DFES_EnvRef.DFC_PEnvSigRngMax_C "" VALUE 0x8024DAD7 Val_Wu8 29.0000000000 DFES_EnvTabVerb 0.00 29.0000000000 FORMAT "%13.10" /end CHARACTERISTIC
/begin CHARACTERISTIC DFES_EnvRef.DFC_PEnvSigRngMin_C "" VALUE 0x8024DAD8 Val_Wu8 29.0000000000 DFES_EnvTabVerb 0.00 29.0000000000 FORMAT "%13.10" /end CHARACTERISTIC
/begin CHARACTERISTIC DFES_EnvRef.DFC_PLnCChpDeactvnFaild_C "" VALUE 0x8024DAD9 Val_Wu8 29.0000000000 DFES_EnvTabVerb 0.00 29.0000000000 FORMAT "%13.10" /end CHARACTERISTIC
/begin CHARACTERISTIC DFES_EnvRef.DFC_PrkgBrkFailr_C "" VALUE 0x8024DADA Val_Wu8 29.0000000000 DFES_EnvTabVerb 0.00 29.0000000000 FORMAT "%13.10" /end CHARACTERISTIC
/begin CHARACTERISTIC DFES_EnvRef.DFC_PtSysLimErr_C "" VALUE 0x8024DADB Val_Wu8 29.0000000000 DFES_EnvTabVerb 0.00 29.0000000000 FORMAT "%13.10" /end CHARACTERISTIC
/begin CHARACTERISTIC DFES_EnvRef.DFC_PwrMaxDchaShoLo_C "" VALUE 0x8024DADC Val_Wu8 29.0000000000 DFES_EnvTabVerb 0.00 29.0000000000 FORMAT "%13.10" /end CHARACTERISTIC
/begin CHARACTERISTIC DFES_EnvRef.DFC_SCtPmp1FailSafeNotSuc_C "" VALUE 0x8024DADD Val_Wu8 29.0000000000 DFES_EnvTabVerb 0.00 29.0000000000 FORMAT "%13.10" /end CHARACTERISTIC
/begin CHARACTERISTIC DFES_EnvRef.DFC_SCtPmp1SCG_C "" VALUE 0x8024DADE Val_Wu8 29.0000000000 DFES_EnvTabVerb 0.00 29.0000000000 FORMAT "%13.10" /end CHARACTERISTIC
/begin CHARACTERISTIC DFES_EnvRef.DFC_VehCoornDrvrNotPrsnt_C "" VALUE 0x8024DADF Val_Wu8 29.0000000000 DFES_EnvTabVerb 0.00 29.0000000000 FORMAT "%13.10" /end CHARACTERISTIC
/begin CHARACTERISTIC DFES_EnvRef.DFC_VehVCanAvl_C "" VALUE 0x8024DAE0 Val_Wu8 29.0000000000 DFES_EnvTabVerb 0.00 29.0000000000 FORMAT "%13.10" /end CHARACTERISTIC
/begin CHARACTERISTIC DFES_EnvRef.DFC_VehVCanErr_C "" VALUE 0x8024DAE1 Val_Wu8 29.0000000000 DFES_EnvTabVerb 0.00 29.0000000000 FORMAT "%13.10" /end CHARACTERISTIC
/begin CHARACTERISTIC DFES_EnvRef.DFC_eTogFailrLvlRes_C "" VALUE 0x8024DAE2 Val_Wu8 29.0000000000 DFES_EnvTabVerb 0.00 29.0000000000 FORMAT "%13.10" /end CHARACTERISTIC
/begin CHARACTERISTIC DFES_EnvRef.DFC_flgBrkMaiDiag_C "" VALUE 0x8024DAE3 Val_Wu8 29.0000000000 DFES_EnvTabVerb 0.00 29.0000000000 FORMAT "%13.10" /end CHARACTERISTIC
/begin CHARACTERISTIC DFES_EnvRef.DFC_stHvbIsoMeasmtRes_C "" VALUE 0x8024DAE4 Val_Wu8 29.0000000000 DFES_EnvTabVerb 0.00 29.0000000000 FORMAT "%13.10" /end CHARACTERISTIC
/begin CHARACTERISTIC DFES_EnvRef.DFC_BrkBstPmpPLeakDfct_C "" VALUE 0x8024DAE5 Val_Wu8 29.0000000000 DFES_EnvTabVerb 0.00 29.0000000000 FORMAT "%13.10" /end CHARACTERISTIC
/begin CHARACTERISTIC DFES_EnvRef.DFC_Com082hTooShort_C "" VALUE 0x8024DAE6 Val_Wu8 29.0000000000 DFES_EnvTabVerb 0.00 29.0000000000 FORMAT "%13.10" /end CHARACTERISTIC
/begin CHARACTERISTIC DFES_EnvRef.DFC_Com092hTooShort_C "" VALUE 0x8024DAE7 Val_Wu8 29.0000000000 DFES_EnvTabVerb 0.00 29.0000000000 FORMAT "%13.10" /end CHARACTERISTIC
/begin CHARACTERISTIC DFES_EnvRef.DFC_Com205hAbsent_C "" VALUE 0x8024DAE8 Val_Wu8 29.0000000000 DFES_EnvTabVerb 0.00 29.0000000000 FORMAT "%13.10" /end CHARACTERISTIC
/begin CHARACTERISTIC DFES_EnvRef.DFC_Com205hChecksum_C "" VALUE 0x8024DAE9 Val_Wu8 29.0000000000 DFES_EnvTabVerb 0.00 29.0000000000 FORMAT "%13.10" /end CHARACTERISTIC
/begin CHARACTERISTIC DFES_EnvRef.DFC_Com205hCounter_C "" VALUE 0x8024DAEA Val_Wu8 29.0000000000 DFES_EnvTabVerb 0.00 29.0000000000 FORMAT "%13.10" /end CHARACTERISTIC
/begin CHARACTERISTIC DFES_EnvRef.DFC_Com205hTooShort_C "" VALUE 0x8024DAEB Val_Wu8 29.0000000000 DFES_EnvTabVerb 0.00 29.0000000000 FORMAT "%13.10" /end CHARACTERISTIC
/begin CHARACTERISTIC DFES_EnvRef.DFC_Com217hAbsent_C "" VALUE 0x8024DAEC Val_Wu8 29.0000000000 DFES_EnvTabVerb 0.00 29.0000000000 FORMAT "%13.10" /end CHARACTERISTIC
/begin CHARACTERISTIC DFES_EnvRef.DFC_Com217hChecksum_C "" VALUE 0x8024DAED Val_Wu8 29.0000000000 DFES_EnvTabVerb 0.00 29.0000000000 FORMAT "%13.10" /end CHARACTERISTIC
/begin CHARACTERISTIC DFES_EnvRef.DFC_Com217hCounter_C "" VALUE 0x8024DAEE Val_Wu8 29.0000000000 DFES_EnvTabVerb 0.00 29.0000000000 FORMAT "%13.10" /end CHARACTERISTIC
/begin CHARACTERISTIC DFES_EnvRef.DFC_Com217hTooShort_C "" VALUE 0x8024DAEF Val_Wu8 29.0000000000 DFES_EnvTabVerb 0.00 29.0000000000 FORMAT "%13.10" /end CHARACTERISTIC
/begin CHARACTERISTIC DFES_EnvRef.DFC_Com227hAbsent_C "" VALUE 0x8024DAF0 Val_Wu8 29.0000000000 DFES_EnvTabVerb 0.00 29.0000000000 FORMAT "%13.10" /end CHARACTERISTIC
/begin CHARACTERISTIC DFES_EnvRef.DFC_Com227hTooShort_C "" VALUE 0x8024DAF1 Val_Wu8 29.0000000000 DFES_EnvTabVerb 0.00 29.0000000000 FORMAT "%13.10" /end CHARACTERISTIC
/begin CHARACTERISTIC DFES_EnvRef.DFC_Com237hAbsent_C "" VALUE 0x8024DAF2 Val_Wu8 29.0000000000 DFES_EnvTabVerb 0.00 29.0000000000 FORMAT "%13.10" /end CHARACTERISTIC
/begin CHARACTERISTIC DFES_EnvRef.DFC_Com237hChecksum_C "" VALUE 0x8024DAF3 Val_Wu8 29.0000000000 DFES_EnvTabVerb 0.00 29.0000000000 FORMAT "%13.10" /end CHARACTERISTIC
/begin CHARACTERISTIC DFES_EnvRef.DFC_Com237hCounter_C "" VALUE 0x8024DAF4 Val_Wu8 29.0000000000 DFES_EnvTabVerb 0.00 29.0000000000 FORMAT "%13.10" /end CHARACTERISTIC
/begin CHARACTERISTIC DFES_EnvRef.DFC_Com237hTooShort_C "" VALUE 0x8024DAF5 Val_Wu8 29.0000000000 DFES_EnvTabVerb 0.00 29.0000000000 FORMAT "%13.10" /end CHARACTERISTIC
/begin CHARACTERISTIC DFES_EnvRef.DFC_Com259hAbsent_C "" VALUE 0x8024DAF6 Val_Wu8 29.0000000000 DFES_EnvTabVerb 0.00 29.0000000000 FORMAT "%13.10" /end CHARACTERISTIC
/begin CHARACTERISTIC DFES_EnvRef.DFC_Com259hChecksum_C "" VALUE 0x8024DAF7 Val_Wu8 29.0000000000 DFES_EnvTabVerb 0.00 29.0000000000 FORMAT "%13.10" /end CHARACTERISTIC
/begin CHARACTERISTIC DFES_EnvRef.DFC_Com259hCounter_C "" VALUE 0x8024DAF8 Val_Wu8 29.0000000000 DFES_EnvTabVerb 0.00 29.0000000000 FORMAT "%13.10" /end CHARACTERISTIC
/begin CHARACTERISTIC DFES_EnvRef.DFC_Com259hTooShort_C "" VALUE 0x8024DAF9 Val_Wu8 29.0000000000 DFES_EnvTabVerb 0.00 29.0000000000 FORMAT "%13.10" /end CHARACTERISTIC
/begin CHARACTERISTIC DFES_EnvRef.DFC_Com26hAbsent_C "" VALUE 0x8024DAFA Val_Wu8 29.0000000000 DFES_EnvTabVerb 0.00 29.0000000000 FORMAT "%13.10" /end CHARACTERISTIC
/begin CHARACTERISTIC DFES_EnvRef.DFC_Com26hTooShort_C "" VALUE 0x8024DAFB Val_Wu8 29.0000000000 DFES_EnvTabVerb 0.00 29.0000000000 FORMAT "%13.10" /end CHARACTERISTIC
/begin CHARACTERISTIC DFES_EnvRef.DFC_Com273hAbsent_C "" VALUE 0x8024DAFC Val_Wu8 29.0000000000 DFES_EnvTabVerb 0.00 29.0000000000 FORMAT "%13.10" /end CHARACTERISTIC
/begin CHARACTERISTIC DFES_EnvRef.DFC_Com273hChecksum_C "" VALUE 0x8024DAFD Val_Wu8 29.0000000000 DFES_EnvTabVerb 0.00 29.0000000000 FORMAT "%13.10" /end CHARACTERISTIC
/begin CHARACTERISTIC DFES_EnvRef.DFC_Com273hCounter_C "" VALUE 0x8024DAFE Val_Wu8 29.0000000000 DFES_EnvTabVerb 0.00 29.0000000000 FORMAT "%13.10" /end CHARACTERISTIC
/begin CHARACTERISTIC DFES_EnvRef.DFC_Com273hTooShort_C "" VALUE 0x8024DAFF Val_Wu8 29.0000000000 DFES_EnvTabVerb 0.00 29.0000000000 FORMAT "%13.10" /end CHARACTERISTIC
/begin CHARACTERISTIC DFES_EnvRef.DFC_Com275hAbsent_C "" VALUE 0x8024DB00 Val_Wu8 29.0000000000 DFES_EnvTabVerb 0.00 29.0000000000 FORMAT "%13.10" /end CHARACTERISTIC
/begin CHARACTERISTIC DFES_EnvRef.DFC_Com275hChecksum_C "" VALUE 0x8024DB01 Val_Wu8 29.0000000000 DFES_EnvTabVerb 0.00 29.0000000000 FORMAT "%13.10" /end CHARACTERISTIC
/begin CHARACTERISTIC DFES_EnvRef.DFC_Com275hCounter_C "" VALUE 0x8024DB02 Val_Wu8 29.0000000000 DFES_EnvTabVerb 0.00 29.0000000000 FORMAT "%13.10" /end CHARACTERISTIC
/begin CHARACTERISTIC DFES_EnvRef.DFC_Com275hTooShort_C "" VALUE 0x8024DB03 Val_Wu8 29.0000000000 DFES_EnvTabVerb 0.00 29.0000000000 FORMAT "%13.10" /end CHARACTERISTIC
/begin CHARACTERISTIC DFES_EnvRef.DFC_Com283hAbsent_C "" VALUE 0x8024DB04 Val_Wu8 29.0000000000 DFES_EnvTabVerb 0.00 29.0000000000 FORMAT "%13.10" /end CHARACTERISTIC
/begin CHARACTERISTIC DFES_EnvRef.DFC_Com283hTooShort_C "" VALUE 0x8024DB05 Val_Wu8 29.0000000000 DFES_EnvTabVerb 0.00 29.0000000000 FORMAT "%13.10" /end CHARACTERISTIC
/begin CHARACTERISTIC DFES_EnvRef.DFC_Com285hAbsent_C "" VALUE 0x8024DB06 Val_Wu8 29.0000000000 DFES_EnvTabVerb 0.00 29.0000000000 FORMAT "%13.10" /end CHARACTERISTIC
/begin CHARACTERISTIC DFES_EnvRef.DFC_Com285hChecksum_C "" VALUE 0x8024DB07 Val_Wu8 29.0000000000 DFES_EnvTabVerb 0.00 29.0000000000 FORMAT "%13.10" /end CHARACTERISTIC
/begin CHARACTERISTIC DFES_EnvRef.DFC_Com285hCounter_C "" VALUE 0x8024DB08 Val_Wu8 29.0000000000 DFES_EnvTabVerb 0.00 29.0000000000 FORMAT "%13.10" /end CHARACTERISTIC
/begin CHARACTERISTIC DFES_EnvRef.DFC_Com285hTooShort_C "" VALUE 0x8024DB09 Val_Wu8 29.0000000000 DFES_EnvTabVerb 0.00 29.0000000000 FORMAT "%13.10" /end CHARACTERISTIC
/begin CHARACTERISTIC DFES_EnvRef.DFC_Com293hAbsent_C "" VALUE 0x8024DB0A Val_Wu8 29.0000000000 DFES_EnvTabVerb 0.00 29.0000000000 FORMAT "%13.10" /end CHARACTERISTIC
/begin CHARACTERISTIC DFES_EnvRef.DFC_Com293hChecksum_C "" VALUE 0x8024DB0B Val_Wu8 29.0000000000 DFES_EnvTabVerb 0.00 29.0000000000 FORMAT "%13.10" /end CHARACTERISTIC
/begin CHARACTERISTIC DFES_EnvRef.DFC_Com293hCounter_C "" VALUE 0x8024DB0C Val_Wu8 29.0000000000 DFES_EnvTabVerb 0.00 29.0000000000 FORMAT "%13.10" /end CHARACTERISTIC
/begin CHARACTERISTIC DFES_EnvRef.DFC_Com293hTooShort_C "" VALUE 0x8024DB0D Val_Wu8 29.0000000000 DFES_EnvTabVerb 0.00 29.0000000000 FORMAT "%13.10" /end CHARACTERISTIC
/begin CHARACTERISTIC DFES_EnvRef.DFC_Com308hAbsent_C "" VALUE 0x8024DB0E Val_Wu8 29.0000000000 DFES_EnvTabVerb 0.00 29.0000000000 FORMAT "%13.10" /end CHARACTERISTIC
/begin CHARACTERISTIC DFES_EnvRef.DFC_Com308hChecksum_C "" VALUE 0x8024DB0F Val_Wu8 29.0000000000 DFES_EnvTabVerb 0.00 29.0000000000 FORMAT "%13.10" /end CHARACTERISTIC
/begin CHARACTERISTIC DFES_EnvRef.DFC_Com308hCounter_C "" VALUE 0x8024DB10 Val_Wu8 29.0000000000 DFES_EnvTabVerb 0.00 29.0000000000 FORMAT "%13.10" /end CHARACTERISTIC
/begin CHARACTERISTIC DFES_EnvRef.DFC_Com308hTooShort_C "" VALUE 0x8024DB11 Val_Wu8 29.0000000000 DFES_EnvTabVerb 0.00 29.0000000000 FORMAT "%13.10" /end CHARACTERISTIC
/begin CHARACTERISTIC DFES_EnvRef.DFC_Com318hAbsent_C "" VALUE 0x8024DB12 Val_Wu8 29.0000000000 DFES_EnvTabVerb 0.00 29.0000000000 FORMAT "%13.10" /end CHARACTERISTIC
/begin CHARACTERISTIC DFES_EnvRef.DFC_Com318hChecksum_C "" VALUE 0x8024DB13 Val_Wu8 29.0000000000 DFES_EnvTabVerb 0.00 29.0000000000 FORMAT "%13.10" /end CHARACTERISTIC
/begin CHARACTERISTIC DFES_EnvRef.DFC_Com318hCounter_C "" VALUE 0x8024DB14 Val_Wu8 29.0000000000 DFES_EnvTabVerb 0.00 29.0000000000 FORMAT "%13.10" /end CHARACTERISTIC
/begin CHARACTERISTIC DFES_EnvRef.DFC_Com318hTooShort_C "" VALUE 0x8024DB15 Val_Wu8 29.0000000000 DFES_EnvTabVerb 0.00 29.0000000000 FORMAT "%13.10" /end CHARACTERISTIC
/begin CHARACTERISTIC DFES_EnvRef.DFC_Com325hAbsent_C "" VALUE 0x8024DB16 Val_Wu8 29.0000000000 DFES_EnvTabVerb 0.00 29.0000000000 FORMAT "%13.10" /end CHARACTERISTIC
/begin CHARACTERISTIC DFES_EnvRef.DFC_Com325hChecksum_C "" VALUE 0x8024DB17 Val_Wu8 29.0000000000 DFES_EnvTabVerb 0.00 29.0000000000 FORMAT "%13.10" /end CHARACTERISTIC
/begin CHARACTERISTIC DFES_EnvRef.DFC_Com325hCounter_C "" VALUE 0x8024DB18 Val_Wu8 29.0000000000 DFES_EnvTabVerb 0.00 29.0000000000 FORMAT "%13.10" /end CHARACTERISTIC
/begin CHARACTERISTIC DFES_EnvRef.DFC_Com325hTooShort_C "" VALUE 0x8024DB19 Val_Wu8 29.0000000000 DFES_EnvTabVerb 0.00 29.0000000000 FORMAT "%13.10" /end CHARACTERISTIC
/begin CHARACTERISTIC DFES_EnvRef.DFC_Com335hAbsent_C "" VALUE 0x8024DB1A Val_Wu8 29.0000000000 DFES_EnvTabVerb 0.00 29.0000000000 FORMAT "%13.10" /end CHARACTERISTIC
/begin CHARACTERISTIC DFES_EnvRef.DFC_Com335hChecksum_C "" VALUE 0x8024DB1B Val_Wu8 29.0000000000 DFES_EnvTabVerb 0.00 29.0000000000 FORMAT "%13.10" /end CHARACTERISTIC
/begin CHARACTERISTIC DFES_EnvRef.DFC_Com335hCounter_C "" VALUE 0x8024DB1C Val_Wu8 29.0000000000 DFES_EnvTabVerb 0.00 29.0000000000 FORMAT "%13.10" /end CHARACTERISTIC
/begin CHARACTERISTIC DFES_EnvRef.DFC_Com335hTooShort_C "" VALUE 0x8024DB1D Val_Wu8 29.0000000000 DFES_EnvTabVerb 0.00 29.0000000000 FORMAT "%13.10" /end CHARACTERISTIC
/begin CHARACTERISTIC DFES_EnvRef.DFC_Com351hAbsent_C "" VALUE 0x8024DB1E Val_Wu8 29.0000000000 DFES_EnvTabVerb 0.00 29.0000000000 FORMAT "%13.10" /end CHARACTERISTIC
/begin CHARACTERISTIC DFES_EnvRef.DFC_Com351hTooShort_C "" VALUE 0x8024DB1F Val_Wu8 29.0000000000 DFES_EnvTabVerb 0.00 29.0000000000 FORMAT "%13.10" /end CHARACTERISTIC
/begin CHARACTERISTIC DFES_EnvRef.DFC_Com38DhAbsent_C "" VALUE 0x8024DB20 Val_Wu8 29.0000000000 DFES_EnvTabVerb 0.00 29.0000000000 FORMAT "%13.10" /end CHARACTERISTIC
/begin CHARACTERISTIC DFES_EnvRef.DFC_Com38DhChecksum_C "" VALUE 0x8024DB21 Val_Wu8 29.0000000000 DFES_EnvTabVerb 0.00 29.0000000000 FORMAT "%13.10" /end CHARACTERISTIC
/begin CHARACTERISTIC DFES_EnvRef.DFC_Com38DhCounter_C "" VALUE 0x8024DB22 Val_Wu8 29.0000000000 DFES_EnvTabVerb 0.00 29.0000000000 FORMAT "%13.10" /end CHARACTERISTIC
/begin CHARACTERISTIC DFES_EnvRef.DFC_Com38DhTooShort_C "" VALUE 0x8024DB23 Val_Wu8 29.0000000000 DFES_EnvTabVerb 0.00 29.0000000000 FORMAT "%13.10" /end CHARACTERISTIC
/begin CHARACTERISTIC DFES_EnvRef.DFC_Com412hAbsent_C "" VALUE 0x8024DB24 Val_Wu8 29.0000000000 DFES_EnvTabVerb 0.00 29.0000000000 FORMAT "%13.10" /end CHARACTERISTIC
/begin CHARACTERISTIC DFES_EnvRef.DFC_Com412hChecksum_C "" VALUE 0x8024DB25 Val_Wu8 29.0000000000 DFES_EnvTabVerb 0.00 29.0000000000 FORMAT "%13.10" /end CHARACTERISTIC
/begin CHARACTERISTIC DFES_EnvRef.DFC_Com412hCounter_C "" VALUE 0x8024DB26 Val_Wu8 29.0000000000 DFES_EnvTabVerb 0.00 29.0000000000 FORMAT "%13.10" /end CHARACTERISTIC
/begin CHARACTERISTIC DFES_EnvRef.DFC_Com412hTooShort_C "" VALUE 0x8024DB27 Val_Wu8 29.0000000000 DFES_EnvTabVerb 0.00 29.0000000000 FORMAT "%13.10" /end CHARACTERISTIC
/begin CHARACTERISTIC DFES_EnvRef.DFC_Com427hAbsent_C "" VALUE 0x8024DB28 Val_Wu8 29.0000000000 DFES_EnvTabVerb 0.00 29.0000000000 FORMAT "%13.10" /end CHARACTERISTIC
/begin CHARACTERISTIC DFES_EnvRef.DFC_Com427hTooShort_C "" VALUE 0x8024DB29 Val_Wu8 29.0000000000 DFES_EnvTabVerb 0.00 29.0000000000 FORMAT "%13.10" /end CHARACTERISTIC
/begin CHARACTERISTIC DFES_EnvRef.DFC_Com432hAbsent_C "" VALUE 0x8024DB2A Val_Wu8 29.0000000000 DFES_EnvTabVerb 0.00 29.0000000000 FORMAT "%13.10" /end CHARACTERISTIC
/begin CHARACTERISTIC DFES_EnvRef.DFC_Com432hChecksum_C "" VALUE 0x8024DB2B Val_Wu8 29.0000000000 DFES_EnvTabVerb 0.00 29.0000000000 FORMAT "%13.10" /end CHARACTERISTIC
/begin CHARACTERISTIC DFES_EnvRef.DFC_Com432hCounter_C "" VALUE 0x8024DB2C Val_Wu8 29.0000000000 DFES_EnvTabVerb 0.00 29.0000000000 FORMAT "%13.10" /end CHARACTERISTIC
/begin CHARACTERISTIC DFES_EnvRef.DFC_Com432hTooShort_C "" VALUE 0x8024DB2D Val_Wu8 29.0000000000 DFES_EnvTabVerb 0.00 29.0000000000 FORMAT "%13.10" /end CHARACTERISTIC
/begin CHARACTERISTIC DFES_EnvRef.DFC_Com435hAbsent_C "" VALUE 0x8024DB2E Val_Wu8 29.0000000000 DFES_EnvTabVerb 0.00 29.0000000000 FORMAT "%13.10" /end CHARACTERISTIC
/begin CHARACTERISTIC DFES_EnvRef.DFC_Com435hTooShort_C "" VALUE 0x8024DB2F Val_Wu8 29.0000000000 DFES_EnvTabVerb 0.00 29.0000000000 FORMAT "%13.10" /end CHARACTERISTIC
/begin CHARACTERISTIC DFES_EnvRef.DFC_Com442hAbsent_C "" VALUE 0x8024DB30 Val_Wu8 29.0000000000 DFES_EnvTabVerb 0.00 29.0000000000 FORMAT "%13.10" /end CHARACTERISTIC
/begin CHARACTERISTIC DFES_EnvRef.DFC_Com442hTooShort_C "" VALUE 0x8024DB31 Val_Wu8 29.0000000000 DFES_EnvTabVerb 0.00 29.0000000000 FORMAT "%13.10" /end CHARACTERISTIC
/begin CHARACTERISTIC DFES_EnvRef.DFC_Com453hAbsent_C "" VALUE 0x8024DB32 Val_Wu8 29.0000000000 DFES_EnvTabVerb 0.00 29.0000000000 FORMAT "%13.10" /end CHARACTERISTIC
/begin CHARACTERISTIC DFES_EnvRef.DFC_Com453hTooShort_C "" VALUE 0x8024DB33 Val_Wu8 29.0000000000 DFES_EnvTabVerb 0.00 29.0000000000 FORMAT "%13.10" /end CHARACTERISTIC
/begin CHARACTERISTIC DFES_EnvRef.DFC_Com455hAbsent_C "" VALUE 0x8024DB34 Val_Wu8 29.0000000000 DFES_EnvTabVerb 0.00 29.0000000000 FORMAT "%13.10" /end CHARACTERISTIC
/begin CHARACTERISTIC DFES_EnvRef.DFC_Com455hTooShort_C "" VALUE 0x8024DB35 Val_Wu8 29.0000000000 DFES_EnvTabVerb 0.00 29.0000000000 FORMAT "%13.10" /end CHARACTERISTIC
/begin CHARACTERISTIC DFES_EnvRef.DFC_Com463hAbsent_C "" VALUE 0x8024DB36 Val_Wu8 29.0000000000 DFES_EnvTabVerb 0.00 29.0000000000 FORMAT "%13.10" /end CHARACTERISTIC
/begin CHARACTERISTIC DFES_EnvRef.DFC_Com463hTooShort_C "" VALUE 0x8024DB37 Val_Wu8 29.0000000000 DFES_EnvTabVerb 0.00 29.0000000000 FORMAT "%13.10" /end CHARACTERISTIC
/begin CHARACTERISTIC DFES_EnvRef.DFC_Com473hAbsent_C "" VALUE 0x8024DB38 Val_Wu8 29.0000000000 DFES_EnvTabVerb 0.00 29.0000000000 FORMAT "%13.10" /end CHARACTERISTIC
/begin CHARACTERISTIC DFES_EnvRef.DFC_Com473hTooShort_C "" VALUE 0x8024DB39 Val_Wu8 29.0000000000 DFES_EnvTabVerb 0.00 29.0000000000 FORMAT "%13.10" /end CHARACTERISTIC
/begin CHARACTERISTIC DFES_EnvRef.DFC_Com47BhAbsent_C "" VALUE 0x8024DB3A Val_Wu8 29.0000000000 DFES_EnvTabVerb 0.00 29.0000000000 FORMAT "%13.10" /end CHARACTERISTIC
/begin CHARACTERISTIC DFES_EnvRef.DFC_Com47BhTooShort_C "" VALUE 0x8024DB3B Val_Wu8 29.0000000000 DFES_EnvTabVerb 0.00 29.0000000000 FORMAT "%13.10" /end CHARACTERISTIC
/begin CHARACTERISTIC DFES_EnvRef.DFC_Com48BhAbsent_C "" VALUE 0x8024DB3C Val_Wu8 29.0000000000 DFES_EnvTabVerb 0.00 29.0000000000 FORMAT "%13.10" /end CHARACTERISTIC
/begin CHARACTERISTIC DFES_EnvRef.DFC_Com48BhTooShort_C "" VALUE 0x8024DB3D Val_Wu8 29.0000000000 DFES_EnvTabVerb 0.00 29.0000000000 FORMAT "%13.10" /end CHARACTERISTIC
/begin CHARACTERISTIC DFES_EnvRef.DFC_Com497hTooShort_C "" VALUE 0x8024DB3E Val_Wu8 29.0000000000 DFES_EnvTabVerb 0.00 29.0000000000 FORMAT "%13.10" /end CHARACTERISTIC
/begin CHARACTERISTIC DFES_EnvRef.DFC_Com4F2hAbsent_C "" VALUE 0x8024DB3F Val_Wu8 29.0000000000 DFES_EnvTabVerb 0.00 29.0000000000 FORMAT "%13.10" /end CHARACTERISTIC
/begin CHARACTERISTIC DFES_EnvRef.DFC_Com4F2hChecksum_C "" VALUE 0x8024DB40 Val_Wu8 29.0000000000 DFES_EnvTabVerb 0.00 29.0000000000 FORMAT "%13.10" /end CHARACTERISTIC
/begin CHARACTERISTIC DFES_EnvRef.DFC_Com4F2hCounter_C "" VALUE 0x8024DB41 Val_Wu8 29.0000000000 DFES_EnvTabVerb 0.00 29.0000000000 FORMAT "%13.10" /end CHARACTERISTIC
/begin CHARACTERISTIC DFES_EnvRef.DFC_Com4F2hTooShort_C "" VALUE 0x8024DB42 Val_Wu8 29.0000000000 DFES_EnvTabVerb 0.00 29.0000000000 FORMAT "%13.10" /end CHARACTERISTIC
/begin CHARACTERISTIC DFES_EnvRef.DFC_Com50DhAbsent_C "" VALUE 0x8024DB43 Val_Wu8 29.0000000000 DFES_EnvTabVerb 0.00 29.0000000000 FORMAT "%13.10" /end CHARACTERISTIC
/begin CHARACTERISTIC DFES_EnvRef.DFC_Com50DhTooShort_C "" VALUE 0x8024DB44 Val_Wu8 29.0000000000 DFES_EnvTabVerb 0.00 29.0000000000 FORMAT "%13.10" /end CHARACTERISTIC
/begin CHARACTERISTIC DFES_EnvRef.DFC_Com535hAbsent_C "" VALUE 0x8024DB45 Val_Wu8 29.0000000000 DFES_EnvTabVerb 0.00 29.0000000000 FORMAT "%13.10" /end CHARACTERISTIC
/begin CHARACTERISTIC DFES_EnvRef.DFC_Com535hTooShort_C "" VALUE 0x8024DB46 Val_Wu8 29.0000000000 DFES_EnvTabVerb 0.00 29.0000000000 FORMAT "%13.10" /end CHARACTERISTIC
/begin CHARACTERISTIC DFES_EnvRef.DFC_Com543hAbsent_C "" VALUE 0x8024DB47 Val_Wu8 29.0000000000 DFES_EnvTabVerb 0.00 29.0000000000 FORMAT "%13.10" /end CHARACTERISTIC
/begin CHARACTERISTIC DFES_EnvRef.DFC_Com543hTooShort_C "" VALUE 0x8024DB48 Val_Wu8 29.0000000000 DFES_EnvTabVerb 0.00 29.0000000000 FORMAT "%13.10" /end CHARACTERISTIC
/begin CHARACTERISTIC DFES_EnvRef.DFC_Com552hAbsent_C "" VALUE 0x8024DB49 Val_Wu8 29.0000000000 DFES_EnvTabVerb 0.00 29.0000000000 FORMAT "%13.10" /end CHARACTERISTIC
/begin CHARACTERISTIC DFES_EnvRef.DFC_Com552hTooShort_C "" VALUE 0x8024DB4A Val_Wu8 29.0000000000 DFES_EnvTabVerb 0.00 29.0000000000 FORMAT "%13.10" /end CHARACTERISTIC
/begin CHARACTERISTIC DFES_EnvRef.DFC_Com583hAbsent_C "" VALUE 0x8024DB4B Val_Wu8 29.0000000000 DFES_EnvTabVerb 0.00 29.0000000000 FORMAT "%13.10" /end CHARACTERISTIC
/begin CHARACTERISTIC DFES_EnvRef.DFC_Com583hTooShort_C "" VALUE 0x8024DB4C Val_Wu8 29.0000000000 DFES_EnvTabVerb 0.00 29.0000000000 FORMAT "%13.10" /end CHARACTERISTIC
/begin CHARACTERISTIC DFES_EnvRef.DFC_Com592hAbsent_C "" VALUE 0x8024DB4D Val_Wu8 29.0000000000 DFES_EnvTabVerb 0.00 29.0000000000 FORMAT "%13.10" /end CHARACTERISTIC
/begin CHARACTERISTIC DFES_EnvRef.DFC_Com592hChecksum_C "" VALUE 0x8024DB4E Val_Wu8 29.0000000000 DFES_EnvTabVerb 0.00 29.0000000000 FORMAT "%13.10" /end CHARACTERISTIC
/begin CHARACTERISTIC DFES_EnvRef.DFC_Com592hCounter_C "" VALUE 0x8024DB4F Val_Wu8 29.0000000000 DFES_EnvTabVerb 0.00 29.0000000000 FORMAT "%13.10" /end CHARACTERISTIC
/begin CHARACTERISTIC DFES_EnvRef.DFC_Com592hTooShort_C "" VALUE 0x8024DB50 Val_Wu8 29.0000000000 DFES_EnvTabVerb 0.00 29.0000000000 FORMAT "%13.10" /end CHARACTERISTIC
/begin CHARACTERISTIC DFES_EnvRef.DFC_Com595hAbsent_C "" VALUE 0x8024DB51 Val_Wu8 29.0000000000 DFES_EnvTabVerb 0.00 29.0000000000 FORMAT "%13.10" /end CHARACTERISTIC
/begin CHARACTERISTIC DFES_EnvRef.DFC_Com595hChecksum_C "" VALUE 0x8024DB52 Val_Wu8 29.0000000000 DFES_EnvTabVerb 0.00 29.0000000000 FORMAT "%13.10" /end CHARACTERISTIC
/begin CHARACTERISTIC DFES_EnvRef.DFC_Com595hCounter_C "" VALUE 0x8024DB53 Val_Wu8 29.0000000000 DFES_EnvTabVerb 0.00 29.0000000000 FORMAT "%13.10" /end CHARACTERISTIC
/begin CHARACTERISTIC DFES_EnvRef.DFC_Com595hTooShort_C "" VALUE 0x8024DB54 Val_Wu8 29.0000000000 DFES_EnvTabVerb 0.00 29.0000000000 FORMAT "%13.10" /end CHARACTERISTIC
/begin CHARACTERISTIC DFES_EnvRef.DFC_Com5B2hAbsent_C "" VALUE 0x8024DB55 Val_Wu8 29.0000000000 DFES_EnvTabVerb 0.00 29.0000000000 FORMAT "%13.10" /end CHARACTERISTIC
/begin CHARACTERISTIC DFES_EnvRef.DFC_Com5B2hTooShort_C "" VALUE 0x8024DB56 Val_Wu8 29.0000000000 DFES_EnvTabVerb 0.00 29.0000000000 FORMAT "%13.10" /end CHARACTERISTIC
/begin CHARACTERISTIC DFES_EnvRef.DFC_Com5B5hAbsent_C "" VALUE 0x8024DB57 Val_Wu8 29.0000000000 DFES_EnvTabVerb 0.00 29.0000000000 FORMAT "%13.10" /end CHARACTERISTIC
/begin CHARACTERISTIC DFES_EnvRef.DFC_Com5B5hChecksum_C "" VALUE 0x8024DB58 Val_Wu8 29.0000000000 DFES_EnvTabVerb 0.00 29.0000000000 FORMAT "%13.10" /end CHARACTERISTIC
/begin CHARACTERISTIC DFES_EnvRef.DFC_Com5B5hCounter_C "" VALUE 0x8024DB59 Val_Wu8 29.0000000000 DFES_EnvTabVerb 0.00 29.0000000000 FORMAT "%13.10" /end CHARACTERISTIC
/begin CHARACTERISTIC DFES_EnvRef.DFC_Com5B5hTooShort_C "" VALUE 0x8024DB5A Val_Wu8 29.0000000000 DFES_EnvTabVerb 0.00 29.0000000000 FORMAT "%13.10" /end CHARACTERISTIC
/begin CHARACTERISTIC DFES_EnvRef.DFC_Com5C7hTooShort_C "" VALUE 0x8024DB5B Val_Wu8 29.0000000000 DFES_EnvTabVerb 0.00 29.0000000000 FORMAT "%13.10" /end CHARACTERISTIC
/begin CHARACTERISTIC DFES_EnvRef.DFC_Com5E7hAbsent_C "" VALUE 0x8024DB5C Val_Wu8 29.0000000000 DFES_EnvTabVerb 0.00 29.0000000000 FORMAT "%13.10" /end CHARACTERISTIC
/begin CHARACTERISTIC DFES_EnvRef.DFC_Com5E7hTooShort_C "" VALUE 0x8024DB5D Val_Wu8 29.0000000000 DFES_EnvTabVerb 0.00 29.0000000000 FORMAT "%13.10" /end CHARACTERISTIC
/begin CHARACTERISTIC DFES_EnvRef.DFC_Com635hTooShort_C "" VALUE 0x8024DB5E Val_Wu8 29.0000000000 DFES_EnvTabVerb 0.00 29.0000000000 FORMAT "%13.10" /end CHARACTERISTIC
/begin CHARACTERISTIC DFES_EnvRef.DFC_Com645hTooShort_C "" VALUE 0x8024DB5F Val_Wu8 29.0000000000 DFES_EnvTabVerb 0.00 29.0000000000 FORMAT "%13.10" /end CHARACTERISTIC
/begin CHARACTERISTIC DFES_EnvRef.DFC_Com663hAbsent_C "" VALUE 0x8024DB60 Val_Wu8 29.0000000000 DFES_EnvTabVerb 0.00 29.0000000000 FORMAT "%13.10" /end CHARACTERISTIC
/begin CHARACTERISTIC DFES_EnvRef.DFC_Com663hTooShort_C "" VALUE 0x8024DB61 Val_Wu8 29.0000000000 DFES_EnvTabVerb 0.00 29.0000000000 FORMAT "%13.10" /end CHARACTERISTIC
/begin CHARACTERISTIC DFES_EnvRef.DFC_Com665hAbsent_C "" VALUE 0x8024DB62 Val_Wu8 29.0000000000 DFES_EnvTabVerb 0.00 29.0000000000 FORMAT "%13.10" /end CHARACTERISTIC
/begin CHARACTERISTIC DFES_EnvRef.DFC_Com665hTooShort_C "" VALUE 0x8024DB63 Val_Wu8 29.0000000000 DFES_EnvTabVerb 0.00 29.0000000000 FORMAT "%13.10" /end CHARACTERISTIC
/begin CHARACTERISTIC DFES_EnvRef.DFC_Com675hAbsent_C "" VALUE 0x8024DB64 Val_Wu8 29.0000000000 DFES_EnvTabVerb 0.00 29.0000000000 FORMAT "%13.10" /end CHARACTERISTIC
/begin CHARACTERISTIC DFES_EnvRef.DFC_Com675hTooShort_C "" VALUE 0x8024DB65 Val_Wu8 29.0000000000 DFES_EnvTabVerb 0.00 29.0000000000 FORMAT "%13.10" /end CHARACTERISTIC
/begin CHARACTERISTIC DFES_EnvRef.DFC_ComFrbd_205h_HVBAT_PACK_CURRENT_C "" VALUE 0x8024DB66 Val_Wu8 29.0000000000 DFES_EnvTabVerb 0.00 29.0000000000 FORMAT "%13.10" /end CHARACTERISTIC
/begin CHARACTERISTIC DFES_EnvRef.DFC_ComFrbd_205h_HVBAT_SOC_DISPLAY_C "" VALUE 0x8024DB67 Val_Wu8 29.0000000000 DFES_EnvTabVerb 0.00 29.0000000000 FORMAT "%13.10" /end CHARACTERISTIC
/begin CHARACTERISTIC DFES_EnvRef.DFC_ComFrbd_205h_HVBAT_VOLTAGE_C "" VALUE 0x8024DB68 Val_Wu8 29.0000000000 DFES_EnvTabVerb 0.00 29.0000000000 FORMAT "%13.10" /end CHARACTERISTIC
/begin CHARACTERISTIC DFES_EnvRef.DFC_ComFrbd_217h_INV_DC_BUS_VOLTAGE_C "" VALUE 0x8024DB69 Val_Wu8 29.0000000000 DFES_EnvTabVerb 0.00 29.0000000000 FORMAT "%13.10" /end CHARACTERISTIC
/begin CHARACTERISTIC DFES_EnvRef.DFC_ComFrbd_217h_INV_MTR_ACTUAL_TRQ_C "" VALUE 0x8024DB6A Val_Wu8 29.0000000000 DFES_EnvTabVerb 0.00 29.0000000000 FORMAT "%13.10" /end CHARACTERISTIC
/begin CHARACTERISTIC DFES_EnvRef.DFC_ComFrbd_217h_INV_MTR_SPEED_C "" VALUE 0x8024DB6B Val_Wu8 29.0000000000 DFES_EnvTabVerb 0.00 29.0000000000 FORMAT "%13.10" /end CHARACTERISTIC
/begin CHARACTERISTIC DFES_EnvRef.DFC_ComFrbd_217h_INV_MTR_TRQ_C "" VALUE 0x8024DB6C Val_Wu8 29.0000000000 DFES_EnvTabVerb 0.00 29.0000000000 FORMAT "%13.10" /end CHARACTERISTIC
/begin CHARACTERISTIC DFES_EnvRef.DFC_ComFrbd_227h_INV_DC_CURRENT_C "" VALUE 0x8024DB6D Val_Wu8 29.0000000000 DFES_EnvTabVerb 0.00 29.0000000000 FORMAT "%13.10" /end CHARACTERISTIC
/begin CHARACTERISTIC DFES_EnvRef.DFC_ComFrbd_227h_INV_MOTORING_PEAK_TRQ_C "" VALUE 0x8024DB6E Val_Wu8 29.0000000000 DFES_EnvTabVerb 0.00 29.0000000000 FORMAT "%13.10" /end CHARACTERISTIC
/begin CHARACTERISTIC DFES_EnvRef.DFC_ComFrbd_227h_INV_MTR_INST_INPUT_POWER_C "" VALUE 0x8024DB6F Val_Wu8 29.0000000000 DFES_EnvTabVerb 0.00 29.0000000000 FORMAT "%13.10" /end CHARACTERISTIC
/begin CHARACTERISTIC DFES_EnvRef.DFC_ComFrbd_227h_INV_REGEN_PEAK_TRQ_C "" VALUE 0x8024DB70 Val_Wu8 29.0000000000 DFES_EnvTabVerb 0.00 29.0000000000 FORMAT "%13.10" /end CHARACTERISTIC
/begin CHARACTERISTIC DFES_EnvRef.DFC_ComFrbd_237h_INV_ACTIVE_DISCHARGE_STATUS_C "" VALUE 0x8024DB71 Val_Wu8 29.0000000000 DFES_EnvTabVerb 0.00 29.0000000000 FORMAT "%13.10" /end CHARACTERISTIC
/begin CHARACTERISTIC DFES_EnvRef.DFC_ComFrbd_237h_INV_CTRL_MODE_ACK_C "" VALUE 0x8024DB72 Val_Wu8 29.0000000000 DFES_EnvTabVerb 0.00 29.0000000000 FORMAT "%13.10" /end CHARACTERISTIC
/begin CHARACTERISTIC DFES_EnvRef.DFC_ComFrbd_237h_INV_EV_WARNING_C "" VALUE 0x8024DB73 Val_Wu8 29.0000000000 DFES_EnvTabVerb 0.00 29.0000000000 FORMAT "%13.10" /end CHARACTERISTIC
/begin CHARACTERISTIC DFES_EnvRef.DFC_ComFrbd_237h_INV_FAULT_LEVEL_C "" VALUE 0x8024DB74 Val_Wu8 29.0000000000 DFES_EnvTabVerb 0.00 29.0000000000 FORMAT "%13.10" /end CHARACTERISTIC
/begin CHARACTERISTIC DFES_EnvRef.DFC_ComFrbd_237h_INV_MASTER_STOP_C "" VALUE 0x8024DB75 Val_Wu8 29.0000000000 DFES_EnvTabVerb 0.00 29.0000000000 FORMAT "%13.10" /end CHARACTERISTIC
/begin CHARACTERISTIC DFES_EnvRef.DFC_ComFrbd_237h_INV_SERVICE_DUE_C "" VALUE 0x8024DB76 Val_Wu8 29.0000000000 DFES_EnvTabVerb 0.00 29.0000000000 FORMAT "%13.10" /end CHARACTERISTIC
/begin CHARACTERISTIC DFES_EnvRef.DFC_ComFrbd_237h_INV_STAB_MIN_TRQ_C "" VALUE 0x8024DB77 Val_Wu8 29.0000000000 DFES_EnvTabVerb 0.00 29.0000000000 FORMAT "%13.10" /end CHARACTERISTIC
/begin CHARACTERISTIC DFES_EnvRef.DFC_ComFrbd_259h_TGLM_FAILURE_STATE_C "" VALUE 0x8024DB78 Val_Wu8 29.0000000000 DFES_EnvTabVerb 0.00 29.0000000000 FORMAT "%13.10" /end CHARACTERISTIC
/begin CHARACTERISTIC DFES_EnvRef.DFC_ComFrbd_259h_TGLM_MODE_PUSH_C "" VALUE 0x8024DB79 Val_Wu8 29.0000000000 DFES_EnvTabVerb 0.00 29.0000000000 FORMAT "%13.10" /end CHARACTERISTIC
/begin CHARACTERISTIC DFES_EnvRef.DFC_ComFrbd_259h_TOGGLE_MONOSTABLE_POS_C "" VALUE 0x8024DB7A Val_Wu8 29.0000000000 DFES_EnvTabVerb 0.00 29.0000000000 FORMAT "%13.10" /end CHARACTERISTIC
/begin CHARACTERISTIC DFES_EnvRef.DFC_ComFrbd_273h_OBC_outputpower_capability_C "" VALUE 0x8024DB7B Val_Wu8 29.0000000000 DFES_EnvTabVerb 0.00 29.0000000000 FORMAT "%13.10" /end CHARACTERISTIC
/begin CHARACTERISTIC DFES_EnvRef.DFC_ComFrbd_275h_HVBAT_DISCHARGE_30S_AVAILABLE_CURRENT_C "" VALUE 0x8024DB7C Val_Wu8 29.0000000000 DFES_EnvTabVerb 0.00 29.0000000000 FORMAT "%13.10" /end CHARACTERISTIC
/begin CHARACTERISTIC DFES_EnvRef.DFC_ComFrbd_275h_HVBAT_DISCHARGE_30S_AVAILABLE_POWER_C "" VALUE 0x8024DB7D Val_Wu8 29.0000000000 DFES_EnvTabVerb 0.00 29.0000000000 FORMAT "%13.10" /end CHARACTERISTIC
/begin CHARACTERISTIC DFES_EnvRef.DFC_ComFrbd_283h_DCDC_IN_CURRENT_C "" VALUE 0x8024DB7E Val_Wu8 29.0000000000 DFES_EnvTabVerb 0.00 29.0000000000 FORMAT "%13.10" /end CHARACTERISTIC
/begin CHARACTERISTIC DFES_EnvRef.DFC_ComFrbd_283h_DCDC_IN_VOLTAGE_C "" VALUE 0x8024DB7F Val_Wu8 29.0000000000 DFES_EnvTabVerb 0.00 29.0000000000 FORMAT "%13.10" /end CHARACTERISTIC
/begin CHARACTERISTIC DFES_EnvRef.DFC_ComFrbd_283h_DCDC_OUT_CURRENT_C "" VALUE 0x8024DB80 Val_Wu8 29.0000000000 DFES_EnvTabVerb 0.00 29.0000000000 FORMAT "%13.10" /end CHARACTERISTIC
/begin CHARACTERISTIC DFES_EnvRef.DFC_ComFrbd_283h_DCDC_OUT_VOLTAGE_C "" VALUE 0x8024DB81 Val_Wu8 29.0000000000 DFES_EnvTabVerb 0.00 29.0000000000 FORMAT "%13.10" /end CHARACTERISTIC
/begin CHARACTERISTIC DFES_EnvRef.DFC_ComFrbd_285h_HVBAT_REGEN_CHG_30S_CURRENT_LIMIT_C "" VALUE 0x8024DB82 Val_Wu8 29.0000000000 DFES_EnvTabVerb 0.00 29.0000000000 FORMAT "%13.10" /end CHARACTERISTIC
/begin CHARACTERISTIC DFES_EnvRef.DFC_ComFrbd_285h_HVBAT_REGEN_CHRG_30S_POWER_LIMIT_C "" VALUE 0x8024DB83 Val_Wu8 29.0000000000 DFES_EnvTabVerb 0.00 29.0000000000 FORMAT "%13.10" /end CHARACTERISTIC
/begin CHARACTERISTIC DFES_EnvRef.DFC_ComFrbd_293h_DCDC_outputpower_capability_C "" VALUE 0x8024DB84 Val_Wu8 29.0000000000 DFES_EnvTabVerb 0.00 29.0000000000 FORMAT "%13.10" /end CHARACTERISTIC
/begin CHARACTERISTIC DFES_EnvRef.DFC_ComFrbd_325h_HVBAT_INSULATION_RESISTANCE_C "" VALUE 0x8024DB85 Val_Wu8 29.0000000000 DFES_EnvTabVerb 0.00 29.0000000000 FORMAT "%13.10" /end CHARACTERISTIC
/begin CHARACTERISTIC DFES_EnvRef.DFC_ComFrbd_325h_HVBAT_TEMPERATURE_C "" VALUE 0x8024DB86 Val_Wu8 29.0000000000 DFES_EnvTabVerb 0.00 29.0000000000 FORMAT "%13.10" /end CHARACTERISTIC
/begin CHARACTERISTIC DFES_EnvRef.DFC_ComFrbd_335h_HVBAT_CHRG_CONTINUOUS_CURR_MAX_C "" VALUE 0x8024DB87 Val_Wu8 29.0000000000 DFES_EnvTabVerb 0.00 29.0000000000 FORMAT "%13.10" /end CHARACTERISTIC
/begin CHARACTERISTIC DFES_EnvRef.DFC_ComFrbd_335h_HVBAT_CHRG_COTINUOUS_CURR_REQ_C "" VALUE 0x8024DB88 Val_Wu8 29.0000000000 DFES_EnvTabVerb 0.00 29.0000000000 FORMAT "%13.10" /end CHARACTERISTIC
/begin CHARACTERISTIC DFES_EnvRef.DFC_ComFrbd_335h_HVBAT_CHRG_MAX_VOLT_C "" VALUE 0x8024DB89 Val_Wu8 29.0000000000 DFES_EnvTabVerb 0.00 29.0000000000 FORMAT "%13.10" /end CHARACTERISTIC
/begin CHARACTERISTIC DFES_EnvRef.DFC_ComFrbd_335h_HVBAT_DC_BUS_VOLTAGE_C "" VALUE 0x8024DB8A Val_Wu8 29.0000000000 DFES_EnvTabVerb 0.00 29.0000000000 FORMAT "%13.10" /end CHARACTERISTIC
/begin CHARACTERISTIC DFES_EnvRef.DFC_ComFrbd_427h_INV_OP_MODE_C "" VALUE 0x8024DB8B Val_Wu8 29.0000000000 DFES_EnvTabVerb 0.00 29.0000000000 FORMAT "%13.10" /end CHARACTERISTIC
/begin CHARACTERISTIC DFES_EnvRef.DFC_ComFrbd_427h_INV_PERMISIBLE_TORQUE_C "" VALUE 0x8024DB8C Val_Wu8 29.0000000000 DFES_EnvTabVerb 0.00 29.0000000000 FORMAT "%13.10" /end CHARACTERISTIC
/begin CHARACTERISTIC DFES_EnvRef.DFC_ComFrbd_435h_HVBAT_MAX_CELL_VOLT_C "" VALUE 0x8024DB8D Val_Wu8 29.0000000000 DFES_EnvTabVerb 0.00 29.0000000000 FORMAT "%13.10" /end CHARACTERISTIC
/begin CHARACTERISTIC DFES_EnvRef.DFC_ComFrbd_435h_HVBAT_MAX_CELL_VOLT_NUM_C "" VALUE 0x8024DB8E Val_Wu8 29.0000000000 DFES_EnvTabVerb 0.00 29.0000000000 FORMAT "%13.10" /end CHARACTERISTIC
/begin CHARACTERISTIC DFES_EnvRef.DFC_ComFrbd_435h_HVBAT_MAX_SENSOR_TEMP_C "" VALUE 0x8024DB8F Val_Wu8 29.0000000000 DFES_EnvTabVerb 0.00 29.0000000000 FORMAT "%13.10" /end CHARACTERISTIC
/begin CHARACTERISTIC DFES_EnvRef.DFC_ComFrbd_435h_HVBAT_MIN_CELL_VOLT_C "" VALUE 0x8024DB90 Val_Wu8 29.0000000000 DFES_EnvTabVerb 0.00 29.0000000000 FORMAT "%13.10" /end CHARACTERISTIC
/begin CHARACTERISTIC DFES_EnvRef.DFC_ComFrbd_435h_HVBAT_MIN_CELL_VOLT_NUM_C "" VALUE 0x8024DB91 Val_Wu8 29.0000000000 DFES_EnvTabVerb 0.00 29.0000000000 FORMAT "%13.10" /end CHARACTERISTIC
/begin CHARACTERISTIC DFES_EnvRef.DFC_ComFrbd_453h_OBC_IN_CURRENT_C "" VALUE 0x8024DB92 Val_Wu8 29.0000000000 DFES_EnvTabVerb 0.00 29.0000000000 FORMAT "%13.10" /end CHARACTERISTIC
/begin CHARACTERISTIC DFES_EnvRef.DFC_ComFrbd_453h_OBC_IN_VOLTAGE_C "" VALUE 0x8024DB93 Val_Wu8 29.0000000000 DFES_EnvTabVerb 0.00 29.0000000000 FORMAT "%13.10" /end CHARACTERISTIC
/begin CHARACTERISTIC DFES_EnvRef.DFC_ComFrbd_453h_OBC_IP_POWER_C "" VALUE 0x8024DB94 Val_Wu8 29.0000000000 DFES_EnvTabVerb 0.00 29.0000000000 FORMAT "%13.10" /end CHARACTERISTIC
/begin CHARACTERISTIC DFES_EnvRef.DFC_ComFrbd_455h_HVBAT_NOMINAL_VOLTAGE_C "" VALUE 0x8024DB95 Val_Wu8 29.0000000000 DFES_EnvTabVerb 0.00 29.0000000000 FORMAT "%13.10" /end CHARACTERISTIC
/begin CHARACTERISTIC DFES_EnvRef.DFC_ComFrbd_463h_OBC_OUT_CURRENT_C "" VALUE 0x8024DB96 Val_Wu8 29.0000000000 DFES_EnvTabVerb 0.00 29.0000000000 FORMAT "%13.10" /end CHARACTERISTIC
/begin CHARACTERISTIC DFES_EnvRef.DFC_ComFrbd_463h_OBC_OUT_VOLTAGE_C "" VALUE 0x8024DB97 Val_Wu8 29.0000000000 DFES_EnvTabVerb 0.00 29.0000000000 FORMAT "%13.10" /end CHARACTERISTIC
/begin CHARACTERISTIC DFES_EnvRef.DFC_ComFrbd_463h_OBC_TEMPERATURE_C "" VALUE 0x8024DB98 Val_Wu8 29.0000000000 DFES_EnvTabVerb 0.00 29.0000000000 FORMAT "%13.10" /end CHARACTERISTIC
/begin CHARACTERISTIC DFES_EnvRef.DFC_ComFrbd_473h_DCDC_Coolant_Temperature_C "" VALUE 0x8024DB99 Val_Wu8 29.0000000000 DFES_EnvTabVerb 0.00 29.0000000000 FORMAT "%13.10" /end CHARACTERISTIC
/begin CHARACTERISTIC DFES_EnvRef.DFC_ComFrbd_473h_DCDC_TEMPERATURE_C "" VALUE 0x8024DB9A Val_Wu8 29.0000000000 DFES_EnvTabVerb 0.00 29.0000000000 FORMAT "%13.10" /end CHARACTERISTIC
/begin CHARACTERISTIC DFES_EnvRef.DFC_ComFrbd_47Bh_eCOMP_BusBarCurrent_C "" VALUE 0x8024DB9B Val_Wu8 29.0000000000 DFES_EnvTabVerb 0.00 29.0000000000 FORMAT "%13.10" /end CHARACTERISTIC
/begin CHARACTERISTIC DFES_EnvRef.DFC_ComFrbd_47Bh_eCOMP_BusBarVoltage_C "" VALUE 0x8024DB9C Val_Wu8 29.0000000000 DFES_EnvTabVerb 0.00 29.0000000000 FORMAT "%13.10" /end CHARACTERISTIC
/begin CHARACTERISTIC DFES_EnvRef.DFC_ComFrbd_47Bh_eCOMP_CompressorSpeed_C "" VALUE 0x8024DB9D Val_Wu8 29.0000000000 DFES_EnvTabVerb 0.00 29.0000000000 FORMAT "%13.10" /end CHARACTERISTIC
/begin CHARACTERISTIC DFES_EnvRef.DFC_ComFrbd_47Bh_eCOMP_IGBT_Temp_C "" VALUE 0x8024DB9E Val_Wu8 29.0000000000 DFES_EnvTabVerb 0.00 29.0000000000 FORMAT "%13.10" /end CHARACTERISTIC
/begin CHARACTERISTIC DFES_EnvRef.DFC_ComFrbd_47Bh_eCOMP_PeakPhaCurrent_C "" VALUE 0x8024DB9F Val_Wu8 29.0000000000 DFES_EnvTabVerb 0.00 29.0000000000 FORMAT "%13.10" /end CHARACTERISTIC
/begin CHARACTERISTIC DFES_EnvRef.DFC_ComFrbd_47Bh_eCOMP_Power_consumption_C "" VALUE 0x8024DBA0 Val_Wu8 29.0000000000 DFES_EnvTabVerb 0.00 29.0000000000 FORMAT "%13.10" /end CHARACTERISTIC
/begin CHARACTERISTIC DFES_EnvRef.DFC_ComFrbd_48Bh_eCOMP_Fault_Level_C "" VALUE 0x8024DBA1 Val_Wu8 29.0000000000 DFES_EnvTabVerb 0.00 29.0000000000 FORMAT "%13.10" /end CHARACTERISTIC
/begin CHARACTERISTIC DFES_EnvRef.DFC_ComFrbd_4F2h_VALEUR_SOC_ETENDUE_C "" VALUE 0x8024DBA2 Val_Wu8 29.0000000000 DFES_EnvTabVerb 0.00 29.0000000000 FORMAT "%13.10" /end CHARACTERISTIC
/begin CHARACTERISTIC DFES_EnvRef.DFC_ComFrbd_535h_HV_BATT_TEMP_AVG_C "" VALUE 0x8024DBA3 Val_Wu8 29.0000000000 DFES_EnvTabVerb 0.00 29.0000000000 FORMAT "%13.10" /end CHARACTERISTIC
/begin CHARACTERISTIC DFES_EnvRef.DFC_ComFrbd_543h_HVBAT_RESTBATTENERGY_C "" VALUE 0x8024DBA4 Val_Wu8 29.0000000000 DFES_EnvTabVerb 0.00 29.0000000000 FORMAT "%13.10" /end CHARACTERISTIC
/begin CHARACTERISTIC DFES_EnvRef.DFC_ComFrbd_543h_HVBAT_SOH_C "" VALUE 0x8024DBA5 Val_Wu8 29.0000000000 DFES_EnvTabVerb 0.00 29.0000000000 FORMAT "%13.10" /end CHARACTERISTIC
/begin CHARACTERISTIC DFES_EnvRef.DFC_ComFrbd_543h_HV_BATT_SOH_RES_C "" VALUE 0x8024DBA6 Val_Wu8 29.0000000000 DFES_EnvTabVerb 0.00 29.0000000000 FORMAT "%13.10" /end CHARACTERISTIC
/begin CHARACTERISTIC DFES_EnvRef.DFC_ComFrbd_592h_IBATT_1_C "" VALUE 0x8024DBA7 Val_Wu8 29.0000000000 DFES_EnvTabVerb 0.00 29.0000000000 FORMAT "%13.10" /end CHARACTERISTIC
/begin CHARACTERISTIC DFES_EnvRef.DFC_ComFrbd_592h_IBATT_2_C "" VALUE 0x8024DBA8 Val_Wu8 29.0000000000 DFES_EnvTabVerb 0.00 29.0000000000 FORMAT "%13.10" /end CHARACTERISTIC
/begin CHARACTERISTIC DFES_EnvRef.DFC_ComFrbd_592h_IBATT_3_C "" VALUE 0x8024DBA9 Val_Wu8 29.0000000000 DFES_EnvTabVerb 0.00 29.0000000000 FORMAT "%13.10" /end CHARACTERISTIC
/begin CHARACTERISTIC DFES_EnvRef.DFC_ComFrbd_592h_TEMP_BATT_C "" VALUE 0x8024DBAA Val_Wu8 29.0000000000 DFES_EnvTabVerb 0.00 29.0000000000 FORMAT "%13.10" /end CHARACTERISTIC
/begin CHARACTERISTIC DFES_EnvRef.DFC_ComFrbd_592h_U_BATT_BECB_C "" VALUE 0x8024DBAB Val_Wu8 29.0000000000 DFES_EnvTabVerb 0.00 29.0000000000 FORMAT "%13.10" /end CHARACTERISTIC
/begin CHARACTERISTIC DFES_EnvRef.DFC_ComFrbd_595h_HVBAT_TIME_TO_CHRG_80_C "" VALUE 0x8024DBAC Val_Wu8 29.0000000000 DFES_EnvTabVerb 0.00 29.0000000000 FORMAT "%13.10" /end CHARACTERISTIC
/begin CHARACTERISTIC DFES_EnvRef.DFC_ComFrbd_5B2h_TEMP_AIR_EXT_C "" VALUE 0x8024DBAD Val_Wu8 29.0000000000 DFES_EnvTabVerb 0.00 29.0000000000 FORMAT "%13.10" /end CHARACTERISTIC
/begin CHARACTERISTIC DFES_EnvRef.DFC_ComFrbd_635h_HVBAT_NEG_CONT_COUNT_SEG1_C "" VALUE 0x8024DBAE Val_Wu8 29.0000000000 DFES_EnvTabVerb 0.00 29.0000000000 FORMAT "%13.10" /end CHARACTERISTIC
/begin CHARACTERISTIC DFES_EnvRef.DFC_ComFrbd_635h_HVBAT_NEG_CONT_COUNT_SEG3_C "" VALUE 0x8024DBAF Val_Wu8 29.0000000000 DFES_EnvTabVerb 0.00 29.0000000000 FORMAT "%13.10" /end CHARACTERISTIC
/begin CHARACTERISTIC DFES_EnvRef.DFC_ComFrbd_635h_HVBAT_NEG_CONT_COUNT_SEG4_C "" VALUE 0x8024DBB0 Val_Wu8 29.0000000000 DFES_EnvTabVerb 0.00 29.0000000000 FORMAT "%13.10" /end CHARACTERISTIC
/begin CHARACTERISTIC DFES_EnvRef.DFC_ComFrbd_635h_HVBAT_PST_CONT_COUNT_SEG1_C "" VALUE 0x8024DBB1 Val_Wu8 29.0000000000 DFES_EnvTabVerb 0.00 29.0000000000 FORMAT "%13.10" /end CHARACTERISTIC
/begin CHARACTERISTIC DFES_EnvRef.DFC_ComFrbd_635h_HVBAT_PST_CONT_COUNT_SEG3_C "" VALUE 0x8024DBB2 Val_Wu8 29.0000000000 DFES_EnvTabVerb 0.00 29.0000000000 FORMAT "%13.10" /end CHARACTERISTIC
/begin CHARACTERISTIC DFES_EnvRef.DFC_ComFrbd_635h_HVBAT_PST_CONT_COUNT_SEG4_C "" VALUE 0x8024DBB3 Val_Wu8 29.0000000000 DFES_EnvTabVerb 0.00 29.0000000000 FORMAT "%13.10" /end CHARACTERISTIC
/begin CHARACTERISTIC DFES_EnvRef.DFC_ComFrbd_645h_HVBAT_PRECHRGE_CONT_COUNT_SEG1_C "" VALUE 0x8024DBB4 Val_Wu8 29.0000000000 DFES_EnvTabVerb 0.00 29.0000000000 FORMAT "%13.10" /end CHARACTERISTIC
/begin CHARACTERISTIC DFES_EnvRef.DFC_ComFrbd_645h_HVBAT_PRECHRGE_CONT_COUNT_SEG2_C "" VALUE 0x8024DBB5 Val_Wu8 29.0000000000 DFES_EnvTabVerb 0.00 29.0000000000 FORMAT "%13.10" /end CHARACTERISTIC
/begin CHARACTERISTIC DFES_EnvRef.DFC_ComFrbd_675h_HVBAT_REMAININGBATTCAPACITY_C "" VALUE 0x8024DBB6 Val_Wu8 29.0000000000 DFES_EnvTabVerb 0.00 29.0000000000 FORMAT "%13.10" /end CHARACTERISTIC
/begin CHARACTERISTIC DFES_EnvRef.DFC_ComInvld_205h_HVBAT_CHARGING_STATUS_C "" VALUE 0x8024DBB7 Val_Wu8 29.0000000000 DFES_EnvTabVerb 0.00 29.0000000000 FORMAT "%13.10" /end CHARACTERISTIC
/begin CHARACTERISTIC DFES_EnvRef.DFC_ComInvld_205h_HVBAT_PACK_CURRENT_C "" VALUE 0x8024DBB8 Val_Wu8 29.0000000000 DFES_EnvTabVerb 0.00 29.0000000000 FORMAT "%13.10" /end CHARACTERISTIC
/begin CHARACTERISTIC DFES_EnvRef.DFC_ComInvld_205h_HVBAT_SOC_DISPLAY_C "" VALUE 0x8024DBB9 Val_Wu8 29.0000000000 DFES_EnvTabVerb 0.00 29.0000000000 FORMAT "%13.10" /end CHARACTERISTIC
/begin CHARACTERISTIC DFES_EnvRef.DFC_ComInvld_205h_HVBAT_VOLTAGE_C "" VALUE 0x8024DBBA Val_Wu8 29.0000000000 DFES_EnvTabVerb 0.00 29.0000000000 FORMAT "%13.10" /end CHARACTERISTIC
/begin CHARACTERISTIC DFES_EnvRef.DFC_ComInvld_217h_INV_DC_BUS_VOLTAGE_C "" VALUE 0x8024DBBB Val_Wu8 29.0000000000 DFES_EnvTabVerb 0.00 29.0000000000 FORMAT "%13.10" /end CHARACTERISTIC
/begin CHARACTERISTIC DFES_EnvRef.DFC_ComInvld_217h_INV_MTR_ACTUAL_TRQ_C "" VALUE 0x8024DBBC Val_Wu8 29.0000000000 DFES_EnvTabVerb 0.00 29.0000000000 FORMAT "%13.10" /end CHARACTERISTIC
/begin CHARACTERISTIC DFES_EnvRef.DFC_ComInvld_217h_INV_MTR_SPEED_C "" VALUE 0x8024DBBD Val_Wu8 29.0000000000 DFES_EnvTabVerb 0.00 29.0000000000 FORMAT "%13.10" /end CHARACTERISTIC
/begin CHARACTERISTIC DFES_EnvRef.DFC_ComInvld_217h_INV_MTR_TRQ_C "" VALUE 0x8024DBBE Val_Wu8 29.0000000000 DFES_EnvTabVerb 0.00 29.0000000000 FORMAT "%13.10" /end CHARACTERISTIC
/begin CHARACTERISTIC DFES_EnvRef.DFC_ComInvld_227h_INV_DC_CURRENT_C "" VALUE 0x8024DBBF Val_Wu8 29.0000000000 DFES_EnvTabVerb 0.00 29.0000000000 FORMAT "%13.10" /end CHARACTERISTIC
/begin CHARACTERISTIC DFES_EnvRef.DFC_ComInvld_227h_INV_MOTORING_PEAK_TRQ_C "" VALUE 0x8024DBC0 Val_Wu8 29.0000000000 DFES_EnvTabVerb 0.00 29.0000000000 FORMAT "%13.10" /end CHARACTERISTIC
/begin CHARACTERISTIC DFES_EnvRef.DFC_ComInvld_227h_INV_MTR_INST_INPUT_POWER_C "" VALUE 0x8024DBC1 Val_Wu8 29.0000000000 DFES_EnvTabVerb 0.00 29.0000000000 FORMAT "%13.10" /end CHARACTERISTIC
/begin CHARACTERISTIC DFES_EnvRef.DFC_ComInvld_227h_INV_REGEN_PEAK_TRQ_C "" VALUE 0x8024DBC2 Val_Wu8 29.0000000000 DFES_EnvTabVerb 0.00 29.0000000000 FORMAT "%13.10" /end CHARACTERISTIC
/begin CHARACTERISTIC DFES_EnvRef.DFC_ComInvld_237h_INV_ACTIVE_DISCHARGE_STATUS_C "" VALUE 0x8024DBC3 Val_Wu8 29.0000000000 DFES_EnvTabVerb 0.00 29.0000000000 FORMAT "%13.10" /end CHARACTERISTIC
/begin CHARACTERISTIC DFES_EnvRef.DFC_ComInvld_237h_INV_FAULT_LEVEL_C "" VALUE 0x8024DBC4 Val_Wu8 29.0000000000 DFES_EnvTabVerb 0.00 29.0000000000 FORMAT "%13.10" /end CHARACTERISTIC
/begin CHARACTERISTIC DFES_EnvRef.DFC_ComInvld_237h_INV_STAB_MIN_TRQ_C "" VALUE 0x8024DBC5 Val_Wu8 29.0000000000 DFES_EnvTabVerb 0.00 29.0000000000 FORMAT "%13.10" /end CHARACTERISTIC
/begin CHARACTERISTIC DFES_EnvRef.DFC_ComInvld_259h_TGLM_MODE_PUSH_C "" VALUE 0x8024DBC6 Val_Wu8 29.0000000000 DFES_EnvTabVerb 0.00 29.0000000000 FORMAT "%13.10" /end CHARACTERISTIC
/begin CHARACTERISTIC DFES_EnvRef.DFC_ComInvld_259h_TOGGLE_MONOSTABLE_POS_C "" VALUE 0x8024DBC7 Val_Wu8 29.0000000000 DFES_EnvTabVerb 0.00 29.0000000000 FORMAT "%13.10" /end CHARACTERISTIC
/begin CHARACTERISTIC DFES_EnvRef.DFC_ComInvld_26h_AC_SWITCH_REQ_C "" VALUE 0x8024DBC8 Val_Wu8 29.0000000000 DFES_EnvTabVerb 0.00 29.0000000000 FORMAT "%13.10" /end CHARACTERISTIC
/begin CHARACTERISTIC DFES_EnvRef.DFC_ComInvld_26h_BLOWER_POSITION_C "" VALUE 0x8024DBC9 Val_Wu8 29.0000000000 DFES_EnvTabVerb 0.00 29.0000000000 FORMAT "%13.10" /end CHARACTERISTIC
/begin CHARACTERISTIC DFES_EnvRef.DFC_ComInvld_26h_EVAP_SENSOR_FAULT_C "" VALUE 0x8024DBCA Val_Wu8 29.0000000000 DFES_EnvTabVerb 0.00 29.0000000000 FORMAT "%13.10" /end CHARACTERISTIC
/begin CHARACTERISTIC DFES_EnvRef.DFC_ComInvld_26h_EVAP_SENSOR_VALUE_C "" VALUE 0x8024DBCB Val_Wu8 29.0000000000 DFES_EnvTabVerb 0.00 29.0000000000 FORMAT "%13.10" /end CHARACTERISTIC
/begin CHARACTERISTIC DFES_EnvRef.DFC_ComInvld_26h_POTENTIOMETER_FAULT_C "" VALUE 0x8024DBCC Val_Wu8 29.0000000000 DFES_EnvTabVerb 0.00 29.0000000000 FORMAT "%13.10" /end CHARACTERISTIC
/begin CHARACTERISTIC DFES_EnvRef.DFC_ComInvld_26h_REAR_DEFOG_REQ_C "" VALUE 0x8024DBCD Val_Wu8 29.0000000000 DFES_EnvTabVerb 0.00 29.0000000000 FORMAT "%13.10" /end CHARACTERISTIC
/begin CHARACTERISTIC DFES_EnvRef.DFC_ComInvld_26h_TEMP_POSITION_C "" VALUE 0x8024DBCE Val_Wu8 29.0000000000 DFES_EnvTabVerb 0.00 29.0000000000 FORMAT "%13.10" /end CHARACTERISTIC
/begin CHARACTERISTIC DFES_EnvRef.DFC_ComInvld_273h_OBC_FAULT_LEVEL_C "" VALUE 0x8024DBCF Val_Wu8 29.0000000000 DFES_EnvTabVerb 0.00 29.0000000000 FORMAT "%13.10" /end CHARACTERISTIC
/begin CHARACTERISTIC DFES_EnvRef.DFC_ComInvld_273h_OBC_outputpower_capability_C "" VALUE 0x8024DBD0 Val_Wu8 29.0000000000 DFES_EnvTabVerb 0.00 29.0000000000 FORMAT "%13.10" /end CHARACTERISTIC
/begin CHARACTERISTIC DFES_EnvRef.DFC_ComInvld_275h_HVBAT_DISCHARGE_30S_AVAILABLE_CURRENT_C "" VALUE 0x8024DBD1 Val_Wu8 29.0000000000 DFES_EnvTabVerb 0.00 29.0000000000 FORMAT "%13.10" /end CHARACTERISTIC
/begin CHARACTERISTIC DFES_EnvRef.DFC_ComInvld_275h_HVBAT_DISCHARGE_30S_AVAILABLE_POWER_C "" VALUE 0x8024DBD2 Val_Wu8 29.0000000000 DFES_EnvTabVerb 0.00 29.0000000000 FORMAT "%13.10" /end CHARACTERISTIC
/begin CHARACTERISTIC DFES_EnvRef.DFC_ComInvld_283h_DCDC_IN_CURRENT_C "" VALUE 0x8024DBD3 Val_Wu8 29.0000000000 DFES_EnvTabVerb 0.00 29.0000000000 FORMAT "%13.10" /end CHARACTERISTIC
/begin CHARACTERISTIC DFES_EnvRef.DFC_ComInvld_283h_DCDC_IN_VOLTAGE_C "" VALUE 0x8024DBD4 Val_Wu8 29.0000000000 DFES_EnvTabVerb 0.00 29.0000000000 FORMAT "%13.10" /end CHARACTERISTIC
/begin CHARACTERISTIC DFES_EnvRef.DFC_ComInvld_283h_DCDC_OUT_CURRENT_C "" VALUE 0x8024DBD5 Val_Wu8 29.0000000000 DFES_EnvTabVerb 0.00 29.0000000000 FORMAT "%13.10" /end CHARACTERISTIC
/begin CHARACTERISTIC DFES_EnvRef.DFC_ComInvld_283h_DCDC_OUT_VOLTAGE_C "" VALUE 0x8024DBD6 Val_Wu8 29.0000000000 DFES_EnvTabVerb 0.00 29.0000000000 FORMAT "%13.10" /end CHARACTERISTIC
/begin CHARACTERISTIC DFES_EnvRef.DFC_ComInvld_285h_HVBAT_REGEN_CHG_30S_CURRENT_LIMIT_C "" VALUE 0x8024DBD7 Val_Wu8 29.0000000000 DFES_EnvTabVerb 0.00 29.0000000000 FORMAT "%13.10" /end CHARACTERISTIC
/begin CHARACTERISTIC DFES_EnvRef.DFC_ComInvld_285h_HVBAT_REGEN_CHRG_30S_POWER_LIMIT_C "" VALUE 0x8024DBD8 Val_Wu8 29.0000000000 DFES_EnvTabVerb 0.00 29.0000000000 FORMAT "%13.10" /end CHARACTERISTIC
/begin CHARACTERISTIC DFES_EnvRef.DFC_ComInvld_293h_DCDC_FAULT_LEVEL_C "" VALUE 0x8024DBD9 Val_Wu8 29.0000000000 DFES_EnvTabVerb 0.00 29.0000000000 FORMAT "%13.10" /end CHARACTERISTIC
/begin CHARACTERISTIC DFES_EnvRef.DFC_ComInvld_293h_DCDC_outputpower_capability_C "" VALUE 0x8024DBDA Val_Wu8 29.0000000000 DFES_EnvTabVerb 0.00 29.0000000000 FORMAT "%13.10" /end CHARACTERISTIC
/begin CHARACTERISTIC DFES_EnvRef.DFC_ComInvld_325h_HVBAT_EPLUG_STATUS_C "" VALUE 0x8024DBDB Val_Wu8 29.0000000000 DFES_EnvTabVerb 0.00 29.0000000000 FORMAT "%13.10" /end CHARACTERISTIC
/begin CHARACTERISTIC DFES_EnvRef.DFC_ComInvld_325h_HVBAT_HVIL_STS_C "" VALUE 0x8024DBDC Val_Wu8 29.0000000000 DFES_EnvTabVerb 0.00 29.0000000000 FORMAT "%13.10" /end CHARACTERISTIC
/begin CHARACTERISTIC DFES_EnvRef.DFC_ComInvld_325h_HVBAT_INSULATION_FAULT_C "" VALUE 0x8024DBDD Val_Wu8 29.0000000000 DFES_EnvTabVerb 0.00 29.0000000000 FORMAT "%13.10" /end CHARACTERISTIC
/begin CHARACTERISTIC DFES_EnvRef.DFC_ComInvld_325h_HVBAT_INSULATION_RESISTANCE_C "" VALUE 0x8024DBDE Val_Wu8 29.0000000000 DFES_EnvTabVerb 0.00 29.0000000000 FORMAT "%13.10" /end CHARACTERISTIC
/begin CHARACTERISTIC DFES_EnvRef.DFC_ComInvld_325h_HVBAT_TEMPERATURE_C "" VALUE 0x8024DBDF Val_Wu8 29.0000000000 DFES_EnvTabVerb 0.00 29.0000000000 FORMAT "%13.10" /end CHARACTERISTIC
/begin CHARACTERISTIC DFES_EnvRef.DFC_ComInvld_335h_HVBAT_CHRG_CONTINUOUS_CURR_MAX_C "" VALUE 0x8024DBE0 Val_Wu8 29.0000000000 DFES_EnvTabVerb 0.00 29.0000000000 FORMAT "%13.10" /end CHARACTERISTIC
/begin CHARACTERISTIC DFES_EnvRef.DFC_ComInvld_335h_HVBAT_CHRG_COTINUOUS_CURR_REQ_C "" VALUE 0x8024DBE1 Val_Wu8 29.0000000000 DFES_EnvTabVerb 0.00 29.0000000000 FORMAT "%13.10" /end CHARACTERISTIC
/begin CHARACTERISTIC DFES_EnvRef.DFC_ComInvld_335h_HVBAT_CHRG_MAX_VOLT_C "" VALUE 0x8024DBE2 Val_Wu8 29.0000000000 DFES_EnvTabVerb 0.00 29.0000000000 FORMAT "%13.10" /end CHARACTERISTIC
/begin CHARACTERISTIC DFES_EnvRef.DFC_ComInvld_335h_HVBAT_DC_BUS_VOLTAGE_C "" VALUE 0x8024DBE3 Val_Wu8 29.0000000000 DFES_EnvTabVerb 0.00 29.0000000000 FORMAT "%13.10" /end CHARACTERISTIC
/begin CHARACTERISTIC DFES_EnvRef.DFC_ComInvld_38Dh_VITESSE_VEHICULE_ROUES_C "" VALUE 0x8024DBE4 Val_Wu8 29.0000000000 DFES_EnvTabVerb 0.00 29.0000000000 FORMAT "%13.10" /end CHARACTERISTIC
/begin CHARACTERISTIC DFES_EnvRef.DFC_ComInvld_38Dh_VVH_INDISP_C "" VALUE 0x8024DBE5 Val_Wu8 29.0000000000 DFES_EnvTabVerb 0.00 29.0000000000 FORMAT "%13.10" /end CHARACTERISTIC
/begin CHARACTERISTIC DFES_EnvRef.DFC_ComInvld_427h_INV_COOLANT_TEMP_C "" VALUE 0x8024DBE6 Val_Wu8 29.0000000000 DFES_EnvTabVerb 0.00 29.0000000000 FORMAT "%13.10" /end CHARACTERISTIC
/begin CHARACTERISTIC DFES_EnvRef.DFC_ComInvld_427h_INV_MOTOR_TEMP_C "" VALUE 0x8024DBE7 Val_Wu8 29.0000000000 DFES_EnvTabVerb 0.00 29.0000000000 FORMAT "%13.10" /end CHARACTERISTIC
/begin CHARACTERISTIC DFES_EnvRef.DFC_ComInvld_427h_INV_OP_MODE_C "" VALUE 0x8024DBE8 Val_Wu8 29.0000000000 DFES_EnvTabVerb 0.00 29.0000000000 FORMAT "%13.10" /end CHARACTERISTIC
/begin CHARACTERISTIC DFES_EnvRef.DFC_ComInvld_427h_INV_PERMISIBLE_TORQUE_C "" VALUE 0x8024DBE9 Val_Wu8 29.0000000000 DFES_EnvTabVerb 0.00 29.0000000000 FORMAT "%13.10" /end CHARACTERISTIC
/begin CHARACTERISTIC DFES_EnvRef.DFC_ComInvld_427h_INV_TEMP_C "" VALUE 0x8024DBEA Val_Wu8 29.0000000000 DFES_EnvTabVerb 0.00 29.0000000000 FORMAT "%13.10" /end CHARACTERISTIC
/begin CHARACTERISTIC DFES_EnvRef.DFC_ComInvld_432h_REVEIL_PRINCIPAL_C "" VALUE 0x8024DBEB Val_Wu8 29.0000000000 DFES_EnvTabVerb 0.00 29.0000000000 FORMAT "%13.10" /end CHARACTERISTIC
/begin CHARACTERISTIC DFES_EnvRef.DFC_ComInvld_435h_HVBAT_MAX_CELL_VOLT_C "" VALUE 0x8024DBEC Val_Wu8 29.0000000000 DFES_EnvTabVerb 0.00 29.0000000000 FORMAT "%13.10" /end CHARACTERISTIC
/begin CHARACTERISTIC DFES_EnvRef.DFC_ComInvld_435h_HVBAT_MAX_CELL_VOLT_NUM_C "" VALUE 0x8024DBED Val_Wu8 29.0000000000 DFES_EnvTabVerb 0.00 29.0000000000 FORMAT "%13.10" /end CHARACTERISTIC
/begin CHARACTERISTIC DFES_EnvRef.DFC_ComInvld_435h_HVBAT_MAX_SENSOR_TEMP_C "" VALUE 0x8024DBEE Val_Wu8 29.0000000000 DFES_EnvTabVerb 0.00 29.0000000000 FORMAT "%13.10" /end CHARACTERISTIC
/begin CHARACTERISTIC DFES_EnvRef.DFC_ComInvld_435h_HVBAT_MIN_CELL_VOLT_C "" VALUE 0x8024DBEF Val_Wu8 29.0000000000 DFES_EnvTabVerb 0.00 29.0000000000 FORMAT "%13.10" /end CHARACTERISTIC
/begin CHARACTERISTIC DFES_EnvRef.DFC_ComInvld_435h_HVBAT_MIN_CELL_VOLT_NUM_C "" VALUE 0x8024DBF0 Val_Wu8 29.0000000000 DFES_EnvTabVerb 0.00 29.0000000000 FORMAT "%13.10" /end CHARACTERISTIC
/begin CHARACTERISTIC DFES_EnvRef.DFC_ComInvld_442h_BCCM_BLOWER_RELAY_STS_C "" VALUE 0x8024DBF1 Val_Wu8 29.0000000000 DFES_EnvTabVerb 0.00 29.0000000000 FORMAT "%13.10" /end CHARACTERISTIC
/begin CHARACTERISTIC DFES_EnvRef.DFC_ComInvld_453h_OBC_IN_CURRENT_C "" VALUE 0x8024DBF2 Val_Wu8 29.0000000000 DFES_EnvTabVerb 0.00 29.0000000000 FORMAT "%13.10" /end CHARACTERISTIC
/begin CHARACTERISTIC DFES_EnvRef.DFC_ComInvld_453h_OBC_IN_VOLTAGE_C "" VALUE 0x8024DBF3 Val_Wu8 29.0000000000 DFES_EnvTabVerb 0.00 29.0000000000 FORMAT "%13.10" /end CHARACTERISTIC
/begin CHARACTERISTIC DFES_EnvRef.DFC_ComInvld_453h_OBC_IP_POWER_C "" VALUE 0x8024DBF4 Val_Wu8 29.0000000000 DFES_EnvTabVerb 0.00 29.0000000000 FORMAT "%13.10" /end CHARACTERISTIC
/begin CHARACTERISTIC DFES_EnvRef.DFC_ComInvld_455h_HVBAT_NOMINAL_VOLTAGE_C "" VALUE 0x8024DBF5 Val_Wu8 29.0000000000 DFES_EnvTabVerb 0.00 29.0000000000 FORMAT "%13.10" /end CHARACTERISTIC
/begin CHARACTERISTIC DFES_EnvRef.DFC_ComInvld_463h_OBC_OUT_CURRENT_C "" VALUE 0x8024DBF6 Val_Wu8 29.0000000000 DFES_EnvTabVerb 0.00 29.0000000000 FORMAT "%13.10" /end CHARACTERISTIC
/begin CHARACTERISTIC DFES_EnvRef.DFC_ComInvld_463h_OBC_OUT_VOLTAGE_C "" VALUE 0x8024DBF7 Val_Wu8 29.0000000000 DFES_EnvTabVerb 0.00 29.0000000000 FORMAT "%13.10" /end CHARACTERISTIC
/begin CHARACTERISTIC DFES_EnvRef.DFC_ComInvld_463h_OBC_TEMPERATURE_C "" VALUE 0x8024DBF8 Val_Wu8 29.0000000000 DFES_EnvTabVerb 0.00 29.0000000000 FORMAT "%13.10" /end CHARACTERISTIC
/begin CHARACTERISTIC DFES_EnvRef.DFC_ComInvld_473h_DCDC_Coolant_Temperature_C "" VALUE 0x8024DBF9 Val_Wu8 29.0000000000 DFES_EnvTabVerb 0.00 29.0000000000 FORMAT "%13.10" /end CHARACTERISTIC
/begin CHARACTERISTIC DFES_EnvRef.DFC_ComInvld_473h_DCDC_TEMPERATURE_C "" VALUE 0x8024DBFA Val_Wu8 29.0000000000 DFES_EnvTabVerb 0.00 29.0000000000 FORMAT "%13.10" /end CHARACTERISTIC
/begin CHARACTERISTIC DFES_EnvRef.DFC_ComInvld_47Bh_eCOMP_BusBarCurrent_C "" VALUE 0x8024DBFB Val_Wu8 29.0000000000 DFES_EnvTabVerb 0.00 29.0000000000 FORMAT "%13.10" /end CHARACTERISTIC
/begin CHARACTERISTIC DFES_EnvRef.DFC_ComInvld_47Bh_eCOMP_BusBarVoltage_C "" VALUE 0x8024DBFC Val_Wu8 29.0000000000 DFES_EnvTabVerb 0.00 29.0000000000 FORMAT "%13.10" /end CHARACTERISTIC
/begin CHARACTERISTIC DFES_EnvRef.DFC_ComInvld_47Bh_eCOMP_CompressorSpeed_C "" VALUE 0x8024DBFD Val_Wu8 29.0000000000 DFES_EnvTabVerb 0.00 29.0000000000 FORMAT "%13.10" /end CHARACTERISTIC
/begin CHARACTERISTIC DFES_EnvRef.DFC_ComInvld_47Bh_eCOMP_IGBT_Temp_C "" VALUE 0x8024DBFE Val_Wu8 29.0000000000 DFES_EnvTabVerb 0.00 29.0000000000 FORMAT "%13.10" /end CHARACTERISTIC
/begin CHARACTERISTIC DFES_EnvRef.DFC_ComInvld_47Bh_eCOMP_PeakPhaCurrent_C "" VALUE 0x8024DBFF Val_Wu8 29.0000000000 DFES_EnvTabVerb 0.00 29.0000000000 FORMAT "%13.10" /end CHARACTERISTIC
/begin CHARACTERISTIC DFES_EnvRef.DFC_ComInvld_47Bh_eCOMP_Power_consumption_C "" VALUE 0x8024DC00 Val_Wu8 29.0000000000 DFES_EnvTabVerb 0.00 29.0000000000 FORMAT "%13.10" /end CHARACTERISTIC
/begin CHARACTERISTIC DFES_EnvRef.DFC_ComInvld_4F2h_STATUS_SOC_C "" VALUE 0x8024DC01 Val_Wu8 29.0000000000 DFES_EnvTabVerb 0.00 29.0000000000 FORMAT "%13.10" /end CHARACTERISTIC
/begin CHARACTERISTIC DFES_EnvRef.DFC_ComInvld_4F2h_TEMP_BATT_STATUS_C "" VALUE 0x8024DC02 Val_Wu8 29.0000000000 DFES_EnvTabVerb 0.00 29.0000000000 FORMAT "%13.10" /end CHARACTERISTIC
/begin CHARACTERISTIC DFES_EnvRef.DFC_ComInvld_4F2h_VALEUR_SOC_ETENDUE_C "" VALUE 0x8024DC03 Val_Wu8 29.0000000000 DFES_EnvTabVerb 0.00 29.0000000000 FORMAT "%13.10" /end CHARACTERISTIC
/begin CHARACTERISTIC DFES_EnvRef.DFC_ComInvld_535h_HV_BATT_TEMP_AVG_C "" VALUE 0x8024DC04 Val_Wu8 29.0000000000 DFES_EnvTabVerb 0.00 29.0000000000 FORMAT "%13.10" /end CHARACTERISTIC
/begin CHARACTERISTIC DFES_EnvRef.DFC_ComInvld_543h_HVBAT_RESTBATTENERGY_C "" VALUE 0x8024DC05 Val_Wu8 29.0000000000 DFES_EnvTabVerb 0.00 29.0000000000 FORMAT "%13.10" /end CHARACTERISTIC
/begin CHARACTERISTIC DFES_EnvRef.DFC_ComInvld_543h_HVBAT_SOH_C "" VALUE 0x8024DC06 Val_Wu8 29.0000000000 DFES_EnvTabVerb 0.00 29.0000000000 FORMAT "%13.10" /end CHARACTERISTIC
/begin CHARACTERISTIC DFES_EnvRef.DFC_ComInvld_543h_HV_BATT_SOH_RES_C "" VALUE 0x8024DC07 Val_Wu8 29.0000000000 DFES_EnvTabVerb 0.00 29.0000000000 FORMAT "%13.10" /end CHARACTERISTIC
/begin CHARACTERISTIC DFES_EnvRef.DFC_ComInvld_552h_CPT_TEMPOREL_C "" VALUE 0x8024DC08 Val_Wu8 29.0000000000 DFES_EnvTabVerb 0.00 29.0000000000 FORMAT "%13.10" /end CHARACTERISTIC
/begin CHARACTERISTIC DFES_EnvRef.DFC_ComInvld_552h_KILOMETRAGE_C "" VALUE 0x8024DC09 Val_Wu8 29.0000000000 DFES_EnvTabVerb 0.00 29.0000000000 FORMAT "%13.10" /end CHARACTERISTIC
/begin CHARACTERISTIC DFES_EnvRef.DFC_ComInvld_583h_HV_BATT_DISCONT_CSE_OPEN_C "" VALUE 0x8024DC0A Val_Wu8 29.0000000000 DFES_EnvTabVerb 0.00 29.0000000000 FORMAT "%13.10" /end CHARACTERISTIC
/begin CHARACTERISTIC DFES_EnvRef.DFC_ComInvld_592h_CALIBRE_IBATT_C "" VALUE 0x8024DC0B Val_Wu8 29.0000000000 DFES_EnvTabVerb 0.00 29.0000000000 FORMAT "%13.10" /end CHARACTERISTIC
/begin CHARACTERISTIC DFES_EnvRef.DFC_ComInvld_592h_IBATT_1_C "" VALUE 0x8024DC0C Val_Wu8 29.0000000000 DFES_EnvTabVerb 0.00 29.0000000000 FORMAT "%13.10" /end CHARACTERISTIC
/begin CHARACTERISTIC DFES_EnvRef.DFC_ComInvld_592h_IBATT_2_C "" VALUE 0x8024DC0D Val_Wu8 29.0000000000 DFES_EnvTabVerb 0.00 29.0000000000 FORMAT "%13.10" /end CHARACTERISTIC
/begin CHARACTERISTIC DFES_EnvRef.DFC_ComInvld_592h_IBATT_3_C "" VALUE 0x8024DC0E Val_Wu8 29.0000000000 DFES_EnvTabVerb 0.00 29.0000000000 FORMAT "%13.10" /end CHARACTERISTIC
/begin CHARACTERISTIC DFES_EnvRef.DFC_ComInvld_592h_TEMP_BATT_C "" VALUE 0x8024DC0F Val_Wu8 29.0000000000 DFES_EnvTabVerb 0.00 29.0000000000 FORMAT "%13.10" /end CHARACTERISTIC
/begin CHARACTERISTIC DFES_EnvRef.DFC_ComInvld_592h_U_BATT_BECB_C "" VALUE 0x8024DC10 Val_Wu8 29.0000000000 DFES_EnvTabVerb 0.00 29.0000000000 FORMAT "%13.10" /end CHARACTERISTIC
/begin CHARACTERISTIC DFES_EnvRef.DFC_ComInvld_595h_HVBAT_TIME_TO_CHRG_80_C "" VALUE 0x8024DC11 Val_Wu8 29.0000000000 DFES_EnvTabVerb 0.00 29.0000000000 FORMAT "%13.10" /end CHARACTERISTIC
/begin CHARACTERISTIC DFES_EnvRef.DFC_ComInvld_5B2h_TEMP_AIR_EXT_C "" VALUE 0x8024DC12 Val_Wu8 29.0000000000 DFES_EnvTabVerb 0.00 29.0000000000 FORMAT "%13.10" /end CHARACTERISTIC
/begin CHARACTERISTIC DFES_EnvRef.DFC_ComInvld_5B5h_HVBAT_THERMAL_RUNAWAY_C "" VALUE 0x8024DC13 Val_Wu8 29.0000000000 DFES_EnvTabVerb 0.00 29.0000000000 FORMAT "%13.10" /end CHARACTERISTIC
/begin CHARACTERISTIC DFES_EnvRef.DFC_ComInvld_635h_HVBAT_NEG_CONT_COUNT_SEG1_C "" VALUE 0x8024DC14 Val_Wu8 29.0000000000 DFES_EnvTabVerb 0.00 29.0000000000 FORMAT "%13.10" /end CHARACTERISTIC
/begin CHARACTERISTIC DFES_EnvRef.DFC_ComInvld_635h_HVBAT_NEG_CONT_COUNT_SEG3_C "" VALUE 0x8024DC15 Val_Wu8 29.0000000000 DFES_EnvTabVerb 0.00 29.0000000000 FORMAT "%13.10" /end CHARACTERISTIC
/begin CHARACTERISTIC DFES_EnvRef.DFC_ComInvld_635h_HVBAT_NEG_CONT_COUNT_SEG4_C "" VALUE 0x8024DC16 Val_Wu8 29.0000000000 DFES_EnvTabVerb 0.00 29.0000000000 FORMAT "%13.10" /end CHARACTERISTIC
/begin CHARACTERISTIC DFES_EnvRef.DFC_ComInvld_635h_HVBAT_PST_CONT_COUNT_SEG1_C "" VALUE 0x8024DC17 Val_Wu8 29.0000000000 DFES_EnvTabVerb 0.00 29.0000000000 FORMAT "%13.10" /end CHARACTERISTIC
/begin CHARACTERISTIC DFES_EnvRef.DFC_ComInvld_635h_HVBAT_PST_CONT_COUNT_SEG3_C "" VALUE 0x8024DC18 Val_Wu8 29.0000000000 DFES_EnvTabVerb 0.00 29.0000000000 FORMAT "%13.10" /end CHARACTERISTIC
/begin CHARACTERISTIC DFES_EnvRef.DFC_ComInvld_635h_HVBAT_PST_CONT_COUNT_SEG4_C "" VALUE 0x8024DC19 Val_Wu8 29.0000000000 DFES_EnvTabVerb 0.00 29.0000000000 FORMAT "%13.10" /end CHARACTERISTIC
/begin CHARACTERISTIC DFES_EnvRef.DFC_ComInvld_645h_HVBAT_PRECHRGE_CONT_COUNT_SEG1_C "" VALUE 0x8024DC1A Val_Wu8 29.0000000000 DFES_EnvTabVerb 0.00 29.0000000000 FORMAT "%13.10" /end CHARACTERISTIC
/begin CHARACTERISTIC DFES_EnvRef.DFC_ComInvld_645h_HVBAT_PRECHRGE_CONT_COUNT_SEG2_C "" VALUE 0x8024DC1B Val_Wu8 29.0000000000 DFES_EnvTabVerb 0.00 29.0000000000 FORMAT "%13.10" /end CHARACTERISTIC
/begin CHARACTERISTIC DFES_EnvRef.DFC_ComInvld_675h_HVBAT_REMAININGBATTCAPACITY_C "" VALUE 0x8024DC1C Val_Wu8 29.0000000000 DFES_EnvTabVerb 0.00 29.0000000000 FORMAT "%13.10" /end CHARACTERISTIC
/begin CHARACTERISTIC DFES_EnvRef.DFC_ACCmprFltLvl1_C "" VALUE 0x8024DC1D Val_Wu8 29.0000000000 DFES_EnvTabVerb 0.00 29.0000000000 FORMAT "%13.10" /end CHARACTERISTIC
/begin CHARACTERISTIC DFES_EnvRef.DFC_ACCmprFltLvl2_C "" VALUE 0x8024DC1E Val_Wu8 29.0000000000 DFES_EnvTabVerb 0.00 29.0000000000 FORMAT "%13.10" /end CHARACTERISTIC
/begin CHARACTERISTIC DFES_EnvRef.DFC_ACCmprFltLvl3_C "" VALUE 0x8024DC1F Val_Wu8 29.0000000000 DFES_EnvTabVerb 0.00 29.0000000000 FORMAT "%13.10" /end CHARACTERISTIC
/begin CHARACTERISTIC DFES_EnvRef.DFC_ACCmprFltLvl4_C "" VALUE 0x8024DC20 Val_Wu8 29.0000000000 DFES_EnvTabVerb 0.00 29.0000000000 FORMAT "%13.10" /end CHARACTERISTIC
/begin CHARACTERISTIC DFES_EnvRef.DFC_ACCmprHiPFlt_C "" VALUE 0x8024DC21 Val_Wu8 29.0000000000 DFES_EnvTabVerb 0.00 29.0000000000 FORMAT "%13.10" /end CHARACTERISTIC
/begin CHARACTERISTIC DFES_EnvRef.DFC_ACCmprInvldCmprSt_C "" VALUE 0x8024DC22 Val_Wu8 29.0000000000 DFES_EnvTabVerb 0.00 29.0000000000 FORMAT "%13.10" /end CHARACTERISTIC
/begin CHARACTERISTIC DFES_EnvRef.DFC_ACCmprInvldElecActPwr_C "" VALUE 0x8024DC23 Val_Wu8 29.0000000000 DFES_EnvTabVerb 0.00 29.0000000000 FORMAT "%13.10" /end CHARACTERISTIC
/begin CHARACTERISTIC DFES_EnvRef.DFC_ACCmprLoPFlt_C "" VALUE 0x8024DC24 Val_Wu8 29.0000000000 DFES_EnvTabVerb 0.00 29.0000000000 FORMAT "%13.10" /end CHARACTERISTIC
/begin CHARACTERISTIC DFES_EnvRef.DFC_AcChrgrIntkTSRCMin_C "" VALUE 0x8024DC25 Val_Wu8 29.0000000000 DFES_EnvTabVerb 0.00 29.0000000000 FORMAT "%13.10" /end CHARACTERISTIC
/begin CHARACTERISTIC DFES_EnvRef.DFC_BattUBMaxBatt_C "" VALUE 0x8024DC26 Val_Wu8 29.0000000000 DFES_EnvTabVerb 0.00 29.0000000000 FORMAT "%13.10" /end CHARACTERISTIC
/begin CHARACTERISTIC DFES_EnvRef.DFC_BattUBMaxNoBatt_C "" VALUE 0x8024DC27 Val_Wu8 29.0000000000 DFES_EnvTabVerb 0.00 29.0000000000 FORMAT "%13.10" /end CHARACTERISTIC
/begin CHARACTERISTIC DFES_EnvRef.DFC_BattUBMinBatt_C "" VALUE 0x8024DC28 Val_Wu8 29.0000000000 DFES_EnvTabVerb 0.00 29.0000000000 FORMAT "%13.10" /end CHARACTERISTIC
/begin CHARACTERISTIC DFES_EnvRef.DFC_BattUBMinNoBatt_C "" VALUE 0x8024DC29 Val_Wu8 29.0000000000 DFES_EnvTabVerb 0.00 29.0000000000 FORMAT "%13.10" /end CHARACTERISTIC
/begin CHARACTERISTIC DFES_EnvRef.DFC_BattUSRCMax_C "" VALUE 0x8024DC2A Val_Wu8 29.0000000000 DFES_EnvTabVerb 0.00 29.0000000000 FORMAT "%13.10" /end CHARACTERISTIC
/begin CHARACTERISTIC DFES_EnvRef.DFC_BattUSRCMin_C "" VALUE 0x8024DC2B Val_Wu8 29.0000000000 DFES_EnvTabVerb 0.00 29.0000000000 FORMAT "%13.10" /end CHARACTERISTIC
/begin CHARACTERISTIC DFES_EnvRef.DFC_BrkBstPHiCautionDfct_C "" VALUE 0x8024DC2C Val_Wu8 29.0000000000 DFES_EnvTabVerb 0.00 29.0000000000 FORMAT "%13.10" /end CHARACTERISTIC
/begin CHARACTERISTIC DFES_EnvRef.DFC_BrkBstPHiWarnDfct_C "" VALUE 0x8024DC2D Val_Wu8 29.0000000000 DFES_EnvTabVerb 0.00 29.0000000000 FORMAT "%13.10" /end CHARACTERISTIC
/begin CHARACTERISTIC DFES_EnvRef.DFC_BrkBstPSnsr12PlausDfct_C "" VALUE 0x8024DC2E Val_Wu8 29.0000000000 DFES_EnvTabVerb 0.00 29.0000000000 FORMAT "%13.10" /end CHARACTERISTIC
/begin CHARACTERISTIC DFES_EnvRef.DFC_BrkBstPSnsr1Scb_C "" VALUE 0x8024DC2F Val_Wu8 29.0000000000 DFES_EnvTabVerb 0.00 29.0000000000 FORMAT "%13.10" /end CHARACTERISTIC
/begin CHARACTERISTIC DFES_EnvRef.DFC_BrkBstPSnsr1Scg_C "" VALUE 0x8024DC30 Val_Wu8 29.0000000000 DFES_EnvTabVerb 0.00 29.0000000000 FORMAT "%13.10" /end CHARACTERISTIC
/begin CHARACTERISTIC DFES_EnvRef.DFC_BrkBstPSnsr2Scb_C "" VALUE 0x8024DC31 Val_Wu8 29.0000000000 DFES_EnvTabVerb 0.00 29.0000000000 FORMAT "%13.10" /end CHARACTERISTIC
/begin CHARACTERISTIC DFES_EnvRef.DFC_BrkBstPSnsr2Scg_C "" VALUE 0x8024DC32 Val_Wu8 29.0000000000 DFES_EnvTabVerb 0.00 29.0000000000 FORMAT "%13.10" /end CHARACTERISTIC
/begin CHARACTERISTIC DFES_EnvRef.DFC_BrkBstPSnsrMax_C "" VALUE 0x8024DC33 Val_Wu8 29.0000000000 DFES_EnvTabVerb 0.00 29.0000000000 FORMAT "%13.10" /end CHARACTERISTIC
/begin CHARACTERISTIC DFES_EnvRef.DFC_BrkBstPSnsrMin_C "" VALUE 0x8024DC34 Val_Wu8 29.0000000000 DFES_EnvTabVerb 0.00 29.0000000000 FORMAT "%13.10" /end CHARACTERISTIC
/begin CHARACTERISTIC DFES_EnvRef.DFC_BrkBstPhyRngChkMax_C "" VALUE 0x8024DC35 Val_Wu8 29.0000000000 DFES_EnvTabVerb 0.00 29.0000000000 FORMAT "%13.10" /end CHARACTERISTIC
/begin CHARACTERISTIC DFES_EnvRef.DFC_BrkBstPhyRngChkMin_C "" VALUE 0x8024DC36 Val_Wu8 29.0000000000 DFES_EnvTabVerb 0.00 29.0000000000 FORMAT "%13.10" /end CHARACTERISTIC
/begin CHARACTERISTIC DFES_EnvRef.DFC_BrkBstPmpHsScb_C "" VALUE 0x8024DC37 Val_Wu8 29.0000000000 DFES_EnvTabVerb 0.00 29.0000000000 FORMAT "%13.10" /end CHARACTERISTIC
/begin CHARACTERISTIC DFES_EnvRef.DFC_BrkBstPmpHsScg_C "" VALUE 0x8024DC38 Val_Wu8 29.0000000000 DFES_EnvTabVerb 0.00 29.0000000000 FORMAT "%13.10" /end CHARACTERISTIC
/begin CHARACTERISTIC DFES_EnvRef.DFC_BrkBstPmpLsOl_C "" VALUE 0x8024DC39 Val_Wu8 29.0000000000 DFES_EnvTabVerb 0.00 29.0000000000 FORMAT "%13.10" /end CHARACTERISTIC
/begin CHARACTERISTIC DFES_EnvRef.DFC_BrkBstPmpLsScb_C "" VALUE 0x8024DC3A Val_Wu8 29.0000000000 DFES_EnvTabVerb 0.00 29.0000000000 FORMAT "%13.10" /end CHARACTERISTIC
/begin CHARACTERISTIC DFES_EnvRef.DFC_BrkBstPmpLsScg_C "" VALUE 0x8024DC3B Val_Wu8 29.0000000000 DFES_EnvTabVerb 0.00 29.0000000000 FORMAT "%13.10" /end CHARACTERISTIC
/begin CHARACTERISTIC DFES_EnvRef.DFC_CbnHeatgHeatrRlyOpend_C "" VALUE 0x8024DC3C Val_Wu8 29.0000000000 DFES_EnvTabVerb 0.00 29.0000000000 FORMAT "%13.10" /end CHARACTERISTIC
/begin CHARACTERISTIC DFES_EnvRef.DFC_CbnHeatgHeatrRlyWldd_C "" VALUE 0x8024DC3D Val_Wu8 29.0000000000 DFES_EnvTabVerb 0.00 29.0000000000 FORMAT "%13.10" /end CHARACTERISTIC
/begin CHARACTERISTIC DFES_EnvRef.DFC_CcsDcIBattExcdd_C "" VALUE 0x8024DC3E Val_Wu8 29.0000000000 DFES_EnvTabVerb 0.00 29.0000000000 FORMAT "%13.10" /end CHARACTERISTIC
/begin CHARACTERISTIC DFES_EnvRef.DFC_CcsDcIEvseOutDe_C "" VALUE 0x8024DC3F Val_Wu8 29.0000000000 DFES_EnvTabVerb 0.00 29.0000000000 FORMAT "%13.10" /end CHARACTERISTIC
/begin CHARACTERISTIC DFES_EnvRef.DFC_CcsDcIOutDe_C "" VALUE 0x8024DC40 Val_Wu8 29.0000000000 DFES_EnvTabVerb 0.00 29.0000000000 FORMAT "%13.10" /end CHARACTERISTIC
/begin CHARACTERISTIC DFES_EnvRef.DFC_CcsDcIOutExcdd_C "" VALUE 0x8024DC41 Val_Wu8 29.0000000000 DFES_EnvTabVerb 0.00 29.0000000000 FORMAT "%13.10" /end CHARACTERISTIC
/begin CHARACTERISTIC DFES_EnvRef.DFC_CcsDcUOutDe_C "" VALUE 0x8024DC42 Val_Wu8 29.0000000000 DFES_EnvTabVerb 0.00 29.0000000000 FORMAT "%13.10" /end CHARACTERISTIC
/begin CHARACTERISTIC DFES_EnvRef.DFC_CcsDcUOutExcdd_C "" VALUE 0x8024DC43 Val_Wu8 29.0000000000 DFES_EnvTabVerb 0.00 29.0000000000 FORMAT "%13.10" /end CHARACTERISTIC
/begin CHARACTERISTIC DFES_EnvRef.DFC_CcsPwrLineChpRstOL_C "" VALUE 0x8024DC44 Val_Wu8 29.0000000000 DFES_EnvTabVerb 0.00 29.0000000000 FORMAT "%13.10" /end CHARACTERISTIC
/begin CHARACTERISTIC DFES_EnvRef.DFC_CcsPwrLineChpRstOvrTemp_C "" VALUE 0x8024DC45 Val_Wu8 29.0000000000 DFES_EnvTabVerb 0.00 29.0000000000 FORMAT "%13.10" /end CHARACTERISTIC
/begin CHARACTERISTIC DFES_EnvRef.DFC_CcsPwrLineChpRstSCB_C "" VALUE 0x8024DC46 Val_Wu8 29.0000000000 DFES_EnvTabVerb 0.00 29.0000000000 FORMAT "%13.10" /end CHARACTERISTIC
/begin CHARACTERISTIC DFES_EnvRef.DFC_CcsPwrLineChpRstSCG_C "" VALUE 0x8024DC47 Val_Wu8 29.0000000000 DFES_EnvTabVerb 0.00 29.0000000000 FORMAT "%13.10" /end CHARACTERISTIC
/begin CHARACTERISTIC DFES_EnvRef.DFC_CcsPwrLineChpVccEnaOL_C "" VALUE 0x8024DC48 Val_Wu8 29.0000000000 DFES_EnvTabVerb 0.00 29.0000000000 FORMAT "%13.10" /end CHARACTERISTIC
/begin CHARACTERISTIC DFES_EnvRef.DFC_CcsPwrLineChpVccEnaOvrTemp_C "" VALUE 0x8024DC49 Val_Wu8 29.0000000000 DFES_EnvTabVerb 0.00 29.0000000000 FORMAT "%13.10" /end CHARACTERISTIC
/begin CHARACTERISTIC DFES_EnvRef.DFC_CcsPwrLineChpVccEnaSCB_C "" VALUE 0x8024DC4A Val_Wu8 29.0000000000 DFES_EnvTabVerb 0.00 29.0000000000 FORMAT "%13.10" /end CHARACTERISTIC
/begin CHARACTERISTIC DFES_EnvRef.DFC_CcsPwrLineChpVccEnaSCG_C "" VALUE 0x8024DC4B Val_Wu8 29.0000000000 DFES_EnvTabVerb 0.00 29.0000000000 FORMAT "%13.10" /end CHARACTERISTIC
/begin CHARACTERISTIC DFES_EnvRef.DFC_CcsPwrLineChpVccSRCMin_C "" VALUE 0x8024DC4C Val_Wu8 29.0000000000 DFES_EnvTabVerb 0.00 29.0000000000 FORMAT "%13.10" /end CHARACTERISTIC
/begin CHARACTERISTIC DFES_EnvRef.DFC_CcsPwrLineComChpTSRCMin_C "" VALUE 0x8024DC4D Val_Wu8 29.0000000000 DFES_EnvTabVerb 0.00 29.0000000000 FORMAT "%13.10" /end CHARACTERISTIC
/begin CHARACTERISTIC DFES_EnvRef.DFC_CtPSwtActrOL_C "" VALUE 0x8024DC4E Val_Wu8 29.0000000000 DFES_EnvTabVerb 0.00 29.0000000000 FORMAT "%13.10" /end CHARACTERISTIC
/begin CHARACTERISTIC DFES_EnvRef.DFC_CtPSwtActrOvrTemp_C "" VALUE 0x8024DC4F Val_Wu8 29.0000000000 DFES_EnvTabVerb 0.00 29.0000000000 FORMAT "%13.10" /end CHARACTERISTIC
/begin CHARACTERISTIC DFES_EnvRef.DFC_CtPSwtActrSCB_C "" VALUE 0x8024DC50 Val_Wu8 29.0000000000 DFES_EnvTabVerb 0.00 29.0000000000 FORMAT "%13.10" /end CHARACTERISTIC
/begin CHARACTERISTIC DFES_EnvRef.DFC_CtPSwtActrSCG_C "" VALUE 0x8024DC51 Val_Wu8 29.0000000000 DFES_EnvTabVerb 0.00 29.0000000000 FORMAT "%13.10" /end CHARACTERISTIC
/begin CHARACTERISTIC DFES_EnvRef.DFC_CtPSwtDiagSRCMin_C "" VALUE 0x8024DC52 Val_Wu8 29.0000000000 DFES_EnvTabVerb 0.00 29.0000000000 FORMAT "%13.10" /end CHARACTERISTIC
/begin CHARACTERISTIC DFES_EnvRef.DFC_CtpCarrFrqSRCMin_C "" VALUE 0x8024DC53 Val_Wu8 29.0000000000 DFES_EnvTabVerb 0.00 29.0000000000 FORMAT "%13.10" /end CHARACTERISTIC
/begin CHARACTERISTIC DFES_EnvRef.DFC_DcChrgrIntkT2SRCMin_C "" VALUE 0x8024DC54 Val_Wu8 29.0000000000 DFES_EnvTabVerb 0.00 29.0000000000 FORMAT "%13.10" /end CHARACTERISTIC
/begin CHARACTERISTIC DFES_EnvRef.DFC_DcChrgrIntkTSRCMin_C "" VALUE 0x8024DC55 Val_Wu8 29.0000000000 DFES_EnvTabVerb 0.00 29.0000000000 FORMAT "%13.10" /end CHARACTERISTIC
/begin CHARACTERISTIC DFES_EnvRef.DFC_DevLibBattUHi_C "" VALUE 0x8024DC56 Val_Wu8 29.0000000000 DFES_EnvTabVerb 0.00 29.0000000000 FORMAT "%13.10" /end CHARACTERISTIC
/begin CHARACTERISTIC DFES_EnvRef.DFC_DevLibBattULo_C "" VALUE 0x8024DC57 Val_Wu8 29.0000000000 DFES_EnvTabVerb 0.00 29.0000000000 FORMAT "%13.10" /end CHARACTERISTIC
/begin CHARACTERISTIC DFES_EnvRef.DFC_EmWakeupSigOL_C "" VALUE 0x8024DC58 Val_Wu8 29.0000000000 DFES_EnvTabVerb 0.00 29.0000000000 FORMAT "%13.10" /end CHARACTERISTIC
/begin CHARACTERISTIC DFES_EnvRef.DFC_EmWakeupSigOvrTemp_C "" VALUE 0x8024DC59 Val_Wu8 29.0000000000 DFES_EnvTabVerb 0.00 29.0000000000 FORMAT "%13.10" /end CHARACTERISTIC
/begin CHARACTERISTIC DFES_EnvRef.DFC_EmWakeupSigSCB_C "" VALUE 0x8024DC5A Val_Wu8 29.0000000000 DFES_EnvTabVerb 0.00 29.0000000000 FORMAT "%13.10" /end CHARACTERISTIC
/begin CHARACTERISTIC DFES_EnvRef.DFC_EmWakeupSigSCG_C "" VALUE 0x8024DC5B Val_Wu8 29.0000000000 DFES_EnvTabVerb 0.00 29.0000000000 FORMAT "%13.10" /end CHARACTERISTIC
/begin CHARACTERISTIC DFES_EnvRef.DFC_Fan1OL_C "" VALUE 0x8024DC5C Val_Wu8 29.0000000000 DFES_EnvTabVerb 0.00 29.0000000000 FORMAT "%13.10" /end CHARACTERISTIC
/begin CHARACTERISTIC DFES_EnvRef.DFC_Fan1OvrTemp_C "" VALUE 0x8024DC5D Val_Wu8 29.0000000000 DFES_EnvTabVerb 0.00 29.0000000000 FORMAT "%13.10" /end CHARACTERISTIC
/begin CHARACTERISTIC DFES_EnvRef.DFC_Fan1SCB_C "" VALUE 0x8024DC5E Val_Wu8 29.0000000000 DFES_EnvTabVerb 0.00 29.0000000000 FORMAT "%13.10" /end CHARACTERISTIC
/begin CHARACTERISTIC DFES_EnvRef.DFC_FanRlySCB_C "" VALUE 0x8024DC5F Val_Wu8 29.0000000000 DFES_EnvTabVerb 0.00 29.0000000000 FORMAT "%13.10" /end CHARACTERISTIC
/begin CHARACTERISTIC DFES_EnvRef.DFC_FanRlySCG_C "" VALUE 0x8024DC60 Val_Wu8 29.0000000000 DFES_EnvTabVerb 0.00 29.0000000000 FORMAT "%13.10" /end CHARACTERISTIC
/begin CHARACTERISTIC DFES_EnvRef.DFC_FanSpdSRCMin_C "" VALUE 0x8024DC61 Val_Wu8 29.0000000000 DFES_EnvTabVerb 0.00 29.0000000000 FORMAT "%13.10" /end CHARACTERISTIC
/begin CHARACTERISTIC DFES_EnvRef.DFC_FreonPSRCMin_C "" VALUE 0x8024DC62 Val_Wu8 29.0000000000 DFES_EnvTabVerb 0.00 29.0000000000 FORMAT "%13.10" /end CHARACTERISTIC
/begin CHARACTERISTIC DFES_EnvRef.DFC_HLCCcsPLnCChipTHi_C "" VALUE 0x8024DC63 Val_Wu8 29.0000000000 DFES_EnvTabVerb 0.00 29.0000000000 FORMAT "%13.10" /end CHARACTERISTIC
/begin CHARACTERISTIC DFES_EnvRef.DFC_HeatrCoreTSRCMin_C "" VALUE 0x8024DC64 Val_Wu8 29.0000000000 DFES_EnvTabVerb 0.00 29.0000000000 FORMAT "%13.10" /end CHARACTERISTIC
/begin CHARACTERISTIC DFES_EnvRef.DFC_PwmCtPSRCMin_C "" VALUE 0x8024DC65 Val_Wu8 29.0000000000 DFES_EnvTabVerb 0.00 29.0000000000 FORMAT "%13.10" /end CHARACTERISTIC
/begin CHARACTERISTIC DFES_EnvRef.DFC_PwrDistbnUnitTSRCMin_C "" VALUE 0x8024DC66 Val_Wu8 29.0000000000 DFES_EnvTabVerb 0.00 29.0000000000 FORMAT "%13.10" /end CHARACTERISTIC
/begin CHARACTERISTIC DFES_EnvRef.DFC_SCtPmp1OL_C "" VALUE 0x8024DC67 Val_Wu8 29.0000000000 DFES_EnvTabVerb 0.00 29.0000000000 FORMAT "%13.10" /end CHARACTERISTIC
/begin CHARACTERISTIC DFES_EnvRef.DFC_SCtPmp1OvrTemp_C "" VALUE 0x8024DC68 Val_Wu8 29.0000000000 DFES_EnvTabVerb 0.00 29.0000000000 FORMAT "%13.10" /end CHARACTERISTIC
/begin CHARACTERISTIC DFES_EnvRef.DFC_SCtPmp1SCB_C "" VALUE 0x8024DC69 Val_Wu8 29.0000000000 DFES_EnvTabVerb 0.00 29.0000000000 FORMAT "%13.10" /end CHARACTERISTIC
/begin CHARACTERISTIC DFES_EnvRef.DFC_SCtPmpRlyOL_C "" VALUE 0x8024DC6A Val_Wu8 29.0000000000 DFES_EnvTabVerb 0.00 29.0000000000 FORMAT "%13.10" /end CHARACTERISTIC
/begin CHARACTERISTIC DFES_EnvRef.DFC_SCtPmpRlyOvrTemp_C "" VALUE 0x8024DC6B Val_Wu8 29.0000000000 DFES_EnvTabVerb 0.00 29.0000000000 FORMAT "%13.10" /end CHARACTERISTIC
/begin CHARACTERISTIC DFES_EnvRef.DFC_SCtPmpRlySCB_C "" VALUE 0x8024DC6C Val_Wu8 29.0000000000 DFES_EnvTabVerb 0.00 29.0000000000 FORMAT "%13.10" /end CHARACTERISTIC
/begin CHARACTERISTIC DFES_EnvRef.DFC_SpplCooltPmpRlyOL_C "" VALUE 0x8024DC6D Val_Wu8 29.0000000000 DFES_EnvTabVerb 0.00 29.0000000000 FORMAT "%13.10" /end CHARACTERISTIC
/begin CHARACTERISTIC DFES_EnvRef.DFC_SpplCooltPmpRlyOvrTemp_C "" VALUE 0x8024DC6E Val_Wu8 29.0000000000 DFES_EnvTabVerb 0.00 29.0000000000 FORMAT "%13.10" /end CHARACTERISTIC
/begin CHARACTERISTIC DFES_EnvRef.DFC_SpplCooltPmpRlySCB_C "" VALUE 0x8024DC6F Val_Wu8 29.0000000000 DFES_EnvTabVerb 0.00 29.0000000000 FORMAT "%13.10" /end CHARACTERISTIC
/begin CHARACTERISTIC DFES_EnvRef.DFC_UCtPSRCMin_C "" VALUE 0x8024DC70 Val_Wu8 29.0000000000 DFES_EnvTabVerb 0.00 29.0000000000 FORMAT "%13.10" /end CHARACTERISTIC
/begin CHARACTERISTIC DFES_EnvRef.DFC_UPxP1SRCMin_C "" VALUE 0x8024DC71 Val_Wu8 29.0000000000 DFES_EnvTabVerb 0.00 29.0000000000 FORMAT "%13.10" /end CHARACTERISTIC
/begin CHARACTERISTIC DFES_EnvRef.DFC_ComHSN1CANMute_C "" VALUE 0x8024DC72 Val_Wu8 29.0000000000 DFES_EnvTabVerb 0.00 29.0000000000 FORMAT "%13.10" /end CHARACTERISTIC
/begin CHARACTERISTIC DFES_EnvRef.DFC_ComHSN3CANMute_C "" VALUE 0x8024DC73 Val_Wu8 29.0000000000 DFES_EnvTabVerb 0.00 29.0000000000 FORMAT "%13.10" /end CHARACTERISTIC
/begin CHARACTERISTIC DFES_EnvRef.DFC_AcChrgrIntkTPhysRngHi_C "" VALUE 0x8024DC74 Val_Wu8 29.0000000000 DFES_EnvTabVerb 0.00 29.0000000000 FORMAT "%13.10" /end CHARACTERISTIC
/begin CHARACTERISTIC DFES_EnvRef.DFC_AcChrgrIntkTPhysRngLo_C "" VALUE 0x8024DC75 Val_Wu8 29.0000000000 DFES_EnvTabVerb 0.00 29.0000000000 FORMAT "%13.10" /end CHARACTERISTIC
/begin CHARACTERISTIC DFES_EnvRef.DFC_AcChrgrIntkTSRCOpn_C "" VALUE 0x8024DC76 Val_Wu8 29.0000000000 DFES_EnvTabVerb 0.00 29.0000000000 FORMAT "%13.10" /end CHARACTERISTIC
/begin CHARACTERISTIC DFES_EnvRef.DFC_CcsPwrLineChpVccPhysRngHi_C "" VALUE 0x8024DC77 Val_Wu8 29.0000000000 DFES_EnvTabVerb 0.00 29.0000000000 FORMAT "%13.10" /end CHARACTERISTIC
/begin CHARACTERISTIC DFES_EnvRef.DFC_CcsPwrLineChpVccPhysRngLo_C "" VALUE 0x8024DC78 Val_Wu8 29.0000000000 DFES_EnvTabVerb 0.00 29.0000000000 FORMAT "%13.10" /end CHARACTERISTIC
/begin CHARACTERISTIC DFES_EnvRef.DFC_CcsPwrLineChpVccSRCOpn_C "" VALUE 0x8024DC79 Val_Wu8 29.0000000000 DFES_EnvTabVerb 0.00 29.0000000000 FORMAT "%13.10" /end CHARACTERISTIC
/begin CHARACTERISTIC DFES_EnvRef.DFC_CcsPwrLineComChpTPhysRngHi_C "" VALUE 0x8024DC7A Val_Wu8 29.0000000000 DFES_EnvTabVerb 0.00 29.0000000000 FORMAT "%13.10" /end CHARACTERISTIC
/begin CHARACTERISTIC DFES_EnvRef.DFC_CcsPwrLineComChpTPhysRngLo_C "" VALUE 0x8024DC7B Val_Wu8 29.0000000000 DFES_EnvTabVerb 0.00 29.0000000000 FORMAT "%13.10" /end CHARACTERISTIC
/begin CHARACTERISTIC DFES_EnvRef.DFC_CcsPwrLineComChpTSRCOpn_C "" VALUE 0x8024DC7C Val_Wu8 29.0000000000 DFES_EnvTabVerb 0.00 29.0000000000 FORMAT "%13.10" /end CHARACTERISTIC
/begin CHARACTERISTIC DFES_EnvRef.DFC_CtPSwtDiagPhysRngHi_C "" VALUE 0x8024DC7D Val_Wu8 29.0000000000 DFES_EnvTabVerb 0.00 29.0000000000 FORMAT "%13.10" /end CHARACTERISTIC
/begin CHARACTERISTIC DFES_EnvRef.DFC_CtPSwtDiagPhysRngLo_C "" VALUE 0x8024DC7E Val_Wu8 29.0000000000 DFES_EnvTabVerb 0.00 29.0000000000 FORMAT "%13.10" /end CHARACTERISTIC
/begin CHARACTERISTIC DFES_EnvRef.DFC_CtPSwtDiagSRCOpn_C "" VALUE 0x8024DC7F Val_Wu8 29.0000000000 DFES_EnvTabVerb 0.00 29.0000000000 FORMAT "%13.10" /end CHARACTERISTIC
/begin CHARACTERISTIC DFES_EnvRef.DFC_CtpCarrFrqPhysRngHi_C "" VALUE 0x8024DC80 Val_Wu8 29.0000000000 DFES_EnvTabVerb 0.00 29.0000000000 FORMAT "%13.10" /end CHARACTERISTIC
/begin CHARACTERISTIC DFES_EnvRef.DFC_CtpCarrFrqPhysRngLo_C "" VALUE 0x8024DC81 Val_Wu8 29.0000000000 DFES_EnvTabVerb 0.00 29.0000000000 FORMAT "%13.10" /end CHARACTERISTIC
/begin CHARACTERISTIC DFES_EnvRef.DFC_CtpCarrFrqSRCMax_C "" VALUE 0x8024DC82 Val_Wu8 29.0000000000 DFES_EnvTabVerb 0.00 29.0000000000 FORMAT "%13.10" /end CHARACTERISTIC
/begin CHARACTERISTIC DFES_EnvRef.DFC_DcChrgrIntkT2PhysRngHi_C "" VALUE 0x8024DC83 Val_Wu8 29.0000000000 DFES_EnvTabVerb 0.00 29.0000000000 FORMAT "%13.10" /end CHARACTERISTIC
/begin CHARACTERISTIC DFES_EnvRef.DFC_DcChrgrIntkT2PhysRngLo_C "" VALUE 0x8024DC84 Val_Wu8 29.0000000000 DFES_EnvTabVerb 0.00 29.0000000000 FORMAT "%13.10" /end CHARACTERISTIC
/begin CHARACTERISTIC DFES_EnvRef.DFC_DcChrgrIntkT2SRCOpn_C "" VALUE 0x8024DC85 Val_Wu8 29.0000000000 DFES_EnvTabVerb 0.00 29.0000000000 FORMAT "%13.10" /end CHARACTERISTIC
/begin CHARACTERISTIC DFES_EnvRef.DFC_DcChrgrIntkTPhysRngHi_C "" VALUE 0x8024DC86 Val_Wu8 29.0000000000 DFES_EnvTabVerb 0.00 29.0000000000 FORMAT "%13.10" /end CHARACTERISTIC
/begin CHARACTERISTIC DFES_EnvRef.DFC_DcChrgrIntkTPhysRngLo_C "" VALUE 0x8024DC87 Val_Wu8 29.0000000000 DFES_EnvTabVerb 0.00 29.0000000000 FORMAT "%13.10" /end CHARACTERISTIC
/begin CHARACTERISTIC DFES_EnvRef.DFC_DcChrgrIntkTSRCOpn_C "" VALUE 0x8024DC88 Val_Wu8 29.0000000000 DFES_EnvTabVerb 0.00 29.0000000000 FORMAT "%13.10" /end CHARACTERISTIC
/begin CHARACTERISTIC DFES_EnvRef.DFC_Fan1SCG_C "" VALUE 0x8024DC89 Val_Wu8 29.0000000000 DFES_EnvTabVerb 0.00 29.0000000000 FORMAT "%13.10" /end CHARACTERISTIC
/begin CHARACTERISTIC DFES_EnvRef.DFC_FanSpdPhysRngHi_C "" VALUE 0x8024DC8A Val_Wu8 29.0000000000 DFES_EnvTabVerb 0.00 29.0000000000 FORMAT "%13.10" /end CHARACTERISTIC
/begin CHARACTERISTIC DFES_EnvRef.DFC_FanSpdPhysRngLo_C "" VALUE 0x8024DC8B Val_Wu8 29.0000000000 DFES_EnvTabVerb 0.00 29.0000000000 FORMAT "%13.10" /end CHARACTERISTIC
/begin CHARACTERISTIC DFES_EnvRef.DFC_FanSpdSRCOpn_C "" VALUE 0x8024DC8C Val_Wu8 29.0000000000 DFES_EnvTabVerb 0.00 29.0000000000 FORMAT "%13.10" /end CHARACTERISTIC
/begin CHARACTERISTIC DFES_EnvRef.DFC_FreonPPhysRngHi_C "" VALUE 0x8024DC8D Val_Wu8 29.0000000000 DFES_EnvTabVerb 0.00 29.0000000000 FORMAT "%13.10" /end CHARACTERISTIC
/begin CHARACTERISTIC DFES_EnvRef.DFC_FreonPPhysRngLo_C "" VALUE 0x8024DC8E Val_Wu8 29.0000000000 DFES_EnvTabVerb 0.00 29.0000000000 FORMAT "%13.10" /end CHARACTERISTIC
/begin CHARACTERISTIC DFES_EnvRef.DFC_FreonPSRCOpn_C "" VALUE 0x8024DC8F Val_Wu8 29.0000000000 DFES_EnvTabVerb 0.00 29.0000000000 FORMAT "%13.10" /end CHARACTERISTIC
/begin CHARACTERISTIC DFES_EnvRef.DFC_HeatrCoreTPhysRngHi_C "" VALUE 0x8024DC90 Val_Wu8 29.0000000000 DFES_EnvTabVerb 0.00 29.0000000000 FORMAT "%13.10" /end CHARACTERISTIC
/begin CHARACTERISTIC DFES_EnvRef.DFC_HeatrCoreTPhysRngLo_C "" VALUE 0x8024DC91 Val_Wu8 29.0000000000 DFES_EnvTabVerb 0.00 29.0000000000 FORMAT "%13.10" /end CHARACTERISTIC
/begin CHARACTERISTIC DFES_EnvRef.DFC_HeatrCoreTSRCOpn_C "" VALUE 0x8024DC92 Val_Wu8 29.0000000000 DFES_EnvTabVerb 0.00 29.0000000000 FORMAT "%13.10" /end CHARACTERISTIC
/begin CHARACTERISTIC DFES_EnvRef.DFC_HvGridUMaxSftyLim_C "" VALUE 0x8024DC93 Val_Wu8 29.0000000000 DFES_EnvTabVerb 0.00 29.0000000000 FORMAT "%13.10" /end CHARACTERISTIC
/begin CHARACTERISTIC DFES_EnvRef.DFC_HvGridUMinSftyLim_C "" VALUE 0x8024DC94 Val_Wu8 29.0000000000 DFES_EnvTabVerb 0.00 29.0000000000 FORMAT "%13.10" /end CHARACTERISTIC
/begin CHARACTERISTIC DFES_EnvRef.DFC_HvGridUPlausy_C "" VALUE 0x8024DC95 Val_Wu8 29.0000000000 DFES_EnvTabVerb 0.00 29.0000000000 FORMAT "%13.10" /end CHARACTERISTIC
/begin CHARACTERISTIC DFES_EnvRef.DFC_IntlckChrgPlgHBrgOpnLd_C "" VALUE 0x8024DC96 Val_Wu8 29.0000000000 DFES_EnvTabVerb 0.00 29.0000000000 FORMAT "%13.10" /end CHARACTERISTIC
/begin CHARACTERISTIC DFES_EnvRef.DFC_IntlckChrgPlgHBrgOvrCurr_C "" VALUE 0x8024DC97 Val_Wu8 29.0000000000 DFES_EnvTabVerb 0.00 29.0000000000 FORMAT "%13.10" /end CHARACTERISTIC
/begin CHARACTERISTIC DFES_EnvRef.DFC_IntlckChrgPlgHBrgOvrTemp_C "" VALUE 0x8024DC98 Val_Wu8 29.0000000000 DFES_EnvTabVerb 0.00 29.0000000000 FORMAT "%13.10" /end CHARACTERISTIC
/begin CHARACTERISTIC DFES_EnvRef.DFC_IntlckChrgPlgHBrgShCirBatt1_C "" VALUE 0x8024DC99 Val_Wu8 29.0000000000 DFES_EnvTabVerb 0.00 29.0000000000 FORMAT "%13.10" /end CHARACTERISTIC
/begin CHARACTERISTIC DFES_EnvRef.DFC_IntlckChrgPlgHBrgShCirBatt2_C "" VALUE 0x8024DC9A Val_Wu8 29.0000000000 DFES_EnvTabVerb 0.00 29.0000000000 FORMAT "%13.10" /end CHARACTERISTIC
/begin CHARACTERISTIC DFES_EnvRef.DFC_IntlckChrgPlgHBrgShCirGnd1_C "" VALUE 0x8024DC9B Val_Wu8 29.0000000000 DFES_EnvTabVerb 0.00 29.0000000000 FORMAT "%13.10" /end CHARACTERISTIC
/begin CHARACTERISTIC DFES_EnvRef.DFC_IntlckChrgPlgHBrgShCirGnd2_C "" VALUE 0x8024DC9C Val_Wu8 29.0000000000 DFES_EnvTabVerb 0.00 29.0000000000 FORMAT "%13.10" /end CHARACTERISTIC
/begin CHARACTERISTIC DFES_EnvRef.DFC_IntlckChrgPlgHBrgShCirOvrLd_C "" VALUE 0x8024DC9D Val_Wu8 29.0000000000 DFES_EnvTabVerb 0.00 29.0000000000 FORMAT "%13.10" /end CHARACTERISTIC
/begin CHARACTERISTIC DFES_EnvRef.DFC_IntlckChrgPlgHBrgTempOvrCurr_C "" VALUE 0x8024DC9E Val_Wu8 29.0000000000 DFES_EnvTabVerb 0.00 29.0000000000 FORMAT "%13.10" /end CHARACTERISTIC
/begin CHARACTERISTIC DFES_EnvRef.DFC_IntlckChrgPlgHBrgUndrVltg_C "" VALUE 0x8024DC9F Val_Wu8 29.0000000000 DFES_EnvTabVerb 0.00 29.0000000000 FORMAT "%13.10" /end CHARACTERISTIC
/begin CHARACTERISTIC DFES_EnvRef.DFC_IntlckChrgPlgPosnRngFlt_C "" VALUE 0x8024DCA0 Val_Wu8 29.0000000000 DFES_EnvTabVerb 0.00 29.0000000000 FORMAT "%13.10" /end CHARACTERISTIC
/begin CHARACTERISTIC DFES_EnvRef.DFC_IntlckChrgPlgPosnSrcMax_C "" VALUE 0x8024DCA1 Val_Wu8 29.0000000000 DFES_EnvTabVerb 0.00 29.0000000000 FORMAT "%13.10" /end CHARACTERISTIC
/begin CHARACTERISTIC DFES_EnvRef.DFC_IntlckChrgPlgPosnSrcMin_C "" VALUE 0x8024DCA2 Val_Wu8 29.0000000000 DFES_EnvTabVerb 0.00 29.0000000000 FORMAT "%13.10" /end CHARACTERISTIC
/begin CHARACTERISTIC DFES_EnvRef.DFC_PwmCtPPhysRngHi_C "" VALUE 0x8024DCA3 Val_Wu8 29.0000000000 DFES_EnvTabVerb 0.00 29.0000000000 FORMAT "%13.10" /end CHARACTERISTIC
/begin CHARACTERISTIC DFES_EnvRef.DFC_PwmCtPPhysRngLo_C "" VALUE 0x8024DCA4 Val_Wu8 29.0000000000 DFES_EnvTabVerb 0.00 29.0000000000 FORMAT "%13.10" /end CHARACTERISTIC
/begin CHARACTERISTIC DFES_EnvRef.DFC_PwmCtPSRCMax_C "" VALUE 0x8024DCA5 Val_Wu8 29.0000000000 DFES_EnvTabVerb 0.00 29.0000000000 FORMAT "%13.10" /end CHARACTERISTIC
/begin CHARACTERISTIC DFES_EnvRef.DFC_PwrDistbnUnitTPhysRngHi_C "" VALUE 0x8024DCA6 Val_Wu8 29.0000000000 DFES_EnvTabVerb 0.00 29.0000000000 FORMAT "%13.10" /end CHARACTERISTIC
/begin CHARACTERISTIC DFES_EnvRef.DFC_PwrDistbnUnitTPhysRngLo_C "" VALUE 0x8024DCA7 Val_Wu8 29.0000000000 DFES_EnvTabVerb 0.00 29.0000000000 FORMAT "%13.10" /end CHARACTERISTIC
/begin CHARACTERISTIC DFES_EnvRef.DFC_PwrDistbnUnitTSRCOpn_C "" VALUE 0x8024DCA8 Val_Wu8 29.0000000000 DFES_EnvTabVerb 0.00 29.0000000000 FORMAT "%13.10" /end CHARACTERISTIC
/begin CHARACTERISTIC DFES_EnvRef.DFC_SCtPmpRlySCG_C "" VALUE 0x8024DCA9 Val_Wu8 29.0000000000 DFES_EnvTabVerb 0.00 29.0000000000 FORMAT "%13.10" /end CHARACTERISTIC
/begin CHARACTERISTIC DFES_EnvRef.DFC_SpplCooltPmpRlySCG_C "" VALUE 0x8024DCAA Val_Wu8 29.0000000000 DFES_EnvTabVerb 0.00 29.0000000000 FORMAT "%13.10" /end CHARACTERISTIC
/begin CHARACTERISTIC DFES_EnvRef.DFC_UCtPPhysRngHi_C "" VALUE 0x8024DCAB Val_Wu8 29.0000000000 DFES_EnvTabVerb 0.00 29.0000000000 FORMAT "%13.10" /end CHARACTERISTIC
/begin CHARACTERISTIC DFES_EnvRef.DFC_UCtPPhysRngLo_C "" VALUE 0x8024DCAC Val_Wu8 29.0000000000 DFES_EnvTabVerb 0.00 29.0000000000 FORMAT "%13.10" /end CHARACTERISTIC
/begin CHARACTERISTIC DFES_EnvRef.DFC_UCtPSRCOpn_C "" VALUE 0x8024DCAD Val_Wu8 29.0000000000 DFES_EnvTabVerb 0.00 29.0000000000 FORMAT "%13.10" /end CHARACTERISTIC
/begin CHARACTERISTIC DFES_EnvRef.DFC_UPxP1PhysRngHi_C "" VALUE 0x8024DCAE Val_Wu8 29.0000000000 DFES_EnvTabVerb 0.00 29.0000000000 FORMAT "%13.10" /end CHARACTERISTIC
/begin CHARACTERISTIC DFES_EnvRef.DFC_UPxP1PhysRngLo_C "" VALUE 0x8024DCAF Val_Wu8 29.0000000000 DFES_EnvTabVerb 0.00 29.0000000000 FORMAT "%13.10" /end CHARACTERISTIC
/begin CHARACTERISTIC DFES_EnvRef.DFC_UPxP1SRCOpn_C "" VALUE 0x8024DCB0 Val_Wu8 29.0000000000 DFES_EnvTabVerb 0.00 29.0000000000 FORMAT "%13.10" /end CHARACTERISTIC
/begin CHARACTERISTIC DFES_EnvRef.DFC_VehVPhysRngHi_C "" VALUE 0x8024DCB1 Val_Wu8 29.0000000000 DFES_EnvTabVerb 0.00 29.0000000000 FORMAT "%13.10" /end CHARACTERISTIC
/begin CHARACTERISTIC DFES_EnvRef.DFC_VehVPhysRngLo_C "" VALUE 0x8024DCB2 Val_Wu8 29.0000000000 DFES_EnvTabVerb 0.00 29.0000000000 FORMAT "%13.10" /end CHARACTERISTIC
/begin CHARACTERISTIC DFES_EnvRef.DFC_VehVSigCan_C "" VALUE 0x8024DCB3 Val_Wu8 29.0000000000 DFES_EnvTabVerb 0.00 29.0000000000 FORMAT "%13.10" /end CHARACTERISTIC
/begin CHARACTERISTIC DFES_EnvRef.DFC_VehVSigCanSafe_C "" VALUE 0x8024DCB4 Val_Wu8 29.0000000000 DFES_EnvTabVerb 0.00 29.0000000000 FORMAT "%13.10" /end CHARACTERISTIC
/begin CHARACTERISTIC DFES_EnvRef.DFC_SCtPmp1DiagGrdKey1_C "" VALUE 0x8024DCB5 Val_Wu8 29.0000000000 DFES_EnvTabVerb 0.00 29.0000000000 FORMAT "%13.10" /end CHARACTERISTIC
/begin CHARACTERISTIC DFES_EnvRef.DFC_SCtPmp1DiagGrdKey2_C "" VALUE 0x8024DCB6 Val_Wu8 29.0000000000 DFES_EnvTabVerb 0.00 29.0000000000 FORMAT "%13.10" /end CHARACTERISTIC
/begin CHARACTERISTIC DFES_EnvRef.DFC_SCtPmp1DiagGrdKey3_C "" VALUE 0x8024DCB7 Val_Wu8 29.0000000000 DFES_EnvTabVerb 0.00 29.0000000000 FORMAT "%13.10" /end CHARACTERISTIC
/begin CHARACTERISTIC DFES_EnvRef.DFC_SCtPmp1DiagGrdKey4_C "" VALUE 0x8024DCB8 Val_Wu8 29.0000000000 DFES_EnvTabVerb 0.00 29.0000000000 FORMAT "%13.10" /end CHARACTERISTIC
/begin CHARACTERISTIC DFES_EnvRef.DFC_SCtPmp1DiagGrdKey5_C "" VALUE 0x8024DCB9 Val_Wu8 29.0000000000 DFES_EnvTabVerb 0.00 29.0000000000 FORMAT "%13.10" /end CHARACTERISTIC
/begin CHARACTERISTIC DFES_EnvRef.DFC_ChrgPlgLiveCntctHzrdCcs_C "" VALUE 0x8024DCBA Val_Wu8 29.0000000000 DFES_EnvTabVerb 0.00 29.0000000000 FORMAT "%13.10" /end CHARACTERISTIC
/begin CHARACTERISTIC DFES_EnvRef.DFC_ChrgPlgProxPltImps_C "" VALUE 0x8024DCBB Val_Wu8 29.0000000000 DFES_EnvTabVerb 0.00 29.0000000000 FORMAT "%13.10" /end CHARACTERISTIC
/begin CHARACTERISTIC DFES_EnvRef.DFC_ChrgPlgTHiCcsDc_C "" VALUE 0x8024DCBC Val_Wu8 29.0000000000 DFES_EnvTabVerb 0.00 29.0000000000 FORMAT "%13.10" /end CHARACTERISTIC
/begin CHARACTERISTIC DFES_EnvRef.DFC_ElMActvDchaFailr_C "" VALUE 0x8024DCBD Val_Wu8 29.0000000000 DFES_EnvTabVerb 0.00 29.0000000000 FORMAT "%13.10" /end CHARACTERISTIC
/begin CHARACTERISTIC DFES_EnvRef.DFC_ElMActvDchaFlt_C "" VALUE 0x8024DCBE Val_Wu8 29.0000000000 DFES_EnvTabVerb 0.00 29.0000000000 FORMAT "%13.10" /end CHARACTERISTIC
/begin CHARACTERISTIC DFES_EnvRef.DFC_ElMFbdnIvtrModDrv01_C "" VALUE 0x8024DCBF Val_Wu8 29.0000000000 DFES_EnvTabVerb 0.00 29.0000000000 FORMAT "%13.10" /end CHARACTERISTIC
/begin CHARACTERISTIC DFES_EnvRef.DFC_ElMImobAuthent_C "" VALUE 0x8024DCC0 Val_Wu8 29.0000000000 DFES_EnvTabVerb 0.00 29.0000000000 FORMAT "%13.10" /end CHARACTERISTIC
/begin CHARACTERISTIC DFES_EnvRef.DFC_ElMIsoMonFlt_C "" VALUE 0x8024DCC1 Val_Wu8 29.0000000000 DFES_EnvTabVerb 0.00 29.0000000000 FORMAT "%13.10" /end CHARACTERISTIC
/begin CHARACTERISTIC DFES_EnvRef.DFC_ElMIsoMonPlausyFlt_C "" VALUE 0x8024DCC2 Val_Wu8 29.0000000000 DFES_EnvTabVerb 0.00 29.0000000000 FORMAT "%13.10" /end CHARACTERISTIC
/begin CHARACTERISTIC DFES_EnvRef.DFC_ElMIvtrCooltT01_C "" VALUE 0x8024DCC3 Val_Wu8 29.0000000000 DFES_EnvTabVerb 0.00 29.0000000000 FORMAT "%13.10" /end CHARACTERISTIC
/begin CHARACTERISTIC DFES_EnvRef.DFC_ElMIvtrEmgyShtDwn01_C "" VALUE 0x8024DCC4 Val_Wu8 29.0000000000 DFES_EnvTabVerb 0.00 29.0000000000 FORMAT "%13.10" /end CHARACTERISTIC
/begin CHARACTERISTIC DFES_EnvRef.DFC_ElMIvtrFailr01_C "" VALUE 0x8024DCC5 Val_Wu8 29.0000000000 DFES_EnvTabVerb 0.00 29.0000000000 FORMAT "%13.10" /end CHARACTERISTIC
/begin CHARACTERISTIC DFES_EnvRef.DFC_ElMIvtrIntlck01_C "" VALUE 0x8024DCC6 Val_Wu8 29.0000000000 DFES_EnvTabVerb 0.00 29.0000000000 FORMAT "%13.10" /end CHARACTERISTIC
/begin CHARACTERISTIC DFES_EnvRef.DFC_ElMIvtrTErr01_C "" VALUE 0x8024DCC7 Val_Wu8 29.0000000000 DFES_EnvTabVerb 0.00 29.0000000000 FORMAT "%13.10" /end CHARACTERISTIC
/begin CHARACTERISTIC DFES_EnvRef.DFC_ElMOverSpdNeg01_C "" VALUE 0x8024DCC8 Val_Wu8 29.0000000000 DFES_EnvTabVerb 0.00 29.0000000000 FORMAT "%13.10" /end CHARACTERISTIC
/begin CHARACTERISTIC DFES_EnvRef.DFC_ElMOverSpdPos01_C "" VALUE 0x8024DCC9 Val_Wu8 29.0000000000 DFES_EnvTabVerb 0.00 29.0000000000 FORMAT "%13.10" /end CHARACTERISTIC
/begin CHARACTERISTIC DFES_EnvRef.DFC_ElMOverTqNeg01_C "" VALUE 0x8024DCCA Val_Wu8 29.0000000000 DFES_EnvTabVerb 0.00 29.0000000000 FORMAT "%13.10" /end CHARACTERISTIC
/begin CHARACTERISTIC DFES_EnvRef.DFC_ElMOverTqPos01_C "" VALUE 0x8024DCCB Val_Wu8 29.0000000000 DFES_EnvTabVerb 0.00 29.0000000000 FORMAT "%13.10" /end CHARACTERISTIC
/begin CHARACTERISTIC DFES_EnvRef.DFC_ElMPwrAuthn_C "" VALUE 0x8024DCCC Val_Wu8 29.0000000000 DFES_EnvTabVerb 0.00 29.0000000000 FORMAT "%13.10" /end CHARACTERISTIC
/begin CHARACTERISTIC DFES_EnvRef.DFC_ElMSpdErr01_C "" VALUE 0x8024DCCD Val_Wu8 29.0000000000 DFES_EnvTabVerb 0.00 29.0000000000 FORMAT "%13.10" /end CHARACTERISTIC
/begin CHARACTERISTIC DFES_EnvRef.DFC_ElMSvs01_C "" VALUE 0x8024DCCE Val_Wu8 29.0000000000 DFES_EnvTabVerb 0.00 29.0000000000 FORMAT "%13.10" /end CHARACTERISTIC
/begin CHARACTERISTIC DFES_EnvRef.DFC_PEnvCcMax_C "" VALUE 0x8024DCCF Val_Wu8 29.0000000000 DFES_EnvTabVerb 0.00 29.0000000000 FORMAT "%13.10" /end CHARACTERISTIC
/begin CHARACTERISTIC DFES_EnvRef.DFC_PEnvCcMin_C "" VALUE 0x8024DCD0 Val_Wu8 29.0000000000 DFES_EnvTabVerb 0.00 29.0000000000 FORMAT "%13.10" /end CHARACTERISTIC
/begin CHARACTERISTIC DFES_EnvRef.DFC_PEnvRngChkMax_C "" VALUE 0x8024DCD1 Val_Wu8 29.0000000000 DFES_EnvTabVerb 0.00 29.0000000000 FORMAT "%13.10" /end CHARACTERISTIC
/begin CHARACTERISTIC DFES_EnvRef.DFC_PEnvRngChkMin_C "" VALUE 0x8024DCD2 Val_Wu8 29.0000000000 DFES_EnvTabVerb 0.00 29.0000000000 FORMAT "%13.10" /end CHARACTERISTIC
/begin CHARACTERISTIC DFES_EnvRef.DFC_PEnvSnsrPlaus_C "" VALUE 0x8024DCD3 Val_Wu8 29.0000000000 DFES_EnvTabVerb 0.00 29.0000000000 FORMAT "%13.10" /end CHARACTERISTIC
/begin CHARACTERISTIC DFES_EnvRef.DFC_BrkBstPmpPlausGenn_C "" VALUE 0x8024DCD4 Val_Wu8 29.0000000000 DFES_EnvTabVerb 0.00 29.0000000000 FORMAT "%13.10" /end CHARACTERISTIC
/begin CHARACTERISTIC DFES_EnvRef.DFC_CbnHeatrRlyLfLoWarn_C "" VALUE 0x8024DCD5 Val_Wu8 29.0000000000 DFES_EnvTabVerb 0.00 29.0000000000 FORMAT "%13.10" /end CHARACTERISTIC
/begin CHARACTERISTIC DFES_EnvRef.DFC_ChgrPlugLockPinByndClsd_C "" VALUE 0x8024DCD6 Val_Wu8 29.0000000000 DFES_EnvTabVerb 0.00 29.0000000000 FORMAT "%13.10" /end CHARACTERISTIC
/begin CHARACTERISTIC DFES_EnvRef.DFC_ChgrPlugLockPinMoveWoCmd_C "" VALUE 0x8024DCD7 Val_Wu8 29.0000000000 DFES_EnvTabVerb 0.00 29.0000000000 FORMAT "%13.10" /end CHARACTERISTIC
/begin CHARACTERISTIC DFES_EnvRef.DFC_ChgrPlugLockPinStuckInClsd_C "" VALUE 0x8024DCD8 Val_Wu8 29.0000000000 DFES_EnvTabVerb 0.00 29.0000000000 FORMAT "%13.10" /end CHARACTERISTIC
/begin CHARACTERISTIC DFES_EnvRef.DFC_ChgrPlugLockPinStuckInOpen_C "" VALUE 0x8024DCD9 Val_Wu8 29.0000000000 DFES_EnvTabVerb 0.00 29.0000000000 FORMAT "%13.10" /end CHARACTERISTIC
/begin CHARACTERISTIC DFES_EnvRef.DFC_ChrgrStErr_C "" VALUE 0x8024DCDA Val_Wu8 29.0000000000 DFES_EnvTabVerb 0.00 29.0000000000 FORMAT "%13.10" /end CHARACTERISTIC
/begin CHARACTERISTIC DFES_EnvRef.DFC_ComHSN1BusOff_C "" VALUE 0x8024DCDB Val_Wu8 29.0000000000 DFES_EnvTabVerb 0.00 29.0000000000 FORMAT "%13.10" /end CHARACTERISTIC
/begin CHARACTERISTIC DFES_EnvRef.DFC_ComHSN3BusOff_C "" VALUE 0x8024DCDC Val_Wu8 29.0000000000 DFES_EnvTabVerb 0.00 29.0000000000 FORMAT "%13.10" /end CHARACTERISTIC
/begin CHARACTERISTIC DFES_EnvRef.DFC_ComVCInval_C "" VALUE 0x8024DCDD Val_Wu8 29.0000000000 DFES_EnvTabVerb 0.00 29.0000000000 FORMAT "%13.10" /end CHARACTERISTIC
/begin CHARACTERISTIC DFES_EnvRef.DFC_EemDcdcPrecSpdInhb_C "" VALUE 0x8024DCDE Val_Wu8 29.0000000000 DFES_EnvTabVerb 0.00 29.0000000000 FORMAT "%13.10" /end CHARACTERISTIC
/begin CHARACTERISTIC DFES_EnvRef.DFC_ExpPwrLatch_C "" VALUE 0x8024DCDF Val_Wu8 29.0000000000 DFES_EnvTabVerb 0.00 29.0000000000 FORMAT "%13.10" /end CHARACTERISTIC
/begin CHARACTERISTIC DFES_EnvRef.DFC_FanMaxOvrd_C "" VALUE 0x8024DCE0 Val_Wu8 29.0000000000 DFES_EnvTabVerb 0.00 29.0000000000 FORMAT "%13.10" /end CHARACTERISTIC
/begin CHARACTERISTIC DFES_EnvRef.DFC_HLCCcsGnrlComErr_C "" VALUE 0x8024DCE1 Val_Wu8 29.0000000000 DFES_EnvTabVerb 0.00 29.0000000000 FORMAT "%13.10" /end CHARACTERISTIC
/begin CHARACTERISTIC DFES_EnvRef.DFC_InmLINNodeHVACPanelAbsnt_C "" VALUE 0x8024DCE2 Val_Wu8 29.0000000000 DFES_EnvTabVerb 0.00 29.0000000000 FORMAT "%13.10" /end CHARACTERISTIC
/begin CHARACTERISTIC DFES_EnvRef.DFC_ResetRcvNotAllwd_C "" VALUE 0x8024DCE3 Val_Wu8 29.0000000000 DFES_EnvTabVerb 0.00 29.0000000000 FORMAT "%13.10" /end CHARACTERISTIC
/begin CHARACTERISTIC DFES_EnvRef.DFC_TelltlCooltPlaus_C "" VALUE 0x8024DCE4 Val_Wu8 29.0000000000 DFES_EnvTabVerb 0.00 29.0000000000 FORMAT "%13.10" /end CHARACTERISTIC
/begin CHARACTERISTIC DFES_EnvRef.DFC_MRlyOL_C "" VALUE 0x8024DCE5 Val_Wu8 29.0000000000 DFES_EnvTabVerb 0.00 29.0000000000 FORMAT "%13.10" /end CHARACTERISTIC
/begin CHARACTERISTIC DFES_EnvRef.DFC_MRlySCB_C "" VALUE 0x8024DCE6 Val_Wu8 29.0000000000 DFES_EnvTabVerb 0.00 29.0000000000 FORMAT "%13.10" /end CHARACTERISTIC
/begin CHARACTERISTIC DFES_EnvRef.DFC_MRlySCG_C "" VALUE 0x8024DCE7 Val_Wu8 29.0000000000 DFES_EnvTabVerb 0.00 29.0000000000 FORMAT "%13.10" /end CHARACTERISTIC
/begin CHARACTERISTIC DFES_EnvRef.DFC_SSpMon1_C "" VALUE 0x8024DCE8 Val_Wu8 29.0000000000 DFES_EnvTabVerb 0.00 29.0000000000 FORMAT "%13.10" /end CHARACTERISTIC
/begin CHARACTERISTIC DFES_EnvRef.DFC_SSpMon1OV_C "" VALUE 0x8024DCE9 Val_Wu8 29.0000000000 DFES_EnvTabVerb 0.00 29.0000000000 FORMAT "%13.10" /end CHARACTERISTIC
/begin CHARACTERISTIC DFES_EnvRef.DFC_SSpMon1SCG_C "" VALUE 0x8024DCEA Val_Wu8 29.0000000000 DFES_EnvTabVerb 0.00 29.0000000000 FORMAT "%13.10" /end CHARACTERISTIC
/begin CHARACTERISTIC DFES_EnvRef.DFC_SSpMon1UV_C "" VALUE 0x8024DCEB Val_Wu8 29.0000000000 DFES_EnvTabVerb 0.00 29.0000000000 FORMAT "%13.10" /end CHARACTERISTIC
/begin CHARACTERISTIC DFES_EnvRef.DFC_SSpMon2_C "" VALUE 0x8024DCEC Val_Wu8 29.0000000000 DFES_EnvTabVerb 0.00 29.0000000000 FORMAT "%13.10" /end CHARACTERISTIC
/begin CHARACTERISTIC DFES_EnvRef.DFC_SSpMon2OV_C "" VALUE 0x8024DCED Val_Wu8 29.0000000000 DFES_EnvTabVerb 0.00 29.0000000000 FORMAT "%13.10" /end CHARACTERISTIC
/begin CHARACTERISTIC DFES_EnvRef.DFC_SSpMon2SCG_C "" VALUE 0x8024DCEE Val_Wu8 29.0000000000 DFES_EnvTabVerb 0.00 29.0000000000 FORMAT "%13.10" /end CHARACTERISTIC
/begin CHARACTERISTIC DFES_EnvRef.DFC_SSpMon2UV_C "" VALUE 0x8024DCEF Val_Wu8 29.0000000000 DFES_EnvTabVerb 0.00 29.0000000000 FORMAT "%13.10" /end CHARACTERISTIC
/begin CHARACTERISTIC DFES_EnvRef.DFC_SSpMon3_C "" VALUE 0x8024DCF0 Val_Wu8 29.0000000000 DFES_EnvTabVerb 0.00 29.0000000000 FORMAT "%13.10" /end CHARACTERISTIC
/begin CHARACTERISTIC DFES_EnvRef.DFC_SSpMon3OV_C "" VALUE 0x8024DCF1 Val_Wu8 29.0000000000 DFES_EnvTabVerb 0.00 29.0000000000 FORMAT "%13.10" /end CHARACTERISTIC
/begin CHARACTERISTIC DFES_EnvRef.DFC_SSpMon3SCG_C "" VALUE 0x8024DCF2 Val_Wu8 29.0000000000 DFES_EnvTabVerb 0.00 29.0000000000 FORMAT "%13.10" /end CHARACTERISTIC
/begin CHARACTERISTIC DFES_EnvRef.DFC_SSpMon3UV_C "" VALUE 0x8024DCF3 Val_Wu8 29.0000000000 DFES_EnvTabVerb 0.00 29.0000000000 FORMAT "%13.10" /end CHARACTERISTIC
/begin CHARACTERISTIC DFES_EnvRef.DFC_CANSM_E_BUS_OFF_NETWORK_HSN1_CAN_C "" VALUE 0x8024DCF4 Val_Wu8 29.0000000000 DFES_EnvTabVerb 0.00 29.0000000000 FORMAT "%13.10" /end CHARACTERISTIC
/begin CHARACTERISTIC DFES_EnvRef.DFC_CANSM_E_BUS_OFF_NETWORK_HSN3_CAN_C "" VALUE 0x8024DCF5 Val_Wu8 29.0000000000 DFES_EnvTabVerb 0.00 29.0000000000 FORMAT "%13.10" /end CHARACTERISTIC
/begin CHARACTERISTIC DFES_EnvRef.DFC_CANSM_E_BUS_OFF_NETWORK_HSN4_CAN_C "" VALUE 0x8024DCF6 Val_Wu8 29.0000000000 DFES_EnvTabVerb 0.00 29.0000000000 FORMAT "%13.10" /end CHARACTERISTIC
/begin CHARACTERISTIC DFES_EnvRef.DFC_CANSM_E_BUS_OFF_NETWORK_XCP_CAN_C "" VALUE 0x8024DCF7 Val_Wu8 29.0000000000 DFES_EnvTabVerb 0.00 29.0000000000 FORMAT "%13.10" /end CHARACTERISTIC
/begin CHARACTERISTIC DFES_EnvRef.DFC_CANTRCV_E_NO_TRCV_CONTROL_0_C "" VALUE 0x8024DCF8 Val_Wu8 29.0000000000 DFES_EnvTabVerb 0.00 29.0000000000 FORMAT "%13.10" /end CHARACTERISTIC
/begin CHARACTERISTIC DFES_EnvRef.DFC_CAN_E_TIMEOUT_C "" VALUE 0x8024DCF9 Val_Wu8 29.0000000000 DFES_EnvTabVerb 0.00 29.0000000000 FORMAT "%13.10" /end CHARACTERISTIC
/begin CHARACTERISTIC DFES_EnvRef.DFC_COMM_E_NET_START_IND_CHANNEL_0_C "" VALUE 0x8024DCFA Val_Wu8 29.0000000000 DFES_EnvTabVerb 0.00 29.0000000000 FORMAT "%13.10" /end CHARACTERISTIC
/begin CHARACTERISTIC DFES_EnvRef.DFC_COMM_E_NET_START_IND_CHANNEL_1_C "" VALUE 0x8024DCFB Val_Wu8 29.0000000000 DFES_EnvTabVerb 0.00 29.0000000000 FORMAT "%13.10" /end CHARACTERISTIC
/begin CHARACTERISTIC DFES_EnvRef.DFC_COMM_E_NET_START_IND_CHANNEL_2_C "" VALUE 0x8024DCFC Val_Wu8 29.0000000000 DFES_EnvTabVerb 0.00 29.0000000000 FORMAT "%13.10" /end CHARACTERISTIC
/begin CHARACTERISTIC DFES_EnvRef.DFC_COMM_E_NET_START_IND_CHANNEL_3_C "" VALUE 0x8024DCFD Val_Wu8 29.0000000000 DFES_EnvTabVerb 0.00 29.0000000000 FORMAT "%13.10" /end CHARACTERISTIC
/begin CHARACTERISTIC DFES_EnvRef.DFC_COMM_E_NET_START_IND_CHANNEL_4_C "" VALUE 0x8024DCFE Val_Wu8 29.0000000000 DFES_EnvTabVerb 0.00 29.0000000000 FORMAT "%13.10" /end CHARACTERISTIC
/begin CHARACTERISTIC DFES_EnvRef.DFC_COMM_E_NET_START_IND_CHANNEL_5_C "" VALUE 0x8024DCFF Val_Wu8 29.0000000000 DFES_EnvTabVerb 0.00 29.0000000000 FORMAT "%13.10" /end CHARACTERISTIC
/begin CHARACTERISTIC DFES_EnvRef.DFC_LIN_E_TIMEOUT_C "" VALUE 0x8024DD00 Val_Wu8 29.0000000000 DFES_EnvTabVerb 0.00 29.0000000000 FORMAT "%13.10" /end CHARACTERISTIC
/begin CHARACTERISTIC DFES_EnvRef.DFC_rba_EcuCtrl_TOMaxProlg_C "" VALUE 0x8024DD01 Val_Wu8 29.0000000000 DFES_EnvTabVerb 0.00 29.0000000000 FORMAT "%13.10" /end CHARACTERISTIC
/begin CHARACTERISTIC DFES_EnvRef.DFC_rba_EcuCtrl_TOMaxShutDwn_C "" VALUE 0x8024DD02 Val_Wu8 29.0000000000 DFES_EnvTabVerb 0.00 29.0000000000 FORMAT "%13.10" /end CHARACTERISTIC
/begin CHARACTERISTIC DFES_EnvRef.DFC_rba_MultiStackTrace_Threshold_C "" VALUE 0x8024DD03 Val_Wu8 29.0000000000 DFES_EnvTabVerb 0.00 29.0000000000 FORMAT "%13.10" /end CHARACTERISTIC
/begin CHARACTERISTIC DFES_EnvRef.DFC_rba_SyC_CustStates_Degraded_disord_Event_C "" VALUE 0x8024DD04 Val_Wu8 29.0000000000 DFES_EnvTabVerb 0.00 29.0000000000 FORMAT "%13.10" /end CHARACTERISTIC
/begin CHARACTERISTIC DFES_EnvRef.DFC_rba_SyC_CustStates_Degraded_incst_Event_C "" VALUE 0x8024DD05 Val_Wu8 29.0000000000 DFES_EnvTabVerb 0.00 29.0000000000 FORMAT "%13.10" /end CHARACTERISTIC
/begin CHARACTERISTIC DFES_EnvRef.DFC_rba_SyC_CustStates_TransNoWakReq_Event_C "" VALUE 0x8024DD06 Val_Wu8 29.0000000000 DFES_EnvTabVerb 0.00 29.0000000000 FORMAT "%13.10" /end CHARACTERISTIC
/begin CHARACTERISTIC DFES_EnvRef.DFC_RBA_IOEXTLIB_KEEPALIVE_DRV_C "" VALUE 0x8024DD07 Val_Wu8 29.0000000000 DFES_EnvTabVerb 0.00 29.0000000000 FORMAT "%13.10" /end CHARACTERISTIC
/begin CHARACTERISTIC DFES_EnvRef.DFC_RBA_IOEXTLIB_KEEPALIVE_INI_C "" VALUE 0x8024DD08 Val_Wu8 29.0000000000 DFES_EnvTabVerb 0.00 29.0000000000 FORMAT "%13.10" /end CHARACTERISTIC
/begin CHARACTERISTIC DFES_EnvRef.DFC_rba_IoSigRtc_StopCounter_C "" VALUE 0x8024DD09 Val_Wu8 29.0000000000 DFES_EnvTabVerb 0.00 29.0000000000 FORMAT "%13.10" /end CHARACTERISTIC
/begin CHARACTERISTIC DFES_EnvRef.DFC_rba_MRly_Diag_Stk_Event_C "" VALUE 0x8024DD0A Val_Wu8 29.0000000000 DFES_EnvTabVerb 0.00 29.0000000000 FORMAT "%13.10" /end CHARACTERISTIC
/begin CHARACTERISTIC DFES_EnvRef.DFC_rba_MemDiag_MemReadErr_C "" VALUE 0x8024DD0B Val_Wu8 29.0000000000 DFES_EnvTabVerb 0.00 29.0000000000 FORMAT "%13.10" /end CHARACTERISTIC
/begin CHARACTERISTIC DFES_EnvRef.DFC_rba_MemDiag_MemWrErr_C "" VALUE 0x8024DD0C Val_Wu8 29.0000000000 DFES_EnvTabVerb 0.00 29.0000000000 FORMAT "%13.10" /end CHARACTERISTIC
/begin CHARACTERISTIC DFES_EnvRef.DFC_rba_SyC_IrrSwOffTrigEngRun_Event_C "" VALUE 0x8024DD0D Val_Wu8 29.0000000000 DFES_EnvTabVerb 0.00 29.0000000000 FORMAT "%13.10" /end CHARACTERISTIC
/begin CHARACTERISTIC DFES_EnvRef.DFC_AcChrgrIntkTSRCMax_C "" VALUE 0x8024DD0E Val_Wu8 29.0000000000 DFES_EnvTabVerb 0.00 29.0000000000 FORMAT "%13.10" /end CHARACTERISTIC
/begin CHARACTERISTIC DFES_EnvRef.DFC_AcChrgrIntkTTmpErr_C "" VALUE 0x8024DD0F Val_Wu8 29.0000000000 DFES_EnvTabVerb 0.00 29.0000000000 FORMAT "%13.10" /end CHARACTERISTIC
/begin CHARACTERISTIC DFES_EnvRef.DFC_AcFlt_C "" VALUE 0x8024DD10 Val_Wu8 29.0000000000 DFES_EnvTabVerb 0.00 29.0000000000 FORMAT "%13.10" /end CHARACTERISTIC
/begin CHARACTERISTIC DFES_EnvRef.DFC_AppAllSnsrDfct_C "" VALUE 0x8024DD11 Val_Wu8 29.0000000000 DFES_EnvTabVerb 0.00 29.0000000000 FORMAT "%13.10" /end CHARACTERISTIC
/begin CHARACTERISTIC DFES_EnvRef.DFC_BattUPwrFail_C "" VALUE 0x8024DD12 Val_Wu8 29.0000000000 DFES_EnvTabVerb 0.00 29.0000000000 FORMAT "%13.10" /end CHARACTERISTIC
/begin CHARACTERISTIC DFES_EnvRef.DFC_BrkBstBkupOvrn_C "" VALUE 0x8024DD13 Val_Wu8 29.0000000000 DFES_EnvTabVerb 0.00 29.0000000000 FORMAT "%13.10" /end CHARACTERISTIC
/begin CHARACTERISTIC DFES_EnvRef.DFC_BrkBstPmpOvld_C "" VALUE 0x8024DD14 Val_Wu8 29.0000000000 DFES_EnvTabVerb 0.00 29.0000000000 FORMAT "%13.10" /end CHARACTERISTIC
/begin CHARACTERISTIC DFES_EnvRef.DFC_BrkPlausChk_C "" VALUE 0x8024DD15 Val_Wu8 29.0000000000 DFES_EnvTabVerb 0.00 29.0000000000 FORMAT "%13.10" /end CHARACTERISTIC
/begin CHARACTERISTIC DFES_EnvRef.DFC_CbnHeatgSwtTmpErr_C "" VALUE 0x8024DD16 Val_Wu8 29.0000000000 DFES_EnvTabVerb 0.00 29.0000000000 FORMAT "%13.10" /end CHARACTERISTIC
/begin CHARACTERISTIC DFES_EnvRef.DFC_CcsPwrLineChpVccSRCMax_C "" VALUE 0x8024DD17 Val_Wu8 29.0000000000 DFES_EnvTabVerb 0.00 29.0000000000 FORMAT "%13.10" /end CHARACTERISTIC
/begin CHARACTERISTIC DFES_EnvRef.DFC_CcsPwrLineChpVccTmpErr_C "" VALUE 0x8024DD18 Val_Wu8 29.0000000000 DFES_EnvTabVerb 0.00 29.0000000000 FORMAT "%13.10" /end CHARACTERISTIC
/begin CHARACTERISTIC DFES_EnvRef.DFC_CcsPwrLineComChpTSRCMax_C "" VALUE 0x8024DD19 Val_Wu8 29.0000000000 DFES_EnvTabVerb 0.00 29.0000000000 FORMAT "%13.10" /end CHARACTERISTIC
/begin CHARACTERISTIC DFES_EnvRef.DFC_CcsPwrLineComChpTTmpErr_C "" VALUE 0x8024DD1A Val_Wu8 29.0000000000 DFES_EnvTabVerb 0.00 29.0000000000 FORMAT "%13.10" /end CHARACTERISTIC
/begin CHARACTERISTIC DFES_EnvRef.DFC_ChgrPlugCtpCarrFrqErr_C "" VALUE 0x8024DD1B Val_Wu8 29.0000000000 DFES_EnvTabVerb 0.00 29.0000000000 FORMAT "%13.10" /end CHARACTERISTIC
/begin CHARACTERISTIC DFES_EnvRef.DFC_ChgrPlugCtpSwtStuckClsd_C "" VALUE 0x8024DD1C Val_Wu8 29.0000000000 DFES_EnvTabVerb 0.00 29.0000000000 FORMAT "%13.10" /end CHARACTERISTIC
/begin CHARACTERISTIC DFES_EnvRef.DFC_ChgrPlugCtpSwtStuckOpen_C "" VALUE 0x8024DD1D Val_Wu8 29.0000000000 DFES_EnvTabVerb 0.00 29.0000000000 FORMAT "%13.10" /end CHARACTERISTIC
/begin CHARACTERISTIC DFES_EnvRef.DFC_ChgrPlugCtpUErrHi_C "" VALUE 0x8024DD1E Val_Wu8 29.0000000000 DFES_EnvTabVerb 0.00 29.0000000000 FORMAT "%13.10" /end CHARACTERISTIC
/begin CHARACTERISTIC DFES_EnvRef.DFC_ChgrPlugPxp1SrcErr_C "" VALUE 0x8024DD1F Val_Wu8 29.0000000000 DFES_EnvTabVerb 0.00 29.0000000000 FORMAT "%13.10" /end CHARACTERISTIC
/begin CHARACTERISTIC DFES_EnvRef.DFC_ChrgCntctAllWldd_C "" VALUE 0x8024DD20 Val_Wu8 29.0000000000 DFES_EnvTabVerb 0.00 29.0000000000 FORMAT "%13.10" /end CHARACTERISTIC
/begin CHARACTERISTIC DFES_EnvRef.DFC_ChrgCntctNegOperErr_C "" VALUE 0x8024DD21 Val_Wu8 29.0000000000 DFES_EnvTabVerb 0.00 29.0000000000 FORMAT "%13.10" /end CHARACTERISTIC
/begin CHARACTERISTIC DFES_EnvRef.DFC_ChrgCntctNegOperWarn_C "" VALUE 0x8024DD22 Val_Wu8 29.0000000000 DFES_EnvTabVerb 0.00 29.0000000000 FORMAT "%13.10" /end CHARACTERISTIC
/begin CHARACTERISTIC DFES_EnvRef.DFC_ChrgCntctNegWldd_C "" VALUE 0x8024DD23 Val_Wu8 29.0000000000 DFES_EnvTabVerb 0.00 29.0000000000 FORMAT "%13.10" /end CHARACTERISTIC
/begin CHARACTERISTIC DFES_EnvRef.DFC_ChrgCntctPosOperErr_C "" VALUE 0x8024DD24 Val_Wu8 29.0000000000 DFES_EnvTabVerb 0.00 29.0000000000 FORMAT "%13.10" /end CHARACTERISTIC
/begin CHARACTERISTIC DFES_EnvRef.DFC_ChrgCntctPosOperWarn_C "" VALUE 0x8024DD25 Val_Wu8 29.0000000000 DFES_EnvTabVerb 0.00 29.0000000000 FORMAT "%13.10" /end CHARACTERISTIC
/begin CHARACTERISTIC DFES_EnvRef.DFC_ChrgCntctPosWldd_C "" VALUE 0x8024DD26 Val_Wu8 29.0000000000 DFES_EnvTabVerb 0.00 29.0000000000 FORMAT "%13.10" /end CHARACTERISTIC
/begin CHARACTERISTIC DFES_EnvRef.DFC_ChrgCntctStuckOpen_C "" VALUE 0x8024DD27 Val_Wu8 29.0000000000 DFES_EnvTabVerb 0.00 29.0000000000 FORMAT "%13.10" /end CHARACTERISTIC
/begin CHARACTERISTIC DFES_EnvRef.DFC_ChrgPlgIntlckFaild_C "" VALUE 0x8024DD28 Val_Wu8 29.0000000000 DFES_EnvTabVerb 0.00 29.0000000000 FORMAT "%13.10" /end CHARACTERISTIC
/begin CHARACTERISTIC DFES_EnvRef.DFC_ChrgnUnplRqrd_C "" VALUE 0x8024DD29 Val_Wu8 29.0000000000 DFES_EnvTabVerb 0.00 29.0000000000 FORMAT "%13.10" /end CHARACTERISTIC
/begin CHARACTERISTIC DFES_EnvRef.DFC_CoElMOffsCalibActv01_C "" VALUE 0x8024DD2A Val_Wu8 29.0000000000 DFES_EnvTabVerb 0.00 29.0000000000 FORMAT "%13.10" /end CHARACTERISTIC
/begin CHARACTERISTIC DFES_EnvRef.DFC_CtPSwtDiagSRCMax_C "" VALUE 0x8024DD2B Val_Wu8 29.0000000000 DFES_EnvTabVerb 0.00 29.0000000000 FORMAT "%13.10" /end CHARACTERISTIC
/begin CHARACTERISTIC DFES_EnvRef.DFC_CtPSwtDiagTmpErr_C "" VALUE 0x8024DD2C Val_Wu8 29.0000000000 DFES_EnvTabVerb 0.00 29.0000000000 FORMAT "%13.10" /end CHARACTERISTIC
/begin CHARACTERISTIC DFES_EnvRef.DFC_CtpCarrFrqTmpErr_C "" VALUE 0x8024DD2D Val_Wu8 29.0000000000 DFES_EnvTabVerb 0.00 29.0000000000 FORMAT "%13.10" /end CHARACTERISTIC
/begin CHARACTERISTIC DFES_EnvRef.DFC_DcChrgrIntkT2SRCMax_C "" VALUE 0x8024DD2E Val_Wu8 29.0000000000 DFES_EnvTabVerb 0.00 29.0000000000 FORMAT "%13.10" /end CHARACTERISTIC
/begin CHARACTERISTIC DFES_EnvRef.DFC_DcChrgrIntkT2TmpErr_C "" VALUE 0x8024DD2F Val_Wu8 29.0000000000 DFES_EnvTabVerb 0.00 29.0000000000 FORMAT "%13.10" /end CHARACTERISTIC
/begin CHARACTERISTIC DFES_EnvRef.DFC_DcChrgrIntkTSRCMax_C "" VALUE 0x8024DD30 Val_Wu8 29.0000000000 DFES_EnvTabVerb 0.00 29.0000000000 FORMAT "%13.10" /end CHARACTERISTIC
/begin CHARACTERISTIC DFES_EnvRef.DFC_DcChrgrIntkTTmpErr_C "" VALUE 0x8024DD31 Val_Wu8 29.0000000000 DFES_EnvTabVerb 0.00 29.0000000000 FORMAT "%13.10" /end CHARACTERISTIC
/begin CHARACTERISTIC DFES_EnvRef.DFC_EChrDvPlinCntrThdExcdd_C "" VALUE 0x8024DD32 Val_Wu8 29.0000000000 DFES_EnvTabVerb 0.00 29.0000000000 FORMAT "%13.10" /end CHARACTERISTIC
/begin CHARACTERISTIC DFES_EnvRef.DFC_EemDiagCtctrClsTout_C "" VALUE 0x8024DD33 Val_Wu8 29.0000000000 DFES_EnvTabVerb 0.00 29.0000000000 FORMAT "%13.10" /end CHARACTERISTIC
/begin CHARACTERISTIC DFES_EnvRef.DFC_EemDiagDcdcOffTOut_C "" VALUE 0x8024DD34 Val_Wu8 29.0000000000 DFES_EnvTabVerb 0.00 29.0000000000 FORMAT "%13.10" /end CHARACTERISTIC
/begin CHARACTERISTIC DFES_EnvRef.DFC_EemDiagHvCnsrOffTOut_C "" VALUE 0x8024DD35 Val_Wu8 29.0000000000 DFES_EnvTabVerb 0.00 29.0000000000 FORMAT "%13.10" /end CHARACTERISTIC
/begin CHARACTERISTIC DFES_EnvRef.DFC_EemDiagHvbOffTOut_C "" VALUE 0x8024DD36 Val_Wu8 29.0000000000 DFES_EnvTabVerb 0.00 29.0000000000 FORMAT "%13.10" /end CHARACTERISTIC
/begin CHARACTERISTIC DFES_EnvRef.DFC_FanSpdSRCMax_C "" VALUE 0x8024DD37 Val_Wu8 29.0000000000 DFES_EnvTabVerb 0.00 29.0000000000 FORMAT "%13.10" /end CHARACTERISTIC
/begin CHARACTERISTIC DFES_EnvRef.DFC_FanSpdTmpErr_C "" VALUE 0x8024DD38 Val_Wu8 29.0000000000 DFES_EnvTabVerb 0.00 29.0000000000 FORMAT "%13.10" /end CHARACTERISTIC
/begin CHARACTERISTIC DFES_EnvRef.DFC_FreonPSRCMax_C "" VALUE 0x8024DD39 Val_Wu8 29.0000000000 DFES_EnvTabVerb 0.00 29.0000000000 FORMAT "%13.10" /end CHARACTERISTIC
/begin CHARACTERISTIC DFES_EnvRef.DFC_FreonPTmpErr_C "" VALUE 0x8024DD3A Val_Wu8 29.0000000000 DFES_EnvTabVerb 0.00 29.0000000000 FORMAT "%13.10" /end CHARACTERISTIC
/begin CHARACTERISTIC DFES_EnvRef.DFC_HeatrCoreTSRCMax_C "" VALUE 0x8024DD3B Val_Wu8 29.0000000000 DFES_EnvTabVerb 0.00 29.0000000000 FORMAT "%13.10" /end CHARACTERISTIC
/begin CHARACTERISTIC DFES_EnvRef.DFC_HeatrCoreTTmpErr_C "" VALUE 0x8024DD3C Val_Wu8 29.0000000000 DFES_EnvTabVerb 0.00 29.0000000000 FORMAT "%13.10" /end CHARACTERISTIC
/begin CHARACTERISTIC DFES_EnvRef.DFC_HvGridSocMinLim_C "" VALUE 0x8024DD3D Val_Wu8 29.0000000000 DFES_EnvTabVerb 0.00 29.0000000000 FORMAT "%13.10" /end CHARACTERISTIC
/begin CHARACTERISTIC DFES_EnvRef.DFC_HvacBlwrFrntFlt_C "" VALUE 0x8024DD3E Val_Wu8 29.0000000000 DFES_EnvTabVerb 0.00 29.0000000000 FORMAT "%13.10" /end CHARACTERISTIC
/begin CHARACTERISTIC DFES_EnvRef.DFC_HvacEvapElecFlt_C "" VALUE 0x8024DD3F Val_Wu8 29.0000000000 DFES_EnvTabVerb 0.00 29.0000000000 FORMAT "%13.10" /end CHARACTERISTIC
/begin CHARACTERISTIC DFES_EnvRef.DFC_HvacEvapElecFltGnd_C "" VALUE 0x8024DD40 Val_Wu8 29.0000000000 DFES_EnvTabVerb 0.00 29.0000000000 FORMAT "%13.10" /end CHARACTERISTIC
/begin CHARACTERISTIC DFES_EnvRef.DFC_HvacKnobPosnFlt_C "" VALUE 0x8024DD41 Val_Wu8 29.0000000000 DFES_EnvTabVerb 0.00 29.0000000000 FORMAT "%13.10" /end CHARACTERISTIC
/begin CHARACTERISTIC DFES_EnvRef.DFC_InvBinID_C "" VALUE 0x8024DD42 Val_Wu8 29.0000000000 DFES_EnvTabVerb 0.00 29.0000000000 FORMAT "%13.10" /end CHARACTERISTIC
/begin CHARACTERISTIC DFES_EnvRef.DFC_InvCalID_C "" VALUE 0x8024DD43 Val_Wu8 29.0000000000 DFES_EnvTabVerb 0.00 29.0000000000 FORMAT "%13.10" /end CHARACTERISTIC
/begin CHARACTERISTIC DFES_EnvRef.DFC_InvErotan_C "" VALUE 0x8024DD44 Val_Wu8 29.0000000000 DFES_EnvTabVerb 0.00 29.0000000000 FORMAT "%13.10" /end CHARACTERISTIC
/begin CHARACTERISTIC DFES_EnvRef.DFC_InvVinID_C "" VALUE 0x8024DD45 Val_Wu8 29.0000000000 DFES_EnvTabVerb 0.00 29.0000000000 FORMAT "%13.10" /end CHARACTERISTIC
/begin CHARACTERISTIC DFES_EnvRef.DFC_MOXEMM_SMU_ALM0_0_C "" VALUE 0x8024DD46 Val_Wu8 29.0000000000 DFES_EnvTabVerb 0.00 29.0000000000 FORMAT "%13.10" /end CHARACTERISTIC
/begin CHARACTERISTIC DFES_EnvRef.DFC_MOXEMM_SMU_ALM0_1_C "" VALUE 0x8024DD47 Val_Wu8 29.0000000000 DFES_EnvTabVerb 0.00 29.0000000000 FORMAT "%13.10" /end CHARACTERISTIC
/begin CHARACTERISTIC DFES_EnvRef.DFC_MOXEMM_SMU_ALM0_10_C "" VALUE 0x8024DD48 Val_Wu8 29.0000000000 DFES_EnvTabVerb 0.00 29.0000000000 FORMAT "%13.10" /end CHARACTERISTIC
/begin CHARACTERISTIC DFES_EnvRef.DFC_MOXEMM_SMU_ALM0_11_C "" VALUE 0x8024DD49 Val_Wu8 29.0000000000 DFES_EnvTabVerb 0.00 29.0000000000 FORMAT "%13.10" /end CHARACTERISTIC
/begin CHARACTERISTIC DFES_EnvRef.DFC_MOXEMM_SMU_ALM0_13_C "" VALUE 0x8024DD4A Val_Wu8 29.0000000000 DFES_EnvTabVerb 0.00 29.0000000000 FORMAT "%13.10" /end CHARACTERISTIC
/begin CHARACTERISTIC DFES_EnvRef.DFC_MOXEMM_SMU_ALM0_14_C "" VALUE 0x8024DD4B Val_Wu8 29.0000000000 DFES_EnvTabVerb 0.00 29.0000000000 FORMAT "%13.10" /end CHARACTERISTIC
/begin CHARACTERISTIC DFES_EnvRef.DFC_MOXEMM_SMU_ALM0_2_C "" VALUE 0x8024DD4C Val_Wu8 29.0000000000 DFES_EnvTabVerb 0.00 29.0000000000 FORMAT "%13.10" /end CHARACTERISTIC
/begin CHARACTERISTIC DFES_EnvRef.DFC_MOXEMM_SMU_ALM0_22_C "" VALUE 0x8024DD4D Val_Wu8 29.0000000000 DFES_EnvTabVerb 0.00 29.0000000000 FORMAT "%13.10" /end CHARACTERISTIC
/begin CHARACTERISTIC DFES_EnvRef.DFC_MOXEMM_SMU_ALM0_23_C "" VALUE 0x8024DD4E Val_Wu8 29.0000000000 DFES_EnvTabVerb 0.00 29.0000000000 FORMAT "%13.10" /end CHARACTERISTIC
/begin CHARACTERISTIC DFES_EnvRef.DFC_MOXEMM_SMU_ALM0_4_C "" VALUE 0x8024DD4F Val_Wu8 29.0000000000 DFES_EnvTabVerb 0.00 29.0000000000 FORMAT "%13.10" /end CHARACTERISTIC
/begin CHARACTERISTIC DFES_EnvRef.DFC_MOXEMM_SMU_ALM0_5_C "" VALUE 0x8024DD50 Val_Wu8 29.0000000000 DFES_EnvTabVerb 0.00 29.0000000000 FORMAT "%13.10" /end CHARACTERISTIC
/begin CHARACTERISTIC DFES_EnvRef.DFC_MOXEMM_SMU_ALM0_7_C "" VALUE 0x8024DD51 Val_Wu8 29.0000000000 DFES_EnvTabVerb 0.00 29.0000000000 FORMAT "%13.10" /end CHARACTERISTIC
/begin CHARACTERISTIC DFES_EnvRef.DFC_MOXEMM_SMU_ALM0_8_C "" VALUE 0x8024DD52 Val_Wu8 29.0000000000 DFES_EnvTabVerb 0.00 29.0000000000 FORMAT "%13.10" /end CHARACTERISTIC
/begin CHARACTERISTIC DFES_EnvRef.DFC_MOXEMM_SMU_ALM10_16_C "" VALUE 0x8024DD53 Val_Wu8 29.0000000000 DFES_EnvTabVerb 0.00 29.0000000000 FORMAT "%13.10" /end CHARACTERISTIC
/begin CHARACTERISTIC DFES_EnvRef.DFC_MOXEMM_SMU_ALM10_17_C "" VALUE 0x8024DD54 Val_Wu8 29.0000000000 DFES_EnvTabVerb 0.00 29.0000000000 FORMAT "%13.10" /end CHARACTERISTIC
/begin CHARACTERISTIC DFES_EnvRef.DFC_MOXEMM_SMU_ALM10_21_C "" VALUE 0x8024DD55 Val_Wu8 29.0000000000 DFES_EnvTabVerb 0.00 29.0000000000 FORMAT "%13.10" /end CHARACTERISTIC
/begin CHARACTERISTIC DFES_EnvRef.DFC_MOXEMM_SMU_ALM11_0_C "" VALUE 0x8024DD56 Val_Wu8 29.0000000000 DFES_EnvTabVerb 0.00 29.0000000000 FORMAT "%13.10" /end CHARACTERISTIC
/begin CHARACTERISTIC DFES_EnvRef.DFC_MOXEMM_SMU_ALM11_1_C "" VALUE 0x8024DD57 Val_Wu8 29.0000000000 DFES_EnvTabVerb 0.00 29.0000000000 FORMAT "%13.10" /end CHARACTERISTIC
/begin CHARACTERISTIC DFES_EnvRef.DFC_MOXEMM_SMU_ALM11_2_C "" VALUE 0x8024DD58 Val_Wu8 29.0000000000 DFES_EnvTabVerb 0.00 29.0000000000 FORMAT "%13.10" /end CHARACTERISTIC
/begin CHARACTERISTIC DFES_EnvRef.DFC_MOXEMM_SMU_ALM11_3_C "" VALUE 0x8024DD59 Val_Wu8 29.0000000000 DFES_EnvTabVerb 0.00 29.0000000000 FORMAT "%13.10" /end CHARACTERISTIC
/begin CHARACTERISTIC DFES_EnvRef.DFC_MOXEMM_SMU_ALM11_4_C "" VALUE 0x8024DD5A Val_Wu8 29.0000000000 DFES_EnvTabVerb 0.00 29.0000000000 FORMAT "%13.10" /end CHARACTERISTIC
/begin CHARACTERISTIC DFES_EnvRef.DFC_MOXEMM_SMU_ALM11_5_C "" VALUE 0x8024DD5B Val_Wu8 29.0000000000 DFES_EnvTabVerb 0.00 29.0000000000 FORMAT "%13.10" /end CHARACTERISTIC
/begin CHARACTERISTIC DFES_EnvRef.DFC_MOXEMM_SMU_ALM11_8_C "" VALUE 0x8024DD5C Val_Wu8 29.0000000000 DFES_EnvTabVerb 0.00 29.0000000000 FORMAT "%13.10" /end CHARACTERISTIC
/begin CHARACTERISTIC DFES_EnvRef.DFC_MOXEMM_SMU_ALM11_9_C "" VALUE 0x8024DD5D Val_Wu8 29.0000000000 DFES_EnvTabVerb 0.00 29.0000000000 FORMAT "%13.10" /end CHARACTERISTIC
/begin CHARACTERISTIC DFES_EnvRef.DFC_MOXEMM_SMU_ALM1_0_C "" VALUE 0x8024DD5E Val_Wu8 29.0000000000 DFES_EnvTabVerb 0.00 29.0000000000 FORMAT "%13.10" /end CHARACTERISTIC
/begin CHARACTERISTIC DFES_EnvRef.DFC_MOXEMM_SMU_ALM1_1_C "" VALUE 0x8024DD5F Val_Wu8 29.0000000000 DFES_EnvTabVerb 0.00 29.0000000000 FORMAT "%13.10" /end CHARACTERISTIC
/begin CHARACTERISTIC DFES_EnvRef.DFC_MOXEMM_SMU_ALM1_10_C "" VALUE 0x8024DD60 Val_Wu8 29.0000000000 DFES_EnvTabVerb 0.00 29.0000000000 FORMAT "%13.10" /end CHARACTERISTIC
/begin CHARACTERISTIC DFES_EnvRef.DFC_MOXEMM_SMU_ALM1_11_C "" VALUE 0x8024DD61 Val_Wu8 29.0000000000 DFES_EnvTabVerb 0.00 29.0000000000 FORMAT "%13.10" /end CHARACTERISTIC
/begin CHARACTERISTIC DFES_EnvRef.DFC_MOXEMM_SMU_ALM1_13_C "" VALUE 0x8024DD62 Val_Wu8 29.0000000000 DFES_EnvTabVerb 0.00 29.0000000000 FORMAT "%13.10" /end CHARACTERISTIC
/begin CHARACTERISTIC DFES_EnvRef.DFC_MOXEMM_SMU_ALM1_14_C "" VALUE 0x8024DD63 Val_Wu8 29.0000000000 DFES_EnvTabVerb 0.00 29.0000000000 FORMAT "%13.10" /end CHARACTERISTIC
/begin CHARACTERISTIC DFES_EnvRef.DFC_MOXEMM_SMU_ALM1_2_C "" VALUE 0x8024DD64 Val_Wu8 29.0000000000 DFES_EnvTabVerb 0.00 29.0000000000 FORMAT "%13.10" /end CHARACTERISTIC
/begin CHARACTERISTIC DFES_EnvRef.DFC_MOXEMM_SMU_ALM1_22_C "" VALUE 0x8024DD65 Val_Wu8 29.0000000000 DFES_EnvTabVerb 0.00 29.0000000000 FORMAT "%13.10" /end CHARACTERISTIC
/begin CHARACTERISTIC DFES_EnvRef.DFC_MOXEMM_SMU_ALM1_23_C "" VALUE 0x8024DD66 Val_Wu8 29.0000000000 DFES_EnvTabVerb 0.00 29.0000000000 FORMAT "%13.10" /end CHARACTERISTIC
/begin CHARACTERISTIC DFES_EnvRef.DFC_MOXEMM_SMU_ALM1_4_C "" VALUE 0x8024DD67 Val_Wu8 29.0000000000 DFES_EnvTabVerb 0.00 29.0000000000 FORMAT "%13.10" /end CHARACTERISTIC
/begin CHARACTERISTIC DFES_EnvRef.DFC_MOXEMM_SMU_ALM1_5_C "" VALUE 0x8024DD68 Val_Wu8 29.0000000000 DFES_EnvTabVerb 0.00 29.0000000000 FORMAT "%13.10" /end CHARACTERISTIC
/begin CHARACTERISTIC DFES_EnvRef.DFC_MOXEMM_SMU_ALM1_7_C "" VALUE 0x8024DD69 Val_Wu8 29.0000000000 DFES_EnvTabVerb 0.00 29.0000000000 FORMAT "%13.10" /end CHARACTERISTIC
/begin CHARACTERISTIC DFES_EnvRef.DFC_MOXEMM_SMU_ALM1_8_C "" VALUE 0x8024DD6A Val_Wu8 29.0000000000 DFES_EnvTabVerb 0.00 29.0000000000 FORMAT "%13.10" /end CHARACTERISTIC
/begin CHARACTERISTIC DFES_EnvRef.DFC_MOXEMM_SMU_ALM21_0_C "" VALUE 0x8024DD6B Val_Wu8 29.0000000000 DFES_EnvTabVerb 0.00 29.0000000000 FORMAT "%13.10" /end CHARACTERISTIC
/begin CHARACTERISTIC DFES_EnvRef.DFC_MOXEMM_SMU_ALM21_16_C "" VALUE 0x8024DD6C Val_Wu8 29.0000000000 DFES_EnvTabVerb 0.00 29.0000000000 FORMAT "%13.10" /end CHARACTERISTIC
/begin CHARACTERISTIC DFES_EnvRef.DFC_MOXEMM_SMU_ALM21_3_C "" VALUE 0x8024DD6D Val_Wu8 29.0000000000 DFES_EnvTabVerb 0.00 29.0000000000 FORMAT "%13.10" /end CHARACTERISTIC
/begin CHARACTERISTIC DFES_EnvRef.DFC_MOXEMM_SMU_ALM2_1_C "" VALUE 0x8024DD6E Val_Wu8 29.0000000000 DFES_EnvTabVerb 0.00 29.0000000000 FORMAT "%13.10" /end CHARACTERISTIC
/begin CHARACTERISTIC DFES_EnvRef.DFC_MOXEMM_SMU_ALM2_10_C "" VALUE 0x8024DD6F Val_Wu8 29.0000000000 DFES_EnvTabVerb 0.00 29.0000000000 FORMAT "%13.10" /end CHARACTERISTIC
/begin CHARACTERISTIC DFES_EnvRef.DFC_MOXEMM_SMU_ALM2_11_C "" VALUE 0x8024DD70 Val_Wu8 29.0000000000 DFES_EnvTabVerb 0.00 29.0000000000 FORMAT "%13.10" /end CHARACTERISTIC
/begin CHARACTERISTIC DFES_EnvRef.DFC_MOXEMM_SMU_ALM2_13_C "" VALUE 0x8024DD71 Val_Wu8 29.0000000000 DFES_EnvTabVerb 0.00 29.0000000000 FORMAT "%13.10" /end CHARACTERISTIC
/begin CHARACTERISTIC DFES_EnvRef.DFC_MOXEMM_SMU_ALM2_14_C "" VALUE 0x8024DD72 Val_Wu8 29.0000000000 DFES_EnvTabVerb 0.00 29.0000000000 FORMAT "%13.10" /end CHARACTERISTIC
/begin CHARACTERISTIC DFES_EnvRef.DFC_MOXEMM_SMU_ALM2_22_C "" VALUE 0x8024DD73 Val_Wu8 29.0000000000 DFES_EnvTabVerb 0.00 29.0000000000 FORMAT "%13.10" /end CHARACTERISTIC
/begin CHARACTERISTIC DFES_EnvRef.DFC_MOXEMM_SMU_ALM2_23_C "" VALUE 0x8024DD74 Val_Wu8 29.0000000000 DFES_EnvTabVerb 0.00 29.0000000000 FORMAT "%13.10" /end CHARACTERISTIC
/begin CHARACTERISTIC DFES_EnvRef.DFC_MOXEMM_SMU_ALM2_4_C "" VALUE 0x8024DD75 Val_Wu8 29.0000000000 DFES_EnvTabVerb 0.00 29.0000000000 FORMAT "%13.10" /end CHARACTERISTIC
/begin CHARACTERISTIC DFES_EnvRef.DFC_MOXEMM_SMU_ALM2_5_C "" VALUE 0x8024DD76 Val_Wu8 29.0000000000 DFES_EnvTabVerb 0.00 29.0000000000 FORMAT "%13.10" /end CHARACTERISTIC
/begin CHARACTERISTIC DFES_EnvRef.DFC_MOXEMM_SMU_ALM2_7_C "" VALUE 0x8024DD77 Val_Wu8 29.0000000000 DFES_EnvTabVerb 0.00 29.0000000000 FORMAT "%13.10" /end CHARACTERISTIC
/begin CHARACTERISTIC DFES_EnvRef.DFC_MOXEMM_SMU_ALM2_8_C "" VALUE 0x8024DD78 Val_Wu8 29.0000000000 DFES_EnvTabVerb 0.00 29.0000000000 FORMAT "%13.10" /end CHARACTERISTIC
/begin CHARACTERISTIC DFES_EnvRef.DFC_MOXEMM_SMU_ALM6_0_C "" VALUE 0x8024DD79 Val_Wu8 29.0000000000 DFES_EnvTabVerb 0.00 29.0000000000 FORMAT "%13.10" /end CHARACTERISTIC
/begin CHARACTERISTIC DFES_EnvRef.DFC_MOXEMM_SMU_ALM6_11_C "" VALUE 0x8024DD7A Val_Wu8 29.0000000000 DFES_EnvTabVerb 0.00 29.0000000000 FORMAT "%13.10" /end CHARACTERISTIC
/begin CHARACTERISTIC DFES_EnvRef.DFC_MOXEMM_SMU_ALM6_12_C "" VALUE 0x8024DD7B Val_Wu8 29.0000000000 DFES_EnvTabVerb 0.00 29.0000000000 FORMAT "%13.10" /end CHARACTERISTIC
/begin CHARACTERISTIC DFES_EnvRef.DFC_MOXEMM_SMU_ALM6_14_C "" VALUE 0x8024DD7C Val_Wu8 29.0000000000 DFES_EnvTabVerb 0.00 29.0000000000 FORMAT "%13.10" /end CHARACTERISTIC
/begin CHARACTERISTIC DFES_EnvRef.DFC_MOXEMM_SMU_ALM6_15_C "" VALUE 0x8024DD7D Val_Wu8 29.0000000000 DFES_EnvTabVerb 0.00 29.0000000000 FORMAT "%13.10" /end CHARACTERISTIC
/begin CHARACTERISTIC DFES_EnvRef.DFC_MOXEMM_SMU_ALM6_17_C "" VALUE 0x8024DD7E Val_Wu8 29.0000000000 DFES_EnvTabVerb 0.00 29.0000000000 FORMAT "%13.10" /end CHARACTERISTIC
/begin CHARACTERISTIC DFES_EnvRef.DFC_MOXEMM_SMU_ALM6_18_C "" VALUE 0x8024DD7F Val_Wu8 29.0000000000 DFES_EnvTabVerb 0.00 29.0000000000 FORMAT "%13.10" /end CHARACTERISTIC
/begin CHARACTERISTIC DFES_EnvRef.DFC_MOXEMM_SMU_ALM6_20_C "" VALUE 0x8024DD80 Val_Wu8 29.0000000000 DFES_EnvTabVerb 0.00 29.0000000000 FORMAT "%13.10" /end CHARACTERISTIC
/begin CHARACTERISTIC DFES_EnvRef.DFC_MOXEMM_SMU_ALM6_21_C "" VALUE 0x8024DD81 Val_Wu8 29.0000000000 DFES_EnvTabVerb 0.00 29.0000000000 FORMAT "%13.10" /end CHARACTERISTIC
/begin CHARACTERISTIC DFES_EnvRef.DFC_MOXEMM_SMU_ALM6_25_C "" VALUE 0x8024DD82 Val_Wu8 29.0000000000 DFES_EnvTabVerb 0.00 29.0000000000 FORMAT "%13.10" /end CHARACTERISTIC
/begin CHARACTERISTIC DFES_EnvRef.DFC_MOXEMM_SMU_ALM6_4_C "" VALUE 0x8024DD83 Val_Wu8 29.0000000000 DFES_EnvTabVerb 0.00 29.0000000000 FORMAT "%13.10" /end CHARACTERISTIC
/begin CHARACTERISTIC DFES_EnvRef.DFC_MOXEMM_SMU_ALM6_5_C "" VALUE 0x8024DD84 Val_Wu8 29.0000000000 DFES_EnvTabVerb 0.00 29.0000000000 FORMAT "%13.10" /end CHARACTERISTIC
/begin CHARACTERISTIC DFES_EnvRef.DFC_MOXEMM_SMU_ALM6_7_C "" VALUE 0x8024DD85 Val_Wu8 29.0000000000 DFES_EnvTabVerb 0.00 29.0000000000 FORMAT "%13.10" /end CHARACTERISTIC
/begin CHARACTERISTIC DFES_EnvRef.DFC_MOXEMM_SMU_ALM6_8_C "" VALUE 0x8024DD86 Val_Wu8 29.0000000000 DFES_EnvTabVerb 0.00 29.0000000000 FORMAT "%13.10" /end CHARACTERISTIC
/begin CHARACTERISTIC DFES_EnvRef.DFC_MOXEMM_SMU_ALM7_1_C "" VALUE 0x8024DD87 Val_Wu8 29.0000000000 DFES_EnvTabVerb 0.00 29.0000000000 FORMAT "%13.10" /end CHARACTERISTIC
/begin CHARACTERISTIC DFES_EnvRef.DFC_MOXEMM_SMU_ALM7_12_C "" VALUE 0x8024DD88 Val_Wu8 29.0000000000 DFES_EnvTabVerb 0.00 29.0000000000 FORMAT "%13.10" /end CHARACTERISTIC
/begin CHARACTERISTIC DFES_EnvRef.DFC_MOXEMM_SMU_ALM7_13_C "" VALUE 0x8024DD89 Val_Wu8 29.0000000000 DFES_EnvTabVerb 0.00 29.0000000000 FORMAT "%13.10" /end CHARACTERISTIC
/begin CHARACTERISTIC DFES_EnvRef.DFC_MOXEMM_SMU_ALM7_14_C "" VALUE 0x8024DD8A Val_Wu8 29.0000000000 DFES_EnvTabVerb 0.00 29.0000000000 FORMAT "%13.10" /end CHARACTERISTIC
/begin CHARACTERISTIC DFES_EnvRef.DFC_MOXEMM_SMU_ALM7_15_C "" VALUE 0x8024DD8B Val_Wu8 29.0000000000 DFES_EnvTabVerb 0.00 29.0000000000 FORMAT "%13.10" /end CHARACTERISTIC
/begin CHARACTERISTIC DFES_EnvRef.DFC_MOXEMM_SMU_ALM7_16_C "" VALUE 0x8024DD8C Val_Wu8 29.0000000000 DFES_EnvTabVerb 0.00 29.0000000000 FORMAT "%13.10" /end CHARACTERISTIC
/begin CHARACTERISTIC DFES_EnvRef.DFC_MOXEMM_SMU_ALM7_17_C "" VALUE 0x8024DD8D Val_Wu8 29.0000000000 DFES_EnvTabVerb 0.00 29.0000000000 FORMAT "%13.10" /end CHARACTERISTIC
/begin CHARACTERISTIC DFES_EnvRef.DFC_MOXEMM_SMU_ALM7_2_C "" VALUE 0x8024DD8E Val_Wu8 29.0000000000 DFES_EnvTabVerb 0.00 29.0000000000 FORMAT "%13.10" /end CHARACTERISTIC
/begin CHARACTERISTIC DFES_EnvRef.DFC_MOXEMM_SMU_ALM7_20_C "" VALUE 0x8024DD8F Val_Wu8 29.0000000000 DFES_EnvTabVerb 0.00 29.0000000000 FORMAT "%13.10" /end CHARACTERISTIC
/begin CHARACTERISTIC DFES_EnvRef.DFC_MOXEMM_SMU_ALM7_25_C "" VALUE 0x8024DD90 Val_Wu8 29.0000000000 DFES_EnvTabVerb 0.00 29.0000000000 FORMAT "%13.10" /end CHARACTERISTIC
/begin CHARACTERISTIC DFES_EnvRef.DFC_MOXEMM_SMU_ALM7_26_C "" VALUE 0x8024DD91 Val_Wu8 29.0000000000 DFES_EnvTabVerb 0.00 29.0000000000 FORMAT "%13.10" /end CHARACTERISTIC
/begin CHARACTERISTIC DFES_EnvRef.DFC_MOXEMM_SMU_ALM7_28_C "" VALUE 0x8024DD92 Val_Wu8 29.0000000000 DFES_EnvTabVerb 0.00 29.0000000000 FORMAT "%13.10" /end CHARACTERISTIC
/begin CHARACTERISTIC DFES_EnvRef.DFC_MOXEMM_SMU_ALM7_29_C "" VALUE 0x8024DD93 Val_Wu8 29.0000000000 DFES_EnvTabVerb 0.00 29.0000000000 FORMAT "%13.10" /end CHARACTERISTIC
/begin CHARACTERISTIC DFES_EnvRef.DFC_MOXEMM_SMU_ALM7_30_C "" VALUE 0x8024DD94 Val_Wu8 29.0000000000 DFES_EnvTabVerb 0.00 29.0000000000 FORMAT "%13.10" /end CHARACTERISTIC
/begin CHARACTERISTIC DFES_EnvRef.DFC_MOXEMM_SMU_ALM7_31_C "" VALUE 0x8024DD95 Val_Wu8 29.0000000000 DFES_EnvTabVerb 0.00 29.0000000000 FORMAT "%13.10" /end CHARACTERISTIC
/begin CHARACTERISTIC DFES_EnvRef.DFC_MOXEMM_SMU_ALM8_0_C "" VALUE 0x8024DD96 Val_Wu8 29.0000000000 DFES_EnvTabVerb 0.00 29.0000000000 FORMAT "%13.10" /end CHARACTERISTIC
/begin CHARACTERISTIC DFES_EnvRef.DFC_MOXEMM_SMU_ALM8_1_C "" VALUE 0x8024DD97 Val_Wu8 29.0000000000 DFES_EnvTabVerb 0.00 29.0000000000 FORMAT "%13.10" /end CHARACTERISTIC
/begin CHARACTERISTIC DFES_EnvRef.DFC_MOXEMM_SMU_ALM8_10_C "" VALUE 0x8024DD98 Val_Wu8 29.0000000000 DFES_EnvTabVerb 0.00 29.0000000000 FORMAT "%13.10" /end CHARACTERISTIC
/begin CHARACTERISTIC DFES_EnvRef.DFC_MOXEMM_SMU_ALM8_11_C "" VALUE 0x8024DD99 Val_Wu8 29.0000000000 DFES_EnvTabVerb 0.00 29.0000000000 FORMAT "%13.10" /end CHARACTERISTIC
/begin CHARACTERISTIC DFES_EnvRef.DFC_MOXEMM_SMU_ALM8_12_C "" VALUE 0x8024DD9A Val_Wu8 29.0000000000 DFES_EnvTabVerb 0.00 29.0000000000 FORMAT "%13.10" /end CHARACTERISTIC
/begin CHARACTERISTIC DFES_EnvRef.DFC_MOXEMM_SMU_ALM8_16_C "" VALUE 0x8024DD9B Val_Wu8 29.0000000000 DFES_EnvTabVerb 0.00 29.0000000000 FORMAT "%13.10" /end CHARACTERISTIC
/begin CHARACTERISTIC DFES_EnvRef.DFC_MOXEMM_SMU_ALM8_18_C "" VALUE 0x8024DD9C Val_Wu8 29.0000000000 DFES_EnvTabVerb 0.00 29.0000000000 FORMAT "%13.10" /end CHARACTERISTIC
/begin CHARACTERISTIC DFES_EnvRef.DFC_MOXEMM_SMU_ALM8_2_C "" VALUE 0x8024DD9D Val_Wu8 29.0000000000 DFES_EnvTabVerb 0.00 29.0000000000 FORMAT "%13.10" /end CHARACTERISTIC
/begin CHARACTERISTIC DFES_EnvRef.DFC_MOXEMM_SMU_ALM8_3_C "" VALUE 0x8024DD9E Val_Wu8 29.0000000000 DFES_EnvTabVerb 0.00 29.0000000000 FORMAT "%13.10" /end CHARACTERISTIC
/begin CHARACTERISTIC DFES_EnvRef.DFC_MOXEMM_SMU_ALM8_31_C "" VALUE 0x8024DD9F Val_Wu8 29.0000000000 DFES_EnvTabVerb 0.00 29.0000000000 FORMAT "%13.10" /end CHARACTERISTIC
/begin CHARACTERISTIC DFES_EnvRef.DFC_MOXEMM_SMU_ALM8_4_C "" VALUE 0x8024DDA0 Val_Wu8 29.0000000000 DFES_EnvTabVerb 0.00 29.0000000000 FORMAT "%13.10" /end CHARACTERISTIC
/begin CHARACTERISTIC DFES_EnvRef.DFC_MOXEMM_SMU_ALM9_0_C "" VALUE 0x8024DDA1 Val_Wu8 29.0000000000 DFES_EnvTabVerb 0.00 29.0000000000 FORMAT "%13.10" /end CHARACTERISTIC
/begin CHARACTERISTIC DFES_EnvRef.DFC_MOXEMM_SMU_ALM9_15_C "" VALUE 0x8024DDA2 Val_Wu8 29.0000000000 DFES_EnvTabVerb 0.00 29.0000000000 FORMAT "%13.10" /end CHARACTERISTIC
/begin CHARACTERISTIC DFES_EnvRef.DFC_MOXEMM_SMU_ALM9_3_C "" VALUE 0x8024DDA3 Val_Wu8 29.0000000000 DFES_EnvTabVerb 0.00 29.0000000000 FORMAT "%13.10" /end CHARACTERISTIC
/begin CHARACTERISTIC DFES_EnvRef.DFC_MoCADCNTPBnk1_C "" VALUE 0x8024DDA4 Val_Wu8 29.0000000000 DFES_EnvTabVerb 0.00 29.0000000000 FORMAT "%13.10" /end CHARACTERISTIC
/begin CHARACTERISTIC DFES_EnvRef.DFC_MoCADCTestVoltBnk1_C "" VALUE 0x8024DDA5 Val_Wu8 29.0000000000 DFES_EnvTabVerb 0.00 29.0000000000 FORMAT "%13.10" /end CHARACTERISTIC
/begin CHARACTERISTIC DFES_EnvRef.DFC_MoCSOPICO_C "" VALUE 0x8024DDA6 Val_Wu8 29.0000000000 DFES_EnvTabVerb 0.00 29.0000000000 FORMAT "%13.10" /end CHARACTERISTIC
/begin CHARACTERISTIC DFES_EnvRef.DFC_MoFAccr_C "" VALUE 0x8024DDA7 Val_Wu8 29.0000000000 DFES_EnvTabVerb 0.00 29.0000000000 FORMAT "%13.10" /end CHARACTERISTIC
/begin CHARACTERISTIC DFES_EnvRef.DFC_MoFCbnPreCdngOvrheat_C "" VALUE 0x8024DDA8 Val_Wu8 29.0000000000 DFES_EnvTabVerb 0.00 29.0000000000 FORMAT "%13.10" /end CHARACTERISTIC
/begin CHARACTERISTIC DFES_EnvRef.DFC_MoFCbnPreCdngTmrExpi_C "" VALUE 0x8024DDA9 Val_Wu8 29.0000000000 DFES_EnvTabVerb 0.00 29.0000000000 FORMAT "%13.10" /end CHARACTERISTIC
/begin CHARACTERISTIC DFES_EnvRef.DFC_MoFEvMngtBms_C "" VALUE 0x8024DDAA Val_Wu8 29.0000000000 DFES_EnvTabVerb 0.00 29.0000000000 FORMAT "%13.10" /end CHARACTERISTIC
/begin CHARACTERISTIC DFES_EnvRef.DFC_MoFEvMngtDcdc_C "" VALUE 0x8024DDAB Val_Wu8 29.0000000000 DFES_EnvTabVerb 0.00 29.0000000000 FORMAT "%13.10" /end CHARACTERISTIC
/begin CHARACTERISTIC DFES_EnvRef.DFC_MoFEvMngtEm01_C "" VALUE 0x8024DDAC Val_Wu8 29.0000000000 DFES_EnvTabVerb 0.00 29.0000000000 FORMAT "%13.10" /end CHARACTERISTIC
/begin CHARACTERISTIC DFES_EnvRef.DFC_MoFEvMngtEm01BrkgToZr_C "" VALUE 0x8024DDAD Val_Wu8 29.0000000000 DFES_EnvTabVerb 0.00 29.0000000000 FORMAT "%13.10" /end CHARACTERISTIC
/begin CHARACTERISTIC DFES_EnvRef.DFC_MoFEvMngtEm01EngSpd_C "" VALUE 0x8024DDAE Val_Wu8 29.0000000000 DFES_EnvTabVerb 0.00 29.0000000000 FORMAT "%13.10" /end CHARACTERISTIC
/begin CHARACTERISTIC DFES_EnvRef.DFC_MoFEvMngtEm02EngSpd_C "" VALUE 0x8024DDAF Val_Wu8 29.0000000000 DFES_EnvTabVerb 0.00 29.0000000000 FORMAT "%13.10" /end CHARACTERISTIC
/begin CHARACTERISTIC DFES_EnvRef.DFC_MoFEvMngtEm02Lvl1_C "" VALUE 0x8024DDB0 Val_Wu8 29.0000000000 DFES_EnvTabVerb 0.00 29.0000000000 FORMAT "%13.10" /end CHARACTERISTIC
/begin CHARACTERISTIC DFES_EnvRef.DFC_MoFEvMngtEm02Lvl2_C "" VALUE 0x8024DDB1 Val_Wu8 29.0000000000 DFES_EnvTabVerb 0.00 29.0000000000 FORMAT "%13.10" /end CHARACTERISTIC
/begin CHARACTERISTIC DFES_EnvRef.DFC_MoFExtCptAuxCpt_C "" VALUE 0x8024DDB2 Val_Wu8 29.0000000000 DFES_EnvTabVerb 0.00 29.0000000000 FORMAT "%13.10" /end CHARACTERISTIC
/begin CHARACTERISTIC DFES_EnvRef.DFC_MoFExtCptVacPmpErr_C "" VALUE 0x8024DDB3 Val_Wu8 29.0000000000 DFES_EnvTabVerb 0.00 29.0000000000 FORMAT "%13.10" /end CHARACTERISTIC
/begin CHARACTERISTIC DFES_EnvRef.DFC_MoFTqPtdAxle_C "" VALUE 0x8024DDB4 Val_Wu8 29.0000000000 DFES_EnvTabVerb 0.00 29.0000000000 FORMAT "%13.10" /end CHARACTERISTIC
/begin CHARACTERISTIC DFES_EnvRef.DFC_MoFTqPtdAxleSec_C "" VALUE 0x8024DDB5 Val_Wu8 29.0000000000 DFES_EnvTabVerb 0.00 29.0000000000 FORMAT "%13.10" /end CHARACTERISTIC
/begin CHARACTERISTIC DFES_EnvRef.DFC_MoFTqPtdEmPtRels_C "" VALUE 0x8024DDB6 Val_Wu8 29.0000000000 DFES_EnvTabVerb 0.00 29.0000000000 FORMAT "%13.10" /end CHARACTERISTIC
/begin CHARACTERISTIC DFES_EnvRef.DFC_MoFTqPtdEmPtRelsSec_C "" VALUE 0x8024DDB7 Val_Wu8 29.0000000000 DFES_EnvTabVerb 0.00 29.0000000000 FORMAT "%13.10" /end CHARACTERISTIC
/begin CHARACTERISTIC DFES_EnvRef.DFC_MoFTqPtdEmSign_C "" VALUE 0x8024DDB8 Val_Wu8 29.0000000000 DFES_EnvTabVerb 0.00 29.0000000000 FORMAT "%13.10" /end CHARACTERISTIC
/begin CHARACTERISTIC DFES_EnvRef.DFC_MoFTqPtdEmSignSec_C "" VALUE 0x8024DDB9 Val_Wu8 29.0000000000 DFES_EnvTabVerb 0.00 29.0000000000 FORMAT "%13.10" /end CHARACTERISTIC
/begin CHARACTERISTIC DFES_EnvRef.DFC_MoFTqPtdEmTq_C "" VALUE 0x8024DDBA Val_Wu8 29.0000000000 DFES_EnvTabVerb 0.00 29.0000000000 FORMAT "%13.10" /end CHARACTERISTIC
/begin CHARACTERISTIC DFES_EnvRef.DFC_MoFTqPtdEmTqSec_C "" VALUE 0x8024DDBB Val_Wu8 29.0000000000 DFES_EnvTabVerb 0.00 29.0000000000 FORMAT "%13.10" /end CHARACTERISTIC
/begin CHARACTERISTIC DFES_EnvRef.DFC_MoFTqPtdVeh_C "" VALUE 0x8024DDBC Val_Wu8 29.0000000000 DFES_EnvTabVerb 0.00 29.0000000000 FORMAT "%13.10" /end CHARACTERISTIC
/begin CHARACTERISTIC DFES_EnvRef.DFC_MoFVarPostBldSel_C "" VALUE 0x8024DDBD Val_Wu8 29.0000000000 DFES_EnvTabVerb 0.00 29.0000000000 FORMAT "%13.10" /end CHARACTERISTIC
/begin CHARACTERISTIC DFES_EnvRef.DFC_MoSysCtrlReIni_C "" VALUE 0x8024DDBE Val_Wu8 29.0000000000 DFES_EnvTabVerb 0.00 29.0000000000 FORMAT "%13.10" /end CHARACTERISTIC
/begin CHARACTERISTIC DFES_EnvRef.DFC_MoXEMMHwLTMCUFW_C "" VALUE 0x8024DDBF Val_Wu8 29.0000000000 DFES_EnvTabVerb 0.00 29.0000000000 FORMAT "%13.10" /end CHARACTERISTIC
/begin CHARACTERISTIC DFES_EnvRef.DFC_MoXEMMHwLTMonBIST_C "" VALUE 0x8024DDC0 Val_Wu8 29.0000000000 DFES_EnvTabVerb 0.00 29.0000000000 FORMAT "%13.10" /end CHARACTERISTIC
/begin CHARACTERISTIC DFES_EnvRef.DFC_MoXEMMHwLTRegMonTest_C "" VALUE 0x8024DDC1 Val_Wu8 29.0000000000 DFES_EnvTabVerb 0.00 29.0000000000 FORMAT "%13.10" /end CHARACTERISTIC
/begin CHARACTERISTIC DFES_EnvRef.DFC_MoXEMMHwLTStbySMUAlvTest_C "" VALUE 0x8024DDC2 Val_Wu8 29.0000000000 DFES_EnvTabVerb 0.00 29.0000000000 FORMAT "%13.10" /end CHARACTERISTIC
/begin CHARACTERISTIC DFES_EnvRef.DFC_MoXEMMHwLTTempSens_C "" VALUE 0x8024DDC3 Val_Wu8 29.0000000000 DFES_EnvTabVerb 0.00 29.0000000000 FORMAT "%13.10" /end CHARACTERISTIC
/begin CHARACTERISTIC DFES_EnvRef.DFC_MoXEMMHwLTUCBCfg_C "" VALUE 0x8024DDC4 Val_Wu8 29.0000000000 DFES_EnvTabVerb 0.00 29.0000000000 FORMAT "%13.10" /end CHARACTERISTIC
/begin CHARACTERISTIC DFES_EnvRef.DFC_MonEgyChrgnCoorr_AcChrgnWoMofRels_C "" VALUE 0x8024DDC5 Val_Wu8 29.0000000000 DFES_EnvTabVerb 0.00 29.0000000000 FORMAT "%13.10" /end CHARACTERISTIC
/begin CHARACTERISTIC DFES_EnvRef.DFC_MonEgyChrgnCoorr_ChrgnAbortIgr_C "" VALUE 0x8024DDC6 Val_Wu8 29.0000000000 DFES_EnvTabVerb 0.00 29.0000000000 FORMAT "%13.10" /end CHARACTERISTIC
/begin CHARACTERISTIC DFES_EnvRef.DFC_MonEgyChrgnCoorr_DcCntctFailr_C "" VALUE 0x8024DDC7 Val_Wu8 29.0000000000 DFES_EnvTabVerb 0.00 29.0000000000 FORMAT "%13.10" /end CHARACTERISTIC
/begin CHARACTERISTIC DFES_EnvRef.DFC_MonEgyChrgnCoorr_ExtChrgnShtOffReq_C "" VALUE 0x8024DDC8 Val_Wu8 29.0000000000 DFES_EnvTabVerb 0.00 29.0000000000 FORMAT "%13.10" /end CHARACTERISTIC
/begin CHARACTERISTIC DFES_EnvRef.DFC_MonEgyChrgnCoorr_ImpsChrgnMod_C "" VALUE 0x8024DDC9 Val_Wu8 29.0000000000 DFES_EnvTabVerb 0.00 29.0000000000 FORMAT "%13.10" /end CHARACTERISTIC
/begin CHARACTERISTIC DFES_EnvRef.DFC_MonEgyChrgnCoorr_ImpsChrgnPrms_C "" VALUE 0x8024DDCA Val_Wu8 29.0000000000 DFES_EnvTabVerb 0.00 29.0000000000 FORMAT "%13.10" /end CHARACTERISTIC
/begin CHARACTERISTIC DFES_EnvRef.DFC_MonEgyChrgnCoorr_ImpsUDcIntk_C "" VALUE 0x8024DDCB Val_Wu8 29.0000000000 DFES_EnvTabVerb 0.00 29.0000000000 FORMAT "%13.10" /end CHARACTERISTIC
/begin CHARACTERISTIC DFES_EnvRef.DFC_MonEgyChrgnCoorr_PlgLockMovmt_C "" VALUE 0x8024DDCC Val_Wu8 29.0000000000 DFES_EnvTabVerb 0.00 29.0000000000 FORMAT "%13.10" /end CHARACTERISTIC
/begin CHARACTERISTIC DFES_EnvRef.DFC_MonEgyChrgnCoorr_VehCrashDetn_C "" VALUE 0x8024DDCD Val_Wu8 29.0000000000 DFES_EnvTabVerb 0.00 29.0000000000 FORMAT "%13.10" /end CHARACTERISTIC
/begin CHARACTERISTIC DFES_EnvRef.DFC_MonEgyChrgnErrReactn_SftySwt_C "" VALUE 0x8024DDCE Val_Wu8 29.0000000000 DFES_EnvTabVerb 0.00 29.0000000000 FORMAT "%13.10" /end CHARACTERISTIC
/begin CHARACTERISTIC DFES_EnvRef.DFC_MonEgyChrgnInlet_CcsPlgCtp_C "" VALUE 0x8024DDCF Val_Wu8 29.0000000000 DFES_EnvTabVerb 0.00 29.0000000000 FORMAT "%13.10" /end CHARACTERISTIC
/begin CHARACTERISTIC DFES_EnvRef.DFC_MonEgyChrgnInlet_CcsPlgCtpPwm_C "" VALUE 0x8024DDD0 Val_Wu8 29.0000000000 DFES_EnvTabVerb 0.00 29.0000000000 FORMAT "%13.10" /end CHARACTERISTIC
/begin CHARACTERISTIC DFES_EnvRef.DFC_MonEgyChrgnInlet_CcsPlgLockCtrlImpsAtmpt_C "" VALUE 0x8024DDD1 Val_Wu8 29.0000000000 DFES_EnvTabVerb 0.00 29.0000000000 FORMAT "%13.10" /end CHARACTERISTIC
/begin CHARACTERISTIC DFES_EnvRef.DFC_MonEgyChrgnInlet_CcsPlgLockSnsrSigRngChk_C "" VALUE 0x8024DDD2 Val_Wu8 29.0000000000 DFES_EnvTabVerb 0.00 29.0000000000 FORMAT "%13.10" /end CHARACTERISTIC
/begin CHARACTERISTIC DFES_EnvRef.DFC_MonEgyChrgnInlet_CcsPlgLockStImps_C "" VALUE 0x8024DDD3 Val_Wu8 29.0000000000 DFES_EnvTabVerb 0.00 29.0000000000 FORMAT "%13.10" /end CHARACTERISTIC
/begin CHARACTERISTIC DFES_EnvRef.DFC_MonEgyChrgnInlet_CcsPlgPxp_C "" VALUE 0x8024DDD4 Val_Wu8 29.0000000000 DFES_EnvTabVerb 0.00 29.0000000000 FORMAT "%13.10" /end CHARACTERISTIC
/begin CHARACTERISTIC DFES_EnvRef.DFC_MonEgyChrgnT_Snsr1GrdtChk_C "" VALUE 0x8024DDD5 Val_Wu8 29.0000000000 DFES_EnvTabVerb 0.00 29.0000000000 FORMAT "%13.10" /end CHARACTERISTIC
/begin CHARACTERISTIC DFES_EnvRef.DFC_MonEgyChrgnT_Snsr1SigRngChk_C "" VALUE 0x8024DDD6 Val_Wu8 29.0000000000 DFES_EnvTabVerb 0.00 29.0000000000 FORMAT "%13.10" /end CHARACTERISTIC
/begin CHARACTERISTIC DFES_EnvRef.DFC_MonEgyChrgnT_Snsr2GrdtChk_C "" VALUE 0x8024DDD7 Val_Wu8 29.0000000000 DFES_EnvTabVerb 0.00 29.0000000000 FORMAT "%13.10" /end CHARACTERISTIC
/begin CHARACTERISTIC DFES_EnvRef.DFC_MonEgyChrgnT_Snsr2SigRngChk_C "" VALUE 0x8024DDD8 Val_Wu8 29.0000000000 DFES_EnvTabVerb 0.00 29.0000000000 FORMAT "%13.10" /end CHARACTERISTIC
/begin CHARACTERISTIC DFES_EnvRef.DFC_MonEgyChrgnT_SnsrDif_C "" VALUE 0x8024DDD9 Val_Wu8 29.0000000000 DFES_EnvTabVerb 0.00 29.0000000000 FORMAT "%13.10" /end CHARACTERISTIC
/begin CHARACTERISTIC DFES_EnvRef.DFC_OCWDAABEActv_C "" VALUE 0x8024DDDA Val_Wu8 29.0000000000 DFES_EnvTabVerb 0.00 29.0000000000 FORMAT "%13.10" /end CHARACTERISTIC
/begin CHARACTERISTIC DFES_EnvRef.DFC_OCWDACom_C "" VALUE 0x8024DDDB Val_Wu8 29.0000000000 DFES_EnvTabVerb 0.00 29.0000000000 FORMAT "%13.10" /end CHARACTERISTIC
/begin CHARACTERISTIC DFES_EnvRef.DFC_OCWDAErrPin_C "" VALUE 0x8024DDDC Val_Wu8 29.0000000000 DFES_EnvTabVerb 0.00 29.0000000000 FORMAT "%13.10" /end CHARACTERISTIC
/begin CHARACTERISTIC DFES_EnvRef.DFC_OCWDAOvrVltg_C "" VALUE 0x8024DDDD Val_Wu8 29.0000000000 DFES_EnvTabVerb 0.00 29.0000000000 FORMAT "%13.10" /end CHARACTERISTIC
/begin CHARACTERISTIC DFES_EnvRef.DFC_PUmax_C "" VALUE 0x8024DDDE Val_Wu8 29.0000000000 DFES_EnvTabVerb 0.00 29.0000000000 FORMAT "%13.10" /end CHARACTERISTIC
/begin CHARACTERISTIC DFES_EnvRef.DFC_PwmCtPTmpErr_C "" VALUE 0x8024DDDF Val_Wu8 29.0000000000 DFES_EnvTabVerb 0.00 29.0000000000 FORMAT "%13.10" /end CHARACTERISTIC
/begin CHARACTERISTIC DFES_EnvRef.DFC_PwrDistbnUnitTSRCMax_C "" VALUE 0x8024DDE0 Val_Wu8 29.0000000000 DFES_EnvTabVerb 0.00 29.0000000000 FORMAT "%13.10" /end CHARACTERISTIC
/begin CHARACTERISTIC DFES_EnvRef.DFC_PwrDistbnUnitTTmpErr_C "" VALUE 0x8024DDE1 Val_Wu8 29.0000000000 DFES_EnvTabVerb 0.00 29.0000000000 FORMAT "%13.10" /end CHARACTERISTIC
/begin CHARACTERISTIC DFES_EnvRef.DFC_SCtPmp1DiagGrdKeyErr_C "" VALUE 0x8024DDE2 Val_Wu8 29.0000000000 DFES_EnvTabVerb 0.00 29.0000000000 FORMAT "%13.10" /end CHARACTERISTIC
/begin CHARACTERISTIC DFES_EnvRef.DFC_SRCHighAPP1_C "" VALUE 0x8024DDE3 Val_Wu8 29.0000000000 DFES_EnvTabVerb 0.00 29.0000000000 FORMAT "%13.10" /end CHARACTERISTIC
/begin CHARACTERISTIC DFES_EnvRef.DFC_SRCHighAPP2_C "" VALUE 0x8024DDE4 Val_Wu8 29.0000000000 DFES_EnvTabVerb 0.00 29.0000000000 FORMAT "%13.10" /end CHARACTERISTIC
/begin CHARACTERISTIC DFES_EnvRef.DFC_SRCLowAPP1_C "" VALUE 0x8024DDE5 Val_Wu8 29.0000000000 DFES_EnvTabVerb 0.00 29.0000000000 FORMAT "%13.10" /end CHARACTERISTIC
/begin CHARACTERISTIC DFES_EnvRef.DFC_SRCLowAPP2_C "" VALUE 0x8024DDE6 Val_Wu8 29.0000000000 DFES_EnvTabVerb 0.00 29.0000000000 FORMAT "%13.10" /end CHARACTERISTIC
/begin CHARACTERISTIC DFES_EnvRef.DFC_SWReset_0_C "" VALUE 0x8024DDE7 Val_Wu8 29.0000000000 DFES_EnvTabVerb 0.00 29.0000000000 FORMAT "%13.10" /end CHARACTERISTIC
/begin CHARACTERISTIC DFES_EnvRef.DFC_SWReset_1_C "" VALUE 0x8024DDE8 Val_Wu8 29.0000000000 DFES_EnvTabVerb 0.00 29.0000000000 FORMAT "%13.10" /end CHARACTERISTIC
/begin CHARACTERISTIC DFES_EnvRef.DFC_SWReset_2_C "" VALUE 0x8024DDE9 Val_Wu8 29.0000000000 DFES_EnvTabVerb 0.00 29.0000000000 FORMAT "%13.10" /end CHARACTERISTIC
/begin CHARACTERISTIC DFES_EnvRef.DFC_Sia_InvldCode_C "" VALUE 0x8024DDEA Val_Wu8 29.0000000000 DFES_EnvTabVerb 0.00 29.0000000000 FORMAT "%13.10" /end CHARACTERISTIC
/begin CHARACTERISTIC DFES_EnvRef.DFC_Sia_InvldKey_C "" VALUE 0x8024DDEB Val_Wu8 29.0000000000 DFES_EnvTabVerb 0.00 29.0000000000 FORMAT "%13.10" /end CHARACTERISTIC
/begin CHARACTERISTIC DFES_EnvRef.DFC_Sia_NoRespUCx_C "" VALUE 0x8024DDEC Val_Wu8 29.0000000000 DFES_EnvTabVerb 0.00 29.0000000000 FORMAT "%13.10" /end CHARACTERISTIC
/begin CHARACTERISTIC DFES_EnvRef.DFC_Sia_TprotRttp_C "" VALUE 0x8024DDED Val_Wu8 29.0000000000 DFES_EnvTabVerb 0.00 29.0000000000 FORMAT "%13.10" /end CHARACTERISTIC
/begin CHARACTERISTIC DFES_EnvRef.DFC_StrtUpEvStandStillDeactvn_C "" VALUE 0x8024DDEE Val_Wu8 29.0000000000 DFES_EnvTabVerb 0.00 29.0000000000 FORMAT "%13.10" /end CHARACTERISTIC
/begin CHARACTERISTIC DFES_EnvRef.DFC_SyncAPP_C "" VALUE 0x8024DDEF Val_Wu8 29.0000000000 DFES_EnvTabVerb 0.00 29.0000000000 FORMAT "%13.10" /end CHARACTERISTIC
/begin CHARACTERISTIC DFES_EnvRef.DFC_UCtPSRCMax_C "" VALUE 0x8024DDF0 Val_Wu8 29.0000000000 DFES_EnvTabVerb 0.00 29.0000000000 FORMAT "%13.10" /end CHARACTERISTIC
/begin CHARACTERISTIC DFES_EnvRef.DFC_UCtPTmpErr_C "" VALUE 0x8024DDF1 Val_Wu8 29.0000000000 DFES_EnvTabVerb 0.00 29.0000000000 FORMAT "%13.10" /end CHARACTERISTIC
/begin CHARACTERISTIC DFES_EnvRef.DFC_UPxP1SRCMax_C "" VALUE 0x8024DDF2 Val_Wu8 29.0000000000 DFES_EnvTabVerb 0.00 29.0000000000 FORMAT "%13.10" /end CHARACTERISTIC
/begin CHARACTERISTIC DFES_EnvRef.DFC_UPxP1TmpErr_C "" VALUE 0x8024DDF3 Val_Wu8 29.0000000000 DFES_EnvTabVerb 0.00 29.0000000000 FORMAT "%13.10" /end CHARACTERISTIC
/begin CHARACTERISTIC DFES_EnvRef.DFC_VehVObd_C "" VALUE 0x8024DDF4 Val_Wu8 29.0000000000 DFES_EnvTabVerb 0.00 29.0000000000 FORMAT "%13.10" /end CHARACTERISTIC
/begin CHARACTERISTIC DFES_FaultTyp.DFC_Unused_C "" VALUE 0x8024DDF6 Val_Wu8 255.0 DFES_OneToOne 0.00 255.0 FORMAT "%5.1" READ_ONLY /end CHARACTERISTIC
/begin CHARACTERISTIC DFES_FaultTyp.DFC_ACCmprFltLvlRes_C "" VALUE 0x8024DDF7 Val_Wu8 255.0 DFES_OneToOne 0.00 255.0 FORMAT "%5.1" /end CHARACTERISTIC
/begin CHARACTERISTIC DFES_FaultTyp.DFC_AbgHiSigFlt_C "" VALUE 0x8024DDF8 Val_Wu8 255.0 DFES_OneToOne 0.00 255.0 FORMAT "%5.1" /end CHARACTERISTIC
/begin CHARACTERISTIC DFES_FaultTyp.DFC_AbgIntPatFlt_C "" VALUE 0x8024DDF9 Val_Wu8 255.0 DFES_OneToOne 0.00 255.0 FORMAT "%5.1" /end CHARACTERISTIC
/begin CHARACTERISTIC DFES_FaultTyp.DFC_AbgLoSigFlt_C "" VALUE 0x8024DDFA Val_Wu8 255.0 DFES_OneToOne 0.00 255.0 FORMAT "%5.1" /end CHARACTERISTIC
/begin CHARACTERISTIC DFES_FaultTyp.DFC_AbgUnkwnErrSigFlt_C "" VALUE 0x8024DDFB Val_Wu8 255.0 DFES_OneToOne 0.00 255.0 FORMAT "%5.1" /end CHARACTERISTIC
/begin CHARACTERISTIC DFES_FaultTyp.DFC_AcExtChrgrIBattExcdd_C "" VALUE 0x8024DDFC Val_Wu8 255.0 DFES_OneToOne 0.00 255.0 FORMAT "%5.1" /end CHARACTERISTIC
/begin CHARACTERISTIC DFES_FaultTyp.DFC_AcExtChrgrIInExcdd_C "" VALUE 0x8024DDFD Val_Wu8 255.0 DFES_OneToOne 0.00 255.0 FORMAT "%5.1" /end CHARACTERISTIC
/begin CHARACTERISTIC DFES_FaultTyp.DFC_AcExtChrgrIOutDe_C "" VALUE 0x8024DDFE Val_Wu8 255.0 DFES_OneToOne 0.00 255.0 FORMAT "%5.1" /end CHARACTERISTIC
/begin CHARACTERISTIC DFES_FaultTyp.DFC_AcExtChrgrIOutExcdd_C "" VALUE 0x8024DDFF Val_Wu8 255.0 DFES_OneToOne 0.00 255.0 FORMAT "%5.1" /end CHARACTERISTIC
/begin CHARACTERISTIC DFES_FaultTyp.DFC_AcExtChrgrUOutDe_C "" VALUE 0x8024DE00 Val_Wu8 255.0 DFES_OneToOne 0.00 255.0 FORMAT "%5.1" /end CHARACTERISTIC
/begin CHARACTERISTIC DFES_FaultTyp.DFC_AdpActvDChaFailr_C "" VALUE 0x8024DE01 Val_Wu8 255.0 DFES_OneToOne 0.00 255.0 FORMAT "%5.1" /end CHARACTERISTIC
/begin CHARACTERISTIC DFES_FaultTyp.DFC_AirbcuFlt_C "" VALUE 0x8024DE02 Val_Wu8 255.0 DFES_OneToOne 0.00 255.0 FORMAT "%5.1" /end CHARACTERISTIC
/begin CHARACTERISTIC DFES_FaultTyp.DFC_Airbg_C "" VALUE 0x8024DE03 Val_Wu8 255.0 DFES_OneToOne 0.00 255.0 FORMAT "%5.1" /end CHARACTERISTIC
/begin CHARACTERISTIC DFES_FaultTyp.DFC_AirbgCan_C "" VALUE 0x8024DE04 Val_Wu8 255.0 DFES_OneToOne 0.00 255.0 FORMAT "%5.1" /end CHARACTERISTIC
/begin CHARACTERISTIC DFES_FaultTyp.DFC_AirbgCanHWPlaus_C "" VALUE 0x8024DE05 Val_Wu8 255.0 DFES_OneToOne 0.00 255.0 FORMAT "%5.1" /end CHARACTERISTIC
/begin CHARACTERISTIC DFES_FaultTyp.DFC_AirbgHWCanPlaus_C "" VALUE 0x8024DE06 Val_Wu8 255.0 DFES_OneToOne 0.00 255.0 FORMAT "%5.1" /end CHARACTERISTIC
/begin CHARACTERISTIC DFES_FaultTyp.DFC_AirbgMnr_C "" VALUE 0x8024DE07 Val_Wu8 255.0 DFES_OneToOne 0.00 255.0 FORMAT "%5.1" /end CHARACTERISTIC
/begin CHARACTERISTIC DFES_FaultTyp.DFC_AirbgPerHi_C "" VALUE 0x8024DE08 Val_Wu8 255.0 DFES_OneToOne 0.00 255.0 FORMAT "%5.1" /end CHARACTERISTIC
/begin CHARACTERISTIC DFES_FaultTyp.DFC_AirbgPerdRngFlt_C "" VALUE 0x8024DE09 Val_Wu8 255.0 DFES_OneToOne 0.00 255.0 FORMAT "%5.1" /end CHARACTERISTIC
/begin CHARACTERISTIC DFES_FaultTyp.DFC_BlowrRlyErr_C "" VALUE 0x8024DE0A Val_Wu8 255.0 DFES_OneToOne 0.00 255.0 FORMAT "%5.1" /end CHARACTERISTIC
/begin CHARACTERISTIC DFES_FaultTyp.DFC_BrkBstPmpActtnDfct_C "" VALUE 0x8024DE0B Val_Wu8 255.0 DFES_OneToOne 0.00 255.0 FORMAT "%5.1" /end CHARACTERISTIC
/begin CHARACTERISTIC DFES_FaultTyp.DFC_BrkBstPmpDeactvnDfct_C "" VALUE 0x8024DE0C Val_Wu8 255.0 DFES_OneToOne 0.00 255.0 FORMAT "%5.1" /end CHARACTERISTIC
/begin CHARACTERISTIC DFES_FaultTyp.DFC_BrkSwtFlt_C "" VALUE 0x8024DE0D Val_Wu8 255.0 DFES_OneToOne 0.00 255.0 FORMAT "%5.1" /end CHARACTERISTIC
/begin CHARACTERISTIC DFES_FaultTyp.DFC_CbnHeatgHeatrHsScb_C "" VALUE 0x8024DE0E Val_Wu8 255.0 DFES_OneToOne 0.00 255.0 FORMAT "%5.1" /end CHARACTERISTIC
/begin CHARACTERISTIC DFES_FaultTyp.DFC_CbnHeatgHeatrHsScg_C "" VALUE 0x8024DE0F Val_Wu8 255.0 DFES_OneToOne 0.00 255.0 FORMAT "%5.1" /end CHARACTERISTIC
/begin CHARACTERISTIC DFES_FaultTyp.DFC_CbnHeatgHeatrLsOl_C "" VALUE 0x8024DE10 Val_Wu8 255.0 DFES_OneToOne 0.00 255.0 FORMAT "%5.1" /end CHARACTERISTIC
/begin CHARACTERISTIC DFES_FaultTyp.DFC_CbnHeatgHeatrLsScb_C "" VALUE 0x8024DE11 Val_Wu8 255.0 DFES_OneToOne 0.00 255.0 FORMAT "%5.1" /end CHARACTERISTIC
/begin CHARACTERISTIC DFES_FaultTyp.DFC_CbnHeatgHeatrLsScg_C "" VALUE 0x8024DE12 Val_Wu8 255.0 DFES_OneToOne 0.00 255.0 FORMAT "%5.1" /end CHARACTERISTIC
/begin CHARACTERISTIC DFES_FaultTyp.DFC_CbnHeatgHeatrUnUsed_C "" VALUE 0x8024DE13 Val_Wu8 255.0 DFES_OneToOne 0.00 255.0 FORMAT "%5.1" /end CHARACTERISTIC
/begin CHARACTERISTIC DFES_FaultTyp.DFC_ChrgnCntctHsOt_C "" VALUE 0x8024DE14 Val_Wu8 255.0 DFES_OneToOne 0.00 255.0 FORMAT "%5.1" /end CHARACTERISTIC
/begin CHARACTERISTIC DFES_FaultTyp.DFC_ChrgnCntctHsScb_C "" VALUE 0x8024DE15 Val_Wu8 255.0 DFES_OneToOne 0.00 255.0 FORMAT "%5.1" /end CHARACTERISTIC
/begin CHARACTERISTIC DFES_FaultTyp.DFC_ChrgnCntctHsScg_C "" VALUE 0x8024DE16 Val_Wu8 255.0 DFES_OneToOne 0.00 255.0 FORMAT "%5.1" /end CHARACTERISTIC
/begin CHARACTERISTIC DFES_FaultTyp.DFC_ChrgnCntctLsNegOl_C "" VALUE 0x8024DE17 Val_Wu8 255.0 DFES_OneToOne 0.00 255.0 FORMAT "%5.1" /end CHARACTERISTIC
/begin CHARACTERISTIC DFES_FaultTyp.DFC_ChrgnCntctLsNegOt_C "" VALUE 0x8024DE18 Val_Wu8 255.0 DFES_OneToOne 0.00 255.0 FORMAT "%5.1" /end CHARACTERISTIC
/begin CHARACTERISTIC DFES_FaultTyp.DFC_ChrgnCntctLsNegScb_C "" VALUE 0x8024DE19 Val_Wu8 255.0 DFES_OneToOne 0.00 255.0 FORMAT "%5.1" /end CHARACTERISTIC
/begin CHARACTERISTIC DFES_FaultTyp.DFC_ChrgnCntctLsNegScg_C "" VALUE 0x8024DE1A Val_Wu8 255.0 DFES_OneToOne 0.00 255.0 FORMAT "%5.1" /end CHARACTERISTIC
/begin CHARACTERISTIC DFES_FaultTyp.DFC_ChrgnCntctLsPosOl_C "" VALUE 0x8024DE1B Val_Wu8 255.0 DFES_OneToOne 0.00 255.0 FORMAT "%5.1" /end CHARACTERISTIC
/begin CHARACTERISTIC DFES_FaultTyp.DFC_ChrgnCntctLsPosOt_C "" VALUE 0x8024DE1C Val_Wu8 255.0 DFES_OneToOne 0.00 255.0 FORMAT "%5.1" /end CHARACTERISTIC
/begin CHARACTERISTIC DFES_FaultTyp.DFC_ChrgnCntctLsPosScb_C "" VALUE 0x8024DE1D Val_Wu8 255.0 DFES_OneToOne 0.00 255.0 FORMAT "%5.1" /end CHARACTERISTIC
/begin CHARACTERISTIC DFES_FaultTyp.DFC_ChrgnCntctLsPosScg_C "" VALUE 0x8024DE1E Val_Wu8 255.0 DFES_OneToOne 0.00 255.0 FORMAT "%5.1" /end CHARACTERISTIC
/begin CHARACTERISTIC DFES_FaultTyp.DFC_ChrgnCntctUnUsed_C "" VALUE 0x8024DE1F Val_Wu8 255.0 DFES_OneToOne 0.00 255.0 FORMAT "%5.1" /end CHARACTERISTIC
/begin CHARACTERISTIC DFES_FaultTyp.DFC_ComBrkMai_C "" VALUE 0x8024DE20 Val_Wu8 255.0 DFES_OneToOne 0.00 255.0 FORMAT "%5.1" /end CHARACTERISTIC
/begin CHARACTERISTIC DFES_FaultTyp.DFC_ComChrgrEVCont_C "" VALUE 0x8024DE21 Val_Wu8 255.0 DFES_OneToOne 0.00 255.0 FORMAT "%5.1" /end CHARACTERISTIC
/begin CHARACTERISTIC DFES_FaultTyp.DFC_ComChrgrEVtBlink_C "" VALUE 0x8024DE22 Val_Wu8 255.0 DFES_OneToOne 0.00 255.0 FORMAT "%5.1" /end CHARACTERISTIC
/begin CHARACTERISTIC DFES_FaultTyp.DFC_ComChrgrMstBlink_C "" VALUE 0x8024DE23 Val_Wu8 255.0 DFES_OneToOne 0.00 255.0 FORMAT "%5.1" /end CHARACTERISTIC
/begin CHARACTERISTIC DFES_FaultTyp.DFC_ComChrgrMstCont_C "" VALUE 0x8024DE24 Val_Wu8 255.0 DFES_OneToOne 0.00 255.0 FORMAT "%5.1" /end CHARACTERISTIC
/begin CHARACTERISTIC DFES_FaultTyp.DFC_ComChrgrSVSBlink_C "" VALUE 0x8024DE25 Val_Wu8 255.0 DFES_OneToOne 0.00 255.0 FORMAT "%5.1" /end CHARACTERISTIC
/begin CHARACTERISTIC DFES_FaultTyp.DFC_ComChrgrSVSCont_C "" VALUE 0x8024DE26 Val_Wu8 255.0 DFES_OneToOne 0.00 255.0 FORMAT "%5.1" /end CHARACTERISTIC
/begin CHARACTERISTIC DFES_FaultTyp.DFC_ComDcdcEVBlink_C "" VALUE 0x8024DE27 Val_Wu8 255.0 DFES_OneToOne 0.00 255.0 FORMAT "%5.1" /end CHARACTERISTIC
/begin CHARACTERISTIC DFES_FaultTyp.DFC_ComDcdcEVCont_C "" VALUE 0x8024DE28 Val_Wu8 255.0 DFES_OneToOne 0.00 255.0 FORMAT "%5.1" /end CHARACTERISTIC
/begin CHARACTERISTIC DFES_FaultTyp.DFC_ComDcdcFltLvl2_C "" VALUE 0x8024DE29 Val_Wu8 255.0 DFES_OneToOne 0.00 255.0 FORMAT "%5.1" /end CHARACTERISTIC
/begin CHARACTERISTIC DFES_FaultTyp.DFC_ComDcdcFltLvl3_C "" VALUE 0x8024DE2A Val_Wu8 255.0 DFES_OneToOne 0.00 255.0 FORMAT "%5.1" /end CHARACTERISTIC
/begin CHARACTERISTIC DFES_FaultTyp.DFC_ComDcdcFltLvl4_C "" VALUE 0x8024DE2B Val_Wu8 255.0 DFES_OneToOne 0.00 255.0 FORMAT "%5.1" /end CHARACTERISTIC
/begin CHARACTERISTIC DFES_FaultTyp.DFC_ComDcdcFltLvl5_C "" VALUE 0x8024DE2C Val_Wu8 255.0 DFES_OneToOne 0.00 255.0 FORMAT "%5.1" /end CHARACTERISTIC
/begin CHARACTERISTIC DFES_FaultTyp.DFC_ComDcdcFltLvlRes_C "" VALUE 0x8024DE2D Val_Wu8 255.0 DFES_OneToOne 0.00 255.0 FORMAT "%5.1" /end CHARACTERISTIC
/begin CHARACTERISTIC DFES_FaultTyp.DFC_ComDcdcMstBlink_C "" VALUE 0x8024DE2E Val_Wu8 255.0 DFES_OneToOne 0.00 255.0 FORMAT "%5.1" /end CHARACTERISTIC
/begin CHARACTERISTIC DFES_FaultTyp.DFC_ComDcdcMstCont_C "" VALUE 0x8024DE2F Val_Wu8 255.0 DFES_OneToOne 0.00 255.0 FORMAT "%5.1" /end CHARACTERISTIC
/begin CHARACTERISTIC DFES_FaultTyp.DFC_ComDcdcSVSBlink_C "" VALUE 0x8024DE30 Val_Wu8 255.0 DFES_OneToOne 0.00 255.0 FORMAT "%5.1" /end CHARACTERISTIC
/begin CHARACTERISTIC DFES_FaultTyp.DFC_ComDcdcSVSCont_C "" VALUE 0x8024DE31 Val_Wu8 255.0 DFES_OneToOne 0.00 255.0 FORMAT "%5.1" /end CHARACTERISTIC
/begin CHARACTERISTIC DFES_FaultTyp.DFC_ComElMIIvtrFltLvl2_C "" VALUE 0x8024DE32 Val_Wu8 255.0 DFES_OneToOne 0.00 255.0 FORMAT "%5.1" /end CHARACTERISTIC
/begin CHARACTERISTIC DFES_FaultTyp.DFC_ComElMIIvtrFltLvl3_C "" VALUE 0x8024DE33 Val_Wu8 255.0 DFES_OneToOne 0.00 255.0 FORMAT "%5.1" /end CHARACTERISTIC
/begin CHARACTERISTIC DFES_FaultTyp.DFC_ComElMIIvtrFltLvl4_C "" VALUE 0x8024DE34 Val_Wu8 255.0 DFES_OneToOne 0.00 255.0 FORMAT "%5.1" /end CHARACTERISTIC
/begin CHARACTERISTIC DFES_FaultTyp.DFC_ComElMIIvtrFltLvl5_C "" VALUE 0x8024DE35 Val_Wu8 255.0 DFES_OneToOne 0.00 255.0 FORMAT "%5.1" /end CHARACTERISTIC
/begin CHARACTERISTIC DFES_FaultTyp.DFC_ComElMIIvtrFltLvlRes_C "" VALUE 0x8024DE36 Val_Wu8 255.0 DFES_OneToOne 0.00 255.0 FORMAT "%5.1" /end CHARACTERISTIC
/begin CHARACTERISTIC DFES_FaultTyp.DFC_ComEmacEVBlink_C "" VALUE 0x8024DE37 Val_Wu8 255.0 DFES_OneToOne 0.00 255.0 FORMAT "%5.1" /end CHARACTERISTIC
/begin CHARACTERISTIC DFES_FaultTyp.DFC_ComEmacEVCont_C "" VALUE 0x8024DE38 Val_Wu8 255.0 DFES_OneToOne 0.00 255.0 FORMAT "%5.1" /end CHARACTERISTIC
/begin CHARACTERISTIC DFES_FaultTyp.DFC_ComEmacMstCont_C "" VALUE 0x8024DE39 Val_Wu8 255.0 DFES_OneToOne 0.00 255.0 FORMAT "%5.1" /end CHARACTERISTIC
/begin CHARACTERISTIC DFES_FaultTyp.DFC_ComEmacMsttBlink_C "" VALUE 0x8024DE3A Val_Wu8 255.0 DFES_OneToOne 0.00 255.0 FORMAT "%5.1" /end CHARACTERISTIC
/begin CHARACTERISTIC DFES_FaultTyp.DFC_ComEmacSVSBlink_C "" VALUE 0x8024DE3B Val_Wu8 255.0 DFES_OneToOne 0.00 255.0 FORMAT "%5.1" /end CHARACTERISTIC
/begin CHARACTERISTIC DFES_FaultTyp.DFC_ComEmacSVSCont_C "" VALUE 0x8024DE3C Val_Wu8 255.0 DFES_OneToOne 0.00 255.0 FORMAT "%5.1" /end CHARACTERISTIC
/begin CHARACTERISTIC DFES_FaultTyp.DFC_ComGunCntInfoWkuReq_C "" VALUE 0x8024DE3D Val_Wu8 255.0 DFES_OneToOne 0.00 255.0 FORMAT "%5.1" /end CHARACTERISTIC
/begin CHARACTERISTIC DFES_FaultTyp.DFC_ComHillHldFlt_C "" VALUE 0x8024DE3E Val_Wu8 255.0 DFES_OneToOne 0.00 255.0 FORMAT "%5.1" /end CHARACTERISTIC
/begin CHARACTERISTIC DFES_FaultTyp.DFC_ComHvBattRchrgWkuReq_C "" VALUE 0x8024DE3F Val_Wu8 255.0 DFES_OneToOne 0.00 255.0 FORMAT "%5.1" /end CHARACTERISTIC
/begin CHARACTERISTIC DFES_FaultTyp.DFC_ComHvbFltLvl2_C "" VALUE 0x8024DE40 Val_Wu8 255.0 DFES_OneToOne 0.00 255.0 FORMAT "%5.1" /end CHARACTERISTIC
/begin CHARACTERISTIC DFES_FaultTyp.DFC_ComHvbFltLvl3_C "" VALUE 0x8024DE41 Val_Wu8 255.0 DFES_OneToOne 0.00 255.0 FORMAT "%5.1" /end CHARACTERISTIC
/begin CHARACTERISTIC DFES_FaultTyp.DFC_ComHvbFltLvl4_C "" VALUE 0x8024DE42 Val_Wu8 255.0 DFES_OneToOne 0.00 255.0 FORMAT "%5.1" /end CHARACTERISTIC
/begin CHARACTERISTIC DFES_FaultTyp.DFC_ComHvbFltLvl5_C "" VALUE 0x8024DE43 Val_Wu8 255.0 DFES_OneToOne 0.00 255.0 FORMAT "%5.1" /end CHARACTERISTIC
/begin CHARACTERISTIC DFES_FaultTyp.DFC_ComHvbFltLvlRes_C "" VALUE 0x8024DE44 Val_Wu8 255.0 DFES_OneToOne 0.00 255.0 FORMAT "%5.1" /end CHARACTERISTIC
/begin CHARACTERISTIC DFES_FaultTyp.DFC_ComHvbMstBlink_C "" VALUE 0x8024DE45 Val_Wu8 255.0 DFES_OneToOne 0.00 255.0 FORMAT "%5.1" /end CHARACTERISTIC
/begin CHARACTERISTIC DFES_FaultTyp.DFC_ComHvbMstCont_C "" VALUE 0x8024DE46 Val_Wu8 255.0 DFES_OneToOne 0.00 255.0 FORMAT "%5.1" /end CHARACTERISTIC
/begin CHARACTERISTIC DFES_FaultTyp.DFC_ComImmoUnlockWkuReq_C "" VALUE 0x8024DE47 Val_Wu8 255.0 DFES_OneToOne 0.00 255.0 FORMAT "%5.1" /end CHARACTERISTIC
/begin CHARACTERISTIC DFES_FaultTyp.DFC_ComInfoReqPtlWkuReq_C "" VALUE 0x8024DE48 Val_Wu8 255.0 DFES_OneToOne 0.00 255.0 FORMAT "%5.1" /end CHARACTERISTIC
/begin CHARACTERISTIC DFES_FaultTyp.DFC_ComOBCFltLvl2_C "" VALUE 0x8024DE49 Val_Wu8 255.0 DFES_OneToOne 0.00 255.0 FORMAT "%5.1" /end CHARACTERISTIC
/begin CHARACTERISTIC DFES_FaultTyp.DFC_ComOBCFltLvl3_C "" VALUE 0x8024DE4A Val_Wu8 255.0 DFES_OneToOne 0.00 255.0 FORMAT "%5.1" /end CHARACTERISTIC
/begin CHARACTERISTIC DFES_FaultTyp.DFC_ComOBCFltLvl4_C "" VALUE 0x8024DE4B Val_Wu8 255.0 DFES_OneToOne 0.00 255.0 FORMAT "%5.1" /end CHARACTERISTIC
/begin CHARACTERISTIC DFES_FaultTyp.DFC_ComOBCFltLvl5_C "" VALUE 0x8024DE4C Val_Wu8 255.0 DFES_OneToOne 0.00 255.0 FORMAT "%5.1" /end CHARACTERISTIC
/begin CHARACTERISTIC DFES_FaultTyp.DFC_ComOBCFltLvlRes_C "" VALUE 0x8024DE4D Val_Wu8 255.0 DFES_OneToOne 0.00 255.0 FORMAT "%5.1" /end CHARACTERISTIC
/begin CHARACTERISTIC DFES_FaultTyp.DFC_ComPostOperationWkuReq_C "" VALUE 0x8024DE4E Val_Wu8 255.0 DFES_OneToOne 0.00 255.0 FORMAT "%5.1" /end CHARACTERISTIC
/begin CHARACTERISTIC DFES_FaultTyp.DFC_ComPreCondElecWkuReq_C "" VALUE 0x8024DE4F Val_Wu8 255.0 DFES_OneToOne 0.00 255.0 FORMAT "%5.1" /end CHARACTERISTIC
/begin CHARACTERISTIC DFES_FaultTyp.DFC_ComRemUnlckWkuReq_C "" VALUE 0x8024DE50 Val_Wu8 255.0 DFES_OneToOne 0.00 255.0 FORMAT "%5.1" /end CHARACTERISTIC
/begin CHARACTERISTIC DFES_FaultTyp.DFC_ComStpDlyHMIWkuReq_C "" VALUE 0x8024DE51 Val_Wu8 255.0 DFES_OneToOne 0.00 255.0 FORMAT "%5.1" /end CHARACTERISTIC
/begin CHARACTERISTIC DFES_FaultTyp.DFC_ComflgCurMeasmtErr_C "" VALUE 0x8024DE52 Val_Wu8 255.0 DFES_OneToOne 0.00 255.0 FORMAT "%5.1" /end CHARACTERISTIC
/begin CHARACTERISTIC DFES_FaultTyp.DFC_ComflgCurMeasmtSysErr_C "" VALUE 0x8024DE53 Val_Wu8 255.0 DFES_OneToOne 0.00 255.0 FORMAT "%5.1" /end CHARACTERISTIC
/begin CHARACTERISTIC DFES_FaultTyp.DFC_ComflgCurMeasmtVld_C "" VALUE 0x8024DE54 Val_Wu8 255.0 DFES_OneToOne 0.00 255.0 FORMAT "%5.1" /end CHARACTERISTIC
/begin CHARACTERISTIC DFES_FaultTyp.DFC_ComflgCurRngErr_C "" VALUE 0x8024DE55 Val_Wu8 255.0 DFES_OneToOne 0.00 255.0 FORMAT "%5.1" /end CHARACTERISTIC
/begin CHARACTERISTIC DFES_FaultTyp.DFC_ComflgTPcbMeasmtErr_C "" VALUE 0x8024DE56 Val_Wu8 255.0 DFES_OneToOne 0.00 255.0 FORMAT "%5.1" /end CHARACTERISTIC
/begin CHARACTERISTIC DFES_FaultTyp.DFC_ComflgTPcbMeasmtVld_C "" VALUE 0x8024DE57 Val_Wu8 255.0 DFES_OneToOne 0.00 255.0 FORMAT "%5.1" /end CHARACTERISTIC
/begin CHARACTERISTIC DFES_FaultTyp.DFC_ComflgTPcbRngErr_C "" VALUE 0x8024DE58 Val_Wu8 255.0 DFES_OneToOne 0.00 255.0 FORMAT "%5.1" /end CHARACTERISTIC
/begin CHARACTERISTIC DFES_FaultTyp.DFC_ComflgTPcbSysErr_C "" VALUE 0x8024DE59 Val_Wu8 255.0 DFES_OneToOne 0.00 255.0 FORMAT "%5.1" /end CHARACTERISTIC
/begin CHARACTERISTIC DFES_FaultTyp.DFC_ComflgTShntMeasmtErr_C "" VALUE 0x8024DE5A Val_Wu8 255.0 DFES_OneToOne 0.00 255.0 FORMAT "%5.1" /end CHARACTERISTIC
/begin CHARACTERISTIC DFES_FaultTyp.DFC_ComflgTShntMeasmtVld_C "" VALUE 0x8024DE5B Val_Wu8 255.0 DFES_OneToOne 0.00 255.0 FORMAT "%5.1" /end CHARACTERISTIC
/begin CHARACTERISTIC DFES_FaultTyp.DFC_ComflgTShntRngErr_C "" VALUE 0x8024DE5C Val_Wu8 255.0 DFES_OneToOne 0.00 255.0 FORMAT "%5.1" /end CHARACTERISTIC
/begin CHARACTERISTIC DFES_FaultTyp.DFC_ComflgTShntSysErr_C "" VALUE 0x8024DE5D Val_Wu8 255.0 DFES_OneToOne 0.00 255.0 FORMAT "%5.1" /end CHARACTERISTIC
/begin CHARACTERISTIC DFES_FaultTyp.DFC_ComflgVoltMeasmtErr_C "" VALUE 0x8024DE5E Val_Wu8 255.0 DFES_OneToOne 0.00 255.0 FORMAT "%5.1" /end CHARACTERISTIC
/begin CHARACTERISTIC DFES_FaultTyp.DFC_ComflgVoltMeasmtSysErr_C "" VALUE 0x8024DE5F Val_Wu8 255.0 DFES_OneToOne 0.00 255.0 FORMAT "%5.1" /end CHARACTERISTIC
/begin CHARACTERISTIC DFES_FaultTyp.DFC_ComflgVoltMeasmtVld_C "" VALUE 0x8024DE60 Val_Wu8 255.0 DFES_OneToOne 0.00 255.0 FORMAT "%5.1" /end CHARACTERISTIC
/begin CHARACTERISTIC DFES_FaultTyp.DFC_ComflgVoltRngErr_C "" VALUE 0x8024DE61 Val_Wu8 255.0 DFES_OneToOne 0.00 255.0 FORMAT "%5.1" /end CHARACTERISTIC
/begin CHARACTERISTIC DFES_FaultTyp.DFC_CrashEveOcc_C "" VALUE 0x8024DE62 Val_Wu8 255.0 DFES_OneToOne 0.00 255.0 FORMAT "%5.1" /end CHARACTERISTIC
/begin CHARACTERISTIC DFES_FaultTyp.DFC_DcdcFwdModStuck_C "" VALUE 0x8024DE63 Val_Wu8 255.0 DFES_OneToOne 0.00 255.0 FORMAT "%5.1" /end CHARACTERISTIC
/begin CHARACTERISTIC DFES_FaultTyp.DFC_DcdcLvUDifMaxFlt_C "" VALUE 0x8024DE64 Val_Wu8 255.0 DFES_OneToOne 0.00 255.0 FORMAT "%5.1" /end CHARACTERISTIC
/begin CHARACTERISTIC DFES_FaultTyp.DFC_DcdcOffModStuck_C "" VALUE 0x8024DE65 Val_Wu8 255.0 DFES_OneToOne 0.00 255.0 FORMAT "%5.1" /end CHARACTERISTIC
/begin CHARACTERISTIC DFES_FaultTyp.DFC_DcdcOperModFailr_C "" VALUE 0x8024DE66 Val_Wu8 255.0 DFES_OneToOne 0.00 255.0 FORMAT "%5.1" /end CHARACTERISTIC
/begin CHARACTERISTIC DFES_FaultTyp.DFC_DcdcPrecModStuck_C "" VALUE 0x8024DE67 Val_Wu8 255.0 DFES_OneToOne 0.00 255.0 FORMAT "%5.1" /end CHARACTERISTIC
/begin CHARACTERISTIC DFES_FaultTyp.DFC_DrvDoorOpn_C "" VALUE 0x8024DE68 Val_Wu8 255.0 DFES_OneToOne 0.00 255.0 FORMAT "%5.1" /end CHARACTERISTIC
/begin CHARACTERISTIC DFES_FaultTyp.DFC_DrvModPosnDfct_C "" VALUE 0x8024DE69 Val_Wu8 255.0 DFES_OneToOne 0.00 255.0 FORMAT "%5.1" /end CHARACTERISTIC
/begin CHARACTERISTIC DFES_FaultTyp.DFC_DrvStbltOpn_C "" VALUE 0x8024DE6A Val_Wu8 255.0 DFES_OneToOne 0.00 255.0 FORMAT "%5.1" /end CHARACTERISTIC
/begin CHARACTERISTIC DFES_FaultTyp.DFC_ETogFailrLvl3_C "" VALUE 0x8024DE6B Val_Wu8 255.0 DFES_OneToOne 0.00 255.0 FORMAT "%5.1" /end CHARACTERISTIC
/begin CHARACTERISTIC DFES_FaultTyp.DFC_ETogFailrLvl4_C "" VALUE 0x8024DE6C Val_Wu8 255.0 DFES_OneToOne 0.00 255.0 FORMAT "%5.1" /end CHARACTERISTIC
/begin CHARACTERISTIC DFES_FaultTyp.DFC_EbsLvBattSocDiagLo_C "" VALUE 0x8024DE6D Val_Wu8 255.0 DFES_OneToOne 0.00 255.0 FORMAT "%5.1" /end CHARACTERISTIC
/begin CHARACTERISTIC DFES_FaultTyp.DFC_EbsLvBattUDiagDiOper_C "" VALUE 0x8024DE6E Val_Wu8 255.0 DFES_OneToOne 0.00 255.0 FORMAT "%5.1" /end CHARACTERISTIC
/begin CHARACTERISTIC DFES_FaultTyp.DFC_EbsLvBattUDiagFltLvl1_C "" VALUE 0x8024DE6F Val_Wu8 255.0 DFES_OneToOne 0.00 255.0 FORMAT "%5.1" /end CHARACTERISTIC
/begin CHARACTERISTIC DFES_FaultTyp.DFC_EbsLvBattUDiagFltLvl2_C "" VALUE 0x8024DE70 Val_Wu8 255.0 DFES_OneToOne 0.00 255.0 FORMAT "%5.1" /end CHARACTERISTIC
/begin CHARACTERISTIC DFES_FaultTyp.DFC_EbsLvBattUDiagLo_C "" VALUE 0x8024DE71 Val_Wu8 255.0 DFES_OneToOne 0.00 255.0 FORMAT "%5.1" /end CHARACTERISTIC
/begin CHARACTERISTIC DFES_FaultTyp.DFC_EbsSnsrSt_C "" VALUE 0x8024DE72 Val_Wu8 255.0 DFES_OneToOne 0.00 255.0 FORMAT "%5.1" /end CHARACTERISTIC
/begin CHARACTERISTIC DFES_FaultTyp.DFC_EbsSofASILErr_C "" VALUE 0x8024DE73 Val_Wu8 255.0 DFES_OneToOne 0.00 255.0 FORMAT "%5.1" /end CHARACTERISTIC
/begin CHARACTERISTIC DFES_FaultTyp.DFC_ElTSPtSysLimDrvErr_C "" VALUE 0x8024DE74 Val_Wu8 255.0 DFES_OneToOne 0.00 255.0 FORMAT "%5.1" /end CHARACTERISTIC
/begin CHARACTERISTIC DFES_FaultTyp.DFC_ElTSPtSysLimRgnErr_C "" VALUE 0x8024DE75 Val_Wu8 255.0 DFES_OneToOne 0.00 255.0 FORMAT "%5.1" /end CHARACTERISTIC
/begin CHARACTERISTIC DFES_FaultTyp.DFC_HLCCcsFwDwnl_C "" VALUE 0x8024DE76 Val_Wu8 255.0 DFES_OneToOne 0.00 255.0 FORMAT "%5.1" /end CHARACTERISTIC
/begin CHARACTERISTIC DFES_FaultTyp.DFC_HvBattChrgPwrMax_C "" VALUE 0x8024DE77 Val_Wu8 255.0 DFES_OneToOne 0.00 255.0 FORMAT "%5.1" /end CHARACTERISTIC
/begin CHARACTERISTIC DFES_FaultTyp.DFC_HvBattCrashDetd_C "" VALUE 0x8024DE78 Val_Wu8 255.0 DFES_OneToOne 0.00 255.0 FORMAT "%5.1" /end CHARACTERISTIC
/begin CHARACTERISTIC DFES_FaultTyp.DFC_HvBattDchaPwrMax_C "" VALUE 0x8024DE79 Val_Wu8 255.0 DFES_OneToOne 0.00 255.0 FORMAT "%5.1" /end CHARACTERISTIC
/begin CHARACTERISTIC DFES_FaultTyp.DFC_HvBattEmgyOff_C "" VALUE 0x8024DE7A Val_Wu8 255.0 DFES_OneToOne 0.00 255.0 FORMAT "%5.1" /end CHARACTERISTIC
/begin CHARACTERISTIC DFES_FaultTyp.DFC_HvBattEmgyOffIntlck_C "" VALUE 0x8024DE7B Val_Wu8 255.0 DFES_OneToOne 0.00 255.0 FORMAT "%5.1" /end CHARACTERISTIC
/begin CHARACTERISTIC DFES_FaultTyp.DFC_HvBattEmgyOffReq_C "" VALUE 0x8024DE7C Val_Wu8 255.0 DFES_OneToOne 0.00 255.0 FORMAT "%5.1" /end CHARACTERISTIC
/begin CHARACTERISTIC DFES_FaultTyp.DFC_HvBattFltMod_C "" VALUE 0x8024DE7D Val_Wu8 255.0 DFES_OneToOne 0.00 255.0 FORMAT "%5.1" /end CHARACTERISTIC
/begin FUNCTION DFES "30000.70.0Diagnostic Fault Event Storage"
 /begin DEF_CHARACTERISTIC DFES_EnvRef.DFC_HvBattSrvPlgDiscnct_C DFES_EnvRef.DFC_HvBattUNomChrgnErr_C DFES_EnvRef.DFC_HvBattUNomChrgnIni_C DFES_EnvRef.DFC_HvBattUnderTDern_C DFES_EnvRef.DFC_HvbEVLmpBlink_C DFES_EnvRef.DFC_HvbEVLmpCont_C DFES_EnvRef.DFC_HvbSVSBlink_C DFES_EnvRef.DFC_HvbSVSCont_C DFES_EnvRef.DFC_InmLINBusBlk_C DFES_EnvRef.DFC_PDUProgmFailr_C DFES_EnvRef.DFC_PEnvSigRngMax_C DFES_EnvRef.DFC_PEnvSigRngMin_C DFES_EnvRef.DFC_PLnCChpDeactvnFaild_C DFES_EnvRef.DFC_PrkgBrkFailr_C DFES_EnvRef.DFC_PtSysLimErr_C DFES_EnvRef.DFC_PwrMaxDchaShoLo_C DFES_EnvRef.DFC_SCtPmp1FailSafeNotSuc_C DFES_EnvRef.DFC_SCtPmp1SCG_C DFES_EnvRef.DFC_VehCoornDrvrNotPrsnt_C DFES_EnvRef.DFC_VehVCanAvl_C DFES_EnvRef.DFC_VehVCanErr_C DFES_EnvRef.DFC_eTogFailrLvlRes_C DFES_EnvRef.DFC_flgBrkMaiDiag_C DFES_EnvRef.DFC_stHvbIsoMeasmtRes_C DFES_EnvRef.DFC_BrkBstPmpPLeakDfct_C DFES_EnvRef.DFC_Com082hTooShort_C DFES_EnvRef.DFC_Com092hTooShort_C DFES_EnvRef.DFC_Com205hAbsent_C DFES_EnvRef.DFC_Com205hChecksum_C DFES_EnvRef.DFC_Com205hCounter_C DFES_EnvRef.DFC_Com205hTooShort_C DFES_EnvRef.DFC_Com217hAbsent_C DFES_EnvRef.DFC_Com217hChecksum_C DFES_EnvRef.DFC_Com217hCounter_C DFES_EnvRef.DFC_Com217hTooShort_C DFES_EnvRef.DFC_Com227hAbsent_C DFES_EnvRef.DFC_Com227hTooShort_C DFES_EnvRef.DFC_Com237hAbsent_C DFES_EnvRef.DFC_Com237hChecksum_C DFES_EnvRef.DFC_Com237hCounter_C DFES_EnvRef.DFC_Com237hTooShort_C DFES_EnvRef.DFC_Com259hAbsent_C DFES_EnvRef.DFC_Com259hChecksum_C DFES_EnvRef.DFC_Com259hCounter_C DFES_EnvRef.DFC_Com259hTooShort_C DFES_EnvRef.DFC_Com26hAbsent_C DFES_EnvRef.DFC_Com26hTooShort_C DFES_EnvRef.DFC_Com273hAbsent_C DFES_EnvRef.DFC_Com273hChecksum_C DFES_EnvRef.DFC_Com273hCounter_C DFES_EnvRef.DFC_Com273hTooShort_C DFES_EnvRef.DFC_Com275hAbsent_C DFES_EnvRef.DFC_Com275hChecksum_C DFES_EnvRef.DFC_Com275hCounter_C DFES_EnvRef.DFC_Com275hTooShort_C DFES_EnvRef.DFC_Com283hAbsent_C DFES_EnvRef.DFC_Com283hTooShort_C DFES_EnvRef.DFC_Com285hAbsent_C DFES_EnvRef.DFC_Com285hChecksum_C DFES_EnvRef.DFC_Com285hCounter_C DFES_EnvRef.DFC_Com285hTooShort_C DFES_EnvRef.DFC_Com293hAbsent_C DFES_EnvRef.DFC_Com293hChecksum_C DFES_EnvRef.DFC_Com293hCounter_C DFES_EnvRef.DFC_Com293hTooShort_C DFES_EnvRef.DFC_Com308hAbsent_C DFES_EnvRef.DFC_Com308hChecksum_C DFES_EnvRef.DFC_Com308hCounter_C DFES_EnvRef.DFC_Com308hTooShort_C DFES_EnvRef.DFC_Com318hAbsent_C DFES_EnvRef.DFC_Com318hChecksum_C DFES_EnvRef.DFC_Com318hCounter_C DFES_EnvRef.DFC_Com318hTooShort_C DFES_EnvRef.DFC_Com325hAbsent_C DFES_EnvRef.DFC_Com325hChecksum_C DFES_EnvRef.DFC_Com325hCounter_C DFES_EnvRef.DFC_Com325hTooShort_C DFES_EnvRef.DFC_Com335hAbsent_C DFES_EnvRef.DFC_Com335hChecksum_C DFES_EnvRef.DFC_Com335hCounter_C DFES_EnvRef.DFC_Com335hTooShort_C DFES_EnvRef.DFC_Com351hAbsent_C DFES_EnvRef.DFC_Com351hTooShort_C DFES_EnvRef.DFC_Com38DhAbsent_C DFES_EnvRef.DFC_Com38DhChecksum_C DFES_EnvRef.DFC_Com38DhCounter_C DFES_EnvRef.DFC_Com38DhTooShort_C DFES_EnvRef.DFC_Com412hAbsent_C DFES_EnvRef.DFC_Com412hChecksum_C DFES_EnvRef.DFC_Com412hCounter_C DFES_EnvRef.DFC_Com412hTooShort_C DFES_EnvRef.DFC_Com427hAbsent_C DFES_EnvRef.DFC_Com427hTooShort_C DFES_EnvRef.DFC_Com432hAbsent_C DFES_EnvRef.DFC_Com432hChecksum_C DFES_EnvRef.DFC_Com432hCounter_C DFES_EnvRef.DFC_Com432hTooShort_C DFES_EnvRef.DFC_Com435hAbsent_C DFES_EnvRef.DFC_Com435hTooShort_C DFES_EnvRef.DFC_Com442hAbsent_C DFES_EnvRef.DFC_Com442hTooShort_C DFES_EnvRef.DFC_Com453hAbsent_C DFES_EnvRef.DFC_Com453hTooShort_C DFES_EnvRef.DFC_Com455hAbsent_C DFES_EnvRef.DFC_Com455hTooShort_C DFES_EnvRef.DFC_Com463hAbsent_C DFES_EnvRef.DFC_Com463hTooShort_C DFES_EnvRef.DFC_Com473hAbsent_C DFES_EnvRef.DFC_Com473hTooShort_C DFES_EnvRef.DFC_Com47BhAbsent_C DFES_EnvRef.DFC_Com47BhTooShort_C DFES_EnvRef.DFC_Com48BhAbsent_C DFES_EnvRef.DFC_Com48BhTooShort_C DFES_EnvRef.DFC_Com497hTooShort_C DFES_EnvRef.DFC_Com4F2hAbsent_C DFES_EnvRef.DFC_Com4F2hChecksum_C DFES_EnvRef.DFC_Com4F2hCounter_C DFES_EnvRef.DFC_Com4F2hTooShort_C DFES_EnvRef.DFC_Com50DhAbsent_C DFES_EnvRef.DFC_Com50DhTooShort_C DFES_EnvRef.DFC_Com535hAbsent_C DFES_EnvRef.DFC_Com535hTooShort_C DFES_EnvRef.DFC_Com543hAbsent_C DFES_EnvRef.DFC_Com543hTooShort_C DFES_EnvRef.DFC_Com552hAbsent_C DFES_EnvRef.DFC_Com552hTooShort_C DFES_EnvRef.DFC_Com583hAbsent_C DFES_EnvRef.DFC_Com583hTooShort_C DFES_EnvRef.DFC_Com592hAbsent_C DFES_EnvRef.DFC_Com592hChecksum_C DFES_EnvRef.DFC_Com592hCounter_C DFES_EnvRef.DFC_Com592hTooShort_C DFES_EnvRef.DFC_Com595hAbsent_C DFES_EnvRef.DFC_Com595hChecksum_C DFES_EnvRef.DFC_Com595hCounter_C DFES_EnvRef.DFC_Com595hTooShort_C DFES_EnvRef.DFC_Com5B2hAbsent_C DFES_EnvRef.DFC_Com5B2hTooShort_C DFES_EnvRef.DFC_Com5B5hAbsent_C DFES_EnvRef.DFC_Com5B5hChecksum_C DFES_EnvRef.DFC_Com5B5hCounter_C DFES_EnvRef.DFC_Com5B5hTooShort_C DFES_EnvRef.DFC_Com5C7hTooShort_C DFES_EnvRef.DFC_Com5E7hAbsent_C DFES_EnvRef.DFC_Com5E7hTooShort_C DFES_EnvRef.DFC_Com635hTooShort_C DFES_EnvRef.DFC_Com645hTooShort_C DFES_EnvRef.DFC_Com663hAbsent_C DFES_EnvRef.DFC_Com663hTooShort_C DFES_EnvRef.DFC_Com665hAbsent_C DFES_EnvRef.DFC_Com665hTooShort_C DFES_EnvRef.DFC_Com675hAbsent_C DFES_EnvRef.DFC_Com675hTooShort_C DFES_EnvRef.DFC_ComFrbd_205h_HVBAT_PACK_CURRENT_C DFES_EnvRef.DFC_ComFrbd_205h_HVBAT_SOC_DISPLAY_C DFES_EnvRef.DFC_ComFrbd_205h_HVBAT_VOLTAGE_C DFES_EnvRef.DFC_ComFrbd_217h_INV_DC_BUS_VOLTAGE_C DFES_EnvRef.DFC_ComFrbd_217h_INV_MTR_ACTUAL_TRQ_C DFES_EnvRef.DFC_ComFrbd_217h_INV_MTR_SPEED_C DFES_EnvRef.DFC_ComFrbd_217h_INV_MTR_TRQ_C DFES_EnvRef.DFC_ComFrbd_227h_INV_DC_CURRENT_C DFES_EnvRef.DFC_ComFrbd_227h_INV_MOTORING_PEAK_TRQ_C DFES_EnvRef.DFC_ComFrbd_227h_INV_MTR_INST_INPUT_POWER_C DFES_EnvRef.DFC_ComFrbd_227h_INV_REGEN_PEAK_TRQ_C DFES_EnvRef.DFC_ComFrbd_237h_INV_ACTIVE_DISCHARGE_STATUS_C DFES_EnvRef.DFC_ComFrbd_237h_INV_CTRL_MODE_ACK_C DFES_EnvRef.DFC_ComFrbd_237h_INV_EV_WARNING_C DFES_EnvRef.DFC_ComFrbd_237h_INV_FAULT_LEVEL_C DFES_EnvRef.DFC_ComFrbd_237h_INV_MASTER_STOP_C DFES_EnvRef.DFC_ComFrbd_237h_INV_SERVICE_DUE_C DFES_EnvRef.DFC_ComFrbd_237h_INV_STAB_MIN_TRQ_C DFES_EnvRef.DFC_ComFrbd_259h_TGLM_FAILURE_STATE_C DFES_EnvRef.DFC_ComFrbd_259h_TGLM_MODE_PUSH_C DFES_EnvRef.DFC_ComFrbd_259h_TOGGLE_MONOSTABLE_POS_C DFES_EnvRef.DFC_ComFrbd_273h_OBC_outputpower_capability_C DFES_EnvRef.DFC_ComFrbd_275h_HVBAT_DISCHARGE_30S_AVAILABLE_CURRENT_C DFES_EnvRef.DFC_ComFrbd_275h_HVBAT_DISCHARGE_30S_AVAILABLE_POWER_C DFES_EnvRef.DFC_ComFrbd_283h_DCDC_IN_CURRENT_C DFES_EnvRef.DFC_ComFrbd_283h_DCDC_IN_VOLTAGE_C DFES_EnvRef.DFC_ComFrbd_283h_DCDC_OUT_CURRENT_C DFES_EnvRef.DFC_ComFrbd_283h_DCDC_OUT_VOLTAGE_C DFES_EnvRef.DFC_ComFrbd_285h_HVBAT_REGEN_CHG_30S_CURRENT_LIMIT_C DFES_EnvRef.DFC_ComFrbd_285h_HVBAT_REGEN_CHRG_30S_POWER_LIMIT_C DFES_EnvRef.DFC_ComFrbd_293h_DCDC_outputpower_capability_C DFES_EnvRef.DFC_ComFrbd_325h_HVBAT_INSULATION_RESISTANCE_C DFES_EnvRef.DFC_ComFrbd_325h_HVBAT_TEMPERATURE_C DFES_EnvRef.DFC_ComFrbd_335h_HVBAT_CHRG_CONTINUOUS_CURR_MAX_C DFES_EnvRef.DFC_ComFrbd_335h_HVBAT_CHRG_COTINUOUS_CURR_REQ_C DFES_EnvRef.DFC_ComFrbd_335h_HVBAT_CHRG_MAX_VOLT_C DFES_EnvRef.DFC_ComFrbd_335h_HVBAT_DC_BUS_VOLTAGE_C DFES_EnvRef.DFC_ComFrbd_427h_INV_OP_MODE_C DFES_EnvRef.DFC_ComFrbd_427h_INV_PERMISIBLE_TORQUE_C DFES_EnvRef.DFC_ComFrbd_435h_HVBAT_MAX_CELL_VOLT_C DFES_EnvRef.DFC_ComFrbd_435h_HVBAT_MAX_CELL_VOLT_NUM_C DFES_EnvRef.DFC_ComFrbd_435h_HVBAT_MAX_SENSOR_TEMP_C DFES_EnvRef.DFC_ComFrbd_435h_HVBAT_MIN_CELL_VOLT_C DFES_EnvRef.DFC_ComFrbd_435h_HVBAT_MIN_CELL_VOLT_NUM_C DFES_EnvRef.DFC_ComFrbd_453h_OBC_IN_CURRENT_C DFES_EnvRef.DFC_ComFrbd_453h_OBC_IN_VOLTAGE_C DFES_EnvRef.DFC_ComFrbd_453h_OBC_IP_POWER_C DFES_EnvRef.DFC_ComFrbd_455h_HVBAT_NOMINAL_VOLTAGE_C DFES_EnvRef.DFC_ComFrbd_463h_OBC_OUT_CURRENT_C DFES_EnvRef.DFC_ComFrbd_463h_OBC_OUT_VOLTAGE_C DFES_EnvRef.DFC_ComFrbd_463h_OBC_TEMPERATURE_C DFES_EnvRef.DFC_ComFrbd_473h_DCDC_Coolant_Temperature_C DFES_EnvRef.DFC_ComFrbd_473h_DCDC_TEMPERATURE_C DFES_EnvRef.DFC_ComFrbd_47Bh_eCOMP_BusBarCurrent_C DFES_EnvRef.DFC_ComFrbd_47Bh_eCOMP_BusBarVoltage_C DFES_EnvRef.DFC_ComFrbd_47Bh_eCOMP_CompressorSpeed_C DFES_EnvRef.DFC_ComFrbd_47Bh_eCOMP_IGBT_Temp_C DFES_EnvRef.DFC_ComFrbd_47Bh_eCOMP_PeakPhaCurrent_C DFES_EnvRef.DFC_ComFrbd_47Bh_eCOMP_Power_consumption_C DFES_EnvRef.DFC_ComFrbd_48Bh_eCOMP_Fault_Level_C DFES_EnvRef.DFC_ComFrbd_4F2h_VALEUR_SOC_ETENDUE_C DFES_EnvRef.DFC_ComFrbd_535h_HV_BATT_TEMP_AVG_C DFES_EnvRef.DFC_ComFrbd_543h_HVBAT_RESTBATTENERGY_C DFES_EnvRef.DFC_ComFrbd_543h_HVBAT_SOH_C DFES_EnvRef.DFC_ComFrbd_543h_HV_BATT_SOH_RES_C DFES_EnvRef.DFC_ComFrbd_592h_IBATT_1_C DFES_EnvRef.DFC_ComFrbd_592h_IBATT_2_C DFES_EnvRef.DFC_ComFrbd_592h_IBATT_3_C DFES_EnvRef.DFC_ComFrbd_592h_TEMP_BATT_C DFES_EnvRef.DFC_ComFrbd_592h_U_BATT_BECB_C DFES_EnvRef.DFC_ComFrbd_595h_HVBAT_TIME_TO_CHRG_80_C DFES_EnvRef.DFC_ComFrbd_5B2h_TEMP_AIR_EXT_C DFES_EnvRef.DFC_ComFrbd_635h_HVBAT_NEG_CONT_COUNT_SEG1_C DFES_EnvRef.DFC_ComFrbd_635h_HVBAT_NEG_CONT_COUNT_SEG3_C DFES_EnvRef.DFC_ComFrbd_635h_HVBAT_NEG_CONT_COUNT_SEG4_C DFES_EnvRef.DFC_ComFrbd_635h_HVBAT_PST_CONT_COUNT_SEG1_C DFES_EnvRef.DFC_ComFrbd_635h_HVBAT_PST_CONT_COUNT_SEG3_C DFES_EnvRef.DFC_ComFrbd_635h_HVBAT_PST_CONT_COUNT_SEG4_C DFES_EnvRef.DFC_ComFrbd_645h_HVBAT_PRECHRGE_CONT_COUNT_SEG1_C DFES_EnvRef.DFC_ComFrbd_645h_HVBAT_PRECHRGE_CONT_COUNT_SEG2_C DFES_EnvRef.DFC_ComFrbd_675h_HVBAT_REMAININGBATTCAPACITY_C DFES_EnvRef.DFC_ComInvld_205h_HVBAT_CHARGING_STATUS_C DFES_EnvRef.DFC_ComInvld_205h_HVBAT_PACK_CURRENT_C DFES_EnvRef.DFC_ComInvld_205h_HVBAT_SOC_DISPLAY_C DFES_EnvRef.DFC_ComInvld_205h_HVBAT_VOLTAGE_C DFES_EnvRef.DFC_ComInvld_217h_INV_DC_BUS_VOLTAGE_C DFES_EnvRef.DFC_ComInvld_217h_INV_MTR_ACTUAL_TRQ_C DFES_EnvRef.DFC_ComInvld_217h_INV_MTR_SPEED_C DFES_EnvRef.DFC_ComInvld_217h_INV_MTR_TRQ_C DFES_EnvRef.DFC_ComInvld_227h_INV_DC_CURRENT_C DFES_EnvRef.DFC_ComInvld_227h_INV_MOTORING_PEAK_TRQ_C DFES_EnvRef.DFC_ComInvld_227h_INV_MTR_INST_INPUT_POWER_C DFES_EnvRef.DFC_ComInvld_227h_INV_REGEN_PEAK_TRQ_C DFES_EnvRef.DFC_ComInvld_237h_INV_ACTIVE_DISCHARGE_STATUS_C DFES_EnvRef.DFC_ComInvld_237h_INV_FAULT_LEVEL_C DFES_EnvRef.DFC_ComInvld_237h_INV_STAB_MIN_TRQ_C DFES_EnvRef.DFC_ComInvld_259h_TGLM_MODE_PUSH_C DFES_EnvRef.DFC_ComInvld_259h_TOGGLE_MONOSTABLE_POS_C DFES_EnvRef.DFC_ComInvld_26h_AC_SWITCH_REQ_C DFES_EnvRef.DFC_ComInvld_26h_BLOWER_POSITION_C DFES_EnvRef.DFC_ComInvld_26h_EVAP_SENSOR_FAULT_C DFES_EnvRef.DFC_ComInvld_26h_EVAP_SENSOR_VALUE_C DFES_EnvRef.DFC_ComInvld_26h_POTENTIOMETER_FAULT_C DFES_EnvRef.DFC_ComInvld_26h_REAR_DEFOG_REQ_C DFES_EnvRef.DFC_ComInvld_26h_TEMP_POSITION_C DFES_EnvRef.DFC_ComInvld_273h_OBC_FAULT_LEVEL_C DFES_EnvRef.DFC_ComInvld_273h_OBC_outputpower_capability_C DFES_EnvRef.DFC_ComInvld_275h_HVBAT_DISCHARGE_30S_AVAILABLE_CURRENT_C DFES_EnvRef.DFC_ComInvld_275h_HVBAT_DISCHARGE_30S_AVAILABLE_POWER_C DFES_EnvRef.DFC_ComInvld_283h_DCDC_IN_CURRENT_C DFES_EnvRef.DFC_ComInvld_283h_DCDC_IN_VOLTAGE_C DFES_EnvRef.DFC_ComInvld_283h_DCDC_OUT_CURRENT_C DFES_EnvRef.DFC_ComInvld_283h_DCDC_OUT_VOLTAGE_C DFES_EnvRef.DFC_ComInvld_285h_HVBAT_REGEN_CHG_30S_CURRENT_LIMIT_C DFES_EnvRef.DFC_ComInvld_285h_HVBAT_REGEN_CHRG_30S_POWER_LIMIT_C DFES_EnvRef.DFC_ComInvld_293h_DCDC_FAULT_LEVEL_C DFES_EnvRef.DFC_ComInvld_293h_DCDC_outputpower_capability_C DFES_EnvRef.DFC_ComInvld_325h_HVBAT_EPLUG_STATUS_C DFES_EnvRef.DFC_ComInvld_325h_HVBAT_HVIL_STS_C DFES_EnvRef.DFC_ComInvld_325h_HVBAT_INSULATION_FAULT_C DFES_EnvRef.DFC_ComInvld_325h_HVBAT_INSULATION_RESISTANCE_C DFES_EnvRef.DFC_ComInvld_325h_HVBAT_TEMPERATURE_C DFES_EnvRef.DFC_ComInvld_335h_HVBAT_CHRG_CONTINUOUS_CURR_MAX_C DFES_EnvRef.DFC_ComInvld_335h_HVBAT_CHRG_COTINUOUS_CURR_REQ_C DFES_EnvRef.DFC_ComInvld_335h_HVBAT_CHRG_MAX_VOLT_C DFES_EnvRef.DFC_ComInvld_335h_HVBAT_DC_BUS_VOLTAGE_C DFES_EnvRef.DFC_ComInvld_38Dh_VITESSE_VEHICULE_ROUES_C DFES_EnvRef.DFC_ComInvld_38Dh_VVH_INDISP_C DFES_EnvRef.DFC_ComInvld_427h_INV_COOLANT_TEMP_C DFES_EnvRef.DFC_ComInvld_427h_INV_MOTOR_TEMP_C DFES_EnvRef.DFC_ComInvld_427h_INV_OP_MODE_C DFES_EnvRef.DFC_ComInvld_427h_INV_PERMISIBLE_TORQUE_C DFES_EnvRef.DFC_ComInvld_427h_INV_TEMP_C DFES_EnvRef.DFC_ComInvld_432h_REVEIL_PRINCIPAL_C DFES_EnvRef.DFC_ComInvld_435h_HVBAT_MAX_CELL_VOLT_C DFES_EnvRef.DFC_ComInvld_435h_HVBAT_MAX_CELL_VOLT_NUM_C DFES_EnvRef.DFC_ComInvld_435h_HVBAT_MAX_SENSOR_TEMP_C DFES_EnvRef.DFC_ComInvld_435h_HVBAT_MIN_CELL_VOLT_C DFES_EnvRef.DFC_ComInvld_435h_HVBAT_MIN_CELL_VOLT_NUM_C DFES_EnvRef.DFC_ComInvld_442h_BCCM_BLOWER_RELAY_STS_C DFES_EnvRef.DFC_ComInvld_453h_OBC_IN_CURRENT_C DFES_EnvRef.DFC_ComInvld_453h_OBC_IN_VOLTAGE_C DFES_EnvRef.DFC_ComInvld_453h_OBC_IP_POWER_C DFES_EnvRef.DFC_ComInvld_455h_HVBAT_NOMINAL_VOLTAGE_C DFES_EnvRef.DFC_ComInvld_463h_OBC_OUT_CURRENT_C DFES_EnvRef.DFC_ComInvld_463h_OBC_OUT_VOLTAGE_C DFES_EnvRef.DFC_ComInvld_463h_OBC_TEMPERATURE_C DFES_EnvRef.DFC_ComInvld_473h_DCDC_Coolant_Temperature_C DFES_EnvRef.DFC_ComInvld_473h_DCDC_TEMPERATURE_C DFES_EnvRef.DFC_ComInvld_47Bh_eCOMP_BusBarCurrent_C DFES_EnvRef.DFC_ComInvld_47Bh_eCOMP_BusBarVoltage_C DFES_EnvRef.DFC_ComInvld_47Bh_eCOMP_CompressorSpeed_C DFES_EnvRef.DFC_ComInvld_47Bh_eCOMP_IGBT_Temp_C DFES_EnvRef.DFC_ComInvld_47Bh_eCOMP_PeakPhaCurrent_C DFES_EnvRef.DFC_ComInvld_47Bh_eCOMP_Power_consumption_C DFES_EnvRef.DFC_ComInvld_4F2h_STATUS_SOC_C DFES_EnvRef.DFC_ComInvld_4F2h_TEMP_BATT_STATUS_C DFES_EnvRef.DFC_ComInvld_4F2h_VALEUR_SOC_ETENDUE_C DFES_EnvRef.DFC_ComInvld_535h_HV_BATT_TEMP_AVG_C DFES_EnvRef.DFC_ComInvld_543h_HVBAT_RESTBATTENERGY_C DFES_EnvRef.DFC_ComInvld_543h_HVBAT_SOH_C DFES_EnvRef.DFC_ComInvld_543h_HV_BATT_SOH_RES_C DFES_EnvRef.DFC_ComInvld_552h_CPT_TEMPOREL_C DFES_EnvRef.DFC_ComInvld_552h_KILOMETRAGE_C DFES_EnvRef.DFC_ComInvld_583h_HV_BATT_DISCONT_CSE_OPEN_C DFES_EnvRef.DFC_ComInvld_592h_CALIBRE_IBATT_C DFES_EnvRef.DFC_ComInvld_592h_IBATT_1_C DFES_EnvRef.DFC_ComInvld_592h_IBATT_2_C DFES_EnvRef.DFC_ComInvld_592h_IBATT_3_C DFES_EnvRef.DFC_ComInvld_592h_TEMP_BATT_C DFES_EnvRef.DFC_ComInvld_592h_U_BATT_BECB_C DFES_EnvRef.DFC_ComInvld_595h_HVBAT_TIME_TO_CHRG_80_C DFES_EnvRef.DFC_ComInvld_5B2h_TEMP_AIR_EXT_C DFES_EnvRef.DFC_ComInvld_5B5h_HVBAT_THERMAL_RUNAWAY_C DFES_EnvRef.DFC_ComInvld_635h_HVBAT_NEG_CONT_COUNT_SEG1_C DFES_EnvRef.DFC_ComInvld_635h_HVBAT_NEG_CONT_COUNT_SEG3_C DFES_EnvRef.DFC_ComInvld_635h_HVBAT_NEG_CONT_COUNT_SEG4_C DFES_EnvRef.DFC_ComInvld_635h_HVBAT_PST_CONT_COUNT_SEG1_C DFES_EnvRef.DFC_ComInvld_635h_HVBAT_PST_CONT_COUNT_SEG3_C DFES_EnvRef.DFC_ComInvld_635h_HVBAT_PST_CONT_COUNT_SEG4_C DFES_EnvRef.DFC_ComInvld_645h_HVBAT_PRECHRGE_CONT_COUNT_SEG1_C DFES_EnvRef.DFC_ComInvld_645h_HVBAT_PRECHRGE_CONT_COUNT_SEG2_C DFES_EnvRef.DFC_ComInvld_675h_HVBAT_REMAININGBATTCAPACITY_C DFES_EnvRef.DFC_ACCmprFltLvl1_C DFES_EnvRef.DFC_ACCmprFltLvl2_C DFES_EnvRef.DFC_ACCmprFltLvl3_C DFES_EnvRef.DFC_ACCmprFltLvl4_C DFES_EnvRef.DFC_ACCmprHiPFlt_C DFES_EnvRef.DFC_ACCmprInvldCmprSt_C DFES_EnvRef.DFC_ACCmprInvldElecActPwr_C DFES_EnvRef.DFC_ACCmprLoPFlt_C DFES_EnvRef.DFC_AcChrgrIntkTSRCMin_C DFES_EnvRef.DFC_BattUBMaxBatt_C DFES_EnvRef.DFC_BattUBMaxNoBatt_C DFES_EnvRef.DFC_BattUBMinBatt_C DFES_EnvRef.DFC_BattUBMinNoBatt_C DFES_EnvRef.DFC_BattUSRCMax_C DFES_EnvRef.DFC_BattUSRCMin_C DFES_EnvRef.DFC_BrkBstPHiCautionDfct_C DFES_EnvRef.DFC_BrkBstPHiWarnDfct_C DFES_EnvRef.DFC_BrkBstPSnsr12PlausDfct_C DFES_EnvRef.DFC_BrkBstPSnsr1Scb_C DFES_EnvRef.DFC_BrkBstPSnsr1Scg_C DFES_EnvRef.DFC_BrkBstPSnsr2Scb_C DFES_EnvRef.DFC_BrkBstPSnsr2Scg_C DFES_EnvRef.DFC_BrkBstPSnsrMax_C DFES_EnvRef.DFC_BrkBstPSnsrMin_C DFES_EnvRef.DFC_BrkBstPhyRngChkMax_C DFES_EnvRef.DFC_BrkBstPhyRngChkMin_C DFES_EnvRef.DFC_BrkBstPmpHsScb_C DFES_EnvRef.DFC_BrkBstPmpHsScg_C DFES_EnvRef.DFC_BrkBstPmpLsOl_C DFES_EnvRef.DFC_BrkBstPmpLsScb_C DFES_EnvRef.DFC_BrkBstPmpLsScg_C DFES_EnvRef.DFC_CbnHeatgHeatrRlyOpend_C DFES_EnvRef.DFC_CbnHeatgHeatrRlyWldd_C DFES_EnvRef.DFC_CcsDcIBattExcdd_C DFES_EnvRef.DFC_CcsDcIEvseOutDe_C DFES_EnvRef.DFC_CcsDcIOutDe_C DFES_EnvRef.DFC_CcsDcIOutExcdd_C DFES_EnvRef.DFC_CcsDcUOutDe_C DFES_EnvRef.DFC_CcsDcUOutExcdd_C DFES_EnvRef.DFC_CcsPwrLineChpRstOL_C DFES_EnvRef.DFC_CcsPwrLineChpRstOvrTemp_C DFES_EnvRef.DFC_CcsPwrLineChpRstSCB_C DFES_EnvRef.DFC_CcsPwrLineChpRstSCG_C DFES_EnvRef.DFC_CcsPwrLineChpVccEnaOL_C DFES_EnvRef.DFC_CcsPwrLineChpVccEnaOvrTemp_C DFES_EnvRef.DFC_CcsPwrLineChpVccEnaSCB_C DFES_EnvRef.DFC_CcsPwrLineChpVccEnaSCG_C DFES_EnvRef.DFC_CcsPwrLineChpVccSRCMin_C DFES_EnvRef.DFC_CcsPwrLineComChpTSRCMin_C DFES_EnvRef.DFC_CtPSwtActrOL_C DFES_EnvRef.DFC_CtPSwtActrOvrTemp_C DFES_EnvRef.DFC_CtPSwtActrSCB_C DFES_EnvRef.DFC_CtPSwtActrSCG_C DFES_EnvRef.DFC_CtPSwtDiagSRCMin_C DFES_EnvRef.DFC_CtpCarrFrqSRCMin_C DFES_EnvRef.DFC_DcChrgrIntkT2SRCMin_C DFES_EnvRef.DFC_DcChrgrIntkTSRCMin_C DFES_EnvRef.DFC_DevLibBattUHi_C DFES_EnvRef.DFC_DevLibBattULo_C DFES_EnvRef.DFC_EmWakeupSigOL_C DFES_EnvRef.DFC_EmWakeupSigOvrTemp_C DFES_EnvRef.DFC_EmWakeupSigSCB_C DFES_EnvRef.DFC_EmWakeupSigSCG_C DFES_EnvRef.DFC_Fan1OL_C DFES_EnvRef.DFC_Fan1OvrTemp_C DFES_EnvRef.DFC_Fan1SCB_C DFES_EnvRef.DFC_FanRlySCB_C DFES_EnvRef.DFC_FanRlySCG_C DFES_EnvRef.DFC_FanSpdSRCMin_C DFES_EnvRef.DFC_FreonPSRCMin_C DFES_EnvRef.DFC_HLCCcsPLnCChipTHi_C DFES_EnvRef.DFC_HeatrCoreTSRCMin_C DFES_EnvRef.DFC_PwmCtPSRCMin_C DFES_EnvRef.DFC_PwrDistbnUnitTSRCMin_C DFES_EnvRef.DFC_SCtPmp1OL_C DFES_EnvRef.DFC_SCtPmp1OvrTemp_C DFES_EnvRef.DFC_SCtPmp1SCB_C DFES_EnvRef.DFC_SCtPmpRlyOL_C DFES_EnvRef.DFC_SCtPmpRlyOvrTemp_C DFES_EnvRef.DFC_SCtPmpRlySCB_C DFES_EnvRef.DFC_SpplCooltPmpRlyOL_C DFES_EnvRef.DFC_SpplCooltPmpRlyOvrTemp_C DFES_EnvRef.DFC_SpplCooltPmpRlySCB_C DFES_EnvRef.DFC_UCtPSRCMin_C DFES_EnvRef.DFC_UPxP1SRCMin_C DFES_EnvRef.DFC_ComHSN1CANMute_C DFES_EnvRef.DFC_ComHSN3CANMute_C DFES_EnvRef.DFC_AcChrgrIntkTPhysRngHi_C DFES_EnvRef.DFC_AcChrgrIntkTPhysRngLo_C DFES_EnvRef.DFC_AcChrgrIntkTSRCOpn_C DFES_EnvRef.DFC_CcsPwrLineChpVccPhysRngHi_C DFES_EnvRef.DFC_CcsPwrLineChpVccPhysRngLo_C DFES_EnvRef.DFC_CcsPwrLineChpVccSRCOpn_C DFES_EnvRef.DFC_CcsPwrLineComChpTPhysRngHi_C DFES_EnvRef.DFC_CcsPwrLineComChpTPhysRngLo_C DFES_EnvRef.DFC_CcsPwrLineComChpTSRCOpn_C DFES_EnvRef.DFC_CtPSwtDiagPhysRngHi_C DFES_EnvRef.DFC_CtPSwtDiagPhysRngLo_C DFES_EnvRef.DFC_CtPSwtDiagSRCOpn_C DFES_EnvRef.DFC_CtpCarrFrqPhysRngHi_C DFES_EnvRef.DFC_CtpCarrFrqPhysRngLo_C DFES_EnvRef.DFC_CtpCarrFrqSRCMax_C DFES_EnvRef.DFC_DcChrgrIntkT2PhysRngHi_C DFES_EnvRef.DFC_DcChrgrIntkT2PhysRngLo_C DFES_EnvRef.DFC_DcChrgrIntkT2SRCOpn_C DFES_EnvRef.DFC_DcChrgrIntkTPhysRngHi_C DFES_EnvRef.DFC_DcChrgrIntkTPhysRngLo_C DFES_EnvRef.DFC_DcChrgrIntkTSRCOpn_C DFES_EnvRef.DFC_Fan1SCG_C DFES_EnvRef.DFC_FanSpdPhysRngHi_C DFES_EnvRef.DFC_FanSpdPhysRngLo_C DFES_EnvRef.DFC_FanSpdSRCOpn_C DFES_EnvRef.DFC_FreonPPhysRngHi_C DFES_EnvRef.DFC_FreonPPhysRngLo_C DFES_EnvRef.DFC_FreonPSRCOpn_C DFES_EnvRef.DFC_HeatrCoreTPhysRngHi_C DFES_EnvRef.DFC_HeatrCoreTPhysRngLo_C DFES_EnvRef.DFC_HeatrCoreTSRCOpn_C DFES_EnvRef.DFC_HvGridUMaxSftyLim_C DFES_EnvRef.DFC_HvGridUMinSftyLim_C DFES_EnvRef.DFC_HvGridUPlausy_C DFES_EnvRef.DFC_IntlckChrgPlgHBrgOpnLd_C DFES_EnvRef.DFC_IntlckChrgPlgHBrgOvrCurr_C DFES_EnvRef.DFC_IntlckChrgPlgHBrgOvrTemp_C DFES_EnvRef.DFC_IntlckChrgPlgHBrgShCirBatt1_C DFES_EnvRef.DFC_IntlckChrgPlgHBrgShCirBatt2_C DFES_EnvRef.DFC_IntlckChrgPlgHBrgShCirGnd1_C DFES_EnvRef.DFC_IntlckChrgPlgHBrgShCirGnd2_C DFES_EnvRef.DFC_IntlckChrgPlgHBrgShCirOvrLd_C DFES_EnvRef.DFC_IntlckChrgPlgHBrgTempOvrCurr_C DFES_EnvRef.DFC_IntlckChrgPlgHBrgUndrVltg_C DFES_EnvRef.DFC_IntlckChrgPlgPosnRngFlt_C DFES_EnvRef.DFC_IntlckChrgPlgPosnSrcMax_C DFES_EnvRef.DFC_IntlckChrgPlgPosnSrcMin_C DFES_EnvRef.DFC_PwmCtPPhysRngHi_C DFES_EnvRef.DFC_PwmCtPPhysRngLo_C DFES_EnvRef.DFC_PwmCtPSRCMax_C DFES_EnvRef.DFC_PwrDistbnUnitTPhysRngHi_C DFES_EnvRef.DFC_PwrDistbnUnitTPhysRngLo_C DFES_EnvRef.DFC_PwrDistbnUnitTSRCOpn_C DFES_EnvRef.DFC_SCtPmpRlySCG_C DFES_EnvRef.DFC_SpplCooltPmpRlySCG_C DFES_EnvRef.DFC_UCtPPhysRngHi_C DFES_EnvRef.DFC_UCtPPhysRngLo_C DFES_EnvRef.DFC_UCtPSRCOpn_C DFES_EnvRef.DFC_UPxP1PhysRngHi_C DFES_EnvRef.DFC_UPxP1PhysRngLo_C DFES_EnvRef.DFC_UPxP1SRCOpn_C DFES_EnvRef.DFC_VehVPhysRngHi_C DFES_EnvRef.DFC_VehVPhysRngLo_C DFES_EnvRef.DFC_VehVSigCan_C DFES_EnvRef.DFC_VehVSigCanSafe_C DFES_EnvRef.DFC_SCtPmp1DiagGrdKey1_C DFES_EnvRef.DFC_SCtPmp1DiagGrdKey2_C DFES_EnvRef.DFC_SCtPmp1DiagGrdKey3_C DFES_EnvRef.DFC_SCtPmp1DiagGrdKey4_C DFES_EnvRef.DFC_SCtPmp1DiagGrdKey5_C DFES_EnvRef.DFC_ChrgPlgLiveCntctHzrdCcs_C DFES_EnvRef.DFC_ChrgPlgProxPltImps_C DFES_EnvRef.DFC_ChrgPlgTHiCcsDc_C DFES_EnvRef.DFC_ElMActvDchaFailr_C DFES_EnvRef.DFC_ElMActvDchaFlt_C DFES_EnvRef.DFC_ElMFbdnIvtrModDrv01_C DFES_EnvRef.DFC_ElMImobAuthent_C DFES_EnvRef.DFC_ElMIsoMonFlt_C DFES_EnvRef.DFC_ElMIsoMonPlausyFlt_C DFES_EnvRef.DFC_ElMIvtrCooltT01_C DFES_EnvRef.DFC_ElMIvtrEmgyShtDwn01_C DFES_EnvRef.DFC_ElMIvtrFailr01_C DFES_EnvRef.DFC_ElMIvtrIntlck01_C DFES_EnvRef.DFC_ElMIvtrTErr01_C DFES_EnvRef.DFC_ElMOverSpdNeg01_C DFES_EnvRef.DFC_ElMOverSpdPos01_C DFES_EnvRef.DFC_ElMOverTqNeg01_C DFES_EnvRef.DFC_ElMOverTqPos01_C DFES_EnvRef.DFC_ElMPwrAuthn_C DFES_EnvRef.DFC_ElMSpdErr01_C DFES_EnvRef.DFC_ElMSvs01_C DFES_EnvRef.DFC_PEnvCcMax_C DFES_EnvRef.DFC_PEnvCcMin_C DFES_EnvRef.DFC_PEnvRngChkMax_C DFES_EnvRef.DFC_PEnvRngChkMin_C DFES_EnvRef.DFC_PEnvSnsrPlaus_C DFES_EnvRef.DFC_BrkBstPmpPlausGenn_C DFES_EnvRef.DFC_CbnHeatrRlyLfLoWarn_C DFES_EnvRef.DFC_ChgrPlugLockPinByndClsd_C DFES_EnvRef.DFC_ChgrPlugLockPinMoveWoCmd_C DFES_EnvRef.DFC_ChgrPlugLockPinStuckInClsd_C DFES_EnvRef.DFC_ChgrPlugLockPinStuckInOpen_C DFES_EnvRef.DFC_ChrgrStErr_C DFES_EnvRef.DFC_ComHSN1BusOff_C DFES_EnvRef.DFC_ComHSN3BusOff_C DFES_EnvRef.DFC_ComVCInval_C DFES_EnvRef.DFC_EemDcdcPrecSpdInhb_C DFES_EnvRef.DFC_ExpPwrLatch_C DFES_EnvRef.DFC_FanMaxOvrd_C DFES_EnvRef.DFC_HLCCcsGnrlComErr_C DFES_EnvRef.DFC_InmLINNodeHVACPanelAbsnt_C DFES_EnvRef.DFC_ResetRcvNotAllwd_C DFES_EnvRef.DFC_TelltlCooltPlaus_C DFES_EnvRef.DFC_MRlyOL_C DFES_EnvRef.DFC_MRlySCB_C DFES_EnvRef.DFC_MRlySCG_C DFES_EnvRef.DFC_SSpMon1_C DFES_EnvRef.DFC_SSpMon1OV_C DFES_EnvRef.DFC_SSpMon1SCG_C DFES_EnvRef.DFC_SSpMon1UV_C DFES_EnvRef.DFC_SSpMon2_C DFES_EnvRef.DFC_SSpMon2OV_C DFES_EnvRef.DFC_SSpMon2SCG_C DFES_EnvRef.DFC_SSpMon2UV_C DFES_EnvRef.DFC_SSpMon3_C DFES_EnvRef.DFC_SSpMon3OV_C DFES_EnvRef.DFC_SSpMon3SCG_C DFES_EnvRef.DFC_SSpMon3UV_C DFES_EnvRef.DFC_CANSM_E_BUS_OFF_NETWORK_HSN1_CAN_C DFES_EnvRef.DFC_CANSM_E_BUS_OFF_NETWORK_HSN3_CAN_C DFES_EnvRef.DFC_CANSM_E_BUS_OFF_NETWORK_HSN4_CAN_C DFES_EnvRef.DFC_CANSM_E_BUS_OFF_NETWORK_XCP_CAN_C DFES_EnvRef.DFC_CANTRCV_E_NO_TRCV_CONTROL_0_C DFES_EnvRef.DFC_CAN_E_TIMEOUT_C DFES_EnvRef.DFC_COMM_E_NET_START_IND_CHANNEL_0_C DFES_EnvRef.DFC_COMM_E_NET_START_IND_CHANNEL_1_C DFES_EnvRef.DFC_COMM_E_NET_START_IND_CHANNEL_2_C DFES_EnvRef.DFC_COMM_E_NET_START_IND_CHANNEL_3_C DFES_EnvRef.DFC_COMM_E_NET_START_IND_CHANNEL_4_C DFES_EnvRef.DFC_COMM_E_NET_START_IND_CHANNEL_5_C DFES_EnvRef.DFC_LIN_E_TIMEOUT_C DFES_EnvRef.DFC_rba_EcuCtrl_TOMaxProlg_C DFES_EnvRef.DFC_rba_EcuCtrl_TOMaxShutDwn_C DFES_EnvRef.DFC_rba_MultiStackTrace_Threshold_C DFES_EnvRef.DFC_rba_SyC_CustStates_Degraded_disord_Event_C DFES_EnvRef.DFC_rba_SyC_CustStates_Degraded_incst_Event_C DFES_EnvRef.DFC_rba_SyC_CustStates_TransNoWakReq_Event_C DFES_EnvRef.DFC_RBA_IOEXTLIB_KEEPALIVE_DRV_C DFES_EnvRef.DFC_RBA_IOEXTLIB_KEEPALIVE_INI_C DFES_EnvRef.DFC_rba_IoSigRtc_StopCounter_C DFES_EnvRef.DFC_rba_MRly_Diag_Stk_Event_C DFES_EnvRef.DFC_rba_MemDiag_MemReadErr_C DFES_EnvRef.DFC_rba_MemDiag_MemWrErr_C DFES_EnvRef.DFC_rba_SyC_IrrSwOffTrigEngRun_Event_C DFES_EnvRef.DFC_AcChrgrIntkTSRCMax_C DFES_EnvRef.DFC_AcChrgrIntkTTmpErr_C DFES_EnvRef.DFC_AcFlt_C DFES_EnvRef.DFC_AppAllSnsrDfct_C DFES_EnvRef.DFC_BattUPwrFail_C DFES_EnvRef.DFC_BrkBstBkupOvrn_C DFES_EnvRef.DFC_BrkBstPmpOvld_C DFES_EnvRef.DFC_BrkPlausChk_C DFES_EnvRef.DFC_CbnHeatgSwtTmpErr_C DFES_EnvRef.DFC_CcsPwrLineChpVccSRCMax_C DFES_EnvRef.DFC_CcsPwrLineChpVccTmpErr_C DFES_EnvRef.DFC_CcsPwrLineComChpTSRCMax_C DFES_EnvRef.DFC_CcsPwrLineComChpTTmpErr_C DFES_EnvRef.DFC_ChgrPlugCtpCarrFrqErr_C DFES_EnvRef.DFC_ChgrPlugCtpSwtStuckClsd_C DFES_EnvRef.DFC_ChgrPlugCtpSwtStuckOpen_C DFES_EnvRef.DFC_ChgrPlugCtpUErrHi_C DFES_EnvRef.DFC_ChgrPlugPxp1SrcErr_C DFES_EnvRef.DFC_ChrgCntctAllWldd_C DFES_EnvRef.DFC_ChrgCntctNegOperErr_C DFES_EnvRef.DFC_ChrgCntctNegOperWarn_C DFES_EnvRef.DFC_ChrgCntctNegWldd_C DFES_EnvRef.DFC_ChrgCntctPosOperErr_C DFES_EnvRef.DFC_ChrgCntctPosOperWarn_C DFES_EnvRef.DFC_ChrgCntctPosWldd_C DFES_EnvRef.DFC_ChrgCntctStuckOpen_C DFES_EnvRef.DFC_ChrgPlgIntlckFaild_C DFES_EnvRef.DFC_ChrgnUnplRqrd_C DFES_EnvRef.DFC_CoElMOffsCalibActv01_C DFES_EnvRef.DFC_CtPSwtDiagSRCMax_C DFES_EnvRef.DFC_CtPSwtDiagTmpErr_C DFES_EnvRef.DFC_CtpCarrFrqTmpErr_C DFES_EnvRef.DFC_DcChrgrIntkT2SRCMax_C DFES_EnvRef.DFC_DcChrgrIntkT2TmpErr_C DFES_EnvRef.DFC_DcChrgrIntkTSRCMax_C DFES_EnvRef.DFC_DcChrgrIntkTTmpErr_C DFES_EnvRef.DFC_EChrDvPlinCntrThdExcdd_C DFES_EnvRef.DFC_EemDiagCtctrClsTout_C DFES_EnvRef.DFC_EemDiagDcdcOffTOut_C DFES_EnvRef.DFC_EemDiagHvCnsrOffTOut_C DFES_EnvRef.DFC_EemDiagHvbOffTOut_C DFES_EnvRef.DFC_FanSpdSRCMax_C DFES_EnvRef.DFC_FanSpdTmpErr_C DFES_EnvRef.DFC_FreonPSRCMax_C DFES_EnvRef.DFC_FreonPTmpErr_C DFES_EnvRef.DFC_HeatrCoreTSRCMax_C DFES_EnvRef.DFC_HeatrCoreTTmpErr_C DFES_EnvRef.DFC_HvGridSocMinLim_C DFES_EnvRef.DFC_HvacBlwrFrntFlt_C DFES_EnvRef.DFC_HvacEvapElecFlt_C DFES_EnvRef.DFC_HvacEvapElecFltGnd_C DFES_EnvRef.DFC_HvacKnobPosnFlt_C DFES_EnvRef.DFC_InvBinID_C DFES_EnvRef.DFC_InvCalID_C DFES_EnvRef.DFC_InvErotan_C DFES_EnvRef.DFC_InvVinID_C DFES_EnvRef.DFC_MOXEMM_SMU_ALM0_0_C DFES_EnvRef.DFC_MOXEMM_SMU_ALM0_1_C DFES_EnvRef.DFC_MOXEMM_SMU_ALM0_10_C DFES_EnvRef.DFC_MOXEMM_SMU_ALM0_11_C DFES_EnvRef.DFC_MOXEMM_SMU_ALM0_13_C DFES_EnvRef.DFC_MOXEMM_SMU_ALM0_14_C DFES_EnvRef.DFC_MOXEMM_SMU_ALM0_2_C DFES_EnvRef.DFC_MOXEMM_SMU_ALM0_22_C DFES_EnvRef.DFC_MOXEMM_SMU_ALM0_23_C DFES_EnvRef.DFC_MOXEMM_SMU_ALM0_4_C DFES_EnvRef.DFC_MOXEMM_SMU_ALM0_5_C DFES_EnvRef.DFC_MOXEMM_SMU_ALM0_7_C DFES_EnvRef.DFC_MOXEMM_SMU_ALM0_8_C DFES_EnvRef.DFC_MOXEMM_SMU_ALM10_16_C DFES_EnvRef.DFC_MOXEMM_SMU_ALM10_17_C DFES_EnvRef.DFC_MOXEMM_SMU_ALM10_21_C DFES_EnvRef.DFC_MOXEMM_SMU_ALM11_0_C DFES_EnvRef.DFC_MOXEMM_SMU_ALM11_1_C DFES_EnvRef.DFC_MOXEMM_SMU_ALM11_2_C DFES_EnvRef.DFC_MOXEMM_SMU_ALM11_3_C DFES_EnvRef.DFC_MOXEMM_SMU_ALM11_4_C DFES_EnvRef.DFC_MOXEMM_SMU_ALM11_5_C DFES_EnvRef.DFC_MOXEMM_SMU_ALM11_8_C DFES_EnvRef.DFC_MOXEMM_SMU_ALM11_9_C DFES_EnvRef.DFC_MOXEMM_SMU_ALM1_0_C DFES_EnvRef.DFC_MOXEMM_SMU_ALM1_1_C DFES_EnvRef.DFC_MOXEMM_SMU_ALM1_10_C DFES_EnvRef.DFC_MOXEMM_SMU_ALM1_11_C DFES_EnvRef.DFC_MOXEMM_SMU_ALM1_13_C DFES_EnvRef.DFC_MOXEMM_SMU_ALM1_14_C DFES_EnvRef.DFC_MOXEMM_SMU_ALM1_2_C DFES_EnvRef.DFC_MOXEMM_SMU_ALM1_22_C DFES_EnvRef.DFC_MOXEMM_SMU_ALM1_23_C DFES_EnvRef.DFC_MOXEMM_SMU_ALM1_4_C DFES_EnvRef.DFC_MOXEMM_SMU_ALM1_5_C DFES_EnvRef.DFC_MOXEMM_SMU_ALM1_7_C DFES_EnvRef.DFC_MOXEMM_SMU_ALM1_8_C DFES_EnvRef.DFC_MOXEMM_SMU_ALM21_0_C DFES_EnvRef.DFC_MOXEMM_SMU_ALM21_16_C DFES_EnvRef.DFC_MOXEMM_SMU_ALM21_3_C DFES_EnvRef.DFC_MOXEMM_SMU_ALM2_1_C DFES_EnvRef.DFC_MOXEMM_SMU_ALM2_10_C DFES_EnvRef.DFC_MOXEMM_SMU_ALM2_11_C DFES_EnvRef.DFC_MOXEMM_SMU_ALM2_13_C DFES_EnvRef.DFC_MOXEMM_SMU_ALM2_14_C DFES_EnvRef.DFC_MOXEMM_SMU_ALM2_22_C DFES_EnvRef.DFC_MOXEMM_SMU_ALM2_23_C DFES_EnvRef.DFC_MOXEMM_SMU_ALM2_4_C DFES_EnvRef.DFC_MOXEMM_SMU_ALM2_5_C DFES_EnvRef.DFC_MOXEMM_SMU_ALM2_7_C DFES_EnvRef.DFC_MOXEMM_SMU_ALM2_8_C DFES_EnvRef.DFC_MOXEMM_SMU_ALM6_0_C DFES_EnvRef.DFC_MOXEMM_SMU_ALM6_11_C DFES_EnvRef.DFC_MOXEMM_SMU_ALM6_12_C DFES_EnvRef.DFC_MOXEMM_SMU_ALM6_14_C DFES_EnvRef.DFC_MOXEMM_SMU_ALM6_15_C DFES_EnvRef.DFC_MOXEMM_SMU_ALM6_17_C DFES_EnvRef.DFC_MOXEMM_SMU_ALM6_18_C DFES_EnvRef.DFC_MOXEMM_SMU_ALM6_20_C DFES_EnvRef.DFC_MOXEMM_SMU_ALM6_21_C DFES_EnvRef.DFC_MOXEMM_SMU_ALM6_25_C DFES_EnvRef.DFC_MOXEMM_SMU_ALM6_4_C DFES_EnvRef.DFC_MOXEMM_SMU_ALM6_5_C DFES_EnvRef.DFC_MOXEMM_SMU_ALM6_7_C DFES_EnvRef.DFC_MOXEMM_SMU_ALM6_8_C DFES_EnvRef.DFC_MOXEMM_SMU_ALM7_1_C DFES_EnvRef.DFC_MOXEMM_SMU_ALM7_12_C DFES_EnvRef.DFC_MOXEMM_SMU_ALM7_13_C DFES_EnvRef.DFC_MOXEMM_SMU_ALM7_14_C DFES_EnvRef.DFC_MOXEMM_SMU_ALM7_15_C DFES_EnvRef.DFC_MOXEMM_SMU_ALM7_16_C DFES_EnvRef.DFC_MOXEMM_SMU_ALM7_17_C DFES_EnvRef.DFC_MOXEMM_SMU_ALM7_2_C DFES_EnvRef.DFC_MOXEMM_SMU_ALM7_20_C DFES_EnvRef.DFC_MOXEMM_SMU_ALM7_25_C DFES_EnvRef.DFC_MOXEMM_SMU_ALM7_26_C DFES_EnvRef.DFC_MOXEMM_SMU_ALM7_28_C DFES_EnvRef.DFC_MOXEMM_SMU_ALM7_29_C DFES_EnvRef.DFC_MOXEMM_SMU_ALM7_30_C DFES_EnvRef.DFC_MOXEMM_SMU_ALM7_31_C DFES_EnvRef.DFC_MOXEMM_SMU_ALM8_0_C DFES_EnvRef.DFC_MOXEMM_SMU_ALM8_1_C DFES_EnvRef.DFC_MOXEMM_SMU_ALM8_10_C DFES_EnvRef.DFC_MOXEMM_SMU_ALM8_11_C DFES_EnvRef.DFC_MOXEMM_SMU_ALM8_12_C DFES_EnvRef.DFC_MOXEMM_SMU_ALM8_16_C DFES_EnvRef.DFC_MOXEMM_SMU_ALM8_18_C DFES_EnvRef.DFC_MOXEMM_SMU_ALM8_2_C DFES_EnvRef.DFC_MOXEMM_SMU_ALM8_3_C DFES_EnvRef.DFC_MOXEMM_SMU_ALM8_31_C DFES_EnvRef.DFC_MOXEMM_SMU_ALM8_4_C DFES_EnvRef.DFC_MOXEMM_SMU_ALM9_0_C DFES_EnvRef.DFC_MOXEMM_SMU_ALM9_15_C DFES_EnvRef.DFC_MOXEMM_SMU_ALM9_3_C DFES_EnvRef.DFC_MoCADCNTPBnk1_C DFES_EnvRef.DFC_MoCADCTestVoltBnk1_C DFES_EnvRef.DFC_MoCSOPICO_C DFES_EnvRef.DFC_MoFAccr_C DFES_EnvRef.DFC_MoFCbnPreCdngOvrheat_C DFES_EnvRef.DFC_MoFCbnPreCdngTmrExpi_C DFES_EnvRef.DFC_MoFEvMngtBms_C DFES_EnvRef.DFC_MoFEvMngtDcdc_C DFES_EnvRef.DFC_MoFEvMngtEm01_C DFES_EnvRef.DFC_MoFEvMngtEm01BrkgToZr_C DFES_EnvRef.DFC_MoFEvMngtEm01EngSpd_C DFES_EnvRef.DFC_MoFEvMngtEm02EngSpd_C DFES_EnvRef.DFC_MoFEvMngtEm02Lvl1_C DFES_EnvRef.DFC_MoFEvMngtEm02Lvl2_C DFES_EnvRef.DFC_MoFExtCptAuxCpt_C DFES_EnvRef.DFC_MoFExtCptVacPmpErr_C DFES_EnvRef.DFC_MoFTqPtdAxle_C DFES_EnvRef.DFC_MoFTqPtdAxleSec_C DFES_EnvRef.DFC_MoFTqPtdEmPtRels_C DFES_EnvRef.DFC_MoFTqPtdEmPtRelsSec_C DFES_EnvRef.DFC_MoFTqPtdEmSign_C DFES_EnvRef.DFC_MoFTqPtdEmSignSec_C DFES_EnvRef.DFC_MoFTqPtdEmTq_C DFES_EnvRef.DFC_MoFTqPtdEmTqSec_C DFES_EnvRef.DFC_MoFTqPtdVeh_C DFES_EnvRef.DFC_MoFVarPostBldSel_C DFES_EnvRef.DFC_MoSysCtrlReIni_C DFES_EnvRef.DFC_MoXEMMHwLTMCUFW_C DFES_EnvRef.DFC_MoXEMMHwLTMonBIST_C DFES_EnvRef.DFC_MoXEMMHwLTRegMonTest_C DFES_EnvRef.DFC_MoXEMMHwLTStbySMUAlvTest_C DFES_EnvRef.DFC_MoXEMMHwLTTempSens_C DFES_EnvRef.DFC_MoXEMMHwLTUCBCfg_C DFES_EnvRef.DFC_MonEgyChrgnCoorr_AcChrgnWoMofRels_C DFES_EnvRef.DFC_MonEgyChrgnCoorr_ChrgnAbortIgr_C DFES_EnvRef.DFC_MonEgyChrgnCoorr_DcCntctFailr_C DFES_EnvRef.DFC_MonEgyChrgnCoorr_ExtChrgnShtOffReq_C DFES_EnvRef.DFC_MonEgyChrgnCoorr_ImpsChrgnMod_C DFES_EnvRef.DFC_MonEgyChrgnCoorr_ImpsChrgnPrms_C DFES_EnvRef.DFC_MonEgyChrgnCoorr_ImpsUDcIntk_C DFES_EnvRef.DFC_MonEgyChrgnCoorr_PlgLockMovmt_C DFES_EnvRef.DFC_MonEgyChrgnCoorr_VehCrashDetn_C DFES_EnvRef.DFC_MonEgyChrgnErrReactn_SftySwt_C DFES_EnvRef.DFC_MonEgyChrgnInlet_CcsPlgCtp_C DFES_EnvRef.DFC_MonEgyChrgnInlet_CcsPlgCtpPwm_C DFES_EnvRef.DFC_MonEgyChrgnInlet_CcsPlgLockCtrlImpsAtmpt_C DFES_EnvRef.DFC_MonEgyChrgnInlet_CcsPlgLockSnsrSigRngChk_C DFES_EnvRef.DFC_MonEgyChrgnInlet_CcsPlgLockStImps_C DFES_EnvRef.DFC_MonEgyChrgnInlet_CcsPlgPxp_C DFES_EnvRef.DFC_MonEgyChrgnT_Snsr1GrdtChk_C DFES_EnvRef.DFC_MonEgyChrgnT_Snsr1SigRngChk_C DFES_EnvRef.DFC_MonEgyChrgnT_Snsr2GrdtChk_C DFES_EnvRef.DFC_MonEgyChrgnT_Snsr2SigRngChk_C DFES_EnvRef.DFC_MonEgyChrgnT_SnsrDif_C DFES_EnvRef.DFC_OCWDAABEActv_C DFES_EnvRef.DFC_OCWDACom_C DFES_EnvRef.DFC_OCWDAErrPin_C DFES_EnvRef.DFC_OCWDAOvrVltg_C DFES_EnvRef.DFC_PUmax_C DFES_EnvRef.DFC_PwmCtPTmpErr_C DFES_EnvRef.DFC_PwrDistbnUnitTSRCMax_C DFES_EnvRef.DFC_PwrDistbnUnitTTmpErr_C DFES_EnvRef.DFC_SCtPmp1DiagGrdKeyErr_C DFES_EnvRef.DFC_SRCHighAPP1_C DFES_EnvRef.DFC_SRCHighAPP2_C DFES_EnvRef.DFC_SRCLowAPP1_C DFES_EnvRef.DFC_SRCLowAPP2_C DFES_EnvRef.DFC_SWReset_0_C DFES_EnvRef.DFC_SWReset_1_C DFES_EnvRef.DFC_SWReset_2_C DFES_EnvRef.DFC_Sia_InvldCode_C DFES_EnvRef.DFC_Sia_InvldKey_C DFES_EnvRef.DFC_Sia_NoRespUCx_C DFES_EnvRef.DFC_Sia_TprotRttp_C DFES_EnvRef.DFC_StrtUpEvStandStillDeactvn_C DFES_EnvRef.DFC_SyncAPP_C DFES_EnvRef.DFC_UCtPSRCMax_C DFES_EnvRef.DFC_UCtPTmpErr_C DFES_EnvRef.DFC_UPxP1SRCMax_C DFES_EnvRef.DFC_UPxP1TmpErr_C DFES_EnvRef.DFC_VehVObd_C DFES_FaultTyp.DFC_Unused_C DFES_FaultTyp.DFC_ACCmprFltLvlRes_C DFES_FaultTyp.DFC_AbgHiSigFlt_C DFES_FaultTyp.DFC_AbgIntPatFlt_C DFES_FaultTyp.DFC_AbgLoSigFlt_C DFES_FaultTyp.DFC_AbgUnkwnErrSigFlt_C DFES_FaultTyp.DFC_AcExtChrgrIBattExcdd_C DFES_FaultTyp.DFC_AcExtChrgrIInExcdd_C DFES_FaultTyp.DFC_AcExtChrgrIOutDe_C DFES_FaultTyp.DFC_AcExtChrgrIOutExcdd_C DFES_FaultTyp.DFC_AcExtChrgrUOutDe_C DFES_FaultTyp.DFC_AdpActvDChaFailr_C DFES_FaultTyp.DFC_AirbcuFlt_C DFES_FaultTyp.DFC_Airbg_C DFES_FaultTyp.DFC_AirbgCan_C DFES_FaultTyp.DFC_AirbgCanHWPlaus_C DFES_FaultTyp.DFC_AirbgHWCanPlaus_C DFES_FaultTyp.DFC_AirbgMnr_C DFES_FaultTyp.DFC_AirbgPerHi_C DFES_FaultTyp.DFC_AirbgPerdRngFlt_C DFES_FaultTyp.DFC_BlowrRlyErr_C DFES_FaultTyp.DFC_BrkBstPmpActtnDfct_C DFES_FaultTyp.DFC_BrkBstPmpDeactvnDfct_C DFES_FaultTyp.DFC_BrkSwtFlt_C DFES_FaultTyp.DFC_CbnHeatgHeatrHsScb_C DFES_FaultTyp.DFC_CbnHeatgHeatrHsScg_C DFES_FaultTyp.DFC_CbnHeatgHeatrLsOl_C DFES_FaultTyp.DFC_CbnHeatgHeatrLsScb_C DFES_FaultTyp.DFC_CbnHeatgHeatrLsScg_C DFES_FaultTyp.DFC_CbnHeatgHeatrUnUsed_C DFES_FaultTyp.DFC_ChrgnCntctHsOt_C DFES_FaultTyp.DFC_ChrgnCntctHsScb_C DFES_FaultTyp.DFC_ChrgnCntctHsScg_C DFES_FaultTyp.DFC_ChrgnCntctLsNegOl_C DFES_FaultTyp.DFC_ChrgnCntctLsNegOt_C DFES_FaultTyp.DFC_ChrgnCntctLsNegScb_C DFES_FaultTyp.DFC_ChrgnCntctLsNegScg_C DFES_FaultTyp.DFC_ChrgnCntctLsPosOl_C DFES_FaultTyp.DFC_ChrgnCntctLsPosOt_C DFES_FaultTyp.DFC_ChrgnCntctLsPosScb_C DFES_FaultTyp.DFC_ChrgnCntctLsPosScg_C DFES_FaultTyp.DFC_ChrgnCntctUnUsed_C DFES_FaultTyp.DFC_ComBrkMai_C DFES_FaultTyp.DFC_ComChrgrEVCont_C DFES_FaultTyp.DFC_ComChrgrEVtBlink_C DFES_FaultTyp.DFC_ComChrgrMstBlink_C DFES_FaultTyp.DFC_ComChrgrMstCont_C DFES_FaultTyp.DFC_ComChrgrSVSBlink_C DFES_FaultTyp.DFC_ComChrgrSVSCont_C DFES_FaultTyp.DFC_ComDcdcEVBlink_C DFES_FaultTyp.DFC_ComDcdcEVCont_C DFES_FaultTyp.DFC_ComDcdcFltLvl2_C DFES_FaultTyp.DFC_ComDcdcFltLvl3_C DFES_FaultTyp.DFC_ComDcdcFltLvl4_C DFES_FaultTyp.DFC_ComDcdcFltLvl5_C DFES_FaultTyp.DFC_ComDcdcFltLvlRes_C DFES_FaultTyp.DFC_ComDcdcMstBlink_C DFES_FaultTyp.DFC_ComDcdcMstCont_C DFES_FaultTyp.DFC_ComDcdcSVSBlink_C DFES_FaultTyp.DFC_ComDcdcSVSCont_C DFES_FaultTyp.DFC_ComElMIIvtrFltLvl2_C DFES_FaultTyp.DFC_ComElMIIvtrFltLvl3_C DFES_FaultTyp.DFC_ComElMIIvtrFltLvl4_C DFES_FaultTyp.DFC_ComElMIIvtrFltLvl5_C DFES_FaultTyp.DFC_ComElMIIvtrFltLvlRes_C DFES_FaultTyp.DFC_ComEmacEVBlink_C DFES_FaultTyp.DFC_ComEmacEVCont_C DFES_FaultTyp.DFC_ComEmacMstCont_C DFES_FaultTyp.DFC_ComEmacMsttBlink_C DFES_FaultTyp.DFC_ComEmacSVSBlink_C DFES_FaultTyp.DFC_ComEmacSVSCont_C DFES_FaultTyp.DFC_ComGunCntInfoWkuReq_C DFES_FaultTyp.DFC_ComHillHldFlt_C DFES_FaultTyp.DFC_ComHvBattRchrgWkuReq_C DFES_FaultTyp.DFC_ComHvbFltLvl2_C DFES_FaultTyp.DFC_ComHvbFltLvl3_C DFES_FaultTyp.DFC_ComHvbFltLvl4_C DFES_FaultTyp.DFC_ComHvbFltLvl5_C DFES_FaultTyp.DFC_ComHvbFltLvlRes_C DFES_FaultTyp.DFC_ComHvbMstBlink_C DFES_FaultTyp.DFC_ComHvbMstCont_C DFES_FaultTyp.DFC_ComImmoUnlockWkuReq_C DFES_FaultTyp.DFC_ComInfoReqPtlWkuReq_C DFES_FaultTyp.DFC_ComOBCFltLvl2_C DFES_FaultTyp.DFC_ComOBCFltLvl3_C DFES_FaultTyp.DFC_ComOBCFltLvl4_C DFES_FaultTyp.DFC_ComOBCFltLvl5_C DFES_FaultTyp.DFC_ComOBCFltLvlRes_C DFES_FaultTyp.DFC_ComPostOperationWkuReq_C DFES_FaultTyp.DFC_ComPreCondElecWkuReq_C DFES_FaultTyp.DFC_ComRemUnlckWkuReq_C DFES_FaultTyp.DFC_ComStpDlyHMIWkuReq_C DFES_FaultTyp.DFC_ComflgCurMeasmtErr_C DFES_FaultTyp.DFC_ComflgCurMeasmtSysErr_C DFES_FaultTyp.DFC_ComflgCurMeasmtVld_C DFES_FaultTyp.DFC_ComflgCurRngErr_C DFES_FaultTyp.DFC_ComflgTPcbMeasmtErr_C DFES_FaultTyp.DFC_ComflgTPcbMeasmtVld_C DFES_FaultTyp.DFC_ComflgTPcbRngErr_C DFES_FaultTyp.DFC_ComflgTPcbSysErr_C DFES_FaultTyp.DFC_ComflgTShntMeasmtErr_C DFES_FaultTyp.DFC_ComflgTShntMeasmtVld_C DFES_FaultTyp.DFC_ComflgTShntRngErr_C DFES_FaultTyp.DFC_ComflgTShntSysErr_C DFES_FaultTyp.DFC_ComflgVoltMeasmtErr_C DFES_FaultTyp.DFC_ComflgVoltMeasmtSysErr_C DFES_FaultTyp.DFC_ComflgVoltMeasmtVld_C DFES_FaultTyp.DFC_ComflgVoltRngErr_C DFES_FaultTyp.DFC_CrashEveOcc_C DFES_FaultTyp.DFC_DcdcFwdModStuck_C DFES_FaultTyp.DFC_DcdcLvUDifMaxFlt_C DFES_FaultTyp.DFC_DcdcOffModStuck_C DFES_FaultTyp.DFC_DcdcOperModFailr_C DFES_FaultTyp.DFC_DcdcPrecModStuck_C DFES_FaultTyp.DFC_DrvDoorOpn_C DFES_FaultTyp.DFC_DrvModPosnDfct_C DFES_FaultTyp.DFC_DrvStbltOpn_C DFES_FaultTyp.DFC_ETogFailrLvl3_C DFES_FaultTyp.DFC_ETogFailrLvl4_C DFES_FaultTyp.DFC_EbsLvBattSocDiagLo_C DFES_FaultTyp.DFC_EbsLvBattUDiagDiOper_C DFES_FaultTyp.DFC_EbsLvBattUDiagFltLvl1_C DFES_FaultTyp.DFC_EbsLvBattUDiagFltLvl2_C DFES_FaultTyp.DFC_EbsLvBattUDiagLo_C DFES_FaultTyp.DFC_EbsSnsrSt_C DFES_FaultTyp.DFC_EbsSofASILErr_C DFES_FaultTyp.DFC_ElTSPtSysLimDrvErr_C DFES_FaultTyp.DFC_ElTSPtSysLimRgnErr_C DFES_FaultTyp.DFC_HLCCcsFwDwnl_C DFES_FaultTyp.DFC_HvBattChrgPwrMax_C DFES_FaultTyp.DFC_HvBattCrashDetd_C DFES_FaultTyp.DFC_HvBattDchaPwrMax_C DFES_FaultTyp.DFC_HvBattEmgyOff_C DFES_FaultTyp.DFC_HvBattEmgyOffIntlck_C DFES_FaultTyp.DFC_HvBattEmgyOffReq_C DFES_FaultTyp.DFC_HvBattFltMod_C /end DEF_CHARACTERISTIC
 FUNCTION_VERSION "30000.70.0" /end FUNCTION
/begin COMPU_METHOD DFES_EnvTabVerb "" TAB_VERB "%6.3" "-" COMPU_TAB_REF DFES_EnvTabVerb /end COMPU_METHOD
/begin COMPU_VTAB DFES_EnvTabVerb "" TAB_VERB 30 0 "xSet1" 1 "xSet2" 2 "xSet3" 3 "xSet4" 4 "xSet5" 5 "xSet6" 6 "xSet7" 7 "xSet8" 8 "xSet9" 9 "xSet10" 10 "xSet11" 11 "xSet12" 12 "xSet13" 13 "xSet14" 14 "xSet15" 15 "xSet16" 16 "xSet17" 17 "xSet18" 18 "xSet19" 19 "xSet20" 20 "xSet21" 21 "xSet22" 22 "xSet23" 23 "xSet24" 24 "xSet25" 25 "xSet26" 26 "xSet27" 27 "xSet28" 28 "xSet29" 29 "xSet30" DEFAULT_VALUE "---" /end COMPU_VTAB
/begin COMPU_METHOD DFES_OneToOne "" RAT_FUNC "%6.2" "-" COEFFS 0 1 0 0 0 1 /end COMPU_METHOD
/begin RECORD_LAYOUT Val_Wu8 FNC_VALUES 1 UBYTE COLUMN_DIR DIRECT /end RECORD_LAYOUT
/end MODULE
/end PROJECT

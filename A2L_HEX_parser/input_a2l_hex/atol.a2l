ASAP2_VERSION 1 70
/begin PROJECT MDG1C "VC1CP091_STLA_N_D061I3"
/begin HEADER "" VERSION "VC1CP091_STLA_N_D061I3" PROJECT_NO MDG1C /end HEADER
/begin MODULE DIM ""
/begin MOD_COMMON "" BYTE_ORDER MSB_LAST ALIGNMENT_BYTE 1 ALIGNMENT_WORD 2 ALIGNMENT_LONG 4 ALIGNMENT_INT64 4 ALIGNMENT_FLOAT32_IEEE 4 ALIGNMENT_FLOAT64_IEEE 4 DATA_SIZE 32 /end MOD_COMMON
/begin CHARACTERISTIC ACCmpr_pwrLimMax_341hIni_C "" VALUE 0x80257C08 Val_Wu16 511.0000 OneToOne 0.00 511.0000 FORMAT "%8.4" EXTENDED_LIMITS 0.00 65535.00 /end CHARACTERISTIC
/begin CHARACTERISTIC ACCmpr_pwrLimMax_341hInvld_C "" VALUE 0x80257C0A Val_Wu16 511.0000 OneToOne 0.00 511.0000 FORMAT "%8.4" EXTENDED_LIMITS 0.00 65535.00 /end CHARACTERISTIC
/begin CHARACTERISTIC ACCtl_flgCmprEna_341hIni_C "" VALUE 0x80257C0C Val_Wu8 1.000 OneToOne 0.00 1.000 FORMAT "%5.3" EXTENDED_LIMITS 0.00 255.0 /end CHARACTERISTIC
/begin CHARACTERISTIC ACCtl_nCmprSpdReq_341hIni_C "" VALUE 0x80257C0E Val_Wu16 511.0000 OneToOne 0.00 511.0000 FORMAT "%8.4" EXTENDED_LIMITS 0.00 65535.00 /end CHARACTERISTIC
/begin CHARACTERISTIC ACCtl_nCmprSpdReq_341hInvld_C "" VALUE 0x80257C10 Val_Wu16 511.0000 OneToOne 0.00 511.0000 FORMAT "%8.4" EXTENDED_LIMITS 0.00 65535.00 /end CHARACTERISTIC
/begin CHARACTERISTIC APP_rInp_201hIni_C "" VALUE 0x80257C12 Val_Wu8 255.0 OneToOne 0.00 255.0 FORMAT "%5.1" /end CHARACTERISTIC
/begin CHARACTERISTIC APP_rInp_201hInvld_C "" VALUE 0x80257C13 Val_Wu8 255.0 OneToOne 0.00 255.0 FORMAT "%5.1" /end CHARACTERISTIC
/begin CHARACTERISTIC BattId_numOrganNature1_5D1hIni_C "" VALUE 0x80257C14 Val_Wu8 255.0 OneToOne 0.00 255.0 FORMAT "%5.1" /end CHARACTERISTIC
/begin CHARACTERISTIC BattId_numOrganNature2_5D1hIni_C "" VALUE 0x80257C15 Val_Wu8 255.0 OneToOne 0.00 255.0 FORMAT "%5.1" /end CHARACTERISTIC
/begin CHARACTERISTIC BattId_numOrganRef1_5D1hIni_C "" VALUE 0x80257C16 Val_Wu8 255.0 OneToOne 0.00 255.0 FORMAT "%5.1" /end CHARACTERISTIC
/begin CHARACTERISTIC BattId_numOrganRef2_5D1hIni_C "" VALUE 0x80257C17 Val_Wu8 255.0 OneToOne 0.00 255.0 FORMAT "%5.1" /end CHARACTERISTIC
/begin CHARACTERISTIC BattId_numOrganRef3_5D1hIni_C "" VALUE 0x80257C18 Val_Wu8 255.0 OneToOne 0.00 255.0 FORMAT "%5.1" /end CHARACTERISTIC
/begin CHARACTERISTIC BattId_numOrganRef4_5D1hIni_C "" VALUE 0x80257C19 Val_Wu8 255.0 OneToOne 0.00 255.0 FORMAT "%5.1" /end CHARACTERISTIC
/begin CHARACTERISTIC BattId_numSerl1_5F1hIni_C "" VALUE 0x80257C1A Val_Wu8 255.0 OneToOne 0.00 255.0 FORMAT "%5.1" /end CHARACTERISTIC
/begin CHARACTERISTIC BattId_numSerl2_5F1hIni_C "" VALUE 0x80257C1B Val_Wu8 255.0 OneToOne 0.00 255.0 FORMAT "%5.1" /end CHARACTERISTIC
/begin CHARACTERISTIC BattId_numSerl3_5F1hIni_C "" VALUE 0x80257C1C Val_Wu8 255.0 OneToOne 0.00 255.0 FORMAT "%5.1" /end CHARACTERISTIC
/begin CHARACTERISTIC BattId_numSerl4_5F1hIni_C "" VALUE 0x80257C1D Val_Wu8 255.0 OneToOne 0.00 255.0 FORMAT "%5.1" /end CHARACTERISTIC
/begin CHARACTERISTIC BattId_numSerl5_5F1hIni_C "" VALUE 0x80257C1E Val_Wu8 255.0 OneToOne 0.00 255.0 FORMAT "%5.1" /end CHARACTERISTIC
/begin CHARACTERISTIC BattId_numSerl6_5F1hIni_C "" VALUE 0x80257C1F Val_Wu8 255.0 OneToOne 0.00 255.0 FORMAT "%5.1" /end CHARACTERISTIC
/begin CHARACTERISTIC BattId_numSerl7_5F1hIni_C "" VALUE 0x80257C20 Val_Wu8 255.0 OneToOne 0.00 255.0 FORMAT "%5.1" /end CHARACTERISTIC
/begin CHARACTERISTIC Brk_stRed_208hIni_C "" VALUE 0x80257C21 Val_Wu8 1.000 OneToOne 0.00 1.000 FORMAT "%5.3" EXTENDED_LIMITS 0.00 255.0 /end CHARACTERISTIC
/begin CHARACTERISTIC CbnHeatgHeatr_cntrRlyLf_481hIni_C "" VALUE 0x80257C24 Val_Wu32 1048575.00000 OneToOne 0.00 1048575.00000 FORMAT "%13.5" EXTENDED_LIMITS 0.00 4294967295.00 /end CHARACTERISTIC
/begin CHARACTERISTIC CbnHeatgHeatr_cntrRlyLf_481hInvld_C "" VALUE 0x80257C28 Val_Wu32 1048575.00000 OneToOne 0.00 1048575.00000 FORMAT "%13.5" EXTENDED_LIMITS 0.00 4294967295.00 /end CHARACTERISTIC
/begin CHARACTERISTIC ChgrPlug_stPlgLockTx_4A2hIni_C "" VALUE 0x80257C2C Val_Wu8 7.000 OneToOne 0.00 7.000 FORMAT "%5.3" EXTENDED_LIMITS 0.00 255.0 /end CHARACTERISTIC
/begin CHARACTERISTIC ChrgCntct_nrNegCntctElpdOper_501hIni_C "" VALUE 0x80257C30 Val_Wu32 1048575.00000 OneToOne 0.00 1048575.00000 FORMAT "%13.5" EXTENDED_LIMITS 0.00 4294967295.00 /end CHARACTERISTIC
/begin CHARACTERISTIC ChrgCntct_nrNegCntctElpdOper_501hInvld_C "" VALUE 0x80257C34 Val_Wu32 1048575.00000 OneToOne 0.00 1048575.00000 FORMAT "%13.5" EXTENDED_LIMITS 0.00 4294967295.00 /end CHARACTERISTIC
/begin CHARACTERISTIC ChrgCntct_nrPosCntctElpdOper_501hIni_C "" VALUE 0x80257C38 Val_Wu32 1048575.00000 OneToOne 0.00 1048575.00000 FORMAT "%13.5" EXTENDED_LIMITS 0.00 4294967295.00 /end CHARACTERISTIC
/begin CHARACTERISTIC ChrgCntct_nrPosCntctElpdOper_501hInvld_C "" VALUE 0x80257C3C Val_Wu32 1048575.00000 OneToOne 0.00 1048575.00000 FORMAT "%13.5" EXTENDED_LIMITS 0.00 4294967295.00 /end CHARACTERISTIC
/begin CHARACTERISTIC ChrgrRly_stRlyDes_211hIni_C "" VALUE 0x80257C40 Val_Wu8 3.000 OneToOne 0.00 3.000 FORMAT "%5.3" EXTENDED_LIMITS 0.00 255.0 /end CHARACTERISTIC
/begin CHARACTERISTIC ChrgrVal_iChrgrDes_211hIni_C "" VALUE 0x80257C42 Val_Wu16 511.0000 OneToOne 0.00 511.0000 FORMAT "%8.4" EXTENDED_LIMITS 0.00 65535.00 /end CHARACTERISTIC
/begin CHARACTERISTIC ChrgrVal_iChrgrDes_211hInvld_C "" VALUE 0x80257C44 Val_Wu16 511.0000 OneToOne 0.00 511.0000 FORMAT "%8.4" EXTENDED_LIMITS 0.00 65535.00 /end CHARACTERISTIC
/begin CHARACTERISTIC ChrgrVal_iChrgrDes_321hIni_C "" VALUE 0x80257C46 Val_Wu8 255.0 OneToOne 0.00 255.0 FORMAT "%5.1" /end CHARACTERISTIC
/begin CHARACTERISTIC ChrgrVal_iChrgrDes_321hInvld_C "" VALUE 0x80257C47 Val_Wu8 255.0 OneToOne 0.00 255.0 FORMAT "%5.1" /end CHARACTERISTIC
/begin CHARACTERISTIC ChrgrVal_iGridLimMax_321hIni_C "" VALUE 0x80257C48 Val_Wu8 255.0 OneToOne 0.00 255.0 FORMAT "%5.1" /end CHARACTERISTIC
/begin CHARACTERISTIC ChrgrVal_iGridLimMax_321hInvld_C "" VALUE 0x80257C49 Val_Wu8 255.0 OneToOne 0.00 255.0 FORMAT "%5.1" /end CHARACTERISTIC
/begin CHARACTERISTIC ChrgrVal_uHvMax_211hIni_C "" VALUE 0x80257C4A Val_Wu16 1023.000 OneToOne 0.00 1023.000 FORMAT "%8.3" EXTENDED_LIMITS 0.00 65535.00 /end CHARACTERISTIC
/begin CHARACTERISTIC ChrgrVal_uHvMax_211hInvld_C "" VALUE 0x80257C4C Val_Wu16 1023.000 OneToOne 0.00 1023.000 FORMAT "%8.3" EXTENDED_LIMITS 0.00 65535.00 /end CHARACTERISTIC
/begin CHARACTERISTIC ChrgrVal_uHvMax_321hIni_C "" VALUE 0x80257C4E Val_Wu16 511.0000 OneToOne 0.00 511.0000 FORMAT "%8.4" EXTENDED_LIMITS 0.00 65535.00 /end CHARACTERISTIC
/begin CHARACTERISTIC ChrgrVal_uHvMax_321hInvld_C "" VALUE 0x80257C50 Val_Wu16 511.0000 OneToOne 0.00 511.0000 FORMAT "%8.4" EXTENDED_LIMITS 0.00 65535.00 /end CHARACTERISTIC
/begin CHARACTERISTIC CoDrvPITh_stEPSModeReq_208hIni_C "" VALUE 0x80257C52 Val_Wu8 7.000 OneToOne 0.00 7.000 FORMAT "%5.3" EXTENDED_LIMITS 0.00 255.0 /end CHARACTERISTIC
/begin CHARACTERISTIC CoDrvPITh_stEPSModeReq_5C1hIni_C "" VALUE 0x80257C53 Val_Wu8 7.000 OneToOne 0.00 7.000 FORMAT "%5.3" EXTENDED_LIMITS 0.00 255.0 /end CHARACTERISTIC
/begin CHARACTERISTIC ComChrgn_iDcRly_318hIni_C "" VALUE 0x80257C54 Val_Ws16 2047.969 RBPtCel_i_0p03125_1 -1024.000 1023.969 FORMAT "%8.3" /end CHARACTERISTIC
/begin CHARACTERISTIC ComChrgn_iDcRly_318hRcf_C "" VALUE 0x80257C56 Val_Ws16 2047.969 RBPtCel_i_0p03125_1 -1024.000 1023.969 FORMAT "%8.3" /end CHARACTERISTIC
/begin CHARACTERISTIC ComChrgn_uDcRly_308hIni_C "" VALUE 0x80257C58 Val_Ws16 6553.500 RBPtCel_u_0p1_1 -3276.800 3276.700 FORMAT "%8.3" /end CHARACTERISTIC
/begin CHARACTERISTIC ComChrgn_uDcRly_308hRcf_C "" VALUE 0x80257C5A Val_Ws16 6553.500 RBPtCel_u_0p1_1 -3276.800 3276.700 FORMAT "%8.3" /end CHARACTERISTIC
/begin CHARACTERISTIC ComChrgr_flgChrgrErrLvl_273hIni_C "" VALUE 0x80257C5C Val_Wu8 7.000 OneToOne 0.00 7.000 FORMAT "%5.3" EXTENDED_LIMITS 0.00 255.0 /end CHARACTERISTIC
/begin CHARACTERISTIC ComChrgr_flgChrgrErrLvl_273hInvld_C "" VALUE 0x80257C5D Val_Wu8 7.000 OneToOne 0.00 7.000 FORMAT "%5.3" EXTENDED_LIMITS 0.00 255.0 /end CHARACTERISTIC
/begin CHARACTERISTIC ComChrgr_flgChrgrErrLvl_273hRcf_C "" VALUE 0x80257C5E Val_Wu8 7.000 OneToOne 0.00 7.000 FORMAT "%5.3" EXTENDED_LIMITS 0.00 255.0 /end CHARACTERISTIC
/begin CHARACTERISTIC ComChrgr_iAcMax_453hIni_C "" VALUE 0x80257C60 Val_Ws16 2047.969 RBPtCel_i_0p03125_1 -1024.000 1023.969 FORMAT "%8.3" /end CHARACTERISTIC
/begin CHARACTERISTIC ComChrgr_iAcMax_453hInvld_C "" VALUE 0x80257C62 Val_Wu8 255.0 OneToOne 0.00 255.0 FORMAT "%5.1" /end CHARACTERISTIC
/begin CHARACTERISTIC ComChrgr_iAcMax_453hRcf_C "" VALUE 0x80257C64 Val_Ws16 2047.969 RBPtCel_i_0p03125_1 -1024.000 1023.969 FORMAT "%8.3" /end CHARACTERISTIC
/begin CHARACTERISTIC ComChrgr_iDcHvAct_463hIni_C "" VALUE 0x80257C66 Val_Ws16 2047.969 RBPtCel_i_0p03125_1 -1024.000 1023.969 FORMAT "%8.3" /end CHARACTERISTIC
/begin CHARACTERISTIC ComChrgr_iDcHvAct_463hInvld_C "" VALUE 0x80257C68 Val_Wu8 255.0 OneToOne 0.00 255.0 FORMAT "%5.1" /end CHARACTERISTIC
/begin CHARACTERISTIC ComChrgr_iDcHvAct_463hRcf_C "" VALUE 0x80257C6A Val_Ws16 2047.969 RBPtCel_i_0p03125_1 -1024.000 1023.969 FORMAT "%8.3" /end CHARACTERISTIC
/begin CHARACTERISTIC ComChrgr_pwrInAct_453hIni_C "" VALUE 0x80257C6C Val_Wu16 655350.0 RBPtCel_pwr_10p0_1 0.00 655350.0 FORMAT "%8.1" /end CHARACTERISTIC
/begin CHARACTERISTIC ComChrgr_pwrInAct_453hInvld_C "" VALUE 0x80257C6E Val_Wu16 511.0000 OneToOne 0.00 511.0000 FORMAT "%8.4" EXTENDED_LIMITS 0.00 65535.00 /end CHARACTERISTIC
/begin CHARACTERISTIC ComChrgr_pwrInAct_453hRcf_C "" VALUE 0x80257C70 Val_Wu16 655350.0 RBPtCel_pwr_10p0_1 0.00 655350.0 FORMAT "%8.1" /end CHARACTERISTIC
/begin CHARACTERISTIC ComChrgr_pwrOutpCpby_273hIni_C "" VALUE 0x80257C72 Val_Wu16 3500.000 RBPtCel_pwr_1p0_1 0.00 3500.000 FORMAT "%8.3" EXTENDED_LIMITS 0.00 65535.00 /end CHARACTERISTIC
/begin CHARACTERISTIC ComChrgr_pwrOutpCpby_273hInvld_C "" VALUE 0x80257C74 Val_Wu16 511.0000 OneToOne 0.00 511.0000 FORMAT "%8.4" EXTENDED_LIMITS 0.00 65535.00 /end CHARACTERISTIC
/begin CHARACTERISTIC ComChrgr_pwrOutpCpby_273hRcf_C "" VALUE 0x80257C76 Val_Wu16 3500.000 RBPtCel_pwr_1p0_1 0.00 3500.000 FORMAT "%8.3" EXTENDED_LIMITS 0.00 65535.00 /end CHARACTERISTIC
/begin CHARACTERISTIC ComChrgr_stChrgnEna_281hIni_C "" VALUE 0x80257C78 Val_Wu8 7.000 OneToOne 0.00 7.000 FORMAT "%5.3" EXTENDED_LIMITS 0.00 255.0 /end CHARACTERISTIC
/begin CHARACTERISTIC ComChrgr_stChrgrRx_273hIni_C "" VALUE 0x80257C79 Val_Wu8 15.00 OneToOne 0.00 15.00 FORMAT "%5.2" EXTENDED_LIMITS 0.00 255.0 /end CHARACTERISTIC
/begin CHARACTERISTIC ComChrgr_stChrgrRx_273hRcf_C "" VALUE 0x80257C7A Val_Wu8 15.00 OneToOne 0.00 15.00 FORMAT "%5.2" EXTENDED_LIMITS 0.00 255.0 /end CHARACTERISTIC
/begin CHARACTERISTIC ComChrgr_stEVLmp_273hIni_C "" VALUE 0x80257C7B Val_Wu8 3.000 OneToOne 0.00 3.000 FORMAT "%5.3" EXTENDED_LIMITS 0.00 255.0 /end CHARACTERISTIC
/begin CHARACTERISTIC ComChrgr_stEVLmp_273hRcf_C "" VALUE 0x80257C7C Val_Wu8 3.000 OneToOne 0.00 3.000 FORMAT "%5.3" EXTENDED_LIMITS 0.00 255.0 /end CHARACTERISTIC
/begin CHARACTERISTIC ComChrgr_stMstWrnLmp_273hIni_C "" VALUE 0x80257C7D Val_Wu8 3.000 OneToOne 0.00 3.000 FORMAT "%5.3" EXTENDED_LIMITS 0.00 255.0 /end CHARACTERISTIC
/begin CHARACTERISTIC ComChrgr_stMstWrnLmp_273hRcf_C "" VALUE 0x80257C7E Val_Wu8 3.000 OneToOne 0.00 3.000 FORMAT "%5.3" EXTENDED_LIMITS 0.00 255.0 /end CHARACTERISTIC
/begin CHARACTERISTIC ComChrgr_stSVSLmp_273hIni_C "" VALUE 0x80257C7F Val_Wu8 3.000 OneToOne 0.00 3.000 FORMAT "%5.3" EXTENDED_LIMITS 0.00 255.0 /end CHARACTERISTIC
/begin CHARACTERISTIC ComChrgr_stSVSLmp_273hRcf_C "" VALUE 0x80257C80 Val_Wu8 3.000 OneToOne 0.00 3.000 FORMAT "%5.3" EXTENDED_LIMITS 0.00 255.0 /end CHARACTERISTIC
/begin CHARACTERISTIC ComChrgr_tChrgrMaxAct_463hIni_C "" VALUE 0x80257C82 Val_Ws16 6553.500 RBPtCel_t_0p1_3 -3276.800 3276.700 FORMAT "%8.3" /end CHARACTERISTIC
/begin CHARACTERISTIC ComChrgr_tChrgrMaxAct_463hInvld_C "" VALUE 0x80257C84 Val_Wu8 255.0 OneToOne 0.00 255.0 FORMAT "%5.1" /end CHARACTERISTIC
/begin CHARACTERISTIC ComChrgr_tChrgrMaxAct_463hRcf_C "" VALUE 0x80257C86 Val_Ws16 6553.500 RBPtCel_t_0p1_3 -3276.800 3276.700 FORMAT "%8.3" /end CHARACTERISTIC
/begin CHARACTERISTIC ComChrgr_uAcActL1_453hIni_C "" VALUE 0x80257C88 Val_Ws16 6553.500 RBPtCel_u_0p1_1 -3276.800 3276.700 FORMAT "%8.3" /end CHARACTERISTIC
/begin CHARACTERISTIC ComChrgr_uAcActL1_453hInvld_C "" VALUE 0x80257C8A Val_Wu16 511.0000 OneToOne 0.00 511.0000 FORMAT "%8.4" EXTENDED_LIMITS 0.00 65535.00 /end CHARACTERISTIC
/begin CHARACTERISTIC ComChrgr_uAcActL1_453hRcf_C "" VALUE 0x80257C8C Val_Ws16 6553.500 RBPtCel_u_0p1_1 -3276.800 3276.700 FORMAT "%8.3" /end CHARACTERISTIC
/begin CHARACTERISTIC ComChrgr_uDcHvAct_463hIni_C "" VALUE 0x80257C8E Val_Ws16 6553.500 RBPtCel_u_0p1_1 -3276.800 3276.700 FORMAT "%8.3" /end CHARACTERISTIC
/begin CHARACTERISTIC ComChrgr_uDcHvAct_463hInvld_C "" VALUE 0x80257C90 Val_Wu16 1023.000 OneToOne 0.00 1023.000 FORMAT "%8.3" EXTENDED_LIMITS 0.00 65535.00 /end CHARACTERISTIC
/begin CHARACTERISTIC ComChrgr_uDcHvAct_463hRcf_C "" VALUE 0x80257C92 Val_Ws16 6553.500 RBPtCel_u_0p1_1 -3276.800 3276.700 FORMAT "%8.3" /end CHARACTERISTIC
/begin CHARACTERISTIC ComChrg_stMod_211hIni_C "" VALUE 0x80257C94 Val_Wu8 7.000 OneToOne 0.00 7.000 FORMAT "%5.3" EXTENDED_LIMITS 0.00 255.0 /end CHARACTERISTIC
/begin CHARACTERISTIC ComEmac_flgImobAuthent_5C7hIni_C "" VALUE 0x80257C95 Val_Wu8 1.00000000000 B_TRUE 0.00 1.00000000000 FORMAT "%13.11" /end CHARACTERISTIC
/begin CHARACTERISTIC ComEmac_flgImobAuthent_5C7hRcf_C "" VALUE 0x80257C96 Val_Wu8 1.00000000000 B_TRUE 0.00 1.00000000000 FORMAT "%13.11" /end CHARACTERISTIC
/begin CHARACTERISTIC ComEmac_iDcLnk01_227hIni_C "" VALUE 0x80257C98 Val_Ws16 2047.969 Curr_A_q0p03125_COMPU -1024.000 1023.969 FORMAT "%8.3" /end CHARACTERISTIC
/begin CHARACTERISTIC ComEmac_iDcLnk01_227hInvld_C "" VALUE 0x80257C9A Val_Wu16 2047.000 OneToOne 0.00 2047.000 FORMAT "%8.3" EXTENDED_LIMITS 0.00 65535.00 /end CHARACTERISTIC
/begin CHARACTERISTIC ComEmac_iDcLnk01_227hRcf_C "" VALUE 0x80257C9C Val_Ws16 2047.969 Curr_A_q0p03125_COMPU -1024.000 1023.969 FORMAT "%8.3" /end CHARACTERISTIC
/begin CHARACTERISTIC ComEmac_nAct01_217hIni_C "" VALUE 0x80257C9E Val_Ws16 65535.00 nmot_q1 -32768.00 32767.00 FORMAT "%8.2" /end CHARACTERISTIC
/begin CHARACTERISTIC ComEmac_nAct01_217hInvld_C "" VALUE 0x80257CA0 Val_Ws16 65535.00 OneToOne -32768.00 32767.00 FORMAT "%8.2" /end CHARACTERISTIC
/begin CHARACTERISTIC ComEmac_nAct01_217hRcf_C "" VALUE 0x80257CA2 Val_Ws16 65535.00 nmot_q1 -32768.00 32767.00 FORMAT "%8.2" /end CHARACTERISTIC
/begin CHARACTERISTIC ComEmac_pwrInstnsInpRx_227hIni_C "" VALUE 0x80257CA4 Val_Ws16 200.0000 q0p1_kW -100.0000 100.0000 FORMAT "%8.4" EXTENDED_LIMITS -3276.800 3276.700 /end CHARACTERISTIC
/begin CHARACTERISTIC ComEmac_pwrInstnsInpRx_227hInvld_C "" VALUE 0x80257CA6 Val_Ws16 2047.000 OneToOne -1024.000 1023.000 FORMAT "%8.3" EXTENDED_LIMITS -32768.00 32767.00 /end CHARACTERISTIC
/begin CHARACTERISTIC ComEmac_pwrInstnsInpRx_227hRcf_C "" VALUE 0x80257CA8 Val_Ws16 200.0000 q0p1_kW -100.0000 100.0000 FORMAT "%8.4" EXTENDED_LIMITS -3276.800 3276.700 /end CHARACTERISTIC
/begin CHARACTERISTIC ComEmac_stActvDcha_237hIni_C "" VALUE 0x80257CAA Val_Wu8 7.000 OneToOne 0.00 7.000 FORMAT "%5.3" EXTENDED_LIMITS 0.00 255.0 /end CHARACTERISTIC
/begin CHARACTERISTIC ComEmac_stActvDcha_237hInvld_C "" VALUE 0x80257CAB Val_Wu8 7.000 OneToOne 0.00 7.000 FORMAT "%5.3" EXTENDED_LIMITS 0.00 255.0 /end CHARACTERISTIC
/begin CHARACTERISTIC ComEmac_stActvDcha_237hRcf_C "" VALUE 0x80257CAC Val_Wu8 7.000 OneToOne 0.00 7.000 FORMAT "%5.3" EXTENDED_LIMITS 0.00 255.0 /end CHARACTERISTIC
/begin CHARACTERISTIC ComEmac_stEVLmp_237hIni_C "" VALUE 0x80257CAD Val_Wu8 3.000 OneToOne 0.00 3.000 FORMAT "%5.3" EXTENDED_LIMITS 0.00 255.0 /end CHARACTERISTIC
/begin CHARACTERISTIC ComEmac_stEVLmp_237hRcf_C "" VALUE 0x80257CAE Val_Wu8 3.000 OneToOne 0.00 3.000 FORMAT "%5.3" EXTENDED_LIMITS 0.00 255.0 /end CHARACTERISTIC
/begin CHARACTERISTIC ComEmac_stHillHld_237hIni_C "" VALUE 0x80257CAF Val_Wu8 3.000 OneToOne 0.00 3.000 FORMAT "%5.3" EXTENDED_LIMITS 0.00 255.0 /end CHARACTERISTIC
/begin CHARACTERISTIC ComEmac_stHillHld_237hRcf_C "" VALUE 0x80257CB0 Val_Wu8 3.000 OneToOne 0.00 3.000 FORMAT "%5.3" EXTENDED_LIMITS 0.00 255.0 /end CHARACTERISTIC
/begin CHARACTERISTIC ComEmac_stIsoMonSwtAck_237hIni_C "" VALUE 0x80257CB1 Val_Wu8 2.000 OneToOne 0.00 2.000 FORMAT "%5.3" EXTENDED_LIMITS 0.00 255.0 /end CHARACTERISTIC
/begin CHARACTERISTIC ComEmac_stIsoMonSwtAck_237hRcf_C "" VALUE 0x80257CB2 Val_Wu8 2.000 OneToOne 0.00 2.000 FORMAT "%5.3" EXTENDED_LIMITS 0.00 255.0 /end CHARACTERISTIC
/begin CHARACTERISTIC ComEmac_stIvtrOpMod01_427hIni_C "" VALUE 0x80257CB3 Val_Wu8 7.000 OneToOne 0.00 7.000 FORMAT "%5.3" EXTENDED_LIMITS 0.00 255.0 /end CHARACTERISTIC
/begin CHARACTERISTIC ComEmac_stIvtrOpMod01_427hInvld_C "" VALUE 0x80257CB4 Val_Wu8 7.000 OneToOne 0.00 7.000 FORMAT "%5.3" EXTENDED_LIMITS 0.00 255.0 /end CHARACTERISTIC
/begin CHARACTERISTIC ComEmac_stIvtrOpMod01_427hRcf_C "" VALUE 0x80257CB5 Val_Wu8 7.000 OneToOne 0.00 7.000 FORMAT "%5.3" EXTENDED_LIMITS 0.00 255.0 /end CHARACTERISTIC
/begin CHARACTERISTIC ComEmac_stMod01Rx_237hIni_C "" VALUE 0x80257CB6 Val_Wu8 7.000 OneToOne 0.00 7.000 FORMAT "%5.3" EXTENDED_LIMITS 0.00 255.0 /end CHARACTERISTIC
/begin CHARACTERISTIC ComEmac_stMod01Rx_237hRcf_C "" VALUE 0x80257CB7 Val_Wu8 7.000 OneToOne 0.00 7.000 FORMAT "%5.3" EXTENDED_LIMITS 0.00 255.0 /end CHARACTERISTIC
/begin CHARACTERISTIC ComEmac_stMstWrnLmp_237hIni_C "" VALUE 0x80257CB8 Val_Wu8 3.000 OneToOne 0.00 3.000 FORMAT "%5.3" EXTENDED_LIMITS 0.00 255.0 /end CHARACTERISTIC
/begin CHARACTERISTIC ComEmac_stMstWrnLmp_237hRcf_C "" VALUE 0x80257CB9 Val_Wu8 3.000 OneToOne 0.00 3.000 FORMAT "%5.3" EXTENDED_LIMITS 0.00 255.0 /end CHARACTERISTIC
/begin CHARACTERISTIC ComEmac_stPwrAuthn_237hIni_C "" VALUE 0x80257CBA Val_Wu8 1.00000000000 B_TRUE 0.00 1.00000000000 FORMAT "%13.11" /end CHARACTERISTIC
/begin CHARACTERISTIC ComEmac_stPwrAuthn_237hRcf_C "" VALUE 0x80257CBB Val_Wu8 1.00000000000 B_TRUE 0.00 1.00000000000 FORMAT "%13.11" /end CHARACTERISTIC
/begin CHARACTERISTIC ComEmac_stSVSLmp_237hIni_C "" VALUE 0x80257CBC Val_Wu8 3.000 OneToOne 0.00 3.000 FORMAT "%5.3" EXTENDED_LIMITS 0.00 255.0 /end CHARACTERISTIC
/begin CHARACTERISTIC ComEmac_stSVSLmp_237hRcf_C "" VALUE 0x80257CBD Val_Wu8 3.000 OneToOne 0.00 3.000 FORMAT "%5.3" EXTENDED_LIMITS 0.00 255.0 /end CHARACTERISTIC
/begin CHARACTERISTIC ComEmac_tInvr01_427hIni_C "" VALUE 0x80257CBE Val_Ws16 6553.500 Temp_Cels -3549.940 3003.560 FORMAT "%8.3" /end CHARACTERISTIC
/begin CHARACTERISTIC ComEmac_tInvr01_427hInvld_C "" VALUE 0x80257CC0 Val_Wu8 255.0 OneToOne 0.00 255.0 FORMAT "%5.1" /end CHARACTERISTIC
/begin CHARACTERISTIC ComEmac_tInvr01_427hRcf_C "" VALUE 0x80257CC2 Val_Ws16 6553.500 Temp_Cels -3549.940 3003.560 FORMAT "%8.3" /end CHARACTERISTIC
/begin CHARACTERISTIC ComEmac_tIvtrCooltIn01_427hIni_C "" VALUE 0x80257CC4 Val_Ws16 6553.500 Temp_Cels -3549.940 3003.560 FORMAT "%8.3" /end CHARACTERISTIC
/begin CHARACTERISTIC ComEmac_tIvtrCooltIn01_427hInvld_C "" VALUE 0x80257CC6 Val_Wu8 255.0 OneToOne 0.00 255.0 FORMAT "%5.1" /end CHARACTERISTIC
/begin CHARACTERISTIC ComEmac_tIvtrCooltIn01_427hRcf_C "" VALUE 0x80257CC8 Val_Ws16 6553.500 Temp_Cels -3549.940 3003.560 FORMAT "%8.3" /end CHARACTERISTIC
/begin CHARACTERISTIC ComEmac_tMac01_427hIni_C "" VALUE 0x80257CCA Val_Ws16 6553.500 Temp_Cels -3549.940 3003.560 FORMAT "%8.3" /end CHARACTERISTIC
/begin CHARACTERISTIC ComEmac_tMac01_427hInvld_C "" VALUE 0x80257CCC Val_Wu8 255.0 OneToOne 0.00 255.0 FORMAT "%5.1" /end CHARACTERISTIC
/begin CHARACTERISTIC ComEmac_tMac01_427hRcf_C "" VALUE 0x80257CCE Val_Ws16 6553.500 Temp_Cels -3549.940 3003.560 FORMAT "%8.3" /end CHARACTERISTIC
/begin CHARACTERISTIC ComEmac_tqAbsltMaxRx01_227hIni_C "" VALUE 0x80257CD0 Val_Ws16 6553.500 Trq -3276.800 3276.700 FORMAT "%8.3" /end CHARACTERISTIC
/begin CHARACTERISTIC ComEmac_tqAbsltMaxRx01_227hInvld_C "" VALUE 0x80257CD2 Val_Ws16 4095.000 OneToOne -2048.000 2047.000 FORMAT "%8.3" EXTENDED_LIMITS -32768.00 32767.00 /end CHARACTERISTIC
/begin CHARACTERISTIC ComEmac_tqAbsltMaxRx01_227hRcf_C "" VALUE 0x80257CD4 Val_Ws16 6553.500 Trq -3276.800 3276.700 FORMAT "%8.3" /end CHARACTERISTIC
/begin CHARACTERISTIC ComEmac_tqAbsltMinRx01_227hIni_C "" VALUE 0x80257CD6 Val_Ws16 6553.500 Trq -3276.800 3276.700 FORMAT "%8.3" /end CHARACTERISTIC
/begin CHARACTERISTIC ComEmac_tqAbsltMinRx01_227hInvld_C "" VALUE 0x80257CD8 Val_Ws16 4095.000 OneToOne -2048.000 2047.000 FORMAT "%8.3" EXTENDED_LIMITS -32768.00 32767.00 /end CHARACTERISTIC
/begin CHARACTERISTIC ComEmac_tqAbsltMinRx01_227hRcf_C "" VALUE 0x80257CDA Val_Ws16 6553.500 Trq -3276.800 3276.700 FORMAT "%8.3" /end CHARACTERISTIC
/begin CHARACTERISTIC ComEmac_tqAckd01_217hIni_C "" VALUE 0x80257CDC Val_Ws16 286.0000 RBPtCel_tq_0p1_1 -143.0000 143.0000 FORMAT "%8.4" EXTENDED_LIMITS -3276.800 3276.700 /end CHARACTERISTIC
/begin CHARACTERISTIC ComEmac_tqAckd01_217hInvld_C "" VALUE 0x80257CDE Val_Ws16 4095.000 OneToOne -2048.000 2047.000 FORMAT "%8.3" EXTENDED_LIMITS -32768.00 32767.00 /end CHARACTERISTIC
/begin CHARACTERISTIC ComEmac_tqAckd01_217hRcf_C "" VALUE 0x80257CE0 Val_Ws16 286.0000 RBPtCel_tq_0p1_1 -143.0000 143.0000 FORMAT "%8.4" EXTENDED_LIMITS -3276.800 3276.700 /end CHARACTERISTIC
/begin CHARACTERISTIC ComEmac_tqAct01_217hIni_C "" VALUE 0x80257CE2 Val_Ws16 6553.500 Trq -3276.800 3276.700 FORMAT "%8.3" /end CHARACTERISTIC
/begin CHARACTERISTIC ComEmac_tqAct01_217hInvld_C "" VALUE 0x80257CE4 Val_Ws16 4095.000 OneToOne -2048.000 2047.000 FORMAT "%8.3" EXTENDED_LIMITS -32768.00 32767.00 /end CHARACTERISTIC
/begin CHARACTERISTIC ComEmac_tqAct01_217hRcf_C "" VALUE 0x80257CE6 Val_Ws16 6553.500 Trq -3276.800 3276.700 FORMAT "%8.3" /end CHARACTERISTIC
/begin CHARACTERISTIC ComEmac_tqPtd01_427hIni_C "" VALUE 0x80257CE8 Val_Wu8 100.0 RBPtCel_Perc_1p0_1 0.00 100.0 FORMAT "%5.1" EXTENDED_LIMITS 0.00 255.0 /end CHARACTERISTIC
/begin CHARACTERISTIC ComEmac_tqPtd01_427hInvld_C "" VALUE 0x80257CE9 Val_Wu8 127.0 OneToOne 0.00 127.0 FORMAT "%5.1" EXTENDED_LIMITS 0.00 255.0 /end CHARACTERISTIC
/begin CHARACTERISTIC ComEmac_tqPtd01_427hRcf_C "" VALUE 0x80257CEA Val_Wu8 100.0 RBPtCel_Perc_1p0_1 0.00 100.0 FORMAT "%5.1" EXTENDED_LIMITS 0.00 255.0 /end CHARACTERISTIC
/begin CHARACTERISTIC ComEmac_tqStabnMin_237hIni_C "" VALUE 0x80257CEC Val_Ws16 6553.500 Trq -3276.800 3276.700 FORMAT "%8.3" /end CHARACTERISTIC
/begin CHARACTERISTIC ComEmac_tqStabnMin_237hInvld_C "" VALUE 0x80257CEE Val_Ws16 4095.000 OneToOne -2048.000 2047.000 FORMAT "%8.3" EXTENDED_LIMITS -32768.00 32767.00 /end CHARACTERISTIC
/begin CHARACTERISTIC ComEmac_tqStabnMin_237hRcf_C "" VALUE 0x80257CF0 Val_Ws16 6553.500 Trq -3276.800 3276.700 FORMAT "%8.3" /end CHARACTERISTIC
/begin CHARACTERISTIC ComEmac_uDcLnk01_217hIni_C "" VALUE 0x80257CF2 Val_Ws16 2047.969 Volt_V_q0p03125_COMPU -1024.000 1023.969 FORMAT "%8.3" /end CHARACTERISTIC
/begin CHARACTERISTIC ComEmac_uDcLnk01_217hInvld_C "" VALUE 0x80257CF4 Val_Wu16 511.0000 OneToOne 0.00 511.0000 FORMAT "%8.4" EXTENDED_LIMITS 0.00 65535.00 /end CHARACTERISTIC
/begin CHARACTERISTIC ComEmac_uDcLnk01_217hRcf_C "" VALUE 0x80257CF6 Val_Ws16 2047.969 Volt_V_q0p03125_COMPU -1024.000 1023.969 FORMAT "%8.3" /end CHARACTERISTIC
/begin CHARACTERISTIC Com_bAcLedReq_25hIni_C "" VALUE 0x80257CF8 Val_Wu8 1.00000000000 B_TRUE 0.00 1.00000000000 FORMAT "%13.11" /end CHARACTERISTIC
/begin CHARACTERISTIC Com_bDelDftReq_092hIni_C "" VALUE 0x80257CF9 Val_Wu8 1.00000000000 B_TRUE 0.00 1.00000000000 FORMAT "%13.11" /end CHARACTERISTIC
/begin CHARACTERISTIC Com_bDelDftReq_092hRcf_C "" VALUE 0x80257CFA Val_Wu8 1.00000000000 B_TRUE 0.00 1.00000000000 FORMAT "%13.11" /end CHARACTERISTIC
/begin CHARACTERISTIC Com_bDiagMuxCAN_208hIni_C "" VALUE 0x80257CFB Val_Wu8 1.000 OneToOne 0.00 1.000 FORMAT "%5.3" EXTENDED_LIMITS 0.00 255.0 /end CHARACTERISTIC
/begin CHARACTERISTIC Com_bElIntgDiagMod_092hIni_C "" VALUE 0x80257CFC Val_Wu8 1.00000000000 B_TRUE 0.00 1.00000000000 FORMAT "%13.11" /end CHARACTERISTIC
/begin CHARACTERISTIC Com_bElIntgDiagMod_092hRcf_C "" VALUE 0x80257CFD Val_Wu8 1.00000000000 B_TRUE 0.00 1.00000000000 FORMAT "%13.11" /end CHARACTERISTIC
/begin CHARACTERISTIC Com_bElIntgDiag_092hIni_C "" VALUE 0x80257CFE Val_Wu8 1.00000000000 B_TRUE 0.00 1.00000000000 FORMAT "%13.11" /end CHARACTERISTIC
/begin CHARACTERISTIC Com_bElIntgDiag_092hRcf_C "" VALUE 0x80257CFF Val_Wu8 1.00000000000 B_TRUE 0.00 1.00000000000 FORMAT "%13.11" /end CHARACTERISTIC
/begin CHARACTERISTIC Com_bGunCntInfoWkuReq_421hIni_C "" VALUE 0x80257D00 Val_Wu8 1.000 OneToOne 0.00 1.000 FORMAT "%5.3" EXTENDED_LIMITS 0.00 255.0 /end CHARACTERISTIC
/begin CHARACTERISTIC Com_bHvBattRchrgWkuReq_421hIni_C "" VALUE 0x80257D01 Val_Wu8 1.000 OneToOne 0.00 1.000 FORMAT "%5.3" EXTENDED_LIMITS 0.00 255.0 /end CHARACTERISTIC
/begin CHARACTERISTIC Com_bImmoUnlockWkuReq_432hIni_C "" VALUE 0x80257D02 Val_Wu8 1.00000000000 B_TRUE 0.00 1.00000000000 FORMAT "%13.11" /end CHARACTERISTIC
/begin CHARACTERISTIC Com_bImmoUnlockWkuReq_432hRcf_C "" VALUE 0x80257D03 Val_Wu8 1.00000000000 B_TRUE 0.00 1.00000000000 FORMAT "%13.11" /end CHARACTERISTIC
/begin CHARACTERISTIC Com_bInfoReqPtlWkuReq_432hIni_C "" VALUE 0x80257D04 Val_Wu8 1.00000000000 B_TRUE 0.00 1.00000000000 FORMAT "%13.11" /end CHARACTERISTIC
/begin CHARACTERISTIC Com_bInfoReqPtlWkuReq_432hRcf_C "" VALUE 0x80257D05 Val_Wu8 1.00000000000 B_TRUE 0.00 1.00000000000 FORMAT "%13.11" /end CHARACTERISTIC
/begin CHARACTERISTIC Com_bPostOperationWkuReq_421hIni_C "" VALUE 0x80257D06 Val_Wu8 1.000 OneToOne 0.00 1.000 FORMAT "%5.3" EXTENDED_LIMITS 0.00 255.0 /end CHARACTERISTIC
/begin CHARACTERISTIC Com_bPreCondElecWkuReq_432hIni_C "" VALUE 0x80257D07 Val_Wu8 1.00000000000 B_TRUE 0.00 1.00000000000 FORMAT "%13.11" /end CHARACTERISTIC
/begin CHARACTERISTIC Com_bPreCondElecWkuReq_432hRcf_C "" VALUE 0x80257D08 Val_Wu8 1.00000000000 B_TRUE 0.00 1.00000000000 FORMAT "%13.11" /end CHARACTERISTIC
/begin CHARACTERISTIC Com_bReFogRlySt_25hIni_C "" VALUE 0x80257D09 Val_Wu8 1.00000000000 B_TRUE 0.00 1.00000000000 FORMAT "%13.11" /end CHARACTERISTIC
/begin CHARACTERISTIC Com_bReFogRlySt_CAN_442hIni_C "" VALUE 0x80257D0A Val_Wu8 1.00000000000 B_TRUE 0.00 1.00000000000 FORMAT "%13.11" /end CHARACTERISTIC
/begin CHARACTERISTIC Com_bReFogRlySt_CAN_442hRcf_C "" VALUE 0x80257D0B Val_Wu8 1.00000000000 B_TRUE 0.00 1.00000000000 FORMAT "%13.11" /end CHARACTERISTIC
/begin CHARACTERISTIC Com_bRemUnlckWkuReq_432hIni_C "" VALUE 0x80257D0C Val_Wu8 1.00000000000 B_TRUE 0.00 1.00000000000 FORMAT "%13.11" /end CHARACTERISTIC
/begin CHARACTERISTIC Com_bRemUnlckWkuReq_432hRcf_C "" VALUE 0x80257D0D Val_Wu8 1.00000000000 B_TRUE 0.00 1.00000000000 FORMAT "%13.11" /end CHARACTERISTIC
/begin CHARACTERISTIC Com_bStpDlyHMIWkuReq_432hIni_C "" VALUE 0x80257D0E Val_Wu8 1.00000000000 B_TRUE 0.00 1.00000000000 FORMAT "%13.11" /end CHARACTERISTIC
/begin CHARACTERISTIC Com_bStpDlyHMIWkuReq_432hRcf_C "" VALUE 0x80257D0F Val_Wu8 1.00000000000 B_TRUE 0.00 1.00000000000 FORMAT "%13.11" /end CHARACTERISTIC
/begin CHARACTERISTIC Com_CDE_RESEAU_LIN_VCU_Tx_EIMode_C "" VALUE 0x80250096 RB_Val_Wboolean 1.00000000000 B_TRUE 0.00 1.00000000000 FORMAT "%13.11" /end CHARACTERISTIC
/begin CHARACTERISTIC Com_ctHvbNegCntctrSeg1_635hIni_C "" VALUE 0x80257D10 Val_Wu32 100032.000000 q64 0.00 100032.000000 FORMAT "%13.6" EXTENDED_LIMITS 0.00 274877906880. /end CHARACTERISTIC
/begin CHARACTERISTIC Com_ctHvbNegCntctrSeg1_635hInvld_C "" VALUE 0x80257D14 Val_Wu16 2047.000 OneToOne 0.00 2047.000 FORMAT "%8.3" EXTENDED_LIMITS 0.00 65535.00 /end CHARACTERISTIC
/begin CHARACTERISTIC Com_ctHvbNegCntctrSeg1_635hRcf_C "" VALUE 0x80257D18 Val_Wu32 100032.000000 q64 0.00 100032.000000 FORMAT "%13.6" EXTENDED_LIMITS 0.00 274877906880. /end CHARACTERISTIC
/begin CHARACTERISTIC Com_ctHvbNegCntctrSeg2_635hIni_C "" VALUE 0x80257D1C Val_Wu16 1008.000 q16 0.00 1008.000 FORMAT "%8.3" EXTENDED_LIMITS 0.00 1048560. /end CHARACTERISTIC
/begin CHARACTERISTIC Com_ctHvbNegCntctrSeg2_635hRcf_C "" VALUE 0x80257D1E Val_Wu16 1008.000 q16 0.00 1008.000 FORMAT "%8.3" EXTENDED_LIMITS 0.00 1048560. /end CHARACTERISTIC
/begin CHARACTERISTIC Com_ctHvbNegCntctrSeg3_635hIni_C "" VALUE 0x80257D20 Val_Wu16 600.0000 q8 0.00 600.0000 FORMAT "%8.4" EXTENDED_LIMITS 0.00 524280.0 /end CHARACTERISTIC
/begin CHARACTERISTIC Com_ctHvbNegCntctrSeg3_635hInvld_C "" VALUE 0x80257D22 Val_Wu8 127.0 OneToOne 0.00 127.0 FORMAT "%5.1" EXTENDED_LIMITS 0.00 255.0 /end CHARACTERISTIC
/begin CHARACTERISTIC Com_ctHvbNegCntctrSeg3_635hRcf_C "" VALUE 0x80257D24 Val_Wu16 600.0000 q8 0.00 600.0000 FORMAT "%8.4" EXTENDED_LIMITS 0.00 524280.0 /end CHARACTERISTIC
/begin CHARACTERISTIC Com_ctHvbNegCntctrSeg4_635hIni_C "" VALUE 0x80257D26 Val_Wu8 20.00 OneToOne 0.00 20.00 FORMAT "%5.2" EXTENDED_LIMITS 0.00 255.0 /end CHARACTERISTIC
/begin CHARACTERISTIC Com_ctHvbNegCntctrSeg4_635hInvld_C "" VALUE 0x80257D27 Val_Wu8 31.00 OneToOne 0.00 31.00 FORMAT "%5.2" EXTENDED_LIMITS 0.00 255.0 /end CHARACTERISTIC
/begin CHARACTERISTIC Com_ctHvbNegCntctrSeg4_635hRcf_C "" VALUE 0x80257D28 Val_Wu8 20.00 OneToOne 0.00 20.00 FORMAT "%5.2" EXTENDED_LIMITS 0.00 255.0 /end CHARACTERISTIC
/begin CHARACTERISTIC Com_ctHvbNegCntctrSeg5_635hIni_C "" VALUE 0x80257D29 Val_Wu8 1.000 OneToOne 0.00 1.000 FORMAT "%5.3" EXTENDED_LIMITS 0.00 255.0 /end CHARACTERISTIC
/begin CHARACTERISTIC Com_ctHvbNegCntctrSeg5_635hRcf_C "" VALUE 0x80257D2A Val_Wu8 1.000 OneToOne 0.00 1.000 FORMAT "%5.3" EXTENDED_LIMITS 0.00 255.0 /end CHARACTERISTIC
/begin CHARACTERISTIC Com_ctHvbPosCntctrSeg1_635hIni_C "" VALUE 0x80257D2C Val_Wu32 100032.000000 q64 0.00 100032.000000 FORMAT "%13.6" EXTENDED_LIMITS 0.00 274877906880. /end CHARACTERISTIC
/begin CHARACTERISTIC Com_ctHvbPosCntctrSeg1_635hInvld_C "" VALUE 0x80257D30 Val_Wu16 2047.000 OneToOne 0.00 2047.000 FORMAT "%8.3" EXTENDED_LIMITS 0.00 65535.00 /end CHARACTERISTIC
/begin CHARACTERISTIC Com_ctHvbPosCntctrSeg1_635hRcf_C "" VALUE 0x80257D34 Val_Wu32 100032.000000 q64 0.00 100032.000000 FORMAT "%13.6" EXTENDED_LIMITS 0.00 274877906880. /end CHARACTERISTIC
/begin CHARACTERISTIC Com_ctHvbPosCntctrSeg2_635hIni_C "" VALUE 0x80257D38 Val_Wu16 1008.000 q16 0.00 1008.000 FORMAT "%8.3" EXTENDED_LIMITS 0.00 1048560. /end CHARACTERISTIC
/begin CHARACTERISTIC Com_ctHvbPosCntctrSeg2_635hRcf_C "" VALUE 0x80257D3A Val_Wu16 1008.000 q16 0.00 1008.000 FORMAT "%8.3" EXTENDED_LIMITS 0.00 1048560. /end CHARACTERISTIC
/begin CHARACTERISTIC Com_ctHvbPosCntctrSeg3_635hIni_C "" VALUE 0x80257D3C Val_Wu16 600.0000 q8 0.00 600.0000 FORMAT "%8.4" EXTENDED_LIMITS 0.00 524280.0 /end CHARACTERISTIC
/begin CHARACTERISTIC Com_ctHvbPosCntctrSeg3_635hInvld_C "" VALUE 0x80257D3E Val_Wu8 127.0 OneToOne 0.00 127.0 FORMAT "%5.1" EXTENDED_LIMITS 0.00 255.0 /end CHARACTERISTIC
/begin CHARACTERISTIC Com_ctHvbPosCntctrSeg3_635hRcf_C "" VALUE 0x80257D40 Val_Wu16 600.0000 q8 0.00 600.0000 FORMAT "%8.4" EXTENDED_LIMITS 0.00 524280.0 /end CHARACTERISTIC
/begin CHARACTERISTIC Com_ctHvbPosCntctrSeg4_635hIni_C "" VALUE 0x80257D42 Val_Wu8 20.00 OneToOne 0.00 20.00 FORMAT "%5.2" EXTENDED_LIMITS 0.00 255.0 /end CHARACTERISTIC
/begin CHARACTERISTIC Com_ctHvbPosCntctrSeg4_635hInvld_C "" VALUE 0x80257D43 Val_Wu8 31.00 OneToOne 0.00 31.00 FORMAT "%5.2" EXTENDED_LIMITS 0.00 255.0 /end CHARACTERISTIC
/begin CHARACTERISTIC Com_ctHvbPosCntctrSeg4_635hRcf_C "" VALUE 0x80257D44 Val_Wu8 20.00 OneToOne 0.00 20.00 FORMAT "%5.2" EXTENDED_LIMITS 0.00 255.0 /end CHARACTERISTIC
/begin CHARACTERISTIC Com_ctHvbPosCntctrSeg5_635hIni_C "" VALUE 0x80257D45 Val_Wu8 1.000 OneToOne 0.00 1.000 FORMAT "%5.3" EXTENDED_LIMITS 0.00 255.0 /end CHARACTERISTIC
/begin CHARACTERISTIC Com_ctHvbPosCntctrSeg5_635hRcf_C "" VALUE 0x80257D46 Val_Wu8 1.000 OneToOne 0.00 1.000 FORMAT "%5.3" EXTENDED_LIMITS 0.00 255.0 /end CHARACTERISTIC
/begin CHARACTERISTIC Com_ctHvbPrecCntctrSeg1_645hIni_C "" VALUE 0x80257D48 Val_Wu32 100032.000000 q64 0.00 100032.000000 FORMAT "%13.6" EXTENDED_LIMITS 0.00 274877906880. /end CHARACTERISTIC
/begin CHARACTERISTIC Com_ctHvbPrecCntctrSeg1_645hInvld_C "" VALUE 0x80257D4C Val_Wu16 2047.000 OneToOne 0.00 2047.000 FORMAT "%8.3" EXTENDED_LIMITS 0.00 65535.00 /end CHARACTERISTIC
/begin CHARACTERISTIC Com_ctHvbPrecCntctrSeg1_645hRcf_C "" VALUE 0x80257D50 Val_Wu32 100032.000000 q64 0.00 100032.000000 FORMAT "%13.6" EXTENDED_LIMITS 0.00 274877906880. /end CHARACTERISTIC
/begin CHARACTERISTIC Com_ctHvbPrecCntctrSeg2_645hIni_C "" VALUE 0x80257D54 Val_Wu16 800.0000 q8 0.00 800.0000 FORMAT "%8.4" EXTENDED_LIMITS 0.00 524280.0 /end CHARACTERISTIC
/begin CHARACTERISTIC Com_ctHvbPrecCntctrSeg2_645hInvld_C "" VALUE 0x80257D56 Val_Wu8 127.0 OneToOne 0.00 127.0 FORMAT "%5.1" EXTENDED_LIMITS 0.00 255.0 /end CHARACTERISTIC
/begin CHARACTERISTIC Com_ctHvbPrecCntctrSeg2_645hRcf_C "" VALUE 0x80257D58 Val_Wu16 800.0000 q8 0.00 800.0000 FORMAT "%8.4" EXTENDED_LIMITS 0.00 524280.0 /end CHARACTERISTIC
/begin CHARACTERISTIC Com_DAT_TBMU_454_Tx_EIMode_C "" VALUE 0x80250097 RB_Val_Wboolean 1.00000000000 B_TRUE 0.00 1.00000000000 FORMAT "%13.11" /end CHARACTERISTIC
/begin CHARACTERISTIC Com_egyHvbAvl_fRx_543hIni_C "" VALUE 0x80257D5A Val_Wu16 65440.00 q16_W_h 0.00 65440.00 FORMAT "%8.2" EXTENDED_LIMITS 0.00 1048560. /end CHARACTERISTIC
/begin CHARACTERISTIC Com_egyHvbAvl_fRx_543hInvld_C "" VALUE 0x80257D5C Val_Wu16 2047.000 OneToOne 0.00 2047.000 FORMAT "%8.3" EXTENDED_LIMITS 0.00 65535.00 /end CHARACTERISTIC
/begin CHARACTERISTIC Com_egyHvbAvl_fRx_543hRcf_C "" VALUE 0x80257D5E Val_Wu16 65440.00 q16_W_h 0.00 65440.00 FORMAT "%8.2" EXTENDED_LIMITS 0.00 1048560. /end CHARACTERISTIC
/begin CHARACTERISTIC Com_E_VCU_522_Tx_EIMode_C "" VALUE 0x80250098 RB_Val_Wboolean 1.00000000000 B_TRUE 0.00 1.00000000000 FORMAT "%13.11" /end CHARACTERISTIC
/begin CHARACTERISTIC Com_flgBlowrAuthn_201hIni_C "" VALUE 0x80257D60 Val_Wu8 1.000 OneToOne 0.00 1.000 FORMAT "%5.3" EXTENDED_LIMITS 0.00 255.0 /end CHARACTERISTIC
/begin CHARACTERISTIC Com_flgBlowrRlyCtrl_221hIni_C "" VALUE 0x80257D61 Val_Wu8 1.000 OneToOne 0.00 1.000 FORMAT "%5.3" EXTENDED_LIMITS 0.00 255.0 /end CHARACTERISTIC
/begin CHARACTERISTIC Com_flgBrkAlrt_221hIni_C "" VALUE 0x80257D62 Val_Wu8 1.000 OneToOne 0.00 1.000 FORMAT "%5.3" EXTENDED_LIMITS 0.00 255.0 /end CHARACTERISTIC
/begin CHARACTERISTIC Com_flgBrkMaiDiag_412hIni_C "" VALUE 0x80257D63 Val_Wu8 1.00000000000 B_TRUE 0.00 1.00000000000 FORMAT "%13.11" /end CHARACTERISTIC
/begin CHARACTERISTIC Com_flgBrkMaiDiag_412hRcf_C "" VALUE 0x80257D64 Val_Wu8 1.00000000000 B_TRUE 0.00 1.00000000000 FORMAT "%13.11" /end CHARACTERISTIC
/begin CHARACTERISTIC Com_flgBrkMai_412hIni_C "" VALUE 0x80257D65 Val_Wu8 1.00000000000 B_TRUE 0.00 1.00000000000 FORMAT "%13.11" /end CHARACTERISTIC
/begin CHARACTERISTIC Com_flgBrkMai_412hRcf_C "" VALUE 0x80257D66 Val_Wu8 1.00000000000 B_TRUE 0.00 1.00000000000 FORMAT "%13.11" /end CHARACTERISTIC
/begin CHARACTERISTIC Com_flgCurMeasmtErr_318hIni_C "" VALUE 0x80257D67 Val_Wu8 1.00000000000 B_TRUE 0.00 1.00000000000 FORMAT "%13.11" /end CHARACTERISTIC
/begin CHARACTERISTIC Com_flgCurMeasmtErr_318hRcf_C "" VALUE 0x80257D68 Val_Wu8 1.00000000000 B_TRUE 0.00 1.00000000000 FORMAT "%13.11" /end CHARACTERISTIC
/begin CHARACTERISTIC Com_flgCurMeasmtSysErr_318hIni_C "" VALUE 0x80257D69 Val_Wu8 1.00000000000 B_TRUE 0.00 1.00000000000 FORMAT "%13.11" /end CHARACTERISTIC
/begin CHARACTERISTIC Com_flgCurMeasmtSysErr_318hRcf_C "" VALUE 0x80257D6A Val_Wu8 1.00000000000 B_TRUE 0.00 1.00000000000 FORMAT "%13.11" /end CHARACTERISTIC
/begin CHARACTERISTIC Com_flgCurMeasmtVld_318hIni_C "" VALUE 0x80257D6B Val_Wu8 1.00000000000 B_TRUE 0.00 1.00000000000 FORMAT "%13.11" /end CHARACTERISTIC
/begin CHARACTERISTIC Com_flgCurMeasmtVld_318hRcf_C "" VALUE 0x80257D6C Val_Wu8 1.00000000000 B_TRUE 0.00 1.00000000000 FORMAT "%13.11" /end CHARACTERISTIC
/begin CHARACTERISTIC Com_flgCurRngErr_318hIni_C "" VALUE 0x80257D6D Val_Wu8 1.00000000000 B_TRUE 0.00 1.00000000000 FORMAT "%13.11" /end CHARACTERISTIC
/begin CHARACTERISTIC Com_flgCurRngErr_318hRcf_C "" VALUE 0x80257D6E Val_Wu8 1.00000000000 B_TRUE 0.00 1.00000000000 FORMAT "%13.11" /end CHARACTERISTIC
/begin CHARACTERISTIC Com_flgDrvAwy_331hIni_C "" VALUE 0x80257D6F Val_Wu8 1.000 OneToOne 0.00 1.000 FORMAT "%5.3" EXTENDED_LIMITS 0.00 255.0 /end CHARACTERISTIC
/begin CHARACTERISTIC Com_flgEcoNormReqRx_259hIni_C "" VALUE 0x80257D70 Val_Wu8 3.000 OneToOne 0.00 3.000 FORMAT "%5.3" EXTENDED_LIMITS 0.00 255.0 /end CHARACTERISTIC
/begin CHARACTERISTIC Com_flgEcoNormReqRx_259hInvld_C "" VALUE 0x80257D71 Val_Wu8 3.000 OneToOne 0.00 3.000 FORMAT "%5.3" EXTENDED_LIMITS 0.00 255.0 /end CHARACTERISTIC
/begin CHARACTERISTIC Com_flgEcoNormReqRx_259hRcf_C "" VALUE 0x80257D72 Val_Wu8 3.000 OneToOne 0.00 3.000 FORMAT "%5.3" EXTENDED_LIMITS 0.00 255.0 /end CHARACTERISTIC
/begin CHARACTERISTIC Com_flgElCmprAbnormSpdFlt_48BhIni_C "" VALUE 0x80257D73 Val_Wu8 1.00000000000 B_TRUE 0.00 1.00000000000 FORMAT "%13.11" /end CHARACTERISTIC
/begin CHARACTERISTIC Com_flgElCmprAbnormSpdFlt_48BhRcf_C "" VALUE 0x80257D74 Val_Wu8 1.00000000000 B_TRUE 0.00 1.00000000000 FORMAT "%13.11" /end CHARACTERISTIC
/begin CHARACTERISTIC Com_flgElCmprCurSampleFailr_48BhIni_C "" VALUE 0x80257D75 Val_Wu8 1.00000000000 B_TRUE 0.00 1.00000000000 FORMAT "%13.11" /end CHARACTERISTIC
/begin CHARACTERISTIC Com_flgElCmprCurSampleFailr_48BhRcf_C "" VALUE 0x80257D76 Val_Wu8 1.00000000000 B_TRUE 0.00 1.00000000000 FORMAT "%13.11" /end CHARACTERISTIC
/begin CHARACTERISTIC Com_flgElCmprIgbtFailr_48BhIni_C "" VALUE 0x80257D77 Val_Wu8 1.00000000000 B_TRUE 0.00 1.00000000000 FORMAT "%13.11" /end CHARACTERISTIC
/begin CHARACTERISTIC Com_flgElCmprIgbtFailr_48BhRcf_C "" VALUE 0x80257D78 Val_Wu8 1.00000000000 B_TRUE 0.00 1.00000000000 FORMAT "%13.11" /end CHARACTERISTIC
/begin CHARACTERISTIC Com_flgElCmprLoUSplyFlt_48BhIni_C "" VALUE 0x80257D79 Val_Wu8 1.00000000000 B_TRUE 0.00 1.00000000000 FORMAT "%13.11" /end CHARACTERISTIC
/begin CHARACTERISTIC Com_flgElCmprLoUSplyFlt_48BhRcf_C "" VALUE 0x80257D7A Val_Wu8 1.00000000000 B_TRUE 0.00 1.00000000000 FORMAT "%13.11" /end CHARACTERISTIC
/begin CHARACTERISTIC Com_flgElCmprLoUUnderUFlt_48BhIni_C "" VALUE 0x80257D7B Val_Wu8 1.00000000000 B_TRUE 0.00 1.00000000000 FORMAT "%13.11" /end CHARACTERISTIC
/begin CHARACTERISTIC Com_flgElCmprLoUUnderUFlt_48BhRcf_C "" VALUE 0x80257D7C Val_Wu8 1.00000000000 B_TRUE 0.00 1.00000000000 FORMAT "%13.11" /end CHARACTERISTIC
/begin CHARACTERISTIC Com_flgElCmprOverCurFlt_48BhIni_C "" VALUE 0x80257D7D Val_Wu8 1.00000000000 B_TRUE 0.00 1.00000000000 FORMAT "%13.11" /end CHARACTERISTIC
/begin CHARACTERISTIC Com_flgElCmprOverCurFlt_48BhRcf_C "" VALUE 0x80257D7E Val_Wu8 1.00000000000 B_TRUE 0.00 1.00000000000 FORMAT "%13.11" /end CHARACTERISTIC
/begin CHARACTERISTIC Com_flgElCmprOverHeatFailr_48BhIni_C "" VALUE 0x80257D7F Val_Wu8 1.00000000000 B_TRUE 0.00 1.00000000000 FORMAT "%13.11" /end CHARACTERISTIC
/begin CHARACTERISTIC Com_flgElCmprOverHeatFailr_48BhRcf_C "" VALUE 0x80257D80 Val_Wu8 1.00000000000 B_TRUE 0.00 1.00000000000 FORMAT "%13.11" /end CHARACTERISTIC
/begin CHARACTERISTIC Com_flgElCmprOverLoad_48BhIni_C "" VALUE 0x80257D81 Val_Wu8 1.00000000000 B_TRUE 0.00 1.00000000000 FORMAT "%13.11" /end CHARACTERISTIC
/begin CHARACTERISTIC Com_flgElCmprOverLoad_48BhRcf_C "" VALUE 0x80257D82 Val_Wu8 1.00000000000 B_TRUE 0.00 1.00000000000 FORMAT "%13.11" /end CHARACTERISTIC
/begin CHARACTERISTIC Com_flgElCmprOverUFlt_48BhIni_C "" VALUE 0x80257D83 Val_Wu8 1.00000000000 B_TRUE 0.00 1.00000000000 FORMAT "%13.11" /end CHARACTERISTIC
/begin CHARACTERISTIC Com_flgElCmprOverUFlt_48BhRcf_C "" VALUE 0x80257D84 Val_Wu8 1.00000000000 B_TRUE 0.00 1.00000000000 FORMAT "%13.11" /end CHARACTERISTIC
/begin CHARACTERISTIC Com_flgElCmprOverUMalfct_48BhIni_C "" VALUE 0x80257D85 Val_Wu8 1.00000000000 B_TRUE 0.00 1.00000000000 FORMAT "%13.11" /end CHARACTERISTIC
/begin CHARACTERISTIC Com_flgElCmprOverUMalfct_48BhRcf_C "" VALUE 0x80257D86 Val_Wu8 1.00000000000 B_TRUE 0.00 1.00000000000 FORMAT "%13.11" /end CHARACTERISTIC
/begin CHARACTERISTIC Com_flgElCmprPhaFailr_48BhIni_C "" VALUE 0x80257D87 Val_Wu8 1.00000000000 B_TRUE 0.00 1.00000000000 FORMAT "%13.11" /end CHARACTERISTIC
/begin CHARACTERISTIC Com_flgElCmprPhaFailr_48BhRcf_C "" VALUE 0x80257D88 Val_Wu8 1.00000000000 B_TRUE 0.00 1.00000000000 FORMAT "%13.11" /end CHARACTERISTIC
/begin CHARACTERISTIC Com_flgElCmprStallFailr_48BhIni_C "" VALUE 0x80257D89 Val_Wu8 1.00000000000 B_TRUE 0.00 1.00000000000 FORMAT "%13.11" /end CHARACTERISTIC
/begin CHARACTERISTIC Com_flgElCmprStallFailr_48BhRcf_C "" VALUE 0x80257D8A Val_Wu8 1.00000000000 B_TRUE 0.00 1.00000000000 FORMAT "%13.11" /end CHARACTERISTIC
/begin CHARACTERISTIC Com_flgElCmprTSnsrFailr_48BhIni_C "" VALUE 0x80257D8B Val_Wu8 1.00000000000 B_TRUE 0.00 1.00000000000 FORMAT "%13.11" /end CHARACTERISTIC
/begin CHARACTERISTIC Com_flgElCmprTSnsrFailr_48BhRcf_C "" VALUE 0x80257D8C Val_Wu8 1.00000000000 B_TRUE 0.00 1.00000000000 FORMAT "%13.11" /end CHARACTERISTIC
/begin CHARACTERISTIC Com_flgGearLvrMovmt_259hIni_C "" VALUE 0x80257D8D Val_Wu8 1.00000000000 B_TRUE 0.00 1.00000000000 FORMAT "%13.11" /end CHARACTERISTIC
/begin CHARACTERISTIC Com_flgGearLvrMovmt_259hRcf_C "" VALUE 0x80257D8E Val_Wu8 1.00000000000 B_TRUE 0.00 1.00000000000 FORMAT "%13.11" /end CHARACTERISTIC
/begin CHARACTERISTIC Com_flgGunUnlckReq_082hIni_C "" VALUE 0x80257D8F Val_Wu8 1.00000000000 B_TRUE 0.00 1.00000000000 FORMAT "%13.11" /end CHARACTERISTIC
/begin CHARACTERISTIC Com_flgGunUnlckReq_082hRcf_C "" VALUE 0x80257D90 Val_Wu8 1.00000000000 B_TRUE 0.00 1.00000000000 FORMAT "%13.11" /end CHARACTERISTIC
/begin CHARACTERISTIC Com_flgHvBattAuthn_325hIni_C "" VALUE 0x80257D91 Val_Wu8 1.00000000000 B_TRUE 0.00 1.00000000000 FORMAT "%13.11" /end CHARACTERISTIC
/begin CHARACTERISTIC Com_flgHvBattAuthn_325hRcf_C "" VALUE 0x80257D92 Val_Wu8 1.00000000000 B_TRUE 0.00 1.00000000000 FORMAT "%13.11" /end CHARACTERISTIC
/begin CHARACTERISTIC Com_flgPDUProgmFailr_308hIni_C "" VALUE 0x80257D93 Val_Wu8 1.00000000000 B_TRUE 0.00 1.00000000000 FORMAT "%13.11" /end CHARACTERISTIC
/begin CHARACTERISTIC Com_flgPDUProgmFailr_308hRcf_C "" VALUE 0x80257D94 Val_Wu8 1.00000000000 B_TRUE 0.00 1.00000000000 FORMAT "%13.11" /end CHARACTERISTIC
/begin CHARACTERISTIC Com_flgRstTripAEE_432hIni_C "" VALUE 0x80257D95 Val_Wu8 1.00000000000 B_TRUE 0.00 1.00000000000 FORMAT "%13.11" /end CHARACTERISTIC
/begin CHARACTERISTIC Com_flgRstTripAEE_432hRcf_C "" VALUE 0x80257D96 Val_Wu8 1.00000000000 B_TRUE 0.00 1.00000000000 FORMAT "%13.11" /end CHARACTERISTIC
/begin CHARACTERISTIC Com_flgRstTripAEE_A_5E7hIni_C "" VALUE 0x80257D97 Val_Wu8 1.00000000000 B_TRUE 0.00 1.00000000000 FORMAT "%13.11" /end CHARACTERISTIC
/begin CHARACTERISTIC Com_flgRstTripAEE_A_5E7hRcf_C "" VALUE 0x80257D98 Val_Wu8 1.00000000000 B_TRUE 0.00 1.00000000000 FORMAT "%13.11" /end CHARACTERISTIC
/begin CHARACTERISTIC Com_flgRstTripAEE_B_5E7hIni_C "" VALUE 0x80257D99 Val_Wu8 1.00000000000 B_TRUE 0.00 1.00000000000 FORMAT "%13.11" /end CHARACTERISTIC
/begin CHARACTERISTIC Com_flgRstTripAEE_B_5E7hRcf_C "" VALUE 0x80257D9A Val_Wu8 1.00000000000 B_TRUE 0.00 1.00000000000 FORMAT "%13.11" /end CHARACTERISTIC
/begin CHARACTERISTIC Com_flgTPcbMeasmtErr_308hIni_C "" VALUE 0x80257D9B Val_Wu8 1.00000000000 B_TRUE 0.00 1.00000000000 FORMAT "%13.11" /end CHARACTERISTIC
/begin CHARACTERISTIC Com_flgTPcbMeasmtErr_308hRcf_C "" VALUE 0x80257D9C Val_Wu8 1.00000000000 B_TRUE 0.00 1.00000000000 FORMAT "%13.11" /end CHARACTERISTIC
/begin CHARACTERISTIC Com_flgTPcbMeasmtVld_308hIni_C "" VALUE 0x80257D9D Val_Wu8 1.00000000000 B_TRUE 0.00 1.00000000000 FORMAT "%13.11" /end CHARACTERISTIC
/begin CHARACTERISTIC Com_flgTPcbMeasmtVld_308hRcf_C "" VALUE 0x80257D9E Val_Wu8 1.00000000000 B_TRUE 0.00 1.00000000000 FORMAT "%13.11" /end CHARACTERISTIC
/begin CHARACTERISTIC Com_flgTPcbRngErr_308hIni_C "" VALUE 0x80257D9F Val_Wu8 1.00000000000 B_TRUE 0.00 1.00000000000 FORMAT "%13.11" /end CHARACTERISTIC
/begin CHARACTERISTIC Com_flgTPcbRngErr_308hRcf_C "" VALUE 0x80257DA0 Val_Wu8 1.00000000000 B_TRUE 0.00 1.00000000000 FORMAT "%13.11" /end CHARACTERISTIC
/begin CHARACTERISTIC Com_flgTPcbSysErr_308hIni_C "" VALUE 0x80257DA1 Val_Wu8 1.00000000000 B_TRUE 0.00 1.00000000000 FORMAT "%13.11" /end CHARACTERISTIC
/begin CHARACTERISTIC Com_flgTPcbSysErr_308hRcf_C "" VALUE 0x80257DA2 Val_Wu8 1.00000000000 B_TRUE 0.00 1.00000000000 FORMAT "%13.11" /end CHARACTERISTIC
/begin CHARACTERISTIC Com_flgTShntMeasmtErr_318hIni_C "" VALUE 0x80257DA3 Val_Wu8 1.00000000000 B_TRUE 0.00 1.00000000000 FORMAT "%13.11" /end CHARACTERISTIC
/begin CHARACTERISTIC Com_flgTShntMeasmtErr_318hRcf_C "" VALUE 0x80257DA4 Val_Wu8 1.00000000000 B_TRUE 0.00 1.00000000000 FORMAT "%13.11" /end CHARACTERISTIC
/begin CHARACTERISTIC Com_flgTShntMeasmtVld_318hIni_C "" VALUE 0x80257DA5 Val_Wu8 1.00000000000 B_TRUE 0.00 1.00000000000 FORMAT "%13.11" /end CHARACTERISTIC
/begin CHARACTERISTIC Com_flgTShntMeasmtVld_318hRcf_C "" VALUE 0x80257DA6 Val_Wu8 1.00000000000 B_TRUE 0.00 1.00000000000 FORMAT "%13.11" /end CHARACTERISTIC
/begin CHARACTERISTIC Com_flgTShntRngErr_318hIni_C "" VALUE 0x80257DA7 Val_Wu8 1.00000000000 B_TRUE 0.00 1.00000000000 FORMAT "%13.11" /end CHARACTERISTIC
/begin CHARACTERISTIC Com_flgTShntRngErr_318hRcf_C "" VALUE 0x80257DA8 Val_Wu8 1.00000000000 B_TRUE 0.00 1.00000000000 FORMAT "%13.11" /end CHARACTERISTIC
/begin CHARACTERISTIC Com_flgTShntSysErr_318hIni_C "" VALUE 0x80257DA9 Val_Wu8 1.00000000000 B_TRUE 0.00 1.00000000000 FORMAT "%13.11" /end CHARACTERISTIC
/begin CHARACTERISTIC Com_flgTShntSysErr_318hRcf_C "" VALUE 0x80257DAA Val_Wu8 1.00000000000 B_TRUE 0.00 1.00000000000 FORMAT "%13.11" /end CHARACTERISTIC
/begin CHARACTERISTIC Com_flgVehSpdAvl_38DhIni_C "" VALUE 0x80257DAB Val_Wu8 3.000 OneToOne 0.00 3.000 FORMAT "%5.3" EXTENDED_LIMITS 0.00 255.0 /end CHARACTERISTIC
/begin CHARACTERISTIC Com_flgVehSpdAvl_38DhInvld1_C "" VALUE 0x80257DAC Val_Wu8 3.000 OneToOne 0.00 3.000 FORMAT "%5.3" EXTENDED_LIMITS 0.00 255.0 /end CHARACTERISTIC
/begin MEASUREMENT Com_ctClcProc201 "counter for frame 201" UBYTE OneToOne 1 100 0.00 15.00 FORMAT "%5.2" ECU_ADDRESS 0x600231A1 /end MEASUREMENT
/begin MEASUREMENT Com_ctClcProc205 "counter for frame 205" UBYTE OneToOne 1 100 0.00 15.00 FORMAT "%5.2" ECU_ADDRESS 0x600231A0 /end MEASUREMENT
/begin MEASUREMENT Com_ctClcProc208 "counter for frame 208" UBYTE OneToOne 1 100 0.00 15.00 FORMAT "%5.2" ECU_ADDRESS 0x6002319F /end MEASUREMENT
/begin MEASUREMENT Com_ctClcProc211 "counter for frame 211" UBYTE OneToOne 1 100 0.00 15.00 FORMAT "%5.2" ECU_ADDRESS 0x6002319E /end MEASUREMENT
/begin MEASUREMENT Com_ctClcProc217 "SW variable to store 0x217 CPT value" UBYTE OneToOne 1 100 0.00 15.00 FORMAT "%5.2" ECU_ADDRESS 0x6002319D /end MEASUREMENT
/begin MEASUREMENT Com_ctClcProc219 "counter for frame 219" UBYTE OneToOne 1 100 0.00 15.00 FORMAT "%5.2" ECU_ADDRESS 0x6002319C /end MEASUREMENT
/begin MEASUREMENT Com_ctClcProc221 "counter for frame 221" UBYTE OneToOne 1 100 0.00 15.00 FORMAT "%5.2" ECU_ADDRESS 0x6002319B /end MEASUREMENT
/begin MEASUREMENT Com_ctClcProc237 "Counter for 0x237 frame" UBYTE OneToOne 1 100 0.00 15.00 FORMAT "%5.2" ECU_ADDRESS 0x6002319A /end MEASUREMENT
/begin MEASUREMENT Com_ctClcProc241 "counter for frame 241" UBYTE OneToOne 1 100 0.00 15.00 FORMAT "%5.2" ECU_ADDRESS 0x60023199 /end MEASUREMENT
/begin MEASUREMENT Com_ctClcProc259 "counter for frame 259" UBYTE OneToOne 1 100 0.00 15.00 FORMAT "%5.2" ECU_ADDRESS 0x60023198 /end MEASUREMENT
/begin MEASUREMENT Com_ctClcProc273 "Counter for 0x273 frame" UBYTE OneToOne 1 100 0.00 15.00 FORMAT "%5.2" ECU_ADDRESS 0x60023197 /end MEASUREMENT
/begin MEASUREMENT Com_ctClcProc275 "Counter for 275" UBYTE OneToOne 1 100 0.00 15.00 FORMAT "%5.2" ECU_ADDRESS 0x60023196 /end MEASUREMENT
/begin MEASUREMENT Com_ctClcProc281 "Counter for 0x281 frame" UBYTE OneToOne 1 100 0.00 15.00 FORMAT "%5.2" ECU_ADDRESS 0x60023195 /end MEASUREMENT
/begin MEASUREMENT Com_ctClcProc285 "Counter for 285" UBYTE OneToOne 1 100 0.00 15.00 FORMAT "%5.2" ECU_ADDRESS 0x60023194 /end MEASUREMENT
/begin MEASUREMENT Com_ctClcProc293 "Counter for 0x293 frame" UBYTE OneToOne 1 100 0.00 15.00 FORMAT "%5.2" ECU_ADDRESS 0x60023193 /end MEASUREMENT
/begin MEASUREMENT Com_ctClcProc308 "counter for frame 308" UBYTE OneToOne 1 100 0.00 15.00 FORMAT "%5.2" ECU_ADDRESS 0x60023192 /end MEASUREMENT
/begin MEASUREMENT Com_ctClcProc318 "counter for frame 318" UBYTE OneToOne 1 100 0.00 15.00 FORMAT "%5.2" ECU_ADDRESS 0x60023191 /end MEASUREMENT
/begin MEASUREMENT Com_ctClcProc325 "Counter for 325" UBYTE OneToOne 1 100 0.00 15.00 FORMAT "%5.2" ECU_ADDRESS 0x60023190 /end MEASUREMENT
/begin MEASUREMENT Com_ctClcProc335 "counter for frame 335" UBYTE OneToOne 1 100 0.00 15.00 FORMAT "%5.2" ECU_ADDRESS 0x6002318F /end MEASUREMENT
/begin MEASUREMENT Com_ctClcProc38D "counter for frame 38d" UBYTE OneToOne 1 100 0.00 15.00 FORMAT "%5.2" ECU_ADDRESS 0x6002318E /end MEASUREMENT
/begin MEASUREMENT Com_ctClcProc412 "Counter for 412" UBYTE OneToOne 1 100 0.00 15.00 FORMAT "%5.2" ECU_ADDRESS 0x6002318D /end MEASUREMENT
/begin MEASUREMENT Com_ctClcProc432 "counter for frame 432" UBYTE OneToOne 1 100 0.00 15.00 FORMAT "%5.2" ECU_ADDRESS 0x6002318C /end MEASUREMENT
/begin MEASUREMENT Com_ctClcProc4F2 "Counter for 4F2" UBYTE OneToOne 1 100 0.00 15.00 FORMAT "%5.2" ECU_ADDRESS 0x6002318B /end MEASUREMENT
/begin MEASUREMENT Com_ctClcProc592 "Counter for 592" UBYTE OneToOne 1 100 0.00 15.00 FORMAT "%5.2" ECU_ADDRESS 0x6002318A /end MEASUREMENT
/begin MEASUREMENT Com_ctClcProc595 "Counter for 595" UBYTE OneToOne 1 100 0.00 15.00 FORMAT "%5.2" ECU_ADDRESS 0x60023189 /end MEASUREMENT
/begin MEASUREMENT Com_ctClcProc5B5 "Counter for5B5" UBYTE OneToOne 1 100 0.00 15.00 FORMAT "%5.2" ECU_ADDRESS 0x60023188 /end MEASUREMENT
/begin MEASUREMENT Com_noCks201 "checksum for frame 201" UBYTE OneToOne 1 100 0.00 15.00 FORMAT "%5.2" ECU_ADDRESS 0x60023187 /end MEASUREMENT
/begin MEASUREMENT Com_noCks205 "checksum for frame 205" UBYTE OneToOne 1 100 0.00 15.00 FORMAT "%5.2" ECU_ADDRESS 0x60023186 /end MEASUREMENT
/begin MEASUREMENT Com_noCks208 "checksum for frame 208" UBYTE OneToOne 1 100 0.00 15.00 FORMAT "%5.2" ECU_ADDRESS 0x60023185 /end MEASUREMENT
/begin MEASUREMENT Com_noCks211 "checksum for frame 211" UBYTE OneToOne 1 100 0.00 15.00 FORMAT "%5.2" ECU_ADDRESS 0x60023184 /end MEASUREMENT
/begin MEASUREMENT Com_noCks217 "SW variable to store 0x217 CHK value" UBYTE OneToOne 1 100 0.00 15.00 FORMAT "%5.2" ECU_ADDRESS 0x60023183 /end MEASUREMENT
/begin MEASUREMENT Com_noCks219 "checksum for frame 219" UBYTE OneToOne 1 100 0.00 15.00 FORMAT "%5.2" ECU_ADDRESS 0x60023182 /end MEASUREMENT
/begin MEASUREMENT Com_noCks221 "checksum for frame 221" UBYTE OneToOne 1 100 0.00 15.00 FORMAT "%5.2" ECU_ADDRESS 0x60023181 /end MEASUREMENT
/begin MEASUREMENT Com_noCks237 "Chksum for 0x237 frame" UBYTE OneToOne 1 100 0.00 15.00 FORMAT "%5.2" ECU_ADDRESS 0x60023180 /end MEASUREMENT
/begin MEASUREMENT Com_noCks241 "checksum for frame 241" UBYTE OneToOne 1 100 0.00 15.00 FORMAT "%5.2" ECU_ADDRESS 0x6002317F /end MEASUREMENT
/begin MEASUREMENT Com_noCks259 "checksum for frame 259" UBYTE OneToOne 1 100 0.00 15.00 FORMAT "%5.2" ECU_ADDRESS 0x6002317E /end MEASUREMENT
/begin MEASUREMENT Com_noCks273 "Chksum for 0x273frame" UBYTE OneToOne 1 100 0.00 15.00 FORMAT "%5.2" ECU_ADDRESS 0x6002317D /end MEASUREMENT
/begin MEASUREMENT Com_noCks275 "Checksum for 275" UBYTE OneToOne 1 100 0.00 15.00 FORMAT "%5.2" ECU_ADDRESS 0x6002317C /end MEASUREMENT
/begin MEASUREMENT Com_noCks281 "Chksum for 0x281frame" UBYTE OneToOne 1 100 0.00 15.00 FORMAT "%5.2" ECU_ADDRESS 0x6002317B /end MEASUREMENT
/begin MEASUREMENT Com_noCks285 "Checksum for 285" UBYTE OneToOne 1 100 0.00 15.00 FORMAT "%5.2" ECU_ADDRESS 0x6002317A /end MEASUREMENT
/begin MEASUREMENT Com_noCks293 "Chksum for 0x293frame" UBYTE OneToOne 1 100 0.00 15.00 FORMAT "%5.2" ECU_ADDRESS 0x60023179 /end MEASUREMENT
/begin MEASUREMENT Com_noCks308 "checksum for frame 308" UBYTE OneToOne 1 100 0.00 15.00 FORMAT "%5.2" ECU_ADDRESS 0x60023178 /end MEASUREMENT
/begin MEASUREMENT Com_noCks318 "checksum for frame 318" UBYTE OneToOne 1 100 0.00 15.00 FORMAT "%5.2" ECU_ADDRESS 0x60023177 /end MEASUREMENT
/begin MEASUREMENT Com_noCks325 "Checksum for325" UBYTE OneToOne 1 100 0.00 15.00 FORMAT "%5.2" ECU_ADDRESS 0x60023176 /end MEASUREMENT
/begin MEASUREMENT Com_noCks335 "checksum for frame 335" UBYTE OneToOne 1 100 0.00 15.00 FORMAT "%5.2" ECU_ADDRESS 0x60023175 /end MEASUREMENT
/begin MEASUREMENT Com_noCks38D "checksum for frame 38d" UBYTE OneToOne 1 100 0.00 15.00 FORMAT "%5.2" ECU_ADDRESS 0x60023174 /end MEASUREMENT
/begin MEASUREMENT Com_noCks412 "Checksum for 412" UBYTE OneToOne 1 100 0.00 15.00 FORMAT "%5.2" ECU_ADDRESS 0x60023173 /end MEASUREMENT
/begin MEASUREMENT Com_noCks432 "checksum for frame 432" UBYTE OneToOne 1 100 0.00 15.00 FORMAT "%5.2" ECU_ADDRESS 0x60023172 /end MEASUREMENT
/begin MEASUREMENT Com_noCks4F2 "Checksum for4F2" UBYTE OneToOne 1 100 0.00 15.00 FORMAT "%5.2" ECU_ADDRESS 0x60023171 /end MEASUREMENT
/begin MEASUREMENT Com_noCks592 "Checksum for592" UBYTE OneToOne 1 100 0.00 15.00 FORMAT "%5.2" ECU_ADDRESS 0x60023170 /end MEASUREMENT
/begin MEASUREMENT Com_noCks595 "Checksum for595" UBYTE OneToOne 1 100 0.00 15.00 FORMAT "%5.2" ECU_ADDRESS 0x6002316F /end MEASUREMENT
/begin MEASUREMENT Com_noCks5B5 "Checksum for5B5" UBYTE OneToOne 1 100 0.00 15.00 FORMAT "%5.2" ECU_ADDRESS 0x6002316E /end MEASUREMENT
/begin MEASUREMENT DINH_stFId.FId_bInhDiag_DCDC_473h "" UWORD DFC_OneToOne 1 100 0.00 65535.00 FORMAT "%8.2" ECU_ADDRESS 0x6002161C /end MEASUREMENT
/begin MEASUREMENT DINH_stFId.FId_bInhDiag_DCDC_663h "" UWORD DFC_OneToOne 1 100 0.00 65535.00 FORMAT "%8.2" ECU_ADDRESS 0x6002161E /end MEASUREMENT
/begin MEASUREMENT DINH_stFId.FId_bInhDiag_HS3_AUTO_GEARBOX_SWITCH_STATUS "" UWORD DFC_OneToOne 1 100 0.00 65535.00 FORMAT "%8.2" ECU_ADDRESS 0x60021620 /end MEASUREMENT
/begin MEASUREMENT DINH_stFId.FId_bInhDiag_HVAC_PANEL_26h "" UWORD DFC_OneToOne 1 100 0.00 65535.00 FORMAT "%8.2" ECU_ADDRESS 0x60021622 /end MEASUREMENT
/begin MEASUREMENT DINH_stFId.FId_bInhDiag_HVBAT_205h "" UWORD DFC_OneToOne 1 100 0.00 65535.00 FORMAT "%8.2" ECU_ADDRESS 0x60021624 /end MEASUREMENT
/begin MEASUREMENT DINH_stFId.FId_bInhDiag_HVBAT_275h "" UWORD DFC_OneToOne 1 100 0.00 65535.00 FORMAT "%8.2" ECU_ADDRESS 0x60021626 /end MEASUREMENT
/begin MEASUREMENT DINH_stFId.FId_bInhDiag_HVBAT_285h "" UWORD DFC_OneToOne 1 100 0.00 65535.00 FORMAT "%8.2" ECU_ADDRESS 0x60021628 /end MEASUREMENT
/begin MEASUREMENT DINH_stFId.FId_bInhDiag_HVBAT_325h "" UWORD DFC_OneToOne 1 100 0.00 65535.00 FORMAT "%8.2" ECU_ADDRESS 0x6002162A /end MEASUREMENT
/begin MEASUREMENT DINH_stFId.FId_bInhDiag_HVBAT_335h "" UWORD DFC_OneToOne 1 100 0.00 65535.00 FORMAT "%8.2" ECU_ADDRESS 0x6002162C /end MEASUREMENT
/begin MEASUREMENT DINH_stFId.FId_bInhDiag_HVBAT_455h "" UWORD DFC_OneToOne 1 100 0.00 65535.00 FORMAT "%8.2" ECU_ADDRESS 0x6002162E /end MEASUREMENT
/begin MEASUREMENT DINH_stFId.FId_bInhDiag_HVBAT_535 "" UWORD DFC_OneToOne 1 100 0.00 65535.00 FORMAT "%8.2" ECU_ADDRESS 0x60021630 /end MEASUREMENT
/begin MEASUREMENT DINH_stFId.FId_bInhDiag_HVBAT_595h "" UWORD DFC_OneToOne 1 100 0.00 65535.00 FORMAT "%8.2" ECU_ADDRESS 0x60021632 /end MEASUREMENT
/begin MEASUREMENT DINH_stFId.FId_bInhDiag_HVBAT_635h "" UWORD DFC_OneToOne 1 100 0.00 65535.00 FORMAT "%8.2" ECU_ADDRESS 0x60021634 /end MEASUREMENT
/begin MEASUREMENT DINH_stFId.FId_bInhDiag_HVBAT_645h "" UWORD DFC_OneToOne 1 100 0.00 65535.00 FORMAT "%8.2" ECU_ADDRESS 0x60021636 /end MEASUREMENT
/begin MEASUREMENT DINH_stFId.FId_bInhDiag_HVBAT_665h "" UWORD DFC_OneToOne 1 100 0.00 65535.00 FORMAT "%8.2" ECU_ADDRESS 0x60021638 /end MEASUREMENT
/begin MEASUREMENT DINH_stFId.FId_bInhDiag_HVBAT_675h "" UWORD DFC_OneToOne 1 100 0.00 65535.00 FORMAT "%8.2" ECU_ADDRESS 0x6002163A /end MEASUREMENT
/begin MEASUREMENT DINH_stFId.FId_bInhDiag_HVBAT_THERMAL_5B5 "" UWORD DFC_OneToOne 1 100 0.00 65535.00 FORMAT "%8.2" ECU_ADDRESS 0x6002163C /end MEASUREMENT
/begin MEASUREMENT DINH_stFId.FId_bInhDiag_HVBAT_VCU_435h "" UWORD DFC_OneToOne 1 100 0.00 65535.00 FORMAT "%8.2" ECU_ADDRESS 0x6002163E /end MEASUREMENT
/begin MEASUREMENT DINH_stFId.FId_bInhDiag_HVBAT_VCU_543 "" UWORD DFC_OneToOne 1 100 0.00 65535.00 FORMAT "%8.2" ECU_ADDRESS 0x60021640 /end MEASUREMENT
/begin MEASUREMENT DINH_stFId.FId_bInhDiag_HVBAT_VCU_583 "" UWORD DFC_OneToOne 1 100 0.00 65535.00 FORMAT "%8.2" ECU_ADDRESS 0x60021642 /end MEASUREMENT
/begin MEASUREMENT DINH_stFId.FId_bInhDiag_INV_217h "" UWORD DFC_OneToOne 1 100 0.00 65535.00 FORMAT "%8.2" ECU_ADDRESS 0x60021644 /end MEASUREMENT
/begin MEASUREMENT DINH_stFId.FId_bInhDiag_INV_227h "" UWORD DFC_OneToOne 1 100 0.00 65535.00 FORMAT "%8.2" ECU_ADDRESS 0x60021646 /end MEASUREMENT
/begin MEASUREMENT DINH_stFId.FId_bInhDiag_INV_237 "" UWORD DFC_OneToOne 1 100 0.00 65535.00 FORMAT "%8.2" ECU_ADDRESS 0x60021648 /end MEASUREMENT
/begin MEASUREMENT DINH_stFId.FId_bInhDiag_INV_427h "" UWORD DFC_OneToOne 1 100 0.00 65535.00 FORMAT "%8.2" ECU_ADDRESS 0x6002164A /end MEASUREMENT
/begin MEASUREMENT DINH_stFId.FId_bInhDiag_INV_497h "" UWORD DFC_OneToOne 1 100 0.00 65535.00 FORMAT "%8.2" ECU_ADDRESS 0x6002164C /end MEASUREMENT
/begin MEASUREMENT DINH_stFId.FId_bInhDiag_INV_IMMO_5C7 "" UWORD DFC_OneToOne 1 100 0.00 65535.00 FORMAT "%8.2" ECU_ADDRESS 0x6002164E /end MEASUREMENT
/begin MEASUREMENT DINH_stFId.FId_bInhDiag_IS_DAT6_BSI_592h "" UWORD DFC_OneToOne 1 100 0.00 65535.00 FORMAT "%8.2" ECU_ADDRESS 0x60021650 /end MEASUREMENT
/begin MEASUREMENT DINH_stFId.FId_bInhDiag_IS_DAT_ABR_50Dh "" UWORD DFC_OneToOne 1 100 0.00 65535.00 FORMAT "%8.2" ECU_ADDRESS 0x60021652 /end MEASUREMENT
/begin MEASUREMENT DINH_stFId.FId_bInhDiag_IS_DAT_BSI_412h "" UWORD DFC_OneToOne 1 100 0.00 65535.00 FORMAT "%8.2" ECU_ADDRESS 0x60021654 /end MEASUREMENT
/begin MEASUREMENT DINH_stFId.FId_bInhDiag_IS_DYN_ABR_38Dh "" UWORD DFC_OneToOne 1 100 0.00 65535.00 FORMAT "%8.2" ECU_ADDRESS 0x60021656 /end MEASUREMENT
/begin MEASUREMENT DINH_stFId.FId_bInhDiag_IS_INTE_ELECTRON_BSI_092h "" UWORD DFC_OneToOne 1 100 0.00 65535.00 FORMAT "%8.2" ECU_ADDRESS 0x60021658 /end MEASUREMENT
/begin MEASUREMENT DINH_stFId.FId_bInhDiag_OBC_273h "" UWORD DFC_OneToOne 1 100 0.00 65535.00 FORMAT "%8.2" ECU_ADDRESS 0x6002165A /end MEASUREMENT
/begin MEASUREMENT DINH_stFId.FId_bInhDiag_OBC_453h "" UWORD DFC_OneToOne 1 100 0.00 65535.00 FORMAT "%8.2" ECU_ADDRESS 0x6002165C /end MEASUREMENT
/begin MEASUREMENT DINH_stFId.FId_bInhDiag_OBC_463h "" UWORD DFC_OneToOne 1 100 0.00 65535.00 FORMAT "%8.2" ECU_ADDRESS 0x6002165E /end MEASUREMENT
/begin MEASUREMENT DINH_stFId.FId_bInhDiag_PDU_BusVoltages_308 "" UWORD DFC_OneToOne 1 100 0.00 65535.00 FORMAT "%8.2" ECU_ADDRESS 0x60021660 /end MEASUREMENT
/begin MEASUREMENT DINH_stFId.FId_bInhDiag_PDU_Current_318 "" UWORD DFC_OneToOne 1 100 0.00 65535.00 FORMAT "%8.2" ECU_ADDRESS 0x60021662 /end MEASUREMENT
/begin MEASUREMENT DINH_stFId.FId_bInhDiag_SC_INFO_BCCM_442h "" UWORD DFC_OneToOne 1 100 0.00 65535.00 FORMAT "%8.2" ECU_ADDRESS 0x60021664 /end MEASUREMENT
/begin MEASUREMENT DINH_stFId.FId_bInhDiag_VCU_AIRBAG_351h "" UWORD DFC_OneToOne 1 100 0.00 65535.00 FORMAT "%8.2" ECU_ADDRESS 0x60021666 /end MEASUREMENT
/begin MEASUREMENT DINH_stFId.FId_bInhDiag_VCU_eBCCM_432h "" UWORD DFC_OneToOne 1 100 0.00 65535.00 FORMAT "%8.2" ECU_ADDRESS 0x60021668 /end MEASUREMENT
/begin MEASUREMENT DINH_stFId.FId_bInhDiag_VCU_eBCCM_552h "" UWORD DFC_OneToOne 1 100 0.00 65535.00 FORMAT "%8.2" ECU_ADDRESS 0x6002166A /end MEASUREMENT
/begin MEASUREMENT DINH_stFId.FId_bInhDiag_eBCCM_082h "" UWORD DFC_OneToOne 1 100 0.00 65535.00 FORMAT "%8.2" ECU_ADDRESS 0x6002166C /end MEASUREMENT
/begin MEASUREMENT DINH_stFId.FId_bInhDiag_eCOMP_Information_47B "" UWORD DFC_OneToOne 1 100 0.00 65535.00 FORMAT "%8.2" ECU_ADDRESS 0x6002166E /end MEASUREMENT
/begin MEASUREMENT DINH_stFId.FId_bInhDiag_eCOMP_Information_48B "" UWORD DFC_OneToOne 1 100 0.00 65535.00 FORMAT "%8.2" ECU_ADDRESS 0x60021670 /end MEASUREMENT
/begin MEASUREMENT DINH_stFId.FId_bInhFrbd_ComChrgr_iAcMax "" UWORD DFC_OneToOne 1 100 0.00 65535.00 FORMAT "%8.2" ECU_ADDRESS 0x60021672 /end MEASUREMENT
/begin MEASUREMENT DINH_stFId.FId_bInhFrbd_ComChrgr_iDcHvAct "" UWORD DFC_OneToOne 1 100 0.00 65535.00 FORMAT "%8.2" ECU_ADDRESS 0x60021674 /end MEASUREMENT
/begin MEASUREMENT DINH_stFId.FId_bInhFrbd_ComChrgr_pwrInAct "" UWORD DFC_OneToOne 1 100 0.00 65535.00 FORMAT "%8.2" ECU_ADDRESS 0x60021676 /end MEASUREMENT
/begin MEASUREMENT DINH_stFId.FId_bInhFrbd_ComChrgr_pwrOutpCpby "" UWORD DFC_OneToOne 1 100 0.00 65535.00 FORMAT "%8.2" ECU_ADDRESS 0x60021678 /end MEASUREMENT
/begin MEASUREMENT DINH_stFId.FId_bInhFrbd_ComChrgr_tChrgrMaxAct "" UWORD DFC_OneToOne 1 100 0.00 65535.00 FORMAT "%8.2" ECU_ADDRESS 0x6002167A /end MEASUREMENT
/begin MEASUREMENT DINH_stFId.FId_bInhFrbd_ComChrgr_uAcActL1 "" UWORD DFC_OneToOne 1 100 0.00 65535.00 FORMAT "%8.2" ECU_ADDRESS 0x6002167C /end MEASUREMENT
/begin MEASUREMENT DINH_stFId.FId_bInhFrbd_ComChrgr_uDcHvAct "" UWORD DFC_OneToOne 1 100 0.00 65535.00 FORMAT "%8.2" ECU_ADDRESS 0x6002167E /end MEASUREMENT
/begin MEASUREMENT DINH_stFId.FId_bInhFrbd_ComEmac_iDcLnk01 "" UWORD DFC_OneToOne 1 100 0.00 65535.00 FORMAT "%8.2" ECU_ADDRESS 0x60021680 /end MEASUREMENT
/begin MEASUREMENT DINH_stFId.FId_bInhFrbd_ComEmac_nAct01 "" UWORD DFC_OneToOne 1 100 0.00 65535.00 FORMAT "%8.2" ECU_ADDRESS 0x60021682 /end MEASUREMENT
/begin MEASUREMENT DINH_stFId.FId_bInhFrbd_ComEmac_pwrInstnsInpRx "" UWORD DFC_OneToOne 1 100 0.00 65535.00 FORMAT "%8.2" ECU_ADDRESS 0x60021684 /end MEASUREMENT
/begin MEASUREMENT DINH_stFId.FId_bInhFrbd_ComEmac_stActvDcha "" UWORD DFC_OneToOne 1 100 0.00 65535.00 FORMAT "%8.2" ECU_ADDRESS 0x60021686 /end MEASUREMENT
/begin MEASUREMENT DINH_stFId.FId_bInhFrbd_ComEmac_stEVLmp "" UWORD DFC_OneToOne 1 100 0.00 65535.00 FORMAT "%8.2" ECU_ADDRESS 0x60021688 /end MEASUREMENT
/begin MEASUREMENT DINH_stFId.FId_bInhFrbd_ComEmac_stIvtrOpMod01 "" UWORD DFC_OneToOne 1 100 0.00 65535.00 FORMAT "%8.2" ECU_ADDRESS 0x6002168A /end MEASUREMENT
/begin MEASUREMENT DINH_stFId.FId_bInhFrbd_ComEmac_stMod01Rx "" UWORD DFC_OneToOne 1 100 0.00 65535.00 FORMAT "%8.2" ECU_ADDRESS 0x6002168C /end MEASUREMENT
/begin MEASUREMENT DINH_stFId.FId_bInhFrbd_ComEmac_stMstWrnLmp "" UWORD DFC_OneToOne 1 100 0.00 65535.00 FORMAT "%8.2" ECU_ADDRESS 0x6002168E /end MEASUREMENT
/begin MEASUREMENT DINH_stFId.FId_bInhFrbd_ComEmac_stSVSLmp "" UWORD DFC_OneToOne 1 100 0.00 65535.00 FORMAT "%8.2" ECU_ADDRESS 0x60021690 /end MEASUREMENT
/begin MEASUREMENT DINH_stFId.FId_bInhFrbd_ComEmac_tqAbsltMax01 "" UWORD DFC_OneToOne 1 100 0.00 65535.00 FORMAT "%8.2" ECU_ADDRESS 0x60021692 /end MEASUREMENT
/begin MEASUREMENT DINH_stFId.FId_bInhFrbd_ComEmac_tqAbsltMaxRx01 "" UWORD DFC_OneToOne 1 100 0.00 65535.00 FORMAT "%8.2" ECU_ADDRESS 0x60021694 /end MEASUREMENT
/begin MEASUREMENT DINH_stFId.FId_bInhFrbd_ComEmac_tqAbsltMin01 "" UWORD DFC_OneToOne 1 100 0.00 65535.00 FORMAT "%8.2" ECU_ADDRESS 0x60021696 /end MEASUREMENT
/begin MEASUREMENT DINH_stFId.FId_bInhFrbd_ComEmac_tqAbsltMinRx01 "" UWORD DFC_OneToOne 1 100 0.00 65535.00 FORMAT "%8.2" ECU_ADDRESS 0x60021698 /end MEASUREMENT
/begin MEASUREMENT DINH_stFId.FId_bInhFrbd_ComEmac_tqAckd01 "" UWORD DFC_OneToOne 1 100 0.00 65535.00 FORMAT "%8.2" ECU_ADDRESS 0x6002169A /end MEASUREMENT
/begin MEASUREMENT DINH_stFId.FId_bInhFrbd_ComEmac_tqAct01 "" UWORD DFC_OneToOne 1 100 0.00 65535.00 FORMAT "%8.2" ECU_ADDRESS 0x6002169C /end MEASUREMENT
/begin MEASUREMENT DINH_stFId.FId_bInhFrbd_ComEmac_tqPtd01 "" UWORD DFC_OneToOne 1 100 0.00 65535.00 FORMAT "%8.2" ECU_ADDRESS 0x6002169E /end MEASUREMENT
/begin MEASUREMENT DINH_stFId.FId_bInhFrbd_ComEmac_tqStabnMin "" UWORD DFC_OneToOne 1 100 0.00 65535.00 FORMAT "%8.2" ECU_ADDRESS 0x600216A0 /end MEASUREMENT
/begin MEASUREMENT DINH_stFId.FId_bInhFrbd_ComEmac_uDcLnk01 "" UWORD DFC_OneToOne 1 100 0.00 65535.00 FORMAT "%8.2" ECU_ADDRESS 0x600216A2 /end MEASUREMENT
/begin MEASUREMENT DINH_stFId.FId_bInhFrbd_Com_HvbMaxSnsrTempRx "" UWORD DFC_OneToOne 1 100 0.00 65535.00 FORMAT "%8.2" ECU_ADDRESS 0x600216A4 /end MEASUREMENT
/begin MEASUREMENT DINH_stFId.FId_bInhFrbd_Com_ctHvbNegCntctrSeg1 "" UWORD DFC_OneToOne 1 100 0.00 65535.00 FORMAT "%8.2" ECU_ADDRESS 0x600216A6 /end MEASUREMENT
/begin MEASUREMENT DINH_stFId.FId_bInhFrbd_Com_ctHvbNegCntctrSeg3 "" UWORD DFC_OneToOne 1 100 0.00 65535.00 FORMAT "%8.2" ECU_ADDRESS 0x600216A8 /end MEASUREMENT
/begin MEASUREMENT DINH_stFId.FId_bInhFrbd_Com_ctHvbNegCntctrSeg4 "" UWORD DFC_OneToOne 1 100 0.00 65535.00 FORMAT "%8.2" ECU_ADDRESS 0x600216AA /end MEASUREMENT
/begin MEASUREMENT DINH_stFId.FId_bInhFrbd_Com_ctHvbPosCntctrSeg1 "" UWORD DFC_OneToOne 1 100 0.00 65535.00 FORMAT "%8.2" ECU_ADDRESS 0x600216AC /end MEASUREMENT
/begin MEASUREMENT DINH_stFId.FId_bInhFrbd_Com_ctHvbPosCntctrSeg3 "" UWORD DFC_OneToOne 1 100 0.00 65535.00 FORMAT "%8.2" ECU_ADDRESS 0x600216AE /end MEASUREMENT
/begin MEASUREMENT DINH_stFId.FId_bInhFrbd_Com_ctHvbPosCntctrSeg4 "" UWORD DFC_OneToOne 1 100 0.00 65535.00 FORMAT "%8.2" ECU_ADDRESS 0x600216B0 /end MEASUREMENT
/begin MEASUREMENT DINH_stFId.FId_bInhFrbd_Com_ctHvbPrecCntctrSeg1 "" UWORD DFC_OneToOne 1 100 0.00 65535.00 FORMAT "%8.2" ECU_ADDRESS 0x600216B2 /end MEASUREMENT
/begin MEASUREMENT DINH_stFId.FId_bInhFrbd_Com_ctHvbPrecCntctrSeg2 "" UWORD DFC_OneToOne 1 100 0.00 65535.00 FORMAT "%8.2" ECU_ADDRESS 0x600216B4 /end MEASUREMENT
/begin MEASUREMENT DINH_stFId.FId_bInhFrbd_Com_egyHvbAvl_fRx "" UWORD DFC_OneToOne 1 100 0.00 65535.00 FORMAT "%8.2" ECU_ADDRESS 0x600216B6 /end MEASUREMENT
/begin MEASUREMENT DINH_stFId.FId_bInhFrbd_Com_flgEcoNormReqRx "" UWORD DFC_OneToOne 1 100 0.00 65535.00 FORMAT "%8.2" ECU_ADDRESS 0x600216B8 /end MEASUREMENT
/begin MEASUREMENT DINH_stFId.FId_bInhFrbd_Com_iBattEBS1Rx "" UWORD DFC_OneToOne 1 100 0.00 65535.00 FORMAT "%8.2" ECU_ADDRESS 0x600216BA /end MEASUREMENT
/begin MEASUREMENT DINH_stFId.FId_bInhFrbd_Com_iBattEBS2Rx "" UWORD DFC_OneToOne 1 100 0.00 65535.00 FORMAT "%8.2" ECU_ADDRESS 0x600216BC /end MEASUREMENT
/begin MEASUREMENT DINH_stFId.FId_bInhFrbd_Com_iBattEBS3Rx "" UWORD DFC_OneToOne 1 100 0.00 65535.00 FORMAT "%8.2" ECU_ADDRESS 0x600216BE /end MEASUREMENT
/begin MEASUREMENT DINH_stFId.FId_bInhFrbd_Com_iDcdcHvActRvsn1 "" UWORD DFC_OneToOne 1 100 0.00 65535.00 FORMAT "%8.2" ECU_ADDRESS 0x600216C0 /end MEASUREMENT
/begin MEASUREMENT DINH_stFId.FId_bInhFrbd_Com_iDcdcLvActRvsn1 "" UWORD DFC_OneToOne 1 100 0.00 65535.00 FORMAT "%8.2" ECU_ADDRESS 0x600216C2 /end MEASUREMENT
/begin MEASUREMENT DINH_stFId.FId_bInhFrbd_Com_iElCmprHvAct "" UWORD DFC_OneToOne 1 100 0.00 65535.00 FORMAT "%8.2" ECU_ADDRESS 0x600216C4 /end MEASUREMENT
/begin MEASUREMENT DINH_stFId.FId_bInhFrbd_Com_iElCmprPeakPha "" UWORD DFC_OneToOne 1 100 0.00 65535.00 FORMAT "%8.2" ECU_ADDRESS 0x600216C6 /end MEASUREMENT
/begin MEASUREMENT DINH_stFId.FId_bInhFrbd_Com_iHvbActRx "" UWORD DFC_OneToOne 1 100 0.00 65535.00 FORMAT "%8.2" ECU_ADDRESS 0x600216C8 /end MEASUREMENT
/begin MEASUREMENT DINH_stFId.FId_bInhFrbd_Com_iHvbChrgMaxSho "" UWORD DFC_OneToOne 1 100 0.00 65535.00 FORMAT "%8.2" ECU_ADDRESS 0x600216CA /end MEASUREMENT
/begin MEASUREMENT DINH_stFId.FId_bInhFrbd_Com_iHvbDchaMaxSho "" UWORD DFC_OneToOne 1 100 0.00 65535.00 FORMAT "%8.2" ECU_ADDRESS 0x600216CC /end MEASUREMENT
/begin MEASUREMENT DINH_stFId.FId_bInhFrbd_Com_iHvbDes "" UWORD DFC_OneToOne 1 100 0.00 65535.00 FORMAT "%8.2" ECU_ADDRESS 0x600216CE /end MEASUREMENT
/begin MEASUREMENT DINH_stFId.FId_bInhFrbd_Com_iHvbNomChrgn "" UWORD DFC_OneToOne 1 100 0.00 65535.00 FORMAT "%8.2" ECU_ADDRESS 0x600216D0 /end MEASUREMENT
/begin MEASUREMENT DINH_stFId.FId_bInhFrbd_Com_nElCmprActl "" UWORD DFC_OneToOne 1 100 0.00 65535.00 FORMAT "%8.2" ECU_ADDRESS 0x600216D2 /end MEASUREMENT
/begin MEASUREMENT DINH_stFId.FId_bInhFrbd_Com_nrSerMaxCell "" UWORD DFC_OneToOne 1 100 0.00 65535.00 FORMAT "%8.2" ECU_ADDRESS 0x600216D4 /end MEASUREMENT
/begin MEASUREMENT DINH_stFId.FId_bInhFrbd_Com_nrSerMinCell "" UWORD DFC_OneToOne 1 100 0.00 65535.00 FORMAT "%8.2" ECU_ADDRESS 0x600216D6 /end MEASUREMENT
/begin MEASUREMENT DINH_stFId.FId_bInhFrbd_Com_pwrDcdcOutpCpby "" UWORD DFC_OneToOne 1 100 0.00 65535.00 FORMAT "%8.2" ECU_ADDRESS 0x600216D8 /end MEASUREMENT
/begin MEASUREMENT DINH_stFId.FId_bInhFrbd_Com_pwrElCmprActl "" UWORD DFC_OneToOne 1 100 0.00 65535.00 FORMAT "%8.2" ECU_ADDRESS 0x600216DA /end MEASUREMENT
/begin MEASUREMENT DINH_stFId.FId_bInhFrbd_Com_pwrMaxChrgSho "" UWORD DFC_OneToOne 1 100 0.00 65535.00 FORMAT "%8.2" ECU_ADDRESS 0x600216DC /end MEASUREMENT
/begin MEASUREMENT DINH_stFId.FId_bInhFrbd_Com_pwrMaxDchaSho "" UWORD DFC_OneToOne 1 100 0.00 65535.00 FORMAT "%8.2" ECU_ADDRESS 0x600216DE /end MEASUREMENT
/begin MEASUREMENT DINH_stFId.FId_bInhFrbd_Com_qHvbTotCpRx "" UWORD DFC_OneToOne 1 100 0.00 65535.00 FORMAT "%8.2" ECU_ADDRESS 0x600216E0 /end MEASUREMENT
/begin MEASUREMENT DINH_stFId.FId_bInhFrbd_Com_rHvbIsoMeasmt "" UWORD DFC_OneToOne 1 100 0.00 65535.00 FORMAT "%8.2" ECU_ADDRESS 0x600216E2 /end MEASUREMENT
/begin MEASUREMENT DINH_stFId.FId_bInhFrbd_Com_ratHvbSoc "" UWORD DFC_OneToOne 1 100 0.00 65535.00 FORMAT "%8.2" ECU_ADDRESS 0x600216E4 /end MEASUREMENT
/begin MEASUREMENT DINH_stFId.FId_bInhFrbd_Com_ratHvbSoh "" UWORD DFC_OneToOne 1 100 0.00 65535.00 FORMAT "%8.2" ECU_ADDRESS 0x600216E6 /end MEASUREMENT
/begin MEASUREMENT DINH_stFId.FId_bInhFrbd_Com_ratRHvbSoh "" UWORD DFC_OneToOne 1 100 0.00 65535.00 FORMAT "%8.2" ECU_ADDRESS 0x600216E8 /end MEASUREMENT
/begin MEASUREMENT DINH_stFId.FId_bInhFrbd_Com_ratSocLvBatt "" UWORD DFC_OneToOne 1 100 0.00 65535.00 FORMAT "%8.2" ECU_ADDRESS 0x600216EA /end MEASUREMENT
/begin MEASUREMENT DINH_stFId.FId_bInhFrbd_Com_stElCmprFltLvl "" UWORD DFC_OneToOne 1 100 0.00 65535.00 FORMAT "%8.2" ECU_ADDRESS 0x600216EC /end MEASUREMENT
/begin MEASUREMENT DINH_stFId.FId_bInhFrbd_Com_stGearLvrPos "" UWORD DFC_OneToOne 1 100 0.00 65535.00 FORMAT "%8.2" ECU_ADDRESS 0x600216EE /end MEASUREMENT
/begin MEASUREMENT DINH_stFId.FId_bInhFrbd_Com_stIIvtrFltLvl01 "" UWORD DFC_OneToOne 1 100 0.00 65535.00 FORMAT "%8.2" ECU_ADDRESS 0x600216F0 /end MEASUREMENT
/begin MEASUREMENT DINH_stFId.FId_bInhFrbd_Com_steTogFailrLvl "" UWORD DFC_OneToOne 1 100 0.00 65535.00 FORMAT "%8.2" ECU_ADDRESS 0x600216F2 /end MEASUREMENT
/begin MEASUREMENT DINH_stFId.FId_bInhFrbd_Com_tDcdcAct "" UWORD DFC_OneToOne 1 100 0.00 65535.00 FORMAT "%8.2" ECU_ADDRESS 0x600216F4 /end MEASUREMENT
/begin MEASUREMENT DINH_stFId.FId_bInhFrbd_Com_tDcdcInltCoolt "" UWORD DFC_OneToOne 1 100 0.00 65535.00 FORMAT "%8.2" ECU_ADDRESS 0x600216F6 /end MEASUREMENT
/begin MEASUREMENT DINH_stFId.FId_bInhFrbd_Com_tElCmprActl "" UWORD DFC_OneToOne 1 100 0.00 65535.00 FORMAT "%8.2" ECU_ADDRESS 0x600216F8 /end MEASUREMENT
/begin MEASUREMENT DINH_stFId.FId_bInhFrbd_Com_tEnvT "" UWORD DFC_OneToOne 1 100 0.00 65535.00 FORMAT "%8.2" ECU_ADDRESS 0x600216FA /end MEASUREMENT
/begin MEASUREMENT DINH_stFId.FId_bInhFrbd_Com_tHvbAct "" UWORD DFC_OneToOne 1 100 0.00 65535.00 FORMAT "%8.2" ECU_ADDRESS 0x600216FC /end MEASUREMENT
/begin MEASUREMENT DINH_stFId.FId_bInhFrbd_Com_tHvbMax "" UWORD DFC_OneToOne 1 100 0.00 65535.00 FORMAT "%8.2" ECU_ADDRESS 0x600216FE /end MEASUREMENT
/begin MEASUREMENT DINH_stFId.FId_bInhFrbd_Com_tLvBatt "" UWORD DFC_OneToOne 1 100 0.00 65535.00 FORMAT "%8.2" ECU_ADDRESS 0x60021700 /end MEASUREMENT
/begin MEASUREMENT DINH_stFId.FId_bInhFrbd_Com_tiHvbChrgnHalfRx "" UWORD DFC_OneToOne 1 100 0.00 65535.00 FORMAT "%8.2" ECU_ADDRESS 0x60021702 /end MEASUREMENT
/begin MEASUREMENT DINH_stFId.FId_bInhFrbd_Com_uBattEBSRx "" UWORD DFC_OneToOne 1 100 0.00 65535.00 FORMAT "%8.2" ECU_ADDRESS 0x60021704 /end MEASUREMENT
/begin MEASUREMENT DINH_stFId.FId_bInhFrbd_Com_uDcdcHvAct "" UWORD DFC_OneToOne 1 100 0.00 65535.00 FORMAT "%8.2" ECU_ADDRESS 0x60021706 /end MEASUREMENT
/begin MEASUREMENT DINH_stFId.FId_bInhFrbd_Com_uDcdcLvAct "" UWORD DFC_OneToOne 1 100 0.00 65535.00 FORMAT "%8.2" ECU_ADDRESS 0x60021708 /end MEASUREMENT
/begin MEASUREMENT DINH_stFId.FId_bInhFrbd_Com_uElCmprHvAct "" UWORD DFC_OneToOne 1 100 0.00 65535.00 FORMAT "%8.2" ECU_ADDRESS 0x6002170A /end MEASUREMENT
/begin MEASUREMENT DINH_stFId.FId_bInhFrbd_Com_uHvbAct "" UWORD DFC_OneToOne 1 100 0.00 65535.00 FORMAT "%8.2" ECU_ADDRESS 0x6002170C /end MEASUREMENT
/begin MEASUREMENT DINH_stFId.FId_bInhFrbd_Com_uHvbDcBus "" UWORD DFC_OneToOne 1 100 0.00 65535.00 FORMAT "%8.2" ECU_ADDRESS 0x6002170E /end MEASUREMENT
/begin MEASUREMENT DINH_stFId.FId_bInhFrbd_Com_uHvbLimHi "" UWORD DFC_OneToOne 1 100 0.00 65535.00 FORMAT "%8.2" ECU_ADDRESS 0x60021710 /end MEASUREMENT
/begin MEASUREMENT DINH_stFId.FId_bInhFrbd_Com_uHvbMaxCell "" UWORD DFC_OneToOne 1 100 0.00 65535.00 FORMAT "%8.2" ECU_ADDRESS 0x60021712 /end MEASUREMENT
/begin MEASUREMENT DINH_stFId.FId_bInhFrbd_Com_uHvbMinCell "" UWORD DFC_OneToOne 1 100 0.00 65535.00 FORMAT "%8.2" ECU_ADDRESS 0x60021714 /end MEASUREMENT
/begin MEASUREMENT DINH_stFId.FId_bInhFrbd_Com_uHvbNomChrgn "" UWORD DFC_OneToOne 1 100 0.00 65535.00 FORMAT "%8.2" ECU_ADDRESS 0x60021716 /end MEASUREMENT
/begin MEASUREMENT DINH_stFId.FId_bInhInvld_ComChrgr_flgChrgrErrLvl "" UWORD DFC_OneToOne 1 100 0.00 65535.00 FORMAT "%8.2" ECU_ADDRESS 0x60021718 /end MEASUREMENT
/begin MEASUREMENT DINH_stFId.FId_bInhInvld_ComChrgr_iAcMax "" UWORD DFC_OneToOne 1 100 0.00 65535.00 FORMAT "%8.2" ECU_ADDRESS 0x6002171A /end MEASUREMENT
/begin MEASUREMENT DINH_stFId.FId_bInhInvld_ComChrgr_iDcHvAct "" UWORD DFC_OneToOne 1 100 0.00 65535.00 FORMAT "%8.2" ECU_ADDRESS 0x6002171C /end MEASUREMENT
/begin MEASUREMENT DINH_stFId.FId_bInhInvld_ComChrgr_pwrInAct "" UWORD DFC_OneToOne 1 100 0.00 65535.00 FORMAT "%8.2" ECU_ADDRESS 0x6002171E /end MEASUREMENT
/begin MEASUREMENT DINH_stFId.FId_bInhInvld_ComChrgr_pwrOutpCpby "" UWORD DFC_OneToOne 1 100 0.00 65535.00 FORMAT "%8.2" ECU_ADDRESS 0x60021720 /end MEASUREMENT
/begin MEASUREMENT DINH_stFId.FId_bInhInvld_ComChrgr_tChrgrMaxAct "" UWORD DFC_OneToOne 1 100 0.00 65535.00 FORMAT "%8.2" ECU_ADDRESS 0x60021722 /end MEASUREMENT
/begin MEASUREMENT DINH_stFId.FId_bInhInvld_ComChrgr_uAcActL1 "" UWORD DFC_OneToOne 1 100 0.00 65535.00 FORMAT "%8.2" ECU_ADDRESS 0x60021724 /end MEASUREMENT
/begin MEASUREMENT DINH_stFId.FId_bInhInvld_ComChrgr_uDcHvAct "" UWORD DFC_OneToOne 1 100 0.00 65535.00 FORMAT "%8.2" ECU_ADDRESS 0x60021726 /end MEASUREMENT
/begin MEASUREMENT DINH_stFId.FId_bInhInvld_ComEmac_iDcLnk01 "" UWORD DFC_OneToOne 1 100 0.00 65535.00 FORMAT "%8.2" ECU_ADDRESS 0x60021728 /end MEASUREMENT
/begin MEASUREMENT DINH_stFId.FId_bInhInvld_ComEmac_nAct01 "" UWORD DFC_OneToOne 1 100 0.00 65535.00 FORMAT "%8.2" ECU_ADDRESS 0x6002172A /end MEASUREMENT
/begin MEASUREMENT DINH_stFId.FId_bInhInvld_ComEmac_pwrInstnsInpRx "" UWORD DFC_OneToOne 1 100 0.00 65535.00 FORMAT "%8.2" ECU_ADDRESS 0x6002172C /end MEASUREMENT
/begin MEASUREMENT DINH_stFId.FId_bInhInvld_ComEmac_stActvDcha "" UWORD DFC_OneToOne 1 100 0.00 65535.00 FORMAT "%8.2" ECU_ADDRESS 0x6002172E /end MEASUREMENT
/begin MEASUREMENT DINH_stFId.FId_bInhInvld_ComEmac_stIvtrOpMod01 "" UWORD DFC_OneToOne 1 100 0.00 65535.00 FORMAT "%8.2" ECU_ADDRESS 0x60021730 /end MEASUREMENT
/begin MEASUREMENT DINH_stFId.FId_bInhInvld_ComEmac_tInvr01 "" UWORD DFC_OneToOne 1 100 0.00 65535.00 FORMAT "%8.2" ECU_ADDRESS 0x60021732 /end MEASUREMENT
/begin MEASUREMENT DINH_stFId.FId_bInhInvld_ComEmac_tIvtrCooltIn01 "" UWORD DFC_OneToOne 1 100 0.00 65535.00 FORMAT "%8.2" ECU_ADDRESS 0x60021734 /end MEASUREMENT
/begin MEASUREMENT DINH_stFId.FId_bInhInvld_ComEmac_tMac01 "" UWORD DFC_OneToOne 1 100 0.00 65535.00 FORMAT "%8.2" ECU_ADDRESS 0x60021736 /end MEASUREMENT
/begin MEASUREMENT DINH_stFId.FId_bInhInvld_ComEmac_tqAbsltMax01 "" UWORD DFC_OneToOne 1 100 0.00 65535.00 FORMAT "%8.2" ECU_ADDRESS 0x60021738 /end MEASUREMENT
/begin MEASUREMENT DINH_stFId.FId_bInhInvld_ComEmac_tqAbsltMaxRx01 "" UWORD DFC_OneToOne 1 100 0.00 65535.00 FORMAT "%8.2" ECU_ADDRESS 0x6002173A /end MEASUREMENT
/begin MEASUREMENT DINH_stFId.FId_bInhInvld_ComEmac_tqAbsltMin01 "" UWORD DFC_OneToOne 1 100 0.00 65535.00 FORMAT "%8.2" ECU_ADDRESS 0x6002173C /end MEASUREMENT
/begin MEASUREMENT DINH_stFId.FId_bInhInvld_ComEmac_tqAbsltMinRx01 "" UWORD DFC_OneToOne 1 100 0.00 65535.00 FORMAT "%8.2" ECU_ADDRESS 0x6002173E /end MEASUREMENT
/begin MEASUREMENT DINH_stFId.FId_bInhInvld_ComEmac_tqAckd01 "" UWORD DFC_OneToOne 1 100 0.00 65535.00 FORMAT "%8.2" ECU_ADDRESS 0x60021740 /end MEASUREMENT
/begin MEASUREMENT DINH_stFId.FId_bInhInvld_ComEmac_tqAct01 "" UWORD DFC_OneToOne 1 100 0.00 65535.00 FORMAT "%8.2" ECU_ADDRESS 0x60021742 /end MEASUREMENT
/begin MEASUREMENT DINH_stFId.FId_bInhInvld_ComEmac_tqPtd01 "" UWORD DFC_OneToOne 1 100 0.00 65535.00 FORMAT "%8.2" ECU_ADDRESS 0x60021744 /end MEASUREMENT
/begin MEASUREMENT DINH_stFId.FId_bInhInvld_ComEmac_tqStabnMin "" UWORD DFC_OneToOne 1 100 0.00 65535.00 FORMAT "%8.2" ECU_ADDRESS 0x60021746 /end MEASUREMENT
/begin MEASUREMENT DINH_stFId.FId_bInhInvld_ComEmac_uDcLnk01 "" UWORD DFC_OneToOne 1 100 0.00 65535.00 FORMAT "%8.2" ECU_ADDRESS 0x60021748 /end MEASUREMENT
/begin MEASUREMENT DINH_stFId.FId_bInhInvld_Com_HvbMaxSnsrTempRx "" UWORD DFC_OneToOne 1 100 0.00 65535.00 FORMAT "%8.2" ECU_ADDRESS 0x6002174A /end MEASUREMENT
/begin MEASUREMENT DINH_stFId.FId_bInhInvld_Com_ctHvbNegCntctrSeg1 "" UWORD DFC_OneToOne 1 100 0.00 65535.00 FORMAT "%8.2" ECU_ADDRESS 0x6002174C /end MEASUREMENT
/begin MEASUREMENT DINH_stFId.FId_bInhInvld_Com_ctHvbNegCntctrSeg3 "" UWORD DFC_OneToOne 1 100 0.00 65535.00 FORMAT "%8.2" ECU_ADDRESS 0x6002174E /end MEASUREMENT
/begin MEASUREMENT DINH_stFId.FId_bInhInvld_Com_ctHvbNegCntctrSeg4 "" UWORD DFC_OneToOne 1 100 0.00 65535.00 FORMAT "%8.2" ECU_ADDRESS 0x60021750 /end MEASUREMENT
/begin MEASUREMENT DINH_stFId.FId_bInhInvld_Com_ctHvbPosCntctrSeg1 "" UWORD DFC_OneToOne 1 100 0.00 65535.00 FORMAT "%8.2" ECU_ADDRESS 0x60021752 /end MEASUREMENT
/begin MEASUREMENT DINH_stFId.FId_bInhInvld_Com_ctHvbPosCntctrSeg3 "" UWORD DFC_OneToOne 1 100 0.00 65535.00 FORMAT "%8.2" ECU_ADDRESS 0x60021754 /end MEASUREMENT
/begin MEASUREMENT DINH_stFId.FId_bInhInvld_Com_ctHvbPosCntctrSeg4 "" UWORD DFC_OneToOne 1 100 0.00 65535.00 FORMAT "%8.2" ECU_ADDRESS 0x60021756 /end MEASUREMENT
/begin MEASUREMENT DINH_stFId.FId_bInhInvld_Com_ctHvbPrecCntctrSeg1 "" UWORD DFC_OneToOne 1 100 0.00 65535.00 FORMAT "%8.2" ECU_ADDRESS 0x60021758 /end MEASUREMENT
/begin MEASUREMENT DINH_stFId.FId_bInhInvld_Com_ctHvbPrecCntctrSeg2 "" UWORD DFC_OneToOne 1 100 0.00 65535.00 FORMAT "%8.2" ECU_ADDRESS 0x6002175A /end MEASUREMENT
/begin MEASUREMENT DINH_stFId.FId_bInhInvld_Com_egyHvbAvl_fRx "" UWORD DFC_OneToOne 1 100 0.00 65535.00 FORMAT "%8.2" ECU_ADDRESS 0x6002175C /end MEASUREMENT
/begin MEASUREMENT DINH_stFId.FId_bInhInvld_Com_flgEcoNormReqRx "" UWORD DFC_OneToOne 1 100 0.00 65535.00 FORMAT "%8.2" ECU_ADDRESS 0x6002175E /end MEASUREMENT
/begin MEASUREMENT DINH_stFId.FId_bInhInvld_Com_flgVehSpdAvl "" UWORD DFC_OneToOne 1 100 0.00 65535.00 FORMAT "%8.2" ECU_ADDRESS 0x60021760 /end MEASUREMENT
/begin MEASUREMENT DINH_stFId.FId_bInhInvld_Com_iBattEBS1Rx "" UWORD DFC_OneToOne 1 100 0.00 65535.00 FORMAT "%8.2" ECU_ADDRESS 0x60021762 /end MEASUREMENT
/begin MEASUREMENT DINH_stFId.FId_bInhInvld_Com_iBattEBS2Rx "" UWORD DFC_OneToOne 1 100 0.00 65535.00 FORMAT "%8.2" ECU_ADDRESS 0x60021764 /end MEASUREMENT
/begin MEASUREMENT DINH_stFId.FId_bInhInvld_Com_iBattEBS3Rx "" UWORD DFC_OneToOne 1 100 0.00 65535.00 FORMAT "%8.2" ECU_ADDRESS 0x60021766 /end MEASUREMENT
/begin MEASUREMENT DINH_stFId.FId_bInhInvld_Com_iDcdcHvActRvsn1 "" UWORD DFC_OneToOne 1 100 0.00 65535.00 FORMAT "%8.2" ECU_ADDRESS 0x60021768 /end MEASUREMENT
/begin MEASUREMENT DINH_stFId.FId_bInhInvld_Com_iDcdcLvActRvsn1 "" UWORD DFC_OneToOne 1 100 0.00 65535.00 FORMAT "%8.2" ECU_ADDRESS 0x6002176A /end MEASUREMENT
/begin MEASUREMENT DINH_stFId.FId_bInhInvld_Com_iElCmprHvAct "" UWORD DFC_OneToOne 1 100 0.00 65535.00 FORMAT "%8.2" ECU_ADDRESS 0x6002176C /end MEASUREMENT
/begin MEASUREMENT DINH_stFId.FId_bInhInvld_Com_iElCmprPeakPha "" UWORD DFC_OneToOne 1 100 0.00 65535.00 FORMAT "%8.2" ECU_ADDRESS 0x6002176E /end MEASUREMENT
/begin MEASUREMENT DINH_stFId.FId_bInhInvld_Com_iHvbActRx "" UWORD DFC_OneToOne 1 100 0.00 65535.00 FORMAT "%8.2" ECU_ADDRESS 0x60021770 /end MEASUREMENT
/begin MEASUREMENT DINH_stFId.FId_bInhInvld_Com_iHvbChrgMaxSho "" UWORD DFC_OneToOne 1 100 0.00 65535.00 FORMAT "%8.2" ECU_ADDRESS 0x60021772 /end MEASUREMENT
/begin MEASUREMENT DINH_stFId.FId_bInhInvld_Com_iHvbDchaMaxSho "" UWORD DFC_OneToOne 1 100 0.00 65535.00 FORMAT "%8.2" ECU_ADDRESS 0x60021774 /end MEASUREMENT
/begin MEASUREMENT DINH_stFId.FId_bInhInvld_Com_iHvbDes "" UWORD DFC_OneToOne 1 100 0.00 65535.00 FORMAT "%8.2" ECU_ADDRESS 0x60021776 /end MEASUREMENT
/begin MEASUREMENT DINH_stFId.FId_bInhInvld_Com_iHvbNomChrgn "" UWORD DFC_OneToOne 1 100 0.00 65535.00 FORMAT "%8.2" ECU_ADDRESS 0x60021778 /end MEASUREMENT
/begin MEASUREMENT DINH_stFId.FId_bInhInvld_Com_lDstGlbDa "" UWORD DFC_OneToOne 1 100 0.00 65535.00 FORMAT "%8.2" ECU_ADDRESS 0x6002177A /end MEASUREMENT
/begin MEASUREMENT DINH_stFId.FId_bInhInvld_Com_lTotOdometer "" UWORD DFC_OneToOne 1 100 0.00 65535.00 FORMAT "%8.2" ECU_ADDRESS 0x6002177C /end MEASUREMENT
/begin MEASUREMENT DINH_stFId.FId_bInhInvld_Com_nElCmprActl "" UWORD DFC_OneToOne 1 100 0.00 65535.00 FORMAT "%8.2" ECU_ADDRESS 0x6002177E /end MEASUREMENT
/begin MEASUREMENT DINH_stFId.FId_bInhInvld_Com_nrSerMaxCell "" UWORD DFC_OneToOne 1 100 0.00 65535.00 FORMAT "%8.2" ECU_ADDRESS 0x60021780 /end MEASUREMENT
/begin MEASUREMENT DINH_stFId.FId_bInhInvld_Com_nrSerMinCell "" UWORD DFC_OneToOne 1 100 0.00 65535.00 FORMAT "%8.2" ECU_ADDRESS 0x60021782 /end MEASUREMENT
/begin MEASUREMENT DINH_stFId.FId_bInhInvld_Com_pwrDcdcOutpCpby "" UWORD DFC_OneToOne 1 100 0.00 65535.00 FORMAT "%8.2" ECU_ADDRESS 0x60021784 /end MEASUREMENT
/begin MEASUREMENT DINH_stFId.FId_bInhInvld_Com_pwrElCmprActl "" UWORD DFC_OneToOne 1 100 0.00 65535.00 FORMAT "%8.2" ECU_ADDRESS 0x60021786 /end MEASUREMENT
/begin MEASUREMENT DINH_stFId.FId_bInhInvld_Com_pwrMaxChrgSho "" UWORD DFC_OneToOne 1 100 0.00 65535.00 FORMAT "%8.2" ECU_ADDRESS 0x60021788 /end MEASUREMENT
/begin MEASUREMENT DINH_stFId.FId_bInhInvld_Com_pwrMaxDchaSho "" UWORD DFC_OneToOne 1 100 0.00 65535.00 FORMAT "%8.2" ECU_ADDRESS 0x6002178A /end MEASUREMENT
/begin MEASUREMENT DINH_stFId.FId_bInhInvld_Com_qHvbTotCpRx "" UWORD DFC_OneToOne 1 100 0.00 65535.00 FORMAT "%8.2" ECU_ADDRESS 0x6002178C /end MEASUREMENT
/begin MEASUREMENT DINH_stFId.FId_bInhInvld_Com_rHvbIsoMeasmt "" UWORD DFC_OneToOne 1 100 0.00 65535.00 FORMAT "%8.2" ECU_ADDRESS 0x6002178E /end MEASUREMENT
/begin MEASUREMENT DINH_stFId.FId_bInhInvld_Com_ratHvbSoc "" UWORD DFC_OneToOne 1 100 0.00 65535.00 FORMAT "%8.2" ECU_ADDRESS 0x60021790 /end MEASUREMENT
/begin MEASUREMENT DINH_stFId.FId_bInhInvld_Com_ratHvbSoh "" UWORD DFC_OneToOne 1 100 0.00 65535.00 FORMAT "%8.2" ECU_ADDRESS 0x60021792 /end MEASUREMENT
/begin MEASUREMENT DINH_stFId.FId_bInhInvld_Com_ratRHvbSoh "" UWORD DFC_OneToOne 1 100 0.00 65535.00 FORMAT "%8.2" ECU_ADDRESS 0x60021794 /end MEASUREMENT
/begin MEASUREMENT DINH_stFId.FId_bInhInvld_Com_ratSocLvBatt "" UWORD DFC_OneToOne 1 100 0.00 65535.00 FORMAT "%8.2" ECU_ADDRESS 0x60021796 /end MEASUREMENT
/begin MEASUREMENT DINH_stFId.FId_bInhInvld_Com_stAC "" UWORD DFC_OneToOne 1 100 0.00 65535.00 FORMAT "%8.2" ECU_ADDRESS 0x60021798 /end MEASUREMENT
/begin MEASUREMENT DINH_stFId.FId_bInhInvld_Com_stAlrtThermRunAwy "" UWORD DFC_OneToOne 1 100 0.00 65535.00 FORMAT "%8.2" ECU_ADDRESS 0x6002179A /end MEASUREMENT
/begin MEASUREMENT DINH_stFId.FId_bInhInvld_Com_stBlowrRly "" UWORD DFC_OneToOne 1 100 0.00 65535.00 FORMAT "%8.2" ECU_ADDRESS 0x6002179C /end MEASUREMENT
/begin MEASUREMENT DINH_stFId.FId_bInhInvld_Com_stDcdcFltLvl "" UWORD DFC_OneToOne 1 100 0.00 65535.00 FORMAT "%8.2" ECU_ADDRESS 0x6002179E /end MEASUREMENT
/begin MEASUREMENT DINH_stFId.FId_bInhInvld_Com_stEvapTFlt "" UWORD DFC_OneToOne 1 100 0.00 65535.00 FORMAT "%8.2" ECU_ADDRESS 0x600217A0 /end MEASUREMENT
/begin MEASUREMENT DINH_stFId.FId_bInhInvld_Com_stGearLvrPos "" UWORD DFC_OneToOne 1 100 0.00 65535.00 FORMAT "%8.2" ECU_ADDRESS 0x600217A2 /end MEASUREMENT
/begin MEASUREMENT DINH_stFId.FId_bInhInvld_Com_stHvacBlwrFront "" UWORD DFC_OneToOne 1 100 0.00 65535.00 FORMAT "%8.2" ECU_ADDRESS 0x600217A4 /end MEASUREMENT
/begin MEASUREMENT DINH_stFId.FId_bInhInvld_Com_stHvacKnobPosn "" UWORD DFC_OneToOne 1 100 0.00 65535.00 FORMAT "%8.2" ECU_ADDRESS 0x600217A6 /end MEASUREMENT
/begin MEASUREMENT DINH_stFId.FId_bInhInvld_Com_stHvacPanPotiFlt "" UWORD DFC_OneToOne 1 100 0.00 65535.00 FORMAT "%8.2" ECU_ADDRESS 0x600217A8 /end MEASUREMENT
/begin MEASUREMENT DINH_stFId.FId_bInhInvld_Com_stHvbChrgn "" UWORD DFC_OneToOne 1 100 0.00 65535.00 FORMAT "%8.2" ECU_ADDRESS 0x600217AA /end MEASUREMENT
/begin MEASUREMENT DINH_stFId.FId_bInhInvld_Com_stHvbDiscnctReas "" UWORD DFC_OneToOne 1 100 0.00 65535.00 FORMAT "%8.2" ECU_ADDRESS 0x600217AC /end MEASUREMENT
/begin MEASUREMENT DINH_stFId.FId_bInhInvld_Com_stHvbIntlckRx "" UWORD DFC_OneToOne 1 100 0.00 65535.00 FORMAT "%8.2" ECU_ADDRESS 0x600217AE /end MEASUREMENT
/begin MEASUREMENT DINH_stFId.FId_bInhInvld_Com_stHvbIsoFltRx "" UWORD DFC_OneToOne 1 100 0.00 65535.00 FORMAT "%8.2" ECU_ADDRESS 0x600217B0 /end MEASUREMENT
/begin MEASUREMENT DINH_stFId.FId_bInhInvld_Com_stHvbSrvPlgRx "" UWORD DFC_OneToOne 1 100 0.00 65535.00 FORMAT "%8.2" ECU_ADDRESS 0x600217B2 /end MEASUREMENT
/begin MEASUREMENT DINH_stFId.FId_bInhInvld_Com_stIBattEBS "" UWORD DFC_OneToOne 1 100 0.00 65535.00 FORMAT "%8.2" ECU_ADDRESS 0x600217B4 /end MEASUREMENT
/begin MEASUREMENT DINH_stFId.FId_bInhInvld_Com_stIIvtrFltLvl01 "" UWORD DFC_OneToOne 1 100 0.00 65535.00 FORMAT "%8.2" ECU_ADDRESS 0x600217B6 /end MEASUREMENT
/begin MEASUREMENT DINH_stFId.FId_bInhInvld_Com_stMainWkuReq "" UWORD DFC_OneToOne 1 100 0.00 65535.00 FORMAT "%8.2" ECU_ADDRESS 0x600217B8 /end MEASUREMENT
/begin MEASUREMENT DINH_stFId.FId_bInhInvld_Com_stReFogReq "" UWORD DFC_OneToOne 1 100 0.00 65535.00 FORMAT "%8.2" ECU_ADDRESS 0x600217BA /end MEASUREMENT
/begin MEASUREMENT DINH_stFId.FId_bInhInvld_Com_stSocRx "" UWORD DFC_OneToOne 1 100 0.00 65535.00 FORMAT "%8.2" ECU_ADDRESS 0x600217BC /end MEASUREMENT
/begin MEASUREMENT DINH_stFId.FId_bInhInvld_Com_stT "" UWORD DFC_OneToOne 1 100 0.00 65535.00 FORMAT "%8.2" ECU_ADDRESS 0x600217BE /end MEASUREMENT
/begin MEASUREMENT DINH_stFId.FId_bInhInvld_Com_tDcdcAct "" UWORD DFC_OneToOne 1 100 0.00 65535.00 FORMAT "%8.2" ECU_ADDRESS 0x600217C0 /end MEASUREMENT
/begin MEASUREMENT DINH_stFId.FId_bInhInvld_Com_tDcdcInltCoolt "" UWORD DFC_OneToOne 1 100 0.00 65535.00 FORMAT "%8.2" ECU_ADDRESS 0x600217C2 /end MEASUREMENT
/begin MEASUREMENT DINH_stFId.FId_bInhInvld_Com_tElCmprActl "" UWORD DFC_OneToOne 1 100 0.00 65535.00 FORMAT "%8.2" ECU_ADDRESS 0x600217C4 /end MEASUREMENT
/begin MEASUREMENT DINH_stFId.FId_bInhInvld_Com_tEnvT "" UWORD DFC_OneToOne 1 100 0.00 65535.00 FORMAT "%8.2" ECU_ADDRESS 0x600217C6 /end MEASUREMENT
/begin MEASUREMENT DINH_stFId.FId_bInhInvld_Com_tEvapT "" UWORD DFC_OneToOne 1 100 0.00 65535.00 FORMAT "%8.2" ECU_ADDRESS 0x600217C8 /end MEASUREMENT
/begin MEASUREMENT DINH_stFId.FId_bInhInvld_Com_tHvbAct "" UWORD DFC_OneToOne 1 100 0.00 65535.00 FORMAT "%8.2" ECU_ADDRESS 0x600217CA /end MEASUREMENT
/begin MEASUREMENT DINH_stFId.FId_bInhInvld_Com_tHvbMax "" UWORD DFC_OneToOne 1 100 0.00 65535.00 FORMAT "%8.2" ECU_ADDRESS 0x600217CC /end MEASUREMENT
/begin MEASUREMENT DINH_stFId.FId_bInhInvld_Com_tLvBatt "" UWORD DFC_OneToOne 1 100 0.00 65535.00 FORMAT "%8.2" ECU_ADDRESS 0x600217CE /end MEASUREMENT
/begin MEASUREMENT DINH_stFId.FId_bInhInvld_Com_tiCurVehTmr "" UWORD DFC_OneToOne 1 100 0.00 65535.00 FORMAT "%8.2" ECU_ADDRESS 0x600217D0 /end MEASUREMENT
/begin MEASUREMENT DINH_stFId.FId_bInhInvld_Com_tiHvbChrgnHalfRx "" UWORD DFC_OneToOne 1 100 0.00 65535.00 FORMAT "%8.2" ECU_ADDRESS 0x600217D2 /end MEASUREMENT
/begin MEASUREMENT DINH_stFId.FId_bInhInvld_Com_uBattEBSRx "" UWORD DFC_OneToOne 1 100 0.00 65535.00 FORMAT "%8.2" ECU_ADDRESS 0x600217D4 /end MEASUREMENT
/begin MEASUREMENT DINH_stFId.FId_bInhInvld_Com_uDcdcHvAct "" UWORD DFC_OneToOne 1 100 0.00 65535.00 FORMAT "%8.2" ECU_ADDRESS 0x600217D6 /end MEASUREMENT
/begin MEASUREMENT DINH_stFId.FId_bInhInvld_Com_uDcdcLvAct "" UWORD DFC_OneToOne 1 100 0.00 65535.00 FORMAT "%8.2" ECU_ADDRESS 0x600217D8 /end MEASUREMENT
/begin MEASUREMENT DINH_stFId.FId_bInhInvld_Com_uElCmprHvAct "" UWORD DFC_OneToOne 1 100 0.00 65535.00 FORMAT "%8.2" ECU_ADDRESS 0x600217DA /end MEASUREMENT
/begin MEASUREMENT DINH_stFId.FId_bInhInvld_Com_uHvbAct "" UWORD DFC_OneToOne 1 100 0.00 65535.00 FORMAT "%8.2" ECU_ADDRESS 0x600217DC /end MEASUREMENT
/begin MEASUREMENT DINH_stFId.FId_bInhInvld_Com_uHvbDcBus "" UWORD DFC_OneToOne 1 100 0.00 65535.00 FORMAT "%8.2" ECU_ADDRESS 0x600217DE /end MEASUREMENT
/begin MEASUREMENT DINH_stFId.FId_bInhInvld_Com_uHvbLimHi "" UWORD DFC_OneToOne 1 100 0.00 65535.00 FORMAT "%8.2" ECU_ADDRESS 0x600217E0 /end MEASUREMENT
/begin MEASUREMENT DINH_stFId.FId_bInhInvld_Com_uHvbMaxCell "" UWORD DFC_OneToOne 1 100 0.00 65535.00 FORMAT "%8.2" ECU_ADDRESS 0x600217E2 /end MEASUREMENT
/begin MEASUREMENT DINH_stFId.FId_bInhInvld_Com_uHvbMinCell "" UWORD DFC_OneToOne 1 100 0.00 65535.00 FORMAT "%8.2" ECU_ADDRESS 0x600217E4 /end MEASUREMENT
/begin MEASUREMENT DINH_stFId.FId_bInhInvld_Com_uHvbNomChrgn "" UWORD DFC_OneToOne 1 100 0.00 65535.00 FORMAT "%8.2" ECU_ADDRESS 0x600217E6 /end MEASUREMENT
/begin MEASUREMENT DINH_stFId.FId_bInhInvld_Com_vVeh "" UWORD DFC_OneToOne 1 100 0.00 65535.00 FORMAT "%8.2" ECU_ADDRESS 0x600217E8 /end MEASUREMENT
/begin MEASUREMENT DINH_stFId.FId_bInh_ACCmpr_pwrLimMax "" UWORD DFC_OneToOne 1 100 0.00 65535.00 FORMAT "%8.2" ECU_ADDRESS 0x600217EA /end MEASUREMENT
/begin MEASUREMENT DINH_stFId.FId_bInh_ACCtl_flgCmprEna "" UWORD DFC_OneToOne 1 100 0.00 65535.00 FORMAT "%8.2" ECU_ADDRESS 0x600217EC /end MEASUREMENT
/begin MEASUREMENT DINH_stFId.FId_bInh_ACCtl_nCmprSpdReq "" UWORD DFC_OneToOne 1 100 0.00 65535.00 FORMAT "%8.2" ECU_ADDRESS 0x600217EE /end MEASUREMENT
/begin MEASUREMENT DINH_stFId.FId_bInh_APP_rInp "" UWORD DFC_OneToOne 1 100 0.00 65535.00 FORMAT "%8.2" ECU_ADDRESS 0x600217F0 /end MEASUREMENT
/begin MEASUREMENT DINH_stFId.FId_bInh_BattId_numOrganNature1 "" UWORD DFC_OneToOne 1 100 0.00 65535.00 FORMAT "%8.2" ECU_ADDRESS 0x600217F2 /end MEASUREMENT
/begin MEASUREMENT DINH_stFId.FId_bInh_BattId_numOrganNature2 "" UWORD DFC_OneToOne 1 100 0.00 65535.00 FORMAT "%8.2" ECU_ADDRESS 0x600217F4 /end MEASUREMENT
/begin MEASUREMENT DINH_stFId.FId_bInh_BattId_numOrganRef1 "" UWORD DFC_OneToOne 1 100 0.00 65535.00 FORMAT "%8.2" ECU_ADDRESS 0x600217F6 /end MEASUREMENT
/begin MEASUREMENT DINH_stFId.FId_bInh_BattId_numOrganRef2 "" UWORD DFC_OneToOne 1 100 0.00 65535.00 FORMAT "%8.2" ECU_ADDRESS 0x600217F8 /end MEASUREMENT
/begin MEASUREMENT DINH_stFId.FId_bInh_BattId_numOrganRef3 "" UWORD DFC_OneToOne 1 100 0.00 65535.00 FORMAT "%8.2" ECU_ADDRESS 0x600217FA /end MEASUREMENT
/begin MEASUREMENT DINH_stFId.FId_bInh_BattId_numOrganRef4 "" UWORD DFC_OneToOne 1 100 0.00 65535.00 FORMAT "%8.2" ECU_ADDRESS 0x600217FC /end MEASUREMENT
/begin MEASUREMENT DINH_stFId.FId_bInh_BattId_numSerl1 "" UWORD DFC_OneToOne 1 100 0.00 65535.00 FORMAT "%8.2" ECU_ADDRESS 0x600217FE /end MEASUREMENT
/begin MEASUREMENT DINH_stFId.FId_bInh_BattId_numSerl2 "" UWORD DFC_OneToOne 1 100 0.00 65535.00 FORMAT "%8.2" ECU_ADDRESS 0x60021800 /end MEASUREMENT
/begin MEASUREMENT DINH_stFId.FId_bInh_BattId_numSerl3 "" UWORD DFC_OneToOne 1 100 0.00 65535.00 FORMAT "%8.2" ECU_ADDRESS 0x60021802 /end MEASUREMENT
/begin MEASUREMENT DINH_stFId.FId_bInh_BattId_numSerl4 "" UWORD DFC_OneToOne 1 100 0.00 65535.00 FORMAT "%8.2" ECU_ADDRESS 0x60021804 /end MEASUREMENT
/begin MEASUREMENT DINH_stFId.FId_bInh_BattId_numSerl5 "" UWORD DFC_OneToOne 1 100 0.00 65535.00 FORMAT "%8.2" ECU_ADDRESS 0x60021806 /end MEASUREMENT
/begin MEASUREMENT DINH_stFId.FId_bInh_BattId_numSerl6 "" UWORD DFC_OneToOne 1 100 0.00 65535.00 FORMAT "%8.2" ECU_ADDRESS 0x60021808 /end MEASUREMENT
/begin MEASUREMENT DINH_stFId.FId_bInh_BattId_numSerl7 "" UWORD DFC_OneToOne 1 100 0.00 65535.00 FORMAT "%8.2" ECU_ADDRESS 0x6002180A /end MEASUREMENT
/begin MEASUREMENT DINH_stFId.FId_bInh_Brk_stRed "" UWORD DFC_OneToOne 1 100 0.00 65535.00 FORMAT "%8.2" ECU_ADDRESS 0x6002180C /end MEASUREMENT
/begin MEASUREMENT DINH_stFId.FId_bInh_CbnHeatgHeatr_cntrRlyLf "" UWORD DFC_OneToOne 1 100 0.00 65535.00 FORMAT "%8.2" ECU_ADDRESS 0x6002180E /end MEASUREMENT
/begin MEASUREMENT DINH_stFId.FId_bInh_ChgrPlug_stPlgLockTx "" UWORD DFC_OneToOne 1 100 0.00 65535.00 FORMAT "%8.2" ECU_ADDRESS 0x60021810 /end MEASUREMENT
/begin MEASUREMENT DINH_stFId.FId_bInh_ChrgCntct_nrNegCntctElpdOper "" UWORD DFC_OneToOne 1 100 0.00 65535.00 FORMAT "%8.2" ECU_ADDRESS 0x60021812 /end MEASUREMENT
/begin MEASUREMENT DINH_stFId.FId_bInh_ChrgCntct_nrPosCntctElpdOper "" UWORD DFC_OneToOne 1 100 0.00 65535.00 FORMAT "%8.2" ECU_ADDRESS 0x60021814 /end MEASUREMENT
/begin MEASUREMENT DINH_stFId.FId_bInh_ChrgrRly_stRlyDes "" UWORD DFC_OneToOne 1 100 0.00 65535.00 FORMAT "%8.2" ECU_ADDRESS 0x60021816 /end MEASUREMENT
/begin MEASUREMENT DINH_stFId.FId_bInh_ChrgrVal_iChrgrDes "" UWORD DFC_OneToOne 1 100 0.00 65535.00 FORMAT "%8.2" ECU_ADDRESS 0x60021818 /end MEASUREMENT
/begin MEASUREMENT DINH_stFId.FId_bInh_ChrgrVal_iGridLimMax "" UWORD DFC_OneToOne 1 100 0.00 65535.00 FORMAT "%8.2" ECU_ADDRESS 0x6002181A /end MEASUREMENT
/begin MEASUREMENT DINH_stFId.FId_bInh_ChrgrVal_uHvMax "" UWORD DFC_OneToOne 1 100 0.00 65535.00 FORMAT "%8.2" ECU_ADDRESS 0x6002181C /end MEASUREMENT
/begin MEASUREMENT DINH_stFId.FId_bInh_CoDrvPITh_stEPSModeReq "" UWORD DFC_OneToOne 1 100 0.00 65535.00 FORMAT "%8.2" ECU_ADDRESS 0x6002181E /end MEASUREMENT
/begin MEASUREMENT DINH_stFId.FId_bInh_CoPtFH_stPwt "" UWORD DFC_OneToOne 1 100 0.00 65535.00 FORMAT "%8.2" ECU_ADDRESS 0x60021820 /end MEASUREMENT
/begin MEASUREMENT DINH_stFId.FId_bInh_ComChrg_stMod "" UWORD DFC_OneToOne 1 100 0.00 65535.00 FORMAT "%8.2" ECU_ADDRESS 0x60021822 /end MEASUREMENT
/begin MEASUREMENT DINH_stFId.FId_bInh_ComChrgr_stChrgnEna "" UWORD DFC_OneToOne 1 100 0.00 65535.00 FORMAT "%8.2" ECU_ADDRESS 0x60021830 /end MEASUREMENT
/begin MEASUREMENT DINH_stFId.FId_bInh_Com_25h_B1b0 "" UWORD DFC_OneToOne 1 100 0.00 65535.00 FORMAT "%8.2" ECU_ADDRESS 0x6002183E /end MEASUREMENT
/begin MEASUREMENT DINH_stFId.FId_bInh_Com_25h_B1b2 "" UWORD DFC_OneToOne 1 100 0.00 65535.00 FORMAT "%8.2" ECU_ADDRESS 0x60021840 /end MEASUREMENT
/begin MEASUREMENT DINH_stFId.FId_bInh_Com_25h_B1b4 "" UWORD DFC_OneToOne 1 100 0.00 65535.00 FORMAT "%8.2" ECU_ADDRESS 0x60021842 /end MEASUREMENT
/begin MEASUREMENT DINH_stFId.FId_bInh_Com_25h_B1b6 "" UWORD DFC_OneToOne 1 100 0.00 65535.00 FORMAT "%8.2" ECU_ADDRESS 0x60021844 /end MEASUREMENT
/begin MEASUREMENT DINH_stFId.FId_bInh_Com_HvbMaxSnsrTempTx "" UWORD DFC_OneToOne 1 100 0.00 65535.00 FORMAT "%8.2" ECU_ADDRESS 0x60021846 /end MEASUREMENT
/begin MEASUREMENT DINH_stFId.FId_bInh_Com_TogLedDrv "" UWORD DFC_OneToOne 1 100 0.00 65535.00 FORMAT "%8.2" ECU_ADDRESS 0x60021848 /end MEASUREMENT
/begin MEASUREMENT DINH_stFId.FId_bInh_Com_TogLedMod "" UWORD DFC_OneToOne 1 100 0.00 65535.00 FORMAT "%8.2" ECU_ADDRESS 0x6002184A /end MEASUREMENT
/begin MEASUREMENT DINH_stFId.FId_bInh_Com_TogLedNeut "" UWORD DFC_OneToOne 1 100 0.00 65535.00 FORMAT "%8.2" ECU_ADDRESS 0x6002184C /end MEASUREMENT
/begin MEASUREMENT DINH_stFId.FId_bInh_Com_TogLedRvs "" UWORD DFC_OneToOne 1 100 0.00 65535.00 FORMAT "%8.2" ECU_ADDRESS 0x6002184E /end MEASUREMENT
/begin MEASUREMENT DINH_stFId.FId_bInh_Com_bAcLedReq "" UWORD DFC_OneToOne 1 100 0.00 65535.00 FORMAT "%8.2" ECU_ADDRESS 0x60021850 /end MEASUREMENT
/begin MEASUREMENT DINH_stFId.FId_bInh_Com_bDiagMuxCAN "" UWORD DFC_OneToOne 1 100 0.00 65535.00 FORMAT "%8.2" ECU_ADDRESS 0x60021852 /end MEASUREMENT
/begin MEASUREMENT DINH_stFId.FId_bInh_Com_bGunCntInfoWkuReq "" UWORD DFC_OneToOne 1 100 0.00 65535.00 FORMAT "%8.2" ECU_ADDRESS 0x60021854 /end MEASUREMENT
/begin MEASUREMENT DINH_stFId.FId_bInh_Com_bHvBattRchrgWkuReq "" UWORD DFC_OneToOne 1 100 0.00 65535.00 FORMAT "%8.2" ECU_ADDRESS 0x60021856 /end MEASUREMENT
/begin MEASUREMENT DINH_stFId.FId_bInh_Com_bPostOperationWkuReq "" UWORD DFC_OneToOne 1 100 0.00 65535.00 FORMAT "%8.2" ECU_ADDRESS 0x60021858 /end MEASUREMENT
/begin MEASUREMENT DINH_stFId.FId_bInh_Com_bReFogRlySt "" UWORD DFC_OneToOne 1 100 0.00 65535.00 FORMAT "%8.2" ECU_ADDRESS 0x6002185A /end MEASUREMENT
/begin MEASUREMENT DINH_stFId.FId_bInh_Com_flgBlowrAuthn "" UWORD DFC_OneToOne 1 100 0.00 65535.00 FORMAT "%8.2" ECU_ADDRESS 0x6002185C /end MEASUREMENT
/begin MEASUREMENT DINH_stFId.FId_bInh_Com_flgBlowrRlyCtrl "" UWORD DFC_OneToOne 1 100 0.00 65535.00 FORMAT "%8.2" ECU_ADDRESS 0x6002185E /end MEASUREMENT
/begin MEASUREMENT DINH_stFId.FId_bInh_Com_flgBrkAlrt "" UWORD DFC_OneToOne 1 100 0.00 65535.00 FORMAT "%8.2" ECU_ADDRESS 0x60021860 /end MEASUREMENT
/begin MEASUREMENT DINH_stFId.FId_bInh_Com_flgDrvAwy "" UWORD DFC_OneToOne 1 100 0.00 65535.00 FORMAT "%8.2" ECU_ADDRESS 0x60021862 /end MEASUREMENT
/begin MEASUREMENT DINH_stFId.FId_bInh_Com_flgVehSpdQly "" UWORD DFC_OneToOne 1 100 0.00 65535.00 FORMAT "%8.2" ECU_ADDRESS 0x60021864 /end MEASUREMENT
/begin MEASUREMENT DINH_stFId.FId_bInh_Com_iHvbActTx "" UWORD DFC_OneToOne 1 100 0.00 65535.00 FORMAT "%8.2" ECU_ADDRESS 0x6002186C /end MEASUREMENT
/begin MEASUREMENT DINH_stFId.FId_bInh_Com_nElCmprActlTx "" UWORD DFC_OneToOne 1 100 0.00 65535.00 FORMAT "%8.2" ECU_ADDRESS 0x6002186E /end MEASUREMENT
/begin MEASUREMENT DINH_stFId.FId_bInh_Com_nIvtrMotAct01 "" UWORD DFC_OneToOne 1 100 0.00 65535.00 FORMAT "%8.2" ECU_ADDRESS 0x60021870 /end MEASUREMENT
/begin MEASUREMENT DINH_stFId.FId_bInh_Com_noEditCal "" UWORD DFC_OneToOne 1 100 0.00 65535.00 FORMAT "%8.2" ECU_ADDRESS 0x60021872 /end MEASUREMENT
/begin MEASUREMENT DINH_stFId.FId_bInh_Com_noEditSw "" UWORD DFC_OneToOne 1 100 0.00 65535.00 FORMAT "%8.2" ECU_ADDRESS 0x60021874 /end MEASUREMENT
/begin MEASUREMENT DINH_stFId.FId_bInh_Com_noVerSysDay "" UWORD DFC_OneToOne 1 100 0.00 65535.00 FORMAT "%8.2" ECU_ADDRESS 0x60021876 /end MEASUREMENT
/begin MEASUREMENT DINH_stFId.FId_bInh_Com_noVersAdp "" UWORD DFC_OneToOne 1 100 0.00 65535.00 FORMAT "%8.2" ECU_ADDRESS 0x60021878 /end MEASUREMENT
/begin MEASUREMENT DINH_stFId.FId_bInh_Com_noVersSw "" UWORD DFC_OneToOne 1 100 0.00 65535.00 FORMAT "%8.2" ECU_ADDRESS 0x6002187A /end MEASUREMENT
/begin MEASUREMENT DINH_stFId.FId_bInh_Com_noVersSys "" UWORD DFC_OneToOne 1 100 0.00 65535.00 FORMAT "%8.2" ECU_ADDRESS 0x6002187C /end MEASUREMENT
/begin MEASUREMENT DINH_stFId.FId_bInh_Com_noVersSysMnth "" UWORD DFC_OneToOne 1 100 0.00 65535.00 FORMAT "%8.2" ECU_ADDRESS 0x6002187E /end MEASUREMENT
/begin MEASUREMENT DINH_stFId.FId_bInh_Com_noVersSysYr "" UWORD DFC_OneToOne 1 100 0.00 65535.00 FORMAT "%8.2" ECU_ADDRESS 0x60021880 /end MEASUREMENT
/begin MEASUREMENT DINH_stFId.FId_bInh_Com_stACTx "" UWORD DFC_OneToOne 1 100 0.00 65535.00 FORMAT "%8.2" ECU_ADDRESS 0x60021884 /end MEASUREMENT
/begin MEASUREMENT DINH_stFId.FId_bInh_Com_stBrk "" UWORD DFC_OneToOne 1 100 0.00 65535.00 FORMAT "%8.2" ECU_ADDRESS 0x60021886 /end MEASUREMENT
/begin MEASUREMENT DINH_stFId.FId_bInh_Com_stBrkBstPFlt "" UWORD DFC_OneToOne 1 100 0.00 65535.00 FORMAT "%8.2" ECU_ADDRESS 0x60021888 /end MEASUREMENT
/begin MEASUREMENT DINH_stFId.FId_bInh_Com_stBrkCntctIndcn "" UWORD DFC_OneToOne 1 100 0.00 65535.00 FORMAT "%8.2" ECU_ADDRESS 0x6002188A /end MEASUREMENT
/begin MEASUREMENT DINH_stFId.FId_bInh_Com_stChrgPlg "" UWORD DFC_OneToOne 1 100 0.00 65535.00 FORMAT "%8.2" ECU_ADDRESS 0x6002188C /end MEASUREMENT
/begin MEASUREMENT DINH_stFId.FId_bInh_Com_stChrgPlgChrgn "" UWORD DFC_OneToOne 1 100 0.00 65535.00 FORMAT "%8.2" ECU_ADDRESS 0x6002188E /end MEASUREMENT
/begin MEASUREMENT DINH_stFId.FId_bInh_Com_stClstrStopIndcn "" UWORD DFC_OneToOne 1 100 0.00 65535.00 FORMAT "%8.2" ECU_ADDRESS 0x60021890 /end MEASUREMENT
/begin MEASUREMENT DINH_stFId.FId_bInh_Com_stCmdHvBattCntctr "" UWORD DFC_OneToOne 1 100 0.00 65535.00 FORMAT "%8.2" ECU_ADDRESS 0x60021892 /end MEASUREMENT
/begin MEASUREMENT DINH_stFId.FId_bInh_Com_stCmdOffsEM01 "" UWORD DFC_OneToOne 1 100 0.00 65535.00 FORMAT "%8.2" ECU_ADDRESS 0x60021894 /end MEASUREMENT
/begin MEASUREMENT DINH_stFId.FId_bInh_Com_stDrvAwyDi "" UWORD DFC_OneToOne 1 100 0.00 65535.00 FORMAT "%8.2" ECU_ADDRESS 0x60021898 /end MEASUREMENT
/begin MEASUREMENT DINH_stFId.FId_bInh_Com_stDrvModPosn "" UWORD DFC_OneToOne 1 100 0.00 65535.00 FORMAT "%8.2" ECU_ADDRESS 0x6002189A /end MEASUREMENT
/begin MEASUREMENT DINH_stFId.FId_bInh_Com_stEVLmp "" UWORD DFC_OneToOne 1 100 0.00 65535.00 FORMAT "%8.2" ECU_ADDRESS 0x6002189C /end MEASUREMENT
/begin MEASUREMENT DINH_stFId.FId_bInh_Com_stElCmprStatTx "" UWORD DFC_OneToOne 1 100 0.00 65535.00 FORMAT "%8.2" ECU_ADDRESS 0x6002189E /end MEASUREMENT
/begin MEASUREMENT DINH_stFId.FId_bInh_Com_stElMDesEem "" UWORD DFC_OneToOne 1 100 0.00 65535.00 FORMAT "%8.2" ECU_ADDRESS 0x600218A0 /end MEASUREMENT
/begin MEASUREMENT DINH_stFId.FId_bInh_Com_stHvBattOperModDes "" UWORD DFC_OneToOne 1 100 0.00 65535.00 FORMAT "%8.2" ECU_ADDRESS 0x600218A2 /end MEASUREMENT
/begin MEASUREMENT DINH_stFId.FId_bInh_Com_stHvacBlwrFront_CAN "" UWORD DFC_OneToOne 1 100 0.00 65535.00 FORMAT "%8.2" ECU_ADDRESS 0x600218A4 /end MEASUREMENT
/begin MEASUREMENT DINH_stFId.FId_bInh_Com_stHvacKnobPosn_CAN "" UWORD DFC_OneToOne 1 100 0.00 65535.00 FORMAT "%8.2" ECU_ADDRESS 0x600218A6 /end MEASUREMENT
/begin MEASUREMENT DINH_stFId.FId_bInh_Com_stMstWrnLmp "" UWORD DFC_OneToOne 1 100 0.00 65535.00 FORMAT "%8.2" ECU_ADDRESS 0x600218A8 /end MEASUREMENT
/begin MEASUREMENT DINH_stFId.FId_bInh_Com_stNwCmdLIN "" UWORD DFC_OneToOne 1 100 0.00 65535.00 FORMAT "%8.2" ECU_ADDRESS 0x600218AA /end MEASUREMENT
/begin MEASUREMENT DINH_stFId.FId_bInh_Com_stPwrLimnLmp "" UWORD DFC_OneToOne 1 100 0.00 65535.00 FORMAT "%8.2" ECU_ADDRESS 0x600218AC /end MEASUREMENT
/begin MEASUREMENT DINH_stFId.FId_bInh_Com_stReFogReq_CAN "" UWORD DFC_OneToOne 1 100 0.00 65535.00 FORMAT "%8.2" ECU_ADDRESS 0x600218AE /end MEASUREMENT
/begin MEASUREMENT DINH_stFId.FId_bInh_Com_stSrvLmp "" UWORD DFC_OneToOne 1 100 0.00 65535.00 FORMAT "%8.2" ECU_ADDRESS 0x600218B0 /end MEASUREMENT
/begin MEASUREMENT DINH_stFId.FId_bInh_Com_stVehCoorn "" UWORD DFC_OneToOne 1 100 0.00 65535.00 FORMAT "%8.2" ECU_ADDRESS 0x600218B2 /end MEASUREMENT
/begin MEASUREMENT DINH_stFId.FId_bInh_Com_tqMotLimMax "" UWORD DFC_OneToOne 1 100 0.00 65535.00 FORMAT "%8.2" ECU_ADDRESS 0x600218B8 /end MEASUREMENT
/begin MEASUREMENT DINH_stFId.FId_bInh_Com_uHvbActTx "" UWORD DFC_OneToOne 1 100 0.00 65535.00 FORMAT "%8.2" ECU_ADDRESS 0x600218BE /end MEASUREMENT
/begin MEASUREMENT DINH_stFId.FId_bInh_Com_valEepOffsEM01 "" UWORD DFC_OneToOne 1 100 0.00 65535.00 FORMAT "%8.2" ECU_ADDRESS 0x600218C0 /end MEASUREMENT
/begin MEASUREMENT DINH_stFId.FId_bInh_DcChrgnRly_ctMaxOperCyc "" UWORD DFC_OneToOne 1 100 0.00 65535.00 FORMAT "%8.2" ECU_ADDRESS 0x600218C2 /end MEASUREMENT
/begin MEASUREMENT DINH_stFId.FId_bInh_Dcdc_flgDesLvGridULim "" UWORD DFC_OneToOne 1 100 0.00 65535.00 FORMAT "%8.2" ECU_ADDRESS 0x600218C4 /end MEASUREMENT
/begin MEASUREMENT DINH_stFId.FId_bInh_Dcdc_iLimLvGrid "" UWORD DFC_OneToOne 1 100 0.00 65535.00 FORMAT "%8.2" ECU_ADDRESS 0x600218C6 /end MEASUREMENT
/begin MEASUREMENT DINH_stFId.FId_bInh_Dcdc_stDesDcdc "" UWORD DFC_OneToOne 1 100 0.00 65535.00 FORMAT "%8.2" ECU_ADDRESS 0x600218C8 /end MEASUREMENT
/begin MEASUREMENT DINH_stFId.FId_bInh_Dcdc_uDesLvGrid "" UWORD DFC_OneToOne 1 100 0.00 65535.00 FORMAT "%8.2" ECU_ADDRESS 0x600218CA /end MEASUREMENT
/begin MEASUREMENT DINH_stFId.FId_bInh_DrvInfo_wTotTripEgy "" UWORD DFC_OneToOne 1 100 0.00 65535.00 FORMAT "%8.2" ECU_ADDRESS 0x600218CC /end MEASUREMENT
/begin MEASUREMENT DINH_stFId.FId_bInh_EChrDv_cntPlin "" UWORD DFC_OneToOne 1 100 0.00 65535.00 FORMAT "%8.2" ECU_ADDRESS 0x600218CE /end MEASUREMENT
/begin MEASUREMENT DINH_stFId.FId_bInh_Eem_flgFstHvShdwn "" UWORD DFC_OneToOne 1 100 0.00 65535.00 FORMAT "%8.2" ECU_ADDRESS 0x600218D0 /end MEASUREMENT
/begin MEASUREMENT DINH_stFId.FId_bInh_ElM_stDesEem01 "" UWORD DFC_OneToOne 1 100 0.00 65535.00 FORMAT "%8.2" ECU_ADDRESS 0x600218D2 /end MEASUREMENT
/begin MEASUREMENT DINH_stFId.FId_bInh_ElTS_egyTotChrgCyc "" UWORD DFC_OneToOne 1 100 0.00 65535.00 FORMAT "%8.2" ECU_ADDRESS 0x600218D4 /end MEASUREMENT
/begin MEASUREMENT DINH_stFId.FId_bInh_ElTS_ratEmPowChrgn "" UWORD DFC_OneToOne 1 100 0.00 65535.00 FORMAT "%8.2" ECU_ADDRESS 0x600218D6 /end MEASUREMENT
/begin MEASUREMENT DINH_stFId.FId_bInh_ElTS_ratEmPowDcha "" UWORD DFC_OneToOne 1 100 0.00 65535.00 FORMAT "%8.2" ECU_ADDRESS 0x600218D8 /end MEASUREMENT
/begin MEASUREMENT DINH_stFId.FId_bInh_ElTS_stChrgCyc "" UWORD DFC_OneToOne 1 100 0.00 65535.00 FORMAT "%8.2" ECU_ADDRESS 0x600218DA /end MEASUREMENT
/begin MEASUREMENT DINH_stFId.FId_bInh_Emac_stIsoMonSwtReq "" UWORD DFC_OneToOne 1 100 0.00 65535.00 FORMAT "%8.2" ECU_ADDRESS 0x600218DC /end MEASUREMENT
/begin MEASUREMENT DINH_stFId.FId_bInh_Emac_tqDesCom01 "" UWORD DFC_OneToOne 1 100 0.00 65535.00 FORMAT "%8.2" ECU_ADDRESS 0x600218DE /end MEASUREMENT
/begin MEASUREMENT DINH_stFId.FId_bInh_Ext_bSyncGPC "" UWORD DFC_OneToOne 1 100 0.00 65535.00 FORMAT "%8.2" ECU_ADDRESS 0x600218E0 /end MEASUREMENT
/begin MEASUREMENT DINH_stFId.FId_bInh_HvBatt_flgIsoMeasmtDiReq "" UWORD DFC_OneToOne 1 100 0.00 65535.00 FORMAT "%8.2" ECU_ADDRESS 0x600218E2 /end MEASUREMENT
/begin MEASUREMENT DINH_stFId.FId_bInh_HvBatt_ratSoc "" UWORD DFC_OneToOne 1 100 0.00 65535.00 FORMAT "%8.2" ECU_ADDRESS 0x600218E4 /end MEASUREMENT
/begin MEASUREMENT DINH_stFId.FId_bInh_HvGrid_pwrMaxDcdc "" UWORD DFC_OneToOne 1 100 0.00 65535.00 FORMAT "%8.2" ECU_ADDRESS 0x600218E6 /end MEASUREMENT
/begin MEASUREMENT DINH_stFId.FId_bInh_HvacPtc_stElHeatr "" UWORD DFC_OneToOne 1 100 0.00 65535.00 FORMAT "%8.2" ECU_ADDRESS 0x600218E8 /end MEASUREMENT
/begin MEASUREMENT DINH_stFId.FId_bInh_Pdu_CLUSTER_5E7_Frz "" UWORD DFC_OneToOne 1 100 0.00 65535.00 FORMAT "%8.2" ECU_ADDRESS 0x600218EA /end MEASUREMENT
/begin MEASUREMENT DINH_stFId.FId_bInh_Pdu_CLUSTER_5E7_Rcf "" UWORD DFC_OneToOne 1 100 0.00 65535.00 FORMAT "%8.2" ECU_ADDRESS 0x600218EC /end MEASUREMENT
/begin MEASUREMENT DINH_stFId.FId_bInh_Pdu_CONTEXTE_1_5B2_Frz "" UWORD DFC_OneToOne 1 100 0.00 65535.00 FORMAT "%8.2" ECU_ADDRESS 0x600218EE /end MEASUREMENT
/begin MEASUREMENT DINH_stFId.FId_bInh_Pdu_CONTEXTE_1_5B2_Rcf "" UWORD DFC_OneToOne 1 100 0.00 65535.00 FORMAT "%8.2" ECU_ADDRESS 0x600218F0 /end MEASUREMENT
/begin MEASUREMENT DINH_stFId.FId_bInh_Pdu_DAT3_BSI_4F2h_Frz "" UWORD DFC_OneToOne 1 100 0.00 65535.00 FORMAT "%8.2" ECU_ADDRESS 0x600218F6 /end MEASUREMENT
/begin MEASUREMENT DINH_stFId.FId_bInh_Pdu_DAT3_BSI_4F2h_Rcf "" UWORD DFC_OneToOne 1 100 0.00 65535.00 FORMAT "%8.2" ECU_ADDRESS 0x600218F8 /end MEASUREMENT
/begin MEASUREMENT DINH_stFId.FId_bInh_Pdu_DCDC_283h_Frz "" UWORD DFC_OneToOne 1 100 0.00 65535.00 FORMAT "%8.2" ECU_ADDRESS 0x600218FA /end MEASUREMENT
/begin MEASUREMENT DINH_stFId.FId_bInh_Pdu_DCDC_283h_Rcf "" UWORD DFC_OneToOne 1 100 0.00 65535.00 FORMAT "%8.2" ECU_ADDRESS 0x600218FC /end MEASUREMENT
/begin MEASUREMENT DINH_stFId.FId_bInh_Pdu_DCDC_293h_Frz "" UWORD DFC_OneToOne 1 100 0.00 65535.00 FORMAT "%8.2" ECU_ADDRESS 0x600218FE /end MEASUREMENT
/begin MEASUREMENT DINH_stFId.FId_bInh_Pdu_DCDC_293h_Rcf "" UWORD DFC_OneToOne 1 100 0.00 65535.00 FORMAT "%8.2" ECU_ADDRESS 0x60021900 /end MEASUREMENT
/begin MEASUREMENT DINH_stFId.FId_bInh_Pdu_DCDC_473h_Frz "" UWORD DFC_OneToOne 1 100 0.00 65535.00 FORMAT "%8.2" ECU_ADDRESS 0x60021902 /end MEASUREMENT
/begin MEASUREMENT DINH_stFId.FId_bInh_Pdu_DCDC_473h_Rcf "" UWORD DFC_OneToOne 1 100 0.00 65535.00 FORMAT "%8.2" ECU_ADDRESS 0x60021904 /end MEASUREMENT
/begin MEASUREMENT DINH_stFId.FId_bInh_Pdu_DCDC_663h_Frz "" UWORD DFC_OneToOne 1 100 0.00 65535.00 FORMAT "%8.2" ECU_ADDRESS 0x60021906 /end MEASUREMENT
/begin MEASUREMENT DINH_stFId.FId_bInh_Pdu_DCDC_663h_Rcf "" UWORD DFC_OneToOne 1 100 0.00 65535.00 FORMAT "%8.2" ECU_ADDRESS 0x60021908 /end MEASUREMENT
/begin MEASUREMENT DINH_stFId.FId_bInh_Pdu_HS3_AUTO_GEARBOX_SWITCH_STATUS_Frz "" UWORD DFC_OneToOne 1 100 0.00 65535.00 FORMAT "%8.2" ECU_ADDRESS 0x6002190A /end MEASUREMENT
/begin MEASUREMENT DINH_stFId.FId_bInh_Pdu_HS3_AUTO_GEARBOX_SWITCH_STATUS_Rcf "" UWORD DFC_OneToOne 1 100 0.00 65535.00 FORMAT "%8.2" ECU_ADDRESS 0x6002190C /end MEASUREMENT
/begin MEASUREMENT DINH_stFId.FId_bInh_Pdu_HVAC_PANEL_26h_Frz "" UWORD DFC_OneToOne 1 100 0.00 65535.00 FORMAT "%8.2" ECU_ADDRESS 0x6002190E /end MEASUREMENT
/begin MEASUREMENT DINH_stFId.FId_bInh_Pdu_HVAC_PANEL_26h_Rcf "" UWORD DFC_OneToOne 1 100 0.00 65535.00 FORMAT "%8.2" ECU_ADDRESS 0x60021910 /end MEASUREMENT
/begin MEASUREMENT DINH_stFId.FId_bInh_Pdu_HVBAT_205h_Frz "" UWORD DFC_OneToOne 1 100 0.00 65535.00 FORMAT "%8.2" ECU_ADDRESS 0x60021912 /end MEASUREMENT
/begin MEASUREMENT DINH_stFId.FId_bInh_Pdu_HVBAT_205h_Rcf "" UWORD DFC_OneToOne 1 100 0.00 65535.00 FORMAT "%8.2" ECU_ADDRESS 0x60021914 /end MEASUREMENT
/begin MEASUREMENT DINH_stFId.FId_bInh_Pdu_HVBAT_275h_Frz "" UWORD DFC_OneToOne 1 100 0.00 65535.00 FORMAT "%8.2" ECU_ADDRESS 0x60021916 /end MEASUREMENT
/begin MEASUREMENT DINH_stFId.FId_bInh_Pdu_HVBAT_275h_Rcf "" UWORD DFC_OneToOne 1 100 0.00 65535.00 FORMAT "%8.2" ECU_ADDRESS 0x60021918 /end MEASUREMENT
/begin MEASUREMENT DINH_stFId.FId_bInh_Pdu_HVBAT_285h_Frz "" UWORD DFC_OneToOne 1 100 0.00 65535.00 FORMAT "%8.2" ECU_ADDRESS 0x6002191A /end MEASUREMENT
/begin MEASUREMENT DINH_stFId.FId_bInh_Pdu_HVBAT_285h_Rcf "" UWORD DFC_OneToOne 1 100 0.00 65535.00 FORMAT "%8.2" ECU_ADDRESS 0x6002191C /end MEASUREMENT
/begin MEASUREMENT DINH_stFId.FId_bInh_Pdu_HVBAT_325h_Frz "" UWORD DFC_OneToOne 1 100 0.00 65535.00 FORMAT "%8.2" ECU_ADDRESS 0x6002191E /end MEASUREMENT
/begin MEASUREMENT DINH_stFId.FId_bInh_Pdu_HVBAT_325h_Rcf "" UWORD DFC_OneToOne 1 100 0.00 65535.00 FORMAT "%8.2" ECU_ADDRESS 0x60021920 /end MEASUREMENT
/begin MEASUREMENT DINH_stFId.FId_bInh_Pdu_HVBAT_335h_Frz "" UWORD DFC_OneToOne 1 100 0.00 65535.00 FORMAT "%8.2" ECU_ADDRESS 0x60021922 /end MEASUREMENT
/begin MEASUREMENT DINH_stFId.FId_bInh_Pdu_HVBAT_335h_Rcf "" UWORD DFC_OneToOne 1 100 0.00 65535.00 FORMAT "%8.2" ECU_ADDRESS 0x60021924 /end MEASUREMENT
/begin MEASUREMENT DINH_stFId.FId_bInh_Pdu_HVBAT_455h_Frz "" UWORD DFC_OneToOne 1 100 0.00 65535.00 FORMAT "%8.2" ECU_ADDRESS 0x60021926 /end MEASUREMENT
/begin MEASUREMENT DINH_stFId.FId_bInh_Pdu_HVBAT_455h_Rcf "" UWORD DFC_OneToOne 1 100 0.00 65535.00 FORMAT "%8.2" ECU_ADDRESS 0x60021928 /end MEASUREMENT
/begin MEASUREMENT DINH_stFId.FId_bInh_Pdu_HVBAT_535_Frz "" UWORD DFC_OneToOne 1 100 0.00 65535.00 FORMAT "%8.2" ECU_ADDRESS 0x6002192A /end MEASUREMENT
/begin MEASUREMENT DINH_stFId.FId_bInh_Pdu_HVBAT_535_Rcf "" UWORD DFC_OneToOne 1 100 0.00 65535.00 FORMAT "%8.2" ECU_ADDRESS 0x6002192C /end MEASUREMENT
/begin MEASUREMENT DINH_stFId.FId_bInh_Pdu_HVBAT_595h_Frz "" UWORD DFC_OneToOne 1 100 0.00 65535.00 FORMAT "%8.2" ECU_ADDRESS 0x6002192E /end MEASUREMENT
/begin MEASUREMENT DINH_stFId.FId_bInh_Pdu_HVBAT_595h_Rcf "" UWORD DFC_OneToOne 1 100 0.00 65535.00 FORMAT "%8.2" ECU_ADDRESS 0x60021930 /end MEASUREMENT
/begin MEASUREMENT DINH_stFId.FId_bInh_Pdu_HVBAT_635h_Frz "" UWORD DFC_OneToOne 1 100 0.00 65535.00 FORMAT "%8.2" ECU_ADDRESS 0x60021932 /end MEASUREMENT
/begin MEASUREMENT DINH_stFId.FId_bInh_Pdu_HVBAT_635h_Rcf "" UWORD DFC_OneToOne 1 100 0.00 65535.00 FORMAT "%8.2" ECU_ADDRESS 0x60021934 /end MEASUREMENT
/begin MEASUREMENT DINH_stFId.FId_bInh_Pdu_HVBAT_645h_Frz "" UWORD DFC_OneToOne 1 100 0.00 65535.00 FORMAT "%8.2" ECU_ADDRESS 0x60021936 /end MEASUREMENT
/begin MEASUREMENT DINH_stFId.FId_bInh_Pdu_HVBAT_645h_Rcf "" UWORD DFC_OneToOne 1 100 0.00 65535.00 FORMAT "%8.2" ECU_ADDRESS 0x60021938 /end MEASUREMENT
/begin MEASUREMENT DINH_stFId.FId_bInh_Pdu_HVBAT_665h_Frz "" UWORD DFC_OneToOne 1 100 0.00 65535.00 FORMAT "%8.2" ECU_ADDRESS 0x6002193A /end MEASUREMENT
/begin MEASUREMENT DINH_stFId.FId_bInh_Pdu_HVBAT_665h_Rcf "" UWORD DFC_OneToOne 1 100 0.00 65535.00 FORMAT "%8.2" ECU_ADDRESS 0x6002193C /end MEASUREMENT
/begin MEASUREMENT DINH_stFId.FId_bInh_Pdu_HVBAT_675h_Frz "" UWORD DFC_OneToOne 1 100 0.00 65535.00 FORMAT "%8.2" ECU_ADDRESS 0x6002193E /end MEASUREMENT
/begin MEASUREMENT DINH_stFId.FId_bInh_Pdu_HVBAT_675h_Rcf "" UWORD DFC_OneToOne 1 100 0.00 65535.00 FORMAT "%8.2" ECU_ADDRESS 0x60021940 /end MEASUREMENT
/begin MEASUREMENT DINH_stFId.FId_bInh_Pdu_HVBAT_THERMAL_5B5_Frz "" UWORD DFC_OneToOne 1 100 0.00 65535.00 FORMAT "%8.2" ECU_ADDRESS 0x60021942 /end MEASUREMENT
/begin MEASUREMENT DINH_stFId.FId_bInh_Pdu_HVBAT_THERMAL_5B5_Rcf "" UWORD DFC_OneToOne 1 100 0.00 65535.00 FORMAT "%8.2" ECU_ADDRESS 0x60021944 /end MEASUREMENT
/begin MEASUREMENT DINH_stFId.FId_bInh_Pdu_HVBAT_VCU_435h_Frz "" UWORD DFC_OneToOne 1 100 0.00 65535.00 FORMAT "%8.2" ECU_ADDRESS 0x60021946 /end MEASUREMENT
/begin MEASUREMENT DINH_stFId.FId_bInh_Pdu_HVBAT_VCU_435h_Rcf "" UWORD DFC_OneToOne 1 100 0.00 65535.00 FORMAT "%8.2" ECU_ADDRESS 0x60021948 /end MEASUREMENT
/begin MEASUREMENT DINH_stFId.FId_bInh_Pdu_HVBAT_VCU_543_Frz "" UWORD DFC_OneToOne 1 100 0.00 65535.00 FORMAT "%8.2" ECU_ADDRESS 0x6002194A /end MEASUREMENT
/begin MEASUREMENT DINH_stFId.FId_bInh_Pdu_HVBAT_VCU_543_Rcf "" UWORD DFC_OneToOne 1 100 0.00 65535.00 FORMAT "%8.2" ECU_ADDRESS 0x6002194C /end MEASUREMENT
/begin MEASUREMENT DINH_stFId.FId_bInh_Pdu_HVBAT_VCU_583_Frz "" UWORD DFC_OneToOne 1 100 0.00 65535.00 FORMAT "%8.2" ECU_ADDRESS 0x6002194E /end MEASUREMENT
/begin MEASUREMENT DINH_stFId.FId_bInh_Pdu_HVBAT_VCU_583_Rcf "" UWORD DFC_OneToOne 1 100 0.00 65535.00 FORMAT "%8.2" ECU_ADDRESS 0x60021950 /end MEASUREMENT
/begin MEASUREMENT DINH_stFId.FId_bInh_Pdu_INV_217h_Frz "" UWORD DFC_OneToOne 1 100 0.00 65535.00 FORMAT "%8.2" ECU_ADDRESS 0x60021952 /end MEASUREMENT
/begin MEASUREMENT DINH_stFId.FId_bInh_Pdu_INV_217h_Rcf "" UWORD DFC_OneToOne 1 100 0.00 65535.00 FORMAT "%8.2" ECU_ADDRESS 0x60021954 /end MEASUREMENT
/begin MEASUREMENT DINH_stFId.FId_bInh_Pdu_INV_227h_Frz "" UWORD DFC_OneToOne 1 100 0.00 65535.00 FORMAT "%8.2" ECU_ADDRESS 0x60021956 /end MEASUREMENT
/begin MEASUREMENT DINH_stFId.FId_bInh_Pdu_INV_227h_Rcf "" UWORD DFC_OneToOne 1 100 0.00 65535.00 FORMAT "%8.2" ECU_ADDRESS 0x60021958 /end MEASUREMENT
/begin MEASUREMENT DINH_stFId.FId_bInh_Pdu_INV_237_Frz "" UWORD DFC_OneToOne 1 100 0.00 65535.00 FORMAT "%8.2" ECU_ADDRESS 0x6002195A /end MEASUREMENT
/begin MEASUREMENT DINH_stFId.FId_bInh_Pdu_INV_237_Rcf "" UWORD DFC_OneToOne 1 100 0.00 65535.00 FORMAT "%8.2" ECU_ADDRESS 0x6002195C /end MEASUREMENT
/begin MEASUREMENT DINH_stFId.FId_bInh_Pdu_INV_427h_Frz "" UWORD DFC_OneToOne 1 100 0.00 65535.00 FORMAT "%8.2" ECU_ADDRESS 0x6002195E /end MEASUREMENT
/begin MEASUREMENT DINH_stFId.FId_bInh_Pdu_INV_427h_Rcf "" UWORD DFC_OneToOne 1 100 0.00 65535.00 FORMAT "%8.2" ECU_ADDRESS 0x60021960 /end MEASUREMENT
/begin MEASUREMENT DINH_stFId.FId_bInh_Pdu_INV_497h_Frz "" UWORD DFC_OneToOne 1 100 0.00 65535.00 FORMAT "%8.2" ECU_ADDRESS 0x60021962 /end MEASUREMENT
/begin MEASUREMENT DINH_stFId.FId_bInh_Pdu_INV_497h_Rcf "" UWORD DFC_OneToOne 1 100 0.00 65535.00 FORMAT "%8.2" ECU_ADDRESS 0x60021964 /end MEASUREMENT
/begin MEASUREMENT DINH_stFId.FId_bInh_Pdu_INV_IMMO_5C7_Frz "" UWORD DFC_OneToOne 1 100 0.00 65535.00 FORMAT "%8.2" ECU_ADDRESS 0x60021966 /end MEASUREMENT
/begin MEASUREMENT DINH_stFId.FId_bInh_Pdu_INV_IMMO_5C7_Rcf "" UWORD DFC_OneToOne 1 100 0.00 65535.00 FORMAT "%8.2" ECU_ADDRESS 0x60021968 /end MEASUREMENT
/begin MEASUREMENT DINH_stFId.FId_bInh_Pdu_IS_DAT6_BSI_592h_Frz "" UWORD DFC_OneToOne 1 100 0.00 65535.00 FORMAT "%8.2" ECU_ADDRESS 0x6002196A /end MEASUREMENT
/begin MEASUREMENT DINH_stFId.FId_bInh_Pdu_IS_DAT6_BSI_592h_Rcf "" UWORD DFC_OneToOne 1 100 0.00 65535.00 FORMAT "%8.2" ECU_ADDRESS 0x6002196C /end MEASUREMENT
/begin MEASUREMENT DINH_stFId.FId_bInh_Pdu_IS_DAT_ABR_50Dh_Frz "" UWORD DFC_OneToOne 1 100 0.00 65535.00 FORMAT "%8.2" ECU_ADDRESS 0x6002196E /end MEASUREMENT
/begin MEASUREMENT DINH_stFId.FId_bInh_Pdu_IS_DAT_ABR_50Dh_Rcf "" UWORD DFC_OneToOne 1 100 0.00 65535.00 FORMAT "%8.2" ECU_ADDRESS 0x60021970 /end MEASUREMENT
/begin MEASUREMENT DINH_stFId.FId_bInh_Pdu_IS_DAT_BSI_412h_Frz "" UWORD DFC_OneToOne 1 100 0.00 65535.00 FORMAT "%8.2" ECU_ADDRESS 0x60021972 /end MEASUREMENT
/begin MEASUREMENT DINH_stFId.FId_bInh_Pdu_IS_DAT_BSI_412h_Rcf "" UWORD DFC_OneToOne 1 100 0.00 65535.00 FORMAT "%8.2" ECU_ADDRESS 0x60021974 /end MEASUREMENT
/begin MEASUREMENT DINH_stFId.FId_bInh_Pdu_IS_DYN_ABR_38Dh_Frz "" UWORD DFC_OneToOne 1 100 0.00 65535.00 FORMAT "%8.2" ECU_ADDRESS 0x60021976 /end MEASUREMENT
/begin MEASUREMENT DINH_stFId.FId_bInh_Pdu_IS_DYN_ABR_38Dh_Rcf "" UWORD DFC_OneToOne 1 100 0.00 65535.00 FORMAT "%8.2" ECU_ADDRESS 0x60021978 /end MEASUREMENT
/begin MEASUREMENT DINH_stFId.FId_bInh_Pdu_IS_INTE_ELECTRON_BSI_092h_Frz "" UWORD DFC_OneToOne 1 100 0.00 65535.00 FORMAT "%8.2" ECU_ADDRESS 0x6002197A /end MEASUREMENT
/begin MEASUREMENT DINH_stFId.FId_bInh_Pdu_IS_INTE_ELECTRON_BSI_092h_Rcf "" UWORD DFC_OneToOne 1 100 0.00 65535.00 FORMAT "%8.2" ECU_ADDRESS 0x6002197C /end MEASUREMENT
/begin MEASUREMENT DINH_stFId.FId_bInh_Pdu_OBC_273h_Frz "" UWORD DFC_OneToOne 1 100 0.00 65535.00 FORMAT "%8.2" ECU_ADDRESS 0x6002197E /end MEASUREMENT
/begin MEASUREMENT DINH_stFId.FId_bInh_Pdu_OBC_273h_Rcf "" UWORD DFC_OneToOne 1 100 0.00 65535.00 FORMAT "%8.2" ECU_ADDRESS 0x60021980 /end MEASUREMENT
/begin MEASUREMENT DINH_stFId.FId_bInh_Pdu_OBC_453h_Frz "" UWORD DFC_OneToOne 1 100 0.00 65535.00 FORMAT "%8.2" ECU_ADDRESS 0x60021982 /end MEASUREMENT
/begin MEASUREMENT DINH_stFId.FId_bInh_Pdu_OBC_453h_Rcf "" UWORD DFC_OneToOne 1 100 0.00 65535.00 FORMAT "%8.2" ECU_ADDRESS 0x60021984 /end MEASUREMENT
/begin MEASUREMENT DINH_stFId.FId_bInh_Pdu_OBC_463h_Frz "" UWORD DFC_OneToOne 1 100 0.00 65535.00 FORMAT "%8.2" ECU_ADDRESS 0x60021986 /end MEASUREMENT
/begin MEASUREMENT DINH_stFId.FId_bInh_Pdu_OBC_463h_Rcf "" UWORD DFC_OneToOne 1 100 0.00 65535.00 FORMAT "%8.2" ECU_ADDRESS 0x60021988 /end MEASUREMENT
/begin MEASUREMENT DINH_stFId.FId_bInh_Pdu_PDU_BusVoltages_308_Frz "" UWORD DFC_OneToOne 1 100 0.00 65535.00 FORMAT "%8.2" ECU_ADDRESS 0x6002198A /end MEASUREMENT
/begin MEASUREMENT DINH_stFId.FId_bInh_Pdu_PDU_BusVoltages_308_Rcf "" UWORD DFC_OneToOne 1 100 0.00 65535.00 FORMAT "%8.2" ECU_ADDRESS 0x6002198C /end MEASUREMENT
/begin MEASUREMENT DINH_stFId.FId_bInh_Pdu_PDU_Current_318_Frz "" UWORD DFC_OneToOne 1 100 0.00 65535.00 FORMAT "%8.2" ECU_ADDRESS 0x6002198E /end MEASUREMENT
/begin MEASUREMENT DINH_stFId.FId_bInh_Pdu_PDU_Current_318_Rcf "" UWORD DFC_OneToOne 1 100 0.00 65535.00 FORMAT "%8.2" ECU_ADDRESS 0x60021990 /end MEASUREMENT
/begin MEASUREMENT DINH_stFId.FId_bInh_Pdu_SC_INFO_BCCM_442h_Frz "" UWORD DFC_OneToOne 1 100 0.00 65535.00 FORMAT "%8.2" ECU_ADDRESS 0x60021992 /end MEASUREMENT
/begin MEASUREMENT DINH_stFId.FId_bInh_Pdu_SC_INFO_BCCM_442h_Rcf "" UWORD DFC_OneToOne 1 100 0.00 65535.00 FORMAT "%8.2" ECU_ADDRESS 0x60021994 /end MEASUREMENT
/begin MEASUREMENT DINH_stFId.FId_bInh_Pdu_VCU_AIRBAG_351h_Frz "" UWORD DFC_OneToOne 1 100 0.00 65535.00 FORMAT "%8.2" ECU_ADDRESS 0x60021996 /end MEASUREMENT
/begin MEASUREMENT DINH_stFId.FId_bInh_Pdu_VCU_AIRBAG_351h_Rcf "" UWORD DFC_OneToOne 1 100 0.00 65535.00 FORMAT "%8.2" ECU_ADDRESS 0x60021998 /end MEASUREMENT
/begin MEASUREMENT DINH_stFId.FId_bInh_Pdu_VCU_eBCCM_432h_Frz "" UWORD DFC_OneToOne 1 100 0.00 65535.00 FORMAT "%8.2" ECU_ADDRESS 0x6002199C /end MEASUREMENT
/begin MEASUREMENT DINH_stFId.FId_bInh_Pdu_VCU_eBCCM_432h_Rcf "" UWORD DFC_OneToOne 1 100 0.00 65535.00 FORMAT "%8.2" ECU_ADDRESS 0x6002199E /end MEASUREMENT
/begin MEASUREMENT DINH_stFId.FId_bInh_Pdu_VCU_eBCCM_552h_Frz "" UWORD DFC_OneToOne 1 100 0.00 65535.00 FORMAT "%8.2" ECU_ADDRESS 0x600219A0 /end MEASUREMENT
/begin MEASUREMENT DINH_stFId.FId_bInh_Pdu_VCU_eBCCM_552h_Rcf "" UWORD DFC_OneToOne 1 100 0.00 65535.00 FORMAT "%8.2" ECU_ADDRESS 0x600219A2 /end MEASUREMENT
/begin MEASUREMENT DINH_stFId.FId_bInh_Pdu_eBCCM_082h_Frz "" UWORD DFC_OneToOne 1 100 0.00 65535.00 FORMAT "%8.2" ECU_ADDRESS 0x600219A4 /end MEASUREMENT
/begin MEASUREMENT DINH_stFId.FId_bInh_Pdu_eBCCM_082h_Rcf "" UWORD DFC_OneToOne 1 100 0.00 65535.00 FORMAT "%8.2" ECU_ADDRESS 0x600219A6 /end MEASUREMENT
/begin MEASUREMENT DINH_stFId.FId_bInh_Pdu_eCOMP_Information_47B_Frz "" UWORD DFC_OneToOne 1 100 0.00 65535.00 FORMAT "%8.2" ECU_ADDRESS 0x600219A8 /end MEASUREMENT
/begin MEASUREMENT DINH_stFId.FId_bInh_Pdu_eCOMP_Information_47B_Rcf "" UWORD DFC_OneToOne 1 100 0.00 65535.00 FORMAT "%8.2" ECU_ADDRESS 0x600219AA /end MEASUREMENT
/begin MEASUREMENT DINH_stFId.FId_bInh_Pdu_eCOMP_Information_48B_Frz "" UWORD DFC_OneToOne 1 100 0.00 65535.00 FORMAT "%8.2" ECU_ADDRESS 0x600219AC /end MEASUREMENT
/begin MEASUREMENT DINH_stFId.FId_bInh_Pdu_eCOMP_Information_48B_Rcf "" UWORD DFC_OneToOne 1 100 0.00 65535.00 FORMAT "%8.2" ECU_ADDRESS 0x600219AE /end MEASUREMENT
/begin MEASUREMENT DINH_stFId.FId_bInh_Sig205h_Com_iHvbActRx_Frz "" UWORD DFC_OneToOne 1 100 0.00 65535.00 FORMAT "%8.2" ECU_ADDRESS 0x600219B0 /end MEASUREMENT
/begin MEASUREMENT DINH_stFId.FId_bInh_Sig205h_Com_iHvbActRx_Rcf "" UWORD DFC_OneToOne 1 100 0.00 65535.00 FORMAT "%8.2" ECU_ADDRESS 0x600219B2 /end MEASUREMENT
/begin MEASUREMENT DINH_stFId.FId_bInh_Sig205h_Com_ratHvbSoc_Frz "" UWORD DFC_OneToOne 1 100 0.00 65535.00 FORMAT "%8.2" ECU_ADDRESS 0x600219B4 /end MEASUREMENT
/begin MEASUREMENT DINH_stFId.FId_bInh_Sig205h_Com_ratHvbSoc_Rcf "" UWORD DFC_OneToOne 1 100 0.00 65535.00 FORMAT "%8.2" ECU_ADDRESS 0x600219B6 /end MEASUREMENT
/begin MEASUREMENT DINH_stFId.FId_bInh_Sig205h_Com_stHvbChrgn_Frz "" UWORD DFC_OneToOne 1 100 0.00 65535.00 FORMAT "%8.2" ECU_ADDRESS 0x600219B8 /end MEASUREMENT
/begin MEASUREMENT DINH_stFId.FId_bInh_Sig205h_Com_stHvbChrgn_Rcf "" UWORD DFC_OneToOne 1 100 0.00 65535.00 FORMAT "%8.2" ECU_ADDRESS 0x600219BA /end MEASUREMENT
/begin MEASUREMENT DINH_stFId.FId_bInh_Sig205h_Com_uHvbAct_Frz "" UWORD DFC_OneToOne 1 100 0.00 65535.00 FORMAT "%8.2" ECU_ADDRESS 0x600219BC /end MEASUREMENT
/begin MEASUREMENT DINH_stFId.FId_bInh_Sig205h_Com_uHvbAct_Rcf "" UWORD DFC_OneToOne 1 100 0.00 65535.00 FORMAT "%8.2" ECU_ADDRESS 0x600219BE /end MEASUREMENT
/begin MEASUREMENT DINH_stFId.FId_bInh_Sig217h_ComEmac_nAct01_Frz "" UWORD DFC_OneToOne 1 100 0.00 65535.00 FORMAT "%8.2" ECU_ADDRESS 0x600219C0 /end MEASUREMENT
/begin MEASUREMENT DINH_stFId.FId_bInh_Sig217h_ComEmac_nAct01_Rcf "" UWORD DFC_OneToOne 1 100 0.00 65535.00 FORMAT "%8.2" ECU_ADDRESS 0x600219C2 /end MEASUREMENT
/begin MEASUREMENT DINH_stFId.FId_bInh_Sig217h_ComEmac_tqAckd01_Frz "" UWORD DFC_OneToOne 1 100 0.00 65535.00 FORMAT "%8.2" ECU_ADDRESS 0x600219C4 /end MEASUREMENT
/begin MEASUREMENT DINH_stFId.FId_bInh_Sig217h_ComEmac_tqAckd01_Rcf "" UWORD DFC_OneToOne 1 100 0.00 65535.00 FORMAT "%8.2" ECU_ADDRESS 0x600219C6 /end MEASUREMENT
/begin MEASUREMENT DINH_stFId.FId_bInh_Sig217h_ComEmac_tqAct01_Frz "" UWORD DFC_OneToOne 1 100 0.00 65535.00 FORMAT "%8.2" ECU_ADDRESS 0x600219C8 /end MEASUREMENT
/begin MEASUREMENT DINH_stFId.FId_bInh_Sig217h_ComEmac_tqAct01_Rcf "" UWORD DFC_OneToOne 1 100 0.00 65535.00 FORMAT "%8.2" ECU_ADDRESS 0x600219CA /end MEASUREMENT
/begin MEASUREMENT DINH_stFId.FId_bInh_Sig217h_ComEmac_uDcLnk01_Frz "" UWORD DFC_OneToOne 1 100 0.00 65535.00 FORMAT "%8.2" ECU_ADDRESS 0x600219CC /end MEASUREMENT
/begin MEASUREMENT DINH_stFId.FId_bInh_Sig217h_ComEmac_uDcLnk01_Rcf "" UWORD DFC_OneToOne 1 100 0.00 65535.00 FORMAT "%8.2" ECU_ADDRESS 0x600219CE /end MEASUREMENT
/begin MEASUREMENT DINH_stFId.FId_bInh_Sig227h_ComEmac_iDcLnk01_Frz "" UWORD DFC_OneToOne 1 100 0.00 65535.00 FORMAT "%8.2" ECU_ADDRESS 0x600219D0 /end MEASUREMENT
/begin MEASUREMENT DINH_stFId.FId_bInh_Sig227h_ComEmac_iDcLnk01_Rcf "" UWORD DFC_OneToOne 1 100 0.00 65535.00 FORMAT "%8.2" ECU_ADDRESS 0x600219D2 /end MEASUREMENT
/begin MEASUREMENT DINH_stFId.FId_bInh_Sig227h_ComEmac_pwrInstnsInpRx_Frz "" UWORD DFC_OneToOne 1 100 0.00 65535.00 FORMAT "%8.2" ECU_ADDRESS 0x600219D4 /end MEASUREMENT
/begin MEASUREMENT DINH_stFId.FId_bInh_Sig227h_ComEmac_pwrInstnsInpRx_Rcf "" UWORD DFC_OneToOne 1 100 0.00 65535.00 FORMAT "%8.2" ECU_ADDRESS 0x600219D6 /end MEASUREMENT
/begin MEASUREMENT DINH_stFId.FId_bInh_Sig227h_ComEmac_tqAbsltMax01_Frz "" UWORD DFC_OneToOne 1 100 0.00 65535.00 FORMAT "%8.2" ECU_ADDRESS 0x600219D8 /end MEASUREMENT
/begin MEASUREMENT DINH_stFId.FId_bInh_Sig227h_ComEmac_tqAbsltMax01_Rcf "" UWORD DFC_OneToOne 1 100 0.00 65535.00 FORMAT "%8.2" ECU_ADDRESS 0x600219DA /end MEASUREMENT
/begin MEASUREMENT DINH_stFId.FId_bInh_Sig227h_ComEmac_tqAbsltMaxRx01_Frz "" UWORD DFC_OneToOne 1 100 0.00 65535.00 FORMAT "%8.2" ECU_ADDRESS 0x600219DC /end MEASUREMENT
/begin MEASUREMENT DINH_stFId.FId_bInh_Sig227h_ComEmac_tqAbsltMaxRx01_Rcf "" UWORD DFC_OneToOne 1 100 0.00 65535.00 FORMAT "%8.2" ECU_ADDRESS 0x600219DE /end MEASUREMENT
/begin MEASUREMENT DINH_stFId.FId_bInh_Sig227h_ComEmac_tqAbsltMin01_Frz "" UWORD DFC_OneToOne 1 100 0.00 65535.00 FORMAT "%8.2" ECU_ADDRESS 0x600219E0 /end MEASUREMENT
/begin MEASUREMENT DINH_stFId.FId_bInh_Sig227h_ComEmac_tqAbsltMin01_Rcf "" UWORD DFC_OneToOne 1 100 0.00 65535.00 FORMAT "%8.2" ECU_ADDRESS 0x600219E2 /end MEASUREMENT
/begin MEASUREMENT DINH_stFId.FId_bInh_Sig227h_ComEmac_tqAbsltMinRx01_Frz "" UWORD DFC_OneToOne 1 100 0.00 65535.00 FORMAT "%8.2" ECU_ADDRESS 0x600219E4 /end MEASUREMENT
/begin MEASUREMENT DINH_stFId.FId_bInh_Sig227h_ComEmac_tqAbsltMinRx01_Rcf "" UWORD DFC_OneToOne 1 100 0.00 65535.00 FORMAT "%8.2" ECU_ADDRESS 0x600219E6 /end MEASUREMENT
/begin MEASUREMENT DINH_stFId.FId_bInh_Sig237h_ComEmac_stActvDcha_Frz "" UWORD DFC_OneToOne 1 100 0.00 65535.00 FORMAT "%8.2" ECU_ADDRESS 0x600219E8 /end MEASUREMENT
/begin MEASUREMENT DINH_stFId.FId_bInh_Sig237h_ComEmac_stActvDcha_Rcf "" UWORD DFC_OneToOne 1 100 0.00 65535.00 FORMAT "%8.2" ECU_ADDRESS 0x600219EA /end MEASUREMENT
/begin MEASUREMENT DINH_stFId.FId_bInh_Sig237h_ComEmac_stEVLmp_Frz "" UWORD DFC_OneToOne 1 100 0.00 65535.00 FORMAT "%8.2" ECU_ADDRESS 0x600219EC /end MEASUREMENT
/begin MEASUREMENT DINH_stFId.FId_bInh_Sig237h_ComEmac_stEVLmp_Rcf "" UWORD DFC_OneToOne 1 100 0.00 65535.00 FORMAT "%8.2" ECU_ADDRESS 0x600219EE /end MEASUREMENT
/begin MEASUREMENT DINH_stFId.FId_bInh_Sig237h_ComEmac_stMod01Rx_Frz "" UWORD DFC_OneToOne 1 100 0.00 65535.00 FORMAT "%8.2" ECU_ADDRESS 0x600219F0 /end MEASUREMENT
/begin MEASUREMENT DINH_stFId.FId_bInh_Sig237h_ComEmac_stMod01Rx_Rcf "" UWORD DFC_OneToOne 1 100 0.00 65535.00 FORMAT "%8.2" ECU_ADDRESS 0x600219F2 /end MEASUREMENT
/begin MEASUREMENT DINH_stFId.FId_bInh_Sig237h_ComEmac_stMstWrnLmp_Frz "" UWORD DFC_OneToOne 1 100 0.00 65535.00 FORMAT "%8.2" ECU_ADDRESS 0x600219F4 /end MEASUREMENT
/begin MEASUREMENT DINH_stFId.FId_bInh_Sig237h_ComEmac_stMstWrnLmp_Rcf "" UWORD DFC_OneToOne 1 100 0.00 65535.00 FORMAT "%8.2" ECU_ADDRESS 0x600219F6 /end MEASUREMENT
/begin MEASUREMENT DINH_stFId.FId_bInh_Sig237h_ComEmac_stSVSLmp_Frz "" UWORD DFC_OneToOne 1 100 0.00 65535.00 FORMAT "%8.2" ECU_ADDRESS 0x600219F8 /end MEASUREMENT
/begin MEASUREMENT DINH_stFId.FId_bInh_Sig237h_ComEmac_stSVSLmp_Rcf "" UWORD DFC_OneToOne 1 100 0.00 65535.00 FORMAT "%8.2" ECU_ADDRESS 0x600219FA /end MEASUREMENT
/begin MEASUREMENT DINH_stFId.FId_bInh_Sig237h_ComEmac_tqStabnMin_Frz "" UWORD DFC_OneToOne 1 100 0.00 65535.00 FORMAT "%8.2" ECU_ADDRESS 0x600219FC /end MEASUREMENT
/begin MEASUREMENT DINH_stFId.FId_bInh_Sig237h_ComEmac_tqStabnMin_Rcf "" UWORD DFC_OneToOne 1 100 0.00 65535.00 FORMAT "%8.2" ECU_ADDRESS 0x600219FE /end MEASUREMENT
/begin MEASUREMENT DINH_stFId.FId_bInh_Sig237h_Com_stIIvtrFltLvl01_Frz "" UWORD DFC_OneToOne 1 100 0.00 65535.00 FORMAT "%8.2" ECU_ADDRESS 0x60021A00 /end MEASUREMENT
/begin MEASUREMENT DINH_stFId.FId_bInh_Sig237h_Com_stIIvtrFltLvl01_Rcf "" UWORD DFC_OneToOne 1 100 0.00 65535.00 FORMAT "%8.2" ECU_ADDRESS 0x60021A02 /end MEASUREMENT
/begin MEASUREMENT DINH_stFId.FId_bInh_Sig259h_Com_flgEcoNormReqRx_Frz "" UWORD DFC_OneToOne 1 100 0.00 65535.00 FORMAT "%8.2" ECU_ADDRESS 0x60021A06 /end MEASUREMENT
/begin MEASUREMENT DINH_stFId.FId_bInh_Sig259h_Com_flgEcoNormReqRx_Rcf "" UWORD DFC_OneToOne 1 100 0.00 65535.00 FORMAT "%8.2" ECU_ADDRESS 0x60021A08 /end MEASUREMENT
/begin MEASUREMENT DINH_stFId.FId_bInh_Sig259h_Com_stGearLvrPos_Frz "" UWORD DFC_OneToOne 1 100 0.00 65535.00 FORMAT "%8.2" ECU_ADDRESS 0x60021A0A /end MEASUREMENT
/begin MEASUREMENT DINH_stFId.FId_bInh_Sig259h_Com_stGearLvrPos_Rcf "" UWORD DFC_OneToOne 1 100 0.00 65535.00 FORMAT "%8.2" ECU_ADDRESS 0x60021A0C /end MEASUREMENT
/begin MEASUREMENT DINH_stFId.FId_bInh_Sig259h_Com_steTogFailrLvl_Frz "" UWORD DFC_OneToOne 1 100 0.00 65535.00 FORMAT "%8.2" ECU_ADDRESS 0x60021A0E /end MEASUREMENT
/begin MEASUREMENT DINH_stFId.FId_bInh_Sig259h_Com_steTogFailrLvl_Rcf "" UWORD DFC_OneToOne 1 100 0.00 65535.00 FORMAT "%8.2" ECU_ADDRESS 0x60021A10 /end MEASUREMENT
/begin MEASUREMENT DINH_stFId.FId_bInh_Sig26h_Com_stAC_Frz "" UWORD DFC_OneToOne 1 100 0.00 65535.00 FORMAT "%8.2" ECU_ADDRESS 0x60021A12 /end MEASUREMENT
/begin MEASUREMENT DINH_stFId.FId_bInh_Sig26h_Com_stAC_Rcf "" UWORD DFC_OneToOne 1 100 0.00 65535.00 FORMAT "%8.2" ECU_ADDRESS 0x60021A14 /end MEASUREMENT
/begin MEASUREMENT DINH_stFId.FId_bInh_Sig26h_Com_stEvapTFlt_Frz "" UWORD DFC_OneToOne 1 100 0.00 65535.00 FORMAT "%8.2" ECU_ADDRESS 0x60021A16 /end MEASUREMENT
/begin MEASUREMENT DINH_stFId.FId_bInh_Sig26h_Com_stEvapTFlt_Rcf "" UWORD DFC_OneToOne 1 100 0.00 65535.00 FORMAT "%8.2" ECU_ADDRESS 0x60021A18 /end MEASUREMENT
/begin MEASUREMENT DINH_stFId.FId_bInh_Sig26h_Com_stHvacBlwrFront_Frz "" UWORD DFC_OneToOne 1 100 0.00 65535.00 FORMAT "%8.2" ECU_ADDRESS 0x60021A1A /end MEASUREMENT
/begin MEASUREMENT DINH_stFId.FId_bInh_Sig26h_Com_stHvacBlwrFront_Rcf "" UWORD DFC_OneToOne 1 100 0.00 65535.00 FORMAT "%8.2" ECU_ADDRESS 0x60021A1C /end MEASUREMENT
/begin MEASUREMENT DINH_stFId.FId_bInh_Sig26h_Com_stHvacKnobPosn_Frz "" UWORD DFC_OneToOne 1 100 0.00 65535.00 FORMAT "%8.2" ECU_ADDRESS 0x60021A1E /end MEASUREMENT
/begin MEASUREMENT DINH_stFId.FId_bInh_Sig26h_Com_stHvacKnobPosn_Rcf "" UWORD DFC_OneToOne 1 100 0.00 65535.00 FORMAT "%8.2" ECU_ADDRESS 0x60021A20 /end MEASUREMENT
/begin MEASUREMENT DINH_stFId.FId_bInh_Sig26h_Com_stHvacPanPotiFlt_Frz "" UWORD DFC_OneToOne 1 100 0.00 65535.00 FORMAT "%8.2" ECU_ADDRESS 0x60021A22 /end MEASUREMENT
/begin MEASUREMENT DINH_stFId.FId_bInh_Sig26h_Com_stHvacPanPotiFlt_Rcf "" UWORD DFC_OneToOne 1 100 0.00 65535.00 FORMAT "%8.2" ECU_ADDRESS 0x60021A24 /end MEASUREMENT
/begin MEASUREMENT DINH_stFId.FId_bInh_Sig26h_Com_stReFogReq_Frz "" UWORD DFC_OneToOne 1 100 0.00 65535.00 FORMAT "%8.2" ECU_ADDRESS 0x60021A26 /end MEASUREMENT
/begin MEASUREMENT DINH_stFId.FId_bInh_Sig26h_Com_stReFogReq_Rcf "" UWORD DFC_OneToOne 1 100 0.00 65535.00 FORMAT "%8.2" ECU_ADDRESS 0x60021A28 /end MEASUREMENT
/begin MEASUREMENT DINH_stFId.FId_bInh_Sig26h_Com_tEvapT_Frz "" UWORD DFC_OneToOne 1 100 0.00 65535.00 FORMAT "%8.2" ECU_ADDRESS 0x60021A2A /end MEASUREMENT
/begin MEASUREMENT DINH_stFId.FId_bInh_Sig26h_Com_tEvapT_Rcf "" UWORD DFC_OneToOne 1 100 0.00 65535.00 FORMAT "%8.2" ECU_ADDRESS 0x60021A2C /end MEASUREMENT
/begin MEASUREMENT DINH_stFId.FId_bInh_Sig273h_ComChrgr_flgChrgrErrLvl_Frz "" UWORD DFC_OneToOne 1 100 0.00 65535.00 FORMAT "%8.2" ECU_ADDRESS 0x60021A2E /end MEASUREMENT
/begin MEASUREMENT DINH_stFId.FId_bInh_Sig273h_ComChrgr_flgChrgrErrLvl_Rcf "" UWORD DFC_OneToOne 1 100 0.00 65535.00 FORMAT "%8.2" ECU_ADDRESS 0x60021A30 /end MEASUREMENT
/begin MEASUREMENT DINH_stFId.FId_bInh_Sig273h_ComChrgr_pwrOutpCpby_Frz "" UWORD DFC_OneToOne 1 100 0.00 65535.00 FORMAT "%8.2" ECU_ADDRESS 0x60021A32 /end MEASUREMENT
/begin MEASUREMENT DINH_stFId.FId_bInh_Sig273h_ComChrgr_pwrOutpCpby_Rcf "" UWORD DFC_OneToOne 1 100 0.00 65535.00 FORMAT "%8.2" ECU_ADDRESS 0x60021A34 /end MEASUREMENT
/begin MEASUREMENT DINH_stFId.FId_bInh_Sig275h_Com_iHvbDchaMaxSho_Frz "" UWORD DFC_OneToOne 1 100 0.00 65535.00 FORMAT "%8.2" ECU_ADDRESS 0x60021A36 /end MEASUREMENT
/begin MEASUREMENT DINH_stFId.FId_bInh_Sig275h_Com_iHvbDchaMaxSho_Rcf "" UWORD DFC_OneToOne 1 100 0.00 65535.00 FORMAT "%8.2" ECU_ADDRESS 0x60021A38 /end MEASUREMENT
/begin MEASUREMENT DINH_stFId.FId_bInh_Sig275h_Com_pwrMaxDchaSho_Frz "" UWORD DFC_OneToOne 1 100 0.00 65535.00 FORMAT "%8.2" ECU_ADDRESS 0x60021A3A /end MEASUREMENT
/begin MEASUREMENT DINH_stFId.FId_bInh_Sig275h_Com_pwrMaxDchaSho_Rcf "" UWORD DFC_OneToOne 1 100 0.00 65535.00 FORMAT "%8.2" ECU_ADDRESS 0x60021A3C /end MEASUREMENT
/begin MEASUREMENT DINH_stFId.FId_bInh_Sig283h_Com_iDcdcHvActRvsn1_Frz "" UWORD DFC_OneToOne 1 100 0.00 65535.00 FORMAT "%8.2" ECU_ADDRESS 0x60021A3E /end MEASUREMENT
/begin MEASUREMENT DINH_stFId.FId_bInh_Sig283h_Com_iDcdcHvActRvsn1_Rcf "" UWORD DFC_OneToOne 1 100 0.00 65535.00 FORMAT "%8.2" ECU_ADDRESS 0x60021A40 /end MEASUREMENT
/begin MEASUREMENT DINH_stFId.FId_bInh_Sig283h_Com_iDcdcLvActRvsn1_Frz "" UWORD DFC_OneToOne 1 100 0.00 65535.00 FORMAT "%8.2" ECU_ADDRESS 0x60021A42 /end MEASUREMENT
/begin MEASUREMENT DINH_stFId.FId_bInh_Sig283h_Com_iDcdcLvActRvsn1_Rcf "" UWORD DFC_OneToOne 1 100 0.00 65535.00 FORMAT "%8.2" ECU_ADDRESS 0x60021A44 /end MEASUREMENT
/begin MEASUREMENT DINH_stFId.FId_bInh_Sig283h_Com_uDcdcHvAct_Frz "" UWORD DFC_OneToOne 1 100 0.00 65535.00 FORMAT "%8.2" ECU_ADDRESS 0x60021A46 /end MEASUREMENT
/begin MEASUREMENT DINH_stFId.FId_bInh_Sig283h_Com_uDcdcHvAct_Rcf "" UWORD DFC_OneToOne 1 100 0.00 65535.00 FORMAT "%8.2" ECU_ADDRESS 0x60021A48 /end MEASUREMENT
/begin MEASUREMENT DINH_stFId.FId_bInh_Sig283h_Com_uDcdcLvAct_Frz "" UWORD DFC_OneToOne 1 100 0.00 65535.00 FORMAT "%8.2" ECU_ADDRESS 0x60021A4A /end MEASUREMENT
/begin MEASUREMENT DINH_stFId.FId_bInh_Sig283h_Com_uDcdcLvAct_Rcf "" UWORD DFC_OneToOne 1 100 0.00 65535.00 FORMAT "%8.2" ECU_ADDRESS 0x60021A4C /end MEASUREMENT
/begin MEASUREMENT DINH_stFId.FId_bInh_Sig285h_Com_iHvbChrgMaxSho_Frz "" UWORD DFC_OneToOne 1 100 0.00 65535.00 FORMAT "%8.2" ECU_ADDRESS 0x60021A4E /end MEASUREMENT
/begin MEASUREMENT DINH_stFId.FId_bInh_Sig285h_Com_iHvbChrgMaxSho_Rcf "" UWORD DFC_OneToOne 1 100 0.00 65535.00 FORMAT "%8.2" ECU_ADDRESS 0x60021A50 /end MEASUREMENT
/begin MEASUREMENT DINH_stFId.FId_bInh_Sig285h_Com_pwrMaxChrgSho_Frz "" UWORD DFC_OneToOne 1 100 0.00 65535.00 FORMAT "%8.2" ECU_ADDRESS 0x60021A52 /end MEASUREMENT
/begin MEASUREMENT DINH_stFId.FId_bInh_Sig285h_Com_pwrMaxChrgSho_Rcf "" UWORD DFC_OneToOne 1 100 0.00 65535.00 FORMAT "%8.2" ECU_ADDRESS 0x60021A54 /end MEASUREMENT
/begin MEASUREMENT DINH_stFId.FId_bInh_Sig293h_Com_pwrDcdcOutpCpby_Frz "" UWORD DFC_OneToOne 1 100 0.00 65535.00 FORMAT "%8.2" ECU_ADDRESS 0x60021A56 /end MEASUREMENT
/begin MEASUREMENT DINH_stFId.FId_bInh_Sig293h_Com_pwrDcdcOutpCpby_Rcf "" UWORD DFC_OneToOne 1 100 0.00 65535.00 FORMAT "%8.2" ECU_ADDRESS 0x60021A58 /end MEASUREMENT
/begin MEASUREMENT DINH_stFId.FId_bInh_Sig293h_Com_stDcdcFltLvl_Frz "" UWORD DFC_OneToOne 1 100 0.00 65535.00 FORMAT "%8.2" ECU_ADDRESS 0x60021A5A /end MEASUREMENT
/begin MEASUREMENT DINH_stFId.FId_bInh_Sig293h_Com_stDcdcFltLvl_Rcf "" UWORD DFC_OneToOne 1 100 0.00 65535.00 FORMAT "%8.2" ECU_ADDRESS 0x60021A5C /end MEASUREMENT
/begin MEASUREMENT DINH_stFId.FId_bInh_Sig325h_Com_rHvbIsoMeasmt_Frz "" UWORD DFC_OneToOne 1 100 0.00 65535.00 FORMAT "%8.2" ECU_ADDRESS 0x60021A5E /end MEASUREMENT
/begin MEASUREMENT DINH_stFId.FId_bInh_Sig325h_Com_rHvbIsoMeasmt_Rcf "" UWORD DFC_OneToOne 1 100 0.00 65535.00 FORMAT "%8.2" ECU_ADDRESS 0x60021A60 /end MEASUREMENT
/begin MEASUREMENT DINH_stFId.FId_bInh_Sig325h_Com_stHvbIntlckRx_Frz "" UWORD DFC_OneToOne 1 100 0.00 65535.00 FORMAT "%8.2" ECU_ADDRESS 0x60021A62 /end MEASUREMENT
/begin MEASUREMENT DINH_stFId.FId_bInh_Sig325h_Com_stHvbIntlckRx_Rcf "" UWORD DFC_OneToOne 1 100 0.00 65535.00 FORMAT "%8.2" ECU_ADDRESS 0x60021A64 /end MEASUREMENT
/begin MEASUREMENT DINH_stFId.FId_bInh_Sig325h_Com_stHvbIsoFltRx_Frz "" UWORD DFC_OneToOne 1 100 0.00 65535.00 FORMAT "%8.2" ECU_ADDRESS 0x60021A66 /end MEASUREMENT
/begin MEASUREMENT DINH_stFId.FId_bInh_Sig325h_Com_stHvbIsoFltRx_Rcf "" UWORD DFC_OneToOne 1 100 0.00 65535.00 FORMAT "%8.2" ECU_ADDRESS 0x60021A68 /end MEASUREMENT
/begin MEASUREMENT DINH_stFId.FId_bInh_Sig325h_Com_stHvbSrvPlgRx_Frz "" UWORD DFC_OneToOne 1 100 0.00 65535.00 FORMAT "%8.2" ECU_ADDRESS 0x60021A6A /end MEASUREMENT
/begin MEASUREMENT DINH_stFId.FId_bInh_Sig325h_Com_stHvbSrvPlgRx_Rcf "" UWORD DFC_OneToOne 1 100 0.00 65535.00 FORMAT "%8.2" ECU_ADDRESS 0x60021A6C /end MEASUREMENT
/begin MEASUREMENT DINH_stFId.FId_bInh_Sig325h_Com_tHvbMax_Frz "" UWORD DFC_OneToOne 1 100 0.00 65535.00 FORMAT "%8.2" ECU_ADDRESS 0x60021A6E /end MEASUREMENT
/begin MEASUREMENT DINH_stFId.FId_bInh_Sig325h_Com_tHvbMax_Rcf "" UWORD DFC_OneToOne 1 100 0.00 65535.00 FORMAT "%8.2" ECU_ADDRESS 0x60021A70 /end MEASUREMENT
/begin MEASUREMENT DINH_stFId.FId_bInh_Sig335h_Com_iHvbDes_Frz "" UWORD DFC_OneToOne 1 100 0.00 65535.00 FORMAT "%8.2" ECU_ADDRESS 0x60021A72 /end MEASUREMENT
/begin MEASUREMENT DINH_stFId.FId_bInh_Sig335h_Com_iHvbDes_Rcf "" UWORD DFC_OneToOne 1 100 0.00 65535.00 FORMAT "%8.2" ECU_ADDRESS 0x60021A74 /end MEASUREMENT
/begin MEASUREMENT DINH_stFId.FId_bInh_Sig335h_Com_iHvbNomChrgn_Frz "" UWORD DFC_OneToOne 1 100 0.00 65535.00 FORMAT "%8.2" ECU_ADDRESS 0x60021A76 /end MEASUREMENT
/begin MEASUREMENT DINH_stFId.FId_bInh_Sig335h_Com_iHvbNomChrgn_Rcf "" UWORD DFC_OneToOne 1 100 0.00 65535.00 FORMAT "%8.2" ECU_ADDRESS 0x60021A78 /end MEASUREMENT
/begin MEASUREMENT DINH_stFId.FId_bInh_Sig335h_Com_uHvbDcBus_Frz "" UWORD DFC_OneToOne 1 100 0.00 65535.00 FORMAT "%8.2" ECU_ADDRESS 0x60021A7A /end MEASUREMENT
/begin MEASUREMENT DINH_stFId.FId_bInh_Sig335h_Com_uHvbDcBus_Rcf "" UWORD DFC_OneToOne 1 100 0.00 65535.00 FORMAT "%8.2" ECU_ADDRESS 0x60021A7C /end MEASUREMENT
/begin MEASUREMENT DINH_stFId.FId_bInh_Sig335h_Com_uHvbLimHi_Frz "" UWORD DFC_OneToOne 1 100 0.00 65535.00 FORMAT "%8.2" ECU_ADDRESS 0x60021A7E /end MEASUREMENT
/begin MEASUREMENT DINH_stFId.FId_bInh_Sig335h_Com_uHvbLimHi_Rcf "" UWORD DFC_OneToOne 1 100 0.00 65535.00 FORMAT "%8.2" ECU_ADDRESS 0x60021A80 /end MEASUREMENT
/begin MEASUREMENT DINH_stFId.FId_bInh_Sig38Dh_Com_flgVehSpdAvl_Frz "" UWORD DFC_OneToOne 1 100 0.00 65535.00 FORMAT "%8.2" ECU_ADDRESS 0x60021A82 /end MEASUREMENT
/begin MEASUREMENT DINH_stFId.FId_bInh_Sig38Dh_Com_flgVehSpdAvl_Rcf "" UWORD DFC_OneToOne 1 100 0.00 65535.00 FORMAT "%8.2" ECU_ADDRESS 0x60021A84 /end MEASUREMENT
/begin MEASUREMENT DINH_stFId.FId_bInh_Sig38Dh_Com_vVeh_Frz "" UWORD DFC_OneToOne 1 100 0.00 65535.00 FORMAT "%8.2" ECU_ADDRESS 0x60021A86 /end MEASUREMENT
/begin MEASUREMENT DINH_stFId.FId_bInh_Sig38Dh_Com_vVeh_Rcf "" UWORD DFC_OneToOne 1 100 0.00 65535.00 FORMAT "%8.2" ECU_ADDRESS 0x60021A88 /end MEASUREMENT
/begin MEASUREMENT DINH_stFId.FId_bInh_Sig427h_ComEmac_stIvtrOpMod01_Frz "" UWORD DFC_OneToOne 1 100 0.00 65535.00 FORMAT "%8.2" ECU_ADDRESS 0x60021A8A /end MEASUREMENT
/begin MEASUREMENT DINH_stFId.FId_bInh_Sig427h_ComEmac_stIvtrOpMod01_Rcf "" UWORD DFC_OneToOne 1 100 0.00 65535.00 FORMAT "%8.2" ECU_ADDRESS 0x60021A8C /end MEASUREMENT
/begin MEASUREMENT DINH_stFId.FId_bInh_Sig427h_ComEmac_tInvr01_Frz "" UWORD DFC_OneToOne 1 100 0.00 65535.00 FORMAT "%8.2" ECU_ADDRESS 0x60021A8E /end MEASUREMENT
/begin MEASUREMENT DINH_stFId.FId_bInh_Sig427h_ComEmac_tInvr01_Rcf "" UWORD DFC_OneToOne 1 100 0.00 65535.00 FORMAT "%8.2" ECU_ADDRESS 0x60021A90 /end MEASUREMENT
/begin MEASUREMENT DINH_stFId.FId_bInh_Sig427h_ComEmac_tIvtrCooltIn01_Frz "" UWORD DFC_OneToOne 1 100 0.00 65535.00 FORMAT "%8.2" ECU_ADDRESS 0x60021A92 /end MEASUREMENT
/begin MEASUREMENT DINH_stFId.FId_bInh_Sig427h_ComEmac_tIvtrCooltIn01_Rcf "" UWORD DFC_OneToOne 1 100 0.00 65535.00 FORMAT "%8.2" ECU_ADDRESS 0x60021A94 /end MEASUREMENT
/begin MEASUREMENT DINH_stFId.FId_bInh_Sig427h_ComEmac_tMac01_Frz "" UWORD DFC_OneToOne 1 100 0.00 65535.00 FORMAT "%8.2" ECU_ADDRESS 0x60021A96 /end MEASUREMENT
/begin MEASUREMENT DINH_stFId.FId_bInh_Sig427h_ComEmac_tMac01_Rcf "" UWORD DFC_OneToOne 1 100 0.00 65535.00 FORMAT "%8.2" ECU_ADDRESS 0x60021A98 /end MEASUREMENT
/begin MEASUREMENT DINH_stFId.FId_bInh_Sig427h_ComEmac_tqPtd01_Frz "" UWORD DFC_OneToOne 1 100 0.00 65535.00 FORMAT "%8.2" ECU_ADDRESS 0x60021A9A /end MEASUREMENT
/begin MEASUREMENT DINH_stFId.FId_bInh_Sig427h_ComEmac_tqPtd01_Rcf "" UWORD DFC_OneToOne 1 100 0.00 65535.00 FORMAT "%8.2" ECU_ADDRESS 0x60021A9C /end MEASUREMENT
/begin MEASUREMENT DINH_stFId.FId_bInh_Sig432h_Com_stMainWkuReq_Frz "" UWORD DFC_OneToOne 1 100 0.00 65535.00 FORMAT "%8.2" ECU_ADDRESS 0x60021A9E /end MEASUREMENT
/begin MEASUREMENT DINH_stFId.FId_bInh_Sig432h_Com_stMainWkuReq_Rcf "" UWORD DFC_OneToOne 1 100 0.00 65535.00 FORMAT "%8.2" ECU_ADDRESS 0x60021AA0 /end MEASUREMENT
/begin MEASUREMENT DINH_stFId.FId_bInh_Sig435h_Com_HvbMaxSnsrTempRx_Frz "" UWORD DFC_OneToOne 1 100 0.00 65535.00 FORMAT "%8.2" ECU_ADDRESS 0x60021AA2 /end MEASUREMENT
/begin MEASUREMENT DINH_stFId.FId_bInh_Sig435h_Com_HvbMaxSnsrTempRx_Rcf "" UWORD DFC_OneToOne 1 100 0.00 65535.00 FORMAT "%8.2" ECU_ADDRESS 0x60021AA4 /end MEASUREMENT
/begin MEASUREMENT DINH_stFId.FId_bInh_Sig435h_Com_nrSerMaxCell_Frz "" UWORD DFC_OneToOne 1 100 0.00 65535.00 FORMAT "%8.2" ECU_ADDRESS 0x60021AA6 /end MEASUREMENT
/begin MEASUREMENT DINH_stFId.FId_bInh_Sig435h_Com_nrSerMaxCell_Rcf "" UWORD DFC_OneToOne 1 100 0.00 65535.00 FORMAT "%8.2" ECU_ADDRESS 0x60021AA8 /end MEASUREMENT
/begin MEASUREMENT DINH_stFId.FId_bInh_Sig435h_Com_nrSerMinCell_Frz "" UWORD DFC_OneToOne 1 100 0.00 65535.00 FORMAT "%8.2" ECU_ADDRESS 0x60021AAA /end MEASUREMENT
/begin MEASUREMENT DINH_stFId.FId_bInh_Sig435h_Com_nrSerMinCell_Rcf "" UWORD DFC_OneToOne 1 100 0.00 65535.00 FORMAT "%8.2" ECU_ADDRESS 0x60021AAC /end MEASUREMENT
/begin MEASUREMENT DINH_stFId.FId_bInh_Sig435h_Com_uHvbMaxCell_Frz "" UWORD DFC_OneToOne 1 100 0.00 65535.00 FORMAT "%8.2" ECU_ADDRESS 0x60021AAE /end MEASUREMENT
/begin MEASUREMENT DINH_stFId.FId_bInh_Sig435h_Com_uHvbMaxCell_Rcf "" UWORD DFC_OneToOne 1 100 0.00 65535.00 FORMAT "%8.2" ECU_ADDRESS 0x60021AB0 /end MEASUREMENT
/begin MEASUREMENT DINH_stFId.FId_bInh_Sig435h_Com_uHvbMinCell_Frz "" UWORD DFC_OneToOne 1 100 0.00 65535.00 FORMAT "%8.2" ECU_ADDRESS 0x60021AB2 /end MEASUREMENT
/begin MEASUREMENT DINH_stFId.FId_bInh_Sig435h_Com_uHvbMinCell_Rcf "" UWORD DFC_OneToOne 1 100 0.00 65535.00 FORMAT "%8.2" ECU_ADDRESS 0x60021AB4 /end MEASUREMENT
/begin MEASUREMENT DINH_stFId.FId_bInh_Sig442h_Com_stBlowrRly_Frz "" UWORD DFC_OneToOne 1 100 0.00 65535.00 FORMAT "%8.2" ECU_ADDRESS 0x60021AB6 /end MEASUREMENT
/begin MEASUREMENT DINH_stFId.FId_bInh_Sig442h_Com_stBlowrRly_Rcf "" UWORD DFC_OneToOne 1 100 0.00 65535.00 FORMAT "%8.2" ECU_ADDRESS 0x60021AB8 /end MEASUREMENT
/begin MEASUREMENT DINH_stFId.FId_bInh_Sig453h_ComChrgr_iAcMax_Frz "" UWORD DFC_OneToOne 1 100 0.00 65535.00 FORMAT "%8.2" ECU_ADDRESS 0x60021ABA /end MEASUREMENT
/begin MEASUREMENT DINH_stFId.FId_bInh_Sig453h_ComChrgr_iAcMax_Rcf "" UWORD DFC_OneToOne 1 100 0.00 65535.00 FORMAT "%8.2" ECU_ADDRESS 0x60021ABC /end MEASUREMENT
/begin MEASUREMENT DINH_stFId.FId_bInh_Sig453h_ComChrgr_pwrInAct_Frz "" UWORD DFC_OneToOne 1 100 0.00 65535.00 FORMAT "%8.2" ECU_ADDRESS 0x60021ABE /end MEASUREMENT
/begin MEASUREMENT DINH_stFId.FId_bInh_Sig453h_ComChrgr_pwrInAct_Rcf "" UWORD DFC_OneToOne 1 100 0.00 65535.00 FORMAT "%8.2" ECU_ADDRESS 0x60021AC0 /end MEASUREMENT
/begin MEASUREMENT DINH_stFId.FId_bInh_Sig453h_ComChrgr_uAcActL1_Frz "" UWORD DFC_OneToOne 1 100 0.00 65535.00 FORMAT "%8.2" ECU_ADDRESS 0x60021AC2 /end MEASUREMENT
/begin MEASUREMENT DINH_stFId.FId_bInh_Sig453h_ComChrgr_uAcActL1_Rcf "" UWORD DFC_OneToOne 1 100 0.00 65535.00 FORMAT "%8.2" ECU_ADDRESS 0x60021AC4 /end MEASUREMENT
/begin MEASUREMENT DINH_stFId.FId_bInh_Sig455h_Com_uHvbNomChrgn_Frz "" UWORD DFC_OneToOne 1 100 0.00 65535.00 FORMAT "%8.2" ECU_ADDRESS 0x60021AC6 /end MEASUREMENT
/begin MEASUREMENT DINH_stFId.FId_bInh_Sig455h_Com_uHvbNomChrgn_Rcf "" UWORD DFC_OneToOne 1 100 0.00 65535.00 FORMAT "%8.2" ECU_ADDRESS 0x60021AC8 /end MEASUREMENT
/begin MEASUREMENT DINH_stFId.FId_bInh_Sig463h_ComChrgr_iDcHvAct_Frz "" UWORD DFC_OneToOne 1 100 0.00 65535.00 FORMAT "%8.2" ECU_ADDRESS 0x60021ACA /end MEASUREMENT
/begin MEASUREMENT DINH_stFId.FId_bInh_Sig463h_ComChrgr_iDcHvAct_Rcf "" UWORD DFC_OneToOne 1 100 0.00 65535.00 FORMAT "%8.2" ECU_ADDRESS 0x60021ACC /end MEASUREMENT
/begin MEASUREMENT DINH_stFId.FId_bInh_Sig463h_ComChrgr_tChrgrMaxAct_Frz "" UWORD DFC_OneToOne 1 100 0.00 65535.00 FORMAT "%8.2" ECU_ADDRESS 0x60021ACE /end MEASUREMENT
/begin MEASUREMENT DINH_stFId.FId_bInh_Sig463h_ComChrgr_tChrgrMaxAct_Rcf "" UWORD DFC_OneToOne 1 100 0.00 65535.00 FORMAT "%8.2" ECU_ADDRESS 0x60021AD0 /end MEASUREMENT
/begin MEASUREMENT DINH_stFId.FId_bInh_Sig463h_ComChrgr_uDcHvAct_Frz "" UWORD DFC_OneToOne 1 100 0.00 65535.00 FORMAT "%8.2" ECU_ADDRESS 0x60021AD2 /end MEASUREMENT
/begin MEASUREMENT DINH_stFId.FId_bInh_Sig463h_ComChrgr_uDcHvAct_Rcf "" UWORD DFC_OneToOne 1 100 0.00 65535.00 FORMAT "%8.2" ECU_ADDRESS 0x60021AD4 /end MEASUREMENT
/begin MEASUREMENT DINH_stFId.FId_bInh_Sig473h_Com_tDcdcAct_Frz "" UWORD DFC_OneToOne 1 100 0.00 65535.00 FORMAT "%8.2" ECU_ADDRESS 0x60021AD6 /end MEASUREMENT
/begin MEASUREMENT DINH_stFId.FId_bInh_Sig473h_Com_tDcdcAct_Rcf "" UWORD DFC_OneToOne 1 100 0.00 65535.00 FORMAT "%8.2" ECU_ADDRESS 0x60021AD8 /end MEASUREMENT
/begin MEASUREMENT DINH_stFId.FId_bInh_Sig473h_Com_tDcdcInltCoolt_Frz "" UWORD DFC_OneToOne 1 100 0.00 65535.00 FORMAT "%8.2" ECU_ADDRESS 0x60021ADA /end MEASUREMENT
/begin MEASUREMENT DINH_stFId.FId_bInh_Sig473h_Com_tDcdcInltCoolt_Rcf "" UWORD DFC_OneToOne 1 100 0.00 65535.00 FORMAT "%8.2" ECU_ADDRESS 0x60021ADC /end MEASUREMENT
/begin MEASUREMENT DINH_stFId.FId_bInh_Sig47Bh_Com_iElCmprHvAct_Frz "" UWORD DFC_OneToOne 1 100 0.00 65535.00 FORMAT "%8.2" ECU_ADDRESS 0x60021ADE /end MEASUREMENT
/begin MEASUREMENT DINH_stFId.FId_bInh_Sig47Bh_Com_iElCmprHvAct_Rcf "" UWORD DFC_OneToOne 1 100 0.00 65535.00 FORMAT "%8.2" ECU_ADDRESS 0x60021AE0 /end MEASUREMENT
/begin MEASUREMENT DINH_stFId.FId_bInh_Sig47Bh_Com_iElCmprPeakPha_Frz "" UWORD DFC_OneToOne 1 100 0.00 65535.00 FORMAT "%8.2" ECU_ADDRESS 0x60021AE2 /end MEASUREMENT
/begin MEASUREMENT DINH_stFId.FId_bInh_Sig47Bh_Com_iElCmprPeakPha_Rcf "" UWORD DFC_OneToOne 1 100 0.00 65535.00 FORMAT "%8.2" ECU_ADDRESS 0x60021AE4 /end MEASUREMENT
/begin MEASUREMENT DINH_stFId.FId_bInh_Sig47Bh_Com_nElCmprActl_Frz "" UWORD DFC_OneToOne 1 100 0.00 65535.00 FORMAT "%8.2" ECU_ADDRESS 0x60021AE6 /end MEASUREMENT
/begin MEASUREMENT DINH_stFId.FId_bInh_Sig47Bh_Com_nElCmprActl_Rcf "" UWORD DFC_OneToOne 1 100 0.00 65535.00 FORMAT "%8.2" ECU_ADDRESS 0x60021AE8 /end MEASUREMENT
/begin MEASUREMENT DINH_stFId.FId_bInh_Sig47Bh_Com_pwrElCmprActl_Frz "" UWORD DFC_OneToOne 1 100 0.00 65535.00 FORMAT "%8.2" ECU_ADDRESS 0x60021AEA /end MEASUREMENT
/begin MEASUREMENT DINH_stFId.FId_bInh_Sig47Bh_Com_pwrElCmprActl_Rcf "" UWORD DFC_OneToOne 1 100 0.00 65535.00 FORMAT "%8.2" ECU_ADDRESS 0x60021AEC /end MEASUREMENT
/begin MEASUREMENT DINH_stFId.FId_bInh_Sig47Bh_Com_tElCmprActl_Frz "" UWORD DFC_OneToOne 1 100 0.00 65535.00 FORMAT "%8.2" ECU_ADDRESS 0x60021AEE /end MEASUREMENT
/begin MEASUREMENT DINH_stFId.FId_bInh_Sig47Bh_Com_tElCmprActl_Rcf "" UWORD DFC_OneToOne 1 100 0.00 65535.00 FORMAT "%8.2" ECU_ADDRESS 0x60021AF0 /end MEASUREMENT
/begin MEASUREMENT DINH_stFId.FId_bInh_Sig47Bh_Com_uElCmprHvAct_Frz "" UWORD DFC_OneToOne 1 100 0.00 65535.00 FORMAT "%8.2" ECU_ADDRESS 0x60021AF2 /end MEASUREMENT
/begin MEASUREMENT DINH_stFId.FId_bInh_Sig47Bh_Com_uElCmprHvAct_Rcf "" UWORD DFC_OneToOne 1 100 0.00 65535.00 FORMAT "%8.2" ECU_ADDRESS 0x60021AF4 /end MEASUREMENT
/begin MEASUREMENT DINH_stFId.FId_bInh_Sig48Bh_Com_stElCmprFltLvl_Frz "" UWORD DFC_OneToOne 1 100 0.00 65535.00 FORMAT "%8.2" ECU_ADDRESS 0x60021AF6 /end MEASUREMENT
/begin MEASUREMENT DINH_stFId.FId_bInh_Sig48Bh_Com_stElCmprFltLvl_Rcf "" UWORD DFC_OneToOne 1 100 0.00 65535.00 FORMAT "%8.2" ECU_ADDRESS 0x60021AF8 /end MEASUREMENT
/begin MEASUREMENT DINH_stFId.FId_bInh_Sig4F2h_Com_ratSocLvBatt_Frz "" UWORD DFC_OneToOne 1 100 0.00 65535.00 FORMAT "%8.2" ECU_ADDRESS 0x60021AFA /end MEASUREMENT
/begin MEASUREMENT DINH_stFId.FId_bInh_Sig4F2h_Com_ratSocLvBatt_Rcf "" UWORD DFC_OneToOne 1 100 0.00 65535.00 FORMAT "%8.2" ECU_ADDRESS 0x60021AFC /end MEASUREMENT
/begin MEASUREMENT DINH_stFId.FId_bInh_Sig4F2h_Com_stSocRx_Frz "" UWORD DFC_OneToOne 1 100 0.00 65535.00 FORMAT "%8.2" ECU_ADDRESS 0x60021AFE /end MEASUREMENT
/begin MEASUREMENT DINH_stFId.FId_bInh_Sig4F2h_Com_stSocRx_Rcf "" UWORD DFC_OneToOne 1 100 0.00 65535.00 FORMAT "%8.2" ECU_ADDRESS 0x60021B00 /end MEASUREMENT
/begin MEASUREMENT DINH_stFId.FId_bInh_Sig4F2h_Com_stT_Frz "" UWORD DFC_OneToOne 1 100 0.00 65535.00 FORMAT "%8.2" ECU_ADDRESS 0x60021B02 /end MEASUREMENT
/begin MEASUREMENT DINH_stFId.FId_bInh_Sig4F2h_Com_stT_Rcf "" UWORD DFC_OneToOne 1 100 0.00 65535.00 FORMAT "%8.2" ECU_ADDRESS 0x60021B04 /end MEASUREMENT
/begin MEASUREMENT DINH_stFId.FId_bInh_Sig535h_Com_tHvbAct_Frz "" UWORD DFC_OneToOne 1 100 0.00 65535.00 FORMAT "%8.2" ECU_ADDRESS 0x60021B06 /end MEASUREMENT
/begin MEASUREMENT DINH_stFId.FId_bInh_Sig535h_Com_tHvbAct_Rcf "" UWORD DFC_OneToOne 1 100 0.00 65535.00 FORMAT "%8.2" ECU_ADDRESS 0x60021B08 /end MEASUREMENT
/begin MEASUREMENT DINH_stFId.FId_bInh_Sig543h_Com_egyHvbAvl_fRx_Frz "" UWORD DFC_OneToOne 1 100 0.00 65535.00 FORMAT "%8.2" ECU_ADDRESS 0x60021B0A /end MEASUREMENT
/begin MEASUREMENT DINH_stFId.FId_bInh_Sig543h_Com_egyHvbAvl_fRx_Rcf "" UWORD DFC_OneToOne 1 100 0.00 65535.00 FORMAT "%8.2" ECU_ADDRESS 0x60021B0C /end MEASUREMENT
/begin MEASUREMENT DINH_stFId.FId_bInh_Sig543h_Com_ratHvbSoh_Frz "" UWORD DFC_OneToOne 1 100 0.00 65535.00 FORMAT "%8.2" ECU_ADDRESS 0x60021B0E /end MEASUREMENT
/begin MEASUREMENT DINH_stFId.FId_bInh_Sig543h_Com_ratHvbSoh_Rcf "" UWORD DFC_OneToOne 1 100 0.00 65535.00 FORMAT "%8.2" ECU_ADDRESS 0x60021B10 /end MEASUREMENT
/begin MEASUREMENT DINH_stFId.FId_bInh_Sig543h_Com_ratRHvbSoh_Frz "" UWORD DFC_OneToOne 1 100 0.00 65535.00 FORMAT "%8.2" ECU_ADDRESS 0x60021B12 /end MEASUREMENT
/begin MEASUREMENT DINH_stFId.FId_bInh_Sig543h_Com_ratRHvbSoh_Rcf "" UWORD DFC_OneToOne 1 100 0.00 65535.00 FORMAT "%8.2" ECU_ADDRESS 0x60021B14 /end MEASUREMENT
/begin MEASUREMENT DINH_stFId.FId_bInh_Sig552h_Com_lDstGlbDa_Frz "" UWORD DFC_OneToOne 1 100 0.00 65535.00 FORMAT "%8.2" ECU_ADDRESS 0x60021B16 /end MEASUREMENT
/begin MEASUREMENT DINH_stFId.FId_bInh_Sig552h_Com_lDstGlbDa_Rcf "" UWORD DFC_OneToOne 1 100 0.00 65535.00 FORMAT "%8.2" ECU_ADDRESS 0x60021B18 /end MEASUREMENT
/begin MEASUREMENT DINH_stFId.FId_bInh_Sig552h_Com_lTotOdometer_Frz "" UWORD DFC_OneToOne 1 100 0.00 65535.00 FORMAT "%8.2" ECU_ADDRESS 0x60021B1A /end MEASUREMENT
/begin MEASUREMENT DINH_stFId.FId_bInh_Sig552h_Com_lTotOdometer_Rcf "" UWORD DFC_OneToOne 1 100 0.00 65535.00 FORMAT "%8.2" ECU_ADDRESS 0x60021B1C /end MEASUREMENT
/begin MEASUREMENT DINH_stFId.FId_bInh_Sig552h_Com_tiCurVehTmr_Frz "" UWORD DFC_OneToOne 1 100 0.00 65535.00 FORMAT "%8.2" ECU_ADDRESS 0x60021B1E /end MEASUREMENT
/begin MEASUREMENT DINH_stFId.FId_bInh_Sig552h_Com_tiCurVehTmr_Rcf "" UWORD DFC_OneToOne 1 100 0.00 65535.00 FORMAT "%8.2" ECU_ADDRESS 0x60021B20 /end MEASUREMENT
/begin MEASUREMENT DINH_stFId.FId_bInh_Sig583h_Com_stHvbDiscnctReas_Frz "" UWORD DFC_OneToOne 1 100 0.00 65535.00 FORMAT "%8.2" ECU_ADDRESS 0x60021B22 /end MEASUREMENT
/begin MEASUREMENT DINH_stFId.FId_bInh_Sig583h_Com_stHvbDiscnctReas_Rcf "" UWORD DFC_OneToOne 1 100 0.00 65535.00 FORMAT "%8.2" ECU_ADDRESS 0x60021B24 /end MEASUREMENT
/begin MEASUREMENT DINH_stFId.FId_bInh_Sig592h_Com_iBattEBS1Rx_Frz "" UWORD DFC_OneToOne 1 100 0.00 65535.00 FORMAT "%8.2" ECU_ADDRESS 0x60021B26 /end MEASUREMENT
/begin MEASUREMENT DINH_stFId.FId_bInh_Sig592h_Com_iBattEBS1Rx_Rcf "" UWORD DFC_OneToOne 1 100 0.00 65535.00 FORMAT "%8.2" ECU_ADDRESS 0x60021B28 /end MEASUREMENT
/begin MEASUREMENT DINH_stFId.FId_bInh_Sig592h_Com_iBattEBS2Rx_Frz "" UWORD DFC_OneToOne 1 100 0.00 65535.00 FORMAT "%8.2" ECU_ADDRESS 0x60021B2A /end MEASUREMENT
/begin MEASUREMENT DINH_stFId.FId_bInh_Sig592h_Com_iBattEBS2Rx_Rcf "" UWORD DFC_OneToOne 1 100 0.00 65535.00 FORMAT "%8.2" ECU_ADDRESS 0x60021B2C /end MEASUREMENT
/begin MEASUREMENT DINH_stFId.FId_bInh_Sig592h_Com_iBattEBS3Rx_Frz "" UWORD DFC_OneToOne 1 100 0.00 65535.00 FORMAT "%8.2" ECU_ADDRESS 0x60021B2E /end MEASUREMENT
/begin MEASUREMENT DINH_stFId.FId_bInh_Sig592h_Com_iBattEBS3Rx_Rcf "" UWORD DFC_OneToOne 1 100 0.00 65535.00 FORMAT "%8.2" ECU_ADDRESS 0x60021B30 /end MEASUREMENT
/begin MEASUREMENT DINH_stFId.FId_bInh_Sig592h_Com_stIBattEBS_Frz "" UWORD DFC_OneToOne 1 100 0.00 65535.00 FORMAT "%8.2" ECU_ADDRESS 0x60021B32 /end MEASUREMENT
/begin MEASUREMENT DINH_stFId.FId_bInh_Sig592h_Com_stIBattEBS_Rcf "" UWORD DFC_OneToOne 1 100 0.00 65535.00 FORMAT "%8.2" ECU_ADDRESS 0x60021B34 /end MEASUREMENT
/begin MEASUREMENT DINH_stFId.FId_bInh_Sig592h_Com_tLvBatt_Frz "" UWORD DFC_OneToOne 1 100 0.00 65535.00 FORMAT "%8.2" ECU_ADDRESS 0x60021B36 /end MEASUREMENT
/begin MEASUREMENT DINH_stFId.FId_bInh_Sig592h_Com_tLvBatt_Rcf "" UWORD DFC_OneToOne 1 100 0.00 65535.00 FORMAT "%8.2" ECU_ADDRESS 0x60021B38 /end MEASUREMENT
/begin MEASUREMENT DINH_stFId.FId_bInh_Sig592h_Com_uBattEBSRx_Frz "" UWORD DFC_OneToOne 1 100 0.00 65535.00 FORMAT "%8.2" ECU_ADDRESS 0x60021B3A /end MEASUREMENT
/begin MEASUREMENT DINH_stFId.FId_bInh_Sig592h_Com_uBattEBSRx_Rcf "" UWORD DFC_OneToOne 1 100 0.00 65535.00 FORMAT "%8.2" ECU_ADDRESS 0x60021B3C /end MEASUREMENT
/begin MEASUREMENT DINH_stFId.FId_bInh_Sig595h_Com_tiHvbChrgnHalfRx_Frz "" UWORD DFC_OneToOne 1 100 0.00 65535.00 FORMAT "%8.2" ECU_ADDRESS 0x60021B3E /end MEASUREMENT
/begin MEASUREMENT DINH_stFId.FId_bInh_Sig595h_Com_tiHvbChrgnHalfRx_Rcf "" UWORD DFC_OneToOne 1 100 0.00 65535.00 FORMAT "%8.2" ECU_ADDRESS 0x60021B40 /end MEASUREMENT
/begin MEASUREMENT DINH_stFId.FId_bInh_Sig5B2h_Com_tEnvT_Frz "" UWORD DFC_OneToOne 1 100 0.00 65535.00 FORMAT "%8.2" ECU_ADDRESS 0x60021B42 /end MEASUREMENT
/begin MEASUREMENT DINH_stFId.FId_bInh_Sig5B2h_Com_tEnvT_Rcf "" UWORD DFC_OneToOne 1 100 0.00 65535.00 FORMAT "%8.2" ECU_ADDRESS 0x60021B44 /end MEASUREMENT
/begin MEASUREMENT DINH_stFId.FId_bInh_Sig5B5h_Com_stAlrtThermRunAwy_Frz "" UWORD DFC_OneToOne 1 100 0.00 65535.00 FORMAT "%8.2" ECU_ADDRESS 0x60021B46 /end MEASUREMENT
/begin MEASUREMENT DINH_stFId.FId_bInh_Sig5B5h_Com_stAlrtThermRunAwy_Rcf "" UWORD DFC_OneToOne 1 100 0.00 65535.00 FORMAT "%8.2" ECU_ADDRESS 0x60021B48 /end MEASUREMENT
/begin MEASUREMENT DINH_stFId.FId_bInh_Sig635h_Com_ctHvbNegCntctrSeg1_Frz "" UWORD DFC_OneToOne 1 100 0.00 65535.00 FORMAT "%8.2" ECU_ADDRESS 0x60021B4A /end MEASUREMENT
/begin MEASUREMENT DINH_stFId.FId_bInh_Sig635h_Com_ctHvbNegCntctrSeg1_Rcf "" UWORD DFC_OneToOne 1 100 0.00 65535.00 FORMAT "%8.2" ECU_ADDRESS 0x60021B4C /end MEASUREMENT
/begin MEASUREMENT DINH_stFId.FId_bInh_Sig635h_Com_ctHvbNegCntctrSeg3_Frz "" UWORD DFC_OneToOne 1 100 0.00 65535.00 FORMAT "%8.2" ECU_ADDRESS 0x60021B4E /end MEASUREMENT
/begin MEASUREMENT DINH_stFId.FId_bInh_Sig635h_Com_ctHvbNegCntctrSeg3_Rcf "" UWORD DFC_OneToOne 1 100 0.00 65535.00 FORMAT "%8.2" ECU_ADDRESS 0x60021B50 /end MEASUREMENT
/begin MEASUREMENT DINH_stFId.FId_bInh_Sig635h_Com_ctHvbNegCntctrSeg4_Frz "" UWORD DFC_OneToOne 1 100 0.00 65535.00 FORMAT "%8.2" ECU_ADDRESS 0x60021B52 /end MEASUREMENT
/begin MEASUREMENT DINH_stFId.FId_bInh_Sig635h_Com_ctHvbNegCntctrSeg4_Rcf "" UWORD DFC_OneToOne 1 100 0.00 65535.00 FORMAT "%8.2" ECU_ADDRESS 0x60021B54 /end MEASUREMENT
/begin MEASUREMENT DINH_stFId.FId_bInh_Sig635h_Com_ctHvbPosCntctrSeg1_Frz "" UWORD DFC_OneToOne 1 100 0.00 65535.00 FORMAT "%8.2" ECU_ADDRESS 0x60021B56 /end MEASUREMENT
/begin MEASUREMENT DINH_stFId.FId_bInh_Sig635h_Com_ctHvbPosCntctrSeg1_Rcf "" UWORD DFC_OneToOne 1 100 0.00 65535.00 FORMAT "%8.2" ECU_ADDRESS 0x60021B58 /end MEASUREMENT
/begin MEASUREMENT DINH_stFId.FId_bInh_Sig635h_Com_ctHvbPosCntctrSeg3_Frz "" UWORD DFC_OneToOne 1 100 0.00 65535.00 FORMAT "%8.2" ECU_ADDRESS 0x60021B5A /end MEASUREMENT
/begin MEASUREMENT DINH_stFId.FId_bInh_Sig635h_Com_ctHvbPosCntctrSeg3_Rcf "" UWORD DFC_OneToOne 1 100 0.00 65535.00 FORMAT "%8.2" ECU_ADDRESS 0x60021B5C /end MEASUREMENT
/begin MEASUREMENT DINH_stFId.FId_bInh_Sig635h_Com_ctHvbPosCntctrSeg4_Frz "" UWORD DFC_OneToOne 1 100 0.00 65535.00 FORMAT "%8.2" ECU_ADDRESS 0x60021B5E /end MEASUREMENT
/begin MEASUREMENT DINH_stFId.FId_bInh_Sig635h_Com_ctHvbPosCntctrSeg4_Rcf "" UWORD DFC_OneToOne 1 100 0.00 65535.00 FORMAT "%8.2" ECU_ADDRESS 0x60021B60 /end MEASUREMENT
/begin MEASUREMENT DINH_stFId.FId_bInh_Sig645h_Com_ctHvbPrecCntctrSeg1_Frz "" UWORD DFC_OneToOne 1 100 0.00 65535.00 FORMAT "%8.2" ECU_ADDRESS 0x60021B62 /end MEASUREMENT
/begin MEASUREMENT DINH_stFId.FId_bInh_Sig645h_Com_ctHvbPrecCntctrSeg1_Rcf "" UWORD DFC_OneToOne 1 100 0.00 65535.00 FORMAT "%8.2" ECU_ADDRESS 0x60021B64 /end MEASUREMENT
/begin MEASUREMENT DINH_stFId.FId_bInh_Sig645h_Com_ctHvbPrecCntctrSeg2_Frz "" UWORD DFC_OneToOne 1 100 0.00 65535.00 FORMAT "%8.2" ECU_ADDRESS 0x60021B66 /end MEASUREMENT
/begin MEASUREMENT DINH_stFId.FId_bInh_Sig645h_Com_ctHvbPrecCntctrSeg2_Rcf "" UWORD DFC_OneToOne 1 100 0.00 65535.00 FORMAT "%8.2" ECU_ADDRESS 0x60021B68 /end MEASUREMENT
/begin MEASUREMENT DINH_stFId.FId_bInh_Sig675h_Com_qHvbTotCpRx_Frz "" UWORD DFC_OneToOne 1 100 0.00 65535.00 FORMAT "%8.2" ECU_ADDRESS 0x60021B6A /end MEASUREMENT
/begin MEASUREMENT DINH_stFId.FId_bInh_Sig675h_Com_qHvbTotCpRx_Rcf "" UWORD DFC_OneToOne 1 100 0.00 65535.00 FORMAT "%8.2" ECU_ADDRESS 0x60021B6C /end MEASUREMENT
/begin MEASUREMENT DINH_stFId.FId_bInh_ThermHvac_stRemPrecndn "" UWORD DFC_OneToOne 1 100 0.00 65535.00 FORMAT "%8.2" ECU_ADDRESS 0x60021B80 /end MEASUREMENT
/begin MEASUREMENT DINH_stFId.FId_bInh_VehCoorn_dstRngPrdcDispTx "" UWORD DFC_OneToOne 1 100 0.00 65535.00 FORMAT "%8.2" ECU_ADDRESS 0x60021B82 /end MEASUREMENT
/begin MEASUREMENT DINH_stFId.FId_bInh_VehCoorn_wCnsTotWghtAvrgEffTripA "" UWORD DFC_OneToOne 1 100 0.00 65535.00 FORMAT "%8.2" ECU_ADDRESS 0x60021B84 /end MEASUREMENT
/begin MEASUREMENT DINH_stFId.FId_bInh_VehCoorn_wCnsTotWghtAvrgEffTripB "" UWORD DFC_OneToOne 1 100 0.00 65535.00 FORMAT "%8.2" ECU_ADDRESS 0x60021B86 /end MEASUREMENT
/begin MEASUREMENT DINH_stFId.FId_bInh_VehCoorn_wCnsTotWghtAvrgEffTx "" UWORD DFC_OneToOne 1 100 0.00 65535.00 FORMAT "%8.2" ECU_ADDRESS 0x60021B88 /end MEASUREMENT
/begin MEASUREMENT DINH_stFId.FId_bInh_VehCoorn_wCnsTotWghtTripAvrgEffTx "" UWORD DFC_OneToOne 1 100 0.00 65535.00 FORMAT "%8.2" ECU_ADDRESS 0x60021B8A /end MEASUREMENT
/begin MEASUREMENT DINH_stFId.FId_bInh_VehCoorn_wCnsWghtAvrgEffTripA "" UWORD DFC_OneToOne 1 100 0.00 65535.00 FORMAT "%8.2" ECU_ADDRESS 0x60021B8C /end MEASUREMENT
/begin MEASUREMENT DINH_stFId.FId_bInh_VehCoorn_wCnsWghtAvrgEffTripB "" UWORD DFC_OneToOne 1 100 0.00 65535.00 FORMAT "%8.2" ECU_ADDRESS 0x60021B8E /end MEASUREMENT
/begin FUNCTION ComScl_NetMtrx "850.8.0   Configuration of network matrix"
 /begin DEF_CHARACTERISTIC ACCmpr_pwrLimMax_341hIni_C ACCmpr_pwrLimMax_341hInvld_C ACCtl_flgCmprEna_341hIni_C ACCtl_nCmprSpdReq_341hIni_C ACCtl_nCmprSpdReq_341hInvld_C APP_rInp_201hIni_C APP_rInp_201hInvld_C BattId_numOrganNature1_5D1hIni_C BattId_numOrganNature2_5D1hIni_C BattId_numOrganRef1_5D1hIni_C BattId_numOrganRef2_5D1hIni_C BattId_numOrganRef3_5D1hIni_C BattId_numOrganRef4_5D1hIni_C BattId_numSerl1_5F1hIni_C BattId_numSerl2_5F1hIni_C BattId_numSerl3_5F1hIni_C BattId_numSerl4_5F1hIni_C BattId_numSerl5_5F1hIni_C BattId_numSerl6_5F1hIni_C BattId_numSerl7_5F1hIni_C Brk_stRed_208hIni_C CbnHeatgHeatr_cntrRlyLf_481hIni_C CbnHeatgHeatr_cntrRlyLf_481hInvld_C ChgrPlug_stPlgLockTx_4A2hIni_C ChrgCntct_nrNegCntctElpdOper_501hIni_C ChrgCntct_nrNegCntctElpdOper_501hInvld_C ChrgCntct_nrPosCntctElpdOper_501hIni_C ChrgCntct_nrPosCntctElpdOper_501hInvld_C ChrgrRly_stRlyDes_211hIni_C ChrgrVal_iChrgrDes_211hIni_C ChrgrVal_iChrgrDes_211hInvld_C ChrgrVal_iChrgrDes_321hIni_C ChrgrVal_iChrgrDes_321hInvld_C ChrgrVal_iGridLimMax_321hIni_C ChrgrVal_iGridLimMax_321hInvld_C ChrgrVal_uHvMax_211hIni_C ChrgrVal_uHvMax_211hInvld_C ChrgrVal_uHvMax_321hIni_C ChrgrVal_uHvMax_321hInvld_C CoDrvPITh_stEPSModeReq_208hIni_C CoDrvPITh_stEPSModeReq_5C1hIni_C ComChrgn_iDcRly_318hIni_C ComChrgn_iDcRly_318hRcf_C ComChrgn_uDcRly_308hIni_C ComChrgn_uDcRly_308hRcf_C ComChrgr_flgChrgrErrLvl_273hIni_C ComChrgr_flgChrgrErrLvl_273hInvld_C ComChrgr_flgChrgrErrLvl_273hRcf_C ComChrgr_iAcMax_453hIni_C ComChrgr_iAcMax_453hInvld_C ComChrgr_iAcMax_453hRcf_C ComChrgr_iDcHvAct_463hIni_C ComChrgr_iDcHvAct_463hInvld_C ComChrgr_iDcHvAct_463hRcf_C ComChrgr_pwrInAct_453hIni_C ComChrgr_pwrInAct_453hInvld_C ComChrgr_pwrInAct_453hRcf_C ComChrgr_pwrOutpCpby_273hIni_C ComChrgr_pwrOutpCpby_273hInvld_C ComChrgr_pwrOutpCpby_273hRcf_C ComChrgr_stChrgnEna_281hIni_C ComChrgr_stChrgrRx_273hIni_C ComChrgr_stChrgrRx_273hRcf_C ComChrgr_stEVLmp_273hIni_C ComChrgr_stEVLmp_273hRcf_C ComChrgr_stMstWrnLmp_273hIni_C ComChrgr_stMstWrnLmp_273hRcf_C ComChrgr_stSVSLmp_273hIni_C ComChrgr_stSVSLmp_273hRcf_C ComChrgr_tChrgrMaxAct_463hIni_C ComChrgr_tChrgrMaxAct_463hInvld_C ComChrgr_tChrgrMaxAct_463hRcf_C ComChrgr_uAcActL1_453hIni_C ComChrgr_uAcActL1_453hInvld_C ComChrgr_uAcActL1_453hRcf_C ComChrgr_uDcHvAct_463hIni_C ComChrgr_uDcHvAct_463hInvld_C ComChrgr_uDcHvAct_463hRcf_C ComChrg_stMod_211hIni_C ComEmac_flgImobAuthent_5C7hIni_C ComEmac_flgImobAuthent_5C7hRcf_C ComEmac_iDcLnk01_227hIni_C ComEmac_iDcLnk01_227hInvld_C ComEmac_iDcLnk01_227hRcf_C ComEmac_nAct01_217hIni_C ComEmac_nAct01_217hInvld_C ComEmac_nAct01_217hRcf_C ComEmac_pwrInstnsInpRx_227hIni_C ComEmac_pwrInstnsInpRx_227hInvld_C ComEmac_pwrInstnsInpRx_227hRcf_C ComEmac_stActvDcha_237hIni_C ComEmac_stActvDcha_237hInvld_C ComEmac_stActvDcha_237hRcf_C ComEmac_stEVLmp_237hIni_C ComEmac_stEVLmp_237hRcf_C ComEmac_stHillHld_237hIni_C ComEmac_stHillHld_237hRcf_C ComEmac_stIsoMonSwtAck_237hIni_C ComEmac_stIsoMonSwtAck_237hRcf_C ComEmac_stIvtrOpMod01_427hIni_C ComEmac_stIvtrOpMod01_427hInvld_C ComEmac_stIvtrOpMod01_427hRcf_C ComEmac_stMod01Rx_237hIni_C ComEmac_stMod01Rx_237hRcf_C ComEmac_stMstWrnLmp_237hIni_C ComEmac_stMstWrnLmp_237hRcf_C ComEmac_stPwrAuthn_237hIni_C ComEmac_stPwrAuthn_237hRcf_C ComEmac_stSVSLmp_237hIni_C ComEmac_stSVSLmp_237hRcf_C ComEmac_tInvr01_427hIni_C ComEmac_tInvr01_427hInvld_C ComEmac_tInvr01_427hRcf_C ComEmac_tIvtrCooltIn01_427hIni_C ComEmac_tIvtrCooltIn01_427hInvld_C ComEmac_tIvtrCooltIn01_427hRcf_C ComEmac_tMac01_427hIni_C ComEmac_tMac01_427hInvld_C ComEmac_tMac01_427hRcf_C ComEmac_tqAbsltMaxRx01_227hIni_C ComEmac_tqAbsltMaxRx01_227hInvld_C ComEmac_tqAbsltMaxRx01_227hRcf_C ComEmac_tqAbsltMinRx01_227hIni_C ComEmac_tqAbsltMinRx01_227hInvld_C ComEmac_tqAbsltMinRx01_227hRcf_C ComEmac_tqAckd01_217hIni_C ComEmac_tqAckd01_217hInvld_C ComEmac_tqAckd01_217hRcf_C ComEmac_tqAct01_217hIni_C ComEmac_tqAct01_217hInvld_C ComEmac_tqAct01_217hRcf_C ComEmac_tqPtd01_427hIni_C ComEmac_tqPtd01_427hInvld_C ComEmac_tqPtd01_427hRcf_C ComEmac_tqStabnMin_237hIni_C ComEmac_tqStabnMin_237hInvld_C ComEmac_tqStabnMin_237hRcf_C ComEmac_uDcLnk01_217hIni_C ComEmac_uDcLnk01_217hInvld_C ComEmac_uDcLnk01_217hRcf_C Com_bAcLedReq_25hIni_C Com_bDelDftReq_092hIni_C Com_bDelDftReq_092hRcf_C Com_bDiagMuxCAN_208hIni_C Com_bElIntgDiagMod_092hIni_C Com_bElIntgDiagMod_092hRcf_C Com_bElIntgDiag_092hIni_C Com_bElIntgDiag_092hRcf_C Com_bGunCntInfoWkuReq_421hIni_C Com_bHvBattRchrgWkuReq_421hIni_C Com_bImmoUnlockWkuReq_432hIni_C Com_bImmoUnlockWkuReq_432hRcf_C Com_bInfoReqPtlWkuReq_432hIni_C Com_bInfoReqPtlWkuReq_432hRcf_C Com_bPostOperationWkuReq_421hIni_C Com_bPreCondElecWkuReq_432hIni_C Com_bPreCondElecWkuReq_432hRcf_C Com_bReFogRlySt_25hIni_C Com_bReFogRlySt_CAN_442hIni_C Com_bReFogRlySt_CAN_442hRcf_C Com_bRemUnlckWkuReq_432hIni_C Com_bRemUnlckWkuReq_432hRcf_C Com_bStpDlyHMIWkuReq_432hIni_C Com_bStpDlyHMIWkuReq_432hRcf_C Com_CDE_RESEAU_LIN_VCU_Tx_EIMode_C Com_ctHvbNegCntctrSeg1_635hIni_C Com_ctHvbNegCntctrSeg1_635hInvld_C Com_ctHvbNegCntctrSeg1_635hRcf_C Com_ctHvbNegCntctrSeg2_635hIni_C Com_ctHvbNegCntctrSeg2_635hRcf_C Com_ctHvbNegCntctrSeg3_635hIni_C Com_ctHvbNegCntctrSeg3_635hInvld_C Com_ctHvbNegCntctrSeg3_635hRcf_C Com_ctHvbNegCntctrSeg4_635hIni_C Com_ctHvbNegCntctrSeg4_635hInvld_C Com_ctHvbNegCntctrSeg4_635hRcf_C Com_ctHvbNegCntctrSeg5_635hIni_C Com_ctHvbNegCntctrSeg5_635hRcf_C Com_ctHvbPosCntctrSeg1_635hIni_C Com_ctHvbPosCntctrSeg1_635hInvld_C Com_ctHvbPosCntctrSeg1_635hRcf_C Com_ctHvbPosCntctrSeg2_635hIni_C Com_ctHvbPosCntctrSeg2_635hRcf_C Com_ctHvbPosCntctrSeg3_635hIni_C Com_ctHvbPosCntctrSeg3_635hInvld_C Com_ctHvbPosCntctrSeg3_635hRcf_C Com_ctHvbPosCntctrSeg4_635hIni_C Com_ctHvbPosCntctrSeg4_635hInvld_C Com_ctHvbPosCntctrSeg4_635hRcf_C Com_ctHvbPosCntctrSeg5_635hIni_C Com_ctHvbPosCntctrSeg5_635hRcf_C Com_ctHvbPrecCntctrSeg1_645hIni_C Com_ctHvbPrecCntctrSeg1_645hInvld_C Com_ctHvbPrecCntctrSeg1_645hRcf_C Com_ctHvbPrecCntctrSeg2_645hIni_C Com_ctHvbPrecCntctrSeg2_645hInvld_C Com_ctHvbPrecCntctrSeg2_645hRcf_C Com_DAT_TBMU_454_Tx_EIMode_C Com_egyHvbAvl_fRx_543hIni_C Com_egyHvbAvl_fRx_543hInvld_C Com_egyHvbAvl_fRx_543hRcf_C Com_E_VCU_522_Tx_EIMode_C Com_flgBlowrAuthn_201hIni_C Com_flgBlowrRlyCtrl_221hIni_C Com_flgBrkAlrt_221hIni_C Com_flgBrkMaiDiag_412hIni_C Com_flgBrkMaiDiag_412hRcf_C Com_flgBrkMai_412hIni_C Com_flgBrkMai_412hRcf_C Com_flgCurMeasmtErr_318hIni_C Com_flgCurMeasmtErr_318hRcf_C Com_flgCurMeasmtSysErr_318hIni_C Com_flgCurMeasmtSysErr_318hRcf_C Com_flgCurMeasmtVld_318hIni_C Com_flgCurMeasmtVld_318hRcf_C Com_flgCurRngErr_318hIni_C Com_flgCurRngErr_318hRcf_C Com_flgDrvAwy_331hIni_C Com_flgEcoNormReqRx_259hIni_C Com_flgEcoNormReqRx_259hInvld_C Com_flgEcoNormReqRx_259hRcf_C Com_flgElCmprAbnormSpdFlt_48BhIni_C Com_flgElCmprAbnormSpdFlt_48BhRcf_C Com_flgElCmprCurSampleFailr_48BhIni_C Com_flgElCmprCurSampleFailr_48BhRcf_C Com_flgElCmprIgbtFailr_48BhIni_C Com_flgElCmprIgbtFailr_48BhRcf_C Com_flgElCmprLoUSplyFlt_48BhIni_C Com_flgElCmprLoUSplyFlt_48BhRcf_C Com_flgElCmprLoUUnderUFlt_48BhIni_C Com_flgElCmprLoUUnderUFlt_48BhRcf_C Com_flgElCmprOverCurFlt_48BhIni_C Com_flgElCmprOverCurFlt_48BhRcf_C Com_flgElCmprOverHeatFailr_48BhIni_C Com_flgElCmprOverHeatFailr_48BhRcf_C Com_flgElCmprOverLoad_48BhIni_C Com_flgElCmprOverLoad_48BhRcf_C Com_flgElCmprOverUFlt_48BhIni_C Com_flgElCmprOverUFlt_48BhRcf_C Com_flgElCmprOverUMalfct_48BhIni_C Com_flgElCmprOverUMalfct_48BhRcf_C Com_flgElCmprPhaFailr_48BhIni_C Com_flgElCmprPhaFailr_48BhRcf_C Com_flgElCmprStallFailr_48BhIni_C Com_flgElCmprStallFailr_48BhRcf_C Com_flgElCmprTSnsrFailr_48BhIni_C Com_flgElCmprTSnsrFailr_48BhRcf_C Com_flgGearLvrMovmt_259hIni_C Com_flgGearLvrMovmt_259hRcf_C Com_flgGunUnlckReq_082hIni_C Com_flgGunUnlckReq_082hRcf_C Com_flgHvBattAuthn_325hIni_C Com_flgHvBattAuthn_325hRcf_C Com_flgPDUProgmFailr_308hIni_C Com_flgPDUProgmFailr_308hRcf_C Com_flgRstTripAEE_432hIni_C Com_flgRstTripAEE_432hRcf_C Com_flgRstTripAEE_A_5E7hIni_C Com_flgRstTripAEE_A_5E7hRcf_C Com_flgRstTripAEE_B_5E7hIni_C Com_flgRstTripAEE_B_5E7hRcf_C Com_flgTPcbMeasmtErr_308hIni_C Com_flgTPcbMeasmtErr_308hRcf_C Com_flgTPcbMeasmtVld_308hIni_C Com_flgTPcbMeasmtVld_308hRcf_C Com_flgTPcbRngErr_308hIni_C Com_flgTPcbRngErr_308hRcf_C Com_flgTPcbSysErr_308hIni_C Com_flgTPcbSysErr_308hRcf_C Com_flgTShntMeasmtErr_318hIni_C Com_flgTShntMeasmtErr_318hRcf_C Com_flgTShntMeasmtVld_318hIni_C Com_flgTShntMeasmtVld_318hRcf_C Com_flgTShntRngErr_318hIni_C Com_flgTShntRngErr_318hRcf_C Com_flgTShntSysErr_318hIni_C Com_flgTShntSysErr_318hRcf_C Com_flgVehSpdAvl_38DhIni_C Com_flgVehSpdAvl_38DhInvld1_C /end DEF_CHARACTERISTIC
 /begin OUT_MEASUREMENT DINH_stFId.FId_bInhDiag_DCDC_473h DINH_stFId.FId_bInhDiag_DCDC_663h DINH_stFId.FId_bInhDiag_HS3_AUTO_GEARBOX_SWITCH_STATUS DINH_stFId.FId_bInhDiag_HVAC_PANEL_26h DINH_stFId.FId_bInhDiag_HVBAT_205h DINH_stFId.FId_bInhDiag_HVBAT_275h DINH_stFId.FId_bInhDiag_HVBAT_285h DINH_stFId.FId_bInhDiag_HVBAT_325h DINH_stFId.FId_bInhDiag_HVBAT_335h DINH_stFId.FId_bInhDiag_HVBAT_455h DINH_stFId.FId_bInhDiag_HVBAT_535 DINH_stFId.FId_bInhDiag_HVBAT_595h DINH_stFId.FId_bInhDiag_HVBAT_635h DINH_stFId.FId_bInhDiag_HVBAT_645h DINH_stFId.FId_bInhDiag_HVBAT_665h DINH_stFId.FId_bInhDiag_HVBAT_675h DINH_stFId.FId_bInhDiag_HVBAT_THERMAL_5B5 DINH_stFId.FId_bInhDiag_HVBAT_VCU_435h DINH_stFId.FId_bInhDiag_HVBAT_VCU_543 DINH_stFId.FId_bInhDiag_HVBAT_VCU_583 DINH_stFId.FId_bInhDiag_INV_217h DINH_stFId.FId_bInhDiag_INV_227h DINH_stFId.FId_bInhDiag_INV_237 DINH_stFId.FId_bInhDiag_INV_427h DINH_stFId.FId_bInhDiag_INV_497h DINH_stFId.FId_bInhDiag_INV_IMMO_5C7 DINH_stFId.FId_bInhDiag_IS_DAT6_BSI_592h DINH_stFId.FId_bInhDiag_IS_DAT_ABR_50Dh DINH_stFId.FId_bInhDiag_IS_DAT_BSI_412h DINH_stFId.FId_bInhDiag_IS_DYN_ABR_38Dh DINH_stFId.FId_bInhDiag_IS_INTE_ELECTRON_BSI_092h DINH_stFId.FId_bInhDiag_OBC_273h DINH_stFId.FId_bInhDiag_OBC_453h DINH_stFId.FId_bInhDiag_OBC_463h DINH_stFId.FId_bInhDiag_PDU_BusVoltages_308 DINH_stFId.FId_bInhDiag_PDU_Current_318 DINH_stFId.FId_bInhDiag_SC_INFO_BCCM_442h DINH_stFId.FId_bInhDiag_VCU_AIRBAG_351h DINH_stFId.FId_bInhDiag_VCU_eBCCM_432h DINH_stFId.FId_bInhDiag_VCU_eBCCM_552h DINH_stFId.FId_bInhDiag_eBCCM_082h DINH_stFId.FId_bInhDiag_eCOMP_Information_47B DINH_stFId.FId_bInhDiag_eCOMP_Information_48B DINH_stFId.FId_bInhFrbd_ComChrgr_iAcMax DINH_stFId.FId_bInhFrbd_ComChrgr_iDcHvAct DINH_stFId.FId_bInhFrbd_ComChrgr_pwrInAct DINH_stFId.FId_bInhFrbd_ComChrgr_pwrOutpCpby DINH_stFId.FId_bInhFrbd_ComChrgr_tChrgrMaxAct DINH_stFId.FId_bInhFrbd_ComChrgr_uAcActL1 DINH_stFId.FId_bInhFrbd_ComChrgr_uDcHvAct DINH_stFId.FId_bInhFrbd_ComEmac_iDcLnk01 DINH_stFId.FId_bInhFrbd_ComEmac_nAct01 DINH_stFId.FId_bInhFrbd_ComEmac_pwrInstnsInpRx DINH_stFId.FId_bInhFrbd_ComEmac_stActvDcha DINH_stFId.FId_bInhFrbd_ComEmac_stEVLmp DINH_stFId.FId_bInhFrbd_ComEmac_stIvtrOpMod01 DINH_stFId.FId_bInhFrbd_ComEmac_stMod01Rx DINH_stFId.FId_bInhFrbd_ComEmac_stMstWrnLmp DINH_stFId.FId_bInhFrbd_ComEmac_stSVSLmp DINH_stFId.FId_bInhFrbd_ComEmac_tqAbsltMax01 DINH_stFId.FId_bInhFrbd_ComEmac_tqAbsltMaxRx01 DINH_stFId.FId_bInhFrbd_ComEmac_tqAbsltMin01 DINH_stFId.FId_bInhFrbd_ComEmac_tqAbsltMinRx01 DINH_stFId.FId_bInhFrbd_ComEmac_tqAckd01 DINH_stFId.FId_bInhFrbd_ComEmac_tqAct01 DINH_stFId.FId_bInhFrbd_ComEmac_tqPtd01 DINH_stFId.FId_bInhFrbd_ComEmac_tqStabnMin DINH_stFId.FId_bInhFrbd_ComEmac_uDcLnk01 DINH_stFId.FId_bInhFrbd_Com_HvbMaxSnsrTempRx DINH_stFId.FId_bInhFrbd_Com_ctHvbNegCntctrSeg1 DINH_stFId.FId_bInhFrbd_Com_ctHvbNegCntctrSeg3 DINH_stFId.FId_bInhFrbd_Com_ctHvbNegCntctrSeg4 DINH_stFId.FId_bInhFrbd_Com_ctHvbPosCntctrSeg1 DINH_stFId.FId_bInhFrbd_Com_ctHvbPosCntctrSeg3 DINH_stFId.FId_bInhFrbd_Com_ctHvbPosCntctrSeg4 DINH_stFId.FId_bInhFrbd_Com_ctHvbPrecCntctrSeg1 DINH_stFId.FId_bInhFrbd_Com_ctHvbPrecCntctrSeg2 DINH_stFId.FId_bInhFrbd_Com_egyHvbAvl_fRx DINH_stFId.FId_bInhFrbd_Com_flgEcoNormReqRx DINH_stFId.FId_bInhFrbd_Com_iBattEBS1Rx DINH_stFId.FId_bInhFrbd_Com_iBattEBS2Rx DINH_stFId.FId_bInhFrbd_Com_iBattEBS3Rx DINH_stFId.FId_bInhFrbd_Com_iDcdcHvActRvsn1 DINH_stFId.FId_bInhFrbd_Com_iDcdcLvActRvsn1 DINH_stFId.FId_bInhFrbd_Com_iElCmprHvAct DINH_stFId.FId_bInhFrbd_Com_iElCmprPeakPha DINH_stFId.FId_bInhFrbd_Com_iHvbActRx DINH_stFId.FId_bInhFrbd_Com_iHvbChrgMaxSho DINH_stFId.FId_bInhFrbd_Com_iHvbDchaMaxSho DINH_stFId.FId_bInhFrbd_Com_iHvbDes DINH_stFId.FId_bInhFrbd_Com_iHvbNomChrgn DINH_stFId.FId_bInhFrbd_Com_nElCmprActl DINH_stFId.FId_bInhFrbd_Com_nrSerMaxCell DINH_stFId.FId_bInhFrbd_Com_nrSerMinCell DINH_stFId.FId_bInhFrbd_Com_pwrDcdcOutpCpby DINH_stFId.FId_bInhFrbd_Com_pwrElCmprActl DINH_stFId.FId_bInhFrbd_Com_pwrMaxChrgSho DINH_stFId.FId_bInhFrbd_Com_pwrMaxDchaSho DINH_stFId.FId_bInhFrbd_Com_qHvbTotCpRx DINH_stFId.FId_bInhFrbd_Com_rHvbIsoMeasmt DINH_stFId.FId_bInhFrbd_Com_ratHvbSoc DINH_stFId.FId_bInhFrbd_Com_ratHvbSoh DINH_stFId.FId_bInhFrbd_Com_ratRHvbSoh DINH_stFId.FId_bInhFrbd_Com_ratSocLvBatt DINH_stFId.FId_bInhFrbd_Com_stElCmprFltLvl DINH_stFId.FId_bInhFrbd_Com_stGearLvrPos DINH_stFId.FId_bInhFrbd_Com_stIIvtrFltLvl01 DINH_stFId.FId_bInhFrbd_Com_steTogFailrLvl DINH_stFId.FId_bInhFrbd_Com_tDcdcAct DINH_stFId.FId_bInhFrbd_Com_tDcdcInltCoolt DINH_stFId.FId_bInhFrbd_Com_tElCmprActl DINH_stFId.FId_bInhFrbd_Com_tEnvT DINH_stFId.FId_bInhFrbd_Com_tHvbAct DINH_stFId.FId_bInhFrbd_Com_tHvbMax DINH_stFId.FId_bInhFrbd_Com_tLvBatt DINH_stFId.FId_bInhFrbd_Com_tiHvbChrgnHalfRx DINH_stFId.FId_bInhFrbd_Com_uBattEBSRx DINH_stFId.FId_bInhFrbd_Com_uDcdcHvAct DINH_stFId.FId_bInhFrbd_Com_uDcdcLvAct DINH_stFId.FId_bInhFrbd_Com_uElCmprHvAct DINH_stFId.FId_bInhFrbd_Com_uHvbAct DINH_stFId.FId_bInhFrbd_Com_uHvbDcBus DINH_stFId.FId_bInhFrbd_Com_uHvbLimHi DINH_stFId.FId_bInhFrbd_Com_uHvbMaxCell DINH_stFId.FId_bInhFrbd_Com_uHvbMinCell DINH_stFId.FId_bInhFrbd_Com_uHvbNomChrgn DINH_stFId.FId_bInhInvld_ComChrgr_flgChrgrErrLvl DINH_stFId.FId_bInhInvld_ComChrgr_iAcMax DINH_stFId.FId_bInhInvld_ComChrgr_iDcHvAct DINH_stFId.FId_bInhInvld_ComChrgr_pwrInAct DINH_stFId.FId_bInhInvld_ComChrgr_pwrOutpCpby DINH_stFId.FId_bInhInvld_ComChrgr_tChrgrMaxAct DINH_stFId.FId_bInhInvld_ComChrgr_uAcActL1 DINH_stFId.FId_bInhInvld_ComChrgr_uDcHvAct DINH_stFId.FId_bInhInvld_ComEmac_iDcLnk01 DINH_stFId.FId_bInhInvld_ComEmac_nAct01 DINH_stFId.FId_bInhInvld_ComEmac_pwrInstnsInpRx DINH_stFId.FId_bInhInvld_ComEmac_stActvDcha DINH_stFId.FId_bInhInvld_ComEmac_stIvtrOpMod01 DINH_stFId.FId_bInhInvld_ComEmac_tInvr01 DINH_stFId.FId_bInhInvld_ComEmac_tIvtrCooltIn01 DINH_stFId.FId_bInhInvld_ComEmac_tMac01 DINH_stFId.FId_bInhInvld_ComEmac_tqAbsltMax01 DINH_stFId.FId_bInhInvld_ComEmac_tqAbsltMaxRx01 DINH_stFId.FId_bInhInvld_ComEmac_tqAbsltMin01 DINH_stFId.FId_bInhInvld_ComEmac_tqAbsltMinRx01 DINH_stFId.FId_bInhInvld_ComEmac_tqAckd01 DINH_stFId.FId_bInhInvld_ComEmac_tqAct01 DINH_stFId.FId_bInhInvld_ComEmac_tqPtd01 DINH_stFId.FId_bInhInvld_ComEmac_tqStabnMin DINH_stFId.FId_bInhInvld_ComEmac_uDcLnk01 DINH_stFId.FId_bInhInvld_Com_HvbMaxSnsrTempRx DINH_stFId.FId_bInhInvld_Com_ctHvbNegCntctrSeg1 DINH_stFId.FId_bInhInvld_Com_ctHvbNegCntctrSeg3 DINH_stFId.FId_bInhInvld_Com_ctHvbNegCntctrSeg4 DINH_stFId.FId_bInhInvld_Com_ctHvbPosCntctrSeg1 DINH_stFId.FId_bInhInvld_Com_ctHvbPosCntctrSeg3 DINH_stFId.FId_bInhInvld_Com_ctHvbPosCntctrSeg4 DINH_stFId.FId_bInhInvld_Com_ctHvbPrecCntctrSeg1 DINH_stFId.FId_bInhInvld_Com_ctHvbPrecCntctrSeg2 DINH_stFId.FId_bInhInvld_Com_egyHvbAvl_fRx DINH_stFId.FId_bInhInvld_Com_flgEcoNormReqRx DINH_stFId.FId_bInhInvld_Com_flgVehSpdAvl DINH_stFId.FId_bInhInvld_Com_iBattEBS1Rx DINH_stFId.FId_bInhInvld_Com_iBattEBS2Rx DINH_stFId.FId_bInhInvld_Com_iBattEBS3Rx DINH_stFId.FId_bInhInvld_Com_iDcdcHvActRvsn1 DINH_stFId.FId_bInhInvld_Com_iDcdcLvActRvsn1 DINH_stFId.FId_bInhInvld_Com_iElCmprHvAct DINH_stFId.FId_bInhInvld_Com_iElCmprPeakPha DINH_stFId.FId_bInhInvld_Com_iHvbActRx DINH_stFId.FId_bInhInvld_Com_iHvbChrgMaxSho DINH_stFId.FId_bInhInvld_Com_iHvbDchaMaxSho DINH_stFId.FId_bInhInvld_Com_iHvbDes DINH_stFId.FId_bInhInvld_Com_iHvbNomChrgn DINH_stFId.FId_bInhInvld_Com_lDstGlbDa DINH_stFId.FId_bInhInvld_Com_lTotOdometer DINH_stFId.FId_bInhInvld_Com_nElCmprActl DINH_stFId.FId_bInhInvld_Com_nrSerMaxCell DINH_stFId.FId_bInhInvld_Com_nrSerMinCell DINH_stFId.FId_bInhInvld_Com_pwrDcdcOutpCpby DINH_stFId.FId_bInhInvld_Com_pwrElCmprActl DINH_stFId.FId_bInhInvld_Com_pwrMaxChrgSho DINH_stFId.FId_bInhInvld_Com_pwrMaxDchaSho DINH_stFId.FId_bInhInvld_Com_qHvbTotCpRx DINH_stFId.FId_bInhInvld_Com_rHvbIsoMeasmt DINH_stFId.FId_bInhInvld_Com_ratHvbSoc DINH_stFId.FId_bInhInvld_Com_ratHvbSoh DINH_stFId.FId_bInhInvld_Com_ratRHvbSoh DINH_stFId.FId_bInhInvld_Com_ratSocLvBatt DINH_stFId.FId_bInhInvld_Com_stAC DINH_stFId.FId_bInhInvld_Com_stAlrtThermRunAwy DINH_stFId.FId_bInhInvld_Com_stBlowrRly DINH_stFId.FId_bInhInvld_Com_stDcdcFltLvl DINH_stFId.FId_bInhInvld_Com_stEvapTFlt DINH_stFId.FId_bInhInvld_Com_stGearLvrPos DINH_stFId.FId_bInhInvld_Com_stHvacBlwrFront DINH_stFId.FId_bInhInvld_Com_stHvacKnobPosn DINH_stFId.FId_bInhInvld_Com_stHvacPanPotiFlt DINH_stFId.FId_bInhInvld_Com_stHvbChrgn DINH_stFId.FId_bInhInvld_Com_stHvbDiscnctReas DINH_stFId.FId_bInhInvld_Com_stHvbIntlckRx DINH_stFId.FId_bInhInvld_Com_stHvbIsoFltRx DINH_stFId.FId_bInhInvld_Com_stHvbSrvPlgRx DINH_stFId.FId_bInhInvld_Com_stIBattEBS DINH_stFId.FId_bInhInvld_Com_stIIvtrFltLvl01 DINH_stFId.FId_bInhInvld_Com_stMainWkuReq DINH_stFId.FId_bInhInvld_Com_stReFogReq DINH_stFId.FId_bInhInvld_Com_stSocRx DINH_stFId.FId_bInhInvld_Com_stT DINH_stFId.FId_bInhInvld_Com_tDcdcAct DINH_stFId.FId_bInhInvld_Com_tDcdcInltCoolt DINH_stFId.FId_bInhInvld_Com_tElCmprActl DINH_stFId.FId_bInhInvld_Com_tEnvT DINH_stFId.FId_bInhInvld_Com_tEvapT DINH_stFId.FId_bInhInvld_Com_tHvbAct DINH_stFId.FId_bInhInvld_Com_tHvbMax DINH_stFId.FId_bInhInvld_Com_tLvBatt DINH_stFId.FId_bInhInvld_Com_tiCurVehTmr DINH_stFId.FId_bInhInvld_Com_tiHvbChrgnHalfRx DINH_stFId.FId_bInhInvld_Com_uBattEBSRx DINH_stFId.FId_bInhInvld_Com_uDcdcHvAct DINH_stFId.FId_bInhInvld_Com_uDcdcLvAct DINH_stFId.FId_bInhInvld_Com_uElCmprHvAct DINH_stFId.FId_bInhInvld_Com_uHvbAct DINH_stFId.FId_bInhInvld_Com_uHvbDcBus DINH_stFId.FId_bInhInvld_Com_uHvbLimHi DINH_stFId.FId_bInhInvld_Com_uHvbMaxCell DINH_stFId.FId_bInhInvld_Com_uHvbMinCell DINH_stFId.FId_bInhInvld_Com_uHvbNomChrgn DINH_stFId.FId_bInhInvld_Com_vVeh DINH_stFId.FId_bInh_ACCmpr_pwrLimMax DINH_stFId.FId_bInh_ACCtl_flgCmprEna DINH_stFId.FId_bInh_ACCtl_nCmprSpdReq DINH_stFId.FId_bInh_APP_rInp DINH_stFId.FId_bInh_BattId_numOrganNature1 DINH_stFId.FId_bInh_BattId_numOrganNature2 DINH_stFId.FId_bInh_BattId_numOrganRef1 DINH_stFId.FId_bInh_BattId_numOrganRef2 DINH_stFId.FId_bInh_BattId_numOrganRef3 DINH_stFId.FId_bInh_BattId_numOrganRef4 DINH_stFId.FId_bInh_BattId_numSerl1 DINH_stFId.FId_bInh_BattId_numSerl2 DINH_stFId.FId_bInh_BattId_numSerl3 DINH_stFId.FId_bInh_BattId_numSerl4 DINH_stFId.FId_bInh_BattId_numSerl5 DINH_stFId.FId_bInh_BattId_numSerl6 DINH_stFId.FId_bInh_BattId_numSerl7 DINH_stFId.FId_bInh_Brk_stRed DINH_stFId.FId_bInh_CbnHeatgHeatr_cntrRlyLf DINH_stFId.FId_bInh_ChgrPlug_stPlgLockTx DINH_stFId.FId_bInh_ChrgCntct_nrNegCntctElpdOper DINH_stFId.FId_bInh_ChrgCntct_nrPosCntctElpdOper DINH_stFId.FId_bInh_ChrgrRly_stRlyDes DINH_stFId.FId_bInh_ChrgrVal_iChrgrDes DINH_stFId.FId_bInh_ChrgrVal_iGridLimMax DINH_stFId.FId_bInh_ChrgrVal_uHvMax DINH_stFId.FId_bInh_CoDrvPITh_stEPSModeReq DINH_stFId.FId_bInh_CoPtFH_stPwt DINH_stFId.FId_bInh_ComChrg_stMod DINH_stFId.FId_bInh_ComChrgr_stChrgnEna DINH_stFId.FId_bInh_Com_25h_B1b0 DINH_stFId.FId_bInh_Com_25h_B1b2 DINH_stFId.FId_bInh_Com_25h_B1b4 DINH_stFId.FId_bInh_Com_25h_B1b6 DINH_stFId.FId_bInh_Com_HvbMaxSnsrTempTx DINH_stFId.FId_bInh_Com_TogLedDrv DINH_stFId.FId_bInh_Com_TogLedMod DINH_stFId.FId_bInh_Com_TogLedNeut DINH_stFId.FId_bInh_Com_TogLedRvs DINH_stFId.FId_bInh_Com_bAcLedReq DINH_stFId.FId_bInh_Com_bDiagMuxCAN DINH_stFId.FId_bInh_Com_bGunCntInfoWkuReq DINH_stFId.FId_bInh_Com_bHvBattRchrgWkuReq DINH_stFId.FId_bInh_Com_bPostOperationWkuReq DINH_stFId.FId_bInh_Com_bReFogRlySt DINH_stFId.FId_bInh_Com_flgBlowrAuthn DINH_stFId.FId_bInh_Com_flgBlowrRlyCtrl DINH_stFId.FId_bInh_Com_flgBrkAlrt DINH_stFId.FId_bInh_Com_flgDrvAwy DINH_stFId.FId_bInh_Com_flgVehSpdQly DINH_stFId.FId_bInh_Com_iHvbActTx DINH_stFId.FId_bInh_Com_nElCmprActlTx DINH_stFId.FId_bInh_Com_nIvtrMotAct01 DINH_stFId.FId_bInh_Com_noEditCal DINH_stFId.FId_bInh_Com_noEditSw DINH_stFId.FId_bInh_Com_noVerSysDay DINH_stFId.FId_bInh_Com_noVersAdp DINH_stFId.FId_bInh_Com_noVersSw DINH_stFId.FId_bInh_Com_noVersSys DINH_stFId.FId_bInh_Com_noVersSysMnth DINH_stFId.FId_bInh_Com_noVersSysYr DINH_stFId.FId_bInh_Com_stACTx DINH_stFId.FId_bInh_Com_stBrk DINH_stFId.FId_bInh_Com_stBrkBstPFlt DINH_stFId.FId_bInh_Com_stBrkCntctIndcn DINH_stFId.FId_bInh_Com_stChrgPlg DINH_stFId.FId_bInh_Com_stChrgPlgChrgn DINH_stFId.FId_bInh_Com_stClstrStopIndcn DINH_stFId.FId_bInh_Com_stCmdHvBattCntctr DINH_stFId.FId_bInh_Com_stCmdOffsEM01 DINH_stFId.FId_bInh_Com_stDrvAwyDi DINH_stFId.FId_bInh_Com_stDrvModPosn DINH_stFId.FId_bInh_Com_stEVLmp DINH_stFId.FId_bInh_Com_stElCmprStatTx DINH_stFId.FId_bInh_Com_stElMDesEem DINH_stFId.FId_bInh_Com_stHvBattOperModDes DINH_stFId.FId_bInh_Com_stHvacBlwrFront_CAN DINH_stFId.FId_bInh_Com_stHvacKnobPosn_CAN DINH_stFId.FId_bInh_Com_stMstWrnLmp DINH_stFId.FId_bInh_Com_stNwCmdLIN DINH_stFId.FId_bInh_Com_stPwrLimnLmp DINH_stFId.FId_bInh_Com_stReFogReq_CAN DINH_stFId.FId_bInh_Com_stSrvLmp DINH_stFId.FId_bInh_Com_stVehCoorn DINH_stFId.FId_bInh_Com_tqMotLimMax DINH_stFId.FId_bInh_Com_uHvbActTx DINH_stFId.FId_bInh_Com_valEepOffsEM01 DINH_stFId.FId_bInh_DcChrgnRly_ctMaxOperCyc DINH_stFId.FId_bInh_Dcdc_flgDesLvGridULim DINH_stFId.FId_bInh_Dcdc_iLimLvGrid DINH_stFId.FId_bInh_Dcdc_stDesDcdc DINH_stFId.FId_bInh_Dcdc_uDesLvGrid DINH_stFId.FId_bInh_DrvInfo_wTotTripEgy DINH_stFId.FId_bInh_EChrDv_cntPlin DINH_stFId.FId_bInh_Eem_flgFstHvShdwn DINH_stFId.FId_bInh_ElM_stDesEem01 DINH_stFId.FId_bInh_ElTS_egyTotChrgCyc DINH_stFId.FId_bInh_ElTS_ratEmPowChrgn DINH_stFId.FId_bInh_ElTS_ratEmPowDcha DINH_stFId.FId_bInh_ElTS_stChrgCyc DINH_stFId.FId_bInh_Emac_stIsoMonSwtReq DINH_stFId.FId_bInh_Emac_tqDesCom01 DINH_stFId.FId_bInh_Ext_bSyncGPC DINH_stFId.FId_bInh_HvBatt_flgIsoMeasmtDiReq DINH_stFId.FId_bInh_HvBatt_ratSoc DINH_stFId.FId_bInh_HvGrid_pwrMaxDcdc DINH_stFId.FId_bInh_HvacPtc_stElHeatr DINH_stFId.FId_bInh_Pdu_CLUSTER_5E7_Frz DINH_stFId.FId_bInh_Pdu_CLUSTER_5E7_Rcf DINH_stFId.FId_bInh_Pdu_CONTEXTE_1_5B2_Frz DINH_stFId.FId_bInh_Pdu_CONTEXTE_1_5B2_Rcf DINH_stFId.FId_bInh_Pdu_DAT3_BSI_4F2h_Frz DINH_stFId.FId_bInh_Pdu_DAT3_BSI_4F2h_Rcf DINH_stFId.FId_bInh_Pdu_DCDC_283h_Frz DINH_stFId.FId_bInh_Pdu_DCDC_283h_Rcf DINH_stFId.FId_bInh_Pdu_DCDC_293h_Frz DINH_stFId.FId_bInh_Pdu_DCDC_293h_Rcf DINH_stFId.FId_bInh_Pdu_DCDC_473h_Frz DINH_stFId.FId_bInh_Pdu_DCDC_473h_Rcf DINH_stFId.FId_bInh_Pdu_DCDC_663h_Frz DINH_stFId.FId_bInh_Pdu_DCDC_663h_Rcf DINH_stFId.FId_bInh_Pdu_HS3_AUTO_GEARBOX_SWITCH_STATUS_Frz DINH_stFId.FId_bInh_Pdu_HS3_AUTO_GEARBOX_SWITCH_STATUS_Rcf DINH_stFId.FId_bInh_Pdu_HVAC_PANEL_26h_Frz DINH_stFId.FId_bInh_Pdu_HVAC_PANEL_26h_Rcf DINH_stFId.FId_bInh_Pdu_HVBAT_205h_Frz DINH_stFId.FId_bInh_Pdu_HVBAT_205h_Rcf DINH_stFId.FId_bInh_Pdu_HVBAT_275h_Frz DINH_stFId.FId_bInh_Pdu_HVBAT_275h_Rcf DINH_stFId.FId_bInh_Pdu_HVBAT_285h_Frz DINH_stFId.FId_bInh_Pdu_HVBAT_285h_Rcf DINH_stFId.FId_bInh_Pdu_HVBAT_325h_Frz DINH_stFId.FId_bInh_Pdu_HVBAT_325h_Rcf DINH_stFId.FId_bInh_Pdu_HVBAT_335h_Frz DINH_stFId.FId_bInh_Pdu_HVBAT_335h_Rcf DINH_stFId.FId_bInh_Pdu_HVBAT_455h_Frz DINH_stFId.FId_bInh_Pdu_HVBAT_455h_Rcf DINH_stFId.FId_bInh_Pdu_HVBAT_535_Frz DINH_stFId.FId_bInh_Pdu_HVBAT_535_Rcf DINH_stFId.FId_bInh_Pdu_HVBAT_595h_Frz DINH_stFId.FId_bInh_Pdu_HVBAT_595h_Rcf DINH_stFId.FId_bInh_Pdu_HVBAT_635h_Frz DINH_stFId.FId_bInh_Pdu_HVBAT_635h_Rcf DINH_stFId.FId_bInh_Pdu_HVBAT_645h_Frz DINH_stFId.FId_bInh_Pdu_HVBAT_645h_Rcf DINH_stFId.FId_bInh_Pdu_HVBAT_665h_Frz DINH_stFId.FId_bInh_Pdu_HVBAT_665h_Rcf DINH_stFId.FId_bInh_Pdu_HVBAT_675h_Frz DINH_stFId.FId_bInh_Pdu_HVBAT_675h_Rcf DINH_stFId.FId_bInh_Pdu_HVBAT_THERMAL_5B5_Frz DINH_stFId.FId_bInh_Pdu_HVBAT_THERMAL_5B5_Rcf DINH_stFId.FId_bInh_Pdu_HVBAT_VCU_435h_Frz DINH_stFId.FId_bInh_Pdu_HVBAT_VCU_435h_Rcf DINH_stFId.FId_bInh_Pdu_HVBAT_VCU_543_Frz DINH_stFId.FId_bInh_Pdu_HVBAT_VCU_543_Rcf DINH_stFId.FId_bInh_Pdu_HVBAT_VCU_583_Frz DINH_stFId.FId_bInh_Pdu_HVBAT_VCU_583_Rcf DINH_stFId.FId_bInh_Pdu_INV_217h_Frz DINH_stFId.FId_bInh_Pdu_INV_217h_Rcf DINH_stFId.FId_bInh_Pdu_INV_227h_Frz DINH_stFId.FId_bInh_Pdu_INV_227h_Rcf DINH_stFId.FId_bInh_Pdu_INV_237_Frz DINH_stFId.FId_bInh_Pdu_INV_237_Rcf DINH_stFId.FId_bInh_Pdu_INV_427h_Frz DINH_stFId.FId_bInh_Pdu_INV_427h_Rcf DINH_stFId.FId_bInh_Pdu_INV_497h_Frz DINH_stFId.FId_bInh_Pdu_INV_497h_Rcf DINH_stFId.FId_bInh_Pdu_INV_IMMO_5C7_Frz DINH_stFId.FId_bInh_Pdu_INV_IMMO_5C7_Rcf DINH_stFId.FId_bInh_Pdu_IS_DAT6_BSI_592h_Frz DINH_stFId.FId_bInh_Pdu_IS_DAT6_BSI_592h_Rcf DINH_stFId.FId_bInh_Pdu_IS_DAT_ABR_50Dh_Frz DINH_stFId.FId_bInh_Pdu_IS_DAT_ABR_50Dh_Rcf DINH_stFId.FId_bInh_Pdu_IS_DAT_BSI_412h_Frz DINH_stFId.FId_bInh_Pdu_IS_DAT_BSI_412h_Rcf DINH_stFId.FId_bInh_Pdu_IS_DYN_ABR_38Dh_Frz DINH_stFId.FId_bInh_Pdu_IS_DYN_ABR_38Dh_Rcf DINH_stFId.FId_bInh_Pdu_IS_INTE_ELECTRON_BSI_092h_Frz DINH_stFId.FId_bInh_Pdu_IS_INTE_ELECTRON_BSI_092h_Rcf DINH_stFId.FId_bInh_Pdu_OBC_273h_Frz DINH_stFId.FId_bInh_Pdu_OBC_273h_Rcf DINH_stFId.FId_bInh_Pdu_OBC_453h_Frz DINH_stFId.FId_bInh_Pdu_OBC_453h_Rcf DINH_stFId.FId_bInh_Pdu_OBC_463h_Frz DINH_stFId.FId_bInh_Pdu_OBC_463h_Rcf DINH_stFId.FId_bInh_Pdu_PDU_BusVoltages_308_Frz DINH_stFId.FId_bInh_Pdu_PDU_BusVoltages_308_Rcf DINH_stFId.FId_bInh_Pdu_PDU_Current_318_Frz DINH_stFId.FId_bInh_Pdu_PDU_Current_318_Rcf DINH_stFId.FId_bInh_Pdu_SC_INFO_BCCM_442h_Frz DINH_stFId.FId_bInh_Pdu_SC_INFO_BCCM_442h_Rcf DINH_stFId.FId_bInh_Pdu_VCU_AIRBAG_351h_Frz DINH_stFId.FId_bInh_Pdu_VCU_AIRBAG_351h_Rcf DINH_stFId.FId_bInh_Pdu_VCU_eBCCM_432h_Frz DINH_stFId.FId_bInh_Pdu_VCU_eBCCM_432h_Rcf DINH_stFId.FId_bInh_Pdu_VCU_eBCCM_552h_Frz DINH_stFId.FId_bInh_Pdu_VCU_eBCCM_552h_Rcf DINH_stFId.FId_bInh_Pdu_eBCCM_082h_Frz DINH_stFId.FId_bInh_Pdu_eBCCM_082h_Rcf DINH_stFId.FId_bInh_Pdu_eCOMP_Information_47B_Frz DINH_stFId.FId_bInh_Pdu_eCOMP_Information_47B_Rcf DINH_stFId.FId_bInh_Pdu_eCOMP_Information_48B_Frz DINH_stFId.FId_bInh_Pdu_eCOMP_Information_48B_Rcf DINH_stFId.FId_bInh_Sig205h_Com_iHvbActRx_Frz DINH_stFId.FId_bInh_Sig205h_Com_iHvbActRx_Rcf DINH_stFId.FId_bInh_Sig205h_Com_ratHvbSoc_Frz DINH_stFId.FId_bInh_Sig205h_Com_ratHvbSoc_Rcf DINH_stFId.FId_bInh_Sig205h_Com_stHvbChrgn_Frz DINH_stFId.FId_bInh_Sig205h_Com_stHvbChrgn_Rcf DINH_stFId.FId_bInh_Sig205h_Com_uHvbAct_Frz DINH_stFId.FId_bInh_Sig205h_Com_uHvbAct_Rcf DINH_stFId.FId_bInh_Sig217h_ComEmac_nAct01_Frz DINH_stFId.FId_bInh_Sig217h_ComEmac_nAct01_Rcf DINH_stFId.FId_bInh_Sig217h_ComEmac_tqAckd01_Frz DINH_stFId.FId_bInh_Sig217h_ComEmac_tqAckd01_Rcf DINH_stFId.FId_bInh_Sig217h_ComEmac_tqAct01_Frz DINH_stFId.FId_bInh_Sig217h_ComEmac_tqAct01_Rcf DINH_stFId.FId_bInh_Sig217h_ComEmac_uDcLnk01_Frz DINH_stFId.FId_bInh_Sig217h_ComEmac_uDcLnk01_Rcf DINH_stFId.FId_bInh_Sig227h_ComEmac_iDcLnk01_Frz DINH_stFId.FId_bInh_Sig227h_ComEmac_iDcLnk01_Rcf DINH_stFId.FId_bInh_Sig227h_ComEmac_pwrInstnsInpRx_Frz DINH_stFId.FId_bInh_Sig227h_ComEmac_pwrInstnsInpRx_Rcf DINH_stFId.FId_bInh_Sig227h_ComEmac_tqAbsltMax01_Frz DINH_stFId.FId_bInh_Sig227h_ComEmac_tqAbsltMax01_Rcf DINH_stFId.FId_bInh_Sig227h_ComEmac_tqAbsltMaxRx01_Frz DINH_stFId.FId_bInh_Sig227h_ComEmac_tqAbsltMaxRx01_Rcf DINH_stFId.FId_bInh_Sig227h_ComEmac_tqAbsltMin01_Frz DINH_stFId.FId_bInh_Sig227h_ComEmac_tqAbsltMin01_Rcf DINH_stFId.FId_bInh_Sig227h_ComEmac_tqAbsltMinRx01_Frz DINH_stFId.FId_bInh_Sig227h_ComEmac_tqAbsltMinRx01_Rcf DINH_stFId.FId_bInh_Sig237h_ComEmac_stActvDcha_Frz DINH_stFId.FId_bInh_Sig237h_ComEmac_stActvDcha_Rcf DINH_stFId.FId_bInh_Sig237h_ComEmac_stEVLmp_Frz DINH_stFId.FId_bInh_Sig237h_ComEmac_stEVLmp_Rcf DINH_stFId.FId_bInh_Sig237h_ComEmac_stMod01Rx_Frz DINH_stFId.FId_bInh_Sig237h_ComEmac_stMod01Rx_Rcf DINH_stFId.FId_bInh_Sig237h_ComEmac_stMstWrnLmp_Frz DINH_stFId.FId_bInh_Sig237h_ComEmac_stMstWrnLmp_Rcf DINH_stFId.FId_bInh_Sig237h_ComEmac_stSVSLmp_Frz DINH_stFId.FId_bInh_Sig237h_ComEmac_stSVSLmp_Rcf DINH_stFId.FId_bInh_Sig237h_ComEmac_tqStabnMin_Frz DINH_stFId.FId_bInh_Sig237h_ComEmac_tqStabnMin_Rcf DINH_stFId.FId_bInh_Sig237h_Com_stIIvtrFltLvl01_Frz DINH_stFId.FId_bInh_Sig237h_Com_stIIvtrFltLvl01_Rcf DINH_stFId.FId_bInh_Sig259h_Com_flgEcoNormReqRx_Frz DINH_stFId.FId_bInh_Sig259h_Com_flgEcoNormReqRx_Rcf DINH_stFId.FId_bInh_Sig259h_Com_stGearLvrPos_Frz DINH_stFId.FId_bInh_Sig259h_Com_stGearLvrPos_Rcf DINH_stFId.FId_bInh_Sig259h_Com_steTogFailrLvl_Frz DINH_stFId.FId_bInh_Sig259h_Com_steTogFailrLvl_Rcf DINH_stFId.FId_bInh_Sig26h_Com_stAC_Frz DINH_stFId.FId_bInh_Sig26h_Com_stAC_Rcf DINH_stFId.FId_bInh_Sig26h_Com_stEvapTFlt_Frz DINH_stFId.FId_bInh_Sig26h_Com_stEvapTFlt_Rcf DINH_stFId.FId_bInh_Sig26h_Com_stHvacBlwrFront_Frz DINH_stFId.FId_bInh_Sig26h_Com_stHvacBlwrFront_Rcf DINH_stFId.FId_bInh_Sig26h_Com_stHvacKnobPosn_Frz DINH_stFId.FId_bInh_Sig26h_Com_stHvacKnobPosn_Rcf DINH_stFId.FId_bInh_Sig26h_Com_stHvacPanPotiFlt_Frz DINH_stFId.FId_bInh_Sig26h_Com_stHvacPanPotiFlt_Rcf DINH_stFId.FId_bInh_Sig26h_Com_stReFogReq_Frz DINH_stFId.FId_bInh_Sig26h_Com_stReFogReq_Rcf DINH_stFId.FId_bInh_Sig26h_Com_tEvapT_Frz DINH_stFId.FId_bInh_Sig26h_Com_tEvapT_Rcf DINH_stFId.FId_bInh_Sig273h_ComChrgr_flgChrgrErrLvl_Frz DINH_stFId.FId_bInh_Sig273h_ComChrgr_flgChrgrErrLvl_Rcf DINH_stFId.FId_bInh_Sig273h_ComChrgr_pwrOutpCpby_Frz DINH_stFId.FId_bInh_Sig273h_ComChrgr_pwrOutpCpby_Rcf DINH_stFId.FId_bInh_Sig275h_Com_iHvbDchaMaxSho_Frz DINH_stFId.FId_bInh_Sig275h_Com_iHvbDchaMaxSho_Rcf DINH_stFId.FId_bInh_Sig275h_Com_pwrMaxDchaSho_Frz DINH_stFId.FId_bInh_Sig275h_Com_pwrMaxDchaSho_Rcf DINH_stFId.FId_bInh_Sig283h_Com_iDcdcHvActRvsn1_Frz DINH_stFId.FId_bInh_Sig283h_Com_iDcdcHvActRvsn1_Rcf DINH_stFId.FId_bInh_Sig283h_Com_iDcdcLvActRvsn1_Frz DINH_stFId.FId_bInh_Sig283h_Com_iDcdcLvActRvsn1_Rcf DINH_stFId.FId_bInh_Sig283h_Com_uDcdcHvAct_Frz DINH_stFId.FId_bInh_Sig283h_Com_uDcdcHvAct_Rcf DINH_stFId.FId_bInh_Sig283h_Com_uDcdcLvAct_Frz DINH_stFId.FId_bInh_Sig283h_Com_uDcdcLvAct_Rcf DINH_stFId.FId_bInh_Sig285h_Com_iHvbChrgMaxSho_Frz DINH_stFId.FId_bInh_Sig285h_Com_iHvbChrgMaxSho_Rcf DINH_stFId.FId_bInh_Sig285h_Com_pwrMaxChrgSho_Frz DINH_stFId.FId_bInh_Sig285h_Com_pwrMaxChrgSho_Rcf DINH_stFId.FId_bInh_Sig293h_Com_pwrDcdcOutpCpby_Frz DINH_stFId.FId_bInh_Sig293h_Com_pwrDcdcOutpCpby_Rcf DINH_stFId.FId_bInh_Sig293h_Com_stDcdcFltLvl_Frz DINH_stFId.FId_bInh_Sig293h_Com_stDcdcFltLvl_Rcf DINH_stFId.FId_bInh_Sig325h_Com_rHvbIsoMeasmt_Frz DINH_stFId.FId_bInh_Sig325h_Com_rHvbIsoMeasmt_Rcf DINH_stFId.FId_bInh_Sig325h_Com_stHvbIntlckRx_Frz DINH_stFId.FId_bInh_Sig325h_Com_stHvbIntlckRx_Rcf DINH_stFId.FId_bInh_Sig325h_Com_stHvbIsoFltRx_Frz DINH_stFId.FId_bInh_Sig325h_Com_stHvbIsoFltRx_Rcf DINH_stFId.FId_bInh_Sig325h_Com_stHvbSrvPlgRx_Frz DINH_stFId.FId_bInh_Sig325h_Com_stHvbSrvPlgRx_Rcf DINH_stFId.FId_bInh_Sig325h_Com_tHvbMax_Frz DINH_stFId.FId_bInh_Sig325h_Com_tHvbMax_Rcf DINH_stFId.FId_bInh_Sig335h_Com_iHvbDes_Frz DINH_stFId.FId_bInh_Sig335h_Com_iHvbDes_Rcf DINH_stFId.FId_bInh_Sig335h_Com_iHvbNomChrgn_Frz DINH_stFId.FId_bInh_Sig335h_Com_iHvbNomChrgn_Rcf DINH_stFId.FId_bInh_Sig335h_Com_uHvbDcBus_Frz DINH_stFId.FId_bInh_Sig335h_Com_uHvbDcBus_Rcf DINH_stFId.FId_bInh_Sig335h_Com_uHvbLimHi_Frz DINH_stFId.FId_bInh_Sig335h_Com_uHvbLimHi_Rcf DINH_stFId.FId_bInh_Sig38Dh_Com_flgVehSpdAvl_Frz DINH_stFId.FId_bInh_Sig38Dh_Com_flgVehSpdAvl_Rcf DINH_stFId.FId_bInh_Sig38Dh_Com_vVeh_Frz DINH_stFId.FId_bInh_Sig38Dh_Com_vVeh_Rcf DINH_stFId.FId_bInh_Sig427h_ComEmac_stIvtrOpMod01_Frz DINH_stFId.FId_bInh_Sig427h_ComEmac_stIvtrOpMod01_Rcf DINH_stFId.FId_bInh_Sig427h_ComEmac_tInvr01_Frz DINH_stFId.FId_bInh_Sig427h_ComEmac_tInvr01_Rcf DINH_stFId.FId_bInh_Sig427h_ComEmac_tIvtrCooltIn01_Frz DINH_stFId.FId_bInh_Sig427h_ComEmac_tIvtrCooltIn01_Rcf DINH_stFId.FId_bInh_Sig427h_ComEmac_tMac01_Frz DINH_stFId.FId_bInh_Sig427h_ComEmac_tMac01_Rcf DINH_stFId.FId_bInh_Sig427h_ComEmac_tqPtd01_Frz DINH_stFId.FId_bInh_Sig427h_ComEmac_tqPtd01_Rcf DINH_stFId.FId_bInh_Sig432h_Com_stMainWkuReq_Frz DINH_stFId.FId_bInh_Sig432h_Com_stMainWkuReq_Rcf DINH_stFId.FId_bInh_Sig435h_Com_HvbMaxSnsrTempRx_Frz DINH_stFId.FId_bInh_Sig435h_Com_HvbMaxSnsrTempRx_Rcf DINH_stFId.FId_bInh_Sig435h_Com_nrSerMaxCell_Frz DINH_stFId.FId_bInh_Sig435h_Com_nrSerMaxCell_Rcf DINH_stFId.FId_bInh_Sig435h_Com_nrSerMinCell_Frz DINH_stFId.FId_bInh_Sig435h_Com_nrSerMinCell_Rcf DINH_stFId.FId_bInh_Sig435h_Com_uHvbMaxCell_Frz DINH_stFId.FId_bInh_Sig435h_Com_uHvbMaxCell_Rcf DINH_stFId.FId_bInh_Sig435h_Com_uHvbMinCell_Frz DINH_stFId.FId_bInh_Sig435h_Com_uHvbMinCell_Rcf DINH_stFId.FId_bInh_Sig442h_Com_stBlowrRly_Frz DINH_stFId.FId_bInh_Sig442h_Com_stBlowrRly_Rcf DINH_stFId.FId_bInh_Sig453h_ComChrgr_iAcMax_Frz DINH_stFId.FId_bInh_Sig453h_ComChrgr_iAcMax_Rcf DINH_stFId.FId_bInh_Sig453h_ComChrgr_pwrInAct_Frz DINH_stFId.FId_bInh_Sig453h_ComChrgr_pwrInAct_Rcf DINH_stFId.FId_bInh_Sig453h_ComChrgr_uAcActL1_Frz DINH_stFId.FId_bInh_Sig453h_ComChrgr_uAcActL1_Rcf DINH_stFId.FId_bInh_Sig455h_Com_uHvbNomChrgn_Frz DINH_stFId.FId_bInh_Sig455h_Com_uHvbNomChrgn_Rcf DINH_stFId.FId_bInh_Sig463h_ComChrgr_iDcHvAct_Frz DINH_stFId.FId_bInh_Sig463h_ComChrgr_iDcHvAct_Rcf DINH_stFId.FId_bInh_Sig463h_ComChrgr_tChrgrMaxAct_Frz DINH_stFId.FId_bInh_Sig463h_ComChrgr_tChrgrMaxAct_Rcf DINH_stFId.FId_bInh_Sig463h_ComChrgr_uDcHvAct_Frz DINH_stFId.FId_bInh_Sig463h_ComChrgr_uDcHvAct_Rcf DINH_stFId.FId_bInh_Sig473h_Com_tDcdcAct_Frz DINH_stFId.FId_bInh_Sig473h_Com_tDcdcAct_Rcf DINH_stFId.FId_bInh_Sig473h_Com_tDcdcInltCoolt_Frz DINH_stFId.FId_bInh_Sig473h_Com_tDcdcInltCoolt_Rcf DINH_stFId.FId_bInh_Sig47Bh_Com_iElCmprHvAct_Frz DINH_stFId.FId_bInh_Sig47Bh_Com_iElCmprHvAct_Rcf DINH_stFId.FId_bInh_Sig47Bh_Com_iElCmprPeakPha_Frz DINH_stFId.FId_bInh_Sig47Bh_Com_iElCmprPeakPha_Rcf DINH_stFId.FId_bInh_Sig47Bh_Com_nElCmprActl_Frz DINH_stFId.FId_bInh_Sig47Bh_Com_nElCmprActl_Rcf DINH_stFId.FId_bInh_Sig47Bh_Com_pwrElCmprActl_Frz DINH_stFId.FId_bInh_Sig47Bh_Com_pwrElCmprActl_Rcf DINH_stFId.FId_bInh_Sig47Bh_Com_tElCmprActl_Frz DINH_stFId.FId_bInh_Sig47Bh_Com_tElCmprActl_Rcf DINH_stFId.FId_bInh_Sig47Bh_Com_uElCmprHvAct_Frz DINH_stFId.FId_bInh_Sig47Bh_Com_uElCmprHvAct_Rcf DINH_stFId.FId_bInh_Sig48Bh_Com_stElCmprFltLvl_Frz DINH_stFId.FId_bInh_Sig48Bh_Com_stElCmprFltLvl_Rcf DINH_stFId.FId_bInh_Sig4F2h_Com_ratSocLvBatt_Frz DINH_stFId.FId_bInh_Sig4F2h_Com_ratSocLvBatt_Rcf DINH_stFId.FId_bInh_Sig4F2h_Com_stSocRx_Frz DINH_stFId.FId_bInh_Sig4F2h_Com_stSocRx_Rcf DINH_stFId.FId_bInh_Sig4F2h_Com_stT_Frz DINH_stFId.FId_bInh_Sig4F2h_Com_stT_Rcf DINH_stFId.FId_bInh_Sig535h_Com_tHvbAct_Frz DINH_stFId.FId_bInh_Sig535h_Com_tHvbAct_Rcf DINH_stFId.FId_bInh_Sig543h_Com_egyHvbAvl_fRx_Frz DINH_stFId.FId_bInh_Sig543h_Com_egyHvbAvl_fRx_Rcf DINH_stFId.FId_bInh_Sig543h_Com_ratHvbSoh_Frz DINH_stFId.FId_bInh_Sig543h_Com_ratHvbSoh_Rcf DINH_stFId.FId_bInh_Sig543h_Com_ratRHvbSoh_Frz DINH_stFId.FId_bInh_Sig543h_Com_ratRHvbSoh_Rcf DINH_stFId.FId_bInh_Sig552h_Com_lDstGlbDa_Frz DINH_stFId.FId_bInh_Sig552h_Com_lDstGlbDa_Rcf DINH_stFId.FId_bInh_Sig552h_Com_lTotOdometer_Frz DINH_stFId.FId_bInh_Sig552h_Com_lTotOdometer_Rcf DINH_stFId.FId_bInh_Sig552h_Com_tiCurVehTmr_Frz DINH_stFId.FId_bInh_Sig552h_Com_tiCurVehTmr_Rcf DINH_stFId.FId_bInh_Sig583h_Com_stHvbDiscnctReas_Frz DINH_stFId.FId_bInh_Sig583h_Com_stHvbDiscnctReas_Rcf DINH_stFId.FId_bInh_Sig592h_Com_iBattEBS1Rx_Frz DINH_stFId.FId_bInh_Sig592h_Com_iBattEBS1Rx_Rcf DINH_stFId.FId_bInh_Sig592h_Com_iBattEBS2Rx_Frz DINH_stFId.FId_bInh_Sig592h_Com_iBattEBS2Rx_Rcf DINH_stFId.FId_bInh_Sig592h_Com_iBattEBS3Rx_Frz DINH_stFId.FId_bInh_Sig592h_Com_iBattEBS3Rx_Rcf DINH_stFId.FId_bInh_Sig592h_Com_stIBattEBS_Frz DINH_stFId.FId_bInh_Sig592h_Com_stIBattEBS_Rcf DINH_stFId.FId_bInh_Sig592h_Com_tLvBatt_Frz DINH_stFId.FId_bInh_Sig592h_Com_tLvBatt_Rcf DINH_stFId.FId_bInh_Sig592h_Com_uBattEBSRx_Frz DINH_stFId.FId_bInh_Sig592h_Com_uBattEBSRx_Rcf DINH_stFId.FId_bInh_Sig595h_Com_tiHvbChrgnHalfRx_Frz DINH_stFId.FId_bInh_Sig595h_Com_tiHvbChrgnHalfRx_Rcf DINH_stFId.FId_bInh_Sig5B2h_Com_tEnvT_Frz DINH_stFId.FId_bInh_Sig5B2h_Com_tEnvT_Rcf DINH_stFId.FId_bInh_Sig5B5h_Com_stAlrtThermRunAwy_Frz DINH_stFId.FId_bInh_Sig5B5h_Com_stAlrtThermRunAwy_Rcf DINH_stFId.FId_bInh_Sig635h_Com_ctHvbNegCntctrSeg1_Frz DINH_stFId.FId_bInh_Sig635h_Com_ctHvbNegCntctrSeg1_Rcf DINH_stFId.FId_bInh_Sig635h_Com_ctHvbNegCntctrSeg3_Frz DINH_stFId.FId_bInh_Sig635h_Com_ctHvbNegCntctrSeg3_Rcf DINH_stFId.FId_bInh_Sig635h_Com_ctHvbNegCntctrSeg4_Frz DINH_stFId.FId_bInh_Sig635h_Com_ctHvbNegCntctrSeg4_Rcf DINH_stFId.FId_bInh_Sig635h_Com_ctHvbPosCntctrSeg1_Frz DINH_stFId.FId_bInh_Sig635h_Com_ctHvbPosCntctrSeg1_Rcf DINH_stFId.FId_bInh_Sig635h_Com_ctHvbPosCntctrSeg3_Frz DINH_stFId.FId_bInh_Sig635h_Com_ctHvbPosCntctrSeg3_Rcf DINH_stFId.FId_bInh_Sig635h_Com_ctHvbPosCntctrSeg4_Frz DINH_stFId.FId_bInh_Sig635h_Com_ctHvbPosCntctrSeg4_Rcf DINH_stFId.FId_bInh_Sig645h_Com_ctHvbPrecCntctrSeg1_Frz DINH_stFId.FId_bInh_Sig645h_Com_ctHvbPrecCntctrSeg1_Rcf DINH_stFId.FId_bInh_Sig645h_Com_ctHvbPrecCntctrSeg2_Frz DINH_stFId.FId_bInh_Sig645h_Com_ctHvbPrecCntctrSeg2_Rcf DINH_stFId.FId_bInh_Sig675h_Com_qHvbTotCpRx_Frz DINH_stFId.FId_bInh_Sig675h_Com_qHvbTotCpRx_Rcf DINH_stFId.FId_bInh_ThermHvac_stRemPrecndn DINH_stFId.FId_bInh_VehCoorn_dstRngPrdcDispTx DINH_stFId.FId_bInh_VehCoorn_wCnsTotWghtAvrgEffTripA DINH_stFId.FId_bInh_VehCoorn_wCnsTotWghtAvrgEffTripB DINH_stFId.FId_bInh_VehCoorn_wCnsTotWghtAvrgEffTx DINH_stFId.FId_bInh_VehCoorn_wCnsTotWghtTripAvrgEffTx DINH_stFId.FId_bInh_VehCoorn_wCnsWghtAvrgEffTripA DINH_stFId.FId_bInh_VehCoorn_wCnsWghtAvrgEffTripB /end OUT_MEASUREMENT
 /begin LOC_MEASUREMENT Com_ctClcProc201 Com_ctClcProc205 Com_ctClcProc208 Com_ctClcProc211 Com_ctClcProc217 Com_ctClcProc219 Com_ctClcProc221 Com_ctClcProc237 Com_ctClcProc241 Com_ctClcProc259 Com_ctClcProc273 Com_ctClcProc275 Com_ctClcProc281 Com_ctClcProc285 Com_ctClcProc293 Com_ctClcProc308 Com_ctClcProc318 Com_ctClcProc325 Com_ctClcProc335 Com_ctClcProc38D Com_ctClcProc412 Com_ctClcProc432 Com_ctClcProc4F2 Com_ctClcProc592 Com_ctClcProc595 Com_ctClcProc5B5 Com_noCks201 Com_noCks205 Com_noCks208 Com_noCks211 Com_noCks217 Com_noCks219 Com_noCks221 Com_noCks237 Com_noCks241 Com_noCks259 Com_noCks273 Com_noCks275 Com_noCks281 Com_noCks285 Com_noCks293 Com_noCks308 Com_noCks318 Com_noCks325 Com_noCks335 Com_noCks38D Com_noCks412 Com_noCks432 Com_noCks4F2 Com_noCks592 Com_noCks595 Com_noCks5B5 /end LOC_MEASUREMENT
 FUNCTION_VERSION "850.8.0" /end FUNCTION
/begin COMPU_METHOD B_TRUE "" TAB_VERB "%6.3" "" COMPU_TAB_REF B_TRUE /end COMPU_METHOD
/begin COMPU_VTAB B_TRUE "" TAB_VERB 2 0 "FALSE" 1 "TRUE" /end COMPU_VTAB
/begin COMPU_METHOD Curr_A_q0p03125_COMPU "" RAT_FUNC "%6.4" "A" COEFFS 0 32 0 0 0 1 /end COMPU_METHOD
/begin COMPU_METHOD DFC_OneToOne "" RAT_FUNC "%6.2" "-" COEFFS 0 1 0 0 0 1 /end COMPU_METHOD
/begin COMPU_METHOD nmot_q1 "" RAT_FUNC "%6.2" "1/min" COEFFS 0 1 0 0 0 1 /end COMPU_METHOD
/begin COMPU_METHOD OneToOne "" RAT_FUNC "%6.2" "-" COEFFS 0 1 0 0 0 1 /end COMPU_METHOD
/begin COMPU_METHOD q0p1_kW "" RAT_FUNC "%6.3" "kW" COEFFS 0 10 0 0 0 1 /end COMPU_METHOD
/begin COMPU_METHOD q16 "" RAT_FUNC "%6.1" "-" COEFFS 0 1 0 0 0 16 /end COMPU_METHOD
/begin COMPU_METHOD q16_W_h "" RAT_FUNC "%6.1" "Wh" COEFFS 0 1 0 0 0 16 /end COMPU_METHOD
/begin COMPU_METHOD q64 "" RAT_FUNC "%6.1" "-" COEFFS 0 1 0 0 0 64 /end COMPU_METHOD
/begin COMPU_METHOD q8 "" RAT_FUNC "%6.2" "-" COEFFS 0 1 0 0 0 8 /end COMPU_METHOD
/begin COMPU_METHOD RBPtCel_i_0p03125_1 "" RAT_FUNC "%6.4" "A" COEFFS 0 32 0 0 0 1 /end COMPU_METHOD
/begin COMPU_METHOD RBPtCel_Perc_1p0_1 "" RAT_FUNC "%6.2" "%" COEFFS 0 1 0 0 0 1 /end COMPU_METHOD
/begin COMPU_METHOD RBPtCel_pwr_10p0_1 "" RAT_FUNC "%6.1" "W" COEFFS 0 1 0 0 0 10 /end COMPU_METHOD
/begin COMPU_METHOD RBPtCel_pwr_1p0_1 "" RAT_FUNC "%6.2" "W" COEFFS 0 1 0 0 0 1 /end COMPU_METHOD
/begin COMPU_METHOD RBPtCel_tq_0p1_1 "" RAT_FUNC "%6.3" "Nm" COEFFS 0 10 0 0 0 1 /end COMPU_METHOD
/begin COMPU_METHOD RBPtCel_t_0p1_3 "" RAT_FUNC "%6.3" "Deg C" COEFFS 0 10 0 0 0 1 /end COMPU_METHOD
/begin COMPU_METHOD RBPtCel_u_0p1_1 "" RAT_FUNC "%6.3" "V" COEFFS 0 10 0 0 0 1 /end COMPU_METHOD
/begin COMPU_METHOD Temp_Cels "" RAT_FUNC "%6.1" "deg C" COEFFS 0 10 2731.4 0 0 1 /end COMPU_METHOD
/begin COMPU_METHOD Trq "" RAT_FUNC "%6.3" "Nm" COEFFS 0 10 0 0 0 1 /end COMPU_METHOD
/begin COMPU_METHOD Volt_V_q0p03125_COMPU "" RAT_FUNC "%6.4" "V" COEFFS 0 32 0 0 0 1 /end COMPU_METHOD
/begin RECORD_LAYOUT RB_Val_Wboolean FNC_VALUES 1 UBYTE COLUMN_DIR DIRECT /end RECORD_LAYOUT
/begin RECORD_LAYOUT Val_Ws16 FNC_VALUES 1 SWORD COLUMN_DIR DIRECT /end RECORD_LAYOUT
/begin RECORD_LAYOUT Val_Wu16 FNC_VALUES 1 UWORD COLUMN_DIR DIRECT /end RECORD_LAYOUT
/begin RECORD_LAYOUT Val_Wu32 FNC_VALUES 1 ULONG COLUMN_DIR DIRECT /end RECORD_LAYOUT
/begin RECORD_LAYOUT Val_Wu8 FNC_VALUES 1 UBYTE COLUMN_DIR DIRECT /end RECORD_LAYOUT
/end MODULE
/end PROJECT

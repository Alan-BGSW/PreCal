ASAP2_VERSION 1 70
/begin PROJECT MDG1C "VC1CP091_STLA_N_D061I3"
/begin HEADER "" VERSION "VC1CP091_STLA_N_D061I3" PROJECT_NO MDG1C /end HEADER
/begin MODULE DIM ""
/begin MOD_COMMON "" BYTE_ORDER MSB_LAST ALIGNMENT_BYTE 1 ALIGNMENT_WORD 2 ALIGNMENT_LONG 4 ALIGNMENT_INT64 4 ALIGNMENT_FLOAT32_IEEE 4 ALIGNMENT_FLOAT64_IEEE 4 DATA_SIZE 32 /end MOD_COMMON
/begin CHARACTERISTIC DDRC_DurDeb.PwmCtP_tiSRCMinDebOk_C "" VALUE 0x80240990 Val_Wu16 655350.0 DDRCTime_ms 0.00 655350.0 FORMAT "%8.1" /end CHARACTERISTIC
/begin CHARACTERISTIC DDRC_DurDeb.PwmCtP_tiSRCMinDebDef_C "" VALUE 0x80240992 Val_Wu16 655350.0 DDRCTime_ms 0.00 655350.0 FORMAT "%8.1" /end CHARACTERISTIC
/begin CHARACTERISTIC DDRC_DurDeb.PwmCtP_tiPhysRngHiDebOk_C "" VALUE 0x80240A88 Val_Wu16 655350.0 DDRCTime_ms 0.00 655350.0 FORMAT "%8.1" /end CHARACTERISTIC
/begin CHARACTERISTIC DDRC_DurDeb.PwmCtP_tiPhysRngHiDebDef_C "" VALUE 0x80240A8A Val_Wu16 655350.0 DDRCTime_ms 0.00 655350.0 FORMAT "%8.1" /end CHARACTERISTIC
/begin CHARACTERISTIC DDRC_DurDeb.PwmCtP_tiPhysRngLoDebOk_C "" VALUE 0x80240A8C Val_Wu16 655350.0 DDRCTime_ms 0.00 655350.0 FORMAT "%8.1" /end CHARACTERISTIC
/begin CHARACTERISTIC DDRC_DurDeb.PwmCtP_tiPhysRngLoDebDef_C "" VALUE 0x80240A8E Val_Wu16 655350.0 DDRCTime_ms 0.00 655350.0 FORMAT "%8.1" /end CHARACTERISTIC
/begin CHARACTERISTIC DDRC_DurDeb.PwmCtP_tiSRCMaxDebOk_C "" VALUE 0x80240A90 Val_Wu16 655350.0 DDRCTime_ms 0.00 655350.0 FORMAT "%8.1" /end CHARACTERISTIC
/begin CHARACTERISTIC DDRC_DurDeb.PwmCtP_tiSRCMaxDebDef_C "" VALUE 0x80240A92 Val_Wu16 655350.0 DDRCTime_ms 0.00 655350.0 FORMAT "%8.1" /end CHARACTERISTIC
/begin CHARACTERISTIC DDRC_DurDeb.PLnCChp_tiPLnCDeactvnFaildDebOk_C "" VALUE 0x80240DA0 Val_Wu16 655350.0 DDRCTime_ms 0.00 655350.0 FORMAT "%8.1" /end CHARACTERISTIC
/begin CHARACTERISTIC DDRC_DurDeb.PLnCChp_tiPLnCDeactvnFaildDebDef_C "" VALUE 0x80240DA2 Val_Wu16 655350.0 DDRCTime_ms 0.00 655350.0 FORMAT "%8.1" /end CHARACTERISTIC
/begin CHARACTERISTIC DDRC_RatDeb.PwmCtP_tiSRCMinUDRat_C "" VALUE 0x80248A68 Val_Wu8 3.00000000000 DDRC_Ratio 1.00000000000 4.00000000000 FORMAT "%13.11" /end CHARACTERISTIC
/begin CHARACTERISTIC DDRC_RatDeb.PwmCtP_tiPhysRngHiUDRat_C "" VALUE 0x80248AA6 Val_Wu8 3.00000000000 DDRC_Ratio 1.00000000000 4.00000000000 FORMAT "%13.11" /end CHARACTERISTIC
/begin CHARACTERISTIC DDRC_RatDeb.PwmCtP_tiPhysRngLoUDRat_C "" VALUE 0x80248AA7 Val_Wu8 3.00000000000 DDRC_Ratio 1.00000000000 4.00000000000 FORMAT "%13.11" /end CHARACTERISTIC
/begin CHARACTERISTIC DDRC_RatDeb.PwmCtP_tiSRCMaxUDRat_C "" VALUE 0x80248AA8 Val_Wu8 3.00000000000 DDRC_Ratio 1.00000000000 4.00000000000 FORMAT "%13.11" /end CHARACTERISTIC
/begin CHARACTERISTIC DFC_CtlMsk2.DFC_PLnCChpDeactvnFaild_C "" VALUE 0x80241395 Val_Wu8 255.0 DFES_OneToOne 0.00 255.0 FORMAT "%5.1" /end CHARACTERISTIC
/begin CHARACTERISTIC DFC_CtlMsk2.DFC_PwmCtPSRCMin_C "" VALUE 0x80241521 Val_Wu8 255.0 DFES_OneToOne 0.00 255.0 FORMAT "%5.1" /end CHARACTERISTIC
/begin CHARACTERISTIC DFC_CtlMsk2.DFC_PwmCtPPhysRngHi_C "" VALUE 0x8024155F Val_Wu8 255.0 DFES_OneToOne 0.00 255.0 FORMAT "%5.1" /end CHARACTERISTIC
/begin CHARACTERISTIC DFC_CtlMsk2.DFC_PwmCtPPhysRngLo_C "" VALUE 0x80241560 Val_Wu8 255.0 DFES_OneToOne 0.00 255.0 FORMAT "%5.1" /end CHARACTERISTIC
/begin CHARACTERISTIC DFC_CtlMsk2.DFC_PwmCtPSRCMax_C "" VALUE 0x80241561 Val_Wu8 255.0 DFES_OneToOne 0.00 255.0 FORMAT "%5.1" /end CHARACTERISTIC
/begin CHARACTERISTIC DFC_CtlMsk2.DFC_MOXEMM_SMU_ALM0_0_C "" VALUE 0x80241602 Val_Wu8 255.0 DFES_OneToOne 0.00 255.0 FORMAT "%5.1" /end CHARACTERISTIC
/begin CHARACTERISTIC DFC_CtlMsk2.DFC_MOXEMM_SMU_ALM0_1_C "" VALUE 0x80241603 Val_Wu8 255.0 DFES_OneToOne 0.00 255.0 FORMAT "%5.1" /end CHARACTERISTIC
/begin CHARACTERISTIC DFC_CtlMsk2.DFC_MOXEMM_SMU_ALM0_10_C "" VALUE 0x80241604 Val_Wu8 255.0 DFES_OneToOne 0.00 255.0 FORMAT "%5.1" /end CHARACTERISTIC
/begin CHARACTERISTIC DFC_CtlMsk2.DFC_MOXEMM_SMU_ALM0_11_C "" VALUE 0x80241605 Val_Wu8 255.0 DFES_OneToOne 0.00 255.0 FORMAT "%5.1" /end CHARACTERISTIC
/begin CHARACTERISTIC DFC_CtlMsk2.DFC_MOXEMM_SMU_ALM0_13_C "" VALUE 0x80241606 Val_Wu8 255.0 DFES_OneToOne 0.00 255.0 FORMAT "%5.1" /end CHARACTERISTIC
/begin CHARACTERISTIC DFC_CtlMsk2.DFC_MOXEMM_SMU_ALM0_14_C "" VALUE 0x80241607 Val_Wu8 255.0 DFES_OneToOne 0.00 255.0 FORMAT "%5.1" /end CHARACTERISTIC
/begin CHARACTERISTIC DFC_CtlMsk2.DFC_MOXEMM_SMU_ALM0_2_C "" VALUE 0x80241608 Val_Wu8 255.0 DFES_OneToOne 0.00 255.0 FORMAT "%5.1" /end CHARACTERISTIC
/begin CHARACTERISTIC DFC_CtlMsk2.DFC_MOXEMM_SMU_ALM0_22_C "" VALUE 0x80241609 Val_Wu8 255.0 DFES_OneToOne 0.00 255.0 FORMAT "%5.1" /end CHARACTERISTIC
/begin CHARACTERISTIC DFC_CtlMsk2.DFC_MOXEMM_SMU_ALM0_23_C "" VALUE 0x8024160A Val_Wu8 255.0 DFES_OneToOne 0.00 255.0 FORMAT "%5.1" /end CHARACTERISTIC
/begin CHARACTERISTIC DFC_CtlMsk2.DFC_MOXEMM_SMU_ALM0_4_C "" VALUE 0x8024160B Val_Wu8 255.0 DFES_OneToOne 0.00 255.0 FORMAT "%5.1" /end CHARACTERISTIC
/begin CHARACTERISTIC DFC_CtlMsk2.DFC_MOXEMM_SMU_ALM0_5_C "" VALUE 0x8024160C Val_Wu8 255.0 DFES_OneToOne 0.00 255.0 FORMAT "%5.1" /end CHARACTERISTIC
/begin CHARACTERISTIC DFC_CtlMsk2.DFC_MOXEMM_SMU_ALM0_7_C "" VALUE 0x8024160D Val_Wu8 255.0 DFES_OneToOne 0.00 255.0 FORMAT "%5.1" /end CHARACTERISTIC
/begin CHARACTERISTIC DFC_CtlMsk2.DFC_MOXEMM_SMU_ALM0_8_C "" VALUE 0x8024160E Val_Wu8 255.0 DFES_OneToOne 0.00 255.0 FORMAT "%5.1" /end CHARACTERISTIC
/begin CHARACTERISTIC DFC_CtlMsk2.DFC_MOXEMM_SMU_ALM10_16_C "" VALUE 0x8024160F Val_Wu8 255.0 DFES_OneToOne 0.00 255.0 FORMAT "%5.1" /end CHARACTERISTIC
/begin CHARACTERISTIC DFC_CtlMsk2.DFC_MOXEMM_SMU_ALM10_17_C "" VALUE 0x80241610 Val_Wu8 255.0 DFES_OneToOne 0.00 255.0 FORMAT "%5.1" /end CHARACTERISTIC
/begin CHARACTERISTIC DFC_CtlMsk2.DFC_MOXEMM_SMU_ALM10_21_C "" VALUE 0x80241611 Val_Wu8 255.0 DFES_OneToOne 0.00 255.0 FORMAT "%5.1" /end CHARACTERISTIC
/begin CHARACTERISTIC DFC_CtlMsk2.DFC_MOXEMM_SMU_ALM11_0_C "" VALUE 0x80241612 Val_Wu8 255.0 DFES_OneToOne 0.00 255.0 FORMAT "%5.1" /end CHARACTERISTIC
/begin CHARACTERISTIC DFC_CtlMsk2.DFC_MOXEMM_SMU_ALM11_1_C "" VALUE 0x80241613 Val_Wu8 255.0 DFES_OneToOne 0.00 255.0 FORMAT "%5.1" /end CHARACTERISTIC
/begin CHARACTERISTIC DFC_CtlMsk2.DFC_MOXEMM_SMU_ALM11_2_C "" VALUE 0x80241614 Val_Wu8 255.0 DFES_OneToOne 0.00 255.0 FORMAT "%5.1" /end CHARACTERISTIC
/begin CHARACTERISTIC DFC_CtlMsk2.DFC_MOXEMM_SMU_ALM11_3_C "" VALUE 0x80241615 Val_Wu8 255.0 DFES_OneToOne 0.00 255.0 FORMAT "%5.1" /end CHARACTERISTIC
/begin CHARACTERISTIC DFC_CtlMsk2.DFC_MOXEMM_SMU_ALM11_4_C "" VALUE 0x80241616 Val_Wu8 255.0 DFES_OneToOne 0.00 255.0 FORMAT "%5.1" /end CHARACTERISTIC
/begin CHARACTERISTIC DFC_CtlMsk2.DFC_MOXEMM_SMU_ALM11_5_C "" VALUE 0x80241617 Val_Wu8 255.0 DFES_OneToOne 0.00 255.0 FORMAT "%5.1" /end CHARACTERISTIC
/begin CHARACTERISTIC DFC_CtlMsk2.DFC_MOXEMM_SMU_ALM11_8_C "" VALUE 0x80241618 Val_Wu8 255.0 DFES_OneToOne 0.00 255.0 FORMAT "%5.1" /end CHARACTERISTIC
/begin CHARACTERISTIC DFC_CtlMsk2.DFC_MOXEMM_SMU_ALM11_9_C "" VALUE 0x80241619 Val_Wu8 255.0 DFES_OneToOne 0.00 255.0 FORMAT "%5.1" /end CHARACTERISTIC
/begin CHARACTERISTIC DFC_CtlMsk2.DFC_MOXEMM_SMU_ALM1_0_C "" VALUE 0x8024161A Val_Wu8 255.0 DFES_OneToOne 0.00 255.0 FORMAT "%5.1" /end CHARACTERISTIC
/begin CHARACTERISTIC DFC_CtlMsk2.DFC_MOXEMM_SMU_ALM1_1_C "" VALUE 0x8024161B Val_Wu8 255.0 DFES_OneToOne 0.00 255.0 FORMAT "%5.1" /end CHARACTERISTIC
/begin CHARACTERISTIC DFC_CtlMsk2.DFC_MOXEMM_SMU_ALM1_10_C "" VALUE 0x8024161C Val_Wu8 255.0 DFES_OneToOne 0.00 255.0 FORMAT "%5.1" /end CHARACTERISTIC
/begin CHARACTERISTIC DFC_CtlMsk2.DFC_MOXEMM_SMU_ALM1_11_C "" VALUE 0x8024161D Val_Wu8 255.0 DFES_OneToOne 0.00 255.0 FORMAT "%5.1" /end CHARACTERISTIC
/begin CHARACTERISTIC DFC_CtlMsk2.DFC_MOXEMM_SMU_ALM1_13_C "" VALUE 0x8024161E Val_Wu8 255.0 DFES_OneToOne 0.00 255.0 FORMAT "%5.1" /end CHARACTERISTIC
/begin CHARACTERISTIC DFC_CtlMsk2.DFC_MOXEMM_SMU_ALM1_14_C "" VALUE 0x8024161F Val_Wu8 255.0 DFES_OneToOne 0.00 255.0 FORMAT "%5.1" /end CHARACTERISTIC
/begin CHARACTERISTIC DFC_CtlMsk2.DFC_MOXEMM_SMU_ALM1_2_C "" VALUE 0x80241620 Val_Wu8 255.0 DFES_OneToOne 0.00 255.0 FORMAT "%5.1" /end CHARACTERISTIC
/begin CHARACTERISTIC DFC_CtlMsk2.DFC_MOXEMM_SMU_ALM1_22_C "" VALUE 0x80241621 Val_Wu8 255.0 DFES_OneToOne 0.00 255.0 FORMAT "%5.1" /end CHARACTERISTIC
/begin CHARACTERISTIC DFC_CtlMsk2.DFC_MOXEMM_SMU_ALM1_23_C "" VALUE 0x80241622 Val_Wu8 255.0 DFES_OneToOne 0.00 255.0 FORMAT "%5.1" /end CHARACTERISTIC
/begin CHARACTERISTIC DFC_CtlMsk2.DFC_MOXEMM_SMU_ALM1_4_C "" VALUE 0x80241623 Val_Wu8 255.0 DFES_OneToOne 0.00 255.0 FORMAT "%5.1" /end CHARACTERISTIC
/begin CHARACTERISTIC DFC_CtlMsk2.DFC_MOXEMM_SMU_ALM1_5_C "" VALUE 0x80241624 Val_Wu8 255.0 DFES_OneToOne 0.00 255.0 FORMAT "%5.1" /end CHARACTERISTIC
/begin CHARACTERISTIC DFC_CtlMsk2.DFC_MOXEMM_SMU_ALM1_7_C "" VALUE 0x80241625 Val_Wu8 255.0 DFES_OneToOne 0.00 255.0 FORMAT "%5.1" /end CHARACTERISTIC
/begin CHARACTERISTIC DFC_CtlMsk2.DFC_MOXEMM_SMU_ALM1_8_C "" VALUE 0x80241626 Val_Wu8 255.0 DFES_OneToOne 0.00 255.0 FORMAT "%5.1" /end CHARACTERISTIC
/begin CHARACTERISTIC DFC_CtlMsk2.DFC_MOXEMM_SMU_ALM21_0_C "" VALUE 0x80241627 Val_Wu8 255.0 DFES_OneToOne 0.00 255.0 FORMAT "%5.1" /end CHARACTERISTIC
/begin CHARACTERISTIC DFC_CtlMsk2.DFC_MOXEMM_SMU_ALM21_16_C "" VALUE 0x80241628 Val_Wu8 255.0 DFES_OneToOne 0.00 255.0 FORMAT "%5.1" /end CHARACTERISTIC
/begin CHARACTERISTIC DFC_CtlMsk2.DFC_MOXEMM_SMU_ALM21_3_C "" VALUE 0x80241629 Val_Wu8 255.0 DFES_OneToOne 0.00 255.0 FORMAT "%5.1" /end CHARACTERISTIC
/begin CHARACTERISTIC DFC_CtlMsk2.DFC_MOXEMM_SMU_ALM2_1_C "" VALUE 0x8024162A Val_Wu8 255.0 DFES_OneToOne 0.00 255.0 FORMAT "%5.1" /end CHARACTERISTIC
/begin CHARACTERISTIC DFC_CtlMsk2.DFC_MOXEMM_SMU_ALM2_10_C "" VALUE 0x8024162B Val_Wu8 255.0 DFES_OneToOne 0.00 255.0 FORMAT "%5.1" /end CHARACTERISTIC
/begin CHARACTERISTIC DFC_CtlMsk2.DFC_MOXEMM_SMU_ALM2_11_C "" VALUE 0x8024162C Val_Wu8 255.0 DFES_OneToOne 0.00 255.0 FORMAT "%5.1" /end CHARACTERISTIC
/begin CHARACTERISTIC DFC_CtlMsk2.DFC_MOXEMM_SMU_ALM2_13_C "" VALUE 0x8024162D Val_Wu8 255.0 DFES_OneToOne 0.00 255.0 FORMAT "%5.1" /end CHARACTERISTIC
/begin CHARACTERISTIC DFC_CtlMsk2.DFC_MOXEMM_SMU_ALM2_14_C "" VALUE 0x8024162E Val_Wu8 255.0 DFES_OneToOne 0.00 255.0 FORMAT "%5.1" /end CHARACTERISTIC
/begin CHARACTERISTIC DFC_CtlMsk2.DFC_MOXEMM_SMU_ALM2_22_C "" VALUE 0x8024162F Val_Wu8 255.0 DFES_OneToOne 0.00 255.0 FORMAT "%5.1" /end CHARACTERISTIC
/begin CHARACTERISTIC DFC_CtlMsk2.DFC_MOXEMM_SMU_ALM2_23_C "" VALUE 0x80241630 Val_Wu8 255.0 DFES_OneToOne 0.00 255.0 FORMAT "%5.1" /end CHARACTERISTIC
/begin CHARACTERISTIC DFC_CtlMsk2.DFC_MOXEMM_SMU_ALM2_4_C "" VALUE 0x80241631 Val_Wu8 255.0 DFES_OneToOne 0.00 255.0 FORMAT "%5.1" /end CHARACTERISTIC
/begin CHARACTERISTIC DFC_CtlMsk2.DFC_MOXEMM_SMU_ALM2_5_C "" VALUE 0x80241632 Val_Wu8 255.0 DFES_OneToOne 0.00 255.0 FORMAT "%5.1" /end CHARACTERISTIC
/begin CHARACTERISTIC DFC_CtlMsk2.DFC_MOXEMM_SMU_ALM2_7_C "" VALUE 0x80241633 Val_Wu8 255.0 DFES_OneToOne 0.00 255.0 FORMAT "%5.1" /end CHARACTERISTIC
/begin CHARACTERISTIC DFC_CtlMsk2.DFC_MOXEMM_SMU_ALM2_8_C "" VALUE 0x80241634 Val_Wu8 255.0 DFES_OneToOne 0.00 255.0 FORMAT "%5.1" /end CHARACTERISTIC
/begin CHARACTERISTIC DFC_CtlMsk2.DFC_MOXEMM_SMU_ALM6_0_C "" VALUE 0x80241635 Val_Wu8 255.0 DFES_OneToOne 0.00 255.0 FORMAT "%5.1" /end CHARACTERISTIC
/begin CHARACTERISTIC DFC_CtlMsk2.DFC_MOXEMM_SMU_ALM6_11_C "" VALUE 0x80241636 Val_Wu8 255.0 DFES_OneToOne 0.00 255.0 FORMAT "%5.1" /end CHARACTERISTIC
/begin CHARACTERISTIC DFC_CtlMsk2.DFC_MOXEMM_SMU_ALM6_12_C "" VALUE 0x80241637 Val_Wu8 255.0 DFES_OneToOne 0.00 255.0 FORMAT "%5.1" /end CHARACTERISTIC
/begin CHARACTERISTIC DFC_CtlMsk2.DFC_MOXEMM_SMU_ALM6_14_C "" VALUE 0x80241638 Val_Wu8 255.0 DFES_OneToOne 0.00 255.0 FORMAT "%5.1" /end CHARACTERISTIC
/begin CHARACTERISTIC DFC_CtlMsk2.DFC_MOXEMM_SMU_ALM6_15_C "" VALUE 0x80241639 Val_Wu8 255.0 DFES_OneToOne 0.00 255.0 FORMAT "%5.1" /end CHARACTERISTIC
/begin CHARACTERISTIC DFC_CtlMsk2.DFC_MOXEMM_SMU_ALM6_17_C "" VALUE 0x8024163A Val_Wu8 255.0 DFES_OneToOne 0.00 255.0 FORMAT "%5.1" /end CHARACTERISTIC
/begin CHARACTERISTIC DFC_CtlMsk2.DFC_MOXEMM_SMU_ALM6_18_C "" VALUE 0x8024163B Val_Wu8 255.0 DFES_OneToOne 0.00 255.0 FORMAT "%5.1" /end CHARACTERISTIC
/begin CHARACTERISTIC DFC_CtlMsk2.DFC_MOXEMM_SMU_ALM6_20_C "" VALUE 0x8024163C Val_Wu8 255.0 DFES_OneToOne 0.00 255.0 FORMAT "%5.1" /end CHARACTERISTIC
/begin CHARACTERISTIC DFC_CtlMsk2.DFC_MOXEMM_SMU_ALM6_21_C "" VALUE 0x8024163D Val_Wu8 255.0 DFES_OneToOne 0.00 255.0 FORMAT "%5.1" /end CHARACTERISTIC
/begin CHARACTERISTIC DFC_CtlMsk2.DFC_MOXEMM_SMU_ALM6_25_C "" VALUE 0x8024163E Val_Wu8 255.0 DFES_OneToOne 0.00 255.0 FORMAT "%5.1" /end CHARACTERISTIC
/begin CHARACTERISTIC DFC_CtlMsk2.DFC_MOXEMM_SMU_ALM6_4_C "" VALUE 0x8024163F Val_Wu8 255.0 DFES_OneToOne 0.00 255.0 FORMAT "%5.1" /end CHARACTERISTIC
/begin CHARACTERISTIC DFC_CtlMsk2.DFC_MOXEMM_SMU_ALM6_5_C "" VALUE 0x80241640 Val_Wu8 255.0 DFES_OneToOne 0.00 255.0 FORMAT "%5.1" /end CHARACTERISTIC
/begin CHARACTERISTIC DFC_CtlMsk2.DFC_MOXEMM_SMU_ALM6_7_C "" VALUE 0x80241641 Val_Wu8 255.0 DFES_OneToOne 0.00 255.0 FORMAT "%5.1" /end CHARACTERISTIC
/begin CHARACTERISTIC DFC_CtlMsk2.DFC_MOXEMM_SMU_ALM6_8_C "" VALUE 0x80241642 Val_Wu8 255.0 DFES_OneToOne 0.00 255.0 FORMAT "%5.1" /end CHARACTERISTIC
/begin CHARACTERISTIC DFC_CtlMsk2.DFC_MOXEMM_SMU_ALM7_1_C "" VALUE 0x80241643 Val_Wu8 255.0 DFES_OneToOne 0.00 255.0 FORMAT "%5.1" /end CHARACTERISTIC
/begin CHARACTERISTIC DFC_CtlMsk2.DFC_MOXEMM_SMU_ALM7_12_C "" VALUE 0x80241644 Val_Wu8 255.0 DFES_OneToOne 0.00 255.0 FORMAT "%5.1" /end CHARACTERISTIC
/begin CHARACTERISTIC DFC_CtlMsk2.DFC_MOXEMM_SMU_ALM7_13_C "" VALUE 0x80241645 Val_Wu8 255.0 DFES_OneToOne 0.00 255.0 FORMAT "%5.1" /end CHARACTERISTIC
/begin CHARACTERISTIC DFC_CtlMsk2.DFC_MOXEMM_SMU_ALM7_14_C "" VALUE 0x80241646 Val_Wu8 255.0 DFES_OneToOne 0.00 255.0 FORMAT "%5.1" /end CHARACTERISTIC
/begin CHARACTERISTIC DFC_CtlMsk2.DFC_MOXEMM_SMU_ALM7_15_C "" VALUE 0x80241647 Val_Wu8 255.0 DFES_OneToOne 0.00 255.0 FORMAT "%5.1" /end CHARACTERISTIC
/begin CHARACTERISTIC DFC_CtlMsk2.DFC_MOXEMM_SMU_ALM7_16_C "" VALUE 0x80241648 Val_Wu8 255.0 DFES_OneToOne 0.00 255.0 FORMAT "%5.1" /end CHARACTERISTIC
/begin CHARACTERISTIC DFC_CtlMsk2.DFC_MOXEMM_SMU_ALM7_17_C "" VALUE 0x80241649 Val_Wu8 255.0 DFES_OneToOne 0.00 255.0 FORMAT "%5.1" /end CHARACTERISTIC
/begin CHARACTERISTIC DFC_CtlMsk2.DFC_MOXEMM_SMU_ALM7_2_C "" VALUE 0x8024164A Val_Wu8 255.0 DFES_OneToOne 0.00 255.0 FORMAT "%5.1" /end CHARACTERISTIC
/begin CHARACTERISTIC DFC_CtlMsk2.DFC_MOXEMM_SMU_ALM7_20_C "" VALUE 0x8024164B Val_Wu8 255.0 DFES_OneToOne 0.00 255.0 FORMAT "%5.1" /end CHARACTERISTIC
/begin CHARACTERISTIC DFC_CtlMsk2.DFC_MOXEMM_SMU_ALM7_25_C "" VALUE 0x8024164C Val_Wu8 255.0 DFES_OneToOne 0.00 255.0 FORMAT "%5.1" /end CHARACTERISTIC
/begin CHARACTERISTIC DFC_CtlMsk2.DFC_MOXEMM_SMU_ALM7_26_C "" VALUE 0x8024164D Val_Wu8 255.0 DFES_OneToOne 0.00 255.0 FORMAT "%5.1" /end CHARACTERISTIC
/begin CHARACTERISTIC DFC_CtlMsk2.DFC_MOXEMM_SMU_ALM7_28_C "" VALUE 0x8024164E Val_Wu8 255.0 DFES_OneToOne 0.00 255.0 FORMAT "%5.1" /end CHARACTERISTIC
/begin CHARACTERISTIC DFC_CtlMsk2.DFC_MOXEMM_SMU_ALM7_29_C "" VALUE 0x8024164F Val_Wu8 255.0 DFES_OneToOne 0.00 255.0 FORMAT "%5.1" /end CHARACTERISTIC
/begin CHARACTERISTIC DFC_CtlMsk2.DFC_MOXEMM_SMU_ALM7_30_C "" VALUE 0x80241650 Val_Wu8 255.0 DFES_OneToOne 0.00 255.0 FORMAT "%5.1" /end CHARACTERISTIC
/begin CHARACTERISTIC DFC_CtlMsk2.DFC_MOXEMM_SMU_ALM7_31_C "" VALUE 0x80241651 Val_Wu8 255.0 DFES_OneToOne 0.00 255.0 FORMAT "%5.1" /end CHARACTERISTIC
/begin CHARACTERISTIC DFC_CtlMsk2.DFC_MOXEMM_SMU_ALM8_0_C "" VALUE 0x80241652 Val_Wu8 255.0 DFES_OneToOne 0.00 255.0 FORMAT "%5.1" /end CHARACTERISTIC
/begin CHARACTERISTIC DFC_CtlMsk2.DFC_MOXEMM_SMU_ALM8_1_C "" VALUE 0x80241653 Val_Wu8 255.0 DFES_OneToOne 0.00 255.0 FORMAT "%5.1" /end CHARACTERISTIC
/begin CHARACTERISTIC DFC_CtlMsk2.DFC_MOXEMM_SMU_ALM8_10_C "" VALUE 0x80241654 Val_Wu8 255.0 DFES_OneToOne 0.00 255.0 FORMAT "%5.1" /end CHARACTERISTIC
/begin CHARACTERISTIC DFC_CtlMsk2.DFC_MOXEMM_SMU_ALM8_11_C "" VALUE 0x80241655 Val_Wu8 255.0 DFES_OneToOne 0.00 255.0 FORMAT "%5.1" /end CHARACTERISTIC
/begin CHARACTERISTIC DFC_CtlMsk2.DFC_MOXEMM_SMU_ALM8_12_C "" VALUE 0x80241656 Val_Wu8 255.0 DFES_OneToOne 0.00 255.0 FORMAT "%5.1" /end CHARACTERISTIC
/begin CHARACTERISTIC DFC_CtlMsk2.DFC_MOXEMM_SMU_ALM8_16_C "" VALUE 0x80241657 Val_Wu8 255.0 DFES_OneToOne 0.00 255.0 FORMAT "%5.1" /end CHARACTERISTIC
/begin CHARACTERISTIC DFC_CtlMsk2.DFC_MOXEMM_SMU_ALM8_18_C "" VALUE 0x80241658 Val_Wu8 255.0 DFES_OneToOne 0.00 255.0 FORMAT "%5.1" /end CHARACTERISTIC
/begin CHARACTERISTIC DFC_CtlMsk2.DFC_MOXEMM_SMU_ALM8_2_C "" VALUE 0x80241659 Val_Wu8 255.0 DFES_OneToOne 0.00 255.0 FORMAT "%5.1" /end CHARACTERISTIC
/begin CHARACTERISTIC DFC_CtlMsk2.DFC_MOXEMM_SMU_ALM8_3_C "" VALUE 0x8024165A Val_Wu8 255.0 DFES_OneToOne 0.00 255.0 FORMAT "%5.1" /end CHARACTERISTIC
/begin CHARACTERISTIC DFC_CtlMsk2.DFC_MOXEMM_SMU_ALM8_31_C "" VALUE 0x8024165B Val_Wu8 255.0 DFES_OneToOne 0.00 255.0 FORMAT "%5.1" /end CHARACTERISTIC
/begin CHARACTERISTIC DFC_CtlMsk2.DFC_MOXEMM_SMU_ALM8_4_C "" VALUE 0x8024165C Val_Wu8 255.0 DFES_OneToOne 0.00 255.0 FORMAT "%5.1" /end CHARACTERISTIC
/begin CHARACTERISTIC DFC_CtlMsk2.DFC_MOXEMM_SMU_ALM9_0_C "" VALUE 0x8024165D Val_Wu8 255.0 DFES_OneToOne 0.00 255.0 FORMAT "%5.1" /end CHARACTERISTIC
/begin CHARACTERISTIC DFC_CtlMsk2.DFC_MOXEMM_SMU_ALM9_15_C "" VALUE 0x8024165E Val_Wu8 255.0 DFES_OneToOne 0.00 255.0 FORMAT "%5.1" /end CHARACTERISTIC
/begin CHARACTERISTIC DFC_CtlMsk2.DFC_MOXEMM_SMU_ALM9_3_C "" VALUE 0x8024165F Val_Wu8 255.0 DFES_OneToOne 0.00 255.0 FORMAT "%5.1" /end CHARACTERISTIC
/begin CHARACTERISTIC DFC_CtlMsk2.DFC_MoSysCtrlReIni_C "" VALUE 0x8024167A Val_Wu8 255.0 DFES_OneToOne 0.00 255.0 FORMAT "%5.1" /end CHARACTERISTIC
/begin CHARACTERISTIC DFC_CtlMsk2.DFC_MoXEMMHwLTMCUFW_C "" VALUE 0x8024167B Val_Wu8 255.0 DFES_OneToOne 0.00 255.0 FORMAT "%5.1" /end CHARACTERISTIC
/begin CHARACTERISTIC DFC_CtlMsk2.DFC_MoXEMMHwLTMonBIST_C "" VALUE 0x8024167C Val_Wu8 255.0 DFES_OneToOne 0.00 255.0 FORMAT "%5.1" /end CHARACTERISTIC
/begin CHARACTERISTIC DFC_CtlMsk2.DFC_MoXEMMHwLTRegMonTest_C "" VALUE 0x8024167D Val_Wu8 255.0 DFES_OneToOne 0.00 255.0 FORMAT "%5.1" /end CHARACTERISTIC
/begin CHARACTERISTIC DFC_CtlMsk2.DFC_MoXEMMHwLTStbySMUAlvTest_C "" VALUE 0x8024167E Val_Wu8 255.0 DFES_OneToOne 0.00 255.0 FORMAT "%5.1" /end CHARACTERISTIC
/begin CHARACTERISTIC DFC_CtlMsk2.DFC_MoXEMMHwLTTempSens_C "" VALUE 0x8024167F Val_Wu8 255.0 DFES_OneToOne 0.00 255.0 FORMAT "%5.1" /end CHARACTERISTIC
/begin CHARACTERISTIC DFC_CtlMsk2.DFC_MoXEMMHwLTUCBCfg_C "" VALUE 0x80241680 Val_Wu8 255.0 DFES_OneToOne 0.00 255.0 FORMAT "%5.1" /end CHARACTERISTIC
/begin CHARACTERISTIC DFC_CtlMsk2.DFC_OCWDAABEActv_C "" VALUE 0x80241696 Val_Wu8 255.0 DFES_OneToOne 0.00 255.0 FORMAT "%5.1" /end CHARACTERISTIC
/begin CHARACTERISTIC DFC_CtlMsk2.DFC_OCWDACom_C "" VALUE 0x80241697 Val_Wu8 255.0 DFES_OneToOne 0.00 255.0 FORMAT "%5.1" /end CHARACTERISTIC
/begin CHARACTERISTIC DFC_CtlMsk2.DFC_OCWDAErrPin_C "" VALUE 0x80241698 Val_Wu8 255.0 DFES_OneToOne 0.00 255.0 FORMAT "%5.1" /end CHARACTERISTIC
/begin CHARACTERISTIC DFC_CtlMsk2.DFC_OCWDAOvrVltg_C "" VALUE 0x80241699 Val_Wu8 255.0 DFES_OneToOne 0.00 255.0 FORMAT "%5.1" /end CHARACTERISTIC
/begin CHARACTERISTIC DFC_CtlMsk2.DFC_PwmCtPTmpErr_C "" VALUE 0x8024169B Val_Wu8 255.0 DFES_OneToOne 0.00 255.0 FORMAT "%5.1" /end CHARACTERISTIC
/begin CHARACTERISTIC DFC_DisblMsk2.DFC_PLnCChpDeactvnFaild_C "" VALUE 0x80248C10 Val_Wu16 65535.00 DFES_OneToOne 0.00 65535.00 FORMAT "%8.2" /end CHARACTERISTIC
/begin CHARACTERISTIC DFC_DisblMsk2.DFC_PwmCtPSRCMin_C "" VALUE 0x80248F28 Val_Wu16 65535.00 DFES_OneToOne 0.00 65535.00 FORMAT "%8.2" /end CHARACTERISTIC
/begin CHARACTERISTIC DFC_DisblMsk2.DFC_PwmCtPPhysRngHi_C "" VALUE 0x80248FA4 Val_Wu16 65535.00 DFES_OneToOne 0.00 65535.00 FORMAT "%8.2" /end CHARACTERISTIC
/begin CHARACTERISTIC DFC_DisblMsk2.DFC_PwmCtPPhysRngLo_C "" VALUE 0x80248FA6 Val_Wu16 65535.00 DFES_OneToOne 0.00 65535.00 FORMAT "%8.2" /end CHARACTERISTIC
/begin CHARACTERISTIC DFC_DisblMsk2.DFC_PwmCtPSRCMax_C "" VALUE 0x80248FA8 Val_Wu16 65535.00 DFES_OneToOne 0.00 65535.00 FORMAT "%8.2" /end CHARACTERISTIC
/begin CHARACTERISTIC DFC_DisblMsk2.DFC_MOXEMM_SMU_ALM0_0_C "" VALUE 0x802490EA Val_Wu16 65535.00 DFES_OneToOne 0.00 65535.00 FORMAT "%8.2" /end CHARACTERISTIC
/begin CHARACTERISTIC DFC_DisblMsk2.DFC_MOXEMM_SMU_ALM0_1_C "" VALUE 0x802490EC Val_Wu16 65535.00 DFES_OneToOne 0.00 65535.00 FORMAT "%8.2" /end CHARACTERISTIC
/begin CHARACTERISTIC DFC_DisblMsk2.DFC_MOXEMM_SMU_ALM0_10_C "" VALUE 0x802490EE Val_Wu16 65535.00 DFES_OneToOne 0.00 65535.00 FORMAT "%8.2" /end CHARACTERISTIC
/begin CHARACTERISTIC DFC_DisblMsk2.DFC_MOXEMM_SMU_ALM0_11_C "" VALUE 0x802490F0 Val_Wu16 65535.00 DFES_OneToOne 0.00 65535.00 FORMAT "%8.2" /end CHARACTERISTIC
/begin CHARACTERISTIC DFC_DisblMsk2.DFC_MOXEMM_SMU_ALM0_13_C "" VALUE 0x802490F2 Val_Wu16 65535.00 DFES_OneToOne 0.00 65535.00 FORMAT "%8.2" /end CHARACTERISTIC
/begin CHARACTERISTIC DFC_DisblMsk2.DFC_MOXEMM_SMU_ALM0_14_C "" VALUE 0x802490F4 Val_Wu16 65535.00 DFES_OneToOne 0.00 65535.00 FORMAT "%8.2" /end CHARACTERISTIC
/begin CHARACTERISTIC DFC_DisblMsk2.DFC_MOXEMM_SMU_ALM0_2_C "" VALUE 0x802490F6 Val_Wu16 65535.00 DFES_OneToOne 0.00 65535.00 FORMAT "%8.2" /end CHARACTERISTIC
/begin CHARACTERISTIC DFC_DisblMsk2.DFC_MOXEMM_SMU_ALM0_22_C "" VALUE 0x802490F8 Val_Wu16 65535.00 DFES_OneToOne 0.00 65535.00 FORMAT "%8.2" /end CHARACTERISTIC
/begin CHARACTERISTIC DFC_DisblMsk2.DFC_MOXEMM_SMU_ALM0_23_C "" VALUE 0x802490FA Val_Wu16 65535.00 DFES_OneToOne 0.00 65535.00 FORMAT "%8.2" /end CHARACTERISTIC
/begin CHARACTERISTIC DFC_DisblMsk2.DFC_MOXEMM_SMU_ALM0_4_C "" VALUE 0x802490FC Val_Wu16 65535.00 DFES_OneToOne 0.00 65535.00 FORMAT "%8.2" /end CHARACTERISTIC
/begin CHARACTERISTIC DFC_DisblMsk2.DFC_MOXEMM_SMU_ALM0_5_C "" VALUE 0x802490FE Val_Wu16 65535.00 DFES_OneToOne 0.00 65535.00 FORMAT "%8.2" /end CHARACTERISTIC
/begin CHARACTERISTIC DFC_DisblMsk2.DFC_MOXEMM_SMU_ALM0_7_C "" VALUE 0x80249100 Val_Wu16 65535.00 DFES_OneToOne 0.00 65535.00 FORMAT "%8.2" /end CHARACTERISTIC
/begin CHARACTERISTIC DFC_DisblMsk2.DFC_MOXEMM_SMU_ALM0_8_C "" VALUE 0x80249102 Val_Wu16 65535.00 DFES_OneToOne 0.00 65535.00 FORMAT "%8.2" /end CHARACTERISTIC
/begin CHARACTERISTIC DFC_DisblMsk2.DFC_MOXEMM_SMU_ALM10_16_C "" VALUE 0x80249104 Val_Wu16 65535.00 DFES_OneToOne 0.00 65535.00 FORMAT "%8.2" /end CHARACTERISTIC
/begin CHARACTERISTIC DFC_DisblMsk2.DFC_MOXEMM_SMU_ALM10_17_C "" VALUE 0x80249106 Val_Wu16 65535.00 DFES_OneToOne 0.00 65535.00 FORMAT "%8.2" /end CHARACTERISTIC
/begin CHARACTERISTIC DFC_DisblMsk2.DFC_MOXEMM_SMU_ALM10_21_C "" VALUE 0x80249108 Val_Wu16 65535.00 DFES_OneToOne 0.00 65535.00 FORMAT "%8.2" /end CHARACTERISTIC
/begin CHARACTERISTIC DFC_DisblMsk2.DFC_MOXEMM_SMU_ALM11_0_C "" VALUE 0x8024910A Val_Wu16 65535.00 DFES_OneToOne 0.00 65535.00 FORMAT "%8.2" /end CHARACTERISTIC
/begin CHARACTERISTIC DFC_DisblMsk2.DFC_MOXEMM_SMU_ALM11_1_C "" VALUE 0x8024910C Val_Wu16 65535.00 DFES_OneToOne 0.00 65535.00 FORMAT "%8.2" /end CHARACTERISTIC
/begin CHARACTERISTIC DFC_DisblMsk2.DFC_MOXEMM_SMU_ALM11_2_C "" VALUE 0x8024910E Val_Wu16 65535.00 DFES_OneToOne 0.00 65535.00 FORMAT "%8.2" /end CHARACTERISTIC
/begin CHARACTERISTIC DFC_DisblMsk2.DFC_MOXEMM_SMU_ALM11_3_C "" VALUE 0x80249110 Val_Wu16 65535.00 DFES_OneToOne 0.00 65535.00 FORMAT "%8.2" /end CHARACTERISTIC
/begin CHARACTERISTIC DFC_DisblMsk2.DFC_MOXEMM_SMU_ALM11_4_C "" VALUE 0x80249112 Val_Wu16 65535.00 DFES_OneToOne 0.00 65535.00 FORMAT "%8.2" /end CHARACTERISTIC
/begin CHARACTERISTIC DFC_DisblMsk2.DFC_MOXEMM_SMU_ALM11_5_C "" VALUE 0x80249114 Val_Wu16 65535.00 DFES_OneToOne 0.00 65535.00 FORMAT "%8.2" /end CHARACTERISTIC
/begin CHARACTERISTIC DFC_DisblMsk2.DFC_MOXEMM_SMU_ALM11_8_C "" VALUE 0x80249116 Val_Wu16 65535.00 DFES_OneToOne 0.00 65535.00 FORMAT "%8.2" /end CHARACTERISTIC
/begin CHARACTERISTIC DFC_DisblMsk2.DFC_MOXEMM_SMU_ALM11_9_C "" VALUE 0x80249118 Val_Wu16 65535.00 DFES_OneToOne 0.00 65535.00 FORMAT "%8.2" /end CHARACTERISTIC
/begin CHARACTERISTIC DFC_DisblMsk2.DFC_MOXEMM_SMU_ALM1_0_C "" VALUE 0x8024911A Val_Wu16 65535.00 DFES_OneToOne 0.00 65535.00 FORMAT "%8.2" /end CHARACTERISTIC
/begin CHARACTERISTIC DFC_DisblMsk2.DFC_MOXEMM_SMU_ALM1_1_C "" VALUE 0x8024911C Val_Wu16 65535.00 DFES_OneToOne 0.00 65535.00 FORMAT "%8.2" /end CHARACTERISTIC
/begin CHARACTERISTIC DFC_DisblMsk2.DFC_MOXEMM_SMU_ALM1_10_C "" VALUE 0x8024911E Val_Wu16 65535.00 DFES_OneToOne 0.00 65535.00 FORMAT "%8.2" /end CHARACTERISTIC
/begin CHARACTERISTIC DFC_DisblMsk2.DFC_MOXEMM_SMU_ALM1_11_C "" VALUE 0x80249120 Val_Wu16 65535.00 DFES_OneToOne 0.00 65535.00 FORMAT "%8.2" /end CHARACTERISTIC
/begin CHARACTERISTIC DFC_DisblMsk2.DFC_MOXEMM_SMU_ALM1_13_C "" VALUE 0x80249122 Val_Wu16 65535.00 DFES_OneToOne 0.00 65535.00 FORMAT "%8.2" /end CHARACTERISTIC
/begin CHARACTERISTIC DFC_DisblMsk2.DFC_MOXEMM_SMU_ALM1_14_C "" VALUE 0x80249124 Val_Wu16 65535.00 DFES_OneToOne 0.00 65535.00 FORMAT "%8.2" /end CHARACTERISTIC
/begin CHARACTERISTIC DFC_DisblMsk2.DFC_MOXEMM_SMU_ALM1_2_C "" VALUE 0x80249126 Val_Wu16 65535.00 DFES_OneToOne 0.00 65535.00 FORMAT "%8.2" /end CHARACTERISTIC
/begin CHARACTERISTIC DFC_DisblMsk2.DFC_MOXEMM_SMU_ALM1_22_C "" VALUE 0x80249128 Val_Wu16 65535.00 DFES_OneToOne 0.00 65535.00 FORMAT "%8.2" /end CHARACTERISTIC
/begin CHARACTERISTIC DFC_DisblMsk2.DFC_MOXEMM_SMU_ALM1_23_C "" VALUE 0x8024912A Val_Wu16 65535.00 DFES_OneToOne 0.00 65535.00 FORMAT "%8.2" /end CHARACTERISTIC
/begin CHARACTERISTIC DFC_DisblMsk2.DFC_MOXEMM_SMU_ALM1_4_C "" VALUE 0x8024912C Val_Wu16 65535.00 DFES_OneToOne 0.00 65535.00 FORMAT "%8.2" /end CHARACTERISTIC
/begin CHARACTERISTIC DFC_DisblMsk2.DFC_MOXEMM_SMU_ALM1_5_C "" VALUE 0x8024912E Val_Wu16 65535.00 DFES_OneToOne 0.00 65535.00 FORMAT "%8.2" /end CHARACTERISTIC
/begin CHARACTERISTIC DFC_DisblMsk2.DFC_MOXEMM_SMU_ALM1_7_C "" VALUE 0x80249130 Val_Wu16 65535.00 DFES_OneToOne 0.00 65535.00 FORMAT "%8.2" /end CHARACTERISTIC
/begin CHARACTERISTIC DFC_DisblMsk2.DFC_MOXEMM_SMU_ALM1_8_C "" VALUE 0x80249132 Val_Wu16 65535.00 DFES_OneToOne 0.00 65535.00 FORMAT "%8.2" /end CHARACTERISTIC
/begin CHARACTERISTIC DFC_DisblMsk2.DFC_MOXEMM_SMU_ALM21_0_C "" VALUE 0x80249134 Val_Wu16 65535.00 DFES_OneToOne 0.00 65535.00 FORMAT "%8.2" /end CHARACTERISTIC
/begin CHARACTERISTIC DFC_DisblMsk2.DFC_MOXEMM_SMU_ALM21_16_C "" VALUE 0x80249136 Val_Wu16 65535.00 DFES_OneToOne 0.00 65535.00 FORMAT "%8.2" /end CHARACTERISTIC
/begin CHARACTERISTIC DFC_DisblMsk2.DFC_MOXEMM_SMU_ALM21_3_C "" VALUE 0x80249138 Val_Wu16 65535.00 DFES_OneToOne 0.00 65535.00 FORMAT "%8.2" /end CHARACTERISTIC
/begin CHARACTERISTIC DFC_DisblMsk2.DFC_MOXEMM_SMU_ALM2_1_C "" VALUE 0x8024913A Val_Wu16 65535.00 DFES_OneToOne 0.00 65535.00 FORMAT "%8.2" /end CHARACTERISTIC
/begin CHARACTERISTIC DFC_DisblMsk2.DFC_MOXEMM_SMU_ALM2_10_C "" VALUE 0x8024913C Val_Wu16 65535.00 DFES_OneToOne 0.00 65535.00 FORMAT "%8.2" /end CHARACTERISTIC
/begin CHARACTERISTIC DFC_DisblMsk2.DFC_MOXEMM_SMU_ALM2_11_C "" VALUE 0x8024913E Val_Wu16 65535.00 DFES_OneToOne 0.00 65535.00 FORMAT "%8.2" /end CHARACTERISTIC
/begin CHARACTERISTIC DFC_DisblMsk2.DFC_MOXEMM_SMU_ALM2_13_C "" VALUE 0x80249140 Val_Wu16 65535.00 DFES_OneToOne 0.00 65535.00 FORMAT "%8.2" /end CHARACTERISTIC
/begin CHARACTERISTIC DFC_DisblMsk2.DFC_MOXEMM_SMU_ALM2_14_C "" VALUE 0x80249142 Val_Wu16 65535.00 DFES_OneToOne 0.00 65535.00 FORMAT "%8.2" /end CHARACTERISTIC
/begin CHARACTERISTIC DFC_DisblMsk2.DFC_MOXEMM_SMU_ALM2_22_C "" VALUE 0x80249144 Val_Wu16 65535.00 DFES_OneToOne 0.00 65535.00 FORMAT "%8.2" /end CHARACTERISTIC
/begin CHARACTERISTIC DFC_DisblMsk2.DFC_MOXEMM_SMU_ALM2_23_C "" VALUE 0x80249146 Val_Wu16 65535.00 DFES_OneToOne 0.00 65535.00 FORMAT "%8.2" /end CHARACTERISTIC
/begin CHARACTERISTIC DFC_DisblMsk2.DFC_MOXEMM_SMU_ALM2_4_C "" VALUE 0x80249148 Val_Wu16 65535.00 DFES_OneToOne 0.00 65535.00 FORMAT "%8.2" /end CHARACTERISTIC
/begin CHARACTERISTIC DFC_DisblMsk2.DFC_MOXEMM_SMU_ALM2_5_C "" VALUE 0x8024914A Val_Wu16 65535.00 DFES_OneToOne 0.00 65535.00 FORMAT "%8.2" /end CHARACTERISTIC
/begin CHARACTERISTIC DFC_DisblMsk2.DFC_MOXEMM_SMU_ALM2_7_C "" VALUE 0x8024914C Val_Wu16 65535.00 DFES_OneToOne 0.00 65535.00 FORMAT "%8.2" /end CHARACTERISTIC
/begin CHARACTERISTIC DFC_DisblMsk2.DFC_MOXEMM_SMU_ALM2_8_C "" VALUE 0x8024914E Val_Wu16 65535.00 DFES_OneToOne 0.00 65535.00 FORMAT "%8.2" /end CHARACTERISTIC
/begin CHARACTERISTIC DFC_DisblMsk2.DFC_MOXEMM_SMU_ALM6_0_C "" VALUE 0x80249150 Val_Wu16 65535.00 DFES_OneToOne 0.00 65535.00 FORMAT "%8.2" /end CHARACTERISTIC
/begin CHARACTERISTIC DFC_DisblMsk2.DFC_MOXEMM_SMU_ALM6_11_C "" VALUE 0x80249152 Val_Wu16 65535.00 DFES_OneToOne 0.00 65535.00 FORMAT "%8.2" /end CHARACTERISTIC
/begin CHARACTERISTIC DFC_DisblMsk2.DFC_MOXEMM_SMU_ALM6_12_C "" VALUE 0x80249154 Val_Wu16 65535.00 DFES_OneToOne 0.00 65535.00 FORMAT "%8.2" /end CHARACTERISTIC
/begin CHARACTERISTIC DFC_DisblMsk2.DFC_MOXEMM_SMU_ALM6_14_C "" VALUE 0x80249156 Val_Wu16 65535.00 DFES_OneToOne 0.00 65535.00 FORMAT "%8.2" /end CHARACTERISTIC
/begin CHARACTERISTIC DFC_DisblMsk2.DFC_MOXEMM_SMU_ALM6_15_C "" VALUE 0x80249158 Val_Wu16 65535.00 DFES_OneToOne 0.00 65535.00 FORMAT "%8.2" /end CHARACTERISTIC
/begin CHARACTERISTIC DFC_DisblMsk2.DFC_MOXEMM_SMU_ALM6_17_C "" VALUE 0x8024915A Val_Wu16 65535.00 DFES_OneToOne 0.00 65535.00 FORMAT "%8.2" /end CHARACTERISTIC
/begin CHARACTERISTIC DFC_DisblMsk2.DFC_MOXEMM_SMU_ALM6_18_C "" VALUE 0x8024915C Val_Wu16 65535.00 DFES_OneToOne 0.00 65535.00 FORMAT "%8.2" /end CHARACTERISTIC
/begin CHARACTERISTIC DFC_DisblMsk2.DFC_MOXEMM_SMU_ALM6_20_C "" VALUE 0x8024915E Val_Wu16 65535.00 DFES_OneToOne 0.00 65535.00 FORMAT "%8.2" /end CHARACTERISTIC
/begin CHARACTERISTIC DFC_DisblMsk2.DFC_MOXEMM_SMU_ALM6_21_C "" VALUE 0x80249160 Val_Wu16 65535.00 DFES_OneToOne 0.00 65535.00 FORMAT "%8.2" /end CHARACTERISTIC
/begin CHARACTERISTIC DFC_DisblMsk2.DFC_MOXEMM_SMU_ALM6_25_C "" VALUE 0x80249162 Val_Wu16 65535.00 DFES_OneToOne 0.00 65535.00 FORMAT "%8.2" /end CHARACTERISTIC
/begin CHARACTERISTIC DFC_DisblMsk2.DFC_MOXEMM_SMU_ALM6_4_C "" VALUE 0x80249164 Val_Wu16 65535.00 DFES_OneToOne 0.00 65535.00 FORMAT "%8.2" /end CHARACTERISTIC
/begin CHARACTERISTIC DFC_DisblMsk2.DFC_MOXEMM_SMU_ALM6_5_C "" VALUE 0x80249166 Val_Wu16 65535.00 DFES_OneToOne 0.00 65535.00 FORMAT "%8.2" /end CHARACTERISTIC
/begin CHARACTERISTIC DFC_DisblMsk2.DFC_MOXEMM_SMU_ALM6_7_C "" VALUE 0x80249168 Val_Wu16 65535.00 DFES_OneToOne 0.00 65535.00 FORMAT "%8.2" /end CHARACTERISTIC
/begin CHARACTERISTIC DFC_DisblMsk2.DFC_MOXEMM_SMU_ALM6_8_C "" VALUE 0x8024916A Val_Wu16 65535.00 DFES_OneToOne 0.00 65535.00 FORMAT "%8.2" /end CHARACTERISTIC
/begin CHARACTERISTIC DFC_DisblMsk2.DFC_MOXEMM_SMU_ALM7_1_C "" VALUE 0x8024916C Val_Wu16 65535.00 DFES_OneToOne 0.00 65535.00 FORMAT "%8.2" /end CHARACTERISTIC
/begin CHARACTERISTIC DFC_DisblMsk2.DFC_MOXEMM_SMU_ALM7_12_C "" VALUE 0x8024916E Val_Wu16 65535.00 DFES_OneToOne 0.00 65535.00 FORMAT "%8.2" /end CHARACTERISTIC
/begin CHARACTERISTIC DFC_DisblMsk2.DFC_MOXEMM_SMU_ALM7_13_C "" VALUE 0x80249170 Val_Wu16 65535.00 DFES_OneToOne 0.00 65535.00 FORMAT "%8.2" /end CHARACTERISTIC
/begin CHARACTERISTIC DFC_DisblMsk2.DFC_MOXEMM_SMU_ALM7_14_C "" VALUE 0x80249172 Val_Wu16 65535.00 DFES_OneToOne 0.00 65535.00 FORMAT "%8.2" /end CHARACTERISTIC
/begin CHARACTERISTIC DFC_DisblMsk2.DFC_MOXEMM_SMU_ALM7_15_C "" VALUE 0x80249174 Val_Wu16 65535.00 DFES_OneToOne 0.00 65535.00 FORMAT "%8.2" /end CHARACTERISTIC
/begin CHARACTERISTIC DFC_DisblMsk2.DFC_MOXEMM_SMU_ALM7_16_C "" VALUE 0x80249176 Val_Wu16 65535.00 DFES_OneToOne 0.00 65535.00 FORMAT "%8.2" /end CHARACTERISTIC
/begin CHARACTERISTIC DFC_DisblMsk2.DFC_MOXEMM_SMU_ALM7_17_C "" VALUE 0x80249178 Val_Wu16 65535.00 DFES_OneToOne 0.00 65535.00 FORMAT "%8.2" /end CHARACTERISTIC
/begin CHARACTERISTIC DFC_DisblMsk2.DFC_MOXEMM_SMU_ALM7_2_C "" VALUE 0x8024917A Val_Wu16 65535.00 DFES_OneToOne 0.00 65535.00 FORMAT "%8.2" /end CHARACTERISTIC
/begin CHARACTERISTIC DFC_DisblMsk2.DFC_MOXEMM_SMU_ALM7_20_C "" VALUE 0x8024917C Val_Wu16 65535.00 DFES_OneToOne 0.00 65535.00 FORMAT "%8.2" /end CHARACTERISTIC
/begin CHARACTERISTIC DFC_DisblMsk2.DFC_MOXEMM_SMU_ALM7_25_C "" VALUE 0x8024917E Val_Wu16 65535.00 DFES_OneToOne 0.00 65535.00 FORMAT "%8.2" /end CHARACTERISTIC
/begin CHARACTERISTIC DFC_DisblMsk2.DFC_MOXEMM_SMU_ALM7_26_C "" VALUE 0x80249180 Val_Wu16 65535.00 DFES_OneToOne 0.00 65535.00 FORMAT "%8.2" /end CHARACTERISTIC
/begin CHARACTERISTIC DFC_DisblMsk2.DFC_MOXEMM_SMU_ALM7_28_C "" VALUE 0x80249182 Val_Wu16 65535.00 DFES_OneToOne 0.00 65535.00 FORMAT "%8.2" /end CHARACTERISTIC
/begin CHARACTERISTIC DFC_DisblMsk2.DFC_MOXEMM_SMU_ALM7_29_C "" VALUE 0x80249184 Val_Wu16 65535.00 DFES_OneToOne 0.00 65535.00 FORMAT "%8.2" /end CHARACTERISTIC
/begin CHARACTERISTIC DFC_DisblMsk2.DFC_MOXEMM_SMU_ALM7_30_C "" VALUE 0x80249186 Val_Wu16 65535.00 DFES_OneToOne 0.00 65535.00 FORMAT "%8.2" /end CHARACTERISTIC
/begin CHARACTERISTIC DFC_DisblMsk2.DFC_MOXEMM_SMU_ALM7_31_C "" VALUE 0x80249188 Val_Wu16 65535.00 DFES_OneToOne 0.00 65535.00 FORMAT "%8.2" /end CHARACTERISTIC
/begin CHARACTERISTIC DFC_DisblMsk2.DFC_MOXEMM_SMU_ALM8_0_C "" VALUE 0x8024918A Val_Wu16 65535.00 DFES_OneToOne 0.00 65535.00 FORMAT "%8.2" /end CHARACTERISTIC
/begin CHARACTERISTIC DFC_DisblMsk2.DFC_MOXEMM_SMU_ALM8_1_C "" VALUE 0x8024918C Val_Wu16 65535.00 DFES_OneToOne 0.00 65535.00 FORMAT "%8.2" /end CHARACTERISTIC
/begin CHARACTERISTIC DFC_DisblMsk2.DFC_MOXEMM_SMU_ALM8_10_C "" VALUE 0x8024918E Val_Wu16 65535.00 DFES_OneToOne 0.00 65535.00 FORMAT "%8.2" /end CHARACTERISTIC
/begin CHARACTERISTIC DFC_DisblMsk2.DFC_MOXEMM_SMU_ALM8_11_C "" VALUE 0x80249190 Val_Wu16 65535.00 DFES_OneToOne 0.00 65535.00 FORMAT "%8.2" /end CHARACTERISTIC
/begin CHARACTERISTIC DFC_DisblMsk2.DFC_MOXEMM_SMU_ALM8_12_C "" VALUE 0x80249192 Val_Wu16 65535.00 DFES_OneToOne 0.00 65535.00 FORMAT "%8.2" /end CHARACTERISTIC
/begin CHARACTERISTIC DFC_DisblMsk2.DFC_MOXEMM_SMU_ALM8_16_C "" VALUE 0x80249194 Val_Wu16 65535.00 DFES_OneToOne 0.00 65535.00 FORMAT "%8.2" /end CHARACTERISTIC
/begin CHARACTERISTIC DFC_DisblMsk2.DFC_MOXEMM_SMU_ALM8_18_C "" VALUE 0x80249196 Val_Wu16 65535.00 DFES_OneToOne 0.00 65535.00 FORMAT "%8.2" /end CHARACTERISTIC
/begin CHARACTERISTIC DFC_DisblMsk2.DFC_MOXEMM_SMU_ALM8_2_C "" VALUE 0x80249198 Val_Wu16 65535.00 DFES_OneToOne 0.00 65535.00 FORMAT "%8.2" /end CHARACTERISTIC
/begin CHARACTERISTIC DFC_DisblMsk2.DFC_MOXEMM_SMU_ALM8_3_C "" VALUE 0x8024919A Val_Wu16 65535.00 DFES_OneToOne 0.00 65535.00 FORMAT "%8.2" /end CHARACTERISTIC
/begin CHARACTERISTIC DFC_DisblMsk2.DFC_MOXEMM_SMU_ALM8_31_C "" VALUE 0x8024919C Val_Wu16 65535.00 DFES_OneToOne 0.00 65535.00 FORMAT "%8.2" /end CHARACTERISTIC
/begin CHARACTERISTIC DFC_DisblMsk2.DFC_MOXEMM_SMU_ALM8_4_C "" VALUE 0x8024919E Val_Wu16 65535.00 DFES_OneToOne 0.00 65535.00 FORMAT "%8.2" /end CHARACTERISTIC
/begin CHARACTERISTIC DFC_DisblMsk2.DFC_MOXEMM_SMU_ALM9_0_C "" VALUE 0x802491A0 Val_Wu16 65535.00 DFES_OneToOne 0.00 65535.00 FORMAT "%8.2" /end CHARACTERISTIC
/begin CHARACTERISTIC DFC_DisblMsk2.DFC_MOXEMM_SMU_ALM9_15_C "" VALUE 0x802491A2 Val_Wu16 65535.00 DFES_OneToOne 0.00 65535.00 FORMAT "%8.2" /end CHARACTERISTIC
/begin CHARACTERISTIC DFC_DisblMsk2.DFC_MOXEMM_SMU_ALM9_3_C "" VALUE 0x802491A4 Val_Wu16 65535.00 DFES_OneToOne 0.00 65535.00 FORMAT "%8.2" /end CHARACTERISTIC
/begin CHARACTERISTIC DFC_DisblMsk2.DFC_MoSysCtrlReIni_C "" VALUE 0x802491DA Val_Wu16 65535.00 DFES_OneToOne 0.00 65535.00 FORMAT "%8.2" /end CHARACTERISTIC
/begin CHARACTERISTIC DFC_DisblMsk2.DFC_MoXEMMHwLTMCUFW_C "" VALUE 0x802491DC Val_Wu16 65535.00 DFES_OneToOne 0.00 65535.00 FORMAT "%8.2" /end CHARACTERISTIC
/begin CHARACTERISTIC DFC_DisblMsk2.DFC_MoXEMMHwLTMonBIST_C "" VALUE 0x802491DE Val_Wu16 65535.00 DFES_OneToOne 0.00 65535.00 FORMAT "%8.2" /end CHARACTERISTIC
/begin CHARACTERISTIC DFC_DisblMsk2.DFC_MoXEMMHwLTRegMonTest_C "" VALUE 0x802491E0 Val_Wu16 65535.00 DFES_OneToOne 0.00 65535.00 FORMAT "%8.2" /end CHARACTERISTIC
/begin CHARACTERISTIC DFC_DisblMsk2.DFC_MoXEMMHwLTStbySMUAlvTest_C "" VALUE 0x802491E2 Val_Wu16 65535.00 DFES_OneToOne 0.00 65535.00 FORMAT "%8.2" /end CHARACTERISTIC
/begin CHARACTERISTIC DFC_DisblMsk2.DFC_MoXEMMHwLTTempSens_C "" VALUE 0x802491E4 Val_Wu16 65535.00 DFES_OneToOne 0.00 65535.00 FORMAT "%8.2" /end CHARACTERISTIC
/begin CHARACTERISTIC DFC_DisblMsk2.DFC_MoXEMMHwLTUCBCfg_C "" VALUE 0x802491E6 Val_Wu16 65535.00 DFES_OneToOne 0.00 65535.00 FORMAT "%8.2" /end CHARACTERISTIC
/begin CHARACTERISTIC DFC_DisblMsk2.DFC_OCWDAABEActv_C "" VALUE 0x80249212 Val_Wu16 65535.00 DFES_OneToOne 0.00 65535.00 FORMAT "%8.2" /end CHARACTERISTIC
/begin CHARACTERISTIC DFC_DisblMsk2.DFC_OCWDACom_C "" VALUE 0x80249214 Val_Wu16 65535.00 DFES_OneToOne 0.00 65535.00 FORMAT "%8.2" /end CHARACTERISTIC
/begin CHARACTERISTIC DFC_DisblMsk2.DFC_OCWDAErrPin_C "" VALUE 0x80249216 Val_Wu16 65535.00 DFES_OneToOne 0.00 65535.00 FORMAT "%8.2" /end CHARACTERISTIC
/begin CHARACTERISTIC DFC_DisblMsk2.DFC_OCWDAOvrVltg_C "" VALUE 0x80249218 Val_Wu16 65535.00 DFES_OneToOne 0.00 65535.00 FORMAT "%8.2" /end CHARACTERISTIC
/begin CHARACTERISTIC DFC_DisblMsk2.DFC_PwmCtPTmpErr_C "" VALUE 0x8024921C Val_Wu16 65535.00 DFES_OneToOne 0.00 65535.00 FORMAT "%8.2" /end CHARACTERISTIC
/begin CHARACTERISTIC MoAdap_nEm01CANRawQlfr_C "software switch MoAdap" VALUE 0x80270626 Val_Wu8 255.0 OneToOne 0.00 255.0 FORMAT "%5.1" /end CHARACTERISTIC
/begin CHARACTERISTIC MoAdap_nEm02CANRawQlfr_C "software switch MoAdap" VALUE 0x80270627 Val_Wu8 255.0 OneToOne 0.00 255.0 FORMAT "%5.1" /end CHARACTERISTIC
/begin CHARACTERISTIC MoAdap_SwtErr_C "software switch MoAdap" VALUE 0x80270628 Val_Wu8 255.0 OneToOne 0.00 255.0 FORMAT "%5.1" /end CHARACTERISTIC
/begin CHARACTERISTIC MoAdap_tqIncTqDmdEM02Qlfr_C "sw Switch for MoAdp" VALUE 0x80270629 Val_Wu8 255.0 OneToOne 0.00 255.0 FORMAT "%5.1" /end CHARACTERISTIC
/begin CHARACTERISTIC MoAdap_tqIncTqDmdQlfr_C "software switch MoAdap" VALUE 0x8027062A Val_Wu8 255.0 OneToOne 0.00 255.0 FORMAT "%5.1" /end CHARACTERISTIC
/begin CHARACTERISTIC MonEgyChrgnDefn_flgVrntCcsPlgLock_C "Variant CCS plug lock monitoring" VALUE 0x8026CF6E Val_Wu8 1.00000000000 B_TRUE 0.00 1.00000000000 FORMAT "%13.11" /end CHARACTERISTIC
/begin CHARACTERISTIC MoSysCtrl_ctErrReIniAllowd_C "Maximum allowed amount for calls of reinitialization process in monitoring for a driving cycle" VALUE 0x8026CF68 Val_Wu8 255.0 OneToOne 0.00 255.0 FORMAT "%5.1" /end CHARACTERISTIC
/begin CHARACTERISTIC MoSysCtrl_ctReIniAllowd_C "calibration for allowed reinitialisation counter in L2" VALUE 0x8026CF69 Val_Wu8 255.0 OneToOne 0.00 255.0 FORMAT "%5.1" /end CHARACTERISTIC
/begin CHARACTERISTIC MoSysCtrl_ctReIniTstDeb_C "Maximum debounce time for setting the testflag of the Diagnosis-functionality in MoSysCtrl_Co" VALUE 0x80270624 Val_Wu8 255.0 OneToOne 0.00 255.0 FORMAT "%5.1" /end CHARACTERISTIC
/begin CHARACTERISTIC MoSysCtrl_ctT15RsngEdgDetnAllwd_C "Maximum allowed amount of T15_st-toggling during a plausibilisation time" VALUE 0x8026CF6A Val_Wu8 255.0 OneToOne 0.00 255.0 FORMAT "%5.1" /end CHARACTERISTIC
/begin CHARACTERISTIC MoSysCtrl_ctT15RsngEdgDetnPlausy_C "Plausibilisation time for the detection of a toggling of T15_st status" VALUE 0x8026CF6B Val_Wu8 255.0 OneToOne 0.00 255.0 FORMAT "%5.1" /end CHARACTERISTIC
/begin CHARACTERISTIC MoSysCtrl_ctT15RsngEdgTurnOff_C "Time for holding a detected rising edge of T15_st status" VALUE 0x8026CF6C Val_Wu8 255.0 OneToOne 0.00 255.0 FORMAT "%5.1" /end CHARACTERISTIC
/begin CHARACTERISTIC MoSysCtrl_stSwtT15PlausEna_C "Switch for the activation of Plausibility Check of T15_st Signal" VALUE 0x8026CF6D Val_Wu8 255.0 OneToOne 0.00 255.0 FORMAT "%5.1" /end CHARACTERISTIC
/begin CHARACTERISTIC MoXEMM_nrHwLTErrSimn_C "Test calibration parameter for simulation of Hardware Logic test errors for diagnosis purposes" VALUE 0x802513BA RB_Val_Wu16 65535.0000000 MoXEMM_HwLTErrorSimnCode_VERB 0.00 65535.0000000 FORMAT "%13.7" /end CHARACTERISTIC
/begin CHARACTERISTIC MoXEMM_nrSmuAlmErrSimn_C "Test calibration parameter for simulation of SMU alarm errors for diagnosis purposes" VALUE 0x802513BC RB_Val_Wu16 65535.0000000 MoXEMM_SMUErrorSimnCode_VERB 0.00 65535.0000000 FORMAT "%13.7" /end CHARACTERISTIC
/begin CHARACTERISTIC Mo_cwMstSlave_C "Codeword master-slave configuration in function monitoring" VALUE 0x8026CF70 Val_Wu8 255.0 OneToOne 0.00 255.0 FORMAT "%5.1" /end CHARACTERISTIC
/begin CHARACTERISTIC Mo_stSwtHyb_C "code word for hybrid vehicle in the function monitoring" VALUE 0x8026CF71 Val_Wu8 255.0 OneToOne 0.00 255.0 FORMAT "%5.1" /end CHARACTERISTIC
/begin CHARACTERISTIC Mo_swtClrCntrMax_C "Condition reset drag counter in function monitoring" VALUE 0x8027062C Val_Wu8 255.0 OneToOne 0.00 255.0 FORMAT "%5.1" /end CHARACTERISTIC
/begin CHARACTERISTIC Mo_swtCyclCalUpdt_C "Switch to update level 2 calibration messages for level 1" VALUE 0x8026CF72 Val_Wu8 255.0 OneToOne 0.00 255.0 FORMAT "%5.1" /end CHARACTERISTIC
/begin CHARACTERISTIC Mo_trqIdcMax_C "Maximum of inner engine torque from ECU monitoring package." VALUE 0x8026FEAC Val_Ws16 3276.600 md_q0p1 0.100 3276.700 FORMAT "%8.3" EXTENDED_LIMITS -3276.800 3276.700 /end CHARACTERISTIC
/begin CHARACTERISTIC OCWDA_ctDebActvErr_C "Debouncing time of Error active condition" VALUE 0x802513BE RB_Val_Wu8 255.0 OneToOne 0.00 255.0 FORMAT "%5.1" /end CHARACTERISTIC
/begin CHARACTERISTIC OCWDA_ctDebOvrVltgOn_C "Debouncing time of overvoltage diagnosis" VALUE 0x802513C0 RB_Val_Wu16 65535.00 OneToOne 0.00 65535.00 FORMAT "%8.2" /end CHARACTERISTIC
/begin CHARACTERISTIC OCWDA_stErrSimn_C "Failure simulation of overvoltage, undervoltage, WDA communication errors, error pin activation (0: no error simulation active)" VALUE 0x802513C2 RB_Val_Wu8 8.00000000000 OCWDA_stErrSimn_C_compu_VERB 0.00 8.00000000000 FORMAT "%13.11" /end CHARACTERISTIC
/begin CHARACTERISTIC OCWDA_swtOffRst_C "Deactivation of error reaction (reset), if signal gets inactive once it was recognized as active." VALUE 0x802513C3 RB_Val_Wu8 1.00000000000 OCWDA_swtOffRst_C_compu_VERB 0.00 1.00000000000 FORMAT "%13.11" /end CHARACTERISTIC
/begin CHARACTERISTIC PLnCChp_rCcsPwrLineChpRstHi_C "Application parameter for DELib actuator to set the Reset line for powerline communication chip to HIGH" VALUE 0x802513C4 RB_Val_Ws16 799.9878 Prc -400.0000 399.9878 FORMAT "%8.4" /end CHARACTERISTIC
/begin CHARACTERISTIC PLnCChp_rCcsPwrLineChpRstLo_C "Application parameter for DELib actuator to set the Reset line for powerline communication chip to LOW" VALUE 0x802513C6 RB_Val_Ws16 799.9878 Prc -400.0000 399.9878 FORMAT "%8.4" /end CHARACTERISTIC
/begin CHARACTERISTIC PLnCChp_rCcsPwrSplyEnaOff_C "Application parameter for DELib actuator to set the activation of voltage supply for power line communication chip to OFF" VALUE 0x802513C8 RB_Val_Ws16 799.9878 Prc -400.0000 399.9878 FORMAT "%8.4" /end CHARACTERISTIC
/begin CHARACTERISTIC PLnCChp_rCcsPwrSplyEnaOn_C "Application parameter for DELib actuator to set the activation of voltage supply for power line communication chip to ON" VALUE 0x802513CA RB_Val_Ws16 799.9878 Prc -400.0000 399.9878 FORMAT "%8.4" /end CHARACTERISTIC
/begin CHARACTERISTIC PLnCChp_tiPLnCDeactvnFaild_C "Debounced time for the measured supply voltage of PLnC chip to be above the OFF threshold for deactivation of the PLnC chip when the requested PLnC chip state from charger control is False" VALUE 0x802513CC RB_Val_Ws32 4294.96729500 Time_Dt -2147.48364800 2147.48364700 FORMAT "%13.8" /end CHARACTERISTIC
/begin CHARACTERISTIC PLnCChp_tiVccOutRng_C "Debounce time for the Measured supply voltage of PLnC chip to be out of the according range for correctly powered powerline communication chip" VALUE 0x802513D0 RB_Val_Ws32 4294.96729500 Time_Dt -2147.48364800 2147.48364700 FORMAT "%13.8" /end CHARACTERISTIC
/begin CHARACTERISTIC PLnCChp_uMaxPwrLineChpVcc_C "Application parameter that indicates the maximum voltage for the measured supply voltage of PLnC chip to be within the according range for correctly powered powerline communication chip" VALUE 0x802513D4 RB_Val_Ws16 65.53500 RBPtCel_u_0p001_1 -32.76800 32.76700 FORMAT "%8.5" /end CHARACTERISTIC
/begin CHARACTERISTIC PLnCChp_uMinPwrLineChpVcc_C "Application parameter that indicates the minimum voltage for the measured supply voltage of PLnC chip to be within the according range for correctly powered powerline communication chip" VALUE 0x802513D6 RB_Val_Ws16 65.53500 RBPtCel_u_0p001_1 -32.76800 32.76700 FORMAT "%8.5" /end CHARACTERISTIC
/begin CHARACTERISTIC PLnCChp_uPLnCChpDeactvnDelta_C "Application parameter to indicate the delta voltage for LDelta Hysteresis to denote that the measured supply voltage from the PLnC chip is above the Off threshold when the requested PLnC chip state from charger control is False" VALUE 0x802513D8 RB_Val_Ws16 65.53500 RBPtCel_u_0p001_1 -32.76800 32.76700 FORMAT "%8.5" /end CHARACTERISTIC
/begin CHARACTERISTIC PLnCChp_uPLnCChpDeactvn_C "Application parameter for the voltage threshold that indicates deactivation of the powerline communication chip" VALUE 0x802513DA RB_Val_Ws16 65.53500 RBPtCel_u_0p001_1 -32.76800 32.76700 FORMAT "%8.5" /end CHARACTERISTIC
/begin CHARACTERISTIC PwmCtP_diActGradLim_f_C "" VALUE 0x802650FC Val_Wr32 2.00000000E+037 q1_A_DIV_s -1.00000000E+037 1.00000000E+037 FORMAT "%13.3" EXTENDED_LIMITS -3.40282347E+038 3.40282347E+038 /end CHARACTERISTIC
/begin CHARACTERISTIC PwmCtP_iActDflVal_f_C "" VALUE 0x80265100 Val_Wr32 2.00000000E+037 RBPtCel_i_1p0_2 -1.00000000E+037 1.00000000E+037 FORMAT "%13.3" EXTENDED_LIMITS -3.40282347E+038 3.40282347E+038 /end CHARACTERISTIC
/begin CHARACTERISTIC PwmCtP_iActEnhPhysSRCMax_f_MAP "" MAP 0x80265120 RB_Map_S16S16_R32_sao 2.00000000E+037 RBPtCel_i_1p0_2 -1.00000000E+037 1.00000000E+037 FORMAT "%13.3" EXTENDED_LIMITS -3.40282347E+038 3.40282347E+038
 /begin AXIS_DESCR STD_AXIS Epm_nEng EngN 25 -16384.00 16383.50 FORMAT "%8.2" DEPOSIT ABSOLUTE /end AXIS_DESCR
 /begin AXIS_DESCR STD_AXIS InjCtl_qSetUnBal InjMass 25 -327.6800 327.6700 FORMAT "%8.4" DEPOSIT ABSOLUTE /end AXIS_DESCR
/end CHARACTERISTIC
/begin CHARACTERISTIC PwmCtP_iActEnhPhysSRCMin_f_MAP "" MAP 0x80265B4C RB_Map_S16S16_R32_sao 2.00000000E+037 RBPtCel_i_1p0_2 -1.00000000E+037 1.00000000E+037 FORMAT "%13.3" EXTENDED_LIMITS -3.40282347E+038 3.40282347E+038
 /begin AXIS_DESCR STD_AXIS Epm_nEng EngN 25 -16384.00 16383.50 FORMAT "%8.2" DEPOSIT ABSOLUTE /end AXIS_DESCR
 /begin AXIS_DESCR STD_AXIS InjCtl_qSetUnBal InjMass 25 -327.6800 327.6700 FORMAT "%8.4" DEPOSIT ABSOLUTE /end AXIS_DESCR
/end CHARACTERISTIC
/begin CHARACTERISTIC PwmCtP_iActHiLimit_f_C "" VALUE 0x80265104 Val_Wr32 2.00000000E+037 RBPtCel_i_1p0_2 -1.00000000E+037 1.00000000E+037 FORMAT "%13.3" EXTENDED_LIMITS -3.40282347E+038 3.40282347E+038 /end CHARACTERISTIC
/begin CHARACTERISTIC PwmCtP_iActLoLimit_f_C "" VALUE 0x80265108 Val_Wr32 2.00000000E+037 RBPtCel_i_1p0_2 -1.00000000E+037 1.00000000E+037 FORMAT "%13.3" EXTENDED_LIMITS -3.40282347E+038 3.40282347E+038 /end CHARACTERISTIC
/begin CHARACTERISTIC PwmCtP_numStdSens_C "" VALUE 0x80266578 Val_Wu32 4294967295.00 OneToOne 0.00 4294967295.00 FORMAT "%13.2" /end CHARACTERISTIC
/begin CHARACTERISTIC PwmCtP_numTempErrDef_C "" VALUE 0x8026657C Val_Wu8 255.0 OneToOne 0.00 255.0 FORMAT "%5.1" /end CHARACTERISTIC
/begin CHARACTERISTIC PwmCtP_numtSel_C "" VALUE 0x8026657E Val_Wu16 255.000000000 DELIB_ALLTEMP_VERB_COMPU 0.00 255.000000000 FORMAT "%13.9" /end CHARACTERISTIC
/begin CHARACTERISTIC PwmCtP_PWMCal.rSRCMax_C "Structure for sensor signal diagnosis / Maximum duty cycle for a valid PWM-transmission" VALUE 0x802513DC RB_Val_Ws16 655.3500 DtyCyc -327.6800 327.6700 FORMAT "%8.4" /end CHARACTERISTIC
/begin CHARACTERISTIC PwmCtP_PWMCal.rSRCMin_C "Structure for sensor signal diagnosis / Minimum duty cycle for a valid PWM-transmission" VALUE 0x802513DE RB_Val_Ws16 655.3500 DtyCyc -327.6800 327.6700 FORMAT "%8.4" /end CHARACTERISTIC
/begin CHARACTERISTIC PwmCtP_PWMCal.tiSRCMax_C "Structure for sensor signal diagnosis / Maximum frequency for a valid PWM-transmission" VALUE 0x802513E0 RB_Val_Ws16 65535.00 Time_msec_q1_COMPU -32768.00 32767.00 FORMAT "%8.2" /end CHARACTERISTIC
/begin CHARACTERISTIC PwmCtP_PWMCal.tiSRCMin_C "Structure for sensor signal diagnosis / Minimum frequency for a valid PWM-transmission" VALUE 0x802513E2 RB_Val_Ws16 65535.00 Time_msec_q1_COMPU -32768.00 32767.00 FORMAT "%8.2" /end CHARACTERISTIC
/begin CHARACTERISTIC PwmCtP_PWMSensTransf_f_MAP "" MAP 0x80264648 RB_Map_R32R32_R32_sao 2.00000000E+037 RBPtCel_i_1p0_2 -1.00000000E+037 1.00000000E+037 FORMAT "%13.3" EXTENDED_LIMITS -3.40282347E+038 3.40282347E+038
 /begin AXIS_DESCR STD_AXIS PwmCtP_rDtyCycRaw_f RBPtCel_Perc_1p0_1 25 -1.00000000E+037 1.00000000E+037 FORMAT "%13.3" EXTENDED_LIMITS -3.40282347E+038 3.40282347E+038 DEPOSIT ABSOLUTE /end AXIS_DESCR
 /begin AXIS_DESCR STD_AXIS PwmCtP_tiPerRaw_f Time_usec_q1_COMPU 25 -1.00000000E+037 1.00000000E+037 FORMAT "%13.3" EXTENDED_LIMITS -3.40282347E+038 3.40282347E+038 DEPOSIT ABSOLUTE /end AXIS_DESCR
/end CHARACTERISTIC
/begin CHARACTERISTIC PwmCtP_RmpSlp_f.Pos_C " / Positive ramp slope dy/dt" VALUE 0x8026510C Kw_Wr32 2.00000000E+038 q1_A_DIV_s -1.00000000E+038 1.00000000E+038 FORMAT "%13.3" EXTENDED_LIMITS -3.40282347E+038 3.40282347E+038 /end CHARACTERISTIC
/begin CHARACTERISTIC PwmCtP_RmpSlp_f.Neg_C " / Negative ramp slope dy/dt" VALUE 0x80265110 Kw_Wr32 2.00000000E+038 q1_A_DIV_s -1.00000000E+038 1.00000000E+038 FORMAT "%13.3" EXTENDED_LIMITS -3.40282347E+038 3.40282347E+038 /end CHARACTERISTIC
/begin CHARACTERISTIC PwmCtP_stEnhPhysSRCRls_MAP "" MAP 0x80266580 RB_Map_S16S16_U8_sao 255.0 OneToOne 0.00 255.0 FORMAT "%5.1"
 /begin AXIS_DESCR STD_AXIS Epm_nEng EngN 25 -16384.00 16383.50 FORMAT "%8.2" DEPOSIT ABSOLUTE /end AXIS_DESCR
 /begin AXIS_DESCR STD_AXIS InjCtl_qSetUnBal InjMass 25 -327.6800 327.6700 FORMAT "%8.4" DEPOSIT ABSOLUTE /end AXIS_DESCR
/end CHARACTERISTIC
/begin CHARACTERISTIC PwmCtP_swtConfStdSens2_C "" VALUE 0x802650E8 Val_Wu32 4294967295.00 OneToOne 0.00 4294967295.00 FORMAT "%13.2" /end CHARACTERISTIC
/begin CHARACTERISTIC PwmCtP_swtConfStdSensSwVers162_C "" VALUE 0x802650EC Val_Wu32 4294967295.00 OneToOne 0.00 4294967295.00 FORMAT "%13.2" /end CHARACTERISTIC
/begin CHARACTERISTIC PwmCtP_swtConfStdSens_C "" VALUE 0x802650F0 Val_Wu32 4294967295.00 OneToOne 0.00 4294967295.00 FORMAT "%13.2" /end CHARACTERISTIC
/begin CHARACTERISTIC PwmCtP_tiEngOnMin_C "" VALUE 0x8026685C Val_Wu32 42949672950.0 Time_ms 0.00 42949672950.0 FORMAT "%13.1" /end CHARACTERISTIC
/begin CHARACTERISTIC PwmCtP_tiPT1Fil_C "" VALUE 0x802650DC Val_Ws32 4294.9672940000000 TimeDelay_s 0.0000020000000 4294.9672959999998 FORMAT "%19.14" EXTENDED_LIMITS 0.000002000000001 4294.9672959999998 /end CHARACTERISTIC
/begin CHARACTERISTIC PwmCtP_tiPT1_f_C "" VALUE 0x80265114 Val_Wr32 2.00000000E+037 RBPtCel_ti_1p0_2 -1.00000000E+037 1.00000000E+037 FORMAT "%13.3" EXTENDED_LIMITS -3.40282347E+038 3.40282347E+038 /end CHARACTERISTIC
/begin CHARACTERISTIC PwmCtP_tiTempErrOk_C "" VALUE 0x80266860 Val_Ws16 655350.0 Time_ms -327680.0 327670.0 FORMAT "%8.1" /end CHARACTERISTIC
/begin CHARACTERISTIC PwmCtP_TransStg_f.Dfl_r32_C " / This is SW-CALPRM-PROTOTYPE" VALUE 0x80265118 Kw_Wr32 2.00000000E+037 RBPtCel_i_1p0_2 -1.00000000E+037 1.00000000E+037 FORMAT "%13.3" EXTENDED_LIMITS -3.40282347E+038 3.40282347E+038 /end CHARACTERISTIC
/begin CHARACTERISTIC PwmCtP_TransStg_f.stSensId_C " / This is SW-CALPRM-PROTOTYPE" VALUE 0x8026511C Kw_Wu8 255.0 OneToOne 0.00 255.0 FORMAT "%5.1" /end CHARACTERISTIC
/begin CHARACTERISTIC PwmCtP_tSnsrMax_f_C "" VALUE 0x80266864 Val_Wr32 2.00000000E+037 RBPtCel_t_1p0_3 -1.00000000E+037 1.00000000E+037 FORMAT "%13.3" EXTENDED_LIMITS -3.40282347E+038 3.40282347E+038 /end CHARACTERISTIC
/begin CHARACTERISTIC PwmCtP_tSnsrMin_f_C "" VALUE 0x80266868 Val_Wr32 2.00000000E+037 RBPtCel_t_1p0_3 -1.00000000E+037 1.00000000E+037 FORMAT "%13.3" EXTENDED_LIMITS -3.40282347E+038 3.40282347E+038 /end CHARACTERISTIC
/begin MEASUREMENT DDRC_St.DFC_PLnCChpDeactvnFaild "" ULONG DFC_OneToOne 1 100 0.00 536870911.000 BIT_MASK 0x1fffffff FORMAT "%13.3" ECU_ADDRESS 0x6001C450 /end MEASUREMENT
/begin MEASUREMENT DDRC_St.DFC_PwmCtPSRCMin "" ULONG DFC_OneToOne 1 100 0.00 536870911.000 BIT_MASK 0x1fffffff FORMAT "%13.3" ECU_ADDRESS 0x6001CA80 /end MEASUREMENT
/begin MEASUREMENT DDRC_St.DFC_PwmCtPPhysRngHi "" UWORD DFC_OneToOne 1 100 0.00 8191.000 BIT_MASK 0x1fff FORMAT "%8.3" ECU_ADDRESS 0x60021FD4 /end MEASUREMENT
/begin MEASUREMENT DDRC_St.DFC_PwmCtPPhysRngLo "" UWORD DFC_OneToOne 1 100 0.00 8191.000 BIT_MASK 0x1fff FORMAT "%8.3" ECU_ADDRESS 0x60021FD6 /end MEASUREMENT
/begin MEASUREMENT DDRC_St.DFC_PwmCtPSRCMax "" UWORD DFC_OneToOne 1 100 0.00 8191.000 BIT_MASK 0x1fff FORMAT "%8.3" ECU_ADDRESS 0x60021FD8 /end MEASUREMENT
/begin MEASUREMENT DFC_st.DFC_PLnCChpDeactvnFaild "" UBYTE DFC_OneToOne 1 100 0.00 255.0 FORMAT "%5.1" ECU_ADDRESS 0x60034A77 /end MEASUREMENT
/begin MEASUREMENT DFC_st.DFC_PwmCtPSRCMin "" UBYTE DFC_OneToOne 1 100 0.00 255.0 FORMAT "%5.1" ECU_ADDRESS 0x60034C03 /end MEASUREMENT
/begin MEASUREMENT DFC_st.DFC_PwmCtPPhysRngHi "" UBYTE DFC_OneToOne 1 100 0.00 255.0 FORMAT "%5.1" ECU_ADDRESS 0x60034C41 /end MEASUREMENT
/begin MEASUREMENT DFC_st.DFC_PwmCtPPhysRngLo "" UBYTE DFC_OneToOne 1 100 0.00 255.0 FORMAT "%5.1" ECU_ADDRESS 0x60034C42 /end MEASUREMENT
/begin MEASUREMENT DFC_st.DFC_PwmCtPSRCMax "" UBYTE DFC_OneToOne 1 100 0.00 255.0 FORMAT "%5.1" ECU_ADDRESS 0x60034C43 /end MEASUREMENT
/begin MEASUREMENT DFC_st.DFC_MOXEMM_SMU_ALM0_0 "" UBYTE DFC_OneToOne 1 100 0.00 255.0 FORMAT "%5.1" ECU_ADDRESS 0x60034CE4 /end MEASUREMENT
/begin MEASUREMENT DFC_st.DFC_MOXEMM_SMU_ALM0_1 "" UBYTE DFC_OneToOne 1 100 0.00 255.0 FORMAT "%5.1" ECU_ADDRESS 0x60034CE5 /end MEASUREMENT
/begin MEASUREMENT DFC_st.DFC_MOXEMM_SMU_ALM0_10 "" UBYTE DFC_OneToOne 1 100 0.00 255.0 FORMAT "%5.1" ECU_ADDRESS 0x60034CE6 /end MEASUREMENT
/begin MEASUREMENT DFC_st.DFC_MOXEMM_SMU_ALM0_11 "" UBYTE DFC_OneToOne 1 100 0.00 255.0 FORMAT "%5.1" ECU_ADDRESS 0x60034CE7 /end MEASUREMENT
/begin MEASUREMENT DFC_st.DFC_MOXEMM_SMU_ALM0_13 "" UBYTE DFC_OneToOne 1 100 0.00 255.0 FORMAT "%5.1" ECU_ADDRESS 0x60034CE8 /end MEASUREMENT
/begin MEASUREMENT DFC_st.DFC_MOXEMM_SMU_ALM0_14 "" UBYTE DFC_OneToOne 1 100 0.00 255.0 FORMAT "%5.1" ECU_ADDRESS 0x60034CE9 /end MEASUREMENT
/begin MEASUREMENT DFC_st.DFC_MOXEMM_SMU_ALM0_2 "" UBYTE DFC_OneToOne 1 100 0.00 255.0 FORMAT "%5.1" ECU_ADDRESS 0x60034CEA /end MEASUREMENT
/begin MEASUREMENT DFC_st.DFC_MOXEMM_SMU_ALM0_22 "" UBYTE DFC_OneToOne 1 100 0.00 255.0 FORMAT "%5.1" ECU_ADDRESS 0x60034CEB /end MEASUREMENT
/begin MEASUREMENT DFC_st.DFC_MOXEMM_SMU_ALM0_23 "" UBYTE DFC_OneToOne 1 100 0.00 255.0 FORMAT "%5.1" ECU_ADDRESS 0x60034CEC /end MEASUREMENT
/begin MEASUREMENT DFC_st.DFC_MOXEMM_SMU_ALM0_4 "" UBYTE DFC_OneToOne 1 100 0.00 255.0 FORMAT "%5.1" ECU_ADDRESS 0x60034CED /end MEASUREMENT
/begin MEASUREMENT DFC_st.DFC_MOXEMM_SMU_ALM0_5 "" UBYTE DFC_OneToOne 1 100 0.00 255.0 FORMAT "%5.1" ECU_ADDRESS 0x60034CEE /end MEASUREMENT
/begin MEASUREMENT DFC_st.DFC_MOXEMM_SMU_ALM0_7 "" UBYTE DFC_OneToOne 1 100 0.00 255.0 FORMAT "%5.1" ECU_ADDRESS 0x60034CEF /end MEASUREMENT
/begin MEASUREMENT DFC_st.DFC_MOXEMM_SMU_ALM0_8 "" UBYTE DFC_OneToOne 1 100 0.00 255.0 FORMAT "%5.1" ECU_ADDRESS 0x60034CF0 /end MEASUREMENT
/begin MEASUREMENT DFC_st.DFC_MOXEMM_SMU_ALM10_16 "" UBYTE DFC_OneToOne 1 100 0.00 255.0 FORMAT "%5.1" ECU_ADDRESS 0x60034CF1 /end MEASUREMENT
/begin MEASUREMENT DFC_st.DFC_MOXEMM_SMU_ALM10_17 "" UBYTE DFC_OneToOne 1 100 0.00 255.0 FORMAT "%5.1" ECU_ADDRESS 0x60034CF2 /end MEASUREMENT
/begin MEASUREMENT DFC_st.DFC_MOXEMM_SMU_ALM10_21 "" UBYTE DFC_OneToOne 1 100 0.00 255.0 FORMAT "%5.1" ECU_ADDRESS 0x60034CF3 /end MEASUREMENT
/begin MEASUREMENT DFC_st.DFC_MOXEMM_SMU_ALM11_0 "" UBYTE DFC_OneToOne 1 100 0.00 255.0 FORMAT "%5.1" ECU_ADDRESS 0x60034CF4 /end MEASUREMENT
/begin MEASUREMENT DFC_st.DFC_MOXEMM_SMU_ALM11_1 "" UBYTE DFC_OneToOne 1 100 0.00 255.0 FORMAT "%5.1" ECU_ADDRESS 0x60034CF5 /end MEASUREMENT
/begin MEASUREMENT DFC_st.DFC_MOXEMM_SMU_ALM11_2 "" UBYTE DFC_OneToOne 1 100 0.00 255.0 FORMAT "%5.1" ECU_ADDRESS 0x60034CF6 /end MEASUREMENT
/begin MEASUREMENT DFC_st.DFC_MOXEMM_SMU_ALM11_3 "" UBYTE DFC_OneToOne 1 100 0.00 255.0 FORMAT "%5.1" ECU_ADDRESS 0x60034CF7 /end MEASUREMENT
/begin MEASUREMENT DFC_st.DFC_MOXEMM_SMU_ALM11_4 "" UBYTE DFC_OneToOne 1 100 0.00 255.0 FORMAT "%5.1" ECU_ADDRESS 0x60034CF8 /end MEASUREMENT
/begin MEASUREMENT DFC_st.DFC_MOXEMM_SMU_ALM11_5 "" UBYTE DFC_OneToOne 1 100 0.00 255.0 FORMAT "%5.1" ECU_ADDRESS 0x60034CF9 /end MEASUREMENT
/begin MEASUREMENT DFC_st.DFC_MOXEMM_SMU_ALM11_8 "" UBYTE DFC_OneToOne 1 100 0.00 255.0 FORMAT "%5.1" ECU_ADDRESS 0x60034CFA /end MEASUREMENT
/begin MEASUREMENT DFC_st.DFC_MOXEMM_SMU_ALM11_9 "" UBYTE DFC_OneToOne 1 100 0.00 255.0 FORMAT "%5.1" ECU_ADDRESS 0x60034CFB /end MEASUREMENT
/begin MEASUREMENT DFC_st.DFC_MOXEMM_SMU_ALM1_0 "" UBYTE DFC_OneToOne 1 100 0.00 255.0 FORMAT "%5.1" ECU_ADDRESS 0x60034CFC /end MEASUREMENT
/begin MEASUREMENT DFC_st.DFC_MOXEMM_SMU_ALM1_1 "" UBYTE DFC_OneToOne 1 100 0.00 255.0 FORMAT "%5.1" ECU_ADDRESS 0x60034CFD /end MEASUREMENT
/begin MEASUREMENT DFC_st.DFC_MOXEMM_SMU_ALM1_10 "" UBYTE DFC_OneToOne 1 100 0.00 255.0 FORMAT "%5.1" ECU_ADDRESS 0x60034CFE /end MEASUREMENT
/begin MEASUREMENT DFC_st.DFC_MOXEMM_SMU_ALM1_11 "" UBYTE DFC_OneToOne 1 100 0.00 255.0 FORMAT "%5.1" ECU_ADDRESS 0x60034CFF /end MEASUREMENT
/begin MEASUREMENT DFC_st.DFC_MOXEMM_SMU_ALM1_13 "" UBYTE DFC_OneToOne 1 100 0.00 255.0 FORMAT "%5.1" ECU_ADDRESS 0x60034D00 /end MEASUREMENT
/begin MEASUREMENT DFC_st.DFC_MOXEMM_SMU_ALM1_14 "" UBYTE DFC_OneToOne 1 100 0.00 255.0 FORMAT "%5.1" ECU_ADDRESS 0x60034D01 /end MEASUREMENT
/begin MEASUREMENT DFC_st.DFC_MOXEMM_SMU_ALM1_2 "" UBYTE DFC_OneToOne 1 100 0.00 255.0 FORMAT "%5.1" ECU_ADDRESS 0x60034D02 /end MEASUREMENT
/begin MEASUREMENT DFC_st.DFC_MOXEMM_SMU_ALM1_22 "" UBYTE DFC_OneToOne 1 100 0.00 255.0 FORMAT "%5.1" ECU_ADDRESS 0x60034D03 /end MEASUREMENT
/begin MEASUREMENT DFC_st.DFC_MOXEMM_SMU_ALM1_23 "" UBYTE DFC_OneToOne 1 100 0.00 255.0 FORMAT "%5.1" ECU_ADDRESS 0x60034D04 /end MEASUREMENT
/begin MEASUREMENT DFC_st.DFC_MOXEMM_SMU_ALM1_4 "" UBYTE DFC_OneToOne 1 100 0.00 255.0 FORMAT "%5.1" ECU_ADDRESS 0x60034D05 /end MEASUREMENT
/begin MEASUREMENT DFC_st.DFC_MOXEMM_SMU_ALM1_5 "" UBYTE DFC_OneToOne 1 100 0.00 255.0 FORMAT "%5.1" ECU_ADDRESS 0x60034D06 /end MEASUREMENT
/begin MEASUREMENT DFC_st.DFC_MOXEMM_SMU_ALM1_7 "" UBYTE DFC_OneToOne 1 100 0.00 255.0 FORMAT "%5.1" ECU_ADDRESS 0x60034D07 /end MEASUREMENT
/begin MEASUREMENT DFC_st.DFC_MOXEMM_SMU_ALM1_8 "" UBYTE DFC_OneToOne 1 100 0.00 255.0 FORMAT "%5.1" ECU_ADDRESS 0x60034D08 /end MEASUREMENT
/begin MEASUREMENT DFC_st.DFC_MOXEMM_SMU_ALM21_0 "" UBYTE DFC_OneToOne 1 100 0.00 255.0 FORMAT "%5.1" ECU_ADDRESS 0x60034D09 /end MEASUREMENT
/begin MEASUREMENT DFC_st.DFC_MOXEMM_SMU_ALM21_16 "" UBYTE DFC_OneToOne 1 100 0.00 255.0 FORMAT "%5.1" ECU_ADDRESS 0x60034D0A /end MEASUREMENT
/begin MEASUREMENT DFC_st.DFC_MOXEMM_SMU_ALM21_3 "" UBYTE DFC_OneToOne 1 100 0.00 255.0 FORMAT "%5.1" ECU_ADDRESS 0x60034D0B /end MEASUREMENT
/begin MEASUREMENT DFC_st.DFC_MOXEMM_SMU_ALM2_1 "" UBYTE DFC_OneToOne 1 100 0.00 255.0 FORMAT "%5.1" ECU_ADDRESS 0x60034D0C /end MEASUREMENT
/begin MEASUREMENT DFC_st.DFC_MOXEMM_SMU_ALM2_10 "" UBYTE DFC_OneToOne 1 100 0.00 255.0 FORMAT "%5.1" ECU_ADDRESS 0x60034D0D /end MEASUREMENT
/begin MEASUREMENT DFC_st.DFC_MOXEMM_SMU_ALM2_11 "" UBYTE DFC_OneToOne 1 100 0.00 255.0 FORMAT "%5.1" ECU_ADDRESS 0x60034D0E /end MEASUREMENT
/begin MEASUREMENT DFC_st.DFC_MOXEMM_SMU_ALM2_13 "" UBYTE DFC_OneToOne 1 100 0.00 255.0 FORMAT "%5.1" ECU_ADDRESS 0x60034D0F /end MEASUREMENT
/begin MEASUREMENT DFC_st.DFC_MOXEMM_SMU_ALM2_14 "" UBYTE DFC_OneToOne 1 100 0.00 255.0 FORMAT "%5.1" ECU_ADDRESS 0x60034D10 /end MEASUREMENT
/begin MEASUREMENT DFC_st.DFC_MOXEMM_SMU_ALM2_22 "" UBYTE DFC_OneToOne 1 100 0.00 255.0 FORMAT "%5.1" ECU_ADDRESS 0x60034D11 /end MEASUREMENT
/begin MEASUREMENT DFC_st.DFC_MOXEMM_SMU_ALM2_23 "" UBYTE DFC_OneToOne 1 100 0.00 255.0 FORMAT "%5.1" ECU_ADDRESS 0x60034D12 /end MEASUREMENT
/begin MEASUREMENT DFC_st.DFC_MOXEMM_SMU_ALM2_4 "" UBYTE DFC_OneToOne 1 100 0.00 255.0 FORMAT "%5.1" ECU_ADDRESS 0x60034D13 /end MEASUREMENT
/begin MEASUREMENT DFC_st.DFC_MOXEMM_SMU_ALM2_5 "" UBYTE DFC_OneToOne 1 100 0.00 255.0 FORMAT "%5.1" ECU_ADDRESS 0x60034D14 /end MEASUREMENT
/begin MEASUREMENT DFC_st.DFC_MOXEMM_SMU_ALM2_7 "" UBYTE DFC_OneToOne 1 100 0.00 255.0 FORMAT "%5.1" ECU_ADDRESS 0x60034D15 /end MEASUREMENT
/begin MEASUREMENT DFC_st.DFC_MOXEMM_SMU_ALM2_8 "" UBYTE DFC_OneToOne 1 100 0.00 255.0 FORMAT "%5.1" ECU_ADDRESS 0x60034D16 /end MEASUREMENT
/begin MEASUREMENT DFC_st.DFC_MOXEMM_SMU_ALM6_0 "" UBYTE DFC_OneToOne 1 100 0.00 255.0 FORMAT "%5.1" ECU_ADDRESS 0x60034D17 /end MEASUREMENT
/begin MEASUREMENT DFC_st.DFC_MOXEMM_SMU_ALM6_11 "" UBYTE DFC_OneToOne 1 100 0.00 255.0 FORMAT "%5.1" ECU_ADDRESS 0x60034D18 /end MEASUREMENT
/begin MEASUREMENT DFC_st.DFC_MOXEMM_SMU_ALM6_12 "" UBYTE DFC_OneToOne 1 100 0.00 255.0 FORMAT "%5.1" ECU_ADDRESS 0x60034D19 /end MEASUREMENT
/begin MEASUREMENT DFC_st.DFC_MOXEMM_SMU_ALM6_14 "" UBYTE DFC_OneToOne 1 100 0.00 255.0 FORMAT "%5.1" ECU_ADDRESS 0x60034D1A /end MEASUREMENT
/begin MEASUREMENT DFC_st.DFC_MOXEMM_SMU_ALM6_15 "" UBYTE DFC_OneToOne 1 100 0.00 255.0 FORMAT "%5.1" ECU_ADDRESS 0x60034D1B /end MEASUREMENT
/begin MEASUREMENT DFC_st.DFC_MOXEMM_SMU_ALM6_17 "" UBYTE DFC_OneToOne 1 100 0.00 255.0 FORMAT "%5.1" ECU_ADDRESS 0x60034D1C /end MEASUREMENT
/begin MEASUREMENT DFC_st.DFC_MOXEMM_SMU_ALM6_18 "" UBYTE DFC_OneToOne 1 100 0.00 255.0 FORMAT "%5.1" ECU_ADDRESS 0x60034D1D /end MEASUREMENT
/begin MEASUREMENT DFC_st.DFC_MOXEMM_SMU_ALM6_20 "" UBYTE DFC_OneToOne 1 100 0.00 255.0 FORMAT "%5.1" ECU_ADDRESS 0x60034D1E /end MEASUREMENT
/begin MEASUREMENT DFC_st.DFC_MOXEMM_SMU_ALM6_21 "" UBYTE DFC_OneToOne 1 100 0.00 255.0 FORMAT "%5.1" ECU_ADDRESS 0x60034D1F /end MEASUREMENT
/begin MEASUREMENT DFC_st.DFC_MOXEMM_SMU_ALM6_25 "" UBYTE DFC_OneToOne 1 100 0.00 255.0 FORMAT "%5.1" ECU_ADDRESS 0x60034D20 /end MEASUREMENT
/begin MEASUREMENT DFC_st.DFC_MOXEMM_SMU_ALM6_4 "" UBYTE DFC_OneToOne 1 100 0.00 255.0 FORMAT "%5.1" ECU_ADDRESS 0x60034D21 /end MEASUREMENT
/begin MEASUREMENT DFC_st.DFC_MOXEMM_SMU_ALM6_5 "" UBYTE DFC_OneToOne 1 100 0.00 255.0 FORMAT "%5.1" ECU_ADDRESS 0x60034D22 /end MEASUREMENT
/begin MEASUREMENT DFC_st.DFC_MOXEMM_SMU_ALM6_7 "" UBYTE DFC_OneToOne 1 100 0.00 255.0 FORMAT "%5.1" ECU_ADDRESS 0x60034D23 /end MEASUREMENT
/begin MEASUREMENT DFC_st.DFC_MOXEMM_SMU_ALM6_8 "" UBYTE DFC_OneToOne 1 100 0.00 255.0 FORMAT "%5.1" ECU_ADDRESS 0x60034D24 /end MEASUREMENT
/begin MEASUREMENT DFC_st.DFC_MOXEMM_SMU_ALM7_1 "" UBYTE DFC_OneToOne 1 100 0.00 255.0 FORMAT "%5.1" ECU_ADDRESS 0x60034D25 /end MEASUREMENT
/begin MEASUREMENT DFC_st.DFC_MOXEMM_SMU_ALM7_12 "" UBYTE DFC_OneToOne 1 100 0.00 255.0 FORMAT "%5.1" ECU_ADDRESS 0x60034D26 /end MEASUREMENT
/begin MEASUREMENT DFC_st.DFC_MOXEMM_SMU_ALM7_13 "" UBYTE DFC_OneToOne 1 100 0.00 255.0 FORMAT "%5.1" ECU_ADDRESS 0x60034D27 /end MEASUREMENT
/begin MEASUREMENT DFC_st.DFC_MOXEMM_SMU_ALM7_14 "" UBYTE DFC_OneToOne 1 100 0.00 255.0 FORMAT "%5.1" ECU_ADDRESS 0x60034D28 /end MEASUREMENT
/begin MEASUREMENT DFC_st.DFC_MOXEMM_SMU_ALM7_15 "" UBYTE DFC_OneToOne 1 100 0.00 255.0 FORMAT "%5.1" ECU_ADDRESS 0x60034D29 /end MEASUREMENT
/begin MEASUREMENT DFC_st.DFC_MOXEMM_SMU_ALM7_16 "" UBYTE DFC_OneToOne 1 100 0.00 255.0 FORMAT "%5.1" ECU_ADDRESS 0x60034D2A /end MEASUREMENT
/begin MEASUREMENT DFC_st.DFC_MOXEMM_SMU_ALM7_17 "" UBYTE DFC_OneToOne 1 100 0.00 255.0 FORMAT "%5.1" ECU_ADDRESS 0x60034D2B /end MEASUREMENT
/begin MEASUREMENT DFC_st.DFC_MOXEMM_SMU_ALM7_2 "" UBYTE DFC_OneToOne 1 100 0.00 255.0 FORMAT "%5.1" ECU_ADDRESS 0x60034D2C /end MEASUREMENT
/begin MEASUREMENT DFC_st.DFC_MOXEMM_SMU_ALM7_20 "" UBYTE DFC_OneToOne 1 100 0.00 255.0 FORMAT "%5.1" ECU_ADDRESS 0x60034D2D /end MEASUREMENT
/begin MEASUREMENT DFC_st.DFC_MOXEMM_SMU_ALM7_25 "" UBYTE DFC_OneToOne 1 100 0.00 255.0 FORMAT "%5.1" ECU_ADDRESS 0x60034D2E /end MEASUREMENT
/begin MEASUREMENT DFC_st.DFC_MOXEMM_SMU_ALM7_26 "" UBYTE DFC_OneToOne 1 100 0.00 255.0 FORMAT "%5.1" ECU_ADDRESS 0x60034D2F /end MEASUREMENT
/begin MEASUREMENT DFC_st.DFC_MOXEMM_SMU_ALM7_28 "" UBYTE DFC_OneToOne 1 100 0.00 255.0 FORMAT "%5.1" ECU_ADDRESS 0x60034D30 /end MEASUREMENT
/begin MEASUREMENT DFC_st.DFC_MOXEMM_SMU_ALM7_29 "" UBYTE DFC_OneToOne 1 100 0.00 255.0 FORMAT "%5.1" ECU_ADDRESS 0x60034D31 /end MEASUREMENT
/begin MEASUREMENT DFC_st.DFC_MOXEMM_SMU_ALM7_30 "" UBYTE DFC_OneToOne 1 100 0.00 255.0 FORMAT "%5.1" ECU_ADDRESS 0x60034D32 /end MEASUREMENT
/begin MEASUREMENT DFC_st.DFC_MOXEMM_SMU_ALM7_31 "" UBYTE DFC_OneToOne 1 100 0.00 255.0 FORMAT "%5.1" ECU_ADDRESS 0x60034D33 /end MEASUREMENT
/begin MEASUREMENT DFC_st.DFC_MOXEMM_SMU_ALM8_0 "" UBYTE DFC_OneToOne 1 100 0.00 255.0 FORMAT "%5.1" ECU_ADDRESS 0x60034D34 /end MEASUREMENT
/begin MEASUREMENT DFC_st.DFC_MOXEMM_SMU_ALM8_1 "" UBYTE DFC_OneToOne 1 100 0.00 255.0 FORMAT "%5.1" ECU_ADDRESS 0x60034D35 /end MEASUREMENT
/begin MEASUREMENT DFC_st.DFC_MOXEMM_SMU_ALM8_10 "" UBYTE DFC_OneToOne 1 100 0.00 255.0 FORMAT "%5.1" ECU_ADDRESS 0x60034D36 /end MEASUREMENT
/begin MEASUREMENT DFC_st.DFC_MOXEMM_SMU_ALM8_11 "" UBYTE DFC_OneToOne 1 100 0.00 255.0 FORMAT "%5.1" ECU_ADDRESS 0x60034D37 /end MEASUREMENT
/begin MEASUREMENT DFC_st.DFC_MOXEMM_SMU_ALM8_12 "" UBYTE DFC_OneToOne 1 100 0.00 255.0 FORMAT "%5.1" ECU_ADDRESS 0x60034D38 /end MEASUREMENT
/begin MEASUREMENT DFC_st.DFC_MOXEMM_SMU_ALM8_16 "" UBYTE DFC_OneToOne 1 100 0.00 255.0 FORMAT "%5.1" ECU_ADDRESS 0x60034D39 /end MEASUREMENT
/begin MEASUREMENT DFC_st.DFC_MOXEMM_SMU_ALM8_18 "" UBYTE DFC_OneToOne 1 100 0.00 255.0 FORMAT "%5.1" ECU_ADDRESS 0x60034D3A /end MEASUREMENT
/begin MEASUREMENT DFC_st.DFC_MOXEMM_SMU_ALM8_2 "" UBYTE DFC_OneToOne 1 100 0.00 255.0 FORMAT "%5.1" ECU_ADDRESS 0x60034D3B /end MEASUREMENT
/begin MEASUREMENT DFC_st.DFC_MOXEMM_SMU_ALM8_3 "" UBYTE DFC_OneToOne 1 100 0.00 255.0 FORMAT "%5.1" ECU_ADDRESS 0x60034D3C /end MEASUREMENT
/begin MEASUREMENT DFC_st.DFC_MOXEMM_SMU_ALM8_31 "" UBYTE DFC_OneToOne 1 100 0.00 255.0 FORMAT "%5.1" ECU_ADDRESS 0x60034D3D /end MEASUREMENT
/begin MEASUREMENT DFC_st.DFC_MOXEMM_SMU_ALM8_4 "" UBYTE DFC_OneToOne 1 100 0.00 255.0 FORMAT "%5.1" ECU_ADDRESS 0x60034D3E /end MEASUREMENT
/begin MEASUREMENT DFC_st.DFC_MOXEMM_SMU_ALM9_0 "" UBYTE DFC_OneToOne 1 100 0.00 255.0 FORMAT "%5.1" ECU_ADDRESS 0x60034D3F /end MEASUREMENT
/begin MEASUREMENT DFC_st.DFC_MOXEMM_SMU_ALM9_15 "" UBYTE DFC_OneToOne 1 100 0.00 255.0 FORMAT "%5.1" ECU_ADDRESS 0x60034D40 /end MEASUREMENT
/begin MEASUREMENT DFC_st.DFC_MOXEMM_SMU_ALM9_3 "" UBYTE DFC_OneToOne 1 100 0.00 255.0 FORMAT "%5.1" ECU_ADDRESS 0x60034D41 /end MEASUREMENT
/begin MEASUREMENT DFC_st.DFC_MoSysCtrlReIni "" UBYTE DFC_OneToOne 1 100 0.00 255.0 FORMAT "%5.1" ECU_ADDRESS 0x60034D5C /end MEASUREMENT
/begin MEASUREMENT DFC_st.DFC_MoXEMMHwLTMCUFW "" UBYTE DFC_OneToOne 1 100 0.00 255.0 FORMAT "%5.1" ECU_ADDRESS 0x60034D5D /end MEASUREMENT
/begin MEASUREMENT DFC_st.DFC_MoXEMMHwLTMonBIST "" UBYTE DFC_OneToOne 1 100 0.00 255.0 FORMAT "%5.1" ECU_ADDRESS 0x60034D5E /end MEASUREMENT
/begin MEASUREMENT DFC_st.DFC_MoXEMMHwLTRegMonTest "" UBYTE DFC_OneToOne 1 100 0.00 255.0 FORMAT "%5.1" ECU_ADDRESS 0x60034D5F /end MEASUREMENT
/begin MEASUREMENT DFC_st.DFC_MoXEMMHwLTStbySMUAlvTest "" UBYTE DFC_OneToOne 1 100 0.00 255.0 FORMAT "%5.1" ECU_ADDRESS 0x60034D60 /end MEASUREMENT
/begin MEASUREMENT DFC_st.DFC_MoXEMMHwLTTempSens "" UBYTE DFC_OneToOne 1 100 0.00 255.0 FORMAT "%5.1" ECU_ADDRESS 0x60034D61 /end MEASUREMENT
/begin MEASUREMENT DFC_st.DFC_MoXEMMHwLTUCBCfg "" UBYTE DFC_OneToOne 1 100 0.00 255.0 FORMAT "%5.1" ECU_ADDRESS 0x60034D62 /end MEASUREMENT
/begin MEASUREMENT DFC_st.DFC_OCWDAABEActv "" UBYTE DFC_OneToOne 1 100 0.00 255.0 FORMAT "%5.1" ECU_ADDRESS 0x60034D78 /end MEASUREMENT
/begin MEASUREMENT DFC_st.DFC_OCWDACom "" UBYTE DFC_OneToOne 1 100 0.00 255.0 FORMAT "%5.1" ECU_ADDRESS 0x60034D79 /end MEASUREMENT
/begin MEASUREMENT DFC_st.DFC_OCWDAErrPin "" UBYTE DFC_OneToOne 1 100 0.00 255.0 FORMAT "%5.1" ECU_ADDRESS 0x60034D7A /end MEASUREMENT
/begin MEASUREMENT DFC_st.DFC_OCWDAOvrVltg "" UBYTE DFC_OneToOne 1 100 0.00 255.0 FORMAT "%5.1" ECU_ADDRESS 0x60034D7B /end MEASUREMENT
/begin MEASUREMENT DFC_st.DFC_PwmCtPTmpErr "" UBYTE DFC_OneToOne 1 100 0.00 255.0 FORMAT "%5.1" ECU_ADDRESS 0x60034D7D /end MEASUREMENT
/begin MEASUREMENT DINH_nrActvInhReas.FId_PwmCtPFrzVal "" UWORD DINH_ct_Compu 1 100 -4095.000 4096.000 BIT_MASK 0x1fff FORMAT "%8.3" ECU_ADDRESS 0x60021520 /end MEASUREMENT
/begin MEASUREMENT DINH_nrActvInhReas.FId_PwmCtPPhysRng "" UWORD DINH_ct_Compu 1 100 -4095.000 4096.000 BIT_MASK 0x1fff FORMAT "%8.3" ECU_ADDRESS 0x60021522 /end MEASUREMENT
/begin MEASUREMENT DINH_nrActvInhReas.FId_PwmCtPRplVal "" UWORD DINH_ct_Compu 1 100 -4095.000 4096.000 BIT_MASK 0x1fff FORMAT "%8.3" ECU_ADDRESS 0x60021524 /end MEASUREMENT
/begin MEASUREMENT DINH_nrActvInhReas.FId_PwmCtPSSpMon "" UWORD DINH_ct_Compu 1 100 -4095.000 4096.000 BIT_MASK 0x1fff FORMAT "%8.3" ECU_ADDRESS 0x60021526 /end MEASUREMENT
/begin MEASUREMENT DINH_nrActvInhReas.FId_PwmCtPTmpErrCnt "" UWORD DINH_ct_Compu 1 100 -4095.000 4096.000 BIT_MASK 0x1fff FORMAT "%8.3" ECU_ADDRESS 0x60021528 /end MEASUREMENT
/begin MEASUREMENT DINH_stFId.FId_PwmCtPFrzVal "" UWORD DFC_OneToOne 1 100 0.00 65535.00 FORMAT "%8.2" ECU_ADDRESS 0x60021520 /end MEASUREMENT
/begin MEASUREMENT DINH_stFId.FId_PwmCtPPhysRng "" UWORD DFC_OneToOne 1 100 0.00 65535.00 FORMAT "%8.2" ECU_ADDRESS 0x60021522 /end MEASUREMENT
/begin MEASUREMENT DINH_stFId.FId_PwmCtPRplVal "" UWORD DFC_OneToOne 1 100 0.00 65535.00 FORMAT "%8.2" ECU_ADDRESS 0x60021524 /end MEASUREMENT
/begin MEASUREMENT DINH_stFId.FId_PwmCtPSSpMon "" UWORD DFC_OneToOne 1 100 0.00 65535.00 FORMAT "%8.2" ECU_ADDRESS 0x60021526 /end MEASUREMENT
/begin MEASUREMENT DINH_stFId.FId_PwmCtPTmpErrCnt "" UWORD DFC_OneToOne 1 100 0.00 65535.00 FORMAT "%8.2" ECU_ADDRESS 0x60021528 /end MEASUREMENT
/begin MEASUREMENT MoAdap_bbOut1Cpl "Complement of MoAdap_bbOut1" UBYTE OneToOne 1 100 0.00 255.0 FORMAT "%5.1" ECU_ADDRESS 0x6002B8E8 /end MEASUREMENT
/begin MEASUREMENT MoAdap_bbOut2Cpl "complement bitbase for MoAdp" UBYTE OneToOne 1 100 0.00 255.0 FORMAT "%5.1" ECU_ADDRESS 0x6002B8E7 /end MEASUREMENT
/begin MEASUREMENT MoAdap_bbOutCpl "Double storage for MoAdap_bbOut" UBYTE OneToOne 1 100 0.00 255.0 FORMAT "%5.1" ECU_ADDRESS 0x6002B8E6 /end MEASUREMENT
/begin MEASUREMENT MoCMem_vblStructCpl_Core1_10ms_Nr1.MoCMem_ctDebErrChkRAMOld "Instance for specific core and task / Old value of counter how often the threshold for MaxValueIndicator for double storage and cyclic RAM-Test is exeeded" UBYTE OneToOne 1 100 0.00 255.0 FORMAT "%5.1" ECU_ADDRESS 0x6002C234 /end MEASUREMENT
/begin MEASUREMENT MoCMem_vblStructCpl_Core1_10ms_Nr1.MoCMem_ctDebErrChkRAMCpl "Instance for specific core and task / RAM data redundancy for MoCMem_ctDebErrChkRAM" UBYTE OneToOne 1 100 0.00 255.0 FORMAT "%5.1" ECU_ADDRESS 0x6002C235 /end MEASUREMENT
/begin MEASUREMENT MoCMem_vblStructCpl_Core1_10ms_Nr1.MoCMem_ctDebHealChkRAMCpl "Instance for specific core and task / complement of the error healing counter for double storage and cyclical RAM-test" UWORD OneToOne 1 100 0.00 65535.00 FORMAT "%8.2" ECU_ADDRESS 0x6002C236 /end MEASUREMENT
/begin MEASUREMENT MoCMem_vblStructCpl_Core1_10ms_Nr1.MoCMem_nrRamChkCpl "Instance for specific core and task / complement of the number of words to be tested on the cyclic RAM check" UWORD OneToOne 1 100 0.00 65535.00 FORMAT "%8.2" ECU_ADDRESS 0x6002C238 /end MEASUREMENT
/begin MEASUREMENT MoCMem_vblStructCpl_Core1_10ms_Nr1.MoCMem_nrStckChkCpl "Instance for specific core and task / Complement of the number of bytes to be checked on each call of the cyclic stack check" ULONG OneToOne 1 100 0.00 4294967295.00 FORMAT "%13.2" ECU_ADDRESS 0x6002C23C /end MEASUREMENT
/begin MEASUREMENT MoCMem_vblStructCpl_Core1_10ms_Nr1.MoCMem_nrCSAChkCpl "Instance for specific core and task / Complement of the number of bytes to be checked on each call of the cyclic CSA check" ULONG OneToOne 1 100 0.00 4294967295.00 FORMAT "%13.2" ECU_ADDRESS 0x6002C240 /end MEASUREMENT
/begin MEASUREMENT MoCMem_vblStructCpl_Core1_10ms_Nr1.MoCMem_RamOffsetPtrCpl "Instance for specific core and task / duplicate storage of MoCMem_RamOffsetPtr" ULONG OneToOne 1 100 0.00 4294967295.00 FORMAT "%13.2" ECU_ADDRESS 0x6002C244 /end MEASUREMENT
/begin MEASUREMENT MoCMem_vblStructCpl_Core1_10ms_Nr1.MoCMem_CSAOffsetPtrCpl "Instance for specific core and task / Complement of CSA start address of the current CSA cyclic check complements" ULONG OneToOne 1 100 0.00 4294967295.00 FORMAT "%13.2" ECU_ADDRESS 0x6002C24C /end MEASUREMENT
/begin MEASUREMENT MoCMem_vblStructCpl_Core1_10ms_Nr1.MoCMem_StckOffsetPtrCpl "Instance for specific core and task / Complement of the stack start address of the current stck cyclic check" ULONG OneToOne 1 100 0.00 4294967295.00 FORMAT "%13.2" ECU_ADDRESS 0x6002C248 /end MEASUREMENT
/begin MEASUREMENT MoCMem_vblStructCpl_Core1_10ms_Nr1.Mo_RamCyclicCheckCpl "Instance for specific core and task / not used" ULONG OneToOne 1 100 0.00 4294967295.00 FORMAT "%13.2" ECU_ADDRESS 0x6002C250 /end MEASUREMENT
/begin MEASUREMENT MoCMem_vblStructCpl_Core1_10ms_Nr1.MoCMem_ctLrnRAMCpl "Instance for specific core and task / Complement of the counter for the learn process of the RAM check" UBYTE OneToOne 1 100 0.00 255.0 FORMAT "%5.1" ECU_ADDRESS 0x6002C254 /end MEASUREMENT
/begin MEASUREMENT MoCMem_vblStructCpl_Core1_10ms_Nr1.MoCMem_tiRAMusOldCpl "Instance for specific core and task / complement of the old time stamp of the cyclic RAM check" ULONG OneToOne 1 100 0.00 4294967295.00 FORMAT "%13.2" ECU_ADDRESS 0x6002C258 /end MEASUREMENT
/begin MEASUREMENT MoCMem_vblStructCpl_Core1_10ms_Nr1.MoCMem_tiRAMAccusCpl "Instance for specific core and task / complement of the sum of the time intervals between calls to the cyclic RAM check" ULONG OneToOne 1 100 0.00 4294967295.00 FORMAT "%13.2" ECU_ADDRESS 0x6002C260 /end MEASUREMENT
/begin MEASUREMENT MoCMem_vblStructCpl_Core1_10ms_Nr1.MoCMem_tiRAMusCpl "Instance for specific core and task / complement of the time stamp of the cyclic RAM check" ULONG OneToOne 1 100 0.00 4294967295.00 FORMAT "%13.2" ECU_ADDRESS 0x6002C25C /end MEASUREMENT
/begin MEASUREMENT MoCMem_vblStructCpl_Core1_10ms_Nr1.MoCMem_ctLrnErrHdlrCpl "Instance for specific core and task / Complement of the counter of the learn process for the error handler" UBYTE OneToOne 1 100 0.00 255.0 FORMAT "%5.1" ECU_ADDRESS 0x6002C264 /end MEASUREMENT
/begin MEASUREMENT MoCMem_vblStructCpl_Core1_10ms_Nr1.MoCMem_tiErrHdlrusOldCpl "Instance for specific core and task / Complement of the previous time stamp for the error handler" ULONG OneToOne 1 100 0.00 4294967295.00 FORMAT "%13.2" ECU_ADDRESS 0x6002C26C /end MEASUREMENT
/begin MEASUREMENT MoCMem_vblStructCpl_Core1_10ms_Nr1.MoCMem_tiErrHdlrusCpl "Instance for specific core and task / Complement of the current time stamp for the error handler" ULONG OneToOne 1 100 0.00 4294967295.00 FORMAT "%13.2" ECU_ADDRESS 0x6002C268 /end MEASUREMENT
/begin MEASUREMENT MoCMem_vblStructCpl_Core1_10ms_Nr1.MoCMem_tiErrHdlrAccusCpl "Instance for specific core and task / Complement of the sums of the intervals between calls for the error handler" ULONG OneToOne 1 100 0.00 4294967295.00 FORMAT "%13.2" ECU_ADDRESS 0x6002C270 /end MEASUREMENT
/begin MEASUREMENT MoCMem_vblStructCpl_Core1_10ms_Nr1.MoCMem_numHealFacCpl "Instance for specific core and task / Complement of the compensation factor for the healing counter" UBYTE OneToOne 1 100 0.00 255.0 FORMAT "%5.1" ECU_ADDRESS 0x6002C274 /end MEASUREMENT
/begin MEASUREMENT MoCMem_vblStructEarlyClearedRAM_Core1_10ms_Nr1.MoCMem_st "Instance for specific core and task / Request of a complete memory test during initialisation; status of complete ROM test" UBYTE OneToOne 1 100 0.00 255.0 FORMAT "%5.1" ECU_ADDRESS 0x70039B90 /end MEASUREMENT
/begin MEASUREMENT MoCMem_vblStructEarlyClearedRAM_Core1_10ms_Nr1.MoCMem_stCpl "Instance for specific core and task / Double storage for request of complete RAMROM-memory checks during initialization" UBYTE OneToOne 1 100 0.00 255.0 FORMAT "%5.1" ECU_ADDRESS 0x70039B91 /end MEASUREMENT
/begin MEASUREMENT MoCMem_vblStructNVRAM_Core1_10ms_Nr1.MoCMem_ctDebErrChkRAMMaxNv "Instance for specific core and task / MaxValueIndicator for double storage and cyclic RAM-Test" UBYTE OneToOne 1 100 0.00 255.0 FORMAT "%5.1" ECU_ADDRESS 0x6003605E /end MEASUREMENT
/begin MEASUREMENT MoCMem_vblStructNVRAM_Core1_10ms_Nr1.MoCMem_ctDebErrChkRAMExcddThdNv "Instance for specific core and task / Counter how often the threshold for MaxValueIndicator for double storage and cyclic RAM-Test is exeeded" UBYTE OneToOne 1 100 0.00 255.0 FORMAT "%5.1" ECU_ADDRESS 0x6003605F /end MEASUREMENT
/begin MEASUREMENT MoCMem_vblStruct_Core1_10ms_Nr1.MoCMem_ctDebErrChkRAM "Instance for specific core and task / error debounce counter for double storage and cyclical RAM-test" UBYTE OneToOne 1 100 0.00 255.0 FORMAT "%5.1" ECU_ADDRESS 0x6002CF00 /end MEASUREMENT
/begin MEASUREMENT MoCMem_vblStruct_Core1_10ms_Nr1.MoCMem_ctDebHealChkRAM "Instance for specific core and task / error healing counter for double storage and cyclical RAM-test" UWORD OneToOne 1 100 0.00 65535.00 FORMAT "%8.2" ECU_ADDRESS 0x6002CF02 /end MEASUREMENT
/begin MEASUREMENT MoCMem_vblStruct_Core1_10ms_Nr1.MoCMem_nrRamChkSize "Instance for specific core and task / Memory size in Byte that is tested in the cyclic RAM check" ULONG OneToOne 1 100 0.00 4294967295.00 FORMAT "%13.2" ECU_ADDRESS 0x6002CF04 /end MEASUREMENT
/begin MEASUREMENT MoCMem_vblStruct_Core1_10ms_Nr1.MoCMem_adrChkStckEnd "Instance for specific core and task / End address of the current tested stack memory" ULONG OneToOne 1 100 0.00 4294967295.00 FORMAT "%13.2" ECU_ADDRESS 0x6002CF0C /end MEASUREMENT
/begin MEASUREMENT MoCMem_vblStruct_Core1_10ms_Nr1.MoCMem_adrChkStckStrt "Instance for specific core and task / Start address of the current tested stack memory" ULONG OneToOne 1 100 0.00 4294967295.00 FORMAT "%13.2" ECU_ADDRESS 0x6002CF08 /end MEASUREMENT
/begin MEASUREMENT MoCMem_vblStruct_Core1_10ms_Nr1.MoCMem_adrChkCSAStrt "Instance for specific core and task / Start address of the current tested CSA region" ULONG OneToOne 1 100 0.00 4294967295.00 FORMAT "%13.2" ECU_ADDRESS 0x6002CF10 /end MEASUREMENT
/begin MEASUREMENT MoCMem_vblStruct_Core1_10ms_Nr1.MoCMem_adrChkCSAEnd "Instance for specific core and task / End address of the current tested CSA region" ULONG OneToOne 1 100 0.00 4294967295.00 FORMAT "%13.2" ECU_ADDRESS 0x6002CF14 /end MEASUREMENT
/begin MEASUREMENT MoCMem_vblStruct_Core1_10ms_Nr1.MoCMem_nrRamChk "Instance for specific core and task / Number of 32-bit memory cells to be tested in cyclical RAM check" UWORD OneToOne 1 100 0.00 65535.00 FORMAT "%8.2" ECU_ADDRESS 0x6002CF18 /end MEASUREMENT
/begin MEASUREMENT MoCMem_vblStruct_Core1_10ms_Nr1.MoCMem_nrStckChk "Instance for specific core and task / Number of bytes to be checked on each call of the cyclic stack check" ULONG OneToOne 1 100 0.00 4294967295.00 FORMAT "%13.2" ECU_ADDRESS 0x6002CF1C /end MEASUREMENT
/begin MEASUREMENT MoCMem_vblStruct_Core1_10ms_Nr1.MoCMem_nrCSAChk "Instance for specific core and task / Number of bytes to be checked on each call of the cyclic CSA check" ULONG OneToOne 1 100 0.00 4294967295.00 FORMAT "%13.2" ECU_ADDRESS 0x6002CF20 /end MEASUREMENT
/begin MEASUREMENT MoCMem_vblStruct_Core1_10ms_Nr1.MoCMem_StckOffsetPtr "Instance for specific core and task / Stack start address of the current stck cyclic check" ULONG OneToOne 1 100 0.00 4294967295.00 FORMAT "%13.2" ECU_ADDRESS 0x6002CF24 /end MEASUREMENT
/begin MEASUREMENT MoCMem_vblStruct_Core1_10ms_Nr1.MoCMem_CSAOffsetPtr "Instance for specific core and task / CSA start address of the current CSA cyclic check" ULONG OneToOne 1 100 0.00 4294967295.00 FORMAT "%13.2" ECU_ADDRESS 0x6002CF28 /end MEASUREMENT
/begin MEASUREMENT MoCMem_vblStruct_Core1_10ms_Nr1.MoCMem_adrChkStckSP "Instance for specific core and task / current test cycle start address of the stack region to be tested" ULONG OneToOne 1 100 0.00 4294967295.00 FORMAT "%13.2" ECU_ADDRESS 0x6002CF2C /end MEASUREMENT
/begin MEASUREMENT MoCMem_vblStruct_Core1_10ms_Nr1.MoCMem_RamOffsetPtr "Instance for specific core and task / pointer with the address for the cyclic checked RAM area which should be checkt at the next cyclic call of the cyclic RAM check" ULONG OneToOne 1 100 0.00 4294967295.00 FORMAT "%13.2" ECU_ADDRESS 0x6002CF30 /end MEASUREMENT
/begin MEASUREMENT MoCMem_vblStruct_Core1_10ms_Nr1.MoCMem_ChkRAMStck "Instance for specific core and task / temporary stack used during cyclic stack check" ULONG OneToOne 1 100 0.00 4294967295.00 FORMAT "%13.2" MATRIX_DIM 80 ECU_ADDRESS 0x6002CF34 /end MEASUREMENT
/begin MEASUREMENT MoCMem_vblStruct_Core1_10ms_Nr1.MoCMem_ctLrnRAM "Instance for specific core and task / Counter for the learn process of the RAM check" UBYTE OneToOne 1 100 0.00 255.0 FORMAT "%5.1" ECU_ADDRESS 0x6002D074 /end MEASUREMENT
/begin MEASUREMENT MoCMem_vblStruct_Core1_10ms_Nr1.MoCMem_tiRAMus "Instance for specific core and task / time stamp of the cyclic RAM check" ULONG OneToOne 1 100 0.00 4294967295.00 FORMAT "%13.2" ECU_ADDRESS 0x6002D07C /end MEASUREMENT
/begin MEASUREMENT MoCMem_vblStruct_Core1_10ms_Nr1.MoCMem_tiRAMusOld "Instance for specific core and task / old time stamp of the cyclic RAM check" ULONG OneToOne 1 100 0.00 4294967295.00 FORMAT "%13.2" ECU_ADDRESS 0x6002D078 /end MEASUREMENT
/begin MEASUREMENT MoCMem_vblStruct_Core1_10ms_Nr1.MoCMem_tiRAMAccus "Instance for specific core and task / sum of the time intervals between calls to the cyclic RAM check" ULONG OneToOne 1 100 0.00 4294967295.00 FORMAT "%13.2" ECU_ADDRESS 0x6002D080 /end MEASUREMENT
/begin MEASUREMENT MoCMem_vblStruct_Core1_10ms_Nr1.MoCMem_ctLrnErrHdlr "Instance for specific core and task / Counter of the learn process for the error handler" UBYTE OneToOne 1 100 0.00 255.0 FORMAT "%5.1" ECU_ADDRESS 0x6002D084 /end MEASUREMENT
/begin MEASUREMENT MoCMem_vblStruct_Core1_10ms_Nr1.MoCMem_tiErrHdlrusOld "Instance for specific core and task / Previous time stamp for the error handler" ULONG OneToOne 1 100 0.00 4294967295.00 FORMAT "%13.2" ECU_ADDRESS 0x6002D088 /end MEASUREMENT
/begin MEASUREMENT MoCMem_vblStruct_Core1_10ms_Nr1.MoCMem_tiErrHdlrus "Instance for specific core and task / Current time stamp for the error handler" ULONG OneToOne 1 100 0.00 4294967295.00 FORMAT "%13.2" ECU_ADDRESS 0x6002D08C /end MEASUREMENT
/begin MEASUREMENT MoCMem_vblStruct_Core1_10ms_Nr1.MoCMem_tiErrHdlrAccus "Instance for specific core and task / Sum of the intervals between calls for the error handler" ULONG OneToOne 1 100 0.00 4294967295.00 FORMAT "%13.2" ECU_ADDRESS 0x6002D090 /end MEASUREMENT
/begin MEASUREMENT MoCMem_vblStruct_Core1_10ms_Nr1.MoCMem_numHealFac "Instance for specific core and task / Compensation factor for the healing counter" UBYTE OneToOne 1 100 0.00 255.0 FORMAT "%5.1" ECU_ADDRESS 0x6002D094 /end MEASUREMENT
/begin MEASUREMENT MoConf_stErr "" UBYTE OneToOne 1 100 0.00 255.0 FORMAT "%5.1" ECU_ADDRESS 0x6002B898
 /begin IF_DATA XCPplus 0x0102
  /begin DAQ_EVENT VARIABLE /end DAQ_EVENT
 /end IF_DATA
/end MEASUREMENT
/begin MEASUREMENT MoCPFC_vblStructCpl_Core1_10ms_Nr1.MoCPFC_cntr "Instance for specific core and task / Module call counter" UBYTE OneToOne 1 100 0.00 255.0 FORMAT "%5.1" ECU_ADDRESS 0x6002C1F4 /end MEASUREMENT
/begin MEASUREMENT MoCPFC_vblStructCpl_Core1_10ms_Nr1.MoCPFC_numChkword "Instance for specific core and task / Module specific checkword" ULONG OneToOne 1 100 0.00 4294967295.00 FORMAT "%13.2" ECU_ADDRESS 0x6002C1F8 /end MEASUREMENT
/begin MEASUREMENT MoCPFC_vblStructCpl_Core1_10ms_Nr1.MoCPFC_numChks "Instance for specific core and task / Module specific total CRC checksum (from MISR algorithm)" ULONG OneToOne 1 100 0.00 4294967295.00 FORMAT "%13.2" ECU_ADDRESS 0x6002C1FC /end MEASUREMENT
/begin MEASUREMENT MoCPFC_vblStructCpl_Core1_10ms_Nr1.MoCPFC_numConCatVal "Instance for specific core and task / Task-core combination specific concatenated value" ULONG OneToOne 1 100 0.00 4294967295.00 FORMAT "%13.2" ECU_ADDRESS 0x6002C200 /end MEASUREMENT
/begin MEASUREMENT MoCPFC_vblStructCpl_Core1_10ms_Nr1.MoCPFC_cntrRollg "Instance for specific core and task / Task-core combination specific Rolling counter" ULONG OneToOne 1 100 0.00 4294967295.00 FORMAT "%13.2" ECU_ADDRESS 0x6002C204 /end MEASUREMENT
/begin MEASUREMENT MoCPFC_vblStructCpl_Core1_10ms_Nr1.MoCPFC_aryRingBuf "Instance for specific core and task / Task-core combination specific Ring Buffer" ULONG OneToOne 1 100 0.00 4294967295.00 FORMAT "%13.2" MATRIX_DIM 6 ECU_ADDRESS 0x6002C208 /end MEASUREMENT
/begin MEASUREMENT MoCPFC_vblStructCpl_Core1_10ms_Nr1.MoCPFC_stWrErr "Instance for specific core and task / Status of task-core combination specific ring buffer full error" UBYTE OneToOne 1 100 0.00 255.0 FORMAT "%5.1" ECU_ADDRESS 0x6002C220 /end MEASUREMENT
/begin MEASUREMENT MoCPFC_vblStructCpl_Core1_10ms_Nr1.MoCPFC_RingBuf_pst.startAdr "Instance for specific core and task / Structure holding task-core combination specific Ring Buffer properties / start address of Ring buffer" ULONG default 1 100 0.00 4294967295.00 FORMAT "%13.2" ECU_ADDRESS 0x6002C224 /end MEASUREMENT
/begin MEASUREMENT MoCPFC_vblStructCpl_Core1_10ms_Nr1.MoCPFC_RingBuf_pst.size "Instance for specific core and task / Structure holding task-core combination specific Ring Buffer properties / maximum number of elements in the buffer" UBYTE OneToOne 1 100 0.00 255.0 FORMAT "%5.1" ECU_ADDRESS 0x6002C228 /end MEASUREMENT
/begin MEASUREMENT MoCPFC_vblStructCpl_Core1_10ms_Nr1.MoCPFC_RingBuf_pst.head "Instance for specific core and task / Structure holding task-core combination specific Ring Buffer properties / pointer to head of the ring buffer" ULONG default 1 100 0.00 4294967295.00 FORMAT "%13.2" ECU_ADDRESS 0x6002C22C /end MEASUREMENT
/begin MEASUREMENT MoCPFC_vblStructCpl_Core1_10ms_Nr1.MoCPFC_RingBuf_pst.tail "Instance for specific core and task / Structure holding task-core combination specific Ring Buffer properties / pointer to head of the ring buffer" ULONG default 1 100 0.00 4294967295.00 FORMAT "%13.2" ECU_ADDRESS 0x6002C230 /end MEASUREMENT
/begin MEASUREMENT MoCSCC_varStructCpl_Core1_10ms_Nr1.MoCSCC_stChpIdCpl "Instance for specific core and task / Complement of CPU version" ULONG OneToOne 1 100 0.00 4294967295.00 FORMAT "%13.2" ECU_ADDRESS 0x6002C1EC /end MEASUREMENT
/begin MEASUREMENT MoCSCC_varStructCpl_Core1_10ms_Nr1.MoCSCC_cntrDebCpl "Instance for specific core and task / Complement of debounce counter for configuration check error" UBYTE OneToOne 1 100 0.00 255.0 FORMAT "%5.1" ECU_ADDRESS 0x6002C1F0 /end MEASUREMENT
/begin MEASUREMENT MoCSCC_varStructCpl_Core1_10ms_Nr1.MoCSCC_stTrmDevCpl "Instance for specific core and task / Complement of trimmed device" UBYTE OneToOne 1 100 0.00 255.0 FORMAT "%5.1" ECU_ADDRESS 0x6002C1F1 /end MEASUREMENT
/begin MEASUREMENT MoCSCC_varStructCpl_Core1_10ms_Nr1.MoCSCC_cntrMPURegChkCpl "Instance for specific core and task / Complement of counter of MPU registers to be checked" UBYTE OneToOne 1 100 0.00 255.0 FORMAT "%5.1" ECU_ADDRESS 0x6002C1F2 /end MEASUREMENT
/begin MEASUREMENT MoCSCC_varStructNVRAM_Core1_10ms_Nr1.MoCSCC_cntrDebMaxNv "Instance for specific core and task / Max value indicator for error debounce counter of configuration check error" UBYTE OneToOne 1 100 0.00 255.0 FORMAT "%5.1" ECU_ADDRESS 0x6003605A /end MEASUREMENT
/begin MEASUREMENT MoCSCC_varStructNVRAM_Core1_10ms_Nr1.MoCSCC_cntrDebExcddThdNv "Instance for specific core and task / Counter to store the number of times error debounce counter of configuration check error exceeds the threshold value" UBYTE OneToOne 1 100 0.00 255.0 FORMAT "%5.1" ECU_ADDRESS 0x6003605B /end MEASUREMENT
/begin MEASUREMENT MoCSCC_varStructNVRAM_Core1_10ms_Nr1.MoCSCC_cntrDebOld "Instance for specific core and task / Counter to store the old value of error debounce counter of configuration check error" UBYTE OneToOne 1 100 0.00 255.0 FORMAT "%5.1" ECU_ADDRESS 0x6003605C /end MEASUREMENT
/begin MEASUREMENT MoCSCC_varStruct_Core1_10ms_Nr1.MoCSCC_stErr "Instance for specific core and task / Status word to report configuration check error" UWORD OneToOne 1 100 0.00 65535.00 FORMAT "%8.2" ECU_ADDRESS 0x6002CEF4 /end MEASUREMENT
/begin MEASUREMENT MoCSCC_varStruct_Core1_10ms_Nr1.MoCSCC_cntrDeb "Instance for specific core and task / Debounce counter for configuration check error" UBYTE OneToOne 1 100 0.00 255.0 FORMAT "%5.1" ECU_ADDRESS 0x6002CEF6 /end MEASUREMENT
/begin MEASUREMENT MoCSCC_varStruct_Core1_10ms_Nr1.MoCSCC_stTrmDev "Instance for specific core and task / Trimmed device" UBYTE OneToOne 1 100 0.00 255.0 FORMAT "%5.1" ECU_ADDRESS 0x6002CEF7 /end MEASUREMENT
/begin MEASUREMENT MoCSCC_varStruct_Core1_10ms_Nr1.MoCSCC_stChpId "Instance for specific core and task / Cpu version" ULONG OneToOne 1 100 0.00 4294967295.00 FORMAT "%13.2" ECU_ADDRESS 0x6002CEF8 /end MEASUREMENT
/begin MEASUREMENT MoCSCC_varStruct_Core1_10ms_Nr1.MoCSCC_cntrMPURegChk "Instance for specific core and task / Counter of MPU registers to be checked" UBYTE OneToOne 1 100 0.00 255.0 FORMAT "%5.1" ECU_ADDRESS 0x6002CEFC /end MEASUREMENT
/begin MEASUREMENT MoExe_varStructCpl_Core1_10ms_Nr1.MoExe_ctCycCpl "Instance for specific core and task / Instance for specific core and task" UBYTE OneToOne 1 100 0.00 255.0 FORMAT "%5.1" ECU_ADDRESS 0x6002C1E8 /end MEASUREMENT
/begin MEASUREMENT MoExe_varStruct_Core1_10ms_Nr1.MoExe_ctCyc "Instance for specific core and task / Instance structure for MoExe_Co scheduling counter" UBYTE OneToOne 1 100 0.00 255.0 FORMAT "%5.1" ECU_ADDRESS 0x6002CEF1 /end MEASUREMENT
/begin MEASUREMENT MoFFrm_flgDecTqDmdActv "ESC indicates that a decreasing torque demand is active" UBYTE B_TRUE 1 100 0.00 1.00000000000 BIT_MASK 0x40 FORMAT "%13.11" ECU_ADDRESS 0x6002C304
 /begin IF_DATA XCPplus 0x0102
  /begin DAQ_EVENT VARIABLE /end DAQ_EVENT
 /end IF_DATA
/end MEASUREMENT
/begin MEASUREMENT MoFFrm_flgDecTqDmdEM02Actv "ESC indicates that a decreasing torque demand is active for secondary axle" UBYTE B_TRUE 1 100 0.00 1.00000000000 BIT_MASK 0x8 FORMAT "%13.11" ECU_ADDRESS 0x6002C303
 /begin IF_DATA XCPplus 0x0102
  /begin DAQ_EVENT VARIABLE /end DAQ_EVENT
 /end IF_DATA
/end MEASUREMENT
/begin MEASUREMENT MoFFrm_flgIncTqDmdActv "ESC indicates that an increasing torque demand is active" UBYTE B_TRUE 1 100 0.00 1.00000000000 BIT_MASK 0x20 FORMAT "%13.11" ECU_ADDRESS 0x6002C304
 /begin IF_DATA XCPplus 0x0102
  /begin DAQ_EVENT VARIABLE /end DAQ_EVENT
 /end IF_DATA
/end MEASUREMENT
/begin MEASUREMENT MoFFrm_flgIncTqDmdEM02Actv "ESC indicates that an increasing torque demand is active for secondary axle" UBYTE B_TRUE 1 100 0.00 1.00000000000 BIT_MASK 0x10 FORMAT "%13.11" ECU_ADDRESS 0x6002C303
 /begin IF_DATA XCPplus 0x0102
  /begin DAQ_EVENT VARIABLE /end DAQ_EVENT
 /end IF_DATA
/end MEASUREMENT
/begin MEASUREMENT MoFFrm_flgRecupInhbnReq "Status of recuperation inhibit request from ESP" UBYTE B_TRUE 1 100 0.00 1.00000000000 BIT_MASK 0x1 FORMAT "%13.11" ECU_ADDRESS 0x6002C303
 /begin IF_DATA XCPplus 0x0102
  /begin DAQ_EVENT VARIABLE /end DAQ_EVENT
 /end IF_DATA
/end MEASUREMENT
/begin MEASUREMENT MoFFrm_nEm02CANRaw "Raw speed from CAN for E-Machine 02" SWORD nmot_q1 1 100 -32768.00 32767.00 FORMAT "%8.2" ECU_ADDRESS 0x6002C2EE
 /begin IF_DATA XCPplus 0x0102
  /begin DAQ_EVENT VARIABLE /end DAQ_EVENT
 /end IF_DATA
/end MEASUREMENT
/begin MEASUREMENT MoFFrm_nEm02CANRawQlfr "CAN Qualifier for speed of E-Machine 02" UBYTE OneToOne 1 100 0.00 255.0 FORMAT "%5.1" ECU_ADDRESS 0x6002C302
 /begin IF_DATA XCPplus 0x0102
  /begin DAQ_EVENT VARIABLE /end DAQ_EVENT
 /end IF_DATA
/end MEASUREMENT
/begin MEASUREMENT MoFFrm_tqDecTqDmd "decreasing torque demand from brake controller" SLONG TrqPrpHigh 1 100 -214748364.800 214748364.700 FORMAT "%13.3" ECU_ADDRESS 0x6002C2FC
 /begin IF_DATA XCPplus 0x0102
  /begin DAQ_EVENT VARIABLE /end DAQ_EVENT
 /end IF_DATA
/end MEASUREMENT
/begin MEASUREMENT MoFFrm_tqDecTqDmdEM02 "decreasing torque demand from brake controller for secondary axle" SLONG TrqPrpHigh 1 100 -214748364.800 214748364.700 FORMAT "%13.3" ECU_ADDRESS 0x6002C2F8
 /begin IF_DATA XCPplus 0x0102
  /begin DAQ_EVENT VARIABLE /end DAQ_EVENT
 /end IF_DATA
/end MEASUREMENT
/begin MEASUREMENT MoFFrm_tqIncTqDmd "increasing torque demand from brake controller" SLONG TrqPrpHigh 1 100 -214748364.800 214748364.700 FORMAT "%13.3" ECU_ADDRESS 0x6002C2F4
 /begin IF_DATA XCPplus 0x0102
  /begin DAQ_EVENT VARIABLE /end DAQ_EVENT
 /end IF_DATA
/end MEASUREMENT
/begin MEASUREMENT MoFFrm_tqIncTqDmdEM02 "increasing torque demand from brake controller for secondary axle" SLONG TrqPrpHigh 1 100 -214748364.800 214748364.700 FORMAT "%13.3" ECU_ADDRESS 0x6002C2F0
 /begin IF_DATA XCPplus 0x0102
  /begin DAQ_EVENT VARIABLE /end DAQ_EVENT
 /end IF_DATA
/end MEASUREMENT
/begin MEASUREMENT MoFFrm_tqIncTqDmdEM02Qlfr "signal qualifier for increasing brake torque for secondary axle" UBYTE OneToOne 1 100 0.00 255.0 FORMAT "%5.1" ECU_ADDRESS 0x6002C301
 /begin IF_DATA XCPplus 0x0102
  /begin DAQ_EVENT VARIABLE /end DAQ_EVENT
 /end IF_DATA
/end MEASUREMENT
/begin MEASUREMENT MoFFrm_tqIncTqDmdQlfr "signal qualifier for increasing brake torque" UBYTE OneToOne 1 100 0.00 255.0 FORMAT "%5.1" ECU_ADDRESS 0x6002C300
 /begin IF_DATA XCPplus 0x0102
  /begin DAQ_EVENT VARIABLE /end DAQ_EVENT
 /end IF_DATA
/end MEASUREMENT
/begin MEASUREMENT MoGlbl_bbLocExtdTskCpl "duplicate storage for MoGlbl_bbLocExtdTskCpl" UBYTE OneToOne 1 100 0.00 255.0 FORMAT "%5.1" ECU_ADDRESS 0x6002B8E5 /end MEASUREMENT
/begin MEASUREMENT MoGlbl_vblStruct.Mo_stMoC "structure variable for instancing concept / Instance variable for Mo_stMoC" UBYTE OneToOne 1 100 0.00 255.0 FORMAT "%5.1" ECU_ADDRESS 0x6002C2E8 /end MEASUREMENT
/begin MEASUREMENT MoGlbl_vblStructCpl.Mo_stCplChk "structure for instancing concept / Instance variable for Mo_stCplChk" ULONG OneToOne 1 100 0.00 4294967295.00 FORMAT "%13.2" ECU_ADDRESS 0x6002B8D0 /end MEASUREMENT
/begin MEASUREMENT MoGlbl_vblStructCpl.Mo_stMoCCpl "structure for instancing concept / Instance variable for Mo_stMoCCpl" UBYTE OneToOne 1 100 0.00 255.0 FORMAT "%5.1" ECU_ADDRESS 0x6002B8D4 /end MEASUREMENT
/begin MEASUREMENT MoGlbl_vblStructCpl_Core1_10ms_Nr1.Mo_stCplChk "Instance for specific core and task / Instance variable for Mo_stCplChk" ULONG OneToOne 1 100 0.00 4294967295.00 FORMAT "%13.2" ECU_ADDRESS 0x6002C1E0 /end MEASUREMENT
/begin MEASUREMENT MoGlbl_vblStructCpl_Core1_10ms_Nr1.Mo_stMoCCpl "Instance for specific core and task / Instance variable for Mo_stMoCCpl" UBYTE OneToOne 1 100 0.00 255.0 FORMAT "%5.1" ECU_ADDRESS 0x6002C1E4 /end MEASUREMENT
/begin MEASUREMENT MoGlbl_vblStruct_Core1_10ms_Nr1.Mo_stMoC "Instance for specific core and task / Instance variable for Mo_stMoC" UBYTE OneToOne 1 100 0.00 255.0 FORMAT "%5.1" ECU_ADDRESS 0x6002CEF0 /end MEASUREMENT
/begin MEASUREMENT MonEgyChrgnDefn_flgVrntCcsPlgLock "Variant CCS plug lock" UBYTE B_TRUE 1 100 0.00 1.00000000000 BIT_MASK 0x2 FORMAT "%13.11" ECU_ADDRESS 0x6002B898
 /begin IF_DATA XCPplus 0x0102
  /begin DAQ_EVENT VARIABLE /end DAQ_EVENT
 /end IF_DATA
/end MEASUREMENT
/begin MEASUREMENT MoSysCtrlCo_bbLoc1Cpl "Double storage for MoSysCtrlCo_bbLoc1" UBYTE OneToOne 1 100 0.00 255.0 FORMAT "%5.1" ECU_ADDRESS 0x6002B8F1
 /begin IF_DATA XCPplus 0x0102
  /begin DAQ_EVENT VARIABLE /end DAQ_EVENT
 /end IF_DATA
/end MEASUREMENT
/begin MEASUREMENT MoSysCtrlCo_bbOut1Cpl "Doppelablage (DA) für MoSysCtrlCo_bbOut1" UBYTE OneToOne 1 100 0.00 255.0 FORMAT "%5.1" ECU_ADDRESS 0x6002B8F0
 /begin IF_DATA XCPplus 0x0102
  /begin DAQ_EVENT VARIABLE /end DAQ_EVENT
 /end IF_DATA
/end MEASUREMENT
/begin MEASUREMENT MoSysCtrl_ctErrReIniAllowd "ECU system state error counter" UBYTE OneToOne 1 100 0.00 255.0 FORMAT "%5.1" ECU_ADDRESS 0x6002C30C
 /begin IF_DATA XCPplus 0x0102
  /begin DAQ_EVENT VARIABLE /end DAQ_EVENT
 /end IF_DATA
/end MEASUREMENT
/begin MEASUREMENT MoSysCtrl_ctErrReIniAllowdCpl "Double storage for MoSysCtrl_ctErrReIniAllowd" UBYTE OneToOne 1 100 0.00 255.0 FORMAT "%5.1" ECU_ADDRESS 0x6002B8EF
 /begin IF_DATA XCPplus 0x0102
  /begin DAQ_EVENT VARIABLE /end DAQ_EVENT
 /end IF_DATA
/end MEASUREMENT
/begin MEASUREMENT MoSysCtrl_ctPostDrvLeave "global drive cycle counter for L2" UBYTE OneToOne 1 100 0.00 255.0 FORMAT "%5.1" ECU_ADDRESS 0x6002C305
 /begin IF_DATA XCPplus 0x0102
  /begin DAQ_EVENT VARIABLE /end DAQ_EVENT
 /end IF_DATA
/end MEASUREMENT
/begin MEASUREMENT MoSysCtrl_ctPostDrvLeaveCpl "Double storage for global drive cycle counter for L2" UBYTE OneToOne 1 100 0.00 255.0 FORMAT "%5.1" ECU_ADDRESS 0x6002B8EE
 /begin IF_DATA XCPplus 0x0102
  /begin DAQ_EVENT VARIABLE /end DAQ_EVENT
 /end IF_DATA
/end MEASUREMENT
/begin MEASUREMENT MoSysCtrl_ctPostDrvLeaveOld "old value of global drive cycle counter for L2" UBYTE OneToOne 1 100 0.00 255.0 FORMAT "%5.1" ECU_ADDRESS 0x6002C30B
 /begin IF_DATA XCPplus 0x0102
  /begin DAQ_EVENT VARIABLE /end DAQ_EVENT
 /end IF_DATA
/end MEASUREMENT
/begin MEASUREMENT MoSysCtrl_ctPostDrvLeaveOldCpl "Double storage for MoSysCtrl_ctPostDrvLeaveOld" UBYTE OneToOne 1 100 0.00 255.0 FORMAT "%5.1" ECU_ADDRESS 0x6002B8ED
 /begin IF_DATA XCPplus 0x0102
  /begin DAQ_EVENT VARIABLE /end DAQ_EVENT
 /end IF_DATA
/end MEASUREMENT
/begin MEASUREMENT MoSysCtrl_ctReIniAllowd "allowed reinitialisation counter in L2" UBYTE OneToOne 1 100 0.00 255.0 FORMAT "%5.1" ECU_ADDRESS 0x6002C30A
 /begin IF_DATA XCPplus 0x0102
  /begin DAQ_EVENT VARIABLE /end DAQ_EVENT
 /end IF_DATA
/end MEASUREMENT
/begin MEASUREMENT MoSysCtrl_ctReIniAllowdCpl "Double storage for global drive cycle counter for L2" UBYTE OneToOne 1 100 0.00 255.0 FORMAT "%5.1" ECU_ADDRESS 0x6002B8EC
 /begin IF_DATA XCPplus 0x0102
  /begin DAQ_EVENT VARIABLE /end DAQ_EVENT
 /end IF_DATA
/end MEASUREMENT
/begin MEASUREMENT MoSysCtrl_ctReIniTst "counter for putting of the test flag in DFC" UBYTE OneToOne 1 100 0.00 255.0 FORMAT "%5.1" ECU_ADDRESS 0x600230C4
 /begin IF_DATA XCPplus 0x0102
  /begin DAQ_EVENT VARIABLE /end DAQ_EVENT
 /end IF_DATA
/end MEASUREMENT
/begin MEASUREMENT MoSysCtrl_ctT15RsngEdgDetn "Counter for detecting the Edge rising of T15_st status" UBYTE OneToOne 1 100 0.00 255.0 FORMAT "%5.1" ECU_ADDRESS 0x6002C309
 /begin IF_DATA XCPplus 0x0102
  /begin DAQ_EVENT VARIABLE /end DAQ_EVENT
 /end IF_DATA
/end MEASUREMENT
/begin MEASUREMENT MoSysCtrl_ctT15RsngEdgDetnCpl "Double storage for MoSysCtrl_ctT15RsngEdgDetnPlausy" UBYTE OneToOne 1 100 0.00 255.0 FORMAT "%5.1" ECU_ADDRESS 0x6002B8EB
 /begin IF_DATA XCPplus 0x0102
  /begin DAQ_EVENT VARIABLE /end DAQ_EVENT
 /end IF_DATA
/end MEASUREMENT
/begin MEASUREMENT MoSysCtrl_ctT15RsngEdgDetnPlausy "Plausibilisation time for the detection of a toggling of T15_st status" UBYTE OneToOne 1 100 0.00 255.0 FORMAT "%5.1" ECU_ADDRESS 0x6002C308
 /begin IF_DATA XCPplus 0x0102
  /begin DAQ_EVENT VARIABLE /end DAQ_EVENT
 /end IF_DATA
/end MEASUREMENT
/begin MEASUREMENT MoSysCtrl_ctT15RsngEdgDetnPlausyCpl "Plausibilisation time for the detection of a toggling T15_st status" UBYTE OneToOne 1 100 0.00 255.0 FORMAT "%5.1" ECU_ADDRESS 0x6002B8EA
 /begin IF_DATA XCPplus 0x0102
  /begin DAQ_EVENT VARIABLE /end DAQ_EVENT
 /end IF_DATA
/end MEASUREMENT
/begin MEASUREMENT MoSysCtrl_ctT15RsngEdgTurnOff "counter for holding T15_st rising edge status" UBYTE OneToOne 1 100 0.00 255.0 FORMAT "%5.1" ECU_ADDRESS 0x6002C307
 /begin IF_DATA XCPplus 0x0102
  /begin DAQ_EVENT VARIABLE /end DAQ_EVENT
 /end IF_DATA
/end MEASUREMENT
/begin MEASUREMENT MoSysCtrl_ctT15RsngEdgTurnOffCpl "Double storage for MoSysCtrl_ctT15RsngEdgTurnOff" UBYTE OneToOne 1 100 0.00 255.0 FORMAT "%5.1" ECU_ADDRESS 0x6002B8E9
 /begin IF_DATA XCPplus 0x0102
  /begin DAQ_EVENT VARIABLE /end DAQ_EVENT
 /end IF_DATA
/end MEASUREMENT
/begin MEASUREMENT MoSysCtrl_flgErrReIniReq "error in the ecu system status flag for L2" UBYTE B_TRUE 1 100 0.00 1.00000000000 BIT_MASK 0x40 FORMAT "%13.11" ECU_ADDRESS 0x6002C30D
 /begin IF_DATA XCPplus 0x0102
  /begin DAQ_EVENT VARIABLE /end DAQ_EVENT
 /end IF_DATA
/end MEASUREMENT
/begin MEASUREMENT MoSysCtrl_flgErrReIniReqMsg "error in the ecu system status flag for L1" UBYTE B_TRUE 1 100 0.00 1.00000000000 BIT_MASK 0x1 FORMAT "%13.11" ECU_ADDRESS 0x70000224
 /begin IF_DATA XCPplus 0x0102
  /begin DAQ_EVENT VARIABLE /end DAQ_EVENT
 /end IF_DATA
/end MEASUREMENT
/begin MEASUREMENT MoSysCtrl_flgIrvErrReIniReqMsg "irreversible error in ECU system state flag" UBYTE B_TRUE 1 100 0.00 1.00000000000 BIT_MASK 0x1 FORMAT "%13.11" ECU_ADDRESS 0x70000223
 /begin IF_DATA XCPplus 0x0102
  /begin DAQ_EVENT VARIABLE /end DAQ_EVENT
 /end IF_DATA
/end MEASUREMENT
/begin MEASUREMENT MoSysCtrl_flgReIniClr "flag for clearing the DFC" UBYTE B_TRUE 1 100 0.00 1.00000000000 BIT_MASK 0x1 FORMAT "%13.11" ECU_ADDRESS 0x70000115
 /begin IF_DATA XCPplus 0x0102
  /begin DAQ_EVENT VARIABLE /end DAQ_EVENT
 /end IF_DATA
/end MEASUREMENT
/begin MEASUREMENT MoSysCtrl_flgReIniReq "ReIni fuer BSWEnd angefordert" UBYTE B_TRUE 1 100 0.00 1.00000000000 BIT_MASK 0x1 FORMAT "%13.11" ECU_ADDRESS 0x6002C30D
 /begin IF_DATA XCPplus 0x0102
  /begin DAQ_EVENT VARIABLE /end DAQ_EVENT
 /end IF_DATA
/end MEASUREMENT
/begin MEASUREMENT MoSysCtrl_flgReIniReqAlwd "reinitalization allowed in L2 flag" UBYTE B_TRUE 1 100 0.00 1.00000000000 BIT_MASK 0x2 FORMAT "%13.11" ECU_ADDRESS 0x6002C30D
 /begin IF_DATA XCPplus 0x0102
  /begin DAQ_EVENT VARIABLE /end DAQ_EVENT
 /end IF_DATA
/end MEASUREMENT
/begin MEASUREMENT MoSysCtrl_flgReIniReqTrig "reinitalization trigger in L2 flag" UBYTE B_TRUE 1 100 0.00 1.00000000000 BIT_MASK 0x1 FORMAT "%13.11" ECU_ADDRESS 0x6002C306
 /begin IF_DATA XCPplus 0x0102
  /begin DAQ_EVENT VARIABLE /end DAQ_EVENT
 /end IF_DATA
/end MEASUREMENT
/begin MEASUREMENT MoSysCtrl_flgReIniReqTrigMsg "reinitalization trigger in L1 flag" UBYTE B_TRUE 1 100 0.00 1.00000000000 BIT_MASK 0x1 FORMAT "%13.11" ECU_ADDRESS 0x70000222
 /begin IF_DATA XCPplus 0x0102
  /begin DAQ_EVENT VARIABLE /end DAQ_EVENT
 /end IF_DATA
/end MEASUREMENT
/begin MEASUREMENT MoSysCtrl_flgReIniTestMsg "Test flag message for the diagnosis MoSysCtrl" UBYTE B_TRUE 1 100 0.00 1.00000000000 BIT_MASK 0x1 FORMAT "%13.11" ECU_ADDRESS 0x70000221
 /begin IF_DATA XCPplus 0x0102
  /begin DAQ_EVENT VARIABLE /end DAQ_EVENT
 /end IF_DATA
/end MEASUREMENT
/begin MEASUREMENT MoSysCtrl_flgT15Old "Old value of Terminal 15 status in L2" UBYTE B_TRUE 1 100 0.00 1.00000000000 BIT_MASK 0x4 FORMAT "%13.11" ECU_ADDRESS 0x6002C30D
 /begin IF_DATA XCPplus 0x0102
  /begin DAQ_EVENT VARIABLE /end DAQ_EVENT
 /end IF_DATA
/end MEASUREMENT
/begin MEASUREMENT MoSysCtrl_flgT15PlausyErr "Terminal 15 status plausibility error flag" UBYTE B_TRUE 1 100 0.00 1.00000000000 BIT_MASK 0x8 FORMAT "%13.11" ECU_ADDRESS 0x6002C30D
 /begin IF_DATA XCPplus 0x0102
  /begin DAQ_EVENT VARIABLE /end DAQ_EVENT
 /end IF_DATA
/end MEASUREMENT
/begin MEASUREMENT MoSysCtrl_flgT15PlausyErrOld "old value of Terminal 15 status plausibility error flag" UBYTE B_TRUE 1 100 0.00 1.00000000000 BIT_MASK 0x10 FORMAT "%13.11" ECU_ADDRESS 0x6002C30D
 /begin IF_DATA XCPplus 0x0102
  /begin DAQ_EVENT VARIABLE /end DAQ_EVENT
 /end IF_DATA
/end MEASUREMENT
/begin MEASUREMENT MoSysCtrl_flgT15RsngEdgTurnOff "flag for holding a detected rising edge of T15_st status" UBYTE B_TRUE 1 100 0.00 1.00000000000 BIT_MASK 0x20 FORMAT "%13.11" ECU_ADDRESS 0x6002C30D
 /begin IF_DATA XCPplus 0x0102
  /begin DAQ_EVENT VARIABLE /end DAQ_EVENT
 /end IF_DATA
/end MEASUREMENT
/begin MEASUREMENT MoXEMM_cntrPostDrvLeaveOld "Local drive cycle counter which is incremented when system state SyC_PostDrive is left." UBYTE OneToOne 1 100 0.00 255.0 FORMAT "%5.1" ECU_ADDRESS 0x60023528
 /begin IF_DATA XCPplus 0x0102
  /begin DAQ_EVENT VARIABLE /end DAQ_EVENT
 /end IF_DATA
/end MEASUREMENT
/begin MEASUREMENT MoXEMM_stEMMAlrms "Status of EMM alarms of MoCEMM_stEmmAlrms" ULONG OneToOne 1 100 0.00 4294967295.00 FORMAT "%13.2" MATRIX_DIM 22 ECU_ADDRESS 0x600006CC
 /begin IF_DATA XCPplus 0x0102
  /begin DAQ_EVENT VARIABLE /end DAQ_EVENT
 /end IF_DATA
/end MEASUREMENT
/begin MEASUREMENT MoXEMM_stEMMAlrmsAftRst "Status of EMM alarms after initialization (read out of hardware register)" ULONG OneToOne 1 100 0.00 4294967295.00 FORMAT "%13.2" MATRIX_DIM 22 ECU_ADDRESS 0x60000674
 /begin IF_DATA XCPplus 0x0102
  /begin DAQ_EVENT VARIABLE /end DAQ_EVENT
 /end IF_DATA
/end MEASUREMENT
/begin MEASUREMENT MoXEMM_stHwLTResult "Status of Hardware Logic Test errors after initialization" ULONG OneToOne 1 100 0.00 4294967295.00 FORMAT "%13.2" ECU_ADDRESS 0x60000724
 /begin IF_DATA XCPplus 0x0102
  /begin DAQ_EVENT VARIABLE /end DAQ_EVENT
 /end IF_DATA
/end MEASUREMENT
/begin MEASUREMENT MoXFrm_Buf_DCDC_283h "" UBYTE OneToOne 1 100 0.00 255.0 FORMAT "%5.1" MATRIX_DIM 8 ECU_ADDRESS 0x600230BC /end MEASUREMENT
/begin MEASUREMENT MoXFrm_Buf_DCDC_293h "MoX Buffer for DCDC_293h" UBYTE OneToOne 1 100 0.00 255.0 FORMAT "%5.1" MATRIX_DIM 8 ECU_ADDRESS 0x600230B4 /end MEASUREMENT
/begin MEASUREMENT MoXFrm_Buf_HS3_AUTO_GEARBOX_SWITCH_STATUS "MoX Buffer for HS3_AUTO_GEARBOX_SWITCH_STATUS" UBYTE OneToOne 1 100 0.00 255.0 FORMAT "%5.1" MATRIX_DIM 3 ECU_ADDRESS 0x600230B1 /end MEASUREMENT
/begin MEASUREMENT MoXFrm_Buf_HVBAT_205h "MoXFrm_Buf_HVBAT_205h" UBYTE OneToOne 1 100 0.00 255.0 FORMAT "%5.1" MATRIX_DIM 8 ECU_ADDRESS 0x600230A9 /end MEASUREMENT
/begin MEASUREMENT MoXFrm_Buf_HVBAT_325h "MoX Buffer for HVBAT_325h" UBYTE OneToOne 1 100 0.00 255.0 FORMAT "%5.1" MATRIX_DIM 8 ECU_ADDRESS 0x600230A1 /end MEASUREMENT
/begin MEASUREMENT MoXFrm_Buf_INV_217h "MoX Buffer for INV_217h" UBYTE OneToOne 1 100 0.00 255.0 FORMAT "%5.1" MATRIX_DIM 8 ECU_ADDRESS 0x60023099 /end MEASUREMENT
/begin MEASUREMENT MoXFrm_Buf_INV_237 "MoX Buffer for INV_237" UBYTE OneToOne 1 100 0.00 255.0 FORMAT "%5.1" MATRIX_DIM 8 ECU_ADDRESS 0x60023091 /end MEASUREMENT
/begin MEASUREMENT MoXFrm_Buf_INV_427h "MoX Buffer for INV_427h" UBYTE OneToOne 1 100 0.00 255.0 FORMAT "%5.1" MATRIX_DIM 8 ECU_ADDRESS 0x60023089 /end MEASUREMENT
/begin MEASUREMENT MoXFrm_Buf_IS_DAT_ABR_50Dh "MoX Buffer for IS_DAT_ABR_50Dh" UBYTE OneToOne 1 100 0.00 255.0 FORMAT "%5.1" MATRIX_DIM 8 ECU_ADDRESS 0x60023081 /end MEASUREMENT
/begin MEASUREMENT MoXFrm_Buf_IS_DAT_BSI_412h "MoX Buffer for IS_DAT_BSI_412h" UBYTE OneToOne 1 100 0.00 255.0 FORMAT "%5.1" MATRIX_DIM 8 ECU_ADDRESS 0x60023079 /end MEASUREMENT
/begin MEASUREMENT MoXFrm_Buf_IS_DYN_ABR_38Dh "MoX Buffer for IS_DYN_ABR_38Dh" UBYTE OneToOne 1 100 0.00 255.0 FORMAT "%5.1" MATRIX_DIM 8 ECU_ADDRESS 0x60023071 /end MEASUREMENT
/begin MEASUREMENT MoXFrm_Buf_IS_DYN_VCU_208h "MoXFrm_Buf_IS_DYN_VCU_208h" UBYTE OneToOne 1 100 0.00 255.0 FORMAT "%5.1" MATRIX_DIM 8 ECU_ADDRESS 0x60023069 /end MEASUREMENT
/begin MEASUREMENT MoXFrm_Buf_PDU_BusVoltages_308 "MoX Buffer for PDU_BusVoltages_308" UBYTE OneToOne 1 100 0.00 255.0 FORMAT "%5.1" MATRIX_DIM 8 ECU_ADDRESS 0x60023061 /end MEASUREMENT
/begin MEASUREMENT MoXFrm_Buf_VCU_211h "MoXFrm_Buf_VCU_211h" UBYTE OneToOne 1 100 0.00 255.0 FORMAT "%5.1" MATRIX_DIM 8 ECU_ADDRESS 0x60023059 /end MEASUREMENT
/begin MEASUREMENT MoXFrm_Buf_VCU_221h "MoXFrm_Buf_VCU_221h" UBYTE OneToOne 1 100 0.00 255.0 FORMAT "%5.1" MATRIX_DIM 8 ECU_ADDRESS 0x60023051 /end MEASUREMENT
/begin MEASUREMENT MoXFrm_Buf_VCU_241h "Buffer for frame VCU_241h" UBYTE OneToOne 1 100 0.00 255.0 FORMAT "%5.1" MATRIX_DIM 8 ECU_ADDRESS 0x60023049 /end MEASUREMENT
/begin MEASUREMENT MoXFrm_Buf_VCU_281h "MoXFrm_Buf_VCU_281h" UBYTE OneToOne 1 100 0.00 255.0 FORMAT "%5.1" MATRIX_DIM 8 ECU_ADDRESS 0x60023041 /end MEASUREMENT
/begin MEASUREMENT MoXFrm_Buf_VCU_AIRBAG_351h "MoX Buffer for VCU_AIRBAG_351h" UBYTE OneToOne 1 100 0.00 255.0 FORMAT "%5.1" MATRIX_DIM 8 ECU_ADDRESS 0x60023039 /end MEASUREMENT
/begin MEASUREMENT MoXFrm_Buf_VCU_eBCCM_432h "MoX buffer for VCU_eBCCM_432h" UBYTE OneToOne 1 100 0.00 255.0 FORMAT "%5.1" MATRIX_DIM 8 ECU_ADDRESS 0x60023031 /end MEASUREMENT
/begin MEASUREMENT MoXFrm_flgUpdDCDC_283h "" UBYTE B_TRUE 1 100 0.00 1.00000000000 BIT_MASK 0x1 FORMAT "%13.11" ECU_ADDRESS 0x60023030 /end MEASUREMENT
/begin MEASUREMENT MoXFrm_flgUpdDCDC_293h "MoXFrm flag update for DCDC_293h" UBYTE B_TRUE 1 100 0.00 1.00000000000 BIT_MASK 0x1 FORMAT "%13.11" ECU_ADDRESS 0x6002302F /end MEASUREMENT
/begin MEASUREMENT MoXFrm_flgUpdHS3_AUTO_GEARBOX_SWITCH_STATUS "MoXFrm flag update for HS3_AUTO_GEARBOX_SWITCH_STATUS" UBYTE B_TRUE 1 100 0.00 1.00000000000 BIT_MASK 0x1 FORMAT "%13.11" ECU_ADDRESS 0x6002302E /end MEASUREMENT
/begin MEASUREMENT MoXFrm_flgUpdHVBAT_205h "MoXFrm_flgUpdHVBAT_205h" UBYTE B_TRUE 1 100 0.00 1.00000000000 BIT_MASK 0x1 FORMAT "%13.11" ECU_ADDRESS 0x6002302D /end MEASUREMENT
/begin MEASUREMENT MoXFrm_flgUpdHVBAT_325h "MoXFrm flag update for HVBAT_325h" UBYTE B_TRUE 1 100 0.00 1.00000000000 BIT_MASK 0x1 FORMAT "%13.11" ECU_ADDRESS 0x6002302C /end MEASUREMENT
/begin MEASUREMENT MoXFrm_flgUpdINV_217h "MoXFrm flag update for INV_217h" UBYTE B_TRUE 1 100 0.00 1.00000000000 BIT_MASK 0x1 FORMAT "%13.11" ECU_ADDRESS 0x6002302B /end MEASUREMENT
/begin MEASUREMENT MoXFrm_flgUpdINV_237 "MoXFrm flag update for INV_237" UBYTE B_TRUE 1 100 0.00 1.00000000000 BIT_MASK 0x1 FORMAT "%13.11" ECU_ADDRESS 0x6002302A /end MEASUREMENT
/begin MEASUREMENT MoXFrm_flgUpdINV_427h "MoXFrm flag update for INV_427h" UBYTE B_TRUE 1 100 0.00 1.00000000000 BIT_MASK 0x1 FORMAT "%13.11" ECU_ADDRESS 0x60023029 /end MEASUREMENT
/begin MEASUREMENT MoXFrm_flgUpdIS_DAT_ABR_50Dh "MoXFrm flag update for DAT_ABR_50Dh" UBYTE B_TRUE 1 100 0.00 1.00000000000 BIT_MASK 0x1 FORMAT "%13.11" ECU_ADDRESS 0x60023028 /end MEASUREMENT
/begin MEASUREMENT MoXFrm_flgUpdIS_DAT_BSI_412h "MoXFrm flag update for DAT_BSI_412h" UBYTE B_TRUE 1 100 0.00 1.00000000000 BIT_MASK 0x1 FORMAT "%13.11" ECU_ADDRESS 0x60023027 /end MEASUREMENT
/begin MEASUREMENT MoXFrm_flgUpdIS_DYN_ABR_38Dh "MoXFrm flag update for IS_DYN_ABR_38Dh" UBYTE B_TRUE 1 100 0.00 1.00000000000 BIT_MASK 0x1 FORMAT "%13.11" ECU_ADDRESS 0x60023026 /end MEASUREMENT
/begin MEASUREMENT MoXFrm_flgUpdIS_DYN_VCU_208h "MoXFrm_flgUpdIS_DYN_VCU_208h" UBYTE B_TRUE 1 100 0.00 1.00000000000 BIT_MASK 0x1 FORMAT "%13.11" ECU_ADDRESS 0x60023025 /end MEASUREMENT
/begin MEASUREMENT MoXFrm_flgUpdPDU_BusVoltages_308 "MoXFrm flag update for PDU_BusVoltages_308" UBYTE B_TRUE 1 100 0.00 1.00000000000 BIT_MASK 0x1 FORMAT "%13.11" ECU_ADDRESS 0x60023024 /end MEASUREMENT
/begin MEASUREMENT MoXFrm_flgUpdVCU_211h "MoXFrm_flgUpdVCU_211h" UBYTE B_TRUE 1 100 0.00 1.00000000000 BIT_MASK 0x1 FORMAT "%13.11" ECU_ADDRESS 0x60023023 /end MEASUREMENT
/begin MEASUREMENT MoXFrm_flgUpdVCU_221h "MoXFrm_flgUpdVCU_221h" UBYTE B_TRUE 1 100 0.00 1.00000000000 BIT_MASK 0x1 FORMAT "%13.11" ECU_ADDRESS 0x60023022 /end MEASUREMENT
/begin MEASUREMENT MoXFrm_flgUpdVCU_241h "Flag to indicate trigger of frame VCU_241h" UBYTE B_TRUE 1 100 0.00 1.00000000000 BIT_MASK 0x1 FORMAT "%13.11" ECU_ADDRESS 0x60023021 /end MEASUREMENT
/begin MEASUREMENT MoXFrm_flgUpdVCU_281h "MoXFrm_flgUpdVCU_281h" UBYTE B_TRUE 1 100 0.00 1.00000000000 BIT_MASK 0x1 FORMAT "%13.11" ECU_ADDRESS 0x60023020 /end MEASUREMENT
/begin MEASUREMENT MoXFrm_flgUpdVCU_AIRBAG_351h "MoXFrm flag update for VCU_AIRBAG_351h" UBYTE B_TRUE 1 100 0.00 1.00000000000 BIT_MASK 0x1 FORMAT "%13.11" ECU_ADDRESS 0x6002301F /end MEASUREMENT
/begin MEASUREMENT MoXFrm_flgUpdVCU_eBCCM_432h "MoXFrm flag update for VCU_eBCCM_432h" UBYTE B_TRUE 1 100 0.00 1.00000000000 BIT_MASK 0x1 FORMAT "%13.11" ECU_ADDRESS 0x6002301E /end MEASUREMENT
/begin MEASUREMENT Mo_bAddConPFC "Generation of additional Response Contributions to program Folw Check" UBYTE B_TRUE 1 100 0.00 1.00000000000 BIT_MASK 0x80 FORMAT "%13.11" ECU_ADDRESS 0x6002C2EA /end MEASUREMENT
/begin MEASUREMENT Mo_bAddConPFCExtdTsk "Generation of additional Response Contributions to program Folw Check in the extended task" UBYTE B_TRUE 1 100 0.00 1.00000000000 BIT_MASK 0x80 FORMAT "%13.11" ECU_ADDRESS 0x6002C2E9 /end MEASUREMENT
/begin MEASUREMENT Mo_bAddDisblPreICORst "Additional condition disable Pre-ICO reset in function monitoring" UBYTE B_TRUE 1 100 0.00 1.00000000000 BIT_MASK 0x8 FORMAT "%13.11" ECU_ADDRESS 0x6002C2EA /end MEASUREMENT
/begin MEASUREMENT Mo_bAddDisblPreICORstExtdTsk "Additional condition disable Pre-ICO reset in function monitoring in the extended task" UBYTE B_TRUE 1 100 0.00 1.00000000000 BIT_MASK 0x8 FORMAT "%13.11" ECU_ADDRESS 0x6002C2E9 /end MEASUREMENT
/begin MEASUREMENT Mo_bCplChk "Fault reaction requirement from cyclic RAM safeguarding in function monitoring" UBYTE B_TRUE 1 100 0.00 1.00000000000 BIT_MASK 0x1 FORMAT "%13.11" ECU_ADDRESS 0x6002C2EC /end MEASUREMENT
/begin MEASUREMENT Mo_bCplChkExtdTsk "Fault reaction requirement from cyclic RAM safeguarding in function monitoring in the extended task" UBYTE B_TRUE 1 100 0.00 1.00000000000 BIT_MASK 0x1 FORMAT "%13.11" ECU_ADDRESS 0x6002C2EB /end MEASUREMENT
/begin MEASUREMENT Mo_bEmgcyAir "Request standby air driving from level1 in function monitoring" UBYTE B_TRUE 1 100 0.00 1.00000000000 BIT_MASK 0x20 FORMAT "%13.11" ECU_ADDRESS 0x6002C2EA /end MEASUREMENT
/begin MEASUREMENT Mo_bICOL1 "Injection Cut Off demand from Level 1" UBYTE B_TRUE 1 100 0.00 1.00000000000 BIT_MASK 0x2 FORMAT "%13.11" ECU_ADDRESS 0x6002C2EA /end MEASUREMENT
/begin MEASUREMENT Mo_bICOL2 "Injection Cut Off demand from Level 2" UBYTE B_TRUE 1 100 0.00 1.00000000000 BIT_MASK 0x1 FORMAT "%13.11" ECU_ADDRESS 0x6002C2EA /end MEASUREMENT
/begin MEASUREMENT Mo_bICOL2ExtdTsk "Injection Cut Off demand from Level 2 in the extended task" UBYTE B_TRUE 1 100 0.00 1.00000000000 BIT_MASK 0x1 FORMAT "%13.11" ECU_ADDRESS 0x6002C2E9 /end MEASUREMENT
/begin MEASUREMENT Mo_bIrvElMIdl "irreversible idle request for the electric motor" UBYTE B_TRUE 1 100 0.00 1.00000000000 BIT_MASK 0x20 FORMAT "%13.11" ECU_ADDRESS 0x6002C2ED /end MEASUREMENT
/begin MEASUREMENT Mo_bIrvHybLimpL1 "Irreversible hybrid-limp-home mode requested from level 1" UBYTE B_TRUE 1 100 0.00 1.00000000000 BIT_MASK 0x2 FORMAT "%13.11" ECU_ADDRESS 0x6002C2ED /end MEASUREMENT
/begin MEASUREMENT Mo_bIrvHybLimpL2 "Irreversible hybrid-limp-home mode requested from level 2" UBYTE B_TRUE 1 100 0.00 1.00000000000 BIT_MASK 0x1 FORMAT "%13.11" ECU_ADDRESS 0x6002C2ED /end MEASUREMENT
/begin MEASUREMENT Mo_bIrvHybP1LimpL2 "Irreversible limp home mode P1 hybrid from level 2 in function monitoring" UBYTE B_TRUE 1 100 0.00 1.00000000000 BIT_MASK 0x10 FORMAT "%13.11" ECU_ADDRESS 0x6002C2ED /end MEASUREMENT
/begin MEASUREMENT Mo_bIrvTrqLimL1 "Irreversible torque limitation from level 1 in function monitoring" UBYTE B_TRUE 1 100 0.00 1.00000000000 BIT_MASK 0x8 FORMAT "%13.11" ECU_ADDRESS 0x6002C2ED /end MEASUREMENT
/begin MEASUREMENT Mo_bIrvTrqLimL2 "Irreversible torque limitation from level 2 in function monitoring" UBYTE B_TRUE 1 100 0.00 1.00000000000 BIT_MASK 0x4 FORMAT "%13.11" ECU_ADDRESS 0x6002C2ED /end MEASUREMENT
/begin MEASUREMENT Mo_bLoVltg "Battery voltage not OK, undervoltage shut-off active" UBYTE B_TRUE 1 100 0.00 1.00000000000 BIT_MASK 0x4 FORMAT "%13.11" ECU_ADDRESS 0x6002C2EA /end MEASUREMENT
/begin MEASUREMENT Mo_bNlh "irreversible demand of non-lean operation mode from function monitoring" UBYTE B_TRUE 1 100 0.00 1.00000000000 BIT_MASK 0x10 FORMAT "%13.11" ECU_ADDRESS 0x6002C2EA /end MEASUREMENT
/begin MEASUREMENT Mo_bRamErr "RAM error occured in cyclic check" UBYTE B_TRUE 1 100 0.00 1.00000000000 BIT_MASK 0x2 FORMAT "%13.11" ECU_ADDRESS 0x6002C2EC /end MEASUREMENT
/begin MEASUREMENT Mo_bRamErrExtdTsk "RAM error occured in cyclic check" UBYTE B_TRUE 1 100 0.00 1.00000000000 BIT_MASK 0x2 FORMAT "%13.11" ECU_ADDRESS 0x6002C2EB /end MEASUREMENT
/begin MEASUREMENT Mo_bRomErr "ROM error occured in cyclic check" UBYTE B_TRUE 1 100 0.00 1.00000000000 BIT_MASK 0x4 FORMAT "%13.11" ECU_ADDRESS 0x6002C2EC /end MEASUREMENT
/begin MEASUREMENT Mo_bSyncLos "condition loss of synchronization in function monitoring" UBYTE B_TRUE 1 100 0.00 1.00000000000 BIT_MASK 0x40 FORMAT "%13.11" ECU_ADDRESS 0x6002C2EA /end MEASUREMENT
/begin MEASUREMENT Mo_ctRst "Reset counter" UBYTE OneToOne 1 100 0.00 255.0 FORMAT "%5.1" ECU_ADDRESS 0x600347B9
 /begin IF_DATA XCPplus 0x0102
  /begin DAQ_EVENT VARIABLE /end DAQ_EVENT
 /end IF_DATA
/end MEASUREMENT
/begin MEASUREMENT Mo_ctRstCpl "RAM data redundancy of Mo_ctRst" UBYTE OneToOne 1 100 0.00 255.0 FORMAT "%5.1" ECU_ADDRESS 0x600347B8
 /begin IF_DATA XCPplus 0x0102
  /begin DAQ_EVENT VARIABLE /end DAQ_EVENT
 /end IF_DATA
/end MEASUREMENT
/begin MEASUREMENT Mo_ctRstMsg "Reset counter" UBYTE OneToOne 1 100 0.00 255.0 FORMAT "%5.1" ECU_ADDRESS 0x60023527
 /begin IF_DATA XCPplus 0x0102
  /begin DAQ_EVENT VARIABLE /end DAQ_EVENT
 /end IF_DATA
/end MEASUREMENT
/begin MEASUREMENT Mo_flgICOMsg "flag for layer 1: error reaction injection quantities limitation from the monitoring" UBYTE B_TRUE 1 100 0.00 1.00000000000 BIT_MASK 0x1 FORMAT "%13.11" ECU_ADDRESS 0x60023491
 /begin IF_DATA XCPplus 0x0102
  /begin DAQ_EVENT VARIABLE /end DAQ_EVENT
 /end IF_DATA
/end MEASUREMENT
/begin MEASUREMENT Mo_stCplChk "Complementcheck failed" ULONG OneToOne 1 100 0.00 4294967295.00 FORMAT "%13.2" ECU_ADDRESS 0x6002B8DC
 /begin IF_DATA XCPplus 0x0102
  /begin DAQ_EVENT VARIABLE /end DAQ_EVENT
 /end IF_DATA
/end MEASUREMENT
/begin MEASUREMENT Mo_stErrHyb "Status Bits for demands of error reaction hybrid system in function monitoring" UBYTE OneToOne 1 100 0.00 255.0 FORMAT "%5.1" ECU_ADDRESS 0x6002C2ED
 /begin IF_DATA XCPplus 0x0102
  /begin DAQ_EVENT VARIABLE /end DAQ_EVENT
 /end IF_DATA
/end MEASUREMENT
/begin MEASUREMENT Mo_stErrHybCpl "RAM data redundancy of Mo_stErrHyb" UBYTE OneToOne 1 100 0.00 255.0 FORMAT "%5.1" ECU_ADDRESS 0x6002B8E4
 /begin IF_DATA XCPplus 0x0102
  /begin DAQ_EVENT VARIABLE /end DAQ_EVENT
 /end IF_DATA
/end MEASUREMENT
/begin MEASUREMENT Mo_stIrvErrReacMsg "Status if ICO or irrev. CAN-Error is existent. (Info to Level 1 for Healing error in case of T15-off/on by power-on reset)" UBYTE OneToOne 1 100 0.00 255.0 FORMAT "%5.1" ECU_ADDRESS 0x60023525
 /begin IF_DATA XCPplus 0x0102
  /begin DAQ_EVENT VARIABLE /end DAQ_EVENT
 /end IF_DATA
/end MEASUREMENT
/begin MEASUREMENT Mo_stMoC "Status Bits for demands of error reaction in controller monitoring" UBYTE OneToOne 1 100 0.00 255.0 FORMAT "%5.1" ECU_ADDRESS 0x6002C2EC
 /begin IF_DATA XCPplus 0x0102
  /begin DAQ_EVENT VARIABLE /end DAQ_EVENT
 /end IF_DATA
/end MEASUREMENT
/begin MEASUREMENT Mo_stMoCCpl "RAM data redundancy of Mo_stMoC" UBYTE OneToOne 1 100 0.00 255.0 FORMAT "%5.1" ECU_ADDRESS 0x6002B8E3
 /begin IF_DATA XCPplus 0x0102
  /begin DAQ_EVENT VARIABLE /end DAQ_EVENT
 /end IF_DATA
/end MEASUREMENT
/begin MEASUREMENT Mo_stMoCExtdTsk "Status bits for the error reaction request in the monitoring processor" UBYTE OneToOne 1 100 0.00 255.0 FORMAT "%5.1" ECU_ADDRESS 0x6002C2EB /end MEASUREMENT
/begin MEASUREMENT Mo_stMoCExtdTskCpl "Complement value for Mo_stMoCExtdTsk" UBYTE OneToOne 1 100 0.00 255.0 FORMAT "%5.1" ECU_ADDRESS 0x6002B8E2 /end MEASUREMENT
/begin MEASUREMENT Mo_stMoCExtdTskMsg "Message containing status bits for the error reaction request in the monitoring processor" UBYTE OneToOne 1 100 0.00 255.0 FORMAT "%5.1" ECU_ADDRESS 0x60023524 /end MEASUREMENT
/begin MEASUREMENT Mo_stMoCMsg "Message containing status Bits for demands of error reaction in controller monitoring" UBYTE OneToOne 1 100 0.00 255.0 FORMAT "%5.1" ECU_ADDRESS 0x60023523
 /begin IF_DATA XCPplus 0x0102
  /begin DAQ_EVENT VARIABLE /end DAQ_EVENT
 /end IF_DATA
/end MEASUREMENT
/begin MEASUREMENT Mo_stMoF "Status Bits for demands of error reaction in function monitoring" UBYTE OneToOne 1 100 0.00 255.0 FORMAT "%5.1" ECU_ADDRESS 0x6002C2EA
 /begin IF_DATA XCPplus 0x0102
  /begin DAQ_EVENT VARIABLE /end DAQ_EVENT
 /end IF_DATA
/end MEASUREMENT
/begin MEASUREMENT Mo_stMoFCpl "RAM data redundancy of Mo_stMoF" UBYTE OneToOne 1 100 0.00 255.0 FORMAT "%5.1" ECU_ADDRESS 0x6002B8E1
 /begin IF_DATA XCPplus 0x0102
  /begin DAQ_EVENT VARIABLE /end DAQ_EVENT
 /end IF_DATA
/end MEASUREMENT
/begin MEASUREMENT Mo_stMoFExtdTsk "Status Bits for demands of error reaction in function monitoring in the extended task" UBYTE OneToOne 1 100 0.00 255.0 FORMAT "%5.1" ECU_ADDRESS 0x6002C2E9 /end MEASUREMENT
/begin MEASUREMENT Mo_stMoFExtdTskCpl "RAM data redundancy of Mo_stMoFExtdTsk" UBYTE OneToOne 1 100 0.00 255.0 FORMAT "%5.1" ECU_ADDRESS 0x6002B8E0 /end MEASUREMENT
/begin MEASUREMENT Mo_stMoFExtdTskMsg "Message containing status Bits for demands of error reaction in function monitoring in the extended task" UBYTE OneToOne 1 100 0.00 255.0 FORMAT "%5.1" ECU_ADDRESS 0x60023522 /end MEASUREMENT
/begin MEASUREMENT Mo_stMoFMsg "Msg for L1of Status Bits for demands of error reaction in function monitoring" UBYTE OneToOne 1 100 0.00 255.0 FORMAT "%5.1" ECU_ADDRESS 0x60023521
 /begin IF_DATA XCPplus 0x0102
  /begin DAQ_EVENT VARIABLE /end DAQ_EVENT
 /end IF_DATA
/end MEASUREMENT
/begin MEASUREMENT Mo_stProtRAM "status of Prot RAM initialisation of error monitoring" UBYTE OneToOne 1 100 0.00 255.0 FORMAT "%5.1" ECU_ADDRESS 0x600347BA
 /begin IF_DATA XCPplus 0x0102
  /begin DAQ_EVENT VARIABLE /end DAQ_EVENT
 /end IF_DATA
/end MEASUREMENT
/begin MEASUREMENT Mo_stVldR32Chk "status to determine if the ValidR32 check failed" ULONG OneToOne 1 100 0.00 4294967295.00 FORMAT "%13.2" ECU_ADDRESS 0x6002B8D8
 /begin IF_DATA XCPplus 0x0102
  /begin DAQ_EVENT VARIABLE /end DAQ_EVENT
 /end IF_DATA
/end MEASUREMENT
/begin MEASUREMENT MRlyst_Sq "signal quality message for Main relay status" UBYTE SigQly_COMPU_VERB 1 100 0.00 15.0000000000 FORMAT "%13.10" ECU_ADDRESS 0x6002352F /end MEASUREMENT
/begin MEASUREMENT MRly_ctErlyOpng "Errorcounter-message to detect early opening of the main relay" UBYTE OneToOne 1 100 0.00 255.0 FORMAT "%5.1" ECU_ADDRESS 0x60023791 /end MEASUREMENT
/begin MEASUREMENT MRly_st "Request to switch on and off the main relay" UBYTE OneToOne 1 100 0.00 255.0 BIT_MASK 0x1 FORMAT "%5.1" ECU_ADDRESS 0x600236A9 /end MEASUREMENT
/begin MEASUREMENT MRly_stAct "Status of main relay" UBYTE OneToOne 1 100 0.00 255.0 FORMAT "%5.1" ECU_ADDRESS 0x60023790 /end MEASUREMENT
/begin MEASUREMENT OCWDA_cntrPostDrvLeaveOld "Local drive cycle counter which is incremented when system state SyC_PostDrive is left" UBYTE OneToOne 1 100 0.00 255.0 FORMAT "%5.1" ECU_ADDRESS 0x6002351C
 /begin IF_DATA XCPplus 0x0102
  /begin DAQ_EVENT VARIABLE /end DAQ_EVENT
 /end IF_DATA
/end MEASUREMENT
/begin MEASUREMENT OCWDA_ctBattU "Debounce counter for stable battery voltage" UBYTE OneToOne 1 100 0.00 255.0 FORMAT "%5.1" ECU_ADDRESS 0x6002351B
 /begin IF_DATA XCPplus 0x0102
  /begin DAQ_EVENT VARIABLE /end DAQ_EVENT
 /end IF_DATA
/end MEASUREMENT
/begin MEASUREMENT OCWDA_ctDebActvErr "Debounce counter for Error Pin, WDA, ABE active" UBYTE OneToOne 1 100 0.00 255.0 FORMAT "%5.1" ECU_ADDRESS 0x6002351A
 /begin IF_DATA XCPplus 0x0102
  /begin DAQ_EVENT VARIABLE /end DAQ_EVENT
 /end IF_DATA
/end MEASUREMENT
/begin MEASUREMENT OCWDA_ctDebErrNotActv "Debounce counter for healing inactive Error Pin, WDA, ABE" UBYTE OneToOne 1 100 0.00 255.0 FORMAT "%5.1" ECU_ADDRESS 0x60023519
 /begin IF_DATA XCPplus 0x0102
  /begin DAQ_EVENT VARIABLE /end DAQ_EVENT
 /end IF_DATA
/end MEASUREMENT
/begin MEASUREMENT OCWDA_ctDebOvrVltgOn "Debounce counter for overvoltage on detection" UWORD OneToOne 1 100 0.00 65535.00 FORMAT "%8.2" ECU_ADDRESS 0x6001FA20
 /begin IF_DATA XCPplus 0x0102
  /begin DAQ_EVENT VARIABLE /end DAQ_EVENT
 /end IF_DATA
/end MEASUREMENT
/begin MEASUREMENT OCWDA_ctTstOCWDA "Debounce counter for setting of test- or errorflags" UBYTE OneToOne 1 100 0.00 255.0 FORMAT "%5.1" ECU_ADDRESS 0x60023518
 /begin IF_DATA XCPplus 0x0102
  /begin DAQ_EVENT VARIABLE /end DAQ_EVENT
 /end IF_DATA
/end MEASUREMENT
/begin MEASUREMENT OCWDA_ctTstOvrVltg "Counter for setting test flag in WDA-diagnosis of the overvoltage check" UWORD OneToOne 1 100 0.00 65535.00 FORMAT "%8.2" ECU_ADDRESS 0x6001FA1E
 /begin IF_DATA XCPplus 0x0102
  /begin DAQ_EVENT VARIABLE /end DAQ_EVENT
 /end IF_DATA
/end MEASUREMENT
/begin MEASUREMENT OCWDA_flgClrDebDFC "Flag bit to indicate request to clear fault memory" UBYTE OneToOne 1 100 0.00 255.0 FORMAT "%5.1" ECU_ADDRESS 0x60023444
 /begin IF_DATA XCPplus 0x0102
  /begin DAQ_EVENT VARIABLE /end DAQ_EVENT
 /end IF_DATA
/end MEASUREMENT
/begin MEASUREMENT OCWDA_stABEActv "Internal ABE status" UBYTE OneToOne 1 100 0.00 255.0 FORMAT "%5.1" ECU_ADDRESS 0x60023517
 /begin IF_DATA XCPplus 0x0102
  /begin DAQ_EVENT VARIABLE /end DAQ_EVENT
 /end IF_DATA
/end MEASUREMENT
/begin MEASUREMENT OCWDA_stCheckState "Variable contains the current state of the WDA diagnosis task" ULONG OneToOne 1 100 0.00 4294967295.00 FORMAT "%13.2" ECU_ADDRESS 0x60000ED4
 /begin IF_DATA XCPplus 0x0102
  /begin DAQ_EVENT VARIABLE /end DAQ_EVENT
 /end IF_DATA
/end MEASUREMENT
/begin MEASUREMENT OCWDA_stErrMonPtt "Status information for diagnosis process to set failure entry" ULONG OneToOne 1 100 0.00 4294967295.00 FORMAT "%13.2" ECU_ADDRESS 0x60000ED0
 /begin IF_DATA XCPplus 0x0102
  /begin DAQ_EVENT VARIABLE /end DAQ_EVENT
 /end IF_DATA
/end MEASUREMENT
/begin MEASUREMENT OCWDA_stErrPinActv "Internal Error Pin status" UBYTE OneToOne 1 100 0.00 255.0 FORMAT "%5.1" ECU_ADDRESS 0x60023516
 /begin IF_DATA XCPplus 0x0102
  /begin DAQ_EVENT VARIABLE /end DAQ_EVENT
 /end IF_DATA
/end MEASUREMENT
/begin MEASUREMENT OCWDA_stOvrVltgActv "Internal status of overvoltage at powerstage modul" UBYTE OneToOne 1 100 0.00 255.0 FORMAT "%5.1" ECU_ADDRESS 0x60023515
 /begin IF_DATA XCPplus 0x0102
  /begin DAQ_EVENT VARIABLE /end DAQ_EVENT
 /end IF_DATA
/end MEASUREMENT
/begin MEASUREMENT OCWDA_stWDAActv "Internal WDA status" UBYTE OneToOne 1 100 0.00 255.0 FORMAT "%5.1" ECU_ADDRESS 0x60023514
 /begin IF_DATA XCPplus 0x0102
  /begin DAQ_EVENT VARIABLE /end DAQ_EVENT
 /end IF_DATA
/end MEASUREMENT
/begin MEASUREMENT PLnCChp_flgCcsPwrLineChpVcc "Flag that indicates that the supply voltage for powerline communication chip of CCS is within a calibratable range which indicates correctly powered PLC chip" UBYTE B_TRUE 1 100 0.00 1.00000000000 BIT_MASK 0x1 FORMAT "%13.11" ECU_ADDRESS 0x6002301D
 /begin IF_DATA XCPplus 0x0102
  /begin DAQ_EVENT VARIABLE /end DAQ_EVENT
 /end IF_DATA
/end MEASUREMENT
/begin MEASUREMENT PLnCChp_flgPLnCChpDeactvn "Flag that indicates that the supply voltage for powerline communication chip of CCS is above a calibratable threshold which indicates deactivation of PLC chip power supply voltage" UBYTE B_TRUE 1 100 0.00 1.00000000000 BIT_MASK 0x1 FORMAT "%13.11" ECU_ADDRESS 0x6002301C
 /begin IF_DATA XCPplus 0x0102
  /begin DAQ_EVENT VARIABLE /end DAQ_EVENT
 /end IF_DATA
/end MEASUREMENT
/begin MEASUREMENT PLnCChp_flgPLnCChpDeactvnFaild "Flag that indicates that the supply voltage for PLC chip of CCS is above a calibratable threshold which indicates deactivation of PLC chip power supply voltage when the request for PLC from charge control is false for more than a calibratable time." UBYTE B_TRUE 1 100 0.00 1.00000000000 BIT_MASK 0x1 FORMAT "%13.11" ECU_ADDRESS 0x6002301B
 /begin IF_DATA XCPplus 0x0102
  /begin DAQ_EVENT VARIABLE /end DAQ_EVENT
 /end IF_DATA
/end MEASUREMENT
/begin MEASUREMENT PLnCChp_flgPLnCChpFltDeactvnFaild "Flag indicating Fault is set when supply voltage for PLC chip of CCS is above a calibratable threshold which indicates deactivation of PLC chip power supply voltage when the request for PLC from charge control is false for more than a calibratable time" UBYTE B_TRUE 1 100 0.00 1.00000000000 BIT_MASK 0x1 FORMAT "%13.11" ECU_ADDRESS 0x6002301A
 /begin IF_DATA XCPplus 0x0102
  /begin DAQ_EVENT VARIABLE /end DAQ_EVENT
 /end IF_DATA
/end MEASUREMENT
/begin MEASUREMENT PLnCChp_flgVccOutRng "Flag that indicates that the supply voltage for powerline communication chip of CCS is not within a calibratable range which indicates correctly powered PLC chip for more than a calibratable time" UBYTE B_TRUE 1 100 0.00 1.00000000000 BIT_MASK 0x1 FORMAT "%13.11" ECU_ADDRESS 0x60023019
 /begin IF_DATA XCPplus 0x0102
  /begin DAQ_EVENT VARIABLE /end DAQ_EVENT
 /end IF_DATA
/end MEASUREMENT
/begin MEASUREMENT PT_tqWhlAct "Actual total torque of electric machine from all driven vehicle axles" SLONG TrqPrpHigh 1 100 -214748364.800 214748364.700 FORMAT "%13.3" ECU_ADDRESS 0x60000F54
 /begin IF_DATA XCPplus 0x0102
  /begin DAQ_EVENT VARIABLE /end DAQ_EVENT
 /end IF_DATA
/end MEASUREMENT
/begin MEASUREMENT PT_tqWhlActPrimAxle "Actual torque at wheel level for primary axle" SLONG TrqPrpHigh 1 100 -214748364.800 214748364.700 FORMAT "%13.3" ECU_ADDRESS 0x60000F50
 /begin IF_DATA XCPplus 0x0102
  /begin DAQ_EVENT VARIABLE /end DAQ_EVENT
 /end IF_DATA
/end MEASUREMENT
/begin MEASUREMENT PwmCtP_DDstSnsrState_mp "" UBYTE OneToOne 1 100 0.00 255.0 FORMAT "%5.1" ECU_ADDRESS 0x70006B5E /end MEASUREMENT
/begin MEASUREMENT PwmCtP_FirCalc.cntrAvrgZr " / Counter for 0-division in FIR (indicates failure)" UBYTE OneToOne 1 100 0.00 255.0 FORMAT "%5.1" ECU_ADDRESS 0x6001F402 /end MEASUREMENT
/begin MEASUREMENT PwmCtP_FirCalc.flgRdDne " / FIR: reading from uRaw-sum done" UBYTE OneToOne 1 100 0.00 1.000 BIT_MASK 0x1 FORMAT "%5.3" ECU_ADDRESS 0x6001F403 /end MEASUREMENT
/begin MEASUREMENT PwmCtP_FirCalc.uRawAvrg " / FIR: simple average calculated uRaw" SWORD Volt 1 100 -6553.600 6553.400 FORMAT "%8.3" ECU_ADDRESS 0x6001F404 /end MEASUREMENT
/begin MEASUREMENT PwmCtP_FirCalc.uRawFir " / FIR: Calculated uRaw" SWORD Volt 1 100 -6553.600 6553.400 FORMAT "%8.3" ECU_ADDRESS 0x6001F406 /end MEASUREMENT
/begin MEASUREMENT PwmCtP_FirRead.cntr " / Counter for simple average FIR" UBYTE OneToOne 1 100 0.00 255.0 FORMAT "%5.1" ECU_ADDRESS 0x60000668 /end MEASUREMENT
/begin MEASUREMENT PwmCtP_FirRead.flgFirstRun " / FIR: 1st run after init" UBYTE OneToOne 1 100 0.00 1.000 BIT_MASK 0x1 FORMAT "%5.3" ECU_ADDRESS 0x60000669 /end MEASUREMENT
/begin MEASUREMENT PwmCtP_FirRead.idxArr " / FIR ringbuffer: actual index" UBYTE OneToOne 1 100 0.00 255.0 FORMAT "%5.1" ECU_ADDRESS 0x6000066A /end MEASUREMENT
/begin MEASUREMENT PwmCtP_FirRead.uSum " / Simple average FIR: sum of uRaws" SLONG Volt 1 100 -429496729.600 429496729.400 FORMAT "%13.3" ECU_ADDRESS 0x6000066C /end MEASUREMENT
/begin MEASUREMENT PwmCtP_iActDynThresPhysRngHi_f_mp "" FLOAT32_IEEE RBPtCel_i_1p0_2 1 100 -1.00000000E+037 1.00000000E+037 FORMAT "%13.3" ECU_ADDRESS 0x7000682C /end MEASUREMENT
/begin MEASUREMENT PwmCtP_iActDynThresPhysRngLo_f_mp "" FLOAT32_IEEE RBPtCel_i_1p0_2 1 100 -1.00000000E+037 1.00000000E+037 FORMAT "%13.3" ECU_ADDRESS 0x70006828 /end MEASUREMENT
/begin MEASUREMENT PwmCtP_iActSensCpl "" SWORD OneToOne 1 100 -32768.00 32767.00 FORMAT "%8.2" ECU_ADDRESS 0x6001FDA4
 /begin IF_DATA XCPplus 0x0102
  /begin DAQ_EVENT VARIABLE /end DAQ_EVENT
 /end IF_DATA
/end MEASUREMENT
/begin MEASUREMENT PwmCtP_iActSensGradLim_f_mp "" FLOAT32_IEEE RBPtCel_i_1p0_2 1 100 -1.00000000E+037 1.00000000E+037 FORMAT "%13.3" ECU_ADDRESS 0x70006830
 /begin IF_DATA XCPplus 0x0102
  /begin DAQ_EVENT VARIABLE /end DAQ_EVENT
 /end IF_DATA
/end MEASUREMENT
/begin MEASUREMENT PwmCtP_iActSensOffsCorrd_f "" FLOAT32_IEEE RBPtCel_i_1p0_2 1 100 -1.00000000E+037 1.00000000E+037 FORMAT "%13.3" ECU_ADDRESS 0x6000113C
 /begin IF_DATA XCPplus 0x0102
  /begin DAQ_EVENT VARIABLE /end DAQ_EVENT
 /end IF_DATA
/end MEASUREMENT
/begin MEASUREMENT PwmCtP_iActSensUnFltd "" SWORD RBPtCel_i_1p0_2 1 100 -32768.00 32767.00 FORMAT "%8.2" ECU_ADDRESS 0x6001FDA2
 /begin IF_DATA XCPplus 0x0102
  /begin DAQ_EVENT VARIABLE /end DAQ_EVENT
 /end IF_DATA
/end MEASUREMENT
/begin MEASUREMENT PwmCtP_iActSens_f "" FLOAT32_IEEE RBPtCel_i_1p0_2 1 100 -1.00000000E+037 1.00000000E+037 FORMAT "%13.3" ECU_ADDRESS 0x60001138
 /begin IF_DATA XCPplus 0x0102
  /begin DAQ_EVENT VARIABLE /end DAQ_EVENT
 /end IF_DATA
/end MEASUREMENT
/begin MEASUREMENT PwmCtP_iActUnFlt_f "" FLOAT32_IEEE RBPtCel_i_1p0_2 1 100 -1.00000000E+037 1.00000000E+037 FORMAT "%13.3" ECU_ADDRESS 0x60001134
 /begin IF_DATA XCPplus 0x0102
  /begin DAQ_EVENT VARIABLE /end DAQ_EVENT
 /end IF_DATA
/end MEASUREMENT
/begin MEASUREMENT PwmCtP_iAct_f "" FLOAT32_IEEE RBPtCel_i_1p0_2 1 100 -1.00000000E+037 1.00000000E+037 FORMAT "%13.3" ECU_ADDRESS 0x60001130
 /begin IF_DATA XCPplus 0x0102
  /begin DAQ_EVENT VARIABLE /end DAQ_EVENT
 /end IF_DATA
/end MEASUREMENT
/begin MEASUREMENT PwmCtP_iAct_f_Sq "" UBYTE SigQly_COMPU_VERB 1 100 0.00 15.0000000000 FORMAT "%13.10" ECU_ADDRESS 0x6002378E
 /begin IF_DATA XCPplus 0x0102
  /begin DAQ_EVENT VARIABLE /end DAQ_EVENT
 /end IF_DATA
/end MEASUREMENT
/begin MEASUREMENT PwmCtP_rDtyCycRaw "" SWORD DtyCyc 1 100 -327.6800 327.6700 FORMAT "%8.4" ECU_ADDRESS 0x6001FDA0
 /begin IF_DATA XCPplus 0x0102
  /begin DAQ_EVENT VARIABLE /end DAQ_EVENT
 /end IF_DATA
/end MEASUREMENT
/begin MEASUREMENT PwmCtP_rDtyCycRaw_f "Sensor signal duty cycle" FLOAT32_IEEE RBPtCel_Perc_1p0_1 1 100 -1.00000000E+037 1.00000000E+037 FORMAT "%13.3" ECU_ADDRESS 0x6000112C
 /begin IF_DATA XCPplus 0x0102
  /begin DAQ_EVENT VARIABLE /end DAQ_EVENT
 /end IF_DATA
/end MEASUREMENT
/begin MEASUREMENT PwmCtP_stMonStdSens "" ULONG OneToOne 1 100 0.00 4294967295.00 FORMAT "%13.2" ECU_ADDRESS 0x6000102C
 /begin IF_DATA XCPplus 0x0102
  /begin DAQ_EVENT VARIABLE /end DAQ_EVENT
 /end IF_DATA
/end MEASUREMENT
/begin MEASUREMENT PwmCtP_stSnsrActv "" UBYTE OneToOne 1 100 0.00 255.0 BIT_MASK 0x1 FORMAT "%5.1" ECU_ADDRESS 0x600236A7
 /begin IF_DATA XCPplus 0x0102
  /begin DAQ_EVENT VARIABLE /end DAQ_EVENT
 /end IF_DATA
/end MEASUREMENT
/begin MEASUREMENT PwmCtP_stSnsrDdCalc "" UBYTE OneToOne 1 100 0.00 255.0 BIT_MASK 0x1 FORMAT "%5.1" ECU_ADDRESS 0x600236A6
 /begin IF_DATA XCPplus 0x0102
  /begin DAQ_EVENT VARIABLE /end DAQ_EVENT
 /end IF_DATA
/end MEASUREMENT
/begin MEASUREMENT PwmCtP_stSnsrDdReadCalc "" UBYTE OneToOne 1 100 0.00 255.0 BIT_MASK 0x1 FORMAT "%5.1" ECU_ADDRESS 0x600236A5
 /begin IF_DATA XCPplus 0x0102
  /begin DAQ_EVENT VARIABLE /end DAQ_EVENT
 /end IF_DATA
/end MEASUREMENT
/begin MEASUREMENT PwmCtP_swtConfStdSens2C "" ULONG OneToOne 1 100 0.00 4294967295.00 FORMAT "%13.2" ECU_ADDRESS 0x60000664 /end MEASUREMENT
/begin MEASUREMENT PwmCtP_swtConfStdSensC "" ULONG OneToOne 1 100 0.00 4294967295.00 FORMAT "%13.2" ECU_ADDRESS 0x60000660 /end MEASUREMENT
/begin MEASUREMENT PwmCtP_swtConfStdSensSwVersC "" ULONG OneToOne 1 100 0.00 4294967295.00 FORMAT "%13.2" ECU_ADDRESS 0x6000065C /end MEASUREMENT
/begin MEASUREMENT PwmCtP_swtSensMode "" UBYTE OneToOne 1 100 0.00 255.0 FORMAT "%5.1" ECU_ADDRESS 0x6002378D /end MEASUREMENT
/begin MEASUREMENT PwmCtP_swtSensPres "" UBYTE OneToOne 1 100 0.00 255.0 FORMAT "%5.1" ECU_ADDRESS 0x6002378C
 /begin IF_DATA XCPplus 0x0102
  /begin DAQ_EVENT VARIABLE /end DAQ_EVENT
 /end IF_DATA
/end MEASUREMENT
/begin MEASUREMENT PwmCtP_tiPerRaw "" SWORD Time_usec_q1_COMPU 1 100 -32768.00 32767.00 FORMAT "%8.2" ECU_ADDRESS 0x6001FD9C
 /begin IF_DATA XCPplus 0x0102
  /begin DAQ_EVENT VARIABLE /end DAQ_EVENT
 /end IF_DATA
/end MEASUREMENT
/begin MEASUREMENT PwmCtP_tiPerRaw_f "" FLOAT32_IEEE Time_usec_q1_COMPU 1 100 -1.00000000E+037 1.00000000E+037 FORMAT "%13.3" ECU_ADDRESS 0x60001128
 /begin IF_DATA XCPplus 0x0102
  /begin DAQ_EVENT VARIABLE /end DAQ_EVENT
 /end IF_DATA
/end MEASUREMENT
/begin MEASUREMENT PwmCtP_tSensPT1Fltd_mp "" SWORD RBPtCel_i_1p0_2 1 100 -32768.00 32767.00 FORMAT "%8.2" ECU_ADDRESS 0x7000694C /end MEASUREMENT
/begin MEASUREMENT PwmCtP_uRaw "" SWORD Volt 1 100 -6553.600 6553.400 FORMAT "%8.3" ECU_ADDRESS 0x6001FD9A
 /begin IF_DATA XCPplus 0x0102
  /begin DAQ_EVENT VARIABLE /end DAQ_EVENT
 /end IF_DATA
/end MEASUREMENT
/begin MEASUREMENT PwmCtP_uRawPT1Fltd "" SWORD Volt 1 100 -6553.600 6553.400 FORMAT "%8.3" ECU_ADDRESS 0x6001FD98
 /begin IF_DATA XCPplus 0x0102
  /begin DAQ_EVENT VARIABLE /end DAQ_EVENT
 /end IF_DATA
/end MEASUREMENT
/begin MEASUREMENT PwmCtP_uRawPT1FltdSens "" SWORD Volt 1 100 -6553.600 6553.400 FORMAT "%8.3" ECU_ADDRESS 0x6001FD96
 /begin IF_DATA XCPplus 0x0102
  /begin DAQ_EVENT VARIABLE /end DAQ_EVENT
 /end IF_DATA
/end MEASUREMENT
/begin MEASUREMENT PwmCtP_uRawUnFltd "" SWORD Volt 1 100 -6553.600 6553.400 FORMAT "%8.3" ECU_ADDRESS 0x6001FD94
 /begin IF_DATA XCPplus 0x0102
  /begin DAQ_EVENT VARIABLE /end DAQ_EVENT
 /end IF_DATA
/end MEASUREMENT
/begin FUNCTION MoSysCtrl_Co "5.0.0     Monitoring: System Control"
 /begin DEF_CHARACTERISTIC DFC_CtlMsk2.DFC_MoSysCtrlReIni_C DFC_DisblMsk2.DFC_MoSysCtrlReIni_C MoSysCtrl_ctErrReIniAllowd_C MoSysCtrl_ctReIniAllowd_C MoSysCtrl_ctReIniTstDeb_C MoSysCtrl_ctT15RsngEdgDetnAllwd_C MoSysCtrl_ctT15RsngEdgDetnPlausy_C MoSysCtrl_ctT15RsngEdgTurnOff_C MoSysCtrl_stSwtT15PlausEna_C /end DEF_CHARACTERISTIC
 /begin IN_MEASUREMENT Mo_stCplChk Mo_stMoC Mo_stMoCCpl Mo_stMoF Mo_stMoFCpl SyC_ctPostDrvLeave T15_st /end IN_MEASUREMENT
 /begin OUT_MEASUREMENT DFC_st.DFC_MoSysCtrlReIni MoSysCtrl_ctPostDrvLeave MoSysCtrl_flgErrReIniReqMsg MoSysCtrl_flgIrvErrReIniReqMsg MoSysCtrl_flgReIniClr MoSysCtrl_flgReIniReqTrig MoSysCtrl_flgReIniReqTrigMsg MoSysCtrl_flgReIniTestMsg /end OUT_MEASUREMENT
 /begin LOC_MEASUREMENT MoSysCtrlCo_bbLoc1Cpl MoSysCtrlCo_bbOut1Cpl MoSysCtrl_ctErrReIniAllowd MoSysCtrl_ctErrReIniAllowdCpl MoSysCtrl_ctPostDrvLeaveCpl MoSysCtrl_ctPostDrvLeaveOld MoSysCtrl_ctPostDrvLeaveOldCpl MoSysCtrl_ctReIniAllowd MoSysCtrl_ctReIniAllowdCpl MoSysCtrl_ctReIniTst MoSysCtrl_ctT15RsngEdgDetn MoSysCtrl_ctT15RsngEdgDetnCpl MoSysCtrl_ctT15RsngEdgDetnPlausy MoSysCtrl_ctT15RsngEdgDetnPlausyCpl MoSysCtrl_ctT15RsngEdgTurnOff MoSysCtrl_ctT15RsngEdgTurnOffCpl MoSysCtrl_flgErrReIniReq MoSysCtrl_flgReIniReq MoSysCtrl_flgReIniReqAlwd MoSysCtrl_flgT15Old MoSysCtrl_flgT15PlausyErr MoSysCtrl_flgT15PlausyErrOld MoSysCtrl_flgT15RsngEdgTurnOff /end LOC_MEASUREMENT
 FUNCTION_VERSION "5.0.0" /end FUNCTION
/begin FUNCTION MoXEMM_Co "20.4.1    Extended Monitoring: Diagnosis Function for EMM-Module"
 /begin DEF_CHARACTERISTIC DFC_CtlMsk2.DFC_MOXEMM_SMU_ALM0_0_C DFC_CtlMsk2.DFC_MOXEMM_SMU_ALM0_1_C DFC_CtlMsk2.DFC_MOXEMM_SMU_ALM0_10_C DFC_CtlMsk2.DFC_MOXEMM_SMU_ALM0_11_C DFC_CtlMsk2.DFC_MOXEMM_SMU_ALM0_13_C DFC_CtlMsk2.DFC_MOXEMM_SMU_ALM0_14_C DFC_CtlMsk2.DFC_MOXEMM_SMU_ALM0_2_C DFC_CtlMsk2.DFC_MOXEMM_SMU_ALM0_22_C DFC_CtlMsk2.DFC_MOXEMM_SMU_ALM0_23_C DFC_CtlMsk2.DFC_MOXEMM_SMU_ALM0_4_C DFC_CtlMsk2.DFC_MOXEMM_SMU_ALM0_5_C DFC_CtlMsk2.DFC_MOXEMM_SMU_ALM0_7_C DFC_CtlMsk2.DFC_MOXEMM_SMU_ALM0_8_C DFC_CtlMsk2.DFC_MOXEMM_SMU_ALM10_16_C DFC_CtlMsk2.DFC_MOXEMM_SMU_ALM10_17_C DFC_CtlMsk2.DFC_MOXEMM_SMU_ALM10_21_C DFC_CtlMsk2.DFC_MOXEMM_SMU_ALM11_0_C DFC_CtlMsk2.DFC_MOXEMM_SMU_ALM11_1_C DFC_CtlMsk2.DFC_MOXEMM_SMU_ALM11_2_C DFC_CtlMsk2.DFC_MOXEMM_SMU_ALM11_3_C DFC_CtlMsk2.DFC_MOXEMM_SMU_ALM11_4_C DFC_CtlMsk2.DFC_MOXEMM_SMU_ALM11_5_C DFC_CtlMsk2.DFC_MOXEMM_SMU_ALM11_8_C DFC_CtlMsk2.DFC_MOXEMM_SMU_ALM11_9_C DFC_CtlMsk2.DFC_MOXEMM_SMU_ALM1_0_C DFC_CtlMsk2.DFC_MOXEMM_SMU_ALM1_1_C DFC_CtlMsk2.DFC_MOXEMM_SMU_ALM1_10_C DFC_CtlMsk2.DFC_MOXEMM_SMU_ALM1_11_C DFC_CtlMsk2.DFC_MOXEMM_SMU_ALM1_13_C DFC_CtlMsk2.DFC_MOXEMM_SMU_ALM1_14_C DFC_CtlMsk2.DFC_MOXEMM_SMU_ALM1_2_C DFC_CtlMsk2.DFC_MOXEMM_SMU_ALM1_22_C DFC_CtlMsk2.DFC_MOXEMM_SMU_ALM1_23_C DFC_CtlMsk2.DFC_MOXEMM_SMU_ALM1_4_C DFC_CtlMsk2.DFC_MOXEMM_SMU_ALM1_5_C DFC_CtlMsk2.DFC_MOXEMM_SMU_ALM1_7_C DFC_CtlMsk2.DFC_MOXEMM_SMU_ALM1_8_C DFC_CtlMsk2.DFC_MOXEMM_SMU_ALM21_0_C DFC_CtlMsk2.DFC_MOXEMM_SMU_ALM21_16_C DFC_CtlMsk2.DFC_MOXEMM_SMU_ALM21_3_C DFC_CtlMsk2.DFC_MOXEMM_SMU_ALM2_1_C DFC_CtlMsk2.DFC_MOXEMM_SMU_ALM2_10_C DFC_CtlMsk2.DFC_MOXEMM_SMU_ALM2_11_C DFC_CtlMsk2.DFC_MOXEMM_SMU_ALM2_13_C DFC_CtlMsk2.DFC_MOXEMM_SMU_ALM2_14_C DFC_CtlMsk2.DFC_MOXEMM_SMU_ALM2_22_C DFC_CtlMsk2.DFC_MOXEMM_SMU_ALM2_23_C DFC_CtlMsk2.DFC_MOXEMM_SMU_ALM2_4_C DFC_CtlMsk2.DFC_MOXEMM_SMU_ALM2_5_C DFC_CtlMsk2.DFC_MOXEMM_SMU_ALM2_7_C DFC_CtlMsk2.DFC_MOXEMM_SMU_ALM2_8_C DFC_CtlMsk2.DFC_MOXEMM_SMU_ALM6_0_C DFC_CtlMsk2.DFC_MOXEMM_SMU_ALM6_11_C DFC_CtlMsk2.DFC_MOXEMM_SMU_ALM6_12_C DFC_CtlMsk2.DFC_MOXEMM_SMU_ALM6_14_C DFC_CtlMsk2.DFC_MOXEMM_SMU_ALM6_15_C DFC_CtlMsk2.DFC_MOXEMM_SMU_ALM6_17_C DFC_CtlMsk2.DFC_MOXEMM_SMU_ALM6_18_C DFC_CtlMsk2.DFC_MOXEMM_SMU_ALM6_20_C DFC_CtlMsk2.DFC_MOXEMM_SMU_ALM6_21_C DFC_CtlMsk2.DFC_MOXEMM_SMU_ALM6_25_C DFC_CtlMsk2.DFC_MOXEMM_SMU_ALM6_4_C DFC_CtlMsk2.DFC_MOXEMM_SMU_ALM6_5_C DFC_CtlMsk2.DFC_MOXEMM_SMU_ALM6_7_C DFC_CtlMsk2.DFC_MOXEMM_SMU_ALM6_8_C DFC_CtlMsk2.DFC_MOXEMM_SMU_ALM7_1_C DFC_CtlMsk2.DFC_MOXEMM_SMU_ALM7_12_C DFC_CtlMsk2.DFC_MOXEMM_SMU_ALM7_13_C DFC_CtlMsk2.DFC_MOXEMM_SMU_ALM7_14_C DFC_CtlMsk2.DFC_MOXEMM_SMU_ALM7_15_C DFC_CtlMsk2.DFC_MOXEMM_SMU_ALM7_16_C DFC_CtlMsk2.DFC_MOXEMM_SMU_ALM7_17_C DFC_CtlMsk2.DFC_MOXEMM_SMU_ALM7_2_C DFC_CtlMsk2.DFC_MOXEMM_SMU_ALM7_20_C DFC_CtlMsk2.DFC_MOXEMM_SMU_ALM7_25_C DFC_CtlMsk2.DFC_MOXEMM_SMU_ALM7_26_C DFC_CtlMsk2.DFC_MOXEMM_SMU_ALM7_28_C DFC_CtlMsk2.DFC_MOXEMM_SMU_ALM7_29_C DFC_CtlMsk2.DFC_MOXEMM_SMU_ALM7_30_C DFC_CtlMsk2.DFC_MOXEMM_SMU_ALM7_31_C DFC_CtlMsk2.DFC_MOXEMM_SMU_ALM8_0_C DFC_CtlMsk2.DFC_MOXEMM_SMU_ALM8_1_C DFC_CtlMsk2.DFC_MOXEMM_SMU_ALM8_10_C DFC_CtlMsk2.DFC_MOXEMM_SMU_ALM8_11_C DFC_CtlMsk2.DFC_MOXEMM_SMU_ALM8_12_C DFC_CtlMsk2.DFC_MOXEMM_SMU_ALM8_16_C DFC_CtlMsk2.DFC_MOXEMM_SMU_ALM8_18_C DFC_CtlMsk2.DFC_MOXEMM_SMU_ALM8_2_C DFC_CtlMsk2.DFC_MOXEMM_SMU_ALM8_3_C DFC_CtlMsk2.DFC_MOXEMM_SMU_ALM8_31_C DFC_CtlMsk2.DFC_MOXEMM_SMU_ALM8_4_C DFC_CtlMsk2.DFC_MOXEMM_SMU_ALM9_0_C DFC_CtlMsk2.DFC_MOXEMM_SMU_ALM9_15_C DFC_CtlMsk2.DFC_MOXEMM_SMU_ALM9_3_C DFC_CtlMsk2.DFC_MoXEMMHwLTMCUFW_C DFC_CtlMsk2.DFC_MoXEMMHwLTMonBIST_C DFC_CtlMsk2.DFC_MoXEMMHwLTRegMonTest_C DFC_CtlMsk2.DFC_MoXEMMHwLTStbySMUAlvTest_C DFC_CtlMsk2.DFC_MoXEMMHwLTTempSens_C DFC_CtlMsk2.DFC_MoXEMMHwLTUCBCfg_C DFC_DisblMsk2.DFC_MOXEMM_SMU_ALM0_0_C DFC_DisblMsk2.DFC_MOXEMM_SMU_ALM0_1_C DFC_DisblMsk2.DFC_MOXEMM_SMU_ALM0_10_C DFC_DisblMsk2.DFC_MOXEMM_SMU_ALM0_11_C DFC_DisblMsk2.DFC_MOXEMM_SMU_ALM0_13_C DFC_DisblMsk2.DFC_MOXEMM_SMU_ALM0_14_C DFC_DisblMsk2.DFC_MOXEMM_SMU_ALM0_2_C DFC_DisblMsk2.DFC_MOXEMM_SMU_ALM0_22_C DFC_DisblMsk2.DFC_MOXEMM_SMU_ALM0_23_C DFC_DisblMsk2.DFC_MOXEMM_SMU_ALM0_4_C DFC_DisblMsk2.DFC_MOXEMM_SMU_ALM0_5_C DFC_DisblMsk2.DFC_MOXEMM_SMU_ALM0_7_C DFC_DisblMsk2.DFC_MOXEMM_SMU_ALM0_8_C DFC_DisblMsk2.DFC_MOXEMM_SMU_ALM10_16_C DFC_DisblMsk2.DFC_MOXEMM_SMU_ALM10_17_C DFC_DisblMsk2.DFC_MOXEMM_SMU_ALM10_21_C DFC_DisblMsk2.DFC_MOXEMM_SMU_ALM11_0_C DFC_DisblMsk2.DFC_MOXEMM_SMU_ALM11_1_C DFC_DisblMsk2.DFC_MOXEMM_SMU_ALM11_2_C DFC_DisblMsk2.DFC_MOXEMM_SMU_ALM11_3_C DFC_DisblMsk2.DFC_MOXEMM_SMU_ALM11_4_C DFC_DisblMsk2.DFC_MOXEMM_SMU_ALM11_5_C DFC_DisblMsk2.DFC_MOXEMM_SMU_ALM11_8_C DFC_DisblMsk2.DFC_MOXEMM_SMU_ALM11_9_C DFC_DisblMsk2.DFC_MOXEMM_SMU_ALM1_0_C DFC_DisblMsk2.DFC_MOXEMM_SMU_ALM1_1_C DFC_DisblMsk2.DFC_MOXEMM_SMU_ALM1_10_C DFC_DisblMsk2.DFC_MOXEMM_SMU_ALM1_11_C DFC_DisblMsk2.DFC_MOXEMM_SMU_ALM1_13_C DFC_DisblMsk2.DFC_MOXEMM_SMU_ALM1_14_C DFC_DisblMsk2.DFC_MOXEMM_SMU_ALM1_2_C DFC_DisblMsk2.DFC_MOXEMM_SMU_ALM1_22_C DFC_DisblMsk2.DFC_MOXEMM_SMU_ALM1_23_C DFC_DisblMsk2.DFC_MOXEMM_SMU_ALM1_4_C DFC_DisblMsk2.DFC_MOXEMM_SMU_ALM1_5_C DFC_DisblMsk2.DFC_MOXEMM_SMU_ALM1_7_C DFC_DisblMsk2.DFC_MOXEMM_SMU_ALM1_8_C DFC_DisblMsk2.DFC_MOXEMM_SMU_ALM21_0_C DFC_DisblMsk2.DFC_MOXEMM_SMU_ALM21_16_C DFC_DisblMsk2.DFC_MOXEMM_SMU_ALM21_3_C DFC_DisblMsk2.DFC_MOXEMM_SMU_ALM2_1_C DFC_DisblMsk2.DFC_MOXEMM_SMU_ALM2_10_C DFC_DisblMsk2.DFC_MOXEMM_SMU_ALM2_11_C DFC_DisblMsk2.DFC_MOXEMM_SMU_ALM2_13_C DFC_DisblMsk2.DFC_MOXEMM_SMU_ALM2_14_C DFC_DisblMsk2.DFC_MOXEMM_SMU_ALM2_22_C DFC_DisblMsk2.DFC_MOXEMM_SMU_ALM2_23_C DFC_DisblMsk2.DFC_MOXEMM_SMU_ALM2_4_C DFC_DisblMsk2.DFC_MOXEMM_SMU_ALM2_5_C DFC_DisblMsk2.DFC_MOXEMM_SMU_ALM2_7_C DFC_DisblMsk2.DFC_MOXEMM_SMU_ALM2_8_C DFC_DisblMsk2.DFC_MOXEMM_SMU_ALM6_0_C DFC_DisblMsk2.DFC_MOXEMM_SMU_ALM6_11_C DFC_DisblMsk2.DFC_MOXEMM_SMU_ALM6_12_C DFC_DisblMsk2.DFC_MOXEMM_SMU_ALM6_14_C DFC_DisblMsk2.DFC_MOXEMM_SMU_ALM6_15_C DFC_DisblMsk2.DFC_MOXEMM_SMU_ALM6_17_C DFC_DisblMsk2.DFC_MOXEMM_SMU_ALM6_18_C DFC_DisblMsk2.DFC_MOXEMM_SMU_ALM6_20_C DFC_DisblMsk2.DFC_MOXEMM_SMU_ALM6_21_C DFC_DisblMsk2.DFC_MOXEMM_SMU_ALM6_25_C DFC_DisblMsk2.DFC_MOXEMM_SMU_ALM6_4_C DFC_DisblMsk2.DFC_MOXEMM_SMU_ALM6_5_C DFC_DisblMsk2.DFC_MOXEMM_SMU_ALM6_7_C DFC_DisblMsk2.DFC_MOXEMM_SMU_ALM6_8_C DFC_DisblMsk2.DFC_MOXEMM_SMU_ALM7_1_C DFC_DisblMsk2.DFC_MOXEMM_SMU_ALM7_12_C DFC_DisblMsk2.DFC_MOXEMM_SMU_ALM7_13_C DFC_DisblMsk2.DFC_MOXEMM_SMU_ALM7_14_C DFC_DisblMsk2.DFC_MOXEMM_SMU_ALM7_15_C DFC_DisblMsk2.DFC_MOXEMM_SMU_ALM7_16_C DFC_DisblMsk2.DFC_MOXEMM_SMU_ALM7_17_C DFC_DisblMsk2.DFC_MOXEMM_SMU_ALM7_2_C DFC_DisblMsk2.DFC_MOXEMM_SMU_ALM7_20_C DFC_DisblMsk2.DFC_MOXEMM_SMU_ALM7_25_C DFC_DisblMsk2.DFC_MOXEMM_SMU_ALM7_26_C DFC_DisblMsk2.DFC_MOXEMM_SMU_ALM7_28_C DFC_DisblMsk2.DFC_MOXEMM_SMU_ALM7_29_C DFC_DisblMsk2.DFC_MOXEMM_SMU_ALM7_30_C DFC_DisblMsk2.DFC_MOXEMM_SMU_ALM7_31_C DFC_DisblMsk2.DFC_MOXEMM_SMU_ALM8_0_C DFC_DisblMsk2.DFC_MOXEMM_SMU_ALM8_1_C DFC_DisblMsk2.DFC_MOXEMM_SMU_ALM8_10_C DFC_DisblMsk2.DFC_MOXEMM_SMU_ALM8_11_C DFC_DisblMsk2.DFC_MOXEMM_SMU_ALM8_12_C DFC_DisblMsk2.DFC_MOXEMM_SMU_ALM8_16_C DFC_DisblMsk2.DFC_MOXEMM_SMU_ALM8_18_C DFC_DisblMsk2.DFC_MOXEMM_SMU_ALM8_2_C DFC_DisblMsk2.DFC_MOXEMM_SMU_ALM8_3_C DFC_DisblMsk2.DFC_MOXEMM_SMU_ALM8_31_C DFC_DisblMsk2.DFC_MOXEMM_SMU_ALM8_4_C DFC_DisblMsk2.DFC_MOXEMM_SMU_ALM9_0_C DFC_DisblMsk2.DFC_MOXEMM_SMU_ALM9_15_C DFC_DisblMsk2.DFC_MOXEMM_SMU_ALM9_3_C DFC_DisblMsk2.DFC_MoXEMMHwLTMCUFW_C DFC_DisblMsk2.DFC_MoXEMMHwLTMonBIST_C DFC_DisblMsk2.DFC_MoXEMMHwLTRegMonTest_C DFC_DisblMsk2.DFC_MoXEMMHwLTStbySMUAlvTest_C DFC_DisblMsk2.DFC_MoXEMMHwLTTempSens_C DFC_DisblMsk2.DFC_MoXEMMHwLTUCBCfg_C MoXEMM_nrHwLTErrSimn_C MoXEMM_nrSmuAlmErrSimn_C /end DEF_CHARACTERISTIC
 /begin IN_MEASUREMENT MoCEMM_stEmmAlrmsMsg SyC_ctPostDrvLeave /end IN_MEASUREMENT
 /begin OUT_MEASUREMENT DFC_st.DFC_MOXEMM_SMU_ALM0_0 DFC_st.DFC_MOXEMM_SMU_ALM0_1 DFC_st.DFC_MOXEMM_SMU_ALM0_10 DFC_st.DFC_MOXEMM_SMU_ALM0_11 DFC_st.DFC_MOXEMM_SMU_ALM0_13 DFC_st.DFC_MOXEMM_SMU_ALM0_14 DFC_st.DFC_MOXEMM_SMU_ALM0_2 DFC_st.DFC_MOXEMM_SMU_ALM0_22 DFC_st.DFC_MOXEMM_SMU_ALM0_23 DFC_st.DFC_MOXEMM_SMU_ALM0_4 DFC_st.DFC_MOXEMM_SMU_ALM0_5 DFC_st.DFC_MOXEMM_SMU_ALM0_7 DFC_st.DFC_MOXEMM_SMU_ALM0_8 DFC_st.DFC_MOXEMM_SMU_ALM10_16 DFC_st.DFC_MOXEMM_SMU_ALM10_17 DFC_st.DFC_MOXEMM_SMU_ALM10_21 DFC_st.DFC_MOXEMM_SMU_ALM11_0 DFC_st.DFC_MOXEMM_SMU_ALM11_1 DFC_st.DFC_MOXEMM_SMU_ALM11_2 DFC_st.DFC_MOXEMM_SMU_ALM11_3 DFC_st.DFC_MOXEMM_SMU_ALM11_4 DFC_st.DFC_MOXEMM_SMU_ALM11_5 DFC_st.DFC_MOXEMM_SMU_ALM11_8 DFC_st.DFC_MOXEMM_SMU_ALM11_9 DFC_st.DFC_MOXEMM_SMU_ALM1_0 DFC_st.DFC_MOXEMM_SMU_ALM1_1 DFC_st.DFC_MOXEMM_SMU_ALM1_10 DFC_st.DFC_MOXEMM_SMU_ALM1_11 DFC_st.DFC_MOXEMM_SMU_ALM1_13 DFC_st.DFC_MOXEMM_SMU_ALM1_14 DFC_st.DFC_MOXEMM_SMU_ALM1_2 DFC_st.DFC_MOXEMM_SMU_ALM1_22 DFC_st.DFC_MOXEMM_SMU_ALM1_23 DFC_st.DFC_MOXEMM_SMU_ALM1_4 DFC_st.DFC_MOXEMM_SMU_ALM1_5 DFC_st.DFC_MOXEMM_SMU_ALM1_7 DFC_st.DFC_MOXEMM_SMU_ALM1_8 DFC_st.DFC_MOXEMM_SMU_ALM21_0 DFC_st.DFC_MOXEMM_SMU_ALM21_16 DFC_st.DFC_MOXEMM_SMU_ALM21_3 DFC_st.DFC_MOXEMM_SMU_ALM2_1 DFC_st.DFC_MOXEMM_SMU_ALM2_10 DFC_st.DFC_MOXEMM_SMU_ALM2_11 DFC_st.DFC_MOXEMM_SMU_ALM2_13 DFC_st.DFC_MOXEMM_SMU_ALM2_14 DFC_st.DFC_MOXEMM_SMU_ALM2_22 DFC_st.DFC_MOXEMM_SMU_ALM2_23 DFC_st.DFC_MOXEMM_SMU_ALM2_4 DFC_st.DFC_MOXEMM_SMU_ALM2_5 DFC_st.DFC_MOXEMM_SMU_ALM2_7 DFC_st.DFC_MOXEMM_SMU_ALM2_8 DFC_st.DFC_MOXEMM_SMU_ALM6_0 DFC_st.DFC_MOXEMM_SMU_ALM6_11 DFC_st.DFC_MOXEMM_SMU_ALM6_12 DFC_st.DFC_MOXEMM_SMU_ALM6_14 DFC_st.DFC_MOXEMM_SMU_ALM6_15 DFC_st.DFC_MOXEMM_SMU_ALM6_17 DFC_st.DFC_MOXEMM_SMU_ALM6_18 DFC_st.DFC_MOXEMM_SMU_ALM6_20 DFC_st.DFC_MOXEMM_SMU_ALM6_21 DFC_st.DFC_MOXEMM_SMU_ALM6_25 DFC_st.DFC_MOXEMM_SMU_ALM6_4 DFC_st.DFC_MOXEMM_SMU_ALM6_5 DFC_st.DFC_MOXEMM_SMU_ALM6_7 DFC_st.DFC_MOXEMM_SMU_ALM6_8 DFC_st.DFC_MOXEMM_SMU_ALM7_1 DFC_st.DFC_MOXEMM_SMU_ALM7_12 DFC_st.DFC_MOXEMM_SMU_ALM7_13 DFC_st.DFC_MOXEMM_SMU_ALM7_14 DFC_st.DFC_MOXEMM_SMU_ALM7_15 DFC_st.DFC_MOXEMM_SMU_ALM7_16 DFC_st.DFC_MOXEMM_SMU_ALM7_17 DFC_st.DFC_MOXEMM_SMU_ALM7_2 DFC_st.DFC_MOXEMM_SMU_ALM7_20 DFC_st.DFC_MOXEMM_SMU_ALM7_25 DFC_st.DFC_MOXEMM_SMU_ALM7_26 DFC_st.DFC_MOXEMM_SMU_ALM7_28 DFC_st.DFC_MOXEMM_SMU_ALM7_29 DFC_st.DFC_MOXEMM_SMU_ALM7_30 DFC_st.DFC_MOXEMM_SMU_ALM7_31 DFC_st.DFC_MOXEMM_SMU_ALM8_0 DFC_st.DFC_MOXEMM_SMU_ALM8_1 DFC_st.DFC_MOXEMM_SMU_ALM8_10 DFC_st.DFC_MOXEMM_SMU_ALM8_11 DFC_st.DFC_MOXEMM_SMU_ALM8_12 DFC_st.DFC_MOXEMM_SMU_ALM8_16 DFC_st.DFC_MOXEMM_SMU_ALM8_18 DFC_st.DFC_MOXEMM_SMU_ALM8_2 DFC_st.DFC_MOXEMM_SMU_ALM8_3 DFC_st.DFC_MOXEMM_SMU_ALM8_31 DFC_st.DFC_MOXEMM_SMU_ALM8_4 DFC_st.DFC_MOXEMM_SMU_ALM9_0 DFC_st.DFC_MOXEMM_SMU_ALM9_15 DFC_st.DFC_MOXEMM_SMU_ALM9_3 DFC_st.DFC_MoXEMMHwLTMCUFW DFC_st.DFC_MoXEMMHwLTMonBIST DFC_st.DFC_MoXEMMHwLTRegMonTest DFC_st.DFC_MoXEMMHwLTStbySMUAlvTest DFC_st.DFC_MoXEMMHwLTTempSens DFC_st.DFC_MoXEMMHwLTUCBCfg MoXEMM_stEMMAlrms MoXEMM_stEMMAlrmsAftRst /end OUT_MEASUREMENT
 /begin LOC_MEASUREMENT MoXEMM_cntrPostDrvLeaveOld MoXEMM_stHwLTResult /end LOC_MEASUREMENT
 FUNCTION_VERSION "20.4.1" /end FUNCTION
/begin FUNCTION MoXFrm_Co "171.3.0   Extended Monitoring: Frame configuration"
 /begin OUT_MEASUREMENT MoXFrm_Buf_DCDC_283h MoXFrm_Buf_DCDC_293h MoXFrm_Buf_HS3_AUTO_GEARBOX_SWITCH_STATUS MoXFrm_Buf_HVBAT_205h MoXFrm_Buf_HVBAT_325h MoXFrm_Buf_INV_217h MoXFrm_Buf_INV_237 MoXFrm_Buf_INV_427h MoXFrm_Buf_IS_DAT_ABR_50Dh MoXFrm_Buf_IS_DAT_BSI_412h MoXFrm_Buf_IS_DYN_ABR_38Dh MoXFrm_Buf_IS_DYN_VCU_208h MoXFrm_Buf_PDU_BusVoltages_308 MoXFrm_Buf_VCU_211h MoXFrm_Buf_VCU_221h MoXFrm_Buf_VCU_241h MoXFrm_Buf_VCU_281h MoXFrm_Buf_VCU_AIRBAG_351h MoXFrm_Buf_VCU_eBCCM_432h MoXFrm_flgUpdDCDC_283h MoXFrm_flgUpdDCDC_293h MoXFrm_flgUpdHS3_AUTO_GEARBOX_SWITCH_STATUS MoXFrm_flgUpdHVBAT_205h MoXFrm_flgUpdHVBAT_325h MoXFrm_flgUpdINV_217h MoXFrm_flgUpdINV_237 MoXFrm_flgUpdINV_427h MoXFrm_flgUpdIS_DAT_ABR_50Dh MoXFrm_flgUpdIS_DAT_BSI_412h MoXFrm_flgUpdIS_DYN_ABR_38Dh MoXFrm_flgUpdIS_DYN_VCU_208h MoXFrm_flgUpdPDU_BusVoltages_308 MoXFrm_flgUpdVCU_211h MoXFrm_flgUpdVCU_221h MoXFrm_flgUpdVCU_241h MoXFrm_flgUpdVCU_281h MoXFrm_flgUpdVCU_AIRBAG_351h MoXFrm_flgUpdVCU_eBCCM_432h /end OUT_MEASUREMENT
 FUNCTION_VERSION "171.3.0" /end FUNCTION
/begin FUNCTION Mo_Adap "145.0.0   Extended Monitoring: Interface adapter"
 /begin DEF_CHARACTERISTIC MoAdap_nEm01CANRawQlfr_C MoAdap_nEm02CANRawQlfr_C MoAdap_SwtErr_C MoAdap_tqIncTqDmdEM02Qlfr_C MoAdap_tqIncTqDmdQlfr_C /end DEF_CHARACTERISTIC
 /begin IN_MEASUREMENT Brk_stMn Brk_stRed ComEmac_nAct01 ComEmac_nAct02 Gbx_stGearLvr StabyIntv_flgDCSIntv01 StabyIntv_flgTCSIntv01 StabyIntv_tqDCSDes01 StabyIntv_tqTCSDes01 /end IN_MEASUREMENT
 /begin OUT_MEASUREMENT MoFFrm_flgDecTqDmdActv MoFFrm_flgDecTqDmdEM02Actv MoFFrm_flgIncTqDmdActv MoFFrm_flgIncTqDmdEM02Actv MoFFrm_flgRecupInhbnReq MoFFrm_nEm02CANRaw MoFFrm_nEm02CANRawQlfr MoFFrm_tqDecTqDmd MoFFrm_tqDecTqDmdEM02 MoFFrm_tqIncTqDmd MoFFrm_tqIncTqDmdEM02 MoFFrm_tqIncTqDmdEM02Qlfr MoFFrm_tqIncTqDmdQlfr Mo_stIrvErrReacMsg /end OUT_MEASUREMENT
 /begin LOC_MEASUREMENT MoAdap_bbOut1Cpl MoAdap_bbOut2Cpl MoAdap_bbOutCpl /end LOC_MEASUREMENT
 FUNCTION_VERSION "145.0.0" /end FUNCTION
/begin FUNCTION Mo_Conf "14.44.5   Configuration Monitoring" /begin DEF_CHARACTERISTIC MonEgyChrgnDefn_flgVrntCcsPlgLock_C /end DEF_CHARACTERISTIC /begin OUT_MEASUREMENT MonEgyChrgnDefn_flgVrntCcsPlgLock /end OUT_MEASUREMENT /begin LOC_MEASUREMENT MoConf_stErr /end LOC_MEASUREMENT FUNCTION_VERSION "14.44.5" /end FUNCTION
/begin FUNCTION Mo_Glbl "97.14.0   Monitoring: Global definitions"
 /begin DEF_CHARACTERISTIC Mo_cwMstSlave_C Mo_stSwtHyb_C Mo_swtClrCntrMax_C Mo_swtCyclCalUpdt_C Mo_trqIdcMax_C /end DEF_CHARACTERISTIC
 /begin IN_MEASUREMENT SyC_stSub /end IN_MEASUREMENT
 /begin OUT_MEASUREMENT MoGlbl_vblStruct.Mo_stMoC MoGlbl_vblStructCpl.Mo_stCplChk MoGlbl_vblStructCpl.Mo_stMoCCpl Mo_ctRst Mo_ctRstCpl Mo_ctRstMsg Mo_flgICOMsg Mo_stCplChk Mo_stErrHyb Mo_stErrHybCpl Mo_stMoC Mo_stMoCCpl Mo_stMoCExtdTsk Mo_stMoCExtdTskCpl Mo_stMoCExtdTskMsg Mo_stMoCMsg Mo_stMoF Mo_stMoFCpl Mo_stMoFExtdTsk Mo_stMoFExtdTskCpl Mo_stMoFExtdTskMsg Mo_stMoFMsg Mo_stVldR32Chk /end OUT_MEASUREMENT
 /begin LOC_MEASUREMENT MoGlbl_bbLocExtdTskCpl Mo_bAddConPFC Mo_bAddConPFCExtdTsk Mo_bAddDisblPreICORst Mo_bAddDisblPreICORstExtdTsk Mo_bCplChk Mo_bCplChkExtdTsk Mo_bEmgcyAir Mo_bICOL1 Mo_bICOL2 Mo_bICOL2ExtdTsk Mo_bIrvElMIdl Mo_bIrvHybLimpL1 Mo_bIrvHybLimpL2 Mo_bIrvHybP1LimpL2 Mo_bIrvTrqLimL1 Mo_bIrvTrqLimL2 Mo_bLoVltg Mo_bNlh Mo_bRamErr Mo_bRamErrExtdTsk Mo_bRomErr Mo_bSyncLos Mo_stProtRAM /end LOC_MEASUREMENT
 FUNCTION_VERSION "97.14.0" /end FUNCTION
/begin FUNCTION Mo_Inst "619.0.0   Function Monitoring: Instances for MultiCore Structs"
 /begin LOC_MEASUREMENT MoCMem_vblStructCpl_Core1_10ms_Nr1.MoCMem_ctDebErrChkRAMOld MoCMem_vblStructCpl_Core1_10ms_Nr1.MoCMem_ctDebErrChkRAMCpl MoCMem_vblStructCpl_Core1_10ms_Nr1.MoCMem_ctDebHealChkRAMCpl MoCMem_vblStructCpl_Core1_10ms_Nr1.MoCMem_nrRamChkCpl MoCMem_vblStructCpl_Core1_10ms_Nr1.MoCMem_nrStckChkCpl MoCMem_vblStructCpl_Core1_10ms_Nr1.MoCMem_nrCSAChkCpl MoCMem_vblStructCpl_Core1_10ms_Nr1.MoCMem_RamOffsetPtrCpl MoCMem_vblStructCpl_Core1_10ms_Nr1.MoCMem_CSAOffsetPtrCpl MoCMem_vblStructCpl_Core1_10ms_Nr1.MoCMem_StckOffsetPtrCpl MoCMem_vblStructCpl_Core1_10ms_Nr1.Mo_RamCyclicCheckCpl MoCMem_vblStructCpl_Core1_10ms_Nr1.MoCMem_ctLrnRAMCpl MoCMem_vblStructCpl_Core1_10ms_Nr1.MoCMem_tiRAMusOldCpl MoCMem_vblStructCpl_Core1_10ms_Nr1.MoCMem_tiRAMAccusCpl MoCMem_vblStructCpl_Core1_10ms_Nr1.MoCMem_tiRAMusCpl MoCMem_vblStructCpl_Core1_10ms_Nr1.MoCMem_ctLrnErrHdlrCpl MoCMem_vblStructCpl_Core1_10ms_Nr1.MoCMem_tiErrHdlrusOldCpl MoCMem_vblStructCpl_Core1_10ms_Nr1.MoCMem_tiErrHdlrusCpl MoCMem_vblStructCpl_Core1_10ms_Nr1.MoCMem_tiErrHdlrAccusCpl MoCMem_vblStructCpl_Core1_10ms_Nr1.MoCMem_numHealFacCpl MoCMem_vblStructEarlyClearedRAM_Core1_10ms_Nr1.MoCMem_st MoCMem_vblStructEarlyClearedRAM_Core1_10ms_Nr1.MoCMem_stCpl MoCMem_vblStructNVRAM_Core1_10ms_Nr1.MoCMem_ctDebErrChkRAMMaxNv MoCMem_vblStructNVRAM_Core1_10ms_Nr1.MoCMem_ctDebErrChkRAMExcddThdNv MoCMem_vblStruct_Core1_10ms_Nr1.MoCMem_ctDebErrChkRAM MoCMem_vblStruct_Core1_10ms_Nr1.MoCMem_ctDebHealChkRAM MoCMem_vblStruct_Core1_10ms_Nr1.MoCMem_nrRamChkSize MoCMem_vblStruct_Core1_10ms_Nr1.MoCMem_adrChkStckEnd MoCMem_vblStruct_Core1_10ms_Nr1.MoCMem_adrChkStckStrt MoCMem_vblStruct_Core1_10ms_Nr1.MoCMem_adrChkCSAStrt MoCMem_vblStruct_Core1_10ms_Nr1.MoCMem_adrChkCSAEnd MoCMem_vblStruct_Core1_10ms_Nr1.MoCMem_nrRamChk MoCMem_vblStruct_Core1_10ms_Nr1.MoCMem_nrStckChk MoCMem_vblStruct_Core1_10ms_Nr1.MoCMem_nrCSAChk MoCMem_vblStruct_Core1_10ms_Nr1.MoCMem_StckOffsetPtr MoCMem_vblStruct_Core1_10ms_Nr1.MoCMem_CSAOffsetPtr MoCMem_vblStruct_Core1_10ms_Nr1.MoCMem_adrChkStckSP MoCMem_vblStruct_Core1_10ms_Nr1.MoCMem_RamOffsetPtr MoCMem_vblStruct_Core1_10ms_Nr1.MoCMem_ChkRAMStck MoCMem_vblStruct_Core1_10ms_Nr1.MoCMem_ctLrnRAM MoCMem_vblStruct_Core1_10ms_Nr1.MoCMem_tiRAMus MoCMem_vblStruct_Core1_10ms_Nr1.MoCMem_tiRAMusOld MoCMem_vblStruct_Core1_10ms_Nr1.MoCMem_tiRAMAccus MoCMem_vblStruct_Core1_10ms_Nr1.MoCMem_ctLrnErrHdlr MoCMem_vblStruct_Core1_10ms_Nr1.MoCMem_tiErrHdlrusOld MoCMem_vblStruct_Core1_10ms_Nr1.MoCMem_tiErrHdlrus MoCMem_vblStruct_Core1_10ms_Nr1.MoCMem_tiErrHdlrAccus MoCMem_vblStruct_Core1_10ms_Nr1.MoCMem_numHealFac MoCPFC_vblStructCpl_Core1_10ms_Nr1.MoCPFC_cntr MoCPFC_vblStructCpl_Core1_10ms_Nr1.MoCPFC_numChkword MoCPFC_vblStructCpl_Core1_10ms_Nr1.MoCPFC_numChks MoCPFC_vblStructCpl_Core1_10ms_Nr1.MoCPFC_numConCatVal MoCPFC_vblStructCpl_Core1_10ms_Nr1.MoCPFC_cntrRollg MoCPFC_vblStructCpl_Core1_10ms_Nr1.MoCPFC_aryRingBuf MoCPFC_vblStructCpl_Core1_10ms_Nr1.MoCPFC_stWrErr MoCPFC_vblStructCpl_Core1_10ms_Nr1.MoCPFC_RingBuf_pst.startAdr MoCPFC_vblStructCpl_Core1_10ms_Nr1.MoCPFC_RingBuf_pst.size MoCPFC_vblStructCpl_Core1_10ms_Nr1.MoCPFC_RingBuf_pst.head MoCPFC_vblStructCpl_Core1_10ms_Nr1.MoCPFC_RingBuf_pst.tail MoCSCC_varStructCpl_Core1_10ms_Nr1.MoCSCC_stChpIdCpl MoCSCC_varStructCpl_Core1_10ms_Nr1.MoCSCC_cntrDebCpl MoCSCC_varStructCpl_Core1_10ms_Nr1.MoCSCC_stTrmDevCpl MoCSCC_varStructCpl_Core1_10ms_Nr1.MoCSCC_cntrMPURegChkCpl MoCSCC_varStructNVRAM_Core1_10ms_Nr1.MoCSCC_cntrDebMaxNv MoCSCC_varStructNVRAM_Core1_10ms_Nr1.MoCSCC_cntrDebExcddThdNv MoCSCC_varStructNVRAM_Core1_10ms_Nr1.MoCSCC_cntrDebOld MoCSCC_varStruct_Core1_10ms_Nr1.MoCSCC_stErr MoCSCC_varStruct_Core1_10ms_Nr1.MoCSCC_cntrDeb MoCSCC_varStruct_Core1_10ms_Nr1.MoCSCC_stTrmDev MoCSCC_varStruct_Core1_10ms_Nr1.MoCSCC_stChpId MoCSCC_varStruct_Core1_10ms_Nr1.MoCSCC_cntrMPURegChk MoExe_varStructCpl_Core1_10ms_Nr1.MoExe_ctCycCpl MoExe_varStruct_Core1_10ms_Nr1.MoExe_ctCyc MoGlbl_vblStructCpl_Core1_10ms_Nr1.Mo_stCplChk MoGlbl_vblStructCpl_Core1_10ms_Nr1.Mo_stMoCCpl MoGlbl_vblStruct_Core1_10ms_Nr1.Mo_stMoC /end LOC_MEASUREMENT
 FUNCTION_VERSION "619.0.0" /end FUNCTION
/begin FUNCTION MRly_Vld2Lcy "1.11.0    SW Adapter Main Relay Component Package: Mapping Valid to Legacy Interface Elements" /begin IN_MEASUREMENT BattU_uSens DSM_TripChgAndClrFinshd /end IN_MEASUREMENT /begin OUT_MEASUREMENT MRlyst_Sq MRly_ctErlyOpng MRly_st MRly_stAct /end OUT_MEASUREMENT FUNCTION_VERSION "1.11.0" /end FUNCTION
/begin FUNCTION OCWDA_Co "80.5.1    Extended Monitoring: Operation conditions of WDA/ABE shut off"
 /begin DEF_CHARACTERISTIC DFC_CtlMsk2.DFC_OCWDAABEActv_C DFC_CtlMsk2.DFC_OCWDACom_C DFC_CtlMsk2.DFC_OCWDAErrPin_C DFC_CtlMsk2.DFC_OCWDAOvrVltg_C DFC_DisblMsk2.DFC_OCWDAABEActv_C DFC_DisblMsk2.DFC_OCWDACom_C DFC_DisblMsk2.DFC_OCWDAErrPin_C DFC_DisblMsk2.DFC_OCWDAOvrVltg_C OCWDA_ctDebActvErr_C OCWDA_ctDebOvrVltgOn_C OCWDA_stErrSimn_C OCWDA_swtOffRst_C /end DEF_CHARACTERISTIC
 /begin IN_MEASUREMENT BattU_u MoCCom_ctErrFC MoCCom_ctErrMM MoCSOP_stActMsg MoCSOP_stOvl SyC_ctPostDrvLeave /end IN_MEASUREMENT
 /begin OUT_MEASUREMENT DFC_st.DFC_OCWDAABEActv DFC_st.DFC_OCWDACom DFC_st.DFC_OCWDAErrPin DFC_st.DFC_OCWDAOvrVltg OCWDA_stErrMonPtt /end OUT_MEASUREMENT
 /begin LOC_MEASUREMENT OCWDA_cntrPostDrvLeaveOld OCWDA_ctBattU OCWDA_ctDebActvErr OCWDA_ctDebErrNotActv OCWDA_ctDebOvrVltgOn OCWDA_ctTstOCWDA OCWDA_ctTstOvrVltg OCWDA_flgClrDebDFC OCWDA_stABEActv OCWDA_stCheckState OCWDA_stErrPinActv OCWDA_stOvrVltgActv OCWDA_stWDAActv /end LOC_MEASUREMENT
 FUNCTION_VERSION "80.5.1" /end FUNCTION
/begin FUNCTION PLnCChpEna_VD "5500.0.0  Virtual device to enable powerline communication chip"
 /begin DEF_CHARACTERISTIC DDRC_DurDeb.PLnCChp_tiPLnCDeactvnFaildDebOk_C DDRC_DurDeb.PLnCChp_tiPLnCDeactvnFaildDebDef_C DFC_CtlMsk2.DFC_PLnCChpDeactvnFaild_C DFC_DisblMsk2.DFC_PLnCChpDeactvnFaild_C PLnCChp_rCcsPwrLineChpRstHi_C PLnCChp_rCcsPwrLineChpRstLo_C PLnCChp_rCcsPwrSplyEnaOff_C PLnCChp_rCcsPwrSplyEnaOn_C PLnCChp_tiPLnCDeactvnFaild_C PLnCChp_tiVccOutRng_C PLnCChp_uMaxPwrLineChpVcc_C PLnCChp_uMinPwrLineChpVcc_C PLnCChp_uPLnCChpDeactvnDelta_C PLnCChp_uPLnCChpDeactvn_C /end DEF_CHARACTERISTIC
 /begin IN_MEASUREMENT CcsPwrLineChpRst_r CcsPwrLineChpVccEna_r CcsPwrLineChpVcc_u_f HLCCcs_flgPLnCEna /end IN_MEASUREMENT
 /begin OUT_MEASUREMENT DDRC_St.DFC_PLnCChpDeactvnFaild DFC_st.DFC_PLnCChpDeactvnFaild /end OUT_MEASUREMENT
 /begin LOC_MEASUREMENT PLnCChp_flgCcsPwrLineChpVcc PLnCChp_flgPLnCChpDeactvn PLnCChp_flgPLnCChpDeactvnFaild PLnCChp_flgPLnCChpFltDeactvnFaild PLnCChp_flgVccOutRng /end LOC_MEASUREMENT
 FUNCTION_VERSION "5500.0.0" /end FUNCTION
/begin FUNCTION PT_TqDataExt "160.2.0   Determination of relevant torque data delivered to external control units for torque interventions" /begin IN_MEASUREMENT Emac_tqAct01 TrsmEmac_ratTqPrimAxle TrsmEmac_tqLoss01 /end IN_MEASUREMENT /begin OUT_MEASUREMENT PT_tqWhlAct PT_tqWhlActPrimAxle /end OUT_MEASUREMENT FUNCTION_VERSION "160.2.0" /end FUNCTION
/begin FUNCTION PwmCtP_DELib_StdSensDd "10.2.0"
 /begin DEF_CHARACTERISTIC DDRC_DurDeb.PwmCtP_tiSRCMinDebOk_C DDRC_DurDeb.PwmCtP_tiSRCMinDebDef_C DDRC_DurDeb.PwmCtP_tiSRCMaxDebOk_C DDRC_DurDeb.PwmCtP_tiSRCMaxDebDef_C DDRC_RatDeb.PwmCtP_tiSRCMinUDRat_C DDRC_RatDeb.PwmCtP_tiSRCMaxUDRat_C DFC_CtlMsk2.DFC_PwmCtPSRCMin_C DFC_CtlMsk2.DFC_PwmCtPSRCMax_C DFC_DisblMsk2.DFC_PwmCtPSRCMin_C DFC_DisblMsk2.DFC_PwmCtPSRCMax_C PwmCtP_PWMCal.rSRCMax_C PwmCtP_PWMCal.rSRCMin_C PwmCtP_PWMCal.tiSRCMax_C PwmCtP_PWMCal.tiSRCMin_C PwmCtP_PWMSensTransf_f_MAP /end DEF_CHARACTERISTIC
 /begin REF_CHARACTERISTIC PwmCtP_tiPT1Fil_C PwmCtP_TransStg_f.Dfl_r32_C PwmCtP_TransStg_f.stSensId_C /end REF_CHARACTERISTIC
 /begin IN_MEASUREMENT DELib_idxArrSnsr DELib_xArrSnsr PwmCtP_FirRead.cntr PwmCtP_FirRead.flgFirstRun PwmCtP_FirRead.idxArr PwmCtP_FirRead.uSum PwmCtP_stSnsrDdReadCalc PwmCtP_swtConfStdSens2C PwmCtP_swtConfStdSensC PwmCtP_swtConfStdSensSwVersC PwmCtP_uRawPT1FltdSens PwmCtP_uRawUnFltd /end IN_MEASUREMENT
 /begin OUT_MEASUREMENT DDRC_St.DFC_PwmCtPSRCMin DDRC_St.DFC_PwmCtPSRCMax DFC_st.DFC_PwmCtPSRCMin DFC_st.DFC_PwmCtPSRCMax DINH_nrActvInhReas.FId_PwmCtPSSpMon DINH_stFId.FId_PwmCtPSSpMon PwmCtP_FirCalc.cntrAvrgZr PwmCtP_FirCalc.flgRdDne PwmCtP_FirCalc.uRawAvrg PwmCtP_FirCalc.uRawFir PwmCtP_iActSensCpl PwmCtP_iActSensUnFltd PwmCtP_iActSens_f PwmCtP_rDtyCycRaw PwmCtP_rDtyCycRaw_f PwmCtP_stSnsrDdCalc PwmCtP_swtSensPres PwmCtP_tiPerRaw PwmCtP_tiPerRaw_f PwmCtP_uRaw /end OUT_MEASUREMENT
 /begin LOC_MEASUREMENT PwmCtP_DDstSnsrState_mp PwmCtP_tSensPT1Fltd_mp /end LOC_MEASUREMENT
 FUNCTION_VERSION "10.2.0" /end FUNCTION
/begin FUNCTION PwmCtP_DELib_StdSensDdRead "10.4.0" /begin DEF_CHARACTERISTIC PwmCtP_tiPT1Fil_C /end DEF_CHARACTERISTIC
 /begin IN_MEASUREMENT PwmCtP_FirCalc.cntrAvrgZr PwmCtP_FirCalc.flgRdDne PwmCtP_FirCalc.uRawAvrg PwmCtP_FirCalc.uRawFir PwmCtP_swtConfStdSens2C PwmCtP_swtConfStdSensC /end IN_MEASUREMENT
 /begin OUT_MEASUREMENT PwmCtP_FirRead.cntr PwmCtP_FirRead.flgFirstRun PwmCtP_FirRead.idxArr PwmCtP_FirRead.uSum PwmCtP_stSnsrDdReadCalc PwmCtP_uRawPT1Fltd PwmCtP_uRawPT1FltdSens PwmCtP_uRawUnFltd /end OUT_MEASUREMENT
 FUNCTION_VERSION "10.4.0" /end FUNCTION
/begin FUNCTION PwmCtP_DELib_StdSensDdSENTSlowRead "3.2.0"
 /begin IN_MEASUREMENT PwmCtP_swtConfStdSens2C PwmCtP_swtConfStdSensC PwmCtP_swtConfStdSensSwVersC /end IN_MEASUREMENT
 FUNCTION_VERSION "3.2.0" /end FUNCTION
/begin FUNCTION PwmCtP_DELib_StdSensExtDiag "8.1.0"
 /begin IN_MEASUREMENT DELib_idxArrSnsr DELib_xArrSnsr DSM_TripChgFinshd PwmCtP_swtConfStdSensC PwmCtP_swtConfStdSensSwVersC SyC_stSub /end IN_MEASUREMENT
 FUNCTION_VERSION "8.1.0" /end FUNCTION
/begin FUNCTION PwmCtP_DELib_StdSensInin "8.2.0"
 /begin DEF_CHARACTERISTIC PwmCtP_swtConfStdSens2_C PwmCtP_swtConfStdSensSwVers162_C PwmCtP_swtConfStdSens_C /end DEF_CHARACTERISTIC
 /begin REF_CHARACTERISTIC PwmCtP_tiPT1Fil_C /end REF_CHARACTERISTIC
 /begin OUT_MEASUREMENT PwmCtP_swtConfStdSens2C PwmCtP_swtConfStdSensC PwmCtP_swtConfStdSensSwVersC PwmCtP_swtSensMode /end OUT_MEASUREMENT
 FUNCTION_VERSION "8.2.0" /end FUNCTION
/begin FUNCTION PwmCtP_DELib_StdSensVd "11.0.0"
 /begin DEF_CHARACTERISTIC PwmCtP_diActGradLim_f_C PwmCtP_iActDflVal_f_C PwmCtP_iActHiLimit_f_C PwmCtP_iActLoLimit_f_C PwmCtP_RmpSlp_f.Pos_C PwmCtP_RmpSlp_f.Neg_C PwmCtP_tiPT1_f_C PwmCtP_TransStg_f.Dfl_r32_C PwmCtP_TransStg_f.stSensId_C /end DEF_CHARACTERISTIC
 /begin IN_MEASUREMENT PwmCtP_iActSens_f PwmCtP_stSnsrDdCalc PwmCtP_swtConfStdSensC PwmCtP_swtConfStdSensSwVersC /end IN_MEASUREMENT
 /begin OUT_MEASUREMENT DINH_nrActvInhReas.FId_PwmCtPFrzVal DINH_nrActvInhReas.FId_PwmCtPRplVal DINH_stFId.FId_PwmCtPFrzVal DINH_stFId.FId_PwmCtPRplVal PwmCtP_iActSensOffsCorrd_f PwmCtP_iActUnFlt_f PwmCtP_iAct_f PwmCtP_iAct_f_Sq /end OUT_MEASUREMENT
 /begin LOC_MEASUREMENT PwmCtP_iActSensGradLim_f_mp /end LOC_MEASUREMENT
 FUNCTION_VERSION "11.0.0" /end FUNCTION
/begin FUNCTION PwmCtP_DELib_StdSensVdMon "9.2.0"
 /begin DEF_CHARACTERISTIC DDRC_DurDeb.PwmCtP_tiPhysRngHiDebOk_C DDRC_DurDeb.PwmCtP_tiPhysRngHiDebDef_C DDRC_DurDeb.PwmCtP_tiPhysRngLoDebOk_C DDRC_DurDeb.PwmCtP_tiPhysRngLoDebDef_C DDRC_RatDeb.PwmCtP_tiPhysRngHiUDRat_C DDRC_RatDeb.PwmCtP_tiPhysRngLoUDRat_C DFC_CtlMsk2.DFC_PwmCtPPhysRngHi_C DFC_CtlMsk2.DFC_PwmCtPPhysRngLo_C DFC_CtlMsk2.DFC_PwmCtPTmpErr_C DFC_DisblMsk2.DFC_PwmCtPPhysRngHi_C DFC_DisblMsk2.DFC_PwmCtPPhysRngLo_C DFC_DisblMsk2.DFC_PwmCtPTmpErr_C PwmCtP_iActEnhPhysSRCMax_f_MAP PwmCtP_iActEnhPhysSRCMin_f_MAP PwmCtP_numStdSens_C PwmCtP_numTempErrDef_C PwmCtP_numtSel_C PwmCtP_stEnhPhysSRCRls_MAP PwmCtP_tiEngOnMin_C PwmCtP_tiTempErrOk_C PwmCtP_tSnsrMax_f_C PwmCtP_tSnsrMin_f_C /end DEF_CHARACTERISTIC
 /begin IN_MEASUREMENT CoEng_tiNormal DELib_idxArrSnsr DELib_xArrSnsr DSM_TripChgFinshd Epm_nEng InjCtl_qSetUnBal PwmCtP_iActSens_f PwmCtP_stSnsrDdCalc PwmCtP_swtConfStdSensC PwmCtP_swtConfStdSensSwVersC /end IN_MEASUREMENT
 /begin OUT_MEASUREMENT DDRC_St.DFC_PwmCtPPhysRngHi DDRC_St.DFC_PwmCtPPhysRngLo DFC_st.DFC_PwmCtPPhysRngHi DFC_st.DFC_PwmCtPPhysRngLo DFC_st.DFC_PwmCtPTmpErr DINH_nrActvInhReas.FId_PwmCtPPhysRng DINH_nrActvInhReas.FId_PwmCtPTmpErrCnt DINH_stFId.FId_PwmCtPPhysRng DINH_stFId.FId_PwmCtPTmpErrCnt PwmCtP_stSnsrActv /end OUT_MEASUREMENT
 /begin LOC_MEASUREMENT PwmCtP_iActDynThresPhysRngHi_f_mp PwmCtP_iActDynThresPhysRngLo_f_mp PwmCtP_stMonStdSens /end LOC_MEASUREMENT
 FUNCTION_VERSION "9.2.0" /end FUNCTION
/begin COMPU_METHOD B_TRUE "" TAB_VERB "%6.3" "" COMPU_TAB_REF B_TRUE /end COMPU_METHOD
/begin COMPU_VTAB B_TRUE "" TAB_VERB 2 0 "FALSE" 1 "TRUE" /end COMPU_VTAB
/begin COMPU_METHOD DDRCTime_ms "" RAT_FUNC "%6.1" "ms" COEFFS 0 1 0 0 0 10 /end COMPU_METHOD
/begin COMPU_METHOD DDRC_Ratio "" TAB_VERB "%6.3" "-" COMPU_TAB_REF DDRC_Ratio /end COMPU_METHOD
/begin COMPU_VTAB DDRC_Ratio "" TAB_VERB 4 1 "Ratio1" 2 "Ratio2" 3 "Ratio3" 4 "Ratio4" /end COMPU_VTAB
/begin COMPU_METHOD DELIB_ALLTEMP_VERB_COMPU "" TAB_VERB "%6.3" "" COMPU_TAB_REF DELIB_ALLTEMP_VERB_COMPU /end COMPU_METHOD
/begin COMPU_VTAB DELIB_ALLTEMP_VERB_COMPU "" TAB_VERB 6 85 "ACCHRGRINTKT" 86 "DCCHRGRINTKT" 0 "ENVT" 89 "HEATRCORET" 254 "DFLTEMP" 255 "NOTEMP" /end COMPU_VTAB
/begin COMPU_METHOD DFC_OneToOne "" RAT_FUNC "%6.2" "-" COEFFS 0 1 0 0 0 1 /end COMPU_METHOD
/begin COMPU_METHOD DFES_OneToOne "" RAT_FUNC "%6.2" "-" COEFFS 0 1 0 0 0 1 /end COMPU_METHOD
/begin COMPU_METHOD DINH_ct_Compu "" RAT_FUNC "%6.0" "" COEFFS 0 -1 4096 0 0 1 /end COMPU_METHOD
/begin COMPU_METHOD DtyCyc "" RAT_FUNC "%6.4" "%" COEFFS 0 100 0 0 0 1 /end COMPU_METHOD
/begin COMPU_METHOD EngN "" RAT_FUNC "%6.3" "rpm" COEFFS 0 2 0 0 0 1 /end COMPU_METHOD
/begin COMPU_METHOD InjMass "" RAT_FUNC "%6.4" "mg/hub" COEFFS 0 100 0 0 0 1 /end COMPU_METHOD
/begin COMPU_METHOD md_q0p1 "" RAT_FUNC "%6.3" "Nm" COEFFS 0 10 0 0 0 1 /end COMPU_METHOD
/begin COMPU_METHOD MoXEMM_HwLTErrorSimnCode_VERB "" TAB_VERB "%6.3" "" COMPU_TAB_REF MoXEMM_HwLTErrorSimnCode_VERB /end COMPU_METHOD
/begin COMPU_VTAB MoXEMM_HwLTErrorSimnCode_VERB "" TAB_VERB 12 0 "MoXEMM_NO_ERROR" 1 "MoXEMMHwLTMCUFW" 2 "MoXEMMHwLTStbySMUAlvTest" 3 "MoXEMMHwLTMonBIST" 4 "MoXEMMHwLTRegMonTest" 5 "MoXEMMHwLTTempSens" 6 "MoXEMMHwLTUCBCfg" 7 "RESERVED_7" 8 "RESERVED_8" 9 "MoXEMMHwLTMBIST" 10 "MoXEMMHwLTLBIST" 65535 "MoXEMM_CLR_ERROR" /end COMPU_VTAB
/begin COMPU_METHOD MoXEMM_SMUErrorSimnCode_VERB "" TAB_VERB "%6.3" "" COMPU_TAB_REF MoXEMM_SMUErrorSimnCode_VERB /end COMPU_METHOD
/begin COMPU_VTAB MoXEMM_SMUErrorSimnCode_VERB "" TAB_VERB 450 0 "MoXEMM_NO_ERROR" 1 "MoXEMM_SMU_ALM_0_0" 2 "MoXEMM_SMU_ALM_0_1" 3 "MoXEMM_SMU_ALM_0_2" 4 "MoXEMM_reserved_0_3" 5 "MoXEMM_SMU_ALM_0_4" 6 "MoXEMM_SMU_ALM_0_5" 7 "MoXEMM_reserved_0_6" 8 "MoXEMM_SMU_ALM_0_7" 9 "MoXEMM_SMU_ALM_0_8" 10 "MoXEMM_reserved_0_9" 11 "MoXEMM_SMU_ALM_0_10" 12 "MoXEMM_SMU_ALM_0_11" 13 "MoXEMM_reserved_0_12" 14 "MoXEMM_SMU_ALM_0_13" 15 "MoXEMM_SMU_ALM_0_14" 16 "MoXEMM_reserved_0_15" 17 "MoXEMM_reserved_0_16" 18 "MoXEMM_reserved_0_17" 19 "MoXEMM_reserved_0_18" 20 "MoXEMM_reserved_0_19" 21 "MoXEMM_reserved_0_20" 22 "MoXEMM_reserved_0_21" 23 "MoXEMM_SMU_ALM_0_22" 24 "MoXEMM_SMU_ALM_0_23" 25 "MoXEMM_reserved_0_24" 26 "MoXEMM_reserved_0_25" 27 "MoXEMM_reserved_0_26" 28 "MoXEMM_reserved_0_27" 29 "MoXEMM_reserved_0_28" 30 "MoXEMM_reserved_0_29" 31 "MoXEMM_reserved_0_30" 32 "MoXEMM_reserved_0_31" 33 "MoXEMM_SMU_ALM_1_0" 34 "MoXEMM_SMU_ALM_1_1" 35 "MoXEMM_SMU_ALM_1_2" 36 "MoXEMM_reserved_1_3" 37 "MoXEMM_SMU_ALM_1_4" 38 "MoXEMM_SMU_ALM_1_5" 39 "MoXEMM_reserved_1_6" 40 "MoXEMM_SMU_ALM_1_7" 41 "MoXEMM_SMU_ALM_1_8" 42 "MoXEMM_reserved_1_9" 43 "MoXEMM_SMU_ALM_1_10" 44 "MoXEMM_SMU_ALM_1_11" 45 "MoXEMM_reserved_1_12" 46 "MoXEMM_SMU_ALM_1_13" 47 "MoXEMM_SMU_ALM_1_14" 48 "MoXEMM_reserved_1_15" 49 "MoXEMM_reserved_1_16" 50 "MoXEMM_reserved_1_17" 51 "MoXEMM_reserved_1_18" 52 "MoXEMM_reserved_1_19" 53 "MoXEMM_reserved_1_20" 54 "MoXEMM_reserved_1_21" 55 "MoXEMM_SMU_ALM_1_22" 56 "MoXEMM_SMU_ALM_1_23" 57 "MoXEMM_reserved_1_24" 58 "MoXEMM_reserved_1_25" 59 "MoXEMM_reserved_1_26" 60 "MoXEMM_reserved_1_27" 61 "MoXEMM_reserved_1_28" 62 "MoXEMM_reserved_1_29" 63 "MoXEMM_reserved_1_30" 64 "MoXEMM_reserved_1_31" 65 "MoXEMM_reserved_2_0" 66 "MoXEMM_SMU_ALM_2_1" 67 "MoXEMM_reserved_2_2" 68 "MoXEMM_reserved_2_3" 69 "MoXEMM_SMU_ALM_2_4" 70 "MoXEMM_SMU_ALM_2_5" 71 "MoXEMM_reserved_2_6" 72 "MoXEMM_SMU_ALM_2_7" 73 "MoXEMM_SMU_ALM_2_8" 74 "MoXEMM_reserved_2_9" 75 "MoXEMM_SMU_ALM_2_10" 76 "MoXEMM_SMU_ALM_2_11" 77 "MoXEMM_reserved_2_12" 78 "MoXEMM_SMU_ALM_2_13" 79 "MoXEMM_SMU_ALM_2_14" 80 "MoXEMM_reserved_2_15" 81 "MoXEMM_reserved_2_16" 82 "MoXEMM_reserved_2_17" 83 "MoXEMM_reserved_2_18" 84 "MoXEMM_reserved_2_19" 85 "MoXEMM_reserved_2_20" 86 "MoXEMM_reserved_2_21" 87 "MoXEMM_SMU_ALM_2_22" 88 "MoXEMM_SMU_ALM_2_23" 89 "MoXEMM_reserved_2_24" 90 "MoXEMM_reserved_2_25" 91 "MoXEMM_reserved_2_26" 92 "MoXEMM_reserved_2_27" 93 "MoXEMM_reserved_2_28" 94 "MoXEMM_reserved_2_29" 95 "MoXEMM_reserved_2_30" 96 "MoXEMM_reserved_2_31" 97 "MoXEMM_reserved_3_0" 98 "MoXEMM_reserved_3_1" 99 "MoXEMM_reserved_3_2" 100 "MoXEMM_reserved_3_3" 101 "MoXEMM_reserved_3_4" 102 "MoXEMM_reserved_3_5" 103 "MoXEMM_reserved_3_6" 104 "MoXEMM_reserved_3_7" 105 "MoXEMM_reserved_3_8" 106 "MoXEMM_reserved_3_9" 107 "MoXEMM_reserved_3_10" 108 "MoXEMM_reserved_3_11" 109 "MoXEMM_reserved_3_12" 110 "MoXEMM_reserved_3_13" 111 "MoXEMM_reserved_3_14" 112 "MoXEMM_reserved_3_15" 113 "MoXEMM_reserved_3_16" 114 "MoXEMM_reserved_3_17" 115 "MoXEMM_reserved_3_18" 116 "MoXEMM_reserved_3_19" 117 "MoXEMM_reserved_3_20" 118 "MoXEMM_reserved_3_21" 119 "MoXEMM_reserved_3_22" 120 "MoXEMM_reserved_3_23" 121 "MoXEMM_reserved_3_24" 122 "MoXEMM_reserved_3_25" 123 "MoXEMM_reserved_3_26" 124 "MoXEMM_reserved_3_27" 125 "MoXEMM_reserved_3_28" 126 "MoXEMM_reserved_3_29" 127 "MoXEMM_reserved_3_30" 128 "MoXEMM_reserved_3_31" 129 "MoXEMM_reserved_4_0" 130 "MoXEMM_reserved_4_1" 131 "MoXEMM_reserved_4_2" 132 "MoXEMM_reserved_4_3" 133 "MoXEMM_reserved_4_4" 134 "MoXEMM_reserved_4_5" 135 "MoXEMM_reserved_4_6" 136 "MoXEMM_reserved_4_7" 137 "MoXEMM_reserved_4_8" 138 "MoXEMM_reserved_4_9" 139 "MoXEMM_reserved_4_10" 140 "MoXEMM_reserved_4_11" 141 "MoXEMM_reserved_4_12" 142 "MoXEMM_reserved_4_13" 143 "MoXEMM_reserved_4_14" 144 "MoXEMM_reserved_4_15" 145 "MoXEMM_reserved_4_16" 146 "MoXEMM_reserved_4_17" 147 "MoXEMM_reserved_4_18" 148 "MoXEMM_reserved_4_19" 149 "MoXEMM_reserved_4_20" 150 "MoXEMM_reserved_4_21" 151 "MoXEMM_reserved_4_22" 152 "MoXEMM_reserved_4_23" 153 "MoXEMM_reserved_4_24" 154 "MoXEMM_reserved_4_25" 155 "MoXEMM_reserved_4_26" 156 "MoXEMM_reserved_4_27" 157 "MoXEMM_reserved_4_28" 158 "MoXEMM_reserved_4_29" 159 "MoXEMM_reserved_4_30" 160 "MoXEMM_reserved_4_31" 161 "MoXEMM_reserved_5_0" 162 "MoXEMM_reserved_5_1" 163 "MoXEMM_reserved_5_2" 164 "MoXEMM_reserved_5_3" 165 "MoXEMM_reserved_5_4" 166 "MoXEMM_reserved_5_5" 167 "MoXEMM_reserved_5_6" 168 "MoXEMM_reserved_5_7" 169 "MoXEMM_reserved_5_8" 170 "MoXEMM_reserved_5_9" 171 "MoXEMM_reserved_5_10" 172 "MoXEMM_reserved_5_11" 173 "MoXEMM_reserved_5_12" 174 "MoXEMM_reserved_5_13" 175 "MoXEMM_reserved_5_14" 176 "MoXEMM_reserved_5_15" 177 "MoXEMM_reserved_5_16" 178 "MoXEMM_reserved_5_17" 179 "MoXEMM_reserved_5_18" 180 "MoXEMM_reserved_5_19" 181 "MoXEMM_reserved_5_20" 182 "MoXEMM_reserved_5_21" 183 "MoXEMM_reserved_5_22" 184 "MoXEMM_reserved_5_23" 185 "MoXEMM_reserved_5_24" 186 "MoXEMM_reserved_5_25" 187 "MoXEMM_reserved_5_26" 188 "MoXEMM_reserved_5_27" 189 "MoXEMM_reserved_5_28" 190 "MoXEMM_reserved_5_29" 191 "MoXEMM_reserved_5_30" 192 "MoXEMM_reserved_5_31" 193 "MoXEMM_SMU_ALM_6_0" 194 "MoXEMM_reserved_6_1" 195 "MoXEMM_reserved_6_2" 196 "MoXEMM_reserved_6_3" 197 "MoXEMM_SMU_ALM_6_4" 198 "MoXEMM_SMU_ALM_6_5" 199 "MoXEMM_reserved_6_6" 200 "MoXEMM_SMU_ALM_6_7" 201 "MoXEMM_SMU_ALM_6_8" 202 "MoXEMM_reserved_6_9" 203 "MoXEMM_reserved_6_10" 204 "MoXEMM_SMU_ALM_6_11" 205 "MoXEMM_SMU_ALM_6_12" 206 "MoXEMM_reserved_6_13" 207 "MoXEMM_SMU_ALM_6_14" 208 "MoXEMM_SMU_ALM_6_15" 209 "MoXEMM_reserved_6_16" 210 "MoXEMM_SMU_ALM_6_17" 211 "MoXEMM_SMU_ALM_6_18" 212 "MoXEMM_reserved_6_19" 213 "MoXEMM_SMU_ALM_6_20" 214 "MoXEMM_SMU_ALM_6_21" 215 "MoXEMM_reserved_6_22" 216 "MoXEMM_reserved_6_23" 217 "MoXEMM_reserved_6_24" 218 "MoXEMM_SMU_ALM_6_25" 219 "MoXEMM_reserved_6_26" 220 "MoXEMM_reserved_6_27" 221 "MoXEMM_reserved_6_28" 222 "MoXEMM_reserved_6_29" 223 "MoXEMM_reserved_6_30" 224 "MoXEMM_reserved_6_31" 225 "MoXEMM_reserved_7_0" 226 "MoXEMM_SMU_ALM_7_1" 227 "MoXEMM_SMU_ALM_7_2" 228 "MoXEMM_reserved_7_3" 229 "MoXEMM_reserved_7_4" 230 "MoXEMM_reserved_7_5" 231 "MoXEMM_reserved_7_6" 232 "MoXEMM_reserved_7_7" 233 "MoXEMM_reserved_7_8" 234 "MoXEMM_reserved_7_9" 235 "MoXEMM_reserved_7_10" 236 "MoXEMM_reserved_7_11" 237 "MoXEMM_SMU_ALM_7_12" 238 "MoXEMM_SMU_ALM_7_13" 239 "MoXEMM_SMU_ALM_7_14" 240 "MoXEMM_SMU_ALM_7_15" 241 "MoXEMM_SMU_ALM_7_16" 242 "MoXEMM_SMU_ALM_7_17" 243 "MoXEMM_reserved_7_18" 244 "MoXEMM_reserved_7_19" 245 "MoXEMM_SMU_ALM_7_20" 246 "MoXEMM_reserved_7_21" 247 "MoXEMM_reserved_7_22" 248 "MoXEMM_reserved_7_23" 249 "MoXEMM_reserved_7_24" 250 "MoXEMM_SMU_ALM_7_25" 251 "MoXEMM_SMU_ALM_7_26" 252 "MoXEMM_reserved_7_27" 253 "MoXEMM_SMU_ALM_7_28" 254 "MoXEMM_SMU_ALM_7_29" 255 "MoXEMM_SMU_ALM_7_30" 256 "MoXEMM_SMU_ALM_7_31" 257 "MoXEMM_SMU_ALM_8_0" 258 "MoXEMM_SMU_ALM_8_1" 259 "MoXEMM_SMU_ALM_8_2" 260 "MoXEMM_SMU_ALM_8_3" 261 "MoXEMM_SMU_ALM_8_4" 262 "MoXEMM_reserved_8_5" 263 "MoXEMM_reserved_8_6" 264 "MoXEMM_reserved_8_7" 265 "MoXEMM_SMU_ALM_8_8" 266 "MoXEMM_SMU_ALM_8_9" 267 "MoXEMM_SMU_ALM_8_10" 268 "MoXEMM_SMU_ALM_8_11" 269 "MoXEMM_SMU_ALM_8_12" 270 "MoXEMM_reserved_8_13" 271 "MoXEMM_reserved_8_14" 272 "MoXEMM_reserved_8_15" 273 "MoXEMM_SMU_ALM_8_16" 274 "MoXEMM_reserved_8_17" 275 "MoXEMM_SMU_ALM_8_18" 276 "MoXEMM_reserved_8_19" 277 "MoXEMM_reserved_8_20" 278 "MoXEMM_reserved_8_21" 279 "MoXEMM_reserved_8_22" 280 "MoXEMM_reserved_8_23" 281 "MoXEMM_reserved_8_24" 282 "MoXEMM_reserved_8_25" 283 "MoXEMM_reserved_8_26" 284 "MoXEMM_reserved_8_27" 285 "MoXEMM_reserved_8_28" 286 "MoXEMM_reserved_8_29" 287 "MoXEMM_SMU_ALM_8_30" 288 "MoXEMM_SMU_ALM_8_31" 289 "MoXEMM_SMU_ALM_9_0" 290 "MoXEMM_SMU_ALM_9_1" 291 "MoXEMM_reserved_9_2" 292 "MoXEMM_SMU_ALM_9_3" 293 "MoXEMM_reserved_9_4" 294 "MoXEMM_reserved_9_5" 295 "MoXEMM_reserved_9_6" 296 "MoXEMM_reserved_9_7" 297 "MoXEMM_reserved_9_8" 298 "MoXEMM_reserved_9_9" 299 "MoXEMM_reserved_9_10" 300 "MoXEMM_reserved_9_11" 301 "MoXEMM_reserved_9_12" 302 "MoXEMM_reserved_9_13" 303 "MoXEMM_reserved_9_14" 304 "MoXEMM_SMU_ALM_9_15" 305 "MoXEMM_reserved_9_16" 306 "MoXEMM_reserved_9_17" 307 "MoXEMM_reserved_9_18" 308 "MoXEMM_reserved_9_19" 309 "MoXEMM_reserved_9_20" 310 "MoXEMM_reserved_9_21" 311 "MoXEMM_reserved_9_22" 312 "MoXEMM_reserved_9_23" 313 "MoXEMM_reserved_9_24" 314 "MoXEMM_reserved_9_25" 315 "MoXEMM_reserved_9_26" 316 "MoXEMM_reserved_9_27" 317 "MoXEMM_reserved_9_28" 318 "MoXEMM_reserved_9_29" 319 "MoXEMM_reserved_9_30" 320 "MoXEMM_reserved_9_31" 321 "MoXEMM_reserved_10_0" 322 "MoXEMM_reserved_10_1" 323 "MoXEMM_reserved_10_2" 324 "MoXEMM_reserved_10_3" 325 "MoXEMM_reserved_10_4" 326 "MoXEMM_reserved_10_5" 327 "MoXEMM_reserved_10_6" 328 "MoXEMM_reserved_10_7" 329 "MoXEMM_reserved_10_8" 330 "MoXEMM_reserved_10_9" 331 "MoXEMM_reserved_10_10" 332 "MoXEMM_reserved_10_11" 333 "MoXEMM_reserved_10_12" 334 "MoXEMM_reserved_10_13" 335 "MoXEMM_reserved_10_14" 336 "MoXEMM_reserved_10_15" 337 "MoXEMM_SMU_ALM_10_16" 338 "MoXEMM_SMU_ALM_10_17" 339 "MoXEMM_reserved_10_18" 340 "MoXEMM_reserved_10_19" 341 "MoXEMM_reserved_10_20" 342 "MoXEMM_SMU_ALM_10_21" 343 "MoXEMM_reserved_10_22" 344 "MoXEMM_reserved_10_23" 345 "MoXEMM_reserved_10_24" 346 "MoXEMM_reserved_10_25" 347 "MoXEMM_reserved_10_26" 348 "MoXEMM_reserved_10_27" 349 "MoXEMM_reserved_10_28" 350 "MoXEMM_reserved_10_29" 351 "MoXEMM_reserved_10_30" 352 "MoXEMM_reserved_10_31" 353 "MoXEMM_SMU_ALM_11_0" 354 "MoXEMM_SMU_ALM_11_1" 355 "MoXEMM_SMU_ALM_11_2" 356 "MoXEMM_SMU_ALM_11_3" 357 "MoXEMM_SMU_ALM_11_4" 358 "MoXEMM_SMU_ALM_11_5" 359 "MoXEMM_reserved_11_6" 360 "MoXEMM_reserved_11_7" 361 "MoXEMM_SMU_ALM_11_8" 362 "MoXEMM_SMU_ALM_11_9" 363 "MoXEMM_reserved_11_10" 364 "MoXEMM_reserved_11_11" 365 "MoXEMM_reserved_11_12" 366 "MoXEMM_reserved_11_13" 367 "MoXEMM_reserved_11_14" 368 "MoXEMM_reserved_11_15" 369 "MoXEMM_reserved_11_16" 370 "MoXEMM_reserved_11_17" 371 "MoXEMM_reserved_11_18" 372 "MoXEMM_reserved_11_19" 373 "MoXEMM_reserved_11_20" 374 "MoXEMM_reserved_11_21" 375 "MoXEMM_reserved_11_22" 376 "MoXEMM_reserved_11_23" 377 "MoXEMM_reserved_11_24" 378 "MoXEMM_reserved_11_25" 379 "MoXEMM_reserved_11_26" 380 "MoXEMM_reserved_11_27" 381 "MoXEMM_reserved_11_28" 382 "MoXEMM_reserved_11_29" 383 "MoXEMM_reserved_11_30" 384 "MoXEMM_reserved_11_31" 641 "MoXEMM_reserved_20_0" 642 "MoXEMM_reserved_20_1" 643 "MoXEMM_reserved_20_2" 644 "MoXEMM_reserved_20_3" 645 "MoXEMM_reserved_20_4" 646 "MoXEMM_reserved_20_5" 647 "MoXEMM_reserved_20_6" 648 "MoXEMM_reserved_20_7" 649 "MoXEMM_reserved_20_8" 650 "MoXEMM_reserved_20_9" 651 "MoXEMM_reserved_20_10" 652 "MoXEMM_reserved_20_11" 653 "MoXEMM_reserved_20_12" 654 "MoXEMM_reserved_20_13" 655 "MoXEMM_reserved_20_14" 656 "MoXEMM_reserved_20_15" 657 "MoXEMM_reserved_20_16" 658 "MoXEMM_reserved_20_17" 659 "MoXEMM_reserved_20_18" 660 "MoXEMM_reserved_20_19" 661 "MoXEMM_reserved_20_20" 662 "MoXEMM_reserved_20_21" 663 "MoXEMM_reserved_20_22" 664 "MoXEMM_reserved_20_23" 665 "MoXEMM_reserved_20_24" 666 "MoXEMM_reserved_20_25" 667 "MoXEMM_reserved_20_26" 668 "MoXEMM_reserved_20_27" 669 "MoXEMM_reserved_20_28" 670 "MoXEMM_reserved_20_29" 671 "MoXEMM_reserved_20_30" 672 "MoXEMM_reserved_20_31" 673 "MoXEMM_SMU_ALM_21_0" 674 "MoXEMM_reserved_21_1" 675 "MoXEMM_reserved_21_2" 676 "MoXEMM_SMU_ALM_21_3" 677 "MoXEMM_reserved_21_4" 678 "MoXEMM_reserved_21_5" 679 "MoXEMM_reserved_21_6" 680 "MoXEMM_reserved_21_7" 681 "MoXEMM_reserved_21_8" 682 "MoXEMM_reserved_21_9" 683 "MoXEMM_reserved_21_10" 684 "MoXEMM_reserved_21_11" 685 "MoXEMM_reserved_21_12" 686 "MoXEMM_reserved_21_13" 687 "MoXEMM_reserved_21_14" 688 "MoXEMM_reserved_21_15" 689 "MoXEMM_SMU_ALM_21_16" 690 "MoXEMM_reserved_21_17" 691 "MoXEMM_reserved_21_18" 692 "MoXEMM_reserved_21_19" 693 "MoXEMM_reserved_21_20" 694 "MoXEMM_reserved_21_21" 695 "MoXEMM_reserved_21_22" 696 "MoXEMM_reserved_21_23" 697 "MoXEMM_reserved_21_24" 698 "MoXEMM_reserved_21_25" 699 "MoXEMM_reserved_21_26" 700 "MoXEMM_reserved_21_27" 701 "MoXEMM_reserved_21_28" 702 "MoXEMM_reserved_21_29" 703 "MoXEMM_reserved_21_30" 704 "MoXEMM_reserved_21_31" 65535 "MoXEMM_CLR_ERROR" /end COMPU_VTAB
/begin COMPU_METHOD nmot_q1 "" RAT_FUNC "%6.2" "1/min" COEFFS 0 1 0 0 0 1 /end COMPU_METHOD
/begin COMPU_METHOD OCWDA_stErrSimn_C_compu_VERB "" TAB_VERB "%6.3" "" COMPU_TAB_REF OCWDA_stErrSimn_C_compu_VERB /end COMPU_METHOD
/begin COMPU_VTAB OCWDA_stErrSimn_C_compu_VERB "" TAB_VERB 9 0 "OCWDA_CO_SIMN_OFF" 1 "OCWDA_CO_SIMNERRPINON" 2 "OCWDA_CO_SIMNERRPINOFF" 3 "OCWDA_CO_SIMNWDAACTV" 4 "OCWDA_CO_SIMNWDAOFF" 5 "OCWDA_CO_SIMNOVRVLTG" 6 "OCWDA_CO_SIMNNORMVLTG" 7 "OCWDA_CO_SIMNABEACTV" 8 "OCWDA_CO_SIMNABEOFF" /end COMPU_VTAB
/begin COMPU_METHOD OCWDA_swtOffRst_C_compu_VERB "" TAB_VERB "%6.3" "" COMPU_TAB_REF OCWDA_swtOffRst_C_compu_VERB /end COMPU_METHOD
/begin COMPU_VTAB OCWDA_swtOffRst_C_compu_VERB "" TAB_VERB 2 0 "OCWDA_RESET_ACTIVE" 1 "OCWDA_RESET_INACTIVE" /end COMPU_VTAB
/begin COMPU_METHOD OneToOne "" RAT_FUNC "%6.2" "-" COEFFS 0 1 0 0 0 1 /end COMPU_METHOD
/begin COMPU_METHOD Prc "" RAT_FUNC "%6.4" "%" COEFFS 0 81.92 0 0 0 1 /end COMPU_METHOD
/begin COMPU_METHOD q1_A_DIV_s "" RAT_FUNC "%6.2" "A/s" COEFFS 0 1 0 0 0 1 /end COMPU_METHOD
/begin COMPU_METHOD RBPtCel_i_1p0_2 "" RAT_FUNC "%6.2" "A" COEFFS 0 1 0 0 0 1 /end COMPU_METHOD
/begin COMPU_METHOD RBPtCel_Perc_1p0_1 "" RAT_FUNC "%6.2" "%" COEFFS 0 1 0 0 0 1 /end COMPU_METHOD
/begin COMPU_METHOD RBPtCel_ti_1p0_2 "" RAT_FUNC "%6.2" "s" COEFFS 0 1 0 0 0 1 /end COMPU_METHOD
/begin COMPU_METHOD RBPtCel_t_1p0_3 "" RAT_FUNC "%6.2" "Deg C" COEFFS 0 1 0 0 0 1 /end COMPU_METHOD
/begin COMPU_METHOD RBPtCel_u_0p001_1 "" RAT_FUNC "%6.5" "V" COEFFS 0 1000 0 0 0 1 /end COMPU_METHOD
/begin COMPU_METHOD SEAWTRP_TYPAVL_SC_Compu "" TAB_VERB "%6.3" "" COMPU_TAB_REF SEAWTRP_TYPAVL_SC_Compu /end COMPU_METHOD
/begin COMPU_VTAB SEAWTRP_TYPAVL_SC_Compu "" TAB_VERB 2 0 "False" 1 "True" /end COMPU_VTAB
/begin COMPU_METHOD SEAWTRT_TYPAVL_SC_Compu "" TAB_VERB "%6.3" "" COMPU_TAB_REF SEAWTRT_TYPAVL_SC_Compu /end COMPU_METHOD
/begin COMPU_VTAB SEAWTRT_TYPAVL_SC_Compu "" TAB_VERB 2 0 "False" 1 "True" /end COMPU_VTAB
/begin COMPU_METHOD SECUPCK_SC_Compu "" TAB_VERB "%6.3" "" COMPU_TAB_REF SECUPCK_SC_Compu /end COMPU_METHOD
/begin COMPU_VTAB SECUPCK_SC_Compu "" TAB_VERB 4 0 "None" 1 "SecuMgr" 2 "EcuSecu_HSM" 3 "EcuSecu_SSM" /end COMPU_VTAB
/begin COMPU_METHOD SENT_SC_Compu "" TAB_VERB "%6.3" "" COMPU_TAB_REF SENT_SC_Compu /end COMPU_METHOD
/begin COMPU_VTAB SENT_SC_Compu "" TAB_VERB 2 0 "False" 1 "True" /end COMPU_VTAB
/begin COMPU_METHOD SEPAIRVOLTHRVLVUS_SC_Compu "" TAB_VERB "%6.3" "" COMPU_TAB_REF SEPAIRVOLTHRVLVUS_SC_Compu /end COMPU_METHOD
/begin COMPU_VTAB SEPAIRVOLTHRVLVUS_SC_Compu "" TAB_VERB 2 0 "False" 1 "True" /end COMPU_VTAB
/begin COMPU_METHOD SETPOINTCALC_TRQBASED_SY_Compu "" TAB_VERB "%6.3" "" COMPU_TAB_REF SETPOINTCALC_TRQBASED_SY_Compu /end COMPU_METHOD
/begin COMPU_VTAB SETPOINTCALC_TRQBASED_SY_Compu "" TAB_VERB 2 0 "QUANTITY" 1 "TORQUE" /end COMPU_VTAB
/begin COMPU_METHOD SIA_GENR_SY_Compu "" RAT_FUNC "%6.2" "" COEFFS 0 1 0 0 0 1 /end COMPU_METHOD
/begin COMPU_METHOD SIA_PRJ_ID_SY_Compu "" RAT_FUNC "%6.2" "" COEFFS 0 1 0 0 0 1 /end COMPU_METHOD
/begin COMPU_METHOD SIGNALS_OBDDIDSUPRT_SC_Compu "" TAB_VERB "%6.3" "" COMPU_TAB_REF SIGNALS_OBDDIDSUPRT_SC_Compu /end COMPU_METHOD
/begin COMPU_VTAB SIGNALS_OBDDIDSUPRT_SC_Compu "" TAB_VERB 2 0 "Disabled" 1 "Enabled" /end COMPU_VTAB
/begin COMPU_METHOD Signals_OneToOne "" RAT_FUNC "%6.2" "" COEFFS 0 1 0 0 0 1 /end COMPU_METHOD
/begin COMPU_METHOD SigQly_COMPU_VERB "" TAB_VERB "%6.3" "" COMPU_TAB_REF SigQly_COMPU_VERB /end COMPU_METHOD
/begin COMPU_VTAB SigQly_COMPU_VERB "" TAB_VERB 16 0 "SIGQLY_NOTCALC" 1 "SIGQLY_INIT" 2 "SIGQLY_OK" 3 "SIGQLY_MODEL" 4 "SIGQLY_REPLACEMENT" 5 "SIGQLY_FROZEN" 6 "SIGQLY_INVALID" 7 "SIGQLY_RESERVED_7" 8 "SIGQLY_RESERVED_8" 9 "SIGQLY_RESERVED_9" 10 "SIGQLY_RESERVED_10" 11 "SIGQLY_RESERVED_11" 12 "SIGQLY_RESERVED_12" 13 "SIGQLY_RESERVED_13" 14 "SIGQLY_RESERVED_14" 15 "SIGQLY_RESERVED_15" /end COMPU_VTAB
/begin COMPU_METHOD Sig_I15031_LeanAppl_SY_Compu "" RAT_FUNC "%6.2" "" COEFFS 0 1 0 0 0 1 /end COMPU_METHOD
/begin COMPU_METHOD Soot_gPerLtr "" RAT_FUNC "%6.4" "g/l" COEFFS 0 100 0 0 0 1 /end COMPU_METHOD
/begin COMPU_METHOD SotMassPerDist "" RAT_FUNC "%7.6" "g/km" COEFFS 0 10000 0 0 0 1 /end COMPU_METHOD
/begin COMPU_METHOD SotMassPerSec "" RAT_FUNC "%6.3" "g/s" COEFFS 0 10 0 0 0 1 /end COMPU_METHOD
/begin COMPU_METHOD SotMassPerTime "" RAT_FUNC "%6.4" "mg/s" COEFFS 0 100 0 0 0 1 /end COMPU_METHOD
/begin COMPU_METHOD SotMsPerkm_COMPU "" RAT_FUNC "%6.5" "g/km" COEFFS 0 8192 0 0 0 1 /end COMPU_METHOD
/begin COMPU_METHOD SotMs_KgPrSec_COMPU "" RAT_FUNC "%6.2" "kg/s" COEFFS 0 1 0 0 0 1 /end COMPU_METHOD
/begin COMPU_METHOD SOxMassPerTime "" RAT_FUNC "%7.6" "mg/s" COEFFS 0 10000 0 0 0 1 /end COMPU_METHOD
/begin COMPU_METHOD SpaVel "" RAT_FUNC "%6.1" "l/h" COEFFS 0 0.1 0 0 0 1 /end COMPU_METHOD
/begin COMPU_METHOD SPDLIM_SY_Compu "" TAB_VERB "%6.3" "" COMPU_TAB_REF SPDLIM_SY_Compu /end COMPU_METHOD
/begin COMPU_VTAB SPDLIM_SY_Compu "" TAB_VERB 2 0 "False" 1 "True" /end COMPU_VTAB
/begin COMPU_METHOD SpecHeatFine "" RAT_FUNC "%6.3" "J/Kg/K" COEFFS 0 5 0 0 0 1 /end COMPU_METHOD
/begin COMPU_METHOD SpecificHeat "" RAT_FUNC "%7.6" "J/g/K" COEFFS 0 10000 0 0 0 1 /end COMPU_METHOD
/begin COMPU_METHOD SPPLCOOLTPMPRLY_TYPAVL_SC_Compu "" TAB_VERB "%6.3" "" COMPU_TAB_REF SPPLCOOLTPMPRLY_TYPAVL_SC_Compu /end COMPU_METHOD
/begin COMPU_VTAB SPPLCOOLTPMPRLY_TYPAVL_SC_Compu "" TAB_VERB 2 0 "False" 1 "True" /end COMPU_VTAB
/begin COMPU_METHOD SqrVltg_s "" RAT_FUNC "%6.3" "V^2s" COEFFS 0 10 0 0 0 1 /end COMPU_METHOD
/begin COMPU_METHOD stroke_pml "" RAT_FUNC "%6.3" "1/ml" COEFFS 0 10 0 0 0 1 /end COMPU_METHOD
/begin COMPU_METHOD STSP_SY_Compu "" TAB_VERB "%6.3" "" COMPU_TAB_REF STSP_SY_Compu /end COMPU_METHOD
/begin COMPU_VTAB STSP_SY_Compu "" TAB_VERB 2 0 "FALSE" 1 "TRUE" /end COMPU_VTAB
/begin COMPU_METHOD SVCrnt_mA_COMPU "" RAT_FUNC "%6.1" "mA" COEFFS 0 0.0341 0 0 0 1 /end COMPU_METHOD
/begin COMPU_METHOD SVSLMP_DISPSUPRT_SC_Compu "" TAB_VERB "%6.3" "" COMPU_TAB_REF SVSLMP_DISPSUPRT_SC_Compu /end COMPU_METHOD
/begin COMPU_VTAB SVSLMP_DISPSUPRT_SC_Compu "" TAB_VERB 2 0 "False" 1 "True" /end COMPU_VTAB
/begin COMPU_METHOD SVSLMP_PWRSTG_SY_Compu "" TAB_VERB "%6.3" "" COMPU_TAB_REF SVSLMP_PWRSTG_SY_Compu /end COMPU_METHOD
/begin COMPU_VTAB SVSLMP_PWRSTG_SY_Compu "" TAB_VERB 2 0 "False" 1 "True" /end COMPU_VTAB
/begin COMPU_METHOD TimeDelay_s "" RAT_FUNC "%6.1" "s" COEFFS 0 0 1 0 0.00023283064365387 0 /end COMPU_METHOD
/begin COMPU_METHOD Time_Dt "" RAT_FUNC "%9.8" "s" COEFFS 0 1000000 0 0 0 1 /end COMPU_METHOD
/begin COMPU_METHOD Time_ms "" RAT_FUNC "%6.1" "ms" COEFFS 0 0.1 0 0 0 1 /end COMPU_METHOD
/begin COMPU_METHOD Time_msec_q1_COMPU "" RAT_FUNC "%6.2" "ms" COEFFS 0 1 0 0 0 1 /end COMPU_METHOD
/begin COMPU_METHOD Time_usec_q1_COMPU "" RAT_FUNC "%6.2" "us" COEFFS 0 1 0 0 0 1 /end COMPU_METHOD
/begin COMPU_METHOD TrqPrpHigh "" RAT_FUNC "%6.3" "Nm" COEFFS 0 10 0 0 0 1 /end COMPU_METHOD
/begin COMPU_METHOD Volt "" RAT_FUNC "%6.3" "mV" COEFFS 0 5 0 0 0 1 /end COMPU_METHOD
/begin COMPU_METHOD default "" RAT_FUNC "%6.2" "" COEFFS 0 1 0 0 0 1 /end COMPU_METHOD
/begin RECORD_LAYOUT Kw_Wr32 FNC_VALUES 1 FLOAT32_IEEE COLUMN_DIR DIRECT /end RECORD_LAYOUT
/begin RECORD_LAYOUT Kw_Wu8 FNC_VALUES 1 UBYTE COLUMN_DIR DIRECT /end RECORD_LAYOUT
/begin RECORD_LAYOUT RB_Map_R32R32_R32_sao NO_AXIS_PTS_X 1 ULONG NO_AXIS_PTS_Y 2 ULONG AXIS_PTS_X 3 FLOAT32_IEEE INDEX_INCR DIRECT AXIS_PTS_Y 4 FLOAT32_IEEE INDEX_INCR DIRECT FNC_VALUES 5 FLOAT32_IEEE COLUMN_DIR DIRECT STATIC_ADDRESS_OFFSETS /end RECORD_LAYOUT
/begin RECORD_LAYOUT RB_Map_S16S16_R32_sao NO_AXIS_PTS_X 1 SWORD NO_AXIS_PTS_Y 2 SWORD AXIS_PTS_X 3 SWORD INDEX_INCR DIRECT AXIS_PTS_Y 4 SWORD INDEX_INCR DIRECT FNC_VALUES 5 FLOAT32_IEEE COLUMN_DIR DIRECT STATIC_ADDRESS_OFFSETS /end RECORD_LAYOUT
/begin RECORD_LAYOUT RB_Map_S16S16_U8_sao NO_AXIS_PTS_X 1 SWORD NO_AXIS_PTS_Y 2 SWORD AXIS_PTS_X 3 SWORD INDEX_INCR DIRECT AXIS_PTS_Y 4 SWORD INDEX_INCR DIRECT FNC_VALUES 5 UBYTE COLUMN_DIR DIRECT STATIC_ADDRESS_OFFSETS /end RECORD_LAYOUT
/begin RECORD_LAYOUT RB_Val_Ws16 FNC_VALUES 1 SWORD COLUMN_DIR DIRECT /end RECORD_LAYOUT
/begin RECORD_LAYOUT RB_Val_Ws32 FNC_VALUES 1 SLONG COLUMN_DIR DIRECT /end RECORD_LAYOUT
/begin RECORD_LAYOUT RB_Val_Wu16 FNC_VALUES 1 UWORD COLUMN_DIR DIRECT /end RECORD_LAYOUT
/begin RECORD_LAYOUT RB_Val_Wu8 FNC_VALUES 1 UBYTE COLUMN_DIR DIRECT /end RECORD_LAYOUT
/begin RECORD_LAYOUT Val_Wr32 FNC_VALUES 1 FLOAT32_IEEE COLUMN_DIR DIRECT /end RECORD_LAYOUT
/begin RECORD_LAYOUT Val_Ws16 FNC_VALUES 1 SWORD COLUMN_DIR DIRECT /end RECORD_LAYOUT
/begin RECORD_LAYOUT Val_Ws32 FNC_VALUES 1 SLONG COLUMN_DIR DIRECT /end RECORD_LAYOUT
/begin RECORD_LAYOUT Val_Wu16 FNC_VALUES 1 UWORD COLUMN_DIR DIRECT /end RECORD_LAYOUT
/begin RECORD_LAYOUT Val_Wu32 FNC_VALUES 1 ULONG COLUMN_DIR DIRECT /end RECORD_LAYOUT
/begin RECORD_LAYOUT Val_Wu8 FNC_VALUES 1 UBYTE COLUMN_DIR DIRECT /end RECORD_LAYOUT
/end MODULE
/end PROJECT

ASAP2_VERSION 1 70
/begin PROJECT MDG1C "VC1CP091_STLA_N_D061I3"
/begin HEADER "" VERSION "VC1CP091_STLA_N_D061I3" PROJECT_NO MDG1C /end HEADER
/begin MODULE DIM ""
/begin MOD_COMMON "" BYTE_ORDER MSB_LAST ALIGNMENT_BYTE 1 ALIGNMENT_WORD 2 ALIGNMENT_LONG 4 ALIGNMENT_INT64 4 ALIGNMENT_FLOAT32_IEEE 4 ALIGNMENT_FLOAT64_IEEE 4 DATA_SIZE 32 /end MOD_COMMON
/begin CHARACTERISTIC CAN_tiHoldNwCom_C "Calibration used in the calculation of CAN_tiHoldNwCom" VALUE 0x80251618 RB_Val_Wu16 65535.00 Time_msec_q1_COMPU 0.00 65535.00 FORMAT "%8.2" /end CHARACTERISTIC
/begin CHARACTERISTIC ComChrgr_flgChrgrErrLvl_C "OBC Fault level signal quality" VALUE 0x8025161A RB_Val_Wu8 255.0 OneToOne 0.00 255.0 FORMAT "%5.1" /end CHARACTERISTIC
/begin CHARACTERISTIC ComChrgr_stChrgr_CUR "Operating mode of OBC to VCU sent as an information." CURVE 0x8025161B RB_Curve_U8_U8 255.0 OneToOne 0.00 255.0 FORMAT "%5.1"
 /begin AXIS_DESCR STD_AXIS ComChrgr_stChrgrRx OneToOne 8 0.00 255.0 FORMAT "%5.1" DEPOSIT ABSOLUTE /end AXIS_DESCR
/end CHARACTERISTIC
/begin CHARACTERISTIC ComChrg_stMod_Cur "Curve used in the calculation of ComChrg_stMod" CURVE 0x8025162C RB_Curve_U8_U8 255.0 OneToOne 0.00 255.0 FORMAT "%5.1"
 /begin AXIS_DESCR STD_AXIS SWAdp_stModLoc OneToOne 7 0.00 9.000 FORMAT "%5.3" EXTENDED_LIMITS 0.00 255.0 DEPOSIT ABSOLUTE /end AXIS_DESCR
/end CHARACTERISTIC
/begin CHARACTERISTIC ComEmac_dtqAbstMaxRmpNeg_C "" VALUE 0x8025163C RB_Val_Ws32 6553599.99847 RmpTrq -3276800.00000 3276799.99847 FORMAT "%13.5" /end CHARACTERISTIC
/begin CHARACTERISTIC ComEmac_dtqAbstMaxRmpPos_MAP "" MAP 0x80251640 RB_Map_S16S16_S32_sao 6553599.99847 RmpTrq -3276800.00000 3276799.99847 FORMAT "%13.5"
 /begin AXIS_DESCR STD_AXIS Emac_nAct01 nmot_q1 12 -32768.00 32767.00 FORMAT "%8.2" DEPOSIT ABSOLUTE /end AXIS_DESCR
 /begin AXIS_DESCR STD_AXIS ElM_t01 Temp_Cels 8 -3549.940 3003.560 FORMAT "%8.3" DEPOSIT ABSOLUTE /end AXIS_DESCR
/end CHARACTERISTIC
/begin CHARACTERISTIC ComEmac_stMod_CUR "Acknowledgement for VCU Control mode request" CURVE 0x802517EC RB_Curve_U8_U8 255.0 OneToOne 0.00 255.0 FORMAT "%5.1"
 /begin AXIS_DESCR STD_AXIS ComEmac_stMod01Rx OneToOne 8 0.00 7.000 FORMAT "%5.3" EXTENDED_LIMITS 0.00 255.0 DEPOSIT ABSOLUTE /end AXIS_DESCR
/end CHARACTERISTIC
/begin CHARACTERISTIC ComEmac_tqAbstMaxThd_CUR "" CURVE 0x802517FE RB_Curve_S16_S16 6553.500 Trq -3276.800 3276.700 FORMAT "%8.3"
 /begin AXIS_DESCR STD_AXIS Emac_nAct01 nmot_q1 12 -32768.00 32767.00 FORMAT "%8.2" DEPOSIT ABSOLUTE /end AXIS_DESCR
/end CHARACTERISTIC
/begin CHARACTERISTIC CommDev_tiPostOperationWkuPls_C "Post Operation Wakeup request calibration" VALUE 0x80251830 RB_Val_Ws16 655.3500 Time_s -327.6800 327.6700 FORMAT "%8.4" /end CHARACTERISTIC
/begin CHARACTERISTIC Com_AllwChrgnLwSOC_C "Calibration used in the calculation of Com_stHvBattOperModDes" VALUE 0x80251832 RB_Val_Ws16 799.9878 Prc -400.0000 399.9878 FORMAT "%8.4" /end CHARACTERISTIC
/begin CHARACTERISTIC Com_egyHvbAvl_SqDelay_C "Calibartion delay for Energy available" VALUE 0x80251834 RB_Val_Wu16 65535.00 Time_msec_q1_COMPU 0.00 65535.00 FORMAT "%8.2" /end CHARACTERISTIC
/begin CHARACTERISTIC Com_flgAllwChrgnPrkBrkOff_C "" VALUE 0x80251836 RB_Val_Wboolean 1.00000000000 B_TRUE 0.00 1.00000000000 FORMAT "%13.11" /end CHARACTERISTIC
/begin CHARACTERISTIC Com_iHvbActMeasdInv_C "HV Battery measured current" VALUE 0x80251837 RB_Val_Wboolean 1.00000000000 B_TRUE 0.00 1.00000000000 FORMAT "%13.11" /end CHARACTERISTIC
/begin CHARACTERISTIC Com_pwrMaxDchaSho_C "Calibration used to set or release DFC_PwrMaxDchaShoLo" VALUE 0x80251838 RB_Val_Wu16 160.0000 q0p1_kW 0.00 160.0000 FORMAT "%8.4" EXTENDED_LIMITS 0.00 6553.500 /end CHARACTERISTIC
/begin CHARACTERISTIC Com_qHvbTotCp_C "Calibration message of Com_qHvbTotCp" VALUE 0x8025183A RB_Val_Ws16 8191.875 RBPtCel_q_0p125_1 -4096.000 4095.875 FORMAT "%8.3" /end CHARACTERISTIC
/begin CHARACTERISTIC Com_stCmdHvBattCntctr_CUR "Curve to calculate Request from VCU to open the battery contactor" CURVE 0x8025183C RB_Curve_U8_U8 255.0 OneToOne 0.00 255.0 FORMAT "%5.1"
 /begin AXIS_DESCR STD_AXIS HvBatt_stOperModDes OneToOne 3 0.00 255.0 FORMAT "%5.1" DEPOSIT ABSOLUTE /end AXIS_DESCR
/end CHARACTERISTIC
/begin CHARACTERISTIC Com_stDcdcOperModAct_CUR "DCDC Internal fault levels" CURVE 0x80251843 RB_Curve_U8_U8 255.0 OneToOne 0.00 255.0 FORMAT "%5.1"
 /begin AXIS_DESCR STD_AXIS Com_stDcdcOperModActRx OneToOne 8 0.00 255.0 FORMAT "%5.1" DEPOSIT ABSOLUTE /end AXIS_DESCR
/end CHARACTERISTIC
/begin CHARACTERISTIC Com_stDcdcShutoffErr_C "Caliration for Com_stDcdcShutoffErr" VALUE 0x80251854 RB_Val_Wu8 255.0 OneToOne 0.00 255.0 FORMAT "%5.1" /end CHARACTERISTIC
/begin CHARACTERISTIC Com_stDcdcShutoffErr_Sq_C "Stubbbing for Com_stDcdcShutoffErr_Sq" VALUE 0x80251855 RB_Val_Wu8 15.0000000000 SigQly_COMPU_VERB 0.00 15.0000000000 FORMAT "%13.10" /end CHARACTERISTIC
/begin CHARACTERISTIC Com_stDcdcT30C_C "Calibration for Com_stDcdcT30" VALUE 0x80251856 RB_Val_Wu8 255.0 OneToOne 0.00 255.0 FORMAT "%5.1" /end CHARACTERISTIC
/begin CHARACTERISTIC Com_stDcdcT30C_Sq_C "Stubbing for Com_stDcdcT30C_Sq" VALUE 0x80251857 RB_Val_Wu8 15.0000000000 SigQly_COMPU_VERB 0.00 15.0000000000 FORMAT "%13.10" /end CHARACTERISTIC
/begin CHARACTERISTIC Com_stDcdcVltgErr_C "Calibration for Com_stDcdcVltgEr" VALUE 0x80251858 RB_Val_Wu8 255.0 OneToOne 0.00 255.0 FORMAT "%5.1" /end CHARACTERISTIC
/begin CHARACTERISTIC Com_stDcdcVltgErr_Sq_C "Stubbing for Com_stDcdcVltgErr_Sq" VALUE 0x80251859 RB_Val_Wu8 15.0000000000 SigQly_COMPU_VERB 0.00 15.0000000000 FORMAT "%13.10" /end CHARACTERISTIC
/begin CHARACTERISTIC Com_stDrvDoor_C "calibration for Driver Door" VALUE 0x8025185A RB_Val_Wu8 255.0 OneToOne 0.00 255.0 FORMAT "%5.1" /end CHARACTERISTIC
/begin CHARACTERISTIC Com_stDrvModPosn_CUR "PRND Info" CURVE 0x8025185B RB_Curve_U8_U8 7.000 OneToOne 0.00 7.000 FORMAT "%5.3" EXTENDED_LIMITS 0.00 255.0
 /begin AXIS_DESCR STD_AXIS SWAdp_stPosnLoc OneToOne 8 0.00 7.000 FORMAT "%5.3" EXTENDED_LIMITS 0.00 255.0 DEPOSIT ABSOLUTE /end AXIS_DESCR
/end CHARACTERISTIC
/begin CHARACTERISTIC Com_stHvBattOperModDes_CUR "Curve to calculate Command from VCU to HVBAT to operate in a specific state" CURVE 0x8025186C RB_Curve_U8_U8 255.0 OneToOne 0.00 255.0 FORMAT "%5.1"
 /begin AXIS_DESCR STD_AXIS HvBatt_stOperModDes OneToOne 8 0.00 255.0 FORMAT "%5.1" DEPOSIT ABSOLUTE /end AXIS_DESCR
/end CHARACTERISTIC
/begin CHARACTERISTIC Com_stHvbFlt1_C "calibration mask to enabledisable Com_stHvbFlt fault mapping" VALUE 0x8025187D RB_Val_Wboolean 1.00000000000 B_TRUE 0.00 1.00000000000 FORMAT "%13.11" /end CHARACTERISTIC
/begin CHARACTERISTIC Com_stHvbFlt2_C "calibration mask to enabledisable Com_stHvbFlt fault mapping" VALUE 0x8025187E RB_Val_Wboolean 1.00000000000 B_TRUE 0.00 1.00000000000 FORMAT "%13.11" /end CHARACTERISTIC
/begin CHARACTERISTIC Com_stHvbFlt3_C "calibration mask to enabledisable Com_stHvbFlt fault mapping" VALUE 0x8025187F RB_Val_Wboolean 1.00000000000 B_TRUE 0.00 1.00000000000 FORMAT "%13.11" /end CHARACTERISTIC
/begin CHARACTERISTIC Com_stHvbFltLvl_C "HVBAT fault level indication" VALUE 0x80251880 RB_Val_Wboolean 1.00000000000 B_TRUE 0.00 1.00000000000 FORMAT "%13.11" /end CHARACTERISTIC
/begin CHARACTERISTIC Com_stHvbMod_CUR "Battery operating mode" CURVE 0x80251881 RB_Curve_U8_U8 255.0 OneToOne 0.00 255.0 FORMAT "%5.1"
 /begin AXIS_DESCR STD_AXIS Com_stHvbModRx OneToOne 16 0.00 15.00 FORMAT "%5.2" EXTENDED_LIMITS 0.00 255.0 DEPOSIT ABSOLUTE /end AXIS_DESCR
/end CHARACTERISTIC
/begin CHARACTERISTIC Com_stSoc_CUR "Status calibration for State of Charge Curve input Curve" CURVE 0x802518A2 RB_Curve_U8_U8 255.0 OneToOne 0.00 255.0 FORMAT "%5.1"
 /begin AXIS_DESCR STD_AXIS Com_stSocRx OneToOne 4 0.00 255.0 FORMAT "%5.1" DEPOSIT ABSOLUTE /end AXIS_DESCR
/end CHARACTERISTIC
/begin CHARACTERISTIC Com_tiPostOperationWkuReqEmgyDly_C "Calibration for post wakeup delay" VALUE 0x802518AC RB_Val_Ws16 655.3500 Time_s -327.6800 327.6700 FORMAT "%8.4" /end CHARACTERISTIC
/begin CHARACTERISTIC Com_tiPostOperationWkuReq_C "Post Operation Wakeup request" VALUE 0x802518AE RB_Val_Ws16 655.3500 Time_s -327.6800 327.6700 FORMAT "%8.4" /end CHARACTERISTIC
/begin CHARACTERISTIC DDRC_DurDeb.Com_tiACCmprFltLvlRes_CDebOk_C "" VALUE 0x80240B74 Val_Wu16 655350.0 DDRCTime_ms 0.00 655350.0 FORMAT "%8.1" /end CHARACTERISTIC
/begin CHARACTERISTIC DDRC_DurDeb.Com_tiACCmprFltLvlRes_CDebDef_C "" VALUE 0x80240B76 Val_Wu16 655350.0 DDRCTime_ms 0.00 655350.0 FORMAT "%8.1" /end CHARACTERISTIC
/begin CHARACTERISTIC DDRC_DurDeb.Com_tiAdpActvDChaFailr_CDebOk_C "" VALUE 0x80240B78 Val_Wu16 655350.0 DDRCTime_ms 0.00 655350.0 FORMAT "%8.1" /end CHARACTERISTIC
/begin CHARACTERISTIC DDRC_DurDeb.Com_tiAdpActvDChaFailr_CDebDef_C "" VALUE 0x80240B7A Val_Wu16 655350.0 DDRCTime_ms 0.00 655350.0 FORMAT "%8.1" /end CHARACTERISTIC
/begin CHARACTERISTIC DDRC_DurDeb.Com_tiAirbcuFlt_CDebOk_C "" VALUE 0x80240B7C Val_Wu16 655350.0 DDRCTime_ms 0.00 655350.0 FORMAT "%8.1" /end CHARACTERISTIC
/begin CHARACTERISTIC DDRC_DurDeb.Com_tiAirbcuFlt_CDebDef_C "" VALUE 0x80240B7E Val_Wu16 655350.0 DDRCTime_ms 0.00 655350.0 FORMAT "%8.1" /end CHARACTERISTIC
/begin CHARACTERISTIC DDRC_DurDeb.Com_tiBrkSwtFlt_CDebOk_C "" VALUE 0x80240B88 Val_Wu16 655350.0 DDRCTime_ms 0.00 655350.0 FORMAT "%8.1" /end CHARACTERISTIC
/begin CHARACTERISTIC DDRC_DurDeb.Com_tiBrkSwtFlt_CDebDef_C "" VALUE 0x80240B8A Val_Wu16 655350.0 DDRCTime_ms 0.00 655350.0 FORMAT "%8.1" /end CHARACTERISTIC
/begin CHARACTERISTIC DDRC_DurDeb.Com_tiComBrkMai_CDebOk_C "" VALUE 0x80240B8C Val_Wu16 655350.0 DDRCTime_ms 0.00 655350.0 FORMAT "%8.1" /end CHARACTERISTIC
/begin CHARACTERISTIC DDRC_DurDeb.Com_tiComBrkMai_CDebDef_C "" VALUE 0x80240B8E Val_Wu16 655350.0 DDRCTime_ms 0.00 655350.0 FORMAT "%8.1" /end CHARACTERISTIC
/begin CHARACTERISTIC DDRC_DurDeb.Com_tiComDcdcFltLvl2_CDebOk_C "" VALUE 0x80240BB0 Val_Wu16 655350.0 DDRCTime_ms 0.00 655350.0 FORMAT "%8.1" /end CHARACTERISTIC
/begin CHARACTERISTIC DDRC_DurDeb.Com_tiComDcdcFltLvl2_CDebDef_C "" VALUE 0x80240BB2 Val_Wu16 655350.0 DDRCTime_ms 0.00 655350.0 FORMAT "%8.1" /end CHARACTERISTIC
/begin CHARACTERISTIC DDRC_DurDeb.Com_tiComDcdcFltLvl3_CDebOk_C "" VALUE 0x80240BB4 Val_Wu16 655350.0 DDRCTime_ms 0.00 655350.0 FORMAT "%8.1" /end CHARACTERISTIC
/begin CHARACTERISTIC DDRC_DurDeb.Com_tiComDcdcFltLvl3_CDebDef_C "" VALUE 0x80240BB6 Val_Wu16 655350.0 DDRCTime_ms 0.00 655350.0 FORMAT "%8.1" /end CHARACTERISTIC
/begin CHARACTERISTIC DDRC_DurDeb.Com_tiComDcdcFltLvl4_CDebOk_C "" VALUE 0x80240BB8 Val_Wu16 655350.0 DDRCTime_ms 0.00 655350.0 FORMAT "%8.1" /end CHARACTERISTIC
/begin CHARACTERISTIC DDRC_DurDeb.Com_tiComDcdcFltLvl4_CDebDef_C "" VALUE 0x80240BBA Val_Wu16 655350.0 DDRCTime_ms 0.00 655350.0 FORMAT "%8.1" /end CHARACTERISTIC
/begin CHARACTERISTIC DDRC_DurDeb.Com_tiComDcdcFltLvl5_CDebOk_C "" VALUE 0x80240BBC Val_Wu16 655350.0 DDRCTime_ms 0.00 655350.0 FORMAT "%8.1" /end CHARACTERISTIC
/begin CHARACTERISTIC DDRC_DurDeb.Com_tiComDcdcFltLvl5_CDebDef_C "" VALUE 0x80240BBE Val_Wu16 655350.0 DDRCTime_ms 0.00 655350.0 FORMAT "%8.1" /end CHARACTERISTIC
/begin CHARACTERISTIC DDRC_DurDeb.Com_tiComDcdcFltLvlRes_CDebOk_C "" VALUE 0x80240BC0 Val_Wu16 655350.0 DDRCTime_ms 0.00 655350.0 FORMAT "%8.1" /end CHARACTERISTIC
/begin CHARACTERISTIC DDRC_DurDeb.Com_tiComDcdcFltLvlRes_CDebDef_C "" VALUE 0x80240BC2 Val_Wu16 655350.0 DDRCTime_ms 0.00 655350.0 FORMAT "%8.1" /end CHARACTERISTIC
/begin CHARACTERISTIC DDRC_DurDeb.Com_tiComElMIIvtrFltLvl2_CDebOk_C "" VALUE 0x80240BD4 Val_Wu16 655350.0 DDRCTime_ms 0.00 655350.0 FORMAT "%8.1" /end CHARACTERISTIC
/begin CHARACTERISTIC DDRC_DurDeb.Com_tiComElMIIvtrFltLvl2_CDebDef_C "" VALUE 0x80240BD6 Val_Wu16 655350.0 DDRCTime_ms 0.00 655350.0 FORMAT "%8.1" /end CHARACTERISTIC
/begin CHARACTERISTIC DDRC_DurDeb.Com_tiComElMIIvtrFltLvl3_CDebOk_C "" VALUE 0x80240BD8 Val_Wu16 655350.0 DDRCTime_ms 0.00 655350.0 FORMAT "%8.1" /end CHARACTERISTIC
/begin CHARACTERISTIC DDRC_DurDeb.Com_tiComElMIIvtrFltLvl3_CDebDef_C "" VALUE 0x80240BDA Val_Wu16 655350.0 DDRCTime_ms 0.00 655350.0 FORMAT "%8.1" /end CHARACTERISTIC
/begin CHARACTERISTIC DDRC_DurDeb.Com_tiComElMIIvtrFltLvlRes_CDebOk_C "" VALUE 0x80240BE4 Val_Wu16 655350.0 DDRCTime_ms 0.00 655350.0 FORMAT "%8.1" /end CHARACTERISTIC
/begin CHARACTERISTIC DDRC_DurDeb.Com_tiComElMIIvtrFltLvlRes_CDebDef_C "" VALUE 0x80240BE6 Val_Wu16 655350.0 DDRCTime_ms 0.00 655350.0 FORMAT "%8.1" /end CHARACTERISTIC
/begin CHARACTERISTIC DDRC_DurDeb.Com_tiComGunCntInfoWkuReq_CDebOk_C "" VALUE 0x80240C00 Val_Wu16 655350.0 DDRCTime_ms 0.00 655350.0 FORMAT "%8.1" /end CHARACTERISTIC
/begin CHARACTERISTIC DDRC_DurDeb.Com_tiComGunCntInfoWkuReq_CDebDef_C "" VALUE 0x80240C02 Val_Wu16 655350.0 DDRCTime_ms 0.00 655350.0 FORMAT "%8.1" /end CHARACTERISTIC
/begin CHARACTERISTIC DDRC_DurDeb.Com_tiComHillHldFlt_CDebOk_C "" VALUE 0x80240C04 Val_Wu16 655350.0 DDRCTime_ms 0.00 655350.0 FORMAT "%8.1" /end CHARACTERISTIC
/begin CHARACTERISTIC DDRC_DurDeb.Com_tiComHillHldFlt_CDebDef_C "" VALUE 0x80240C06 Val_Wu16 655350.0 DDRCTime_ms 0.00 655350.0 FORMAT "%8.1" /end CHARACTERISTIC
/begin CHARACTERISTIC DDRC_DurDeb.Com_tiComHvBattRchrgWkuReq_CDebOk_C "" VALUE 0x80240C08 Val_Wu16 655350.0 DDRCTime_ms 0.00 655350.0 FORMAT "%8.1" /end CHARACTERISTIC
/begin CHARACTERISTIC DDRC_DurDeb.Com_tiComHvBattRchrgWkuReq_CDebDef_C "" VALUE 0x80240C0A Val_Wu16 655350.0 DDRCTime_ms 0.00 655350.0 FORMAT "%8.1" /end CHARACTERISTIC
/begin CHARACTERISTIC DDRC_DurDeb.Com_tiComHvbFltLvl2_CDebOk_C "" VALUE 0x80240C0C Val_Wu16 655350.0 DDRCTime_ms 0.00 655350.0 FORMAT "%8.1" /end CHARACTERISTIC
/begin CHARACTERISTIC DDRC_DurDeb.Com_tiComHvbFltLvl2_CDebDef_C "" VALUE 0x80240C0E Val_Wu16 655350.0 DDRCTime_ms 0.00 655350.0 FORMAT "%8.1" /end CHARACTERISTIC
/begin CHARACTERISTIC DDRC_DurDeb.Com_tiComHvbFltLvl3_CDebOk_C "" VALUE 0x80240C10 Val_Wu16 655350.0 DDRCTime_ms 0.00 655350.0 FORMAT "%8.1" /end CHARACTERISTIC
/begin CHARACTERISTIC DDRC_DurDeb.Com_tiComHvbFltLvl3_CDebDef_C "" VALUE 0x80240C12 Val_Wu16 655350.0 DDRCTime_ms 0.00 655350.0 FORMAT "%8.1" /end CHARACTERISTIC
/begin CHARACTERISTIC DDRC_DurDeb.Com_tiComHvbFltLvl4_CDebOk_C "" VALUE 0x80240C14 Val_Wu16 655350.0 DDRCTime_ms 0.00 655350.0 FORMAT "%8.1" /end CHARACTERISTIC
/begin CHARACTERISTIC DDRC_DurDeb.Com_tiComHvbFltLvl4_CDebDef_C "" VALUE 0x80240C16 Val_Wu16 655350.0 DDRCTime_ms 0.00 655350.0 FORMAT "%8.1" /end CHARACTERISTIC
/begin CHARACTERISTIC DDRC_DurDeb.Com_tiComHvbFltLvl5_CDebOk_C "" VALUE 0x80240C18 Val_Wu16 655350.0 DDRCTime_ms 0.00 655350.0 FORMAT "%8.1" /end CHARACTERISTIC
/begin CHARACTERISTIC DDRC_DurDeb.Com_tiComHvbFltLvl5_CDebDef_C "" VALUE 0x80240C1A Val_Wu16 655350.0 DDRCTime_ms 0.00 655350.0 FORMAT "%8.1" /end CHARACTERISTIC
/begin CHARACTERISTIC DDRC_DurDeb.Com_tiComHvbFltLvlRes_CDebOk_C "" VALUE 0x80240C1C Val_Wu16 655350.0 DDRCTime_ms 0.00 655350.0 FORMAT "%8.1" /end CHARACTERISTIC
/begin CHARACTERISTIC DDRC_DurDeb.Com_tiComHvbFltLvlRes_CDebDef_C "" VALUE 0x80240C1E Val_Wu16 655350.0 DDRCTime_ms 0.00 655350.0 FORMAT "%8.1" /end CHARACTERISTIC
/begin CHARACTERISTIC DDRC_DurDeb.Com_tiComImmoUnlockWkuReq_CDebOk_C "" VALUE 0x80240C28 Val_Wu16 655350.0 DDRCTime_ms 0.00 655350.0 FORMAT "%8.1" /end CHARACTERISTIC
/begin CHARACTERISTIC DDRC_DurDeb.Com_tiComImmoUnlockWkuReq_CDebDef_C "" VALUE 0x80240C2A Val_Wu16 655350.0 DDRCTime_ms 0.00 655350.0 FORMAT "%8.1" /end CHARACTERISTIC
/begin CHARACTERISTIC DDRC_DurDeb.Com_tiComInfoReqPtlWkuReq_CDebOk_C "" VALUE 0x80240C2C Val_Wu16 655350.0 DDRCTime_ms 0.00 655350.0 FORMAT "%8.1" /end CHARACTERISTIC
/begin CHARACTERISTIC DDRC_DurDeb.Com_tiComInfoReqPtlWkuReq_CDebDef_C "" VALUE 0x80240C2E Val_Wu16 655350.0 DDRCTime_ms 0.00 655350.0 FORMAT "%8.1" /end CHARACTERISTIC
/begin CHARACTERISTIC DDRC_DurDeb.Com_tiComOBCFltLvl2_CDebOk_C "" VALUE 0x80240C30 Val_Wu16 655350.0 DDRCTime_ms 0.00 655350.0 FORMAT "%8.1" /end CHARACTERISTIC
/begin CHARACTERISTIC DDRC_DurDeb.Com_tiComOBCFltLvl2_CDebDef_C "" VALUE 0x80240C32 Val_Wu16 655350.0 DDRCTime_ms 0.00 655350.0 FORMAT "%8.1" /end CHARACTERISTIC
/begin CHARACTERISTIC DDRC_DurDeb.Com_tiComOBCFltLvl3_CDebOk_C "" VALUE 0x80240C34 Val_Wu16 655350.0 DDRCTime_ms 0.00 655350.0 FORMAT "%8.1" /end CHARACTERISTIC
/begin CHARACTERISTIC DDRC_DurDeb.Com_tiComOBCFltLvl3_CDebDef_C "" VALUE 0x80240C36 Val_Wu16 655350.0 DDRCTime_ms 0.00 655350.0 FORMAT "%8.1" /end CHARACTERISTIC
/begin CHARACTERISTIC DDRC_DurDeb.Com_tiComOBCFltLvl4_CDebOk_C "" VALUE 0x80240C38 Val_Wu16 655350.0 DDRCTime_ms 0.00 655350.0 FORMAT "%8.1" /end CHARACTERISTIC
/begin CHARACTERISTIC DDRC_DurDeb.Com_tiComOBCFltLvl4_CDebDef_C "" VALUE 0x80240C3A Val_Wu16 655350.0 DDRCTime_ms 0.00 655350.0 FORMAT "%8.1" /end CHARACTERISTIC
/begin CHARACTERISTIC DDRC_DurDeb.Com_tiComOBCFltLvl5_CDebOk_C "" VALUE 0x80240C3C Val_Wu16 655350.0 DDRCTime_ms 0.00 655350.0 FORMAT "%8.1" /end CHARACTERISTIC
/begin CHARACTERISTIC DDRC_DurDeb.Com_tiComOBCFltLvl5_CDebDef_C "" VALUE 0x80240C3E Val_Wu16 655350.0 DDRCTime_ms 0.00 655350.0 FORMAT "%8.1" /end CHARACTERISTIC
/begin CHARACTERISTIC DDRC_DurDeb.Com_tiComOBCFltLvlRes_CDebOk_C "" VALUE 0x80240C40 Val_Wu16 655350.0 DDRCTime_ms 0.00 655350.0 FORMAT "%8.1" /end CHARACTERISTIC
/begin CHARACTERISTIC DDRC_DurDeb.Com_tiComOBCFltLvlRes_CDebDef_C "" VALUE 0x80240C42 Val_Wu16 655350.0 DDRCTime_ms 0.00 655350.0 FORMAT "%8.1" /end CHARACTERISTIC
/begin CHARACTERISTIC DDRC_DurDeb.Com_tiComPostOperationWkuReq_CDebOk_C "" VALUE 0x80240C44 Val_Wu16 655350.0 DDRCTime_ms 0.00 655350.0 FORMAT "%8.1" /end CHARACTERISTIC
/begin CHARACTERISTIC DDRC_DurDeb.Com_tiComPostOperationWkuReq_CDebDef_C "" VALUE 0x80240C46 Val_Wu16 655350.0 DDRCTime_ms 0.00 655350.0 FORMAT "%8.1" /end CHARACTERISTIC
/begin CHARACTERISTIC DDRC_DurDeb.Com_tiComPreCondElecWkuReq_CDebOk_C "" VALUE 0x80240C48 Val_Wu16 655350.0 DDRCTime_ms 0.00 655350.0 FORMAT "%8.1" /end CHARACTERISTIC
/begin CHARACTERISTIC DDRC_DurDeb.Com_tiComPreCondElecWkuReq_CDebDef_C "" VALUE 0x80240C4A Val_Wu16 655350.0 DDRCTime_ms 0.00 655350.0 FORMAT "%8.1" /end CHARACTERISTIC
/begin CHARACTERISTIC DDRC_DurDeb.Com_tiComRemUnlckWkuReq_CDebOk_C "" VALUE 0x80240C4C Val_Wu16 655350.0 DDRCTime_ms 0.00 655350.0 FORMAT "%8.1" /end CHARACTERISTIC
/begin CHARACTERISTIC DDRC_DurDeb.Com_tiComRemUnlckWkuReq_CDebDef_C "" VALUE 0x80240C4E Val_Wu16 655350.0 DDRCTime_ms 0.00 655350.0 FORMAT "%8.1" /end CHARACTERISTIC
/begin CHARACTERISTIC DDRC_DurDeb.Com_tiComStpDlyHMIWkuReq_CDebOk_C "" VALUE 0x80240C50 Val_Wu16 655350.0 DDRCTime_ms 0.00 655350.0 FORMAT "%8.1" /end CHARACTERISTIC
/begin CHARACTERISTIC DDRC_DurDeb.Com_tiComStpDlyHMIWkuReq_CDebDef_C "" VALUE 0x80240C52 Val_Wu16 655350.0 DDRCTime_ms 0.00 655350.0 FORMAT "%8.1" /end CHARACTERISTIC
/begin CHARACTERISTIC DDRC_DurDeb.Com_tiComVehVCanErr_CDebOk_C "" VALUE 0x80240C54 Val_Wu16 655350.0 DDRCTime_ms 0.00 655350.0 FORMAT "%8.1" /end CHARACTERISTIC
/begin CHARACTERISTIC DDRC_DurDeb.Com_tiComVehVCanErr_CDebDef_C "" VALUE 0x80240C56 Val_Wu16 655350.0 DDRCTime_ms 0.00 655350.0 FORMAT "%8.1" /end CHARACTERISTIC
/begin CHARACTERISTIC DDRC_DurDeb.Com_tiHvbSVSBlink_CDebOk_C "" VALUE 0x80240CA8 Val_Wu16 655350.0 DDRCTime_ms 0.00 655350.0 FORMAT "%8.1" /end CHARACTERISTIC
/begin CHARACTERISTIC DDRC_DurDeb.Com_tiHvbSVSBlink_CDebDef_C "" VALUE 0x80240CAA Val_Wu16 655350.0 DDRCTime_ms 0.00 655350.0 FORMAT "%8.1" /end CHARACTERISTIC
/begin CHARACTERISTIC DDRC_DurDeb.Com_tiHvbSVSCont_CDebOk_C "" VALUE 0x80240CAC Val_Wu16 655350.0 DDRCTime_ms 0.00 655350.0 FORMAT "%8.1" /end CHARACTERISTIC
/begin CHARACTERISTIC DDRC_DurDeb.Com_tiHvbSVSCont_CDebDef_C "" VALUE 0x80240CAE Val_Wu16 655350.0 DDRCTime_ms 0.00 655350.0 FORMAT "%8.1" /end CHARACTERISTIC
/begin CHARACTERISTIC DDRC_DurDeb.Com_tiPDUProgmFailr_CDebOk_C "" VALUE 0x80240CB4 Val_Wu16 655350.0 DDRCTime_ms 0.00 655350.0 FORMAT "%8.1" /end CHARACTERISTIC
/begin CHARACTERISTIC DDRC_DurDeb.Com_tiPDUProgmFailr_CDebDef_C "" VALUE 0x80240CB6 Val_Wu16 655350.0 DDRCTime_ms 0.00 655350.0 FORMAT "%8.1" /end CHARACTERISTIC
/begin CHARACTERISTIC DDRC_DurDeb.Com_tiPwrMaxDchaShoLo_CDebOk_C "" VALUE 0x80240CC0 Val_Wu16 655350.0 DDRCTime_ms 0.00 655350.0 FORMAT "%8.1" /end CHARACTERISTIC
/begin CHARACTERISTIC DDRC_DurDeb.Com_tiPwrMaxDchaShoLo_CDebDef_C "" VALUE 0x80240CC2 Val_Wu16 655350.0 DDRCTime_ms 0.00 655350.0 FORMAT "%8.1" /end CHARACTERISTIC
/begin CHARACTERISTIC DDRC_DurDeb.Com_tiVehVCanAvl_CDebOk_C "" VALUE 0x80240CC4 Val_Wu16 655350.0 DDRCTime_ms 0.00 655350.0 FORMAT "%8.1" /end CHARACTERISTIC
/begin CHARACTERISTIC DDRC_DurDeb.Com_tiVehVCanAvl_CDebDef_C "" VALUE 0x80240CC6 Val_Wu16 655350.0 DDRCTime_ms 0.00 655350.0 FORMAT "%8.1" /end CHARACTERISTIC
/begin CHARACTERISTIC DDRC_DurDeb.Com_tieTogFailrLvlRes_CDebOk_C "" VALUE 0x80240CC8 Val_Wu16 655350.0 DDRCTime_ms 0.00 655350.0 FORMAT "%8.1" /end CHARACTERISTIC
/begin CHARACTERISTIC DDRC_DurDeb.Com_tieTogFailrLvlRes_CDebDef_C "" VALUE 0x80240CCA Val_Wu16 655350.0 DDRCTime_ms 0.00 655350.0 FORMAT "%8.1" /end CHARACTERISTIC
/begin CHARACTERISTIC DDRC_DurDeb.Com_tiflgBrkMaiDiag_CDebOk_C "" VALUE 0x80240CCC Val_Wu16 655350.0 DDRCTime_ms 0.00 655350.0 FORMAT "%8.1" /end CHARACTERISTIC
/begin CHARACTERISTIC DDRC_DurDeb.Com_tiflgBrkMaiDiag_CDebDef_C "" VALUE 0x80240CCE Val_Wu16 655350.0 DDRCTime_ms 0.00 655350.0 FORMAT "%8.1" /end CHARACTERISTIC
/begin CHARACTERISTIC DDRC_DurDeb.Com_tistHvbIsoMeasmtRes_CDebOk_C "" VALUE 0x80240CD0 Val_Wu16 655350.0 DDRCTime_ms 0.00 655350.0 FORMAT "%8.1" /end CHARACTERISTIC
/begin CHARACTERISTIC DDRC_DurDeb.Com_tistHvbIsoMeasmtRes_CDebDef_C "" VALUE 0x80240CD2 Val_Wu16 655350.0 DDRCTime_ms 0.00 655350.0 FORMAT "%8.1" /end CHARACTERISTIC
/begin CHARACTERISTIC DFC_CtlMsk2.DFC_ACCmprFltLvlRes_C "" VALUE 0x802412ED Val_Wu8 255.0 DFES_OneToOne 0.00 255.0 FORMAT "%5.1" /end CHARACTERISTIC
/begin CHARACTERISTIC DFC_CtlMsk2.DFC_AdpActvDChaFailr_C "" VALUE 0x802412F7 Val_Wu8 255.0 DFES_OneToOne 0.00 255.0 FORMAT "%5.1" /end CHARACTERISTIC
/begin CHARACTERISTIC DFC_CtlMsk2.DFC_AirbcuFlt_C "" VALUE 0x802412F8 Val_Wu8 255.0 DFES_OneToOne 0.00 255.0 FORMAT "%5.1" /end CHARACTERISTIC
/begin CHARACTERISTIC DFC_CtlMsk2.DFC_BrkSwtFlt_C "" VALUE 0x80241303 Val_Wu8 255.0 DFES_OneToOne 0.00 255.0 FORMAT "%5.1" /end CHARACTERISTIC
/begin CHARACTERISTIC DFC_CtlMsk2.DFC_ComBrkMai_C "" VALUE 0x80241316 Val_Wu8 255.0 DFES_OneToOne 0.00 255.0 FORMAT "%5.1" /end CHARACTERISTIC
/begin CHARACTERISTIC DFC_CtlMsk2.DFC_ComDcdcFltLvl2_C "" VALUE 0x8024131F Val_Wu8 255.0 DFES_OneToOne 0.00 255.0 FORMAT "%5.1" /end CHARACTERISTIC
/begin CHARACTERISTIC DFC_CtlMsk2.DFC_ComDcdcFltLvl3_C "" VALUE 0x80241320 Val_Wu8 255.0 DFES_OneToOne 0.00 255.0 FORMAT "%5.1" /end CHARACTERISTIC
/begin CHARACTERISTIC DFC_CtlMsk2.DFC_ComDcdcFltLvl4_C "" VALUE 0x80241321 Val_Wu8 255.0 DFES_OneToOne 0.00 255.0 FORMAT "%5.1" /end CHARACTERISTIC
/begin CHARACTERISTIC DFC_CtlMsk2.DFC_ComDcdcFltLvl5_C "" VALUE 0x80241322 Val_Wu8 255.0 DFES_OneToOne 0.00 255.0 FORMAT "%5.1" /end CHARACTERISTIC
/begin CHARACTERISTIC DFC_CtlMsk2.DFC_ComDcdcFltLvlRes_C "" VALUE 0x80241323 Val_Wu8 255.0 DFES_OneToOne 0.00 255.0 FORMAT "%5.1" /end CHARACTERISTIC
/begin CHARACTERISTIC DFC_CtlMsk2.DFC_ComElMIIvtrFltLvl2_C "" VALUE 0x80241328 Val_Wu8 255.0 DFES_OneToOne 0.00 255.0 FORMAT "%5.1" /end CHARACTERISTIC
/begin CHARACTERISTIC DFC_CtlMsk2.DFC_ComElMIIvtrFltLvl3_C "" VALUE 0x80241329 Val_Wu8 255.0 DFES_OneToOne 0.00 255.0 FORMAT "%5.1" /end CHARACTERISTIC
/begin CHARACTERISTIC DFC_CtlMsk2.DFC_ComElMIIvtrFltLvlRes_C "" VALUE 0x8024132C Val_Wu8 255.0 DFES_OneToOne 0.00 255.0 FORMAT "%5.1" /end CHARACTERISTIC
/begin CHARACTERISTIC DFC_CtlMsk2.DFC_ComGunCntInfoWkuReq_C "" VALUE 0x80241333 Val_Wu8 255.0 DFES_OneToOne 0.00 255.0 FORMAT "%5.1" /end CHARACTERISTIC
/begin CHARACTERISTIC DFC_CtlMsk2.DFC_ComHillHldFlt_C "" VALUE 0x80241334 Val_Wu8 255.0 DFES_OneToOne 0.00 255.0 FORMAT "%5.1" /end CHARACTERISTIC
/begin CHARACTERISTIC DFC_CtlMsk2.DFC_ComHvBattRchrgWkuReq_C "" VALUE 0x80241335 Val_Wu8 255.0 DFES_OneToOne 0.00 255.0 FORMAT "%5.1" /end CHARACTERISTIC
/begin CHARACTERISTIC DFC_CtlMsk2.DFC_ComHvbFltLvl2_C "" VALUE 0x80241336 Val_Wu8 255.0 DFES_OneToOne 0.00 255.0 FORMAT "%5.1" /end CHARACTERISTIC
/begin CHARACTERISTIC DFC_CtlMsk2.DFC_ComHvbFltLvl3_C "" VALUE 0x80241337 Val_Wu8 255.0 DFES_OneToOne 0.00 255.0 FORMAT "%5.1" /end CHARACTERISTIC
/begin CHARACTERISTIC DFC_CtlMsk2.DFC_ComHvbFltLvl4_C "" VALUE 0x80241338 Val_Wu8 255.0 DFES_OneToOne 0.00 255.0 FORMAT "%5.1" /end CHARACTERISTIC
/begin CHARACTERISTIC DFC_CtlMsk2.DFC_ComHvbFltLvl5_C "" VALUE 0x80241339 Val_Wu8 255.0 DFES_OneToOne 0.00 255.0 FORMAT "%5.1" /end CHARACTERISTIC
/begin CHARACTERISTIC DFC_CtlMsk2.DFC_ComHvbFltLvlRes_C "" VALUE 0x8024133A Val_Wu8 255.0 DFES_OneToOne 0.00 255.0 FORMAT "%5.1" /end CHARACTERISTIC
/begin CHARACTERISTIC DFC_CtlMsk2.DFC_ComImmoUnlockWkuReq_C "" VALUE 0x8024133D Val_Wu8 255.0 DFES_OneToOne 0.00 255.0 FORMAT "%5.1" /end CHARACTERISTIC
/begin CHARACTERISTIC DFC_CtlMsk2.DFC_ComInfoReqPtlWkuReq_C "" VALUE 0x8024133E Val_Wu8 255.0 DFES_OneToOne 0.00 255.0 FORMAT "%5.1" /end CHARACTERISTIC
/begin CHARACTERISTIC DFC_CtlMsk2.DFC_ComOBCFltLvl2_C "" VALUE 0x8024133F Val_Wu8 255.0 DFES_OneToOne 0.00 255.0 FORMAT "%5.1" /end CHARACTERISTIC
/begin CHARACTERISTIC DFC_CtlMsk2.DFC_ComOBCFltLvl3_C "" VALUE 0x80241340 Val_Wu8 255.0 DFES_OneToOne 0.00 255.0 FORMAT "%5.1" /end CHARACTERISTIC
/begin CHARACTERISTIC DFC_CtlMsk2.DFC_ComOBCFltLvl4_C "" VALUE 0x80241341 Val_Wu8 255.0 DFES_OneToOne 0.00 255.0 FORMAT "%5.1" /end CHARACTERISTIC
/begin CHARACTERISTIC DFC_CtlMsk2.DFC_ComOBCFltLvl5_C "" VALUE 0x80241342 Val_Wu8 255.0 DFES_OneToOne 0.00 255.0 FORMAT "%5.1" /end CHARACTERISTIC
/begin CHARACTERISTIC DFC_CtlMsk2.DFC_ComOBCFltLvlRes_C "" VALUE 0x80241343 Val_Wu8 255.0 DFES_OneToOne 0.00 255.0 FORMAT "%5.1" /end CHARACTERISTIC
/begin CHARACTERISTIC DFC_CtlMsk2.DFC_ComPostOperationWkuReq_C "" VALUE 0x80241344 Val_Wu8 255.0 DFES_OneToOne 0.00 255.0 FORMAT "%5.1" /end CHARACTERISTIC
/begin CHARACTERISTIC DFC_CtlMsk2.DFC_ComPreCondElecWkuReq_C "" VALUE 0x80241345 Val_Wu8 255.0 DFES_OneToOne 0.00 255.0 FORMAT "%5.1" /end CHARACTERISTIC
/begin CHARACTERISTIC DFC_CtlMsk2.DFC_ComRemUnlckWkuReq_C "" VALUE 0x80241346 Val_Wu8 255.0 DFES_OneToOne 0.00 255.0 FORMAT "%5.1" /end CHARACTERISTIC
/begin CHARACTERISTIC DFC_CtlMsk2.DFC_ComStpDlyHMIWkuReq_C "" VALUE 0x80241347 Val_Wu8 255.0 DFES_OneToOne 0.00 255.0 FORMAT "%5.1" /end CHARACTERISTIC
/begin CHARACTERISTIC DFC_CtlMsk2.DFC_HvbSVSBlink_C "" VALUE 0x8024138F Val_Wu8 255.0 DFES_OneToOne 0.00 255.0 FORMAT "%5.1" /end CHARACTERISTIC
/begin CHARACTERISTIC DFC_CtlMsk2.DFC_HvbSVSCont_C "" VALUE 0x80241390 Val_Wu8 255.0 DFES_OneToOne 0.00 255.0 FORMAT "%5.1" /end CHARACTERISTIC
/begin CHARACTERISTIC DFC_CtlMsk2.DFC_PDUProgmFailr_C "" VALUE 0x80241392 Val_Wu8 255.0 DFES_OneToOne 0.00 255.0 FORMAT "%5.1" /end CHARACTERISTIC
/begin CHARACTERISTIC DFC_CtlMsk2.DFC_PwrMaxDchaShoLo_C "" VALUE 0x80241398 Val_Wu8 255.0 DFES_OneToOne 0.00 255.0 FORMAT "%5.1" /end CHARACTERISTIC
/begin CHARACTERISTIC DFC_CtlMsk2.DFC_VehVCanAvl_C "" VALUE 0x8024139C Val_Wu8 255.0 DFES_OneToOne 0.00 255.0 FORMAT "%5.1" /end CHARACTERISTIC
/begin CHARACTERISTIC DFC_CtlMsk2.DFC_VehVCanErr_C "" VALUE 0x8024139D Val_Wu8 255.0 DFES_OneToOne 0.00 255.0 FORMAT "%5.1" /end CHARACTERISTIC
/begin CHARACTERISTIC DFC_CtlMsk2.DFC_eTogFailrLvlRes_C "" VALUE 0x8024139E Val_Wu8 255.0 DFES_OneToOne 0.00 255.0 FORMAT "%5.1" /end CHARACTERISTIC
/begin CHARACTERISTIC DFC_CtlMsk2.DFC_flgBrkMaiDiag_C "" VALUE 0x8024139F Val_Wu8 255.0 DFES_OneToOne 0.00 255.0 FORMAT "%5.1" /end CHARACTERISTIC
/begin CHARACTERISTIC DFC_CtlMsk2.DFC_stHvbIsoMeasmtRes_C "" VALUE 0x802413A0 Val_Wu8 255.0 DFES_OneToOne 0.00 255.0 FORMAT "%5.1" /end CHARACTERISTIC
/begin CHARACTERISTIC DFC_CtlMsk2.DFC_ResetRcvNotAllwd_C "" VALUE 0x8024159F Val_Wu8 255.0 DFES_OneToOne 0.00 255.0 FORMAT "%5.1" /end CHARACTERISTIC
/begin CHARACTERISTIC DFC_CtlMsk2.DFC_TelltlCooltPlaus_C "" VALUE 0x802415A0 Val_Wu8 255.0 DFES_OneToOne 0.00 255.0 FORMAT "%5.1" /end CHARACTERISTIC
/begin CHARACTERISTIC DFC_DisblMsk2.DFC_ACCmprFltLvlRes_C "" VALUE 0x80248AC0 Val_Wu16 65535.00 DFES_OneToOne 0.00 65535.00 FORMAT "%8.2" /end CHARACTERISTIC
/begin CHARACTERISTIC DFC_DisblMsk2.DFC_AdpActvDChaFailr_C "" VALUE 0x80248AD4 Val_Wu16 65535.00 DFES_OneToOne 0.00 65535.00 FORMAT "%8.2" /end CHARACTERISTIC
/begin CHARACTERISTIC DFC_DisblMsk2.DFC_AirbcuFlt_C "" VALUE 0x80248AD6 Val_Wu16 65535.00 DFES_OneToOne 0.00 65535.00 FORMAT "%8.2" /end CHARACTERISTIC
/begin CHARACTERISTIC DFC_DisblMsk2.DFC_BrkSwtFlt_C "" VALUE 0x80248AEC Val_Wu16 65535.00 DFES_OneToOne 0.00 65535.00 FORMAT "%8.2" /end CHARACTERISTIC
/begin CHARACTERISTIC DFC_DisblMsk2.DFC_ComBrkMai_C "" VALUE 0x80248B12 Val_Wu16 65535.00 DFES_OneToOne 0.00 65535.00 FORMAT "%8.2" /end CHARACTERISTIC
/begin CHARACTERISTIC DFC_DisblMsk2.DFC_ComDcdcFltLvl2_C "" VALUE 0x80248B24 Val_Wu16 65535.00 DFES_OneToOne 0.00 65535.00 FORMAT "%8.2" /end CHARACTERISTIC
/begin CHARACTERISTIC DFC_DisblMsk2.DFC_ComDcdcFltLvl3_C "" VALUE 0x80248B26 Val_Wu16 65535.00 DFES_OneToOne 0.00 65535.00 FORMAT "%8.2" /end CHARACTERISTIC
/begin CHARACTERISTIC DFC_DisblMsk2.DFC_ComDcdcFltLvl4_C "" VALUE 0x80248B28 Val_Wu16 65535.00 DFES_OneToOne 0.00 65535.00 FORMAT "%8.2" /end CHARACTERISTIC
/begin CHARACTERISTIC DFC_DisblMsk2.DFC_ComDcdcFltLvl5_C "" VALUE 0x80248B2A Val_Wu16 65535.00 DFES_OneToOne 0.00 65535.00 FORMAT "%8.2" /end CHARACTERISTIC
/begin CHARACTERISTIC DFC_DisblMsk2.DFC_ComDcdcFltLvlRes_C "" VALUE 0x80248B2C Val_Wu16 65535.00 DFES_OneToOne 0.00 65535.00 FORMAT "%8.2" /end CHARACTERISTIC
/begin CHARACTERISTIC DFC_DisblMsk2.DFC_ComElMIIvtrFltLvl2_C "" VALUE 0x80248B36 Val_Wu16 65535.00 DFES_OneToOne 0.00 65535.00 FORMAT "%8.2" /end CHARACTERISTIC
/begin CHARACTERISTIC DFC_DisblMsk2.DFC_ComElMIIvtrFltLvl3_C "" VALUE 0x80248B38 Val_Wu16 65535.00 DFES_OneToOne 0.00 65535.00 FORMAT "%8.2" /end CHARACTERISTIC
/begin CHARACTERISTIC DFC_DisblMsk2.DFC_ComElMIIvtrFltLvlRes_C "" VALUE 0x80248B3E Val_Wu16 65535.00 DFES_OneToOne 0.00 65535.00 FORMAT "%8.2" /end CHARACTERISTIC
/begin CHARACTERISTIC DFC_DisblMsk2.DFC_ComGunCntInfoWkuReq_C "" VALUE 0x80248B4C Val_Wu16 65535.00 DFES_OneToOne 0.00 65535.00 FORMAT "%8.2" /end CHARACTERISTIC
/begin CHARACTERISTIC DFC_DisblMsk2.DFC_ComHillHldFlt_C "" VALUE 0x80248B4E Val_Wu16 65535.00 DFES_OneToOne 0.00 65535.00 FORMAT "%8.2" /end CHARACTERISTIC
/begin CHARACTERISTIC DFC_DisblMsk2.DFC_ComHvBattRchrgWkuReq_C "" VALUE 0x80248B50 Val_Wu16 65535.00 DFES_OneToOne 0.00 65535.00 FORMAT "%8.2" /end CHARACTERISTIC
/begin CHARACTERISTIC DFC_DisblMsk2.DFC_ComHvbFltLvl2_C "" VALUE 0x80248B52 Val_Wu16 65535.00 DFES_OneToOne 0.00 65535.00 FORMAT "%8.2" /end CHARACTERISTIC
/begin CHARACTERISTIC DFC_DisblMsk2.DFC_ComHvbFltLvl3_C "" VALUE 0x80248B54 Val_Wu16 65535.00 DFES_OneToOne 0.00 65535.00 FORMAT "%8.2" /end CHARACTERISTIC
/begin CHARACTERISTIC DFC_DisblMsk2.DFC_ComHvbFltLvl4_C "" VALUE 0x80248B56 Val_Wu16 65535.00 DFES_OneToOne 0.00 65535.00 FORMAT "%8.2" /end CHARACTERISTIC
/begin CHARACTERISTIC DFC_DisblMsk2.DFC_ComHvbFltLvl5_C "" VALUE 0x80248B58 Val_Wu16 65535.00 DFES_OneToOne 0.00 65535.00 FORMAT "%8.2" /end CHARACTERISTIC
/begin CHARACTERISTIC DFC_DisblMsk2.DFC_ComHvbFltLvlRes_C "" VALUE 0x80248B5A Val_Wu16 65535.00 DFES_OneToOne 0.00 65535.00 FORMAT "%8.2" /end CHARACTERISTIC
/begin CHARACTERISTIC DFC_DisblMsk2.DFC_ComImmoUnlockWkuReq_C "" VALUE 0x80248B60 Val_Wu16 65535.00 DFES_OneToOne 0.00 65535.00 FORMAT "%8.2" /end CHARACTERISTIC
/begin CHARACTERISTIC DFC_DisblMsk2.DFC_ComInfoReqPtlWkuReq_C "" VALUE 0x80248B62 Val_Wu16 65535.00 DFES_OneToOne 0.00 65535.00 FORMAT "%8.2" /end CHARACTERISTIC
/begin CHARACTERISTIC DFC_DisblMsk2.DFC_ComOBCFltLvl2_C "" VALUE 0x80248B64 Val_Wu16 65535.00 DFES_OneToOne 0.00 65535.00 FORMAT "%8.2" /end CHARACTERISTIC
/begin CHARACTERISTIC DFC_DisblMsk2.DFC_ComOBCFltLvl3_C "" VALUE 0x80248B66 Val_Wu16 65535.00 DFES_OneToOne 0.00 65535.00 FORMAT "%8.2" /end CHARACTERISTIC
/begin CHARACTERISTIC DFC_DisblMsk2.DFC_ComOBCFltLvl4_C "" VALUE 0x80248B68 Val_Wu16 65535.00 DFES_OneToOne 0.00 65535.00 FORMAT "%8.2" /end CHARACTERISTIC
/begin CHARACTERISTIC DFC_DisblMsk2.DFC_ComOBCFltLvl5_C "" VALUE 0x80248B6A Val_Wu16 65535.00 DFES_OneToOne 0.00 65535.00 FORMAT "%8.2" /end CHARACTERISTIC
/begin CHARACTERISTIC DFC_DisblMsk2.DFC_ComOBCFltLvlRes_C "" VALUE 0x80248B6C Val_Wu16 65535.00 DFES_OneToOne 0.00 65535.00 FORMAT "%8.2" /end CHARACTERISTIC
/begin CHARACTERISTIC DFC_DisblMsk2.DFC_ComPostOperationWkuReq_C "" VALUE 0x80248B6E Val_Wu16 65535.00 DFES_OneToOne 0.00 65535.00 FORMAT "%8.2" /end CHARACTERISTIC
/begin CHARACTERISTIC DFC_DisblMsk2.DFC_ComPreCondElecWkuReq_C "" VALUE 0x80248B70 Val_Wu16 65535.00 DFES_OneToOne 0.00 65535.00 FORMAT "%8.2" /end CHARACTERISTIC
/begin CHARACTERISTIC DFC_DisblMsk2.DFC_ComRemUnlckWkuReq_C "" VALUE 0x80248B72 Val_Wu16 65535.00 DFES_OneToOne 0.00 65535.00 FORMAT "%8.2" /end CHARACTERISTIC
/begin CHARACTERISTIC DFC_DisblMsk2.DFC_ComStpDlyHMIWkuReq_C "" VALUE 0x80248B74 Val_Wu16 65535.00 DFES_OneToOne 0.00 65535.00 FORMAT "%8.2" /end CHARACTERISTIC
/begin CHARACTERISTIC DFC_DisblMsk2.DFC_HvbSVSBlink_C "" VALUE 0x80248C04 Val_Wu16 65535.00 DFES_OneToOne 0.00 65535.00 FORMAT "%8.2" /end CHARACTERISTIC
/begin CHARACTERISTIC DFC_DisblMsk2.DFC_HvbSVSCont_C "" VALUE 0x80248C06 Val_Wu16 65535.00 DFES_OneToOne 0.00 65535.00 FORMAT "%8.2" /end CHARACTERISTIC
/begin CHARACTERISTIC DFC_DisblMsk2.DFC_PDUProgmFailr_C "" VALUE 0x80248C0A Val_Wu16 65535.00 DFES_OneToOne 0.00 65535.00 FORMAT "%8.2" /end CHARACTERISTIC
/begin CHARACTERISTIC DFC_DisblMsk2.DFC_PwrMaxDchaShoLo_C "" VALUE 0x80248C16 Val_Wu16 65535.00 DFES_OneToOne 0.00 65535.00 FORMAT "%8.2" /end CHARACTERISTIC
/begin CHARACTERISTIC DFC_DisblMsk2.DFC_VehVCanAvl_C "" VALUE 0x80248C1E Val_Wu16 65535.00 DFES_OneToOne 0.00 65535.00 FORMAT "%8.2" /end CHARACTERISTIC
/begin CHARACTERISTIC DFC_DisblMsk2.DFC_VehVCanErr_C "" VALUE 0x80248C20 Val_Wu16 65535.00 DFES_OneToOne 0.00 65535.00 FORMAT "%8.2" /end CHARACTERISTIC
/begin CHARACTERISTIC DFC_DisblMsk2.DFC_eTogFailrLvlRes_C "" VALUE 0x80248C22 Val_Wu16 65535.00 DFES_OneToOne 0.00 65535.00 FORMAT "%8.2" /end CHARACTERISTIC
/begin CHARACTERISTIC DFC_DisblMsk2.DFC_flgBrkMaiDiag_C "" VALUE 0x80248C24 Val_Wu16 65535.00 DFES_OneToOne 0.00 65535.00 FORMAT "%8.2" /end CHARACTERISTIC
/begin CHARACTERISTIC DFC_DisblMsk2.DFC_stHvbIsoMeasmtRes_C "" VALUE 0x80248C26 Val_Wu16 65535.00 DFES_OneToOne 0.00 65535.00 FORMAT "%8.2" /end CHARACTERISTIC
/begin CHARACTERISTIC DFC_DisblMsk2.DFC_ResetRcvNotAllwd_C "" VALUE 0x80249024 Val_Wu16 65535.00 DFES_OneToOne 0.00 65535.00 FORMAT "%8.2" /end CHARACTERISTIC
/begin CHARACTERISTIC DFC_DisblMsk2.DFC_TelltlCooltPlaus_C "" VALUE 0x80249026 Val_Wu16 65535.00 DFES_OneToOne 0.00 65535.00 FORMAT "%8.2" /end CHARACTERISTIC
/begin CHARACTERISTIC DrvDoor_SelSig_C "Caibration determining value of Com_stDrvDoor" VALUE 0x802518B0 RB_Val_Wboolean 1.00000000000 B_TRUE 0.00 1.00000000000 FORMAT "%13.11" /end CHARACTERISTIC
/begin CHARACTERISTIC HvBattBlwrThres_C "Calibration involved in the calculation of Com_flgBlowrAuthn" VALUE 0x802518B2 RB_Val_Ws16 799.9878 Prc -400.0000 399.9878 FORMAT "%8.4" /end CHARACTERISTIC
/begin CHARACTERISTIC HvBatt_iActMeasdMax_C "Max value of HvBatt_iActMeasd" VALUE 0x802518B4 RB_Val_Ws16 2047.969 Curr_A_q0p03125_COMPU -1024.000 1023.969 FORMAT "%8.3" /end CHARACTERISTIC
/begin CHARACTERISTIC HvBatt_iActMeasdMin_C "Min value of HvBatt_iActMeasd" VALUE 0x802518B6 RB_Val_Ws16 2047.969 Curr_A_q0p03125_COMPU -1024.000 1023.969 FORMAT "%8.3" /end CHARACTERISTIC
/begin CHARACTERISTIC HvbTotCp_CalSelSig_C "Calibration determing value of Com_qHvbTotCp" VALUE 0x802518B8 RB_Val_Wboolean 1.00000000000 B_TRUE 0.00 1.00000000000 FORMAT "%13.11" /end CHARACTERISTIC
/begin CHARACTERISTIC LIN_tiHoldNwCom_C "Calibration used in the calculation of LIN_tiHoldNwCom." VALUE 0x802518BA RB_Val_Wu16 65535.00 Time_msec_q1_COMPU 0.00 65535.00 FORMAT "%8.2" /end CHARACTERISTIC
/begin CHARACTERISTIC LVBATTBLWRDIS_C "Calibration involved in the calculation of Com_flgBlowrAuthn" VALUE 0x802518BC RB_Val_Wboolean 1.00000000000 B_TRUE 0.00 1.00000000000 FORMAT "%13.11" /end CHARACTERISTIC
/begin CHARACTERISTIC Reset_nrRstRcvAllwd_C "" VALUE 0x802518BD RB_Val_Ws8 3.000 OneToOne 0.00 3.000 FORMAT "%5.3" EXTENDED_LIMITS -128.0 127.0 /end CHARACTERISTIC
/begin CHARACTERISTIC Reset_tiRstFlgHld_C "" VALUE 0x802518BE RB_Val_Wu16 65535.00 Time_msec_q1_COMPU 0.00 65535.00 FORMAT "%8.2" /end CHARACTERISTIC
/begin CHARACTERISTIC SWAdp_PSA_T15OffTimer_C "" VALUE 0x802518C0 RB_Val_Ws16 655.3500 Time_s -327.6800 327.6700 FORMAT "%8.4" /end CHARACTERISTIC
/begin CHARACTERISTIC SWAdp_PSA_T15OnTimer_C "" VALUE 0x802518C2 RB_Val_Ws16 655.3500 Time_s -327.6800 327.6700 FORMAT "%8.4" /end CHARACTERISTIC
/begin CHARACTERISTIC SyC_tiPostDrvMin_C "Minimum time in PostDrive state with rpm equal zero" VALUE 0x802699E0 Val_Wu16 59.80000 SyC_Time_10ms 0.20000 60.00000 FORMAT "%8.5" EXTENDED_LIMITS 0.00 655.3500 /end CHARACTERISTIC
/begin CHARACTERISTIC SyC_tiPreDrvMin_C "Timer for minimum time between Sleep Acknowledge and ECU Shutdown." VALUE 0x802699E2 Val_Wu16 59.80000 SyC_Time_10ms 0.20000 60.00000 FORMAT "%8.5" EXTENDED_LIMITS 0.00 655.3500 /end CHARACTERISTIC
/begin CHARACTERISTIC Telltl_tCooltLampChrgHi_C "Upper threshold for coolant temperature difference of medium temperature circuit and inverter for Telltale Charging control" VALUE 0x80251F48 RB_Val_Wu16 655.3500 q0p01_K 0.00 655.3500 FORMAT "%8.4" /end CHARACTERISTIC
/begin CHARACTERISTIC Telltl_tCooltLampChrgLo_C "Lower threshold for coolant temperature difference of medium temperature circuit and inverter for Telltale Charging control" VALUE 0x80251F4A RB_Val_Wu16 655.3500 q0p01_K 0.00 655.3500 FORMAT "%8.4" /end CHARACTERISTIC
/begin CHARACTERISTIC Telltl_tCooltLampDrvHi_C "Upper threshold for coolant temperature difference of medium temperature circuit and inverter for Telltale drive control" VALUE 0x80251F4C RB_Val_Wu16 655.3500 q0p01_K 0.00 655.3500 FORMAT "%8.4" /end CHARACTERISTIC
/begin CHARACTERISTIC Telltl_tCooltLampDrvLo_C "Lower threshold for coolant temperature difference of medium temperature circuit and inverter for Telltale Drive control" VALUE 0x80251F4E RB_Val_Wu16 655.3500 q0p01_K 0.00 655.3500 FORMAT "%8.4" /end CHARACTERISTIC
/begin CHARACTERISTIC Telltl_tCooltLampIdleHi_C "Upper threshold for coolant temperature difference of medium temperature circuit and inverter for Telltale Idle control" VALUE 0x80251F50 RB_Val_Wu16 655.3500 q0p01_K 0.00 655.3500 FORMAT "%8.4" /end CHARACTERISTIC
/begin CHARACTERISTIC Telltl_tCooltLampIdleLo_C "Lower threshold for coolant temperature difference of medium temperature circuit and inverter for Telltale Idle control" VALUE 0x80251F52 RB_Val_Wu16 655.3500 q0p01_K 0.00 655.3500 FORMAT "%8.4" /end CHARACTERISTIC
/begin CHARACTERISTIC Telltl_tCooltMax_C "Upper Threshold for coolant temperature for Telltale control." VALUE 0x80251F54 RB_Val_Ws16 6553.500 Temp_Cels -3549.940 3003.560 FORMAT "%8.3" /end CHARACTERISTIC
/begin CHARACTERISTIC Telltl_tCooltMin_C "Lower Threshold for coolant temperature for Telltale control." VALUE 0x80251F56 RB_Val_Ws16 6553.500 Temp_Cels -3549.940 3003.560 FORMAT "%8.3" /end CHARACTERISTIC
/begin CHARACTERISTIC Telltl_tiCooltLampChrgDebHiLo_C "HiLo debounce threshold for coolant temperature during charging" VALUE 0x80251F58 RB_Val_Ws16 655.3500 Time_s -327.6800 327.6700 FORMAT "%8.4" /end CHARACTERISTIC
/begin CHARACTERISTIC Telltl_tiCooltLampChrgDebLoHi_C "LoHi debounce threshold for coolant temperature during charging" VALUE 0x80251F5A RB_Val_Ws16 655.3500 Time_s -327.6800 327.6700 FORMAT "%8.4" /end CHARACTERISTIC
/begin CHARACTERISTIC Telltl_tiCooltLampDebHiLo_C "High to low debounce time for telltale control." VALUE 0x80251F5C RB_Val_Ws16 655.3500 Time_s -327.6800 327.6700 FORMAT "%8.4" /end CHARACTERISTIC
/begin CHARACTERISTIC Telltl_tiCooltLampDebLoHi_C "Low to high debounce time for telltale control." VALUE 0x80251F5E RB_Val_Ws16 655.3500 Time_s -327.6800 327.6700 FORMAT "%8.4" /end CHARACTERISTIC
/begin CHARACTERISTIC Telltl_tiCooltLampDrvDebHiLo_C "HiLo debounce threshold for coolant temperature during drive" VALUE 0x80251F60 RB_Val_Ws16 655.3500 Time_s -327.6800 327.6700 FORMAT "%8.4" /end CHARACTERISTIC
/begin CHARACTERISTIC Telltl_tiCooltLampDrvDebLoHi_C "LoHi debounce threshold for coolant temperature during drive." VALUE 0x80251F62 RB_Val_Ws16 655.3500 Time_s -327.6800 327.6700 FORMAT "%8.4" /end CHARACTERISTIC
/begin CHARACTERISTIC Telltl_tiCooltLampIdelDebHiLo_C "HiLo debounce threshold for coolant temperature during idle" VALUE 0x80251F64 RB_Val_Ws16 655.3500 Time_s -327.6800 327.6700 FORMAT "%8.4" /end CHARACTERISTIC
/begin CHARACTERISTIC Telltl_tiCooltLampIdleDebLoHi_C "LoHi debounce threshold for coolant temperature during idle" VALUE 0x80251F66 RB_Val_Ws16 655.3500 Time_s -327.6800 327.6700 FORMAT "%8.4" /end CHARACTERISTIC
/begin CHARACTERISTIC ThermCfg_ratFastSocFild_C "Minimu LV SoC for thermal system to be active" VALUE 0x80251F8C RB_Val_Wu8 255.0 rel_q1 0.00 255.0 FORMAT "%5.1" /end CHARACTERISTIC
/begin CHARACTERISTIC ThermCfg_stMTCircAlc_C "parameter to select the components in the medium temperature circuit" VALUE 0x80251F8E RB_Val_Wu16 65535.00 OneToOne 0.00 65535.00 FORMAT "%8.2" /end CHARACTERISTIC
/begin CHARACTERISTIC ThermCfg_tiAftRunEmgyOff_C "Minimum post drive extenstion delay during emergency shutdown" VALUE 0x80251F90 RB_Val_Ws16 655.3500 Time_s -327.6800 327.6700 FORMAT "%8.4" /end CHARACTERISTIC
/begin CHARACTERISTIC ThermCfg_tiAftRunMin_C "Minimum post drive extenstion time" VALUE 0x80251F92 RB_Val_Ws16 655.3500 Time_s -327.6800 327.6700 FORMAT "%8.4" /end CHARACTERISTIC
/begin CHARACTERISTIC ThermCfg_vVehSpdLim_C "Vehicle speed threshold to keep thermal system active during shutdown" VALUE 0x80251F94 RB_Val_Ws16 655.3500 Vel -327.6800 327.6700 FORMAT "%8.4" /end CHARACTERISTIC
/begin CHARACTERISTIC ThermCoorn_stCtrl_CA "parameter array for control state in the different thermal states of the medium temperature coolant circuit" VAL_BLK 0x80251F96 RB_ValA_Wu8 255.0 q1 0.00 255.0 FORMAT "%5.1" MATRIX_DIM 9 /end CHARACTERISTIC
/begin CHARACTERISTIC ThermCoorn_stHVReqMidT_CA "parameter array to determine HV request based on mid temperature circuit" VAL_BLK 0x80251F9F RB_ValA_Wu8 255.0 q1 0.00 255.0 FORMAT "%5.1" MATRIX_DIM 9 /end CHARACTERISTIC
/begin CHARACTERISTIC ThermCoorn_stMTBypVlv_CA "parameter array for control state of the bypass valve in the different thermal states of the medium temperature coolant circuit" VAL_BLK 0x80251FA8 RB_ValA_Wu8 255.0 q1 0.00 255.0 FORMAT "%5.1" MATRIX_DIM 9 /end CHARACTERISTIC
/begin CHARACTERISTIC ThermCoorn_stMTFanRels_CA "parameter array for fan release in the different thermal states of the medium temperature coolant circuit" VAL_BLK 0x80251FB1 RB_ValA_Wu8 255.0 q1 0.00 255.0 FORMAT "%5.1" MATRIX_DIM 9 /end CHARACTERISTIC
/begin CHARACTERISTIC ThermCoorn_stMTPmp_CA "parameter array for control state of the water pump in the different thermal states of the medium temperature coolant circuit" VAL_BLK 0x80251FBA RB_ValA_Wu8 255.0 q1 0.00 255.0 FORMAT "%5.1" MATRIX_DIM 9 /end CHARACTERISTIC
/begin CHARACTERISTIC ThermCoorn_tiHvacHvReqOffDly_C "Turn off delay to remove HV request" VALUE 0x80251FC4 RB_Val_Ws16 655.3500 q0p01_s -327.6800 327.6700 FORMAT "%8.4" /end CHARACTERISTIC
/begin CHARACTERISTIC ThermDcdc_flgProlg_C "Calibration to define the after run request" VALUE 0x80251FC8 RB_Val_Wu8 1.00000000000 B_TRUE 0.00 1.00000000000 FORMAT "%13.11" /end CHARACTERISTIC
/begin CHARACTERISTIC ThermDcdc_ratCooltReqMap_T "Parameter to define flow with respect to Dcdc temperature" CURVE 0x80251FCA RB_Curve_S16_S8_sao 255.0 RBPtCel_Perc_1p0_1 -128.0 127.0 FORMAT "%5.1"
 /begin AXIS_DESCR STD_AXIS ThermDcdc_tFild RBPtCel_t_0p02_1 3 -655.3600 655.3400 FORMAT "%8.4" DEPOSIT ABSOLUTE /end AXIS_DESCR
/end CHARACTERISTIC
/begin CHARACTERISTIC ThermDcdc_tiFil_C "Parameter to time for filtering the temperature" VALUE 0x80251FD8 RB_Val_Wu32 4294.96729500 RBPtCel_ti_1p0em6_1 0.00 4294.96729500 FORMAT "%13.8" /end CHARACTERISTIC
/begin CHARACTERISTIC ThermDcdc_tProlg_C "Parameter for the threshold temperature" VALUE 0x80251FDC RB_Val_Ws16 1310.700 RBPtCel_t_0p02_1 -655.3600 655.3400 FORMAT "%8.4" /end CHARACTERISTIC
/begin CHARACTERISTIC ThermDcdc_tPT1Ini_C "Paramter to initialize the filter" VALUE 0x80251FDE RB_Val_Ws16 1310.700 RBPtCel_t_0p02_1 -655.3600 655.3400 FORMAT "%8.4" /end CHARACTERISTIC
/begin CHARACTERISTIC ThermElTrac_flgElM01Prolg_C "parameter to enable an afterrun request depending on the temperature of electrical machine 1" VALUE 0x80251FE0 RB_Val_Wu8 1.00000000000 B_TRUE 0.00 1.00000000000 FORMAT "%13.11" /end CHARACTERISTIC
/begin CHARACTERISTIC ThermElTrac_flgEm01PwrLossProlg_C "parameter to enable an afterrun request depending on the power losses of electrical machine 1" VALUE 0x80251FE1 RB_Val_Wu8 1.00000000000 B_TRUE 0.00 1.00000000000 FORMAT "%13.11" /end CHARACTERISTIC
/begin CHARACTERISTIC ThermElTrac_flgIvtr01Prolg_C "parameter to enable an afterrun request depending on the temperature of inverter 1" VALUE 0x80251FE2 RB_Val_Wu8 1.00000000000 B_TRUE 0.00 1.00000000000 FORMAT "%13.11" /end CHARACTERISTIC
/begin CHARACTERISTIC ThermElTrac_pwrEm01Init_C "initial value of the PT1 filter for the power losses of electrical machine 1" VALUE 0x80251FE4 RB_Val_Ws16 1048560. leist_q16_W -524288.0 524272.0 FORMAT "%8.1" /end CHARACTERISTIC
/begin CHARACTERISTIC ThermElTrac_pwrLossEm01_C "threshold for a flow and afterrun request depending on the power losses of electrical machine 1" VALUE 0x80251FE6 RB_Val_Ws16 1048560. leist_q16_W -524288.0 524272.0 FORMAT "%8.1" /end CHARACTERISTIC
/begin CHARACTERISTIC ThermElTrac_ratCooltReqElM01_T "curve for the flow request depending on the temperature of electrical machine 1" CURVE 0x80251FE8 RB_Curve_S16_S8_sao 255.0 RBPtCel_Perc_1p0_1 -128.0 127.0 FORMAT "%5.1"
 /begin AXIS_DESCR STD_AXIS ThermElTrac_tElM01Flt RBPtCel_t_0p02_1 3 -655.3600 655.3400 FORMAT "%8.4" DEPOSIT ABSOLUTE /end AXIS_DESCR
/end CHARACTERISTIC
/begin CHARACTERISTIC ThermElTrac_ratCooltReqIvtr01_T "curve for the flow request depending on the temperature of inverter 1" CURVE 0x80251FF4 RB_Curve_S16_S8_sao 255.0 RBPtCel_Perc_1p0_1 -128.0 127.0 FORMAT "%5.1"
 /begin AXIS_DESCR STD_AXIS ThermElTrac_tIvtr01Flt RBPtCel_t_0p02_1 3 -655.3600 655.3400 FORMAT "%8.4" DEPOSIT ABSOLUTE /end AXIS_DESCR
/end CHARACTERISTIC
/begin CHARACTERISTIC ThermElTrac_ratEm01PwrLoss_C "parameter for the additional flow request depending on the power losses of electrical machine 1" VALUE 0x80252000 RB_Val_Ws8 255.0 RBPtCel_Perc_1p0_1 -128.0 127.0 FORMAT "%5.1" /end CHARACTERISTIC
/begin CHARACTERISTIC ThermElTrac_tElM01Init_C "initial value of the PT1 filter for the temperature of electrical machine 1" VALUE 0x80252002 RB_Val_Ws16 1310.700 RBPtCel_t_0p02_1 -655.3600 655.3400 FORMAT "%8.4" /end CHARACTERISTIC
/begin CHARACTERISTIC ThermElTrac_tElM01Prolg_C "parameter to enable an afterrun request depending on the temperature of electrical machine 1" VALUE 0x80252004 RB_Val_Ws16 1310.700 RBPtCel_t_0p02_1 -655.3600 655.3400 FORMAT "%8.4" /end CHARACTERISTIC
/begin CHARACTERISTIC ThermElTrac_tiElM01T_C "filter constant of the PT1 filter for the temperature of electrical machine 1" VALUE 0x80252008 RB_Val_Wu32 4294.96729500 RBPtCel_ti_1p0em6_1 0.00 4294.96729500 FORMAT "%13.8" /end CHARACTERISTIC
/begin CHARACTERISTIC ThermElTrac_tiEm01PwrLossProlg_C "turn off delay time of the afterrun request depending on the power losses of electrical machine 1" VALUE 0x8025200C RB_Val_Ws16 655.3500 Time_s -327.6800 327.6700 FORMAT "%8.4" /end CHARACTERISTIC
/begin CHARACTERISTIC ThermElTrac_tiEm01PwrLoss_C "filter constant of the PT1 filter for the power losses of electrical machine 1" VALUE 0x80252010 RB_Val_Wu32 4294.96729500 RBPtCel_ti_1p0em6_1 0.00 4294.96729500 FORMAT "%13.8" /end CHARACTERISTIC
/begin CHARACTERISTIC ThermElTrac_tiIvtr01T_C "filter constant of the PT1 filter for the temperature of inverter 1" VALUE 0x80252014 RB_Val_Wu32 4294.96729500 RBPtCel_ti_1p0em6_1 0.00 4294.96729500 FORMAT "%13.8" /end CHARACTERISTIC
/begin CHARACTERISTIC ThermElTrac_tIvtr01Init_C "initial value of the PT1 filter for the temperature of inverter 1" VALUE 0x80252018 RB_Val_Ws16 1310.700 RBPtCel_t_0p02_1 -655.3600 655.3400 FORMAT "%8.4" /end CHARACTERISTIC
/begin CHARACTERISTIC ThermElTrac_tIvtr01Prolg_C "parameter to enable an afterrun request depending on the temperature of inverter 1" VALUE 0x8025201A RB_Val_Ws16 1310.700 RBPtCel_t_0p02_1 -655.3600 655.3400 FORMAT "%8.4" /end CHARACTERISTIC
/begin CHARACTERISTIC ThermHvac_ratHvBattSocDelta_C "battery SOC delta to avoid toggling of detected battery state" VALUE 0x8025201C RB_Val_Ws16 799.9878 Prc -400.0000 399.9878 FORMAT "%8.4" /end CHARACTERISTIC
/begin CHARACTERISTIC ThermHvac_ratHvBattSocPreCdngMin_C "Minimum threshold for SoC" VALUE 0x8025201E RB_Val_Ws16 799.9878 Prc -400.0000 399.9878 FORMAT "%8.4" /end CHARACTERISTIC
/begin CHARACTERISTIC ThermHvac_stPrecndnDisCfg_C "Calibration to disable pre-condition state evaluations" VALUE 0x80252020 RB_Val_Wu16 65535.00 q1 0.00 65535.00 FORMAT "%8.2" /end CHARACTERISTIC
/begin CHARACTERISTIC ThermHvac_stRemPrecndnMap_T "Pre-conditioning status mapping table" CURVE 0x80252022 RB_Curve_U8_U8 255.0 q1 0.00 255.0 FORMAT "%5.1"
 /begin AXIS_DESCR STD_AXIS ThermHvac_stRemPrecndnInt q1 11 0.00 255.0 FORMAT "%5.1" DEPOSIT ABSOLUTE /end AXIS_DESCR
/end CHARACTERISTIC
/begin CHARACTERISTIC ThermHvac_tEvaprSpDeFogMaxEco_C "Maximum desired ecomode defog evaporator temperature" VALUE 0x8025203A RB_Val_Ws16 6553.500 Temp_Cels -3549.940 3003.560 FORMAT "%8.3" /end CHARACTERISTIC
/begin CHARACTERISTIC ThermHvac_tEvaprSpDeFogMax_C "Maximum desired defog evaporator temperature" VALUE 0x8025203C RB_Val_Ws16 6553.500 Temp_Cels -3549.940 3003.560 FORMAT "%8.3" /end CHARACTERISTIC
/begin CHARACTERISTIC ThermHvac_tEvaprSpDeFogMinEco_C "Minimum desired ecomode defog evaporator temperature" VALUE 0x8025203E RB_Val_Ws16 6553.500 Temp_Cels -3549.940 3003.560 FORMAT "%8.3" /end CHARACTERISTIC
/begin CHARACTERISTIC ThermHvac_tEvaprSpDeFogMin_C "Minimum desired defog evaporator temperature" VALUE 0x80252040 RB_Val_Ws16 6553.500 Temp_Cels -3549.940 3003.560 FORMAT "%8.3" /end CHARACTERISTIC
/begin CHARACTERISTIC ThermHvac_tEvaprSpMaxEco_T "Maximum desired ecomode evaporator temperature" CURVE 0x80252042 RB_Curve_U8_S16_sao 6553.500 Temp_Cels -3549.940 3003.560 FORMAT "%8.3"
 /begin AXIS_DESCR STD_AXIS HvacHmi_stCoolgReq q1 6 0.00 255.0 FORMAT "%5.1" DEPOSIT ABSOLUTE /end AXIS_DESCR
/end CHARACTERISTIC
/begin CHARACTERISTIC ThermHvac_tEvaprSpMax_T "Maximum desired evaporator temperature" CURVE 0x80252056 RB_Curve_U8_S16_sao 6553.500 Temp_Cels -3549.940 3003.560 FORMAT "%8.3"
 /begin AXIS_DESCR STD_AXIS HvacHmi_stCoolgReq q1 6 0.00 255.0 FORMAT "%5.1" DEPOSIT ABSOLUTE /end AXIS_DESCR
/end CHARACTERISTIC
/begin CHARACTERISTIC ThermHvac_tEvaprSpMinEco_T "Minimum desired ecomode evaporator temperature" CURVE 0x8025206A RB_Curve_U8_S16_sao 6553.500 Temp_Cels -3549.940 3003.560 FORMAT "%8.3"
 /begin AXIS_DESCR STD_AXIS HvacHmi_stCoolgReq q1 6 0.00 255.0 FORMAT "%5.1" DEPOSIT ABSOLUTE /end AXIS_DESCR
/end CHARACTERISTIC
/begin CHARACTERISTIC ThermHvac_tEvaprSpMin_T "Minimum desired evaporator temperature" CURVE 0x8025207E RB_Curve_U8_S16_sao 6553.500 Temp_Cels -3549.940 3003.560 FORMAT "%8.3"
 /begin AXIS_DESCR STD_AXIS HvacHmi_stCoolgReq q1 6 0.00 255.0 FORMAT "%5.1" DEPOSIT ABSOLUTE /end AXIS_DESCR
/end CHARACTERISTIC
/begin CHARACTERISTIC ThermHvac_tiEvlnDly_C "Delay for pre-condition status evaluation" VALUE 0x80252092 RB_Val_Ws8 25.50 q0p1_s -12.80 12.70 FORMAT "%5.2" /end CHARACTERISTIC
/begin CHARACTERISTIC ThermLvl_tDiffEnvMTCooltMax_C "maximum temperature difference between environment and MT coolant to ensure heat transition" VALUE 0x80252094 RB_Val_Ws16 6553.500 RBPtCel_t_0p1_1 -3276.800 3276.700 FORMAT "%8.3" /end CHARACTERISTIC
/begin CHARACTERISTIC ThermLvl_tMTCoolgCooltMin_C "minimum coolant temperature for passive cooling in the medium temperature circuit" VALUE 0x80252096 RB_Val_Ws16 6553.500 Temp_Cels -3549.940 3003.560 FORMAT "%8.3" /end CHARACTERISTIC
/begin CHARACTERISTIC ThermMod_dTAirFlowHysDelta_C "Hysteresis delta for requesting air-flow mode" VALUE 0x80252098 RB_Val_Ws16 6553.500 RBPtCel_t_0p1_1 -3276.800 3276.700 FORMAT "%8.3" /end CHARACTERISTIC
/begin CHARACTERISTIC ThermMod_dTAirFlowReq_C "Threshold for requesting air-flow mode" VALUE 0x8025209A RB_Val_Ws16 6553.500 RBPtCel_t_0p1_1 -3276.800 3276.700 FORMAT "%8.3" /end CHARACTERISTIC
/begin CHARACTERISTIC ThermMod_dTMTEnvDelta_C "Hysteresis delta-temperature for categories of environment temperature effect on MT-coolant" VALUE 0x8025209C RB_Val_Ws16 6553.500 RBPtCel_t_0p1_1 -3276.800 3276.700 FORMAT "%8.3" /end CHARACTERISTIC
/begin CHARACTERISTIC ThermMod_dTMTEnvHeatgMax_C "threshold for the delta between MT coolant and environmental temperature for heating" VALUE 0x8025209E RB_Val_Ws16 6553.500 RBPtCel_t_0p1_1 -3276.800 3276.700 FORMAT "%8.3" /end CHARACTERISTIC
/begin CHARACTERISTIC ThermMod_dTMTEnvInRngMax_C "Threshold for upper limit of category MT-coolant ""in range"" w.r.t. environment temperature" VALUE 0x802520A0 RB_Val_Ws16 6553.500 RBPtCel_t_0p1_1 -3276.800 3276.700 FORMAT "%8.3" /end CHARACTERISTIC
/begin CHARACTERISTIC ThermMod_tiReqDeb_C "Debounce time for component-request conditions" VALUE 0x802520A2 RB_Val_Ws16 655.3500 Time_s -327.6800 327.6700 FORMAT "%8.4" /end CHARACTERISTIC
/begin CHARACTERISTIC VehCoorn_maskIgnPosnVldy1Sq_C "" VALUE 0x802518C4 RB_Val_Wu16 65535.00 OneToOne 0.00 65535.00 FORMAT "%8.2" /end CHARACTERISTIC
/begin MEASUREMENT AirBgECU_stAirBg "AirBg status message" UBYTE OneToOne 1 100 0.00 255.0 FORMAT "%5.1" ECU_ADDRESS 0x6002368E
 /begin IF_DATA XCPplus 0x0102
  /begin DAQ_EVENT VARIABLE /end DAQ_EVENT
 /end IF_DATA
/end MEASUREMENT
/begin MEASUREMENT APP_rInp "Accelarator Input" UBYTE rel_q0p5 1 100 0.00 100.0 FORMAT "%5.1" ECU_ADDRESS 0x60023694
 /begin IF_DATA XCPplus 0x0102
  /begin DAQ_EVENT VARIABLE /end DAQ_EVENT
 /end IF_DATA
/end MEASUREMENT
/begin MEASUREMENT BattId_numOrganNature1 "Battery organ nature number 1 - Category" UBYTE OneToOne 1 100 0.00 255.0 FORMAT "%5.1" ECU_ADDRESS 0x60023689
 /begin IF_DATA XCPplus 0x0102
  /begin DAQ_EVENT VARIABLE /end DAQ_EVENT
 /end IF_DATA
/end MEASUREMENT
/begin MEASUREMENT BattId_numOrganNature2 "Battery organ nature number 2 - Category" UBYTE OneToOne 1 100 0.00 255.0 FORMAT "%5.1" ECU_ADDRESS 0x60023688
 /begin IF_DATA XCPplus 0x0102
  /begin DAQ_EVENT VARIABLE /end DAQ_EVENT
 /end IF_DATA
/end MEASUREMENT
/begin MEASUREMENT BattId_numOrganRef1 "Battery organ reference number 1 - Unit code" UBYTE OneToOne 1 100 0.00 255.0 FORMAT "%5.1" ECU_ADDRESS 0x60023687
 /begin IF_DATA XCPplus 0x0102
  /begin DAQ_EVENT VARIABLE /end DAQ_EVENT
 /end IF_DATA
/end MEASUREMENT
/begin MEASUREMENT BattId_numOrganRef2 "Battery organ reference number 2 - Unit code" UBYTE OneToOne 1 100 0.00 255.0 FORMAT "%5.1" ECU_ADDRESS 0x60023686
 /begin IF_DATA XCPplus 0x0102
  /begin DAQ_EVENT VARIABLE /end DAQ_EVENT
 /end IF_DATA
/end MEASUREMENT
/begin MEASUREMENT BattId_numOrganRef3 "Battery organ reference number 3 - Unit code" UBYTE OneToOne 1 100 0.00 255.0 FORMAT "%5.1" ECU_ADDRESS 0x60023685
 /begin IF_DATA XCPplus 0x0102
  /begin DAQ_EVENT VARIABLE /end DAQ_EVENT
 /end IF_DATA
/end MEASUREMENT
/begin MEASUREMENT BattId_numOrganRef4 "Battery organ reference number 4 - Unit code" UBYTE OneToOne 1 100 0.00 255.0 FORMAT "%5.1" ECU_ADDRESS 0x60023684
 /begin IF_DATA XCPplus 0x0102
  /begin DAQ_EVENT VARIABLE /end DAQ_EVENT
 /end IF_DATA
/end MEASUREMENT
/begin MEASUREMENT BattId_numSerl1 "Battery serial number 1" UBYTE OneToOne 1 100 0.00 255.0 FORMAT "%5.1" ECU_ADDRESS 0x60023683
 /begin IF_DATA XCPplus 0x0102
  /begin DAQ_EVENT VARIABLE /end DAQ_EVENT
 /end IF_DATA
/end MEASUREMENT
/begin MEASUREMENT BattId_numSerl2 "Battery serial number 2" UBYTE OneToOne 1 100 0.00 255.0 FORMAT "%5.1" ECU_ADDRESS 0x60023682
 /begin IF_DATA XCPplus 0x0102
  /begin DAQ_EVENT VARIABLE /end DAQ_EVENT
 /end IF_DATA
/end MEASUREMENT
/begin MEASUREMENT BattId_numSerl3 "Battery serial number 3" UBYTE OneToOne 1 100 0.00 255.0 FORMAT "%5.1" ECU_ADDRESS 0x60023681
 /begin IF_DATA XCPplus 0x0102
  /begin DAQ_EVENT VARIABLE /end DAQ_EVENT
 /end IF_DATA
/end MEASUREMENT
/begin MEASUREMENT BattId_numSerl4 "Battery serial number 4" UBYTE OneToOne 1 100 0.00 255.0 FORMAT "%5.1" ECU_ADDRESS 0x60023680
 /begin IF_DATA XCPplus 0x0102
  /begin DAQ_EVENT VARIABLE /end DAQ_EVENT
 /end IF_DATA
/end MEASUREMENT
/begin MEASUREMENT BattId_numSerl5 "Battery serial number 5" UBYTE OneToOne 1 100 0.00 255.0 FORMAT "%5.1" ECU_ADDRESS 0x6002367F
 /begin IF_DATA XCPplus 0x0102
  /begin DAQ_EVENT VARIABLE /end DAQ_EVENT
 /end IF_DATA
/end MEASUREMENT
/begin MEASUREMENT BattId_numSerl6 "Battery serial number 6" UBYTE OneToOne 1 100 0.00 255.0 FORMAT "%5.1" ECU_ADDRESS 0x6002367E
 /begin IF_DATA XCPplus 0x0102
  /begin DAQ_EVENT VARIABLE /end DAQ_EVENT
 /end IF_DATA
/end MEASUREMENT
/begin MEASUREMENT BattId_numSerl7 "Battery serial number 7" UBYTE OneToOne 1 100 0.00 255.0 FORMAT "%5.1" ECU_ADDRESS 0x6002367D
 /begin IF_DATA XCPplus 0x0102
  /begin DAQ_EVENT VARIABLE /end DAQ_EVENT
 /end IF_DATA
/end MEASUREMENT
/begin MEASUREMENT ChrgrRly_stRlyDes "Desired DC charging contactor state for kunction box" UBYTE OneToOne 1 100 0.00 3.000 FORMAT "%5.3" ECU_ADDRESS 0x6002364C
 /begin IF_DATA XCPplus 0x0102
  /begin DAQ_EVENT VARIABLE /end DAQ_EVENT
 /end IF_DATA
/end MEASUREMENT
/begin MEASUREMENT CoDrvPITh_stEPSModeReq "EPS Mode Request from VCU" UBYTE CoPtFH_stPs_VERB 1 100 0.00 5.00000000000 FORMAT "%13.11" ECU_ADDRESS 0x60023649
 /begin IF_DATA XCPplus 0x0102
  /begin DAQ_EVENT VARIABLE /end DAQ_EVENT
 /end IF_DATA
/end MEASUREMENT
/begin MEASUREMENT ComChrgn_iDcRly_Sq "Signal qualifier for DC current at charge inlet from CAN" UBYTE SigQly_COMPU_VERB 1 100 0.00 15.0000000000 FORMAT "%13.10" ECU_ADDRESS 0x60023643
 /begin IF_DATA XCPplus 0x0102
  /begin DAQ_EVENT VARIABLE /end DAQ_EVENT
 /end IF_DATA
/end MEASUREMENT
/begin MEASUREMENT ComChrgn_uDcRly_Sq "Signal qualifier for DC voltage at charge inlet from CAN" UBYTE SigQly_COMPU_VERB 1 100 0.00 15.0000000000 FORMAT "%13.10" ECU_ADDRESS 0x60023642
 /begin IF_DATA XCPplus 0x0102
  /begin DAQ_EVENT VARIABLE /end DAQ_EVENT
 /end IF_DATA
/end MEASUREMENT
/begin MEASUREMENT ComChrgr_flgChrgrErr "Inverted info of OBC_FaultLevel" UBYTE B_TRUE 1 100 0.00 1.00000000000 BIT_MASK 0x1 FORMAT "%13.11" ECU_ADDRESS 0x600234C4
 /begin IF_DATA XCPplus 0x0102
  /begin DAQ_EVENT VARIABLE /end DAQ_EVENT
 /end IF_DATA
/end MEASUREMENT
/begin MEASUREMENT ComChrgr_flgChrgrErr_Sq "flag to inidcate charge error" UBYTE SigQly_COMPU_VERB 1 100 0.00 15.0000000000 FORMAT "%13.10" ECU_ADDRESS 0x60023641
 /begin IF_DATA XCPplus 0x0102
  /begin DAQ_EVENT VARIABLE /end DAQ_EVENT
 /end IF_DATA
/end MEASUREMENT
/begin MEASUREMENT ComChrgr_iAcMax_Sq "Input AC current sent to VCU signal quality" UBYTE SigQly_COMPU_VERB 1 100 0.00 15.0000000000 FORMAT "%13.10" ECU_ADDRESS 0x60023640
 /begin IF_DATA XCPplus 0x0102
  /begin DAQ_EVENT VARIABLE /end DAQ_EVENT
 /end IF_DATA
/end MEASUREMENT
/begin MEASUREMENT ComChrgr_iDcHvAct_Sq "Output current of OBC signal quality" UBYTE SigQly_COMPU_VERB 1 100 0.00 15.0000000000 FORMAT "%13.10" ECU_ADDRESS 0x6002363F
 /begin IF_DATA XCPplus 0x0102
  /begin DAQ_EVENT VARIABLE /end DAQ_EVENT
 /end IF_DATA
/end MEASUREMENT
/begin MEASUREMENT ComChrgr_pwrInAct_Sq "Signal quality for Actual Charger input power" UBYTE SigQly_COMPU_VERB 1 100 0.00 15.0000000000 FORMAT "%13.10" ECU_ADDRESS 0x6002345E
 /begin IF_DATA XCPplus 0x0102
  /begin DAQ_EVENT VARIABLE /end DAQ_EVENT
 /end IF_DATA
/end MEASUREMENT
/begin MEASUREMENT ComChrgr_stChrgnEna "Command from VCU to OBC to operate in a specific mode" UBYTE OneToOne 1 100 0.00 255.0 FORMAT "%5.1" ECU_ADDRESS 0x6002363E
 /begin IF_DATA XCPplus 0x0102
  /begin DAQ_EVENT VARIABLE /end DAQ_EVENT
 /end IF_DATA
/end MEASUREMENT
/begin MEASUREMENT ComChrgr_stChrgr "charging status from On Board charger" UBYTE OneToOne 1 100 0.00 255.0 FORMAT "%5.1" ECU_ADDRESS 0x6002363D
 /begin IF_DATA XCPplus 0x0102
  /begin DAQ_EVENT VARIABLE /end DAQ_EVENT
 /end IF_DATA
/end MEASUREMENT
/begin MEASUREMENT ComChrgr_stChrgr_Sq "falg for charger state" UBYTE SigQly_COMPU_VERB 1 100 0.00 15.0000000000 FORMAT "%13.10" ECU_ADDRESS 0x6002363C
 /begin IF_DATA XCPplus 0x0102
  /begin DAQ_EVENT VARIABLE /end DAQ_EVENT
 /end IF_DATA
/end MEASUREMENT
/begin MEASUREMENT ComChrgr_tChrgrMaxAct_Sq "Power module temperature signal quality" UBYTE SigQly_COMPU_VERB 1 100 0.00 15.0000000000 FORMAT "%13.10" ECU_ADDRESS 0x6002363B
 /begin IF_DATA XCPplus 0x0102
  /begin DAQ_EVENT VARIABLE /end DAQ_EVENT
 /end IF_DATA
/end MEASUREMENT
/begin MEASUREMENT ComChrgr_uAcActL1_Sq "Input voltage signal quality" UBYTE SigQly_COMPU_VERB 1 100 0.00 15.0000000000 FORMAT "%13.10" ECU_ADDRESS 0x60000242
 /begin IF_DATA XCPplus 0x0102
  /begin DAQ_EVENT VARIABLE /end DAQ_EVENT
 /end IF_DATA
/end MEASUREMENT
/begin MEASUREMENT ComChrgr_uDcHvAct_Sq "Output voltage signal quality" UBYTE SigQly_COMPU_VERB 1 100 0.00 15.0000000000 FORMAT "%13.10" ECU_ADDRESS 0x6002363A
 /begin IF_DATA XCPplus 0x0102
  /begin DAQ_EVENT VARIABLE /end DAQ_EVENT
 /end IF_DATA
/end MEASUREMENT
/begin MEASUREMENT ComChrg_stMod "HVBAT fastslow charging" UBYTE OneToOne 1 100 0.00 255.0 FORMAT "%5.1" ECU_ADDRESS 0x60023644
 /begin IF_DATA XCPplus 0x0102
  /begin DAQ_EVENT VARIABLE /end DAQ_EVENT
 /end IF_DATA
/end MEASUREMENT
/begin MEASUREMENT ComEmac_flgEmgyShtDwnReq01 "Emergency shutdown request from inverter of Emachine-01" UBYTE B_TRUE 1 100 0.00 1.00000000000 BIT_MASK 0x1 FORMAT "%13.11" ECU_ADDRESS 0x600234C3
 /begin IF_DATA XCPplus 0x0102
  /begin DAQ_EVENT VARIABLE /end DAQ_EVENT
 /end IF_DATA
/end MEASUREMENT
/begin MEASUREMENT ComEmac_flgImobAuthent_Sq "Immobilizer authentication signal quality" UBYTE SigQly_COMPU_VERB 1 100 0.00 15.0000000000 FORMAT "%13.10" ECU_ADDRESS 0x6002345D
 /begin IF_DATA XCPplus 0x0102
  /begin DAQ_EVENT VARIABLE /end DAQ_EVENT
 /end IF_DATA
/end MEASUREMENT
/begin MEASUREMENT ComEmac_stIsoMonSwtAck_Sq "Insulation Monitoring Acknowledge Switch signal quality" UBYTE SigQly_COMPU_VERB 1 100 0.00 15.0000000000 FORMAT "%13.10" ECU_ADDRESS 0x60023634
 /begin IF_DATA XCPplus 0x0102
  /begin DAQ_EVENT VARIABLE /end DAQ_EVENT
 /end IF_DATA
/end MEASUREMENT
/begin MEASUREMENT ComEmac_stMod01 "Operation mode, e-machine 01" UBYTE OneToOne 1 100 0.00 255.0 FORMAT "%5.1" ECU_ADDRESS 0x60023633
 /begin IF_DATA XCPplus 0x0102
  /begin DAQ_EVENT VARIABLE /end DAQ_EVENT
 /end IF_DATA
/end MEASUREMENT
/begin MEASUREMENT ComEmac_stPwrAuthn_Sq "Traction operation authorization signal quality" UBYTE SigQly_COMPU_VERB 1 100 0.00 15.0000000000 FORMAT "%13.10" ECU_ADDRESS 0x60023631
 /begin IF_DATA XCPplus 0x0102
  /begin DAQ_EVENT VARIABLE /end DAQ_EVENT
 /end IF_DATA
/end MEASUREMENT
/begin MEASUREMENT ComEmac_tqAbsltMax01 "Maximum absolute torque, e-machine 01" SWORD Trq 1 100 -3276.800 3276.700 FORMAT "%8.3" ECU_ADDRESS 0x6001FBD4
 /begin IF_DATA XCPplus 0x0102
  /begin DAQ_EVENT VARIABLE /end DAQ_EVENT
 /end IF_DATA
/end MEASUREMENT
/begin MEASUREMENT ComEmac_tqAbsltMin01 "Minimum absolute torque, e-machine 01" SWORD Trq 1 100 -3276.800 3276.700 FORMAT "%8.3" ECU_ADDRESS 0x6001FBD2
 /begin IF_DATA XCPplus 0x0102
  /begin DAQ_EVENT VARIABLE /end DAQ_EVENT
 /end IF_DATA
/end MEASUREMENT
/begin MEASUREMENT CommDev_bPostOperationWkuPls "Post Operation Wakeup request" UBYTE OneToOne 1 100 0.00 255.0 FORMAT "%5.1" ECU_ADDRESS 0x600235D4
 /begin IF_DATA XCPplus 0x0102
  /begin DAQ_EVENT VARIABLE /end DAQ_EVENT
 /end IF_DATA
/end MEASUREMENT
/begin MEASUREMENT Com_bCAN1ComNd "Activation request for CAN 1 network" UBYTE B_TRUE 1 100 0.00 1.00000000000 BIT_MASK 0x1 FORMAT "%13.11" ECU_ADDRESS 0x600234C1
 /begin IF_DATA XCPplus 0x0102
  /begin DAQ_EVENT VARIABLE /end DAQ_EVENT
 /end IF_DATA
/end MEASUREMENT
/begin MEASUREMENT Com_bCAN2ComNd "Activation request for CAN 2 network" UBYTE B_TRUE 1 100 0.00 1.00000000000 BIT_MASK 0x1 FORMAT "%13.11" ECU_ADDRESS 0x600234C0
 /begin IF_DATA XCPplus 0x0102
  /begin DAQ_EVENT VARIABLE /end DAQ_EVENT
 /end IF_DATA
/end MEASUREMENT
/begin MEASUREMENT Com_bCAN3ComNd "Activation request for CAN 3 network" UBYTE B_TRUE 1 100 0.00 1.00000000000 BIT_MASK 0x1 FORMAT "%13.11" ECU_ADDRESS 0x600234BF
 /begin IF_DATA XCPplus 0x0102
  /begin DAQ_EVENT VARIABLE /end DAQ_EVENT
 /end IF_DATA
/end MEASUREMENT
/begin MEASUREMENT Com_bCANComNdLoc1 "" UBYTE B_TRUE 1 100 0.00 1.00000000000 BIT_MASK 0x1 FORMAT "%13.11" ECU_ADDRESS 0x60022FC8
 /begin IF_DATA XCPplus 0x0102
  /begin DAQ_EVENT VARIABLE /end DAQ_EVENT
 /end IF_DATA
/end MEASUREMENT
/begin MEASUREMENT Com_bfPtlWkuReq "Partial Wakeup request" UWORD OneToOne 1 100 0.00 65535.00 FORMAT "%8.2" ECU_ADDRESS 0x6001FA42
 /begin IF_DATA XCPplus 0x0102
  /begin DAQ_EVENT VARIABLE /end DAQ_EVENT
 /end IF_DATA
/end MEASUREMENT
/begin MEASUREMENT Com_bLINComNd "Activation request for LIN network" UBYTE B_TRUE 1 100 0.00 1.00000000000 BIT_MASK 0x1 FORMAT "%13.11" ECU_ADDRESS 0x600234BD
 /begin IF_DATA XCPplus 0x0102
  /begin DAQ_EVENT VARIABLE /end DAQ_EVENT
 /end IF_DATA
/end MEASUREMENT
/begin MEASUREMENT Com_bLINComReq "LIN Communication Request" UBYTE B_TRUE 1 100 0.00 1.00000000000 BIT_MASK 0x1 FORMAT "%13.11" ECU_ADDRESS 0x600234BC
 /begin IF_DATA XCPplus 0x0102
  /begin DAQ_EVENT VARIABLE /end DAQ_EVENT
 /end IF_DATA
/end MEASUREMENT
/begin MEASUREMENT Com_bPostOperationWkuReq "Post Operation Wakeup request" UBYTE B_TRUE 1 100 0.00 1.00000000000 BIT_MASK 0x1 FORMAT "%13.11" ECU_ADDRESS 0x600234BB
 /begin IF_DATA XCPplus 0x0102
  /begin DAQ_EVENT VARIABLE /end DAQ_EVENT
 /end IF_DATA
/end MEASUREMENT
/begin MEASUREMENT Com_bRstDetdLoc "Local variable for detection of ECU reset" UBYTE B_TRUE 1 100 0.00 1.00000000000 BIT_MASK 0x1 FORMAT "%13.11" ECU_ADDRESS 0x60022FC7
 /begin IF_DATA XCPplus 0x0102
  /begin DAQ_EVENT VARIABLE /end DAQ_EVENT
 /end IF_DATA
/end MEASUREMENT
/begin MEASUREMENT Com_egyHvbAvl_Sq "Energy available signal quality" UBYTE SigQly_COMPU_VERB 1 100 0.00 15.0000000000 FORMAT "%13.10" ECU_ADDRESS 0x6002345A
 /begin IF_DATA XCPplus 0x0102
  /begin DAQ_EVENT VARIABLE /end DAQ_EVENT
 /end IF_DATA
/end MEASUREMENT
/begin MEASUREMENT Com_flgBlowrAuthn "VCU commands to turn off blower relay when SOC is less than 65" UBYTE B_TRUE 1 100 0.00 1.00000000000 BIT_MASK 0x1 FORMAT "%13.11" ECU_ADDRESS 0x600234BA
 /begin IF_DATA XCPplus 0x0102
  /begin DAQ_EVENT VARIABLE /end DAQ_EVENT
 /end IF_DATA
/end MEASUREMENT
/begin MEASUREMENT Com_flgChrgnStopAndUnlckReq "Request to stop charging and unlock charge plug" UBYTE B_TRUE 1 100 0.00 1.00000000000 BIT_MASK 0x1 FORMAT "%13.11" ECU_ADDRESS 0x600234B7
 /begin IF_DATA XCPplus 0x0102
  /begin DAQ_EVENT VARIABLE /end DAQ_EVENT
 /end IF_DATA
/end MEASUREMENT
/begin MEASUREMENT Com_flgDrvAwy "Creep function status" UBYTE B_TRUE 1 100 0.00 1.00000000000 BIT_MASK 0x1 FORMAT "%13.11" ECU_ADDRESS 0x600234B5
 /begin IF_DATA XCPplus 0x0102
  /begin DAQ_EVENT VARIABLE /end DAQ_EVENT
 /end IF_DATA
/end MEASUREMENT
/begin MEASUREMENT Com_flgHillHldActvd "flag to check hillhold is activated" UBYTE B_TRUE 1 100 0.00 1.00000000000 BIT_MASK 0x1 FORMAT "%13.11" ECU_ADDRESS 0x600234B3
 /begin IF_DATA XCPplus 0x0102
  /begin DAQ_EVENT VARIABLE /end DAQ_EVENT
 /end IF_DATA
/end MEASUREMENT
/begin MEASUREMENT Com_flgT15ChrgnStopAndUnlckReq "Flag for charge stop and unlock request" UBYTE B_TRUE 1 100 0.00 1.00000000000 BIT_MASK 0x1 FORMAT "%13.11" ECU_ADDRESS 0x60022FC6
 /begin IF_DATA XCPplus 0x0102
  /begin DAQ_EVENT VARIABLE /end DAQ_EVENT
 /end IF_DATA
/end MEASUREMENT
/begin MEASUREMENT Com_flgVehSpdQly "Vehicle speed unavailability flag" UBYTE OneToOne 1 100 0.00 255.0 FORMAT "%5.1" ECU_ADDRESS 0x60023621
 /begin IF_DATA XCPplus 0x0102
  /begin DAQ_EVENT VARIABLE /end DAQ_EVENT
 /end IF_DATA
/end MEASUREMENT
/begin MEASUREMENT Com_iBattEBS "Battery current from EBS" SLONG Curr_mA_q0p9765625_COMPU 1 100 -2097152000.00 2097151999.02 FORMAT "%13.2" ECU_ADDRESS 0x60000F74
 /begin IF_DATA XCPplus 0x0102
  /begin DAQ_EVENT VARIABLE /end DAQ_EVENT
 /end IF_DATA
/end MEASUREMENT
/begin MEASUREMENT Com_iDcdcHvActRvsn1_Sq "Signal quality of DCDC input current" UBYTE SigQly_COMPU_VERB 1 100 0.00 15.0000000000 FORMAT "%13.10" ECU_ADDRESS 0x60023620
 /begin IF_DATA XCPplus 0x0102
  /begin DAQ_EVENT VARIABLE /end DAQ_EVENT
 /end IF_DATA
/end MEASUREMENT
/begin MEASUREMENT Com_iDcdcLvActRvsn1_Sq "Signal quality for Com_iDcdcLvActRvsn1" UBYTE SigQly_COMPU_VERB 1 100 0.00 15.0000000000 FORMAT "%13.10" ECU_ADDRESS 0x6002361F
 /begin IF_DATA XCPplus 0x0102
  /begin DAQ_EVENT VARIABLE /end DAQ_EVENT
 /end IF_DATA
/end MEASUREMENT
/begin MEASUREMENT Com_iHvbAct "Actual current of the HV battery" SWORD Curr_A_q0p03125_COMPU 1 100 -1024.000 1023.969 FORMAT "%8.3" ECU_ADDRESS 0x6001FBD0
 /begin IF_DATA XCPplus 0x0102
  /begin DAQ_EVENT VARIABLE /end DAQ_EVENT
 /end IF_DATA
/end MEASUREMENT
/begin MEASUREMENT Com_iHvbActTx "Real current of HV battery on CAN" SWORD q0p4_A 1 100 -400.0000 400.0000 FORMAT "%8.4" ECU_ADDRESS 0x6001F9EC
 /begin IF_DATA XCPplus 0x0102
  /begin DAQ_EVENT VARIABLE /end DAQ_EVENT
 /end IF_DATA
/end MEASUREMENT
/begin MEASUREMENT Com_nElCmprActlTx "e-compressor RPM" UWORD RBPtCel_n_1p0_1 1 100 0.00 8000.000 FORMAT "%8.3" ECU_ADDRESS 0x6001FA40
 /begin IF_DATA XCPplus 0x0102
  /begin DAQ_EVENT VARIABLE /end DAQ_EVENT
 /end IF_DATA
/end MEASUREMENT
/begin MEASUREMENT Com_nIvtrMotAct01 "Inverter Motor Speed CAN signal" SWORD RBPtCel_n_10p0_1 1 100 -32770.00 32770.00 FORMAT "%8.2" ECU_ADDRESS 0x6001F9EA
 /begin IF_DATA XCPplus 0x0102
  /begin DAQ_EVENT VARIABLE /end DAQ_EVENT
 /end IF_DATA
/end MEASUREMENT
/begin MEASUREMENT com_postoperationwkuplsloc "Local variable to stire diffswtmr value" SLONG Time_s 1 100 -21474836.4800 21474836.4700 FORMAT "%13.4" ECU_ADDRESS 0x60000F14
 /begin IF_DATA XCPplus 0x0102
  /begin DAQ_EVENT VARIABLE /end DAQ_EVENT
 /end IF_DATA
/end MEASUREMENT
/begin MEASUREMENT Com_pwrMaxChrgContns "Power input to calculate, Regenerative voltage limit for 30 secs" UWORD q0p1_kW 1 100 0.00 160.0000 FORMAT "%8.4" ECU_ADDRESS 0x6001FA3E
 /begin IF_DATA XCPplus 0x0102
  /begin DAQ_EVENT VARIABLE /end DAQ_EVENT
 /end IF_DATA
/end MEASUREMENT
/begin MEASUREMENT Com_pwrMaxChrgContns_Sq "Signal quality of CAN signal Regenerative continuous Power limit" UBYTE SigQly_COMPU_VERB 1 100 0.00 15.0000000000 FORMAT "%13.10" ECU_ADDRESS 0x60023617
 /begin IF_DATA XCPplus 0x0102
  /begin DAQ_EVENT VARIABLE /end DAQ_EVENT
 /end IF_DATA
/end MEASUREMENT
/begin MEASUREMENT Com_pwrMaxChrgSho_Sq "Signal quality of CAN signal Regenerative Power limit for 30 secs" UBYTE SigQly_COMPU_VERB 1 100 0.00 15.0000000000 FORMAT "%13.10" ECU_ADDRESS 0x60023616
 /begin IF_DATA XCPplus 0x0102
  /begin DAQ_EVENT VARIABLE /end DAQ_EVENT
 /end IF_DATA
/end MEASUREMENT
/begin MEASUREMENT Com_pwrMaxDchaContns "Power inputto calculate, HV Battery available Peak Discharging voltage limit for 30 sec" UWORD q0p1_kW 1 100 0.00 160.0000 FORMAT "%8.4" ECU_ADDRESS 0x60000244
 /begin IF_DATA XCPplus 0x0102
  /begin DAQ_EVENT VARIABLE /end DAQ_EVENT
 /end IF_DATA
/end MEASUREMENT
/begin MEASUREMENT Com_pwrMaxDchaContns_Sq "Signal quality of CAN signal HV Battery available Peak continuous Discharging power" UBYTE SigQly_COMPU_VERB 1 100 0.00 15.0000000000 FORMAT "%13.10" ECU_ADDRESS 0x60023615
 /begin IF_DATA XCPplus 0x0102
  /begin DAQ_EVENT VARIABLE /end DAQ_EVENT
 /end IF_DATA
/end MEASUREMENT
/begin MEASUREMENT Com_pwrMaxDchaSho_Sq "Signal quality of CAN signal HV Battery available Peak Discharging power for 30 sec" UBYTE SigQly_COMPU_VERB 1 100 0.00 15.0000000000 FORMAT "%13.10" ECU_ADDRESS 0x60023614
 /begin IF_DATA XCPplus 0x0102
  /begin DAQ_EVENT VARIABLE /end DAQ_EVENT
 /end IF_DATA
/end MEASUREMENT
/begin MEASUREMENT Com_qHvbTotCp "Capacity of battery system of whole vehicle, with rated capacityAh, 0.1 Ahbit; 0Ah offset" SWORD RBPtCel_q_0p125_1 1 100 -4096.000 4095.875 FORMAT "%8.3" ECU_ADDRESS 0x6001FBCA
 /begin IF_DATA XCPplus 0x0102
  /begin DAQ_EVENT VARIABLE /end DAQ_EVENT
 /end IF_DATA
/end MEASUREMENT
/begin MEASUREMENT Com_ratHvbSoh_Sq "Hv Battery state of health ratio raw signal quality" UBYTE SigQly_COMPU_VERB 1 100 0.00 15.0000000000 FORMAT "%13.10" ECU_ADDRESS 0x60023611
 /begin IF_DATA XCPplus 0x0102
  /begin DAQ_EVENT VARIABLE /end DAQ_EVENT
 /end IF_DATA
/end MEASUREMENT
/begin MEASUREMENT Com_stACTx "AC switch status on CAN" UBYTE B_TRUE 1 100 0.00 1.00000000000 BIT_MASK 0x1 FORMAT "%13.11" ECU_ADDRESS 0x600234B2
 /begin IF_DATA XCPplus 0x0102
  /begin DAQ_EVENT VARIABLE /end DAQ_EVENT
 /end IF_DATA
/end MEASUREMENT
/begin MEASUREMENT Com_stBrk "Status of Brk/FDR" UBYTE OneToOne 1 100 0.00 255.0 FORMAT "%5.1" ECU_ADDRESS 0x6002360F
 /begin IF_DATA XCPplus 0x0102
  /begin DAQ_EVENT VARIABLE /end DAQ_EVENT
 /end IF_DATA
/end MEASUREMENT
/begin MEASUREMENT Com_stCAN1ComReq "CAN Communication Request on CAN node 1" UBYTE Com_stCANComReq_VERB 1 100 0.00 2.00000000000 FORMAT "%13.11" ECU_ADDRESS 0x6002360C
 /begin IF_DATA XCPplus 0x0102
  /begin DAQ_EVENT VARIABLE /end DAQ_EVENT
 /end IF_DATA
/end MEASUREMENT
/begin MEASUREMENT Com_stCAN2ComReq "CAN Communication Request on CAN node 2" UBYTE Com_stCANComReq_VERB 1 100 0.00 2.00000000000 FORMAT "%13.11" ECU_ADDRESS 0x6002360B
 /begin IF_DATA XCPplus 0x0102
  /begin DAQ_EVENT VARIABLE /end DAQ_EVENT
 /end IF_DATA
/end MEASUREMENT
/begin MEASUREMENT Com_stCAN3ComReq "CAN Communication Request on CAN node 3" UBYTE Com_stCANComReq_VERB 1 100 0.00 2.00000000000 FORMAT "%13.11" ECU_ADDRESS 0x6002360A
 /begin IF_DATA XCPplus 0x0102
  /begin DAQ_EVENT VARIABLE /end DAQ_EVENT
 /end IF_DATA
/end MEASUREMENT
/begin MEASUREMENT Com_stChrgPlg "Gun connectionCharging Status" UBYTE OneToOne 1 100 0.00 2.000 FORMAT "%5.3" ECU_ADDRESS 0x60023609
 /begin IF_DATA XCPplus 0x0102
  /begin DAQ_EVENT VARIABLE /end DAQ_EVENT
 /end IF_DATA
/end MEASUREMENT
/begin MEASUREMENT Com_stChrgPlgChrgn "Gun connectionCharging Status" UBYTE OneToOne 1 100 0.00 255.0 FORMAT "%5.1" ECU_ADDRESS 0x60023608
 /begin IF_DATA XCPplus 0x0102
  /begin DAQ_EVENT VARIABLE /end DAQ_EVENT
 /end IF_DATA
/end MEASUREMENT
/begin MEASUREMENT Com_stClstrStopIndcn "Stop indication in Cluster" UBYTE OneToOne 1 100 0.00 255.0 FORMAT "%5.1" ECU_ADDRESS 0x60023607
 /begin IF_DATA XCPplus 0x0102
  /begin DAQ_EVENT VARIABLE /end DAQ_EVENT
 /end IF_DATA
/end MEASUREMENT
/begin MEASUREMENT Com_stCmdHvBattCntctr "Request from VCU to open the battery contactor" UBYTE OneToOne 1 100 0.00 255.0 FORMAT "%5.1" ECU_ADDRESS 0x60023606
 /begin IF_DATA XCPplus 0x0102
  /begin DAQ_EVENT VARIABLE /end DAQ_EVENT
 /end IF_DATA
/end MEASUREMENT
/begin MEASUREMENT Com_stDcdcOperModAct "Current mode of the DCDC converte" UBYTE OneToOne 1 100 0.00 255.0 FORMAT "%5.1" ECU_ADDRESS 0x60023605
 /begin IF_DATA XCPplus 0x0102
  /begin DAQ_EVENT VARIABLE /end DAQ_EVENT
 /end IF_DATA
/end MEASUREMENT
/begin MEASUREMENT Com_stDcdcOperModAct_Sq "Signal quality for operation mode of DCDC1" UBYTE SigQly_COMPU_VERB 1 100 0.00 15.0000000000 FORMAT "%13.10" ECU_ADDRESS 0x60023604
 /begin IF_DATA XCPplus 0x0102
  /begin DAQ_EVENT VARIABLE /end DAQ_EVENT
 /end IF_DATA
/end MEASUREMENT
/begin MEASUREMENT Com_stDcdcShutoffErr "DCDC shut off error status" UBYTE OneToOne 1 100 0.00 255.0 FORMAT "%5.1" ECU_ADDRESS 0x60023603
 /begin IF_DATA XCPplus 0x0102
  /begin DAQ_EVENT VARIABLE /end DAQ_EVENT
 /end IF_DATA
/end MEASUREMENT
/begin MEASUREMENT Com_stDcdcShutoffErr_Sq "Signal quality interface for shut off error of DCDC" UBYTE SigQly_COMPU_VERB 1 100 0.00 15.0000000000 FORMAT "%13.10" ECU_ADDRESS 0x60023602
 /begin IF_DATA XCPplus 0x0102
  /begin DAQ_EVENT VARIABLE /end DAQ_EVENT
 /end IF_DATA
/end MEASUREMENT
/begin MEASUREMENT Com_stDcdcT30C "Com_stDcdcT30C" UBYTE OneToOne 1 100 0.00 255.0 FORMAT "%5.1" ECU_ADDRESS 0x60023601
 /begin IF_DATA XCPplus 0x0102
  /begin DAQ_EVENT VARIABLE /end DAQ_EVENT
 /end IF_DATA
/end MEASUREMENT
/begin MEASUREMENT Com_stDcdcT30C_Sq "Signal quality for Com DCDC T30C status" UBYTE SigQly_COMPU_VERB 1 100 0.00 15.0000000000 FORMAT "%13.10" ECU_ADDRESS 0x60023600
 /begin IF_DATA XCPplus 0x0102
  /begin DAQ_EVENT VARIABLE /end DAQ_EVENT
 /end IF_DATA
/end MEASUREMENT
/begin MEASUREMENT Com_stDcdcULimReq_Sq "Signal quality of LV Output Voltage limit request signal" UBYTE SigQly_COMPU_VERB 1 100 0.00 15.0000000000 FORMAT "%13.10" ECU_ADDRESS 0x60023458
 /begin IF_DATA XCPplus 0x0102
  /begin DAQ_EVENT VARIABLE /end DAQ_EVENT
 /end IF_DATA
/end MEASUREMENT
/begin MEASUREMENT Com_stDcdcVltgErr "DCDC voltage error status" UBYTE OneToOne 1 100 0.00 255.0 FORMAT "%5.1" ECU_ADDRESS 0x600235FF
 /begin IF_DATA XCPplus 0x0102
  /begin DAQ_EVENT VARIABLE /end DAQ_EVENT
 /end IF_DATA
/end MEASUREMENT
/begin MEASUREMENT Com_stDcdcVltgErr_Sq "Signal quality for Com DCDC voltage error status" UBYTE SigQly_COMPU_VERB 1 100 0.00 15.0000000000 FORMAT "%13.10" ECU_ADDRESS 0x600235FE
 /begin IF_DATA XCPplus 0x0102
  /begin DAQ_EVENT VARIABLE /end DAQ_EVENT
 /end IF_DATA
/end MEASUREMENT
/begin MEASUREMENT Com_stDrvAwyDi "Reason for disabling creep" UBYTE OneToOne 1 100 0.00 3.000 FORMAT "%5.3" ECU_ADDRESS 0x600235FD
 /begin IF_DATA XCPplus 0x0102
  /begin DAQ_EVENT VARIABLE /end DAQ_EVENT
 /end IF_DATA
/end MEASUREMENT
/begin MEASUREMENT Com_stDrvDoor "Driver Door status given by CEM" UBYTE OneToOne 1 100 0.00 255.0 FORMAT "%5.1" ECU_ADDRESS 0x600235FC
 /begin IF_DATA XCPplus 0x0102
  /begin DAQ_EVENT VARIABLE /end DAQ_EVENT
 /end IF_DATA
/end MEASUREMENT
/begin MEASUREMENT Com_stDrvModPosn "actual GearStatus position" UBYTE OneToOne 1 100 0.00 7.000 FORMAT "%5.3" ECU_ADDRESS 0x600235FB
 /begin IF_DATA XCPplus 0x0102
  /begin DAQ_EVENT VARIABLE /end DAQ_EVENT
 /end IF_DATA
/end MEASUREMENT
/begin MEASUREMENT Com_stDrvStblt "Com message of drivers seat belt buckle status" UBYTE OneToOne 1 100 0.00 3.000 FORMAT "%5.3" ECU_ADDRESS 0x600235FA
 /begin IF_DATA XCPplus 0x0102
  /begin DAQ_EVENT VARIABLE /end DAQ_EVENT
 /end IF_DATA
/end MEASUREMENT
/begin MEASUREMENT Com_stElCmprStatTx "Air conditioing status on CAN" UBYTE B_TRUE 1 100 0.00 1.00000000000 BIT_MASK 0x1 FORMAT "%13.11" ECU_ADDRESS 0x600234AF
 /begin IF_DATA XCPplus 0x0102
  /begin DAQ_EVENT VARIABLE /end DAQ_EVENT
 /end IF_DATA
/end MEASUREMENT
/begin MEASUREMENT Com_stElMDesEem "Request for active Discharge initiation" UBYTE OneToOne 1 100 0.00 255.0 FORMAT "%5.1" ECU_ADDRESS 0x600235F4
 /begin IF_DATA XCPplus 0x0102
  /begin DAQ_EVENT VARIABLE /end DAQ_EVENT
 /end IF_DATA
/end MEASUREMENT
/begin MEASUREMENT Com_stHvBattOperModDes "Command from VCU to HVBAT to operate in a specific state" UBYTE OneToOne 1 100 0.00 255.0 FORMAT "%5.1" ECU_ADDRESS 0x600235F2
 /begin IF_DATA XCPplus 0x0102
  /begin DAQ_EVENT VARIABLE /end DAQ_EVENT
 /end IF_DATA
/end MEASUREMENT
/begin MEASUREMENT Com_stHvbChrgFlt "HV battery fault state" UWORD OneToOne 1 100 0.00 65535.00 FORMAT "%8.2" ECU_ADDRESS 0x6001FA3C
 /begin IF_DATA XCPplus 0x0102
  /begin DAQ_EVENT VARIABLE /end DAQ_EVENT
 /end IF_DATA
/end MEASUREMENT
/begin MEASUREMENT Com_stHvbCntct "Main contactor status of the HV battery" UBYTE OneToOne 1 100 0.00 255.0 FORMAT "%5.1" ECU_ADDRESS 0x600235F1
 /begin IF_DATA XCPplus 0x0102
  /begin DAQ_EVENT VARIABLE /end DAQ_EVENT
 /end IF_DATA
/end MEASUREMENT
/begin MEASUREMENT Com_stHvbFlt "HV Battery Error" UBYTE OneToOne 1 100 0.00 255.0 FORMAT "%5.1" ECU_ADDRESS 0x600235EF
 /begin IF_DATA XCPplus 0x0102
  /begin DAQ_EVENT VARIABLE /end DAQ_EVENT
 /end IF_DATA
/end MEASUREMENT
/begin MEASUREMENT Com_stHvbIntlck "HV interlock state" UBYTE OneToOne 1 100 0.00 255.0 FORMAT "%5.1" ECU_ADDRESS 0x600235ED
 /begin IF_DATA XCPplus 0x0102
  /begin DAQ_EVENT VARIABLE /end DAQ_EVENT
 /end IF_DATA
/end MEASUREMENT
/begin MEASUREMENT Com_stHvbIsoFlt "Isolations resistance error HV battery" UBYTE OneToOne 1 100 0.00 255.0 FORMAT "%5.1" ECU_ADDRESS 0x600235EC
 /begin IF_DATA XCPplus 0x0102
  /begin DAQ_EVENT VARIABLE /end DAQ_EVENT
 /end IF_DATA
/end MEASUREMENT
/begin MEASUREMENT Com_stHvbMod "Status HV battery" UBYTE OneToOne 1 100 0.00 255.0 FORMAT "%5.1" ECU_ADDRESS 0x600235EB
 /begin IF_DATA XCPplus 0x0102
  /begin DAQ_EVENT VARIABLE /end DAQ_EVENT
 /end IF_DATA
/end MEASUREMENT
/begin MEASUREMENT Com_stHvbSrvPlg "E -service plug status" UBYTE OneToOne 1 100 0.00 3.000 FORMAT "%5.3" ECU_ADDRESS 0x600235E9
 /begin IF_DATA XCPplus 0x0102
  /begin DAQ_EVENT VARIABLE /end DAQ_EVENT
 /end IF_DATA
/end MEASUREMENT
/begin MEASUREMENT Com_stIgnkeyPos_Sq "Ignition key position signal quality" UBYTE SigQly_COMPU_VERB 1 100 0.00 15.0000000000 FORMAT "%13.10" ECU_ADDRESS 0x600235E7
 /begin IF_DATA XCPplus 0x0102
  /begin DAQ_EVENT VARIABLE /end DAQ_EVENT
 /end IF_DATA
/end MEASUREMENT
/begin MEASUREMENT Com_stMainWkuInvld "FId_Com_stMainWkuInvld status updated using this interface." UBYTE B_TRUE 1 100 0.00 1.00000000000 BIT_MASK 0x1 FORMAT "%13.11" ECU_ADDRESS 0x600234AC
 /begin IF_DATA XCPplus 0x0102
  /begin DAQ_EVENT VARIABLE /end DAQ_EVENT
 /end IF_DATA
/end MEASUREMENT
/begin MEASUREMENT Com_stPckCnctn "HVBAT connection status" UBYTE OneToOne 1 100 0.00 255.0 FORMAT "%5.1" ECU_ADDRESS 0x600235E5
 /begin IF_DATA XCPplus 0x0102
  /begin DAQ_EVENT VARIABLE /end DAQ_EVENT
 /end IF_DATA
/end MEASUREMENT
/begin MEASUREMENT Com_stPrkBrk "Parking brake activation by EasyMov function received on CAN" UBYTE OneToOne 1 100 0.00 255.0 FORMAT "%5.1" ECU_ADDRESS 0x600235E4
 /begin IF_DATA XCPplus 0x0102
  /begin DAQ_EVENT VARIABLE /end DAQ_EVENT
 /end IF_DATA
/end MEASUREMENT
/begin MEASUREMENT Com_stSoc "State of SOC signal" UBYTE OneToOne 1 100 0.00 255.0 FORMAT "%5.1" ECU_ADDRESS 0x600235E2
 /begin IF_DATA XCPplus 0x0102
  /begin DAQ_EVENT VARIABLE /end DAQ_EVENT
 /end IF_DATA
/end MEASUREMENT
/begin MEASUREMENT Com_stVehCoorn "Ready to start driving . Whenever this signal is updated with 1: Ready to drive, simultaneously the signal VCU_MODE_EPS_REQUEST also to be updated." UBYTE OneToOne 1 100 0.00 255.0 FORMAT "%5.1" ECU_ADDRESS 0x600235E0
 /begin IF_DATA XCPplus 0x0102
  /begin DAQ_EVENT VARIABLE /end DAQ_EVENT
 /end IF_DATA
/end MEASUREMENT
/begin MEASUREMENT Com_tBattEBS "Battery temperature from EBS" SWORD SCR_TEMP_CELS_float 1 100 -32768.00 32767.00 FORMAT "%8.2" ECU_ADDRESS 0x6001FBC8
 /begin IF_DATA XCPplus 0x0102
  /begin DAQ_EVENT VARIABLE /end DAQ_EVENT
 /end IF_DATA
/end MEASUREMENT
/begin MEASUREMENT Com_tDcdcAct_Sq "Signal quality interface of temperature signal of dcdc" UBYTE SigQly_COMPU_VERB 1 100 0.00 15.0000000000 FORMAT "%13.10" ECU_ADDRESS 0x600235DF
 /begin IF_DATA XCPplus 0x0102
  /begin DAQ_EVENT VARIABLE /end DAQ_EVENT
 /end IF_DATA
/end MEASUREMENT
/begin MEASUREMENT Com_tDcdcInltCoolt_Sq "Signal quality of DCDC Coolant Temperature" UBYTE SigQly_COMPU_VERB 1 100 0.00 15.0000000000 FORMAT "%13.10" ECU_ADDRESS 0x600235DE
 /begin IF_DATA XCPplus 0x0102
  /begin DAQ_EVENT VARIABLE /end DAQ_EVENT
 /end IF_DATA
/end MEASUREMENT
/begin MEASUREMENT Com_tiRstHldLoc "local variable for Local variable for delay time ECU reset" SLONG Time_Dt 1 100 -2147.48364800 2147.48364700 FORMAT "%13.8" ECU_ADDRESS 0x600005F8
 /begin IF_DATA XCPplus 0x0102
  /begin DAQ_EVENT VARIABLE /end DAQ_EVENT
 /end IF_DATA
/end MEASUREMENT
/begin MEASUREMENT Com_tqMotLimMax "Maximum inverter torque limit" SLONG TrqPrpHigh 1 100 -214748364.800 214748364.700 FORMAT "%13.3" ECU_ADDRESS 0x60000F70
 /begin IF_DATA XCPplus 0x0102
  /begin DAQ_EVENT VARIABLE /end DAQ_EVENT
 /end IF_DATA
/end MEASUREMENT
/begin MEASUREMENT Com_uBattEBS "Battery voltage from EBS" SWORD U_mV_q0p9765625_COMPU 1 100 -32000.00 31999.02 FORMAT "%8.2" ECU_ADDRESS 0x6001FBC6
 /begin IF_DATA XCPplus 0x0102
  /begin DAQ_EVENT VARIABLE /end DAQ_EVENT
 /end IF_DATA
/end MEASUREMENT
/begin MEASUREMENT Com_uDcdcHvAct_Sq "Signal quality for Com_uDcdcHvAct" UBYTE SigQly_COMPU_VERB 1 100 0.00 15.0000000000 FORMAT "%13.10" ECU_ADDRESS 0x600235DD
 /begin IF_DATA XCPplus 0x0102
  /begin DAQ_EVENT VARIABLE /end DAQ_EVENT
 /end IF_DATA
/end MEASUREMENT
/begin MEASUREMENT Com_uDcdcLvAct_Sq "Signal quality for Com_uDcdcLvAct" UBYTE SigQly_COMPU_VERB 1 100 0.00 15.0000000000 FORMAT "%13.10" ECU_ADDRESS 0x600235DC
 /begin IF_DATA XCPplus 0x0102
  /begin DAQ_EVENT VARIABLE /end DAQ_EVENT
 /end IF_DATA
/end MEASUREMENT
/begin MEASUREMENT Com_uHvbActTx "Traction battery voltage" SLONG RBPtCel_u_0p25_1 1 100 -1024.00000000 1024.00000000 FORMAT "%13.8" ECU_ADDRESS 0x60000F6C
 /begin IF_DATA XCPplus 0x0102
  /begin DAQ_EVENT VARIABLE /end DAQ_EVENT
 /end IF_DATA
/end MEASUREMENT
/begin MEASUREMENT Com_uHvbChrgMaxSho "Short-term Maximum Charging voltage of HV Battery" SWORD Volt_V_q0p03125_COMPU 1 100 -1024.000 1023.969 FORMAT "%8.3" ECU_ADDRESS 0x6001FBC2
 /begin IF_DATA XCPplus 0x0102
  /begin DAQ_EVENT VARIABLE /end DAQ_EVENT
 /end IF_DATA
/end MEASUREMENT
/begin MEASUREMENT Com_uHvbDchaMaxSho "Short-term Maximum Discharging voltage of HV Battery" SWORD Volt_V_q0p03125_COMPU 1 100 -1024.000 1023.969 FORMAT "%8.3" ECU_ADDRESS 0x6001FBBE
 /begin IF_DATA XCPplus 0x0102
  /begin DAQ_EVENT VARIABLE /end DAQ_EVENT
 /end IF_DATA
/end MEASUREMENT
/begin MEASUREMENT CoPtFH_stPwt "GMP status" UBYTE CoPtFH_stPwt_VERB 1 100 0.00 15.0000000000 FORMAT "%13.10" ECU_ADDRESS 0x60023645
 /begin IF_DATA XCPplus 0x0102
  /begin DAQ_EVENT VARIABLE /end DAQ_EVENT
 /end IF_DATA
/end MEASUREMENT
/begin MEASUREMENT ct_Ary_flg0 "flag deciding the value updated to BattId_numOrganNature1" UBYTE B_TRUE 1 100 0.00 1.00000000000 BIT_MASK 0x1 FORMAT "%13.11" ECU_ADDRESS 0x60023483
 /begin IF_DATA XCPplus 0x0102
  /begin DAQ_EVENT VARIABLE /end DAQ_EVENT
 /end IF_DATA
/end MEASUREMENT
/begin MEASUREMENT ct_Ary_flg1 "flag deciding the value updated to BattId_numOrganNature2" UBYTE B_TRUE 1 100 0.00 1.00000000000 BIT_MASK 0x1 FORMAT "%13.11" ECU_ADDRESS 0x6002347F
 /begin IF_DATA XCPplus 0x0102
  /begin DAQ_EVENT VARIABLE /end DAQ_EVENT
 /end IF_DATA
/end MEASUREMENT
/begin MEASUREMENT ct_Ary_flg10 "flag deciding the value updated to BattId_numSerl5" UBYTE B_TRUE 1 100 0.00 1.00000000000 BIT_MASK 0x1 FORMAT "%13.11" ECU_ADDRESS 0x60023482
 /begin IF_DATA XCPplus 0x0102
  /begin DAQ_EVENT VARIABLE /end DAQ_EVENT
 /end IF_DATA
/end MEASUREMENT
/begin MEASUREMENT ct_Ary_flg11 "flag deciding the value updated to BattId_numSerl6" UBYTE B_TRUE 1 100 0.00 1.00000000000 BIT_MASK 0x1 FORMAT "%13.11" ECU_ADDRESS 0x60023481
 /begin IF_DATA XCPplus 0x0102
  /begin DAQ_EVENT VARIABLE /end DAQ_EVENT
 /end IF_DATA
/end MEASUREMENT
/begin MEASUREMENT ct_Ary_flg12 "flag deciding the value updated to BattId_numSerl7" UBYTE B_TRUE 1 100 0.00 1.00000000000 BIT_MASK 0x1 FORMAT "%13.11" ECU_ADDRESS 0x60023480
 /begin IF_DATA XCPplus 0x0102
  /begin DAQ_EVENT VARIABLE /end DAQ_EVENT
 /end IF_DATA
/end MEASUREMENT
/begin MEASUREMENT ct_Ary_flg2 "flag deciding the value updated to BattId_numOrganRef1" UBYTE B_TRUE 1 100 0.00 1.00000000000 BIT_MASK 0x1 FORMAT "%13.11" ECU_ADDRESS 0x6002347E
 /begin IF_DATA XCPplus 0x0102
  /begin DAQ_EVENT VARIABLE /end DAQ_EVENT
 /end IF_DATA
/end MEASUREMENT
/begin MEASUREMENT ct_Ary_flg3 "flag deciding the value updated to BattId_numOrganRef2" UBYTE B_TRUE 1 100 0.00 1.00000000000 BIT_MASK 0x1 FORMAT "%13.11" ECU_ADDRESS 0x6002347D
 /begin IF_DATA XCPplus 0x0102
  /begin DAQ_EVENT VARIABLE /end DAQ_EVENT
 /end IF_DATA
/end MEASUREMENT
/begin MEASUREMENT ct_Ary_flg4 "flag deciding the value updated to BattId_numOrganRef3" UBYTE B_TRUE 1 100 0.00 1.00000000000 BIT_MASK 0x1 FORMAT "%13.11" ECU_ADDRESS 0x6002347C
 /begin IF_DATA XCPplus 0x0102
  /begin DAQ_EVENT VARIABLE /end DAQ_EVENT
 /end IF_DATA
/end MEASUREMENT
/begin MEASUREMENT ct_Ary_flg5 "flag deciding the value updated to BattId_numOrganRef4" UBYTE B_TRUE 1 100 0.00 1.00000000000 BIT_MASK 0x1 FORMAT "%13.11" ECU_ADDRESS 0x6002347B
 /begin IF_DATA XCPplus 0x0102
  /begin DAQ_EVENT VARIABLE /end DAQ_EVENT
 /end IF_DATA
/end MEASUREMENT
/begin MEASUREMENT ct_Ary_flg6 "flag deciding the value updated to BattId_numSerl1" UBYTE B_TRUE 1 100 0.00 1.00000000000 BIT_MASK 0x1 FORMAT "%13.11" ECU_ADDRESS 0x6002347A
 /begin IF_DATA XCPplus 0x0102
  /begin DAQ_EVENT VARIABLE /end DAQ_EVENT
 /end IF_DATA
/end MEASUREMENT
/begin MEASUREMENT ct_Ary_flg7 "flag deciding the value updated to BattId_numSerl2" UBYTE B_TRUE 1 100 0.00 1.00000000000 BIT_MASK 0x1 FORMAT "%13.11" ECU_ADDRESS 0x60023479
 /begin IF_DATA XCPplus 0x0102
  /begin DAQ_EVENT VARIABLE /end DAQ_EVENT
 /end IF_DATA
/end MEASUREMENT
/begin MEASUREMENT ct_Ary_flg8 "flag deciding the value updated to BattId_numSerl3" UBYTE B_TRUE 1 100 0.00 1.00000000000 BIT_MASK 0x1 FORMAT "%13.11" ECU_ADDRESS 0x60023478
 /begin IF_DATA XCPplus 0x0102
  /begin DAQ_EVENT VARIABLE /end DAQ_EVENT
 /end IF_DATA
/end MEASUREMENT
/begin MEASUREMENT ct_Ary_flg9 "flag deciding the value updated to BattId_numSerl4" UBYTE B_TRUE 1 100 0.00 1.00000000000 BIT_MASK 0x1 FORMAT "%13.11" ECU_ADDRESS 0x60023477
 /begin IF_DATA XCPplus 0x0102
  /begin DAQ_EVENT VARIABLE /end DAQ_EVENT
 /end IF_DATA
/end MEASUREMENT
/begin MEASUREMENT DcChrgnRly_ctMaxOperCyc "DC charge relay activation counter" ULONG OneToOne 1 100 0.00 200000.000000 FORMAT "%13.6" ECU_ADDRESS 0x60000DF4
 /begin IF_DATA XCPplus 0x0102
  /begin DAQ_EVENT VARIABLE /end DAQ_EVENT
 /end IF_DATA
/end MEASUREMENT
/begin MEASUREMENT DDRC_St.DFC_ACCmprFltLvlRes "" ULONG DFC_OneToOne 1 100 0.00 536870911.000 BIT_MASK 0x1fffffff FORMAT "%13.3" ECU_ADDRESS 0x6001C1B0 /end MEASUREMENT
/begin MEASUREMENT DDRC_St.DFC_AdpActvDChaFailr "" ULONG DFC_OneToOne 1 100 0.00 536870911.000 BIT_MASK 0x1fffffff FORMAT "%13.3" ECU_ADDRESS 0x6001C1D8 /end MEASUREMENT
/begin MEASUREMENT DDRC_St.DFC_AirbcuFlt "" ULONG DFC_OneToOne 1 100 0.00 536870911.000 BIT_MASK 0x1fffffff FORMAT "%13.3" ECU_ADDRESS 0x6001C1DC /end MEASUREMENT
/begin MEASUREMENT DDRC_St.DFC_BrkSwtFlt "" ULONG DFC_OneToOne 1 100 0.00 536870911.000 BIT_MASK 0x1fffffff FORMAT "%13.3" ECU_ADDRESS 0x6001C208 /end MEASUREMENT
/begin MEASUREMENT DDRC_St.DFC_ComBrkMai "" ULONG DFC_OneToOne 1 100 0.00 536870911.000 BIT_MASK 0x1fffffff FORMAT "%13.3" ECU_ADDRESS 0x6001C254 /end MEASUREMENT
/begin MEASUREMENT DDRC_St.DFC_ComDcdcFltLvl2 "" ULONG DFC_OneToOne 1 100 0.00 536870911.000 BIT_MASK 0x1fffffff FORMAT "%13.3" ECU_ADDRESS 0x6001C278 /end MEASUREMENT
/begin MEASUREMENT DDRC_St.DFC_ComDcdcFltLvl3 "" ULONG DFC_OneToOne 1 100 0.00 536870911.000 BIT_MASK 0x1fffffff FORMAT "%13.3" ECU_ADDRESS 0x6001C27C /end MEASUREMENT
/begin MEASUREMENT DDRC_St.DFC_ComDcdcFltLvl4 "" ULONG DFC_OneToOne 1 100 0.00 536870911.000 BIT_MASK 0x1fffffff FORMAT "%13.3" ECU_ADDRESS 0x6001C280 /end MEASUREMENT
/begin MEASUREMENT DDRC_St.DFC_ComDcdcFltLvl5 "" ULONG DFC_OneToOne 1 100 0.00 536870911.000 BIT_MASK 0x1fffffff FORMAT "%13.3" ECU_ADDRESS 0x6001C284 /end MEASUREMENT
/begin MEASUREMENT DDRC_St.DFC_ComDcdcFltLvlRes "" ULONG DFC_OneToOne 1 100 0.00 536870911.000 BIT_MASK 0x1fffffff FORMAT "%13.3" ECU_ADDRESS 0x6001C288 /end MEASUREMENT
/begin MEASUREMENT DDRC_St.DFC_ComElMIIvtrFltLvl2 "" ULONG DFC_OneToOne 1 100 0.00 536870911.000 BIT_MASK 0x1fffffff FORMAT "%13.3" ECU_ADDRESS 0x6001C29C /end MEASUREMENT
/begin MEASUREMENT DDRC_St.DFC_ComElMIIvtrFltLvl3 "" ULONG DFC_OneToOne 1 100 0.00 536870911.000 BIT_MASK 0x1fffffff FORMAT "%13.3" ECU_ADDRESS 0x6001C2A0 /end MEASUREMENT
/begin MEASUREMENT DDRC_St.DFC_ComElMIIvtrFltLvlRes "" ULONG DFC_OneToOne 1 100 0.00 536870911.000 BIT_MASK 0x1fffffff FORMAT "%13.3" ECU_ADDRESS 0x6001C2AC /end MEASUREMENT
/begin MEASUREMENT DDRC_St.DFC_ComGunCntInfoWkuReq "" ULONG DFC_OneToOne 1 100 0.00 536870911.000 BIT_MASK 0x1fffffff FORMAT "%13.3" ECU_ADDRESS 0x6001C2C8 /end MEASUREMENT
/begin MEASUREMENT DDRC_St.DFC_ComHillHldFlt "" ULONG DFC_OneToOne 1 100 0.00 536870911.000 BIT_MASK 0x1fffffff FORMAT "%13.3" ECU_ADDRESS 0x6001C2CC /end MEASUREMENT
/begin MEASUREMENT DDRC_St.DFC_ComHvBattRchrgWkuReq "" ULONG DFC_OneToOne 1 100 0.00 536870911.000 BIT_MASK 0x1fffffff FORMAT "%13.3" ECU_ADDRESS 0x6001C2D0 /end MEASUREMENT
/begin MEASUREMENT DDRC_St.DFC_ComHvbFltLvl2 "" ULONG DFC_OneToOne 1 100 0.00 536870911.000 BIT_MASK 0x1fffffff FORMAT "%13.3" ECU_ADDRESS 0x6001C2D4 /end MEASUREMENT
/begin MEASUREMENT DDRC_St.DFC_ComHvbFltLvl3 "" ULONG DFC_OneToOne 1 100 0.00 536870911.000 BIT_MASK 0x1fffffff FORMAT "%13.3" ECU_ADDRESS 0x6001C2D8 /end MEASUREMENT
/begin MEASUREMENT DDRC_St.DFC_ComHvbFltLvl4 "" ULONG DFC_OneToOne 1 100 0.00 536870911.000 BIT_MASK 0x1fffffff FORMAT "%13.3" ECU_ADDRESS 0x6001C2DC /end MEASUREMENT
/begin MEASUREMENT DDRC_St.DFC_ComHvbFltLvl5 "" ULONG DFC_OneToOne 1 100 0.00 536870911.000 BIT_MASK 0x1fffffff FORMAT "%13.3" ECU_ADDRESS 0x6001C2E0 /end MEASUREMENT
/begin MEASUREMENT DDRC_St.DFC_ComHvbFltLvlRes "" ULONG DFC_OneToOne 1 100 0.00 536870911.000 BIT_MASK 0x1fffffff FORMAT "%13.3" ECU_ADDRESS 0x6001C2E4 /end MEASUREMENT
/begin MEASUREMENT DDRC_St.DFC_ComImmoUnlockWkuReq "" ULONG DFC_OneToOne 1 100 0.00 536870911.000 BIT_MASK 0x1fffffff FORMAT "%13.3" ECU_ADDRESS 0x6001C2F0 /end MEASUREMENT
/begin MEASUREMENT DDRC_St.DFC_ComInfoReqPtlWkuReq "" ULONG DFC_OneToOne 1 100 0.00 536870911.000 BIT_MASK 0x1fffffff FORMAT "%13.3" ECU_ADDRESS 0x6001C2F4 /end MEASUREMENT
/begin MEASUREMENT DDRC_St.DFC_ComOBCFltLvl2 "" ULONG DFC_OneToOne 1 100 0.00 536870911.000 BIT_MASK 0x1fffffff FORMAT "%13.3" ECU_ADDRESS 0x6001C2F8 /end MEASUREMENT
/begin MEASUREMENT DDRC_St.DFC_ComOBCFltLvl3 "" ULONG DFC_OneToOne 1 100 0.00 536870911.000 BIT_MASK 0x1fffffff FORMAT "%13.3" ECU_ADDRESS 0x6001C2FC /end MEASUREMENT
/begin MEASUREMENT DDRC_St.DFC_ComOBCFltLvl4 "" ULONG DFC_OneToOne 1 100 0.00 536870911.000 BIT_MASK 0x1fffffff FORMAT "%13.3" ECU_ADDRESS 0x6001C300 /end MEASUREMENT
/begin MEASUREMENT DDRC_St.DFC_ComOBCFltLvl5 "" ULONG DFC_OneToOne 1 100 0.00 536870911.000 BIT_MASK 0x1fffffff FORMAT "%13.3" ECU_ADDRESS 0x6001C304 /end MEASUREMENT
/begin MEASUREMENT DDRC_St.DFC_ComOBCFltLvlRes "" ULONG DFC_OneToOne 1 100 0.00 536870911.000 BIT_MASK 0x1fffffff FORMAT "%13.3" ECU_ADDRESS 0x6001C308 /end MEASUREMENT
/begin MEASUREMENT DDRC_St.DFC_ComPostOperationWkuReq "" ULONG DFC_OneToOne 1 100 0.00 536870911.000 BIT_MASK 0x1fffffff FORMAT "%13.3" ECU_ADDRESS 0x6001C30C /end MEASUREMENT
/begin MEASUREMENT DDRC_St.DFC_ComPreCondElecWkuReq "" ULONG DFC_OneToOne 1 100 0.00 536870911.000 BIT_MASK 0x1fffffff FORMAT "%13.3" ECU_ADDRESS 0x6001C310 /end MEASUREMENT
/begin MEASUREMENT DDRC_St.DFC_ComRemUnlckWkuReq "" ULONG DFC_OneToOne 1 100 0.00 536870911.000 BIT_MASK 0x1fffffff FORMAT "%13.3" ECU_ADDRESS 0x6001C314 /end MEASUREMENT
/begin MEASUREMENT DDRC_St.DFC_ComStpDlyHMIWkuReq "" ULONG DFC_OneToOne 1 100 0.00 536870911.000 BIT_MASK 0x1fffffff FORMAT "%13.3" ECU_ADDRESS 0x6001C318 /end MEASUREMENT
/begin MEASUREMENT DDRC_St.DFC_HvbSVSBlink "" ULONG DFC_OneToOne 1 100 0.00 536870911.000 BIT_MASK 0x1fffffff FORMAT "%13.3" ECU_ADDRESS 0x6001C438 /end MEASUREMENT
/begin MEASUREMENT DDRC_St.DFC_HvbSVSCont "" ULONG DFC_OneToOne 1 100 0.00 536870911.000 BIT_MASK 0x1fffffff FORMAT "%13.3" ECU_ADDRESS 0x6001C43C /end MEASUREMENT
/begin MEASUREMENT DDRC_St.DFC_PDUProgmFailr "" ULONG DFC_OneToOne 1 100 0.00 536870911.000 BIT_MASK 0x1fffffff FORMAT "%13.3" ECU_ADDRESS 0x6001C444 /end MEASUREMENT
/begin MEASUREMENT DDRC_St.DFC_PwrMaxDchaShoLo "" ULONG DFC_OneToOne 1 100 0.00 536870911.000 BIT_MASK 0x1fffffff FORMAT "%13.3" ECU_ADDRESS 0x6001C45C /end MEASUREMENT
/begin MEASUREMENT DDRC_St.DFC_VehVCanAvl "" ULONG DFC_OneToOne 1 100 0.00 536870911.000 BIT_MASK 0x1fffffff FORMAT "%13.3" ECU_ADDRESS 0x6001C46C /end MEASUREMENT
/begin MEASUREMENT DDRC_St.DFC_VehVCanErr "" ULONG DFC_OneToOne 1 100 0.00 536870911.000 BIT_MASK 0x1fffffff FORMAT "%13.3" ECU_ADDRESS 0x6001C470 /end MEASUREMENT
/begin MEASUREMENT DDRC_St.DFC_eTogFailrLvlRes "" ULONG DFC_OneToOne 1 100 0.00 536870911.000 BIT_MASK 0x1fffffff FORMAT "%13.3" ECU_ADDRESS 0x6001C474 /end MEASUREMENT
/begin MEASUREMENT DDRC_St.DFC_flgBrkMaiDiag "" ULONG DFC_OneToOne 1 100 0.00 536870911.000 BIT_MASK 0x1fffffff FORMAT "%13.3" ECU_ADDRESS 0x6001C478 /end MEASUREMENT
/begin MEASUREMENT DDRC_St.DFC_stHvbIsoMeasmtRes "" ULONG DFC_OneToOne 1 100 0.00 536870911.000 BIT_MASK 0x1fffffff FORMAT "%13.3" ECU_ADDRESS 0x6001C47C /end MEASUREMENT
/begin MEASUREMENT DFC_st.DFC_ACCmprFltLvlRes "" UBYTE DFC_OneToOne 1 100 0.00 255.0 FORMAT "%5.1" ECU_ADDRESS 0x600349CF /end MEASUREMENT
/begin MEASUREMENT DFC_st.DFC_AdpActvDChaFailr "" UBYTE DFC_OneToOne 1 100 0.00 255.0 FORMAT "%5.1" ECU_ADDRESS 0x600349D9 /end MEASUREMENT
/begin MEASUREMENT DFC_st.DFC_AirbcuFlt "" UBYTE DFC_OneToOne 1 100 0.00 255.0 FORMAT "%5.1" ECU_ADDRESS 0x600349DA /end MEASUREMENT
/begin MEASUREMENT DFC_st.DFC_BrkSwtFlt "" UBYTE DFC_OneToOne 1 100 0.00 255.0 FORMAT "%5.1" ECU_ADDRESS 0x600349E5 /end MEASUREMENT
/begin MEASUREMENT DFC_st.DFC_ComBrkMai "" UBYTE DFC_OneToOne 1 100 0.00 255.0 FORMAT "%5.1" ECU_ADDRESS 0x600349F8 /end MEASUREMENT
/begin MEASUREMENT DFC_st.DFC_ComDcdcFltLvl2 "" UBYTE DFC_OneToOne 1 100 0.00 255.0 FORMAT "%5.1" ECU_ADDRESS 0x60034A01 /end MEASUREMENT
/begin MEASUREMENT DFC_st.DFC_ComDcdcFltLvl3 "" UBYTE DFC_OneToOne 1 100 0.00 255.0 FORMAT "%5.1" ECU_ADDRESS 0x60034A02 /end MEASUREMENT
/begin MEASUREMENT DFC_st.DFC_ComDcdcFltLvl4 "" UBYTE DFC_OneToOne 1 100 0.00 255.0 FORMAT "%5.1" ECU_ADDRESS 0x60034A03 /end MEASUREMENT
/begin MEASUREMENT DFC_st.DFC_ComDcdcFltLvl5 "" UBYTE DFC_OneToOne 1 100 0.00 255.0 FORMAT "%5.1" ECU_ADDRESS 0x60034A04 /end MEASUREMENT
/begin MEASUREMENT DFC_st.DFC_ComDcdcFltLvlRes "" UBYTE DFC_OneToOne 1 100 0.00 255.0 FORMAT "%5.1" ECU_ADDRESS 0x60034A05 /end MEASUREMENT
/begin MEASUREMENT DFC_st.DFC_ComElMIIvtrFltLvl2 "" UBYTE DFC_OneToOne 1 100 0.00 255.0 FORMAT "%5.1" ECU_ADDRESS 0x60034A0A /end MEASUREMENT
/begin MEASUREMENT DFC_st.DFC_ComElMIIvtrFltLvl3 "" UBYTE DFC_OneToOne 1 100 0.00 255.0 FORMAT "%5.1" ECU_ADDRESS 0x60034A0B /end MEASUREMENT
/begin MEASUREMENT DFC_st.DFC_ComElMIIvtrFltLvlRes "" UBYTE DFC_OneToOne 1 100 0.00 255.0 FORMAT "%5.1" ECU_ADDRESS 0x60034A0E /end MEASUREMENT
/begin MEASUREMENT DFC_st.DFC_ComGunCntInfoWkuReq "" UBYTE DFC_OneToOne 1 100 0.00 255.0 FORMAT "%5.1" ECU_ADDRESS 0x60034A15 /end MEASUREMENT
/begin MEASUREMENT DFC_st.DFC_ComHillHldFlt "" UBYTE DFC_OneToOne 1 100 0.00 255.0 FORMAT "%5.1" ECU_ADDRESS 0x60034A16 /end MEASUREMENT
/begin MEASUREMENT DFC_st.DFC_ComHvBattRchrgWkuReq "" UBYTE DFC_OneToOne 1 100 0.00 255.0 FORMAT "%5.1" ECU_ADDRESS 0x60034A17 /end MEASUREMENT
/begin MEASUREMENT DFC_st.DFC_ComHvbFltLvl2 "" UBYTE DFC_OneToOne 1 100 0.00 255.0 FORMAT "%5.1" ECU_ADDRESS 0x60034A18 /end MEASUREMENT
/begin MEASUREMENT DFC_st.DFC_ComHvbFltLvl3 "" UBYTE DFC_OneToOne 1 100 0.00 255.0 FORMAT "%5.1" ECU_ADDRESS 0x60034A19 /end MEASUREMENT
/begin MEASUREMENT DFC_st.DFC_ComHvbFltLvl4 "" UBYTE DFC_OneToOne 1 100 0.00 255.0 FORMAT "%5.1" ECU_ADDRESS 0x60034A1A /end MEASUREMENT
/begin MEASUREMENT DFC_st.DFC_ComHvbFltLvl5 "" UBYTE DFC_OneToOne 1 100 0.00 255.0 FORMAT "%5.1" ECU_ADDRESS 0x60034A1B /end MEASUREMENT
/begin MEASUREMENT DFC_st.DFC_ComHvbFltLvlRes "" UBYTE DFC_OneToOne 1 100 0.00 255.0 FORMAT "%5.1" ECU_ADDRESS 0x60034A1C /end MEASUREMENT
/begin MEASUREMENT DFC_st.DFC_ComImmoUnlockWkuReq "" UBYTE DFC_OneToOne 1 100 0.00 255.0 FORMAT "%5.1" ECU_ADDRESS 0x60034A1F /end MEASUREMENT
/begin MEASUREMENT DFC_st.DFC_ComInfoReqPtlWkuReq "" UBYTE DFC_OneToOne 1 100 0.00 255.0 FORMAT "%5.1" ECU_ADDRESS 0x60034A20 /end MEASUREMENT
/begin MEASUREMENT DFC_st.DFC_ComOBCFltLvl2 "" UBYTE DFC_OneToOne 1 100 0.00 255.0 FORMAT "%5.1" ECU_ADDRESS 0x60034A21 /end MEASUREMENT
/begin MEASUREMENT DFC_st.DFC_ComOBCFltLvl3 "" UBYTE DFC_OneToOne 1 100 0.00 255.0 FORMAT "%5.1" ECU_ADDRESS 0x60034A22 /end MEASUREMENT
/begin MEASUREMENT DFC_st.DFC_ComOBCFltLvl4 "" UBYTE DFC_OneToOne 1 100 0.00 255.0 FORMAT "%5.1" ECU_ADDRESS 0x60034A23 /end MEASUREMENT
/begin MEASUREMENT DFC_st.DFC_ComOBCFltLvl5 "" UBYTE DFC_OneToOne 1 100 0.00 255.0 FORMAT "%5.1" ECU_ADDRESS 0x60034A24 /end MEASUREMENT
/begin MEASUREMENT DFC_st.DFC_ComOBCFltLvlRes "" UBYTE DFC_OneToOne 1 100 0.00 255.0 FORMAT "%5.1" ECU_ADDRESS 0x60034A25 /end MEASUREMENT
/begin MEASUREMENT DFC_st.DFC_ComPostOperationWkuReq "" UBYTE DFC_OneToOne 1 100 0.00 255.0 FORMAT "%5.1" ECU_ADDRESS 0x60034A26 /end MEASUREMENT
/begin MEASUREMENT DFC_st.DFC_ComPreCondElecWkuReq "" UBYTE DFC_OneToOne 1 100 0.00 255.0 FORMAT "%5.1" ECU_ADDRESS 0x60034A27 /end MEASUREMENT
/begin MEASUREMENT DFC_st.DFC_ComRemUnlckWkuReq "" UBYTE DFC_OneToOne 1 100 0.00 255.0 FORMAT "%5.1" ECU_ADDRESS 0x60034A28 /end MEASUREMENT
/begin MEASUREMENT DFC_st.DFC_ComStpDlyHMIWkuReq "" UBYTE DFC_OneToOne 1 100 0.00 255.0 FORMAT "%5.1" ECU_ADDRESS 0x60034A29 /end MEASUREMENT
/begin MEASUREMENT DFC_st.DFC_HvbSVSBlink "" UBYTE DFC_OneToOne 1 100 0.00 255.0 FORMAT "%5.1" ECU_ADDRESS 0x60034A71 /end MEASUREMENT
/begin MEASUREMENT DFC_st.DFC_HvbSVSCont "" UBYTE DFC_OneToOne 1 100 0.00 255.0 FORMAT "%5.1" ECU_ADDRESS 0x60034A72 /end MEASUREMENT
/begin MEASUREMENT DFC_st.DFC_PDUProgmFailr "" UBYTE DFC_OneToOne 1 100 0.00 255.0 FORMAT "%5.1" ECU_ADDRESS 0x60034A74 /end MEASUREMENT
/begin MEASUREMENT DFC_st.DFC_PwrMaxDchaShoLo "" UBYTE DFC_OneToOne 1 100 0.00 255.0 FORMAT "%5.1" ECU_ADDRESS 0x60034A7A /end MEASUREMENT
/begin MEASUREMENT DFC_st.DFC_VehVCanAvl "" UBYTE DFC_OneToOne 1 100 0.00 255.0 FORMAT "%5.1" ECU_ADDRESS 0x60034A7E /end MEASUREMENT
/begin MEASUREMENT DFC_st.DFC_VehVCanErr "" UBYTE DFC_OneToOne 1 100 0.00 255.0 FORMAT "%5.1" ECU_ADDRESS 0x60034A7F /end MEASUREMENT
/begin MEASUREMENT DFC_st.DFC_eTogFailrLvlRes "" UBYTE DFC_OneToOne 1 100 0.00 255.0 FORMAT "%5.1" ECU_ADDRESS 0x60034A80 /end MEASUREMENT
/begin MEASUREMENT DFC_st.DFC_flgBrkMaiDiag "" UBYTE DFC_OneToOne 1 100 0.00 255.0 FORMAT "%5.1" ECU_ADDRESS 0x60034A81 /end MEASUREMENT
/begin MEASUREMENT DFC_st.DFC_stHvbIsoMeasmtRes "" UBYTE DFC_OneToOne 1 100 0.00 255.0 FORMAT "%5.1" ECU_ADDRESS 0x60034A82 /end MEASUREMENT
/begin MEASUREMENT DFC_st.DFC_ResetRcvNotAllwd "" UBYTE DFC_OneToOne 1 100 0.00 255.0 FORMAT "%5.1" ECU_ADDRESS 0x60034C81 /end MEASUREMENT
/begin MEASUREMENT DFC_st.DFC_TelltlCooltPlaus "" UBYTE DFC_OneToOne 1 100 0.00 255.0 FORMAT "%5.1" ECU_ADDRESS 0x60034C82 /end MEASUREMENT
/begin MEASUREMENT DINH_nrActvInhReas.FId_ChrgnLmpChrgnFlt "" UWORD DINH_ct_Compu 1 100 -4095.000 4096.000 BIT_MASK 0x1fff FORMAT "%8.3" ECU_ADDRESS 0x600213AE /end MEASUREMENT
/begin MEASUREMENT DINH_nrActvInhReas.FId_ChrgnLmpNoChrgn "" UWORD DINH_ct_Compu 1 100 -4095.000 4096.000 BIT_MASK 0x1fff FORMAT "%8.3" ECU_ADDRESS 0x600213B0 /end MEASUREMENT
/begin MEASUREMENT DINH_nrActvInhReas.FId_ComHillHldFrmErr "" UWORD DINH_ct_Compu 1 100 -4095.000 4096.000 BIT_MASK 0x1fff FORMAT "%8.3" ECU_ADDRESS 0x600213DC /end MEASUREMENT
/begin MEASUREMENT DINH_nrActvInhReas.FId_Com_stMainWkuInvld "" UWORD DINH_ct_Compu 1 100 -4095.000 4096.000 BIT_MASK 0x1fff FORMAT "%8.3" ECU_ADDRESS 0x600213DE /end MEASUREMENT
/begin MEASUREMENT DINH_nrActvInhReas.FId_TelltlCooltTErr "" UWORD DINH_ct_Compu 1 100 -4095.000 4096.000 BIT_MASK 0x1fff FORMAT "%8.3" ECU_ADDRESS 0x60021564 /end MEASUREMENT
/begin MEASUREMENT DINH_nrActvInhReas.FId_TelltlCooltTMon "" UWORD DINH_ct_Compu 1 100 -4095.000 4096.000 BIT_MASK 0x1fff FORMAT "%8.3" ECU_ADDRESS 0x60021566 /end MEASUREMENT
/begin MEASUREMENT DINH_nrActvInhReas.FId_ThermHvacPreCdngFlt "" UWORD DINH_ct_Compu 1 100 -4095.000 4096.000 BIT_MASK 0x1fff FORMAT "%8.3" ECU_ADDRESS 0x60021568 /end MEASUREMENT
/begin MEASUREMENT DINH_nrActvInhReas.FId_bInh_ComChrgn_iDcRly_Sq_Frz "" UWORD DINH_ct_Compu 1 100 -4095.000 4096.000 BIT_MASK 0x1fff FORMAT "%8.3" ECU_ADDRESS 0x60021824 /end MEASUREMENT
/begin MEASUREMENT DINH_nrActvInhReas.FId_bInh_ComChrgn_uDcRly_Sq_Frz "" UWORD DINH_ct_Compu 1 100 -4095.000 4096.000 BIT_MASK 0x1fff FORMAT "%8.3" ECU_ADDRESS 0x60021826 /end MEASUREMENT
/begin MEASUREMENT DINH_nrActvInhReas.FId_bInh_ComChrgr_flgChrgrErr_Sq_Frz "" UWORD DINH_ct_Compu 1 100 -4095.000 4096.000 BIT_MASK 0x1fff FORMAT "%8.3" ECU_ADDRESS 0x60021828 /end MEASUREMENT
/begin MEASUREMENT DINH_nrActvInhReas.FId_bInh_ComChrgr_iAcMax_Sq_Frz "" UWORD DINH_ct_Compu 1 100 -4095.000 4096.000 BIT_MASK 0x1fff FORMAT "%8.3" ECU_ADDRESS 0x6002182A /end MEASUREMENT
/begin MEASUREMENT DINH_nrActvInhReas.FId_bInh_ComChrgr_iDcHvAct_Sq_Frz "" UWORD DINH_ct_Compu 1 100 -4095.000 4096.000 BIT_MASK 0x1fff FORMAT "%8.3" ECU_ADDRESS 0x6002182C /end MEASUREMENT
/begin MEASUREMENT DINH_nrActvInhReas.FId_bInh_ComChrgr_pwrInAct_Sq_Frz "" UWORD DINH_ct_Compu 1 100 -4095.000 4096.000 BIT_MASK 0x1fff FORMAT "%8.3" ECU_ADDRESS 0x6002182E /end MEASUREMENT
/begin MEASUREMENT DINH_nrActvInhReas.FId_bInh_ComChrgr_stChrgr_Sq_Frz "" UWORD DINH_ct_Compu 1 100 -4095.000 4096.000 BIT_MASK 0x1fff FORMAT "%8.3" ECU_ADDRESS 0x60021832 /end MEASUREMENT
/begin MEASUREMENT DINH_nrActvInhReas.FId_bInh_ComChrgr_tChrgrMaxAct_Sq_Frz "" UWORD DINH_ct_Compu 1 100 -4095.000 4096.000 BIT_MASK 0x1fff FORMAT "%8.3" ECU_ADDRESS 0x60021834 /end MEASUREMENT
/begin MEASUREMENT DINH_nrActvInhReas.FId_bInh_ComChrgr_uAcActL1_Sq_Frz "" UWORD DINH_ct_Compu 1 100 -4095.000 4096.000 BIT_MASK 0x1fff FORMAT "%8.3" ECU_ADDRESS 0x60021836 /end MEASUREMENT
/begin MEASUREMENT DINH_nrActvInhReas.FId_bInh_ComChrgr_uDcHvAct_Sq_Frz "" UWORD DINH_ct_Compu 1 100 -4095.000 4096.000 BIT_MASK 0x1fff FORMAT "%8.3" ECU_ADDRESS 0x60021838 /end MEASUREMENT
/begin MEASUREMENT DINH_nrActvInhReas.FId_bInh_Com_iDcdcHvActRvsn1_Sq_Frz "" UWORD DINH_ct_Compu 1 100 -4095.000 4096.000 BIT_MASK 0x1fff FORMAT "%8.3" ECU_ADDRESS 0x60021866 /end MEASUREMENT
/begin MEASUREMENT DINH_nrActvInhReas.FId_bInh_Com_iDcdcLvActRvsn1_Sq_Frz "" UWORD DINH_ct_Compu 1 100 -4095.000 4096.000 BIT_MASK 0x1fff FORMAT "%8.3" ECU_ADDRESS 0x60021868 /end MEASUREMENT
/begin MEASUREMENT DINH_nrActvInhReas.FId_bInh_Com_ratHvbSoh_Sq_Frz "" UWORD DINH_ct_Compu 1 100 -4095.000 4096.000 BIT_MASK 0x1fff FORMAT "%8.3" ECU_ADDRESS 0x60021882 /end MEASUREMENT
/begin MEASUREMENT DINH_nrActvInhReas.FId_bInh_Com_stDcdcOperModAct_Sq_Frz "" UWORD DINH_ct_Compu 1 100 -4095.000 4096.000 BIT_MASK 0x1fff FORMAT "%8.3" ECU_ADDRESS 0x60021896 /end MEASUREMENT
/begin MEASUREMENT DINH_nrActvInhReas.FId_bInh_Com_tDcdcAct_Sq_Frz "" UWORD DINH_ct_Compu 1 100 -4095.000 4096.000 BIT_MASK 0x1fff FORMAT "%8.3" ECU_ADDRESS 0x600218B4 /end MEASUREMENT
/begin MEASUREMENT DINH_nrActvInhReas.FId_bInh_Com_tDcdcInltCoolt_Sq "" UWORD DINH_ct_Compu 1 100 -4095.000 4096.000 BIT_MASK 0x1fff FORMAT "%8.3" ECU_ADDRESS 0x600218B6 /end MEASUREMENT
/begin MEASUREMENT DINH_nrActvInhReas.FId_bInh_Com_uDcdcHvAct_Sq_Frz "" UWORD DINH_ct_Compu 1 100 -4095.000 4096.000 BIT_MASK 0x1fff FORMAT "%8.3" ECU_ADDRESS 0x600218BA /end MEASUREMENT
/begin MEASUREMENT DINH_nrActvInhReas.FId_bInh_Com_uDcdcLvAct_Sq_Frz "" UWORD DINH_ct_Compu 1 100 -4095.000 4096.000 BIT_MASK 0x1fff FORMAT "%8.3" ECU_ADDRESS 0x600218BC /end MEASUREMENT
/begin MEASUREMENT DINH_nrActvInhReas.FId_bInh_Pdu_Com_pwrMaxChrgSho_Sq_Frz "" UWORD DINH_ct_Compu 1 100 -4095.000 4096.000 BIT_MASK 0x1fff FORMAT "%8.3" ECU_ADDRESS 0x600218F2 /end MEASUREMENT
/begin MEASUREMENT DINH_nrActvInhReas.FId_bInh_Pdu_Com_pwrMaxDchaSho_Sq_Frz "" UWORD DINH_ct_Compu 1 100 -4095.000 4096.000 BIT_MASK 0x1fff FORMAT "%8.3" ECU_ADDRESS 0x600218F4 /end MEASUREMENT
/begin MEASUREMENT DINH_nrActvInhReas.FId_bInh_Pdu_VCU_AIRBAG_fault_Frz "" UWORD DINH_ct_Compu 1 100 -4095.000 4096.000 BIT_MASK 0x1fff FORMAT "%8.3" ECU_ADDRESS 0x6002199A /end MEASUREMENT
/begin MEASUREMENT DINH_nrActvInhReas.FId_bInh_Sig_ComEmac_flgImobAuthent_Sq_Frz "" UWORD DINH_ct_Compu 1 100 -4095.000 4096.000 BIT_MASK 0x1fff FORMAT "%8.3" ECU_ADDRESS 0x60021B6E /end MEASUREMENT
/begin MEASUREMENT DINH_nrActvInhReas.FId_bInh_Sig_ComEmac_stIsoMonSwtAck_Sq_Frz "" UWORD DINH_ct_Compu 1 100 -4095.000 4096.000 BIT_MASK 0x1fff FORMAT "%8.3" ECU_ADDRESS 0x60021B70 /end MEASUREMENT
/begin MEASUREMENT DINH_nrActvInhReas.FId_bInh_Sig_ComEmac_stPwrAuthn_Sq_Frz "" UWORD DINH_ct_Compu 1 100 -4095.000 4096.000 BIT_MASK 0x1fff FORMAT "%8.3" ECU_ADDRESS 0x60021B72 /end MEASUREMENT
/begin MEASUREMENT DINH_nrActvInhReas.FId_bInh_Sig_Com_stDcdcULimReq_Sq_Frz "" UWORD DINH_ct_Compu 1 100 -4095.000 4096.000 BIT_MASK 0x1fff FORMAT "%8.3" ECU_ADDRESS 0x60021B7A /end MEASUREMENT
/begin MEASUREMENT DINH_nrActvInhReas.FId_bInh_Sig_Com_stIgnkeyPos_Sq_Frz "" UWORD DINH_ct_Compu 1 100 -4095.000 4096.000 BIT_MASK 0x1fff FORMAT "%8.3" ECU_ADDRESS 0x60021B7E /end MEASUREMENT
/begin MEASUREMENT DINH_nrActvInhReas.FId_binnh_Sig_Com_egyHvbAvl_Sq_Frz "" UWORD DINH_ct_Compu 1 100 -4095.000 4096.000 BIT_MASK 0x1fff FORMAT "%8.3" ECU_ADDRESS 0x60021BAC /end MEASUREMENT
/begin MEASUREMENT DINH_stFId.FId_ChrgnLmpChrgnFlt "" UWORD DFC_OneToOne 1 100 0.00 65535.00 FORMAT "%8.2" ECU_ADDRESS 0x600213AE /end MEASUREMENT
/begin MEASUREMENT DINH_stFId.FId_ChrgnLmpNoChrgn "" UWORD DFC_OneToOne 1 100 0.00 65535.00 FORMAT "%8.2" ECU_ADDRESS 0x600213B0 /end MEASUREMENT
/begin MEASUREMENT DINH_stFId.FId_ComHillHldFrmErr "" UWORD DFC_OneToOne 1 100 0.00 65535.00 FORMAT "%8.2" ECU_ADDRESS 0x600213DC /end MEASUREMENT
/begin MEASUREMENT DINH_stFId.FId_Com_stMainWkuInvld "" UWORD DFC_OneToOne 1 100 0.00 65535.00 FORMAT "%8.2" ECU_ADDRESS 0x600213DE /end MEASUREMENT
/begin MEASUREMENT DINH_stFId.FId_TelltlCooltTErr "" UWORD DFC_OneToOne 1 100 0.00 65535.00 FORMAT "%8.2" ECU_ADDRESS 0x60021564 /end MEASUREMENT
/begin MEASUREMENT DINH_stFId.FId_TelltlCooltTMon "" UWORD DFC_OneToOne 1 100 0.00 65535.00 FORMAT "%8.2" ECU_ADDRESS 0x60021566 /end MEASUREMENT
/begin MEASUREMENT DINH_stFId.FId_ThermHvacPreCdngFlt "" UWORD DFC_OneToOne 1 100 0.00 65535.00 FORMAT "%8.2" ECU_ADDRESS 0x60021568 /end MEASUREMENT
/begin MEASUREMENT DINH_stFId.FId_bInh_ComChrgn_iDcRly_Sq_Frz "" UWORD DFC_OneToOne 1 100 0.00 65535.00 FORMAT "%8.2" ECU_ADDRESS 0x60021824 /end MEASUREMENT
/begin MEASUREMENT DINH_stFId.FId_bInh_ComChrgn_uDcRly_Sq_Frz "" UWORD DFC_OneToOne 1 100 0.00 65535.00 FORMAT "%8.2" ECU_ADDRESS 0x60021826 /end MEASUREMENT
/begin MEASUREMENT DINH_stFId.FId_bInh_ComChrgr_flgChrgrErr_Sq_Frz "" UWORD DFC_OneToOne 1 100 0.00 65535.00 FORMAT "%8.2" ECU_ADDRESS 0x60021828 /end MEASUREMENT
/begin MEASUREMENT DINH_stFId.FId_bInh_ComChrgr_iAcMax_Sq_Frz "" UWORD DFC_OneToOne 1 100 0.00 65535.00 FORMAT "%8.2" ECU_ADDRESS 0x6002182A /end MEASUREMENT
/begin MEASUREMENT DINH_stFId.FId_bInh_ComChrgr_iDcHvAct_Sq_Frz "" UWORD DFC_OneToOne 1 100 0.00 65535.00 FORMAT "%8.2" ECU_ADDRESS 0x6002182C /end MEASUREMENT
/begin MEASUREMENT DINH_stFId.FId_bInh_ComChrgr_pwrInAct_Sq_Frz "" UWORD DFC_OneToOne 1 100 0.00 65535.00 FORMAT "%8.2" ECU_ADDRESS 0x6002182E /end MEASUREMENT
/begin MEASUREMENT DINH_stFId.FId_bInh_ComChrgr_stChrgr_Sq_Frz "" UWORD DFC_OneToOne 1 100 0.00 65535.00 FORMAT "%8.2" ECU_ADDRESS 0x60021832 /end MEASUREMENT
/begin MEASUREMENT DINH_stFId.FId_bInh_ComChrgr_tChrgrMaxAct_Sq_Frz "" UWORD DFC_OneToOne 1 100 0.00 65535.00 FORMAT "%8.2" ECU_ADDRESS 0x60021834 /end MEASUREMENT
/begin MEASUREMENT DINH_stFId.FId_bInh_ComChrgr_uAcActL1_Sq_Frz "" UWORD DFC_OneToOne 1 100 0.00 65535.00 FORMAT "%8.2" ECU_ADDRESS 0x60021836 /end MEASUREMENT
/begin MEASUREMENT DINH_stFId.FId_bInh_ComChrgr_uDcHvAct_Sq_Frz "" UWORD DFC_OneToOne 1 100 0.00 65535.00 FORMAT "%8.2" ECU_ADDRESS 0x60021838 /end MEASUREMENT
/begin MEASUREMENT DINH_stFId.FId_bInh_Com_iDcdcHvActRvsn1_Sq_Frz "" UWORD DFC_OneToOne 1 100 0.00 65535.00 FORMAT "%8.2" ECU_ADDRESS 0x60021866 /end MEASUREMENT
/begin MEASUREMENT DINH_stFId.FId_bInh_Com_iDcdcLvActRvsn1_Sq_Frz "" UWORD DFC_OneToOne 1 100 0.00 65535.00 FORMAT "%8.2" ECU_ADDRESS 0x60021868 /end MEASUREMENT
/begin MEASUREMENT DINH_stFId.FId_bInh_Com_ratHvbSoh_Sq_Frz "" UWORD DFC_OneToOne 1 100 0.00 65535.00 FORMAT "%8.2" ECU_ADDRESS 0x60021882 /end MEASUREMENT
/begin MEASUREMENT DINH_stFId.FId_bInh_Com_stDcdcOperModAct_Sq_Frz "" UWORD DFC_OneToOne 1 100 0.00 65535.00 FORMAT "%8.2" ECU_ADDRESS 0x60021896 /end MEASUREMENT
/begin MEASUREMENT DINH_stFId.FId_bInh_Com_tDcdcAct_Sq_Frz "" UWORD DFC_OneToOne 1 100 0.00 65535.00 FORMAT "%8.2" ECU_ADDRESS 0x600218B4 /end MEASUREMENT
/begin MEASUREMENT DINH_stFId.FId_bInh_Com_tDcdcInltCoolt_Sq "" UWORD DFC_OneToOne 1 100 0.00 65535.00 FORMAT "%8.2" ECU_ADDRESS 0x600218B6 /end MEASUREMENT
/begin MEASUREMENT DINH_stFId.FId_bInh_Com_uDcdcHvAct_Sq_Frz "" UWORD DFC_OneToOne 1 100 0.00 65535.00 FORMAT "%8.2" ECU_ADDRESS 0x600218BA /end MEASUREMENT
/begin MEASUREMENT DINH_stFId.FId_bInh_Com_uDcdcLvAct_Sq_Frz "" UWORD DFC_OneToOne 1 100 0.00 65535.00 FORMAT "%8.2" ECU_ADDRESS 0x600218BC /end MEASUREMENT
/begin MEASUREMENT DINH_stFId.FId_bInh_Pdu_Com_pwrMaxChrgSho_Sq_Frz "" UWORD DFC_OneToOne 1 100 0.00 65535.00 FORMAT "%8.2" ECU_ADDRESS 0x600218F2 /end MEASUREMENT
/begin MEASUREMENT DINH_stFId.FId_bInh_Pdu_Com_pwrMaxDchaSho_Sq_Frz "" UWORD DFC_OneToOne 1 100 0.00 65535.00 FORMAT "%8.2" ECU_ADDRESS 0x600218F4 /end MEASUREMENT
/begin MEASUREMENT DINH_stFId.FId_bInh_Pdu_VCU_AIRBAG_fault_Frz "" UWORD DFC_OneToOne 1 100 0.00 65535.00 FORMAT "%8.2" ECU_ADDRESS 0x6002199A /end MEASUREMENT
/begin MEASUREMENT DINH_stFId.FId_bInh_Sig_ComEmac_flgImobAuthent_Sq_Frz "" UWORD DFC_OneToOne 1 100 0.00 65535.00 FORMAT "%8.2" ECU_ADDRESS 0x60021B6E /end MEASUREMENT
/begin MEASUREMENT DINH_stFId.FId_bInh_Sig_ComEmac_stIsoMonSwtAck_Sq_Frz "" UWORD DFC_OneToOne 1 100 0.00 65535.00 FORMAT "%8.2" ECU_ADDRESS 0x60021B70 /end MEASUREMENT
/begin MEASUREMENT DINH_stFId.FId_bInh_Sig_ComEmac_stPwrAuthn_Sq_Frz "" UWORD DFC_OneToOne 1 100 0.00 65535.00 FORMAT "%8.2" ECU_ADDRESS 0x60021B72 /end MEASUREMENT
/begin MEASUREMENT DINH_stFId.FId_bInh_Sig_Com_stDcdcULimReq_Sq_Frz "" UWORD DFC_OneToOne 1 100 0.00 65535.00 FORMAT "%8.2" ECU_ADDRESS 0x60021B7A /end MEASUREMENT
/begin MEASUREMENT DINH_stFId.FId_bInh_Sig_Com_stIgnkeyPos_Sq_Frz "" UWORD DFC_OneToOne 1 100 0.00 65535.00 FORMAT "%8.2" ECU_ADDRESS 0x60021B7E /end MEASUREMENT
/begin MEASUREMENT DINH_stFId.FId_binnh_Sig_Com_egyHvbAvl_Sq_Frz "" UWORD DFC_OneToOne 1 100 0.00 65535.00 FORMAT "%8.2" ECU_ADDRESS 0x60021BAC /end MEASUREMENT
/begin MEASUREMENT DSQ_st.DSQ_T15TurnOfDly "" UBYTE DFC_OneToOne 1 100 0.00 255.0 FORMAT "%5.1" ECU_ADDRESS 0x60024665 /end MEASUREMENT
/begin MEASUREMENT HvacPtc_stElHeatr "Definition for HvacPtc_stElHeatr" UBYTE OneToOne 1 100 0.00 255.0 FORMAT "%5.1" ECU_ADDRESS 0x60023446
 /begin IF_DATA XCPplus 0x0102
  /begin DAQ_EVENT VARIABLE /end DAQ_EVENT
 /end IF_DATA
/end MEASUREMENT
/begin MEASUREMENT Reset_flgECURstOcc "Monitoring the CAN bus for Busoff errors" UBYTE B_TRUE 1 100 0.00 1.00000000000 BIT_MASK 0x1 FORMAT "%13.11" ECU_ADDRESS 0x6002348F
 /begin IF_DATA XCPplus 0x0102
  /begin DAQ_EVENT VARIABLE /end DAQ_EVENT
 /end IF_DATA
/end MEASUREMENT
/begin MEASUREMENT StabyIntv_flgAbsIntv01 "Flag to inhibit regenration" UBYTE B_TRUE 1 100 0.00 1.00000000000 BIT_MASK 0x1 FORMAT "%13.11" ECU_ADDRESS 0x60023489
 /begin IF_DATA XCPplus 0x0102
  /begin DAQ_EVENT VARIABLE /end DAQ_EVENT
 /end IF_DATA
/end MEASUREMENT
/begin MEASUREMENT SWAdp_bCANComNdLoc "Local used in the calculation of Com_bCAN1ComNd" SLONG Time_Dt 1 100 -2147.48364800 2147.48364700 FORMAT "%13.8" ECU_ADDRESS 0x600005F4
 /begin IF_DATA XCPplus 0x0102
  /begin DAQ_EVENT VARIABLE /end DAQ_EVENT
 /end IF_DATA
/end MEASUREMENT
/begin MEASUREMENT SWAdp_bLINComNdLoc "Local used in the calculation of Local used in the calculation of Com_bLINComNd." SLONG Time_Dt 1 100 -2147.48364800 2147.48364700 FORMAT "%13.8" ECU_ADDRESS 0x600005F0
 /begin IF_DATA XCPplus 0x0102
  /begin DAQ_EVENT VARIABLE /end DAQ_EVENT
 /end IF_DATA
/end MEASUREMENT
/begin MEASUREMENT SWAdp_BrkSwtFltLoc "local used in the calculation of SWAdp_BrkSwtFlt" UBYTE B_TRUE 1 100 0.00 1.00000000000 BIT_MASK 0x1 FORMAT "%13.11" ECU_ADDRESS 0x60022FC5
 /begin IF_DATA XCPplus 0x0102
  /begin DAQ_EVENT VARIABLE /end DAQ_EVENT
 /end IF_DATA
/end MEASUREMENT
/begin MEASUREMENT SWAdp_ComChrgr_pwrInAct_Loc "" UBYTE B_TRUE 1 100 0.00 1.00000000000 BIT_MASK 0x1 FORMAT "%13.11" ECU_ADDRESS 0x60022F96
 /begin IF_DATA XCPplus 0x0102
  /begin DAQ_EVENT VARIABLE /end DAQ_EVENT
 /end IF_DATA
/end MEASUREMENT
/begin MEASUREMENT SWAdp_ComDcdcFltLvl2Loc "local for calculating DFC_ComDcdcFltLvl2" UBYTE B_TRUE 1 100 0.00 1.00000000000 BIT_MASK 0x1 FORMAT "%13.11" ECU_ADDRESS 0x60022FC4
 /begin IF_DATA XCPplus 0x0102
  /begin DAQ_EVENT VARIABLE /end DAQ_EVENT
 /end IF_DATA
/end MEASUREMENT
/begin MEASUREMENT SWAdp_ComDcdcFltLvl3Loc "local for calculating ComDcdcFltLvl3" UBYTE B_TRUE 1 100 0.00 1.00000000000 BIT_MASK 0x1 FORMAT "%13.11" ECU_ADDRESS 0x60022FC3
 /begin IF_DATA XCPplus 0x0102
  /begin DAQ_EVENT VARIABLE /end DAQ_EVENT
 /end IF_DATA
/end MEASUREMENT
/begin MEASUREMENT SWAdp_ComElMIIvtrFltLvl2Loc "local for calculating ComElMIIvtrFltLvl2" UBYTE B_TRUE 1 100 0.00 1.00000000000 BIT_MASK 0x1 FORMAT "%13.11" ECU_ADDRESS 0x60022FC2
 /begin IF_DATA XCPplus 0x0102
  /begin DAQ_EVENT VARIABLE /end DAQ_EVENT
 /end IF_DATA
/end MEASUREMENT
/begin MEASUREMENT SWAdp_ComElMIIvtrFltLvl3Loc "local for calculating ComElMIIvtrFltLvl3" UBYTE B_TRUE 1 100 0.00 1.00000000000 BIT_MASK 0x1 FORMAT "%13.11" ECU_ADDRESS 0x60022FC1
 /begin IF_DATA XCPplus 0x0102
  /begin DAQ_EVENT VARIABLE /end DAQ_EVENT
 /end IF_DATA
/end MEASUREMENT
/begin MEASUREMENT SWAdp_ComHvbFltLvl2Loc "local for calculating ComHvbFltLvl2" UBYTE B_TRUE 1 100 0.00 1.00000000000 BIT_MASK 0x1 FORMAT "%13.11" ECU_ADDRESS 0x60022FC0
 /begin IF_DATA XCPplus 0x0102
  /begin DAQ_EVENT VARIABLE /end DAQ_EVENT
 /end IF_DATA
/end MEASUREMENT
/begin MEASUREMENT SWAdp_Com_stHvbMod_SqLoc "" UBYTE SigQly_COMPU_VERB 1 100 0.00 15.0000000000 FORMAT "%13.10" ECU_ADDRESS 0x60022FBF
 /begin IF_DATA XCPplus 0x0102
  /begin DAQ_EVENT VARIABLE /end DAQ_EVENT
 /end IF_DATA
/end MEASUREMENT
/begin MEASUREMENT swadp_ebslvbattsocdiagloLoc "Local variable to check the status of DFC_EbsLvBattSocDiagLo" UBYTE B_TRUE 1 100 0.00 1.00000000000 BIT_MASK 0x1 FORMAT "%13.11" ECU_ADDRESS 0x60022FBE
 /begin IF_DATA XCPplus 0x0102
  /begin DAQ_EVENT VARIABLE /end DAQ_EVENT
 /end IF_DATA
/end MEASUREMENT
/begin MEASUREMENT swadp_eeprambuffer "buffer holding the value of BattId_numOrganNature1" UBYTE OneToOne 1 100 0.00 255.0 FORMAT "%5.1" ECU_ADDRESS 0x60022FBD /end MEASUREMENT
/begin MEASUREMENT swadp_eeprambuffer1 "buffer holding the value of BattId_numOrganNature2" UBYTE OneToOne 1 100 0.00 255.0 FORMAT "%5.1" ECU_ADDRESS 0x60022FBC /end MEASUREMENT
/begin MEASUREMENT swadp_eeprambuffer10 "buffer holding the value of BattId_numSerl5" UBYTE OneToOne 1 100 0.00 255.0 FORMAT "%5.1" ECU_ADDRESS 0x60022FBB /end MEASUREMENT
/begin MEASUREMENT swadp_eeprambuffer11 "buffer holding the value of BattId_numSerl6" UBYTE OneToOne 1 100 0.00 255.0 FORMAT "%5.1" ECU_ADDRESS 0x60022FBA /end MEASUREMENT
/begin MEASUREMENT swadp_eeprambuffer12 "buffer holding the value of BattId_numSerl7" UBYTE OneToOne 1 100 0.00 255.0 FORMAT "%5.1" ECU_ADDRESS 0x60022FB9 /end MEASUREMENT
/begin MEASUREMENT swadp_eeprambuffer2 "buffer holding the value of BattId_numOrganRef1" UBYTE OneToOne 1 100 0.00 255.0 FORMAT "%5.1" ECU_ADDRESS 0x60022FB8 /end MEASUREMENT
/begin MEASUREMENT swadp_eeprambuffer3 "buffer holding the value of BattId_numOrganRef2" UBYTE OneToOne 1 100 0.00 255.0 FORMAT "%5.1" ECU_ADDRESS 0x60022FB7 /end MEASUREMENT
/begin MEASUREMENT swadp_eeprambuffer4 "buffer holding the value of BattId_numOrganRef3" UBYTE OneToOne 1 100 0.00 255.0 FORMAT "%5.1" ECU_ADDRESS 0x60022FB6 /end MEASUREMENT
/begin MEASUREMENT swadp_eeprambuffer5 "buffer holding the value of BattId_numOrganRef4" UBYTE OneToOne 1 100 0.00 255.0 FORMAT "%5.1" ECU_ADDRESS 0x60022FB5 /end MEASUREMENT
/begin MEASUREMENT swadp_eeprambuffer6 "buffer holding the value of BattId_numSerl1" UBYTE OneToOne 1 100 0.00 255.0 FORMAT "%5.1" ECU_ADDRESS 0x60022FB4 /end MEASUREMENT
/begin MEASUREMENT swadp_eeprambuffer7 "buffer holding the value of BattId_numSerl2" UBYTE OneToOne 1 100 0.00 255.0 FORMAT "%5.1" ECU_ADDRESS 0x60022FB3 /end MEASUREMENT
/begin MEASUREMENT swadp_eeprambuffer8 "buffer holding the value of BattId_numSerl3" UBYTE OneToOne 1 100 0.00 255.0 FORMAT "%5.1" ECU_ADDRESS 0x60022FB2 /end MEASUREMENT
/begin MEASUREMENT swadp_eeprambuffer9 "buffer holding the value of BattId_numSerl4" UBYTE OneToOne 1 100 0.00 255.0 FORMAT "%5.1" ECU_ADDRESS 0x60022FB1 /end MEASUREMENT
/begin MEASUREMENT SWAdp_egyHvbAvlDly_Loc "" UBYTE B_TRUE 1 100 0.00 1.00000000000 BIT_MASK 0x1 FORMAT "%13.11" ECU_ADDRESS 0x60022F95
 /begin IF_DATA XCPplus 0x0102
  /begin DAQ_EVENT VARIABLE /end DAQ_EVENT
 /end IF_DATA
/end MEASUREMENT
/begin MEASUREMENT SWAdp_egyHvbAvl_SqDelayLoc "" SLONG Time_Dt 1 100 -2147.48364800 2147.48364700 FORMAT "%13.8" ECU_ADDRESS 0x600005EC
 /begin IF_DATA XCPplus 0x0102
  /begin DAQ_EVENT VARIABLE /end DAQ_EVENT
 /end IF_DATA
/end MEASUREMENT
/begin MEASUREMENT SWAdp_egyHvbAvl_SqLoc "" UBYTE B_TRUE 1 100 0.00 1.00000000000 BIT_MASK 0x1 FORMAT "%13.11" ECU_ADDRESS 0x60022F94
 /begin IF_DATA XCPplus 0x0102
  /begin DAQ_EVENT VARIABLE /end DAQ_EVENT
 /end IF_DATA
/end MEASUREMENT
/begin MEASUREMENT SWAdp_egyHvbAvl_SqLoc_1 "" UBYTE B_TRUE 1 100 0.00 1.00000000000 BIT_MASK 0x1 FORMAT "%13.11" ECU_ADDRESS 0x60022F93 /end MEASUREMENT
/begin MEASUREMENT SWAdp_flgChrgNmComReq "Network activation in case of Charging functionality" UBYTE B_TRUE 1 100 0.00 1.00000000000 BIT_MASK 0x1 FORMAT "%13.11" ECU_ADDRESS 0x6002348B
 /begin IF_DATA XCPplus 0x0102
  /begin DAQ_EVENT VARIABLE /end DAQ_EVENT
 /end IF_DATA
/end MEASUREMENT
/begin MEASUREMENT SWAdp_flgChrgrErrLoc "local value determing value of ComChrgr_flgChrgrErr_Sq" UBYTE B_TRUE 1 100 0.00 1.00000000000 BIT_MASK 0x1 FORMAT "%13.11" ECU_ADDRESS 0x60022FB0
 /begin IF_DATA XCPplus 0x0102
  /begin DAQ_EVENT VARIABLE /end DAQ_EVENT
 /end IF_DATA
/end MEASUREMENT
/begin MEASUREMENT SWAdp_flgImobAuthent_SqLoc "local for calculating DFC_flgImobAuthent_Sq" UBYTE B_TRUE 1 100 0.00 1.00000000000 BIT_MASK 0x1 FORMAT "%13.11" ECU_ADDRESS 0x60022F92
 /begin IF_DATA XCPplus 0x0102
  /begin DAQ_EVENT VARIABLE /end DAQ_EVENT
 /end IF_DATA
/end MEASUREMENT
/begin MEASUREMENT SWAdp_HvbSVSBlinkLoc "local for calculating DFC_HvbSVSBlink" UBYTE B_TRUE 1 100 0.00 1.00000000000 BIT_MASK 0x1 FORMAT "%13.11" ECU_ADDRESS 0x60022F91
 /begin IF_DATA XCPplus 0x0102
  /begin DAQ_EVENT VARIABLE /end DAQ_EVENT
 /end IF_DATA
/end MEASUREMENT
/begin MEASUREMENT SWAdp_HvbSVSContLoc "local for calculating DFC_HvbSVSCon" UBYTE B_TRUE 1 100 0.00 1.00000000000 BIT_MASK 0x1 FORMAT "%13.11" ECU_ADDRESS 0x60022F90
 /begin IF_DATA XCPplus 0x0102
  /begin DAQ_EVENT VARIABLE /end DAQ_EVENT
 /end IF_DATA
/end MEASUREMENT
/begin MEASUREMENT SWAdp_iAcMax_SqLoc "local value determing value of ComChrgr_iAcMax_Sq" UBYTE B_TRUE 1 100 0.00 1.00000000000 BIT_MASK 0x1 FORMAT "%13.11" ECU_ADDRESS 0x60022FAF
 /begin IF_DATA XCPplus 0x0102
  /begin DAQ_EVENT VARIABLE /end DAQ_EVENT
 /end IF_DATA
/end MEASUREMENT
/begin MEASUREMENT SWAdp_iDcdcHvActRvsn1_sqLoc "local value determing value of Com_iDcdcHvActRvsn1_Sq" UBYTE B_TRUE 1 100 0.00 1.00000000000 BIT_MASK 0x1 FORMAT "%13.11" ECU_ADDRESS 0x60022FAE
 /begin IF_DATA XCPplus 0x0102
  /begin DAQ_EVENT VARIABLE /end DAQ_EVENT
 /end IF_DATA
/end MEASUREMENT
/begin MEASUREMENT SWAdp_iDcdcLvActRvsn1_SqLoc "local value determing value of Com_iDcdcLvActRvsn1_Sq" UBYTE B_TRUE 1 100 0.00 1.00000000000 BIT_MASK 0x1 FORMAT "%13.11" ECU_ADDRESS 0x60022FAD
 /begin IF_DATA XCPplus 0x0102
  /begin DAQ_EVENT VARIABLE /end DAQ_EVENT
 /end IF_DATA
/end MEASUREMENT
/begin MEASUREMENT SWAdp_iDcHvAct_SqLoc "local value determing value of ComChrgr_iDcHvAct_Sq" UBYTE B_TRUE 1 100 0.00 1.00000000000 BIT_MASK 0x1 FORMAT "%13.11" ECU_ADDRESS 0x60022FAC
 /begin IF_DATA XCPplus 0x0102
  /begin DAQ_EVENT VARIABLE /end DAQ_EVENT
 /end IF_DATA
/end MEASUREMENT
/begin MEASUREMENT SWAdp_iDcRly_SqLoc "local value determing value of ComChrgn_iDcRly_Sq" UBYTE B_TRUE 1 100 0.00 1.00000000000 BIT_MASK 0x1 FORMAT "%13.11" ECU_ADDRESS 0x60022FAB
 /begin IF_DATA XCPplus 0x0102
  /begin DAQ_EVENT VARIABLE /end DAQ_EVENT
 /end IF_DATA
/end MEASUREMENT
/begin MEASUREMENT SWAdp_PSA_tqAbsltMaxOldLoc "" SWORD Trq 1 100 -3276.800 3276.700 FORMAT "%8.3" ECU_ADDRESS 0x6001F3E8
 /begin IF_DATA XCPplus 0x0102
  /begin DAQ_EVENT VARIABLE /end DAQ_EVENT
 /end IF_DATA
/end MEASUREMENT
/begin MEASUREMENT SWAdp_PSA_tqmaxLoc "" SWORD Trq 1 100 -3276.800 3276.700 FORMAT "%8.3" ECU_ADDRESS 0x6001F3E6
 /begin IF_DATA XCPplus 0x0102
  /begin DAQ_EVENT VARIABLE /end DAQ_EVENT
 /end IF_DATA
/end MEASUREMENT
/begin MEASUREMENT SWAdp_pwrMaxChrgSho_SqLoc "local value determing value of Com_pwrMaxChrgSho_Sq" UBYTE B_TRUE 1 100 0.00 1.00000000000 BIT_MASK 0x1 FORMAT "%13.11" ECU_ADDRESS 0x60022FAA
 /begin IF_DATA XCPplus 0x0102
  /begin DAQ_EVENT VARIABLE /end DAQ_EVENT
 /end IF_DATA
/end MEASUREMENT
/begin MEASUREMENT SWAdp_PwrMaxDchaShoLoLoc "Calibration used to set or release DFC_PwrMaxDchaShoLo" UBYTE B_TRUE 1 100 0.00 1.00000000000 BIT_MASK 0x1 FORMAT "%13.11" ECU_ADDRESS 0x60022FA9
 /begin IF_DATA XCPplus 0x0102
  /begin DAQ_EVENT VARIABLE /end DAQ_EVENT
 /end IF_DATA
/end MEASUREMENT
/begin MEASUREMENT SWAdp_pwrMaxDchaSho_SqLoc "local value determing value of Com_pwrMaxDchaSho_Sq" UBYTE B_TRUE 1 100 0.00 1.00000000000 BIT_MASK 0x1 FORMAT "%13.11" ECU_ADDRESS 0x60022FA8
 /begin IF_DATA XCPplus 0x0102
  /begin DAQ_EVENT VARIABLE /end DAQ_EVENT
 /end IF_DATA
/end MEASUREMENT
/begin MEASUREMENT SWAdp_ratHvbSoh_SqLoc "local variable used in the calculation of Com_ratHvbSoh_Sq" UBYTE B_TRUE 1 100 0.00 1.00000000000 BIT_MASK 0x1 FORMAT "%13.11" ECU_ADDRESS 0x60022FA7
 /begin IF_DATA XCPplus 0x0102
  /begin DAQ_EVENT VARIABLE /end DAQ_EVENT
 /end IF_DATA
/end MEASUREMENT
/begin MEASUREMENT SWAdp_stChrgr_SqLoc "local value determing value of ComChrgr_stChrgr_Sq" UBYTE B_TRUE 1 100 0.00 1.00000000000 BIT_MASK 0x1 FORMAT "%13.11" ECU_ADDRESS 0x60022FA6
 /begin IF_DATA XCPplus 0x0102
  /begin DAQ_EVENT VARIABLE /end DAQ_EVENT
 /end IF_DATA
/end MEASUREMENT
/begin MEASUREMENT SWAdp_stDcdcOperModAct_SqLoc "local value determing value of Com_stDcdcOperModAct_Sq" UBYTE B_TRUE 1 100 0.00 1.00000000000 BIT_MASK 0x1 FORMAT "%13.11" ECU_ADDRESS 0x60022FA5
 /begin IF_DATA XCPplus 0x0102
  /begin DAQ_EVENT VARIABLE /end DAQ_EVENT
 /end IF_DATA
/end MEASUREMENT
/begin MEASUREMENT SWAdp_stDcdcULimReq_SqLoc "local for calculating Com_stDcdcULimReq_Sq" UBYTE B_TRUE 1 100 0.00 1.00000000000 BIT_MASK 0x1 FORMAT "%13.11" ECU_ADDRESS 0x60022F8F
 /begin IF_DATA XCPplus 0x0102
  /begin DAQ_EVENT VARIABLE /end DAQ_EVENT
 /end IF_DATA
/end MEASUREMENT
/begin MEASUREMENT swadp_stIgnkeyPos_SqLoc "Local variable involved in the calculation of Com_stIgnkeyPos_Sq" UBYTE B_TRUE 1 100 0.00 1.00000000000 BIT_MASK 0x1 FORMAT "%13.11" ECU_ADDRESS 0x60022FA4
 /begin IF_DATA XCPplus 0x0102
  /begin DAQ_EVENT VARIABLE /end DAQ_EVENT
 /end IF_DATA
/end MEASUREMENT
/begin MEASUREMENT SWAdp_stIsoMonSwtAck_SqLoc "local for calculating Com_stIsoMonSwtAck_Sq" UBYTE B_TRUE 1 100 0.00 1.00000000000 BIT_MASK 0x1 FORMAT "%13.11" ECU_ADDRESS 0x60022FA3
 /begin IF_DATA XCPplus 0x0102
  /begin DAQ_EVENT VARIABLE /end DAQ_EVENT
 /end IF_DATA
/end MEASUREMENT
/begin MEASUREMENT SWAdp_stModLoc "Local variable for Active charging mode" UBYTE OneToOne 1 100 0.00 9.000 FORMAT "%5.3" ECU_ADDRESS 0x60022FA2
 /begin IF_DATA XCPplus 0x0102
  /begin DAQ_EVENT VARIABLE /end DAQ_EVENT
 /end IF_DATA
/end MEASUREMENT
/begin MEASUREMENT SWAdp_stPosnLoc "Local interface used in the calculation of Com_stDrvModPosn" UBYTE OneToOne 1 100 0.00 7.000 FORMAT "%5.3" ECU_ADDRESS 0x60022FA1
 /begin IF_DATA XCPplus 0x0102
  /begin DAQ_EVENT VARIABLE /end DAQ_EVENT
 /end IF_DATA
/end MEASUREMENT
/begin MEASUREMENT SWAdp_stPwrAuthn_SqLoc "local for calculating Com_stPwrAuthn_Sq" UBYTE B_TRUE 1 100 0.00 1.00000000000 BIT_MASK 0x1 FORMAT "%13.11" ECU_ADDRESS 0x60022FA0
 /begin IF_DATA XCPplus 0x0102
  /begin DAQ_EVENT VARIABLE /end DAQ_EVENT
 /end IF_DATA
/end MEASUREMENT
/begin MEASUREMENT swadp_strlydes1Loc "Local variable involved in the calculation of ChrgrRly_stRlyDes" UBYTE B_TRUE 1 100 0.00 1.00000000000 BIT_MASK 0x1 FORMAT "%13.11" ECU_ADDRESS 0x60022F8E
 /begin IF_DATA XCPplus 0x0102
  /begin DAQ_EVENT VARIABLE /end DAQ_EVENT
 /end IF_DATA
/end MEASUREMENT
/begin MEASUREMENT swadp_strlydes2Loc "Local variable involved in the calculation of ChrgrRly_stRlyDes" UBYTE B_TRUE 1 100 0.00 1.00000000000 BIT_MASK 0x1 FORMAT "%13.11" ECU_ADDRESS 0x60022F8D
 /begin IF_DATA XCPplus 0x0102
  /begin DAQ_EVENT VARIABLE /end DAQ_EVENT
 /end IF_DATA
/end MEASUREMENT
/begin MEASUREMENT swadp_strlydesLoc "Local variable involved in the calculation of ChrgrRly_stRlyDes" UBYTE B_TRUE 1 100 0.00 1.00000000000 BIT_MASK 0x1 FORMAT "%13.11" ECU_ADDRESS 0x60022F8C
 /begin IF_DATA XCPplus 0x0102
  /begin DAQ_EVENT VARIABLE /end DAQ_EVENT
 /end IF_DATA
/end MEASUREMENT
/begin MEASUREMENT SWAdp_tChrgrMaxAct_SqLoc "local value determing value of ComChrgr_tChrgrMaxAct_Sq" UBYTE B_TRUE 1 100 0.00 1.00000000000 BIT_MASK 0x1 FORMAT "%13.11" ECU_ADDRESS 0x60022F9F
 /begin IF_DATA XCPplus 0x0102
  /begin DAQ_EVENT VARIABLE /end DAQ_EVENT
 /end IF_DATA
/end MEASUREMENT
/begin MEASUREMENT SWAdp_tDcdcAct_SqLoc "local value determing value of Com_tDcdcAct_Sq" UBYTE B_TRUE 1 100 0.00 1.00000000000 BIT_MASK 0x1 FORMAT "%13.11" ECU_ADDRESS 0x60022F9E
 /begin IF_DATA XCPplus 0x0102
  /begin DAQ_EVENT VARIABLE /end DAQ_EVENT
 /end IF_DATA
/end MEASUREMENT
/begin MEASUREMENT SWAdp_tDcdcInltCoolt_SqLoc "local variable used in the calculation of Com_tDcdcInltCoolt_Sq" UBYTE B_TRUE 1 100 0.00 1.00000000000 BIT_MASK 0x1 FORMAT "%13.11" ECU_ADDRESS 0x60022F9D
 /begin IF_DATA XCPplus 0x0102
  /begin DAQ_EVENT VARIABLE /end DAQ_EVENT
 /end IF_DATA
/end MEASUREMENT
/begin MEASUREMENT SWAdp_uAcActL1_SqLoc "local value determing value of ComChrgr_uAcActL1_Sq" UBYTE B_TRUE 1 100 0.00 1.00000000000 BIT_MASK 0x1 FORMAT "%13.11" ECU_ADDRESS 0x60022F9C
 /begin IF_DATA XCPplus 0x0102
  /begin DAQ_EVENT VARIABLE /end DAQ_EVENT
 /end IF_DATA
/end MEASUREMENT
/begin MEASUREMENT SWAdp_uDcdcHvAct_SqLoc "local value determing value of Com_uDcdcHvAct_Sq" UBYTE B_TRUE 1 100 0.00 1.00000000000 BIT_MASK 0x1 FORMAT "%13.11" ECU_ADDRESS 0x60022F9B
 /begin IF_DATA XCPplus 0x0102
  /begin DAQ_EVENT VARIABLE /end DAQ_EVENT
 /end IF_DATA
/end MEASUREMENT
/begin MEASUREMENT SWAdp_uDcdcLvAct_SqLoc "local value determing value of Com_uDcdcLvAct_Sq" UBYTE B_TRUE 1 100 0.00 1.00000000000 BIT_MASK 0x1 FORMAT "%13.11" ECU_ADDRESS 0x60022F9A
 /begin IF_DATA XCPplus 0x0102
  /begin DAQ_EVENT VARIABLE /end DAQ_EVENT
 /end IF_DATA
/end MEASUREMENT
/begin MEASUREMENT SWAdp_uDcHvAct_SqLoc "local value determing value of ComChrgr_uDcHvAct_Sq" UBYTE B_TRUE 1 100 0.00 1.00000000000 BIT_MASK 0x1 FORMAT "%13.11" ECU_ADDRESS 0x60022F99
 /begin IF_DATA XCPplus 0x0102
  /begin DAQ_EVENT VARIABLE /end DAQ_EVENT
 /end IF_DATA
/end MEASUREMENT
/begin MEASUREMENT SWAdp_uDcRly_SqLoc "local value determing value of ComChrgn_uDcRly_Sq" UBYTE B_TRUE 1 100 0.00 1.00000000000 BIT_MASK 0x1 FORMAT "%13.11" ECU_ADDRESS 0x60022F98
 /begin IF_DATA XCPplus 0x0102
  /begin DAQ_EVENT VARIABLE /end DAQ_EVENT
 /end IF_DATA
/end MEASUREMENT
/begin MEASUREMENT SWAP_PSA_T15OffTimer "T15 Off Timer" SLONG Time_s 1 100 -21474836.4800 21474836.4700 FORMAT "%13.4" ECU_ADDRESS 0x600005E8
 /begin IF_DATA XCPplus 0x0102
  /begin DAQ_EVENT VARIABLE /end DAQ_EVENT
 /end IF_DATA
/end MEASUREMENT
/begin MEASUREMENT SWAP_PSA_T15OnTimer "T15 On Timer" SLONG Time_s 1 100 -21474836.4800 21474836.4700 FORMAT "%13.4" ECU_ADDRESS 0x600005E4
 /begin IF_DATA XCPplus 0x0102
  /begin DAQ_EVENT VARIABLE /end DAQ_EVENT
 /end IF_DATA
/end MEASUREMENT
/begin MEASUREMENT SyC_ctDrvEnter "Global drive cycle counter which is incremented when system state DRIVE is entered" UBYTE OneToOne 1 100 0.00 255.0 FORMAT "%5.1" ECU_ADDRESS 0x60023776 /end MEASUREMENT
/begin MEASUREMENT SyC_ctIrrSwOff "Counter for detection of irregular switch-off of the ECU" UBYTE OneToOne 1 100 0.00 255.0 FORMAT "%5.1" ECU_ADDRESS 0x60023775 /end MEASUREMENT
/begin MEASUREMENT SyC_ctPostDrvLeave "Global drive cycle counter which is incremented when system state leaves post drive" UBYTE OneToOne 1 100 0.00 255.0 FORMAT "%5.1" ECU_ADDRESS 0x60023774 /end MEASUREMENT
/begin MEASUREMENT SyC_stDrv_e "drive internal state machine" UBYTE SyC_Drv_state_e 1 100 0.00 1.00000000000 FORMAT "%13.11" ECU_ADDRESS 0x60023773
 /begin IF_DATA XCPplus 0x0102
  /begin DAQ_EVENT VARIABLE /end DAQ_EVENT
 /end IF_DATA
/end MEASUREMENT
/begin MEASUREMENT SyC_stMn "Current system/ECU state" UBYTE ExeCon_State_01 1 100 0.00 3.00000000000 FORMAT "%13.11" ECU_ADDRESS 0x60023772 /end MEASUREMENT
/begin MEASUREMENT SyC_stMnOld "Previous system/ECU state" UBYTE ExeCon_State_01 1 100 0.00 3.00000000000 FORMAT "%13.11" ECU_ADDRESS 0x60023771 /end MEASUREMENT
/begin MEASUREMENT SyC_stPostDrv "PostDrive control state" UBYTE SyC_PostDrv_State 1 100 0.00 8.00000000000 FORMAT "%13.11" ECU_ADDRESS 0x60023770 /end MEASUREMENT
/begin MEASUREMENT SyC_stPostDrvDel "post-drive delay request" UBYTE OneToOne 1 100 0.00 255.0 FORMAT "%5.1" ECU_ADDRESS 0x600236A1
 /begin IF_DATA XCPplus 0x0102
  /begin DAQ_EVENT VARIABLE /end DAQ_EVENT
 /end IF_DATA
/end MEASUREMENT
/begin MEASUREMENT SyC_stPostDrv_e "postdrive internal state machine" UBYTE SyC_PostDrv_state_e 1 100 0.00 2.00000000000 FORMAT "%13.11" ECU_ADDRESS 0x6002376F
 /begin IF_DATA XCPplus 0x0102
  /begin DAQ_EVENT VARIABLE /end DAQ_EVENT
 /end IF_DATA
/end MEASUREMENT
/begin MEASUREMENT SyC_stPreDrv "PreDrive control state" UBYTE SyC_PreDrv_State 1 100 0.00 9.00000000000 FORMAT "%13.11" ECU_ADDRESS 0x6002376E /end MEASUREMENT
/begin MEASUREMENT SyC_stPreDrvDel "Variable to check if predrive is prolonged or not" UBYTE OneToOne 1 100 0.00 255.0 FORMAT "%5.1" ECU_ADDRESS 0x600236A0
 /begin IF_DATA XCPplus 0x0102
  /begin DAQ_EVENT VARIABLE /end DAQ_EVENT
 /end IF_DATA
/end MEASUREMENT
/begin MEASUREMENT SyC_stPreDrv_e "predrive internal state machine" UBYTE SyC_PreDrv_state_e 1 100 0.00 3.00000000000 FORMAT "%13.11" ECU_ADDRESS 0x6002376D
 /begin IF_DATA XCPplus 0x0102
  /begin DAQ_EVENT VARIABLE /end DAQ_EVENT
 /end IF_DATA
/end MEASUREMENT
/begin MEASUREMENT SyC_stRCD "State machine for RCD" UBYTE SyC_stRCDVerb 1 100 0.00 6.00000000000 FORMAT "%13.11" ECU_ADDRESS 0x6002376C
 /begin IF_DATA XCPplus 0x0102
  /begin DAQ_EVENT VARIABLE /end DAQ_EVENT
 /end IF_DATA
/end MEASUREMENT
/begin MEASUREMENT SyC_stRCDold "SyC_stRCD Previous state" UBYTE SyC_stRCDVerb 1 100 0.00 6.00000000000 FORMAT "%13.11" ECU_ADDRESS 0x6002376B
 /begin IF_DATA XCPplus 0x0102
  /begin DAQ_EVENT VARIABLE /end DAQ_EVENT
 /end IF_DATA
/end MEASUREMENT
/begin MEASUREMENT SyC_stSub "Current system/ECU sub-state" UBYTE ExeCon_State_02 1 100 0.00 6.00000000000 FORMAT "%13.11" ECU_ADDRESS 0x6002376A /end MEASUREMENT
/begin MEASUREMENT SyC_stSubOld "Previous system/ECU sub-state" UBYTE ExeCon_State_02 1 100 0.00 6.00000000000 FORMAT "%13.11" ECU_ADDRESS 0x60023769 /end MEASUREMENT
/begin MEASUREMENT SyC_stSwtOn_mp "Status current reason for switching-on ECU" UBYTE OneToOne 1 100 0.00 255.0 FORMAT "%5.1" ECU_ADDRESS 0x70006B56 /end MEASUREMENT
/begin MEASUREMENT SyC_stVldTiEcuOff "ECU off time valid" UBYTE OneToOne 1 100 0.00 255.0 BIT_MASK 0x1 FORMAT "%5.1" ECU_ADDRESS 0x6002369F /end MEASUREMENT
/begin MEASUREMENT SyC_tiDrv "Time since state SYC_DRIVE was reached" ULONG Time_msec_q10_COMPU 1 100 0.00 42949672950.0 FORMAT "%13.1" ECU_ADDRESS 0x60000FE8
 /begin IF_DATA XCPplus 0x0102
  /begin DAQ_EVENT VARIABLE /end DAQ_EVENT
 /end IF_DATA
/end MEASUREMENT
/begin MEASUREMENT SyC_tiEcuOff "ECU off time" SLONG Time_sec_q1_COMPU 1 100 -2147483648.00 2147483647.00 FORMAT "%13.2" ECU_ADDRESS 0x600010A0 /end MEASUREMENT
/begin MEASUREMENT SyC_tiFrst10ms "Time from ECU boot until the first 10ms task" UWORD Time_msec_q1_COMPU 1 100 0.00 65535.00 FORMAT "%8.2" ECU_ADDRESS 0x6001FC96
 /begin IF_DATA XCPplus 0x0102
  /begin DAQ_EVENT VARIABLE /end DAQ_EVENT
 /end IF_DATA
/end MEASUREMENT
/begin MEASUREMENT SyC_tiIniEnd_mp "Duration of system state SYC_INIEND" UWORD Time_usec_q1_COMPU 1 100 0.00 65535.00 FORMAT "%8.2" ECU_ADDRESS 0x70006942 /end MEASUREMENT
/begin MEASUREMENT SyC_tiIniSyn_mp "Duration of system state SYC_INISYN" UWORD Time_usec_q1_COMPU 1 100 0.00 65535.00 FORMAT "%8.2" ECU_ADDRESS 0x70006940 /end MEASUREMENT
/begin MEASUREMENT SyC_tiIni_mp "Duration of system state SYC_INI" ULONG Time_usec_q1_COMPU 1 100 0.00 4294967295.00 FORMAT "%13.2" ECU_ADDRESS 0x70006818 /end MEASUREMENT
/begin MEASUREMENT SyC_tiPostDrv "Time since state SYC_POSTDRIVE was reached" ULONG Time_msec_q10_COMPU 1 100 0.00 42949672950.0 FORMAT "%13.1" ECU_ADDRESS 0x60000FE4
 /begin IF_DATA XCPplus 0x0102
  /begin DAQ_EVENT VARIABLE /end DAQ_EVENT
 /end IF_DATA
/end MEASUREMENT
/begin MEASUREMENT SyC_tiPreDrv "Time since state SYC_PREDRIVE was reached" ULONG Time_msec_q10_COMPU 1 100 0.00 42949672950.0 FORMAT "%13.1" ECU_ADDRESS 0x60000FE0
 /begin IF_DATA XCPplus 0x0102
  /begin DAQ_EVENT VARIABLE /end DAQ_EVENT
 /end IF_DATA
/end MEASUREMENT
/begin MEASUREMENT T15_flgOn "Terminal 15 state" UBYTE OneToOne 1 100 0.00 1.000 BIT_MASK 0x1 FORMAT "%5.3" ECU_ADDRESS 0x60023888 /end MEASUREMENT
/begin MEASUREMENT T15_st "Terminal 15 status after debouncing" UBYTE OneToOne 1 100 0.00 1.000 BIT_MASK 0x1 FORMAT "%5.3" ECU_ADDRESS 0x6002369E /end MEASUREMENT
/begin MEASUREMENT T15_stRaw "Raw value of Terminal 15 status" UBYTE OneToOne 1 100 0.00 255.0 FORMAT "%5.1" ECU_ADDRESS 0x60023768 /end MEASUREMENT
/begin MEASUREMENT T15_stRawTurnOffDly_Sq "signal quality message for T15stRAW" UBYTE SigQly_COMPU_VERB 1 100 0.00 15.0000000000 FORMAT "%13.10" ECU_ADDRESS 0x600234FF
 /begin IF_DATA XCPplus 0x0102
  /begin DAQ_EVENT VARIABLE /end DAQ_EVENT
 /end IF_DATA
/end MEASUREMENT
/begin MEASUREMENT T50_st "Status of Terminal 50" UBYTE B_TRUE 1 100 0.00 1.00000000000 BIT_MASK 0x1 FORMAT "%13.11" ECU_ADDRESS 0x60023485
 /begin IF_DATA XCPplus 0x0102
  /begin DAQ_EVENT VARIABLE /end DAQ_EVENT
 /end IF_DATA
/end MEASUREMENT
/begin MEASUREMENT Telltl_stReqd "Thermal system warning lamp status" UBYTE q1 1 100 0.00 255.0 FORMAT "%5.1" ECU_ADDRESS 0x6002343C
 /begin IF_DATA XCPplus 0x0102
  /begin DAQ_EVENT VARIABLE /end DAQ_EVENT
 /end IF_DATA
/end MEASUREMENT
/begin MEASUREMENT ThermCfg_flgMTAftRunReq "afterrun request in medium temperature circuit" UBYTE B_TRUE 1 100 0.00 1.00000000000 BIT_MASK 0x1 FORMAT "%13.11" ECU_ADDRESS 0x70000275
 /begin IF_DATA XCPplus 0x0102
  /begin DAQ_EVENT VARIABLE /end DAQ_EVENT
 /end IF_DATA
/end MEASUREMENT
/begin MEASUREMENT ThermCfg_ratMTPmpReq "pump request in medium temperature circuit" SBYTE RBPtCel_Perc_1p0_1 1 100 -128.0 127.0 FORMAT "%5.1" ECU_ADDRESS 0x60023473
 /begin IF_DATA XCPplus 0x0102
  /begin DAQ_EVENT VARIABLE /end DAQ_EVENT
 /end IF_DATA
/end MEASUREMENT
/begin MEASUREMENT ThermCoorn_flgHVReq "Thermal coordinator request for HV supply" UBYTE B_TRUE 1 100 0.00 1.00000000000 BIT_MASK 0x1 FORMAT "%13.11" ECU_ADDRESS 0x70000274
 /begin IF_DATA XCPplus 0x0102
  /begin DAQ_EVENT VARIABLE /end DAQ_EVENT
 /end IF_DATA
/end MEASUREMENT
/begin MEASUREMENT ThermCoorn_flgMTFanRels "release flag for the fan request of the medium temperature coolant circuit" UBYTE B_TRUE 1 100 0.00 1.00000000000 BIT_MASK 0x1 FORMAT "%13.11" ECU_ADDRESS 0x70000273
 /begin IF_DATA XCPplus 0x0102
  /begin DAQ_EVENT VARIABLE /end DAQ_EVENT
 /end IF_DATA
/end MEASUREMENT
/begin MEASUREMENT ThermCoorn_stCtrl "Thermal coordinator control mode" UBYTE q1 1 100 0.00 255.0 FORMAT "%5.1" ECU_ADDRESS 0x6002343B
 /begin IF_DATA XCPplus 0x0102
  /begin DAQ_EVENT VARIABLE /end DAQ_EVENT
 /end IF_DATA
/end MEASUREMENT
/begin MEASUREMENT ThermCoorn_stMTBypVlvPosn "control state of the bypass valve for the medium temperature coolant circuit" UBYTE q1 1 100 0.00 255.0 FORMAT "%5.1" ECU_ADDRESS 0x6002343A
 /begin IF_DATA XCPplus 0x0102
  /begin DAQ_EVENT VARIABLE /end DAQ_EVENT
 /end IF_DATA
/end MEASUREMENT
/begin MEASUREMENT ThermCoorn_stMTPmp "control state of the water pump for the medium temperature coolant circuit" UBYTE q1 1 100 0.00 255.0 FORMAT "%5.1" ECU_ADDRESS 0x60023439
 /begin IF_DATA XCPplus 0x0102
  /begin DAQ_EVENT VARIABLE /end DAQ_EVENT
 /end IF_DATA
/end MEASUREMENT
/begin MEASUREMENT ThermDcdc_flgAftRunReq "afterrun request of the dcdc converter" UBYTE B_TRUE 1 100 0.00 1.00000000000 BIT_MASK 0x1 FORMAT "%13.11" ECU_ADDRESS 0x70000272
 /begin IF_DATA XCPplus 0x0102
  /begin DAQ_EVENT VARIABLE /end DAQ_EVENT
 /end IF_DATA
/end MEASUREMENT
/begin MEASUREMENT ThermDcdc_ratPmpReq "flow request of the dcdc converter" SBYTE RBPtCel_Perc_1p0_1 1 100 -128.0 127.0 FORMAT "%5.1" ECU_ADDRESS 0x60023472
 /begin IF_DATA XCPplus 0x0102
  /begin DAQ_EVENT VARIABLE /end DAQ_EVENT
 /end IF_DATA
/end MEASUREMENT
/begin MEASUREMENT ThermDcdc_tFild "Filtered dcdc temperature" SWORD RBPtCel_t_0p02_1 1 100 -655.3600 655.3400 FORMAT "%8.4" ECU_ADDRESS 0x6001F3E4
 /begin IF_DATA XCPplus 0x0102
  /begin DAQ_EVENT VARIABLE /end DAQ_EVENT
 /end IF_DATA
/end MEASUREMENT
/begin MEASUREMENT ThermElTrac_flgAftRunReq "traction component aftrun request" UBYTE B_TRUE 1 100 0.00 1.00000000000 BIT_MASK 0x1 FORMAT "%13.11" ECU_ADDRESS 0x70000271
 /begin IF_DATA XCPplus 0x0102
  /begin DAQ_EVENT VARIABLE /end DAQ_EVENT
 /end IF_DATA
/end MEASUREMENT
/begin MEASUREMENT ThermElTrac_flgAftRunReq01 "inverter or electrical machine 1 request an afterrun" UBYTE B_TRUE 1 100 0.00 1.00000000000 BIT_MASK 0x1 FORMAT "%13.11" ECU_ADDRESS 0x7000010B
 /begin IF_DATA XCPplus 0x0102
  /begin DAQ_EVENT VARIABLE /end DAQ_EVENT
 /end IF_DATA
/end MEASUREMENT
/begin MEASUREMENT ThermElTrac_flgAftRunReq02 "inverter or electrical machine 2 request an afterrun" UBYTE B_TRUE 1 100 0.00 1.00000000000 BIT_MASK 0x1 FORMAT "%13.11" ECU_ADDRESS 0x7000010A
 /begin IF_DATA XCPplus 0x0102
  /begin DAQ_EVENT VARIABLE /end DAQ_EVENT
 /end IF_DATA
/end MEASUREMENT
/begin MEASUREMENT ThermElTrac_pwrLossAbslt01Flt "filtered value of the power losses of electrical machine 1" SWORD leist_q16_W 1 100 -524288.0 524272.0 FORMAT "%8.1" ECU_ADDRESS 0x6001F3E2
 /begin IF_DATA XCPplus 0x0102
  /begin DAQ_EVENT VARIABLE /end DAQ_EVENT
 /end IF_DATA
/end MEASUREMENT
/begin MEASUREMENT ThermElTrac_ratElM01PmpReq "flow request of the electrical machine 1" SBYTE RBPtCel_Perc_1p0_1 1 100 -128.0 127.0 FORMAT "%5.1" ECU_ADDRESS 0x60022F8B
 /begin IF_DATA XCPplus 0x0102
  /begin DAQ_EVENT VARIABLE /end DAQ_EVENT
 /end IF_DATA
/end MEASUREMENT
/begin MEASUREMENT ThermElTrac_ratEm01AddlPmpReq "additional flow request depending on the power losses of electrical machine 1" SBYTE RBPtCel_Perc_1p0_1 1 100 -128.0 127.0 FORMAT "%5.1" ECU_ADDRESS 0x60022F8A
 /begin IF_DATA XCPplus 0x0102
  /begin DAQ_EVENT VARIABLE /end DAQ_EVENT
 /end IF_DATA
/end MEASUREMENT
/begin MEASUREMENT ThermElTrac_ratEm01PmpReq "flow request depending on the temperature of electrical machine 1" SBYTE RBPtCel_Perc_1p0_1 1 100 -128.0 127.0 FORMAT "%5.1" ECU_ADDRESS 0x60022F89
 /begin IF_DATA XCPplus 0x0102
  /begin DAQ_EVENT VARIABLE /end DAQ_EVENT
 /end IF_DATA
/end MEASUREMENT
/begin MEASUREMENT ThermElTrac_ratEm02PmpReq "flow request depending on the temperature of electrical machine 2" SBYTE RBPtCel_Perc_1p0_1 1 100 -128.0 127.0 FORMAT "%5.1" ECU_ADDRESS 0x60022F88
 /begin IF_DATA XCPplus 0x0102
  /begin DAQ_EVENT VARIABLE /end DAQ_EVENT
 /end IF_DATA
/end MEASUREMENT
/begin MEASUREMENT ThermElTrac_ratIvtr01PmpReq "flow request depending on the temperature of inverter 1" SBYTE RBPtCel_Perc_1p0_1 1 100 -128.0 127.0 FORMAT "%5.1" ECU_ADDRESS 0x60022F87
 /begin IF_DATA XCPplus 0x0102
  /begin DAQ_EVENT VARIABLE /end DAQ_EVENT
 /end IF_DATA
/end MEASUREMENT
/begin MEASUREMENT ThermElTrac_ratPmpReq "flow request of the electrical traction components" SBYTE RBPtCel_Perc_1p0_1 1 100 -128.0 127.0 FORMAT "%5.1" ECU_ADDRESS 0x60023471
 /begin IF_DATA XCPplus 0x0102
  /begin DAQ_EVENT VARIABLE /end DAQ_EVENT
 /end IF_DATA
/end MEASUREMENT
/begin MEASUREMENT ThermElTrac_tElM01Flt "filtered value of the temperature of electrical machine 1" SWORD RBPtCel_t_0p02_1 1 100 -655.3600 655.3400 FORMAT "%8.4" ECU_ADDRESS 0x6001F3E0
 /begin IF_DATA XCPplus 0x0102
  /begin DAQ_EVENT VARIABLE /end DAQ_EVENT
 /end IF_DATA
/end MEASUREMENT
/begin MEASUREMENT ThermElTrac_tIvtr01Flt "filtered value of the temperature of inverter 1" SWORD RBPtCel_t_0p02_1 1 100 -655.3600 655.3400 FORMAT "%8.4" ECU_ADDRESS 0x6001F3DE
 /begin IF_DATA XCPplus 0x0102
  /begin DAQ_EVENT VARIABLE /end DAQ_EVENT
 /end IF_DATA
/end MEASUREMENT
/begin MEASUREMENT ThermHvac_flgPreCdngSocSuff "HV battery SoC is sufficient for pre-conditioning" UBYTE B_TRUE 1 100 0.00 1.00000000000 BIT_MASK 0x1 FORMAT "%13.11" ECU_ADDRESS 0x70000109
 /begin IF_DATA XCPplus 0x0102
  /begin DAQ_EVENT VARIABLE /end DAQ_EVENT
 /end IF_DATA
/end MEASUREMENT
/begin MEASUREMENT ThermHvac_flgRemPrecndnActv "Preconditioning active" UBYTE B_TRUE 1 100 0.00 1.00000000000 BIT_MASK 0x1 FORMAT "%13.11" ECU_ADDRESS 0x70000270
 /begin IF_DATA XCPplus 0x0102
  /begin DAQ_EVENT VARIABLE /end DAQ_EVENT
 /end IF_DATA
/end MEASUREMENT
/begin MEASUREMENT ThermHvac_ratBlowrSpd "Cabin blower air flow" SBYTE RBPtCel_Perc_1p0_1 1 100 -128.0 127.0 FORMAT "%5.1" ECU_ADDRESS 0x60023470
 /begin IF_DATA XCPplus 0x0102
  /begin DAQ_EVENT VARIABLE /end DAQ_EVENT
 /end IF_DATA
/end MEASUREMENT
/begin MEASUREMENT ThermHvac_stAc "AC request" UBYTE q1 1 100 0.00 255.0 FORMAT "%5.1" ECU_ADDRESS 0x60023438
 /begin IF_DATA XCPplus 0x0102
  /begin DAQ_EVENT VARIABLE /end DAQ_EVENT
 /end IF_DATA
/end MEASUREMENT
/begin MEASUREMENT ThermHvac_stFrntCoolgReq "Front Cooling Request" UBYTE q1 1 100 0.00 255.0 FORMAT "%5.1" ECU_ADDRESS 0x60023437
 /begin IF_DATA XCPplus 0x0102
  /begin DAQ_EVENT VARIABLE /end DAQ_EVENT
 /end IF_DATA
/end MEASUREMENT
/begin MEASUREMENT ThermHvac_stFrntHeatgReq "Front Heating Request" UBYTE q1 1 100 0.00 255.0 FORMAT "%5.1" ECU_ADDRESS 0x60023436
 /begin IF_DATA XCPplus 0x0102
  /begin DAQ_EVENT VARIABLE /end DAQ_EVENT
 /end IF_DATA
/end MEASUREMENT
/begin MEASUREMENT ThermHvac_stRemPrecndn "State of HVAC remote preconditioning" UBYTE q1 1 100 0.00 255.0 FORMAT "%5.1" ECU_ADDRESS 0x60023435
 /begin IF_DATA XCPplus 0x0102
  /begin DAQ_EVENT VARIABLE /end DAQ_EVENT
 /end IF_DATA
/end MEASUREMENT
/begin MEASUREMENT ThermHvac_stRemPrecndnInt "Evaluated pre-conditioning status internal to VCU" UBYTE q1 1 100 0.00 255.0 FORMAT "%5.1" ECU_ADDRESS 0x60023434
 /begin IF_DATA XCPplus 0x0102
  /begin DAQ_EVENT VARIABLE /end DAQ_EVENT
 /end IF_DATA
/end MEASUREMENT
/begin MEASUREMENT ThermHvac_tEvaprSpMax "Maximum evaporator temperature setpoint" SWORD Temp_Cels 1 100 -3549.940 3003.560 FORMAT "%8.3" ECU_ADDRESS 0x6001F9D6
 /begin IF_DATA XCPplus 0x0102
  /begin DAQ_EVENT VARIABLE /end DAQ_EVENT
 /end IF_DATA
/end MEASUREMENT
/begin MEASUREMENT ThermHvac_tEvaprSpMin "minimum evaporator temperature setpoint" SWORD Temp_Cels 1 100 -3549.940 3003.560 FORMAT "%8.3" ECU_ADDRESS 0x6001F9D4
 /begin IF_DATA XCPplus 0x0102
  /begin DAQ_EVENT VARIABLE /end DAQ_EVENT
 /end IF_DATA
/end MEASUREMENT
/begin MEASUREMENT ThermHvac_tiEvlnDly "Pre-condition status evaluation timer" SBYTE q0p1_s 1 100 -12.80 12.70 FORMAT "%5.2" ECU_ADDRESS 0x60022F86
 /begin IF_DATA XCPplus 0x0102
  /begin DAQ_EVENT VARIABLE /end DAQ_EVENT
 /end IF_DATA
/end MEASUREMENT
/begin MEASUREMENT ThermLvl_dTMTCooltEnv "temperature difference medium temperature circuit coolant to environment" SWORD RBPtCel_t_0p1_1 1 100 -3276.800 3276.700 FORMAT "%8.3" ECU_ADDRESS 0x6001F9D0
 /begin IF_DATA XCPplus 0x0102
  /begin DAQ_EVENT VARIABLE /end DAQ_EVENT
 /end IF_DATA
/end MEASUREMENT
/begin MEASUREMENT ThermLvl_dTMTCooltSp "temperature difference medium temperature circuit coolant to medium temperature circuit setpoint" SWORD RBPtCel_t_0p1_1 1 100 -3276.800 3276.700 FORMAT "%8.3" ECU_ADDRESS 0x6001F9CE
 /begin IF_DATA XCPplus 0x0102
  /begin DAQ_EVENT VARIABLE /end DAQ_EVENT
 /end IF_DATA
/end MEASUREMENT
/begin MEASUREMENT ThermLvl_tMedTCircRadDs "medium temperature circuit coolant temperature" SWORD RBPtCel_t_0p1om273p14_1 1 100 -3549.940 3003.560 FORMAT "%8.3" ECU_ADDRESS 0x6001F9CC
 /begin IF_DATA XCPplus 0x0102
  /begin DAQ_EVENT VARIABLE /end DAQ_EVENT
 /end IF_DATA
/end MEASUREMENT
/begin MEASUREMENT ThermLvl_tMTPasSp "temperature setpoint of medium temperature circuit for passive cooling" SWORD Temp_Cels 1 100 -3549.940 3003.560 FORMAT "%8.3" ECU_ADDRESS 0x6001F3DC
 /begin IF_DATA XCPplus 0x0102
  /begin DAQ_EVENT VARIABLE /end DAQ_EVENT
 /end IF_DATA
/end MEASUREMENT
/begin MEASUREMENT ThermMod_MTAftRunReqDebTOFF_I.XOld "TurnOffDelay for MT-afterrun request condition / old input value from previous call" UBYTE B_TRUE 1 100 0.00 1.00000000000 BIT_MASK 0x1 FORMAT "%13.11" ECU_ADDRESS 0x6000057C /end MEASUREMENT
/begin MEASUREMENT ThermMod_MTAftRunReqDebTOFF_I.Timer "TurnOffDelay for MT-afterrun request condition / Timer for internal state" SLONG OneToOne 1 100 -2147483648.00 2147483647.00 FORMAT "%13.2" ECU_ADDRESS 0x60000580 /end MEASUREMENT
/begin MEASUREMENT ThermMod_MTAirFlowHDR_I "Hyteresis for MT airflow cooling request" UBYTE B_TRUE 1 100 0.00 1.00000000000 BIT_MASK 0x1 FORMAT "%13.11" ECU_ADDRESS 0x70000107
 /begin IF_DATA XCPplus 0x0102
  /begin DAQ_EVENT VARIABLE /end DAQ_EVENT
 /end IF_DATA
/end MEASUREMENT
/begin MEASUREMENT ThermMod_MTEnvHeatgHDR_I "Hysteresis for environment heating state detection" UBYTE B_TRUE 1 100 0.00 1.00000000000 BIT_MASK 0x1 FORMAT "%13.11" ECU_ADDRESS 0x70000106
 /begin IF_DATA XCPplus 0x0102
  /begin DAQ_EVENT VARIABLE /end DAQ_EVENT
 /end IF_DATA
/end MEASUREMENT
/begin MEASUREMENT ThermMod_MTEnvInRngHDR_I "Hysteresis for environment heating state detection" UBYTE B_TRUE 1 100 0.00 1.00000000000 BIT_MASK 0x1 FORMAT "%13.11" ECU_ADDRESS 0x70000105
 /begin IF_DATA XCPplus 0x0102
  /begin DAQ_EVENT VARIABLE /end DAQ_EVENT
 /end IF_DATA
/end MEASUREMENT
/begin MEASUREMENT ThermMod_MTReqDebTOFF_I.XOld "TurnOffDelay for MT-cooling request condition / old input value from previous call" UBYTE B_TRUE 1 100 0.00 1.00000000000 BIT_MASK 0x1 FORMAT "%13.11" ECU_ADDRESS 0x60000574 /end MEASUREMENT
/begin MEASUREMENT ThermMod_MTReqDebTOFF_I.Timer "TurnOffDelay for MT-cooling request condition / Timer for internal state" SLONG OneToOne 1 100 -2147483648.00 2147483647.00 FORMAT "%13.2" ECU_ADDRESS 0x60000578 /end MEASUREMENT
/begin MEASUREMENT ThermMod_st "Thermal constrol state" UBYTE ThermMod_st_VERB 1 100 0.00 8.00000000000 FORMAT "%13.11" ECU_ADDRESS 0x60023432
 /begin IF_DATA XCPplus 0x0102
  /begin DAQ_EVENT VARIABLE /end DAQ_EVENT
 /end IF_DATA
/end MEASUREMENT
/begin MEASUREMENT ThermMod_stMTAftRunReq "Status of MT-circuit afterrun request for thermal coordination" UBYTE ThermMod_stMTAftRunReq_VERB 1 100 0.00 1.00000000000 FORMAT "%13.11" ECU_ADDRESS 0x60022F85
 /begin IF_DATA XCPplus 0x0102
  /begin DAQ_EVENT VARIABLE /end DAQ_EVENT
 /end IF_DATA
/end MEASUREMENT
/begin MEASUREMENT ThermMod_stMTCooltEnv "State of MT-coolant w.r.t. environment temperature" UBYTE ThermMod_stMTCooltEnv_VERB 1 100 0.00 2.00000000000 FORMAT "%13.11" ECU_ADDRESS 0x60022F84
 /begin IF_DATA XCPplus 0x0102
  /begin DAQ_EVENT VARIABLE /end DAQ_EVENT
 /end IF_DATA
/end MEASUREMENT
/begin MEASUREMENT ThermMod_stMTReq "Status of MT-circuit request for thermal coordination" UBYTE ThermMod_stMTReq_VERB 1 100 0.00 2.00000000000 FORMAT "%13.11" ECU_ADDRESS 0x60022F83
 /begin IF_DATA XCPplus 0x0102
  /begin DAQ_EVENT VARIABLE /end DAQ_EVENT
 /end IF_DATA
/end MEASUREMENT
/begin MEASUREMENT ThermMod_stVehOpMod "actual vehicle operation mode used for the scode block" UBYTE ThermMod_stVehOpMod_VERB 1 100 0.00 6.00000000000 FORMAT "%13.11" ECU_ADDRESS 0x60022F82
 /begin IF_DATA XCPplus 0x0102
  /begin DAQ_EVENT VARIABLE /end DAQ_EVENT
 /end IF_DATA
/end MEASUREMENT
/begin MEASUREMENT VehCoorn_dstRngPredTx "Maximum distance covered with available charge in Km" SLONG RBPtCel_dst_1p0_4 1 100 0.00 500.000000000 FORMAT "%13.9" ECU_ADDRESS 0x60000F38
 /begin IF_DATA XCPplus 0x0102
  /begin DAQ_EVENT VARIABLE /end DAQ_EVENT
 /end IF_DATA
/end MEASUREMENT
/begin MEASUREMENT VehCoorn_wCnsTotWghtTx "Ride power consumption trip" UWORD q1_Wh_DIV_km 1 100 0.00 500.0000 FORMAT "%8.4" ECU_ADDRESS 0x6001FA1A
 /begin IF_DATA XCPplus 0x0102
  /begin DAQ_EVENT VARIABLE /end DAQ_EVENT
 /end IF_DATA
/end MEASUREMENT
/begin MEASUREMENT _flgChrgNmComReq "Network activation in case of Charging functionality" UBYTE B_TRUE 1 100 0.00 1.00000000000 BIT_MASK 0x1 FORMAT "%13.11" ECU_ADDRESS 0x60022F97
 /begin IF_DATA XCPplus 0x0102
  /begin DAQ_EVENT VARIABLE /end DAQ_EVENT
 /end IF_DATA
/end MEASUREMENT
/begin FUNCTION SWAdp_PSA "Software Adapter for PSA Modules"
 /begin DEF_CHARACTERISTIC CAN_tiHoldNwCom_C ComChrgr_flgChrgrErrLvl_C ComChrgr_stChrgr_CUR ComChrg_stMod_Cur ComEmac_dtqAbstMaxRmpNeg_C ComEmac_dtqAbstMaxRmpPos_MAP ComEmac_stMod_CUR ComEmac_tqAbstMaxThd_CUR CommDev_tiPostOperationWkuPls_C Com_AllwChrgnLwSOC_C Com_egyHvbAvl_SqDelay_C Com_flgAllwChrgnPrkBrkOff_C Com_iHvbActMeasdInv_C Com_pwrMaxDchaSho_C Com_qHvbTotCp_C Com_stCmdHvBattCntctr_CUR Com_stDcdcOperModAct_CUR Com_stDcdcShutoffErr_C Com_stDcdcShutoffErr_Sq_C Com_stDcdcT30C_C Com_stDcdcT30C_Sq_C Com_stDcdcVltgErr_C Com_stDcdcVltgErr_Sq_C Com_stDrvDoor_C Com_stDrvModPosn_CUR Com_stHvBattOperModDes_CUR Com_stHvbFlt1_C Com_stHvbFlt2_C Com_stHvbFlt3_C Com_stHvbFltLvl_C Com_stHvbMod_CUR Com_stSoc_CUR Com_tiPostOperationWkuReqEmgyDly_C Com_tiPostOperationWkuReq_C DDRC_DurDeb.Com_tiACCmprFltLvlRes_CDebOk_C DDRC_DurDeb.Com_tiACCmprFltLvlRes_CDebDef_C DDRC_DurDeb.Com_tiAdpActvDChaFailr_CDebOk_C DDRC_DurDeb.Com_tiAdpActvDChaFailr_CDebDef_C DDRC_DurDeb.Com_tiAirbcuFlt_CDebOk_C DDRC_DurDeb.Com_tiAirbcuFlt_CDebDef_C DDRC_DurDeb.Com_tiBrkSwtFlt_CDebOk_C DDRC_DurDeb.Com_tiBrkSwtFlt_CDebDef_C DDRC_DurDeb.Com_tiComBrkMai_CDebOk_C DDRC_DurDeb.Com_tiComBrkMai_CDebDef_C DDRC_DurDeb.Com_tiComDcdcFltLvl2_CDebOk_C DDRC_DurDeb.Com_tiComDcdcFltLvl2_CDebDef_C DDRC_DurDeb.Com_tiComDcdcFltLvl3_CDebOk_C DDRC_DurDeb.Com_tiComDcdcFltLvl3_CDebDef_C DDRC_DurDeb.Com_tiComDcdcFltLvl4_CDebOk_C DDRC_DurDeb.Com_tiComDcdcFltLvl4_CDebDef_C DDRC_DurDeb.Com_tiComDcdcFltLvl5_CDebOk_C DDRC_DurDeb.Com_tiComDcdcFltLvl5_CDebDef_C DDRC_DurDeb.Com_tiComDcdcFltLvlRes_CDebOk_C DDRC_DurDeb.Com_tiComDcdcFltLvlRes_CDebDef_C DDRC_DurDeb.Com_tiComElMIIvtrFltLvl2_CDebOk_C DDRC_DurDeb.Com_tiComElMIIvtrFltLvl2_CDebDef_C DDRC_DurDeb.Com_tiComElMIIvtrFltLvl3_CDebOk_C DDRC_DurDeb.Com_tiComElMIIvtrFltLvl3_CDebDef_C DDRC_DurDeb.Com_tiComElMIIvtrFltLvlRes_CDebOk_C DDRC_DurDeb.Com_tiComElMIIvtrFltLvlRes_CDebDef_C DDRC_DurDeb.Com_tiComGunCntInfoWkuReq_CDebOk_C DDRC_DurDeb.Com_tiComGunCntInfoWkuReq_CDebDef_C DDRC_DurDeb.Com_tiComHillHldFlt_CDebOk_C DDRC_DurDeb.Com_tiComHillHldFlt_CDebDef_C DDRC_DurDeb.Com_tiComHvBattRchrgWkuReq_CDebOk_C DDRC_DurDeb.Com_tiComHvBattRchrgWkuReq_CDebDef_C DDRC_DurDeb.Com_tiComHvbFltLvl2_CDebOk_C DDRC_DurDeb.Com_tiComHvbFltLvl2_CDebDef_C DDRC_DurDeb.Com_tiComHvbFltLvl3_CDebOk_C DDRC_DurDeb.Com_tiComHvbFltLvl3_CDebDef_C DDRC_DurDeb.Com_tiComHvbFltLvl4_CDebOk_C DDRC_DurDeb.Com_tiComHvbFltLvl4_CDebDef_C DDRC_DurDeb.Com_tiComHvbFltLvl5_CDebOk_C DDRC_DurDeb.Com_tiComHvbFltLvl5_CDebDef_C DDRC_DurDeb.Com_tiComHvbFltLvlRes_CDebOk_C DDRC_DurDeb.Com_tiComHvbFltLvlRes_CDebDef_C DDRC_DurDeb.Com_tiComImmoUnlockWkuReq_CDebOk_C DDRC_DurDeb.Com_tiComImmoUnlockWkuReq_CDebDef_C DDRC_DurDeb.Com_tiComInfoReqPtlWkuReq_CDebOk_C DDRC_DurDeb.Com_tiComInfoReqPtlWkuReq_CDebDef_C DDRC_DurDeb.Com_tiComOBCFltLvl2_CDebOk_C DDRC_DurDeb.Com_tiComOBCFltLvl2_CDebDef_C DDRC_DurDeb.Com_tiComOBCFltLvl3_CDebOk_C DDRC_DurDeb.Com_tiComOBCFltLvl3_CDebDef_C DDRC_DurDeb.Com_tiComOBCFltLvl4_CDebOk_C DDRC_DurDeb.Com_tiComOBCFltLvl4_CDebDef_C DDRC_DurDeb.Com_tiComOBCFltLvl5_CDebOk_C DDRC_DurDeb.Com_tiComOBCFltLvl5_CDebDef_C DDRC_DurDeb.Com_tiComOBCFltLvlRes_CDebOk_C DDRC_DurDeb.Com_tiComOBCFltLvlRes_CDebDef_C DDRC_DurDeb.Com_tiComPostOperationWkuReq_CDebOk_C DDRC_DurDeb.Com_tiComPostOperationWkuReq_CDebDef_C DDRC_DurDeb.Com_tiComPreCondElecWkuReq_CDebOk_C DDRC_DurDeb.Com_tiComPreCondElecWkuReq_CDebDef_C DDRC_DurDeb.Com_tiComRemUnlckWkuReq_CDebOk_C DDRC_DurDeb.Com_tiComRemUnlckWkuReq_CDebDef_C DDRC_DurDeb.Com_tiComStpDlyHMIWkuReq_CDebOk_C DDRC_DurDeb.Com_tiComStpDlyHMIWkuReq_CDebDef_C DDRC_DurDeb.Com_tiComVehVCanErr_CDebOk_C DDRC_DurDeb.Com_tiComVehVCanErr_CDebDef_C DDRC_DurDeb.Com_tiHvbSVSBlink_CDebOk_C DDRC_DurDeb.Com_tiHvbSVSBlink_CDebDef_C DDRC_DurDeb.Com_tiHvbSVSCont_CDebOk_C DDRC_DurDeb.Com_tiHvbSVSCont_CDebDef_C DDRC_DurDeb.Com_tiPDUProgmFailr_CDebOk_C DDRC_DurDeb.Com_tiPDUProgmFailr_CDebDef_C DDRC_DurDeb.Com_tiPwrMaxDchaShoLo_CDebOk_C DDRC_DurDeb.Com_tiPwrMaxDchaShoLo_CDebDef_C DDRC_DurDeb.Com_tiVehVCanAvl_CDebOk_C DDRC_DurDeb.Com_tiVehVCanAvl_CDebDef_C DDRC_DurDeb.Com_tieTogFailrLvlRes_CDebOk_C DDRC_DurDeb.Com_tieTogFailrLvlRes_CDebDef_C DDRC_DurDeb.Com_tiflgBrkMaiDiag_CDebOk_C DDRC_DurDeb.Com_tiflgBrkMaiDiag_CDebDef_C DDRC_DurDeb.Com_tistHvbIsoMeasmtRes_CDebOk_C DDRC_DurDeb.Com_tistHvbIsoMeasmtRes_CDebDef_C DFC_CtlMsk2.DFC_ACCmprFltLvlRes_C DFC_CtlMsk2.DFC_AdpActvDChaFailr_C DFC_CtlMsk2.DFC_AirbcuFlt_C DFC_CtlMsk2.DFC_BrkSwtFlt_C DFC_CtlMsk2.DFC_ComBrkMai_C DFC_CtlMsk2.DFC_ComDcdcFltLvl2_C DFC_CtlMsk2.DFC_ComDcdcFltLvl3_C DFC_CtlMsk2.DFC_ComDcdcFltLvl4_C DFC_CtlMsk2.DFC_ComDcdcFltLvl5_C DFC_CtlMsk2.DFC_ComDcdcFltLvlRes_C DFC_CtlMsk2.DFC_ComElMIIvtrFltLvl2_C DFC_CtlMsk2.DFC_ComElMIIvtrFltLvl3_C DFC_CtlMsk2.DFC_ComElMIIvtrFltLvlRes_C DFC_CtlMsk2.DFC_ComGunCntInfoWkuReq_C DFC_CtlMsk2.DFC_ComHillHldFlt_C DFC_CtlMsk2.DFC_ComHvBattRchrgWkuReq_C DFC_CtlMsk2.DFC_ComHvbFltLvl2_C DFC_CtlMsk2.DFC_ComHvbFltLvl3_C DFC_CtlMsk2.DFC_ComHvbFltLvl4_C DFC_CtlMsk2.DFC_ComHvbFltLvl5_C DFC_CtlMsk2.DFC_ComHvbFltLvlRes_C DFC_CtlMsk2.DFC_ComImmoUnlockWkuReq_C DFC_CtlMsk2.DFC_ComInfoReqPtlWkuReq_C DFC_CtlMsk2.DFC_ComOBCFltLvl2_C DFC_CtlMsk2.DFC_ComOBCFltLvl3_C DFC_CtlMsk2.DFC_ComOBCFltLvl4_C DFC_CtlMsk2.DFC_ComOBCFltLvl5_C DFC_CtlMsk2.DFC_ComOBCFltLvlRes_C DFC_CtlMsk2.DFC_ComPostOperationWkuReq_C DFC_CtlMsk2.DFC_ComPreCondElecWkuReq_C DFC_CtlMsk2.DFC_ComRemUnlckWkuReq_C DFC_CtlMsk2.DFC_ComStpDlyHMIWkuReq_C DFC_CtlMsk2.DFC_HvbSVSBlink_C DFC_CtlMsk2.DFC_HvbSVSCont_C DFC_CtlMsk2.DFC_PDUProgmFailr_C DFC_CtlMsk2.DFC_PwrMaxDchaShoLo_C DFC_CtlMsk2.DFC_VehVCanAvl_C DFC_CtlMsk2.DFC_VehVCanErr_C DFC_CtlMsk2.DFC_eTogFailrLvlRes_C DFC_CtlMsk2.DFC_flgBrkMaiDiag_C DFC_CtlMsk2.DFC_stHvbIsoMeasmtRes_C DFC_CtlMsk2.DFC_ResetRcvNotAllwd_C DFC_DisblMsk2.DFC_ACCmprFltLvlRes_C DFC_DisblMsk2.DFC_AdpActvDChaFailr_C DFC_DisblMsk2.DFC_AirbcuFlt_C DFC_DisblMsk2.DFC_BrkSwtFlt_C DFC_DisblMsk2.DFC_ComBrkMai_C DFC_DisblMsk2.DFC_ComDcdcFltLvl2_C DFC_DisblMsk2.DFC_ComDcdcFltLvl3_C DFC_DisblMsk2.DFC_ComDcdcFltLvl4_C DFC_DisblMsk2.DFC_ComDcdcFltLvl5_C DFC_DisblMsk2.DFC_ComDcdcFltLvlRes_C DFC_DisblMsk2.DFC_ComElMIIvtrFltLvl2_C DFC_DisblMsk2.DFC_ComElMIIvtrFltLvl3_C DFC_DisblMsk2.DFC_ComElMIIvtrFltLvlRes_C DFC_DisblMsk2.DFC_ComGunCntInfoWkuReq_C DFC_DisblMsk2.DFC_ComHillHldFlt_C DFC_DisblMsk2.DFC_ComHvBattRchrgWkuReq_C DFC_DisblMsk2.DFC_ComHvbFltLvl2_C DFC_DisblMsk2.DFC_ComHvbFltLvl3_C DFC_DisblMsk2.DFC_ComHvbFltLvl4_C DFC_DisblMsk2.DFC_ComHvbFltLvl5_C DFC_DisblMsk2.DFC_ComHvbFltLvlRes_C DFC_DisblMsk2.DFC_ComImmoUnlockWkuReq_C DFC_DisblMsk2.DFC_ComInfoReqPtlWkuReq_C DFC_DisblMsk2.DFC_ComOBCFltLvl2_C DFC_DisblMsk2.DFC_ComOBCFltLvl3_C DFC_DisblMsk2.DFC_ComOBCFltLvl4_C DFC_DisblMsk2.DFC_ComOBCFltLvl5_C DFC_DisblMsk2.DFC_ComOBCFltLvlRes_C DFC_DisblMsk2.DFC_ComPostOperationWkuReq_C DFC_DisblMsk2.DFC_ComPreCondElecWkuReq_C DFC_DisblMsk2.DFC_ComRemUnlckWkuReq_C DFC_DisblMsk2.DFC_ComStpDlyHMIWkuReq_C DFC_DisblMsk2.DFC_HvbSVSBlink_C DFC_DisblMsk2.DFC_HvbSVSCont_C DFC_DisblMsk2.DFC_PDUProgmFailr_C DFC_DisblMsk2.DFC_PwrMaxDchaShoLo_C DFC_DisblMsk2.DFC_VehVCanAvl_C DFC_DisblMsk2.DFC_VehVCanErr_C DFC_DisblMsk2.DFC_eTogFailrLvlRes_C DFC_DisblMsk2.DFC_flgBrkMaiDiag_C DFC_DisblMsk2.DFC_stHvbIsoMeasmtRes_C DFC_DisblMsk2.DFC_ResetRcvNotAllwd_C DrvDoor_SelSig_C HvBattBlwrThres_C HvBatt_iActMeasdMax_C HvBatt_iActMeasdMin_C HvbTotCp_CalSelSig_C LIN_tiHoldNwCom_C LVBATTBLWRDIS_C Reset_nrRstRcvAllwd_C Reset_tiRstFlgHld_C SWAdp_PSA_T15OffTimer_C SWAdp_PSA_T15OnTimer_C VehCoorn_maskIgnPosnVldy1Sq_C /end DEF_CHARACTERISTIC
 /begin IN_MEASUREMENT APP_r Brk_st Brk_st_Sq B_rcd_msg CanEif_bMode CbnHeatgSwt_stAct ChrgCntct_nrNegCntctOper ChrgCntct_nrPosCntctOper ChrgCntct_st ChrgMod_stChrgn ChrgMod_stMod ChrgPlg_stPlg ChrgrSt_stChrgnEna ComChrgr_flgChrgrErrLvl ComChrgr_stChrgrRx ComEmac_nAct01 ComEmac_stHillHld ComEmac_stMod01Rx ComEmac_tqAbsltMaxRx01 ComEmac_tqAbsltMinRx01 Com_bGunCntInfoWkuReq Com_bHvBattRchrgWkuReq Com_bImmoUnlockWkuReq Com_bInfoReqPtlWkuReq Com_bOBCClgWkuReq Com_bPreCondElecWkuReq Com_bPreDrvWkuReq Com_bRemUnlckWkuReq Com_bStpDlyHMIWkuReq Com_bTBoxPtlWkuReq Com_flgBrkMaiDiag Com_flgGunUnlckReq Com_flgHvBattAuthn Com_flgPDUProgmFailr Com_flgVehSpdAvl Com_iBattEBS1Rx Com_iBattEBS2Rx Com_iBattEBS3Rx Com_iHvbActRx Com_iHvbChrgMaxSho Com_iHvbDchaMaxSho Com_nElCmprActl Com_pwrMaxChrgSho Com_pwrMaxDchaSho Com_qHvbTotCpRx Com_ratHvbSoc Com_stABSActv Com_stAC Com_stAirbCrashSev Com_stAlrtThermRunAwy Com_stDcdcFltLvl Com_stDcdcOperModActRx Com_stDoor1 Com_stDoor2 Com_stDoor3 Com_stDoor4 Com_stDrvStBltRx Com_stElCmprFltLvl Com_stElCmprStat Com_steTogFailrLvl Com_stHvbCnctn Com_stHvbDiscnctReas Com_stHvbFltLvl Com_stHvbIntlckRx Com_stHvbIsoFltRx Com_stHvbIsoMeasmtActv Com_stHvbModRx Com_stHvbMod_Sq Com_stHvbNegCntct Com_stHvbPosCntct Com_stHvbSrvPlgRx Com_stHvbSVSLmp Com_stIBattEBS Com_stIgnkeyPos Com_stIIvtrFltLvl01 Com_stPrkBrkRx Com_stSocRx Com_stT50 Com_tLvBatt Com_uBattEBSRx Com_uHvbAct CoPOM_tqWhlQstyMax DrvModSeln_stReq DrvMod_stPosn Eem_flgFstHvShdwn Eem_flgProlgEcuActvPost Eem_flgProlgEcuActvPre Eem_flgSetMaiSwtHvBattClsd ElM_stDesEemInt01 ElM_stOperModAct01 ElM_t01 Emac_nAct01 GlbDa_bChrgnSockCfg HeatrRly1_st HvacMod_stPtc HvBatt_iActMeasd HvBatt_ratSoc HvBatt_ratSoc_Sq HvBatt_stOperModDes rba_SyC_bWkuMain Reset_Env_ctRst StrtUpEv_flgDrvAwyDi StrtUpEv_stDrvAwyDi SyC_stRCD SyC_stSub T15_st ThermCoorn_stCtrl ThermHvac_stRemPrecndnInt TrsmEmac_ratTqPrimAxle TrsmEmac_tqLoss01 VehCoorn_dstRngPred VehCoorn_flgChrgReq VehCoorn_st VehCoorn_wCnsTotWght VehV_v_Sq /end IN_MEASUREMENT
 /begin OUT_MEASUREMENT AirBgECU_stAirBg APP_rInp BattId_numOrganNature1 BattId_numOrganNature2 BattId_numOrganRef1 BattId_numOrganRef2 BattId_numOrganRef3 BattId_numOrganRef4 BattId_numSerl1 BattId_numSerl2 BattId_numSerl3 BattId_numSerl4 BattId_numSerl5 BattId_numSerl6 BattId_numSerl7 ChrgrRly_stRlyDes CoDrvPITh_stEPSModeReq ComChrgn_iDcRly_Sq ComChrgn_uDcRly_Sq ComChrgr_flgChrgrErr ComChrgr_flgChrgrErr_Sq ComChrgr_iAcMax_Sq ComChrgr_iDcHvAct_Sq ComChrgr_pwrInAct_Sq ComChrgr_stChrgnEna ComChrgr_stChrgr ComChrgr_stChrgr_Sq ComChrgr_tChrgrMaxAct_Sq ComChrgr_uAcActL1_Sq ComChrgr_uDcHvAct_Sq ComChrg_stMod ComEmac_flgEmgyShtDwnReq01 ComEmac_flgImobAuthent_Sq ComEmac_stIsoMonSwtAck_Sq ComEmac_stMod01 ComEmac_stPwrAuthn_Sq ComEmac_tqAbsltMax01 ComEmac_tqAbsltMin01 CommDev_bPostOperationWkuPls Com_bCAN1ComNd Com_bCAN2ComNd Com_bCAN3ComNd Com_bfPtlWkuReq Com_bLINComNd Com_bLINComReq Com_bPostOperationWkuReq Com_egyHvbAvl_Sq Com_flgBlowrAuthn Com_flgChrgnStopAndUnlckReq Com_flgDrvAwy Com_flgHillHldActvd Com_flgVehSpdQly Com_iBattEBS Com_iDcdcHvActRvsn1_Sq Com_iDcdcLvActRvsn1_Sq Com_iHvbAct Com_iHvbActTx Com_nElCmprActlTx Com_nIvtrMotAct01 Com_pwrMaxChrgContns Com_pwrMaxChrgContns_Sq Com_pwrMaxChrgSho_Sq Com_pwrMaxDchaContns Com_pwrMaxDchaContns_Sq Com_pwrMaxDchaSho_Sq Com_qHvbTotCp Com_ratHvbSoh_Sq Com_stACTx Com_stBrk Com_stCAN1ComReq Com_stCAN2ComReq Com_stCAN3ComReq Com_stChrgPlg Com_stChrgPlgChrgn Com_stClstrStopIndcn Com_stCmdHvBattCntctr Com_stDcdcOperModAct Com_stDcdcOperModAct_Sq Com_stDcdcShutoffErr Com_stDcdcShutoffErr_Sq Com_stDcdcT30C Com_stDcdcT30C_Sq Com_stDcdcULimReq_Sq Com_stDcdcVltgErr Com_stDcdcVltgErr_Sq Com_stDrvAwyDi Com_stDrvDoor Com_stDrvModPosn Com_stDrvStblt Com_stElCmprStatTx Com_stElMDesEem Com_stHvBattOperModDes Com_stHvbChrgFlt Com_stHvbCntct Com_stHvbFlt Com_stHvbIntlck Com_stHvbIsoFlt Com_stHvbMod Com_stHvbSrvPlg Com_stIgnkeyPos_Sq Com_stMainWkuInvld Com_stPckCnctn Com_stPrkBrk Com_stSoc Com_stVehCoorn Com_tBattEBS Com_tDcdcAct_Sq Com_tDcdcInltCoolt_Sq Com_tqMotLimMax Com_uBattEBS Com_uDcdcHvAct_Sq Com_uDcdcLvAct_Sq Com_uHvbActTx Com_uHvbChrgMaxSho Com_uHvbDchaMaxSho CoPtFH_stPwt ct_Ary_flg0 ct_Ary_flg1 ct_Ary_flg10 ct_Ary_flg11 ct_Ary_flg12 ct_Ary_flg2 ct_Ary_flg3 ct_Ary_flg4 ct_Ary_flg5 ct_Ary_flg6 ct_Ary_flg7 ct_Ary_flg8 ct_Ary_flg9 DcChrgnRly_ctMaxOperCyc DDRC_St.DFC_ACCmprFltLvlRes DDRC_St.DFC_AdpActvDChaFailr DDRC_St.DFC_AirbcuFlt DDRC_St.DFC_BrkSwtFlt DDRC_St.DFC_ComBrkMai DDRC_St.DFC_ComDcdcFltLvl2 DDRC_St.DFC_ComDcdcFltLvl3 DDRC_St.DFC_ComDcdcFltLvl4 DDRC_St.DFC_ComDcdcFltLvl5 DDRC_St.DFC_ComDcdcFltLvlRes DDRC_St.DFC_ComElMIIvtrFltLvl2 DDRC_St.DFC_ComElMIIvtrFltLvl3 DDRC_St.DFC_ComElMIIvtrFltLvlRes DDRC_St.DFC_ComGunCntInfoWkuReq DDRC_St.DFC_ComHillHldFlt DDRC_St.DFC_ComHvBattRchrgWkuReq DDRC_St.DFC_ComHvbFltLvl2 DDRC_St.DFC_ComHvbFltLvl3 DDRC_St.DFC_ComHvbFltLvl4 DDRC_St.DFC_ComHvbFltLvl5 DDRC_St.DFC_ComHvbFltLvlRes DDRC_St.DFC_ComImmoUnlockWkuReq DDRC_St.DFC_ComInfoReqPtlWkuReq DDRC_St.DFC_ComOBCFltLvl2 DDRC_St.DFC_ComOBCFltLvl3 DDRC_St.DFC_ComOBCFltLvl4 DDRC_St.DFC_ComOBCFltLvl5 DDRC_St.DFC_ComOBCFltLvlRes DDRC_St.DFC_ComPostOperationWkuReq DDRC_St.DFC_ComPreCondElecWkuReq DDRC_St.DFC_ComRemUnlckWkuReq DDRC_St.DFC_ComStpDlyHMIWkuReq DDRC_St.DFC_HvbSVSBlink DDRC_St.DFC_HvbSVSCont DDRC_St.DFC_PDUProgmFailr DDRC_St.DFC_PwrMaxDchaShoLo DDRC_St.DFC_VehVCanAvl DDRC_St.DFC_VehVCanErr DDRC_St.DFC_eTogFailrLvlRes DDRC_St.DFC_flgBrkMaiDiag DDRC_St.DFC_stHvbIsoMeasmtRes DFC_st.DFC_ACCmprFltLvlRes DFC_st.DFC_AdpActvDChaFailr DFC_st.DFC_AirbcuFlt DFC_st.DFC_BrkSwtFlt DFC_st.DFC_ComBrkMai DFC_st.DFC_ComDcdcFltLvl2 DFC_st.DFC_ComDcdcFltLvl3 DFC_st.DFC_ComDcdcFltLvl4 DFC_st.DFC_ComDcdcFltLvl5 DFC_st.DFC_ComDcdcFltLvlRes DFC_st.DFC_ComElMIIvtrFltLvl2 DFC_st.DFC_ComElMIIvtrFltLvl3 DFC_st.DFC_ComElMIIvtrFltLvlRes DFC_st.DFC_ComGunCntInfoWkuReq DFC_st.DFC_ComHillHldFlt DFC_st.DFC_ComHvBattRchrgWkuReq DFC_st.DFC_ComHvbFltLvl2 DFC_st.DFC_ComHvbFltLvl3 DFC_st.DFC_ComHvbFltLvl4 DFC_st.DFC_ComHvbFltLvl5 DFC_st.DFC_ComHvbFltLvlRes DFC_st.DFC_ComImmoUnlockWkuReq DFC_st.DFC_ComInfoReqPtlWkuReq DFC_st.DFC_ComOBCFltLvl2 DFC_st.DFC_ComOBCFltLvl3 DFC_st.DFC_ComOBCFltLvl4 DFC_st.DFC_ComOBCFltLvl5 DFC_st.DFC_ComOBCFltLvlRes DFC_st.DFC_ComPostOperationWkuReq DFC_st.DFC_ComPreCondElecWkuReq DFC_st.DFC_ComRemUnlckWkuReq DFC_st.DFC_ComStpDlyHMIWkuReq DFC_st.DFC_HvbSVSBlink DFC_st.DFC_HvbSVSCont DFC_st.DFC_PDUProgmFailr DFC_st.DFC_PwrMaxDchaShoLo DFC_st.DFC_VehVCanAvl DFC_st.DFC_VehVCanErr DFC_st.DFC_eTogFailrLvlRes DFC_st.DFC_flgBrkMaiDiag DFC_st.DFC_stHvbIsoMeasmtRes DFC_st.DFC_ResetRcvNotAllwd DINH_nrActvInhReas.FId_ChrgnLmpChrgnFlt DINH_nrActvInhReas.FId_ChrgnLmpNoChrgn DINH_nrActvInhReas.FId_ComHillHldFrmErr DINH_nrActvInhReas.FId_Com_stMainWkuInvld DINH_nrActvInhReas.FId_bInh_ComChrgn_iDcRly_Sq_Frz DINH_nrActvInhReas.FId_bInh_ComChrgn_uDcRly_Sq_Frz DINH_nrActvInhReas.FId_bInh_ComChrgr_flgChrgrErr_Sq_Frz DINH_nrActvInhReas.FId_bInh_ComChrgr_iAcMax_Sq_Frz DINH_nrActvInhReas.FId_bInh_ComChrgr_iDcHvAct_Sq_Frz DINH_nrActvInhReas.FId_bInh_ComChrgr_pwrInAct_Sq_Frz DINH_nrActvInhReas.FId_bInh_ComChrgr_stChrgr_Sq_Frz DINH_nrActvInhReas.FId_bInh_ComChrgr_tChrgrMaxAct_Sq_Frz DINH_nrActvInhReas.FId_bInh_ComChrgr_uAcActL1_Sq_Frz DINH_nrActvInhReas.FId_bInh_ComChrgr_uDcHvAct_Sq_Frz DINH_nrActvInhReas.FId_bInh_Com_iDcdcHvActRvsn1_Sq_Frz DINH_nrActvInhReas.FId_bInh_Com_iDcdcLvActRvsn1_Sq_Frz DINH_nrActvInhReas.FId_bInh_Com_ratHvbSoh_Sq_Frz DINH_nrActvInhReas.FId_bInh_Com_stDcdcOperModAct_Sq_Frz DINH_nrActvInhReas.FId_bInh_Com_tDcdcAct_Sq_Frz DINH_nrActvInhReas.FId_bInh_Com_tDcdcInltCoolt_Sq DINH_nrActvInhReas.FId_bInh_Com_uDcdcHvAct_Sq_Frz DINH_nrActvInhReas.FId_bInh_Com_uDcdcLvAct_Sq_Frz DINH_nrActvInhReas.FId_bInh_Pdu_Com_pwrMaxChrgSho_Sq_Frz DINH_nrActvInhReas.FId_bInh_Pdu_Com_pwrMaxDchaSho_Sq_Frz DINH_nrActvInhReas.FId_bInh_Pdu_VCU_AIRBAG_fault_Frz DINH_nrActvInhReas.FId_bInh_Sig_ComEmac_flgImobAuthent_Sq_Frz DINH_nrActvInhReas.FId_bInh_Sig_ComEmac_stIsoMonSwtAck_Sq_Frz DINH_nrActvInhReas.FId_bInh_Sig_ComEmac_stPwrAuthn_Sq_Frz DINH_nrActvInhReas.FId_bInh_Sig_Com_stDcdcULimReq_Sq_Frz DINH_nrActvInhReas.FId_bInh_Sig_Com_stIgnkeyPos_Sq_Frz DINH_nrActvInhReas.FId_binnh_Sig_Com_egyHvbAvl_Sq_Frz DINH_stFId.FId_ChrgnLmpChrgnFlt DINH_stFId.FId_ChrgnLmpNoChrgn DINH_stFId.FId_ComHillHldFrmErr DINH_stFId.FId_Com_stMainWkuInvld DINH_stFId.FId_bInh_ComChrgn_iDcRly_Sq_Frz DINH_stFId.FId_bInh_ComChrgn_uDcRly_Sq_Frz DINH_stFId.FId_bInh_ComChrgr_flgChrgrErr_Sq_Frz DINH_stFId.FId_bInh_ComChrgr_iAcMax_Sq_Frz DINH_stFId.FId_bInh_ComChrgr_iDcHvAct_Sq_Frz DINH_stFId.FId_bInh_ComChrgr_pwrInAct_Sq_Frz DINH_stFId.FId_bInh_ComChrgr_stChrgr_Sq_Frz DINH_stFId.FId_bInh_ComChrgr_tChrgrMaxAct_Sq_Frz DINH_stFId.FId_bInh_ComChrgr_uAcActL1_Sq_Frz DINH_stFId.FId_bInh_ComChrgr_uDcHvAct_Sq_Frz DINH_stFId.FId_bInh_Com_iDcdcHvActRvsn1_Sq_Frz DINH_stFId.FId_bInh_Com_iDcdcLvActRvsn1_Sq_Frz DINH_stFId.FId_bInh_Com_ratHvbSoh_Sq_Frz DINH_stFId.FId_bInh_Com_stDcdcOperModAct_Sq_Frz DINH_stFId.FId_bInh_Com_tDcdcAct_Sq_Frz DINH_stFId.FId_bInh_Com_tDcdcInltCoolt_Sq DINH_stFId.FId_bInh_Com_uDcdcHvAct_Sq_Frz DINH_stFId.FId_bInh_Com_uDcdcLvAct_Sq_Frz DINH_stFId.FId_bInh_Pdu_Com_pwrMaxChrgSho_Sq_Frz DINH_stFId.FId_bInh_Pdu_Com_pwrMaxDchaSho_Sq_Frz DINH_stFId.FId_bInh_Pdu_VCU_AIRBAG_fault_Frz DINH_stFId.FId_bInh_Sig_ComEmac_flgImobAuthent_Sq_Frz DINH_stFId.FId_bInh_Sig_ComEmac_stIsoMonSwtAck_Sq_Frz DINH_stFId.FId_bInh_Sig_ComEmac_stPwrAuthn_Sq_Frz DINH_stFId.FId_bInh_Sig_Com_stDcdcULimReq_Sq_Frz DINH_stFId.FId_bInh_Sig_Com_stIgnkeyPos_Sq_Frz DINH_stFId.FId_binnh_Sig_Com_egyHvbAvl_Sq_Frz HvacPtc_stElHeatr Reset_flgECURstOcc StabyIntv_flgAbsIntv01 SWAdp_flgChrgNmComReq T50_st VehCoorn_dstRngPredTx VehCoorn_wCnsTotWghtTx /end OUT_MEASUREMENT
 /begin LOC_MEASUREMENT Com_bCANComNdLoc1 Com_bRstDetdLoc Com_flgT15ChrgnStopAndUnlckReq com_postoperationwkuplsloc Com_tiRstHldLoc SWAdp_bCANComNdLoc SWAdp_bLINComNdLoc SWAdp_BrkSwtFltLoc SWAdp_ComChrgr_pwrInAct_Loc SWAdp_ComDcdcFltLvl2Loc SWAdp_ComDcdcFltLvl3Loc SWAdp_ComElMIIvtrFltLvl2Loc SWAdp_ComElMIIvtrFltLvl3Loc SWAdp_ComHvbFltLvl2Loc SWAdp_Com_stHvbMod_SqLoc swadp_ebslvbattsocdiagloLoc swadp_eeprambuffer swadp_eeprambuffer1 swadp_eeprambuffer10 swadp_eeprambuffer11 swadp_eeprambuffer12 swadp_eeprambuffer2 swadp_eeprambuffer3 swadp_eeprambuffer4 swadp_eeprambuffer5 swadp_eeprambuffer6 swadp_eeprambuffer7 swadp_eeprambuffer8 swadp_eeprambuffer9 SWAdp_egyHvbAvlDly_Loc SWAdp_egyHvbAvl_SqDelayLoc SWAdp_egyHvbAvl_SqLoc SWAdp_egyHvbAvl_SqLoc_1 SWAdp_flgChrgrErrLoc SWAdp_flgImobAuthent_SqLoc SWAdp_HvbSVSBlinkLoc SWAdp_HvbSVSContLoc SWAdp_iAcMax_SqLoc SWAdp_iDcdcHvActRvsn1_sqLoc SWAdp_iDcdcLvActRvsn1_SqLoc SWAdp_iDcHvAct_SqLoc SWAdp_iDcRly_SqLoc SWAdp_PSA_tqAbsltMaxOldLoc SWAdp_PSA_tqmaxLoc SWAdp_pwrMaxChrgSho_SqLoc SWAdp_PwrMaxDchaShoLoLoc SWAdp_pwrMaxDchaSho_SqLoc SWAdp_ratHvbSoh_SqLoc SWAdp_stChrgr_SqLoc SWAdp_stDcdcOperModAct_SqLoc SWAdp_stDcdcULimReq_SqLoc swadp_stIgnkeyPos_SqLoc SWAdp_stIsoMonSwtAck_SqLoc SWAdp_stModLoc SWAdp_stPosnLoc SWAdp_stPwrAuthn_SqLoc swadp_strlydes1Loc swadp_strlydes2Loc swadp_strlydesLoc SWAdp_tChrgrMaxAct_SqLoc SWAdp_tDcdcAct_SqLoc SWAdp_tDcdcInltCoolt_SqLoc SWAdp_uAcActL1_SqLoc SWAdp_uDcdcHvAct_SqLoc SWAdp_uDcdcLvAct_SqLoc SWAdp_uDcHvAct_SqLoc SWAdp_uDcRly_SqLoc SWAP_PSA_T15OffTimer SWAP_PSA_T15OnTimer _flgChrgNmComReq /end LOC_MEASUREMENT
/end FUNCTION
/begin FUNCTION SyC_Vld2Lcy "3.7.0     SW Adapter System Control: Mapping Valid to Legacy Interface Elements" /begin DEF_CHARACTERISTIC SyC_tiPostDrvMin_C SyC_tiPreDrvMin_C /end DEF_CHARACTERISTIC /begin IN_MEASUREMENT CoEng_st DSM_TripChgAndClrFinshd Epm_nEng T15_st /end IN_MEASUREMENT
 /begin OUT_MEASUREMENT SyC_ctDrvEnter SyC_ctIrrSwOff SyC_ctPostDrvLeave SyC_stMn SyC_stMnOld SyC_stPostDrv SyC_stPostDrvDel SyC_stPreDrv SyC_stPreDrvDel SyC_stRCD SyC_stRCDold SyC_stSub SyC_stSubOld SyC_stVldTiEcuOff SyC_tiDrv SyC_tiEcuOff SyC_tiFrst10ms SyC_tiPostDrv SyC_tiPreDrv /end OUT_MEASUREMENT
 /begin LOC_MEASUREMENT SyC_stDrv_e SyC_stPostDrv_e SyC_stPreDrv_e SyC_stSwtOn_mp SyC_tiIniEnd_mp SyC_tiIniSyn_mp SyC_tiIni_mp /end LOC_MEASUREMENT
 FUNCTION_VERSION "3.7.0" /end FUNCTION
/begin FUNCTION T15_Vld2Lcy "1.11.0    SW Adapter Terminal15 Component Package: Mapping Valid to Legacy Interface Elements"
 /begin OUT_MEASUREMENT DSQ_st.DSQ_T15TurnOfDly T15_flgOn T15_st T15_stRaw T15_stRawTurnOffDly_Sq /end OUT_MEASUREMENT
 FUNCTION_VERSION "1.11.0" /end FUNCTION
/begin FUNCTION Telltl_Ctrl "5.3.0     coolant tell tale"
 /begin DEF_CHARACTERISTIC DFC_CtlMsk2.DFC_TelltlCooltPlaus_C DFC_DisblMsk2.DFC_TelltlCooltPlaus_C Telltl_tCooltLampChrgHi_C Telltl_tCooltLampChrgLo_C Telltl_tCooltLampDrvHi_C Telltl_tCooltLampDrvLo_C Telltl_tCooltLampIdleHi_C Telltl_tCooltLampIdleLo_C Telltl_tCooltMax_C Telltl_tCooltMin_C Telltl_tiCooltLampChrgDebHiLo_C Telltl_tiCooltLampChrgDebLoHi_C Telltl_tiCooltLampDebHiLo_C Telltl_tiCooltLampDebLoHi_C Telltl_tiCooltLampDrvDebHiLo_C Telltl_tiCooltLampDrvDebLoHi_C Telltl_tiCooltLampIdelDebHiLo_C Telltl_tiCooltLampIdleDebLoHi_C /end DEF_CHARACTERISTIC
 /begin IN_MEASUREMENT Com_bPreCondElecWkuReq Dcdc_tInCoolt Dcdc_tInCoolt_Sq ElM_tIvtrCoolt01 ElM_tIvtrCoolt01_Sq ThermLvl_tMedTCircRadDs ThermMod_stOpMod VehCoorn_st /end IN_MEASUREMENT
 /begin OUT_MEASUREMENT DFC_st.DFC_TelltlCooltPlaus DINH_nrActvInhReas.FId_TelltlCooltTErr DINH_nrActvInhReas.FId_TelltlCooltTMon DINH_stFId.FId_TelltlCooltTErr DINH_stFId.FId_TelltlCooltTMon Telltl_stReqd /end OUT_MEASUREMENT
 FUNCTION_VERSION "5.3.0" /end FUNCTION
/begin FUNCTION ThermCfg_CircDetrm "8.1.0     Configuration of the coolant circuit \ topology of the thermal system"
 /begin DEF_CHARACTERISTIC ThermCfg_ratFastSocFild_C ThermCfg_stMTCircAlc_C ThermCfg_tiAftRunEmgyOff_C ThermCfg_tiAftRunMin_C ThermCfg_vVehSpdLim_C /end DEF_CHARACTERISTIC
 /begin IN_MEASUREMENT Ebs_ratSocFild Ebs_ratSocFild_Sq Eem_flgFstHvShdwn ThermDcdc_flgAftRunReq ThermDcdc_ratPmpReq ThermElTrac_flgAftRunReq ThermElTrac_ratPmpReq ThermMod_st ThermPlinChrgr_flgAftRunReq ThermPlinChrgr_ratPmpReq VehV_v VehV_v_Sq /end IN_MEASUREMENT
 /begin OUT_MEASUREMENT ThermCfg_flgMTAftRunReq ThermCfg_ratMTPmpReq /end OUT_MEASUREMENT
 FUNCTION_VERSION "8.1.0" /end FUNCTION
/begin FUNCTION ThermCoorn_CptCtrl "7.0.0     Activation of the component control from the coordinated thermal system"
 /begin DEF_CHARACTERISTIC ThermCoorn_stCtrl_CA ThermCoorn_stHVReqMidT_CA ThermCoorn_stMTBypVlv_CA ThermCoorn_stMTFanRels_CA ThermCoorn_stMTPmp_CA ThermCoorn_tiHvacHvReqOffDly_C /end DEF_CHARACTERISTIC
 /begin IN_MEASUREMENT ThermHvac_flgRemPrecndnActv ThermMod_st /end IN_MEASUREMENT
 /begin OUT_MEASUREMENT ThermCoorn_flgHVReq ThermCoorn_flgMTFanRels ThermCoorn_stCtrl ThermCoorn_stMTBypVlvPosn ThermCoorn_stMTPmp /end OUT_MEASUREMENT
 FUNCTION_VERSION "7.0.0" /end FUNCTION
/begin FUNCTION ThermDcdc_Req "1.3.0     Calculation of the coolant flow request of the DCDC converter"
 /begin DEF_CHARACTERISTIC ThermDcdc_flgProlg_C ThermDcdc_ratCooltReqMap_T ThermDcdc_tiFil_C ThermDcdc_tProlg_C ThermDcdc_tPT1Ini_C /end DEF_CHARACTERISTIC
 /begin IN_MEASUREMENT Dcdc_tAct /end IN_MEASUREMENT
 /begin OUT_MEASUREMENT ThermDcdc_flgAftRunReq ThermDcdc_ratPmpReq /end OUT_MEASUREMENT
 /begin LOC_MEASUREMENT ThermDcdc_tFild /end LOC_MEASUREMENT
 FUNCTION_VERSION "1.3.0" /end FUNCTION
/begin FUNCTION ThermElTrac_Req "2.3.0     Thermal request of Electric traction components"
 /begin DEF_CHARACTERISTIC ThermElTrac_flgElM01Prolg_C ThermElTrac_flgEm01PwrLossProlg_C ThermElTrac_flgIvtr01Prolg_C ThermElTrac_pwrEm01Init_C ThermElTrac_pwrLossEm01_C ThermElTrac_ratCooltReqElM01_T ThermElTrac_ratCooltReqIvtr01_T ThermElTrac_ratEm01PwrLoss_C ThermElTrac_tElM01Init_C ThermElTrac_tElM01Prolg_C ThermElTrac_tiElM01T_C ThermElTrac_tiEm01PwrLossProlg_C ThermElTrac_tiEm01PwrLoss_C ThermElTrac_tiIvtr01T_C ThermElTrac_tIvtr01Init_C ThermElTrac_tIvtr01Prolg_C /end DEF_CHARACTERISTIC
 /begin IN_MEASUREMENT ElM_t01 ElM_tIvtr01 Emac_pwrLossAbslt01 /end IN_MEASUREMENT
 /begin OUT_MEASUREMENT ThermElTrac_flgAftRunReq ThermElTrac_ratPmpReq /end OUT_MEASUREMENT
 /begin LOC_MEASUREMENT ThermElTrac_flgAftRunReq01 ThermElTrac_flgAftRunReq02 ThermElTrac_pwrLossAbslt01Flt ThermElTrac_ratElM01PmpReq ThermElTrac_ratEm01AddlPmpReq ThermElTrac_ratEm01PmpReq ThermElTrac_ratEm02PmpReq ThermElTrac_ratIvtr01PmpReq ThermElTrac_tElM01Flt ThermElTrac_tIvtr01Flt /end LOC_MEASUREMENT
 FUNCTION_VERSION "2.3.0" /end FUNCTION
/begin FUNCTION ThermHvac_Req "3.2.0     Thermal request from the heating ventilation and air conditioning (Hvac) to the thermal system"
 /begin DEF_CHARACTERISTIC ThermHvac_ratHvBattSocDelta_C ThermHvac_ratHvBattSocPreCdngMin_C ThermHvac_stPrecndnDisCfg_C ThermHvac_stRemPrecndnMap_T ThermHvac_tEvaprSpDeFogMaxEco_C ThermHvac_tEvaprSpDeFogMax_C ThermHvac_tEvaprSpDeFogMinEco_C ThermHvac_tEvaprSpDeFogMin_C ThermHvac_tEvaprSpMaxEco_T ThermHvac_tEvaprSpMax_T ThermHvac_tEvaprSpMinEco_T ThermHvac_tEvaprSpMin_T ThermHvac_tiEvlnDly_C /end DEF_CHARACTERISTIC
 /begin IN_MEASUREMENT CbnHeatgSwt_stAct Com_bPreCondElecWkuReq Com_stBlowrRly Com_stHvacBlwrFront Com_stPrkBrk DrvPrgSwt_stReq HvacHmi_ratBlowrSpd HvacHmi_stAc HvacHmi_stCoolgReq HvacHmi_stHeatgReq HvBatt_ratSoc HvBatt_ratSoc_Sq MoFCbnPreCdng_flgPreHeatCanCfmMsg T15_st VehCoorn_st /end IN_MEASUREMENT
 /begin OUT_MEASUREMENT DINH_nrActvInhReas.FId_ThermHvacPreCdngFlt DINH_stFId.FId_ThermHvacPreCdngFlt ThermHvac_flgRemPrecndnActv ThermHvac_ratBlowrSpd ThermHvac_stAc ThermHvac_stFrntCoolgReq ThermHvac_stFrntHeatgReq ThermHvac_stRemPrecndn ThermHvac_stRemPrecndnInt ThermHvac_tEvaprSpMax ThermHvac_tEvaprSpMin /end OUT_MEASUREMENT
 /begin LOC_MEASUREMENT ThermHvac_flgPreCdngSocSuff ThermHvac_tiEvlnDly /end LOC_MEASUREMENT
 FUNCTION_VERSION "3.2.0" /end FUNCTION
/begin FUNCTION ThermLvl_Detrm "2.2.0     Determine and provide the thermal levels (coolant and components) for thermal system coordination" /begin DEF_CHARACTERISTIC ThermLvl_tDiffEnvMTCooltMax_C ThermLvl_tMTCoolgCooltMin_C /end DEF_CHARACTERISTIC /begin IN_MEASUREMENT EnvT_t MedCooltT1_t_f /end IN_MEASUREMENT
 /begin OUT_MEASUREMENT ThermLvl_dTMTCooltEnv ThermLvl_dTMTCooltSp ThermLvl_tMedTCircRadDs /end OUT_MEASUREMENT
 /begin LOC_MEASUREMENT ThermLvl_tMTPasSp /end LOC_MEASUREMENT
 FUNCTION_VERSION "2.2.0" /end FUNCTION
/begin FUNCTION ThermMod_Detrm "3.1.0     Determine the thermal mode of the several coolant circuit\topologies"
 /begin DEF_CHARACTERISTIC ThermMod_dTAirFlowHysDelta_C ThermMod_dTAirFlowReq_C ThermMod_dTMTEnvDelta_C ThermMod_dTMTEnvHeatgMax_C ThermMod_dTMTEnvInRngMax_C ThermMod_tiReqDeb_C /end DEF_CHARACTERISTIC
 /begin IN_MEASUREMENT ThermCfg_flgMTAftRunReq ThermCfg_ratMTPmpReq ThermLvl_dTMTCooltEnv ThermLvl_dTMTCooltSp ThermMod_stOpMod /end IN_MEASUREMENT
 /begin OUT_MEASUREMENT ThermMod_st /end OUT_MEASUREMENT
 /begin LOC_MEASUREMENT ThermMod_MTAftRunReqDebTOFF_I.XOld ThermMod_MTAftRunReqDebTOFF_I.Timer ThermMod_MTAirFlowHDR_I ThermMod_MTEnvHeatgHDR_I ThermMod_MTEnvInRngHDR_I ThermMod_MTReqDebTOFF_I.XOld ThermMod_MTReqDebTOFF_I.Timer ThermMod_stMTAftRunReq ThermMod_stMTCooltEnv ThermMod_stMTReq ThermMod_stVehOpMod /end LOC_MEASUREMENT
 FUNCTION_VERSION "3.1.0" /end FUNCTION
/begin COMPU_METHOD B_TRUE "" TAB_VERB "%6.3" "" COMPU_TAB_REF B_TRUE /end COMPU_METHOD
/begin COMPU_VTAB B_TRUE "" TAB_VERB 2 0 "FALSE" 1 "TRUE" /end COMPU_VTAB
/begin COMPU_METHOD Com_stCANComReq_VERB "" TAB_VERB "%6.3" "" COMPU_TAB_REF Com_stCANComReq_VERB /end COMPU_METHOD
/begin COMPU_VTAB Com_stCANComReq_VERB "" TAB_VERB 3 0 "NO_COM" 1 "FULL_COM" 2 "EI_MODE" /end COMPU_VTAB
/begin COMPU_METHOD CoPtFH_stPs_VERB "" TAB_VERB "%6.3" "" COMPU_TAB_REF CoPtFH_stPs_VERB /end COMPU_METHOD
/begin COMPU_VTAB CoPtFH_stPs_VERB "" TAB_VERB 6 0 "ePs_OFF" 1 "ePs_Active_Drive" 2 "ePs_Discharge" 3 "ePs_PI_Charge" 4 "ePs_Pl_Balance" 5 "ePs_PI_Discharge" /end COMPU_VTAB
/begin COMPU_METHOD CoPtFH_stPwt_VERB "" TAB_VERB "%6.3" "" COMPU_TAB_REF CoPtFH_stPwt_VERB /end COMPU_METHOD
/begin COMPU_VTAB CoPtFH_stPwt_VERB "" TAB_VERB 16 0 "GMP inactif" 1 "Reserve" 2 "Reserve1" 3 "Reserve2" 4 "Activation GMP" 5 "Reserve3" 6 "Reserve4" 7 "Reserve5" 8 "GMP actif" 9 "Reserve6" 10 "Desactivation_GMP" 11 "Reserve7" 12 "Maintien_post_desactivation_GMP" 13 "Reserve8" 14 "GMP_au_repos" 15 "Reserve9" /end COMPU_VTAB
/begin COMPU_METHOD Curr_A_q0p03125_COMPU "" RAT_FUNC "%6.4" "A" COEFFS 0 32 0 0 0 1 /end COMPU_METHOD
/begin COMPU_METHOD Curr_mA_q0p9765625_COMPU "" RAT_FUNC "%6.2" "mA" COEFFS 0 1.024 0 0 0 1 /end COMPU_METHOD
/begin COMPU_METHOD DDRCTime_ms "" RAT_FUNC "%6.1" "ms" COEFFS 0 1 0 0 0 10 /end COMPU_METHOD
/begin COMPU_METHOD DFC_OneToOne "" RAT_FUNC "%6.2" "-" COEFFS 0 1 0 0 0 1 /end COMPU_METHOD
/begin COMPU_METHOD DFES_OneToOne "" RAT_FUNC "%6.2" "-" COEFFS 0 1 0 0 0 1 /end COMPU_METHOD
/begin COMPU_METHOD DINH_ct_Compu "" RAT_FUNC "%6.0" "" COEFFS 0 -1 4096 0 0 1 /end COMPU_METHOD
/begin COMPU_METHOD ExeCon_State_01 "" TAB_VERB "%6.3" "" COMPU_TAB_REF ExeCon_State_01 /end COMPU_METHOD
/begin COMPU_VTAB ExeCon_State_01 "" TAB_VERB 4 0 "SYC_BOOT" 1 "SYC_PROC_INIT" 2 "SYC_PROC_EXEC" 3 "SYC_SHUTDOWN" /end COMPU_VTAB
/begin COMPU_METHOD ExeCon_State_02 "" TAB_VERB "%6.3" "" COMPU_TAB_REF ExeCon_State_02 /end COMPU_METHOD
/begin COMPU_VTAB ExeCon_State_02 "" TAB_VERB 7 0 "SYC_INI" 1 "SYC_INISYN" 2 "SYC_INIEND" 3 "SYC_PREDRIVE" 4 "SYC_DRIVE" 5 "SYC_POSTDRIVE" 6 "SYC_POST_OS_EXIT" /end COMPU_VTAB
/begin COMPU_METHOD leist_q16_W "" RAT_FUNC "%6.1" "W" COEFFS 0 1 0 0 0 16 /end COMPU_METHOD
/begin COMPU_METHOD nmot_q1 "" RAT_FUNC "%6.2" "1/min" COEFFS 0 1 0 0 0 1 /end COMPU_METHOD
/begin COMPU_METHOD OneToOne "" RAT_FUNC "%6.2" "-" COEFFS 0 1 0 0 0 1 /end COMPU_METHOD
/begin COMPU_METHOD Prc "" RAT_FUNC "%6.4" "%" COEFFS 0 81.92 0 0 0 1 /end COMPU_METHOD
/begin COMPU_METHOD q0p01_K "" RAT_FUNC "%6.4" "K" COEFFS 0 100 0 0 0 1 /end COMPU_METHOD
/begin COMPU_METHOD q0p01_s "" RAT_FUNC "%6.4" "s" COEFFS 0 100 0 0 0 1 /end COMPU_METHOD
/begin COMPU_METHOD q0p1_kW "" RAT_FUNC "%6.3" "kW" COEFFS 0 10 0 0 0 1 /end COMPU_METHOD
/begin COMPU_METHOD q0p1_s "" RAT_FUNC "%6.3" "s" COEFFS 0 10 0 0 0 1 /end COMPU_METHOD
/begin COMPU_METHOD q0p4_A "" RAT_FUNC "%6.3" "A" COEFFS 0 10 0 0 0 4 /end COMPU_METHOD
/begin COMPU_METHOD q1 "" RAT_FUNC "%6.2" "-" COEFFS 0 1 0 0 0 1 /end COMPU_METHOD
/begin COMPU_METHOD q1_Wh_DIV_km "" RAT_FUNC "%6.2" "Wh/km" COEFFS 0 1 0 0 0 1 /end COMPU_METHOD
/begin COMPU_METHOD RBPtCel_dst_1p0_4 "" RAT_FUNC "%6.2" "km" COEFFS 0 1 0 0 0 1 /end COMPU_METHOD
/begin COMPU_METHOD RBPtCel_n_10p0_1 "" RAT_FUNC "%6.1" "rpm" COEFFS 0 1 0 0 0 10 /end COMPU_METHOD
/begin COMPU_METHOD RBPtCel_n_1p0_1 "" RAT_FUNC "%6.2" "rpm" COEFFS 0 1 0 0 0 1 /end COMPU_METHOD
/begin COMPU_METHOD RBPtCel_Perc_1p0_1 "" RAT_FUNC "%6.2" "%" COEFFS 0 1 0 0 0 1 /end COMPU_METHOD
/begin COMPU_METHOD RBPtCel_q_0p125_1 "" RAT_FUNC "%6.3" "Ah" COEFFS 0 8 0 0 0 1 /end COMPU_METHOD
/begin COMPU_METHOD RBPtCel_ti_1p0em6_1 "" RAT_FUNC "%9.8" "s" COEFFS 0 1000000 0 0 0 1 /end COMPU_METHOD
/begin COMPU_METHOD RBPtCel_t_0p02_1 "" RAT_FUNC "%6.4" "Deg C" COEFFS 0 50 0 0 0 1 /end COMPU_METHOD
/begin COMPU_METHOD RBPtCel_t_0p1om273p14_1 "" RAT_FUNC "%6.1" "Deg C" COEFFS 0 10 2731.4 0 0 1 /end COMPU_METHOD
/begin COMPU_METHOD RBPtCel_t_0p1_1 "" RAT_FUNC "%6.3" "K" COEFFS 0 10 0 0 0 1 /end COMPU_METHOD
/begin COMPU_METHOD RBPtCel_u_0p25_1 "" RAT_FUNC "%6.3" "V" COEFFS 0 4 0 0 0 1 /end COMPU_METHOD
/begin COMPU_METHOD rel_q0p5 "" RAT_FUNC "%6.3" "%" COEFFS 0 1 0 0 0 0.5 /end COMPU_METHOD
/begin COMPU_METHOD rel_q1 "" RAT_FUNC "%6.2" "%" COEFFS 0 1 0 0 0 1 /end COMPU_METHOD
/begin COMPU_METHOD RmpTrq "" RAT_FUNC "%6.4" "Nm/s" COEFFS 0 655.36 0 0 0 1 /end COMPU_METHOD
/begin COMPU_METHOD SCR_TEMP_CELS_float "" RAT_FUNC "%6.2" "deg C" COEFFS 0 1 0 0 0 1 /end COMPU_METHOD
/begin COMPU_METHOD SigQly_COMPU_VERB "" TAB_VERB "%6.3" "" COMPU_TAB_REF SigQly_COMPU_VERB /end COMPU_METHOD
/begin COMPU_VTAB SigQly_COMPU_VERB "" TAB_VERB 16 0 "SIGQLY_NOTCALC" 1 "SIGQLY_INIT" 2 "SIGQLY_OK" 3 "SIGQLY_MODEL" 4 "SIGQLY_REPLACEMENT" 5 "SIGQLY_FROZEN" 6 "SIGQLY_INVALID" 7 "SIGQLY_RESERVED_7" 8 "SIGQLY_RESERVED_8" 9 "SIGQLY_RESERVED_9" 10 "SIGQLY_RESERVED_10" 11 "SIGQLY_RESERVED_11" 12 "SIGQLY_RESERVED_12" 13 "SIGQLY_RESERVED_13" 14 "SIGQLY_RESERVED_14" 15 "SIGQLY_RESERVED_15" /end COMPU_VTAB
/begin COMPU_METHOD SyC_Drv_state_e "" TAB_VERB "%6.3" "" COMPU_TAB_REF SyC_Drv_state_e /end COMPU_METHOD
/begin COMPU_VTAB SyC_Drv_state_e "" TAB_VERB 2 0 "DRV_INIT" 1 "DRV_RUNNING" /end COMPU_VTAB
/begin COMPU_METHOD SyC_PostDrv_State "" TAB_VERB "%6.3" "" COMPU_TAB_REF SyC_PostDrv_State /end COMPU_METHOD
/begin COMPU_VTAB SyC_PostDrv_State "" TAB_VERB 9 0 "SYC_POSTDRV_INACTV" 1 "SYC_POSTDRV_DSM_BGN" 2 "SYC_POSTDRV_EEP_BGN" 3 "SYC_POSTDRV_WAIT" 4 "SYC_POSTDRV_NWM" 5 "SYC_POSTDRV_DSM_END" 6 "SYC_POSTDRV_EEP_END" 7 "SYC_POSTDRV_MIN_TIME" 8 "SYC_POSTDRV_DONE" /end COMPU_VTAB
/begin COMPU_METHOD SyC_PostDrv_state_e "" TAB_VERB "%6.3" "" COMPU_TAB_REF SyC_PostDrv_state_e /end COMPU_METHOD
/begin COMPU_VTAB SyC_PostDrv_state_e "" TAB_VERB 3 0 "POSTDRV_INIT" 1 "POSTDRV_TIMEOUT" 2 "POSTDRV_EXIT" /end COMPU_VTAB
/begin COMPU_METHOD SyC_PreDrv_State "" TAB_VERB "%6.3" "" COMPU_TAB_REF SyC_PreDrv_State /end COMPU_METHOD
/begin COMPU_VTAB SyC_PreDrv_State "" TAB_VERB 10 0 "SYC_PREDRV_INI_DRV" 1 "SYC_PREDRV_DONE" 2 "SYC_PREDRV_INI_SHDWN" 3 "SYC_PREDRV_PROLONG" 4 "SYC_PREDRV_NWM" 5 "SYC_PREDRV_EEP" 6 "SYC_PREDRV_DSM" 7 "SYC_PREDRV_MR" 8 "SYC_PREDRV_MOM" 9 "SYC_PREDRV_EXIT" /end COMPU_VTAB
/begin COMPU_METHOD SyC_PreDrv_state_e "" TAB_VERB "%6.3" "" COMPU_TAB_REF SyC_PreDrv_state_e /end COMPU_METHOD
/begin COMPU_VTAB SyC_PreDrv_state_e "" TAB_VERB 4 0 "PREDRV_INIT" 1 "PREDRV_TIMEOUT" 2 "PREDRV_MRLY" 3 "PREDRV_EXIT" /end COMPU_VTAB
/begin COMPU_METHOD SyC_stRCDVerb "" TAB_VERB "%6.3" "" COMPU_TAB_REF SyC_stRCDVerb /end COMPU_METHOD
/begin COMPU_VTAB SyC_stRCDVerb "" TAB_VERB 7 0 "SYC_UNKNOWN" 1 "SYC_PARTIALWAKEUP" 2 "SYC_INTERNAL_PARTIALWAKEUP" 3 "SYC_TRANSITORY" 4 "SYC_NOMINAL_MAINWAKEUP" 5 "SYC_DEGRADED_MAINWAKEUP" 6 "SYC_SHUTDOWN_PREPARATION" /end COMPU_VTAB
/begin COMPU_METHOD SyC_Time_10ms "" RAT_FUNC "%6.4" "s" COEFFS 0 1000 0 0 0 10 /end COMPU_METHOD
/begin COMPU_METHOD Temp_Cels "" RAT_FUNC "%6.1" "deg C" COEFFS 0 10 2731.4 0 0 1 /end COMPU_METHOD
/begin COMPU_METHOD ThermMod_stMTAftRunReq_VERB "" TAB_VERB "%6.3" "" COMPU_TAB_REF ThermMod_stMTAftRunReq_VERB /end COMPU_METHOD
/begin COMPU_VTAB ThermMod_stMTAftRunReq_VERB "" TAB_VERB 2 0 "ThermMod_stMTAftRunReq_ENUM_Off" 1 "ThermMod_stMTAftRunReq_ENUM_On" /end COMPU_VTAB
/begin COMPU_METHOD ThermMod_stMTCooltEnv_VERB "" TAB_VERB "%6.3" "" COMPU_TAB_REF ThermMod_stMTCooltEnv_VERB /end COMPU_METHOD
/begin COMPU_VTAB ThermMod_stMTCooltEnv_VERB "" TAB_VERB 3 0 "ThermMod_stMTCooltEnv_ENUM_Coolg" 1 "ThermMod_stMTCooltEnv_ENUM_InRng" 2 "ThermMod_stMTCooltEnv_ENUM_Heatg" /end COMPU_VTAB
/begin COMPU_METHOD ThermMod_stMTReq_VERB "" TAB_VERB "%6.3" "" COMPU_TAB_REF ThermMod_stMTReq_VERB /end COMPU_METHOD
/begin COMPU_VTAB ThermMod_stMTReq_VERB "" TAB_VERB 3 0 "ThermMod_stMTReq_ENUM_Off" 1 "ThermMod_stMTReq_ENUM_Pmp" 2 "ThermMod_stMTReq_ENUM_AirFlow" /end COMPU_VTAB
/begin COMPU_METHOD ThermMod_stVehOpMod_VERB "" TAB_VERB "%6.3" "" COMPU_TAB_REF ThermMod_stVehOpMod_VERB /end COMPU_METHOD
/begin COMPU_VTAB ThermMod_stVehOpMod_VERB "" TAB_VERB 7 0 "ThermMod_stVehOpMod_ENUM_StrtDly" 1 "ThermMod_stVehOpMod_ENUM_IniRun" 2 "ThermMod_stVehOpMod_ENUM_Chrg" 3 "ThermMod_stVehOpMod_ENUM_Drv" 4 "ThermMod_stVehOpMod_ENUM_IniAftRun" 5 "ThermMod_stVehOpMod_ENUM_AftRun" 6 "ThermMod_stVehOpMod_ENUM_ShtOff" /end COMPU_VTAB
/begin COMPU_METHOD ThermMod_st_VERB "" TAB_VERB "%6.3" "" COMPU_TAB_REF ThermMod_st_VERB /end COMPU_METHOD
/begin COMPU_VTAB ThermMod_st_VERB "" TAB_VERB 9 0 "MTMOD_INISTRT" 1 "MTMOD_INIRUN" 2 "MTMOD_INIAFTRUN" 3 "MTMOD_CTRLOFF" 4 "MTMOD_FLOWONLY" 5 "MTMOD_PASCOOLG" 6 "MTMOD_PASCOOLGAFTRUN" 7 "MTMOD_PROTNCOOLGAFTRUN" 8 "MTMOD_AFTRUNCMPL" /end COMPU_VTAB
/begin COMPU_METHOD Time_Dt "" RAT_FUNC "%9.8" "s" COEFFS 0 1000000 0 0 0 1 /end COMPU_METHOD
/begin COMPU_METHOD Time_msec_q10_COMPU "" RAT_FUNC "%6.1" "ms" COEFFS 0 1 0 0 0 10 /end COMPU_METHOD
/begin COMPU_METHOD Time_msec_q1_COMPU "" RAT_FUNC "%6.2" "ms" COEFFS 0 1 0 0 0 1 /end COMPU_METHOD
/begin COMPU_METHOD Time_s "" RAT_FUNC "%6.4" "s" COEFFS 0 100 0 0 0 1 /end COMPU_METHOD
/begin COMPU_METHOD Time_sec_q1_COMPU "" RAT_FUNC "%6.2" "s" COEFFS 0 1 0 0 0 1 /end COMPU_METHOD
/begin COMPU_METHOD Time_usec_q1_COMPU "" RAT_FUNC "%6.2" "us" COEFFS 0 1 0 0 0 1 /end COMPU_METHOD
/begin COMPU_METHOD Trq "" RAT_FUNC "%6.3" "Nm" COEFFS 0 10 0 0 0 1 /end COMPU_METHOD
/begin COMPU_METHOD TrqPrpHigh "" RAT_FUNC "%6.3" "Nm" COEFFS 0 10 0 0 0 1 /end COMPU_METHOD
/begin COMPU_METHOD TTLMP_SC_Compu "" TAB_VERB "%6.3" "" COMPU_TAB_REF TTLMP_SC_Compu /end COMPU_METHOD
/begin COMPU_VTAB TTLMP_SC_Compu "" TAB_VERB 2 0 "False" 1 "True" /end COMPU_VTAB
/begin COMPU_METHOD TTRBNUS_TYPAVL_SY_Compu "" TAB_VERB "%6.3" "" COMPU_TAB_REF TTRBNUS_TYPAVL_SY_Compu /end COMPU_METHOD
/begin COMPU_VTAB TTRBNUS_TYPAVL_SY_Compu "" TAB_VERB 2 0 "False" 1 "True" /end COMPU_VTAB
/begin COMPU_METHOD TTRBUSASICT_TYPAVL_SC_Compu "" TAB_VERB "%6.3" "" COMPU_TAB_REF TTRBUSASICT_TYPAVL_SC_Compu /end COMPU_METHOD
/begin COMPU_VTAB TTRBUSASICT_TYPAVL_SC_Compu "" TAB_VERB 2 0 "False" 1 "True" /end COMPU_VTAB
/begin COMPU_METHOD TWALLTC_MDLAVL_SC_Compu "" TAB_VERB "%6.3" "" COMPU_TAB_REF TWALLTC_MDLAVL_SC_Compu /end COMPU_METHOD
/begin COMPU_VTAB TWALLTC_MDLAVL_SC_Compu "" TAB_VERB 2 0 "False" 1 "True" /end COMPU_VTAB
/begin COMPU_METHOD TWTRCOOLRDS_TYPAVL_SC_Compu "" TAB_VERB "%6.3" "" COMPU_TAB_REF TWTRCOOLRDS_TYPAVL_SC_Compu /end COMPU_METHOD
/begin COMPU_VTAB TWTRCOOLRDS_TYPAVL_SC_Compu "" TAB_VERB 2 0 "False" 1 "True" /end COMPU_VTAB
/begin COMPU_METHOD UART_SY_Compu "" TAB_VERB "%6.3" "" COMPU_TAB_REF UART_SY_Compu /end COMPU_METHOD
/begin COMPU_VTAB UART_SY_Compu "" TAB_VERB 2 0 "UART not used" 1 "UART used" /end COMPU_VTAB
/begin COMPU_METHOD UBFAILSRC_SY_Compu "" TAB_VERB "%6.3" "" COMPU_TAB_REF UBFAILSRC_SY_Compu /end COMPU_METHOD
/begin COMPU_VTAB UBFAILSRC_SY_Compu "" TAB_VERB 2 0 "NONE" 1 "PWRSPLYCHIP" /end COMPU_VTAB
/begin COMPU_METHOD UCATDST2_TYPAVL_SC_Compu "" TAB_VERB "%6.3" "" COMPU_TAB_REF UCATDST2_TYPAVL_SC_Compu /end COMPU_METHOD
/begin COMPU_VTAB UCATDST2_TYPAVL_SC_Compu "" TAB_VERB 2 0 "False" 1 "True" /end COMPU_VTAB
/begin COMPU_METHOD UCATDST_TYPAVL_SC_Compu "" TAB_VERB "%6.3" "" COMPU_TAB_REF UCATDST_TYPAVL_SC_Compu /end COMPU_METHOD
/begin COMPU_VTAB UCATDST_TYPAVL_SC_Compu "" TAB_VERB 2 0 "False" 1 "True" /end COMPU_VTAB
/begin COMPU_METHOD UCATUST2_TYPAVL_SC_Compu "" TAB_VERB "%6.3" "" COMPU_TAB_REF UCATUST2_TYPAVL_SC_Compu /end COMPU_METHOD
/begin COMPU_VTAB UCATUST2_TYPAVL_SC_Compu "" TAB_VERB 2 0 "False" 1 "True" /end COMPU_VTAB
/begin COMPU_METHOD UCATUST_TYPAVL_SC_Compu "" TAB_VERB "%6.3" "" COMPU_TAB_REF UCATUST_TYPAVL_SC_Compu /end COMPU_METHOD
/begin COMPU_VTAB UCATUST_TYPAVL_SC_Compu "" TAB_VERB 2 0 "False" 1 "True" /end COMPU_VTAB
/begin COMPU_METHOD UCTP_TYPAVL_SC_Compu "" TAB_VERB "%6.3" "" COMPU_TAB_REF UCTP_TYPAVL_SC_Compu /end COMPU_METHOD
/begin COMPU_VTAB UCTP_TYPAVL_SC_Compu "" TAB_VERB 2 0 "False" 1 "True" /end COMPU_VTAB
/begin COMPU_METHOD UDPNM_SC_Compu "" TAB_VERB "%6.3" "" COMPU_TAB_REF UDPNM_SC_Compu /end COMPU_METHOD
/begin COMPU_VTAB UDPNM_SC_Compu "" TAB_VERB 2 0 "INACTIVE" 1 "ACTIVE" /end COMPU_VTAB
/begin COMPU_METHOD UPXP1_TYPAVL_SC_Compu "" TAB_VERB "%6.3" "" COMPU_TAB_REF UPXP1_TYPAVL_SC_Compu /end COMPU_METHOD
/begin COMPU_VTAB UPXP1_TYPAVL_SC_Compu "" TAB_VERB 2 0 "False" 1 "True" /end COMPU_VTAB
/begin COMPU_METHOD U_mV_q0p9765625_COMPU "" RAT_FUNC "%6.2" "mV" COEFFS 0 1.024 0 0 0 1 /end COMPU_METHOD
/begin COMPU_METHOD VEHCOORN_DRVGREQMETHOD_SC_Compu "" TAB_VERB "%6.3" "" COMPU_TAB_REF VEHCOORN_DRVGREQMETHOD_SC_Compu /end COMPU_METHOD
/begin COMPU_VTAB VEHCOORN_DRVGREQMETHOD_SC_Compu "" TAB_VERB 2 1 "T50" 2 "DRIVE_MODE" /end COMPU_VTAB
/begin COMPU_METHOD VEHCOORN_HVIDLESHTOFF_SC_Compu "" TAB_VERB "%6.3" "" COMPU_TAB_REF VEHCOORN_HVIDLESHTOFF_SC_Compu /end COMPU_METHOD
/begin COMPU_VTAB VEHCOORN_HVIDLESHTOFF_SC_Compu "" TAB_VERB 2 0 "False" 1 "True" /end COMPU_VTAB
/begin COMPU_METHOD VEHCOORN_RNGPREDROUTEPROFENA_SC_Compu "" TAB_VERB "%6.3" "" COMPU_TAB_REF VEHCOORN_RNGPREDROUTEPROFENA_SC_Compu /end COMPU_METHOD
/begin COMPU_VTAB VEHCOORN_RNGPREDROUTEPROFENA_SC_Compu "" TAB_VERB 2 0 "False" 1 "True" /end COMPU_VTAB
/begin COMPU_METHOD VEHDEV_APPPIDENA_SC_Compu "" TAB_VERB "%6.3" "" COMPU_TAB_REF VEHDEV_APPPIDENA_SC_Compu /end COMPU_METHOD
/begin COMPU_VTAB VEHDEV_APPPIDENA_SC_Compu "" TAB_VERB 2 0 "False" 1 "True" /end COMPU_VTAB
/begin COMPU_METHOD Vel "" RAT_FUNC "%6.4" "km/h" COEFFS 0 100 0 0 0 1 /end COMPU_METHOD
/begin COMPU_METHOD Volt_V_q0p03125_COMPU "" RAT_FUNC "%6.4" "V" COEFFS 0 32 0 0 0 1 /end COMPU_METHOD
/begin RECORD_LAYOUT RB_Curve_S16_S16 NO_AXIS_PTS_X 1 SWORD AXIS_PTS_X 2 SWORD INDEX_INCR DIRECT FNC_VALUES 3 SWORD COLUMN_DIR DIRECT /end RECORD_LAYOUT
/begin RECORD_LAYOUT RB_Curve_S16_S8_sao NO_AXIS_PTS_X 1 SWORD AXIS_PTS_X 2 SWORD INDEX_INCR DIRECT FNC_VALUES 3 SBYTE COLUMN_DIR DIRECT STATIC_ADDRESS_OFFSETS /end RECORD_LAYOUT
/begin RECORD_LAYOUT RB_Curve_U8_S16_sao NO_AXIS_PTS_X 1 UBYTE AXIS_PTS_X 2 UBYTE INDEX_INCR DIRECT FNC_VALUES 3 SWORD COLUMN_DIR DIRECT STATIC_ADDRESS_OFFSETS /end RECORD_LAYOUT
/begin RECORD_LAYOUT RB_Curve_U8_U8 NO_AXIS_PTS_X 1 UBYTE AXIS_PTS_X 2 UBYTE INDEX_INCR DIRECT FNC_VALUES 3 UBYTE COLUMN_DIR DIRECT /end RECORD_LAYOUT
/begin RECORD_LAYOUT RB_Map_S16S16_S32_sao NO_AXIS_PTS_X 1 SWORD NO_AXIS_PTS_Y 2 SWORD AXIS_PTS_X 3 SWORD INDEX_INCR DIRECT AXIS_PTS_Y 4 SWORD INDEX_INCR DIRECT FNC_VALUES 5 SLONG COLUMN_DIR DIRECT STATIC_ADDRESS_OFFSETS /end RECORD_LAYOUT
/begin RECORD_LAYOUT RB_ValA_Wu8 FNC_VALUES 1 UBYTE COLUMN_DIR DIRECT /end RECORD_LAYOUT
/begin RECORD_LAYOUT RB_Val_Wboolean FNC_VALUES 1 UBYTE COLUMN_DIR DIRECT /end RECORD_LAYOUT
/begin RECORD_LAYOUT RB_Val_Ws16 FNC_VALUES 1 SWORD COLUMN_DIR DIRECT /end RECORD_LAYOUT
/begin RECORD_LAYOUT RB_Val_Ws32 FNC_VALUES 1 SLONG COLUMN_DIR DIRECT /end RECORD_LAYOUT
/begin RECORD_LAYOUT RB_Val_Ws8 FNC_VALUES 1 SBYTE COLUMN_DIR DIRECT /end RECORD_LAYOUT
/begin RECORD_LAYOUT RB_Val_Wu16 FNC_VALUES 1 UWORD COLUMN_DIR DIRECT /end RECORD_LAYOUT
/begin RECORD_LAYOUT RB_Val_Wu32 FNC_VALUES 1 ULONG COLUMN_DIR DIRECT /end RECORD_LAYOUT
/begin RECORD_LAYOUT RB_Val_Wu8 FNC_VALUES 1 UBYTE COLUMN_DIR DIRECT /end RECORD_LAYOUT
/begin RECORD_LAYOUT Val_Wu16 FNC_VALUES 1 UWORD COLUMN_DIR DIRECT /end RECORD_LAYOUT
/begin RECORD_LAYOUT Val_Wu8 FNC_VALUES 1 UBYTE COLUMN_DIR DIRECT /end RECORD_LAYOUT
/end MODULE
/end PROJECT

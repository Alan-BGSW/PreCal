ASAP2_VERSION 1 70
/begin PROJECT MDG1C "VC1CP091_STLA_N_D061I3"
/begin HEADER "" VERSION "VC1CP091_STLA_N_D061I3" PROJECT_NO MDG1C /end HEADER
/begin MODULE DIM ""
/begin MOD_COMMON "" BYTE_ORDER MSB_LAST ALIGNMENT_BYTE 1 ALIGNMENT_WORD 2 ALIGNMENT_LONG 4 ALIGNMENT_INT64 4 ALIGNMENT_FLOAT32_IEEE 4 ALIGNMENT_FLOAT64_IEEE 4 DATA_SIZE 32 /end MOD_COMMON
/begin CHARACTERISTIC DFC_CtlMsk2.DFC_Unused_C "" VALUE 0x802412EC Val_Wu8 255.0 DFES_OneToOne 0.00 255.0 FORMAT "%5.1" READ_ONLY /end CHARACTERISTIC
/begin CHARACTERISTIC DFC_CtlMsk2.DFC_CANSM_E_BUS_OFF_NETWORK_HSN1_CAN_C "" VALUE 0x802415B0 Val_Wu8 255.0 DFES_OneToOne 0.00 255.0 FORMAT "%5.1" /end CHARACTERISTIC
/begin CHARACTERISTIC DFC_CtlMsk2.DFC_CANSM_E_BUS_OFF_NETWORK_HSN3_CAN_C "" VALUE 0x802415B1 Val_Wu8 255.0 DFES_OneToOne 0.00 255.0 FORMAT "%5.1" /end CHARACTERISTIC
/begin CHARACTERISTIC DFC_CtlMsk2.DFC_CANSM_E_BUS_OFF_NETWORK_HSN4_CAN_C "" VALUE 0x802415B2 Val_Wu8 255.0 DFES_OneToOne 0.00 255.0 FORMAT "%5.1" /end CHARACTERISTIC
/begin CHARACTERISTIC DFC_CtlMsk2.DFC_CANSM_E_BUS_OFF_NETWORK_XCP_CAN_C "" VALUE 0x802415B3 Val_Wu8 255.0 DFES_OneToOne 0.00 255.0 FORMAT "%5.1" /end CHARACTERISTIC
/begin CHARACTERISTIC DFC_CtlMsk2.DFC_COMM_E_NET_START_IND_CHANNEL_0_C "" VALUE 0x802415B6 Val_Wu8 255.0 DFES_OneToOne 0.00 255.0 FORMAT "%5.1" /end CHARACTERISTIC
/begin CHARACTERISTIC DFC_CtlMsk2.DFC_COMM_E_NET_START_IND_CHANNEL_1_C "" VALUE 0x802415B7 Val_Wu8 255.0 DFES_OneToOne 0.00 255.0 FORMAT "%5.1" /end CHARACTERISTIC
/begin CHARACTERISTIC DFC_CtlMsk2.DFC_COMM_E_NET_START_IND_CHANNEL_2_C "" VALUE 0x802415B8 Val_Wu8 255.0 DFES_OneToOne 0.00 255.0 FORMAT "%5.1" /end CHARACTERISTIC
/begin CHARACTERISTIC DFC_CtlMsk2.DFC_LIN_E_TIMEOUT_C "" VALUE 0x802415BC Val_Wu8 255.0 DFES_OneToOne 0.00 255.0 FORMAT "%5.1" /end CHARACTERISTIC
/begin CHARACTERISTIC DFC_CtlMsk2.DFC_rba_SyC_CustStates_Degraded_disord_Event_C "" VALUE 0x802415C0 Val_Wu8 255.0 DFES_OneToOne 0.00 255.0 FORMAT "%5.1" /end CHARACTERISTIC
/begin CHARACTERISTIC DFC_CtlMsk2.DFC_rba_SyC_CustStates_Degraded_incst_Event_C "" VALUE 0x802415C1 Val_Wu8 255.0 DFES_OneToOne 0.00 255.0 FORMAT "%5.1" /end CHARACTERISTIC
/begin CHARACTERISTIC DFC_CtlMsk2.DFC_rba_SyC_CustStates_TransNoWakReq_Event_C "" VALUE 0x802415C2 Val_Wu8 255.0 DFES_OneToOne 0.00 255.0 FORMAT "%5.1" /end CHARACTERISTIC
/begin CHARACTERISTIC DFC_DisblMsk2.DFC_Unused_C "" VALUE 0x80248ABE Val_Wu16 65535.00 DFES_OneToOne 0.00 65535.00 FORMAT "%8.2" READ_ONLY /end CHARACTERISTIC
/begin CHARACTERISTIC DFC_DisblMsk2.DFC_CANSM_E_BUS_OFF_NETWORK_HSN1_CAN_C "" VALUE 0x80249046 Val_Wu16 65535.00 DFES_OneToOne 0.00 65535.00 FORMAT "%8.2" /end CHARACTERISTIC
/begin CHARACTERISTIC DFC_DisblMsk2.DFC_CANSM_E_BUS_OFF_NETWORK_HSN3_CAN_C "" VALUE 0x80249048 Val_Wu16 65535.00 DFES_OneToOne 0.00 65535.00 FORMAT "%8.2" /end CHARACTERISTIC
/begin CHARACTERISTIC DFC_DisblMsk2.DFC_CANSM_E_BUS_OFF_NETWORK_HSN4_CAN_C "" VALUE 0x8024904A Val_Wu16 65535.00 DFES_OneToOne 0.00 65535.00 FORMAT "%8.2" /end CHARACTERISTIC
/begin CHARACTERISTIC DFC_DisblMsk2.DFC_CANSM_E_BUS_OFF_NETWORK_XCP_CAN_C "" VALUE 0x8024904C Val_Wu16 65535.00 DFES_OneToOne 0.00 65535.00 FORMAT "%8.2" /end CHARACTERISTIC
/begin CHARACTERISTIC DFC_DisblMsk2.DFC_COMM_E_NET_START_IND_CHANNEL_0_C "" VALUE 0x80249052 Val_Wu16 65535.00 DFES_OneToOne 0.00 65535.00 FORMAT "%8.2" /end CHARACTERISTIC
/begin CHARACTERISTIC DFC_DisblMsk2.DFC_COMM_E_NET_START_IND_CHANNEL_1_C "" VALUE 0x80249054 Val_Wu16 65535.00 DFES_OneToOne 0.00 65535.00 FORMAT "%8.2" /end CHARACTERISTIC
/begin CHARACTERISTIC DFC_DisblMsk2.DFC_COMM_E_NET_START_IND_CHANNEL_2_C "" VALUE 0x80249056 Val_Wu16 65535.00 DFES_OneToOne 0.00 65535.00 FORMAT "%8.2" /end CHARACTERISTIC
/begin CHARACTERISTIC DFC_DisblMsk2.DFC_LIN_E_TIMEOUT_C "" VALUE 0x8024905E Val_Wu16 65535.00 DFES_OneToOne 0.00 65535.00 FORMAT "%8.2" /end CHARACTERISTIC
/begin CHARACTERISTIC DFC_DisblMsk2.DFC_rba_SyC_CustStates_Degraded_disord_Event_C "" VALUE 0x80249066 Val_Wu16 65535.00 DFES_OneToOne 0.00 65535.00 FORMAT "%8.2" /end CHARACTERISTIC
/begin CHARACTERISTIC DFC_DisblMsk2.DFC_rba_SyC_CustStates_Degraded_incst_Event_C "" VALUE 0x80249068 Val_Wu16 65535.00 DFES_OneToOne 0.00 65535.00 FORMAT "%8.2" /end CHARACTERISTIC
/begin CHARACTERISTIC DFC_DisblMsk2.DFC_rba_SyC_CustStates_TransNoWakReq_Event_C "" VALUE 0x8024906A Val_Wu16 65535.00 DFES_OneToOne 0.00 65535.00 FORMAT "%8.2" /end CHARACTERISTIC
/begin CHARACTERISTIC DFC_DtcFuncUnit_C "" VALUE 0x802416B2 Val_Wu8 255.0 OneToOne 0.00 255.0 FORMAT "%5.1" /end CHARACTERISTIC
/begin CHARACTERISTIC DFC_DtcGroup_C "" VALUE 0x802416B3 Val_Wu8 16.0000000000 Dem_DTCGroup_Verb 0.00 16.0000000000 FORMAT "%13.10" /end CHARACTERISTIC
/begin CHARACTERISTIC DFC_DtcSeverity_C "" VALUE 0x802416B4 Val_Wu8 128.000000000 Dem_DTCSeverity_Verb 0.00 128.000000000 FORMAT "%13.9" /end CHARACTERISTIC
/begin CHARACTERISTIC DFES_Cls.DFC_Unused_C "" VALUE 0x802416B6 Val_Wu8 3.000 DFES_OneToOne 0.00 3.000 FORMAT "%5.3" EXTENDED_LIMITS 0.00 255.0 READ_ONLY /end CHARACTERISTIC
/begin CHARACTERISTIC DFES_Cls.DFC_ACCmprFltLvlRes_C "" VALUE 0x802416B7 Val_Wu8 3.000 DFES_OneToOne 0.00 3.000 FORMAT "%5.3" EXTENDED_LIMITS 0.00 255.0 /end CHARACTERISTIC
/begin CHARACTERISTIC DFES_Cls.DFC_AbgHiSigFlt_C "" VALUE 0x802416B8 Val_Wu8 3.000 DFES_OneToOne 0.00 3.000 FORMAT "%5.3" EXTENDED_LIMITS 0.00 255.0 /end CHARACTERISTIC
/begin CHARACTERISTIC DFES_Cls.DFC_AbgIntPatFlt_C "" VALUE 0x802416B9 Val_Wu8 3.000 DFES_OneToOne 0.00 3.000 FORMAT "%5.3" EXTENDED_LIMITS 0.00 255.0 /end CHARACTERISTIC
/begin CHARACTERISTIC DFES_Cls.DFC_AbgLoSigFlt_C "" VALUE 0x802416BA Val_Wu8 3.000 DFES_OneToOne 0.00 3.000 FORMAT "%5.3" EXTENDED_LIMITS 0.00 255.0 /end CHARACTERISTIC
/begin CHARACTERISTIC DFES_Cls.DFC_AbgUnkwnErrSigFlt_C "" VALUE 0x802416BB Val_Wu8 3.000 DFES_OneToOne 0.00 3.000 FORMAT "%5.3" EXTENDED_LIMITS 0.00 255.0 /end CHARACTERISTIC
/begin CHARACTERISTIC DFES_Cls.DFC_AcExtChrgrIBattExcdd_C "" VALUE 0x802416BC Val_Wu8 3.000 DFES_OneToOne 0.00 3.000 FORMAT "%5.3" EXTENDED_LIMITS 0.00 255.0 /end CHARACTERISTIC
/begin CHARACTERISTIC DFES_Cls.DFC_AcExtChrgrIInExcdd_C "" VALUE 0x802416BD Val_Wu8 3.000 DFES_OneToOne 0.00 3.000 FORMAT "%5.3" EXTENDED_LIMITS 0.00 255.0 /end CHARACTERISTIC
/begin CHARACTERISTIC DFES_Cls.DFC_AcExtChrgrIOutDe_C "" VALUE 0x802416BE Val_Wu8 3.000 DFES_OneToOne 0.00 3.000 FORMAT "%5.3" EXTENDED_LIMITS 0.00 255.0 /end CHARACTERISTIC
/begin CHARACTERISTIC DFES_Cls.DFC_AcExtChrgrIOutExcdd_C "" VALUE 0x802416BF Val_Wu8 3.000 DFES_OneToOne 0.00 3.000 FORMAT "%5.3" EXTENDED_LIMITS 0.00 255.0 /end CHARACTERISTIC
/begin CHARACTERISTIC DFES_Cls.DFC_AcExtChrgrUOutDe_C "" VALUE 0x802416C0 Val_Wu8 3.000 DFES_OneToOne 0.00 3.000 FORMAT "%5.3" EXTENDED_LIMITS 0.00 255.0 /end CHARACTERISTIC
/begin CHARACTERISTIC DFES_Cls.DFC_AdpActvDChaFailr_C "" VALUE 0x802416C1 Val_Wu8 3.000 DFES_OneToOne 0.00 3.000 FORMAT "%5.3" EXTENDED_LIMITS 0.00 255.0 /end CHARACTERISTIC
/begin CHARACTERISTIC DFES_Cls.DFC_AirbcuFlt_C "" VALUE 0x802416C2 Val_Wu8 3.000 DFES_OneToOne 0.00 3.000 FORMAT "%5.3" EXTENDED_LIMITS 0.00 255.0 /end CHARACTERISTIC
/begin CHARACTERISTIC DFES_Cls.DFC_Airbg_C "" VALUE 0x802416C3 Val_Wu8 3.000 DFES_OneToOne 0.00 3.000 FORMAT "%5.3" EXTENDED_LIMITS 0.00 255.0 /end CHARACTERISTIC
/begin CHARACTERISTIC DFES_Cls.DFC_AirbgCan_C "" VALUE 0x802416C4 Val_Wu8 3.000 DFES_OneToOne 0.00 3.000 FORMAT "%5.3" EXTENDED_LIMITS 0.00 255.0 /end CHARACTERISTIC
/begin CHARACTERISTIC DFES_Cls.DFC_AirbgCanHWPlaus_C "" VALUE 0x802416C5 Val_Wu8 3.000 DFES_OneToOne 0.00 3.000 FORMAT "%5.3" EXTENDED_LIMITS 0.00 255.0 /end CHARACTERISTIC
/begin CHARACTERISTIC DFES_Cls.DFC_AirbgHWCanPlaus_C "" VALUE 0x802416C6 Val_Wu8 3.000 DFES_OneToOne 0.00 3.000 FORMAT "%5.3" EXTENDED_LIMITS 0.00 255.0 /end CHARACTERISTIC
/begin CHARACTERISTIC DFES_Cls.DFC_AirbgMnr_C "" VALUE 0x802416C7 Val_Wu8 3.000 DFES_OneToOne 0.00 3.000 FORMAT "%5.3" EXTENDED_LIMITS 0.00 255.0 /end CHARACTERISTIC
/begin CHARACTERISTIC DFES_Cls.DFC_AirbgPerHi_C "" VALUE 0x802416C8 Val_Wu8 3.000 DFES_OneToOne 0.00 3.000 FORMAT "%5.3" EXTENDED_LIMITS 0.00 255.0 /end CHARACTERISTIC
/begin CHARACTERISTIC DFES_Cls.DFC_AirbgPerdRngFlt_C "" VALUE 0x802416C9 Val_Wu8 3.000 DFES_OneToOne 0.00 3.000 FORMAT "%5.3" EXTENDED_LIMITS 0.00 255.0 /end CHARACTERISTIC
/begin CHARACTERISTIC DFES_Cls.DFC_BlowrRlyErr_C "" VALUE 0x802416CA Val_Wu8 3.000 DFES_OneToOne 0.00 3.000 FORMAT "%5.3" EXTENDED_LIMITS 0.00 255.0 /end CHARACTERISTIC
/begin CHARACTERISTIC DFES_Cls.DFC_BrkBstPmpActtnDfct_C "" VALUE 0x802416CB Val_Wu8 3.000 DFES_OneToOne 0.00 3.000 FORMAT "%5.3" EXTENDED_LIMITS 0.00 255.0 /end CHARACTERISTIC
/begin CHARACTERISTIC DFES_Cls.DFC_BrkBstPmpDeactvnDfct_C "" VALUE 0x802416CC Val_Wu8 3.000 DFES_OneToOne 0.00 3.000 FORMAT "%5.3" EXTENDED_LIMITS 0.00 255.0 /end CHARACTERISTIC
/begin CHARACTERISTIC DFES_Cls.DFC_BrkSwtFlt_C "" VALUE 0x802416CD Val_Wu8 3.000 DFES_OneToOne 0.00 3.000 FORMAT "%5.3" EXTENDED_LIMITS 0.00 255.0 /end CHARACTERISTIC
/begin CHARACTERISTIC DFES_Cls.DFC_CbnHeatgHeatrHsScb_C "" VALUE 0x802416CE Val_Wu8 3.000 DFES_OneToOne 0.00 3.000 FORMAT "%5.3" EXTENDED_LIMITS 0.00 255.0 /end CHARACTERISTIC
/begin CHARACTERISTIC DFES_Cls.DFC_CbnHeatgHeatrHsScg_C "" VALUE 0x802416CF Val_Wu8 3.000 DFES_OneToOne 0.00 3.000 FORMAT "%5.3" EXTENDED_LIMITS 0.00 255.0 /end CHARACTERISTIC
/begin CHARACTERISTIC DFES_Cls.DFC_CbnHeatgHeatrLsOl_C "" VALUE 0x802416D0 Val_Wu8 3.000 DFES_OneToOne 0.00 3.000 FORMAT "%5.3" EXTENDED_LIMITS 0.00 255.0 /end CHARACTERISTIC
/begin CHARACTERISTIC DFES_Cls.DFC_CbnHeatgHeatrLsScb_C "" VALUE 0x802416D1 Val_Wu8 3.000 DFES_OneToOne 0.00 3.000 FORMAT "%5.3" EXTENDED_LIMITS 0.00 255.0 /end CHARACTERISTIC
/begin CHARACTERISTIC DFES_Cls.DFC_CbnHeatgHeatrLsScg_C "" VALUE 0x802416D2 Val_Wu8 3.000 DFES_OneToOne 0.00 3.000 FORMAT "%5.3" EXTENDED_LIMITS 0.00 255.0 /end CHARACTERISTIC
/begin CHARACTERISTIC DFES_Cls.DFC_CbnHeatgHeatrUnUsed_C "" VALUE 0x802416D3 Val_Wu8 3.000 DFES_OneToOne 0.00 3.000 FORMAT "%5.3" EXTENDED_LIMITS 0.00 255.0 /end CHARACTERISTIC
/begin CHARACTERISTIC DFES_Cls.DFC_ChrgnCntctHsOt_C "" VALUE 0x802416D4 Val_Wu8 3.000 DFES_OneToOne 0.00 3.000 FORMAT "%5.3" EXTENDED_LIMITS 0.00 255.0 /end CHARACTERISTIC
/begin CHARACTERISTIC DFES_Cls.DFC_ChrgnCntctHsScb_C "" VALUE 0x802416D5 Val_Wu8 3.000 DFES_OneToOne 0.00 3.000 FORMAT "%5.3" EXTENDED_LIMITS 0.00 255.0 /end CHARACTERISTIC
/begin CHARACTERISTIC DFES_Cls.DFC_ChrgnCntctHsScg_C "" VALUE 0x802416D6 Val_Wu8 3.000 DFES_OneToOne 0.00 3.000 FORMAT "%5.3" EXTENDED_LIMITS 0.00 255.0 /end CHARACTERISTIC
/begin CHARACTERISTIC DFES_Cls.DFC_ChrgnCntctLsNegOl_C "" VALUE 0x802416D7 Val_Wu8 3.000 DFES_OneToOne 0.00 3.000 FORMAT "%5.3" EXTENDED_LIMITS 0.00 255.0 /end CHARACTERISTIC
/begin CHARACTERISTIC DFES_Cls.DFC_ChrgnCntctLsNegOt_C "" VALUE 0x802416D8 Val_Wu8 3.000 DFES_OneToOne 0.00 3.000 FORMAT "%5.3" EXTENDED_LIMITS 0.00 255.0 /end CHARACTERISTIC
/begin CHARACTERISTIC DFES_Cls.DFC_ChrgnCntctLsNegScb_C "" VALUE 0x802416D9 Val_Wu8 3.000 DFES_OneToOne 0.00 3.000 FORMAT "%5.3" EXTENDED_LIMITS 0.00 255.0 /end CHARACTERISTIC
/begin CHARACTERISTIC DFES_Cls.DFC_ChrgnCntctLsNegScg_C "" VALUE 0x802416DA Val_Wu8 3.000 DFES_OneToOne 0.00 3.000 FORMAT "%5.3" EXTENDED_LIMITS 0.00 255.0 /end CHARACTERISTIC
/begin CHARACTERISTIC DFES_Cls.DFC_ChrgnCntctLsPosOl_C "" VALUE 0x802416DB Val_Wu8 3.000 DFES_OneToOne 0.00 3.000 FORMAT "%5.3" EXTENDED_LIMITS 0.00 255.0 /end CHARACTERISTIC
/begin CHARACTERISTIC DFES_Cls.DFC_ChrgnCntctLsPosOt_C "" VALUE 0x802416DC Val_Wu8 3.000 DFES_OneToOne 0.00 3.000 FORMAT "%5.3" EXTENDED_LIMITS 0.00 255.0 /end CHARACTERISTIC
/begin CHARACTERISTIC DFES_Cls.DFC_ChrgnCntctLsPosScb_C "" VALUE 0x802416DD Val_Wu8 3.000 DFES_OneToOne 0.00 3.000 FORMAT "%5.3" EXTENDED_LIMITS 0.00 255.0 /end CHARACTERISTIC
/begin CHARACTERISTIC DFES_Cls.DFC_ChrgnCntctLsPosScg_C "" VALUE 0x802416DE Val_Wu8 3.000 DFES_OneToOne 0.00 3.000 FORMAT "%5.3" EXTENDED_LIMITS 0.00 255.0 /end CHARACTERISTIC
/begin CHARACTERISTIC DFES_Cls.DFC_ChrgnCntctUnUsed_C "" VALUE 0x802416DF Val_Wu8 3.000 DFES_OneToOne 0.00 3.000 FORMAT "%5.3" EXTENDED_LIMITS 0.00 255.0 /end CHARACTERISTIC
/begin CHARACTERISTIC DFES_Cls.DFC_ComBrkMai_C "" VALUE 0x802416E0 Val_Wu8 3.000 DFES_OneToOne 0.00 3.000 FORMAT "%5.3" EXTENDED_LIMITS 0.00 255.0 /end CHARACTERISTIC
/begin CHARACTERISTIC DFES_Cls.DFC_ComChrgrEVCont_C "" VALUE 0x802416E1 Val_Wu8 3.000 DFES_OneToOne 0.00 3.000 FORMAT "%5.3" EXTENDED_LIMITS 0.00 255.0 /end CHARACTERISTIC
/begin CHARACTERISTIC DFES_Cls.DFC_ComChrgrEVtBlink_C "" VALUE 0x802416E2 Val_Wu8 3.000 DFES_OneToOne 0.00 3.000 FORMAT "%5.3" EXTENDED_LIMITS 0.00 255.0 /end CHARACTERISTIC
/begin CHARACTERISTIC DFES_Cls.DFC_ComChrgrMstBlink_C "" VALUE 0x802416E3 Val_Wu8 3.000 DFES_OneToOne 0.00 3.000 FORMAT "%5.3" EXTENDED_LIMITS 0.00 255.0 /end CHARACTERISTIC
/begin CHARACTERISTIC DFES_Cls.DFC_ComChrgrMstCont_C "" VALUE 0x802416E4 Val_Wu8 3.000 DFES_OneToOne 0.00 3.000 FORMAT "%5.3" EXTENDED_LIMITS 0.00 255.0 /end CHARACTERISTIC
/begin CHARACTERISTIC DFES_Cls.DFC_ComChrgrSVSBlink_C "" VALUE 0x802416E5 Val_Wu8 3.000 DFES_OneToOne 0.00 3.000 FORMAT "%5.3" EXTENDED_LIMITS 0.00 255.0 /end CHARACTERISTIC
/begin CHARACTERISTIC DFES_Cls.DFC_ComChrgrSVSCont_C "" VALUE 0x802416E6 Val_Wu8 3.000 DFES_OneToOne 0.00 3.000 FORMAT "%5.3" EXTENDED_LIMITS 0.00 255.0 /end CHARACTERISTIC
/begin CHARACTERISTIC DFES_Cls.DFC_ComDcdcEVBlink_C "" VALUE 0x802416E7 Val_Wu8 3.000 DFES_OneToOne 0.00 3.000 FORMAT "%5.3" EXTENDED_LIMITS 0.00 255.0 /end CHARACTERISTIC
/begin CHARACTERISTIC DFES_Cls.DFC_ComDcdcEVCont_C "" VALUE 0x802416E8 Val_Wu8 3.000 DFES_OneToOne 0.00 3.000 FORMAT "%5.3" EXTENDED_LIMITS 0.00 255.0 /end CHARACTERISTIC
/begin CHARACTERISTIC DFES_Cls.DFC_ComDcdcFltLvl2_C "" VALUE 0x802416E9 Val_Wu8 3.000 DFES_OneToOne 0.00 3.000 FORMAT "%5.3" EXTENDED_LIMITS 0.00 255.0 /end CHARACTERISTIC
/begin CHARACTERISTIC DFES_Cls.DFC_ComDcdcFltLvl3_C "" VALUE 0x802416EA Val_Wu8 3.000 DFES_OneToOne 0.00 3.000 FORMAT "%5.3" EXTENDED_LIMITS 0.00 255.0 /end CHARACTERISTIC
/begin CHARACTERISTIC DFES_Cls.DFC_ComDcdcFltLvl4_C "" VALUE 0x802416EB Val_Wu8 3.000 DFES_OneToOne 0.00 3.000 FORMAT "%5.3" EXTENDED_LIMITS 0.00 255.0 /end CHARACTERISTIC
/begin CHARACTERISTIC DFES_Cls.DFC_ComDcdcFltLvl5_C "" VALUE 0x802416EC Val_Wu8 3.000 DFES_OneToOne 0.00 3.000 FORMAT "%5.3" EXTENDED_LIMITS 0.00 255.0 /end CHARACTERISTIC
/begin CHARACTERISTIC DFES_Cls.DFC_ComDcdcFltLvlRes_C "" VALUE 0x802416ED Val_Wu8 3.000 DFES_OneToOne 0.00 3.000 FORMAT "%5.3" EXTENDED_LIMITS 0.00 255.0 /end CHARACTERISTIC
/begin CHARACTERISTIC DFES_Cls.DFC_ComDcdcMstBlink_C "" VALUE 0x802416EE Val_Wu8 3.000 DFES_OneToOne 0.00 3.000 FORMAT "%5.3" EXTENDED_LIMITS 0.00 255.0 /end CHARACTERISTIC
/begin CHARACTERISTIC DFES_Cls.DFC_ComDcdcMstCont_C "" VALUE 0x802416EF Val_Wu8 3.000 DFES_OneToOne 0.00 3.000 FORMAT "%5.3" EXTENDED_LIMITS 0.00 255.0 /end CHARACTERISTIC
/begin CHARACTERISTIC DFES_Cls.DFC_ComDcdcSVSBlink_C "" VALUE 0x802416F0 Val_Wu8 3.000 DFES_OneToOne 0.00 3.000 FORMAT "%5.3" EXTENDED_LIMITS 0.00 255.0 /end CHARACTERISTIC
/begin CHARACTERISTIC DFES_Cls.DFC_ComDcdcSVSCont_C "" VALUE 0x802416F1 Val_Wu8 3.000 DFES_OneToOne 0.00 3.000 FORMAT "%5.3" EXTENDED_LIMITS 0.00 255.0 /end CHARACTERISTIC
/begin CHARACTERISTIC DFES_Cls.DFC_ComElMIIvtrFltLvl2_C "" VALUE 0x802416F2 Val_Wu8 3.000 DFES_OneToOne 0.00 3.000 FORMAT "%5.3" EXTENDED_LIMITS 0.00 255.0 /end CHARACTERISTIC
/begin CHARACTERISTIC DFES_Cls.DFC_ComElMIIvtrFltLvl3_C "" VALUE 0x802416F3 Val_Wu8 3.000 DFES_OneToOne 0.00 3.000 FORMAT "%5.3" EXTENDED_LIMITS 0.00 255.0 /end CHARACTERISTIC
/begin CHARACTERISTIC DFES_Cls.DFC_ComElMIIvtrFltLvl4_C "" VALUE 0x802416F4 Val_Wu8 3.000 DFES_OneToOne 0.00 3.000 FORMAT "%5.3" EXTENDED_LIMITS 0.00 255.0 /end CHARACTERISTIC
/begin CHARACTERISTIC DFES_Cls.DFC_ComElMIIvtrFltLvl5_C "" VALUE 0x802416F5 Val_Wu8 3.000 DFES_OneToOne 0.00 3.000 FORMAT "%5.3" EXTENDED_LIMITS 0.00 255.0 /end CHARACTERISTIC
/begin CHARACTERISTIC DFES_Cls.DFC_ComElMIIvtrFltLvlRes_C "" VALUE 0x802416F6 Val_Wu8 3.000 DFES_OneToOne 0.00 3.000 FORMAT "%5.3" EXTENDED_LIMITS 0.00 255.0 /end CHARACTERISTIC
/begin CHARACTERISTIC DFES_Cls.DFC_ComEmacEVBlink_C "" VALUE 0x802416F7 Val_Wu8 3.000 DFES_OneToOne 0.00 3.000 FORMAT "%5.3" EXTENDED_LIMITS 0.00 255.0 /end CHARACTERISTIC
/begin CHARACTERISTIC DFES_Cls.DFC_ComEmacEVCont_C "" VALUE 0x802416F8 Val_Wu8 3.000 DFES_OneToOne 0.00 3.000 FORMAT "%5.3" EXTENDED_LIMITS 0.00 255.0 /end CHARACTERISTIC
/begin CHARACTERISTIC DFES_Cls.DFC_ComEmacMstCont_C "" VALUE 0x802416F9 Val_Wu8 3.000 DFES_OneToOne 0.00 3.000 FORMAT "%5.3" EXTENDED_LIMITS 0.00 255.0 /end CHARACTERISTIC
/begin CHARACTERISTIC DFES_Cls.DFC_ComEmacMsttBlink_C "" VALUE 0x802416FA Val_Wu8 3.000 DFES_OneToOne 0.00 3.000 FORMAT "%5.3" EXTENDED_LIMITS 0.00 255.0 /end CHARACTERISTIC
/begin CHARACTERISTIC DFES_Cls.DFC_ComEmacSVSBlink_C "" VALUE 0x802416FB Val_Wu8 3.000 DFES_OneToOne 0.00 3.000 FORMAT "%5.3" EXTENDED_LIMITS 0.00 255.0 /end CHARACTERISTIC
/begin CHARACTERISTIC DFES_Cls.DFC_ComEmacSVSCont_C "" VALUE 0x802416FC Val_Wu8 3.000 DFES_OneToOne 0.00 3.000 FORMAT "%5.3" EXTENDED_LIMITS 0.00 255.0 /end CHARACTERISTIC
/begin CHARACTERISTIC DFES_Cls.DFC_ComGunCntInfoWkuReq_C "" VALUE 0x802416FD Val_Wu8 3.000 DFES_OneToOne 0.00 3.000 FORMAT "%5.3" EXTENDED_LIMITS 0.00 255.0 /end CHARACTERISTIC
/begin CHARACTERISTIC DFES_Cls.DFC_ComHillHldFlt_C "" VALUE 0x802416FE Val_Wu8 3.000 DFES_OneToOne 0.00 3.000 FORMAT "%5.3" EXTENDED_LIMITS 0.00 255.0 /end CHARACTERISTIC
/begin CHARACTERISTIC DFES_Cls.DFC_ComHvBattRchrgWkuReq_C "" VALUE 0x802416FF Val_Wu8 3.000 DFES_OneToOne 0.00 3.000 FORMAT "%5.3" EXTENDED_LIMITS 0.00 255.0 /end CHARACTERISTIC
/begin CHARACTERISTIC DFES_Cls.DFC_ComHvbFltLvl2_C "" VALUE 0x80241700 Val_Wu8 3.000 DFES_OneToOne 0.00 3.000 FORMAT "%5.3" EXTENDED_LIMITS 0.00 255.0 /end CHARACTERISTIC
/begin CHARACTERISTIC DFES_Cls.DFC_ComHvbFltLvl3_C "" VALUE 0x80241701 Val_Wu8 3.000 DFES_OneToOne 0.00 3.000 FORMAT "%5.3" EXTENDED_LIMITS 0.00 255.0 /end CHARACTERISTIC
/begin CHARACTERISTIC DFES_Cls.DFC_ComHvbFltLvl4_C "" VALUE 0x80241702 Val_Wu8 3.000 DFES_OneToOne 0.00 3.000 FORMAT "%5.3" EXTENDED_LIMITS 0.00 255.0 /end CHARACTERISTIC
/begin CHARACTERISTIC DFES_Cls.DFC_ComHvbFltLvl5_C "" VALUE 0x80241703 Val_Wu8 3.000 DFES_OneToOne 0.00 3.000 FORMAT "%5.3" EXTENDED_LIMITS 0.00 255.0 /end CHARACTERISTIC
/begin CHARACTERISTIC DFES_Cls.DFC_ComHvbFltLvlRes_C "" VALUE 0x80241704 Val_Wu8 3.000 DFES_OneToOne 0.00 3.000 FORMAT "%5.3" EXTENDED_LIMITS 0.00 255.0 /end CHARACTERISTIC
/begin CHARACTERISTIC DFES_Cls.DFC_ComHvbMstBlink_C "" VALUE 0x80241705 Val_Wu8 3.000 DFES_OneToOne 0.00 3.000 FORMAT "%5.3" EXTENDED_LIMITS 0.00 255.0 /end CHARACTERISTIC
/begin CHARACTERISTIC DFES_Cls.DFC_ComHvbMstCont_C "" VALUE 0x80241706 Val_Wu8 3.000 DFES_OneToOne 0.00 3.000 FORMAT "%5.3" EXTENDED_LIMITS 0.00 255.0 /end CHARACTERISTIC
/begin CHARACTERISTIC DFES_Cls.DFC_ComImmoUnlockWkuReq_C "" VALUE 0x80241707 Val_Wu8 3.000 DFES_OneToOne 0.00 3.000 FORMAT "%5.3" EXTENDED_LIMITS 0.00 255.0 /end CHARACTERISTIC
/begin CHARACTERISTIC DFES_Cls.DFC_ComInfoReqPtlWkuReq_C "" VALUE 0x80241708 Val_Wu8 3.000 DFES_OneToOne 0.00 3.000 FORMAT "%5.3" EXTENDED_LIMITS 0.00 255.0 /end CHARACTERISTIC
/begin CHARACTERISTIC DFES_Cls.DFC_ComOBCFltLvl2_C "" VALUE 0x80241709 Val_Wu8 3.000 DFES_OneToOne 0.00 3.000 FORMAT "%5.3" EXTENDED_LIMITS 0.00 255.0 /end CHARACTERISTIC
/begin CHARACTERISTIC DFES_Cls.DFC_ComOBCFltLvl3_C "" VALUE 0x8024170A Val_Wu8 3.000 DFES_OneToOne 0.00 3.000 FORMAT "%5.3" EXTENDED_LIMITS 0.00 255.0 /end CHARACTERISTIC
/begin CHARACTERISTIC DFES_Cls.DFC_ComOBCFltLvl4_C "" VALUE 0x8024170B Val_Wu8 3.000 DFES_OneToOne 0.00 3.000 FORMAT "%5.3" EXTENDED_LIMITS 0.00 255.0 /end CHARACTERISTIC
/begin CHARACTERISTIC DFES_Cls.DFC_ComOBCFltLvl5_C "" VALUE 0x8024170C Val_Wu8 3.000 DFES_OneToOne 0.00 3.000 FORMAT "%5.3" EXTENDED_LIMITS 0.00 255.0 /end CHARACTERISTIC
/begin CHARACTERISTIC DFES_Cls.DFC_ComOBCFltLvlRes_C "" VALUE 0x8024170D Val_Wu8 3.000 DFES_OneToOne 0.00 3.000 FORMAT "%5.3" EXTENDED_LIMITS 0.00 255.0 /end CHARACTERISTIC
/begin CHARACTERISTIC DFES_Cls.DFC_ComPostOperationWkuReq_C "" VALUE 0x8024170E Val_Wu8 3.000 DFES_OneToOne 0.00 3.000 FORMAT "%5.3" EXTENDED_LIMITS 0.00 255.0 /end CHARACTERISTIC
/begin CHARACTERISTIC DFES_Cls.DFC_ComPreCondElecWkuReq_C "" VALUE 0x8024170F Val_Wu8 3.000 DFES_OneToOne 0.00 3.000 FORMAT "%5.3" EXTENDED_LIMITS 0.00 255.0 /end CHARACTERISTIC
/begin CHARACTERISTIC DFES_Cls.DFC_ComRemUnlckWkuReq_C "" VALUE 0x80241710 Val_Wu8 3.000 DFES_OneToOne 0.00 3.000 FORMAT "%5.3" EXTENDED_LIMITS 0.00 255.0 /end CHARACTERISTIC
/begin CHARACTERISTIC DFES_Cls.DFC_ComStpDlyHMIWkuReq_C "" VALUE 0x80241711 Val_Wu8 3.000 DFES_OneToOne 0.00 3.000 FORMAT "%5.3" EXTENDED_LIMITS 0.00 255.0 /end CHARACTERISTIC
/begin CHARACTERISTIC DFES_Cls.DFC_ComflgCurMeasmtErr_C "" VALUE 0x80241712 Val_Wu8 3.000 DFES_OneToOne 0.00 3.000 FORMAT "%5.3" EXTENDED_LIMITS 0.00 255.0 /end CHARACTERISTIC
/begin CHARACTERISTIC DFES_Cls.DFC_ComflgCurMeasmtSysErr_C "" VALUE 0x80241713 Val_Wu8 3.000 DFES_OneToOne 0.00 3.000 FORMAT "%5.3" EXTENDED_LIMITS 0.00 255.0 /end CHARACTERISTIC
/begin CHARACTERISTIC DFES_Cls.DFC_ComflgCurMeasmtVld_C "" VALUE 0x80241714 Val_Wu8 3.000 DFES_OneToOne 0.00 3.000 FORMAT "%5.3" EXTENDED_LIMITS 0.00 255.0 /end CHARACTERISTIC
/begin CHARACTERISTIC DFES_Cls.DFC_ComflgCurRngErr_C "" VALUE 0x80241715 Val_Wu8 3.000 DFES_OneToOne 0.00 3.000 FORMAT "%5.3" EXTENDED_LIMITS 0.00 255.0 /end CHARACTERISTIC
/begin CHARACTERISTIC DFES_Cls.DFC_ComflgTPcbMeasmtErr_C "" VALUE 0x80241716 Val_Wu8 3.000 DFES_OneToOne 0.00 3.000 FORMAT "%5.3" EXTENDED_LIMITS 0.00 255.0 /end CHARACTERISTIC
/begin CHARACTERISTIC DFES_Cls.DFC_ComflgTPcbMeasmtVld_C "" VALUE 0x80241717 Val_Wu8 3.000 DFES_OneToOne 0.00 3.000 FORMAT "%5.3" EXTENDED_LIMITS 0.00 255.0 /end CHARACTERISTIC
/begin CHARACTERISTIC DFES_Cls.DFC_ComflgTPcbRngErr_C "" VALUE 0x80241718 Val_Wu8 3.000 DFES_OneToOne 0.00 3.000 FORMAT "%5.3" EXTENDED_LIMITS 0.00 255.0 /end CHARACTERISTIC
/begin CHARACTERISTIC DFES_Cls.DFC_ComflgTPcbSysErr_C "" VALUE 0x80241719 Val_Wu8 3.000 DFES_OneToOne 0.00 3.000 FORMAT "%5.3" EXTENDED_LIMITS 0.00 255.0 /end CHARACTERISTIC
/begin CHARACTERISTIC DFES_Cls.DFC_ComflgTShntMeasmtErr_C "" VALUE 0x8024171A Val_Wu8 3.000 DFES_OneToOne 0.00 3.000 FORMAT "%5.3" EXTENDED_LIMITS 0.00 255.0 /end CHARACTERISTIC
/begin CHARACTERISTIC DFES_Cls.DFC_ComflgTShntMeasmtVld_C "" VALUE 0x8024171B Val_Wu8 3.000 DFES_OneToOne 0.00 3.000 FORMAT "%5.3" EXTENDED_LIMITS 0.00 255.0 /end CHARACTERISTIC
/begin CHARACTERISTIC DFES_Cls.DFC_ComflgTShntRngErr_C "" VALUE 0x8024171C Val_Wu8 3.000 DFES_OneToOne 0.00 3.000 FORMAT "%5.3" EXTENDED_LIMITS 0.00 255.0 /end CHARACTERISTIC
/begin CHARACTERISTIC DFES_Cls.DFC_ComflgTShntSysErr_C "" VALUE 0x8024171D Val_Wu8 3.000 DFES_OneToOne 0.00 3.000 FORMAT "%5.3" EXTENDED_LIMITS 0.00 255.0 /end CHARACTERISTIC
/begin CHARACTERISTIC DFES_Cls.DFC_ComflgVoltMeasmtErr_C "" VALUE 0x8024171E Val_Wu8 3.000 DFES_OneToOne 0.00 3.000 FORMAT "%5.3" EXTENDED_LIMITS 0.00 255.0 /end CHARACTERISTIC
/begin CHARACTERISTIC DFES_Cls.DFC_ComflgVoltMeasmtSysErr_C "" VALUE 0x8024171F Val_Wu8 3.000 DFES_OneToOne 0.00 3.000 FORMAT "%5.3" EXTENDED_LIMITS 0.00 255.0 /end CHARACTERISTIC
/begin CHARACTERISTIC DFES_Cls.DFC_ComflgVoltMeasmtVld_C "" VALUE 0x80241720 Val_Wu8 3.000 DFES_OneToOne 0.00 3.000 FORMAT "%5.3" EXTENDED_LIMITS 0.00 255.0 /end CHARACTERISTIC
/begin CHARACTERISTIC DFES_Cls.DFC_ComflgVoltRngErr_C "" VALUE 0x80241721 Val_Wu8 3.000 DFES_OneToOne 0.00 3.000 FORMAT "%5.3" EXTENDED_LIMITS 0.00 255.0 /end CHARACTERISTIC
/begin CHARACTERISTIC DFES_Cls.DFC_CrashEveOcc_C "" VALUE 0x80241722 Val_Wu8 3.000 DFES_OneToOne 0.00 3.000 FORMAT "%5.3" EXTENDED_LIMITS 0.00 255.0 /end CHARACTERISTIC
/begin CHARACTERISTIC DFES_Cls.DFC_DcdcFwdModStuck_C "" VALUE 0x80241723 Val_Wu8 3.000 DFES_OneToOne 0.00 3.000 FORMAT "%5.3" EXTENDED_LIMITS 0.00 255.0 /end CHARACTERISTIC
/begin CHARACTERISTIC DFES_Cls.DFC_DcdcLvUDifMaxFlt_C "" VALUE 0x80241724 Val_Wu8 3.000 DFES_OneToOne 0.00 3.000 FORMAT "%5.3" EXTENDED_LIMITS 0.00 255.0 /end CHARACTERISTIC
/begin CHARACTERISTIC DFES_Cls.DFC_DcdcOffModStuck_C "" VALUE 0x80241725 Val_Wu8 3.000 DFES_OneToOne 0.00 3.000 FORMAT "%5.3" EXTENDED_LIMITS 0.00 255.0 /end CHARACTERISTIC
/begin CHARACTERISTIC DFES_Cls.DFC_DcdcOperModFailr_C "" VALUE 0x80241726 Val_Wu8 3.000 DFES_OneToOne 0.00 3.000 FORMAT "%5.3" EXTENDED_LIMITS 0.00 255.0 /end CHARACTERISTIC
/begin CHARACTERISTIC DFES_Cls.DFC_DcdcPrecModStuck_C "" VALUE 0x80241727 Val_Wu8 3.000 DFES_OneToOne 0.00 3.000 FORMAT "%5.3" EXTENDED_LIMITS 0.00 255.0 /end CHARACTERISTIC
/begin CHARACTERISTIC DFES_Cls.DFC_DrvDoorOpn_C "" VALUE 0x80241728 Val_Wu8 3.000 DFES_OneToOne 0.00 3.000 FORMAT "%5.3" EXTENDED_LIMITS 0.00 255.0 /end CHARACTERISTIC
/begin CHARACTERISTIC DFES_Cls.DFC_DrvModPosnDfct_C "" VALUE 0x80241729 Val_Wu8 3.000 DFES_OneToOne 0.00 3.000 FORMAT "%5.3" EXTENDED_LIMITS 0.00 255.0 /end CHARACTERISTIC
/begin CHARACTERISTIC DFES_Cls.DFC_DrvStbltOpn_C "" VALUE 0x8024172A Val_Wu8 3.000 DFES_OneToOne 0.00 3.000 FORMAT "%5.3" EXTENDED_LIMITS 0.00 255.0 /end CHARACTERISTIC
/begin CHARACTERISTIC DFES_Cls.DFC_ETogFailrLvl3_C "" VALUE 0x8024172B Val_Wu8 3.000 DFES_OneToOne 0.00 3.000 FORMAT "%5.3" EXTENDED_LIMITS 0.00 255.0 /end CHARACTERISTIC
/begin CHARACTERISTIC DFES_Cls.DFC_ETogFailrLvl4_C "" VALUE 0x8024172C Val_Wu8 3.000 DFES_OneToOne 0.00 3.000 FORMAT "%5.3" EXTENDED_LIMITS 0.00 255.0 /end CHARACTERISTIC
/begin CHARACTERISTIC DFES_Cls.DFC_EbsLvBattSocDiagLo_C "" VALUE 0x8024172D Val_Wu8 3.000 DFES_OneToOne 0.00 3.000 FORMAT "%5.3" EXTENDED_LIMITS 0.00 255.0 /end CHARACTERISTIC
/begin CHARACTERISTIC DFES_Cls.DFC_EbsLvBattUDiagDiOper_C "" VALUE 0x8024172E Val_Wu8 3.000 DFES_OneToOne 0.00 3.000 FORMAT "%5.3" EXTENDED_LIMITS 0.00 255.0 /end CHARACTERISTIC
/begin CHARACTERISTIC DFES_Cls.DFC_EbsLvBattUDiagFltLvl1_C "" VALUE 0x8024172F Val_Wu8 3.000 DFES_OneToOne 0.00 3.000 FORMAT "%5.3" EXTENDED_LIMITS 0.00 255.0 /end CHARACTERISTIC
/begin CHARACTERISTIC DFES_Cls.DFC_EbsLvBattUDiagFltLvl2_C "" VALUE 0x80241730 Val_Wu8 3.000 DFES_OneToOne 0.00 3.000 FORMAT "%5.3" EXTENDED_LIMITS 0.00 255.0 /end CHARACTERISTIC
/begin CHARACTERISTIC DFES_Cls.DFC_EbsLvBattUDiagLo_C "" VALUE 0x80241731 Val_Wu8 3.000 DFES_OneToOne 0.00 3.000 FORMAT "%5.3" EXTENDED_LIMITS 0.00 255.0 /end CHARACTERISTIC
/begin CHARACTERISTIC DFES_Cls.DFC_EbsSnsrSt_C "" VALUE 0x80241732 Val_Wu8 3.000 DFES_OneToOne 0.00 3.000 FORMAT "%5.3" EXTENDED_LIMITS 0.00 255.0 /end CHARACTERISTIC
/begin CHARACTERISTIC DFES_Cls.DFC_EbsSofASILErr_C "" VALUE 0x80241733 Val_Wu8 3.000 DFES_OneToOne 0.00 3.000 FORMAT "%5.3" EXTENDED_LIMITS 0.00 255.0 /end CHARACTERISTIC
/begin CHARACTERISTIC DFES_Cls.DFC_ElTSPtSysLimDrvErr_C "" VALUE 0x80241734 Val_Wu8 3.000 DFES_OneToOne 0.00 3.000 FORMAT "%5.3" EXTENDED_LIMITS 0.00 255.0 /end CHARACTERISTIC
/begin CHARACTERISTIC DFES_Cls.DFC_ElTSPtSysLimRgnErr_C "" VALUE 0x80241735 Val_Wu8 3.000 DFES_OneToOne 0.00 3.000 FORMAT "%5.3" EXTENDED_LIMITS 0.00 255.0 /end CHARACTERISTIC
/begin CHARACTERISTIC DFES_Cls.DFC_HLCCcsFwDwnl_C "" VALUE 0x80241736 Val_Wu8 3.000 DFES_OneToOne 0.00 3.000 FORMAT "%5.3" EXTENDED_LIMITS 0.00 255.0 /end CHARACTERISTIC
/begin CHARACTERISTIC DFES_Cls.DFC_HvBattChrgPwrMax_C "" VALUE 0x80241737 Val_Wu8 3.000 DFES_OneToOne 0.00 3.000 FORMAT "%5.3" EXTENDED_LIMITS 0.00 255.0 /end CHARACTERISTIC
/begin CHARACTERISTIC DFES_Cls.DFC_HvBattCrashDetd_C "" VALUE 0x80241738 Val_Wu8 3.000 DFES_OneToOne 0.00 3.000 FORMAT "%5.3" EXTENDED_LIMITS 0.00 255.0 /end CHARACTERISTIC
/begin CHARACTERISTIC DFES_Cls.DFC_HvBattDchaPwrMax_C "" VALUE 0x80241739 Val_Wu8 3.000 DFES_OneToOne 0.00 3.000 FORMAT "%5.3" EXTENDED_LIMITS 0.00 255.0 /end CHARACTERISTIC
/begin CHARACTERISTIC DFES_Cls.DFC_HvBattEmgyOff_C "" VALUE 0x8024173A Val_Wu8 3.000 DFES_OneToOne 0.00 3.000 FORMAT "%5.3" EXTENDED_LIMITS 0.00 255.0 /end CHARACTERISTIC
/begin CHARACTERISTIC DFES_Cls.DFC_HvBattEmgyOffIntlck_C "" VALUE 0x8024173B Val_Wu8 3.000 DFES_OneToOne 0.00 3.000 FORMAT "%5.3" EXTENDED_LIMITS 0.00 255.0 /end CHARACTERISTIC
/begin CHARACTERISTIC DFES_Cls.DFC_HvBattEmgyOffReq_C "" VALUE 0x8024173C Val_Wu8 3.000 DFES_OneToOne 0.00 3.000 FORMAT "%5.3" EXTENDED_LIMITS 0.00 255.0 /end CHARACTERISTIC
/begin CHARACTERISTIC DFES_Cls.DFC_HvBattFltMod_C "" VALUE 0x8024173D Val_Wu8 3.000 DFES_OneToOne 0.00 3.000 FORMAT "%5.3" EXTENDED_LIMITS 0.00 255.0 /end CHARACTERISTIC
/begin CHARACTERISTIC DFES_Cls.DFC_HvBattIReqToChrgrErr_C "" VALUE 0x8024173E Val_Wu8 3.000 DFES_OneToOne 0.00 3.000 FORMAT "%5.3" EXTENDED_LIMITS 0.00 255.0 /end CHARACTERISTIC
/begin CHARACTERISTIC DFES_Cls.DFC_HvBattIReqToChrgrIni_C "" VALUE 0x8024173F Val_Wu8 3.000 DFES_OneToOne 0.00 3.000 FORMAT "%5.3" EXTENDED_LIMITS 0.00 255.0 /end CHARACTERISTIC
/begin CHARACTERISTIC DFES_Cls.DFC_HvBattIninTout_C "" VALUE 0x80241740 Val_Wu8 3.000 DFES_OneToOne 0.00 3.000 FORMAT "%5.3" EXTENDED_LIMITS 0.00 255.0 /end CHARACTERISTIC
/begin CHARACTERISTIC DFES_Cls.DFC_HvBattIntlckSt_C "" VALUE 0x80241741 Val_Wu8 3.000 DFES_OneToOne 0.00 3.000 FORMAT "%5.3" EXTENDED_LIMITS 0.00 255.0 /end CHARACTERISTIC
/begin CHARACTERISTIC DFES_Cls.DFC_HvBattIsoFlt_C "" VALUE 0x80241742 Val_Wu8 3.000 DFES_OneToOne 0.00 3.000 FORMAT "%5.3" EXTENDED_LIMITS 0.00 255.0 /end CHARACTERISTIC
/begin CHARACTERISTIC DFES_Cls.DFC_HvBattLimdPwr_C "" VALUE 0x80241743 Val_Wu8 3.000 DFES_OneToOne 0.00 3.000 FORMAT "%5.3" EXTENDED_LIMITS 0.00 255.0 /end CHARACTERISTIC
/begin CHARACTERISTIC DFES_Cls.DFC_HvBattMaiSwtClsngFlt_C "" VALUE 0x80241744 Val_Wu8 3.000 DFES_OneToOne 0.00 3.000 FORMAT "%5.3" EXTENDED_LIMITS 0.00 255.0 /end CHARACTERISTIC
/begin CHARACTERISTIC DFES_Cls.DFC_HvBattMaiSwtFlt_C "" VALUE 0x80241745 Val_Wu8 3.000 DFES_OneToOne 0.00 3.000 FORMAT "%5.3" EXTENDED_LIMITS 0.00 255.0 /end CHARACTERISTIC
/begin CHARACTERISTIC DFES_Cls.DFC_HvBattMaiSwtOpen_C "" VALUE 0x80241746 Val_Wu8 3.000 DFES_OneToOne 0.00 3.000 FORMAT "%5.3" EXTENDED_LIMITS 0.00 255.0 /end CHARACTERISTIC
/begin CHARACTERISTIC DFES_Cls.DFC_HvBattMaiSwtOpngFlt_C "" VALUE 0x80241747 Val_Wu8 3.000 DFES_OneToOne 0.00 3.000 FORMAT "%5.3" EXTENDED_LIMITS 0.00 255.0 /end CHARACTERISTIC
/begin MEASUREMENT DFC_b.LDF_EmWakeupSigSCG "" UBYTE DFC_OneToOne 1 100 0.00 1.000 BIT_MASK 0x10 FORMAT "%5.3" ECU_ADDRESS 0x60034BF9 /end MEASUREMENT
/begin MEASUREMENT DFC_b.LDF_Fan1OL "" UBYTE DFC_OneToOne 1 100 0.00 1.000 BIT_MASK 0x10 FORMAT "%5.3" ECU_ADDRESS 0x60034BFA /end MEASUREMENT
/begin MEASUREMENT DFC_b.LDF_Fan1OvrTemp "" UBYTE DFC_OneToOne 1 100 0.00 1.000 BIT_MASK 0x10 FORMAT "%5.3" ECU_ADDRESS 0x60034BFB /end MEASUREMENT
/begin MEASUREMENT DFC_b.LDF_Fan1SCB "" UBYTE DFC_OneToOne 1 100 0.00 1.000 BIT_MASK 0x10 FORMAT "%5.3" ECU_ADDRESS 0x60034BFC /end MEASUREMENT
/begin MEASUREMENT DFC_b.LDF_FanRlySCB "" UBYTE DFC_OneToOne 1 100 0.00 1.000 BIT_MASK 0x10 FORMAT "%5.3" ECU_ADDRESS 0x60034BFD /end MEASUREMENT
/begin MEASUREMENT DFC_b.LDF_FanRlySCG "" UBYTE DFC_OneToOne 1 100 0.00 1.000 BIT_MASK 0x10 FORMAT "%5.3" ECU_ADDRESS 0x60034BFE /end MEASUREMENT
/begin MEASUREMENT DFC_b.LDF_FanSpdSRCMin "" UBYTE DFC_OneToOne 1 100 0.00 1.000 BIT_MASK 0x10 FORMAT "%5.3" ECU_ADDRESS 0x60034BFF /end MEASUREMENT
/begin MEASUREMENT DFC_b.LDF_FreonPSRCMin "" UBYTE DFC_OneToOne 1 100 0.00 1.000 BIT_MASK 0x10 FORMAT "%5.3" ECU_ADDRESS 0x60034C00 /end MEASUREMENT
/begin MEASUREMENT DFC_b.LDF_HLCCcsPLnCChipTHi "" UBYTE DFC_OneToOne 1 100 0.00 1.000 BIT_MASK 0x10 FORMAT "%5.3" ECU_ADDRESS 0x60034C01 /end MEASUREMENT
/begin MEASUREMENT DFC_b.LDF_HeatrCoreTSRCMin "" UBYTE DFC_OneToOne 1 100 0.00 1.000 BIT_MASK 0x10 FORMAT "%5.3" ECU_ADDRESS 0x60034C02 /end MEASUREMENT
/begin MEASUREMENT DFC_b.LDF_PwmCtPSRCMin "" UBYTE DFC_OneToOne 1 100 0.00 1.000 BIT_MASK 0x10 FORMAT "%5.3" ECU_ADDRESS 0x60034C03 /end MEASUREMENT
/begin MEASUREMENT DFC_b.LDF_PwrDistbnUnitTSRCMin "" UBYTE DFC_OneToOne 1 100 0.00 1.000 BIT_MASK 0x10 FORMAT "%5.3" ECU_ADDRESS 0x60034C04 /end MEASUREMENT
/begin MEASUREMENT DFC_b.LDF_SCtPmp1OL "" UBYTE DFC_OneToOne 1 100 0.00 1.000 BIT_MASK 0x10 FORMAT "%5.3" ECU_ADDRESS 0x60034C05 /end MEASUREMENT
/begin MEASUREMENT DFC_b.LDF_SCtPmp1OvrTemp "" UBYTE DFC_OneToOne 1 100 0.00 1.000 BIT_MASK 0x10 FORMAT "%5.3" ECU_ADDRESS 0x60034C06 /end MEASUREMENT
/begin MEASUREMENT DFC_b.LDF_SCtPmp1SCB "" UBYTE DFC_OneToOne 1 100 0.00 1.000 BIT_MASK 0x10 FORMAT "%5.3" ECU_ADDRESS 0x60034C07 /end MEASUREMENT
/begin MEASUREMENT DFC_b.LDF_SCtPmpRlyOL "" UBYTE DFC_OneToOne 1 100 0.00 1.000 BIT_MASK 0x10 FORMAT "%5.3" ECU_ADDRESS 0x60034C08 /end MEASUREMENT
/begin MEASUREMENT DFC_b.LDF_SCtPmpRlyOvrTemp "" UBYTE DFC_OneToOne 1 100 0.00 1.000 BIT_MASK 0x10 FORMAT "%5.3" ECU_ADDRESS 0x60034C09 /end MEASUREMENT
/begin MEASUREMENT DFC_b.LDF_SCtPmpRlySCB "" UBYTE DFC_OneToOne 1 100 0.00 1.000 BIT_MASK 0x10 FORMAT "%5.3" ECU_ADDRESS 0x60034C0A /end MEASUREMENT
/begin MEASUREMENT DFC_b.LDF_SpplCooltPmpRlyOL "" UBYTE DFC_OneToOne 1 100 0.00 1.000 BIT_MASK 0x10 FORMAT "%5.3" ECU_ADDRESS 0x60034C0B /end MEASUREMENT
/begin MEASUREMENT DFC_b.LDF_SpplCooltPmpRlyOvrTemp "" UBYTE DFC_OneToOne 1 100 0.00 1.000 BIT_MASK 0x10 FORMAT "%5.3" ECU_ADDRESS 0x60034C0C /end MEASUREMENT
/begin MEASUREMENT DFC_b.LDF_SpplCooltPmpRlySCB "" UBYTE DFC_OneToOne 1 100 0.00 1.000 BIT_MASK 0x10 FORMAT "%5.3" ECU_ADDRESS 0x60034C0D /end MEASUREMENT
/begin MEASUREMENT DFC_b.LDF_UCtPSRCMin "" UBYTE DFC_OneToOne 1 100 0.00 1.000 BIT_MASK 0x10 FORMAT "%5.3" ECU_ADDRESS 0x60034C0E /end MEASUREMENT
/begin MEASUREMENT DFC_b.LDF_UPxP1SRCMin "" UBYTE DFC_OneToOne 1 100 0.00 1.000 BIT_MASK 0x10 FORMAT "%5.3" ECU_ADDRESS 0x60034C0F /end MEASUREMENT
/begin MEASUREMENT DFC_b.LDF_ComHSN1CANMute "" UBYTE DFC_OneToOne 1 100 0.00 1.000 BIT_MASK 0x10 FORMAT "%5.3" ECU_ADDRESS 0x60034C10 /end MEASUREMENT
/begin MEASUREMENT DFC_b.LDF_ComHSN3CANMute "" UBYTE DFC_OneToOne 1 100 0.00 1.000 BIT_MASK 0x10 FORMAT "%5.3" ECU_ADDRESS 0x60034C11 /end MEASUREMENT
/begin MEASUREMENT DFC_b.LDF_AcChrgrIntkTPhysRngHi "" UBYTE DFC_OneToOne 1 100 0.00 1.000 BIT_MASK 0x10 FORMAT "%5.3" ECU_ADDRESS 0x60034C12 /end MEASUREMENT
/begin MEASUREMENT DFC_b.LDF_AcChrgrIntkTPhysRngLo "" UBYTE DFC_OneToOne 1 100 0.00 1.000 BIT_MASK 0x10 FORMAT "%5.3" ECU_ADDRESS 0x60034C13 /end MEASUREMENT
/begin MEASUREMENT DFC_b.LDF_AcChrgrIntkTSRCOpn "" UBYTE DFC_OneToOne 1 100 0.00 1.000 BIT_MASK 0x10 FORMAT "%5.3" ECU_ADDRESS 0x60034C14 /end MEASUREMENT
/begin MEASUREMENT DFC_b.LDF_CcsPwrLineChpVccPhysRngHi "" UBYTE DFC_OneToOne 1 100 0.00 1.000 BIT_MASK 0x10 FORMAT "%5.3" ECU_ADDRESS 0x60034C15 /end MEASUREMENT
/begin MEASUREMENT DFC_b.LDF_CcsPwrLineChpVccPhysRngLo "" UBYTE DFC_OneToOne 1 100 0.00 1.000 BIT_MASK 0x10 FORMAT "%5.3" ECU_ADDRESS 0x60034C16 /end MEASUREMENT
/begin MEASUREMENT DFC_b.LDF_CcsPwrLineChpVccSRCOpn "" UBYTE DFC_OneToOne 1 100 0.00 1.000 BIT_MASK 0x10 FORMAT "%5.3" ECU_ADDRESS 0x60034C17 /end MEASUREMENT
/begin MEASUREMENT DFC_b.LDF_CcsPwrLineComChpTPhysRngHi "" UBYTE DFC_OneToOne 1 100 0.00 1.000 BIT_MASK 0x10 FORMAT "%5.3" ECU_ADDRESS 0x60034C18 /end MEASUREMENT
/begin MEASUREMENT DFC_b.LDF_CcsPwrLineComChpTPhysRngLo "" UBYTE DFC_OneToOne 1 100 0.00 1.000 BIT_MASK 0x10 FORMAT "%5.3" ECU_ADDRESS 0x60034C19 /end MEASUREMENT
/begin MEASUREMENT DFC_b.LDF_CcsPwrLineComChpTSRCOpn "" UBYTE DFC_OneToOne 1 100 0.00 1.000 BIT_MASK 0x10 FORMAT "%5.3" ECU_ADDRESS 0x60034C1A /end MEASUREMENT
/begin MEASUREMENT DFC_b.LDF_CtPSwtDiagPhysRngHi "" UBYTE DFC_OneToOne 1 100 0.00 1.000 BIT_MASK 0x10 FORMAT "%5.3" ECU_ADDRESS 0x60034C1B /end MEASUREMENT
/begin MEASUREMENT DFC_b.LDF_CtPSwtDiagPhysRngLo "" UBYTE DFC_OneToOne 1 100 0.00 1.000 BIT_MASK 0x10 FORMAT "%5.3" ECU_ADDRESS 0x60034C1C /end MEASUREMENT
/begin MEASUREMENT DFC_b.LDF_CtPSwtDiagSRCOpn "" UBYTE DFC_OneToOne 1 100 0.00 1.000 BIT_MASK 0x10 FORMAT "%5.3" ECU_ADDRESS 0x60034C1D /end MEASUREMENT
/begin MEASUREMENT DFC_b.LDF_CtpCarrFrqPhysRngHi "" UBYTE DFC_OneToOne 1 100 0.00 1.000 BIT_MASK 0x10 FORMAT "%5.3" ECU_ADDRESS 0x60034C1E /end MEASUREMENT
/begin MEASUREMENT DFC_b.LDF_CtpCarrFrqPhysRngLo "" UBYTE DFC_OneToOne 1 100 0.00 1.000 BIT_MASK 0x10 FORMAT "%5.3" ECU_ADDRESS 0x60034C1F /end MEASUREMENT
/begin MEASUREMENT DFC_b.LDF_CtpCarrFrqSRCMax "" UBYTE DFC_OneToOne 1 100 0.00 1.000 BIT_MASK 0x10 FORMAT "%5.3" ECU_ADDRESS 0x60034C20 /end MEASUREMENT
/begin MEASUREMENT DFC_b.LDF_DcChrgrIntkT2PhysRngHi "" UBYTE DFC_OneToOne 1 100 0.00 1.000 BIT_MASK 0x10 FORMAT "%5.3" ECU_ADDRESS 0x60034C21 /end MEASUREMENT
/begin MEASUREMENT DFC_b.LDF_DcChrgrIntkT2PhysRngLo "" UBYTE DFC_OneToOne 1 100 0.00 1.000 BIT_MASK 0x10 FORMAT "%5.3" ECU_ADDRESS 0x60034C22 /end MEASUREMENT
/begin MEASUREMENT DFC_b.LDF_DcChrgrIntkT2SRCOpn "" UBYTE DFC_OneToOne 1 100 0.00 1.000 BIT_MASK 0x10 FORMAT "%5.3" ECU_ADDRESS 0x60034C23 /end MEASUREMENT
/begin MEASUREMENT DFC_b.LDF_DcChrgrIntkTPhysRngHi "" UBYTE DFC_OneToOne 1 100 0.00 1.000 BIT_MASK 0x10 FORMAT "%5.3" ECU_ADDRESS 0x60034C24 /end MEASUREMENT
/begin MEASUREMENT DFC_b.LDF_DcChrgrIntkTPhysRngLo "" UBYTE DFC_OneToOne 1 100 0.00 1.000 BIT_MASK 0x10 FORMAT "%5.3" ECU_ADDRESS 0x60034C25 /end MEASUREMENT
/begin MEASUREMENT DFC_b.LDF_DcChrgrIntkTSRCOpn "" UBYTE DFC_OneToOne 1 100 0.00 1.000 BIT_MASK 0x10 FORMAT "%5.3" ECU_ADDRESS 0x60034C26 /end MEASUREMENT
/begin MEASUREMENT DFC_b.LDF_Fan1SCG "" UBYTE DFC_OneToOne 1 100 0.00 1.000 BIT_MASK 0x10 FORMAT "%5.3" ECU_ADDRESS 0x60034C27 /end MEASUREMENT
/begin MEASUREMENT DFC_b.LDF_FanSpdPhysRngHi "" UBYTE DFC_OneToOne 1 100 0.00 1.000 BIT_MASK 0x10 FORMAT "%5.3" ECU_ADDRESS 0x60034C28 /end MEASUREMENT
/begin MEASUREMENT DFC_b.LDF_FanSpdPhysRngLo "" UBYTE DFC_OneToOne 1 100 0.00 1.000 BIT_MASK 0x10 FORMAT "%5.3" ECU_ADDRESS 0x60034C29 /end MEASUREMENT
/begin MEASUREMENT DFC_b.LDF_FanSpdSRCOpn "" UBYTE DFC_OneToOne 1 100 0.00 1.000 BIT_MASK 0x10 FORMAT "%5.3" ECU_ADDRESS 0x60034C2A /end MEASUREMENT
/begin MEASUREMENT DFC_b.LDF_FreonPPhysRngHi "" UBYTE DFC_OneToOne 1 100 0.00 1.000 BIT_MASK 0x10 FORMAT "%5.3" ECU_ADDRESS 0x60034C2B /end MEASUREMENT
/begin MEASUREMENT DFC_b.LDF_FreonPPhysRngLo "" UBYTE DFC_OneToOne 1 100 0.00 1.000 BIT_MASK 0x10 FORMAT "%5.3" ECU_ADDRESS 0x60034C2C /end MEASUREMENT
/begin MEASUREMENT DFC_b.LDF_FreonPSRCOpn "" UBYTE DFC_OneToOne 1 100 0.00 1.000 BIT_MASK 0x10 FORMAT "%5.3" ECU_ADDRESS 0x60034C2D /end MEASUREMENT
/begin MEASUREMENT DFC_b.LDF_HeatrCoreTPhysRngHi "" UBYTE DFC_OneToOne 1 100 0.00 1.000 BIT_MASK 0x10 FORMAT "%5.3" ECU_ADDRESS 0x60034C2E /end MEASUREMENT
/begin MEASUREMENT DFC_b.LDF_HeatrCoreTPhysRngLo "" UBYTE DFC_OneToOne 1 100 0.00 1.000 BIT_MASK 0x10 FORMAT "%5.3" ECU_ADDRESS 0x60034C2F /end MEASUREMENT
/begin MEASUREMENT DFC_b.LDF_HeatrCoreTSRCOpn "" UBYTE DFC_OneToOne 1 100 0.00 1.000 BIT_MASK 0x10 FORMAT "%5.3" ECU_ADDRESS 0x60034C30 /end MEASUREMENT
/begin MEASUREMENT DFC_b.LDF_HvGridUMaxSftyLim "" UBYTE DFC_OneToOne 1 100 0.00 1.000 BIT_MASK 0x10 FORMAT "%5.3" ECU_ADDRESS 0x60034C31 /end MEASUREMENT
/begin MEASUREMENT DFC_b.LDF_HvGridUMinSftyLim "" UBYTE DFC_OneToOne 1 100 0.00 1.000 BIT_MASK 0x10 FORMAT "%5.3" ECU_ADDRESS 0x60034C32 /end MEASUREMENT
/begin MEASUREMENT DFC_b.LDF_HvGridUPlausy "" UBYTE DFC_OneToOne 1 100 0.00 1.000 BIT_MASK 0x10 FORMAT "%5.3" ECU_ADDRESS 0x60034C33 /end MEASUREMENT
/begin MEASUREMENT DFC_b.LDF_IntlckChrgPlgHBrgOpnLd "" UBYTE DFC_OneToOne 1 100 0.00 1.000 BIT_MASK 0x10 FORMAT "%5.3" ECU_ADDRESS 0x60034C34 /end MEASUREMENT
/begin MEASUREMENT DFC_b.LDF_IntlckChrgPlgHBrgOvrCurr "" UBYTE DFC_OneToOne 1 100 0.00 1.000 BIT_MASK 0x10 FORMAT "%5.3" ECU_ADDRESS 0x60034C35 /end MEASUREMENT
/begin MEASUREMENT DFC_b.LDF_IntlckChrgPlgHBrgOvrTemp "" UBYTE DFC_OneToOne 1 100 0.00 1.000 BIT_MASK 0x10 FORMAT "%5.3" ECU_ADDRESS 0x60034C36 /end MEASUREMENT
/begin MEASUREMENT DFC_b.LDF_IntlckChrgPlgHBrgShCirBatt1 "" UBYTE DFC_OneToOne 1 100 0.00 1.000 BIT_MASK 0x10 FORMAT "%5.3" ECU_ADDRESS 0x60034C37 /end MEASUREMENT
/begin MEASUREMENT DFC_b.LDF_IntlckChrgPlgHBrgShCirBatt2 "" UBYTE DFC_OneToOne 1 100 0.00 1.000 BIT_MASK 0x10 FORMAT "%5.3" ECU_ADDRESS 0x60034C38 /end MEASUREMENT
/begin MEASUREMENT DFC_b.LDF_IntlckChrgPlgHBrgShCirGnd1 "" UBYTE DFC_OneToOne 1 100 0.00 1.000 BIT_MASK 0x10 FORMAT "%5.3" ECU_ADDRESS 0x60034C39 /end MEASUREMENT
/begin MEASUREMENT DFC_b.LDF_IntlckChrgPlgHBrgShCirGnd2 "" UBYTE DFC_OneToOne 1 100 0.00 1.000 BIT_MASK 0x10 FORMAT "%5.3" ECU_ADDRESS 0x60034C3A /end MEASUREMENT
/begin MEASUREMENT DFC_b.LDF_IntlckChrgPlgHBrgShCirOvrLd "" UBYTE DFC_OneToOne 1 100 0.00 1.000 BIT_MASK 0x10 FORMAT "%5.3" ECU_ADDRESS 0x60034C3B /end MEASUREMENT
/begin MEASUREMENT DFC_b.LDF_IntlckChrgPlgHBrgTempOvrCurr "" UBYTE DFC_OneToOne 1 100 0.00 1.000 BIT_MASK 0x10 FORMAT "%5.3" ECU_ADDRESS 0x60034C3C /end MEASUREMENT
/begin MEASUREMENT DFC_b.LDF_IntlckChrgPlgHBrgUndrVltg "" UBYTE DFC_OneToOne 1 100 0.00 1.000 BIT_MASK 0x10 FORMAT "%5.3" ECU_ADDRESS 0x60034C3D /end MEASUREMENT
/begin MEASUREMENT DFC_b.LDF_IntlckChrgPlgPosnRngFlt "" UBYTE DFC_OneToOne 1 100 0.00 1.000 BIT_MASK 0x10 FORMAT "%5.3" ECU_ADDRESS 0x60034C3E /end MEASUREMENT
/begin MEASUREMENT DFC_b.LDF_IntlckChrgPlgPosnSrcMax "" UBYTE DFC_OneToOne 1 100 0.00 1.000 BIT_MASK 0x10 FORMAT "%5.3" ECU_ADDRESS 0x60034C3F /end MEASUREMENT
/begin MEASUREMENT DFC_b.LDF_IntlckChrgPlgPosnSrcMin "" UBYTE DFC_OneToOne 1 100 0.00 1.000 BIT_MASK 0x10 FORMAT "%5.3" ECU_ADDRESS 0x60034C40 /end MEASUREMENT
/begin MEASUREMENT DFC_b.LDF_PwmCtPPhysRngHi "" UBYTE DFC_OneToOne 1 100 0.00 1.000 BIT_MASK 0x10 FORMAT "%5.3" ECU_ADDRESS 0x60034C41 /end MEASUREMENT
/begin MEASUREMENT DFC_b.LDF_PwmCtPPhysRngLo "" UBYTE DFC_OneToOne 1 100 0.00 1.000 BIT_MASK 0x10 FORMAT "%5.3" ECU_ADDRESS 0x60034C42 /end MEASUREMENT
/begin MEASUREMENT DFC_b.LDF_PwmCtPSRCMax "" UBYTE DFC_OneToOne 1 100 0.00 1.000 BIT_MASK 0x10 FORMAT "%5.3" ECU_ADDRESS 0x60034C43 /end MEASUREMENT
/begin MEASUREMENT DFC_b.LDF_PwrDistbnUnitTPhysRngHi "" UBYTE DFC_OneToOne 1 100 0.00 1.000 BIT_MASK 0x10 FORMAT "%5.3" ECU_ADDRESS 0x60034C44 /end MEASUREMENT
/begin MEASUREMENT DFC_b.LDF_PwrDistbnUnitTPhysRngLo "" UBYTE DFC_OneToOne 1 100 0.00 1.000 BIT_MASK 0x10 FORMAT "%5.3" ECU_ADDRESS 0x60034C45 /end MEASUREMENT
/begin MEASUREMENT DFC_b.LDF_PwrDistbnUnitTSRCOpn "" UBYTE DFC_OneToOne 1 100 0.00 1.000 BIT_MASK 0x10 FORMAT "%5.3" ECU_ADDRESS 0x60034C46 /end MEASUREMENT
/begin MEASUREMENT DFC_b.LDF_SCtPmpRlySCG "" UBYTE DFC_OneToOne 1 100 0.00 1.000 BIT_MASK 0x10 FORMAT "%5.3" ECU_ADDRESS 0x60034C47 /end MEASUREMENT
/begin MEASUREMENT DFC_b.LDF_SpplCooltPmpRlySCG "" UBYTE DFC_OneToOne 1 100 0.00 1.000 BIT_MASK 0x10 FORMAT "%5.3" ECU_ADDRESS 0x60034C48 /end MEASUREMENT
/begin MEASUREMENT DFC_b.LDF_UCtPPhysRngHi "" UBYTE DFC_OneToOne 1 100 0.00 1.000 BIT_MASK 0x10 FORMAT "%5.3" ECU_ADDRESS 0x60034C49 /end MEASUREMENT
/begin MEASUREMENT DFC_b.LDF_UCtPPhysRngLo "" UBYTE DFC_OneToOne 1 100 0.00 1.000 BIT_MASK 0x10 FORMAT "%5.3" ECU_ADDRESS 0x60034C4A /end MEASUREMENT
/begin MEASUREMENT DFC_b.LDF_UCtPSRCOpn "" UBYTE DFC_OneToOne 1 100 0.00 1.000 BIT_MASK 0x10 FORMAT "%5.3" ECU_ADDRESS 0x60034C4B /end MEASUREMENT
/begin MEASUREMENT DFC_b.LDF_UPxP1PhysRngHi "" UBYTE DFC_OneToOne 1 100 0.00 1.000 BIT_MASK 0x10 FORMAT "%5.3" ECU_ADDRESS 0x60034C4C /end MEASUREMENT
/begin MEASUREMENT DFC_b.LDF_UPxP1PhysRngLo "" UBYTE DFC_OneToOne 1 100 0.00 1.000 BIT_MASK 0x10 FORMAT "%5.3" ECU_ADDRESS 0x60034C4D /end MEASUREMENT
/begin MEASUREMENT DFC_b.LDF_UPxP1SRCOpn "" UBYTE DFC_OneToOne 1 100 0.00 1.000 BIT_MASK 0x10 FORMAT "%5.3" ECU_ADDRESS 0x60034C4E /end MEASUREMENT
/begin MEASUREMENT DFC_b.LDF_VehVPhysRngHi "" UBYTE DFC_OneToOne 1 100 0.00 1.000 BIT_MASK 0x10 FORMAT "%5.3" ECU_ADDRESS 0x60034C4F /end MEASUREMENT
/begin MEASUREMENT DFC_b.LDF_VehVPhysRngLo "" UBYTE DFC_OneToOne 1 100 0.00 1.000 BIT_MASK 0x10 FORMAT "%5.3" ECU_ADDRESS 0x60034C50 /end MEASUREMENT
/begin MEASUREMENT DFC_b.LDF_VehVSigCan "" UBYTE DFC_OneToOne 1 100 0.00 1.000 BIT_MASK 0x10 FORMAT "%5.3" ECU_ADDRESS 0x60034C51 /end MEASUREMENT
/begin MEASUREMENT DFC_b.LDF_VehVSigCanSafe "" UBYTE DFC_OneToOne 1 100 0.00 1.000 BIT_MASK 0x10 FORMAT "%5.3" ECU_ADDRESS 0x60034C52 /end MEASUREMENT
/begin MEASUREMENT DFC_b.LDF_SCtPmp1DiagGrdKey1 "" UBYTE DFC_OneToOne 1 100 0.00 1.000 BIT_MASK 0x10 FORMAT "%5.3" ECU_ADDRESS 0x60034C53 /end MEASUREMENT
/begin MEASUREMENT DFC_b.LDF_SCtPmp1DiagGrdKey2 "" UBYTE DFC_OneToOne 1 100 0.00 1.000 BIT_MASK 0x10 FORMAT "%5.3" ECU_ADDRESS 0x60034C54 /end MEASUREMENT
/begin MEASUREMENT DFC_b.LDF_SCtPmp1DiagGrdKey3 "" UBYTE DFC_OneToOne 1 100 0.00 1.000 BIT_MASK 0x10 FORMAT "%5.3" ECU_ADDRESS 0x60034C55 /end MEASUREMENT
/begin MEASUREMENT DFC_b.LDF_SCtPmp1DiagGrdKey4 "" UBYTE DFC_OneToOne 1 100 0.00 1.000 BIT_MASK 0x10 FORMAT "%5.3" ECU_ADDRESS 0x60034C56 /end MEASUREMENT
/begin MEASUREMENT DFC_b.LDF_SCtPmp1DiagGrdKey5 "" UBYTE DFC_OneToOne 1 100 0.00 1.000 BIT_MASK 0x10 FORMAT "%5.3" ECU_ADDRESS 0x60034C57 /end MEASUREMENT
/begin MEASUREMENT DFC_b.LDF_ChrgPlgLiveCntctHzrdCcs "" UBYTE DFC_OneToOne 1 100 0.00 1.000 BIT_MASK 0x10 FORMAT "%5.3" ECU_ADDRESS 0x60034C58 /end MEASUREMENT
/begin MEASUREMENT DFC_b.LDF_ChrgPlgProxPltImps "" UBYTE DFC_OneToOne 1 100 0.00 1.000 BIT_MASK 0x10 FORMAT "%5.3" ECU_ADDRESS 0x60034C59 /end MEASUREMENT
/begin MEASUREMENT DFC_b.LDF_ChrgPlgTHiCcsDc "" UBYTE DFC_OneToOne 1 100 0.00 1.000 BIT_MASK 0x10 FORMAT "%5.3" ECU_ADDRESS 0x60034C5A /end MEASUREMENT
/begin MEASUREMENT DFC_b.LDF_ElMActvDchaFailr "" UBYTE DFC_OneToOne 1 100 0.00 1.000 BIT_MASK 0x10 FORMAT "%5.3" ECU_ADDRESS 0x60034C5B /end MEASUREMENT
/begin MEASUREMENT DFC_b.LDF_ElMActvDchaFlt "" UBYTE DFC_OneToOne 1 100 0.00 1.000 BIT_MASK 0x10 FORMAT "%5.3" ECU_ADDRESS 0x60034C5C /end MEASUREMENT
/begin MEASUREMENT DFC_b.LDF_ElMFbdnIvtrModDrv01 "" UBYTE DFC_OneToOne 1 100 0.00 1.000 BIT_MASK 0x10 FORMAT "%5.3" ECU_ADDRESS 0x60034C5D /end MEASUREMENT
/begin MEASUREMENT DFC_b.LDF_ElMImobAuthent "" UBYTE DFC_OneToOne 1 100 0.00 1.000 BIT_MASK 0x10 FORMAT "%5.3" ECU_ADDRESS 0x60034C5E /end MEASUREMENT
/begin MEASUREMENT DFC_b.LDF_ElMIsoMonFlt "" UBYTE DFC_OneToOne 1 100 0.00 1.000 BIT_MASK 0x10 FORMAT "%5.3" ECU_ADDRESS 0x60034C5F /end MEASUREMENT
/begin MEASUREMENT DFC_b.LDF_ElMIsoMonPlausyFlt "" UBYTE DFC_OneToOne 1 100 0.00 1.000 BIT_MASK 0x10 FORMAT "%5.3" ECU_ADDRESS 0x60034C60 /end MEASUREMENT
/begin MEASUREMENT DFC_b.LDF_ElMIvtrCooltT01 "" UBYTE DFC_OneToOne 1 100 0.00 1.000 BIT_MASK 0x10 FORMAT "%5.3" ECU_ADDRESS 0x60034C61 /end MEASUREMENT
/begin MEASUREMENT DFC_b.LDF_ElMIvtrEmgyShtDwn01 "" UBYTE DFC_OneToOne 1 100 0.00 1.000 BIT_MASK 0x10 FORMAT "%5.3" ECU_ADDRESS 0x60034C62 /end MEASUREMENT
/begin MEASUREMENT DFC_b.LDF_ElMIvtrFailr01 "" UBYTE DFC_OneToOne 1 100 0.00 1.000 BIT_MASK 0x10 FORMAT "%5.3" ECU_ADDRESS 0x60034C63 /end MEASUREMENT
/begin MEASUREMENT DFC_b.LDF_ElMIvtrIntlck01 "" UBYTE DFC_OneToOne 1 100 0.00 1.000 BIT_MASK 0x10 FORMAT "%5.3" ECU_ADDRESS 0x60034C64 /end MEASUREMENT
/begin MEASUREMENT DFC_b.LDF_ElMIvtrTErr01 "" UBYTE DFC_OneToOne 1 100 0.00 1.000 BIT_MASK 0x10 FORMAT "%5.3" ECU_ADDRESS 0x60034C65 /end MEASUREMENT
/begin MEASUREMENT DFC_b.LDF_ElMOverSpdNeg01 "" UBYTE DFC_OneToOne 1 100 0.00 1.000 BIT_MASK 0x10 FORMAT "%5.3" ECU_ADDRESS 0x60034C66 /end MEASUREMENT
/begin MEASUREMENT DFC_b.LDF_ElMOverSpdPos01 "" UBYTE DFC_OneToOne 1 100 0.00 1.000 BIT_MASK 0x10 FORMAT "%5.3" ECU_ADDRESS 0x60034C67 /end MEASUREMENT
/begin MEASUREMENT DFC_b.LDF_ElMOverTqNeg01 "" UBYTE DFC_OneToOne 1 100 0.00 1.000 BIT_MASK 0x10 FORMAT "%5.3" ECU_ADDRESS 0x60034C68 /end MEASUREMENT
/begin MEASUREMENT DFC_b.LDF_ElMOverTqPos01 "" UBYTE DFC_OneToOne 1 100 0.00 1.000 BIT_MASK 0x10 FORMAT "%5.3" ECU_ADDRESS 0x60034C69 /end MEASUREMENT
/begin MEASUREMENT DFC_b.LDF_ElMPwrAuthn "" UBYTE DFC_OneToOne 1 100 0.00 1.000 BIT_MASK 0x10 FORMAT "%5.3" ECU_ADDRESS 0x60034C6A /end MEASUREMENT
/begin MEASUREMENT DFC_b.LDF_ElMSpdErr01 "" UBYTE DFC_OneToOne 1 100 0.00 1.000 BIT_MASK 0x10 FORMAT "%5.3" ECU_ADDRESS 0x60034C6B /end MEASUREMENT
/begin MEASUREMENT DFC_b.LDF_ElMSvs01 "" UBYTE DFC_OneToOne 1 100 0.00 1.000 BIT_MASK 0x10 FORMAT "%5.3" ECU_ADDRESS 0x60034C6C /end MEASUREMENT
/begin MEASUREMENT DFC_b.LDF_PEnvCcMax "" UBYTE DFC_OneToOne 1 100 0.00 1.000 BIT_MASK 0x10 FORMAT "%5.3" ECU_ADDRESS 0x60034C6D /end MEASUREMENT
/begin MEASUREMENT DFC_b.LDF_PEnvCcMin "" UBYTE DFC_OneToOne 1 100 0.00 1.000 BIT_MASK 0x10 FORMAT "%5.3" ECU_ADDRESS 0x60034C6E /end MEASUREMENT
/begin MEASUREMENT DFC_b.LDF_PEnvRngChkMax "" UBYTE DFC_OneToOne 1 100 0.00 1.000 BIT_MASK 0x10 FORMAT "%5.3" ECU_ADDRESS 0x60034C6F /end MEASUREMENT
/begin MEASUREMENT DFC_b.LDF_PEnvRngChkMin "" UBYTE DFC_OneToOne 1 100 0.00 1.000 BIT_MASK 0x10 FORMAT "%5.3" ECU_ADDRESS 0x60034C70 /end MEASUREMENT
/begin MEASUREMENT DFC_b.LDF_PEnvSnsrPlaus "" UBYTE DFC_OneToOne 1 100 0.00 1.000 BIT_MASK 0x10 FORMAT "%5.3" ECU_ADDRESS 0x60034C71 /end MEASUREMENT
/begin MEASUREMENT DFC_b.LDF_BrkBstPmpPlausGenn "" UBYTE DFC_OneToOne 1 100 0.00 1.000 BIT_MASK 0x10 FORMAT "%5.3" ECU_ADDRESS 0x60034C72 /end MEASUREMENT
/begin MEASUREMENT DFC_b.LDF_CbnHeatrRlyLfLoWarn "" UBYTE DFC_OneToOne 1 100 0.00 1.000 BIT_MASK 0x10 FORMAT "%5.3" ECU_ADDRESS 0x60034C73 /end MEASUREMENT
/begin MEASUREMENT DFC_b.LDF_ChgrPlugLockPinByndClsd "" UBYTE DFC_OneToOne 1 100 0.00 1.000 BIT_MASK 0x10 FORMAT "%5.3" ECU_ADDRESS 0x60034C74 /end MEASUREMENT
/begin MEASUREMENT DFC_b.LDF_ChgrPlugLockPinMoveWoCmd "" UBYTE DFC_OneToOne 1 100 0.00 1.000 BIT_MASK 0x10 FORMAT "%5.3" ECU_ADDRESS 0x60034C75 /end MEASUREMENT
/begin MEASUREMENT DFC_b.LDF_ChgrPlugLockPinStuckInClsd "" UBYTE DFC_OneToOne 1 100 0.00 1.000 BIT_MASK 0x10 FORMAT "%5.3" ECU_ADDRESS 0x60034C76 /end MEASUREMENT
/begin MEASUREMENT DFC_b.LDF_ChgrPlugLockPinStuckInOpen "" UBYTE DFC_OneToOne 1 100 0.00 1.000 BIT_MASK 0x10 FORMAT "%5.3" ECU_ADDRESS 0x60034C77 /end MEASUREMENT
/begin MEASUREMENT DFC_b.LDF_ChrgrStErr "" UBYTE DFC_OneToOne 1 100 0.00 1.000 BIT_MASK 0x10 FORMAT "%5.3" ECU_ADDRESS 0x60034C78 /end MEASUREMENT
/begin MEASUREMENT DFC_b.LDF_ComHSN1BusOff "" UBYTE DFC_OneToOne 1 100 0.00 1.000 BIT_MASK 0x10 FORMAT "%5.3" ECU_ADDRESS 0x60034C79 /end MEASUREMENT
/begin MEASUREMENT DFC_b.LDF_ComHSN3BusOff "" UBYTE DFC_OneToOne 1 100 0.00 1.000 BIT_MASK 0x10 FORMAT "%5.3" ECU_ADDRESS 0x60034C7A /end MEASUREMENT
/begin MEASUREMENT DFC_b.LDF_ComVCInval "" UBYTE DFC_OneToOne 1 100 0.00 1.000 BIT_MASK 0x10 FORMAT "%5.3" ECU_ADDRESS 0x60034C7B /end MEASUREMENT
/begin MEASUREMENT DFC_b.LDF_EemDcdcPrecSpdInhb "" UBYTE DFC_OneToOne 1 100 0.00 1.000 BIT_MASK 0x10 FORMAT "%5.3" ECU_ADDRESS 0x60034C7C /end MEASUREMENT
/begin MEASUREMENT DFC_b.LDF_ExpPwrLatch "" UBYTE DFC_OneToOne 1 100 0.00 1.000 BIT_MASK 0x10 FORMAT "%5.3" ECU_ADDRESS 0x60034C7D /end MEASUREMENT
/begin MEASUREMENT DFC_b.LDF_FanMaxOvrd "" UBYTE DFC_OneToOne 1 100 0.00 1.000 BIT_MASK 0x10 FORMAT "%5.3" ECU_ADDRESS 0x60034C7E /end MEASUREMENT
/begin MEASUREMENT DFC_b.LDF_HLCCcsGnrlComErr "" UBYTE DFC_OneToOne 1 100 0.00 1.000 BIT_MASK 0x10 FORMAT "%5.3" ECU_ADDRESS 0x60034C7F /end MEASUREMENT
/begin MEASUREMENT DFC_b.LDF_InmLINNodeHVACPanelAbsnt "" UBYTE DFC_OneToOne 1 100 0.00 1.000 BIT_MASK 0x10 FORMAT "%5.3" ECU_ADDRESS 0x60034C80 /end MEASUREMENT
/begin MEASUREMENT DFC_b.LDF_ResetRcvNotAllwd "" UBYTE DFC_OneToOne 1 100 0.00 1.000 BIT_MASK 0x10 FORMAT "%5.3" ECU_ADDRESS 0x60034C81 /end MEASUREMENT
/begin MEASUREMENT DFC_b.LDF_TelltlCooltPlaus "" UBYTE DFC_OneToOne 1 100 0.00 1.000 BIT_MASK 0x10 FORMAT "%5.3" ECU_ADDRESS 0x60034C82 /end MEASUREMENT
/begin MEASUREMENT DFC_b.LDF_MRlyOL "" UBYTE DFC_OneToOne 1 100 0.00 1.000 BIT_MASK 0x10 FORMAT "%5.3" ECU_ADDRESS 0x60034C83 /end MEASUREMENT
/begin MEASUREMENT DFC_b.LDF_MRlySCB "" UBYTE DFC_OneToOne 1 100 0.00 1.000 BIT_MASK 0x10 FORMAT "%5.3" ECU_ADDRESS 0x60034C84 /end MEASUREMENT
/begin MEASUREMENT DFC_b.LDF_MRlySCG "" UBYTE DFC_OneToOne 1 100 0.00 1.000 BIT_MASK 0x10 FORMAT "%5.3" ECU_ADDRESS 0x60034C85 /end MEASUREMENT
/begin MEASUREMENT DFC_b.LDF_SSpMon1 "" UBYTE DFC_OneToOne 1 100 0.00 1.000 BIT_MASK 0x10 FORMAT "%5.3" ECU_ADDRESS 0x60034C86 /end MEASUREMENT
/begin MEASUREMENT DFC_b.LDF_SSpMon1OV "" UBYTE DFC_OneToOne 1 100 0.00 1.000 BIT_MASK 0x10 FORMAT "%5.3" ECU_ADDRESS 0x60034C87 /end MEASUREMENT
/begin MEASUREMENT DFC_b.LDF_SSpMon1SCG "" UBYTE DFC_OneToOne 1 100 0.00 1.000 BIT_MASK 0x10 FORMAT "%5.3" ECU_ADDRESS 0x60034C88 /end MEASUREMENT
/begin MEASUREMENT DFC_b.LDF_SSpMon1UV "" UBYTE DFC_OneToOne 1 100 0.00 1.000 BIT_MASK 0x10 FORMAT "%5.3" ECU_ADDRESS 0x60034C89 /end MEASUREMENT
/begin MEASUREMENT DFC_b.LDF_SSpMon2 "" UBYTE DFC_OneToOne 1 100 0.00 1.000 BIT_MASK 0x10 FORMAT "%5.3" ECU_ADDRESS 0x60034C8A /end MEASUREMENT
/begin MEASUREMENT DFC_b.LDF_SSpMon2OV "" UBYTE DFC_OneToOne 1 100 0.00 1.000 BIT_MASK 0x10 FORMAT "%5.3" ECU_ADDRESS 0x60034C8B /end MEASUREMENT
/begin MEASUREMENT DFC_b.LDF_SSpMon2SCG "" UBYTE DFC_OneToOne 1 100 0.00 1.000 BIT_MASK 0x10 FORMAT "%5.3" ECU_ADDRESS 0x60034C8C /end MEASUREMENT
/begin MEASUREMENT DFC_b.LDF_SSpMon2UV "" UBYTE DFC_OneToOne 1 100 0.00 1.000 BIT_MASK 0x10 FORMAT "%5.3" ECU_ADDRESS 0x60034C8D /end MEASUREMENT
/begin MEASUREMENT DFC_b.LDF_SSpMon3 "" UBYTE DFC_OneToOne 1 100 0.00 1.000 BIT_MASK 0x10 FORMAT "%5.3" ECU_ADDRESS 0x60034C8E /end MEASUREMENT
/begin MEASUREMENT DFC_b.LDF_SSpMon3OV "" UBYTE DFC_OneToOne 1 100 0.00 1.000 BIT_MASK 0x10 FORMAT "%5.3" ECU_ADDRESS 0x60034C8F /end MEASUREMENT
/begin MEASUREMENT DFC_b.LDF_SSpMon3SCG "" UBYTE DFC_OneToOne 1 100 0.00 1.000 BIT_MASK 0x10 FORMAT "%5.3" ECU_ADDRESS 0x60034C90 /end MEASUREMENT
/begin MEASUREMENT DFC_b.LDF_SSpMon3UV "" UBYTE DFC_OneToOne 1 100 0.00 1.000 BIT_MASK 0x10 FORMAT "%5.3" ECU_ADDRESS 0x60034C91 /end MEASUREMENT
/begin MEASUREMENT DFC_b.LDF_CANSM_E_BUS_OFF_NETWORK_HSN1_CAN "" UBYTE DFC_OneToOne 1 100 0.00 1.000 BIT_MASK 0x10 FORMAT "%5.3" ECU_ADDRESS 0x60034C92 /end MEASUREMENT
/begin MEASUREMENT DFC_b.LDF_CANSM_E_BUS_OFF_NETWORK_HSN3_CAN "" UBYTE DFC_OneToOne 1 100 0.00 1.000 BIT_MASK 0x10 FORMAT "%5.3" ECU_ADDRESS 0x60034C93 /end MEASUREMENT
/begin MEASUREMENT DFC_b.LDF_CANSM_E_BUS_OFF_NETWORK_HSN4_CAN "" UBYTE DFC_OneToOne 1 100 0.00 1.000 BIT_MASK 0x10 FORMAT "%5.3" ECU_ADDRESS 0x60034C94 /end MEASUREMENT
/begin MEASUREMENT DFC_b.LDF_CANSM_E_BUS_OFF_NETWORK_XCP_CAN "" UBYTE DFC_OneToOne 1 100 0.00 1.000 BIT_MASK 0x10 FORMAT "%5.3" ECU_ADDRESS 0x60034C95 /end MEASUREMENT
/begin MEASUREMENT DFC_b.LDF_CANTRCV_E_NO_TRCV_CONTROL_0 "" UBYTE DFC_OneToOne 1 100 0.00 1.000 BIT_MASK 0x10 FORMAT "%5.3" ECU_ADDRESS 0x60034C96 /end MEASUREMENT
/begin MEASUREMENT DFC_b.LDF_CAN_E_TIMEOUT "" UBYTE DFC_OneToOne 1 100 0.00 1.000 BIT_MASK 0x10 FORMAT "%5.3" ECU_ADDRESS 0x60034C97 /end MEASUREMENT
/begin MEASUREMENT DFC_b.LDF_COMM_E_NET_START_IND_CHANNEL_0 "" UBYTE DFC_OneToOne 1 100 0.00 1.000 BIT_MASK 0x10 FORMAT "%5.3" ECU_ADDRESS 0x60034C98 /end MEASUREMENT
/begin MEASUREMENT DFC_b.LDF_COMM_E_NET_START_IND_CHANNEL_1 "" UBYTE DFC_OneToOne 1 100 0.00 1.000 BIT_MASK 0x10 FORMAT "%5.3" ECU_ADDRESS 0x60034C99 /end MEASUREMENT
/begin MEASUREMENT DFC_b.LDF_COMM_E_NET_START_IND_CHANNEL_2 "" UBYTE DFC_OneToOne 1 100 0.00 1.000 BIT_MASK 0x10 FORMAT "%5.3" ECU_ADDRESS 0x60034C9A /end MEASUREMENT
/begin MEASUREMENT DFC_b.LDF_COMM_E_NET_START_IND_CHANNEL_3 "" UBYTE DFC_OneToOne 1 100 0.00 1.000 BIT_MASK 0x10 FORMAT "%5.3" ECU_ADDRESS 0x60034C9B /end MEASUREMENT
/begin MEASUREMENT DFC_b.LDF_COMM_E_NET_START_IND_CHANNEL_4 "" UBYTE DFC_OneToOne 1 100 0.00 1.000 BIT_MASK 0x10 FORMAT "%5.3" ECU_ADDRESS 0x60034C9C /end MEASUREMENT
/begin MEASUREMENT DFC_b.LDF_COMM_E_NET_START_IND_CHANNEL_5 "" UBYTE DFC_OneToOne 1 100 0.00 1.000 BIT_MASK 0x10 FORMAT "%5.3" ECU_ADDRESS 0x60034C9D /end MEASUREMENT
/begin MEASUREMENT DFC_b.LDF_LIN_E_TIMEOUT "" UBYTE DFC_OneToOne 1 100 0.00 1.000 BIT_MASK 0x10 FORMAT "%5.3" ECU_ADDRESS 0x60034C9E /end MEASUREMENT
/begin MEASUREMENT DFC_b.LDF_rba_EcuCtrl_TOMaxProlg "" UBYTE DFC_OneToOne 1 100 0.00 1.000 BIT_MASK 0x10 FORMAT "%5.3" ECU_ADDRESS 0x60034C9F /end MEASUREMENT
/begin MEASUREMENT DFC_b.LDF_rba_EcuCtrl_TOMaxShutDwn "" UBYTE DFC_OneToOne 1 100 0.00 1.000 BIT_MASK 0x10 FORMAT "%5.3" ECU_ADDRESS 0x60034CA0 /end MEASUREMENT
/begin MEASUREMENT DFC_b.LDF_rba_MultiStackTrace_Threshold "" UBYTE DFC_OneToOne 1 100 0.00 1.000 BIT_MASK 0x10 FORMAT "%5.3" ECU_ADDRESS 0x60034CA1 /end MEASUREMENT
/begin MEASUREMENT DFC_b.LDF_rba_SyC_CustStates_Degraded_disord_Event "" UBYTE DFC_OneToOne 1 100 0.00 1.000 BIT_MASK 0x10 FORMAT "%5.3" ECU_ADDRESS 0x60034CA2 /end MEASUREMENT
/begin MEASUREMENT DFC_b.LDF_rba_SyC_CustStates_Degraded_incst_Event "" UBYTE DFC_OneToOne 1 100 0.00 1.000 BIT_MASK 0x10 FORMAT "%5.3" ECU_ADDRESS 0x60034CA3 /end MEASUREMENT
/begin MEASUREMENT DFC_b.LDF_rba_SyC_CustStates_TransNoWakReq_Event "" UBYTE DFC_OneToOne 1 100 0.00 1.000 BIT_MASK 0x10 FORMAT "%5.3" ECU_ADDRESS 0x60034CA4 /end MEASUREMENT
/begin MEASUREMENT DFC_b.LDF_RBA_IOEXTLIB_KEEPALIVE_DRV "" UBYTE DFC_OneToOne 1 100 0.00 1.000 BIT_MASK 0x10 FORMAT "%5.3" ECU_ADDRESS 0x60034CA5 /end MEASUREMENT
/begin MEASUREMENT DFC_b.LDF_RBA_IOEXTLIB_KEEPALIVE_INI "" UBYTE DFC_OneToOne 1 100 0.00 1.000 BIT_MASK 0x10 FORMAT "%5.3" ECU_ADDRESS 0x60034CA6 /end MEASUREMENT
/begin MEASUREMENT DFC_b.LDF_rba_IoSigRtc_StopCounter "" UBYTE DFC_OneToOne 1 100 0.00 1.000 BIT_MASK 0x10 FORMAT "%5.3" ECU_ADDRESS 0x60034CA7 /end MEASUREMENT
/begin MEASUREMENT DFC_b.LDF_rba_MRly_Diag_Stk_Event "" UBYTE DFC_OneToOne 1 100 0.00 1.000 BIT_MASK 0x10 FORMAT "%5.3" ECU_ADDRESS 0x60034CA8 /end MEASUREMENT
/begin MEASUREMENT DFC_b.LDF_rba_MemDiag_MemReadErr "" UBYTE DFC_OneToOne 1 100 0.00 1.000 BIT_MASK 0x10 FORMAT "%5.3" ECU_ADDRESS 0x60034CA9 /end MEASUREMENT
/begin MEASUREMENT DFC_b.LDF_rba_MemDiag_MemWrErr "" UBYTE DFC_OneToOne 1 100 0.00 1.000 BIT_MASK 0x10 FORMAT "%5.3" ECU_ADDRESS 0x60034CAA /end MEASUREMENT
/begin MEASUREMENT DFC_b.LDF_rba_SyC_IrrSwOffTrigEngRun_Event "" UBYTE DFC_OneToOne 1 100 0.00 1.000 BIT_MASK 0x10 FORMAT "%5.3" ECU_ADDRESS 0x60034CAB /end MEASUREMENT
/begin MEASUREMENT DFC_b.LDF_AcChrgrIntkTSRCMax "" UBYTE DFC_OneToOne 1 100 0.00 1.000 BIT_MASK 0x10 FORMAT "%5.3" ECU_ADDRESS 0x60034CAC /end MEASUREMENT
/begin MEASUREMENT DFC_b.LDF_AcChrgrIntkTTmpErr "" UBYTE DFC_OneToOne 1 100 0.00 1.000 BIT_MASK 0x10 FORMAT "%5.3" ECU_ADDRESS 0x60034CAD /end MEASUREMENT
/begin MEASUREMENT DFC_b.LDF_AcFlt "" UBYTE DFC_OneToOne 1 100 0.00 1.000 BIT_MASK 0x10 FORMAT "%5.3" ECU_ADDRESS 0x60034CAE /end MEASUREMENT
/begin MEASUREMENT DFC_b.LDF_AppAllSnsrDfct "" UBYTE DFC_OneToOne 1 100 0.00 1.000 BIT_MASK 0x10 FORMAT "%5.3" ECU_ADDRESS 0x60034CAF /end MEASUREMENT
/begin MEASUREMENT DFC_b.LDF_BattUPwrFail "" UBYTE DFC_OneToOne 1 100 0.00 1.000 BIT_MASK 0x10 FORMAT "%5.3" ECU_ADDRESS 0x60034CB0 /end MEASUREMENT
/begin MEASUREMENT DFC_b.LDF_BrkBstBkupOvrn "" UBYTE DFC_OneToOne 1 100 0.00 1.000 BIT_MASK 0x10 FORMAT "%5.3" ECU_ADDRESS 0x60034CB1 /end MEASUREMENT
/begin MEASUREMENT DFC_b.LDF_BrkBstPmpOvld "" UBYTE DFC_OneToOne 1 100 0.00 1.000 BIT_MASK 0x10 FORMAT "%5.3" ECU_ADDRESS 0x60034CB2 /end MEASUREMENT
/begin MEASUREMENT DFC_b.LDF_BrkPlausChk "" UBYTE DFC_OneToOne 1 100 0.00 1.000 BIT_MASK 0x10 FORMAT "%5.3" ECU_ADDRESS 0x60034CB3 /end MEASUREMENT
/begin MEASUREMENT DFC_b.LDF_CbnHeatgSwtTmpErr "" UBYTE DFC_OneToOne 1 100 0.00 1.000 BIT_MASK 0x10 FORMAT "%5.3" ECU_ADDRESS 0x60034CB4 /end MEASUREMENT
/begin MEASUREMENT DFC_b.LDF_CcsPwrLineChpVccSRCMax "" UBYTE DFC_OneToOne 1 100 0.00 1.000 BIT_MASK 0x10 FORMAT "%5.3" ECU_ADDRESS 0x60034CB5 /end MEASUREMENT
/begin MEASUREMENT DFC_b.LDF_CcsPwrLineChpVccTmpErr "" UBYTE DFC_OneToOne 1 100 0.00 1.000 BIT_MASK 0x10 FORMAT "%5.3" ECU_ADDRESS 0x60034CB6 /end MEASUREMENT
/begin MEASUREMENT DFC_b.LDF_CcsPwrLineComChpTSRCMax "" UBYTE DFC_OneToOne 1 100 0.00 1.000 BIT_MASK 0x10 FORMAT "%5.3" ECU_ADDRESS 0x60034CB7 /end MEASUREMENT
/begin MEASUREMENT DFC_b.LDF_CcsPwrLineComChpTTmpErr "" UBYTE DFC_OneToOne 1 100 0.00 1.000 BIT_MASK 0x10 FORMAT "%5.3" ECU_ADDRESS 0x60034CB8 /end MEASUREMENT
/begin MEASUREMENT DFC_b.LDF_ChgrPlugCtpCarrFrqErr "" UBYTE DFC_OneToOne 1 100 0.00 1.000 BIT_MASK 0x10 FORMAT "%5.3" ECU_ADDRESS 0x60034CB9 /end MEASUREMENT
/begin MEASUREMENT DFC_b.LDF_ChgrPlugCtpSwtStuckClsd "" UBYTE DFC_OneToOne 1 100 0.00 1.000 BIT_MASK 0x10 FORMAT "%5.3" ECU_ADDRESS 0x60034CBA /end MEASUREMENT
/begin MEASUREMENT DFC_b.LDF_ChgrPlugCtpSwtStuckOpen "" UBYTE DFC_OneToOne 1 100 0.00 1.000 BIT_MASK 0x10 FORMAT "%5.3" ECU_ADDRESS 0x60034CBB /end MEASUREMENT
/begin MEASUREMENT DFC_b.LDF_ChgrPlugCtpUErrHi "" UBYTE DFC_OneToOne 1 100 0.00 1.000 BIT_MASK 0x10 FORMAT "%5.3" ECU_ADDRESS 0x60034CBC /end MEASUREMENT
/begin MEASUREMENT DFC_b.LDF_ChgrPlugPxp1SrcErr "" UBYTE DFC_OneToOne 1 100 0.00 1.000 BIT_MASK 0x10 FORMAT "%5.3" ECU_ADDRESS 0x60034CBD /end MEASUREMENT
/begin MEASUREMENT DFC_b.LDF_ChrgCntctAllWldd "" UBYTE DFC_OneToOne 1 100 0.00 1.000 BIT_MASK 0x10 FORMAT "%5.3" ECU_ADDRESS 0x60034CBE /end MEASUREMENT
/begin MEASUREMENT DFC_b.LDF_ChrgCntctNegOperErr "" UBYTE DFC_OneToOne 1 100 0.00 1.000 BIT_MASK 0x10 FORMAT "%5.3" ECU_ADDRESS 0x60034CBF /end MEASUREMENT
/begin MEASUREMENT DFC_b.LDF_ChrgCntctNegOperWarn "" UBYTE DFC_OneToOne 1 100 0.00 1.000 BIT_MASK 0x10 FORMAT "%5.3" ECU_ADDRESS 0x60034CC0 /end MEASUREMENT
/begin MEASUREMENT DFC_b.LDF_ChrgCntctNegWldd "" UBYTE DFC_OneToOne 1 100 0.00 1.000 BIT_MASK 0x10 FORMAT "%5.3" ECU_ADDRESS 0x60034CC1 /end MEASUREMENT
/begin MEASUREMENT DFC_b.LDF_ChrgCntctPosOperErr "" UBYTE DFC_OneToOne 1 100 0.00 1.000 BIT_MASK 0x10 FORMAT "%5.3" ECU_ADDRESS 0x60034CC2 /end MEASUREMENT
/begin MEASUREMENT DFC_b.LDF_ChrgCntctPosOperWarn "" UBYTE DFC_OneToOne 1 100 0.00 1.000 BIT_MASK 0x10 FORMAT "%5.3" ECU_ADDRESS 0x60034CC3 /end MEASUREMENT
/begin MEASUREMENT DFC_b.LDF_ChrgCntctPosWldd "" UBYTE DFC_OneToOne 1 100 0.00 1.000 BIT_MASK 0x10 FORMAT "%5.3" ECU_ADDRESS 0x60034CC4 /end MEASUREMENT
/begin MEASUREMENT DFC_b.LDF_ChrgCntctStuckOpen "" UBYTE DFC_OneToOne 1 100 0.00 1.000 BIT_MASK 0x10 FORMAT "%5.3" ECU_ADDRESS 0x60034CC5 /end MEASUREMENT
/begin MEASUREMENT DFC_b.LDF_ChrgPlgIntlckFaild "" UBYTE DFC_OneToOne 1 100 0.00 1.000 BIT_MASK 0x10 FORMAT "%5.3" ECU_ADDRESS 0x60034CC6 /end MEASUREMENT
/begin MEASUREMENT DFC_b.LDF_ChrgnUnplRqrd "" UBYTE DFC_OneToOne 1 100 0.00 1.000 BIT_MASK 0x10 FORMAT "%5.3" ECU_ADDRESS 0x60034CC7 /end MEASUREMENT
/begin MEASUREMENT DFC_b.LDF_CoElMOffsCalibActv01 "" UBYTE DFC_OneToOne 1 100 0.00 1.000 BIT_MASK 0x10 FORMAT "%5.3" ECU_ADDRESS 0x60034CC8 /end MEASUREMENT
/begin MEASUREMENT DFC_b.LDF_CtPSwtDiagSRCMax "" UBYTE DFC_OneToOne 1 100 0.00 1.000 BIT_MASK 0x10 FORMAT "%5.3" ECU_ADDRESS 0x60034CC9 /end MEASUREMENT
/begin MEASUREMENT DFC_b.LDF_CtPSwtDiagTmpErr "" UBYTE DFC_OneToOne 1 100 0.00 1.000 BIT_MASK 0x10 FORMAT "%5.3" ECU_ADDRESS 0x60034CCA /end MEASUREMENT
/begin MEASUREMENT DFC_b.LDF_CtpCarrFrqTmpErr "" UBYTE DFC_OneToOne 1 100 0.00 1.000 BIT_MASK 0x10 FORMAT "%5.3" ECU_ADDRESS 0x60034CCB /end MEASUREMENT
/begin MEASUREMENT DFC_b.LDF_DcChrgrIntkT2SRCMax "" UBYTE DFC_OneToOne 1 100 0.00 1.000 BIT_MASK 0x10 FORMAT "%5.3" ECU_ADDRESS 0x60034CCC /end MEASUREMENT
/begin MEASUREMENT DFC_b.LDF_DcChrgrIntkT2TmpErr "" UBYTE DFC_OneToOne 1 100 0.00 1.000 BIT_MASK 0x10 FORMAT "%5.3" ECU_ADDRESS 0x60034CCD /end MEASUREMENT
/begin MEASUREMENT DFC_b.LDF_DcChrgrIntkTSRCMax "" UBYTE DFC_OneToOne 1 100 0.00 1.000 BIT_MASK 0x10 FORMAT "%5.3" ECU_ADDRESS 0x60034CCE /end MEASUREMENT
/begin MEASUREMENT DFC_b.LDF_DcChrgrIntkTTmpErr "" UBYTE DFC_OneToOne 1 100 0.00 1.000 BIT_MASK 0x10 FORMAT "%5.3" ECU_ADDRESS 0x60034CCF /end MEASUREMENT
/begin MEASUREMENT DFC_b.LDF_EChrDvPlinCntrThdExcdd "" UBYTE DFC_OneToOne 1 100 0.00 1.000 BIT_MASK 0x10 FORMAT "%5.3" ECU_ADDRESS 0x60034CD0 /end MEASUREMENT
/begin MEASUREMENT DFC_b.LDF_EemDiagCtctrClsTout "" UBYTE DFC_OneToOne 1 100 0.00 1.000 BIT_MASK 0x10 FORMAT "%5.3" ECU_ADDRESS 0x60034CD1 /end MEASUREMENT
/begin MEASUREMENT DFC_b.LDF_EemDiagDcdcOffTOut "" UBYTE DFC_OneToOne 1 100 0.00 1.000 BIT_MASK 0x10 FORMAT "%5.3" ECU_ADDRESS 0x60034CD2 /end MEASUREMENT
/begin MEASUREMENT DFC_b.LDF_EemDiagHvCnsrOffTOut "" UBYTE DFC_OneToOne 1 100 0.00 1.000 BIT_MASK 0x10 FORMAT "%5.3" ECU_ADDRESS 0x60034CD3 /end MEASUREMENT
/begin MEASUREMENT DFC_b.LDF_EemDiagHvbOffTOut "" UBYTE DFC_OneToOne 1 100 0.00 1.000 BIT_MASK 0x10 FORMAT "%5.3" ECU_ADDRESS 0x60034CD4 /end MEASUREMENT
/begin MEASUREMENT DFC_b.LDF_FanSpdSRCMax "" UBYTE DFC_OneToOne 1 100 0.00 1.000 BIT_MASK 0x10 FORMAT "%5.3" ECU_ADDRESS 0x60034CD5 /end MEASUREMENT
/begin MEASUREMENT DFC_b.LDF_FanSpdTmpErr "" UBYTE DFC_OneToOne 1 100 0.00 1.000 BIT_MASK 0x10 FORMAT "%5.3" ECU_ADDRESS 0x60034CD6 /end MEASUREMENT
/begin MEASUREMENT DFC_b.LDF_FreonPSRCMax "" UBYTE DFC_OneToOne 1 100 0.00 1.000 BIT_MASK 0x10 FORMAT "%5.3" ECU_ADDRESS 0x60034CD7 /end MEASUREMENT
/begin MEASUREMENT DFC_b.LDF_FreonPTmpErr "" UBYTE DFC_OneToOne 1 100 0.00 1.000 BIT_MASK 0x10 FORMAT "%5.3" ECU_ADDRESS 0x60034CD8 /end MEASUREMENT
/begin MEASUREMENT DFC_b.LDF_HeatrCoreTSRCMax "" UBYTE DFC_OneToOne 1 100 0.00 1.000 BIT_MASK 0x10 FORMAT "%5.3" ECU_ADDRESS 0x60034CD9 /end MEASUREMENT
/begin MEASUREMENT DFC_b.LDF_HeatrCoreTTmpErr "" UBYTE DFC_OneToOne 1 100 0.00 1.000 BIT_MASK 0x10 FORMAT "%5.3" ECU_ADDRESS 0x60034CDA /end MEASUREMENT
/begin MEASUREMENT DFC_b.LDF_HvGridSocMinLim "" UBYTE DFC_OneToOne 1 100 0.00 1.000 BIT_MASK 0x10 FORMAT "%5.3" ECU_ADDRESS 0x60034CDB /end MEASUREMENT
/begin MEASUREMENT DFC_b.LDF_HvacBlwrFrntFlt "" UBYTE DFC_OneToOne 1 100 0.00 1.000 BIT_MASK 0x10 FORMAT "%5.3" ECU_ADDRESS 0x60034CDC /end MEASUREMENT
/begin MEASUREMENT DFC_b.LDF_HvacEvapElecFlt "" UBYTE DFC_OneToOne 1 100 0.00 1.000 BIT_MASK 0x10 FORMAT "%5.3" ECU_ADDRESS 0x60034CDD /end MEASUREMENT
/begin MEASUREMENT DFC_b.LDF_HvacEvapElecFltGnd "" UBYTE DFC_OneToOne 1 100 0.00 1.000 BIT_MASK 0x10 FORMAT "%5.3" ECU_ADDRESS 0x60034CDE /end MEASUREMENT
/begin MEASUREMENT DFC_b.LDF_HvacKnobPosnFlt "" UBYTE DFC_OneToOne 1 100 0.00 1.000 BIT_MASK 0x10 FORMAT "%5.3" ECU_ADDRESS 0x60034CDF /end MEASUREMENT
/begin MEASUREMENT DFC_b.LDF_InvBinID "" UBYTE DFC_OneToOne 1 100 0.00 1.000 BIT_MASK 0x10 FORMAT "%5.3" ECU_ADDRESS 0x60034CE0 /end MEASUREMENT
/begin MEASUREMENT DFC_b.LDF_InvCalID "" UBYTE DFC_OneToOne 1 100 0.00 1.000 BIT_MASK 0x10 FORMAT "%5.3" ECU_ADDRESS 0x60034CE1 /end MEASUREMENT
/begin MEASUREMENT DFC_b.LDF_InvErotan "" UBYTE DFC_OneToOne 1 100 0.00 1.000 BIT_MASK 0x10 FORMAT "%5.3" ECU_ADDRESS 0x60034CE2 /end MEASUREMENT
/begin MEASUREMENT DFC_b.LDF_InvVinID "" UBYTE DFC_OneToOne 1 100 0.00 1.000 BIT_MASK 0x10 FORMAT "%5.3" ECU_ADDRESS 0x60034CE3 /end MEASUREMENT
/begin MEASUREMENT DFC_b.LDF_MOXEMM_SMU_ALM0_0 "" UBYTE DFC_OneToOne 1 100 0.00 1.000 BIT_MASK 0x10 FORMAT "%5.3" ECU_ADDRESS 0x60034CE4 /end MEASUREMENT
/begin MEASUREMENT DFC_b.LDF_MOXEMM_SMU_ALM0_1 "" UBYTE DFC_OneToOne 1 100 0.00 1.000 BIT_MASK 0x10 FORMAT "%5.3" ECU_ADDRESS 0x60034CE5 /end MEASUREMENT
/begin MEASUREMENT DFC_b.LDF_MOXEMM_SMU_ALM0_10 "" UBYTE DFC_OneToOne 1 100 0.00 1.000 BIT_MASK 0x10 FORMAT "%5.3" ECU_ADDRESS 0x60034CE6 /end MEASUREMENT
/begin MEASUREMENT DFC_b.LDF_MOXEMM_SMU_ALM0_11 "" UBYTE DFC_OneToOne 1 100 0.00 1.000 BIT_MASK 0x10 FORMAT "%5.3" ECU_ADDRESS 0x60034CE7 /end MEASUREMENT
/begin MEASUREMENT DFC_b.LDF_MOXEMM_SMU_ALM0_13 "" UBYTE DFC_OneToOne 1 100 0.00 1.000 BIT_MASK 0x10 FORMAT "%5.3" ECU_ADDRESS 0x60034CE8 /end MEASUREMENT
/begin MEASUREMENT DFC_b.LDF_MOXEMM_SMU_ALM0_14 "" UBYTE DFC_OneToOne 1 100 0.00 1.000 BIT_MASK 0x10 FORMAT "%5.3" ECU_ADDRESS 0x60034CE9 /end MEASUREMENT
/begin MEASUREMENT DFC_b.LDF_MOXEMM_SMU_ALM0_2 "" UBYTE DFC_OneToOne 1 100 0.00 1.000 BIT_MASK 0x10 FORMAT "%5.3" ECU_ADDRESS 0x60034CEA /end MEASUREMENT
/begin MEASUREMENT DFC_b.LDF_MOXEMM_SMU_ALM0_22 "" UBYTE DFC_OneToOne 1 100 0.00 1.000 BIT_MASK 0x10 FORMAT "%5.3" ECU_ADDRESS 0x60034CEB /end MEASUREMENT
/begin MEASUREMENT DFC_b.LDF_MOXEMM_SMU_ALM0_23 "" UBYTE DFC_OneToOne 1 100 0.00 1.000 BIT_MASK 0x10 FORMAT "%5.3" ECU_ADDRESS 0x60034CEC /end MEASUREMENT
/begin MEASUREMENT DFC_b.LDF_MOXEMM_SMU_ALM0_4 "" UBYTE DFC_OneToOne 1 100 0.00 1.000 BIT_MASK 0x10 FORMAT "%5.3" ECU_ADDRESS 0x60034CED /end MEASUREMENT
/begin MEASUREMENT DFC_b.LDF_MOXEMM_SMU_ALM0_5 "" UBYTE DFC_OneToOne 1 100 0.00 1.000 BIT_MASK 0x10 FORMAT "%5.3" ECU_ADDRESS 0x60034CEE /end MEASUREMENT
/begin MEASUREMENT DFC_b.LDF_MOXEMM_SMU_ALM0_7 "" UBYTE DFC_OneToOne 1 100 0.00 1.000 BIT_MASK 0x10 FORMAT "%5.3" ECU_ADDRESS 0x60034CEF /end MEASUREMENT
/begin MEASUREMENT DFC_b.LDF_MOXEMM_SMU_ALM0_8 "" UBYTE DFC_OneToOne 1 100 0.00 1.000 BIT_MASK 0x10 FORMAT "%5.3" ECU_ADDRESS 0x60034CF0 /end MEASUREMENT
/begin MEASUREMENT DFC_b.LDF_MOXEMM_SMU_ALM10_16 "" UBYTE DFC_OneToOne 1 100 0.00 1.000 BIT_MASK 0x10 FORMAT "%5.3" ECU_ADDRESS 0x60034CF1 /end MEASUREMENT
/begin MEASUREMENT DFC_b.LDF_MOXEMM_SMU_ALM10_17 "" UBYTE DFC_OneToOne 1 100 0.00 1.000 BIT_MASK 0x10 FORMAT "%5.3" ECU_ADDRESS 0x60034CF2 /end MEASUREMENT
/begin MEASUREMENT DFC_b.LDF_MOXEMM_SMU_ALM10_21 "" UBYTE DFC_OneToOne 1 100 0.00 1.000 BIT_MASK 0x10 FORMAT "%5.3" ECU_ADDRESS 0x60034CF3 /end MEASUREMENT
/begin MEASUREMENT DFC_b.LDF_MOXEMM_SMU_ALM11_0 "" UBYTE DFC_OneToOne 1 100 0.00 1.000 BIT_MASK 0x10 FORMAT "%5.3" ECU_ADDRESS 0x60034CF4 /end MEASUREMENT
/begin MEASUREMENT DFC_b.LDF_MOXEMM_SMU_ALM11_1 "" UBYTE DFC_OneToOne 1 100 0.00 1.000 BIT_MASK 0x10 FORMAT "%5.3" ECU_ADDRESS 0x60034CF5 /end MEASUREMENT
/begin MEASUREMENT DFC_b.LDF_MOXEMM_SMU_ALM11_2 "" UBYTE DFC_OneToOne 1 100 0.00 1.000 BIT_MASK 0x10 FORMAT "%5.3" ECU_ADDRESS 0x60034CF6 /end MEASUREMENT
/begin MEASUREMENT DFC_b.LDF_MOXEMM_SMU_ALM11_3 "" UBYTE DFC_OneToOne 1 100 0.00 1.000 BIT_MASK 0x10 FORMAT "%5.3" ECU_ADDRESS 0x60034CF7 /end MEASUREMENT
/begin MEASUREMENT DFC_b.LDF_MOXEMM_SMU_ALM11_4 "" UBYTE DFC_OneToOne 1 100 0.00 1.000 BIT_MASK 0x10 FORMAT "%5.3" ECU_ADDRESS 0x60034CF8 /end MEASUREMENT
/begin MEASUREMENT DFC_b.LDF_MOXEMM_SMU_ALM11_5 "" UBYTE DFC_OneToOne 1 100 0.00 1.000 BIT_MASK 0x10 FORMAT "%5.3" ECU_ADDRESS 0x60034CF9 /end MEASUREMENT
/begin MEASUREMENT DFC_b.LDF_MOXEMM_SMU_ALM11_8 "" UBYTE DFC_OneToOne 1 100 0.00 1.000 BIT_MASK 0x10 FORMAT "%5.3" ECU_ADDRESS 0x60034CFA /end MEASUREMENT
/begin MEASUREMENT DFC_b.LDF_MOXEMM_SMU_ALM11_9 "" UBYTE DFC_OneToOne 1 100 0.00 1.000 BIT_MASK 0x10 FORMAT "%5.3" ECU_ADDRESS 0x60034CFB /end MEASUREMENT
/begin MEASUREMENT DFC_b.LDF_MOXEMM_SMU_ALM1_0 "" UBYTE DFC_OneToOne 1 100 0.00 1.000 BIT_MASK 0x10 FORMAT "%5.3" ECU_ADDRESS 0x60034CFC /end MEASUREMENT
/begin MEASUREMENT DFC_b.LDF_MOXEMM_SMU_ALM1_1 "" UBYTE DFC_OneToOne 1 100 0.00 1.000 BIT_MASK 0x10 FORMAT "%5.3" ECU_ADDRESS 0x60034CFD /end MEASUREMENT
/begin MEASUREMENT DFC_b.LDF_MOXEMM_SMU_ALM1_10 "" UBYTE DFC_OneToOne 1 100 0.00 1.000 BIT_MASK 0x10 FORMAT "%5.3" ECU_ADDRESS 0x60034CFE /end MEASUREMENT
/begin MEASUREMENT DFC_b.LDF_MOXEMM_SMU_ALM1_11 "" UBYTE DFC_OneToOne 1 100 0.00 1.000 BIT_MASK 0x10 FORMAT "%5.3" ECU_ADDRESS 0x60034CFF /end MEASUREMENT
/begin MEASUREMENT DFC_b.LDF_MOXEMM_SMU_ALM1_13 "" UBYTE DFC_OneToOne 1 100 0.00 1.000 BIT_MASK 0x10 FORMAT "%5.3" ECU_ADDRESS 0x60034D00 /end MEASUREMENT
/begin MEASUREMENT DFC_b.LDF_MOXEMM_SMU_ALM1_14 "" UBYTE DFC_OneToOne 1 100 0.00 1.000 BIT_MASK 0x10 FORMAT "%5.3" ECU_ADDRESS 0x60034D01 /end MEASUREMENT
/begin MEASUREMENT DFC_b.LDF_MOXEMM_SMU_ALM1_2 "" UBYTE DFC_OneToOne 1 100 0.00 1.000 BIT_MASK 0x10 FORMAT "%5.3" ECU_ADDRESS 0x60034D02 /end MEASUREMENT
/begin MEASUREMENT DFC_b.LDF_MOXEMM_SMU_ALM1_22 "" UBYTE DFC_OneToOne 1 100 0.00 1.000 BIT_MASK 0x10 FORMAT "%5.3" ECU_ADDRESS 0x60034D03 /end MEASUREMENT
/begin MEASUREMENT DFC_b.LDF_MOXEMM_SMU_ALM1_23 "" UBYTE DFC_OneToOne 1 100 0.00 1.000 BIT_MASK 0x10 FORMAT "%5.3" ECU_ADDRESS 0x60034D04 /end MEASUREMENT
/begin MEASUREMENT DFC_b.LDF_MOXEMM_SMU_ALM1_4 "" UBYTE DFC_OneToOne 1 100 0.00 1.000 BIT_MASK 0x10 FORMAT "%5.3" ECU_ADDRESS 0x60034D05 /end MEASUREMENT
/begin MEASUREMENT DFC_b.LDF_MOXEMM_SMU_ALM1_5 "" UBYTE DFC_OneToOne 1 100 0.00 1.000 BIT_MASK 0x10 FORMAT "%5.3" ECU_ADDRESS 0x60034D06 /end MEASUREMENT
/begin MEASUREMENT DFC_b.LDF_MOXEMM_SMU_ALM1_7 "" UBYTE DFC_OneToOne 1 100 0.00 1.000 BIT_MASK 0x10 FORMAT "%5.3" ECU_ADDRESS 0x60034D07 /end MEASUREMENT
/begin MEASUREMENT DFC_b.LDF_MOXEMM_SMU_ALM1_8 "" UBYTE DFC_OneToOne 1 100 0.00 1.000 BIT_MASK 0x10 FORMAT "%5.3" ECU_ADDRESS 0x60034D08 /end MEASUREMENT
/begin MEASUREMENT DFC_b.LDF_MOXEMM_SMU_ALM21_0 "" UBYTE DFC_OneToOne 1 100 0.00 1.000 BIT_MASK 0x10 FORMAT "%5.3" ECU_ADDRESS 0x60034D09 /end MEASUREMENT
/begin MEASUREMENT DFC_b.LDF_MOXEMM_SMU_ALM21_16 "" UBYTE DFC_OneToOne 1 100 0.00 1.000 BIT_MASK 0x10 FORMAT "%5.3" ECU_ADDRESS 0x60034D0A /end MEASUREMENT
/begin MEASUREMENT DFC_b.LDF_MOXEMM_SMU_ALM21_3 "" UBYTE DFC_OneToOne 1 100 0.00 1.000 BIT_MASK 0x10 FORMAT "%5.3" ECU_ADDRESS 0x60034D0B /end MEASUREMENT
/begin MEASUREMENT DFC_b.LDF_MOXEMM_SMU_ALM2_1 "" UBYTE DFC_OneToOne 1 100 0.00 1.000 BIT_MASK 0x10 FORMAT "%5.3" ECU_ADDRESS 0x60034D0C /end MEASUREMENT
/begin MEASUREMENT DFC_b.LDF_MOXEMM_SMU_ALM2_10 "" UBYTE DFC_OneToOne 1 100 0.00 1.000 BIT_MASK 0x10 FORMAT "%5.3" ECU_ADDRESS 0x60034D0D /end MEASUREMENT
/begin MEASUREMENT DFC_b.LDF_MOXEMM_SMU_ALM2_11 "" UBYTE DFC_OneToOne 1 100 0.00 1.000 BIT_MASK 0x10 FORMAT "%5.3" ECU_ADDRESS 0x60034D0E /end MEASUREMENT
/begin MEASUREMENT DFC_b.LDF_MOXEMM_SMU_ALM2_13 "" UBYTE DFC_OneToOne 1 100 0.00 1.000 BIT_MASK 0x10 FORMAT "%5.3" ECU_ADDRESS 0x60034D0F /end MEASUREMENT
/begin MEASUREMENT DFC_b.LDF_MOXEMM_SMU_ALM2_14 "" UBYTE DFC_OneToOne 1 100 0.00 1.000 BIT_MASK 0x10 FORMAT "%5.3" ECU_ADDRESS 0x60034D10 /end MEASUREMENT
/begin MEASUREMENT DFC_b.LDF_MOXEMM_SMU_ALM2_22 "" UBYTE DFC_OneToOne 1 100 0.00 1.000 BIT_MASK 0x10 FORMAT "%5.3" ECU_ADDRESS 0x60034D11 /end MEASUREMENT
/begin MEASUREMENT DFC_b.LDF_MOXEMM_SMU_ALM2_23 "" UBYTE DFC_OneToOne 1 100 0.00 1.000 BIT_MASK 0x10 FORMAT "%5.3" ECU_ADDRESS 0x60034D12 /end MEASUREMENT
/begin MEASUREMENT DFC_b.LDF_MOXEMM_SMU_ALM2_4 "" UBYTE DFC_OneToOne 1 100 0.00 1.000 BIT_MASK 0x10 FORMAT "%5.3" ECU_ADDRESS 0x60034D13 /end MEASUREMENT
/begin MEASUREMENT DFC_b.LDF_MOXEMM_SMU_ALM2_5 "" UBYTE DFC_OneToOne 1 100 0.00 1.000 BIT_MASK 0x10 FORMAT "%5.3" ECU_ADDRESS 0x60034D14 /end MEASUREMENT
/begin MEASUREMENT DFC_b.LDF_MOXEMM_SMU_ALM2_7 "" UBYTE DFC_OneToOne 1 100 0.00 1.000 BIT_MASK 0x10 FORMAT "%5.3" ECU_ADDRESS 0x60034D15 /end MEASUREMENT
/begin MEASUREMENT DFC_b.LDF_MOXEMM_SMU_ALM2_8 "" UBYTE DFC_OneToOne 1 100 0.00 1.000 BIT_MASK 0x10 FORMAT "%5.3" ECU_ADDRESS 0x60034D16 /end MEASUREMENT
/begin MEASUREMENT DFC_b.LDF_MOXEMM_SMU_ALM6_0 "" UBYTE DFC_OneToOne 1 100 0.00 1.000 BIT_MASK 0x10 FORMAT "%5.3" ECU_ADDRESS 0x60034D17 /end MEASUREMENT
/begin MEASUREMENT DFC_b.LDF_MOXEMM_SMU_ALM6_11 "" UBYTE DFC_OneToOne 1 100 0.00 1.000 BIT_MASK 0x10 FORMAT "%5.3" ECU_ADDRESS 0x60034D18 /end MEASUREMENT
/begin MEASUREMENT DFC_b.LDF_MOXEMM_SMU_ALM6_12 "" UBYTE DFC_OneToOne 1 100 0.00 1.000 BIT_MASK 0x10 FORMAT "%5.3" ECU_ADDRESS 0x60034D19 /end MEASUREMENT
/begin MEASUREMENT DFC_b.LDF_MOXEMM_SMU_ALM6_14 "" UBYTE DFC_OneToOne 1 100 0.00 1.000 BIT_MASK 0x10 FORMAT "%5.3" ECU_ADDRESS 0x60034D1A /end MEASUREMENT
/begin MEASUREMENT DFC_b.LDF_MOXEMM_SMU_ALM6_15 "" UBYTE DFC_OneToOne 1 100 0.00 1.000 BIT_MASK 0x10 FORMAT "%5.3" ECU_ADDRESS 0x60034D1B /end MEASUREMENT
/begin MEASUREMENT DFC_b.LDF_MOXEMM_SMU_ALM6_17 "" UBYTE DFC_OneToOne 1 100 0.00 1.000 BIT_MASK 0x10 FORMAT "%5.3" ECU_ADDRESS 0x60034D1C /end MEASUREMENT
/begin MEASUREMENT DFC_b.LDF_MOXEMM_SMU_ALM6_18 "" UBYTE DFC_OneToOne 1 100 0.00 1.000 BIT_MASK 0x10 FORMAT "%5.3" ECU_ADDRESS 0x60034D1D /end MEASUREMENT
/begin MEASUREMENT DFC_b.LDF_MOXEMM_SMU_ALM6_20 "" UBYTE DFC_OneToOne 1 100 0.00 1.000 BIT_MASK 0x10 FORMAT "%5.3" ECU_ADDRESS 0x60034D1E /end MEASUREMENT
/begin MEASUREMENT DFC_b.LDF_MOXEMM_SMU_ALM6_21 "" UBYTE DFC_OneToOne 1 100 0.00 1.000 BIT_MASK 0x10 FORMAT "%5.3" ECU_ADDRESS 0x60034D1F /end MEASUREMENT
/begin MEASUREMENT DFC_b.LDF_MOXEMM_SMU_ALM6_25 "" UBYTE DFC_OneToOne 1 100 0.00 1.000 BIT_MASK 0x10 FORMAT "%5.3" ECU_ADDRESS 0x60034D20 /end MEASUREMENT
/begin MEASUREMENT DFC_b.LDF_MOXEMM_SMU_ALM6_4 "" UBYTE DFC_OneToOne 1 100 0.00 1.000 BIT_MASK 0x10 FORMAT "%5.3" ECU_ADDRESS 0x60034D21 /end MEASUREMENT
/begin MEASUREMENT DFC_b.LDF_MOXEMM_SMU_ALM6_5 "" UBYTE DFC_OneToOne 1 100 0.00 1.000 BIT_MASK 0x10 FORMAT "%5.3" ECU_ADDRESS 0x60034D22 /end MEASUREMENT
/begin MEASUREMENT DFC_b.LDF_MOXEMM_SMU_ALM6_7 "" UBYTE DFC_OneToOne 1 100 0.00 1.000 BIT_MASK 0x10 FORMAT "%5.3" ECU_ADDRESS 0x60034D23 /end MEASUREMENT
/begin MEASUREMENT DFC_b.LDF_MOXEMM_SMU_ALM6_8 "" UBYTE DFC_OneToOne 1 100 0.00 1.000 BIT_MASK 0x10 FORMAT "%5.3" ECU_ADDRESS 0x60034D24 /end MEASUREMENT
/begin MEASUREMENT DFC_b.LDF_MOXEMM_SMU_ALM7_1 "" UBYTE DFC_OneToOne 1 100 0.00 1.000 BIT_MASK 0x10 FORMAT "%5.3" ECU_ADDRESS 0x60034D25 /end MEASUREMENT
/begin MEASUREMENT DFC_b.LDF_MOXEMM_SMU_ALM7_12 "" UBYTE DFC_OneToOne 1 100 0.00 1.000 BIT_MASK 0x10 FORMAT "%5.3" ECU_ADDRESS 0x60034D26 /end MEASUREMENT
/begin MEASUREMENT DFC_b.LDF_MOXEMM_SMU_ALM7_13 "" UBYTE DFC_OneToOne 1 100 0.00 1.000 BIT_MASK 0x10 FORMAT "%5.3" ECU_ADDRESS 0x60034D27 /end MEASUREMENT
/begin MEASUREMENT DFC_b.LDF_MOXEMM_SMU_ALM7_14 "" UBYTE DFC_OneToOne 1 100 0.00 1.000 BIT_MASK 0x10 FORMAT "%5.3" ECU_ADDRESS 0x60034D28 /end MEASUREMENT
/begin MEASUREMENT DFC_b.LDF_MOXEMM_SMU_ALM7_15 "" UBYTE DFC_OneToOne 1 100 0.00 1.000 BIT_MASK 0x10 FORMAT "%5.3" ECU_ADDRESS 0x60034D29 /end MEASUREMENT
/begin MEASUREMENT DFC_b.LDF_MOXEMM_SMU_ALM7_16 "" UBYTE DFC_OneToOne 1 100 0.00 1.000 BIT_MASK 0x10 FORMAT "%5.3" ECU_ADDRESS 0x60034D2A /end MEASUREMENT
/begin MEASUREMENT DFC_b.LDF_MOXEMM_SMU_ALM7_17 "" UBYTE DFC_OneToOne 1 100 0.00 1.000 BIT_MASK 0x10 FORMAT "%5.3" ECU_ADDRESS 0x60034D2B /end MEASUREMENT
/begin MEASUREMENT DFC_b.LDF_MOXEMM_SMU_ALM7_2 "" UBYTE DFC_OneToOne 1 100 0.00 1.000 BIT_MASK 0x10 FORMAT "%5.3" ECU_ADDRESS 0x60034D2C /end MEASUREMENT
/begin MEASUREMENT DFC_b.LDF_MOXEMM_SMU_ALM7_20 "" UBYTE DFC_OneToOne 1 100 0.00 1.000 BIT_MASK 0x10 FORMAT "%5.3" ECU_ADDRESS 0x60034D2D /end MEASUREMENT
/begin MEASUREMENT DFC_b.LDF_MOXEMM_SMU_ALM7_25 "" UBYTE DFC_OneToOne 1 100 0.00 1.000 BIT_MASK 0x10 FORMAT "%5.3" ECU_ADDRESS 0x60034D2E /end MEASUREMENT
/begin MEASUREMENT DFC_b.LDF_MOXEMM_SMU_ALM7_26 "" UBYTE DFC_OneToOne 1 100 0.00 1.000 BIT_MASK 0x10 FORMAT "%5.3" ECU_ADDRESS 0x60034D2F /end MEASUREMENT
/begin MEASUREMENT DFC_b.LDF_MOXEMM_SMU_ALM7_28 "" UBYTE DFC_OneToOne 1 100 0.00 1.000 BIT_MASK 0x10 FORMAT "%5.3" ECU_ADDRESS 0x60034D30 /end MEASUREMENT
/begin MEASUREMENT DFC_b.LDF_MOXEMM_SMU_ALM7_29 "" UBYTE DFC_OneToOne 1 100 0.00 1.000 BIT_MASK 0x10 FORMAT "%5.3" ECU_ADDRESS 0x60034D31 /end MEASUREMENT
/begin MEASUREMENT DFC_b.LDF_MOXEMM_SMU_ALM7_30 "" UBYTE DFC_OneToOne 1 100 0.00 1.000 BIT_MASK 0x10 FORMAT "%5.3" ECU_ADDRESS 0x60034D32 /end MEASUREMENT
/begin MEASUREMENT DFC_b.LDF_MOXEMM_SMU_ALM7_31 "" UBYTE DFC_OneToOne 1 100 0.00 1.000 BIT_MASK 0x10 FORMAT "%5.3" ECU_ADDRESS 0x60034D33 /end MEASUREMENT
/begin MEASUREMENT DFC_b.LDF_MOXEMM_SMU_ALM8_0 "" UBYTE DFC_OneToOne 1 100 0.00 1.000 BIT_MASK 0x10 FORMAT "%5.3" ECU_ADDRESS 0x60034D34 /end MEASUREMENT
/begin MEASUREMENT DFC_b.LDF_MOXEMM_SMU_ALM8_1 "" UBYTE DFC_OneToOne 1 100 0.00 1.000 BIT_MASK 0x10 FORMAT "%5.3" ECU_ADDRESS 0x60034D35 /end MEASUREMENT
/begin MEASUREMENT DFC_b.LDF_MOXEMM_SMU_ALM8_10 "" UBYTE DFC_OneToOne 1 100 0.00 1.000 BIT_MASK 0x10 FORMAT "%5.3" ECU_ADDRESS 0x60034D36 /end MEASUREMENT
/begin MEASUREMENT DFC_b.LDF_MOXEMM_SMU_ALM8_11 "" UBYTE DFC_OneToOne 1 100 0.00 1.000 BIT_MASK 0x10 FORMAT "%5.3" ECU_ADDRESS 0x60034D37 /end MEASUREMENT
/begin MEASUREMENT DFC_b.LDF_MOXEMM_SMU_ALM8_12 "" UBYTE DFC_OneToOne 1 100 0.00 1.000 BIT_MASK 0x10 FORMAT "%5.3" ECU_ADDRESS 0x60034D38 /end MEASUREMENT
/begin MEASUREMENT DFC_b.LDF_MOXEMM_SMU_ALM8_16 "" UBYTE DFC_OneToOne 1 100 0.00 1.000 BIT_MASK 0x10 FORMAT "%5.3" ECU_ADDRESS 0x60034D39 /end MEASUREMENT
/begin MEASUREMENT DFC_b.LDF_MOXEMM_SMU_ALM8_18 "" UBYTE DFC_OneToOne 1 100 0.00 1.000 BIT_MASK 0x10 FORMAT "%5.3" ECU_ADDRESS 0x60034D3A /end MEASUREMENT
/begin MEASUREMENT DFC_b.LDF_MOXEMM_SMU_ALM8_2 "" UBYTE DFC_OneToOne 1 100 0.00 1.000 BIT_MASK 0x10 FORMAT "%5.3" ECU_ADDRESS 0x60034D3B /end MEASUREMENT
/begin MEASUREMENT DFC_b.LDF_MOXEMM_SMU_ALM8_3 "" UBYTE DFC_OneToOne 1 100 0.00 1.000 BIT_MASK 0x10 FORMAT "%5.3" ECU_ADDRESS 0x60034D3C /end MEASUREMENT
/begin MEASUREMENT DFC_b.LDF_MOXEMM_SMU_ALM8_31 "" UBYTE DFC_OneToOne 1 100 0.00 1.000 BIT_MASK 0x10 FORMAT "%5.3" ECU_ADDRESS 0x60034D3D /end MEASUREMENT
/begin MEASUREMENT DFC_b.LDF_MOXEMM_SMU_ALM8_4 "" UBYTE DFC_OneToOne 1 100 0.00 1.000 BIT_MASK 0x10 FORMAT "%5.3" ECU_ADDRESS 0x60034D3E /end MEASUREMENT
/begin MEASUREMENT DFC_b.LDF_MOXEMM_SMU_ALM9_0 "" UBYTE DFC_OneToOne 1 100 0.00 1.000 BIT_MASK 0x10 FORMAT "%5.3" ECU_ADDRESS 0x60034D3F /end MEASUREMENT
/begin MEASUREMENT DFC_b.LDF_MOXEMM_SMU_ALM9_15 "" UBYTE DFC_OneToOne 1 100 0.00 1.000 BIT_MASK 0x10 FORMAT "%5.3" ECU_ADDRESS 0x60034D40 /end MEASUREMENT
/begin MEASUREMENT DFC_b.LDF_MOXEMM_SMU_ALM9_3 "" UBYTE DFC_OneToOne 1 100 0.00 1.000 BIT_MASK 0x10 FORMAT "%5.3" ECU_ADDRESS 0x60034D41 /end MEASUREMENT
/begin MEASUREMENT DFC_b.LDF_MoCADCNTPBnk1 "" UBYTE DFC_OneToOne 1 100 0.00 1.000 BIT_MASK 0x10 FORMAT "%5.3" ECU_ADDRESS 0x60034D42 /end MEASUREMENT
/begin MEASUREMENT DFC_b.LDF_MoCADCTestVoltBnk1 "" UBYTE DFC_OneToOne 1 100 0.00 1.000 BIT_MASK 0x10 FORMAT "%5.3" ECU_ADDRESS 0x60034D43 /end MEASUREMENT
/begin MEASUREMENT DFC_b.LDF_MoCSOPICO "" UBYTE DFC_OneToOne 1 100 0.00 1.000 BIT_MASK 0x10 FORMAT "%5.3" ECU_ADDRESS 0x60034D44 /end MEASUREMENT
/begin MEASUREMENT DFC_b.LDF_MoFAccr "" UBYTE DFC_OneToOne 1 100 0.00 1.000 BIT_MASK 0x10 FORMAT "%5.3" ECU_ADDRESS 0x60034D45 /end MEASUREMENT
/begin MEASUREMENT DFC_b.LDF_MoFCbnPreCdngOvrheat "" UBYTE DFC_OneToOne 1 100 0.00 1.000 BIT_MASK 0x10 FORMAT "%5.3" ECU_ADDRESS 0x60034D46 /end MEASUREMENT
/begin MEASUREMENT DFC_b.LDF_MoFCbnPreCdngTmrExpi "" UBYTE DFC_OneToOne 1 100 0.00 1.000 BIT_MASK 0x10 FORMAT "%5.3" ECU_ADDRESS 0x60034D47 /end MEASUREMENT
/begin MEASUREMENT DFC_b.LDF_MoFEvMngtBms "" UBYTE DFC_OneToOne 1 100 0.00 1.000 BIT_MASK 0x10 FORMAT "%5.3" ECU_ADDRESS 0x60034D48 /end MEASUREMENT
/begin MEASUREMENT DFC_b.LDF_MoFEvMngtDcdc "" UBYTE DFC_OneToOne 1 100 0.00 1.000 BIT_MASK 0x10 FORMAT "%5.3" ECU_ADDRESS 0x60034D49 /end MEASUREMENT
/begin MEASUREMENT DFC_b.LDF_MoFEvMngtEm01 "" UBYTE DFC_OneToOne 1 100 0.00 1.000 BIT_MASK 0x10 FORMAT "%5.3" ECU_ADDRESS 0x60034D4A /end MEASUREMENT
/begin MEASUREMENT DFC_b.LDF_MoFEvMngtEm01BrkgToZr "" UBYTE DFC_OneToOne 1 100 0.00 1.000 BIT_MASK 0x10 FORMAT "%5.3" ECU_ADDRESS 0x60034D4B /end MEASUREMENT
/begin MEASUREMENT DFC_b.LDF_MoFEvMngtEm01EngSpd "" UBYTE DFC_OneToOne 1 100 0.00 1.000 BIT_MASK 0x10 FORMAT "%5.3" ECU_ADDRESS 0x60034D4C /end MEASUREMENT
/begin MEASUREMENT DFC_b.LDF_MoFEvMngtEm02EngSpd "" UBYTE DFC_OneToOne 1 100 0.00 1.000 BIT_MASK 0x10 FORMAT "%5.3" ECU_ADDRESS 0x60034D4D /end MEASUREMENT
/begin MEASUREMENT DFC_b.LDF_MoFEvMngtEm02Lvl1 "" UBYTE DFC_OneToOne 1 100 0.00 1.000 BIT_MASK 0x10 FORMAT "%5.3" ECU_ADDRESS 0x60034D4E /end MEASUREMENT
/begin MEASUREMENT DFC_b.LDF_MoFEvMngtEm02Lvl2 "" UBYTE DFC_OneToOne 1 100 0.00 1.000 BIT_MASK 0x10 FORMAT "%5.3" ECU_ADDRESS 0x60034D4F /end MEASUREMENT
/begin MEASUREMENT DFC_b.LDF_MoFExtCptAuxCpt "" UBYTE DFC_OneToOne 1 100 0.00 1.000 BIT_MASK 0x10 FORMAT "%5.3" ECU_ADDRESS 0x60034D50 /end MEASUREMENT
/begin MEASUREMENT DFC_b.LDF_MoFExtCptVacPmpErr "" UBYTE DFC_OneToOne 1 100 0.00 1.000 BIT_MASK 0x10 FORMAT "%5.3" ECU_ADDRESS 0x60034D51 /end MEASUREMENT
/begin MEASUREMENT DFC_b.LDF_MoFTqPtdAxle "" UBYTE DFC_OneToOne 1 100 0.00 1.000 BIT_MASK 0x10 FORMAT "%5.3" ECU_ADDRESS 0x60034D52 /end MEASUREMENT
/begin MEASUREMENT DFC_b.LDF_MoFTqPtdAxleSec "" UBYTE DFC_OneToOne 1 100 0.00 1.000 BIT_MASK 0x10 FORMAT "%5.3" ECU_ADDRESS 0x60034D53 /end MEASUREMENT
/begin MEASUREMENT DFC_b.LDF_MoFTqPtdEmPtRels "" UBYTE DFC_OneToOne 1 100 0.00 1.000 BIT_MASK 0x10 FORMAT "%5.3" ECU_ADDRESS 0x60034D54 /end MEASUREMENT
/begin MEASUREMENT DFC_b.LDF_MoFTqPtdEmPtRelsSec "" UBYTE DFC_OneToOne 1 100 0.00 1.000 BIT_MASK 0x10 FORMAT "%5.3" ECU_ADDRESS 0x60034D55 /end MEASUREMENT
/begin MEASUREMENT DFC_b.LDF_MoFTqPtdEmSign "" UBYTE DFC_OneToOne 1 100 0.00 1.000 BIT_MASK 0x10 FORMAT "%5.3" ECU_ADDRESS 0x60034D56 /end MEASUREMENT
/begin MEASUREMENT DFC_b.LDF_MoFTqPtdEmSignSec "" UBYTE DFC_OneToOne 1 100 0.00 1.000 BIT_MASK 0x10 FORMAT "%5.3" ECU_ADDRESS 0x60034D57 /end MEASUREMENT
/begin MEASUREMENT DFC_b.LDF_MoFTqPtdEmTq "" UBYTE DFC_OneToOne 1 100 0.00 1.000 BIT_MASK 0x10 FORMAT "%5.3" ECU_ADDRESS 0x60034D58 /end MEASUREMENT
/begin MEASUREMENT DFC_b.LDF_MoFTqPtdEmTqSec "" UBYTE DFC_OneToOne 1 100 0.00 1.000 BIT_MASK 0x10 FORMAT "%5.3" ECU_ADDRESS 0x60034D59 /end MEASUREMENT
/begin MEASUREMENT DFC_b.LDF_MoFTqPtdVeh "" UBYTE DFC_OneToOne 1 100 0.00 1.000 BIT_MASK 0x10 FORMAT "%5.3" ECU_ADDRESS 0x60034D5A /end MEASUREMENT
/begin MEASUREMENT DFC_b.LDF_MoFVarPostBldSel "" UBYTE DFC_OneToOne 1 100 0.00 1.000 BIT_MASK 0x10 FORMAT "%5.3" ECU_ADDRESS 0x60034D5B /end MEASUREMENT
/begin MEASUREMENT DFC_b.LDF_MoSysCtrlReIni "" UBYTE DFC_OneToOne 1 100 0.00 1.000 BIT_MASK 0x10 FORMAT "%5.3" ECU_ADDRESS 0x60034D5C /end MEASUREMENT
/begin MEASUREMENT DFC_b.LDF_MoXEMMHwLTMCUFW "" UBYTE DFC_OneToOne 1 100 0.00 1.000 BIT_MASK 0x10 FORMAT "%5.3" ECU_ADDRESS 0x60034D5D /end MEASUREMENT
/begin MEASUREMENT DFC_b.LDF_MoXEMMHwLTMonBIST "" UBYTE DFC_OneToOne 1 100 0.00 1.000 BIT_MASK 0x10 FORMAT "%5.3" ECU_ADDRESS 0x60034D5E /end MEASUREMENT
/begin MEASUREMENT DFC_b.LDF_MoXEMMHwLTRegMonTest "" UBYTE DFC_OneToOne 1 100 0.00 1.000 BIT_MASK 0x10 FORMAT "%5.3" ECU_ADDRESS 0x60034D5F /end MEASUREMENT
/begin MEASUREMENT DFC_b.LDF_MoXEMMHwLTStbySMUAlvTest "" UBYTE DFC_OneToOne 1 100 0.00 1.000 BIT_MASK 0x10 FORMAT "%5.3" ECU_ADDRESS 0x60034D60 /end MEASUREMENT
/begin MEASUREMENT DFC_b.LDF_MoXEMMHwLTTempSens "" UBYTE DFC_OneToOne 1 100 0.00 1.000 BIT_MASK 0x10 FORMAT "%5.3" ECU_ADDRESS 0x60034D61 /end MEASUREMENT
/begin MEASUREMENT DFC_b.LDF_MoXEMMHwLTUCBCfg "" UBYTE DFC_OneToOne 1 100 0.00 1.000 BIT_MASK 0x10 FORMAT "%5.3" ECU_ADDRESS 0x60034D62 /end MEASUREMENT
/begin MEASUREMENT DFC_b.LDF_MonEgyChrgnCoorr_AcChrgnWoMofRels "" UBYTE DFC_OneToOne 1 100 0.00 1.000 BIT_MASK 0x10 FORMAT "%5.3" ECU_ADDRESS 0x60034D63 /end MEASUREMENT
/begin MEASUREMENT DFC_b.LDF_MonEgyChrgnCoorr_ChrgnAbortIgr "" UBYTE DFC_OneToOne 1 100 0.00 1.000 BIT_MASK 0x10 FORMAT "%5.3" ECU_ADDRESS 0x60034D64 /end MEASUREMENT
/begin MEASUREMENT DFC_b.LDF_MonEgyChrgnCoorr_DcCntctFailr "" UBYTE DFC_OneToOne 1 100 0.00 1.000 BIT_MASK 0x10 FORMAT "%5.3" ECU_ADDRESS 0x60034D65 /end MEASUREMENT
/begin MEASUREMENT DFC_b.LDF_MonEgyChrgnCoorr_ExtChrgnShtOffReq "" UBYTE DFC_OneToOne 1 100 0.00 1.000 BIT_MASK 0x10 FORMAT "%5.3" ECU_ADDRESS 0x60034D66 /end MEASUREMENT
/begin MEASUREMENT DFC_b.LDF_MonEgyChrgnCoorr_ImpsChrgnMod "" UBYTE DFC_OneToOne 1 100 0.00 1.000 BIT_MASK 0x10 FORMAT "%5.3" ECU_ADDRESS 0x60034D67 /end MEASUREMENT
/begin MEASUREMENT DFC_b.LDF_MonEgyChrgnCoorr_ImpsChrgnPrms "" UBYTE DFC_OneToOne 1 100 0.00 1.000 BIT_MASK 0x10 FORMAT "%5.3" ECU_ADDRESS 0x60034D68 /end MEASUREMENT
/begin MEASUREMENT DFC_b.LDF_MonEgyChrgnCoorr_ImpsUDcIntk "" UBYTE DFC_OneToOne 1 100 0.00 1.000 BIT_MASK 0x10 FORMAT "%5.3" ECU_ADDRESS 0x60034D69 /end MEASUREMENT
/begin MEASUREMENT DFC_b.LDF_MonEgyChrgnCoorr_PlgLockMovmt "" UBYTE DFC_OneToOne 1 100 0.00 1.000 BIT_MASK 0x10 FORMAT "%5.3" ECU_ADDRESS 0x60034D6A /end MEASUREMENT
/begin MEASUREMENT DFC_b.LDF_MonEgyChrgnCoorr_VehCrashDetn "" UBYTE DFC_OneToOne 1 100 0.00 1.000 BIT_MASK 0x10 FORMAT "%5.3" ECU_ADDRESS 0x60034D6B /end MEASUREMENT
/begin MEASUREMENT DFC_b.LDF_MonEgyChrgnErrReactn_SftySwt "" UBYTE DFC_OneToOne 1 100 0.00 1.000 BIT_MASK 0x10 FORMAT "%5.3" ECU_ADDRESS 0x60034D6C /end MEASUREMENT
/begin MEASUREMENT DFC_b.LDF_MonEgyChrgnInlet_CcsPlgCtp "" UBYTE DFC_OneToOne 1 100 0.00 1.000 BIT_MASK 0x10 FORMAT "%5.3" ECU_ADDRESS 0x60034D6D /end MEASUREMENT
/begin MEASUREMENT DFC_b.LDF_MonEgyChrgnInlet_CcsPlgCtpPwm "" UBYTE DFC_OneToOne 1 100 0.00 1.000 BIT_MASK 0x10 FORMAT "%5.3" ECU_ADDRESS 0x60034D6E /end MEASUREMENT
/begin MEASUREMENT DFC_b.LDF_MonEgyChrgnInlet_CcsPlgLockCtrlImpsAtmpt "" UBYTE DFC_OneToOne 1 100 0.00 1.000 BIT_MASK 0x10 FORMAT "%5.3" ECU_ADDRESS 0x60034D6F /end MEASUREMENT
/begin MEASUREMENT DFC_b.LDF_MonEgyChrgnInlet_CcsPlgLockSnsrSigRngChk "" UBYTE DFC_OneToOne 1 100 0.00 1.000 BIT_MASK 0x10 FORMAT "%5.3" ECU_ADDRESS 0x60034D70 /end MEASUREMENT
/begin MEASUREMENT DFC_b.LDF_MonEgyChrgnInlet_CcsPlgLockStImps "" UBYTE DFC_OneToOne 1 100 0.00 1.000 BIT_MASK 0x10 FORMAT "%5.3" ECU_ADDRESS 0x60034D71 /end MEASUREMENT
/begin MEASUREMENT DFC_b.LDF_MonEgyChrgnInlet_CcsPlgPxp "" UBYTE DFC_OneToOne 1 100 0.00 1.000 BIT_MASK 0x10 FORMAT "%5.3" ECU_ADDRESS 0x60034D72 /end MEASUREMENT
/begin MEASUREMENT DFC_b.LDF_MonEgyChrgnT_Snsr1GrdtChk "" UBYTE DFC_OneToOne 1 100 0.00 1.000 BIT_MASK 0x10 FORMAT "%5.3" ECU_ADDRESS 0x60034D73 /end MEASUREMENT
/begin MEASUREMENT DFC_b.LDF_MonEgyChrgnT_Snsr1SigRngChk "" UBYTE DFC_OneToOne 1 100 0.00 1.000 BIT_MASK 0x10 FORMAT "%5.3" ECU_ADDRESS 0x60034D74 /end MEASUREMENT
/begin MEASUREMENT DFC_b.LDF_MonEgyChrgnT_Snsr2GrdtChk "" UBYTE DFC_OneToOne 1 100 0.00 1.000 BIT_MASK 0x10 FORMAT "%5.3" ECU_ADDRESS 0x60034D75 /end MEASUREMENT
/begin MEASUREMENT DFC_b.LDF_MonEgyChrgnT_Snsr2SigRngChk "" UBYTE DFC_OneToOne 1 100 0.00 1.000 BIT_MASK 0x10 FORMAT "%5.3" ECU_ADDRESS 0x60034D76 /end MEASUREMENT
/begin MEASUREMENT DFC_b.LDF_MonEgyChrgnT_SnsrDif "" UBYTE DFC_OneToOne 1 100 0.00 1.000 BIT_MASK 0x10 FORMAT "%5.3" ECU_ADDRESS 0x60034D77 /end MEASUREMENT
/begin MEASUREMENT DFC_b.LDF_OCWDAABEActv "" UBYTE DFC_OneToOne 1 100 0.00 1.000 BIT_MASK 0x10 FORMAT "%5.3" ECU_ADDRESS 0x60034D78 /end MEASUREMENT
/begin MEASUREMENT DFC_b.LDF_OCWDACom "" UBYTE DFC_OneToOne 1 100 0.00 1.000 BIT_MASK 0x10 FORMAT "%5.3" ECU_ADDRESS 0x60034D79 /end MEASUREMENT
/begin MEASUREMENT DFC_b.LDF_OCWDAErrPin "" UBYTE DFC_OneToOne 1 100 0.00 1.000 BIT_MASK 0x10 FORMAT "%5.3" ECU_ADDRESS 0x60034D7A /end MEASUREMENT
/begin MEASUREMENT DFC_b.LDF_OCWDAOvrVltg "" UBYTE DFC_OneToOne 1 100 0.00 1.000 BIT_MASK 0x10 FORMAT "%5.3" ECU_ADDRESS 0x60034D7B /end MEASUREMENT
/begin MEASUREMENT DFC_b.LDF_PUmax "" UBYTE DFC_OneToOne 1 100 0.00 1.000 BIT_MASK 0x10 FORMAT "%5.3" ECU_ADDRESS 0x60034D7C /end MEASUREMENT
/begin MEASUREMENT DFC_b.LDF_PwmCtPTmpErr "" UBYTE DFC_OneToOne 1 100 0.00 1.000 BIT_MASK 0x10 FORMAT "%5.3" ECU_ADDRESS 0x60034D7D /end MEASUREMENT
/begin MEASUREMENT DFC_b.LDF_PwrDistbnUnitTSRCMax "" UBYTE DFC_OneToOne 1 100 0.00 1.000 BIT_MASK 0x10 FORMAT "%5.3" ECU_ADDRESS 0x60034D7E /end MEASUREMENT
/begin MEASUREMENT DFC_b.LDF_PwrDistbnUnitTTmpErr "" UBYTE DFC_OneToOne 1 100 0.00 1.000 BIT_MASK 0x10 FORMAT "%5.3" ECU_ADDRESS 0x60034D7F /end MEASUREMENT
/begin MEASUREMENT DFC_b.LDF_SCtPmp1DiagGrdKeyErr "" UBYTE DFC_OneToOne 1 100 0.00 1.000 BIT_MASK 0x10 FORMAT "%5.3" ECU_ADDRESS 0x60034D80 /end MEASUREMENT
/begin MEASUREMENT DFC_b.LDF_SRCHighAPP1 "" UBYTE DFC_OneToOne 1 100 0.00 1.000 BIT_MASK 0x10 FORMAT "%5.3" ECU_ADDRESS 0x60034D81 /end MEASUREMENT
/begin MEASUREMENT DFC_b.LDF_SRCHighAPP2 "" UBYTE DFC_OneToOne 1 100 0.00 1.000 BIT_MASK 0x10 FORMAT "%5.3" ECU_ADDRESS 0x60034D82 /end MEASUREMENT
/begin MEASUREMENT DFC_b.LDF_SRCLowAPP1 "" UBYTE DFC_OneToOne 1 100 0.00 1.000 BIT_MASK 0x10 FORMAT "%5.3" ECU_ADDRESS 0x60034D83 /end MEASUREMENT
/begin MEASUREMENT DFC_b.LDF_SRCLowAPP2 "" UBYTE DFC_OneToOne 1 100 0.00 1.000 BIT_MASK 0x10 FORMAT "%5.3" ECU_ADDRESS 0x60034D84 /end MEASUREMENT
/begin MEASUREMENT DFC_b.LDF_SWReset_0 "" UBYTE DFC_OneToOne 1 100 0.00 1.000 BIT_MASK 0x10 FORMAT "%5.3" ECU_ADDRESS 0x60034D85 /end MEASUREMENT
/begin MEASUREMENT DFC_b.LDF_SWReset_1 "" UBYTE DFC_OneToOne 1 100 0.00 1.000 BIT_MASK 0x10 FORMAT "%5.3" ECU_ADDRESS 0x60034D86 /end MEASUREMENT
/begin MEASUREMENT DFC_b.LDF_SWReset_2 "" UBYTE DFC_OneToOne 1 100 0.00 1.000 BIT_MASK 0x10 FORMAT "%5.3" ECU_ADDRESS 0x60034D87 /end MEASUREMENT
/begin MEASUREMENT DFC_b.LDF_Sia_InvldCode "" UBYTE DFC_OneToOne 1 100 0.00 1.000 BIT_MASK 0x10 FORMAT "%5.3" ECU_ADDRESS 0x60034D88 /end MEASUREMENT
/begin MEASUREMENT DFC_b.LDF_Sia_InvldKey "" UBYTE DFC_OneToOne 1 100 0.00 1.000 BIT_MASK 0x10 FORMAT "%5.3" ECU_ADDRESS 0x60034D89 /end MEASUREMENT
/begin MEASUREMENT DFC_b.LDF_Sia_NoRespUCx "" UBYTE DFC_OneToOne 1 100 0.00 1.000 BIT_MASK 0x10 FORMAT "%5.3" ECU_ADDRESS 0x60034D8A /end MEASUREMENT
/begin MEASUREMENT DFC_b.LDF_Sia_TprotRttp "" UBYTE DFC_OneToOne 1 100 0.00 1.000 BIT_MASK 0x10 FORMAT "%5.3" ECU_ADDRESS 0x60034D8B /end MEASUREMENT
/begin MEASUREMENT DFC_b.LDF_StrtUpEvStandStillDeactvn "" UBYTE DFC_OneToOne 1 100 0.00 1.000 BIT_MASK 0x10 FORMAT "%5.3" ECU_ADDRESS 0x60034D8C /end MEASUREMENT
/begin MEASUREMENT DFC_b.LDF_SyncAPP "" UBYTE DFC_OneToOne 1 100 0.00 1.000 BIT_MASK 0x10 FORMAT "%5.3" ECU_ADDRESS 0x60034D8D /end MEASUREMENT
/begin MEASUREMENT DFC_b.LDF_UCtPSRCMax "" UBYTE DFC_OneToOne 1 100 0.00 1.000 BIT_MASK 0x10 FORMAT "%5.3" ECU_ADDRESS 0x60034D8E /end MEASUREMENT
/begin MEASUREMENT DFC_b.LDF_UCtPTmpErr "" UBYTE DFC_OneToOne 1 100 0.00 1.000 BIT_MASK 0x10 FORMAT "%5.3" ECU_ADDRESS 0x60034D8F /end MEASUREMENT
/begin MEASUREMENT DFC_b.LDF_UPxP1SRCMax "" UBYTE DFC_OneToOne 1 100 0.00 1.000 BIT_MASK 0x10 FORMAT "%5.3" ECU_ADDRESS 0x60034D90 /end MEASUREMENT
/begin MEASUREMENT DFC_b.LDF_UPxP1TmpErr "" UBYTE DFC_OneToOne 1 100 0.00 1.000 BIT_MASK 0x10 FORMAT "%5.3" ECU_ADDRESS 0x60034D91 /end MEASUREMENT
/begin MEASUREMENT DFC_b.LDF_VehVObd "" UBYTE DFC_OneToOne 1 100 0.00 1.000 BIT_MASK 0x10 FORMAT "%5.3" ECU_ADDRESS 0x60034D92 /end MEASUREMENT
/begin MEASUREMENT DFC_ctLDF_mp "" UWORD OneToOne 1 100 0.00 65535.00 FORMAT "%8.2" ECU_ADDRESS 0x70006B30 /end MEASUREMENT
/begin MEASUREMENT DFC_ctLDF_msg "" UWORD OneToOne 1 100 0.00 65535.00 FORMAT "%8.2" ECU_ADDRESS 0x6001FCA0 /end MEASUREMENT
/begin MEASUREMENT DFC_lenMaxCllsn "Measurement longest DFC Kollision" ULONG OneToOne 1 100 0.00 4294967295.00 FORMAT "%13.2" ECU_ADDRESS 0x60035FEC /end MEASUREMENT
/begin MEASUREMENT DFC_nrCllsnClear "Number of DFC collisions at fcmclear" ULONG OneToOne 1 100 0.00 4294967295.00 FORMAT "%13.2" ECU_ADDRESS 0x700012E8 /end MEASUREMENT
/begin MEASUREMENT DFC_nrCllsnReInit "Number of DFC collisions at reInit" ULONG OneToOne 1 100 0.00 4294967295.00 FORMAT "%13.2" ECU_ADDRESS 0x700012E4 /end MEASUREMENT
/begin MEASUREMENT DFC_nrCllsnReport "Number of DFC collisions at report" ULONG OneToOne 1 100 0.00 4294967295.00 FORMAT "%13.2" ECU_ADDRESS 0x700012E0 /end MEASUREMENT
/begin MEASUREMENT DFC_numDfcMaxCllsn "DFC which encountered the longest collision" UWORD DFCDFP_Verb 1 100 0.00 970.000000000 FORMAT "%13.9" ECU_ADDRESS 0x60035FE8 /end MEASUREMENT
/begin MEASUREMENT DFC_st.DFC_Unused "" UBYTE DFC_OneToOne 1 100 0.00 255.0 FORMAT "%5.1" ECU_ADDRESS 0x600349CE /end MEASUREMENT
/begin MEASUREMENT DFC_st.DFC_CANSM_E_BUS_OFF_NETWORK_HSN1_CAN "" UBYTE DFC_OneToOne 1 100 0.00 255.0 FORMAT "%5.1" ECU_ADDRESS 0x60034C92 /end MEASUREMENT
/begin MEASUREMENT DFC_st.DFC_CANSM_E_BUS_OFF_NETWORK_HSN3_CAN "" UBYTE DFC_OneToOne 1 100 0.00 255.0 FORMAT "%5.1" ECU_ADDRESS 0x60034C93 /end MEASUREMENT
/begin MEASUREMENT DFC_st.DFC_CANSM_E_BUS_OFF_NETWORK_HSN4_CAN "" UBYTE DFC_OneToOne 1 100 0.00 255.0 FORMAT "%5.1" ECU_ADDRESS 0x60034C94 /end MEASUREMENT
/begin MEASUREMENT DFC_st.DFC_CANSM_E_BUS_OFF_NETWORK_XCP_CAN "" UBYTE DFC_OneToOne 1 100 0.00 255.0 FORMAT "%5.1" ECU_ADDRESS 0x60034C95 /end MEASUREMENT
/begin MEASUREMENT DFC_st.DFC_COMM_E_NET_START_IND_CHANNEL_0 "" UBYTE DFC_OneToOne 1 100 0.00 255.0 FORMAT "%5.1" ECU_ADDRESS 0x60034C98 /end MEASUREMENT
/begin MEASUREMENT DFC_st.DFC_COMM_E_NET_START_IND_CHANNEL_1 "" UBYTE DFC_OneToOne 1 100 0.00 255.0 FORMAT "%5.1" ECU_ADDRESS 0x60034C99 /end MEASUREMENT
/begin MEASUREMENT DFC_st.DFC_COMM_E_NET_START_IND_CHANNEL_2 "" UBYTE DFC_OneToOne 1 100 0.00 255.0 FORMAT "%5.1" ECU_ADDRESS 0x60034C9A /end MEASUREMENT
/begin MEASUREMENT DFC_st.DFC_LIN_E_TIMEOUT "" UBYTE DFC_OneToOne 1 100 0.00 255.0 FORMAT "%5.1" ECU_ADDRESS 0x60034C9E /end MEASUREMENT
/begin MEASUREMENT DFC_st.DFC_rba_SyC_CustStates_Degraded_disord_Event "" UBYTE DFC_OneToOne 1 100 0.00 255.0 FORMAT "%5.1" ECU_ADDRESS 0x60034CA2 /end MEASUREMENT
/begin MEASUREMENT DFC_st.DFC_rba_SyC_CustStates_Degraded_incst_Event "" UBYTE DFC_OneToOne 1 100 0.00 255.0 FORMAT "%5.1" ECU_ADDRESS 0x60034CA3 /end MEASUREMENT
/begin MEASUREMENT DFC_st.DFC_rba_SyC_CustStates_TransNoWakReq_Event "" UBYTE DFC_OneToOne 1 100 0.00 255.0 FORMAT "%5.1" ECU_ADDRESS 0x60034CA4 /end MEASUREMENT
/begin MEASUREMENT DFC_stClctFault_mp "" UWORD DFC_OneToOne 1 100 0.00 65535.00 FORMAT "%8.2" MATRIX_DIM 61 ECU_ADDRESS 0x70006AB6 /end MEASUREMENT
/begin MEASUREMENT DFC_stClctTst_mp "" UWORD DFC_OneToOne 1 100 0.00 65535.00 FORMAT "%8.2" MATRIX_DIM 61 ECU_ADDRESS 0x70006A3C /end MEASUREMENT
/begin MEASUREMENT DFC_stFinal "" UWORD DFC_OneToOne 1 100 0.00 65535.00 FORMAT "%8.2" MATRIX_DIM 61 ECU_ADDRESS 0x6002203C /end MEASUREMENT
/begin MEASUREMENT DFC_stMem "" UWORD DFC_OneToOne 1 100 0.00 65535.00 FORMAT "%8.2" MATRIX_DIM 61 ECU_ADDRESS 0x60034954 /end MEASUREMENT
/begin MEASUREMENT DFC_stRdy "" UWORD DFC_OneToOne 1 100 0.00 65535.00 FORMAT "%8.2" MATRIX_DIM 61 ECU_ADDRESS 0x60035DDC /end MEASUREMENT
/begin MEASUREMENT DFES_ChkLstDltDemExCond_mp "Exit condition of last delete demand check during initialisation" UBYTE OneToOne 1 100 0.00 255.0 FORMAT "%5.1" ECU_ADDRESS 0x70006C1F /end MEASUREMENT
/begin MEASUREMENT DFES_chkSt "" UWORD OneToOne 1 100 0.00 65535.00 FORMAT "%8.2" MATRIX_DIM 20 ECU_ADDRESS 0x60035D12 /end MEASUREMENT
/begin MEASUREMENT DFES_cnfSequence "DSM internal sequence counter to obtain confirmed entry sorting of all error memory entries" UBYTE OneToOne 1 100 0.00 255.0 FORMAT "%5.1" MATRIX_DIM 20 ECU_ADDRESS 0x60035BD0 /end MEASUREMENT
/begin MEASUREMENT DFES_ctDef "" UBYTE DFES_OneToOne 1 100 0.00 255.0 FORMAT "%5.1" MATRIX_DIM 20 ECU_ADDRESS 0x60035C86 /end MEASUREMENT
/begin MEASUREMENT DFES_ctDel "" UBYTE DFES_OneToOne 1 100 0.00 255.0 FORMAT "%5.1" MATRIX_DIM 20 ECU_ADDRESS 0x60035C36 /end MEASUREMENT
/begin MEASUREMENT DFES_ctEntry "Number of occupied DFES Entries" UBYTE DFES_OneToOne 1 100 0.00 255.0 FORMAT "%5.1" ECU_ADDRESS 0x60024646 /end MEASUREMENT
/begin MEASUREMENT DFES_ctFrq "" UBYTE DFES_OneToOne 1 100 0.00 255.0 FORMAT "%5.1" MATRIX_DIM 20 ECU_ADDRESS 0x60034D98 /end MEASUREMENT
/begin MEASUREMENT DFES_ctManuDef "" UBYTE DFES_OneToOne 1 100 0.00 255.0 FORMAT "%5.1" MATRIX_DIM 20 ECU_ADDRESS 0x60035C5E /end MEASUREMENT
/begin MEASUREMENT DFES_ctManuOk "" UBYTE DFES_OneToOne 1 100 0.00 255.0 FORMAT "%5.1" MATRIX_DIM 20 ECU_ADDRESS 0x60035C4A /end MEASUREMENT
/begin MEASUREMENT DFES_ctMIL "Number of DFES Entries illuminating the MIL(Only continuous illumination, no blinking counted)" UBYTE DFES_OneToOne 1 100 0.00 255.0 FORMAT "%5.1" ECU_ADDRESS 0x60024648 /end MEASUREMENT
/begin MEASUREMENT DFES_ctOBD "Number of DFES Entries visible in OBD Mode 3" UBYTE DFES_OneToOne 1 100 0.00 255.0 FORMAT "%5.1" ECU_ADDRESS 0x6002464A /end MEASUREMENT
/begin MEASUREMENT DFES_ctOBDPend "Number of DFES Entries visible in OBD Mode 7 (pending)" UBYTE DFES_OneToOne 1 100 0.00 255.0 FORMAT "%5.1" ECU_ADDRESS 0x60024649 /end MEASUREMENT
/begin MEASUREMENT DFES_ctOk "" UBYTE DFES_OneToOne 1 100 0.00 255.0 FORMAT "%5.1" MATRIX_DIM 20 ECU_ADDRESS 0x60035C72 /end MEASUREMENT
/begin MEASUREMENT DFES_ctSrv "Number of DFES Entries visible for Service tester" UBYTE DFES_OneToOne 1 100 0.00 255.0 FORMAT "%5.1" ECU_ADDRESS 0x60024647 /end MEASUREMENT
/begin MEASUREMENT DFES_entrySt "" UBYTE DFES_Entry_Verb 1 100 0.00 34.0000000000 FORMAT "%13.10" MATRIX_DIM 20 ECU_ADDRESS 0x60035CFE /end MEASUREMENT
/begin MEASUREMENT DFES_EnvBlock "" UBYTE DFES_OneToOne 1 100 0.00 255.0 FORMAT "%5.1" MATRIX_DIM 3600 ECU_ADDRESS 0x60034DAC /end MEASUREMENT
/begin MEASUREMENT DFES_FrzFrVal "" UBYTE DFES_OneToOne 1 100 0.00 255.0 FORMAT "%5.1" MATRIX_DIM 20 ECU_ADDRESS 0x60035BBC /end MEASUREMENT
/begin MEASUREMENT DFES_idxSequence "" UBYTE DFES_OneToOne 1 100 0.00 255.0 FORMAT "%5.1" MATRIX_DIM 20 ECU_ADDRESS 0x60035BE5 /end MEASUREMENT
/begin MEASUREMENT DFES_ISOFrstCnfDFC "DFC matching to criteria of first confirmed DTC" UWORD DFCDFP_Verb 1 100 0.00 970.000000000 FORMAT "%13.9" ECU_ADDRESS 0x60034D96 /end MEASUREMENT
/begin MEASUREMENT DFES_ISOFrstFailDFC "DFC matching to criteria of first failed DTC" UWORD DFCDFP_Verb 1 100 0.00 970.000000000 FORMAT "%13.9" ECU_ADDRESS 0x60035D3C /end MEASUREMENT
/begin MEASUREMENT DFES_ISORcntCnfDFC "DFC matching to criteria of most recent confirmed DTC" UWORD DFCDFP_Verb 1 100 0.00 970.000000000 FORMAT "%13.9" ECU_ADDRESS 0x60034D94 /end MEASUREMENT
/begin MEASUREMENT DFES_ISORcntFailDFC "DFC matching to criteria of most recent failed DTC" UWORD DFCDFP_Verb 1 100 0.00 970.000000000 FORMAT "%13.9" ECU_ADDRESS 0x60035D3A /end MEASUREMENT
/begin MEASUREMENT DFES_MonEvnt "DFES monitoring - Event Id" UWORD DFES_Mon_Verb 1 100 0.00 32786.0000000 FORMAT "%13.7" MATRIX_DIM 4 ECU_ADDRESS 0x60035DC8 /end MEASUREMENT
/begin MEASUREMENT DFES_MonObjt "DFES monitoring - Object Id" UWORD OneToOne 1 100 0.00 65535.00 FORMAT "%8.2" MATRIX_DIM 4 ECU_ADDRESS 0x60035DC0 /end MEASUREMENT
/begin MEASUREMENT DFES_MonParm "DFES monitoring - Parameter" UWORD OneToOne 1 100 0.00 65535.00 FORMAT "%8.2" MATRIX_DIM 4 ECU_ADDRESS 0x60035DB8 /end MEASUREMENT
/begin MEASUREMENT DFES_MonPtr "DSM internal pointer for DFES monitoring" UBYTE DFES_OneToOne 1 100 0.00 255.0 FORMAT "%5.1" ECU_ADDRESS 0x60035DD0 /end MEASUREMENT
/begin MEASUREMENT DFES_numDFC "" UWORD DFC_Verb 1 100 0.00 964.000000000 FORMAT "%13.9" MATRIX_DIM 20 ECU_ADDRESS 0x60035CD6 /end MEASUREMENT
/begin MEASUREMENT DFES_numDFCAck "acknowledged ID of fault entry (scanned and handled)" UWORD DFC_Verb 1 100 0.00 964.000000000 FORMAT "%13.9" MATRIX_DIM 20 ECU_ADDRESS 0x60035C0E /end MEASUREMENT
/begin MEASUREMENT DFES_numDFCImdt "" UWORD DFC_Verb 1 100 0.00 964.000000000 FORMAT "%13.9" MATRIX_DIM 20 ECU_ADDRESS 0x60035D8E /end MEASUREMENT
/begin MEASUREMENT DFES_numEntryAvl "Number of possible DFES Entries" UBYTE DFES_OneToOne 1 100 0.00 255.0 FORMAT "%5.1" ECU_ADDRESS 0x60024644 /end MEASUREMENT
/begin MEASUREMENT DFES_numEnvSize "Number of bytes in one environment block" UBYTE DFES_OneToOne 1 100 0.00 255.0 FORMAT "%5.1" ECU_ADDRESS 0x60024641 /end MEASUREMENT
/begin MEASUREMENT DFES_numExtdFrzFrmSize "Number of bytes for environmental conditions contained in one freeze frame extension set" UBYTE DFES_OneToOne 1 100 0.00 255.0 FORMAT "%5.1" ECU_ADDRESS 0x60024642 /end MEASUREMENT
/begin MEASUREMENT DFES_numFrzFrmSize "Number of bytes in one freeze frame" UBYTE DFES_OneToOne 1 100 0.00 255.0 FORMAT "%5.1" ECU_ADDRESS 0x60024643 /end MEASUREMENT
/begin MEASUREMENT DFES_OutLamps "" UBYTE DFES_OneToOne 1 100 0.00 255.0 FORMAT "%5.1" MATRIX_DIM 20 ECU_ADDRESS 0x6002460F /end MEASUREMENT
/begin MEASUREMENT DFES_PDTCStore "indication to store permanent DTCs at beginning of postdrive" UBYTE OneToOne 1 100 0.00 255.0 BIT_MASK 0x1 FORMAT "%5.1" ECU_ADDRESS 0x6002463B /end MEASUREMENT
/begin MEASUREMENT DFES_prioEntryImdt "" UBYTE DFES_OneToOne 1 100 0.00 255.0 FORMAT "%5.1" MATRIX_DIM 20 ECU_ADDRESS 0x60035D7A /end MEASUREMENT
/begin MEASUREMENT DFES_StateVisibility "" UWORD DFES_OneToOne 1 100 0.00 65535.00 FORMAT "%8.2" MATRIX_DIM 20 ECU_ADDRESS 0x60021218 /end MEASUREMENT
/begin MEASUREMENT DFES_stChk "" UBYTE DFES_stCheck_Verb 1 100 0.00 7.00000000000 FORMAT "%13.11" MATRIX_DIM 20 ECU_ADDRESS 0x60035CC2 /end MEASUREMENT
/begin MEASUREMENT DFES_stCounters "" UBYTE DFES_stCnt_Verb 1 100 0.00 85.0000000000 FORMAT "%13.10" MATRIX_DIM 20 ECU_ADDRESS 0x60035C9A /end MEASUREMENT
/begin MEASUREMENT DFES_stCtlSetting "internal and central disable request" UBYTE OneToOne 1 100 0.00 255.0 FORMAT "%5.1" ECU_ADDRESS 0x60024639 /end MEASUREMENT
/begin MEASUREMENT DFES_stDataImdt "" UBYTE DFES_stDataImdt_Verb 1 100 0.00 21.0000000000 FORMAT "%13.10" MATRIX_DIM 20 ECU_ADDRESS 0x60035D3E /end MEASUREMENT
/begin MEASUREMENT DFES_stDataImdtTrans "" UBYTE DFES_stDataImdt_Verb 1 100 0.00 21.0000000000 FORMAT "%13.10" MATRIX_DIM 20 ECU_ADDRESS 0x60024623 /end MEASUREMENT
/begin MEASUREMENT DFES_stDTCRecUpdt "state of disable DTC record update, AUTOSAR feature" UBYTE OneToOne 1 100 0.00 255.0 FORMAT "%5.1" ECU_ADDRESS 0x60024638 /end MEASUREMENT
/begin MEASUREMENT DFES_stDTCStorage "state of disable DTC storage AUTOSAR feature" UBYTE OneToOne 1 100 0.00 255.0 FORMAT "%5.1" ECU_ADDRESS 0x60024637 /end MEASUREMENT
/begin MEASUREMENT DFES_stEepWrReq "request for an EEPROM storage" UBYTE OneToOne 1 100 0.00 255.0 FORMAT "%5.1" ECU_ADDRESS 0x6002463E /end MEASUREMENT
/begin MEASUREMENT DFES_stEntry "" UBYTE DFES_stEntry_Verb 1 100 0.00 254.000000000 FORMAT "%13.9" MATRIX_DIM 20 ECU_ADDRESS 0x60035CAE /end MEASUREMENT
/begin MEASUREMENT DFES_stErrDia "DSM internal status of all tester visibilities" UBYTE DFES_OneToOne 1 100 0.00 255.0 FORMAT "%5.1" ECU_ADDRESS 0x6002464C /end MEASUREMENT
/begin MEASUREMENT DFES_stErrLamp "DFES error lamp demands" UBYTE DFES_OneToOne 1 100 0.00 255.0 FORMAT "%5.1" ECU_ADDRESS 0x6002464D /end MEASUREMENT
/begin MEASUREMENT DFES_stErrLamp_msg "DFES error lamp demands" UBYTE DFES_OneToOne 1 100 0.00 255.0 FORMAT "%5.1" ECU_ADDRESS 0x600235CC /end MEASUREMENT
/begin MEASUREMENT DFES_stInh "Inhibit (FIM) relevant state of fault entry" UBYTE DFES_OneToOne 1 100 0.00 255.0 FORMAT "%5.1" MATRIX_DIM 20 ECU_ADDRESS 0x60035BFA /end MEASUREMENT
/begin MEASUREMENT DFES_stOrdImdt "" UWORD DFES_OneToOne 1 100 0.00 65535.00 FORMAT "%8.2" MATRIX_DIM 20 ECU_ADDRESS 0x60035D52 /end MEASUREMENT
/begin MEASUREMENT DFES_stOrdImdtTrans "" UBYTE DFES_OneToOne 1 100 0.00 255.0 FORMAT "%5.1" MATRIX_DIM 20 ECU_ADDRESS 0x60034030 /end MEASUREMENT
/begin MEASUREMENT DFES_stOutstate "DSM Flag status to check whether error counter is valid or not." UBYTE DFES_OneToOne 1 100 0.00 255.0 FORMAT "%5.1" ECU_ADDRESS 0x6002464B /end MEASUREMENT
/begin MEASUREMENT DFES_stPrgEvt "ECU programming event detected (reset of all diagnostic informations including IUMPR and permanent DTCs)" UBYTE OneToOne 1 100 0.00 255.0 BIT_MASK 0x1 FORMAT "%5.1" ECU_ADDRESS 0x6002463A /end MEASUREMENT
/begin MEASUREMENT DFES_stPrgEvt_msg "Interface that gives information about ECU programming event." UBYTE OneToOne 1 100 0.00 255.0 BIT_MASK 0x1 FORMAT "%5.1" ECU_ADDRESS 0x600236D6 /end MEASUREMENT
/begin MEASUREMENT DFES_stRepClrAftPwrFail "Repeated DSM clear after powerfail necessary" UBYTE B_TRUE 1 100 0.00 1.00000000000 BIT_MASK 0x1 FORMAT "%13.11" ECU_ADDRESS 0x60023168 /end MEASUREMENT
/begin MEASUREMENT DFES_xAsgnEnvAllDataSize "Memory usage of common calibrated environment data" UBYTE DFES_OneToOne 1 100 0.00 255.0 FORMAT "%5.1" ECU_ADDRESS 0x6002460E /end MEASUREMENT
/begin MEASUREMENT DSM_stProtdRamVld "DFES protected ram content is valid" UBYTE OneToOne 1 100 0.00 255.0 BIT_MASK 0x1 FORMAT "%5.1" ECU_ADDRESS 0x60034048 /end MEASUREMENT
/begin MEASUREMENT DSQ_st.DSQ_DSMInhibitAlways "" UBYTE DFC_OneToOne 1 100 0.00 255.0 FORMAT "%5.1" ECU_ADDRESS 0x60024664 /end MEASUREMENT
/begin MEASUREMENT DSQ_stClct_mp "" UWORD DFC_OneToOne 1 100 0.00 65535.00 FORMAT "%8.2" MATRIX_DIM 1 ECU_ADDRESS 0x70006A3A /end MEASUREMENT
/begin FUNCTION DFC "30000.32.0Diagnostic Fault Check"
 /begin DEF_CHARACTERISTIC DFC_CtlMsk2.DFC_Unused_C DFC_CtlMsk2.DFC_CANSM_E_BUS_OFF_NETWORK_HSN1_CAN_C DFC_CtlMsk2.DFC_CANSM_E_BUS_OFF_NETWORK_HSN3_CAN_C DFC_CtlMsk2.DFC_CANSM_E_BUS_OFF_NETWORK_HSN4_CAN_C DFC_CtlMsk2.DFC_CANSM_E_BUS_OFF_NETWORK_XCP_CAN_C DFC_CtlMsk2.DFC_COMM_E_NET_START_IND_CHANNEL_0_C DFC_CtlMsk2.DFC_COMM_E_NET_START_IND_CHANNEL_1_C DFC_CtlMsk2.DFC_COMM_E_NET_START_IND_CHANNEL_2_C DFC_CtlMsk2.DFC_LIN_E_TIMEOUT_C DFC_CtlMsk2.DFC_rba_SyC_CustStates_Degraded_disord_Event_C DFC_CtlMsk2.DFC_rba_SyC_CustStates_Degraded_incst_Event_C DFC_CtlMsk2.DFC_rba_SyC_CustStates_TransNoWakReq_Event_C DFC_DisblMsk2.DFC_Unused_C DFC_DisblMsk2.DFC_CANSM_E_BUS_OFF_NETWORK_HSN1_CAN_C DFC_DisblMsk2.DFC_CANSM_E_BUS_OFF_NETWORK_HSN3_CAN_C DFC_DisblMsk2.DFC_CANSM_E_BUS_OFF_NETWORK_HSN4_CAN_C DFC_DisblMsk2.DFC_CANSM_E_BUS_OFF_NETWORK_XCP_CAN_C DFC_DisblMsk2.DFC_COMM_E_NET_START_IND_CHANNEL_0_C DFC_DisblMsk2.DFC_COMM_E_NET_START_IND_CHANNEL_1_C DFC_DisblMsk2.DFC_COMM_E_NET_START_IND_CHANNEL_2_C DFC_DisblMsk2.DFC_LIN_E_TIMEOUT_C DFC_DisblMsk2.DFC_rba_SyC_CustStates_Degraded_disord_Event_C DFC_DisblMsk2.DFC_rba_SyC_CustStates_Degraded_incst_Event_C DFC_DisblMsk2.DFC_rba_SyC_CustStates_TransNoWakReq_Event_C DFC_DtcFuncUnit_C DFC_DtcGroup_C DFC_DtcSeverity_C /end DEF_CHARACTERISTIC
 /begin OUT_MEASUREMENT DFC_b.LDF_EmWakeupSigSCG DFC_b.LDF_Fan1OL DFC_b.LDF_Fan1OvrTemp DFC_b.LDF_Fan1SCB DFC_b.LDF_FanRlySCB DFC_b.LDF_FanRlySCG DFC_b.LDF_FanSpdSRCMin DFC_b.LDF_FreonPSRCMin DFC_b.LDF_HLCCcsPLnCChipTHi DFC_b.LDF_HeatrCoreTSRCMin DFC_b.LDF_PwmCtPSRCMin DFC_b.LDF_PwrDistbnUnitTSRCMin DFC_b.LDF_SCtPmp1OL DFC_b.LDF_SCtPmp1OvrTemp DFC_b.LDF_SCtPmp1SCB DFC_b.LDF_SCtPmpRlyOL DFC_b.LDF_SCtPmpRlyOvrTemp DFC_b.LDF_SCtPmpRlySCB DFC_b.LDF_SpplCooltPmpRlyOL DFC_b.LDF_SpplCooltPmpRlyOvrTemp DFC_b.LDF_SpplCooltPmpRlySCB DFC_b.LDF_UCtPSRCMin DFC_b.LDF_UPxP1SRCMin DFC_b.LDF_ComHSN1CANMute DFC_b.LDF_ComHSN3CANMute DFC_b.LDF_AcChrgrIntkTPhysRngHi DFC_b.LDF_AcChrgrIntkTPhysRngLo DFC_b.LDF_AcChrgrIntkTSRCOpn DFC_b.LDF_CcsPwrLineChpVccPhysRngHi DFC_b.LDF_CcsPwrLineChpVccPhysRngLo DFC_b.LDF_CcsPwrLineChpVccSRCOpn DFC_b.LDF_CcsPwrLineComChpTPhysRngHi DFC_b.LDF_CcsPwrLineComChpTPhysRngLo DFC_b.LDF_CcsPwrLineComChpTSRCOpn DFC_b.LDF_CtPSwtDiagPhysRngHi DFC_b.LDF_CtPSwtDiagPhysRngLo DFC_b.LDF_CtPSwtDiagSRCOpn DFC_b.LDF_CtpCarrFrqPhysRngHi DFC_b.LDF_CtpCarrFrqPhysRngLo DFC_b.LDF_CtpCarrFrqSRCMax DFC_b.LDF_DcChrgrIntkT2PhysRngHi DFC_b.LDF_DcChrgrIntkT2PhysRngLo DFC_b.LDF_DcChrgrIntkT2SRCOpn DFC_b.LDF_DcChrgrIntkTPhysRngHi DFC_b.LDF_DcChrgrIntkTPhysRngLo DFC_b.LDF_DcChrgrIntkTSRCOpn DFC_b.LDF_Fan1SCG DFC_b.LDF_FanSpdPhysRngHi DFC_b.LDF_FanSpdPhysRngLo DFC_b.LDF_FanSpdSRCOpn DFC_b.LDF_FreonPPhysRngHi DFC_b.LDF_FreonPPhysRngLo DFC_b.LDF_FreonPSRCOpn DFC_b.LDF_HeatrCoreTPhysRngHi DFC_b.LDF_HeatrCoreTPhysRngLo DFC_b.LDF_HeatrCoreTSRCOpn DFC_b.LDF_HvGridUMaxSftyLim DFC_b.LDF_HvGridUMinSftyLim DFC_b.LDF_HvGridUPlausy DFC_b.LDF_IntlckChrgPlgHBrgOpnLd DFC_b.LDF_IntlckChrgPlgHBrgOvrCurr DFC_b.LDF_IntlckChrgPlgHBrgOvrTemp DFC_b.LDF_IntlckChrgPlgHBrgShCirBatt1 DFC_b.LDF_IntlckChrgPlgHBrgShCirBatt2 DFC_b.LDF_IntlckChrgPlgHBrgShCirGnd1 DFC_b.LDF_IntlckChrgPlgHBrgShCirGnd2 DFC_b.LDF_IntlckChrgPlgHBrgShCirOvrLd DFC_b.LDF_IntlckChrgPlgHBrgTempOvrCurr DFC_b.LDF_IntlckChrgPlgHBrgUndrVltg DFC_b.LDF_IntlckChrgPlgPosnRngFlt DFC_b.LDF_IntlckChrgPlgPosnSrcMax DFC_b.LDF_IntlckChrgPlgPosnSrcMin DFC_b.LDF_PwmCtPPhysRngHi DFC_b.LDF_PwmCtPPhysRngLo DFC_b.LDF_PwmCtPSRCMax DFC_b.LDF_PwrDistbnUnitTPhysRngHi DFC_b.LDF_PwrDistbnUnitTPhysRngLo DFC_b.LDF_PwrDistbnUnitTSRCOpn DFC_b.LDF_SCtPmpRlySCG DFC_b.LDF_SpplCooltPmpRlySCG DFC_b.LDF_UCtPPhysRngHi DFC_b.LDF_UCtPPhysRngLo DFC_b.LDF_UCtPSRCOpn DFC_b.LDF_UPxP1PhysRngHi DFC_b.LDF_UPxP1PhysRngLo DFC_b.LDF_UPxP1SRCOpn DFC_b.LDF_VehVPhysRngHi DFC_b.LDF_VehVPhysRngLo DFC_b.LDF_VehVSigCan DFC_b.LDF_VehVSigCanSafe DFC_b.LDF_SCtPmp1DiagGrdKey1 DFC_b.LDF_SCtPmp1DiagGrdKey2 DFC_b.LDF_SCtPmp1DiagGrdKey3 DFC_b.LDF_SCtPmp1DiagGrdKey4 DFC_b.LDF_SCtPmp1DiagGrdKey5 DFC_b.LDF_ChrgPlgLiveCntctHzrdCcs DFC_b.LDF_ChrgPlgProxPltImps DFC_b.LDF_ChrgPlgTHiCcsDc DFC_b.LDF_ElMActvDchaFailr DFC_b.LDF_ElMActvDchaFlt DFC_b.LDF_ElMFbdnIvtrModDrv01 DFC_b.LDF_ElMImobAuthent DFC_b.LDF_ElMIsoMonFlt DFC_b.LDF_ElMIsoMonPlausyFlt DFC_b.LDF_ElMIvtrCooltT01 DFC_b.LDF_ElMIvtrEmgyShtDwn01 DFC_b.LDF_ElMIvtrFailr01 DFC_b.LDF_ElMIvtrIntlck01 DFC_b.LDF_ElMIvtrTErr01 DFC_b.LDF_ElMOverSpdNeg01 DFC_b.LDF_ElMOverSpdPos01 DFC_b.LDF_ElMOverTqNeg01 DFC_b.LDF_ElMOverTqPos01 DFC_b.LDF_ElMPwrAuthn DFC_b.LDF_ElMSpdErr01 DFC_b.LDF_ElMSvs01 DFC_b.LDF_PEnvCcMax DFC_b.LDF_PEnvCcMin DFC_b.LDF_PEnvRngChkMax DFC_b.LDF_PEnvRngChkMin DFC_b.LDF_PEnvSnsrPlaus DFC_b.LDF_BrkBstPmpPlausGenn DFC_b.LDF_CbnHeatrRlyLfLoWarn DFC_b.LDF_ChgrPlugLockPinByndClsd DFC_b.LDF_ChgrPlugLockPinMoveWoCmd DFC_b.LDF_ChgrPlugLockPinStuckInClsd DFC_b.LDF_ChgrPlugLockPinStuckInOpen DFC_b.LDF_ChrgrStErr DFC_b.LDF_ComHSN1BusOff DFC_b.LDF_ComHSN3BusOff DFC_b.LDF_ComVCInval DFC_b.LDF_EemDcdcPrecSpdInhb DFC_b.LDF_ExpPwrLatch DFC_b.LDF_FanMaxOvrd DFC_b.LDF_HLCCcsGnrlComErr DFC_b.LDF_InmLINNodeHVACPanelAbsnt DFC_b.LDF_ResetRcvNotAllwd DFC_b.LDF_TelltlCooltPlaus DFC_b.LDF_MRlyOL DFC_b.LDF_MRlySCB DFC_b.LDF_MRlySCG DFC_b.LDF_SSpMon1 DFC_b.LDF_SSpMon1OV DFC_b.LDF_SSpMon1SCG DFC_b.LDF_SSpMon1UV DFC_b.LDF_SSpMon2 DFC_b.LDF_SSpMon2OV DFC_b.LDF_SSpMon2SCG DFC_b.LDF_SSpMon2UV DFC_b.LDF_SSpMon3 DFC_b.LDF_SSpMon3OV DFC_b.LDF_SSpMon3SCG DFC_b.LDF_SSpMon3UV DFC_b.LDF_CANSM_E_BUS_OFF_NETWORK_HSN1_CAN DFC_b.LDF_CANSM_E_BUS_OFF_NETWORK_HSN3_CAN DFC_b.LDF_CANSM_E_BUS_OFF_NETWORK_HSN4_CAN DFC_b.LDF_CANSM_E_BUS_OFF_NETWORK_XCP_CAN DFC_b.LDF_CANTRCV_E_NO_TRCV_CONTROL_0 DFC_b.LDF_CAN_E_TIMEOUT DFC_b.LDF_COMM_E_NET_START_IND_CHANNEL_0 DFC_b.LDF_COMM_E_NET_START_IND_CHANNEL_1 DFC_b.LDF_COMM_E_NET_START_IND_CHANNEL_2 DFC_b.LDF_COMM_E_NET_START_IND_CHANNEL_3 DFC_b.LDF_COMM_E_NET_START_IND_CHANNEL_4 DFC_b.LDF_COMM_E_NET_START_IND_CHANNEL_5 DFC_b.LDF_LIN_E_TIMEOUT DFC_b.LDF_rba_EcuCtrl_TOMaxProlg DFC_b.LDF_rba_EcuCtrl_TOMaxShutDwn DFC_b.LDF_rba_MultiStackTrace_Threshold DFC_b.LDF_rba_SyC_CustStates_Degraded_disord_Event DFC_b.LDF_rba_SyC_CustStates_Degraded_incst_Event DFC_b.LDF_rba_SyC_CustStates_TransNoWakReq_Event DFC_b.LDF_RBA_IOEXTLIB_KEEPALIVE_DRV DFC_b.LDF_RBA_IOEXTLIB_KEEPALIVE_INI DFC_b.LDF_rba_IoSigRtc_StopCounter DFC_b.LDF_rba_MRly_Diag_Stk_Event DFC_b.LDF_rba_MemDiag_MemReadErr DFC_b.LDF_rba_MemDiag_MemWrErr DFC_b.LDF_rba_SyC_IrrSwOffTrigEngRun_Event DFC_b.LDF_AcChrgrIntkTSRCMax DFC_b.LDF_AcChrgrIntkTTmpErr DFC_b.LDF_AcFlt DFC_b.LDF_AppAllSnsrDfct DFC_b.LDF_BattUPwrFail DFC_b.LDF_BrkBstBkupOvrn DFC_b.LDF_BrkBstPmpOvld DFC_b.LDF_BrkPlausChk DFC_b.LDF_CbnHeatgSwtTmpErr DFC_b.LDF_CcsPwrLineChpVccSRCMax DFC_b.LDF_CcsPwrLineChpVccTmpErr DFC_b.LDF_CcsPwrLineComChpTSRCMax DFC_b.LDF_CcsPwrLineComChpTTmpErr DFC_b.LDF_ChgrPlugCtpCarrFrqErr DFC_b.LDF_ChgrPlugCtpSwtStuckClsd DFC_b.LDF_ChgrPlugCtpSwtStuckOpen DFC_b.LDF_ChgrPlugCtpUErrHi DFC_b.LDF_ChgrPlugPxp1SrcErr DFC_b.LDF_ChrgCntctAllWldd DFC_b.LDF_ChrgCntctNegOperErr DFC_b.LDF_ChrgCntctNegOperWarn DFC_b.LDF_ChrgCntctNegWldd DFC_b.LDF_ChrgCntctPosOperErr DFC_b.LDF_ChrgCntctPosOperWarn DFC_b.LDF_ChrgCntctPosWldd DFC_b.LDF_ChrgCntctStuckOpen DFC_b.LDF_ChrgPlgIntlckFaild DFC_b.LDF_ChrgnUnplRqrd DFC_b.LDF_CoElMOffsCalibActv01 DFC_b.LDF_CtPSwtDiagSRCMax DFC_b.LDF_CtPSwtDiagTmpErr DFC_b.LDF_CtpCarrFrqTmpErr DFC_b.LDF_DcChrgrIntkT2SRCMax DFC_b.LDF_DcChrgrIntkT2TmpErr DFC_b.LDF_DcChrgrIntkTSRCMax DFC_b.LDF_DcChrgrIntkTTmpErr DFC_b.LDF_EChrDvPlinCntrThdExcdd DFC_b.LDF_EemDiagCtctrClsTout DFC_b.LDF_EemDiagDcdcOffTOut DFC_b.LDF_EemDiagHvCnsrOffTOut DFC_b.LDF_EemDiagHvbOffTOut DFC_b.LDF_FanSpdSRCMax DFC_b.LDF_FanSpdTmpErr DFC_b.LDF_FreonPSRCMax DFC_b.LDF_FreonPTmpErr DFC_b.LDF_HeatrCoreTSRCMax DFC_b.LDF_HeatrCoreTTmpErr DFC_b.LDF_HvGridSocMinLim DFC_b.LDF_HvacBlwrFrntFlt DFC_b.LDF_HvacEvapElecFlt DFC_b.LDF_HvacEvapElecFltGnd DFC_b.LDF_HvacKnobPosnFlt DFC_b.LDF_InvBinID DFC_b.LDF_InvCalID DFC_b.LDF_InvErotan DFC_b.LDF_InvVinID DFC_b.LDF_MOXEMM_SMU_ALM0_0 DFC_b.LDF_MOXEMM_SMU_ALM0_1 DFC_b.LDF_MOXEMM_SMU_ALM0_10 DFC_b.LDF_MOXEMM_SMU_ALM0_11 DFC_b.LDF_MOXEMM_SMU_ALM0_13 DFC_b.LDF_MOXEMM_SMU_ALM0_14 DFC_b.LDF_MOXEMM_SMU_ALM0_2 DFC_b.LDF_MOXEMM_SMU_ALM0_22 DFC_b.LDF_MOXEMM_SMU_ALM0_23 DFC_b.LDF_MOXEMM_SMU_ALM0_4 DFC_b.LDF_MOXEMM_SMU_ALM0_5 DFC_b.LDF_MOXEMM_SMU_ALM0_7 DFC_b.LDF_MOXEMM_SMU_ALM0_8 DFC_b.LDF_MOXEMM_SMU_ALM10_16 DFC_b.LDF_MOXEMM_SMU_ALM10_17 DFC_b.LDF_MOXEMM_SMU_ALM10_21 DFC_b.LDF_MOXEMM_SMU_ALM11_0 DFC_b.LDF_MOXEMM_SMU_ALM11_1 DFC_b.LDF_MOXEMM_SMU_ALM11_2 DFC_b.LDF_MOXEMM_SMU_ALM11_3 DFC_b.LDF_MOXEMM_SMU_ALM11_4 DFC_b.LDF_MOXEMM_SMU_ALM11_5 DFC_b.LDF_MOXEMM_SMU_ALM11_8 DFC_b.LDF_MOXEMM_SMU_ALM11_9 DFC_b.LDF_MOXEMM_SMU_ALM1_0 DFC_b.LDF_MOXEMM_SMU_ALM1_1 DFC_b.LDF_MOXEMM_SMU_ALM1_10 DFC_b.LDF_MOXEMM_SMU_ALM1_11 DFC_b.LDF_MOXEMM_SMU_ALM1_13 DFC_b.LDF_MOXEMM_SMU_ALM1_14 DFC_b.LDF_MOXEMM_SMU_ALM1_2 DFC_b.LDF_MOXEMM_SMU_ALM1_22 DFC_b.LDF_MOXEMM_SMU_ALM1_23 DFC_b.LDF_MOXEMM_SMU_ALM1_4 DFC_b.LDF_MOXEMM_SMU_ALM1_5 DFC_b.LDF_MOXEMM_SMU_ALM1_7 DFC_b.LDF_MOXEMM_SMU_ALM1_8 DFC_b.LDF_MOXEMM_SMU_ALM21_0 DFC_b.LDF_MOXEMM_SMU_ALM21_16 DFC_b.LDF_MOXEMM_SMU_ALM21_3 DFC_b.LDF_MOXEMM_SMU_ALM2_1 DFC_b.LDF_MOXEMM_SMU_ALM2_10 DFC_b.LDF_MOXEMM_SMU_ALM2_11 DFC_b.LDF_MOXEMM_SMU_ALM2_13 DFC_b.LDF_MOXEMM_SMU_ALM2_14 DFC_b.LDF_MOXEMM_SMU_ALM2_22 DFC_b.LDF_MOXEMM_SMU_ALM2_23 DFC_b.LDF_MOXEMM_SMU_ALM2_4 DFC_b.LDF_MOXEMM_SMU_ALM2_5 DFC_b.LDF_MOXEMM_SMU_ALM2_7 DFC_b.LDF_MOXEMM_SMU_ALM2_8 DFC_b.LDF_MOXEMM_SMU_ALM6_0 DFC_b.LDF_MOXEMM_SMU_ALM6_11 DFC_b.LDF_MOXEMM_SMU_ALM6_12 DFC_b.LDF_MOXEMM_SMU_ALM6_14 DFC_b.LDF_MOXEMM_SMU_ALM6_15 DFC_b.LDF_MOXEMM_SMU_ALM6_17 DFC_b.LDF_MOXEMM_SMU_ALM6_18 DFC_b.LDF_MOXEMM_SMU_ALM6_20 DFC_b.LDF_MOXEMM_SMU_ALM6_21 DFC_b.LDF_MOXEMM_SMU_ALM6_25 DFC_b.LDF_MOXEMM_SMU_ALM6_4 DFC_b.LDF_MOXEMM_SMU_ALM6_5 DFC_b.LDF_MOXEMM_SMU_ALM6_7 DFC_b.LDF_MOXEMM_SMU_ALM6_8 DFC_b.LDF_MOXEMM_SMU_ALM7_1 DFC_b.LDF_MOXEMM_SMU_ALM7_12 DFC_b.LDF_MOXEMM_SMU_ALM7_13 DFC_b.LDF_MOXEMM_SMU_ALM7_14 DFC_b.LDF_MOXEMM_SMU_ALM7_15 DFC_b.LDF_MOXEMM_SMU_ALM7_16 DFC_b.LDF_MOXEMM_SMU_ALM7_17 DFC_b.LDF_MOXEMM_SMU_ALM7_2 DFC_b.LDF_MOXEMM_SMU_ALM7_20 DFC_b.LDF_MOXEMM_SMU_ALM7_25 DFC_b.LDF_MOXEMM_SMU_ALM7_26 DFC_b.LDF_MOXEMM_SMU_ALM7_28 DFC_b.LDF_MOXEMM_SMU_ALM7_29 DFC_b.LDF_MOXEMM_SMU_ALM7_30 DFC_b.LDF_MOXEMM_SMU_ALM7_31 DFC_b.LDF_MOXEMM_SMU_ALM8_0 DFC_b.LDF_MOXEMM_SMU_ALM8_1 DFC_b.LDF_MOXEMM_SMU_ALM8_10 DFC_b.LDF_MOXEMM_SMU_ALM8_11 DFC_b.LDF_MOXEMM_SMU_ALM8_12 DFC_b.LDF_MOXEMM_SMU_ALM8_16 DFC_b.LDF_MOXEMM_SMU_ALM8_18 DFC_b.LDF_MOXEMM_SMU_ALM8_2 DFC_b.LDF_MOXEMM_SMU_ALM8_3 DFC_b.LDF_MOXEMM_SMU_ALM8_31 DFC_b.LDF_MOXEMM_SMU_ALM8_4 DFC_b.LDF_MOXEMM_SMU_ALM9_0 DFC_b.LDF_MOXEMM_SMU_ALM9_15 DFC_b.LDF_MOXEMM_SMU_ALM9_3 DFC_b.LDF_MoCADCNTPBnk1 DFC_b.LDF_MoCADCTestVoltBnk1 DFC_b.LDF_MoCSOPICO DFC_b.LDF_MoFAccr DFC_b.LDF_MoFCbnPreCdngOvrheat DFC_b.LDF_MoFCbnPreCdngTmrExpi DFC_b.LDF_MoFEvMngtBms DFC_b.LDF_MoFEvMngtDcdc DFC_b.LDF_MoFEvMngtEm01 DFC_b.LDF_MoFEvMngtEm01BrkgToZr DFC_b.LDF_MoFEvMngtEm01EngSpd DFC_b.LDF_MoFEvMngtEm02EngSpd DFC_b.LDF_MoFEvMngtEm02Lvl1 DFC_b.LDF_MoFEvMngtEm02Lvl2 DFC_b.LDF_MoFExtCptAuxCpt DFC_b.LDF_MoFExtCptVacPmpErr DFC_b.LDF_MoFTqPtdAxle DFC_b.LDF_MoFTqPtdAxleSec DFC_b.LDF_MoFTqPtdEmPtRels DFC_b.LDF_MoFTqPtdEmPtRelsSec DFC_b.LDF_MoFTqPtdEmSign DFC_b.LDF_MoFTqPtdEmSignSec DFC_b.LDF_MoFTqPtdEmTq DFC_b.LDF_MoFTqPtdEmTqSec DFC_b.LDF_MoFTqPtdVeh DFC_b.LDF_MoFVarPostBldSel DFC_b.LDF_MoSysCtrlReIni DFC_b.LDF_MoXEMMHwLTMCUFW DFC_b.LDF_MoXEMMHwLTMonBIST DFC_b.LDF_MoXEMMHwLTRegMonTest DFC_b.LDF_MoXEMMHwLTStbySMUAlvTest DFC_b.LDF_MoXEMMHwLTTempSens DFC_b.LDF_MoXEMMHwLTUCBCfg DFC_b.LDF_MonEgyChrgnCoorr_AcChrgnWoMofRels DFC_b.LDF_MonEgyChrgnCoorr_ChrgnAbortIgr DFC_b.LDF_MonEgyChrgnCoorr_DcCntctFailr DFC_b.LDF_MonEgyChrgnCoorr_ExtChrgnShtOffReq DFC_b.LDF_MonEgyChrgnCoorr_ImpsChrgnMod DFC_b.LDF_MonEgyChrgnCoorr_ImpsChrgnPrms DFC_b.LDF_MonEgyChrgnCoorr_ImpsUDcIntk DFC_b.LDF_MonEgyChrgnCoorr_PlgLockMovmt DFC_b.LDF_MonEgyChrgnCoorr_VehCrashDetn DFC_b.LDF_MonEgyChrgnErrReactn_SftySwt DFC_b.LDF_MonEgyChrgnInlet_CcsPlgCtp DFC_b.LDF_MonEgyChrgnInlet_CcsPlgCtpPwm DFC_b.LDF_MonEgyChrgnInlet_CcsPlgLockCtrlImpsAtmpt DFC_b.LDF_MonEgyChrgnInlet_CcsPlgLockSnsrSigRngChk DFC_b.LDF_MonEgyChrgnInlet_CcsPlgLockStImps DFC_b.LDF_MonEgyChrgnInlet_CcsPlgPxp DFC_b.LDF_MonEgyChrgnT_Snsr1GrdtChk DFC_b.LDF_MonEgyChrgnT_Snsr1SigRngChk DFC_b.LDF_MonEgyChrgnT_Snsr2GrdtChk DFC_b.LDF_MonEgyChrgnT_Snsr2SigRngChk DFC_b.LDF_MonEgyChrgnT_SnsrDif DFC_b.LDF_OCWDAABEActv DFC_b.LDF_OCWDACom DFC_b.LDF_OCWDAErrPin DFC_b.LDF_OCWDAOvrVltg DFC_b.LDF_PUmax DFC_b.LDF_PwmCtPTmpErr DFC_b.LDF_PwrDistbnUnitTSRCMax DFC_b.LDF_PwrDistbnUnitTTmpErr DFC_b.LDF_SCtPmp1DiagGrdKeyErr DFC_b.LDF_SRCHighAPP1 DFC_b.LDF_SRCHighAPP2 DFC_b.LDF_SRCLowAPP1 DFC_b.LDF_SRCLowAPP2 DFC_b.LDF_SWReset_0 DFC_b.LDF_SWReset_1 DFC_b.LDF_SWReset_2 DFC_b.LDF_Sia_InvldCode DFC_b.LDF_Sia_InvldKey DFC_b.LDF_Sia_NoRespUCx DFC_b.LDF_Sia_TprotRttp DFC_b.LDF_StrtUpEvStandStillDeactvn DFC_b.LDF_SyncAPP DFC_b.LDF_UCtPSRCMax DFC_b.LDF_UCtPTmpErr DFC_b.LDF_UPxP1SRCMax DFC_b.LDF_UPxP1TmpErr DFC_b.LDF_VehVObd DFC_ctLDF_msg DFC_st.DFC_Unused DFC_st.DFC_CANSM_E_BUS_OFF_NETWORK_HSN1_CAN DFC_st.DFC_CANSM_E_BUS_OFF_NETWORK_HSN3_CAN DFC_st.DFC_CANSM_E_BUS_OFF_NETWORK_HSN4_CAN DFC_st.DFC_CANSM_E_BUS_OFF_NETWORK_XCP_CAN DFC_st.DFC_COMM_E_NET_START_IND_CHANNEL_0 DFC_st.DFC_COMM_E_NET_START_IND_CHANNEL_1 DFC_st.DFC_COMM_E_NET_START_IND_CHANNEL_2 DFC_st.DFC_LIN_E_TIMEOUT DFC_st.DFC_rba_SyC_CustStates_Degraded_disord_Event DFC_st.DFC_rba_SyC_CustStates_Degraded_incst_Event DFC_st.DFC_rba_SyC_CustStates_TransNoWakReq_Event DSQ_st.DSQ_DSMInhibitAlways /end OUT_MEASUREMENT
 /begin LOC_MEASUREMENT DFC_ctLDF_mp DFC_lenMaxCllsn DFC_nrCllsnClear DFC_nrCllsnReInit DFC_nrCllsnReport DFC_numDfcMaxCllsn DFC_stClctFault_mp DFC_stClctTst_mp DFC_stFinal DFC_stMem DFC_stRdy DSQ_stClct_mp /end LOC_MEASUREMENT
 FUNCTION_VERSION "30000.32.0" /end FUNCTION
/begin FUNCTION DFES "30000.70.0Diagnostic Fault Event Storage"
 /begin DEF_CHARACTERISTIC DFES_Cls.DFC_Unused_C DFES_Cls.DFC_ACCmprFltLvlRes_C DFES_Cls.DFC_AbgHiSigFlt_C DFES_Cls.DFC_AbgIntPatFlt_C DFES_Cls.DFC_AbgLoSigFlt_C DFES_Cls.DFC_AbgUnkwnErrSigFlt_C DFES_Cls.DFC_AcExtChrgrIBattExcdd_C DFES_Cls.DFC_AcExtChrgrIInExcdd_C DFES_Cls.DFC_AcExtChrgrIOutDe_C DFES_Cls.DFC_AcExtChrgrIOutExcdd_C DFES_Cls.DFC_AcExtChrgrUOutDe_C DFES_Cls.DFC_AdpActvDChaFailr_C DFES_Cls.DFC_AirbcuFlt_C DFES_Cls.DFC_Airbg_C DFES_Cls.DFC_AirbgCan_C DFES_Cls.DFC_AirbgCanHWPlaus_C DFES_Cls.DFC_AirbgHWCanPlaus_C DFES_Cls.DFC_AirbgMnr_C DFES_Cls.DFC_AirbgPerHi_C DFES_Cls.DFC_AirbgPerdRngFlt_C DFES_Cls.DFC_BlowrRlyErr_C DFES_Cls.DFC_BrkBstPmpActtnDfct_C DFES_Cls.DFC_BrkBstPmpDeactvnDfct_C DFES_Cls.DFC_BrkSwtFlt_C DFES_Cls.DFC_CbnHeatgHeatrHsScb_C DFES_Cls.DFC_CbnHeatgHeatrHsScg_C DFES_Cls.DFC_CbnHeatgHeatrLsOl_C DFES_Cls.DFC_CbnHeatgHeatrLsScb_C DFES_Cls.DFC_CbnHeatgHeatrLsScg_C DFES_Cls.DFC_CbnHeatgHeatrUnUsed_C DFES_Cls.DFC_ChrgnCntctHsOt_C DFES_Cls.DFC_ChrgnCntctHsScb_C DFES_Cls.DFC_ChrgnCntctHsScg_C DFES_Cls.DFC_ChrgnCntctLsNegOl_C DFES_Cls.DFC_ChrgnCntctLsNegOt_C DFES_Cls.DFC_ChrgnCntctLsNegScb_C DFES_Cls.DFC_ChrgnCntctLsNegScg_C DFES_Cls.DFC_ChrgnCntctLsPosOl_C DFES_Cls.DFC_ChrgnCntctLsPosOt_C DFES_Cls.DFC_ChrgnCntctLsPosScb_C DFES_Cls.DFC_ChrgnCntctLsPosScg_C DFES_Cls.DFC_ChrgnCntctUnUsed_C DFES_Cls.DFC_ComBrkMai_C DFES_Cls.DFC_ComChrgrEVCont_C DFES_Cls.DFC_ComChrgrEVtBlink_C DFES_Cls.DFC_ComChrgrMstBlink_C DFES_Cls.DFC_ComChrgrMstCont_C DFES_Cls.DFC_ComChrgrSVSBlink_C DFES_Cls.DFC_ComChrgrSVSCont_C DFES_Cls.DFC_ComDcdcEVBlink_C DFES_Cls.DFC_ComDcdcEVCont_C DFES_Cls.DFC_ComDcdcFltLvl2_C DFES_Cls.DFC_ComDcdcFltLvl3_C DFES_Cls.DFC_ComDcdcFltLvl4_C DFES_Cls.DFC_ComDcdcFltLvl5_C DFES_Cls.DFC_ComDcdcFltLvlRes_C DFES_Cls.DFC_ComDcdcMstBlink_C DFES_Cls.DFC_ComDcdcMstCont_C DFES_Cls.DFC_ComDcdcSVSBlink_C DFES_Cls.DFC_ComDcdcSVSCont_C DFES_Cls.DFC_ComElMIIvtrFltLvl2_C DFES_Cls.DFC_ComElMIIvtrFltLvl3_C DFES_Cls.DFC_ComElMIIvtrFltLvl4_C DFES_Cls.DFC_ComElMIIvtrFltLvl5_C DFES_Cls.DFC_ComElMIIvtrFltLvlRes_C DFES_Cls.DFC_ComEmacEVBlink_C DFES_Cls.DFC_ComEmacEVCont_C DFES_Cls.DFC_ComEmacMstCont_C DFES_Cls.DFC_ComEmacMsttBlink_C DFES_Cls.DFC_ComEmacSVSBlink_C DFES_Cls.DFC_ComEmacSVSCont_C DFES_Cls.DFC_ComGunCntInfoWkuReq_C DFES_Cls.DFC_ComHillHldFlt_C DFES_Cls.DFC_ComHvBattRchrgWkuReq_C DFES_Cls.DFC_ComHvbFltLvl2_C DFES_Cls.DFC_ComHvbFltLvl3_C DFES_Cls.DFC_ComHvbFltLvl4_C DFES_Cls.DFC_ComHvbFltLvl5_C DFES_Cls.DFC_ComHvbFltLvlRes_C DFES_Cls.DFC_ComHvbMstBlink_C DFES_Cls.DFC_ComHvbMstCont_C DFES_Cls.DFC_ComImmoUnlockWkuReq_C DFES_Cls.DFC_ComInfoReqPtlWkuReq_C DFES_Cls.DFC_ComOBCFltLvl2_C DFES_Cls.DFC_ComOBCFltLvl3_C DFES_Cls.DFC_ComOBCFltLvl4_C DFES_Cls.DFC_ComOBCFltLvl5_C DFES_Cls.DFC_ComOBCFltLvlRes_C DFES_Cls.DFC_ComPostOperationWkuReq_C DFES_Cls.DFC_ComPreCondElecWkuReq_C DFES_Cls.DFC_ComRemUnlckWkuReq_C DFES_Cls.DFC_ComStpDlyHMIWkuReq_C DFES_Cls.DFC_ComflgCurMeasmtErr_C DFES_Cls.DFC_ComflgCurMeasmtSysErr_C DFES_Cls.DFC_ComflgCurMeasmtVld_C DFES_Cls.DFC_ComflgCurRngErr_C DFES_Cls.DFC_ComflgTPcbMeasmtErr_C DFES_Cls.DFC_ComflgTPcbMeasmtVld_C DFES_Cls.DFC_ComflgTPcbRngErr_C DFES_Cls.DFC_ComflgTPcbSysErr_C DFES_Cls.DFC_ComflgTShntMeasmtErr_C DFES_Cls.DFC_ComflgTShntMeasmtVld_C DFES_Cls.DFC_ComflgTShntRngErr_C DFES_Cls.DFC_ComflgTShntSysErr_C DFES_Cls.DFC_ComflgVoltMeasmtErr_C DFES_Cls.DFC_ComflgVoltMeasmtSysErr_C DFES_Cls.DFC_ComflgVoltMeasmtVld_C DFES_Cls.DFC_ComflgVoltRngErr_C DFES_Cls.DFC_CrashEveOcc_C DFES_Cls.DFC_DcdcFwdModStuck_C DFES_Cls.DFC_DcdcLvUDifMaxFlt_C DFES_Cls.DFC_DcdcOffModStuck_C DFES_Cls.DFC_DcdcOperModFailr_C DFES_Cls.DFC_DcdcPrecModStuck_C DFES_Cls.DFC_DrvDoorOpn_C DFES_Cls.DFC_DrvModPosnDfct_C DFES_Cls.DFC_DrvStbltOpn_C DFES_Cls.DFC_ETogFailrLvl3_C DFES_Cls.DFC_ETogFailrLvl4_C DFES_Cls.DFC_EbsLvBattSocDiagLo_C DFES_Cls.DFC_EbsLvBattUDiagDiOper_C DFES_Cls.DFC_EbsLvBattUDiagFltLvl1_C DFES_Cls.DFC_EbsLvBattUDiagFltLvl2_C DFES_Cls.DFC_EbsLvBattUDiagLo_C DFES_Cls.DFC_EbsSnsrSt_C DFES_Cls.DFC_EbsSofASILErr_C DFES_Cls.DFC_ElTSPtSysLimDrvErr_C DFES_Cls.DFC_ElTSPtSysLimRgnErr_C DFES_Cls.DFC_HLCCcsFwDwnl_C DFES_Cls.DFC_HvBattChrgPwrMax_C DFES_Cls.DFC_HvBattCrashDetd_C DFES_Cls.DFC_HvBattDchaPwrMax_C DFES_Cls.DFC_HvBattEmgyOff_C DFES_Cls.DFC_HvBattEmgyOffIntlck_C DFES_Cls.DFC_HvBattEmgyOffReq_C DFES_Cls.DFC_HvBattFltMod_C DFES_Cls.DFC_HvBattIReqToChrgrErr_C DFES_Cls.DFC_HvBattIReqToChrgrIni_C DFES_Cls.DFC_HvBattIninTout_C DFES_Cls.DFC_HvBattIntlckSt_C DFES_Cls.DFC_HvBattIsoFlt_C DFES_Cls.DFC_HvBattLimdPwr_C DFES_Cls.DFC_HvBattMaiSwtClsngFlt_C DFES_Cls.DFC_HvBattMaiSwtFlt_C DFES_Cls.DFC_HvBattMaiSwtOpen_C DFES_Cls.DFC_HvBattMaiSwtOpngFlt_C /end DEF_CHARACTERISTIC
 /begin IN_MEASUREMENT DSMAUX_stDCy DSM_TripChgAndClrFinshd /end IN_MEASUREMENT
 /begin OUT_MEASUREMENT DFES_stEepWrReq DFES_stErrLamp DFES_stErrLamp_msg DFES_stOutstate DFES_stPrgEvt_msg DSM_stProtdRamVld /end OUT_MEASUREMENT
 /begin LOC_MEASUREMENT DFES_ChkLstDltDemExCond_mp DFES_chkSt DFES_cnfSequence DFES_ctDef DFES_ctDel DFES_ctEntry DFES_ctFrq DFES_ctManuDef DFES_ctManuOk DFES_ctMIL DFES_ctOBD DFES_ctOBDPend DFES_ctOk DFES_ctSrv DFES_entrySt DFES_EnvBlock DFES_FrzFrVal DFES_idxSequence DFES_ISOFrstCnfDFC DFES_ISOFrstFailDFC DFES_ISORcntCnfDFC DFES_ISORcntFailDFC DFES_MonEvnt DFES_MonObjt DFES_MonParm DFES_MonPtr DFES_numDFC DFES_numDFCAck DFES_numDFCImdt DFES_numEntryAvl DFES_numEnvSize DFES_numExtdFrzFrmSize DFES_numFrzFrmSize DFES_OutLamps DFES_PDTCStore DFES_prioEntryImdt DFES_StateVisibility DFES_stChk DFES_stCounters DFES_stCtlSetting DFES_stDataImdt DFES_stDataImdtTrans DFES_stDTCRecUpdt DFES_stDTCStorage DFES_stEntry DFES_stErrDia DFES_stInh DFES_stOrdImdt DFES_stOrdImdtTrans DFES_stPrgEvt DFES_stRepClrAftPwrFail DFES_xAsgnEnvAllDataSize /end LOC_MEASUREMENT
 FUNCTION_VERSION "30000.70.0" /end FUNCTION
/begin COMPU_METHOD B_TRUE "" TAB_VERB "%6.3" "" COMPU_TAB_REF B_TRUE /end COMPU_METHOD
/begin COMPU_VTAB B_TRUE "" TAB_VERB 2 0 "FALSE" 1 "TRUE" /end COMPU_VTAB
/begin COMPU_METHOD Dem_DTCGroup_Verb "" TAB_VERB "%6.3" "-" COMPU_TAB_REF Dem_DTCGroup_Verb /end COMPU_METHOD
/begin COMPU_VTAB Dem_DTCGroup_Verb "" TAB_VERB 6 0 "DEM_DTC_GROUP_NONE" 1 "DEM_DTC_GROUP_EMISSION_REL" 2 "DEM_DTC_GROUP_POWERTRAIN" 4 "DEM_DTC_GROUP_CHASSIS" 8 "DEM_DTC_GROUP_BODY" 16 "DEM_DTC_GROUP_NETWORK_COM" /end COMPU_VTAB
/begin COMPU_METHOD Dem_DTCSeverity_Verb "" TAB_VERB "%6.3" "NO" COMPU_TAB_REF Dem_DTCSeverity_Verb /end COMPU_METHOD
/begin COMPU_VTAB Dem_DTCSeverity_Verb "" TAB_VERB 4 0 "DEM_SEVERITY_NO_SEVERITY" 32 "DEM_SEVERITY_MAINTENANCE_ONLY" 64 "DEM_SEVERITY_CHECK_AT_NEXT_HALT" 128 "DEM_SEVERITY_CHECK_IMMEDIATELY" /end COMPU_VTAB
/begin COMPU_METHOD DFCDFP_Verb "" TAB_VERB "%6.3" "-" COMPU_TAB_REF DFCDFP_Verb /end COMPU_METHOD
/begin COMPU_VTAB DFCDFP_Verb "" TAB_VERB 971 0 "NoEntry" 1 "DFC_ACCmprFltLvlRes" 2 "DFC_AbgHiSigFlt" 3 "DFC_AbgIntPatFlt" 4 "DFC_AbgLoSigFlt" 5 "DFC_AbgUnkwnErrSigFlt" 6 "DFC_AcExtChrgrIBattExcdd" 7 "DFC_AcExtChrgrIInExcdd" 8 "DFC_AcExtChrgrIOutDe" 9 "DFC_AcExtChrgrIOutExcdd" 10 "DFC_AcExtChrgrUOutDe" 11 "DFC_AdpActvDChaFailr" 12 "DFC_AirbcuFlt" 13 "DFC_Airbg" 14 "DFC_AirbgCan" 15 "DFC_AirbgCanHWPlaus" 16 "DFC_AirbgHWCanPlaus" 17 "DFC_AirbgMnr" 18 "DFC_AirbgPerHi" 19 "DFC_AirbgPerdRngFlt" 20 "DFC_BlowrRlyErr" 21 "DFC_BrkBstPmpActtnDfct" 22 "DFC_BrkBstPmpDeactvnDfct" 23 "DFC_BrkSwtFlt" 24 "DFC_CbnHeatgHeatrHsScb" 25 "DFC_CbnHeatgHeatrHsScg" 26 "DFC_CbnHeatgHeatrLsOl" 27 "DFC_CbnHeatgHeatrLsScb" 28 "DFC_CbnHeatgHeatrLsScg" 29 "DFC_CbnHeatgHeatrUnUsed" 30 "DFC_ChrgnCntctHsOt" 31 "DFC_ChrgnCntctHsScb" 32 "DFC_ChrgnCntctHsScg" 33 "DFC_ChrgnCntctLsNegOl" 34 "DFC_ChrgnCntctLsNegOt" 35 "DFC_ChrgnCntctLsNegScb" 36 "DFC_ChrgnCntctLsNegScg" 37 "DFC_ChrgnCntctLsPosOl" 38 "DFC_ChrgnCntctLsPosOt" 39 "DFC_ChrgnCntctLsPosScb" 40 "DFC_ChrgnCntctLsPosScg" 41 "DFC_ChrgnCntctUnUsed" 42 "DFC_ComBrkMai" 43 "DFC_ComChrgrEVCont" 44 "DFC_ComChrgrEVtBlink" 45 "DFC_ComChrgrMstBlink" 46 "DFC_ComChrgrMstCont" 47 "DFC_ComChrgrSVSBlink" 48 "DFC_ComChrgrSVSCont" 49 "DFC_ComDcdcEVBlink" 50 "DFC_ComDcdcEVCont" 51 "DFC_ComDcdcFltLvl2" 52 "DFC_ComDcdcFltLvl3" 53 "DFC_ComDcdcFltLvl4" 54 "DFC_ComDcdcFltLvl5" 55 "DFC_ComDcdcFltLvlRes" 56 "DFC_ComDcdcMstBlink" 57 "DFC_ComDcdcMstCont" 58 "DFC_ComDcdcSVSBlink" 59 "DFC_ComDcdcSVSCont" 60 "DFC_ComElMIIvtrFltLvl2" 61 "DFC_ComElMIIvtrFltLvl3" 62 "DFC_ComElMIIvtrFltLvl4" 63 "DFC_ComElMIIvtrFltLvl5" 64 "DFC_ComElMIIvtrFltLvlRes" 65 "DFC_ComEmacEVBlink" 66 "DFC_ComEmacEVCont" 67 "DFC_ComEmacMstCont" 68 "DFC_ComEmacMsttBlink" 69 "DFC_ComEmacSVSBlink" 70 "DFC_ComEmacSVSCont" 71 "DFC_ComGunCntInfoWkuReq" 72 "DFC_ComHillHldFlt" 73 "DFC_ComHvBattRchrgWkuReq" 74 "DFC_ComHvbFltLvl2" 75 "DFC_ComHvbFltLvl3" 76 "DFC_ComHvbFltLvl4" 77 "DFC_ComHvbFltLvl5" 78 "DFC_ComHvbFltLvlRes" 79 "DFC_ComHvbMstBlink" 80 "DFC_ComHvbMstCont" 81 "DFC_ComImmoUnlockWkuReq" 82 "DFC_ComInfoReqPtlWkuReq" 83 "DFC_ComOBCFltLvl2" 84 "DFC_ComOBCFltLvl3" 85 "DFC_ComOBCFltLvl4" 86 "DFC_ComOBCFltLvl5" 87 "DFC_ComOBCFltLvlRes" 88 "DFC_ComPostOperationWkuReq" 89 "DFC_ComPreCondElecWkuReq" 90 "DFC_ComRemUnlckWkuReq" 91 "DFC_ComStpDlyHMIWkuReq" 92 "DFC_ComflgCurMeasmtErr" 93 "DFC_ComflgCurMeasmtSysErr" 94 "DFC_ComflgCurMeasmtVld" 95 "DFC_ComflgCurRngErr" 96 "DFC_ComflgTPcbMeasmtErr" 97 "DFC_ComflgTPcbMeasmtVld" 98 "DFC_ComflgTPcbRngErr" 99 "DFC_ComflgTPcbSysErr" 100 "DFC_ComflgTShntMeasmtErr" 101 "DFC_ComflgTShntMeasmtVld" 102 "DFC_ComflgTShntRngErr" 103 "DFC_ComflgTShntSysErr" 104 "DFC_ComflgVoltMeasmtErr" 105 "DFC_ComflgVoltMeasmtSysErr" 106 "DFC_ComflgVoltMeasmtVld" 107 "DFC_ComflgVoltRngErr" 108 "DFC_CrashEveOcc" 109 "DFC_DcdcFwdModStuck" 110 "DFC_DcdcLvUDifMaxFlt" 111 "DFC_DcdcOffModStuck" 112 "DFC_DcdcOperModFailr" 113 "DFC_DcdcPrecModStuck" 114 "DFC_DrvDoorOpn" 115 "DFC_DrvModPosnDfct" 116 "DFC_DrvStbltOpn" 117 "DFC_ETogFailrLvl3" 118 "DFC_ETogFailrLvl4" 119 "DFC_EbsLvBattSocDiagLo" 120 "DFC_EbsLvBattUDiagDiOper" 121 "DFC_EbsLvBattUDiagFltLvl1" 122 "DFC_EbsLvBattUDiagFltLvl2" 123 "DFC_EbsLvBattUDiagLo" 124 "DFC_EbsSnsrSt" 125 "DFC_EbsSofASILErr" 126 "DFC_ElTSPtSysLimDrvErr" 127 "DFC_ElTSPtSysLimRgnErr" 128 "DFC_HLCCcsFwDwnl" 129 "DFC_HvBattChrgPwrMax" 130 "DFC_HvBattCrashDetd" 131 "DFC_HvBattDchaPwrMax" 132 "DFC_HvBattEmgyOff" 133 "DFC_HvBattEmgyOffIntlck" 134 "DFC_HvBattEmgyOffReq" 135 "DFC_HvBattFltMod" 136 "DFC_HvBattIReqToChrgrErr" 137 "DFC_HvBattIReqToChrgrIni" 138 "DFC_HvBattIninTout" 139 "DFC_HvBattIntlckSt" 140 "DFC_HvBattIsoFlt" 141 "DFC_HvBattLimdPwr" 142 "DFC_HvBattMaiSwtClsngFlt" 143 "DFC_HvBattMaiSwtFlt" 144 "DFC_HvBattMaiSwtOpen" 145 "DFC_HvBattMaiSwtOpngFlt" 146 "DFC_HvBattMaiSwtWldd" 147 "DFC_HvBattNegCntctrCntErr" 148 "DFC_HvBattOperModChrgPlausy" 149 "DFC_HvBattOverTDern" 150 "DFC_HvBattPosCntctrCntErr" 151 "DFC_HvBattPrecCntctrCntErr" 152 "DFC_HvBattPwrDistbnTDern" 153 "DFC_HvBattPwrDistbnTInhbn" 154 "DFC_HvBattRatRSohErr" 155 "DFC_HvBattRatSohErr" 156 "DFC_HvBattSngIsoWarn" 157 "DFC_HvBattSrvPlgDiscnct" 158 "DFC_HvBattUNomChrgnErr" 159 "DFC_HvBattUNomChrgnIni" 160 "DFC_HvBattUnderTDern" 161 "DFC_HvbEVLmpBlink" 162 "DFC_HvbEVLmpCont" 163 "DFC_HvbSVSBlink" 164 "DFC_HvbSVSCont" 165 "DFC_InmLINBusBlk" 166 "DFC_PDUProgmFailr" 167 "DFC_PEnvSigRngMax" 168 "DFC_PEnvSigRngMin" 169 "DFC_PLnCChpDeactvnFaild" 170 "DFC_PrkgBrkFailr" 171 "DFC_PtSysLimErr" 172 "DFC_PwrMaxDchaShoLo" 173 "DFC_SCtPmp1FailSafeNotSuc" 174 "DFC_SCtPmp1SCG" 175 "DFC_VehCoornDrvrNotPrsnt" 176 "DFC_VehVCanAvl" 177 "DFC_VehVCanErr" 178 "DFC_eTogFailrLvlRes" 179 "DFC_flgBrkMaiDiag" 180 "DFC_stHvbIsoMeasmtRes" 181 "DFC_BrkBstPmpPLeakDfct" 182 "DFC_Com082hTooShort" 183 "DFC_Com092hTooShort" 184 "DFC_Com205hAbsent" 185 "DFC_Com205hChecksum" 186 "DFC_Com205hCounter" 187 "DFC_Com205hTooShort" 188 "DFC_Com217hAbsent" 189 "DFC_Com217hChecksum" 190 "DFC_Com217hCounter" 191 "DFC_Com217hTooShort" 192 "DFC_Com227hAbsent" 193 "DFC_Com227hTooShort" 194 "DFC_Com237hAbsent" 195 "DFC_Com237hChecksum" 196 "DFC_Com237hCounter" 197 "DFC_Com237hTooShort" 198 "DFC_Com259hAbsent" 199 "DFC_Com259hChecksum" 200 "DFC_Com259hCounter" 201 "DFC_Com259hTooShort" 202 "DFC_Com26hAbsent" 203 "DFC_Com26hTooShort" 204 "DFC_Com273hAbsent" 205 "DFC_Com273hChecksum" 206 "DFC_Com273hCounter" 207 "DFC_Com273hTooShort" 208 "DFC_Com275hAbsent" 209 "DFC_Com275hChecksum" 210 "DFC_Com275hCounter" 211 "DFC_Com275hTooShort" 212 "DFC_Com283hAbsent" 213 "DFC_Com283hTooShort" 214 "DFC_Com285hAbsent" 215 "DFC_Com285hChecksum" 216 "DFC_Com285hCounter" 217 "DFC_Com285hTooShort" 218 "DFC_Com293hAbsent" 219 "DFC_Com293hChecksum" 220 "DFC_Com293hCounter" 221 "DFC_Com293hTooShort" 222 "DFC_Com308hAbsent" 223 "DFC_Com308hChecksum" 224 "DFC_Com308hCounter" 225 "DFC_Com308hTooShort" 226 "DFC_Com318hAbsent" 227 "DFC_Com318hChecksum" 228 "DFC_Com318hCounter" 229 "DFC_Com318hTooShort" 230 "DFC_Com325hAbsent" 231 "DFC_Com325hChecksum" 232 "DFC_Com325hCounter" 233 "DFC_Com325hTooShort" 234 "DFC_Com335hAbsent" 235 "DFC_Com335hChecksum" 236 "DFC_Com335hCounter" 237 "DFC_Com335hTooShort" 238 "DFC_Com351hAbsent" 239 "DFC_Com351hTooShort" 240 "DFC_Com38DhAbsent" 241 "DFC_Com38DhChecksum" 242 "DFC_Com38DhCounter" 243 "DFC_Com38DhTooShort" 244 "DFC_Com412hAbsent" 245 "DFC_Com412hChecksum" 246 "DFC_Com412hCounter" 247 "DFC_Com412hTooShort" 248 "DFC_Com427hAbsent" 249 "DFC_Com427hTooShort" 250 "DFC_Com432hAbsent" 251 "DFC_Com432hChecksum" 252 "DFC_Com432hCounter" 253 "DFC_Com432hTooShort" 254 "DFC_Com435hAbsent" 255 "DFC_Com435hTooShort" 256 "DFC_Com442hAbsent" 257 "DFC_Com442hTooShort" 258 "DFC_Com453hAbsent" 259 "DFC_Com453hTooShort" 260 "DFC_Com455hAbsent" 261 "DFC_Com455hTooShort" 262 "DFC_Com463hAbsent" 263 "DFC_Com463hTooShort" 264 "DFC_Com473hAbsent" 265 "DFC_Com473hTooShort" 266 "DFC_Com47BhAbsent" 267 "DFC_Com47BhTooShort" 268 "DFC_Com48BhAbsent" 269 "DFC_Com48BhTooShort" 270 "DFC_Com497hTooShort" 271 "DFC_Com4F2hAbsent" 272 "DFC_Com4F2hChecksum" 273 "DFC_Com4F2hCounter" 274 "DFC_Com4F2hTooShort" 275 "DFC_Com50DhAbsent" 276 "DFC_Com50DhTooShort" 277 "DFC_Com535hAbsent" 278 "DFC_Com535hTooShort" 279 "DFC_Com543hAbsent" 280 "DFC_Com543hTooShort" 281 "DFC_Com552hAbsent" 282 "DFC_Com552hTooShort" 283 "DFC_Com583hAbsent" 284 "DFC_Com583hTooShort" 285 "DFC_Com592hAbsent" 286 "DFC_Com592hChecksum" 287 "DFC_Com592hCounter" 288 "DFC_Com592hTooShort" 289 "DFC_Com595hAbsent" 290 "DFC_Com595hChecksum" 291 "DFC_Com595hCounter" 292 "DFC_Com595hTooShort" 293 "DFC_Com5B2hAbsent" 294 "DFC_Com5B2hTooShort" 295 "DFC_Com5B5hAbsent" 296 "DFC_Com5B5hChecksum" 297 "DFC_Com5B5hCounter" 298 "DFC_Com5B5hTooShort" 299 "DFC_Com5C7hTooShort" 300 "DFC_Com5E7hAbsent" 301 "DFC_Com5E7hTooShort" 302 "DFC_Com635hTooShort" 303 "DFC_Com645hTooShort" 304 "DFC_Com663hAbsent" 305 "DFC_Com663hTooShort" 306 "DFC_Com665hAbsent" 307 "DFC_Com665hTooShort" 308 "DFC_Com675hAbsent" 309 "DFC_Com675hTooShort" 310 "DFC_ComFrbd_205h_HVBAT_PACK_CURRENT" 311 "DFC_ComFrbd_205h_HVBAT_SOC_DISPLAY" 312 "DFC_ComFrbd_205h_HVBAT_VOLTAGE" 313 "DFC_ComFrbd_217h_INV_DC_BUS_VOLTAGE" 314 "DFC_ComFrbd_217h_INV_MTR_ACTUAL_TRQ" 315 "DFC_ComFrbd_217h_INV_MTR_SPEED" 316 "DFC_ComFrbd_217h_INV_MTR_TRQ" 317 "DFC_ComFrbd_227h_INV_DC_CURRENT" 318 "DFC_ComFrbd_227h_INV_MOTORING_PEAK_TRQ" 319 "DFC_ComFrbd_227h_INV_MTR_INST_INPUT_POWER" 320 "DFC_ComFrbd_227h_INV_REGEN_PEAK_TRQ" 321 "DFC_ComFrbd_237h_INV_ACTIVE_DISCHARGE_STATUS" 322 "DFC_ComFrbd_237h_INV_CTRL_MODE_ACK" 323 "DFC_ComFrbd_237h_INV_EV_WARNING" 324 "DFC_ComFrbd_237h_INV_FAULT_LEVEL" 325 "DFC_ComFrbd_237h_INV_MASTER_STOP" 326 "DFC_ComFrbd_237h_INV_SERVICE_DUE" 327 "DFC_ComFrbd_237h_INV_STAB_MIN_TRQ" 328 "DFC_ComFrbd_259h_TGLM_FAILURE_STATE" 329 "DFC_ComFrbd_259h_TGLM_MODE_PUSH" 330 "DFC_ComFrbd_259h_TOGGLE_MONOSTABLE_POS" 331 "DFC_ComFrbd_273h_OBC_outputpower_capability" 332 "DFC_ComFrbd_275h_HVBAT_DISCHARGE_30S_AVAILABLE_CURRENT" 333 "DFC_ComFrbd_275h_HVBAT_DISCHARGE_30S_AVAILABLE_POWER" 334 "DFC_ComFrbd_283h_DCDC_IN_CURRENT" 335 "DFC_ComFrbd_283h_DCDC_IN_VOLTAGE" 336 "DFC_ComFrbd_283h_DCDC_OUT_CURRENT" 337 "DFC_ComFrbd_283h_DCDC_OUT_VOLTAGE" 338 "DFC_ComFrbd_285h_HVBAT_REGEN_CHG_30S_CURRENT_LIMIT" 339 "DFC_ComFrbd_285h_HVBAT_REGEN_CHRG_30S_POWER_LIMIT" 340 "DFC_ComFrbd_293h_DCDC_outputpower_capability" 341 "DFC_ComFrbd_325h_HVBAT_INSULATION_RESISTANCE" 342 "DFC_ComFrbd_325h_HVBAT_TEMPERATURE" 343 "DFC_ComFrbd_335h_HVBAT_CHRG_CONTINUOUS_CURR_MAX" 344 "DFC_ComFrbd_335h_HVBAT_CHRG_COTINUOUS_CURR_REQ" 345 "DFC_ComFrbd_335h_HVBAT_CHRG_MAX_VOLT" 346 "DFC_ComFrbd_335h_HVBAT_DC_BUS_VOLTAGE" 347 "DFC_ComFrbd_427h_INV_OP_MODE" 348 "DFC_ComFrbd_427h_INV_PERMISIBLE_TORQUE" 349 "DFC_ComFrbd_435h_HVBAT_MAX_CELL_VOLT" 350 "DFC_ComFrbd_435h_HVBAT_MAX_CELL_VOLT_NUM" 351 "DFC_ComFrbd_435h_HVBAT_MAX_SENSOR_TEMP" 352 "DFC_ComFrbd_435h_HVBAT_MIN_CELL_VOLT" 353 "DFC_ComFrbd_435h_HVBAT_MIN_CELL_VOLT_NUM" 354 "DFC_ComFrbd_453h_OBC_IN_CURRENT" 355 "DFC_ComFrbd_453h_OBC_IN_VOLTAGE" 356 "DFC_ComFrbd_453h_OBC_IP_POWER" 357 "DFC_ComFrbd_455h_HVBAT_NOMINAL_VOLTAGE" 358 "DFC_ComFrbd_463h_OBC_OUT_CURRENT" 359 "DFC_ComFrbd_463h_OBC_OUT_VOLTAGE" 360 "DFC_ComFrbd_463h_OBC_TEMPERATURE" 361 "DFC_ComFrbd_473h_DCDC_Coolant_Temperature" 362 "DFC_ComFrbd_473h_DCDC_TEMPERATURE" 363 "DFC_ComFrbd_47Bh_eCOMP_BusBarCurrent" 364 "DFC_ComFrbd_47Bh_eCOMP_BusBarVoltage" 365 "DFC_ComFrbd_47Bh_eCOMP_CompressorSpeed" 366 "DFC_ComFrbd_47Bh_eCOMP_IGBT_Temp" 367 "DFC_ComFrbd_47Bh_eCOMP_PeakPhaCurrent" 368 "DFC_ComFrbd_47Bh_eCOMP_Power_consumption" 369 "DFC_ComFrbd_48Bh_eCOMP_Fault_Level" 370 "DFC_ComFrbd_4F2h_VALEUR_SOC_ETENDUE" 371 "DFC_ComFrbd_535h_HV_BATT_TEMP_AVG" 372 "DFC_ComFrbd_543h_HVBAT_RESTBATTENERGY" 373 "DFC_ComFrbd_543h_HVBAT_SOH" 374 "DFC_ComFrbd_543h_HV_BATT_SOH_RES" 375 "DFC_ComFrbd_592h_IBATT_1" 376 "DFC_ComFrbd_592h_IBATT_2" 377 "DFC_ComFrbd_592h_IBATT_3" 378 "DFC_ComFrbd_592h_TEMP_BATT" 379 "DFC_ComFrbd_592h_U_BATT_BECB" 380 "DFC_ComFrbd_595h_HVBAT_TIME_TO_CHRG_80" 381 "DFC_ComFrbd_5B2h_TEMP_AIR_EXT" 382 "DFC_ComFrbd_635h_HVBAT_NEG_CONT_COUNT_SEG1" 383 "DFC_ComFrbd_635h_HVBAT_NEG_CONT_COUNT_SEG3" 384 "DFC_ComFrbd_635h_HVBAT_NEG_CONT_COUNT_SEG4" 385 "DFC_ComFrbd_635h_HVBAT_PST_CONT_COUNT_SEG1" 386 "DFC_ComFrbd_635h_HVBAT_PST_CONT_COUNT_SEG3" 387 "DFC_ComFrbd_635h_HVBAT_PST_CONT_COUNT_SEG4" 388 "DFC_ComFrbd_645h_HVBAT_PRECHRGE_CONT_COUNT_SEG1" 389 "DFC_ComFrbd_645h_HVBAT_PRECHRGE_CONT_COUNT_SEG2" 390 "DFC_ComFrbd_675h_HVBAT_REMAININGBATTCAPACITY" 391 "DFC_ComInvld_205h_HVBAT_CHARGING_STATUS" 392 "DFC_ComInvld_205h_HVBAT_PACK_CURRENT" 393 "DFC_ComInvld_205h_HVBAT_SOC_DISPLAY" 394 "DFC_ComInvld_205h_HVBAT_VOLTAGE" 395 "DFC_ComInvld_217h_INV_DC_BUS_VOLTAGE" 396 "DFC_ComInvld_217h_INV_MTR_ACTUAL_TRQ" 397 "DFC_ComInvld_217h_INV_MTR_SPEED" 398 "DFC_ComInvld_217h_INV_MTR_TRQ" 399 "DFC_ComInvld_227h_INV_DC_CURRENT" 400 "DFC_ComInvld_227h_INV_MOTORING_PEAK_TRQ" 401 "DFC_ComInvld_227h_INV_MTR_INST_INPUT_POWER" 402 "DFC_ComInvld_227h_INV_REGEN_PEAK_TRQ" 403 "DFC_ComInvld_237h_INV_ACTIVE_DISCHARGE_STATUS" 404 "DFC_ComInvld_237h_INV_FAULT_LEVEL" 405 "DFC_ComInvld_237h_INV_STAB_MIN_TRQ" 406 "DFC_ComInvld_259h_TGLM_MODE_PUSH" 407 "DFC_ComInvld_259h_TOGGLE_MONOSTABLE_POS" 408 "DFC_ComInvld_26h_AC_SWITCH_REQ" 409 "DFC_ComInvld_26h_BLOWER_POSITION" 410 "DFC_ComInvld_26h_EVAP_SENSOR_FAULT" 411 "DFC_ComInvld_26h_EVAP_SENSOR_VALUE" 412 "DFC_ComInvld_26h_POTENTIOMETER_FAULT" 413 "DFC_ComInvld_26h_REAR_DEFOG_REQ" 414 "DFC_ComInvld_26h_TEMP_POSITION" 415 "DFC_ComInvld_273h_OBC_FAULT_LEVEL" 416 "DFC_ComInvld_273h_OBC_outputpower_capability" 417 "DFC_ComInvld_275h_HVBAT_DISCHARGE_30S_AVAILABLE_CURRENT" 418 "DFC_ComInvld_275h_HVBAT_DISCHARGE_30S_AVAILABLE_POWER" 419 "DFC_ComInvld_283h_DCDC_IN_CURRENT" 420 "DFC_ComInvld_283h_DCDC_IN_VOLTAGE" 421 "DFC_ComInvld_283h_DCDC_OUT_CURRENT" 422 "DFC_ComInvld_283h_DCDC_OUT_VOLTAGE" 423 "DFC_ComInvld_285h_HVBAT_REGEN_CHG_30S_CURRENT_LIMIT" 424 "DFC_ComInvld_285h_HVBAT_REGEN_CHRG_30S_POWER_LIMIT" 425 "DFC_ComInvld_293h_DCDC_FAULT_LEVEL" 426 "DFC_ComInvld_293h_DCDC_outputpower_capability" 427 "DFC_ComInvld_325h_HVBAT_EPLUG_STATUS" 428 "DFC_ComInvld_325h_HVBAT_HVIL_STS" 429 "DFC_ComInvld_325h_HVBAT_INSULATION_FAULT" 430 "DFC_ComInvld_325h_HVBAT_INSULATION_RESISTANCE" 431 "DFC_ComInvld_325h_HVBAT_TEMPERATURE" 432 "DFC_ComInvld_335h_HVBAT_CHRG_CONTINUOUS_CURR_MAX" 433 "DFC_ComInvld_335h_HVBAT_CHRG_COTINUOUS_CURR_REQ" 434 "DFC_ComInvld_335h_HVBAT_CHRG_MAX_VOLT" 435 "DFC_ComInvld_335h_HVBAT_DC_BUS_VOLTAGE" 436 "DFC_ComInvld_38Dh_VITESSE_VEHICULE_ROUES" 437 "DFC_ComInvld_38Dh_VVH_INDISP" 438 "DFC_ComInvld_427h_INV_COOLANT_TEMP" 439 "DFC_ComInvld_427h_INV_MOTOR_TEMP" 440 "DFC_ComInvld_427h_INV_OP_MODE" 441 "DFC_ComInvld_427h_INV_PERMISIBLE_TORQUE" 442 "DFC_ComInvld_427h_INV_TEMP" 443 "DFC_ComInvld_432h_REVEIL_PRINCIPAL" 444 "DFC_ComInvld_435h_HVBAT_MAX_CELL_VOLT" 445 "DFC_ComInvld_435h_HVBAT_MAX_CELL_VOLT_NUM" 446 "DFC_ComInvld_435h_HVBAT_MAX_SENSOR_TEMP" 447 "DFC_ComInvld_435h_HVBAT_MIN_CELL_VOLT" 448 "DFC_ComInvld_435h_HVBAT_MIN_CELL_VOLT_NUM" 449 "DFC_ComInvld_442h_BCCM_BLOWER_RELAY_STS" 450 "DFC_ComInvld_453h_OBC_IN_CURRENT" 451 "DFC_ComInvld_453h_OBC_IN_VOLTAGE" 452 "DFC_ComInvld_453h_OBC_IP_POWER" 453 "DFC_ComInvld_455h_HVBAT_NOMINAL_VOLTAGE" 454 "DFC_ComInvld_463h_OBC_OUT_CURRENT" 455 "DFC_ComInvld_463h_OBC_OUT_VOLTAGE" 456 "DFC_ComInvld_463h_OBC_TEMPERATURE" 457 "DFC_ComInvld_473h_DCDC_Coolant_Temperature" 458 "DFC_ComInvld_473h_DCDC_TEMPERATURE" 459 "DFC_ComInvld_47Bh_eCOMP_BusBarCurrent" 460 "DFC_ComInvld_47Bh_eCOMP_BusBarVoltage" 461 "DFC_ComInvld_47Bh_eCOMP_CompressorSpeed" 462 "DFC_ComInvld_47Bh_eCOMP_IGBT_Temp" 463 "DFC_ComInvld_47Bh_eCOMP_PeakPhaCurrent" 464 "DFC_ComInvld_47Bh_eCOMP_Power_consumption" 465 "DFC_ComInvld_4F2h_STATUS_SOC" 466 "DFC_ComInvld_4F2h_TEMP_BATT_STATUS" 467 "DFC_ComInvld_4F2h_VALEUR_SOC_ETENDUE" 468 "DFC_ComInvld_535h_HV_BATT_TEMP_AVG" 469 "DFC_ComInvld_543h_HVBAT_RESTBATTENERGY" 470 "DFC_ComInvld_543h_HVBAT_SOH" 471 "DFC_ComInvld_543h_HV_BATT_SOH_RES" 472 "DFC_ComInvld_552h_CPT_TEMPOREL" 473 "DFC_ComInvld_552h_KILOMETRAGE" 474 "DFC_ComInvld_583h_HV_BATT_DISCONT_CSE_OPEN" 475 "DFC_ComInvld_592h_CALIBRE_IBATT" 476 "DFC_ComInvld_592h_IBATT_1" 477 "DFC_ComInvld_592h_IBATT_2" 478 "DFC_ComInvld_592h_IBATT_3" 479 "DFC_ComInvld_592h_TEMP_BATT" 480 "DFC_ComInvld_592h_U_BATT_BECB" 481 "DFC_ComInvld_595h_HVBAT_TIME_TO_CHRG_80" 482 "DFC_ComInvld_5B2h_TEMP_AIR_EXT" 483 "DFC_ComInvld_5B5h_HVBAT_THERMAL_RUNAWAY" 484 "DFC_ComInvld_635h_HVBAT_NEG_CONT_COUNT_SEG1" 485 "DFC_ComInvld_635h_HVBAT_NEG_CONT_COUNT_SEG3" 486 "DFC_ComInvld_635h_HVBAT_NEG_CONT_COUNT_SEG4" 487 "DFC_ComInvld_635h_HVBAT_PST_CONT_COUNT_SEG1" 488 "DFC_ComInvld_635h_HVBAT_PST_CONT_COUNT_SEG3" 489 "DFC_ComInvld_635h_HVBAT_PST_CONT_COUNT_SEG4" 490 "DFC_ComInvld_645h_HVBAT_PRECHRGE_CONT_COUNT_SEG1" 491 "DFC_ComInvld_645h_HVBAT_PRECHRGE_CONT_COUNT_SEG2" 492 "DFC_ComInvld_675h_HVBAT_REMAININGBATTCAPACITY" 493 "DFC_ACCmprFltLvl1" 494 "DFC_ACCmprFltLvl2" 495 "DFC_ACCmprFltLvl3" 496 "DFC_ACCmprFltLvl4" 497 "DFC_ACCmprHiPFlt" 498 "DFC_ACCmprInvldCmprSt" 499 "DFC_ACCmprInvldElecActPwr" 500 "DFC_ACCmprLoPFlt" 501 "DFC_AcChrgrIntkTSRCMin" 502 "DFC_BattUBMaxBatt" 503 "DFC_BattUBMaxNoBatt" 504 "DFC_BattUBMinBatt" 505 "DFC_BattUBMinNoBatt" 506 "DFC_BattUSRCMax" 507 "DFC_BattUSRCMin" 508 "DFC_BrkBstPHiCautionDfct" 509 "DFC_BrkBstPHiWarnDfct" 510 "DFC_BrkBstPSnsr12PlausDfct" 511 "DFC_BrkBstPSnsr1Scb" 512 "DFC_BrkBstPSnsr1Scg" 513 "DFC_BrkBstPSnsr2Scb" 514 "DFC_BrkBstPSnsr2Scg" 515 "DFC_BrkBstPSnsrMax" 516 "DFC_BrkBstPSnsrMin" 517 "DFC_BrkBstPhyRngChkMax" 518 "DFC_BrkBstPhyRngChkMin" 519 "DFC_BrkBstPmpHsScb" 520 "DFC_BrkBstPmpHsScg" 521 "DFC_BrkBstPmpLsOl" 522 "DFC_BrkBstPmpLsScb" 523 "DFC_BrkBstPmpLsScg" 524 "DFC_CbnHeatgHeatrRlyOpend" 525 "DFC_CbnHeatgHeatrRlyWldd" 526 "DFC_CcsDcIBattExcdd" 527 "DFC_CcsDcIEvseOutDe" 528 "DFC_CcsDcIOutDe" 529 "DFC_CcsDcIOutExcdd" 530 "DFC_CcsDcUOutDe" 531 "DFC_CcsDcUOutExcdd" 532 "DFC_CcsPwrLineChpRstOL" 533 "DFC_CcsPwrLineChpRstOvrTemp" 534 "DFC_CcsPwrLineChpRstSCB" 535 "DFC_CcsPwrLineChpRstSCG" 536 "DFC_CcsPwrLineChpVccEnaOL" 537 "DFC_CcsPwrLineChpVccEnaOvrTemp" 538 "DFC_CcsPwrLineChpVccEnaSCB" 539 "DFC_CcsPwrLineChpVccEnaSCG" 540 "DFC_CcsPwrLineChpVccSRCMin" 541 "DFC_CcsPwrLineComChpTSRCMin" 542 "DFC_CtPSwtActrOL" 543 "DFC_CtPSwtActrOvrTemp" 544 "DFC_CtPSwtActrSCB" 545 "DFC_CtPSwtActrSCG" 546 "DFC_CtPSwtDiagSRCMin" 547 "DFC_CtpCarrFrqSRCMin" 548 "DFC_DcChrgrIntkT2SRCMin" 549 "DFC_DcChrgrIntkTSRCMin" 550 "DFC_DevLibBattUHi" 551 "DFC_DevLibBattULo" 552 "DFC_EmWakeupSigOL" 553 "DFC_EmWakeupSigOvrTemp" 554 "DFC_EmWakeupSigSCB" 555 "DFC_EmWakeupSigSCG" 556 "DFC_Fan1OL" 557 "DFC_Fan1OvrTemp" 558 "DFC_Fan1SCB" 559 "DFC_FanRlySCB" 560 "DFC_FanRlySCG" 561 "DFC_FanSpdSRCMin" 562 "DFC_FreonPSRCMin" 563 "DFC_HLCCcsPLnCChipTHi" 564 "DFC_HeatrCoreTSRCMin" 565 "DFC_PwmCtPSRCMin" 566 "DFC_PwrDistbnUnitTSRCMin" 567 "DFC_SCtPmp1OL" 568 "DFC_SCtPmp1OvrTemp" 569 "DFC_SCtPmp1SCB" 570 "DFC_SCtPmpRlyOL" 571 "DFC_SCtPmpRlyOvrTemp" 572 "DFC_SCtPmpRlySCB" 573 "DFC_SpplCooltPmpRlyOL" 574 "DFC_SpplCooltPmpRlyOvrTemp" 575 "DFC_SpplCooltPmpRlySCB" 576 "DFC_UCtPSRCMin" 577 "DFC_UPxP1SRCMin" 578 "DFC_ComHSN1CANMute" 579 "DFC_ComHSN3CANMute" 580 "DFC_AcChrgrIntkTPhysRngHi" 581 "DFC_AcChrgrIntkTPhysRngLo" 582 "DFC_AcChrgrIntkTSRCOpn" 583 "DFC_CcsPwrLineChpVccPhysRngHi" 584 "DFC_CcsPwrLineChpVccPhysRngLo" 585 "DFC_CcsPwrLineChpVccSRCOpn" 586 "DFC_CcsPwrLineComChpTPhysRngHi" 587 "DFC_CcsPwrLineComChpTPhysRngLo" 588 "DFC_CcsPwrLineComChpTSRCOpn" 589 "DFC_CtPSwtDiagPhysRngHi" 590 "DFC_CtPSwtDiagPhysRngLo" 591 "DFC_CtPSwtDiagSRCOpn" 592 "DFC_CtpCarrFrqPhysRngHi" 593 "DFC_CtpCarrFrqPhysRngLo" 594 "DFC_CtpCarrFrqSRCMax" 595 "DFC_DcChrgrIntkT2PhysRngHi" 596 "DFC_DcChrgrIntkT2PhysRngLo" 597 "DFC_DcChrgrIntkT2SRCOpn" 598 "DFC_DcChrgrIntkTPhysRngHi" 599 "DFC_DcChrgrIntkTPhysRngLo" 600 "DFC_DcChrgrIntkTSRCOpn" 601 "DFC_Fan1SCG" 602 "DFC_FanSpdPhysRngHi" 603 "DFC_FanSpdPhysRngLo" 604 "DFC_FanSpdSRCOpn" 605 "DFC_FreonPPhysRngHi" 606 "DFC_FreonPPhysRngLo" 607 "DFC_FreonPSRCOpn" 608 "DFC_HeatrCoreTPhysRngHi" 609 "DFC_HeatrCoreTPhysRngLo" 610 "DFC_HeatrCoreTSRCOpn" 611 "DFC_HvGridUMaxSftyLim" 612 "DFC_HvGridUMinSftyLim" 613 "DFC_HvGridUPlausy" 614 "DFC_IntlckChrgPlgHBrgOpnLd" 615 "DFC_IntlckChrgPlgHBrgOvrCurr" 616 "DFC_IntlckChrgPlgHBrgOvrTemp" 617 "DFC_IntlckChrgPlgHBrgShCirBatt1" 618 "DFC_IntlckChrgPlgHBrgShCirBatt2" 619 "DFC_IntlckChrgPlgHBrgShCirGnd1" 620 "DFC_IntlckChrgPlgHBrgShCirGnd2" 621 "DFC_IntlckChrgPlgHBrgShCirOvrLd" 622 "DFC_IntlckChrgPlgHBrgTempOvrCurr" 623 "DFC_IntlckChrgPlgHBrgUndrVltg" 624 "DFC_IntlckChrgPlgPosnRngFlt" 625 "DFC_IntlckChrgPlgPosnSrcMax" 626 "DFC_IntlckChrgPlgPosnSrcMin" 627 "DFC_PwmCtPPhysRngHi" 628 "DFC_PwmCtPPhysRngLo" 629 "DFC_PwmCtPSRCMax" 630 "DFC_PwrDistbnUnitTPhysRngHi" 631 "DFC_PwrDistbnUnitTPhysRngLo" 632 "DFC_PwrDistbnUnitTSRCOpn" 633 "DFC_SCtPmpRlySCG" 634 "DFC_SpplCooltPmpRlySCG" 635 "DFC_UCtPPhysRngHi" 636 "DFC_UCtPPhysRngLo" 637 "DFC_UCtPSRCOpn" 638 "DFC_UPxP1PhysRngHi" 639 "DFC_UPxP1PhysRngLo" 640 "DFC_UPxP1SRCOpn" 641 "DFC_VehVPhysRngHi" 642 "DFC_VehVPhysRngLo" 643 "DFC_VehVSigCan" 644 "DFC_VehVSigCanSafe" 645 "DFC_SCtPmp1DiagGrdKey1" 646 "DFC_SCtPmp1DiagGrdKey2" 647 "DFC_SCtPmp1DiagGrdKey3" 648 "DFC_SCtPmp1DiagGrdKey4" 649 "DFC_SCtPmp1DiagGrdKey5" 650 "DFC_ChrgPlgLiveCntctHzrdCcs" 651 "DFC_ChrgPlgProxPltImps" 652 "DFC_ChrgPlgTHiCcsDc" 653 "DFC_ElMActvDchaFailr" 654 "DFC_ElMActvDchaFlt" 655 "DFC_ElMFbdnIvtrModDrv01" 656 "DFC_ElMImobAuthent" 657 "DFC_ElMIsoMonFlt" 658 "DFC_ElMIsoMonPlausyFlt" 659 "DFC_ElMIvtrCooltT01" 660 "DFC_ElMIvtrEmgyShtDwn01" 661 "DFC_ElMIvtrFailr01" 662 "DFC_ElMIvtrIntlck01" 663 "DFC_ElMIvtrTErr01" 664 "DFC_ElMOverSpdNeg01" 665 "DFC_ElMOverSpdPos01" 666 "DFC_ElMOverTqNeg01" 667 "DFC_ElMOverTqPos01" 668 "DFC_ElMPwrAuthn" 669 "DFC_ElMSpdErr01" 670 "DFC_ElMSvs01" 671 "DFC_PEnvCcMax" 672 "DFC_PEnvCcMin" 673 "DFC_PEnvRngChkMax" 674 "DFC_PEnvRngChkMin" 675 "DFC_PEnvSnsrPlaus" 676 "DFC_BrkBstPmpPlausGenn" 677 "DFC_CbnHeatrRlyLfLoWarn" 678 "DFC_ChgrPlugLockPinByndClsd" 679 "DFC_ChgrPlugLockPinMoveWoCmd" 680 "DFC_ChgrPlugLockPinStuckInClsd" 681 "DFC_ChgrPlugLockPinStuckInOpen" 682 "DFC_ChrgrStErr" 683 "DFC_ComHSN1BusOff" 684 "DFC_ComHSN3BusOff" 685 "DFC_ComVCInval" 686 "DFC_EemDcdcPrecSpdInhb" 687 "DFC_ExpPwrLatch" 688 "DFC_FanMaxOvrd" 689 "DFC_HLCCcsGnrlComErr" 690 "DFC_InmLINNodeHVACPanelAbsnt" 691 "DFC_ResetRcvNotAllwd" 692 "DFC_TelltlCooltPlaus" 693 "DFC_MRlyOL" 694 "DFC_MRlySCB" 695 "DFC_MRlySCG" 696 "DFC_SSpMon1" 697 "DFC_SSpMon1OV" 698 "DFC_SSpMon1SCG" 699 "DFC_SSpMon1UV" 700 "DFC_SSpMon2" 701 "DFC_SSpMon2OV" 702 "DFC_SSpMon2SCG" 703 "DFC_SSpMon2UV" 704 "DFC_SSpMon3" 705 "DFC_SSpMon3OV" 706 "DFC_SSpMon3SCG" 707 "DFC_SSpMon3UV" 708 "DFC_CANSM_E_BUS_OFF_NETWORK_HSN1_CAN" 709 "DFC_CANSM_E_BUS_OFF_NETWORK_HSN3_CAN" 710 "DFC_CANSM_E_BUS_OFF_NETWORK_HSN4_CAN" 711 "DFC_CANSM_E_BUS_OFF_NETWORK_XCP_CAN" 712 "DFC_CANTRCV_E_NO_TRCV_CONTROL_0" 713 "DFC_CAN_E_TIMEOUT" 714 "DFC_COMM_E_NET_START_IND_CHANNEL_0" 715 "DFC_COMM_E_NET_START_IND_CHANNEL_1" 716 "DFC_COMM_E_NET_START_IND_CHANNEL_2" 717 "DFC_COMM_E_NET_START_IND_CHANNEL_3" 718 "DFC_COMM_E_NET_START_IND_CHANNEL_4" 719 "DFC_COMM_E_NET_START_IND_CHANNEL_5" 720 "DFC_LIN_E_TIMEOUT" 721 "DFC_rba_EcuCtrl_TOMaxProlg" 722 "DFC_rba_EcuCtrl_TOMaxShutDwn" 723 "DFC_rba_MultiStackTrace_Threshold" 724 "DFC_rba_SyC_CustStates_Degraded_disord_Event" 725 "DFC_rba_SyC_CustStates_Degraded_incst_Event" 726 "DFC_rba_SyC_CustStates_TransNoWakReq_Event" 727 "DFC_RBA_IOEXTLIB_KEEPALIVE_DRV" 728 "DFC_RBA_IOEXTLIB_KEEPALIVE_INI" 729 "DFC_rba_IoSigRtc_StopCounter" 730 "DFC_rba_MRly_Diag_Stk_Event" 731 "DFC_rba_MemDiag_MemReadErr" 732 "DFC_rba_MemDiag_MemWrErr" 733 "DFC_rba_SyC_IrrSwOffTrigEngRun_Event" 734 "DFC_AcChrgrIntkTSRCMax" 735 "DFC_AcChrgrIntkTTmpErr" 736 "DFC_AcFlt" 737 "DFC_AppAllSnsrDfct" 738 "DFC_BattUPwrFail" 739 "DFC_BrkBstBkupOvrn" 740 "DFC_BrkBstPmpOvld" 741 "DFC_BrkPlausChk" 742 "DFC_CbnHeatgSwtTmpErr" 743 "DFC_CcsPwrLineChpVccSRCMax" 744 "DFC_CcsPwrLineChpVccTmpErr" 745 "DFC_CcsPwrLineComChpTSRCMax" 746 "DFC_CcsPwrLineComChpTTmpErr" 747 "DFC_ChgrPlugCtpCarrFrqErr" 748 "DFC_ChgrPlugCtpSwtStuckClsd" 749 "DFC_ChgrPlugCtpSwtStuckOpen" 750 "DFC_ChgrPlugCtpUErrHi" 751 "DFC_ChgrPlugPxp1SrcErr" 752 "DFC_ChrgCntctAllWldd" 753 "DFC_ChrgCntctNegOperErr" 754 "DFC_ChrgCntctNegOperWarn" 755 "DFC_ChrgCntctNegWldd" 756 "DFC_ChrgCntctPosOperErr" 757 "DFC_ChrgCntctPosOperWarn" 758 "DFC_ChrgCntctPosWldd" 759 "DFC_ChrgCntctStuckOpen" 760 "DFC_ChrgPlgIntlckFaild" 761 "DFC_ChrgnUnplRqrd" 762 "DFC_CoElMOffsCalibActv01" 763 "DFC_CtPSwtDiagSRCMax" 764 "DFC_CtPSwtDiagTmpErr" 765 "DFC_CtpCarrFrqTmpErr" 766 "DFC_DcChrgrIntkT2SRCMax" 767 "DFC_DcChrgrIntkT2TmpErr" 768 "DFC_DcChrgrIntkTSRCMax" 769 "DFC_DcChrgrIntkTTmpErr" 770 "DFC_EChrDvPlinCntrThdExcdd" 771 "DFC_EemDiagCtctrClsTout" 772 "DFC_EemDiagDcdcOffTOut" 773 "DFC_EemDiagHvCnsrOffTOut" 774 "DFC_EemDiagHvbOffTOut" 775 "DFC_FanSpdSRCMax" 776 "DFC_FanSpdTmpErr" 777 "DFC_FreonPSRCMax" 778 "DFC_FreonPTmpErr" 779 "DFC_HeatrCoreTSRCMax" 780 "DFC_HeatrCoreTTmpErr" 781 "DFC_HvGridSocMinLim" 782 "DFC_HvacBlwrFrntFlt" 783 "DFC_HvacEvapElecFlt" 784 "DFC_HvacEvapElecFltGnd" 785 "DFC_HvacKnobPosnFlt" 786 "DFC_InvBinID" 787 "DFC_InvCalID" 788 "DFC_InvErotan" 789 "DFC_InvVinID" 790 "DFC_MOXEMM_SMU_ALM0_0" 791 "DFC_MOXEMM_SMU_ALM0_1" 792 "DFC_MOXEMM_SMU_ALM0_10" 793 "DFC_MOXEMM_SMU_ALM0_11" 794 "DFC_MOXEMM_SMU_ALM0_13" 795 "DFC_MOXEMM_SMU_ALM0_14" 796 "DFC_MOXEMM_SMU_ALM0_2" 797 "DFC_MOXEMM_SMU_ALM0_22" 798 "DFC_MOXEMM_SMU_ALM0_23" 799 "DFC_MOXEMM_SMU_ALM0_4" 800 "DFC_MOXEMM_SMU_ALM0_5" 801 "DFC_MOXEMM_SMU_ALM0_7" 802 "DFC_MOXEMM_SMU_ALM0_8" 803 "DFC_MOXEMM_SMU_ALM10_16" 804 "DFC_MOXEMM_SMU_ALM10_17" 805 "DFC_MOXEMM_SMU_ALM10_21" 806 "DFC_MOXEMM_SMU_ALM11_0" 807 "DFC_MOXEMM_SMU_ALM11_1" 808 "DFC_MOXEMM_SMU_ALM11_2" 809 "DFC_MOXEMM_SMU_ALM11_3" 810 "DFC_MOXEMM_SMU_ALM11_4" 811 "DFC_MOXEMM_SMU_ALM11_5" 812 "DFC_MOXEMM_SMU_ALM11_8" 813 "DFC_MOXEMM_SMU_ALM11_9" 814 "DFC_MOXEMM_SMU_ALM1_0" 815 "DFC_MOXEMM_SMU_ALM1_1" 816 "DFC_MOXEMM_SMU_ALM1_10" 817 "DFC_MOXEMM_SMU_ALM1_11" 818 "DFC_MOXEMM_SMU_ALM1_13" 819 "DFC_MOXEMM_SMU_ALM1_14" 820 "DFC_MOXEMM_SMU_ALM1_2" 821 "DFC_MOXEMM_SMU_ALM1_22" 822 "DFC_MOXEMM_SMU_ALM1_23" 823 "DFC_MOXEMM_SMU_ALM1_4" 824 "DFC_MOXEMM_SMU_ALM1_5" 825 "DFC_MOXEMM_SMU_ALM1_7" 826 "DFC_MOXEMM_SMU_ALM1_8" 827 "DFC_MOXEMM_SMU_ALM21_0" 828 "DFC_MOXEMM_SMU_ALM21_16" 829 "DFC_MOXEMM_SMU_ALM21_3" 830 "DFC_MOXEMM_SMU_ALM2_1" 831 "DFC_MOXEMM_SMU_ALM2_10" 832 "DFC_MOXEMM_SMU_ALM2_11" 833 "DFC_MOXEMM_SMU_ALM2_13" 834 "DFC_MOXEMM_SMU_ALM2_14" 835 "DFC_MOXEMM_SMU_ALM2_22" 836 "DFC_MOXEMM_SMU_ALM2_23" 837 "DFC_MOXEMM_SMU_ALM2_4" 838 "DFC_MOXEMM_SMU_ALM2_5" 839 "DFC_MOXEMM_SMU_ALM2_7" 840 "DFC_MOXEMM_SMU_ALM2_8" 841 "DFC_MOXEMM_SMU_ALM6_0" 842 "DFC_MOXEMM_SMU_ALM6_11" 843 "DFC_MOXEMM_SMU_ALM6_12" 844 "DFC_MOXEMM_SMU_ALM6_14" 845 "DFC_MOXEMM_SMU_ALM6_15" 846 "DFC_MOXEMM_SMU_ALM6_17" 847 "DFC_MOXEMM_SMU_ALM6_18" 848 "DFC_MOXEMM_SMU_ALM6_20" 849 "DFC_MOXEMM_SMU_ALM6_21" 850 "DFC_MOXEMM_SMU_ALM6_25" 851 "DFC_MOXEMM_SMU_ALM6_4" 852 "DFC_MOXEMM_SMU_ALM6_5" 853 "DFC_MOXEMM_SMU_ALM6_7" 854 "DFC_MOXEMM_SMU_ALM6_8" 855 "DFC_MOXEMM_SMU_ALM7_1" 856 "DFC_MOXEMM_SMU_ALM7_12" 857 "DFC_MOXEMM_SMU_ALM7_13" 858 "DFC_MOXEMM_SMU_ALM7_14" 859 "DFC_MOXEMM_SMU_ALM7_15" 860 "DFC_MOXEMM_SMU_ALM7_16" 861 "DFC_MOXEMM_SMU_ALM7_17" 862 "DFC_MOXEMM_SMU_ALM7_2" 863 "DFC_MOXEMM_SMU_ALM7_20" 864 "DFC_MOXEMM_SMU_ALM7_25" 865 "DFC_MOXEMM_SMU_ALM7_26" 866 "DFC_MOXEMM_SMU_ALM7_28" 867 "DFC_MOXEMM_SMU_ALM7_29" 868 "DFC_MOXEMM_SMU_ALM7_30" 869 "DFC_MOXEMM_SMU_ALM7_31" 870 "DFC_MOXEMM_SMU_ALM8_0" 871 "DFC_MOXEMM_SMU_ALM8_1" 872 "DFC_MOXEMM_SMU_ALM8_10" 873 "DFC_MOXEMM_SMU_ALM8_11" 874 "DFC_MOXEMM_SMU_ALM8_12" 875 "DFC_MOXEMM_SMU_ALM8_16" 876 "DFC_MOXEMM_SMU_ALM8_18" 877 "DFC_MOXEMM_SMU_ALM8_2" 878 "DFC_MOXEMM_SMU_ALM8_3" 879 "DFC_MOXEMM_SMU_ALM8_31" 880 "DFC_MOXEMM_SMU_ALM8_4" 881 "DFC_MOXEMM_SMU_ALM9_0" 882 "DFC_MOXEMM_SMU_ALM9_15" 883 "DFC_MOXEMM_SMU_ALM9_3" 884 "DFC_MoCADCNTPBnk1" 885 "DFC_MoCADCTestVoltBnk1" 886 "DFC_MoCSOPICO" 887 "DFC_MoFAccr" 888 "DFC_MoFCbnPreCdngOvrheat" 889 "DFC_MoFCbnPreCdngTmrExpi" 890 "DFC_MoFEvMngtBms" 891 "DFC_MoFEvMngtDcdc" 892 "DFC_MoFEvMngtEm01" 893 "DFC_MoFEvMngtEm01BrkgToZr" 894 "DFC_MoFEvMngtEm01EngSpd" 895 "DFC_MoFEvMngtEm02EngSpd" 896 "DFC_MoFEvMngtEm02Lvl1" 897 "DFC_MoFEvMngtEm02Lvl2" 898 "DFC_MoFExtCptAuxCpt" 899 "DFC_MoFExtCptVacPmpErr" 900 "DFC_MoFTqPtdAxle" 901 "DFC_MoFTqPtdAxleSec" 902 "DFC_MoFTqPtdEmPtRels" 903 "DFC_MoFTqPtdEmPtRelsSec" 904 "DFC_MoFTqPtdEmSign" 905 "DFC_MoFTqPtdEmSignSec" 906 "DFC_MoFTqPtdEmTq" 907 "DFC_MoFTqPtdEmTqSec" 908 "DFC_MoFTqPtdVeh" 909 "DFC_MoFVarPostBldSel" 910 "DFC_MoSysCtrlReIni" 911 "DFC_MoXEMMHwLTMCUFW" 912 "DFC_MoXEMMHwLTMonBIST" 913 "DFC_MoXEMMHwLTRegMonTest" 914 "DFC_MoXEMMHwLTStbySMUAlvTest" 915 "DFC_MoXEMMHwLTTempSens" 916 "DFC_MoXEMMHwLTUCBCfg" 917 "DFC_MonEgyChrgnCoorr_AcChrgnWoMofRels" 918 "DFC_MonEgyChrgnCoorr_ChrgnAbortIgr" 919 "DFC_MonEgyChrgnCoorr_DcCntctFailr" 920 "DFC_MonEgyChrgnCoorr_ExtChrgnShtOffReq" 921 "DFC_MonEgyChrgnCoorr_ImpsChrgnMod" 922 "DFC_MonEgyChrgnCoorr_ImpsChrgnPrms" 923 "DFC_MonEgyChrgnCoorr_ImpsUDcIntk" 924 "DFC_MonEgyChrgnCoorr_PlgLockMovmt" 925 "DFC_MonEgyChrgnCoorr_VehCrashDetn" 926 "DFC_MonEgyChrgnErrReactn_SftySwt" 927 "DFC_MonEgyChrgnInlet_CcsPlgCtp" 928 "DFC_MonEgyChrgnInlet_CcsPlgCtpPwm" 929 "DFC_MonEgyChrgnInlet_CcsPlgLockCtrlImpsAtmpt" 930 "DFC_MonEgyChrgnInlet_CcsPlgLockSnsrSigRngChk" 931 "DFC_MonEgyChrgnInlet_CcsPlgLockStImps" 932 "DFC_MonEgyChrgnInlet_CcsPlgPxp" 933 "DFC_MonEgyChrgnT_Snsr1GrdtChk" 934 "DFC_MonEgyChrgnT_Snsr1SigRngChk" 935 "DFC_MonEgyChrgnT_Snsr2GrdtChk" 936 "DFC_MonEgyChrgnT_Snsr2SigRngChk" 937 "DFC_MonEgyChrgnT_SnsrDif" 938 "DFC_OCWDAABEActv" 939 "DFC_OCWDACom" 940 "DFC_OCWDAErrPin" 941 "DFC_OCWDAOvrVltg" 942 "DFC_PUmax" 943 "DFC_PwmCtPTmpErr" 944 "DFC_PwrDistbnUnitTSRCMax" 945 "DFC_PwrDistbnUnitTTmpErr" 946 "DFC_SCtPmp1DiagGrdKeyErr" 947 "DFC_SRCHighAPP1" 948 "DFC_SRCHighAPP2" 949 "DFC_SRCLowAPP1" 950 "DFC_SRCLowAPP2" 951 "DFC_SWReset_0" 952 "DFC_SWReset_1" 953 "DFC_SWReset_2" 954 "DFC_Sia_InvldCode" 955 "DFC_Sia_InvldKey" 956 "DFC_Sia_NoRespUCx" 957 "DFC_Sia_TprotRttp" 958 "DFC_StrtUpEvStandStillDeactvn" 959 "DFC_SyncAPP" 960 "DFC_UCtPSRCMax" 961 "DFC_UCtPTmpErr" 962 "DFC_UPxP1SRCMax" 963 "DFC_UPxP1TmpErr" 964 "DFC_VehVObd" 965 "DFP_AAA" 966 "DFP_PU" 967 "DFP_PUE" 968 "DFP_PUPL" 969 "DFP_PUR" 970 "DFP_ZZZ" DEFAULT_VALUE "---" /end COMPU_VTAB
/begin COMPU_METHOD DFC_OneToOne "" RAT_FUNC "%6.2" "-" COEFFS 0 1 0 0 0 1 /end COMPU_METHOD
/begin COMPU_METHOD DFC_Verb "" TAB_VERB "%6.3" "-" COMPU_TAB_REF DFC_Verb /end COMPU_METHOD
/begin COMPU_VTAB DFC_Verb "" TAB_VERB 965 0 "DFC_Unused" 2 "DFC_AbgHiSigFlt" 3 "DFC_AbgIntPatFlt" 4 "DFC_AbgLoSigFlt" 5 "DFC_AbgUnkwnErrSigFlt" 580 "DFC_AcChrgrIntkTPhysRngHi" 581 "DFC_AcChrgrIntkTPhysRngLo" 734 "DFC_AcChrgrIntkTSRCMax" 501 "DFC_AcChrgrIntkTSRCMin" 582 "DFC_AcChrgrIntkTSRCOpn" 735 "DFC_AcChrgrIntkTTmpErr" 493 "DFC_ACCmprFltLvl1" 494 "DFC_ACCmprFltLvl2" 495 "DFC_ACCmprFltLvl3" 496 "DFC_ACCmprFltLvl4" 1 "DFC_ACCmprFltLvlRes" 497 "DFC_ACCmprHiPFlt" 498 "DFC_ACCmprInvldCmprSt" 499 "DFC_ACCmprInvldElecActPwr" 500 "DFC_ACCmprLoPFlt" 6 "DFC_AcExtChrgrIBattExcdd" 7 "DFC_AcExtChrgrIInExcdd" 8 "DFC_AcExtChrgrIOutDe" 9 "DFC_AcExtChrgrIOutExcdd" 10 "DFC_AcExtChrgrUOutDe" 736 "DFC_AcFlt" 11 "DFC_AdpActvDChaFailr" 12 "DFC_AirbcuFlt" 13 "DFC_Airbg" 14 "DFC_AirbgCan" 15 "DFC_AirbgCanHWPlaus" 16 "DFC_AirbgHWCanPlaus" 17 "DFC_AirbgMnr" 19 "DFC_AirbgPerdRngFlt" 18 "DFC_AirbgPerHi" 737 "DFC_AppAllSnsrDfct" 502 "DFC_BattUBMaxBatt" 503 "DFC_BattUBMaxNoBatt" 504 "DFC_BattUBMinBatt" 505 "DFC_BattUBMinNoBatt" 738 "DFC_BattUPwrFail" 506 "DFC_BattUSRCMax" 507 "DFC_BattUSRCMin" 20 "DFC_BlowrRlyErr" 739 "DFC_BrkBstBkupOvrn" 508 "DFC_BrkBstPHiCautionDfct" 509 "DFC_BrkBstPHiWarnDfct" 517 "DFC_BrkBstPhyRngChkMax" 518 "DFC_BrkBstPhyRngChkMin" 21 "DFC_BrkBstPmpActtnDfct" 22 "DFC_BrkBstPmpDeactvnDfct" 519 "DFC_BrkBstPmpHsScb" 520 "DFC_BrkBstPmpHsScg" 521 "DFC_BrkBstPmpLsOl" 522 "DFC_BrkBstPmpLsScb" 523 "DFC_BrkBstPmpLsScg" 740 "DFC_BrkBstPmpOvld" 676 "DFC_BrkBstPmpPlausGenn" 181 "DFC_BrkBstPmpPLeakDfct" 510 "DFC_BrkBstPSnsr12PlausDfct" 511 "DFC_BrkBstPSnsr1Scb" 512 "DFC_BrkBstPSnsr1Scg" 513 "DFC_BrkBstPSnsr2Scb" 514 "DFC_BrkBstPSnsr2Scg" 515 "DFC_BrkBstPSnsrMax" 516 "DFC_BrkBstPSnsrMin" 741 "DFC_BrkPlausChk" 23 "DFC_BrkSwtFlt" 713 "DFC_CAN_E_TIMEOUT" 708 "DFC_CANSM_E_BUS_OFF_NETWORK_HSN1_CAN" 709 "DFC_CANSM_E_BUS_OFF_NETWORK_HSN3_CAN" 710 "DFC_CANSM_E_BUS_OFF_NETWORK_HSN4_CAN" 711 "DFC_CANSM_E_BUS_OFF_NETWORK_XCP_CAN" 712 "DFC_CANTRCV_E_NO_TRCV_CONTROL_0" 24 "DFC_CbnHeatgHeatrHsScb" 25 "DFC_CbnHeatgHeatrHsScg" 26 "DFC_CbnHeatgHeatrLsOl" 27 "DFC_CbnHeatgHeatrLsScb" 28 "DFC_CbnHeatgHeatrLsScg" 524 "DFC_CbnHeatgHeatrRlyOpend" 525 "DFC_CbnHeatgHeatrRlyWldd" 29 "DFC_CbnHeatgHeatrUnUsed" 742 "DFC_CbnHeatgSwtTmpErr" 677 "DFC_CbnHeatrRlyLfLoWarn" 526 "DFC_CcsDcIBattExcdd" 527 "DFC_CcsDcIEvseOutDe" 528 "DFC_CcsDcIOutDe" 529 "DFC_CcsDcIOutExcdd" 530 "DFC_CcsDcUOutDe" 531 "DFC_CcsDcUOutExcdd" 532 "DFC_CcsPwrLineChpRstOL" 533 "DFC_CcsPwrLineChpRstOvrTemp" 534 "DFC_CcsPwrLineChpRstSCB" 535 "DFC_CcsPwrLineChpRstSCG" 536 "DFC_CcsPwrLineChpVccEnaOL" 537 "DFC_CcsPwrLineChpVccEnaOvrTemp" 538 "DFC_CcsPwrLineChpVccEnaSCB" 539 "DFC_CcsPwrLineChpVccEnaSCG" 583 "DFC_CcsPwrLineChpVccPhysRngHi" 584 "DFC_CcsPwrLineChpVccPhysRngLo" 743 "DFC_CcsPwrLineChpVccSRCMax" 540 "DFC_CcsPwrLineChpVccSRCMin" 585 "DFC_CcsPwrLineChpVccSRCOpn" 744 "DFC_CcsPwrLineChpVccTmpErr" 586 "DFC_CcsPwrLineComChpTPhysRngHi" 587 "DFC_CcsPwrLineComChpTPhysRngLo" 745 "DFC_CcsPwrLineComChpTSRCMax" 541 "DFC_CcsPwrLineComChpTSRCMin" 588 "DFC_CcsPwrLineComChpTSRCOpn" 746 "DFC_CcsPwrLineComChpTTmpErr" 747 "DFC_ChgrPlugCtpCarrFrqErr" 748 "DFC_ChgrPlugCtpSwtStuckClsd" 749 "DFC_ChgrPlugCtpSwtStuckOpen" 750 "DFC_ChgrPlugCtpUErrHi" 678 "DFC_ChgrPlugLockPinByndClsd" 679 "DFC_ChgrPlugLockPinMoveWoCmd" 680 "DFC_ChgrPlugLockPinStuckInClsd" 681 "DFC_ChgrPlugLockPinStuckInOpen" 751 "DFC_ChgrPlugPxp1SrcErr" 752 "DFC_ChrgCntctAllWldd" 753 "DFC_ChrgCntctNegOperErr" 754 "DFC_ChrgCntctNegOperWarn" 755 "DFC_ChrgCntctNegWldd" 756 "DFC_ChrgCntctPosOperErr" 757 "DFC_ChrgCntctPosOperWarn" 758 "DFC_ChrgCntctPosWldd" 759 "DFC_ChrgCntctStuckOpen" 30 "DFC_ChrgnCntctHsOt" 31 "DFC_ChrgnCntctHsScb" 32 "DFC_ChrgnCntctHsScg" 33 "DFC_ChrgnCntctLsNegOl" 34 "DFC_ChrgnCntctLsNegOt" 35 "DFC_ChrgnCntctLsNegScb" 36 "DFC_ChrgnCntctLsNegScg" 37 "DFC_ChrgnCntctLsPosOl" 38 "DFC_ChrgnCntctLsPosOt" 39 "DFC_ChrgnCntctLsPosScb" 40 "DFC_ChrgnCntctLsPosScg" 41 "DFC_ChrgnCntctUnUsed" 761 "DFC_ChrgnUnplRqrd" 760 "DFC_ChrgPlgIntlckFaild" 650 "DFC_ChrgPlgLiveCntctHzrdCcs" 651 "DFC_ChrgPlgProxPltImps" 652 "DFC_ChrgPlgTHiCcsDc" 682 "DFC_ChrgrStErr" 762 "DFC_CoElMOffsCalibActv01" 182 "DFC_Com082hTooShort" 183 "DFC_Com092hTooShort" 184 "DFC_Com205hAbsent" 185 "DFC_Com205hChecksum" 186 "DFC_Com205hCounter" 187 "DFC_Com205hTooShort" 188 "DFC_Com217hAbsent" 189 "DFC_Com217hChecksum" 190 "DFC_Com217hCounter" 191 "DFC_Com217hTooShort" 192 "DFC_Com227hAbsent" 193 "DFC_Com227hTooShort" 194 "DFC_Com237hAbsent" 195 "DFC_Com237hChecksum" 196 "DFC_Com237hCounter" 197 "DFC_Com237hTooShort" 198 "DFC_Com259hAbsent" 199 "DFC_Com259hChecksum" 200 "DFC_Com259hCounter" 201 "DFC_Com259hTooShort" 202 "DFC_Com26hAbsent" 203 "DFC_Com26hTooShort" 204 "DFC_Com273hAbsent" 205 "DFC_Com273hChecksum" 206 "DFC_Com273hCounter" 207 "DFC_Com273hTooShort" 208 "DFC_Com275hAbsent" 209 "DFC_Com275hChecksum" 210 "DFC_Com275hCounter" 211 "DFC_Com275hTooShort" 212 "DFC_Com283hAbsent" 213 "DFC_Com283hTooShort" 214 "DFC_Com285hAbsent" 215 "DFC_Com285hChecksum" 216 "DFC_Com285hCounter" 217 "DFC_Com285hTooShort" 218 "DFC_Com293hAbsent" 219 "DFC_Com293hChecksum" 220 "DFC_Com293hCounter" 221 "DFC_Com293hTooShort" 222 "DFC_Com308hAbsent" 223 "DFC_Com308hChecksum" 224 "DFC_Com308hCounter" 225 "DFC_Com308hTooShort" 226 "DFC_Com318hAbsent" 227 "DFC_Com318hChecksum" 228 "DFC_Com318hCounter" 229 "DFC_Com318hTooShort" 230 "DFC_Com325hAbsent" 231 "DFC_Com325hChecksum" 232 "DFC_Com325hCounter" 233 "DFC_Com325hTooShort" 234 "DFC_Com335hAbsent" 235 "DFC_Com335hChecksum" 236 "DFC_Com335hCounter" 237 "DFC_Com335hTooShort" 238 "DFC_Com351hAbsent" 239 "DFC_Com351hTooShort" 240 "DFC_Com38DhAbsent" 241 "DFC_Com38DhChecksum" 242 "DFC_Com38DhCounter" 243 "DFC_Com38DhTooShort" 244 "DFC_Com412hAbsent" 245 "DFC_Com412hChecksum" 246 "DFC_Com412hCounter" 247 "DFC_Com412hTooShort" 248 "DFC_Com427hAbsent" 249 "DFC_Com427hTooShort" 250 "DFC_Com432hAbsent" 251 "DFC_Com432hChecksum" 252 "DFC_Com432hCounter" 253 "DFC_Com432hTooShort" 254 "DFC_Com435hAbsent" 255 "DFC_Com435hTooShort" 256 "DFC_Com442hAbsent" 257 "DFC_Com442hTooShort" 258 "DFC_Com453hAbsent" 259 "DFC_Com453hTooShort" 260 "DFC_Com455hAbsent" 261 "DFC_Com455hTooShort" 262 "DFC_Com463hAbsent" 263 "DFC_Com463hTooShort" 264 "DFC_Com473hAbsent" 265 "DFC_Com473hTooShort" 266 "DFC_Com47BhAbsent" 267 "DFC_Com47BhTooShort" 268 "DFC_Com48BhAbsent" 269 "DFC_Com48BhTooShort" 270 "DFC_Com497hTooShort" 271 "DFC_Com4F2hAbsent" 272 "DFC_Com4F2hChecksum" 273 "DFC_Com4F2hCounter" 274 "DFC_Com4F2hTooShort" 275 "DFC_Com50DhAbsent" 276 "DFC_Com50DhTooShort" 277 "DFC_Com535hAbsent" 278 "DFC_Com535hTooShort" 279 "DFC_Com543hAbsent" 280 "DFC_Com543hTooShort" 281 "DFC_Com552hAbsent" 282 "DFC_Com552hTooShort" 283 "DFC_Com583hAbsent" 284 "DFC_Com583hTooShort" 285 "DFC_Com592hAbsent" 286 "DFC_Com592hChecksum" 287 "DFC_Com592hCounter" 288 "DFC_Com592hTooShort" 289 "DFC_Com595hAbsent" 290 "DFC_Com595hChecksum" 291 "DFC_Com595hCounter" 292 "DFC_Com595hTooShort" 293 "DFC_Com5B2hAbsent" 294 "DFC_Com5B2hTooShort" 295 "DFC_Com5B5hAbsent" 296 "DFC_Com5B5hChecksum" 297 "DFC_Com5B5hCounter" 298 "DFC_Com5B5hTooShort" 299 "DFC_Com5C7hTooShort" 300 "DFC_Com5E7hAbsent" 301 "DFC_Com5E7hTooShort" 302 "DFC_Com635hTooShort" 303 "DFC_Com645hTooShort" 304 "DFC_Com663hAbsent" 305 "DFC_Com663hTooShort" 306 "DFC_Com665hAbsent" 307 "DFC_Com665hTooShort" 308 "DFC_Com675hAbsent" 309 "DFC_Com675hTooShort" 42 "DFC_ComBrkMai" 43 "DFC_ComChrgrEVCont" 44 "DFC_ComChrgrEVtBlink" 45 "DFC_ComChrgrMstBlink" 46 "DFC_ComChrgrMstCont" 47 "DFC_ComChrgrSVSBlink" 48 "DFC_ComChrgrSVSCont" 49 "DFC_ComDcdcEVBlink" 50 "DFC_ComDcdcEVCont" 51 "DFC_ComDcdcFltLvl2" 52 "DFC_ComDcdcFltLvl3" 53 "DFC_ComDcdcFltLvl4" 54 "DFC_ComDcdcFltLvl5" 55 "DFC_ComDcdcFltLvlRes" 56 "DFC_ComDcdcMstBlink" 57 "DFC_ComDcdcMstCont" 58 "DFC_ComDcdcSVSBlink" 59 "DFC_ComDcdcSVSCont" 60 "DFC_ComElMIIvtrFltLvl2" 61 "DFC_ComElMIIvtrFltLvl3" 62 "DFC_ComElMIIvtrFltLvl4" 63 "DFC_ComElMIIvtrFltLvl5" 64 "DFC_ComElMIIvtrFltLvlRes" 65 "DFC_ComEmacEVBlink" 66 "DFC_ComEmacEVCont" 67 "DFC_ComEmacMstCont" 68 "DFC_ComEmacMsttBlink" 69 "DFC_ComEmacSVSBlink" 70 "DFC_ComEmacSVSCont" 92 "DFC_ComflgCurMeasmtErr" 93 "DFC_ComflgCurMeasmtSysErr" 94 "DFC_ComflgCurMeasmtVld" 95 "DFC_ComflgCurRngErr" 96 "DFC_ComflgTPcbMeasmtErr" 97 "DFC_ComflgTPcbMeasmtVld" 98 "DFC_ComflgTPcbRngErr" 99 "DFC_ComflgTPcbSysErr" 100 "DFC_ComflgTShntMeasmtErr" 101 "DFC_ComflgTShntMeasmtVld" 102 "DFC_ComflgTShntRngErr" 103 "DFC_ComflgTShntSysErr" 104 "DFC_ComflgVoltMeasmtErr" 105 "DFC_ComflgVoltMeasmtSysErr" 106 "DFC_ComflgVoltMeasmtVld" 107 "DFC_ComflgVoltRngErr" 310 "DFC_ComFrbd_205h_HVBAT_PACK_CURRENT" 311 "DFC_ComFrbd_205h_HVBAT_SOC_DISPLAY" 312 "DFC_ComFrbd_205h_HVBAT_VOLTAGE" 313 "DFC_ComFrbd_217h_INV_DC_BUS_VOLTAGE" 314 "DFC_ComFrbd_217h_INV_MTR_ACTUAL_TRQ" 315 "DFC_ComFrbd_217h_INV_MTR_SPEED" 316 "DFC_ComFrbd_217h_INV_MTR_TRQ" 317 "DFC_ComFrbd_227h_INV_DC_CURRENT" 318 "DFC_ComFrbd_227h_INV_MOTORING_PEAK_TRQ" 319 "DFC_ComFrbd_227h_INV_MTR_INST_INPUT_POWER" 320 "DFC_ComFrbd_227h_INV_REGEN_PEAK_TRQ" 321 "DFC_ComFrbd_237h_INV_ACTIVE_DISCHARGE_STATUS" 322 "DFC_ComFrbd_237h_INV_CTRL_MODE_ACK" 323 "DFC_ComFrbd_237h_INV_EV_WARNING" 324 "DFC_ComFrbd_237h_INV_FAULT_LEVEL" 325 "DFC_ComFrbd_237h_INV_MASTER_STOP" 326 "DFC_ComFrbd_237h_INV_SERVICE_DUE" 327 "DFC_ComFrbd_237h_INV_STAB_MIN_TRQ" 328 "DFC_ComFrbd_259h_TGLM_FAILURE_STATE" 329 "DFC_ComFrbd_259h_TGLM_MODE_PUSH" 330 "DFC_ComFrbd_259h_TOGGLE_MONOSTABLE_POS" 331 "DFC_ComFrbd_273h_OBC_outputpower_capability" 332 "DFC_ComFrbd_275h_HVBAT_DISCHARGE_30S_AVAILABLE_CURRENT" 333 "DFC_ComFrbd_275h_HVBAT_DISCHARGE_30S_AVAILABLE_POWER" 334 "DFC_ComFrbd_283h_DCDC_IN_CURRENT" 335 "DFC_ComFrbd_283h_DCDC_IN_VOLTAGE" 336 "DFC_ComFrbd_283h_DCDC_OUT_CURRENT" 337 "DFC_ComFrbd_283h_DCDC_OUT_VOLTAGE" 338 "DFC_ComFrbd_285h_HVBAT_REGEN_CHG_30S_CURRENT_LIMIT" 339 "DFC_ComFrbd_285h_HVBAT_REGEN_CHRG_30S_POWER_LIMIT" 340 "DFC_ComFrbd_293h_DCDC_outputpower_capability" 341 "DFC_ComFrbd_325h_HVBAT_INSULATION_RESISTANCE" 342 "DFC_ComFrbd_325h_HVBAT_TEMPERATURE" 343 "DFC_ComFrbd_335h_HVBAT_CHRG_CONTINUOUS_CURR_MAX" 344 "DFC_ComFrbd_335h_HVBAT_CHRG_COTINUOUS_CURR_REQ" 345 "DFC_ComFrbd_335h_HVBAT_CHRG_MAX_VOLT" 346 "DFC_ComFrbd_335h_HVBAT_DC_BUS_VOLTAGE" 347 "DFC_ComFrbd_427h_INV_OP_MODE" 348 "DFC_ComFrbd_427h_INV_PERMISIBLE_TORQUE" 349 "DFC_ComFrbd_435h_HVBAT_MAX_CELL_VOLT" 350 "DFC_ComFrbd_435h_HVBAT_MAX_CELL_VOLT_NUM" 351 "DFC_ComFrbd_435h_HVBAT_MAX_SENSOR_TEMP" 352 "DFC_ComFrbd_435h_HVBAT_MIN_CELL_VOLT" 353 "DFC_ComFrbd_435h_HVBAT_MIN_CELL_VOLT_NUM" 354 "DFC_ComFrbd_453h_OBC_IN_CURRENT" 355 "DFC_ComFrbd_453h_OBC_IN_VOLTAGE" 356 "DFC_ComFrbd_453h_OBC_IP_POWER" 357 "DFC_ComFrbd_455h_HVBAT_NOMINAL_VOLTAGE" 358 "DFC_ComFrbd_463h_OBC_OUT_CURRENT" 359 "DFC_ComFrbd_463h_OBC_OUT_VOLTAGE" 360 "DFC_ComFrbd_463h_OBC_TEMPERATURE" 361 "DFC_ComFrbd_473h_DCDC_Coolant_Temperature" 362 "DFC_ComFrbd_473h_DCDC_TEMPERATURE" 363 "DFC_ComFrbd_47Bh_eCOMP_BusBarCurrent" 364 "DFC_ComFrbd_47Bh_eCOMP_BusBarVoltage" 365 "DFC_ComFrbd_47Bh_eCOMP_CompressorSpeed" 366 "DFC_ComFrbd_47Bh_eCOMP_IGBT_Temp" 367 "DFC_ComFrbd_47Bh_eCOMP_PeakPhaCurrent" 368 "DFC_ComFrbd_47Bh_eCOMP_Power_consumption" 369 "DFC_ComFrbd_48Bh_eCOMP_Fault_Level" 370 "DFC_ComFrbd_4F2h_VALEUR_SOC_ETENDUE" 371 "DFC_ComFrbd_535h_HV_BATT_TEMP_AVG" 374 "DFC_ComFrbd_543h_HV_BATT_SOH_RES" 372 "DFC_ComFrbd_543h_HVBAT_RESTBATTENERGY" 373 "DFC_ComFrbd_543h_HVBAT_SOH" 375 "DFC_ComFrbd_592h_IBATT_1" 376 "DFC_ComFrbd_592h_IBATT_2" 377 "DFC_ComFrbd_592h_IBATT_3" 378 "DFC_ComFrbd_592h_TEMP_BATT" 379 "DFC_ComFrbd_592h_U_BATT_BECB" 380 "DFC_ComFrbd_595h_HVBAT_TIME_TO_CHRG_80" 381 "DFC_ComFrbd_5B2h_TEMP_AIR_EXT" 382 "DFC_ComFrbd_635h_HVBAT_NEG_CONT_COUNT_SEG1" 383 "DFC_ComFrbd_635h_HVBAT_NEG_CONT_COUNT_SEG3" 384 "DFC_ComFrbd_635h_HVBAT_NEG_CONT_COUNT_SEG4" 385 "DFC_ComFrbd_635h_HVBAT_PST_CONT_COUNT_SEG1" 386 "DFC_ComFrbd_635h_HVBAT_PST_CONT_COUNT_SEG3" 387 "DFC_ComFrbd_635h_HVBAT_PST_CONT_COUNT_SEG4" 388 "DFC_ComFrbd_645h_HVBAT_PRECHRGE_CONT_COUNT_SEG1" 389 "DFC_ComFrbd_645h_HVBAT_PRECHRGE_CONT_COUNT_SEG2" 390 "DFC_ComFrbd_675h_HVBAT_REMAININGBATTCAPACITY" 71 "DFC_ComGunCntInfoWkuReq" 72 "DFC_ComHillHldFlt" 683 "DFC_ComHSN1BusOff" 578 "DFC_ComHSN1CANMute" 684 "DFC_ComHSN3BusOff" 579 "DFC_ComHSN3CANMute" 73 "DFC_ComHvBattRchrgWkuReq" 74 "DFC_ComHvbFltLvl2" 75 "DFC_ComHvbFltLvl3" 76 "DFC_ComHvbFltLvl4" 77 "DFC_ComHvbFltLvl5" 78 "DFC_ComHvbFltLvlRes" 79 "DFC_ComHvbMstBlink" 80 "DFC_ComHvbMstCont" 81 "DFC_ComImmoUnlockWkuReq" 82 "DFC_ComInfoReqPtlWkuReq" 391 "DFC_ComInvld_205h_HVBAT_CHARGING_STATUS" 392 "DFC_ComInvld_205h_HVBAT_PACK_CURRENT" 393 "DFC_ComInvld_205h_HVBAT_SOC_DISPLAY" 394 "DFC_ComInvld_205h_HVBAT_VOLTAGE" 395 "DFC_ComInvld_217h_INV_DC_BUS_VOLTAGE" 396 "DFC_ComInvld_217h_INV_MTR_ACTUAL_TRQ" 397 "DFC_ComInvld_217h_INV_MTR_SPEED" 398 "DFC_ComInvld_217h_INV_MTR_TRQ" 399 "DFC_ComInvld_227h_INV_DC_CURRENT" 400 "DFC_ComInvld_227h_INV_MOTORING_PEAK_TRQ" 401 "DFC_ComInvld_227h_INV_MTR_INST_INPUT_POWER" 402 "DFC_ComInvld_227h_INV_REGEN_PEAK_TRQ" 403 "DFC_ComInvld_237h_INV_ACTIVE_DISCHARGE_STATUS" 404 "DFC_ComInvld_237h_INV_FAULT_LEVEL" 405 "DFC_ComInvld_237h_INV_STAB_MIN_TRQ" 406 "DFC_ComInvld_259h_TGLM_MODE_PUSH" 407 "DFC_ComInvld_259h_TOGGLE_MONOSTABLE_POS" 408 "DFC_ComInvld_26h_AC_SWITCH_REQ" 409 "DFC_ComInvld_26h_BLOWER_POSITION" 410 "DFC_ComInvld_26h_EVAP_SENSOR_FAULT" 411 "DFC_ComInvld_26h_EVAP_SENSOR_VALUE" 412 "DFC_ComInvld_26h_POTENTIOMETER_FAULT" 413 "DFC_ComInvld_26h_REAR_DEFOG_REQ" 414 "DFC_ComInvld_26h_TEMP_POSITION" 415 "DFC_ComInvld_273h_OBC_FAULT_LEVEL" 416 "DFC_ComInvld_273h_OBC_outputpower_capability" 417 "DFC_ComInvld_275h_HVBAT_DISCHARGE_30S_AVAILABLE_CURRENT" 418 "DFC_ComInvld_275h_HVBAT_DISCHARGE_30S_AVAILABLE_POWER" 419 "DFC_ComInvld_283h_DCDC_IN_CURRENT" 420 "DFC_ComInvld_283h_DCDC_IN_VOLTAGE" 421 "DFC_ComInvld_283h_DCDC_OUT_CURRENT" 422 "DFC_ComInvld_283h_DCDC_OUT_VOLTAGE" 423 "DFC_ComInvld_285h_HVBAT_REGEN_CHG_30S_CURRENT_LIMIT" 424 "DFC_ComInvld_285h_HVBAT_REGEN_CHRG_30S_POWER_LIMIT" 425 "DFC_ComInvld_293h_DCDC_FAULT_LEVEL" 426 "DFC_ComInvld_293h_DCDC_outputpower_capability" 427 "DFC_ComInvld_325h_HVBAT_EPLUG_STATUS" 428 "DFC_ComInvld_325h_HVBAT_HVIL_STS" 429 "DFC_ComInvld_325h_HVBAT_INSULATION_FAULT" 430 "DFC_ComInvld_325h_HVBAT_INSULATION_RESISTANCE" 431 "DFC_ComInvld_325h_HVBAT_TEMPERATURE" 432 "DFC_ComInvld_335h_HVBAT_CHRG_CONTINUOUS_CURR_MAX" 433 "DFC_ComInvld_335h_HVBAT_CHRG_COTINUOUS_CURR_REQ" 434 "DFC_ComInvld_335h_HVBAT_CHRG_MAX_VOLT" 435 "DFC_ComInvld_335h_HVBAT_DC_BUS_VOLTAGE" 436 "DFC_ComInvld_38Dh_VITESSE_VEHICULE_ROUES" 437 "DFC_ComInvld_38Dh_VVH_INDISP" 438 "DFC_ComInvld_427h_INV_COOLANT_TEMP" 439 "DFC_ComInvld_427h_INV_MOTOR_TEMP" 440 "DFC_ComInvld_427h_INV_OP_MODE" 441 "DFC_ComInvld_427h_INV_PERMISIBLE_TORQUE" 442 "DFC_ComInvld_427h_INV_TEMP" 443 "DFC_ComInvld_432h_REVEIL_PRINCIPAL" 444 "DFC_ComInvld_435h_HVBAT_MAX_CELL_VOLT" 445 "DFC_ComInvld_435h_HVBAT_MAX_CELL_VOLT_NUM" 446 "DFC_ComInvld_435h_HVBAT_MAX_SENSOR_TEMP" 447 "DFC_ComInvld_435h_HVBAT_MIN_CELL_VOLT" 448 "DFC_ComInvld_435h_HVBAT_MIN_CELL_VOLT_NUM" 449 "DFC_ComInvld_442h_BCCM_BLOWER_RELAY_STS" 450 "DFC_ComInvld_453h_OBC_IN_CURRENT" 451 "DFC_ComInvld_453h_OBC_IN_VOLTAGE" 452 "DFC_ComInvld_453h_OBC_IP_POWER" 453 "DFC_ComInvld_455h_HVBAT_NOMINAL_VOLTAGE" 454 "DFC_ComInvld_463h_OBC_OUT_CURRENT" 455 "DFC_ComInvld_463h_OBC_OUT_VOLTAGE" 456 "DFC_ComInvld_463h_OBC_TEMPERATURE" 457 "DFC_ComInvld_473h_DCDC_Coolant_Temperature" 458 "DFC_ComInvld_473h_DCDC_TEMPERATURE" 459 "DFC_ComInvld_47Bh_eCOMP_BusBarCurrent" 460 "DFC_ComInvld_47Bh_eCOMP_BusBarVoltage" 461 "DFC_ComInvld_47Bh_eCOMP_CompressorSpeed" 462 "DFC_ComInvld_47Bh_eCOMP_IGBT_Temp" 463 "DFC_ComInvld_47Bh_eCOMP_PeakPhaCurrent" 464 "DFC_ComInvld_47Bh_eCOMP_Power_consumption" 465 "DFC_ComInvld_4F2h_STATUS_SOC" 466 "DFC_ComInvld_4F2h_TEMP_BATT_STATUS" 467 "DFC_ComInvld_4F2h_VALEUR_SOC_ETENDUE" 468 "DFC_ComInvld_535h_HV_BATT_TEMP_AVG" 471 "DFC_ComInvld_543h_HV_BATT_SOH_RES" 469 "DFC_ComInvld_543h_HVBAT_RESTBATTENERGY" 470 "DFC_ComInvld_543h_HVBAT_SOH" 472 "DFC_ComInvld_552h_CPT_TEMPOREL" 473 "DFC_ComInvld_552h_KILOMETRAGE" 474 "DFC_ComInvld_583h_HV_BATT_DISCONT_CSE_OPEN" 475 "DFC_ComInvld_592h_CALIBRE_IBATT" 476 "DFC_ComInvld_592h_IBATT_1" 477 "DFC_ComInvld_592h_IBATT_2" 478 "DFC_ComInvld_592h_IBATT_3" 479 "DFC_ComInvld_592h_TEMP_BATT" 480 "DFC_ComInvld_592h_U_BATT_BECB" 481 "DFC_ComInvld_595h_HVBAT_TIME_TO_CHRG_80" 482 "DFC_ComInvld_5B2h_TEMP_AIR_EXT" 483 "DFC_ComInvld_5B5h_HVBAT_THERMAL_RUNAWAY" 484 "DFC_ComInvld_635h_HVBAT_NEG_CONT_COUNT_SEG1" 485 "DFC_ComInvld_635h_HVBAT_NEG_CONT_COUNT_SEG3" 486 "DFC_ComInvld_635h_HVBAT_NEG_CONT_COUNT_SEG4" 487 "DFC_ComInvld_635h_HVBAT_PST_CONT_COUNT_SEG1" 488 "DFC_ComInvld_635h_HVBAT_PST_CONT_COUNT_SEG3" 489 "DFC_ComInvld_635h_HVBAT_PST_CONT_COUNT_SEG4" 490 "DFC_ComInvld_645h_HVBAT_PRECHRGE_CONT_COUNT_SEG1" 491 "DFC_ComInvld_645h_HVBAT_PRECHRGE_CONT_COUNT_SEG2" 492 "DFC_ComInvld_675h_HVBAT_REMAININGBATTCAPACITY" 714 "DFC_COMM_E_NET_START_IND_CHANNEL_0" 715 "DFC_COMM_E_NET_START_IND_CHANNEL_1" 716 "DFC_COMM_E_NET_START_IND_CHANNEL_2" 717 "DFC_COMM_E_NET_START_IND_CHANNEL_3" 718 "DFC_COMM_E_NET_START_IND_CHANNEL_4" 719 "DFC_COMM_E_NET_START_IND_CHANNEL_5" 83 "DFC_ComOBCFltLvl2" 84 "DFC_ComOBCFltLvl3" 85 "DFC_ComOBCFltLvl4" 86 "DFC_ComOBCFltLvl5" 87 "DFC_ComOBCFltLvlRes" 88 "DFC_ComPostOperationWkuReq" 89 "DFC_ComPreCondElecWkuReq" 90 "DFC_ComRemUnlckWkuReq" 91 "DFC_ComStpDlyHMIWkuReq" 685 "DFC_ComVCInval" 108 "DFC_CrashEveOcc" 592 "DFC_CtpCarrFrqPhysRngHi" 593 "DFC_CtpCarrFrqPhysRngLo" 594 "DFC_CtpCarrFrqSRCMax" 547 "DFC_CtpCarrFrqSRCMin" 765 "DFC_CtpCarrFrqTmpErr" 542 "DFC_CtPSwtActrOL" 543 "DFC_CtPSwtActrOvrTemp" 544 "DFC_CtPSwtActrSCB" 545 "DFC_CtPSwtActrSCG" 589 "DFC_CtPSwtDiagPhysRngHi" 590 "DFC_CtPSwtDiagPhysRngLo" 763 "DFC_CtPSwtDiagSRCMax" 546 "DFC_CtPSwtDiagSRCMin" 591 "DFC_CtPSwtDiagSRCOpn" 764 "DFC_CtPSwtDiagTmpErr" 595 "DFC_DcChrgrIntkT2PhysRngHi" 596 "DFC_DcChrgrIntkT2PhysRngLo" 766 "DFC_DcChrgrIntkT2SRCMax" 548 "DFC_DcChrgrIntkT2SRCMin" 597 "DFC_DcChrgrIntkT2SRCOpn" 767 "DFC_DcChrgrIntkT2TmpErr" 598 "DFC_DcChrgrIntkTPhysRngHi" 599 "DFC_DcChrgrIntkTPhysRngLo" 768 "DFC_DcChrgrIntkTSRCMax" 549 "DFC_DcChrgrIntkTSRCMin" 600 "DFC_DcChrgrIntkTSRCOpn" 769 "DFC_DcChrgrIntkTTmpErr" 109 "DFC_DcdcFwdModStuck" 110 "DFC_DcdcLvUDifMaxFlt" 111 "DFC_DcdcOffModStuck" 112 "DFC_DcdcOperModFailr" 113 "DFC_DcdcPrecModStuck" 550 "DFC_DevLibBattUHi" 551 "DFC_DevLibBattULo" 114 "DFC_DrvDoorOpn" 115 "DFC_DrvModPosnDfct" 116 "DFC_DrvStbltOpn" 119 "DFC_EbsLvBattSocDiagLo" 120 "DFC_EbsLvBattUDiagDiOper" 121 "DFC_EbsLvBattUDiagFltLvl1" 122 "DFC_EbsLvBattUDiagFltLvl2" 123 "DFC_EbsLvBattUDiagLo" 124 "DFC_EbsSnsrSt" 125 "DFC_EbsSofASILErr" 770 "DFC_EChrDvPlinCntrThdExcdd" 686 "DFC_EemDcdcPrecSpdInhb" 771 "DFC_EemDiagCtctrClsTout" 772 "DFC_EemDiagDcdcOffTOut" 774 "DFC_EemDiagHvbOffTOut" 773 "DFC_EemDiagHvCnsrOffTOut" 653 "DFC_ElMActvDchaFailr" 654 "DFC_ElMActvDchaFlt" 655 "DFC_ElMFbdnIvtrModDrv01" 656 "DFC_ElMImobAuthent" 657 "DFC_ElMIsoMonFlt" 658 "DFC_ElMIsoMonPlausyFlt" 659 "DFC_ElMIvtrCooltT01" 660 "DFC_ElMIvtrEmgyShtDwn01" 661 "DFC_ElMIvtrFailr01" 662 "DFC_ElMIvtrIntlck01" 663 "DFC_ElMIvtrTErr01" 664 "DFC_ElMOverSpdNeg01" 665 "DFC_ElMOverSpdPos01" 666 "DFC_ElMOverTqNeg01" 667 "DFC_ElMOverTqPos01" 668 "DFC_ElMPwrAuthn" 669 "DFC_ElMSpdErr01" 670 "DFC_ElMSvs01" 126 "DFC_ElTSPtSysLimDrvErr" 127 "DFC_ElTSPtSysLimRgnErr" 552 "DFC_EmWakeupSigOL" 553 "DFC_EmWakeupSigOvrTemp" 554 "DFC_EmWakeupSigSCB" 555 "DFC_EmWakeupSigSCG" 117 "DFC_ETogFailrLvl3" 118 "DFC_ETogFailrLvl4" 178 "DFC_eTogFailrLvlRes" 687 "DFC_ExpPwrLatch" 556 "DFC_Fan1OL" 557 "DFC_Fan1OvrTemp" 558 "DFC_Fan1SCB" 601 "DFC_Fan1SCG" 688 "DFC_FanMaxOvrd" 559 "DFC_FanRlySCB" 560 "DFC_FanRlySCG" 602 "DFC_FanSpdPhysRngHi" 603 "DFC_FanSpdPhysRngLo" 775 "DFC_FanSpdSRCMax" 561 "DFC_FanSpdSRCMin" 604 "DFC_FanSpdSRCOpn" 776 "DFC_FanSpdTmpErr" 179 "DFC_flgBrkMaiDiag" 605 "DFC_FreonPPhysRngHi" 606 "DFC_FreonPPhysRngLo" 777 "DFC_FreonPSRCMax" 562 "DFC_FreonPSRCMin" 607 "DFC_FreonPSRCOpn" 778 "DFC_FreonPTmpErr" 608 "DFC_HeatrCoreTPhysRngHi" 609 "DFC_HeatrCoreTPhysRngLo" 779 "DFC_HeatrCoreTSRCMax" 564 "DFC_HeatrCoreTSRCMin" 610 "DFC_HeatrCoreTSRCOpn" 780 "DFC_HeatrCoreTTmpErr" 128 "DFC_HLCCcsFwDwnl" 689 "DFC_HLCCcsGnrlComErr" 563 "DFC_HLCCcsPLnCChipTHi" 782 "DFC_HvacBlwrFrntFlt" 783 "DFC_HvacEvapElecFlt" 784 "DFC_HvacEvapElecFltGnd" 785 "DFC_HvacKnobPosnFlt" 129 "DFC_HvBattChrgPwrMax" 130 "DFC_HvBattCrashDetd" 131 "DFC_HvBattDchaPwrMax" 132 "DFC_HvBattEmgyOff" 133 "DFC_HvBattEmgyOffIntlck" 134 "DFC_HvBattEmgyOffReq" 135 "DFC_HvBattFltMod" 138 "DFC_HvBattIninTout" 139 "DFC_HvBattIntlckSt" 136 "DFC_HvBattIReqToChrgrErr" 137 "DFC_HvBattIReqToChrgrIni" 140 "DFC_HvBattIsoFlt" 141 "DFC_HvBattLimdPwr" 142 "DFC_HvBattMaiSwtClsngFlt" 143 "DFC_HvBattMaiSwtFlt" 144 "DFC_HvBattMaiSwtOpen" 145 "DFC_HvBattMaiSwtOpngFlt" 146 "DFC_HvBattMaiSwtWldd" 147 "DFC_HvBattNegCntctrCntErr" 148 "DFC_HvBattOperModChrgPlausy" 149 "DFC_HvBattOverTDern" 150 "DFC_HvBattPosCntctrCntErr" 151 "DFC_HvBattPrecCntctrCntErr" 152 "DFC_HvBattPwrDistbnTDern" 153 "DFC_HvBattPwrDistbnTInhbn" 154 "DFC_HvBattRatRSohErr" 155 "DFC_HvBattRatSohErr" 156 "DFC_HvBattSngIsoWarn" 157 "DFC_HvBattSrvPlgDiscnct" 160 "DFC_HvBattUnderTDern" 158 "DFC_HvBattUNomChrgnErr" 159 "DFC_HvBattUNomChrgnIni" 161 "DFC_HvbEVLmpBlink" 162 "DFC_HvbEVLmpCont" 163 "DFC_HvbSVSBlink" 164 "DFC_HvbSVSCont" 781 "DFC_HvGridSocMinLim" 611 "DFC_HvGridUMaxSftyLim" 612 "DFC_HvGridUMinSftyLim" 613 "DFC_HvGridUPlausy" 165 "DFC_InmLINBusBlk" 690 "DFC_InmLINNodeHVACPanelAbsnt" 614 "DFC_IntlckChrgPlgHBrgOpnLd" 615 "DFC_IntlckChrgPlgHBrgOvrCurr" 616 "DFC_IntlckChrgPlgHBrgOvrTemp" 617 "DFC_IntlckChrgPlgHBrgShCirBatt1" 618 "DFC_IntlckChrgPlgHBrgShCirBatt2" 619 "DFC_IntlckChrgPlgHBrgShCirGnd1" 620 "DFC_IntlckChrgPlgHBrgShCirGnd2" 621 "DFC_IntlckChrgPlgHBrgShCirOvrLd" 622 "DFC_IntlckChrgPlgHBrgTempOvrCurr" 623 "DFC_IntlckChrgPlgHBrgUndrVltg" 624 "DFC_IntlckChrgPlgPosnRngFlt" 625 "DFC_IntlckChrgPlgPosnSrcMax" 626 "DFC_IntlckChrgPlgPosnSrcMin" 786 "DFC_InvBinID" 787 "DFC_InvCalID" 788 "DFC_InvErotan" 789 "DFC_InvVinID" 720 "DFC_LIN_E_TIMEOUT" 884 "DFC_MoCADCNTPBnk1" 885 "DFC_MoCADCTestVoltBnk1" 886 "DFC_MoCSOPICO" 887 "DFC_MoFAccr" 888 "DFC_MoFCbnPreCdngOvrheat" 889 "DFC_MoFCbnPreCdngTmrExpi" 890 "DFC_MoFEvMngtBms" 891 "DFC_MoFEvMngtDcdc" 892 "DFC_MoFEvMngtEm01" 893 "DFC_MoFEvMngtEm01BrkgToZr" 894 "DFC_MoFEvMngtEm01EngSpd" 895 "DFC_MoFEvMngtEm02EngSpd" 896 "DFC_MoFEvMngtEm02Lvl1" 897 "DFC_MoFEvMngtEm02Lvl2" 898 "DFC_MoFExtCptAuxCpt" 899 "DFC_MoFExtCptVacPmpErr" 900 "DFC_MoFTqPtdAxle" 901 "DFC_MoFTqPtdAxleSec" 902 "DFC_MoFTqPtdEmPtRels" 903 "DFC_MoFTqPtdEmPtRelsSec" 904 "DFC_MoFTqPtdEmSign" 905 "DFC_MoFTqPtdEmSignSec" 906 "DFC_MoFTqPtdEmTq" 907 "DFC_MoFTqPtdEmTqSec" 908 "DFC_MoFTqPtdVeh" 909 "DFC_MoFVarPostBldSel" 917 "DFC_MonEgyChrgnCoorr_AcChrgnWoMofRels" 918 "DFC_MonEgyChrgnCoorr_ChrgnAbortIgr" 919 "DFC_MonEgyChrgnCoorr_DcCntctFailr" 920 "DFC_MonEgyChrgnCoorr_ExtChrgnShtOffReq" 921 "DFC_MonEgyChrgnCoorr_ImpsChrgnMod" 922 "DFC_MonEgyChrgnCoorr_ImpsChrgnPrms" 923 "DFC_MonEgyChrgnCoorr_ImpsUDcIntk" 924 "DFC_MonEgyChrgnCoorr_PlgLockMovmt" 925 "DFC_MonEgyChrgnCoorr_VehCrashDetn" 926 "DFC_MonEgyChrgnErrReactn_SftySwt" 927 "DFC_MonEgyChrgnInlet_CcsPlgCtp" 928 "DFC_MonEgyChrgnInlet_CcsPlgCtpPwm" 929 "DFC_MonEgyChrgnInlet_CcsPlgLockCtrlImpsAtmpt" 930 "DFC_MonEgyChrgnInlet_CcsPlgLockSnsrSigRngChk" 931 "DFC_MonEgyChrgnInlet_CcsPlgLockStImps" 932 "DFC_MonEgyChrgnInlet_CcsPlgPxp" 933 "DFC_MonEgyChrgnT_Snsr1GrdtChk" 934 "DFC_MonEgyChrgnT_Snsr1SigRngChk" 935 "DFC_MonEgyChrgnT_Snsr2GrdtChk" 936 "DFC_MonEgyChrgnT_Snsr2SigRngChk" 937 "DFC_MonEgyChrgnT_SnsrDif" 910 "DFC_MoSysCtrlReIni" 790 "DFC_MOXEMM_SMU_ALM0_0" 791 "DFC_MOXEMM_SMU_ALM0_1" 792 "DFC_MOXEMM_SMU_ALM0_10" 793 "DFC_MOXEMM_SMU_ALM0_11" 794 "DFC_MOXEMM_SMU_ALM0_13" 795 "DFC_MOXEMM_SMU_ALM0_14" 796 "DFC_MOXEMM_SMU_ALM0_2" 797 "DFC_MOXEMM_SMU_ALM0_22" 798 "DFC_MOXEMM_SMU_ALM0_23" 799 "DFC_MOXEMM_SMU_ALM0_4" 800 "DFC_MOXEMM_SMU_ALM0_5" 801 "DFC_MOXEMM_SMU_ALM0_7" 802 "DFC_MOXEMM_SMU_ALM0_8" 803 "DFC_MOXEMM_SMU_ALM10_16" 804 "DFC_MOXEMM_SMU_ALM10_17" 805 "DFC_MOXEMM_SMU_ALM10_21" 806 "DFC_MOXEMM_SMU_ALM11_0" 807 "DFC_MOXEMM_SMU_ALM11_1" 808 "DFC_MOXEMM_SMU_ALM11_2" 809 "DFC_MOXEMM_SMU_ALM11_3" 810 "DFC_MOXEMM_SMU_ALM11_4" 811 "DFC_MOXEMM_SMU_ALM11_5" 812 "DFC_MOXEMM_SMU_ALM11_8" 813 "DFC_MOXEMM_SMU_ALM11_9" 814 "DFC_MOXEMM_SMU_ALM1_0" 815 "DFC_MOXEMM_SMU_ALM1_1" 816 "DFC_MOXEMM_SMU_ALM1_10" 817 "DFC_MOXEMM_SMU_ALM1_11" 818 "DFC_MOXEMM_SMU_ALM1_13" 819 "DFC_MOXEMM_SMU_ALM1_14" 820 "DFC_MOXEMM_SMU_ALM1_2" 821 "DFC_MOXEMM_SMU_ALM1_22" 822 "DFC_MOXEMM_SMU_ALM1_23" 823 "DFC_MOXEMM_SMU_ALM1_4" 824 "DFC_MOXEMM_SMU_ALM1_5" 825 "DFC_MOXEMM_SMU_ALM1_7" 826 "DFC_MOXEMM_SMU_ALM1_8" 827 "DFC_MOXEMM_SMU_ALM21_0" 828 "DFC_MOXEMM_SMU_ALM21_16" 829 "DFC_MOXEMM_SMU_ALM21_3" 830 "DFC_MOXEMM_SMU_ALM2_1" 831 "DFC_MOXEMM_SMU_ALM2_10" 832 "DFC_MOXEMM_SMU_ALM2_11" 833 "DFC_MOXEMM_SMU_ALM2_13" 834 "DFC_MOXEMM_SMU_ALM2_14" 835 "DFC_MOXEMM_SMU_ALM2_22" 836 "DFC_MOXEMM_SMU_ALM2_23" 837 "DFC_MOXEMM_SMU_ALM2_4" 838 "DFC_MOXEMM_SMU_ALM2_5" 839 "DFC_MOXEMM_SMU_ALM2_7" 840 "DFC_MOXEMM_SMU_ALM2_8" 841 "DFC_MOXEMM_SMU_ALM6_0" 842 "DFC_MOXEMM_SMU_ALM6_11" 843 "DFC_MOXEMM_SMU_ALM6_12" 844 "DFC_MOXEMM_SMU_ALM6_14" 845 "DFC_MOXEMM_SMU_ALM6_15" 846 "DFC_MOXEMM_SMU_ALM6_17" 847 "DFC_MOXEMM_SMU_ALM6_18" 848 "DFC_MOXEMM_SMU_ALM6_20" 849 "DFC_MOXEMM_SMU_ALM6_21" 850 "DFC_MOXEMM_SMU_ALM6_25" 851 "DFC_MOXEMM_SMU_ALM6_4" 852 "DFC_MOXEMM_SMU_ALM6_5" 853 "DFC_MOXEMM_SMU_ALM6_7" 854 "DFC_MOXEMM_SMU_ALM6_8" 855 "DFC_MOXEMM_SMU_ALM7_1" 856 "DFC_MOXEMM_SMU_ALM7_12" 857 "DFC_MOXEMM_SMU_ALM7_13" 858 "DFC_MOXEMM_SMU_ALM7_14" 859 "DFC_MOXEMM_SMU_ALM7_15" 860 "DFC_MOXEMM_SMU_ALM7_16" 861 "DFC_MOXEMM_SMU_ALM7_17" 862 "DFC_MOXEMM_SMU_ALM7_2" 863 "DFC_MOXEMM_SMU_ALM7_20" 864 "DFC_MOXEMM_SMU_ALM7_25" 865 "DFC_MOXEMM_SMU_ALM7_26" 866 "DFC_MOXEMM_SMU_ALM7_28" 867 "DFC_MOXEMM_SMU_ALM7_29" 868 "DFC_MOXEMM_SMU_ALM7_30" 869 "DFC_MOXEMM_SMU_ALM7_31" 870 "DFC_MOXEMM_SMU_ALM8_0" 871 "DFC_MOXEMM_SMU_ALM8_1" 872 "DFC_MOXEMM_SMU_ALM8_10" 873 "DFC_MOXEMM_SMU_ALM8_11" 874 "DFC_MOXEMM_SMU_ALM8_12" 875 "DFC_MOXEMM_SMU_ALM8_16" 876 "DFC_MOXEMM_SMU_ALM8_18" 877 "DFC_MOXEMM_SMU_ALM8_2" 878 "DFC_MOXEMM_SMU_ALM8_3" 879 "DFC_MOXEMM_SMU_ALM8_31" 880 "DFC_MOXEMM_SMU_ALM8_4" 881 "DFC_MOXEMM_SMU_ALM9_0" 882 "DFC_MOXEMM_SMU_ALM9_15" 883 "DFC_MOXEMM_SMU_ALM9_3" 911 "DFC_MoXEMMHwLTMCUFW" 912 "DFC_MoXEMMHwLTMonBIST" 913 "DFC_MoXEMMHwLTRegMonTest" 914 "DFC_MoXEMMHwLTStbySMUAlvTest" 915 "DFC_MoXEMMHwLTTempSens" 916 "DFC_MoXEMMHwLTUCBCfg" 693 "DFC_MRlyOL" 694 "DFC_MRlySCB" 695 "DFC_MRlySCG" 938 "DFC_OCWDAABEActv" 939 "DFC_OCWDACom" 940 "DFC_OCWDAErrPin" 941 "DFC_OCWDAOvrVltg" 166 "DFC_PDUProgmFailr" 671 "DFC_PEnvCcMax" 672 "DFC_PEnvCcMin" 673 "DFC_PEnvRngChkMax" 674 "DFC_PEnvRngChkMin" 167 "DFC_PEnvSigRngMax" 168 "DFC_PEnvSigRngMin" 675 "DFC_PEnvSnsrPlaus" 169 "DFC_PLnCChpDeactvnFaild" 170 "DFC_PrkgBrkFailr" 171 "DFC_PtSysLimErr" 942 "DFC_PUmax" 627 "DFC_PwmCtPPhysRngHi" 628 "DFC_PwmCtPPhysRngLo" 629 "DFC_PwmCtPSRCMax" 565 "DFC_PwmCtPSRCMin" 943 "DFC_PwmCtPTmpErr" 630 "DFC_PwrDistbnUnitTPhysRngHi" 631 "DFC_PwrDistbnUnitTPhysRngLo" 944 "DFC_PwrDistbnUnitTSRCMax" 566 "DFC_PwrDistbnUnitTSRCMin" 632 "DFC_PwrDistbnUnitTSRCOpn" 945 "DFC_PwrDistbnUnitTTmpErr" 172 "DFC_PwrMaxDchaShoLo" 721 "DFC_rba_EcuCtrl_TOMaxProlg" 722 "DFC_rba_EcuCtrl_TOMaxShutDwn" 727 "DFC_RBA_IOEXTLIB_KEEPALIVE_DRV" 728 "DFC_RBA_IOEXTLIB_KEEPALIVE_INI" 729 "DFC_rba_IoSigRtc_StopCounter" 731 "DFC_rba_MemDiag_MemReadErr" 732 "DFC_rba_MemDiag_MemWrErr" 730 "DFC_rba_MRly_Diag_Stk_Event" 723 "DFC_rba_MultiStackTrace_Threshold" 724 "DFC_rba_SyC_CustStates_Degraded_disord_Event" 725 "DFC_rba_SyC_CustStates_Degraded_incst_Event" 726 "DFC_rba_SyC_CustStates_TransNoWakReq_Event" 733 "DFC_rba_SyC_IrrSwOffTrigEngRun_Event" 691 "DFC_ResetRcvNotAllwd" 645 "DFC_SCtPmp1DiagGrdKey1" 646 "DFC_SCtPmp1DiagGrdKey2" 647 "DFC_SCtPmp1DiagGrdKey3" 648 "DFC_SCtPmp1DiagGrdKey4" 649 "DFC_SCtPmp1DiagGrdKey5" 946 "DFC_SCtPmp1DiagGrdKeyErr" 173 "DFC_SCtPmp1FailSafeNotSuc" 567 "DFC_SCtPmp1OL" 568 "DFC_SCtPmp1OvrTemp" 569 "DFC_SCtPmp1SCB" 174 "DFC_SCtPmp1SCG" 570 "DFC_SCtPmpRlyOL" 571 "DFC_SCtPmpRlyOvrTemp" 572 "DFC_SCtPmpRlySCB" 633 "DFC_SCtPmpRlySCG" 954 "DFC_Sia_InvldCode" 955 "DFC_Sia_InvldKey" 956 "DFC_Sia_NoRespUCx" 957 "DFC_Sia_TprotRttp" 573 "DFC_SpplCooltPmpRlyOL" 574 "DFC_SpplCooltPmpRlyOvrTemp" 575 "DFC_SpplCooltPmpRlySCB" 634 "DFC_SpplCooltPmpRlySCG" 947 "DFC_SRCHighAPP1" 948 "DFC_SRCHighAPP2" 949 "DFC_SRCLowAPP1" 950 "DFC_SRCLowAPP2" 696 "DFC_SSpMon1" 697 "DFC_SSpMon1OV" 698 "DFC_SSpMon1SCG" 699 "DFC_SSpMon1UV" 700 "DFC_SSpMon2" 701 "DFC_SSpMon2OV" 702 "DFC_SSpMon2SCG" 703 "DFC_SSpMon2UV" 704 "DFC_SSpMon3" 705 "DFC_SSpMon3OV" 706 "DFC_SSpMon3SCG" 707 "DFC_SSpMon3UV" 180 "DFC_stHvbIsoMeasmtRes" 958 "DFC_StrtUpEvStandStillDeactvn" 951 "DFC_SWReset_0" 952 "DFC_SWReset_1" 953 "DFC_SWReset_2" 959 "DFC_SyncAPP" 692 "DFC_TelltlCooltPlaus" 635 "DFC_UCtPPhysRngHi" 636 "DFC_UCtPPhysRngLo" 960 "DFC_UCtPSRCMax" 576 "DFC_UCtPSRCMin" 637 "DFC_UCtPSRCOpn" 961 "DFC_UCtPTmpErr" 638 "DFC_UPxP1PhysRngHi" 639 "DFC_UPxP1PhysRngLo" 962 "DFC_UPxP1SRCMax" 577 "DFC_UPxP1SRCMin" 640 "DFC_UPxP1SRCOpn" 963 "DFC_UPxP1TmpErr" 175 "DFC_VehCoornDrvrNotPrsnt" 176 "DFC_VehVCanAvl" 177 "DFC_VehVCanErr" 964 "DFC_VehVObd" 641 "DFC_VehVPhysRngHi" 642 "DFC_VehVPhysRngLo" 643 "DFC_VehVSigCan" 644 "DFC_VehVSigCanSafe" DEFAULT_VALUE "---" /end COMPU_VTAB
/begin COMPU_METHOD DFES_Entry_Verb "" TAB_VERB "%6.3" "" COMPU_TAB_REF DFES_Entry_Verb /end COMPU_METHOD
/begin COMPU_VTAB DFES_Entry_Verb "" TAB_VERB 35 0 "Empty" 1 "Erased" 2 "Erased_PdtcClrd" 3 "Erased_PdtcClrdMinTrip" 4 "Erased_PdtcClrdOk" 5 "FrzFrm" 6 "FrzFrm_PdtcClrd" 7 "FrzFrm_PdtcClrdMinTrip" 8 "FrzFrm_PdtcClrdOk" 9 "Shadow" 10 "Shadow_PdtcClrd" 11 "Shadow_PdtcClrdMinTrip" 12 "Shadow_PdtcClrdOk" 13 "Service" 14 "Service_PdtcClrd" 15 "Service_PdtcClrdMinTrip" 16 "Service_PdtcClrdOk" 17 "Service_Shdw" 18 "Service_ShdwPdtcClrd" 19 "Service_ShdwPdtcClrdMinTrip" 20 "Service_ShdwPdtcClrdOk" 21 "Service_FrzFrm" 22 "Service_FrzFrmPdtcClrd" 23 "Service_FrzFrmPdtcClrdMinTrip" 24 "Service_FrzFrmPdtcClrdOk" 25 "Pending" 26 "Pending_PdtcClrd" 27 "Pending_PdtcClrdMinTrip" 28 "Pending_PdtcClrdOk" 29 "Confirmed" 30 "Confirmed_Pdtc" 31 "ConfirmedHealing" 32 "ConfirmedHealing_Pdtc" 33 "ConfirmedPending" 34 "ConfirmedAging" /end COMPU_VTAB
/begin COMPU_METHOD DFES_Mon_Verb "" TAB_VERB "%6.3" "-" COMPU_TAB_REF DFES_Mon_Verb /end COMPU_METHOD
/begin COMPU_VTAB DFES_Mon_Verb "" TAB_VERB 22 0 "-----" 257 "double entry" 1025 "LDF_Diff DFCst - ORD" 513 "Counter exceeds" 258 "MEM missing" 1032 "retry entry" 514 "DEL Counter Serv ex" 260 "MEM no Entry" 516 "DEL Counter Pend ex" 1026 "Deb ok missing" 520 "DEL Counter OBD ex" 1028 "Deb def missing" 2049 "EepQueOvfl" 2050 "EepIniFailed" 2051 "EepIniNoSucss" 4097 "Erased_prioHigh" 4098 "slow_scan" 8193 "miss diumpr Fid" 16385 "invalid DTR limit" 32770 "event lost due to rollback limit" 32785 "number active InhUdp negative" 32786 "non zero InhUpd counter used" /end COMPU_VTAB
/begin COMPU_METHOD DFES_OneToOne "" RAT_FUNC "%6.2" "-" COEFFS 0 1 0 0 0 1 /end COMPU_METHOD
/begin COMPU_METHOD DFES_stCheck_Verb "" TAB_VERB "%6.3" "-" COMPU_TAB_REF DFES_stCheck_Verb /end COMPU_METHOD
/begin COMPU_VTAB DFES_stCheck_Verb "" TAB_VERB 8 0 "OkNoTst" 1 "OkTested" 2 "OkHealed" 3 "OkRstNoTst" 4 "DefectNoTst" 5 "DefectDelay" 6 "Defect" 7 "DefectRstNoTst" /end COMPU_VTAB
/begin COMPU_METHOD DFES_stCnt_Verb "" TAB_VERB "%6.3" "-" COMPU_TAB_REF DFES_stCnt_Verb /end COMPU_METHOD
/begin COMPU_VTAB DFES_stCnt_Verb "" TAB_VERB 36 0 "SVS_NONE__MIL_NONE" 1 "SVS_NONE__MIL_HLC_TRG" 2 "SVS_NONE__MIL_HLC_ELAP" 3 "SVS_NONE__MIL_FLC_CNT" 4 "SVS_NONE__MIL_FLC_TIME" 5 "SVS_NONE__MIL_HLC_TIME" 16 "SVS_HLC_TRG__MIL_NONE" 17 "SVS_HLC_TRG__MIL_HLC_TRG" 18 "SVS_HLC_TRG__MIL_HLC_ELAP" 19 "SVS_HLC_TRG__MIL_FLC_CNT" 20 "SVS_HLC_TRG__MIL_FLC_TIME" 21 "SVS_HLC_TRG__MIL_HLC_TIME" 32 "SVS_HLC_ELAP__MIL_NONE" 33 "SVS_HLC_ELAP__MIL_HLC_TRG" 34 "SVS_HLC_ELAP__MIL_HLC_ELAP" 35 "SVS_HLC_ELAP__MIL_FLC_CNT" 36 "SVS_HLC_ELAP__MIL_FLC_TIME" 37 "SVS_HLC_ELAP__MIL_HLC_TIME" 48 "SVS_FLC_CNT__MIL_NONE" 49 "SVS_FLC_CNT__MIL_HLC_TRG" 50 "SVS_FLC_CNT__MIL_HLC_ELAP" 51 "SVS_FLC_CNT__MIL_FLC_CNT" 52 "SVS_FLC_CNT__MIL_FLC_TIME" 53 "SVS_FLC_CNT__MIL_HLC_TIME" 64 "SVS_FLC_TIME__MIL_NONE" 65 "SVS_FLC_TIME__MIL_HLC_TRG" 66 "SVS_FLC_TIME__MIL_HLC_ELAP" 67 "SVS_FLC_TIME__MIL_FLC_CNT" 68 "SVS_FLC_TIME__MIL_FLC_TIME" 69 "SVS_FLC_TIME__MIL_HLC_TIME" 80 "SVS_HLC_TIME__MIL_NONE" 81 "SVS_HLC_TIME__MIL_HLC_TRG" 82 "SVS_HLC_TIME__MIL_HLC_ELAP" 83 "SVS_HLC_TIME__MIL_FLC_CNT" 84 "SVS_HLC_TIME__MIL_FLC_TIME" 85 "SVS_HLC_TIME__MIL_HLC_TIME" /end COMPU_VTAB
/begin COMPU_METHOD DFES_stDataImdt_Verb "" TAB_VERB "%6.3" "" COMPU_TAB_REF DFES_stDataImdt_Verb /end COMPU_METHOD
/begin COMPU_VTAB DFES_stDataImdt_Verb "" TAB_VERB 22 0 "ERASED" 1 "ERASED_ACTSEQ_FRZ_ENV" 2 "FRZONLY" 3 "FRZONLY_ACTSEQ_FRZ_ENV" 4 "SHADOW" 5 "SHADOW_ACTSEQ_FRZ_ENV" 12 "OKENTRY" 13 "OKENTRY_ACTSEQ_LCK" 14 "OKENTRY_ACTSEQ_LCK_ENV_LCK" 15 "OKENTRY_ACTSEQ_FRZ_ENV_LCK" 16 "OKENTRY_ACTSEQ_ENV_LCK" 17 "ERROR" 18 "ERROR_ACTSEQ_LCK" 19 "ERROR_ACTSEQ_LCK_ENV_LCK" 20 "ERROR_ACTSEQ_FRZ_ENV_LCK" 21 "ERROR_ACTSEQ_ENV_LCK" 6 "SHADOWFRZ" 7 "SHADOWFRZ_ACTSEQ_FRZ_ENV" 8 "SHADOWOK" 9 "SHADOWOK_ACTSEQ_FRZ_ENV" 10 "SHADOWOKFRZ" 11 "SHADOWOKFRZ_ACTSEQ_FRZ_ENV" /end COMPU_VTAB
/begin COMPU_METHOD DFES_stEntry_Verb "" TAB_VERB "%6.3" "-" COMPU_TAB_REF DFES_stEntry_Verb /end COMPU_METHOD
/begin COMPU_VTAB DFES_stEntry_Verb "" TAB_VERB 240 0 "NoEntry" 1 "Erased" 2 "PrivateTemporary" 3 "SVSOff_FreezeFrameOnly" 4 "SVSOff_DelayActiveDefect" 5 "SVSOff_ServiceNoDefect" 6 "SVSOff_ServiceDefect" 7 "SVSOff_ServiceHistoryDefect" 8 "SVSOff_ServiceHistoryNoDefect" 9 "SVSOff_DelayActiveNoDefect" 10 "SVSOff_PendingDefect" 11 "SVSOff_DebouncedDefect" 12 "SVSOff_HistoryPendingDefect" 13 "SVSOff_HealingNoDefect" 14 "SVSOff_HistoryNoDefect" 16 "DelD_NoEntry" 17 "DelD_Erased" 18 "DelD_PrivateTemporary" 19 "SVSOff_DelD_FreezeFrameOnly" 20 "SVSOff_DelD_DelayActiveDefect" 21 "SVSOff_DelD_ServiceNoDefect" 22 "SVSOff_DelD_ServiceDefect" 23 "SVSOff_DelD_ServiceHistoryDefect" 24 "SVSOff_DelD_ServiceHistoryNoDefect" 25 "SVSOff_DelD_DelayActiveNoDefect" 26 "SVSOff_DelD_PendingDefect" 27 "SVSOff_DelD_DebouncedDefect" 28 "SVSOff_DelD_HistoryPendingDefect" 29 "SVSOff_DelD_HealingNoDefect" 30 "SVSOff_DelD_HistoryNoDefect" 32 "P_NoEntry" 33 "P_Erased" 34 "P_PrivateTemporary" 35 "SVSOff_P_FreezeFrameOnly" 36 "SVSOff_P_DelayActiveDefect" 37 "SVSOff_P_ServiceNoDefect" 38 "SVSOff_P_ServiceDefect" 39 "SVSOff_P_ServiceHistoryDefect" 40 "SVSOff_P_ServiceHistoryNoDefect" 41 "SVSOff_P_DelayActiveNoDefect" 42 "SVSOff_P_PendingDefect" 43 "SVSOff_P_DebouncedDefect" 44 "SVSOff_P_HistoryPendingDefect" 45 "SVSOff_P_HealingNoDefect" 46 "SVSOff_P_HistoryNoDefect" 48 "P_DelD_NoEntry" 49 "P_DelD_Erased" 50 "P_DelD_PrivateTemporary" 51 "SVSOff_P_DelD_FreezeFrameOnly" 52 "SVSOff_P_DelD_DelayActiveDefect" 53 "SVSOff_P_DelD_ServiceNoDefect" 54 "SVSOff_P_DelD_ServiceDefect" 55 "SVSOff_P_DelD_ServiceHistoryDefect" 56 "SVSOff_P_DelD_ServiceHistoryNoDefect" 57 "SVSOff_P_DelD_DelayActiveNoDefect" 58 "SVSOff_P_DelD_PendingDefect" 59 "SVSOff_P_DelD_DebouncedDefect" 60 "SVSOff_P_DelD_HistoryPendingDefect" 61 "SVSOff_P_DelD_HealingNoDefect" 62 "SVSOff_P_DelD_HistoryNoDefect" 64 "PS_NoEntry" 65 "PS_Erased" 66 "PS_PrivateTemporary" 67 "SVSOff_PS_FreezeFrameOnly" 68 "SVSOff_PS_DelayActiveDefect" 69 "SVSOff_PS_ServiceNoDefect" 70 "SVSOff_PS_ServiceDefect" 71 "SVSOff_PS_ServiceHistoryDefect" 72 "SVSOff_PS_ServiceHistoryNoDefect" 73 "SVSOff_PS_DelayActiveNoDefect" 74 "SVSOff_PS_PendingDefect" 75 "SVSOff_PS_DebouncedDefect" 76 "SVSOff_PS_HistoryPendingDefect" 77 "SVSOff_PS_HealingNoDefect" 78 "SVSOff_PS_HistoryNoDefect" 80 "PS_DelD_NoEntry" 81 "PS_DelD_Erased" 82 "PS_DelD_PrivateTemporary" 83 "SVSOff_PS_DelD_FreezeFrameOnly" 84 "SVSOff_PS_DelD_DelayActiveDefect" 85 "SVSOff_PS_DelD_ServiceNoDefect" 86 "SVSOff_PS_DelD_ServiceDefect" 87 "SVSOff_PS_DelD_ServiceHistoryDefect" 88 "SVSOff_PS_DelD_ServiceHistoryNoDefect" 89 "SVSOff_PS_DelD_DelayActiveNoDefect" 90 "SVSOff_PS_DelD_PendingDefect" 91 "SVSOff_PS_DelD_DebouncedDefect" 92 "SVSOff_PS_DelD_HistoryPendingDefect" 93 "SVSOff_PS_DelD_HealingNoDefect" 94 "SVSOff_PS_DelD_HistoryNoDefect" 96 "PS_P_NoEntry" 97 "PS_P_Erased" 98 "PS_P_PrivateTemporary" 99 "SVSOff_PS_P_FreezeFrameOnly" 100 "SVSOff_PS_P_DelayActiveDefect" 101 "SVSOff_PS_P_ServiceNoDefect" 102 "SVSOff_PS_P_ServiceDefect" 103 "SVSOff_PS_P_ServiceHistoryDefect" 104 "SVSOff_PS_P_ServiceHistoryNoDefect" 105 "SVSOff_PS_P_DelayActiveNoDefect" 106 "SVSOff_PS_P_PendingDefect" 107 "SVSOff_PS_P_DebouncedDefect" 108 "SVSOff_PS_P_HistoryPendingDefect" 109 "SVSOff_PS_P_HealingNoDefect" 110 "SVSOff_PS_P_HistoryNoDefect" 112 "PS_P_DelD_NoEntry" 113 "PS_P_DelD_Erased" 114 "PS_P_DelD_PrivateTemporary" 115 "SVSOff_PS_P_DelD_FreezeFrameOnly" 116 "SVSOff_PS_P_DelD_DelayActiveDefect" 117 "SVSOff_PS_P_DelD_ServiceNoDefect" 118 "SVSOff_PS_P_DelD_ServiceDefect" 119 "SVSOff_PS_P_DelD_ServiceHistoryDefect" 120 "SVSOff_PS_P_DelD_ServiceHistoryNoDefect" 121 "SVSOff_PS_P_DelD_DelayActiveNoDefect" 122 "SVSOff_PS_P_DelD_PendingDefect" 123 "SVSOff_PS_P_DelD_DebouncedDefect" 124 "SVSOff_PS_P_DelD_HistoryPendingDefect" 125 "SVSOff_PS_P_DelD_HealingNoDefect" 126 "SVSOff_PS_P_DelD_HistoryNoDefect" 128 "SVSOn_NoEntry" 129 "SVSOn_Erased" 130 "SVSOn_PrivateTemporary" 131 "SVSOn_FreezeFrameOnly" 132 "SVSOn_DelayActiveDefect" 133 "SVSOn_ServiceNoDefect" 134 "SVSOn_ServiceDefect" 135 "SVSOn_ServiceHistoryDefect" 136 "SVSOn_ServiceHistoryNoDefect" 137 "SVSOn_DelayActiveNoDefect" 138 "SVSOn_PendingDefect" 139 "SVSOn_DebouncedDefect" 140 "SVSOn_HistoryPendingDefect" 141 "SVSOn_HealingNoDefect" 142 "SVSOn_HistoryNoDefect" 144 "SVSOn_DelD_NoEntry" 145 "SVSOn_DelD_Erased" 146 "SVSOn_DelD_PrivateTemporary" 147 "SVSOn_DelD_FreezeFrameOnly" 148 "SVSOn_DelD_DelayActiveDefect" 149 "SVSOn_DelD_ServiceNoDefect" 150 "SVSOn_DelD_ServiceDefect" 151 "SVSOn_DelD_ServiceHistoryDefect" 152 "SVSOn_DelD_ServiceHistoryNoDefect" 153 "SVSOn_DelD_DelayActiveNoDefect" 154 "SVSOn_DelD_PendingDefect" 155 "SVSOn_DelD_DebouncedDefect" 156 "SVSOn_DelD_HistoryPendingDefect" 157 "SVSOn_DelD_HealingNoDefect" 158 "SVSOn_DelD_HistoryNoDefect" 160 "SVSOn_P_NoEntry" 161 "SVSOn_P_Erased" 162 "SVSOn_P_PrivateTemporary" 163 "SVSOn_P_FreezeFrameOnly" 164 "SVSOn_P_DelayActiveDefect" 165 "SVSOn_P_ServiceNoDefect" 166 "SVSOn_P_ServiceDefect" 167 "SVSOn_P_ServiceHistoryDefect" 168 "SVSOn_P_ServiceHistoryNoDefect" 169 "SVSOn_P_DelayActiveNoDefect" 170 "SVSOn_P_PendingDefect" 171 "SVSOn_P_DebouncedDefect" 172 "SVSOn_P_HistoryPendingDefect" 173 "SVSOn_P_HealingNoDefect" 174 "SVSOn_P_HistoryNoDefect" 176 "SVSOn_P_DelD_NoEntry" 177 "SVSOn_P_DelD_Erased" 178 "SVSOn_P_DelD_PrivateTemporary" 179 "SVSOn_P_DelD_FreezeFrameOnly" 180 "SVSOn_P_DelD_DelayActiveDefect" 181 "SVSOn_P_DelD_ServiceNoDefect" 182 "SVSOn_P_DelD_ServiceDefect" 183 "SVSOn_P_DelD_ServiceHistoryDefect" 184 "SVSOn_P_DelD_ServiceHistoryNoDefect" 185 "SVSOn_P_DelD_DelayActiveNoDefect" 186 "SVSOn_P_DelD_PendingDefect" 187 "SVSOn_P_DelD_DebouncedDefect" 188 "SVSOn_P_DelD_HistoryPendingDefect" 189 "SVSOn_P_DelD_HealingNoDefect" 190 "SVSOn_P_DelD_HistoryNoDefect" 192 "SVSOn_PS_NoEntry" 193 "SVSOn_PS_Erased" 194 "SVSOn_PS_PrivateTemporary" 195 "SVSOn_PS_FreezeFrameOnly" 196 "SVSOn_PS_DelayActiveDefect" 197 "SVSOn_PS_ServiceNoDefect" 198 "SVSOn_PS_ServiceDefect" 199 "SVSOn_PS_ServiceHistoryDefect" 200 "SVSOn_PS_ServiceHistoryNoDefect" 201 "SVSOn_PS_DelayActiveNoDefect" 202 "SVSOn_PS_PendingDefect" 203 "SVSOn_PS_DebouncedDefect" 204 "SVSOn_PS_HistoryPendingDefect" 205 "SVSOn_PS_HealingNoDefect" 206 "SVSOn_PS_HistoryNoDefect" 208 "SVSOn_PS_DelD_NoEntry" 209 "SVSOn_PS_DelD_Erased" 210 "SVSOn_PS_DelD_PrivateTemporary" 211 "SVSOn_PS_DelD_FreezeFrameOnly" 212 "SVSOn_PS_DelD_DelayActiveDefect" 213 "SVSOn_PS_DelD_ServiceNoDefect" 214 "SVSOn_PS_DelD_ServiceDefect" 215 "SVSOn_PS_DelD_ServiceHistoryDefect" 216 "SVSOn_PS_DelD_ServiceHistoryNoDefect" 217 "SVSOn_PS_DelD_DelayActiveNoDefect" 218 "SVSOn_PS_DelD_PendingDefect" 219 "SVSOn_PS_DelD_DebouncedDefect" 220 "SVSOn_PS_DelD_HistoryPendingDefect" 221 "SVSOn_PS_DelD_HealingNoDefect" 222 "SVSOn_PS_DelD_HistoryNoDefect" 224 "SVSOn_PS_P_NoEntry" 225 "SVSOn_PS_P_Erased" 226 "SVSOn_PS_P_PrivateTemporary" 227 "SVSOn_PS_P_FreezeFrameOnly" 228 "SVSOn_PS_P_DelayActiveDefect" 229 "SVSOn_PS_P_ServiceNoDefect" 230 "SVSOn_PS_P_ServiceDefect" 231 "SVSOn_PS_P_ServiceHistoryDefect" 232 "SVSOn_PS_P_ServiceHistoryNoDefect" 233 "SVSOn_PS_P_DelayActiveNoDefect" 234 "SVSOn_PS_P_PendingDefect" 235 "SVSOn_PS_P_DebouncedDefect" 236 "SVSOn_PS_P_HistoryPendingDefect" 237 "SVSOn_PS_P_HealingNoDefect" 238 "SVSOn_PS_P_HistoryNoDefect" 240 "SVSOn_PS_P_DelD_NoEntry" 241 "SVSOn_PS_P_DelD_Erased" 242 "SVSOn_PS_P_DelD_PrivateTemporary" 243 "SVSOn_PS_P_DelD_FreezeFrameOnly" 244 "SVSOn_PS_P_DelD_DelayActiveDefect" 245 "SVSOn_PS_P_DelD_ServiceNoDefect" 246 "SVSOn_PS_P_DelD_ServiceDefect" 247 "SVSOn_PS_P_DelD_ServiceHistoryDefect" 248 "SVSOn_PS_P_DelD_ServiceHistoryNoDefect" 249 "SVSOn_PS_P_DelD_DelayActiveNoDefect" 250 "SVSOn_PS_P_DelD_PendingDefect" 251 "SVSOn_PS_P_DelD_DebouncedDefect" 252 "SVSOn_PS_P_DelD_HistoryPendingDefect" 253 "SVSOn_PS_P_DelD_HealingNoDefect" 254 "SVSOn_PS_P_DelD_HistoryNoDefect" /end COMPU_VTAB
/begin COMPU_METHOD ETCtlGovKp_fac "" RAT_FUNC "%7.6" "-" COEFFS 0 25600 0 0 0 1 /end COMPU_METHOD
/begin COMPU_METHOD OneToOne "" RAT_FUNC "%6.2" "-" COEFFS 0 1 0 0 0 1 /end COMPU_METHOD
/begin RECORD_LAYOUT Val_Wu16 FNC_VALUES 1 UWORD COLUMN_DIR DIRECT /end RECORD_LAYOUT
/begin RECORD_LAYOUT Val_Wu8 FNC_VALUES 1 UBYTE COLUMN_DIR DIRECT /end RECORD_LAYOUT
/end MODULE
/end PROJECT

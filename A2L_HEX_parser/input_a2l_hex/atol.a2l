ASAP2_VERSION 1 70
/begin PROJECT MDG1C "VC1CP091_STLA_N_D061I3"
/begin HEADER "" VERSION "VC1CP091_STLA_N_D061I3" PROJECT_NO MDG1C /end HEADER
/begin MODULE DIM ""
/begin MOD_COMMON "" BYTE_ORDER MSB_LAST ALIGNMENT_BYTE 1 ALIGNMENT_WORD 2 ALIGNMENT_LONG 4 ALIGNMENT_INT64 4 ALIGNMENT_FLOAT32_IEEE 4 ALIGNMENT_FLOAT64_IEEE 4 DATA_SIZE 32 /end MOD_COMMON
/begin CHARACTERISTIC DFES_DTCO.DFC_VehVCanAvl_C "" VALUE 0x8024D402 Val_Wu16 65535.00 DFES_OneToOne 0.00 65535.00 FORMAT "%8.2" /end CHARACTERISTIC
/begin CHARACTERISTIC DFES_DTCO.DFC_VehVCanErr_C "" VALUE 0x8024D404 Val_Wu16 65535.00 DFES_OneToOne 0.00 65535.00 FORMAT "%8.2" /end CHARACTERISTIC
/begin CHARACTERISTIC DFES_DTCO.DFC_eTogFailrLvlRes_C "" VALUE 0x8024D406 Val_Wu16 65535.00 DFES_OneToOne 0.00 65535.00 FORMAT "%8.2" /end CHARACTERISTIC
/begin CHARACTERISTIC DFES_DTCO.DFC_flgBrkMaiDiag_C "" VALUE 0x8024D408 Val_Wu16 65535.00 DFES_OneToOne 0.00 65535.00 FORMAT "%8.2" /end CHARACTERISTIC
/begin CHARACTERISTIC DFES_DTCO.DFC_stHvbIsoMeasmtRes_C "" VALUE 0x8024D40A Val_Wu16 65535.00 DFES_OneToOne 0.00 65535.00 FORMAT "%8.2" /end CHARACTERISTIC
/begin CHARACTERISTIC DFES_DTCO.DFC_BrkBstPmpPLeakDfct_C "" VALUE 0x8024D40C Val_Wu16 65535.00 DFES_OneToOne 0.00 65535.00 FORMAT "%8.2" /end CHARACTERISTIC
/begin CHARACTERISTIC DFES_DTCO.DFC_Com082hTooShort_C "" VALUE 0x8024D40E Val_Wu16 65535.00 DFES_OneToOne 0.00 65535.00 FORMAT "%8.2" /end CHARACTERISTIC
/begin CHARACTERISTIC DFES_DTCO.DFC_Com092hTooShort_C "" VALUE 0x8024D410 Val_Wu16 65535.00 DFES_OneToOne 0.00 65535.00 FORMAT "%8.2" /end CHARACTERISTIC
/begin CHARACTERISTIC DFES_DTCO.DFC_Com205hAbsent_C "" VALUE 0x8024D412 Val_Wu16 65535.00 DFES_OneToOne 0.00 65535.00 FORMAT "%8.2" /end CHARACTERISTIC
/begin CHARACTERISTIC DFES_DTCO.DFC_Com205hChecksum_C "" VALUE 0x8024D414 Val_Wu16 65535.00 DFES_OneToOne 0.00 65535.00 FORMAT "%8.2" /end CHARACTERISTIC
/begin CHARACTERISTIC DFES_DTCO.DFC_Com205hCounter_C "" VALUE 0x8024D416 Val_Wu16 65535.00 DFES_OneToOne 0.00 65535.00 FORMAT "%8.2" /end CHARACTERISTIC
/begin CHARACTERISTIC DFES_DTCO.DFC_Com205hTooShort_C "" VALUE 0x8024D418 Val_Wu16 65535.00 DFES_OneToOne 0.00 65535.00 FORMAT "%8.2" /end CHARACTERISTIC
/begin CHARACTERISTIC DFES_DTCO.DFC_Com217hAbsent_C "" VALUE 0x8024D41A Val_Wu16 65535.00 DFES_OneToOne 0.00 65535.00 FORMAT "%8.2" /end CHARACTERISTIC
/begin CHARACTERISTIC DFES_DTCO.DFC_Com217hChecksum_C "" VALUE 0x8024D41C Val_Wu16 65535.00 DFES_OneToOne 0.00 65535.00 FORMAT "%8.2" /end CHARACTERISTIC
/begin CHARACTERISTIC DFES_DTCO.DFC_Com217hCounter_C "" VALUE 0x8024D41E Val_Wu16 65535.00 DFES_OneToOne 0.00 65535.00 FORMAT "%8.2" /end CHARACTERISTIC
/begin CHARACTERISTIC DFES_DTCO.DFC_Com217hTooShort_C "" VALUE 0x8024D420 Val_Wu16 65535.00 DFES_OneToOne 0.00 65535.00 FORMAT "%8.2" /end CHARACTERISTIC
/begin CHARACTERISTIC DFES_DTCO.DFC_Com227hAbsent_C "" VALUE 0x8024D422 Val_Wu16 65535.00 DFES_OneToOne 0.00 65535.00 FORMAT "%8.2" /end CHARACTERISTIC
/begin CHARACTERISTIC DFES_DTCO.DFC_Com227hTooShort_C "" VALUE 0x8024D424 Val_Wu16 65535.00 DFES_OneToOne 0.00 65535.00 FORMAT "%8.2" /end CHARACTERISTIC
/begin CHARACTERISTIC DFES_DTCO.DFC_Com237hAbsent_C "" VALUE 0x8024D426 Val_Wu16 65535.00 DFES_OneToOne 0.00 65535.00 FORMAT "%8.2" /end CHARACTERISTIC
/begin CHARACTERISTIC DFES_DTCO.DFC_Com237hChecksum_C "" VALUE 0x8024D428 Val_Wu16 65535.00 DFES_OneToOne 0.00 65535.00 FORMAT "%8.2" /end CHARACTERISTIC
/begin CHARACTERISTIC DFES_DTCO.DFC_Com237hCounter_C "" VALUE 0x8024D42A Val_Wu16 65535.00 DFES_OneToOne 0.00 65535.00 FORMAT "%8.2" /end CHARACTERISTIC
/begin CHARACTERISTIC DFES_DTCO.DFC_Com237hTooShort_C "" VALUE 0x8024D42C Val_Wu16 65535.00 DFES_OneToOne 0.00 65535.00 FORMAT "%8.2" /end CHARACTERISTIC
/begin CHARACTERISTIC DFES_DTCO.DFC_Com259hAbsent_C "" VALUE 0x8024D42E Val_Wu16 65535.00 DFES_OneToOne 0.00 65535.00 FORMAT "%8.2" /end CHARACTERISTIC
/begin CHARACTERISTIC DFES_DTCO.DFC_Com259hChecksum_C "" VALUE 0x8024D430 Val_Wu16 65535.00 DFES_OneToOne 0.00 65535.00 FORMAT "%8.2" /end CHARACTERISTIC
/begin CHARACTERISTIC DFES_DTCO.DFC_Com259hCounter_C "" VALUE 0x8024D432 Val_Wu16 65535.00 DFES_OneToOne 0.00 65535.00 FORMAT "%8.2" /end CHARACTERISTIC
/begin CHARACTERISTIC DFES_DTCO.DFC_Com259hTooShort_C "" VALUE 0x8024D434 Val_Wu16 65535.00 DFES_OneToOne 0.00 65535.00 FORMAT "%8.2" /end CHARACTERISTIC
/begin CHARACTERISTIC DFES_DTCO.DFC_Com26hAbsent_C "" VALUE 0x8024D436 Val_Wu16 65535.00 DFES_OneToOne 0.00 65535.00 FORMAT "%8.2" /end CHARACTERISTIC
/begin CHARACTERISTIC DFES_DTCO.DFC_Com26hTooShort_C "" VALUE 0x8024D438 Val_Wu16 65535.00 DFES_OneToOne 0.00 65535.00 FORMAT "%8.2" /end CHARACTERISTIC
/begin CHARACTERISTIC DFES_DTCO.DFC_Com273hAbsent_C "" VALUE 0x8024D43A Val_Wu16 65535.00 DFES_OneToOne 0.00 65535.00 FORMAT "%8.2" /end CHARACTERISTIC
/begin CHARACTERISTIC DFES_DTCO.DFC_Com273hChecksum_C "" VALUE 0x8024D43C Val_Wu16 65535.00 DFES_OneToOne 0.00 65535.00 FORMAT "%8.2" /end CHARACTERISTIC
/begin CHARACTERISTIC DFES_DTCO.DFC_Com273hCounter_C "" VALUE 0x8024D43E Val_Wu16 65535.00 DFES_OneToOne 0.00 65535.00 FORMAT "%8.2" /end CHARACTERISTIC
/begin CHARACTERISTIC DFES_DTCO.DFC_Com273hTooShort_C "" VALUE 0x8024D440 Val_Wu16 65535.00 DFES_OneToOne 0.00 65535.00 FORMAT "%8.2" /end CHARACTERISTIC
/begin CHARACTERISTIC DFES_DTCO.DFC_Com275hAbsent_C "" VALUE 0x8024D442 Val_Wu16 65535.00 DFES_OneToOne 0.00 65535.00 FORMAT "%8.2" /end CHARACTERISTIC
/begin CHARACTERISTIC DFES_DTCO.DFC_Com275hChecksum_C "" VALUE 0x8024D444 Val_Wu16 65535.00 DFES_OneToOne 0.00 65535.00 FORMAT "%8.2" /end CHARACTERISTIC
/begin CHARACTERISTIC DFES_DTCO.DFC_Com275hCounter_C "" VALUE 0x8024D446 Val_Wu16 65535.00 DFES_OneToOne 0.00 65535.00 FORMAT "%8.2" /end CHARACTERISTIC
/begin CHARACTERISTIC DFES_DTCO.DFC_Com275hTooShort_C "" VALUE 0x8024D448 Val_Wu16 65535.00 DFES_OneToOne 0.00 65535.00 FORMAT "%8.2" /end CHARACTERISTIC
/begin CHARACTERISTIC DFES_DTCO.DFC_Com283hAbsent_C "" VALUE 0x8024D44A Val_Wu16 65535.00 DFES_OneToOne 0.00 65535.00 FORMAT "%8.2" /end CHARACTERISTIC
/begin CHARACTERISTIC DFES_DTCO.DFC_Com283hTooShort_C "" VALUE 0x8024D44C Val_Wu16 65535.00 DFES_OneToOne 0.00 65535.00 FORMAT "%8.2" /end CHARACTERISTIC
/begin CHARACTERISTIC DFES_DTCO.DFC_Com285hAbsent_C "" VALUE 0x8024D44E Val_Wu16 65535.00 DFES_OneToOne 0.00 65535.00 FORMAT "%8.2" /end CHARACTERISTIC
/begin CHARACTERISTIC DFES_DTCO.DFC_Com285hChecksum_C "" VALUE 0x8024D450 Val_Wu16 65535.00 DFES_OneToOne 0.00 65535.00 FORMAT "%8.2" /end CHARACTERISTIC
/begin CHARACTERISTIC DFES_DTCO.DFC_Com285hCounter_C "" VALUE 0x8024D452 Val_Wu16 65535.00 DFES_OneToOne 0.00 65535.00 FORMAT "%8.2" /end CHARACTERISTIC
/begin CHARACTERISTIC DFES_DTCO.DFC_Com285hTooShort_C "" VALUE 0x8024D454 Val_Wu16 65535.00 DFES_OneToOne 0.00 65535.00 FORMAT "%8.2" /end CHARACTERISTIC
/begin CHARACTERISTIC DFES_DTCO.DFC_Com293hAbsent_C "" VALUE 0x8024D456 Val_Wu16 65535.00 DFES_OneToOne 0.00 65535.00 FORMAT "%8.2" /end CHARACTERISTIC
/begin CHARACTERISTIC DFES_DTCO.DFC_Com293hChecksum_C "" VALUE 0x8024D458 Val_Wu16 65535.00 DFES_OneToOne 0.00 65535.00 FORMAT "%8.2" /end CHARACTERISTIC
/begin CHARACTERISTIC DFES_DTCO.DFC_Com293hCounter_C "" VALUE 0x8024D45A Val_Wu16 65535.00 DFES_OneToOne 0.00 65535.00 FORMAT "%8.2" /end CHARACTERISTIC
/begin CHARACTERISTIC DFES_DTCO.DFC_Com293hTooShort_C "" VALUE 0x8024D45C Val_Wu16 65535.00 DFES_OneToOne 0.00 65535.00 FORMAT "%8.2" /end CHARACTERISTIC
/begin CHARACTERISTIC DFES_DTCO.DFC_Com308hAbsent_C "" VALUE 0x8024D45E Val_Wu16 65535.00 DFES_OneToOne 0.00 65535.00 FORMAT "%8.2" /end CHARACTERISTIC
/begin CHARACTERISTIC DFES_DTCO.DFC_Com308hChecksum_C "" VALUE 0x8024D460 Val_Wu16 65535.00 DFES_OneToOne 0.00 65535.00 FORMAT "%8.2" /end CHARACTERISTIC
/begin CHARACTERISTIC DFES_DTCO.DFC_Com308hCounter_C "" VALUE 0x8024D462 Val_Wu16 65535.00 DFES_OneToOne 0.00 65535.00 FORMAT "%8.2" /end CHARACTERISTIC
/begin CHARACTERISTIC DFES_DTCO.DFC_Com308hTooShort_C "" VALUE 0x8024D464 Val_Wu16 65535.00 DFES_OneToOne 0.00 65535.00 FORMAT "%8.2" /end CHARACTERISTIC
/begin CHARACTERISTIC DFES_DTCO.DFC_Com318hAbsent_C "" VALUE 0x8024D466 Val_Wu16 65535.00 DFES_OneToOne 0.00 65535.00 FORMAT "%8.2" /end CHARACTERISTIC
/begin CHARACTERISTIC DFES_DTCO.DFC_Com318hChecksum_C "" VALUE 0x8024D468 Val_Wu16 65535.00 DFES_OneToOne 0.00 65535.00 FORMAT "%8.2" /end CHARACTERISTIC
/begin CHARACTERISTIC DFES_DTCO.DFC_Com318hCounter_C "" VALUE 0x8024D46A Val_Wu16 65535.00 DFES_OneToOne 0.00 65535.00 FORMAT "%8.2" /end CHARACTERISTIC
/begin CHARACTERISTIC DFES_DTCO.DFC_Com318hTooShort_C "" VALUE 0x8024D46C Val_Wu16 65535.00 DFES_OneToOne 0.00 65535.00 FORMAT "%8.2" /end CHARACTERISTIC
/begin CHARACTERISTIC DFES_DTCO.DFC_Com325hAbsent_C "" VALUE 0x8024D46E Val_Wu16 65535.00 DFES_OneToOne 0.00 65535.00 FORMAT "%8.2" /end CHARACTERISTIC
/begin CHARACTERISTIC DFES_DTCO.DFC_Com325hChecksum_C "" VALUE 0x8024D470 Val_Wu16 65535.00 DFES_OneToOne 0.00 65535.00 FORMAT "%8.2" /end CHARACTERISTIC
/begin CHARACTERISTIC DFES_DTCO.DFC_Com325hCounter_C "" VALUE 0x8024D472 Val_Wu16 65535.00 DFES_OneToOne 0.00 65535.00 FORMAT "%8.2" /end CHARACTERISTIC
/begin CHARACTERISTIC DFES_DTCO.DFC_Com325hTooShort_C "" VALUE 0x8024D474 Val_Wu16 65535.00 DFES_OneToOne 0.00 65535.00 FORMAT "%8.2" /end CHARACTERISTIC
/begin CHARACTERISTIC DFES_DTCO.DFC_Com335hAbsent_C "" VALUE 0x8024D476 Val_Wu16 65535.00 DFES_OneToOne 0.00 65535.00 FORMAT "%8.2" /end CHARACTERISTIC
/begin CHARACTERISTIC DFES_DTCO.DFC_Com335hChecksum_C "" VALUE 0x8024D478 Val_Wu16 65535.00 DFES_OneToOne 0.00 65535.00 FORMAT "%8.2" /end CHARACTERISTIC
/begin CHARACTERISTIC DFES_DTCO.DFC_Com335hCounter_C "" VALUE 0x8024D47A Val_Wu16 65535.00 DFES_OneToOne 0.00 65535.00 FORMAT "%8.2" /end CHARACTERISTIC
/begin CHARACTERISTIC DFES_DTCO.DFC_Com335hTooShort_C "" VALUE 0x8024D47C Val_Wu16 65535.00 DFES_OneToOne 0.00 65535.00 FORMAT "%8.2" /end CHARACTERISTIC
/begin CHARACTERISTIC DFES_DTCO.DFC_Com351hAbsent_C "" VALUE 0x8024D47E Val_Wu16 65535.00 DFES_OneToOne 0.00 65535.00 FORMAT "%8.2" /end CHARACTERISTIC
/begin CHARACTERISTIC DFES_DTCO.DFC_Com351hTooShort_C "" VALUE 0x8024D480 Val_Wu16 65535.00 DFES_OneToOne 0.00 65535.00 FORMAT "%8.2" /end CHARACTERISTIC
/begin CHARACTERISTIC DFES_DTCO.DFC_Com38DhAbsent_C "" VALUE 0x8024D482 Val_Wu16 65535.00 DFES_OneToOne 0.00 65535.00 FORMAT "%8.2" /end CHARACTERISTIC
/begin CHARACTERISTIC DFES_DTCO.DFC_Com38DhChecksum_C "" VALUE 0x8024D484 Val_Wu16 65535.00 DFES_OneToOne 0.00 65535.00 FORMAT "%8.2" /end CHARACTERISTIC
/begin CHARACTERISTIC DFES_DTCO.DFC_Com38DhCounter_C "" VALUE 0x8024D486 Val_Wu16 65535.00 DFES_OneToOne 0.00 65535.00 FORMAT "%8.2" /end CHARACTERISTIC
/begin CHARACTERISTIC DFES_DTCO.DFC_Com38DhTooShort_C "" VALUE 0x8024D488 Val_Wu16 65535.00 DFES_OneToOne 0.00 65535.00 FORMAT "%8.2" /end CHARACTERISTIC
/begin CHARACTERISTIC DFES_DTCO.DFC_Com412hAbsent_C "" VALUE 0x8024D48A Val_Wu16 65535.00 DFES_OneToOne 0.00 65535.00 FORMAT "%8.2" /end CHARACTERISTIC
/begin CHARACTERISTIC DFES_DTCO.DFC_Com412hChecksum_C "" VALUE 0x8024D48C Val_Wu16 65535.00 DFES_OneToOne 0.00 65535.00 FORMAT "%8.2" /end CHARACTERISTIC
/begin CHARACTERISTIC DFES_DTCO.DFC_Com412hCounter_C "" VALUE 0x8024D48E Val_Wu16 65535.00 DFES_OneToOne 0.00 65535.00 FORMAT "%8.2" /end CHARACTERISTIC
/begin CHARACTERISTIC DFES_DTCO.DFC_Com412hTooShort_C "" VALUE 0x8024D490 Val_Wu16 65535.00 DFES_OneToOne 0.00 65535.00 FORMAT "%8.2" /end CHARACTERISTIC
/begin CHARACTERISTIC DFES_DTCO.DFC_Com427hAbsent_C "" VALUE 0x8024D492 Val_Wu16 65535.00 DFES_OneToOne 0.00 65535.00 FORMAT "%8.2" /end CHARACTERISTIC
/begin CHARACTERISTIC DFES_DTCO.DFC_Com427hTooShort_C "" VALUE 0x8024D494 Val_Wu16 65535.00 DFES_OneToOne 0.00 65535.00 FORMAT "%8.2" /end CHARACTERISTIC
/begin CHARACTERISTIC DFES_DTCO.DFC_Com432hAbsent_C "" VALUE 0x8024D496 Val_Wu16 65535.00 DFES_OneToOne 0.00 65535.00 FORMAT "%8.2" /end CHARACTERISTIC
/begin CHARACTERISTIC DFES_DTCO.DFC_Com432hChecksum_C "" VALUE 0x8024D498 Val_Wu16 65535.00 DFES_OneToOne 0.00 65535.00 FORMAT "%8.2" /end CHARACTERISTIC
/begin CHARACTERISTIC DFES_DTCO.DFC_Com432hCounter_C "" VALUE 0x8024D49A Val_Wu16 65535.00 DFES_OneToOne 0.00 65535.00 FORMAT "%8.2" /end CHARACTERISTIC
/begin CHARACTERISTIC DFES_DTCO.DFC_Com432hTooShort_C "" VALUE 0x8024D49C Val_Wu16 65535.00 DFES_OneToOne 0.00 65535.00 FORMAT "%8.2" /end CHARACTERISTIC
/begin CHARACTERISTIC DFES_DTCO.DFC_Com435hAbsent_C "" VALUE 0x8024D49E Val_Wu16 65535.00 DFES_OneToOne 0.00 65535.00 FORMAT "%8.2" /end CHARACTERISTIC
/begin CHARACTERISTIC DFES_DTCO.DFC_Com435hTooShort_C "" VALUE 0x8024D4A0 Val_Wu16 65535.00 DFES_OneToOne 0.00 65535.00 FORMAT "%8.2" /end CHARACTERISTIC
/begin CHARACTERISTIC DFES_DTCO.DFC_Com442hAbsent_C "" VALUE 0x8024D4A2 Val_Wu16 65535.00 DFES_OneToOne 0.00 65535.00 FORMAT "%8.2" /end CHARACTERISTIC
/begin CHARACTERISTIC DFES_DTCO.DFC_Com442hTooShort_C "" VALUE 0x8024D4A4 Val_Wu16 65535.00 DFES_OneToOne 0.00 65535.00 FORMAT "%8.2" /end CHARACTERISTIC
/begin CHARACTERISTIC DFES_DTCO.DFC_Com453hAbsent_C "" VALUE 0x8024D4A6 Val_Wu16 65535.00 DFES_OneToOne 0.00 65535.00 FORMAT "%8.2" /end CHARACTERISTIC
/begin CHARACTERISTIC DFES_DTCO.DFC_Com453hTooShort_C "" VALUE 0x8024D4A8 Val_Wu16 65535.00 DFES_OneToOne 0.00 65535.00 FORMAT "%8.2" /end CHARACTERISTIC
/begin CHARACTERISTIC DFES_DTCO.DFC_Com455hAbsent_C "" VALUE 0x8024D4AA Val_Wu16 65535.00 DFES_OneToOne 0.00 65535.00 FORMAT "%8.2" /end CHARACTERISTIC
/begin CHARACTERISTIC DFES_DTCO.DFC_Com455hTooShort_C "" VALUE 0x8024D4AC Val_Wu16 65535.00 DFES_OneToOne 0.00 65535.00 FORMAT "%8.2" /end CHARACTERISTIC
/begin CHARACTERISTIC DFES_DTCO.DFC_Com463hAbsent_C "" VALUE 0x8024D4AE Val_Wu16 65535.00 DFES_OneToOne 0.00 65535.00 FORMAT "%8.2" /end CHARACTERISTIC
/begin CHARACTERISTIC DFES_DTCO.DFC_Com463hTooShort_C "" VALUE 0x8024D4B0 Val_Wu16 65535.00 DFES_OneToOne 0.00 65535.00 FORMAT "%8.2" /end CHARACTERISTIC
/begin CHARACTERISTIC DFES_DTCO.DFC_Com473hAbsent_C "" VALUE 0x8024D4B2 Val_Wu16 65535.00 DFES_OneToOne 0.00 65535.00 FORMAT "%8.2" /end CHARACTERISTIC
/begin CHARACTERISTIC DFES_DTCO.DFC_Com473hTooShort_C "" VALUE 0x8024D4B4 Val_Wu16 65535.00 DFES_OneToOne 0.00 65535.00 FORMAT "%8.2" /end CHARACTERISTIC
/begin CHARACTERISTIC DFES_DTCO.DFC_Com47BhAbsent_C "" VALUE 0x8024D4B6 Val_Wu16 65535.00 DFES_OneToOne 0.00 65535.00 FORMAT "%8.2" /end CHARACTERISTIC
/begin CHARACTERISTIC DFES_DTCO.DFC_Com47BhTooShort_C "" VALUE 0x8024D4B8 Val_Wu16 65535.00 DFES_OneToOne 0.00 65535.00 FORMAT "%8.2" /end CHARACTERISTIC
/begin CHARACTERISTIC DFES_DTCO.DFC_Com48BhAbsent_C "" VALUE 0x8024D4BA Val_Wu16 65535.00 DFES_OneToOne 0.00 65535.00 FORMAT "%8.2" /end CHARACTERISTIC
/begin CHARACTERISTIC DFES_DTCO.DFC_Com48BhTooShort_C "" VALUE 0x8024D4BC Val_Wu16 65535.00 DFES_OneToOne 0.00 65535.00 FORMAT "%8.2" /end CHARACTERISTIC
/begin CHARACTERISTIC DFES_DTCO.DFC_Com497hTooShort_C "" VALUE 0x8024D4BE Val_Wu16 65535.00 DFES_OneToOne 0.00 65535.00 FORMAT "%8.2" /end CHARACTERISTIC
/begin CHARACTERISTIC DFES_DTCO.DFC_Com4F2hAbsent_C "" VALUE 0x8024D4C0 Val_Wu16 65535.00 DFES_OneToOne 0.00 65535.00 FORMAT "%8.2" /end CHARACTERISTIC
/begin CHARACTERISTIC DFES_DTCO.DFC_Com4F2hChecksum_C "" VALUE 0x8024D4C2 Val_Wu16 65535.00 DFES_OneToOne 0.00 65535.00 FORMAT "%8.2" /end CHARACTERISTIC
/begin CHARACTERISTIC DFES_DTCO.DFC_Com4F2hCounter_C "" VALUE 0x8024D4C4 Val_Wu16 65535.00 DFES_OneToOne 0.00 65535.00 FORMAT "%8.2" /end CHARACTERISTIC
/begin CHARACTERISTIC DFES_DTCO.DFC_Com4F2hTooShort_C "" VALUE 0x8024D4C6 Val_Wu16 65535.00 DFES_OneToOne 0.00 65535.00 FORMAT "%8.2" /end CHARACTERISTIC
/begin CHARACTERISTIC DFES_DTCO.DFC_Com50DhAbsent_C "" VALUE 0x8024D4C8 Val_Wu16 65535.00 DFES_OneToOne 0.00 65535.00 FORMAT "%8.2" /end CHARACTERISTIC
/begin CHARACTERISTIC DFES_DTCO.DFC_Com50DhTooShort_C "" VALUE 0x8024D4CA Val_Wu16 65535.00 DFES_OneToOne 0.00 65535.00 FORMAT "%8.2" /end CHARACTERISTIC
/begin CHARACTERISTIC DFES_DTCO.DFC_Com535hAbsent_C "" VALUE 0x8024D4CC Val_Wu16 65535.00 DFES_OneToOne 0.00 65535.00 FORMAT "%8.2" /end CHARACTERISTIC
/begin CHARACTERISTIC DFES_DTCO.DFC_Com535hTooShort_C "" VALUE 0x8024D4CE Val_Wu16 65535.00 DFES_OneToOne 0.00 65535.00 FORMAT "%8.2" /end CHARACTERISTIC
/begin CHARACTERISTIC DFES_DTCO.DFC_Com543hAbsent_C "" VALUE 0x8024D4D0 Val_Wu16 65535.00 DFES_OneToOne 0.00 65535.00 FORMAT "%8.2" /end CHARACTERISTIC
/begin CHARACTERISTIC DFES_DTCO.DFC_Com543hTooShort_C "" VALUE 0x8024D4D2 Val_Wu16 65535.00 DFES_OneToOne 0.00 65535.00 FORMAT "%8.2" /end CHARACTERISTIC
/begin CHARACTERISTIC DFES_DTCO.DFC_Com552hAbsent_C "" VALUE 0x8024D4D4 Val_Wu16 65535.00 DFES_OneToOne 0.00 65535.00 FORMAT "%8.2" /end CHARACTERISTIC
/begin CHARACTERISTIC DFES_DTCO.DFC_Com552hTooShort_C "" VALUE 0x8024D4D6 Val_Wu16 65535.00 DFES_OneToOne 0.00 65535.00 FORMAT "%8.2" /end CHARACTERISTIC
/begin CHARACTERISTIC DFES_DTCO.DFC_Com583hAbsent_C "" VALUE 0x8024D4D8 Val_Wu16 65535.00 DFES_OneToOne 0.00 65535.00 FORMAT "%8.2" /end CHARACTERISTIC
/begin CHARACTERISTIC DFES_DTCO.DFC_Com583hTooShort_C "" VALUE 0x8024D4DA Val_Wu16 65535.00 DFES_OneToOne 0.00 65535.00 FORMAT "%8.2" /end CHARACTERISTIC
/begin CHARACTERISTIC DFES_DTCO.DFC_Com592hAbsent_C "" VALUE 0x8024D4DC Val_Wu16 65535.00 DFES_OneToOne 0.00 65535.00 FORMAT "%8.2" /end CHARACTERISTIC
/begin CHARACTERISTIC DFES_DTCO.DFC_Com592hChecksum_C "" VALUE 0x8024D4DE Val_Wu16 65535.00 DFES_OneToOne 0.00 65535.00 FORMAT "%8.2" /end CHARACTERISTIC
/begin CHARACTERISTIC DFES_DTCO.DFC_Com592hCounter_C "" VALUE 0x8024D4E0 Val_Wu16 65535.00 DFES_OneToOne 0.00 65535.00 FORMAT "%8.2" /end CHARACTERISTIC
/begin CHARACTERISTIC DFES_DTCO.DFC_Com592hTooShort_C "" VALUE 0x8024D4E2 Val_Wu16 65535.00 DFES_OneToOne 0.00 65535.00 FORMAT "%8.2" /end CHARACTERISTIC
/begin CHARACTERISTIC DFES_DTCO.DFC_Com595hAbsent_C "" VALUE 0x8024D4E4 Val_Wu16 65535.00 DFES_OneToOne 0.00 65535.00 FORMAT "%8.2" /end CHARACTERISTIC
/begin CHARACTERISTIC DFES_DTCO.DFC_Com595hChecksum_C "" VALUE 0x8024D4E6 Val_Wu16 65535.00 DFES_OneToOne 0.00 65535.00 FORMAT "%8.2" /end CHARACTERISTIC
/begin CHARACTERISTIC DFES_DTCO.DFC_Com595hCounter_C "" VALUE 0x8024D4E8 Val_Wu16 65535.00 DFES_OneToOne 0.00 65535.00 FORMAT "%8.2" /end CHARACTERISTIC
/begin CHARACTERISTIC DFES_DTCO.DFC_Com595hTooShort_C "" VALUE 0x8024D4EA Val_Wu16 65535.00 DFES_OneToOne 0.00 65535.00 FORMAT "%8.2" /end CHARACTERISTIC
/begin CHARACTERISTIC DFES_DTCO.DFC_Com5B2hAbsent_C "" VALUE 0x8024D4EC Val_Wu16 65535.00 DFES_OneToOne 0.00 65535.00 FORMAT "%8.2" /end CHARACTERISTIC
/begin CHARACTERISTIC DFES_DTCO.DFC_Com5B2hTooShort_C "" VALUE 0x8024D4EE Val_Wu16 65535.00 DFES_OneToOne 0.00 65535.00 FORMAT "%8.2" /end CHARACTERISTIC
/begin CHARACTERISTIC DFES_DTCO.DFC_Com5B5hAbsent_C "" VALUE 0x8024D4F0 Val_Wu16 65535.00 DFES_OneToOne 0.00 65535.00 FORMAT "%8.2" /end CHARACTERISTIC
/begin CHARACTERISTIC DFES_DTCO.DFC_Com5B5hChecksum_C "" VALUE 0x8024D4F2 Val_Wu16 65535.00 DFES_OneToOne 0.00 65535.00 FORMAT "%8.2" /end CHARACTERISTIC
/begin CHARACTERISTIC DFES_DTCO.DFC_Com5B5hCounter_C "" VALUE 0x8024D4F4 Val_Wu16 65535.00 DFES_OneToOne 0.00 65535.00 FORMAT "%8.2" /end CHARACTERISTIC
/begin CHARACTERISTIC DFES_DTCO.DFC_Com5B5hTooShort_C "" VALUE 0x8024D4F6 Val_Wu16 65535.00 DFES_OneToOne 0.00 65535.00 FORMAT "%8.2" /end CHARACTERISTIC
/begin CHARACTERISTIC DFES_DTCO.DFC_Com5C7hTooShort_C "" VALUE 0x8024D4F8 Val_Wu16 65535.00 DFES_OneToOne 0.00 65535.00 FORMAT "%8.2" /end CHARACTERISTIC
/begin CHARACTERISTIC DFES_DTCO.DFC_Com5E7hAbsent_C "" VALUE 0x8024D4FA Val_Wu16 65535.00 DFES_OneToOne 0.00 65535.00 FORMAT "%8.2" /end CHARACTERISTIC
/begin CHARACTERISTIC DFES_DTCO.DFC_Com5E7hTooShort_C "" VALUE 0x8024D4FC Val_Wu16 65535.00 DFES_OneToOne 0.00 65535.00 FORMAT "%8.2" /end CHARACTERISTIC
/begin CHARACTERISTIC DFES_DTCO.DFC_Com635hTooShort_C "" VALUE 0x8024D4FE Val_Wu16 65535.00 DFES_OneToOne 0.00 65535.00 FORMAT "%8.2" /end CHARACTERISTIC
/begin CHARACTERISTIC DFES_DTCO.DFC_Com645hTooShort_C "" VALUE 0x8024D500 Val_Wu16 65535.00 DFES_OneToOne 0.00 65535.00 FORMAT "%8.2" /end CHARACTERISTIC
/begin CHARACTERISTIC DFES_DTCO.DFC_Com663hAbsent_C "" VALUE 0x8024D502 Val_Wu16 65535.00 DFES_OneToOne 0.00 65535.00 FORMAT "%8.2" /end CHARACTERISTIC
/begin CHARACTERISTIC DFES_DTCO.DFC_Com663hTooShort_C "" VALUE 0x8024D504 Val_Wu16 65535.00 DFES_OneToOne 0.00 65535.00 FORMAT "%8.2" /end CHARACTERISTIC
/begin CHARACTERISTIC DFES_DTCO.DFC_Com665hAbsent_C "" VALUE 0x8024D506 Val_Wu16 65535.00 DFES_OneToOne 0.00 65535.00 FORMAT "%8.2" /end CHARACTERISTIC
/begin CHARACTERISTIC DFES_DTCO.DFC_Com665hTooShort_C "" VALUE 0x8024D508 Val_Wu16 65535.00 DFES_OneToOne 0.00 65535.00 FORMAT "%8.2" /end CHARACTERISTIC
/begin CHARACTERISTIC DFES_DTCO.DFC_Com675hAbsent_C "" VALUE 0x8024D50A Val_Wu16 65535.00 DFES_OneToOne 0.00 65535.00 FORMAT "%8.2" /end CHARACTERISTIC
/begin CHARACTERISTIC DFES_DTCO.DFC_Com675hTooShort_C "" VALUE 0x8024D50C Val_Wu16 65535.00 DFES_OneToOne 0.00 65535.00 FORMAT "%8.2" /end CHARACTERISTIC
/begin CHARACTERISTIC DFES_DTCO.DFC_ComFrbd_205h_HVBAT_PACK_CURRENT_C "" VALUE 0x8024D50E Val_Wu16 65535.00 DFES_OneToOne 0.00 65535.00 FORMAT "%8.2" /end CHARACTERISTIC
/begin CHARACTERISTIC DFES_DTCO.DFC_ComFrbd_205h_HVBAT_SOC_DISPLAY_C "" VALUE 0x8024D510 Val_Wu16 65535.00 DFES_OneToOne 0.00 65535.00 FORMAT "%8.2" /end CHARACTERISTIC
/begin CHARACTERISTIC DFES_DTCO.DFC_ComFrbd_205h_HVBAT_VOLTAGE_C "" VALUE 0x8024D512 Val_Wu16 65535.00 DFES_OneToOne 0.00 65535.00 FORMAT "%8.2" /end CHARACTERISTIC
/begin CHARACTERISTIC DFES_DTCO.DFC_ComFrbd_217h_INV_DC_BUS_VOLTAGE_C "" VALUE 0x8024D514 Val_Wu16 65535.00 DFES_OneToOne 0.00 65535.00 FORMAT "%8.2" /end CHARACTERISTIC
/begin CHARACTERISTIC DFES_DTCO.DFC_ComFrbd_217h_INV_MTR_ACTUAL_TRQ_C "" VALUE 0x8024D516 Val_Wu16 65535.00 DFES_OneToOne 0.00 65535.00 FORMAT "%8.2" /end CHARACTERISTIC
/begin CHARACTERISTIC DFES_DTCO.DFC_ComFrbd_217h_INV_MTR_SPEED_C "" VALUE 0x8024D518 Val_Wu16 65535.00 DFES_OneToOne 0.00 65535.00 FORMAT "%8.2" /end CHARACTERISTIC
/begin CHARACTERISTIC DFES_DTCO.DFC_ComFrbd_217h_INV_MTR_TRQ_C "" VALUE 0x8024D51A Val_Wu16 65535.00 DFES_OneToOne 0.00 65535.00 FORMAT "%8.2" /end CHARACTERISTIC
/begin CHARACTERISTIC DFES_DTCO.DFC_ComFrbd_227h_INV_DC_CURRENT_C "" VALUE 0x8024D51C Val_Wu16 65535.00 DFES_OneToOne 0.00 65535.00 FORMAT "%8.2" /end CHARACTERISTIC
/begin CHARACTERISTIC DFES_DTCO.DFC_ComFrbd_227h_INV_MOTORING_PEAK_TRQ_C "" VALUE 0x8024D51E Val_Wu16 65535.00 DFES_OneToOne 0.00 65535.00 FORMAT "%8.2" /end CHARACTERISTIC
/begin CHARACTERISTIC DFES_DTCO.DFC_ComFrbd_227h_INV_MTR_INST_INPUT_POWER_C "" VALUE 0x8024D520 Val_Wu16 65535.00 DFES_OneToOne 0.00 65535.00 FORMAT "%8.2" /end CHARACTERISTIC
/begin CHARACTERISTIC DFES_DTCO.DFC_ComFrbd_227h_INV_REGEN_PEAK_TRQ_C "" VALUE 0x8024D522 Val_Wu16 65535.00 DFES_OneToOne 0.00 65535.00 FORMAT "%8.2" /end CHARACTERISTIC
/begin CHARACTERISTIC DFES_DTCO.DFC_ComFrbd_237h_INV_ACTIVE_DISCHARGE_STATUS_C "" VALUE 0x8024D524 Val_Wu16 65535.00 DFES_OneToOne 0.00 65535.00 FORMAT "%8.2" /end CHARACTERISTIC
/begin CHARACTERISTIC DFES_DTCO.DFC_ComFrbd_237h_INV_CTRL_MODE_ACK_C "" VALUE 0x8024D526 Val_Wu16 65535.00 DFES_OneToOne 0.00 65535.00 FORMAT "%8.2" /end CHARACTERISTIC
/begin CHARACTERISTIC DFES_DTCO.DFC_ComFrbd_237h_INV_EV_WARNING_C "" VALUE 0x8024D528 Val_Wu16 65535.00 DFES_OneToOne 0.00 65535.00 FORMAT "%8.2" /end CHARACTERISTIC
/begin CHARACTERISTIC DFES_DTCO.DFC_ComFrbd_237h_INV_FAULT_LEVEL_C "" VALUE 0x8024D52A Val_Wu16 65535.00 DFES_OneToOne 0.00 65535.00 FORMAT "%8.2" /end CHARACTERISTIC
/begin CHARACTERISTIC DFES_DTCO.DFC_ComFrbd_237h_INV_MASTER_STOP_C "" VALUE 0x8024D52C Val_Wu16 65535.00 DFES_OneToOne 0.00 65535.00 FORMAT "%8.2" /end CHARACTERISTIC
/begin CHARACTERISTIC DFES_DTCO.DFC_ComFrbd_237h_INV_SERVICE_DUE_C "" VALUE 0x8024D52E Val_Wu16 65535.00 DFES_OneToOne 0.00 65535.00 FORMAT "%8.2" /end CHARACTERISTIC
/begin CHARACTERISTIC DFES_DTCO.DFC_ComFrbd_237h_INV_STAB_MIN_TRQ_C "" VALUE 0x8024D530 Val_Wu16 65535.00 DFES_OneToOne 0.00 65535.00 FORMAT "%8.2" /end CHARACTERISTIC
/begin CHARACTERISTIC DFES_DTCO.DFC_ComFrbd_259h_TGLM_FAILURE_STATE_C "" VALUE 0x8024D532 Val_Wu16 65535.00 DFES_OneToOne 0.00 65535.00 FORMAT "%8.2" /end CHARACTERISTIC
/begin CHARACTERISTIC DFES_DTCO.DFC_ComFrbd_259h_TGLM_MODE_PUSH_C "" VALUE 0x8024D534 Val_Wu16 65535.00 DFES_OneToOne 0.00 65535.00 FORMAT "%8.2" /end CHARACTERISTIC
/begin CHARACTERISTIC DFES_DTCO.DFC_ComFrbd_259h_TOGGLE_MONOSTABLE_POS_C "" VALUE 0x8024D536 Val_Wu16 65535.00 DFES_OneToOne 0.00 65535.00 FORMAT "%8.2" /end CHARACTERISTIC
/begin CHARACTERISTIC DFES_DTCO.DFC_ComFrbd_273h_OBC_outputpower_capability_C "" VALUE 0x8024D538 Val_Wu16 65535.00 DFES_OneToOne 0.00 65535.00 FORMAT "%8.2" /end CHARACTERISTIC
/begin CHARACTERISTIC DFES_DTCO.DFC_ComFrbd_275h_HVBAT_DISCHARGE_30S_AVAILABLE_CURRENT_C "" VALUE 0x8024D53A Val_Wu16 65535.00 DFES_OneToOne 0.00 65535.00 FORMAT "%8.2" /end CHARACTERISTIC
/begin CHARACTERISTIC DFES_DTCO.DFC_ComFrbd_275h_HVBAT_DISCHARGE_30S_AVAILABLE_POWER_C "" VALUE 0x8024D53C Val_Wu16 65535.00 DFES_OneToOne 0.00 65535.00 FORMAT "%8.2" /end CHARACTERISTIC
/begin CHARACTERISTIC DFES_DTCO.DFC_ComFrbd_283h_DCDC_IN_CURRENT_C "" VALUE 0x8024D53E Val_Wu16 65535.00 DFES_OneToOne 0.00 65535.00 FORMAT "%8.2" /end CHARACTERISTIC
/begin CHARACTERISTIC DFES_DTCO.DFC_ComFrbd_283h_DCDC_IN_VOLTAGE_C "" VALUE 0x8024D540 Val_Wu16 65535.00 DFES_OneToOne 0.00 65535.00 FORMAT "%8.2" /end CHARACTERISTIC
/begin CHARACTERISTIC DFES_DTCO.DFC_ComFrbd_283h_DCDC_OUT_CURRENT_C "" VALUE 0x8024D542 Val_Wu16 65535.00 DFES_OneToOne 0.00 65535.00 FORMAT "%8.2" /end CHARACTERISTIC
/begin CHARACTERISTIC DFES_DTCO.DFC_ComFrbd_283h_DCDC_OUT_VOLTAGE_C "" VALUE 0x8024D544 Val_Wu16 65535.00 DFES_OneToOne 0.00 65535.00 FORMAT "%8.2" /end CHARACTERISTIC
/begin CHARACTERISTIC DFES_DTCO.DFC_ComFrbd_285h_HVBAT_REGEN_CHG_30S_CURRENT_LIMIT_C "" VALUE 0x8024D546 Val_Wu16 65535.00 DFES_OneToOne 0.00 65535.00 FORMAT "%8.2" /end CHARACTERISTIC
/begin CHARACTERISTIC DFES_DTCO.DFC_ComFrbd_285h_HVBAT_REGEN_CHRG_30S_POWER_LIMIT_C "" VALUE 0x8024D548 Val_Wu16 65535.00 DFES_OneToOne 0.00 65535.00 FORMAT "%8.2" /end CHARACTERISTIC
/begin CHARACTERISTIC DFES_DTCO.DFC_ComFrbd_293h_DCDC_outputpower_capability_C "" VALUE 0x8024D54A Val_Wu16 65535.00 DFES_OneToOne 0.00 65535.00 FORMAT "%8.2" /end CHARACTERISTIC
/begin CHARACTERISTIC DFES_DTCO.DFC_ComFrbd_325h_HVBAT_INSULATION_RESISTANCE_C "" VALUE 0x8024D54C Val_Wu16 65535.00 DFES_OneToOne 0.00 65535.00 FORMAT "%8.2" /end CHARACTERISTIC
/begin CHARACTERISTIC DFES_DTCO.DFC_ComFrbd_325h_HVBAT_TEMPERATURE_C "" VALUE 0x8024D54E Val_Wu16 65535.00 DFES_OneToOne 0.00 65535.00 FORMAT "%8.2" /end CHARACTERISTIC
/begin CHARACTERISTIC DFES_DTCO.DFC_ComFrbd_335h_HVBAT_CHRG_CONTINUOUS_CURR_MAX_C "" VALUE 0x8024D550 Val_Wu16 65535.00 DFES_OneToOne 0.00 65535.00 FORMAT "%8.2" /end CHARACTERISTIC
/begin CHARACTERISTIC DFES_DTCO.DFC_ComFrbd_335h_HVBAT_CHRG_COTINUOUS_CURR_REQ_C "" VALUE 0x8024D552 Val_Wu16 65535.00 DFES_OneToOne 0.00 65535.00 FORMAT "%8.2" /end CHARACTERISTIC
/begin CHARACTERISTIC DFES_DTCO.DFC_ComFrbd_335h_HVBAT_CHRG_MAX_VOLT_C "" VALUE 0x8024D554 Val_Wu16 65535.00 DFES_OneToOne 0.00 65535.00 FORMAT "%8.2" /end CHARACTERISTIC
/begin CHARACTERISTIC DFES_DTCO.DFC_ComFrbd_335h_HVBAT_DC_BUS_VOLTAGE_C "" VALUE 0x8024D556 Val_Wu16 65535.00 DFES_OneToOne 0.00 65535.00 FORMAT "%8.2" /end CHARACTERISTIC
/begin CHARACTERISTIC DFES_DTCO.DFC_ComFrbd_427h_INV_OP_MODE_C "" VALUE 0x8024D558 Val_Wu16 65535.00 DFES_OneToOne 0.00 65535.00 FORMAT "%8.2" /end CHARACTERISTIC
/begin CHARACTERISTIC DFES_DTCO.DFC_ComFrbd_427h_INV_PERMISIBLE_TORQUE_C "" VALUE 0x8024D55A Val_Wu16 65535.00 DFES_OneToOne 0.00 65535.00 FORMAT "%8.2" /end CHARACTERISTIC
/begin CHARACTERISTIC DFES_DTCO.DFC_ComFrbd_435h_HVBAT_MAX_CELL_VOLT_C "" VALUE 0x8024D55C Val_Wu16 65535.00 DFES_OneToOne 0.00 65535.00 FORMAT "%8.2" /end CHARACTERISTIC
/begin CHARACTERISTIC DFES_DTCO.DFC_ComFrbd_435h_HVBAT_MAX_CELL_VOLT_NUM_C "" VALUE 0x8024D55E Val_Wu16 65535.00 DFES_OneToOne 0.00 65535.00 FORMAT "%8.2" /end CHARACTERISTIC
/begin CHARACTERISTIC DFES_DTCO.DFC_ComFrbd_435h_HVBAT_MAX_SENSOR_TEMP_C "" VALUE 0x8024D560 Val_Wu16 65535.00 DFES_OneToOne 0.00 65535.00 FORMAT "%8.2" /end CHARACTERISTIC
/begin CHARACTERISTIC DFES_DTCO.DFC_ComFrbd_435h_HVBAT_MIN_CELL_VOLT_C "" VALUE 0x8024D562 Val_Wu16 65535.00 DFES_OneToOne 0.00 65535.00 FORMAT "%8.2" /end CHARACTERISTIC
/begin CHARACTERISTIC DFES_DTCO.DFC_ComFrbd_435h_HVBAT_MIN_CELL_VOLT_NUM_C "" VALUE 0x8024D564 Val_Wu16 65535.00 DFES_OneToOne 0.00 65535.00 FORMAT "%8.2" /end CHARACTERISTIC
/begin CHARACTERISTIC DFES_DTCO.DFC_ComFrbd_453h_OBC_IN_CURRENT_C "" VALUE 0x8024D566 Val_Wu16 65535.00 DFES_OneToOne 0.00 65535.00 FORMAT "%8.2" /end CHARACTERISTIC
/begin CHARACTERISTIC DFES_DTCO.DFC_ComFrbd_453h_OBC_IN_VOLTAGE_C "" VALUE 0x8024D568 Val_Wu16 65535.00 DFES_OneToOne 0.00 65535.00 FORMAT "%8.2" /end CHARACTERISTIC
/begin CHARACTERISTIC DFES_DTCO.DFC_ComFrbd_453h_OBC_IP_POWER_C "" VALUE 0x8024D56A Val_Wu16 65535.00 DFES_OneToOne 0.00 65535.00 FORMAT "%8.2" /end CHARACTERISTIC
/begin CHARACTERISTIC DFES_DTCO.DFC_ComFrbd_455h_HVBAT_NOMINAL_VOLTAGE_C "" VALUE 0x8024D56C Val_Wu16 65535.00 DFES_OneToOne 0.00 65535.00 FORMAT "%8.2" /end CHARACTERISTIC
/begin CHARACTERISTIC DFES_DTCO.DFC_ComFrbd_463h_OBC_OUT_CURRENT_C "" VALUE 0x8024D56E Val_Wu16 65535.00 DFES_OneToOne 0.00 65535.00 FORMAT "%8.2" /end CHARACTERISTIC
/begin CHARACTERISTIC DFES_DTCO.DFC_ComFrbd_463h_OBC_OUT_VOLTAGE_C "" VALUE 0x8024D570 Val_Wu16 65535.00 DFES_OneToOne 0.00 65535.00 FORMAT "%8.2" /end CHARACTERISTIC
/begin CHARACTERISTIC DFES_DTCO.DFC_ComFrbd_463h_OBC_TEMPERATURE_C "" VALUE 0x8024D572 Val_Wu16 65535.00 DFES_OneToOne 0.00 65535.00 FORMAT "%8.2" /end CHARACTERISTIC
/begin CHARACTERISTIC DFES_DTCO.DFC_ComFrbd_473h_DCDC_Coolant_Temperature_C "" VALUE 0x8024D574 Val_Wu16 65535.00 DFES_OneToOne 0.00 65535.00 FORMAT "%8.2" /end CHARACTERISTIC
/begin CHARACTERISTIC DFES_DTCO.DFC_ComFrbd_473h_DCDC_TEMPERATURE_C "" VALUE 0x8024D576 Val_Wu16 65535.00 DFES_OneToOne 0.00 65535.00 FORMAT "%8.2" /end CHARACTERISTIC
/begin CHARACTERISTIC DFES_DTCO.DFC_ComFrbd_47Bh_eCOMP_BusBarCurrent_C "" VALUE 0x8024D578 Val_Wu16 65535.00 DFES_OneToOne 0.00 65535.00 FORMAT "%8.2" /end CHARACTERISTIC
/begin CHARACTERISTIC DFES_DTCO.DFC_ComFrbd_47Bh_eCOMP_BusBarVoltage_C "" VALUE 0x8024D57A Val_Wu16 65535.00 DFES_OneToOne 0.00 65535.00 FORMAT "%8.2" /end CHARACTERISTIC
/begin CHARACTERISTIC DFES_DTCO.DFC_ComFrbd_47Bh_eCOMP_CompressorSpeed_C "" VALUE 0x8024D57C Val_Wu16 65535.00 DFES_OneToOne 0.00 65535.00 FORMAT "%8.2" /end CHARACTERISTIC
/begin CHARACTERISTIC DFES_DTCO.DFC_ComFrbd_47Bh_eCOMP_IGBT_Temp_C "" VALUE 0x8024D57E Val_Wu16 65535.00 DFES_OneToOne 0.00 65535.00 FORMAT "%8.2" /end CHARACTERISTIC
/begin CHARACTERISTIC DFES_DTCO.DFC_ComFrbd_47Bh_eCOMP_PeakPhaCurrent_C "" VALUE 0x8024D580 Val_Wu16 65535.00 DFES_OneToOne 0.00 65535.00 FORMAT "%8.2" /end CHARACTERISTIC
/begin CHARACTERISTIC DFES_DTCO.DFC_ComFrbd_47Bh_eCOMP_Power_consumption_C "" VALUE 0x8024D582 Val_Wu16 65535.00 DFES_OneToOne 0.00 65535.00 FORMAT "%8.2" /end CHARACTERISTIC
/begin CHARACTERISTIC DFES_DTCO.DFC_ComFrbd_48Bh_eCOMP_Fault_Level_C "" VALUE 0x8024D584 Val_Wu16 65535.00 DFES_OneToOne 0.00 65535.00 FORMAT "%8.2" /end CHARACTERISTIC
/begin CHARACTERISTIC DFES_DTCO.DFC_ComFrbd_4F2h_VALEUR_SOC_ETENDUE_C "" VALUE 0x8024D586 Val_Wu16 65535.00 DFES_OneToOne 0.00 65535.00 FORMAT "%8.2" /end CHARACTERISTIC
/begin CHARACTERISTIC DFES_DTCO.DFC_ComFrbd_535h_HV_BATT_TEMP_AVG_C "" VALUE 0x8024D588 Val_Wu16 65535.00 DFES_OneToOne 0.00 65535.00 FORMAT "%8.2" /end CHARACTERISTIC
/begin CHARACTERISTIC DFES_DTCO.DFC_ComFrbd_543h_HVBAT_RESTBATTENERGY_C "" VALUE 0x8024D58A Val_Wu16 65535.00 DFES_OneToOne 0.00 65535.00 FORMAT "%8.2" /end CHARACTERISTIC
/begin CHARACTERISTIC DFES_DTCO.DFC_ComFrbd_543h_HVBAT_SOH_C "" VALUE 0x8024D58C Val_Wu16 65535.00 DFES_OneToOne 0.00 65535.00 FORMAT "%8.2" /end CHARACTERISTIC
/begin CHARACTERISTIC DFES_DTCO.DFC_ComFrbd_543h_HV_BATT_SOH_RES_C "" VALUE 0x8024D58E Val_Wu16 65535.00 DFES_OneToOne 0.00 65535.00 FORMAT "%8.2" /end CHARACTERISTIC
/begin CHARACTERISTIC DFES_DTCO.DFC_ComFrbd_592h_IBATT_1_C "" VALUE 0x8024D590 Val_Wu16 65535.00 DFES_OneToOne 0.00 65535.00 FORMAT "%8.2" /end CHARACTERISTIC
/begin CHARACTERISTIC DFES_DTCO.DFC_ComFrbd_592h_IBATT_2_C "" VALUE 0x8024D592 Val_Wu16 65535.00 DFES_OneToOne 0.00 65535.00 FORMAT "%8.2" /end CHARACTERISTIC
/begin CHARACTERISTIC DFES_DTCO.DFC_ComFrbd_592h_IBATT_3_C "" VALUE 0x8024D594 Val_Wu16 65535.00 DFES_OneToOne 0.00 65535.00 FORMAT "%8.2" /end CHARACTERISTIC
/begin CHARACTERISTIC DFES_DTCO.DFC_ComFrbd_592h_TEMP_BATT_C "" VALUE 0x8024D596 Val_Wu16 65535.00 DFES_OneToOne 0.00 65535.00 FORMAT "%8.2" /end CHARACTERISTIC
/begin CHARACTERISTIC DFES_DTCO.DFC_ComFrbd_592h_U_BATT_BECB_C "" VALUE 0x8024D598 Val_Wu16 65535.00 DFES_OneToOne 0.00 65535.00 FORMAT "%8.2" /end CHARACTERISTIC
/begin CHARACTERISTIC DFES_DTCO.DFC_ComFrbd_595h_HVBAT_TIME_TO_CHRG_80_C "" VALUE 0x8024D59A Val_Wu16 65535.00 DFES_OneToOne 0.00 65535.00 FORMAT "%8.2" /end CHARACTERISTIC
/begin CHARACTERISTIC DFES_DTCO.DFC_ComFrbd_5B2h_TEMP_AIR_EXT_C "" VALUE 0x8024D59C Val_Wu16 65535.00 DFES_OneToOne 0.00 65535.00 FORMAT "%8.2" /end CHARACTERISTIC
/begin CHARACTERISTIC DFES_DTCO.DFC_ComFrbd_635h_HVBAT_NEG_CONT_COUNT_SEG1_C "" VALUE 0x8024D59E Val_Wu16 65535.00 DFES_OneToOne 0.00 65535.00 FORMAT "%8.2" /end CHARACTERISTIC
/begin CHARACTERISTIC DFES_DTCO.DFC_ComFrbd_635h_HVBAT_NEG_CONT_COUNT_SEG3_C "" VALUE 0x8024D5A0 Val_Wu16 65535.00 DFES_OneToOne 0.00 65535.00 FORMAT "%8.2" /end CHARACTERISTIC
/begin CHARACTERISTIC DFES_DTCO.DFC_ComFrbd_635h_HVBAT_NEG_CONT_COUNT_SEG4_C "" VALUE 0x8024D5A2 Val_Wu16 65535.00 DFES_OneToOne 0.00 65535.00 FORMAT "%8.2" /end CHARACTERISTIC
/begin CHARACTERISTIC DFES_DTCO.DFC_ComFrbd_635h_HVBAT_PST_CONT_COUNT_SEG1_C "" VALUE 0x8024D5A4 Val_Wu16 65535.00 DFES_OneToOne 0.00 65535.00 FORMAT "%8.2" /end CHARACTERISTIC
/begin CHARACTERISTIC DFES_DTCO.DFC_ComFrbd_635h_HVBAT_PST_CONT_COUNT_SEG3_C "" VALUE 0x8024D5A6 Val_Wu16 65535.00 DFES_OneToOne 0.00 65535.00 FORMAT "%8.2" /end CHARACTERISTIC
/begin CHARACTERISTIC DFES_DTCO.DFC_ComFrbd_635h_HVBAT_PST_CONT_COUNT_SEG4_C "" VALUE 0x8024D5A8 Val_Wu16 65535.00 DFES_OneToOne 0.00 65535.00 FORMAT "%8.2" /end CHARACTERISTIC
/begin CHARACTERISTIC DFES_DTCO.DFC_ComFrbd_645h_HVBAT_PRECHRGE_CONT_COUNT_SEG1_C "" VALUE 0x8024D5AA Val_Wu16 65535.00 DFES_OneToOne 0.00 65535.00 FORMAT "%8.2" /end CHARACTERISTIC
/begin CHARACTERISTIC DFES_DTCO.DFC_ComFrbd_645h_HVBAT_PRECHRGE_CONT_COUNT_SEG2_C "" VALUE 0x8024D5AC Val_Wu16 65535.00 DFES_OneToOne 0.00 65535.00 FORMAT "%8.2" /end CHARACTERISTIC
/begin CHARACTERISTIC DFES_DTCO.DFC_ComFrbd_675h_HVBAT_REMAININGBATTCAPACITY_C "" VALUE 0x8024D5AE Val_Wu16 65535.00 DFES_OneToOne 0.00 65535.00 FORMAT "%8.2" /end CHARACTERISTIC
/begin CHARACTERISTIC DFES_DTCO.DFC_ComInvld_205h_HVBAT_CHARGING_STATUS_C "" VALUE 0x8024D5B0 Val_Wu16 65535.00 DFES_OneToOne 0.00 65535.00 FORMAT "%8.2" /end CHARACTERISTIC
/begin CHARACTERISTIC DFES_DTCO.DFC_ComInvld_205h_HVBAT_PACK_CURRENT_C "" VALUE 0x8024D5B2 Val_Wu16 65535.00 DFES_OneToOne 0.00 65535.00 FORMAT "%8.2" /end CHARACTERISTIC
/begin CHARACTERISTIC DFES_DTCO.DFC_ComInvld_205h_HVBAT_SOC_DISPLAY_C "" VALUE 0x8024D5B4 Val_Wu16 65535.00 DFES_OneToOne 0.00 65535.00 FORMAT "%8.2" /end CHARACTERISTIC
/begin CHARACTERISTIC DFES_DTCO.DFC_ComInvld_205h_HVBAT_VOLTAGE_C "" VALUE 0x8024D5B6 Val_Wu16 65535.00 DFES_OneToOne 0.00 65535.00 FORMAT "%8.2" /end CHARACTERISTIC
/begin CHARACTERISTIC DFES_DTCO.DFC_ComInvld_217h_INV_DC_BUS_VOLTAGE_C "" VALUE 0x8024D5B8 Val_Wu16 65535.00 DFES_OneToOne 0.00 65535.00 FORMAT "%8.2" /end CHARACTERISTIC
/begin CHARACTERISTIC DFES_DTCO.DFC_ComInvld_217h_INV_MTR_ACTUAL_TRQ_C "" VALUE 0x8024D5BA Val_Wu16 65535.00 DFES_OneToOne 0.00 65535.00 FORMAT "%8.2" /end CHARACTERISTIC
/begin CHARACTERISTIC DFES_DTCO.DFC_ComInvld_217h_INV_MTR_SPEED_C "" VALUE 0x8024D5BC Val_Wu16 65535.00 DFES_OneToOne 0.00 65535.00 FORMAT "%8.2" /end CHARACTERISTIC
/begin CHARACTERISTIC DFES_DTCO.DFC_ComInvld_217h_INV_MTR_TRQ_C "" VALUE 0x8024D5BE Val_Wu16 65535.00 DFES_OneToOne 0.00 65535.00 FORMAT "%8.2" /end CHARACTERISTIC
/begin CHARACTERISTIC DFES_DTCO.DFC_ComInvld_227h_INV_DC_CURRENT_C "" VALUE 0x8024D5C0 Val_Wu16 65535.00 DFES_OneToOne 0.00 65535.00 FORMAT "%8.2" /end CHARACTERISTIC
/begin CHARACTERISTIC DFES_DTCO.DFC_ComInvld_227h_INV_MOTORING_PEAK_TRQ_C "" VALUE 0x8024D5C2 Val_Wu16 65535.00 DFES_OneToOne 0.00 65535.00 FORMAT "%8.2" /end CHARACTERISTIC
/begin CHARACTERISTIC DFES_DTCO.DFC_ComInvld_227h_INV_MTR_INST_INPUT_POWER_C "" VALUE 0x8024D5C4 Val_Wu16 65535.00 DFES_OneToOne 0.00 65535.00 FORMAT "%8.2" /end CHARACTERISTIC
/begin CHARACTERISTIC DFES_DTCO.DFC_ComInvld_227h_INV_REGEN_PEAK_TRQ_C "" VALUE 0x8024D5C6 Val_Wu16 65535.00 DFES_OneToOne 0.00 65535.00 FORMAT "%8.2" /end CHARACTERISTIC
/begin CHARACTERISTIC DFES_DTCO.DFC_ComInvld_237h_INV_ACTIVE_DISCHARGE_STATUS_C "" VALUE 0x8024D5C8 Val_Wu16 65535.00 DFES_OneToOne 0.00 65535.00 FORMAT "%8.2" /end CHARACTERISTIC
/begin CHARACTERISTIC DFES_DTCO.DFC_ComInvld_237h_INV_FAULT_LEVEL_C "" VALUE 0x8024D5CA Val_Wu16 65535.00 DFES_OneToOne 0.00 65535.00 FORMAT "%8.2" /end CHARACTERISTIC
/begin CHARACTERISTIC DFES_DTCO.DFC_ComInvld_237h_INV_STAB_MIN_TRQ_C "" VALUE 0x8024D5CC Val_Wu16 65535.00 DFES_OneToOne 0.00 65535.00 FORMAT "%8.2" /end CHARACTERISTIC
/begin CHARACTERISTIC DFES_DTCO.DFC_ComInvld_259h_TGLM_MODE_PUSH_C "" VALUE 0x8024D5CE Val_Wu16 65535.00 DFES_OneToOne 0.00 65535.00 FORMAT "%8.2" /end CHARACTERISTIC
/begin CHARACTERISTIC DFES_DTCO.DFC_ComInvld_259h_TOGGLE_MONOSTABLE_POS_C "" VALUE 0x8024D5D0 Val_Wu16 65535.00 DFES_OneToOne 0.00 65535.00 FORMAT "%8.2" /end CHARACTERISTIC
/begin CHARACTERISTIC DFES_DTCO.DFC_ComInvld_26h_AC_SWITCH_REQ_C "" VALUE 0x8024D5D2 Val_Wu16 65535.00 DFES_OneToOne 0.00 65535.00 FORMAT "%8.2" /end CHARACTERISTIC
/begin CHARACTERISTIC DFES_DTCO.DFC_ComInvld_26h_BLOWER_POSITION_C "" VALUE 0x8024D5D4 Val_Wu16 65535.00 DFES_OneToOne 0.00 65535.00 FORMAT "%8.2" /end CHARACTERISTIC
/begin CHARACTERISTIC DFES_DTCO.DFC_ComInvld_26h_EVAP_SENSOR_FAULT_C "" VALUE 0x8024D5D6 Val_Wu16 65535.00 DFES_OneToOne 0.00 65535.00 FORMAT "%8.2" /end CHARACTERISTIC
/begin CHARACTERISTIC DFES_DTCO.DFC_ComInvld_26h_EVAP_SENSOR_VALUE_C "" VALUE 0x8024D5D8 Val_Wu16 65535.00 DFES_OneToOne 0.00 65535.00 FORMAT "%8.2" /end CHARACTERISTIC
/begin CHARACTERISTIC DFES_DTCO.DFC_ComInvld_26h_POTENTIOMETER_FAULT_C "" VALUE 0x8024D5DA Val_Wu16 65535.00 DFES_OneToOne 0.00 65535.00 FORMAT "%8.2" /end CHARACTERISTIC
/begin CHARACTERISTIC DFES_DTCO.DFC_ComInvld_26h_REAR_DEFOG_REQ_C "" VALUE 0x8024D5DC Val_Wu16 65535.00 DFES_OneToOne 0.00 65535.00 FORMAT "%8.2" /end CHARACTERISTIC
/begin CHARACTERISTIC DFES_DTCO.DFC_ComInvld_26h_TEMP_POSITION_C "" VALUE 0x8024D5DE Val_Wu16 65535.00 DFES_OneToOne 0.00 65535.00 FORMAT "%8.2" /end CHARACTERISTIC
/begin CHARACTERISTIC DFES_DTCO.DFC_ComInvld_273h_OBC_FAULT_LEVEL_C "" VALUE 0x8024D5E0 Val_Wu16 65535.00 DFES_OneToOne 0.00 65535.00 FORMAT "%8.2" /end CHARACTERISTIC
/begin CHARACTERISTIC DFES_DTCO.DFC_ComInvld_273h_OBC_outputpower_capability_C "" VALUE 0x8024D5E2 Val_Wu16 65535.00 DFES_OneToOne 0.00 65535.00 FORMAT "%8.2" /end CHARACTERISTIC
/begin CHARACTERISTIC DFES_DTCO.DFC_ComInvld_275h_HVBAT_DISCHARGE_30S_AVAILABLE_CURRENT_C "" VALUE 0x8024D5E4 Val_Wu16 65535.00 DFES_OneToOne 0.00 65535.00 FORMAT "%8.2" /end CHARACTERISTIC
/begin CHARACTERISTIC DFES_DTCO.DFC_ComInvld_275h_HVBAT_DISCHARGE_30S_AVAILABLE_POWER_C "" VALUE 0x8024D5E6 Val_Wu16 65535.00 DFES_OneToOne 0.00 65535.00 FORMAT "%8.2" /end CHARACTERISTIC
/begin CHARACTERISTIC DFES_DTCO.DFC_ComInvld_283h_DCDC_IN_CURRENT_C "" VALUE 0x8024D5E8 Val_Wu16 65535.00 DFES_OneToOne 0.00 65535.00 FORMAT "%8.2" /end CHARACTERISTIC
/begin CHARACTERISTIC DFES_DTCO.DFC_ComInvld_283h_DCDC_IN_VOLTAGE_C "" VALUE 0x8024D5EA Val_Wu16 65535.00 DFES_OneToOne 0.00 65535.00 FORMAT "%8.2" /end CHARACTERISTIC
/begin CHARACTERISTIC DFES_DTCO.DFC_ComInvld_283h_DCDC_OUT_CURRENT_C "" VALUE 0x8024D5EC Val_Wu16 65535.00 DFES_OneToOne 0.00 65535.00 FORMAT "%8.2" /end CHARACTERISTIC
/begin CHARACTERISTIC DFES_DTCO.DFC_ComInvld_283h_DCDC_OUT_VOLTAGE_C "" VALUE 0x8024D5EE Val_Wu16 65535.00 DFES_OneToOne 0.00 65535.00 FORMAT "%8.2" /end CHARACTERISTIC
/begin CHARACTERISTIC DFES_DTCO.DFC_ComInvld_285h_HVBAT_REGEN_CHG_30S_CURRENT_LIMIT_C "" VALUE 0x8024D5F0 Val_Wu16 65535.00 DFES_OneToOne 0.00 65535.00 FORMAT "%8.2" /end CHARACTERISTIC
/begin CHARACTERISTIC DFES_DTCO.DFC_ComInvld_285h_HVBAT_REGEN_CHRG_30S_POWER_LIMIT_C "" VALUE 0x8024D5F2 Val_Wu16 65535.00 DFES_OneToOne 0.00 65535.00 FORMAT "%8.2" /end CHARACTERISTIC
/begin CHARACTERISTIC DFES_DTCO.DFC_ComInvld_293h_DCDC_FAULT_LEVEL_C "" VALUE 0x8024D5F4 Val_Wu16 65535.00 DFES_OneToOne 0.00 65535.00 FORMAT "%8.2" /end CHARACTERISTIC
/begin CHARACTERISTIC DFES_DTCO.DFC_ComInvld_293h_DCDC_outputpower_capability_C "" VALUE 0x8024D5F6 Val_Wu16 65535.00 DFES_OneToOne 0.00 65535.00 FORMAT "%8.2" /end CHARACTERISTIC
/begin CHARACTERISTIC DFES_DTCO.DFC_ComInvld_325h_HVBAT_EPLUG_STATUS_C "" VALUE 0x8024D5F8 Val_Wu16 65535.00 DFES_OneToOne 0.00 65535.00 FORMAT "%8.2" /end CHARACTERISTIC
/begin CHARACTERISTIC DFES_DTCO.DFC_ComInvld_325h_HVBAT_HVIL_STS_C "" VALUE 0x8024D5FA Val_Wu16 65535.00 DFES_OneToOne 0.00 65535.00 FORMAT "%8.2" /end CHARACTERISTIC
/begin CHARACTERISTIC DFES_DTCO.DFC_ComInvld_325h_HVBAT_INSULATION_FAULT_C "" VALUE 0x8024D5FC Val_Wu16 65535.00 DFES_OneToOne 0.00 65535.00 FORMAT "%8.2" /end CHARACTERISTIC
/begin CHARACTERISTIC DFES_DTCO.DFC_ComInvld_325h_HVBAT_INSULATION_RESISTANCE_C "" VALUE 0x8024D5FE Val_Wu16 65535.00 DFES_OneToOne 0.00 65535.00 FORMAT "%8.2" /end CHARACTERISTIC
/begin CHARACTERISTIC DFES_DTCO.DFC_ComInvld_325h_HVBAT_TEMPERATURE_C "" VALUE 0x8024D600 Val_Wu16 65535.00 DFES_OneToOne 0.00 65535.00 FORMAT "%8.2" /end CHARACTERISTIC
/begin CHARACTERISTIC DFES_DTCO.DFC_ComInvld_335h_HVBAT_CHRG_CONTINUOUS_CURR_MAX_C "" VALUE 0x8024D602 Val_Wu16 65535.00 DFES_OneToOne 0.00 65535.00 FORMAT "%8.2" /end CHARACTERISTIC
/begin CHARACTERISTIC DFES_DTCO.DFC_ComInvld_335h_HVBAT_CHRG_COTINUOUS_CURR_REQ_C "" VALUE 0x8024D604 Val_Wu16 65535.00 DFES_OneToOne 0.00 65535.00 FORMAT "%8.2" /end CHARACTERISTIC
/begin CHARACTERISTIC DFES_DTCO.DFC_ComInvld_335h_HVBAT_CHRG_MAX_VOLT_C "" VALUE 0x8024D606 Val_Wu16 65535.00 DFES_OneToOne 0.00 65535.00 FORMAT "%8.2" /end CHARACTERISTIC
/begin CHARACTERISTIC DFES_DTCO.DFC_ComInvld_335h_HVBAT_DC_BUS_VOLTAGE_C "" VALUE 0x8024D608 Val_Wu16 65535.00 DFES_OneToOne 0.00 65535.00 FORMAT "%8.2" /end CHARACTERISTIC
/begin CHARACTERISTIC DFES_DTCO.DFC_ComInvld_38Dh_VITESSE_VEHICULE_ROUES_C "" VALUE 0x8024D60A Val_Wu16 65535.00 DFES_OneToOne 0.00 65535.00 FORMAT "%8.2" /end CHARACTERISTIC
/begin CHARACTERISTIC DFES_DTCO.DFC_ComInvld_38Dh_VVH_INDISP_C "" VALUE 0x8024D60C Val_Wu16 65535.00 DFES_OneToOne 0.00 65535.00 FORMAT "%8.2" /end CHARACTERISTIC
/begin CHARACTERISTIC DFES_DTCO.DFC_ComInvld_427h_INV_COOLANT_TEMP_C "" VALUE 0x8024D60E Val_Wu16 65535.00 DFES_OneToOne 0.00 65535.00 FORMAT "%8.2" /end CHARACTERISTIC
/begin CHARACTERISTIC DFES_DTCO.DFC_ComInvld_427h_INV_MOTOR_TEMP_C "" VALUE 0x8024D610 Val_Wu16 65535.00 DFES_OneToOne 0.00 65535.00 FORMAT "%8.2" /end CHARACTERISTIC
/begin CHARACTERISTIC DFES_DTCO.DFC_ComInvld_427h_INV_OP_MODE_C "" VALUE 0x8024D612 Val_Wu16 65535.00 DFES_OneToOne 0.00 65535.00 FORMAT "%8.2" /end CHARACTERISTIC
/begin CHARACTERISTIC DFES_DTCO.DFC_ComInvld_427h_INV_PERMISIBLE_TORQUE_C "" VALUE 0x8024D614 Val_Wu16 65535.00 DFES_OneToOne 0.00 65535.00 FORMAT "%8.2" /end CHARACTERISTIC
/begin CHARACTERISTIC DFES_DTCO.DFC_ComInvld_427h_INV_TEMP_C "" VALUE 0x8024D616 Val_Wu16 65535.00 DFES_OneToOne 0.00 65535.00 FORMAT "%8.2" /end CHARACTERISTIC
/begin CHARACTERISTIC DFES_DTCO.DFC_ComInvld_432h_REVEIL_PRINCIPAL_C "" VALUE 0x8024D618 Val_Wu16 65535.00 DFES_OneToOne 0.00 65535.00 FORMAT "%8.2" /end CHARACTERISTIC
/begin CHARACTERISTIC DFES_DTCO.DFC_ComInvld_435h_HVBAT_MAX_CELL_VOLT_C "" VALUE 0x8024D61A Val_Wu16 65535.00 DFES_OneToOne 0.00 65535.00 FORMAT "%8.2" /end CHARACTERISTIC
/begin CHARACTERISTIC DFES_DTCO.DFC_ComInvld_435h_HVBAT_MAX_CELL_VOLT_NUM_C "" VALUE 0x8024D61C Val_Wu16 65535.00 DFES_OneToOne 0.00 65535.00 FORMAT "%8.2" /end CHARACTERISTIC
/begin CHARACTERISTIC DFES_DTCO.DFC_ComInvld_435h_HVBAT_MAX_SENSOR_TEMP_C "" VALUE 0x8024D61E Val_Wu16 65535.00 DFES_OneToOne 0.00 65535.00 FORMAT "%8.2" /end CHARACTERISTIC
/begin CHARACTERISTIC DFES_DTCO.DFC_ComInvld_435h_HVBAT_MIN_CELL_VOLT_C "" VALUE 0x8024D620 Val_Wu16 65535.00 DFES_OneToOne 0.00 65535.00 FORMAT "%8.2" /end CHARACTERISTIC
/begin CHARACTERISTIC DFES_DTCO.DFC_ComInvld_435h_HVBAT_MIN_CELL_VOLT_NUM_C "" VALUE 0x8024D622 Val_Wu16 65535.00 DFES_OneToOne 0.00 65535.00 FORMAT "%8.2" /end CHARACTERISTIC
/begin CHARACTERISTIC DFES_DTCO.DFC_ComInvld_442h_BCCM_BLOWER_RELAY_STS_C "" VALUE 0x8024D624 Val_Wu16 65535.00 DFES_OneToOne 0.00 65535.00 FORMAT "%8.2" /end CHARACTERISTIC
/begin CHARACTERISTIC DFES_DTCO.DFC_ComInvld_453h_OBC_IN_CURRENT_C "" VALUE 0x8024D626 Val_Wu16 65535.00 DFES_OneToOne 0.00 65535.00 FORMAT "%8.2" /end CHARACTERISTIC
/begin CHARACTERISTIC DFES_DTCO.DFC_ComInvld_453h_OBC_IN_VOLTAGE_C "" VALUE 0x8024D628 Val_Wu16 65535.00 DFES_OneToOne 0.00 65535.00 FORMAT "%8.2" /end CHARACTERISTIC
/begin CHARACTERISTIC DFES_DTCO.DFC_ComInvld_453h_OBC_IP_POWER_C "" VALUE 0x8024D62A Val_Wu16 65535.00 DFES_OneToOne 0.00 65535.00 FORMAT "%8.2" /end CHARACTERISTIC
/begin CHARACTERISTIC DFES_DTCO.DFC_ComInvld_455h_HVBAT_NOMINAL_VOLTAGE_C "" VALUE 0x8024D62C Val_Wu16 65535.00 DFES_OneToOne 0.00 65535.00 FORMAT "%8.2" /end CHARACTERISTIC
/begin CHARACTERISTIC DFES_DTCO.DFC_ComInvld_463h_OBC_OUT_CURRENT_C "" VALUE 0x8024D62E Val_Wu16 65535.00 DFES_OneToOne 0.00 65535.00 FORMAT "%8.2" /end CHARACTERISTIC
/begin CHARACTERISTIC DFES_DTCO.DFC_ComInvld_463h_OBC_OUT_VOLTAGE_C "" VALUE 0x8024D630 Val_Wu16 65535.00 DFES_OneToOne 0.00 65535.00 FORMAT "%8.2" /end CHARACTERISTIC
/begin CHARACTERISTIC DFES_DTCO.DFC_ComInvld_463h_OBC_TEMPERATURE_C "" VALUE 0x8024D632 Val_Wu16 65535.00 DFES_OneToOne 0.00 65535.00 FORMAT "%8.2" /end CHARACTERISTIC
/begin CHARACTERISTIC DFES_DTCO.DFC_ComInvld_473h_DCDC_Coolant_Temperature_C "" VALUE 0x8024D634 Val_Wu16 65535.00 DFES_OneToOne 0.00 65535.00 FORMAT "%8.2" /end CHARACTERISTIC
/begin CHARACTERISTIC DFES_DTCO.DFC_ComInvld_473h_DCDC_TEMPERATURE_C "" VALUE 0x8024D636 Val_Wu16 65535.00 DFES_OneToOne 0.00 65535.00 FORMAT "%8.2" /end CHARACTERISTIC
/begin CHARACTERISTIC DFES_DTCO.DFC_ComInvld_47Bh_eCOMP_BusBarCurrent_C "" VALUE 0x8024D638 Val_Wu16 65535.00 DFES_OneToOne 0.00 65535.00 FORMAT "%8.2" /end CHARACTERISTIC
/begin CHARACTERISTIC DFES_DTCO.DFC_ComInvld_47Bh_eCOMP_BusBarVoltage_C "" VALUE 0x8024D63A Val_Wu16 65535.00 DFES_OneToOne 0.00 65535.00 FORMAT "%8.2" /end CHARACTERISTIC
/begin CHARACTERISTIC DFES_DTCO.DFC_ComInvld_47Bh_eCOMP_CompressorSpeed_C "" VALUE 0x8024D63C Val_Wu16 65535.00 DFES_OneToOne 0.00 65535.00 FORMAT "%8.2" /end CHARACTERISTIC
/begin CHARACTERISTIC DFES_DTCO.DFC_ComInvld_47Bh_eCOMP_IGBT_Temp_C "" VALUE 0x8024D63E Val_Wu16 65535.00 DFES_OneToOne 0.00 65535.00 FORMAT "%8.2" /end CHARACTERISTIC
/begin CHARACTERISTIC DFES_DTCO.DFC_ComInvld_47Bh_eCOMP_PeakPhaCurrent_C "" VALUE 0x8024D640 Val_Wu16 65535.00 DFES_OneToOne 0.00 65535.00 FORMAT "%8.2" /end CHARACTERISTIC
/begin CHARACTERISTIC DFES_DTCO.DFC_ComInvld_47Bh_eCOMP_Power_consumption_C "" VALUE 0x8024D642 Val_Wu16 65535.00 DFES_OneToOne 0.00 65535.00 FORMAT "%8.2" /end CHARACTERISTIC
/begin CHARACTERISTIC DFES_DTCO.DFC_ComInvld_4F2h_STATUS_SOC_C "" VALUE 0x8024D644 Val_Wu16 65535.00 DFES_OneToOne 0.00 65535.00 FORMAT "%8.2" /end CHARACTERISTIC
/begin CHARACTERISTIC DFES_DTCO.DFC_ComInvld_4F2h_TEMP_BATT_STATUS_C "" VALUE 0x8024D646 Val_Wu16 65535.00 DFES_OneToOne 0.00 65535.00 FORMAT "%8.2" /end CHARACTERISTIC
/begin CHARACTERISTIC DFES_DTCO.DFC_ComInvld_4F2h_VALEUR_SOC_ETENDUE_C "" VALUE 0x8024D648 Val_Wu16 65535.00 DFES_OneToOne 0.00 65535.00 FORMAT "%8.2" /end CHARACTERISTIC
/begin CHARACTERISTIC DFES_DTCO.DFC_ComInvld_535h_HV_BATT_TEMP_AVG_C "" VALUE 0x8024D64A Val_Wu16 65535.00 DFES_OneToOne 0.00 65535.00 FORMAT "%8.2" /end CHARACTERISTIC
/begin CHARACTERISTIC DFES_DTCO.DFC_ComInvld_543h_HVBAT_RESTBATTENERGY_C "" VALUE 0x8024D64C Val_Wu16 65535.00 DFES_OneToOne 0.00 65535.00 FORMAT "%8.2" /end CHARACTERISTIC
/begin CHARACTERISTIC DFES_DTCO.DFC_ComInvld_543h_HVBAT_SOH_C "" VALUE 0x8024D64E Val_Wu16 65535.00 DFES_OneToOne 0.00 65535.00 FORMAT "%8.2" /end CHARACTERISTIC
/begin CHARACTERISTIC DFES_DTCO.DFC_ComInvld_543h_HV_BATT_SOH_RES_C "" VALUE 0x8024D650 Val_Wu16 65535.00 DFES_OneToOne 0.00 65535.00 FORMAT "%8.2" /end CHARACTERISTIC
/begin CHARACTERISTIC DFES_DTCO.DFC_ComInvld_552h_CPT_TEMPOREL_C "" VALUE 0x8024D652 Val_Wu16 65535.00 DFES_OneToOne 0.00 65535.00 FORMAT "%8.2" /end CHARACTERISTIC
/begin CHARACTERISTIC DFES_DTCO.DFC_ComInvld_552h_KILOMETRAGE_C "" VALUE 0x8024D654 Val_Wu16 65535.00 DFES_OneToOne 0.00 65535.00 FORMAT "%8.2" /end CHARACTERISTIC
/begin CHARACTERISTIC DFES_DTCO.DFC_ComInvld_583h_HV_BATT_DISCONT_CSE_OPEN_C "" VALUE 0x8024D656 Val_Wu16 65535.00 DFES_OneToOne 0.00 65535.00 FORMAT "%8.2" /end CHARACTERISTIC
/begin CHARACTERISTIC DFES_DTCO.DFC_ComInvld_592h_CALIBRE_IBATT_C "" VALUE 0x8024D658 Val_Wu16 65535.00 DFES_OneToOne 0.00 65535.00 FORMAT "%8.2" /end CHARACTERISTIC
/begin CHARACTERISTIC DFES_DTCO.DFC_ComInvld_592h_IBATT_1_C "" VALUE 0x8024D65A Val_Wu16 65535.00 DFES_OneToOne 0.00 65535.00 FORMAT "%8.2" /end CHARACTERISTIC
/begin CHARACTERISTIC DFES_DTCO.DFC_ComInvld_592h_IBATT_2_C "" VALUE 0x8024D65C Val_Wu16 65535.00 DFES_OneToOne 0.00 65535.00 FORMAT "%8.2" /end CHARACTERISTIC
/begin CHARACTERISTIC DFES_DTCO.DFC_ComInvld_592h_IBATT_3_C "" VALUE 0x8024D65E Val_Wu16 65535.00 DFES_OneToOne 0.00 65535.00 FORMAT "%8.2" /end CHARACTERISTIC
/begin CHARACTERISTIC DFES_DTCO.DFC_ComInvld_592h_TEMP_BATT_C "" VALUE 0x8024D660 Val_Wu16 65535.00 DFES_OneToOne 0.00 65535.00 FORMAT "%8.2" /end CHARACTERISTIC
/begin CHARACTERISTIC DFES_DTCO.DFC_ComInvld_592h_U_BATT_BECB_C "" VALUE 0x8024D662 Val_Wu16 65535.00 DFES_OneToOne 0.00 65535.00 FORMAT "%8.2" /end CHARACTERISTIC
/begin CHARACTERISTIC DFES_DTCO.DFC_ComInvld_595h_HVBAT_TIME_TO_CHRG_80_C "" VALUE 0x8024D664 Val_Wu16 65535.00 DFES_OneToOne 0.00 65535.00 FORMAT "%8.2" /end CHARACTERISTIC
/begin CHARACTERISTIC DFES_DTCO.DFC_ComInvld_5B2h_TEMP_AIR_EXT_C "" VALUE 0x8024D666 Val_Wu16 65535.00 DFES_OneToOne 0.00 65535.00 FORMAT "%8.2" /end CHARACTERISTIC
/begin CHARACTERISTIC DFES_DTCO.DFC_ComInvld_5B5h_HVBAT_THERMAL_RUNAWAY_C "" VALUE 0x8024D668 Val_Wu16 65535.00 DFES_OneToOne 0.00 65535.00 FORMAT "%8.2" /end CHARACTERISTIC
/begin CHARACTERISTIC DFES_DTCO.DFC_ComInvld_635h_HVBAT_NEG_CONT_COUNT_SEG1_C "" VALUE 0x8024D66A Val_Wu16 65535.00 DFES_OneToOne 0.00 65535.00 FORMAT "%8.2" /end CHARACTERISTIC
/begin CHARACTERISTIC DFES_DTCO.DFC_ComInvld_635h_HVBAT_NEG_CONT_COUNT_SEG3_C "" VALUE 0x8024D66C Val_Wu16 65535.00 DFES_OneToOne 0.00 65535.00 FORMAT "%8.2" /end CHARACTERISTIC
/begin CHARACTERISTIC DFES_DTCO.DFC_ComInvld_635h_HVBAT_NEG_CONT_COUNT_SEG4_C "" VALUE 0x8024D66E Val_Wu16 65535.00 DFES_OneToOne 0.00 65535.00 FORMAT "%8.2" /end CHARACTERISTIC
/begin CHARACTERISTIC DFES_DTCO.DFC_ComInvld_635h_HVBAT_PST_CONT_COUNT_SEG1_C "" VALUE 0x8024D670 Val_Wu16 65535.00 DFES_OneToOne 0.00 65535.00 FORMAT "%8.2" /end CHARACTERISTIC
/begin CHARACTERISTIC DFES_DTCO.DFC_ComInvld_635h_HVBAT_PST_CONT_COUNT_SEG3_C "" VALUE 0x8024D672 Val_Wu16 65535.00 DFES_OneToOne 0.00 65535.00 FORMAT "%8.2" /end CHARACTERISTIC
/begin CHARACTERISTIC DFES_DTCO.DFC_ComInvld_635h_HVBAT_PST_CONT_COUNT_SEG4_C "" VALUE 0x8024D674 Val_Wu16 65535.00 DFES_OneToOne 0.00 65535.00 FORMAT "%8.2" /end CHARACTERISTIC
/begin CHARACTERISTIC DFES_DTCO.DFC_ComInvld_645h_HVBAT_PRECHRGE_CONT_COUNT_SEG1_C "" VALUE 0x8024D676 Val_Wu16 65535.00 DFES_OneToOne 0.00 65535.00 FORMAT "%8.2" /end CHARACTERISTIC
/begin CHARACTERISTIC DFES_DTCO.DFC_ComInvld_645h_HVBAT_PRECHRGE_CONT_COUNT_SEG2_C "" VALUE 0x8024D678 Val_Wu16 65535.00 DFES_OneToOne 0.00 65535.00 FORMAT "%8.2" /end CHARACTERISTIC
/begin CHARACTERISTIC DFES_DTCO.DFC_ComInvld_675h_HVBAT_REMAININGBATTCAPACITY_C "" VALUE 0x8024D67A Val_Wu16 65535.00 DFES_OneToOne 0.00 65535.00 FORMAT "%8.2" /end CHARACTERISTIC
/begin CHARACTERISTIC DFES_DTCO.DFC_ACCmprFltLvl1_C "" VALUE 0x8024D67C Val_Wu16 65535.00 DFES_OneToOne 0.00 65535.00 FORMAT "%8.2" /end CHARACTERISTIC
/begin CHARACTERISTIC DFES_DTCO.DFC_ACCmprFltLvl2_C "" VALUE 0x8024D67E Val_Wu16 65535.00 DFES_OneToOne 0.00 65535.00 FORMAT "%8.2" /end CHARACTERISTIC
/begin CHARACTERISTIC DFES_DTCO.DFC_ACCmprFltLvl3_C "" VALUE 0x8024D680 Val_Wu16 65535.00 DFES_OneToOne 0.00 65535.00 FORMAT "%8.2" /end CHARACTERISTIC
/begin CHARACTERISTIC DFES_DTCO.DFC_ACCmprFltLvl4_C "" VALUE 0x8024D682 Val_Wu16 65535.00 DFES_OneToOne 0.00 65535.00 FORMAT "%8.2" /end CHARACTERISTIC
/begin CHARACTERISTIC DFES_DTCO.DFC_ACCmprHiPFlt_C "" VALUE 0x8024D684 Val_Wu16 65535.00 DFES_OneToOne 0.00 65535.00 FORMAT "%8.2" /end CHARACTERISTIC
/begin CHARACTERISTIC DFES_DTCO.DFC_ACCmprInvldCmprSt_C "" VALUE 0x8024D686 Val_Wu16 65535.00 DFES_OneToOne 0.00 65535.00 FORMAT "%8.2" /end CHARACTERISTIC
/begin CHARACTERISTIC DFES_DTCO.DFC_ACCmprInvldElecActPwr_C "" VALUE 0x8024D688 Val_Wu16 65535.00 DFES_OneToOne 0.00 65535.00 FORMAT "%8.2" /end CHARACTERISTIC
/begin CHARACTERISTIC DFES_DTCO.DFC_ACCmprLoPFlt_C "" VALUE 0x8024D68A Val_Wu16 65535.00 DFES_OneToOne 0.00 65535.00 FORMAT "%8.2" /end CHARACTERISTIC
/begin CHARACTERISTIC DFES_DTCO.DFC_AcChrgrIntkTSRCMin_C "" VALUE 0x8024D68C Val_Wu16 65535.00 DFES_OneToOne 0.00 65535.00 FORMAT "%8.2" /end CHARACTERISTIC
/begin CHARACTERISTIC DFES_DTCO.DFC_BattUBMaxBatt_C "" VALUE 0x8024D68E Val_Wu16 65535.00 DFES_OneToOne 0.00 65535.00 FORMAT "%8.2" /end CHARACTERISTIC
/begin CHARACTERISTIC DFES_DTCO.DFC_BattUBMaxNoBatt_C "" VALUE 0x8024D690 Val_Wu16 65535.00 DFES_OneToOne 0.00 65535.00 FORMAT "%8.2" /end CHARACTERISTIC
/begin CHARACTERISTIC DFES_DTCO.DFC_BattUBMinBatt_C "" VALUE 0x8024D692 Val_Wu16 65535.00 DFES_OneToOne 0.00 65535.00 FORMAT "%8.2" /end CHARACTERISTIC
/begin CHARACTERISTIC DFES_DTCO.DFC_BattUBMinNoBatt_C "" VALUE 0x8024D694 Val_Wu16 65535.00 DFES_OneToOne 0.00 65535.00 FORMAT "%8.2" /end CHARACTERISTIC
/begin CHARACTERISTIC DFES_DTCO.DFC_BattUSRCMax_C "" VALUE 0x8024D696 Val_Wu16 65535.00 DFES_OneToOne 0.00 65535.00 FORMAT "%8.2" /end CHARACTERISTIC
/begin CHARACTERISTIC DFES_DTCO.DFC_BattUSRCMin_C "" VALUE 0x8024D698 Val_Wu16 65535.00 DFES_OneToOne 0.00 65535.00 FORMAT "%8.2" /end CHARACTERISTIC
/begin CHARACTERISTIC DFES_DTCO.DFC_BrkBstPHiCautionDfct_C "" VALUE 0x8024D69A Val_Wu16 65535.00 DFES_OneToOne 0.00 65535.00 FORMAT "%8.2" /end CHARACTERISTIC
/begin CHARACTERISTIC DFES_DTCO.DFC_BrkBstPHiWarnDfct_C "" VALUE 0x8024D69C Val_Wu16 65535.00 DFES_OneToOne 0.00 65535.00 FORMAT "%8.2" /end CHARACTERISTIC
/begin CHARACTERISTIC DFES_DTCO.DFC_BrkBstPSnsr12PlausDfct_C "" VALUE 0x8024D69E Val_Wu16 65535.00 DFES_OneToOne 0.00 65535.00 FORMAT "%8.2" /end CHARACTERISTIC
/begin CHARACTERISTIC DFES_DTCO.DFC_BrkBstPSnsr1Scb_C "" VALUE 0x8024D6A0 Val_Wu16 65535.00 DFES_OneToOne 0.00 65535.00 FORMAT "%8.2" /end CHARACTERISTIC
/begin CHARACTERISTIC DFES_DTCO.DFC_BrkBstPSnsr1Scg_C "" VALUE 0x8024D6A2 Val_Wu16 65535.00 DFES_OneToOne 0.00 65535.00 FORMAT "%8.2" /end CHARACTERISTIC
/begin CHARACTERISTIC DFES_DTCO.DFC_BrkBstPSnsr2Scb_C "" VALUE 0x8024D6A4 Val_Wu16 65535.00 DFES_OneToOne 0.00 65535.00 FORMAT "%8.2" /end CHARACTERISTIC
/begin CHARACTERISTIC DFES_DTCO.DFC_BrkBstPSnsr2Scg_C "" VALUE 0x8024D6A6 Val_Wu16 65535.00 DFES_OneToOne 0.00 65535.00 FORMAT "%8.2" /end CHARACTERISTIC
/begin CHARACTERISTIC DFES_DTCO.DFC_BrkBstPSnsrMax_C "" VALUE 0x8024D6A8 Val_Wu16 65535.00 DFES_OneToOne 0.00 65535.00 FORMAT "%8.2" /end CHARACTERISTIC
/begin CHARACTERISTIC DFES_DTCO.DFC_BrkBstPSnsrMin_C "" VALUE 0x8024D6AA Val_Wu16 65535.00 DFES_OneToOne 0.00 65535.00 FORMAT "%8.2" /end CHARACTERISTIC
/begin CHARACTERISTIC DFES_DTCO.DFC_BrkBstPhyRngChkMax_C "" VALUE 0x8024D6AC Val_Wu16 65535.00 DFES_OneToOne 0.00 65535.00 FORMAT "%8.2" /end CHARACTERISTIC
/begin CHARACTERISTIC DFES_DTCO.DFC_BrkBstPhyRngChkMin_C "" VALUE 0x8024D6AE Val_Wu16 65535.00 DFES_OneToOne 0.00 65535.00 FORMAT "%8.2" /end CHARACTERISTIC
/begin CHARACTERISTIC DFES_DTCO.DFC_BrkBstPmpHsScb_C "" VALUE 0x8024D6B0 Val_Wu16 65535.00 DFES_OneToOne 0.00 65535.00 FORMAT "%8.2" /end CHARACTERISTIC
/begin CHARACTERISTIC DFES_DTCO.DFC_BrkBstPmpHsScg_C "" VALUE 0x8024D6B2 Val_Wu16 65535.00 DFES_OneToOne 0.00 65535.00 FORMAT "%8.2" /end CHARACTERISTIC
/begin CHARACTERISTIC DFES_DTCO.DFC_BrkBstPmpLsOl_C "" VALUE 0x8024D6B4 Val_Wu16 65535.00 DFES_OneToOne 0.00 65535.00 FORMAT "%8.2" /end CHARACTERISTIC
/begin CHARACTERISTIC DFES_DTCO.DFC_BrkBstPmpLsScb_C "" VALUE 0x8024D6B6 Val_Wu16 65535.00 DFES_OneToOne 0.00 65535.00 FORMAT "%8.2" /end CHARACTERISTIC
/begin CHARACTERISTIC DFES_DTCO.DFC_BrkBstPmpLsScg_C "" VALUE 0x8024D6B8 Val_Wu16 65535.00 DFES_OneToOne 0.00 65535.00 FORMAT "%8.2" /end CHARACTERISTIC
/begin CHARACTERISTIC DFES_DTCO.DFC_CbnHeatgHeatrRlyOpend_C "" VALUE 0x8024D6BA Val_Wu16 65535.00 DFES_OneToOne 0.00 65535.00 FORMAT "%8.2" /end CHARACTERISTIC
/begin CHARACTERISTIC DFES_DTCO.DFC_CbnHeatgHeatrRlyWldd_C "" VALUE 0x8024D6BC Val_Wu16 65535.00 DFES_OneToOne 0.00 65535.00 FORMAT "%8.2" /end CHARACTERISTIC
/begin CHARACTERISTIC DFES_DTCO.DFC_CcsDcIBattExcdd_C "" VALUE 0x8024D6BE Val_Wu16 65535.00 DFES_OneToOne 0.00 65535.00 FORMAT "%8.2" /end CHARACTERISTIC
/begin CHARACTERISTIC DFES_DTCO.DFC_CcsDcIEvseOutDe_C "" VALUE 0x8024D6C0 Val_Wu16 65535.00 DFES_OneToOne 0.00 65535.00 FORMAT "%8.2" /end CHARACTERISTIC
/begin CHARACTERISTIC DFES_DTCO.DFC_CcsDcIOutDe_C "" VALUE 0x8024D6C2 Val_Wu16 65535.00 DFES_OneToOne 0.00 65535.00 FORMAT "%8.2" /end CHARACTERISTIC
/begin CHARACTERISTIC DFES_DTCO.DFC_CcsDcIOutExcdd_C "" VALUE 0x8024D6C4 Val_Wu16 65535.00 DFES_OneToOne 0.00 65535.00 FORMAT "%8.2" /end CHARACTERISTIC
/begin CHARACTERISTIC DFES_DTCO.DFC_CcsDcUOutDe_C "" VALUE 0x8024D6C6 Val_Wu16 65535.00 DFES_OneToOne 0.00 65535.00 FORMAT "%8.2" /end CHARACTERISTIC
/begin CHARACTERISTIC DFES_DTCO.DFC_CcsDcUOutExcdd_C "" VALUE 0x8024D6C8 Val_Wu16 65535.00 DFES_OneToOne 0.00 65535.00 FORMAT "%8.2" /end CHARACTERISTIC
/begin CHARACTERISTIC DFES_DTCO.DFC_CcsPwrLineChpRstOL_C "" VALUE 0x8024D6CA Val_Wu16 65535.00 DFES_OneToOne 0.00 65535.00 FORMAT "%8.2" /end CHARACTERISTIC
/begin CHARACTERISTIC DFES_DTCO.DFC_CcsPwrLineChpRstOvrTemp_C "" VALUE 0x8024D6CC Val_Wu16 65535.00 DFES_OneToOne 0.00 65535.00 FORMAT "%8.2" /end CHARACTERISTIC
/begin CHARACTERISTIC DFES_DTCO.DFC_CcsPwrLineChpRstSCB_C "" VALUE 0x8024D6CE Val_Wu16 65535.00 DFES_OneToOne 0.00 65535.00 FORMAT "%8.2" /end CHARACTERISTIC
/begin CHARACTERISTIC DFES_DTCO.DFC_CcsPwrLineChpRstSCG_C "" VALUE 0x8024D6D0 Val_Wu16 65535.00 DFES_OneToOne 0.00 65535.00 FORMAT "%8.2" /end CHARACTERISTIC
/begin CHARACTERISTIC DFES_DTCO.DFC_CcsPwrLineChpVccEnaOL_C "" VALUE 0x8024D6D2 Val_Wu16 65535.00 DFES_OneToOne 0.00 65535.00 FORMAT "%8.2" /end CHARACTERISTIC
/begin CHARACTERISTIC DFES_DTCO.DFC_CcsPwrLineChpVccEnaOvrTemp_C "" VALUE 0x8024D6D4 Val_Wu16 65535.00 DFES_OneToOne 0.00 65535.00 FORMAT "%8.2" /end CHARACTERISTIC
/begin CHARACTERISTIC DFES_DTCO.DFC_CcsPwrLineChpVccEnaSCB_C "" VALUE 0x8024D6D6 Val_Wu16 65535.00 DFES_OneToOne 0.00 65535.00 FORMAT "%8.2" /end CHARACTERISTIC
/begin CHARACTERISTIC DFES_DTCO.DFC_CcsPwrLineChpVccEnaSCG_C "" VALUE 0x8024D6D8 Val_Wu16 65535.00 DFES_OneToOne 0.00 65535.00 FORMAT "%8.2" /end CHARACTERISTIC
/begin CHARACTERISTIC DFES_DTCO.DFC_CcsPwrLineChpVccSRCMin_C "" VALUE 0x8024D6DA Val_Wu16 65535.00 DFES_OneToOne 0.00 65535.00 FORMAT "%8.2" /end CHARACTERISTIC
/begin CHARACTERISTIC DFES_DTCO.DFC_CcsPwrLineComChpTSRCMin_C "" VALUE 0x8024D6DC Val_Wu16 65535.00 DFES_OneToOne 0.00 65535.00 FORMAT "%8.2" /end CHARACTERISTIC
/begin CHARACTERISTIC DFES_DTCO.DFC_CtPSwtActrOL_C "" VALUE 0x8024D6DE Val_Wu16 65535.00 DFES_OneToOne 0.00 65535.00 FORMAT "%8.2" /end CHARACTERISTIC
/begin CHARACTERISTIC DFES_DTCO.DFC_CtPSwtActrOvrTemp_C "" VALUE 0x8024D6E0 Val_Wu16 65535.00 DFES_OneToOne 0.00 65535.00 FORMAT "%8.2" /end CHARACTERISTIC
/begin CHARACTERISTIC DFES_DTCO.DFC_CtPSwtActrSCB_C "" VALUE 0x8024D6E2 Val_Wu16 65535.00 DFES_OneToOne 0.00 65535.00 FORMAT "%8.2" /end CHARACTERISTIC
/begin CHARACTERISTIC DFES_DTCO.DFC_CtPSwtActrSCG_C "" VALUE 0x8024D6E4 Val_Wu16 65535.00 DFES_OneToOne 0.00 65535.00 FORMAT "%8.2" /end CHARACTERISTIC
/begin CHARACTERISTIC DFES_DTCO.DFC_CtPSwtDiagSRCMin_C "" VALUE 0x8024D6E6 Val_Wu16 65535.00 DFES_OneToOne 0.00 65535.00 FORMAT "%8.2" /end CHARACTERISTIC
/begin CHARACTERISTIC DFES_DTCO.DFC_CtpCarrFrqSRCMin_C "" VALUE 0x8024D6E8 Val_Wu16 65535.00 DFES_OneToOne 0.00 65535.00 FORMAT "%8.2" /end CHARACTERISTIC
/begin CHARACTERISTIC DFES_DTCO.DFC_DcChrgrIntkT2SRCMin_C "" VALUE 0x8024D6EA Val_Wu16 65535.00 DFES_OneToOne 0.00 65535.00 FORMAT "%8.2" /end CHARACTERISTIC
/begin CHARACTERISTIC DFES_DTCO.DFC_DcChrgrIntkTSRCMin_C "" VALUE 0x8024D6EC Val_Wu16 65535.00 DFES_OneToOne 0.00 65535.00 FORMAT "%8.2" /end CHARACTERISTIC
/begin CHARACTERISTIC DFES_DTCO.DFC_DevLibBattUHi_C "" VALUE 0x8024D6EE Val_Wu16 65535.00 DFES_OneToOne 0.00 65535.00 FORMAT "%8.2" /end CHARACTERISTIC
/begin CHARACTERISTIC DFES_DTCO.DFC_DevLibBattULo_C "" VALUE 0x8024D6F0 Val_Wu16 65535.00 DFES_OneToOne 0.00 65535.00 FORMAT "%8.2" /end CHARACTERISTIC
/begin CHARACTERISTIC DFES_DTCO.DFC_EmWakeupSigOL_C "" VALUE 0x8024D6F2 Val_Wu16 65535.00 DFES_OneToOne 0.00 65535.00 FORMAT "%8.2" /end CHARACTERISTIC
/begin CHARACTERISTIC DFES_DTCO.DFC_EmWakeupSigOvrTemp_C "" VALUE 0x8024D6F4 Val_Wu16 65535.00 DFES_OneToOne 0.00 65535.00 FORMAT "%8.2" /end CHARACTERISTIC
/begin CHARACTERISTIC DFES_DTCO.DFC_EmWakeupSigSCB_C "" VALUE 0x8024D6F6 Val_Wu16 65535.00 DFES_OneToOne 0.00 65535.00 FORMAT "%8.2" /end CHARACTERISTIC
/begin CHARACTERISTIC DFES_DTCO.DFC_EmWakeupSigSCG_C "" VALUE 0x8024D6F8 Val_Wu16 65535.00 DFES_OneToOne 0.00 65535.00 FORMAT "%8.2" /end CHARACTERISTIC
/begin CHARACTERISTIC DFES_DTCO.DFC_Fan1OL_C "" VALUE 0x8024D6FA Val_Wu16 65535.00 DFES_OneToOne 0.00 65535.00 FORMAT "%8.2" /end CHARACTERISTIC
/begin CHARACTERISTIC DFES_DTCO.DFC_Fan1OvrTemp_C "" VALUE 0x8024D6FC Val_Wu16 65535.00 DFES_OneToOne 0.00 65535.00 FORMAT "%8.2" /end CHARACTERISTIC
/begin CHARACTERISTIC DFES_DTCO.DFC_Fan1SCB_C "" VALUE 0x8024D6FE Val_Wu16 65535.00 DFES_OneToOne 0.00 65535.00 FORMAT "%8.2" /end CHARACTERISTIC
/begin CHARACTERISTIC DFES_DTCO.DFC_FanRlySCB_C "" VALUE 0x8024D700 Val_Wu16 65535.00 DFES_OneToOne 0.00 65535.00 FORMAT "%8.2" /end CHARACTERISTIC
/begin CHARACTERISTIC DFES_DTCO.DFC_FanRlySCG_C "" VALUE 0x8024D702 Val_Wu16 65535.00 DFES_OneToOne 0.00 65535.00 FORMAT "%8.2" /end CHARACTERISTIC
/begin CHARACTERISTIC DFES_DTCO.DFC_FanSpdSRCMin_C "" VALUE 0x8024D704 Val_Wu16 65535.00 DFES_OneToOne 0.00 65535.00 FORMAT "%8.2" /end CHARACTERISTIC
/begin CHARACTERISTIC DFES_DTCO.DFC_FreonPSRCMin_C "" VALUE 0x8024D706 Val_Wu16 65535.00 DFES_OneToOne 0.00 65535.00 FORMAT "%8.2" /end CHARACTERISTIC
/begin CHARACTERISTIC DFES_DTCO.DFC_HLCCcsPLnCChipTHi_C "" VALUE 0x8024D708 Val_Wu16 65535.00 DFES_OneToOne 0.00 65535.00 FORMAT "%8.2" /end CHARACTERISTIC
/begin CHARACTERISTIC DFES_DTCO.DFC_HeatrCoreTSRCMin_C "" VALUE 0x8024D70A Val_Wu16 65535.00 DFES_OneToOne 0.00 65535.00 FORMAT "%8.2" /end CHARACTERISTIC
/begin CHARACTERISTIC DFES_DTCO.DFC_PwmCtPSRCMin_C "" VALUE 0x8024D70C Val_Wu16 65535.00 DFES_OneToOne 0.00 65535.00 FORMAT "%8.2" /end CHARACTERISTIC
/begin CHARACTERISTIC DFES_DTCO.DFC_PwrDistbnUnitTSRCMin_C "" VALUE 0x8024D70E Val_Wu16 65535.00 DFES_OneToOne 0.00 65535.00 FORMAT "%8.2" /end CHARACTERISTIC
/begin CHARACTERISTIC DFES_DTCO.DFC_SCtPmp1OL_C "" VALUE 0x8024D710 Val_Wu16 65535.00 DFES_OneToOne 0.00 65535.00 FORMAT "%8.2" /end CHARACTERISTIC
/begin CHARACTERISTIC DFES_DTCO.DFC_SCtPmp1OvrTemp_C "" VALUE 0x8024D712 Val_Wu16 65535.00 DFES_OneToOne 0.00 65535.00 FORMAT "%8.2" /end CHARACTERISTIC
/begin CHARACTERISTIC DFES_DTCO.DFC_SCtPmp1SCB_C "" VALUE 0x8024D714 Val_Wu16 65535.00 DFES_OneToOne 0.00 65535.00 FORMAT "%8.2" /end CHARACTERISTIC
/begin CHARACTERISTIC DFES_DTCO.DFC_SCtPmpRlyOL_C "" VALUE 0x8024D716 Val_Wu16 65535.00 DFES_OneToOne 0.00 65535.00 FORMAT "%8.2" /end CHARACTERISTIC
/begin CHARACTERISTIC DFES_DTCO.DFC_SCtPmpRlyOvrTemp_C "" VALUE 0x8024D718 Val_Wu16 65535.00 DFES_OneToOne 0.00 65535.00 FORMAT "%8.2" /end CHARACTERISTIC
/begin CHARACTERISTIC DFES_DTCO.DFC_SCtPmpRlySCB_C "" VALUE 0x8024D71A Val_Wu16 65535.00 DFES_OneToOne 0.00 65535.00 FORMAT "%8.2" /end CHARACTERISTIC
/begin CHARACTERISTIC DFES_DTCO.DFC_SpplCooltPmpRlyOL_C "" VALUE 0x8024D71C Val_Wu16 65535.00 DFES_OneToOne 0.00 65535.00 FORMAT "%8.2" /end CHARACTERISTIC
/begin CHARACTERISTIC DFES_DTCO.DFC_SpplCooltPmpRlyOvrTemp_C "" VALUE 0x8024D71E Val_Wu16 65535.00 DFES_OneToOne 0.00 65535.00 FORMAT "%8.2" /end CHARACTERISTIC
/begin CHARACTERISTIC DFES_DTCO.DFC_SpplCooltPmpRlySCB_C "" VALUE 0x8024D720 Val_Wu16 65535.00 DFES_OneToOne 0.00 65535.00 FORMAT "%8.2" /end CHARACTERISTIC
/begin CHARACTERISTIC DFES_DTCO.DFC_UCtPSRCMin_C "" VALUE 0x8024D722 Val_Wu16 65535.00 DFES_OneToOne 0.00 65535.00 FORMAT "%8.2" /end CHARACTERISTIC
/begin CHARACTERISTIC DFES_DTCO.DFC_UPxP1SRCMin_C "" VALUE 0x8024D724 Val_Wu16 65535.00 DFES_OneToOne 0.00 65535.00 FORMAT "%8.2" /end CHARACTERISTIC
/begin CHARACTERISTIC DFES_DTCO.DFC_ComHSN1CANMute_C "" VALUE 0x8024D726 Val_Wu16 65535.00 DFES_OneToOne 0.00 65535.00 FORMAT "%8.2" /end CHARACTERISTIC
/begin CHARACTERISTIC DFES_DTCO.DFC_ComHSN3CANMute_C "" VALUE 0x8024D728 Val_Wu16 65535.00 DFES_OneToOne 0.00 65535.00 FORMAT "%8.2" /end CHARACTERISTIC
/begin CHARACTERISTIC DFES_DTCO.DFC_AcChrgrIntkTPhysRngHi_C "" VALUE 0x8024D72A Val_Wu16 65535.00 DFES_OneToOne 0.00 65535.00 FORMAT "%8.2" /end CHARACTERISTIC
/begin CHARACTERISTIC DFES_DTCO.DFC_AcChrgrIntkTPhysRngLo_C "" VALUE 0x8024D72C Val_Wu16 65535.00 DFES_OneToOne 0.00 65535.00 FORMAT "%8.2" /end CHARACTERISTIC
/begin CHARACTERISTIC DFES_DTCO.DFC_AcChrgrIntkTSRCOpn_C "" VALUE 0x8024D72E Val_Wu16 65535.00 DFES_OneToOne 0.00 65535.00 FORMAT "%8.2" /end CHARACTERISTIC
/begin CHARACTERISTIC DFES_DTCO.DFC_CcsPwrLineChpVccPhysRngHi_C "" VALUE 0x8024D730 Val_Wu16 65535.00 DFES_OneToOne 0.00 65535.00 FORMAT "%8.2" /end CHARACTERISTIC
/begin CHARACTERISTIC DFES_DTCO.DFC_CcsPwrLineChpVccPhysRngLo_C "" VALUE 0x8024D732 Val_Wu16 65535.00 DFES_OneToOne 0.00 65535.00 FORMAT "%8.2" /end CHARACTERISTIC
/begin CHARACTERISTIC DFES_DTCO.DFC_CcsPwrLineChpVccSRCOpn_C "" VALUE 0x8024D734 Val_Wu16 65535.00 DFES_OneToOne 0.00 65535.00 FORMAT "%8.2" /end CHARACTERISTIC
/begin CHARACTERISTIC DFES_DTCO.DFC_CcsPwrLineComChpTPhysRngHi_C "" VALUE 0x8024D736 Val_Wu16 65535.00 DFES_OneToOne 0.00 65535.00 FORMAT "%8.2" /end CHARACTERISTIC
/begin CHARACTERISTIC DFES_DTCO.DFC_CcsPwrLineComChpTPhysRngLo_C "" VALUE 0x8024D738 Val_Wu16 65535.00 DFES_OneToOne 0.00 65535.00 FORMAT "%8.2" /end CHARACTERISTIC
/begin CHARACTERISTIC DFES_DTCO.DFC_CcsPwrLineComChpTSRCOpn_C "" VALUE 0x8024D73A Val_Wu16 65535.00 DFES_OneToOne 0.00 65535.00 FORMAT "%8.2" /end CHARACTERISTIC
/begin CHARACTERISTIC DFES_DTCO.DFC_CtPSwtDiagPhysRngHi_C "" VALUE 0x8024D73C Val_Wu16 65535.00 DFES_OneToOne 0.00 65535.00 FORMAT "%8.2" /end CHARACTERISTIC
/begin CHARACTERISTIC DFES_DTCO.DFC_CtPSwtDiagPhysRngLo_C "" VALUE 0x8024D73E Val_Wu16 65535.00 DFES_OneToOne 0.00 65535.00 FORMAT "%8.2" /end CHARACTERISTIC
/begin CHARACTERISTIC DFES_DTCO.DFC_CtPSwtDiagSRCOpn_C "" VALUE 0x8024D740 Val_Wu16 65535.00 DFES_OneToOne 0.00 65535.00 FORMAT "%8.2" /end CHARACTERISTIC
/begin CHARACTERISTIC DFES_DTCO.DFC_CtpCarrFrqPhysRngHi_C "" VALUE 0x8024D742 Val_Wu16 65535.00 DFES_OneToOne 0.00 65535.00 FORMAT "%8.2" /end CHARACTERISTIC
/begin CHARACTERISTIC DFES_DTCO.DFC_CtpCarrFrqPhysRngLo_C "" VALUE 0x8024D744 Val_Wu16 65535.00 DFES_OneToOne 0.00 65535.00 FORMAT "%8.2" /end CHARACTERISTIC
/begin CHARACTERISTIC DFES_DTCO.DFC_CtpCarrFrqSRCMax_C "" VALUE 0x8024D746 Val_Wu16 65535.00 DFES_OneToOne 0.00 65535.00 FORMAT "%8.2" /end CHARACTERISTIC
/begin CHARACTERISTIC DFES_DTCO.DFC_DcChrgrIntkT2PhysRngHi_C "" VALUE 0x8024D748 Val_Wu16 65535.00 DFES_OneToOne 0.00 65535.00 FORMAT "%8.2" /end CHARACTERISTIC
/begin CHARACTERISTIC DFES_DTCO.DFC_DcChrgrIntkT2PhysRngLo_C "" VALUE 0x8024D74A Val_Wu16 65535.00 DFES_OneToOne 0.00 65535.00 FORMAT "%8.2" /end CHARACTERISTIC
/begin CHARACTERISTIC DFES_DTCO.DFC_DcChrgrIntkT2SRCOpn_C "" VALUE 0x8024D74C Val_Wu16 65535.00 DFES_OneToOne 0.00 65535.00 FORMAT "%8.2" /end CHARACTERISTIC
/begin CHARACTERISTIC DFES_DTCO.DFC_DcChrgrIntkTPhysRngHi_C "" VALUE 0x8024D74E Val_Wu16 65535.00 DFES_OneToOne 0.00 65535.00 FORMAT "%8.2" /end CHARACTERISTIC
/begin CHARACTERISTIC DFES_DTCO.DFC_DcChrgrIntkTPhysRngLo_C "" VALUE 0x8024D750 Val_Wu16 65535.00 DFES_OneToOne 0.00 65535.00 FORMAT "%8.2" /end CHARACTERISTIC
/begin CHARACTERISTIC DFES_DTCO.DFC_DcChrgrIntkTSRCOpn_C "" VALUE 0x8024D752 Val_Wu16 65535.00 DFES_OneToOne 0.00 65535.00 FORMAT "%8.2" /end CHARACTERISTIC
/begin CHARACTERISTIC DFES_DTCO.DFC_Fan1SCG_C "" VALUE 0x8024D754 Val_Wu16 65535.00 DFES_OneToOne 0.00 65535.00 FORMAT "%8.2" /end CHARACTERISTIC
/begin CHARACTERISTIC DFES_DTCO.DFC_FanSpdPhysRngHi_C "" VALUE 0x8024D756 Val_Wu16 65535.00 DFES_OneToOne 0.00 65535.00 FORMAT "%8.2" /end CHARACTERISTIC
/begin CHARACTERISTIC DFES_DTCO.DFC_FanSpdPhysRngLo_C "" VALUE 0x8024D758 Val_Wu16 65535.00 DFES_OneToOne 0.00 65535.00 FORMAT "%8.2" /end CHARACTERISTIC
/begin CHARACTERISTIC DFES_DTCO.DFC_FanSpdSRCOpn_C "" VALUE 0x8024D75A Val_Wu16 65535.00 DFES_OneToOne 0.00 65535.00 FORMAT "%8.2" /end CHARACTERISTIC
/begin CHARACTERISTIC DFES_DTCO.DFC_FreonPPhysRngHi_C "" VALUE 0x8024D75C Val_Wu16 65535.00 DFES_OneToOne 0.00 65535.00 FORMAT "%8.2" /end CHARACTERISTIC
/begin CHARACTERISTIC DFES_DTCO.DFC_FreonPPhysRngLo_C "" VALUE 0x8024D75E Val_Wu16 65535.00 DFES_OneToOne 0.00 65535.00 FORMAT "%8.2" /end CHARACTERISTIC
/begin CHARACTERISTIC DFES_DTCO.DFC_FreonPSRCOpn_C "" VALUE 0x8024D760 Val_Wu16 65535.00 DFES_OneToOne 0.00 65535.00 FORMAT "%8.2" /end CHARACTERISTIC
/begin CHARACTERISTIC DFES_DTCO.DFC_HeatrCoreTPhysRngHi_C "" VALUE 0x8024D762 Val_Wu16 65535.00 DFES_OneToOne 0.00 65535.00 FORMAT "%8.2" /end CHARACTERISTIC
/begin CHARACTERISTIC DFES_DTCO.DFC_HeatrCoreTPhysRngLo_C "" VALUE 0x8024D764 Val_Wu16 65535.00 DFES_OneToOne 0.00 65535.00 FORMAT "%8.2" /end CHARACTERISTIC
/begin CHARACTERISTIC DFES_DTCO.DFC_HeatrCoreTSRCOpn_C "" VALUE 0x8024D766 Val_Wu16 65535.00 DFES_OneToOne 0.00 65535.00 FORMAT "%8.2" /end CHARACTERISTIC
/begin CHARACTERISTIC DFES_DTCO.DFC_HvGridUMaxSftyLim_C "" VALUE 0x8024D768 Val_Wu16 65535.00 DFES_OneToOne 0.00 65535.00 FORMAT "%8.2" /end CHARACTERISTIC
/begin CHARACTERISTIC DFES_DTCO.DFC_HvGridUMinSftyLim_C "" VALUE 0x8024D76A Val_Wu16 65535.00 DFES_OneToOne 0.00 65535.00 FORMAT "%8.2" /end CHARACTERISTIC
/begin CHARACTERISTIC DFES_DTCO.DFC_HvGridUPlausy_C "" VALUE 0x8024D76C Val_Wu16 65535.00 DFES_OneToOne 0.00 65535.00 FORMAT "%8.2" /end CHARACTERISTIC
/begin CHARACTERISTIC DFES_DTCO.DFC_IntlckChrgPlgHBrgOpnLd_C "" VALUE 0x8024D76E Val_Wu16 65535.00 DFES_OneToOne 0.00 65535.00 FORMAT "%8.2" /end CHARACTERISTIC
/begin CHARACTERISTIC DFES_DTCO.DFC_IntlckChrgPlgHBrgOvrCurr_C "" VALUE 0x8024D770 Val_Wu16 65535.00 DFES_OneToOne 0.00 65535.00 FORMAT "%8.2" /end CHARACTERISTIC
/begin CHARACTERISTIC DFES_DTCO.DFC_IntlckChrgPlgHBrgOvrTemp_C "" VALUE 0x8024D772 Val_Wu16 65535.00 DFES_OneToOne 0.00 65535.00 FORMAT "%8.2" /end CHARACTERISTIC
/begin CHARACTERISTIC DFES_DTCO.DFC_IntlckChrgPlgHBrgShCirBatt1_C "" VALUE 0x8024D774 Val_Wu16 65535.00 DFES_OneToOne 0.00 65535.00 FORMAT "%8.2" /end CHARACTERISTIC
/begin CHARACTERISTIC DFES_DTCO.DFC_IntlckChrgPlgHBrgShCirBatt2_C "" VALUE 0x8024D776 Val_Wu16 65535.00 DFES_OneToOne 0.00 65535.00 FORMAT "%8.2" /end CHARACTERISTIC
/begin CHARACTERISTIC DFES_DTCO.DFC_IntlckChrgPlgHBrgShCirGnd1_C "" VALUE 0x8024D778 Val_Wu16 65535.00 DFES_OneToOne 0.00 65535.00 FORMAT "%8.2" /end CHARACTERISTIC
/begin CHARACTERISTIC DFES_DTCO.DFC_IntlckChrgPlgHBrgShCirGnd2_C "" VALUE 0x8024D77A Val_Wu16 65535.00 DFES_OneToOne 0.00 65535.00 FORMAT "%8.2" /end CHARACTERISTIC
/begin CHARACTERISTIC DFES_DTCO.DFC_IntlckChrgPlgHBrgShCirOvrLd_C "" VALUE 0x8024D77C Val_Wu16 65535.00 DFES_OneToOne 0.00 65535.00 FORMAT "%8.2" /end CHARACTERISTIC
/begin CHARACTERISTIC DFES_DTCO.DFC_IntlckChrgPlgHBrgTempOvrCurr_C "" VALUE 0x8024D77E Val_Wu16 65535.00 DFES_OneToOne 0.00 65535.00 FORMAT "%8.2" /end CHARACTERISTIC
/begin CHARACTERISTIC DFES_DTCO.DFC_IntlckChrgPlgHBrgUndrVltg_C "" VALUE 0x8024D780 Val_Wu16 65535.00 DFES_OneToOne 0.00 65535.00 FORMAT "%8.2" /end CHARACTERISTIC
/begin CHARACTERISTIC DFES_DTCO.DFC_IntlckChrgPlgPosnRngFlt_C "" VALUE 0x8024D782 Val_Wu16 65535.00 DFES_OneToOne 0.00 65535.00 FORMAT "%8.2" /end CHARACTERISTIC
/begin CHARACTERISTIC DFES_DTCO.DFC_IntlckChrgPlgPosnSrcMax_C "" VALUE 0x8024D784 Val_Wu16 65535.00 DFES_OneToOne 0.00 65535.00 FORMAT "%8.2" /end CHARACTERISTIC
/begin CHARACTERISTIC DFES_DTCO.DFC_IntlckChrgPlgPosnSrcMin_C "" VALUE 0x8024D786 Val_Wu16 65535.00 DFES_OneToOne 0.00 65535.00 FORMAT "%8.2" /end CHARACTERISTIC
/begin CHARACTERISTIC DFES_DTCO.DFC_PwmCtPPhysRngHi_C "" VALUE 0x8024D788 Val_Wu16 65535.00 DFES_OneToOne 0.00 65535.00 FORMAT "%8.2" /end CHARACTERISTIC
/begin CHARACTERISTIC DFES_DTCO.DFC_PwmCtPPhysRngLo_C "" VALUE 0x8024D78A Val_Wu16 65535.00 DFES_OneToOne 0.00 65535.00 FORMAT "%8.2" /end CHARACTERISTIC
/begin CHARACTERISTIC DFES_DTCO.DFC_PwmCtPSRCMax_C "" VALUE 0x8024D78C Val_Wu16 65535.00 DFES_OneToOne 0.00 65535.00 FORMAT "%8.2" /end CHARACTERISTIC
/begin CHARACTERISTIC DFES_DTCO.DFC_PwrDistbnUnitTPhysRngHi_C "" VALUE 0x8024D78E Val_Wu16 65535.00 DFES_OneToOne 0.00 65535.00 FORMAT "%8.2" /end CHARACTERISTIC
/begin CHARACTERISTIC DFES_DTCO.DFC_PwrDistbnUnitTPhysRngLo_C "" VALUE 0x8024D790 Val_Wu16 65535.00 DFES_OneToOne 0.00 65535.00 FORMAT "%8.2" /end CHARACTERISTIC
/begin CHARACTERISTIC DFES_DTCO.DFC_PwrDistbnUnitTSRCOpn_C "" VALUE 0x8024D792 Val_Wu16 65535.00 DFES_OneToOne 0.00 65535.00 FORMAT "%8.2" /end CHARACTERISTIC
/begin CHARACTERISTIC DFES_DTCO.DFC_SCtPmpRlySCG_C "" VALUE 0x8024D794 Val_Wu16 65535.00 DFES_OneToOne 0.00 65535.00 FORMAT "%8.2" /end CHARACTERISTIC
/begin CHARACTERISTIC DFES_DTCO.DFC_SpplCooltPmpRlySCG_C "" VALUE 0x8024D796 Val_Wu16 65535.00 DFES_OneToOne 0.00 65535.00 FORMAT "%8.2" /end CHARACTERISTIC
/begin CHARACTERISTIC DFES_DTCO.DFC_UCtPPhysRngHi_C "" VALUE 0x8024D798 Val_Wu16 65535.00 DFES_OneToOne 0.00 65535.00 FORMAT "%8.2" /end CHARACTERISTIC
/begin CHARACTERISTIC DFES_DTCO.DFC_UCtPPhysRngLo_C "" VALUE 0x8024D79A Val_Wu16 65535.00 DFES_OneToOne 0.00 65535.00 FORMAT "%8.2" /end CHARACTERISTIC
/begin CHARACTERISTIC DFES_DTCO.DFC_UCtPSRCOpn_C "" VALUE 0x8024D79C Val_Wu16 65535.00 DFES_OneToOne 0.00 65535.00 FORMAT "%8.2" /end CHARACTERISTIC
/begin CHARACTERISTIC DFES_DTCO.DFC_UPxP1PhysRngHi_C "" VALUE 0x8024D79E Val_Wu16 65535.00 DFES_OneToOne 0.00 65535.00 FORMAT "%8.2" /end CHARACTERISTIC
/begin CHARACTERISTIC DFES_DTCO.DFC_UPxP1PhysRngLo_C "" VALUE 0x8024D7A0 Val_Wu16 65535.00 DFES_OneToOne 0.00 65535.00 FORMAT "%8.2" /end CHARACTERISTIC
/begin CHARACTERISTIC DFES_DTCO.DFC_UPxP1SRCOpn_C "" VALUE 0x8024D7A2 Val_Wu16 65535.00 DFES_OneToOne 0.00 65535.00 FORMAT "%8.2" /end CHARACTERISTIC
/begin CHARACTERISTIC DFES_DTCO.DFC_VehVPhysRngHi_C "" VALUE 0x8024D7A4 Val_Wu16 65535.00 DFES_OneToOne 0.00 65535.00 FORMAT "%8.2" /end CHARACTERISTIC
/begin CHARACTERISTIC DFES_DTCO.DFC_VehVPhysRngLo_C "" VALUE 0x8024D7A6 Val_Wu16 65535.00 DFES_OneToOne 0.00 65535.00 FORMAT "%8.2" /end CHARACTERISTIC
/begin CHARACTERISTIC DFES_DTCO.DFC_VehVSigCan_C "" VALUE 0x8024D7A8 Val_Wu16 65535.00 DFES_OneToOne 0.00 65535.00 FORMAT "%8.2" /end CHARACTERISTIC
/begin CHARACTERISTIC DFES_DTCO.DFC_VehVSigCanSafe_C "" VALUE 0x8024D7AA Val_Wu16 65535.00 DFES_OneToOne 0.00 65535.00 FORMAT "%8.2" /end CHARACTERISTIC
/begin CHARACTERISTIC DFES_DTCO.DFC_SCtPmp1DiagGrdKey1_C "" VALUE 0x8024D7AC Val_Wu16 65535.00 DFES_OneToOne 0.00 65535.00 FORMAT "%8.2" /end CHARACTERISTIC
/begin CHARACTERISTIC DFES_DTCO.DFC_SCtPmp1DiagGrdKey2_C "" VALUE 0x8024D7AE Val_Wu16 65535.00 DFES_OneToOne 0.00 65535.00 FORMAT "%8.2" /end CHARACTERISTIC
/begin CHARACTERISTIC DFES_DTCO.DFC_SCtPmp1DiagGrdKey3_C "" VALUE 0x8024D7B0 Val_Wu16 65535.00 DFES_OneToOne 0.00 65535.00 FORMAT "%8.2" /end CHARACTERISTIC
/begin CHARACTERISTIC DFES_DTCO.DFC_SCtPmp1DiagGrdKey4_C "" VALUE 0x8024D7B2 Val_Wu16 65535.00 DFES_OneToOne 0.00 65535.00 FORMAT "%8.2" /end CHARACTERISTIC
/begin CHARACTERISTIC DFES_DTCO.DFC_SCtPmp1DiagGrdKey5_C "" VALUE 0x8024D7B4 Val_Wu16 65535.00 DFES_OneToOne 0.00 65535.00 FORMAT "%8.2" /end CHARACTERISTIC
/begin CHARACTERISTIC DFES_DTCO.DFC_ChrgPlgLiveCntctHzrdCcs_C "" VALUE 0x8024D7B6 Val_Wu16 65535.00 DFES_OneToOne 0.00 65535.00 FORMAT "%8.2" /end CHARACTERISTIC
/begin CHARACTERISTIC DFES_DTCO.DFC_ChrgPlgProxPltImps_C "" VALUE 0x8024D7B8 Val_Wu16 65535.00 DFES_OneToOne 0.00 65535.00 FORMAT "%8.2" /end CHARACTERISTIC
/begin CHARACTERISTIC DFES_DTCO.DFC_ChrgPlgTHiCcsDc_C "" VALUE 0x8024D7BA Val_Wu16 65535.00 DFES_OneToOne 0.00 65535.00 FORMAT "%8.2" /end CHARACTERISTIC
/begin CHARACTERISTIC DFES_DTCO.DFC_ElMActvDchaFailr_C "" VALUE 0x8024D7BC Val_Wu16 65535.00 DFES_OneToOne 0.00 65535.00 FORMAT "%8.2" /end CHARACTERISTIC
/begin CHARACTERISTIC DFES_DTCO.DFC_ElMActvDchaFlt_C "" VALUE 0x8024D7BE Val_Wu16 65535.00 DFES_OneToOne 0.00 65535.00 FORMAT "%8.2" /end CHARACTERISTIC
/begin CHARACTERISTIC DFES_DTCO.DFC_ElMFbdnIvtrModDrv01_C "" VALUE 0x8024D7C0 Val_Wu16 65535.00 DFES_OneToOne 0.00 65535.00 FORMAT "%8.2" /end CHARACTERISTIC
/begin CHARACTERISTIC DFES_DTCO.DFC_ElMImobAuthent_C "" VALUE 0x8024D7C2 Val_Wu16 65535.00 DFES_OneToOne 0.00 65535.00 FORMAT "%8.2" /end CHARACTERISTIC
/begin CHARACTERISTIC DFES_DTCO.DFC_ElMIsoMonFlt_C "" VALUE 0x8024D7C4 Val_Wu16 65535.00 DFES_OneToOne 0.00 65535.00 FORMAT "%8.2" /end CHARACTERISTIC
/begin CHARACTERISTIC DFES_DTCO.DFC_ElMIsoMonPlausyFlt_C "" VALUE 0x8024D7C6 Val_Wu16 65535.00 DFES_OneToOne 0.00 65535.00 FORMAT "%8.2" /end CHARACTERISTIC
/begin CHARACTERISTIC DFES_DTCO.DFC_ElMIvtrCooltT01_C "" VALUE 0x8024D7C8 Val_Wu16 65535.00 DFES_OneToOne 0.00 65535.00 FORMAT "%8.2" /end CHARACTERISTIC
/begin CHARACTERISTIC DFES_DTCO.DFC_ElMIvtrEmgyShtDwn01_C "" VALUE 0x8024D7CA Val_Wu16 65535.00 DFES_OneToOne 0.00 65535.00 FORMAT "%8.2" /end CHARACTERISTIC
/begin CHARACTERISTIC DFES_DTCO.DFC_ElMIvtrFailr01_C "" VALUE 0x8024D7CC Val_Wu16 65535.00 DFES_OneToOne 0.00 65535.00 FORMAT "%8.2" /end CHARACTERISTIC
/begin CHARACTERISTIC DFES_DTCO.DFC_ElMIvtrIntlck01_C "" VALUE 0x8024D7CE Val_Wu16 65535.00 DFES_OneToOne 0.00 65535.00 FORMAT "%8.2" /end CHARACTERISTIC
/begin CHARACTERISTIC DFES_DTCO.DFC_ElMIvtrTErr01_C "" VALUE 0x8024D7D0 Val_Wu16 65535.00 DFES_OneToOne 0.00 65535.00 FORMAT "%8.2" /end CHARACTERISTIC
/begin CHARACTERISTIC DFES_DTCO.DFC_ElMOverSpdNeg01_C "" VALUE 0x8024D7D2 Val_Wu16 65535.00 DFES_OneToOne 0.00 65535.00 FORMAT "%8.2" /end CHARACTERISTIC
/begin CHARACTERISTIC DFES_DTCO.DFC_ElMOverSpdPos01_C "" VALUE 0x8024D7D4 Val_Wu16 65535.00 DFES_OneToOne 0.00 65535.00 FORMAT "%8.2" /end CHARACTERISTIC
/begin CHARACTERISTIC DFES_DTCO.DFC_ElMOverTqNeg01_C "" VALUE 0x8024D7D6 Val_Wu16 65535.00 DFES_OneToOne 0.00 65535.00 FORMAT "%8.2" /end CHARACTERISTIC
/begin CHARACTERISTIC DFES_DTCO.DFC_ElMOverTqPos01_C "" VALUE 0x8024D7D8 Val_Wu16 65535.00 DFES_OneToOne 0.00 65535.00 FORMAT "%8.2" /end CHARACTERISTIC
/begin CHARACTERISTIC DFES_DTCO.DFC_ElMPwrAuthn_C "" VALUE 0x8024D7DA Val_Wu16 65535.00 DFES_OneToOne 0.00 65535.00 FORMAT "%8.2" /end CHARACTERISTIC
/begin CHARACTERISTIC DFES_DTCO.DFC_ElMSpdErr01_C "" VALUE 0x8024D7DC Val_Wu16 65535.00 DFES_OneToOne 0.00 65535.00 FORMAT "%8.2" /end CHARACTERISTIC
/begin CHARACTERISTIC DFES_DTCO.DFC_ElMSvs01_C "" VALUE 0x8024D7DE Val_Wu16 65535.00 DFES_OneToOne 0.00 65535.00 FORMAT "%8.2" /end CHARACTERISTIC
/begin CHARACTERISTIC DFES_DTCO.DFC_PEnvCcMax_C "" VALUE 0x8024D7E0 Val_Wu16 65535.00 DFES_OneToOne 0.00 65535.00 FORMAT "%8.2" /end CHARACTERISTIC
/begin CHARACTERISTIC DFES_DTCO.DFC_PEnvCcMin_C "" VALUE 0x8024D7E2 Val_Wu16 65535.00 DFES_OneToOne 0.00 65535.00 FORMAT "%8.2" /end CHARACTERISTIC
/begin CHARACTERISTIC DFES_DTCO.DFC_PEnvRngChkMax_C "" VALUE 0x8024D7E4 Val_Wu16 65535.00 DFES_OneToOne 0.00 65535.00 FORMAT "%8.2" /end CHARACTERISTIC
/begin CHARACTERISTIC DFES_DTCO.DFC_PEnvRngChkMin_C "" VALUE 0x8024D7E6 Val_Wu16 65535.00 DFES_OneToOne 0.00 65535.00 FORMAT "%8.2" /end CHARACTERISTIC
/begin CHARACTERISTIC DFES_DTCO.DFC_PEnvSnsrPlaus_C "" VALUE 0x8024D7E8 Val_Wu16 65535.00 DFES_OneToOne 0.00 65535.00 FORMAT "%8.2" /end CHARACTERISTIC
/begin CHARACTERISTIC DFES_DTCO.DFC_BrkBstPmpPlausGenn_C "" VALUE 0x8024D7EA Val_Wu16 65535.00 DFES_OneToOne 0.00 65535.00 FORMAT "%8.2" /end CHARACTERISTIC
/begin CHARACTERISTIC DFES_DTCO.DFC_CbnHeatrRlyLfLoWarn_C "" VALUE 0x8024D7EC Val_Wu16 65535.00 DFES_OneToOne 0.00 65535.00 FORMAT "%8.2" /end CHARACTERISTIC
/begin CHARACTERISTIC DFES_DTCO.DFC_ChgrPlugLockPinByndClsd_C "" VALUE 0x8024D7EE Val_Wu16 65535.00 DFES_OneToOne 0.00 65535.00 FORMAT "%8.2" /end CHARACTERISTIC
/begin CHARACTERISTIC DFES_DTCO.DFC_ChgrPlugLockPinMoveWoCmd_C "" VALUE 0x8024D7F0 Val_Wu16 65535.00 DFES_OneToOne 0.00 65535.00 FORMAT "%8.2" /end CHARACTERISTIC
/begin CHARACTERISTIC DFES_DTCO.DFC_ChgrPlugLockPinStuckInClsd_C "" VALUE 0x8024D7F2 Val_Wu16 65535.00 DFES_OneToOne 0.00 65535.00 FORMAT "%8.2" /end CHARACTERISTIC
/begin CHARACTERISTIC DFES_DTCO.DFC_ChgrPlugLockPinStuckInOpen_C "" VALUE 0x8024D7F4 Val_Wu16 65535.00 DFES_OneToOne 0.00 65535.00 FORMAT "%8.2" /end CHARACTERISTIC
/begin CHARACTERISTIC DFES_DTCO.DFC_ChrgrStErr_C "" VALUE 0x8024D7F6 Val_Wu16 65535.00 DFES_OneToOne 0.00 65535.00 FORMAT "%8.2" /end CHARACTERISTIC
/begin CHARACTERISTIC DFES_DTCO.DFC_ComHSN1BusOff_C "" VALUE 0x8024D7F8 Val_Wu16 65535.00 DFES_OneToOne 0.00 65535.00 FORMAT "%8.2" /end CHARACTERISTIC
/begin CHARACTERISTIC DFES_DTCO.DFC_ComHSN3BusOff_C "" VALUE 0x8024D7FA Val_Wu16 65535.00 DFES_OneToOne 0.00 65535.00 FORMAT "%8.2" /end CHARACTERISTIC
/begin CHARACTERISTIC DFES_DTCO.DFC_ComVCInval_C "" VALUE 0x8024D7FC Val_Wu16 65535.00 DFES_OneToOne 0.00 65535.00 FORMAT "%8.2" /end CHARACTERISTIC
/begin CHARACTERISTIC DFES_DTCO.DFC_EemDcdcPrecSpdInhb_C "" VALUE 0x8024D7FE Val_Wu16 65535.00 DFES_OneToOne 0.00 65535.00 FORMAT "%8.2" /end CHARACTERISTIC
/begin CHARACTERISTIC DFES_DTCO.DFC_ExpPwrLatch_C "" VALUE 0x8024D800 Val_Wu16 65535.00 DFES_OneToOne 0.00 65535.00 FORMAT "%8.2" /end CHARACTERISTIC
/begin CHARACTERISTIC DFES_DTCO.DFC_FanMaxOvrd_C "" VALUE 0x8024D802 Val_Wu16 65535.00 DFES_OneToOne 0.00 65535.00 FORMAT "%8.2" /end CHARACTERISTIC
/begin CHARACTERISTIC DFES_DTCO.DFC_HLCCcsGnrlComErr_C "" VALUE 0x8024D804 Val_Wu16 65535.00 DFES_OneToOne 0.00 65535.00 FORMAT "%8.2" /end CHARACTERISTIC
/begin CHARACTERISTIC DFES_DTCO.DFC_InmLINNodeHVACPanelAbsnt_C "" VALUE 0x8024D806 Val_Wu16 65535.00 DFES_OneToOne 0.00 65535.00 FORMAT "%8.2" /end CHARACTERISTIC
/begin CHARACTERISTIC DFES_DTCO.DFC_ResetRcvNotAllwd_C "" VALUE 0x8024D808 Val_Wu16 65535.00 DFES_OneToOne 0.00 65535.00 FORMAT "%8.2" /end CHARACTERISTIC
/begin CHARACTERISTIC DFES_DTCO.DFC_TelltlCooltPlaus_C "" VALUE 0x8024D80A Val_Wu16 65535.00 DFES_OneToOne 0.00 65535.00 FORMAT "%8.2" /end CHARACTERISTIC
/begin CHARACTERISTIC DFES_DTCO.DFC_MRlyOL_C "" VALUE 0x8024D80C Val_Wu16 65535.00 DFES_OneToOne 0.00 65535.00 FORMAT "%8.2" /end CHARACTERISTIC
/begin CHARACTERISTIC DFES_DTCO.DFC_MRlySCB_C "" VALUE 0x8024D80E Val_Wu16 65535.00 DFES_OneToOne 0.00 65535.00 FORMAT "%8.2" /end CHARACTERISTIC
/begin CHARACTERISTIC DFES_DTCO.DFC_MRlySCG_C "" VALUE 0x8024D810 Val_Wu16 65535.00 DFES_OneToOne 0.00 65535.00 FORMAT "%8.2" /end CHARACTERISTIC
/begin CHARACTERISTIC DFES_DTCO.DFC_SSpMon1_C "" VALUE 0x8024D812 Val_Wu16 65535.00 DFES_OneToOne 0.00 65535.00 FORMAT "%8.2" /end CHARACTERISTIC
/begin CHARACTERISTIC DFES_DTCO.DFC_SSpMon1OV_C "" VALUE 0x8024D814 Val_Wu16 65535.00 DFES_OneToOne 0.00 65535.00 FORMAT "%8.2" /end CHARACTERISTIC
/begin CHARACTERISTIC DFES_DTCO.DFC_SSpMon1SCG_C "" VALUE 0x8024D816 Val_Wu16 65535.00 DFES_OneToOne 0.00 65535.00 FORMAT "%8.2" /end CHARACTERISTIC
/begin CHARACTERISTIC DFES_DTCO.DFC_SSpMon1UV_C "" VALUE 0x8024D818 Val_Wu16 65535.00 DFES_OneToOne 0.00 65535.00 FORMAT "%8.2" /end CHARACTERISTIC
/begin CHARACTERISTIC DFES_DTCO.DFC_SSpMon2_C "" VALUE 0x8024D81A Val_Wu16 65535.00 DFES_OneToOne 0.00 65535.00 FORMAT "%8.2" /end CHARACTERISTIC
/begin CHARACTERISTIC DFES_DTCO.DFC_SSpMon2OV_C "" VALUE 0x8024D81C Val_Wu16 65535.00 DFES_OneToOne 0.00 65535.00 FORMAT "%8.2" /end CHARACTERISTIC
/begin CHARACTERISTIC DFES_DTCO.DFC_SSpMon2SCG_C "" VALUE 0x8024D81E Val_Wu16 65535.00 DFES_OneToOne 0.00 65535.00 FORMAT "%8.2" /end CHARACTERISTIC
/begin CHARACTERISTIC DFES_DTCO.DFC_SSpMon2UV_C "" VALUE 0x8024D820 Val_Wu16 65535.00 DFES_OneToOne 0.00 65535.00 FORMAT "%8.2" /end CHARACTERISTIC
/begin CHARACTERISTIC DFES_DTCO.DFC_SSpMon3_C "" VALUE 0x8024D822 Val_Wu16 65535.00 DFES_OneToOne 0.00 65535.00 FORMAT "%8.2" /end CHARACTERISTIC
/begin CHARACTERISTIC DFES_DTCO.DFC_SSpMon3OV_C "" VALUE 0x8024D824 Val_Wu16 65535.00 DFES_OneToOne 0.00 65535.00 FORMAT "%8.2" /end CHARACTERISTIC
/begin CHARACTERISTIC DFES_DTCO.DFC_SSpMon3SCG_C "" VALUE 0x8024D826 Val_Wu16 65535.00 DFES_OneToOne 0.00 65535.00 FORMAT "%8.2" /end CHARACTERISTIC
/begin CHARACTERISTIC DFES_DTCO.DFC_SSpMon3UV_C "" VALUE 0x8024D828 Val_Wu16 65535.00 DFES_OneToOne 0.00 65535.00 FORMAT "%8.2" /end CHARACTERISTIC
/begin CHARACTERISTIC DFES_DTCO.DFC_CANSM_E_BUS_OFF_NETWORK_HSN1_CAN_C "" VALUE 0x8024D82A Val_Wu16 65535.00 DFES_OneToOne 0.00 65535.00 FORMAT "%8.2" /end CHARACTERISTIC
/begin CHARACTERISTIC DFES_DTCO.DFC_CANSM_E_BUS_OFF_NETWORK_HSN3_CAN_C "" VALUE 0x8024D82C Val_Wu16 65535.00 DFES_OneToOne 0.00 65535.00 FORMAT "%8.2" /end CHARACTERISTIC
/begin CHARACTERISTIC DFES_DTCO.DFC_CANSM_E_BUS_OFF_NETWORK_HSN4_CAN_C "" VALUE 0x8024D82E Val_Wu16 65535.00 DFES_OneToOne 0.00 65535.00 FORMAT "%8.2" /end CHARACTERISTIC
/begin CHARACTERISTIC DFES_DTCO.DFC_CANSM_E_BUS_OFF_NETWORK_XCP_CAN_C "" VALUE 0x8024D830 Val_Wu16 65535.00 DFES_OneToOne 0.00 65535.00 FORMAT "%8.2" /end CHARACTERISTIC
/begin CHARACTERISTIC DFES_DTCO.DFC_CANTRCV_E_NO_TRCV_CONTROL_0_C "" VALUE 0x8024D832 Val_Wu16 65535.00 DFES_OneToOne 0.00 65535.00 FORMAT "%8.2" /end CHARACTERISTIC
/begin CHARACTERISTIC DFES_DTCO.DFC_CAN_E_TIMEOUT_C "" VALUE 0x8024D834 Val_Wu16 65535.00 DFES_OneToOne 0.00 65535.00 FORMAT "%8.2" /end CHARACTERISTIC
/begin CHARACTERISTIC DFES_DTCO.DFC_COMM_E_NET_START_IND_CHANNEL_0_C "" VALUE 0x8024D836 Val_Wu16 65535.00 DFES_OneToOne 0.00 65535.00 FORMAT "%8.2" /end CHARACTERISTIC
/begin CHARACTERISTIC DFES_DTCO.DFC_COMM_E_NET_START_IND_CHANNEL_1_C "" VALUE 0x8024D838 Val_Wu16 65535.00 DFES_OneToOne 0.00 65535.00 FORMAT "%8.2" /end CHARACTERISTIC
/begin CHARACTERISTIC DFES_DTCO.DFC_COMM_E_NET_START_IND_CHANNEL_2_C "" VALUE 0x8024D83A Val_Wu16 65535.00 DFES_OneToOne 0.00 65535.00 FORMAT "%8.2" /end CHARACTERISTIC
/begin CHARACTERISTIC DFES_DTCO.DFC_COMM_E_NET_START_IND_CHANNEL_3_C "" VALUE 0x8024D83C Val_Wu16 65535.00 DFES_OneToOne 0.00 65535.00 FORMAT "%8.2" /end CHARACTERISTIC
/begin CHARACTERISTIC DFES_DTCO.DFC_COMM_E_NET_START_IND_CHANNEL_4_C "" VALUE 0x8024D83E Val_Wu16 65535.00 DFES_OneToOne 0.00 65535.00 FORMAT "%8.2" /end CHARACTERISTIC
/begin CHARACTERISTIC DFES_DTCO.DFC_COMM_E_NET_START_IND_CHANNEL_5_C "" VALUE 0x8024D840 Val_Wu16 65535.00 DFES_OneToOne 0.00 65535.00 FORMAT "%8.2" /end CHARACTERISTIC
/begin CHARACTERISTIC DFES_DTCO.DFC_LIN_E_TIMEOUT_C "" VALUE 0x8024D842 Val_Wu16 65535.00 DFES_OneToOne 0.00 65535.00 FORMAT "%8.2" /end CHARACTERISTIC
/begin CHARACTERISTIC DFES_DTCO.DFC_rba_EcuCtrl_TOMaxProlg_C "" VALUE 0x8024D844 Val_Wu16 65535.00 DFES_OneToOne 0.00 65535.00 FORMAT "%8.2" /end CHARACTERISTIC
/begin CHARACTERISTIC DFES_DTCO.DFC_rba_EcuCtrl_TOMaxShutDwn_C "" VALUE 0x8024D846 Val_Wu16 65535.00 DFES_OneToOne 0.00 65535.00 FORMAT "%8.2" /end CHARACTERISTIC
/begin CHARACTERISTIC DFES_DTCO.DFC_rba_MultiStackTrace_Threshold_C "" VALUE 0x8024D848 Val_Wu16 65535.00 DFES_OneToOne 0.00 65535.00 FORMAT "%8.2" /end CHARACTERISTIC
/begin CHARACTERISTIC DFES_DTCO.DFC_rba_SyC_CustStates_Degraded_disord_Event_C "" VALUE 0x8024D84A Val_Wu16 65535.00 DFES_OneToOne 0.00 65535.00 FORMAT "%8.2" /end CHARACTERISTIC
/begin CHARACTERISTIC DFES_DTCO.DFC_rba_SyC_CustStates_Degraded_incst_Event_C "" VALUE 0x8024D84C Val_Wu16 65535.00 DFES_OneToOne 0.00 65535.00 FORMAT "%8.2" /end CHARACTERISTIC
/begin CHARACTERISTIC DFES_DTCO.DFC_rba_SyC_CustStates_TransNoWakReq_Event_C "" VALUE 0x8024D84E Val_Wu16 65535.00 DFES_OneToOne 0.00 65535.00 FORMAT "%8.2" /end CHARACTERISTIC
/begin CHARACTERISTIC DFES_DTCO.DFC_RBA_IOEXTLIB_KEEPALIVE_DRV_C "" VALUE 0x8024D850 Val_Wu16 65535.00 DFES_OneToOne 0.00 65535.00 FORMAT "%8.2" /end CHARACTERISTIC
/begin CHARACTERISTIC DFES_DTCO.DFC_RBA_IOEXTLIB_KEEPALIVE_INI_C "" VALUE 0x8024D852 Val_Wu16 65535.00 DFES_OneToOne 0.00 65535.00 FORMAT "%8.2" /end CHARACTERISTIC
/begin CHARACTERISTIC DFES_DTCO.DFC_rba_IoSigRtc_StopCounter_C "" VALUE 0x8024D854 Val_Wu16 65535.00 DFES_OneToOne 0.00 65535.00 FORMAT "%8.2" /end CHARACTERISTIC
/begin CHARACTERISTIC DFES_DTCO.DFC_rba_MRly_Diag_Stk_Event_C "" VALUE 0x8024D856 Val_Wu16 65535.00 DFES_OneToOne 0.00 65535.00 FORMAT "%8.2" /end CHARACTERISTIC
/begin CHARACTERISTIC DFES_DTCO.DFC_rba_MemDiag_MemReadErr_C "" VALUE 0x8024D858 Val_Wu16 65535.00 DFES_OneToOne 0.00 65535.00 FORMAT "%8.2" /end CHARACTERISTIC
/begin CHARACTERISTIC DFES_DTCO.DFC_rba_MemDiag_MemWrErr_C "" VALUE 0x8024D85A Val_Wu16 65535.00 DFES_OneToOne 0.00 65535.00 FORMAT "%8.2" /end CHARACTERISTIC
/begin CHARACTERISTIC DFES_DTCO.DFC_rba_SyC_IrrSwOffTrigEngRun_Event_C "" VALUE 0x8024D85C Val_Wu16 65535.00 DFES_OneToOne 0.00 65535.00 FORMAT "%8.2" /end CHARACTERISTIC
/begin CHARACTERISTIC DFES_DTCO.DFC_AcChrgrIntkTSRCMax_C "" VALUE 0x8024D85E Val_Wu16 65535.00 DFES_OneToOne 0.00 65535.00 FORMAT "%8.2" /end CHARACTERISTIC
/begin CHARACTERISTIC DFES_DTCO.DFC_AcChrgrIntkTTmpErr_C "" VALUE 0x8024D860 Val_Wu16 65535.00 DFES_OneToOne 0.00 65535.00 FORMAT "%8.2" /end CHARACTERISTIC
/begin CHARACTERISTIC DFES_DTCO.DFC_AcFlt_C "" VALUE 0x8024D862 Val_Wu16 65535.00 DFES_OneToOne 0.00 65535.00 FORMAT "%8.2" /end CHARACTERISTIC
/begin CHARACTERISTIC DFES_DTCO.DFC_AppAllSnsrDfct_C "" VALUE 0x8024D864 Val_Wu16 65535.00 DFES_OneToOne 0.00 65535.00 FORMAT "%8.2" /end CHARACTERISTIC
/begin CHARACTERISTIC DFES_DTCO.DFC_BattUPwrFail_C "" VALUE 0x8024D866 Val_Wu16 65535.00 DFES_OneToOne 0.00 65535.00 FORMAT "%8.2" /end CHARACTERISTIC
/begin CHARACTERISTIC DFES_DTCO.DFC_BrkBstBkupOvrn_C "" VALUE 0x8024D868 Val_Wu16 65535.00 DFES_OneToOne 0.00 65535.00 FORMAT "%8.2" /end CHARACTERISTIC
/begin CHARACTERISTIC DFES_DTCO.DFC_BrkBstPmpOvld_C "" VALUE 0x8024D86A Val_Wu16 65535.00 DFES_OneToOne 0.00 65535.00 FORMAT "%8.2" /end CHARACTERISTIC
/begin CHARACTERISTIC DFES_DTCO.DFC_BrkPlausChk_C "" VALUE 0x8024D86C Val_Wu16 65535.00 DFES_OneToOne 0.00 65535.00 FORMAT "%8.2" /end CHARACTERISTIC
/begin CHARACTERISTIC DFES_DTCO.DFC_CbnHeatgSwtTmpErr_C "" VALUE 0x8024D86E Val_Wu16 65535.00 DFES_OneToOne 0.00 65535.00 FORMAT "%8.2" /end CHARACTERISTIC
/begin CHARACTERISTIC DFES_DTCO.DFC_CcsPwrLineChpVccSRCMax_C "" VALUE 0x8024D870 Val_Wu16 65535.00 DFES_OneToOne 0.00 65535.00 FORMAT "%8.2" /end CHARACTERISTIC
/begin CHARACTERISTIC DFES_DTCO.DFC_CcsPwrLineChpVccTmpErr_C "" VALUE 0x8024D872 Val_Wu16 65535.00 DFES_OneToOne 0.00 65535.00 FORMAT "%8.2" /end CHARACTERISTIC
/begin CHARACTERISTIC DFES_DTCO.DFC_CcsPwrLineComChpTSRCMax_C "" VALUE 0x8024D874 Val_Wu16 65535.00 DFES_OneToOne 0.00 65535.00 FORMAT "%8.2" /end CHARACTERISTIC
/begin CHARACTERISTIC DFES_DTCO.DFC_CcsPwrLineComChpTTmpErr_C "" VALUE 0x8024D876 Val_Wu16 65535.00 DFES_OneToOne 0.00 65535.00 FORMAT "%8.2" /end CHARACTERISTIC
/begin CHARACTERISTIC DFES_DTCO.DFC_ChgrPlugCtpCarrFrqErr_C "" VALUE 0x8024D878 Val_Wu16 65535.00 DFES_OneToOne 0.00 65535.00 FORMAT "%8.2" /end CHARACTERISTIC
/begin CHARACTERISTIC DFES_DTCO.DFC_ChgrPlugCtpSwtStuckClsd_C "" VALUE 0x8024D87A Val_Wu16 65535.00 DFES_OneToOne 0.00 65535.00 FORMAT "%8.2" /end CHARACTERISTIC
/begin CHARACTERISTIC DFES_DTCO.DFC_ChgrPlugCtpSwtStuckOpen_C "" VALUE 0x8024D87C Val_Wu16 65535.00 DFES_OneToOne 0.00 65535.00 FORMAT "%8.2" /end CHARACTERISTIC
/begin CHARACTERISTIC DFES_DTCO.DFC_ChgrPlugCtpUErrHi_C "" VALUE 0x8024D87E Val_Wu16 65535.00 DFES_OneToOne 0.00 65535.00 FORMAT "%8.2" /end CHARACTERISTIC
/begin CHARACTERISTIC DFES_DTCO.DFC_ChgrPlugPxp1SrcErr_C "" VALUE 0x8024D880 Val_Wu16 65535.00 DFES_OneToOne 0.00 65535.00 FORMAT "%8.2" /end CHARACTERISTIC
/begin CHARACTERISTIC DFES_DTCO.DFC_ChrgCntctAllWldd_C "" VALUE 0x8024D882 Val_Wu16 65535.00 DFES_OneToOne 0.00 65535.00 FORMAT "%8.2" /end CHARACTERISTIC
/begin CHARACTERISTIC DFES_DTCO.DFC_ChrgCntctNegOperErr_C "" VALUE 0x8024D884 Val_Wu16 65535.00 DFES_OneToOne 0.00 65535.00 FORMAT "%8.2" /end CHARACTERISTIC
/begin CHARACTERISTIC DFES_DTCO.DFC_ChrgCntctNegOperWarn_C "" VALUE 0x8024D886 Val_Wu16 65535.00 DFES_OneToOne 0.00 65535.00 FORMAT "%8.2" /end CHARACTERISTIC
/begin CHARACTERISTIC DFES_DTCO.DFC_ChrgCntctNegWldd_C "" VALUE 0x8024D888 Val_Wu16 65535.00 DFES_OneToOne 0.00 65535.00 FORMAT "%8.2" /end CHARACTERISTIC
/begin CHARACTERISTIC DFES_DTCO.DFC_ChrgCntctPosOperErr_C "" VALUE 0x8024D88A Val_Wu16 65535.00 DFES_OneToOne 0.00 65535.00 FORMAT "%8.2" /end CHARACTERISTIC
/begin CHARACTERISTIC DFES_DTCO.DFC_ChrgCntctPosOperWarn_C "" VALUE 0x8024D88C Val_Wu16 65535.00 DFES_OneToOne 0.00 65535.00 FORMAT "%8.2" /end CHARACTERISTIC
/begin CHARACTERISTIC DFES_DTCO.DFC_ChrgCntctPosWldd_C "" VALUE 0x8024D88E Val_Wu16 65535.00 DFES_OneToOne 0.00 65535.00 FORMAT "%8.2" /end CHARACTERISTIC
/begin CHARACTERISTIC DFES_DTCO.DFC_ChrgCntctStuckOpen_C "" VALUE 0x8024D890 Val_Wu16 65535.00 DFES_OneToOne 0.00 65535.00 FORMAT "%8.2" /end CHARACTERISTIC
/begin CHARACTERISTIC DFES_DTCO.DFC_ChrgPlgIntlckFaild_C "" VALUE 0x8024D892 Val_Wu16 65535.00 DFES_OneToOne 0.00 65535.00 FORMAT "%8.2" /end CHARACTERISTIC
/begin CHARACTERISTIC DFES_DTCO.DFC_ChrgnUnplRqrd_C "" VALUE 0x8024D894 Val_Wu16 65535.00 DFES_OneToOne 0.00 65535.00 FORMAT "%8.2" /end CHARACTERISTIC
/begin CHARACTERISTIC DFES_DTCO.DFC_CoElMOffsCalibActv01_C "" VALUE 0x8024D896 Val_Wu16 65535.00 DFES_OneToOne 0.00 65535.00 FORMAT "%8.2" /end CHARACTERISTIC
/begin CHARACTERISTIC DFES_DTCO.DFC_CtPSwtDiagSRCMax_C "" VALUE 0x8024D898 Val_Wu16 65535.00 DFES_OneToOne 0.00 65535.00 FORMAT "%8.2" /end CHARACTERISTIC
/begin CHARACTERISTIC DFES_DTCO.DFC_CtPSwtDiagTmpErr_C "" VALUE 0x8024D89A Val_Wu16 65535.00 DFES_OneToOne 0.00 65535.00 FORMAT "%8.2" /end CHARACTERISTIC
/begin CHARACTERISTIC DFES_DTCO.DFC_CtpCarrFrqTmpErr_C "" VALUE 0x8024D89C Val_Wu16 65535.00 DFES_OneToOne 0.00 65535.00 FORMAT "%8.2" /end CHARACTERISTIC
/begin CHARACTERISTIC DFES_DTCO.DFC_DcChrgrIntkT2SRCMax_C "" VALUE 0x8024D89E Val_Wu16 65535.00 DFES_OneToOne 0.00 65535.00 FORMAT "%8.2" /end CHARACTERISTIC
/begin CHARACTERISTIC DFES_DTCO.DFC_DcChrgrIntkT2TmpErr_C "" VALUE 0x8024D8A0 Val_Wu16 65535.00 DFES_OneToOne 0.00 65535.00 FORMAT "%8.2" /end CHARACTERISTIC
/begin CHARACTERISTIC DFES_DTCO.DFC_DcChrgrIntkTSRCMax_C "" VALUE 0x8024D8A2 Val_Wu16 65535.00 DFES_OneToOne 0.00 65535.00 FORMAT "%8.2" /end CHARACTERISTIC
/begin CHARACTERISTIC DFES_DTCO.DFC_DcChrgrIntkTTmpErr_C "" VALUE 0x8024D8A4 Val_Wu16 65535.00 DFES_OneToOne 0.00 65535.00 FORMAT "%8.2" /end CHARACTERISTIC
/begin CHARACTERISTIC DFES_DTCO.DFC_EChrDvPlinCntrThdExcdd_C "" VALUE 0x8024D8A6 Val_Wu16 65535.00 DFES_OneToOne 0.00 65535.00 FORMAT "%8.2" /end CHARACTERISTIC
/begin CHARACTERISTIC DFES_DTCO.DFC_EemDiagCtctrClsTout_C "" VALUE 0x8024D8A8 Val_Wu16 65535.00 DFES_OneToOne 0.00 65535.00 FORMAT "%8.2" /end CHARACTERISTIC
/begin CHARACTERISTIC DFES_DTCO.DFC_EemDiagDcdcOffTOut_C "" VALUE 0x8024D8AA Val_Wu16 65535.00 DFES_OneToOne 0.00 65535.00 FORMAT "%8.2" /end CHARACTERISTIC
/begin CHARACTERISTIC DFES_DTCO.DFC_EemDiagHvCnsrOffTOut_C "" VALUE 0x8024D8AC Val_Wu16 65535.00 DFES_OneToOne 0.00 65535.00 FORMAT "%8.2" /end CHARACTERISTIC
/begin CHARACTERISTIC DFES_DTCO.DFC_EemDiagHvbOffTOut_C "" VALUE 0x8024D8AE Val_Wu16 65535.00 DFES_OneToOne 0.00 65535.00 FORMAT "%8.2" /end CHARACTERISTIC
/begin CHARACTERISTIC DFES_DTCO.DFC_FanSpdSRCMax_C "" VALUE 0x8024D8B0 Val_Wu16 65535.00 DFES_OneToOne 0.00 65535.00 FORMAT "%8.2" /end CHARACTERISTIC
/begin CHARACTERISTIC DFES_DTCO.DFC_FanSpdTmpErr_C "" VALUE 0x8024D8B2 Val_Wu16 65535.00 DFES_OneToOne 0.00 65535.00 FORMAT "%8.2" /end CHARACTERISTIC
/begin CHARACTERISTIC DFES_DTCO.DFC_FreonPSRCMax_C "" VALUE 0x8024D8B4 Val_Wu16 65535.00 DFES_OneToOne 0.00 65535.00 FORMAT "%8.2" /end CHARACTERISTIC
/begin CHARACTERISTIC DFES_DTCO.DFC_FreonPTmpErr_C "" VALUE 0x8024D8B6 Val_Wu16 65535.00 DFES_OneToOne 0.00 65535.00 FORMAT "%8.2" /end CHARACTERISTIC
/begin CHARACTERISTIC DFES_DTCO.DFC_HeatrCoreTSRCMax_C "" VALUE 0x8024D8B8 Val_Wu16 65535.00 DFES_OneToOne 0.00 65535.00 FORMAT "%8.2" /end CHARACTERISTIC
/begin CHARACTERISTIC DFES_DTCO.DFC_HeatrCoreTTmpErr_C "" VALUE 0x8024D8BA Val_Wu16 65535.00 DFES_OneToOne 0.00 65535.00 FORMAT "%8.2" /end CHARACTERISTIC
/begin CHARACTERISTIC DFES_DTCO.DFC_HvGridSocMinLim_C "" VALUE 0x8024D8BC Val_Wu16 65535.00 DFES_OneToOne 0.00 65535.00 FORMAT "%8.2" /end CHARACTERISTIC
/begin CHARACTERISTIC DFES_DTCO.DFC_HvacBlwrFrntFlt_C "" VALUE 0x8024D8BE Val_Wu16 65535.00 DFES_OneToOne 0.00 65535.00 FORMAT "%8.2" /end CHARACTERISTIC
/begin CHARACTERISTIC DFES_DTCO.DFC_HvacEvapElecFlt_C "" VALUE 0x8024D8C0 Val_Wu16 65535.00 DFES_OneToOne 0.00 65535.00 FORMAT "%8.2" /end CHARACTERISTIC
/begin CHARACTERISTIC DFES_DTCO.DFC_HvacEvapElecFltGnd_C "" VALUE 0x8024D8C2 Val_Wu16 65535.00 DFES_OneToOne 0.00 65535.00 FORMAT "%8.2" /end CHARACTERISTIC
/begin CHARACTERISTIC DFES_DTCO.DFC_HvacKnobPosnFlt_C "" VALUE 0x8024D8C4 Val_Wu16 65535.00 DFES_OneToOne 0.00 65535.00 FORMAT "%8.2" /end CHARACTERISTIC
/begin CHARACTERISTIC DFES_DTCO.DFC_InvBinID_C "" VALUE 0x8024D8C6 Val_Wu16 65535.00 DFES_OneToOne 0.00 65535.00 FORMAT "%8.2" /end CHARACTERISTIC
/begin CHARACTERISTIC DFES_DTCO.DFC_InvCalID_C "" VALUE 0x8024D8C8 Val_Wu16 65535.00 DFES_OneToOne 0.00 65535.00 FORMAT "%8.2" /end CHARACTERISTIC
/begin CHARACTERISTIC DFES_DTCO.DFC_InvErotan_C "" VALUE 0x8024D8CA Val_Wu16 65535.00 DFES_OneToOne 0.00 65535.00 FORMAT "%8.2" /end CHARACTERISTIC
/begin CHARACTERISTIC DFES_DTCO.DFC_InvVinID_C "" VALUE 0x8024D8CC Val_Wu16 65535.00 DFES_OneToOne 0.00 65535.00 FORMAT "%8.2" /end CHARACTERISTIC
/begin CHARACTERISTIC DFES_DTCO.DFC_MOXEMM_SMU_ALM0_0_C "" VALUE 0x8024D8CE Val_Wu16 65535.00 DFES_OneToOne 0.00 65535.00 FORMAT "%8.2" /end CHARACTERISTIC
/begin CHARACTERISTIC DFES_DTCO.DFC_MOXEMM_SMU_ALM0_1_C "" VALUE 0x8024D8D0 Val_Wu16 65535.00 DFES_OneToOne 0.00 65535.00 FORMAT "%8.2" /end CHARACTERISTIC
/begin CHARACTERISTIC DFES_DTCO.DFC_MOXEMM_SMU_ALM0_10_C "" VALUE 0x8024D8D2 Val_Wu16 65535.00 DFES_OneToOne 0.00 65535.00 FORMAT "%8.2" /end CHARACTERISTIC
/begin CHARACTERISTIC DFES_DTCO.DFC_MOXEMM_SMU_ALM0_11_C "" VALUE 0x8024D8D4 Val_Wu16 65535.00 DFES_OneToOne 0.00 65535.00 FORMAT "%8.2" /end CHARACTERISTIC
/begin CHARACTERISTIC DFES_DTCO.DFC_MOXEMM_SMU_ALM0_13_C "" VALUE 0x8024D8D6 Val_Wu16 65535.00 DFES_OneToOne 0.00 65535.00 FORMAT "%8.2" /end CHARACTERISTIC
/begin CHARACTERISTIC DFES_DTCO.DFC_MOXEMM_SMU_ALM0_14_C "" VALUE 0x8024D8D8 Val_Wu16 65535.00 DFES_OneToOne 0.00 65535.00 FORMAT "%8.2" /end CHARACTERISTIC
/begin CHARACTERISTIC DFES_DTCO.DFC_MOXEMM_SMU_ALM0_2_C "" VALUE 0x8024D8DA Val_Wu16 65535.00 DFES_OneToOne 0.00 65535.00 FORMAT "%8.2" /end CHARACTERISTIC
/begin CHARACTERISTIC DFES_DTCO.DFC_MOXEMM_SMU_ALM0_22_C "" VALUE 0x8024D8DC Val_Wu16 65535.00 DFES_OneToOne 0.00 65535.00 FORMAT "%8.2" /end CHARACTERISTIC
/begin CHARACTERISTIC DFES_DTCO.DFC_MOXEMM_SMU_ALM0_23_C "" VALUE 0x8024D8DE Val_Wu16 65535.00 DFES_OneToOne 0.00 65535.00 FORMAT "%8.2" /end CHARACTERISTIC
/begin CHARACTERISTIC DFES_DTCO.DFC_MOXEMM_SMU_ALM0_4_C "" VALUE 0x8024D8E0 Val_Wu16 65535.00 DFES_OneToOne 0.00 65535.00 FORMAT "%8.2" /end CHARACTERISTIC
/begin CHARACTERISTIC DFES_DTCO.DFC_MOXEMM_SMU_ALM0_5_C "" VALUE 0x8024D8E2 Val_Wu16 65535.00 DFES_OneToOne 0.00 65535.00 FORMAT "%8.2" /end CHARACTERISTIC
/begin CHARACTERISTIC DFES_DTCO.DFC_MOXEMM_SMU_ALM0_7_C "" VALUE 0x8024D8E4 Val_Wu16 65535.00 DFES_OneToOne 0.00 65535.00 FORMAT "%8.2" /end CHARACTERISTIC
/begin CHARACTERISTIC DFES_DTCO.DFC_MOXEMM_SMU_ALM0_8_C "" VALUE 0x8024D8E6 Val_Wu16 65535.00 DFES_OneToOne 0.00 65535.00 FORMAT "%8.2" /end CHARACTERISTIC
/begin CHARACTERISTIC DFES_DTCO.DFC_MOXEMM_SMU_ALM10_16_C "" VALUE 0x8024D8E8 Val_Wu16 65535.00 DFES_OneToOne 0.00 65535.00 FORMAT "%8.2" /end CHARACTERISTIC
/begin CHARACTERISTIC DFES_DTCO.DFC_MOXEMM_SMU_ALM10_17_C "" VALUE 0x8024D8EA Val_Wu16 65535.00 DFES_OneToOne 0.00 65535.00 FORMAT "%8.2" /end CHARACTERISTIC
/begin CHARACTERISTIC DFES_DTCO.DFC_MOXEMM_SMU_ALM10_21_C "" VALUE 0x8024D8EC Val_Wu16 65535.00 DFES_OneToOne 0.00 65535.00 FORMAT "%8.2" /end CHARACTERISTIC
/begin CHARACTERISTIC DFES_DTCO.DFC_MOXEMM_SMU_ALM11_0_C "" VALUE 0x8024D8EE Val_Wu16 65535.00 DFES_OneToOne 0.00 65535.00 FORMAT "%8.2" /end CHARACTERISTIC
/begin CHARACTERISTIC DFES_DTCO.DFC_MOXEMM_SMU_ALM11_1_C "" VALUE 0x8024D8F0 Val_Wu16 65535.00 DFES_OneToOne 0.00 65535.00 FORMAT "%8.2" /end CHARACTERISTIC
/begin CHARACTERISTIC DFES_DTCO.DFC_MOXEMM_SMU_ALM11_2_C "" VALUE 0x8024D8F2 Val_Wu16 65535.00 DFES_OneToOne 0.00 65535.00 FORMAT "%8.2" /end CHARACTERISTIC
/begin CHARACTERISTIC DFES_DTCO.DFC_MOXEMM_SMU_ALM11_3_C "" VALUE 0x8024D8F4 Val_Wu16 65535.00 DFES_OneToOne 0.00 65535.00 FORMAT "%8.2" /end CHARACTERISTIC
/begin CHARACTERISTIC DFES_DTCO.DFC_MOXEMM_SMU_ALM11_4_C "" VALUE 0x8024D8F6 Val_Wu16 65535.00 DFES_OneToOne 0.00 65535.00 FORMAT "%8.2" /end CHARACTERISTIC
/begin CHARACTERISTIC DFES_DTCO.DFC_MOXEMM_SMU_ALM11_5_C "" VALUE 0x8024D8F8 Val_Wu16 65535.00 DFES_OneToOne 0.00 65535.00 FORMAT "%8.2" /end CHARACTERISTIC
/begin CHARACTERISTIC DFES_DTCO.DFC_MOXEMM_SMU_ALM11_8_C "" VALUE 0x8024D8FA Val_Wu16 65535.00 DFES_OneToOne 0.00 65535.00 FORMAT "%8.2" /end CHARACTERISTIC
/begin CHARACTERISTIC DFES_DTCO.DFC_MOXEMM_SMU_ALM11_9_C "" VALUE 0x8024D8FC Val_Wu16 65535.00 DFES_OneToOne 0.00 65535.00 FORMAT "%8.2" /end CHARACTERISTIC
/begin CHARACTERISTIC DFES_DTCO.DFC_MOXEMM_SMU_ALM1_0_C "" VALUE 0x8024D8FE Val_Wu16 65535.00 DFES_OneToOne 0.00 65535.00 FORMAT "%8.2" /end CHARACTERISTIC
/begin CHARACTERISTIC DFES_DTCO.DFC_MOXEMM_SMU_ALM1_1_C "" VALUE 0x8024D900 Val_Wu16 65535.00 DFES_OneToOne 0.00 65535.00 FORMAT "%8.2" /end CHARACTERISTIC
/begin CHARACTERISTIC DFES_DTCO.DFC_MOXEMM_SMU_ALM1_10_C "" VALUE 0x8024D902 Val_Wu16 65535.00 DFES_OneToOne 0.00 65535.00 FORMAT "%8.2" /end CHARACTERISTIC
/begin CHARACTERISTIC DFES_DTCO.DFC_MOXEMM_SMU_ALM1_11_C "" VALUE 0x8024D904 Val_Wu16 65535.00 DFES_OneToOne 0.00 65535.00 FORMAT "%8.2" /end CHARACTERISTIC
/begin CHARACTERISTIC DFES_DTCO.DFC_MOXEMM_SMU_ALM1_13_C "" VALUE 0x8024D906 Val_Wu16 65535.00 DFES_OneToOne 0.00 65535.00 FORMAT "%8.2" /end CHARACTERISTIC
/begin CHARACTERISTIC DFES_DTCO.DFC_MOXEMM_SMU_ALM1_14_C "" VALUE 0x8024D908 Val_Wu16 65535.00 DFES_OneToOne 0.00 65535.00 FORMAT "%8.2" /end CHARACTERISTIC
/begin CHARACTERISTIC DFES_DTCO.DFC_MOXEMM_SMU_ALM1_2_C "" VALUE 0x8024D90A Val_Wu16 65535.00 DFES_OneToOne 0.00 65535.00 FORMAT "%8.2" /end CHARACTERISTIC
/begin CHARACTERISTIC DFES_DTCO.DFC_MOXEMM_SMU_ALM1_22_C "" VALUE 0x8024D90C Val_Wu16 65535.00 DFES_OneToOne 0.00 65535.00 FORMAT "%8.2" /end CHARACTERISTIC
/begin CHARACTERISTIC DFES_DTCO.DFC_MOXEMM_SMU_ALM1_23_C "" VALUE 0x8024D90E Val_Wu16 65535.00 DFES_OneToOne 0.00 65535.00 FORMAT "%8.2" /end CHARACTERISTIC
/begin CHARACTERISTIC DFES_DTCO.DFC_MOXEMM_SMU_ALM1_4_C "" VALUE 0x8024D910 Val_Wu16 65535.00 DFES_OneToOne 0.00 65535.00 FORMAT "%8.2" /end CHARACTERISTIC
/begin CHARACTERISTIC DFES_DTCO.DFC_MOXEMM_SMU_ALM1_5_C "" VALUE 0x8024D912 Val_Wu16 65535.00 DFES_OneToOne 0.00 65535.00 FORMAT "%8.2" /end CHARACTERISTIC
/begin CHARACTERISTIC DFES_DTCO.DFC_MOXEMM_SMU_ALM1_7_C "" VALUE 0x8024D914 Val_Wu16 65535.00 DFES_OneToOne 0.00 65535.00 FORMAT "%8.2" /end CHARACTERISTIC
/begin CHARACTERISTIC DFES_DTCO.DFC_MOXEMM_SMU_ALM1_8_C "" VALUE 0x8024D916 Val_Wu16 65535.00 DFES_OneToOne 0.00 65535.00 FORMAT "%8.2" /end CHARACTERISTIC
/begin CHARACTERISTIC DFES_DTCO.DFC_MOXEMM_SMU_ALM21_0_C "" VALUE 0x8024D918 Val_Wu16 65535.00 DFES_OneToOne 0.00 65535.00 FORMAT "%8.2" /end CHARACTERISTIC
/begin CHARACTERISTIC DFES_DTCO.DFC_MOXEMM_SMU_ALM21_16_C "" VALUE 0x8024D91A Val_Wu16 65535.00 DFES_OneToOne 0.00 65535.00 FORMAT "%8.2" /end CHARACTERISTIC
/begin CHARACTERISTIC DFES_DTCO.DFC_MOXEMM_SMU_ALM21_3_C "" VALUE 0x8024D91C Val_Wu16 65535.00 DFES_OneToOne 0.00 65535.00 FORMAT "%8.2" /end CHARACTERISTIC
/begin CHARACTERISTIC DFES_DTCO.DFC_MOXEMM_SMU_ALM2_1_C "" VALUE 0x8024D91E Val_Wu16 65535.00 DFES_OneToOne 0.00 65535.00 FORMAT "%8.2" /end CHARACTERISTIC
/begin CHARACTERISTIC DFES_DTCO.DFC_MOXEMM_SMU_ALM2_10_C "" VALUE 0x8024D920 Val_Wu16 65535.00 DFES_OneToOne 0.00 65535.00 FORMAT "%8.2" /end CHARACTERISTIC
/begin CHARACTERISTIC DFES_DTCO.DFC_MOXEMM_SMU_ALM2_11_C "" VALUE 0x8024D922 Val_Wu16 65535.00 DFES_OneToOne 0.00 65535.00 FORMAT "%8.2" /end CHARACTERISTIC
/begin CHARACTERISTIC DFES_DTCO.DFC_MOXEMM_SMU_ALM2_13_C "" VALUE 0x8024D924 Val_Wu16 65535.00 DFES_OneToOne 0.00 65535.00 FORMAT "%8.2" /end CHARACTERISTIC
/begin CHARACTERISTIC DFES_DTCO.DFC_MOXEMM_SMU_ALM2_14_C "" VALUE 0x8024D926 Val_Wu16 65535.00 DFES_OneToOne 0.00 65535.00 FORMAT "%8.2" /end CHARACTERISTIC
/begin CHARACTERISTIC DFES_DTCO.DFC_MOXEMM_SMU_ALM2_22_C "" VALUE 0x8024D928 Val_Wu16 65535.00 DFES_OneToOne 0.00 65535.00 FORMAT "%8.2" /end CHARACTERISTIC
/begin CHARACTERISTIC DFES_DTCO.DFC_MOXEMM_SMU_ALM2_23_C "" VALUE 0x8024D92A Val_Wu16 65535.00 DFES_OneToOne 0.00 65535.00 FORMAT "%8.2" /end CHARACTERISTIC
/begin CHARACTERISTIC DFES_DTCO.DFC_MOXEMM_SMU_ALM2_4_C "" VALUE 0x8024D92C Val_Wu16 65535.00 DFES_OneToOne 0.00 65535.00 FORMAT "%8.2" /end CHARACTERISTIC
/begin CHARACTERISTIC DFES_DTCO.DFC_MOXEMM_SMU_ALM2_5_C "" VALUE 0x8024D92E Val_Wu16 65535.00 DFES_OneToOne 0.00 65535.00 FORMAT "%8.2" /end CHARACTERISTIC
/begin CHARACTERISTIC DFES_DTCO.DFC_MOXEMM_SMU_ALM2_7_C "" VALUE 0x8024D930 Val_Wu16 65535.00 DFES_OneToOne 0.00 65535.00 FORMAT "%8.2" /end CHARACTERISTIC
/begin CHARACTERISTIC DFES_DTCO.DFC_MOXEMM_SMU_ALM2_8_C "" VALUE 0x8024D932 Val_Wu16 65535.00 DFES_OneToOne 0.00 65535.00 FORMAT "%8.2" /end CHARACTERISTIC
/begin CHARACTERISTIC DFES_DTCO.DFC_MOXEMM_SMU_ALM6_0_C "" VALUE 0x8024D934 Val_Wu16 65535.00 DFES_OneToOne 0.00 65535.00 FORMAT "%8.2" /end CHARACTERISTIC
/begin CHARACTERISTIC DFES_DTCO.DFC_MOXEMM_SMU_ALM6_11_C "" VALUE 0x8024D936 Val_Wu16 65535.00 DFES_OneToOne 0.00 65535.00 FORMAT "%8.2" /end CHARACTERISTIC
/begin CHARACTERISTIC DFES_DTCO.DFC_MOXEMM_SMU_ALM6_12_C "" VALUE 0x8024D938 Val_Wu16 65535.00 DFES_OneToOne 0.00 65535.00 FORMAT "%8.2" /end CHARACTERISTIC
/begin CHARACTERISTIC DFES_DTCO.DFC_MOXEMM_SMU_ALM6_14_C "" VALUE 0x8024D93A Val_Wu16 65535.00 DFES_OneToOne 0.00 65535.00 FORMAT "%8.2" /end CHARACTERISTIC
/begin CHARACTERISTIC DFES_DTCO.DFC_MOXEMM_SMU_ALM6_15_C "" VALUE 0x8024D93C Val_Wu16 65535.00 DFES_OneToOne 0.00 65535.00 FORMAT "%8.2" /end CHARACTERISTIC
/begin CHARACTERISTIC DFES_DTCO.DFC_MOXEMM_SMU_ALM6_17_C "" VALUE 0x8024D93E Val_Wu16 65535.00 DFES_OneToOne 0.00 65535.00 FORMAT "%8.2" /end CHARACTERISTIC
/begin CHARACTERISTIC DFES_DTCO.DFC_MOXEMM_SMU_ALM6_18_C "" VALUE 0x8024D940 Val_Wu16 65535.00 DFES_OneToOne 0.00 65535.00 FORMAT "%8.2" /end CHARACTERISTIC
/begin CHARACTERISTIC DFES_DTCO.DFC_MOXEMM_SMU_ALM6_20_C "" VALUE 0x8024D942 Val_Wu16 65535.00 DFES_OneToOne 0.00 65535.00 FORMAT "%8.2" /end CHARACTERISTIC
/begin CHARACTERISTIC DFES_DTCO.DFC_MOXEMM_SMU_ALM6_21_C "" VALUE 0x8024D944 Val_Wu16 65535.00 DFES_OneToOne 0.00 65535.00 FORMAT "%8.2" /end CHARACTERISTIC
/begin CHARACTERISTIC DFES_DTCO.DFC_MOXEMM_SMU_ALM6_25_C "" VALUE 0x8024D946 Val_Wu16 65535.00 DFES_OneToOne 0.00 65535.00 FORMAT "%8.2" /end CHARACTERISTIC
/begin CHARACTERISTIC DFES_DTCO.DFC_MOXEMM_SMU_ALM6_4_C "" VALUE 0x8024D948 Val_Wu16 65535.00 DFES_OneToOne 0.00 65535.00 FORMAT "%8.2" /end CHARACTERISTIC
/begin CHARACTERISTIC DFES_DTCO.DFC_MOXEMM_SMU_ALM6_5_C "" VALUE 0x8024D94A Val_Wu16 65535.00 DFES_OneToOne 0.00 65535.00 FORMAT "%8.2" /end CHARACTERISTIC
/begin CHARACTERISTIC DFES_DTCO.DFC_MOXEMM_SMU_ALM6_7_C "" VALUE 0x8024D94C Val_Wu16 65535.00 DFES_OneToOne 0.00 65535.00 FORMAT "%8.2" /end CHARACTERISTIC
/begin CHARACTERISTIC DFES_DTCO.DFC_MOXEMM_SMU_ALM6_8_C "" VALUE 0x8024D94E Val_Wu16 65535.00 DFES_OneToOne 0.00 65535.00 FORMAT "%8.2" /end CHARACTERISTIC
/begin CHARACTERISTIC DFES_DTCO.DFC_MOXEMM_SMU_ALM7_1_C "" VALUE 0x8024D950 Val_Wu16 65535.00 DFES_OneToOne 0.00 65535.00 FORMAT "%8.2" /end CHARACTERISTIC
/begin CHARACTERISTIC DFES_DTCO.DFC_MOXEMM_SMU_ALM7_12_C "" VALUE 0x8024D952 Val_Wu16 65535.00 DFES_OneToOne 0.00 65535.00 FORMAT "%8.2" /end CHARACTERISTIC
/begin CHARACTERISTIC DFES_DTCO.DFC_MOXEMM_SMU_ALM7_13_C "" VALUE 0x8024D954 Val_Wu16 65535.00 DFES_OneToOne 0.00 65535.00 FORMAT "%8.2" /end CHARACTERISTIC
/begin CHARACTERISTIC DFES_DTCO.DFC_MOXEMM_SMU_ALM7_14_C "" VALUE 0x8024D956 Val_Wu16 65535.00 DFES_OneToOne 0.00 65535.00 FORMAT "%8.2" /end CHARACTERISTIC
/begin CHARACTERISTIC DFES_DTCO.DFC_MOXEMM_SMU_ALM7_15_C "" VALUE 0x8024D958 Val_Wu16 65535.00 DFES_OneToOne 0.00 65535.00 FORMAT "%8.2" /end CHARACTERISTIC
/begin CHARACTERISTIC DFES_DTCO.DFC_MOXEMM_SMU_ALM7_16_C "" VALUE 0x8024D95A Val_Wu16 65535.00 DFES_OneToOne 0.00 65535.00 FORMAT "%8.2" /end CHARACTERISTIC
/begin CHARACTERISTIC DFES_DTCO.DFC_MOXEMM_SMU_ALM7_17_C "" VALUE 0x8024D95C Val_Wu16 65535.00 DFES_OneToOne 0.00 65535.00 FORMAT "%8.2" /end CHARACTERISTIC
/begin CHARACTERISTIC DFES_DTCO.DFC_MOXEMM_SMU_ALM7_2_C "" VALUE 0x8024D95E Val_Wu16 65535.00 DFES_OneToOne 0.00 65535.00 FORMAT "%8.2" /end CHARACTERISTIC
/begin CHARACTERISTIC DFES_DTCO.DFC_MOXEMM_SMU_ALM7_20_C "" VALUE 0x8024D960 Val_Wu16 65535.00 DFES_OneToOne 0.00 65535.00 FORMAT "%8.2" /end CHARACTERISTIC
/begin CHARACTERISTIC DFES_DTCO.DFC_MOXEMM_SMU_ALM7_25_C "" VALUE 0x8024D962 Val_Wu16 65535.00 DFES_OneToOne 0.00 65535.00 FORMAT "%8.2" /end CHARACTERISTIC
/begin CHARACTERISTIC DFES_DTCO.DFC_MOXEMM_SMU_ALM7_26_C "" VALUE 0x8024D964 Val_Wu16 65535.00 DFES_OneToOne 0.00 65535.00 FORMAT "%8.2" /end CHARACTERISTIC
/begin CHARACTERISTIC DFES_DTCO.DFC_MOXEMM_SMU_ALM7_28_C "" VALUE 0x8024D966 Val_Wu16 65535.00 DFES_OneToOne 0.00 65535.00 FORMAT "%8.2" /end CHARACTERISTIC
/begin CHARACTERISTIC DFES_DTCO.DFC_MOXEMM_SMU_ALM7_29_C "" VALUE 0x8024D968 Val_Wu16 65535.00 DFES_OneToOne 0.00 65535.00 FORMAT "%8.2" /end CHARACTERISTIC
/begin CHARACTERISTIC DFES_DTCO.DFC_MOXEMM_SMU_ALM7_30_C "" VALUE 0x8024D96A Val_Wu16 65535.00 DFES_OneToOne 0.00 65535.00 FORMAT "%8.2" /end CHARACTERISTIC
/begin CHARACTERISTIC DFES_DTCO.DFC_MOXEMM_SMU_ALM7_31_C "" VALUE 0x8024D96C Val_Wu16 65535.00 DFES_OneToOne 0.00 65535.00 FORMAT "%8.2" /end CHARACTERISTIC
/begin CHARACTERISTIC DFES_DTCO.DFC_MOXEMM_SMU_ALM8_0_C "" VALUE 0x8024D96E Val_Wu16 65535.00 DFES_OneToOne 0.00 65535.00 FORMAT "%8.2" /end CHARACTERISTIC
/begin CHARACTERISTIC DFES_DTCO.DFC_MOXEMM_SMU_ALM8_1_C "" VALUE 0x8024D970 Val_Wu16 65535.00 DFES_OneToOne 0.00 65535.00 FORMAT "%8.2" /end CHARACTERISTIC
/begin CHARACTERISTIC DFES_DTCO.DFC_MOXEMM_SMU_ALM8_10_C "" VALUE 0x8024D972 Val_Wu16 65535.00 DFES_OneToOne 0.00 65535.00 FORMAT "%8.2" /end CHARACTERISTIC
/begin CHARACTERISTIC DFES_DTCO.DFC_MOXEMM_SMU_ALM8_11_C "" VALUE 0x8024D974 Val_Wu16 65535.00 DFES_OneToOne 0.00 65535.00 FORMAT "%8.2" /end CHARACTERISTIC
/begin CHARACTERISTIC DFES_DTCO.DFC_MOXEMM_SMU_ALM8_12_C "" VALUE 0x8024D976 Val_Wu16 65535.00 DFES_OneToOne 0.00 65535.00 FORMAT "%8.2" /end CHARACTERISTIC
/begin CHARACTERISTIC DFES_DTCO.DFC_MOXEMM_SMU_ALM8_16_C "" VALUE 0x8024D978 Val_Wu16 65535.00 DFES_OneToOne 0.00 65535.00 FORMAT "%8.2" /end CHARACTERISTIC
/begin CHARACTERISTIC DFES_DTCO.DFC_MOXEMM_SMU_ALM8_18_C "" VALUE 0x8024D97A Val_Wu16 65535.00 DFES_OneToOne 0.00 65535.00 FORMAT "%8.2" /end CHARACTERISTIC
/begin CHARACTERISTIC DFES_DTCO.DFC_MOXEMM_SMU_ALM8_2_C "" VALUE 0x8024D97C Val_Wu16 65535.00 DFES_OneToOne 0.00 65535.00 FORMAT "%8.2" /end CHARACTERISTIC
/begin CHARACTERISTIC DFES_DTCO.DFC_MOXEMM_SMU_ALM8_3_C "" VALUE 0x8024D97E Val_Wu16 65535.00 DFES_OneToOne 0.00 65535.00 FORMAT "%8.2" /end CHARACTERISTIC
/begin CHARACTERISTIC DFES_DTCO.DFC_MOXEMM_SMU_ALM8_31_C "" VALUE 0x8024D980 Val_Wu16 65535.00 DFES_OneToOne 0.00 65535.00 FORMAT "%8.2" /end CHARACTERISTIC
/begin CHARACTERISTIC DFES_DTCO.DFC_MOXEMM_SMU_ALM8_4_C "" VALUE 0x8024D982 Val_Wu16 65535.00 DFES_OneToOne 0.00 65535.00 FORMAT "%8.2" /end CHARACTERISTIC
/begin CHARACTERISTIC DFES_DTCO.DFC_MOXEMM_SMU_ALM9_0_C "" VALUE 0x8024D984 Val_Wu16 65535.00 DFES_OneToOne 0.00 65535.00 FORMAT "%8.2" /end CHARACTERISTIC
/begin CHARACTERISTIC DFES_DTCO.DFC_MOXEMM_SMU_ALM9_15_C "" VALUE 0x8024D986 Val_Wu16 65535.00 DFES_OneToOne 0.00 65535.00 FORMAT "%8.2" /end CHARACTERISTIC
/begin CHARACTERISTIC DFES_DTCO.DFC_MOXEMM_SMU_ALM9_3_C "" VALUE 0x8024D988 Val_Wu16 65535.00 DFES_OneToOne 0.00 65535.00 FORMAT "%8.2" /end CHARACTERISTIC
/begin CHARACTERISTIC DFES_DTCO.DFC_MoCADCNTPBnk1_C "" VALUE 0x8024D98A Val_Wu16 65535.00 DFES_OneToOne 0.00 65535.00 FORMAT "%8.2" /end CHARACTERISTIC
/begin CHARACTERISTIC DFES_DTCO.DFC_MoCADCTestVoltBnk1_C "" VALUE 0x8024D98C Val_Wu16 65535.00 DFES_OneToOne 0.00 65535.00 FORMAT "%8.2" /end CHARACTERISTIC
/begin CHARACTERISTIC DFES_DTCO.DFC_MoCSOPICO_C "" VALUE 0x8024D98E Val_Wu16 65535.00 DFES_OneToOne 0.00 65535.00 FORMAT "%8.2" /end CHARACTERISTIC
/begin CHARACTERISTIC DFES_DTCO.DFC_MoFAccr_C "" VALUE 0x8024D990 Val_Wu16 65535.00 DFES_OneToOne 0.00 65535.00 FORMAT "%8.2" /end CHARACTERISTIC
/begin CHARACTERISTIC DFES_DTCO.DFC_MoFCbnPreCdngOvrheat_C "" VALUE 0x8024D992 Val_Wu16 65535.00 DFES_OneToOne 0.00 65535.00 FORMAT "%8.2" /end CHARACTERISTIC
/begin CHARACTERISTIC DFES_DTCO.DFC_MoFCbnPreCdngTmrExpi_C "" VALUE 0x8024D994 Val_Wu16 65535.00 DFES_OneToOne 0.00 65535.00 FORMAT "%8.2" /end CHARACTERISTIC
/begin CHARACTERISTIC DFES_DTCO.DFC_MoFEvMngtBms_C "" VALUE 0x8024D996 Val_Wu16 65535.00 DFES_OneToOne 0.00 65535.00 FORMAT "%8.2" /end CHARACTERISTIC
/begin CHARACTERISTIC DFES_DTCO.DFC_MoFEvMngtDcdc_C "" VALUE 0x8024D998 Val_Wu16 65535.00 DFES_OneToOne 0.00 65535.00 FORMAT "%8.2" /end CHARACTERISTIC
/begin CHARACTERISTIC DFES_DTCO.DFC_MoFEvMngtEm01_C "" VALUE 0x8024D99A Val_Wu16 65535.00 DFES_OneToOne 0.00 65535.00 FORMAT "%8.2" /end CHARACTERISTIC
/begin CHARACTERISTIC DFES_DTCO.DFC_MoFEvMngtEm01BrkgToZr_C "" VALUE 0x8024D99C Val_Wu16 65535.00 DFES_OneToOne 0.00 65535.00 FORMAT "%8.2" /end CHARACTERISTIC
/begin CHARACTERISTIC DFES_DTCO.DFC_MoFEvMngtEm01EngSpd_C "" VALUE 0x8024D99E Val_Wu16 65535.00 DFES_OneToOne 0.00 65535.00 FORMAT "%8.2" /end CHARACTERISTIC
/begin CHARACTERISTIC DFES_DTCO.DFC_MoFEvMngtEm02EngSpd_C "" VALUE 0x8024D9A0 Val_Wu16 65535.00 DFES_OneToOne 0.00 65535.00 FORMAT "%8.2" /end CHARACTERISTIC
/begin CHARACTERISTIC DFES_DTCO.DFC_MoFEvMngtEm02Lvl1_C "" VALUE 0x8024D9A2 Val_Wu16 65535.00 DFES_OneToOne 0.00 65535.00 FORMAT "%8.2" /end CHARACTERISTIC
/begin CHARACTERISTIC DFES_DTCO.DFC_MoFEvMngtEm02Lvl2_C "" VALUE 0x8024D9A4 Val_Wu16 65535.00 DFES_OneToOne 0.00 65535.00 FORMAT "%8.2" /end CHARACTERISTIC
/begin CHARACTERISTIC DFES_DTCO.DFC_MoFExtCptAuxCpt_C "" VALUE 0x8024D9A6 Val_Wu16 65535.00 DFES_OneToOne 0.00 65535.00 FORMAT "%8.2" /end CHARACTERISTIC
/begin CHARACTERISTIC DFES_DTCO.DFC_MoFExtCptVacPmpErr_C "" VALUE 0x8024D9A8 Val_Wu16 65535.00 DFES_OneToOne 0.00 65535.00 FORMAT "%8.2" /end CHARACTERISTIC
/begin CHARACTERISTIC DFES_DTCO.DFC_MoFTqPtdAxle_C "" VALUE 0x8024D9AA Val_Wu16 65535.00 DFES_OneToOne 0.00 65535.00 FORMAT "%8.2" /end CHARACTERISTIC
/begin CHARACTERISTIC DFES_DTCO.DFC_MoFTqPtdAxleSec_C "" VALUE 0x8024D9AC Val_Wu16 65535.00 DFES_OneToOne 0.00 65535.00 FORMAT "%8.2" /end CHARACTERISTIC
/begin CHARACTERISTIC DFES_DTCO.DFC_MoFTqPtdEmPtRels_C "" VALUE 0x8024D9AE Val_Wu16 65535.00 DFES_OneToOne 0.00 65535.00 FORMAT "%8.2" /end CHARACTERISTIC
/begin CHARACTERISTIC DFES_DTCO.DFC_MoFTqPtdEmPtRelsSec_C "" VALUE 0x8024D9B0 Val_Wu16 65535.00 DFES_OneToOne 0.00 65535.00 FORMAT "%8.2" /end CHARACTERISTIC
/begin CHARACTERISTIC DFES_DTCO.DFC_MoFTqPtdEmSign_C "" VALUE 0x8024D9B2 Val_Wu16 65535.00 DFES_OneToOne 0.00 65535.00 FORMAT "%8.2" /end CHARACTERISTIC
/begin CHARACTERISTIC DFES_DTCO.DFC_MoFTqPtdEmSignSec_C "" VALUE 0x8024D9B4 Val_Wu16 65535.00 DFES_OneToOne 0.00 65535.00 FORMAT "%8.2" /end CHARACTERISTIC
/begin CHARACTERISTIC DFES_DTCO.DFC_MoFTqPtdEmTq_C "" VALUE 0x8024D9B6 Val_Wu16 65535.00 DFES_OneToOne 0.00 65535.00 FORMAT "%8.2" /end CHARACTERISTIC
/begin CHARACTERISTIC DFES_DTCO.DFC_MoFTqPtdEmTqSec_C "" VALUE 0x8024D9B8 Val_Wu16 65535.00 DFES_OneToOne 0.00 65535.00 FORMAT "%8.2" /end CHARACTERISTIC
/begin CHARACTERISTIC DFES_DTCO.DFC_MoFTqPtdVeh_C "" VALUE 0x8024D9BA Val_Wu16 65535.00 DFES_OneToOne 0.00 65535.00 FORMAT "%8.2" /end CHARACTERISTIC
/begin CHARACTERISTIC DFES_DTCO.DFC_MoFVarPostBldSel_C "" VALUE 0x8024D9BC Val_Wu16 65535.00 DFES_OneToOne 0.00 65535.00 FORMAT "%8.2" /end CHARACTERISTIC
/begin CHARACTERISTIC DFES_DTCO.DFC_MoSysCtrlReIni_C "" VALUE 0x8024D9BE Val_Wu16 65535.00 DFES_OneToOne 0.00 65535.00 FORMAT "%8.2" /end CHARACTERISTIC
/begin CHARACTERISTIC DFES_DTCO.DFC_MoXEMMHwLTMCUFW_C "" VALUE 0x8024D9C0 Val_Wu16 65535.00 DFES_OneToOne 0.00 65535.00 FORMAT "%8.2" /end CHARACTERISTIC
/begin CHARACTERISTIC DFES_DTCO.DFC_MoXEMMHwLTMonBIST_C "" VALUE 0x8024D9C2 Val_Wu16 65535.00 DFES_OneToOne 0.00 65535.00 FORMAT "%8.2" /end CHARACTERISTIC
/begin CHARACTERISTIC DFES_DTCO.DFC_MoXEMMHwLTRegMonTest_C "" VALUE 0x8024D9C4 Val_Wu16 65535.00 DFES_OneToOne 0.00 65535.00 FORMAT "%8.2" /end CHARACTERISTIC
/begin CHARACTERISTIC DFES_DTCO.DFC_MoXEMMHwLTStbySMUAlvTest_C "" VALUE 0x8024D9C6 Val_Wu16 65535.00 DFES_OneToOne 0.00 65535.00 FORMAT "%8.2" /end CHARACTERISTIC
/begin CHARACTERISTIC DFES_DTCO.DFC_MoXEMMHwLTTempSens_C "" VALUE 0x8024D9C8 Val_Wu16 65535.00 DFES_OneToOne 0.00 65535.00 FORMAT "%8.2" /end CHARACTERISTIC
/begin CHARACTERISTIC DFES_DTCO.DFC_MoXEMMHwLTUCBCfg_C "" VALUE 0x8024D9CA Val_Wu16 65535.00 DFES_OneToOne 0.00 65535.00 FORMAT "%8.2" /end CHARACTERISTIC
/begin CHARACTERISTIC DFES_DTCO.DFC_MonEgyChrgnCoorr_AcChrgnWoMofRels_C "" VALUE 0x8024D9CC Val_Wu16 65535.00 DFES_OneToOne 0.00 65535.00 FORMAT "%8.2" /end CHARACTERISTIC
/begin CHARACTERISTIC DFES_DTCO.DFC_MonEgyChrgnCoorr_ChrgnAbortIgr_C "" VALUE 0x8024D9CE Val_Wu16 65535.00 DFES_OneToOne 0.00 65535.00 FORMAT "%8.2" /end CHARACTERISTIC
/begin CHARACTERISTIC DFES_DTCO.DFC_MonEgyChrgnCoorr_DcCntctFailr_C "" VALUE 0x8024D9D0 Val_Wu16 65535.00 DFES_OneToOne 0.00 65535.00 FORMAT "%8.2" /end CHARACTERISTIC
/begin CHARACTERISTIC DFES_DTCO.DFC_MonEgyChrgnCoorr_ExtChrgnShtOffReq_C "" VALUE 0x8024D9D2 Val_Wu16 65535.00 DFES_OneToOne 0.00 65535.00 FORMAT "%8.2" /end CHARACTERISTIC
/begin CHARACTERISTIC DFES_DTCO.DFC_MonEgyChrgnCoorr_ImpsChrgnMod_C "" VALUE 0x8024D9D4 Val_Wu16 65535.00 DFES_OneToOne 0.00 65535.00 FORMAT "%8.2" /end CHARACTERISTIC
/begin CHARACTERISTIC DFES_DTCO.DFC_MonEgyChrgnCoorr_ImpsChrgnPrms_C "" VALUE 0x8024D9D6 Val_Wu16 65535.00 DFES_OneToOne 0.00 65535.00 FORMAT "%8.2" /end CHARACTERISTIC
/begin CHARACTERISTIC DFES_DTCO.DFC_MonEgyChrgnCoorr_ImpsUDcIntk_C "" VALUE 0x8024D9D8 Val_Wu16 65535.00 DFES_OneToOne 0.00 65535.00 FORMAT "%8.2" /end CHARACTERISTIC
/begin CHARACTERISTIC DFES_DTCO.DFC_MonEgyChrgnCoorr_PlgLockMovmt_C "" VALUE 0x8024D9DA Val_Wu16 65535.00 DFES_OneToOne 0.00 65535.00 FORMAT "%8.2" /end CHARACTERISTIC
/begin CHARACTERISTIC DFES_DTCO.DFC_MonEgyChrgnCoorr_VehCrashDetn_C "" VALUE 0x8024D9DC Val_Wu16 65535.00 DFES_OneToOne 0.00 65535.00 FORMAT "%8.2" /end CHARACTERISTIC
/begin CHARACTERISTIC DFES_DTCO.DFC_MonEgyChrgnErrReactn_SftySwt_C "" VALUE 0x8024D9DE Val_Wu16 65535.00 DFES_OneToOne 0.00 65535.00 FORMAT "%8.2" /end CHARACTERISTIC
/begin CHARACTERISTIC DFES_DTCO.DFC_MonEgyChrgnInlet_CcsPlgCtp_C "" VALUE 0x8024D9E0 Val_Wu16 65535.00 DFES_OneToOne 0.00 65535.00 FORMAT "%8.2" /end CHARACTERISTIC
/begin CHARACTERISTIC DFES_DTCO.DFC_MonEgyChrgnInlet_CcsPlgCtpPwm_C "" VALUE 0x8024D9E2 Val_Wu16 65535.00 DFES_OneToOne 0.00 65535.00 FORMAT "%8.2" /end CHARACTERISTIC
/begin CHARACTERISTIC DFES_DTCO.DFC_MonEgyChrgnInlet_CcsPlgLockCtrlImpsAtmpt_C "" VALUE 0x8024D9E4 Val_Wu16 65535.00 DFES_OneToOne 0.00 65535.00 FORMAT "%8.2" /end CHARACTERISTIC
/begin CHARACTERISTIC DFES_DTCO.DFC_MonEgyChrgnInlet_CcsPlgLockSnsrSigRngChk_C "" VALUE 0x8024D9E6 Val_Wu16 65535.00 DFES_OneToOne 0.00 65535.00 FORMAT "%8.2" /end CHARACTERISTIC
/begin CHARACTERISTIC DFES_DTCO.DFC_MonEgyChrgnInlet_CcsPlgLockStImps_C "" VALUE 0x8024D9E8 Val_Wu16 65535.00 DFES_OneToOne 0.00 65535.00 FORMAT "%8.2" /end CHARACTERISTIC
/begin CHARACTERISTIC DFES_DTCO.DFC_MonEgyChrgnInlet_CcsPlgPxp_C "" VALUE 0x8024D9EA Val_Wu16 65535.00 DFES_OneToOne 0.00 65535.00 FORMAT "%8.2" /end CHARACTERISTIC
/begin CHARACTERISTIC DFES_DTCO.DFC_MonEgyChrgnT_Snsr1GrdtChk_C "" VALUE 0x8024D9EC Val_Wu16 65535.00 DFES_OneToOne 0.00 65535.00 FORMAT "%8.2" /end CHARACTERISTIC
/begin CHARACTERISTIC DFES_DTCO.DFC_MonEgyChrgnT_Snsr1SigRngChk_C "" VALUE 0x8024D9EE Val_Wu16 65535.00 DFES_OneToOne 0.00 65535.00 FORMAT "%8.2" /end CHARACTERISTIC
/begin CHARACTERISTIC DFES_DTCO.DFC_MonEgyChrgnT_Snsr2GrdtChk_C "" VALUE 0x8024D9F0 Val_Wu16 65535.00 DFES_OneToOne 0.00 65535.00 FORMAT "%8.2" /end CHARACTERISTIC
/begin CHARACTERISTIC DFES_DTCO.DFC_MonEgyChrgnT_Snsr2SigRngChk_C "" VALUE 0x8024D9F2 Val_Wu16 65535.00 DFES_OneToOne 0.00 65535.00 FORMAT "%8.2" /end CHARACTERISTIC
/begin CHARACTERISTIC DFES_DTCO.DFC_MonEgyChrgnT_SnsrDif_C "" VALUE 0x8024D9F4 Val_Wu16 65535.00 DFES_OneToOne 0.00 65535.00 FORMAT "%8.2" /end CHARACTERISTIC
/begin CHARACTERISTIC DFES_DTCO.DFC_OCWDAABEActv_C "" VALUE 0x8024D9F6 Val_Wu16 65535.00 DFES_OneToOne 0.00 65535.00 FORMAT "%8.2" /end CHARACTERISTIC
/begin CHARACTERISTIC DFES_DTCO.DFC_OCWDACom_C "" VALUE 0x8024D9F8 Val_Wu16 65535.00 DFES_OneToOne 0.00 65535.00 FORMAT "%8.2" /end CHARACTERISTIC
/begin CHARACTERISTIC DFES_DTCO.DFC_OCWDAErrPin_C "" VALUE 0x8024D9FA Val_Wu16 65535.00 DFES_OneToOne 0.00 65535.00 FORMAT "%8.2" /end CHARACTERISTIC
/begin CHARACTERISTIC DFES_DTCO.DFC_OCWDAOvrVltg_C "" VALUE 0x8024D9FC Val_Wu16 65535.00 DFES_OneToOne 0.00 65535.00 FORMAT "%8.2" /end CHARACTERISTIC
/begin CHARACTERISTIC DFES_DTCO.DFC_PUmax_C "" VALUE 0x8024D9FE Val_Wu16 65535.00 DFES_OneToOne 0.00 65535.00 FORMAT "%8.2" /end CHARACTERISTIC
/begin CHARACTERISTIC DFES_DTCO.DFC_PwmCtPTmpErr_C "" VALUE 0x8024DA00 Val_Wu16 65535.00 DFES_OneToOne 0.00 65535.00 FORMAT "%8.2" /end CHARACTERISTIC
/begin CHARACTERISTIC DFES_DTCO.DFC_PwrDistbnUnitTSRCMax_C "" VALUE 0x8024DA02 Val_Wu16 65535.00 DFES_OneToOne 0.00 65535.00 FORMAT "%8.2" /end CHARACTERISTIC
/begin CHARACTERISTIC DFES_DTCO.DFC_PwrDistbnUnitTTmpErr_C "" VALUE 0x8024DA04 Val_Wu16 65535.00 DFES_OneToOne 0.00 65535.00 FORMAT "%8.2" /end CHARACTERISTIC
/begin CHARACTERISTIC DFES_DTCO.DFC_SCtPmp1DiagGrdKeyErr_C "" VALUE 0x8024DA06 Val_Wu16 65535.00 DFES_OneToOne 0.00 65535.00 FORMAT "%8.2" /end CHARACTERISTIC
/begin CHARACTERISTIC DFES_DTCO.DFC_SRCHighAPP1_C "" VALUE 0x8024DA08 Val_Wu16 65535.00 DFES_OneToOne 0.00 65535.00 FORMAT "%8.2" /end CHARACTERISTIC
/begin CHARACTERISTIC DFES_DTCO.DFC_SRCHighAPP2_C "" VALUE 0x8024DA0A Val_Wu16 65535.00 DFES_OneToOne 0.00 65535.00 FORMAT "%8.2" /end CHARACTERISTIC
/begin CHARACTERISTIC DFES_DTCO.DFC_SRCLowAPP1_C "" VALUE 0x8024DA0C Val_Wu16 65535.00 DFES_OneToOne 0.00 65535.00 FORMAT "%8.2" /end CHARACTERISTIC
/begin CHARACTERISTIC DFES_DTCO.DFC_SRCLowAPP2_C "" VALUE 0x8024DA0E Val_Wu16 65535.00 DFES_OneToOne 0.00 65535.00 FORMAT "%8.2" /end CHARACTERISTIC
/begin CHARACTERISTIC DFES_DTCO.DFC_SWReset_0_C "" VALUE 0x8024DA10 Val_Wu16 65535.00 DFES_OneToOne 0.00 65535.00 FORMAT "%8.2" /end CHARACTERISTIC
/begin CHARACTERISTIC DFES_DTCO.DFC_SWReset_1_C "" VALUE 0x8024DA12 Val_Wu16 65535.00 DFES_OneToOne 0.00 65535.00 FORMAT "%8.2" /end CHARACTERISTIC
/begin CHARACTERISTIC DFES_DTCO.DFC_SWReset_2_C "" VALUE 0x8024DA14 Val_Wu16 65535.00 DFES_OneToOne 0.00 65535.00 FORMAT "%8.2" /end CHARACTERISTIC
/begin CHARACTERISTIC DFES_DTCO.DFC_Sia_InvldCode_C "" VALUE 0x8024DA16 Val_Wu16 65535.00 DFES_OneToOne 0.00 65535.00 FORMAT "%8.2" /end CHARACTERISTIC
/begin CHARACTERISTIC DFES_DTCO.DFC_Sia_InvldKey_C "" VALUE 0x8024DA18 Val_Wu16 65535.00 DFES_OneToOne 0.00 65535.00 FORMAT "%8.2" /end CHARACTERISTIC
/begin CHARACTERISTIC DFES_DTCO.DFC_Sia_NoRespUCx_C "" VALUE 0x8024DA1A Val_Wu16 65535.00 DFES_OneToOne 0.00 65535.00 FORMAT "%8.2" /end CHARACTERISTIC
/begin CHARACTERISTIC DFES_DTCO.DFC_Sia_TprotRttp_C "" VALUE 0x8024DA1C Val_Wu16 65535.00 DFES_OneToOne 0.00 65535.00 FORMAT "%8.2" /end CHARACTERISTIC
/begin CHARACTERISTIC DFES_DTCO.DFC_StrtUpEvStandStillDeactvn_C "" VALUE 0x8024DA1E Val_Wu16 65535.00 DFES_OneToOne 0.00 65535.00 FORMAT "%8.2" /end CHARACTERISTIC
/begin CHARACTERISTIC DFES_DTCO.DFC_SyncAPP_C "" VALUE 0x8024DA20 Val_Wu16 65535.00 DFES_OneToOne 0.00 65535.00 FORMAT "%8.2" /end CHARACTERISTIC
/begin CHARACTERISTIC DFES_DTCO.DFC_UCtPSRCMax_C "" VALUE 0x8024DA22 Val_Wu16 65535.00 DFES_OneToOne 0.00 65535.00 FORMAT "%8.2" /end CHARACTERISTIC
/begin CHARACTERISTIC DFES_DTCO.DFC_UCtPTmpErr_C "" VALUE 0x8024DA24 Val_Wu16 65535.00 DFES_OneToOne 0.00 65535.00 FORMAT "%8.2" /end CHARACTERISTIC
/begin CHARACTERISTIC DFES_DTCO.DFC_UPxP1SRCMax_C "" VALUE 0x8024DA26 Val_Wu16 65535.00 DFES_OneToOne 0.00 65535.00 FORMAT "%8.2" /end CHARACTERISTIC
/begin CHARACTERISTIC DFES_DTCO.DFC_UPxP1TmpErr_C "" VALUE 0x8024DA28 Val_Wu16 65535.00 DFES_OneToOne 0.00 65535.00 FORMAT "%8.2" /end CHARACTERISTIC
/begin CHARACTERISTIC DFES_DTCO.DFC_VehVObd_C "" VALUE 0x8024DA2A Val_Wu16 65535.00 DFES_OneToOne 0.00 65535.00 FORMAT "%8.2" /end CHARACTERISTIC
/begin CHARACTERISTIC DFES_EnvDid.xSet1_CA "" VAL_BLK 0x8024E1BC ValA_Wu16 61846.0000000 DID_Verb 0.00 61846.0000000 FORMAT "%13.7" MATRIX_DIM 20 /end CHARACTERISTIC
/begin CHARACTERISTIC DFES_EnvDid.xSet2_CA "" VAL_BLK 0x8024E1E4 ValA_Wu16 61846.0000000 DID_Verb 0.00 61846.0000000 FORMAT "%13.7" MATRIX_DIM 20 /end CHARACTERISTIC
/begin CHARACTERISTIC DFES_EnvDid.xSet3_CA "" VAL_BLK 0x8024E20C ValA_Wu16 61846.0000000 DID_Verb 0.00 61846.0000000 FORMAT "%13.7" MATRIX_DIM 20 /end CHARACTERISTIC
/begin CHARACTERISTIC DFES_EnvDid.xSet4_CA "" VAL_BLK 0x8024E234 ValA_Wu16 61846.0000000 DID_Verb 0.00 61846.0000000 FORMAT "%13.7" MATRIX_DIM 20 /end CHARACTERISTIC
/begin CHARACTERISTIC DFES_EnvDid.xSet5_CA "" VAL_BLK 0x8024E25C ValA_Wu16 61846.0000000 DID_Verb 0.00 61846.0000000 FORMAT "%13.7" MATRIX_DIM 20 /end CHARACTERISTIC
/begin CHARACTERISTIC DFES_EnvDid.xSet6_CA "" VAL_BLK 0x8024E284 ValA_Wu16 61846.0000000 DID_Verb 0.00 61846.0000000 FORMAT "%13.7" MATRIX_DIM 20 /end CHARACTERISTIC
/begin CHARACTERISTIC DFES_EnvDid.xSet7_CA "" VAL_BLK 0x8024E2AC ValA_Wu16 61846.0000000 DID_Verb 0.00 61846.0000000 FORMAT "%13.7" MATRIX_DIM 20 /end CHARACTERISTIC
/begin CHARACTERISTIC DFES_EnvDid.xSet8_CA "" VAL_BLK 0x8024E2D4 ValA_Wu16 61846.0000000 DID_Verb 0.00 61846.0000000 FORMAT "%13.7" MATRIX_DIM 20 /end CHARACTERISTIC
/begin CHARACTERISTIC DFES_EnvDid.xSet9_CA "" VAL_BLK 0x8024E2FC ValA_Wu16 61846.0000000 DID_Verb 0.00 61846.0000000 FORMAT "%13.7" MATRIX_DIM 20 /end CHARACTERISTIC
/begin CHARACTERISTIC DFES_EnvDid.xSet10_CA "" VAL_BLK 0x8024E324 ValA_Wu16 61846.0000000 DID_Verb 0.00 61846.0000000 FORMAT "%13.7" MATRIX_DIM 20 /end CHARACTERISTIC
/begin CHARACTERISTIC DFES_EnvDid.xSet11_CA "" VAL_BLK 0x8024E34C ValA_Wu16 61846.0000000 DID_Verb 0.00 61846.0000000 FORMAT "%13.7" MATRIX_DIM 20 /end CHARACTERISTIC
/begin CHARACTERISTIC DFES_EnvDid.xSet12_CA "" VAL_BLK 0x8024E374 ValA_Wu16 61846.0000000 DID_Verb 0.00 61846.0000000 FORMAT "%13.7" MATRIX_DIM 20 /end CHARACTERISTIC
/begin CHARACTERISTIC DFES_EnvDid.xSet13_CA "" VAL_BLK 0x8024E39C ValA_Wu16 61846.0000000 DID_Verb 0.00 61846.0000000 FORMAT "%13.7" MATRIX_DIM 20 /end CHARACTERISTIC
/begin CHARACTERISTIC DFES_EnvDid.xSet14_CA "" VAL_BLK 0x8024E3C4 ValA_Wu16 61846.0000000 DID_Verb 0.00 61846.0000000 FORMAT "%13.7" MATRIX_DIM 20 /end CHARACTERISTIC
/begin CHARACTERISTIC DFES_EnvDid.xSet15_CA "" VAL_BLK 0x8024E3EC ValA_Wu16 61846.0000000 DID_Verb 0.00 61846.0000000 FORMAT "%13.7" MATRIX_DIM 20 /end CHARACTERISTIC
/begin CHARACTERISTIC DFES_EnvDid.xSet16_CA "" VAL_BLK 0x8024E414 ValA_Wu16 61846.0000000 DID_Verb 0.00 61846.0000000 FORMAT "%13.7" MATRIX_DIM 20 /end CHARACTERISTIC
/begin CHARACTERISTIC DFES_EnvDid.xSet17_CA "" VAL_BLK 0x8024E43C ValA_Wu16 61846.0000000 DID_Verb 0.00 61846.0000000 FORMAT "%13.7" MATRIX_DIM 20 /end CHARACTERISTIC
/begin CHARACTERISTIC DFES_EnvDid.xSet18_CA "" VAL_BLK 0x8024E464 ValA_Wu16 61846.0000000 DID_Verb 0.00 61846.0000000 FORMAT "%13.7" MATRIX_DIM 20 /end CHARACTERISTIC
/begin CHARACTERISTIC DFES_EnvDid.xSet19_CA "" VAL_BLK 0x8024E48C ValA_Wu16 61846.0000000 DID_Verb 0.00 61846.0000000 FORMAT "%13.7" MATRIX_DIM 20 /end CHARACTERISTIC
/begin CHARACTERISTIC DFES_EnvDid.xSet20_CA "" VAL_BLK 0x8024E4B4 ValA_Wu16 61846.0000000 DID_Verb 0.00 61846.0000000 FORMAT "%13.7" MATRIX_DIM 20 /end CHARACTERISTIC
/begin CHARACTERISTIC DFES_EnvDid.xSet21_CA "" VAL_BLK 0x8024E4DC ValA_Wu16 61846.0000000 DID_Verb 0.00 61846.0000000 FORMAT "%13.7" MATRIX_DIM 20 /end CHARACTERISTIC
/begin CHARACTERISTIC DFES_EnvDid.xSet22_CA "" VAL_BLK 0x8024E504 ValA_Wu16 61846.0000000 DID_Verb 0.00 61846.0000000 FORMAT "%13.7" MATRIX_DIM 20 /end CHARACTERISTIC
/begin CHARACTERISTIC DFES_EnvDid.xSet23_CA "" VAL_BLK 0x8024E52C ValA_Wu16 61846.0000000 DID_Verb 0.00 61846.0000000 FORMAT "%13.7" MATRIX_DIM 20 /end CHARACTERISTIC
/begin CHARACTERISTIC DFES_EnvDid.xSet24_CA "" VAL_BLK 0x8024E554 ValA_Wu16 61846.0000000 DID_Verb 0.00 61846.0000000 FORMAT "%13.7" MATRIX_DIM 20 /end CHARACTERISTIC
/begin CHARACTERISTIC DFES_EnvDid.xSet25_CA "" VAL_BLK 0x8024E57C ValA_Wu16 61846.0000000 DID_Verb 0.00 61846.0000000 FORMAT "%13.7" MATRIX_DIM 20 /end CHARACTERISTIC
/begin CHARACTERISTIC DFES_EnvDid.xSet26_CA "" VAL_BLK 0x8024E5A4 ValA_Wu16 61846.0000000 DID_Verb 0.00 61846.0000000 FORMAT "%13.7" MATRIX_DIM 20 /end CHARACTERISTIC
/begin CHARACTERISTIC DFES_EnvDid.xSet27_CA "" VAL_BLK 0x8024E5CC ValA_Wu16 61846.0000000 DID_Verb 0.00 61846.0000000 FORMAT "%13.7" MATRIX_DIM 20 /end CHARACTERISTIC
/begin CHARACTERISTIC DFES_EnvDid.xSet28_CA "" VAL_BLK 0x8024E5F4 ValA_Wu16 61846.0000000 DID_Verb 0.00 61846.0000000 FORMAT "%13.7" MATRIX_DIM 20 /end CHARACTERISTIC
/begin CHARACTERISTIC DFES_EnvDid.xSet29_CA "" VAL_BLK 0x8024E61C ValA_Wu16 61846.0000000 DID_Verb 0.00 61846.0000000 FORMAT "%13.7" MATRIX_DIM 20 /end CHARACTERISTIC
/begin CHARACTERISTIC DFES_EnvDid.xSet30_CA "" VAL_BLK 0x8024E644 ValA_Wu16 61846.0000000 DID_Verb 0.00 61846.0000000 FORMAT "%13.7" MATRIX_DIM 20 /end CHARACTERISTIC
/begin CHARACTERISTIC DFES_EnvRef.DFC_Unused_C "" VALUE 0x8024DA30 Val_Wu8 29.0000000000 DFES_EnvTabVerb 0.00 29.0000000000 FORMAT "%13.10" READ_ONLY /end CHARACTERISTIC
/begin CHARACTERISTIC DFES_EnvRef.DFC_ACCmprFltLvlRes_C "" VALUE 0x8024DA31 Val_Wu8 29.0000000000 DFES_EnvTabVerb 0.00 29.0000000000 FORMAT "%13.10" /end CHARACTERISTIC
/begin CHARACTERISTIC DFES_EnvRef.DFC_AbgHiSigFlt_C "" VALUE 0x8024DA32 Val_Wu8 29.0000000000 DFES_EnvTabVerb 0.00 29.0000000000 FORMAT "%13.10" /end CHARACTERISTIC
/begin CHARACTERISTIC DFES_EnvRef.DFC_AbgIntPatFlt_C "" VALUE 0x8024DA33 Val_Wu8 29.0000000000 DFES_EnvTabVerb 0.00 29.0000000000 FORMAT "%13.10" /end CHARACTERISTIC
/begin CHARACTERISTIC DFES_EnvRef.DFC_AbgLoSigFlt_C "" VALUE 0x8024DA34 Val_Wu8 29.0000000000 DFES_EnvTabVerb 0.00 29.0000000000 FORMAT "%13.10" /end CHARACTERISTIC
/begin CHARACTERISTIC DFES_EnvRef.DFC_AbgUnkwnErrSigFlt_C "" VALUE 0x8024DA35 Val_Wu8 29.0000000000 DFES_EnvTabVerb 0.00 29.0000000000 FORMAT "%13.10" /end CHARACTERISTIC
/begin CHARACTERISTIC DFES_EnvRef.DFC_AcExtChrgrIBattExcdd_C "" VALUE 0x8024DA36 Val_Wu8 29.0000000000 DFES_EnvTabVerb 0.00 29.0000000000 FORMAT "%13.10" /end CHARACTERISTIC
/begin CHARACTERISTIC DFES_EnvRef.DFC_AcExtChrgrIInExcdd_C "" VALUE 0x8024DA37 Val_Wu8 29.0000000000 DFES_EnvTabVerb 0.00 29.0000000000 FORMAT "%13.10" /end CHARACTERISTIC
/begin CHARACTERISTIC DFES_EnvRef.DFC_AcExtChrgrIOutDe_C "" VALUE 0x8024DA38 Val_Wu8 29.0000000000 DFES_EnvTabVerb 0.00 29.0000000000 FORMAT "%13.10" /end CHARACTERISTIC
/begin CHARACTERISTIC DFES_EnvRef.DFC_AcExtChrgrIOutExcdd_C "" VALUE 0x8024DA39 Val_Wu8 29.0000000000 DFES_EnvTabVerb 0.00 29.0000000000 FORMAT "%13.10" /end CHARACTERISTIC
/begin CHARACTERISTIC DFES_EnvRef.DFC_AcExtChrgrUOutDe_C "" VALUE 0x8024DA3A Val_Wu8 29.0000000000 DFES_EnvTabVerb 0.00 29.0000000000 FORMAT "%13.10" /end CHARACTERISTIC
/begin CHARACTERISTIC DFES_EnvRef.DFC_AdpActvDChaFailr_C "" VALUE 0x8024DA3B Val_Wu8 29.0000000000 DFES_EnvTabVerb 0.00 29.0000000000 FORMAT "%13.10" /end CHARACTERISTIC
/begin CHARACTERISTIC DFES_EnvRef.DFC_AirbcuFlt_C "" VALUE 0x8024DA3C Val_Wu8 29.0000000000 DFES_EnvTabVerb 0.00 29.0000000000 FORMAT "%13.10" /end CHARACTERISTIC
/begin CHARACTERISTIC DFES_EnvRef.DFC_Airbg_C "" VALUE 0x8024DA3D Val_Wu8 29.0000000000 DFES_EnvTabVerb 0.00 29.0000000000 FORMAT "%13.10" /end CHARACTERISTIC
/begin CHARACTERISTIC DFES_EnvRef.DFC_AirbgCan_C "" VALUE 0x8024DA3E Val_Wu8 29.0000000000 DFES_EnvTabVerb 0.00 29.0000000000 FORMAT "%13.10" /end CHARACTERISTIC
/begin CHARACTERISTIC DFES_EnvRef.DFC_AirbgCanHWPlaus_C "" VALUE 0x8024DA3F Val_Wu8 29.0000000000 DFES_EnvTabVerb 0.00 29.0000000000 FORMAT "%13.10" /end CHARACTERISTIC
/begin CHARACTERISTIC DFES_EnvRef.DFC_AirbgHWCanPlaus_C "" VALUE 0x8024DA40 Val_Wu8 29.0000000000 DFES_EnvTabVerb 0.00 29.0000000000 FORMAT "%13.10" /end CHARACTERISTIC
/begin CHARACTERISTIC DFES_EnvRef.DFC_AirbgMnr_C "" VALUE 0x8024DA41 Val_Wu8 29.0000000000 DFES_EnvTabVerb 0.00 29.0000000000 FORMAT "%13.10" /end CHARACTERISTIC
/begin CHARACTERISTIC DFES_EnvRef.DFC_AirbgPerHi_C "" VALUE 0x8024DA42 Val_Wu8 29.0000000000 DFES_EnvTabVerb 0.00 29.0000000000 FORMAT "%13.10" /end CHARACTERISTIC
/begin CHARACTERISTIC DFES_EnvRef.DFC_AirbgPerdRngFlt_C "" VALUE 0x8024DA43 Val_Wu8 29.0000000000 DFES_EnvTabVerb 0.00 29.0000000000 FORMAT "%13.10" /end CHARACTERISTIC
/begin CHARACTERISTIC DFES_EnvRef.DFC_BlowrRlyErr_C "" VALUE 0x8024DA44 Val_Wu8 29.0000000000 DFES_EnvTabVerb 0.00 29.0000000000 FORMAT "%13.10" /end CHARACTERISTIC
/begin CHARACTERISTIC DFES_EnvRef.DFC_BrkBstPmpActtnDfct_C "" VALUE 0x8024DA45 Val_Wu8 29.0000000000 DFES_EnvTabVerb 0.00 29.0000000000 FORMAT "%13.10" /end CHARACTERISTIC
/begin CHARACTERISTIC DFES_EnvRef.DFC_BrkBstPmpDeactvnDfct_C "" VALUE 0x8024DA46 Val_Wu8 29.0000000000 DFES_EnvTabVerb 0.00 29.0000000000 FORMAT "%13.10" /end CHARACTERISTIC
/begin CHARACTERISTIC DFES_EnvRef.DFC_BrkSwtFlt_C "" VALUE 0x8024DA47 Val_Wu8 29.0000000000 DFES_EnvTabVerb 0.00 29.0000000000 FORMAT "%13.10" /end CHARACTERISTIC
/begin CHARACTERISTIC DFES_EnvRef.DFC_CbnHeatgHeatrHsScb_C "" VALUE 0x8024DA48 Val_Wu8 29.0000000000 DFES_EnvTabVerb 0.00 29.0000000000 FORMAT "%13.10" /end CHARACTERISTIC
/begin CHARACTERISTIC DFES_EnvRef.DFC_CbnHeatgHeatrHsScg_C "" VALUE 0x8024DA49 Val_Wu8 29.0000000000 DFES_EnvTabVerb 0.00 29.0000000000 FORMAT "%13.10" /end CHARACTERISTIC
/begin CHARACTERISTIC DFES_EnvRef.DFC_CbnHeatgHeatrLsOl_C "" VALUE 0x8024DA4A Val_Wu8 29.0000000000 DFES_EnvTabVerb 0.00 29.0000000000 FORMAT "%13.10" /end CHARACTERISTIC
/begin CHARACTERISTIC DFES_EnvRef.DFC_CbnHeatgHeatrLsScb_C "" VALUE 0x8024DA4B Val_Wu8 29.0000000000 DFES_EnvTabVerb 0.00 29.0000000000 FORMAT "%13.10" /end CHARACTERISTIC
/begin CHARACTERISTIC DFES_EnvRef.DFC_CbnHeatgHeatrLsScg_C "" VALUE 0x8024DA4C Val_Wu8 29.0000000000 DFES_EnvTabVerb 0.00 29.0000000000 FORMAT "%13.10" /end CHARACTERISTIC
/begin CHARACTERISTIC DFES_EnvRef.DFC_CbnHeatgHeatrUnUsed_C "" VALUE 0x8024DA4D Val_Wu8 29.0000000000 DFES_EnvTabVerb 0.00 29.0000000000 FORMAT "%13.10" /end CHARACTERISTIC
/begin CHARACTERISTIC DFES_EnvRef.DFC_ChrgnCntctHsOt_C "" VALUE 0x8024DA4E Val_Wu8 29.0000000000 DFES_EnvTabVerb 0.00 29.0000000000 FORMAT "%13.10" /end CHARACTERISTIC
/begin CHARACTERISTIC DFES_EnvRef.DFC_ChrgnCntctHsScb_C "" VALUE 0x8024DA4F Val_Wu8 29.0000000000 DFES_EnvTabVerb 0.00 29.0000000000 FORMAT "%13.10" /end CHARACTERISTIC
/begin CHARACTERISTIC DFES_EnvRef.DFC_ChrgnCntctHsScg_C "" VALUE 0x8024DA50 Val_Wu8 29.0000000000 DFES_EnvTabVerb 0.00 29.0000000000 FORMAT "%13.10" /end CHARACTERISTIC
/begin CHARACTERISTIC DFES_EnvRef.DFC_ChrgnCntctLsNegOl_C "" VALUE 0x8024DA51 Val_Wu8 29.0000000000 DFES_EnvTabVerb 0.00 29.0000000000 FORMAT "%13.10" /end CHARACTERISTIC
/begin CHARACTERISTIC DFES_EnvRef.DFC_ChrgnCntctLsNegOt_C "" VALUE 0x8024DA52 Val_Wu8 29.0000000000 DFES_EnvTabVerb 0.00 29.0000000000 FORMAT "%13.10" /end CHARACTERISTIC
/begin CHARACTERISTIC DFES_EnvRef.DFC_ChrgnCntctLsNegScb_C "" VALUE 0x8024DA53 Val_Wu8 29.0000000000 DFES_EnvTabVerb 0.00 29.0000000000 FORMAT "%13.10" /end CHARACTERISTIC
/begin CHARACTERISTIC DFES_EnvRef.DFC_ChrgnCntctLsNegScg_C "" VALUE 0x8024DA54 Val_Wu8 29.0000000000 DFES_EnvTabVerb 0.00 29.0000000000 FORMAT "%13.10" /end CHARACTERISTIC
/begin CHARACTERISTIC DFES_EnvRef.DFC_ChrgnCntctLsPosOl_C "" VALUE 0x8024DA55 Val_Wu8 29.0000000000 DFES_EnvTabVerb 0.00 29.0000000000 FORMAT "%13.10" /end CHARACTERISTIC
/begin CHARACTERISTIC DFES_EnvRef.DFC_ChrgnCntctLsPosOt_C "" VALUE 0x8024DA56 Val_Wu8 29.0000000000 DFES_EnvTabVerb 0.00 29.0000000000 FORMAT "%13.10" /end CHARACTERISTIC
/begin CHARACTERISTIC DFES_EnvRef.DFC_ChrgnCntctLsPosScb_C "" VALUE 0x8024DA57 Val_Wu8 29.0000000000 DFES_EnvTabVerb 0.00 29.0000000000 FORMAT "%13.10" /end CHARACTERISTIC
/begin CHARACTERISTIC DFES_EnvRef.DFC_ChrgnCntctLsPosScg_C "" VALUE 0x8024DA58 Val_Wu8 29.0000000000 DFES_EnvTabVerb 0.00 29.0000000000 FORMAT "%13.10" /end CHARACTERISTIC
/begin CHARACTERISTIC DFES_EnvRef.DFC_ChrgnCntctUnUsed_C "" VALUE 0x8024DA59 Val_Wu8 29.0000000000 DFES_EnvTabVerb 0.00 29.0000000000 FORMAT "%13.10" /end CHARACTERISTIC
/begin CHARACTERISTIC DFES_EnvRef.DFC_ComBrkMai_C "" VALUE 0x8024DA5A Val_Wu8 29.0000000000 DFES_EnvTabVerb 0.00 29.0000000000 FORMAT "%13.10" /end CHARACTERISTIC
/begin CHARACTERISTIC DFES_EnvRef.DFC_ComChrgrEVCont_C "" VALUE 0x8024DA5B Val_Wu8 29.0000000000 DFES_EnvTabVerb 0.00 29.0000000000 FORMAT "%13.10" /end CHARACTERISTIC
/begin CHARACTERISTIC DFES_EnvRef.DFC_ComChrgrEVtBlink_C "" VALUE 0x8024DA5C Val_Wu8 29.0000000000 DFES_EnvTabVerb 0.00 29.0000000000 FORMAT "%13.10" /end CHARACTERISTIC
/begin CHARACTERISTIC DFES_EnvRef.DFC_ComChrgrMstBlink_C "" VALUE 0x8024DA5D Val_Wu8 29.0000000000 DFES_EnvTabVerb 0.00 29.0000000000 FORMAT "%13.10" /end CHARACTERISTIC
/begin CHARACTERISTIC DFES_EnvRef.DFC_ComChrgrMstCont_C "" VALUE 0x8024DA5E Val_Wu8 29.0000000000 DFES_EnvTabVerb 0.00 29.0000000000 FORMAT "%13.10" /end CHARACTERISTIC
/begin CHARACTERISTIC DFES_EnvRef.DFC_ComChrgrSVSBlink_C "" VALUE 0x8024DA5F Val_Wu8 29.0000000000 DFES_EnvTabVerb 0.00 29.0000000000 FORMAT "%13.10" /end CHARACTERISTIC
/begin CHARACTERISTIC DFES_EnvRef.DFC_ComChrgrSVSCont_C "" VALUE 0x8024DA60 Val_Wu8 29.0000000000 DFES_EnvTabVerb 0.00 29.0000000000 FORMAT "%13.10" /end CHARACTERISTIC
/begin CHARACTERISTIC DFES_EnvRef.DFC_ComDcdcEVBlink_C "" VALUE 0x8024DA61 Val_Wu8 29.0000000000 DFES_EnvTabVerb 0.00 29.0000000000 FORMAT "%13.10" /end CHARACTERISTIC
/begin CHARACTERISTIC DFES_EnvRef.DFC_ComDcdcEVCont_C "" VALUE 0x8024DA62 Val_Wu8 29.0000000000 DFES_EnvTabVerb 0.00 29.0000000000 FORMAT "%13.10" /end CHARACTERISTIC
/begin CHARACTERISTIC DFES_EnvRef.DFC_ComDcdcFltLvl2_C "" VALUE 0x8024DA63 Val_Wu8 29.0000000000 DFES_EnvTabVerb 0.00 29.0000000000 FORMAT "%13.10" /end CHARACTERISTIC
/begin CHARACTERISTIC DFES_EnvRef.DFC_ComDcdcFltLvl3_C "" VALUE 0x8024DA64 Val_Wu8 29.0000000000 DFES_EnvTabVerb 0.00 29.0000000000 FORMAT "%13.10" /end CHARACTERISTIC
/begin CHARACTERISTIC DFES_EnvRef.DFC_ComDcdcFltLvl4_C "" VALUE 0x8024DA65 Val_Wu8 29.0000000000 DFES_EnvTabVerb 0.00 29.0000000000 FORMAT "%13.10" /end CHARACTERISTIC
/begin CHARACTERISTIC DFES_EnvRef.DFC_ComDcdcFltLvl5_C "" VALUE 0x8024DA66 Val_Wu8 29.0000000000 DFES_EnvTabVerb 0.00 29.0000000000 FORMAT "%13.10" /end CHARACTERISTIC
/begin CHARACTERISTIC DFES_EnvRef.DFC_ComDcdcFltLvlRes_C "" VALUE 0x8024DA67 Val_Wu8 29.0000000000 DFES_EnvTabVerb 0.00 29.0000000000 FORMAT "%13.10" /end CHARACTERISTIC
/begin CHARACTERISTIC DFES_EnvRef.DFC_ComDcdcMstBlink_C "" VALUE 0x8024DA68 Val_Wu8 29.0000000000 DFES_EnvTabVerb 0.00 29.0000000000 FORMAT "%13.10" /end CHARACTERISTIC
/begin CHARACTERISTIC DFES_EnvRef.DFC_ComDcdcMstCont_C "" VALUE 0x8024DA69 Val_Wu8 29.0000000000 DFES_EnvTabVerb 0.00 29.0000000000 FORMAT "%13.10" /end CHARACTERISTIC
/begin CHARACTERISTIC DFES_EnvRef.DFC_ComDcdcSVSBlink_C "" VALUE 0x8024DA6A Val_Wu8 29.0000000000 DFES_EnvTabVerb 0.00 29.0000000000 FORMAT "%13.10" /end CHARACTERISTIC
/begin CHARACTERISTIC DFES_EnvRef.DFC_ComDcdcSVSCont_C "" VALUE 0x8024DA6B Val_Wu8 29.0000000000 DFES_EnvTabVerb 0.00 29.0000000000 FORMAT "%13.10" /end CHARACTERISTIC
/begin CHARACTERISTIC DFES_EnvRef.DFC_ComElMIIvtrFltLvl2_C "" VALUE 0x8024DA6C Val_Wu8 29.0000000000 DFES_EnvTabVerb 0.00 29.0000000000 FORMAT "%13.10" /end CHARACTERISTIC
/begin CHARACTERISTIC DFES_EnvRef.DFC_ComElMIIvtrFltLvl3_C "" VALUE 0x8024DA6D Val_Wu8 29.0000000000 DFES_EnvTabVerb 0.00 29.0000000000 FORMAT "%13.10" /end CHARACTERISTIC
/begin CHARACTERISTIC DFES_EnvRef.DFC_ComElMIIvtrFltLvl4_C "" VALUE 0x8024DA6E Val_Wu8 29.0000000000 DFES_EnvTabVerb 0.00 29.0000000000 FORMAT "%13.10" /end CHARACTERISTIC
/begin CHARACTERISTIC DFES_EnvRef.DFC_ComElMIIvtrFltLvl5_C "" VALUE 0x8024DA6F Val_Wu8 29.0000000000 DFES_EnvTabVerb 0.00 29.0000000000 FORMAT "%13.10" /end CHARACTERISTIC
/begin CHARACTERISTIC DFES_EnvRef.DFC_ComElMIIvtrFltLvlRes_C "" VALUE 0x8024DA70 Val_Wu8 29.0000000000 DFES_EnvTabVerb 0.00 29.0000000000 FORMAT "%13.10" /end CHARACTERISTIC
/begin CHARACTERISTIC DFES_EnvRef.DFC_ComEmacEVBlink_C "" VALUE 0x8024DA71 Val_Wu8 29.0000000000 DFES_EnvTabVerb 0.00 29.0000000000 FORMAT "%13.10" /end CHARACTERISTIC
/begin CHARACTERISTIC DFES_EnvRef.DFC_ComEmacEVCont_C "" VALUE 0x8024DA72 Val_Wu8 29.0000000000 DFES_EnvTabVerb 0.00 29.0000000000 FORMAT "%13.10" /end CHARACTERISTIC
/begin CHARACTERISTIC DFES_EnvRef.DFC_ComEmacMstCont_C "" VALUE 0x8024DA73 Val_Wu8 29.0000000000 DFES_EnvTabVerb 0.00 29.0000000000 FORMAT "%13.10" /end CHARACTERISTIC
/begin CHARACTERISTIC DFES_EnvRef.DFC_ComEmacMsttBlink_C "" VALUE 0x8024DA74 Val_Wu8 29.0000000000 DFES_EnvTabVerb 0.00 29.0000000000 FORMAT "%13.10" /end CHARACTERISTIC
/begin CHARACTERISTIC DFES_EnvRef.DFC_ComEmacSVSBlink_C "" VALUE 0x8024DA75 Val_Wu8 29.0000000000 DFES_EnvTabVerb 0.00 29.0000000000 FORMAT "%13.10" /end CHARACTERISTIC
/begin CHARACTERISTIC DFES_EnvRef.DFC_ComEmacSVSCont_C "" VALUE 0x8024DA76 Val_Wu8 29.0000000000 DFES_EnvTabVerb 0.00 29.0000000000 FORMAT "%13.10" /end CHARACTERISTIC
/begin CHARACTERISTIC DFES_EnvRef.DFC_ComGunCntInfoWkuReq_C "" VALUE 0x8024DA77 Val_Wu8 29.0000000000 DFES_EnvTabVerb 0.00 29.0000000000 FORMAT "%13.10" /end CHARACTERISTIC
/begin CHARACTERISTIC DFES_EnvRef.DFC_ComHillHldFlt_C "" VALUE 0x8024DA78 Val_Wu8 29.0000000000 DFES_EnvTabVerb 0.00 29.0000000000 FORMAT "%13.10" /end CHARACTERISTIC
/begin CHARACTERISTIC DFES_EnvRef.DFC_ComHvBattRchrgWkuReq_C "" VALUE 0x8024DA79 Val_Wu8 29.0000000000 DFES_EnvTabVerb 0.00 29.0000000000 FORMAT "%13.10" /end CHARACTERISTIC
/begin CHARACTERISTIC DFES_EnvRef.DFC_ComHvbFltLvl2_C "" VALUE 0x8024DA7A Val_Wu8 29.0000000000 DFES_EnvTabVerb 0.00 29.0000000000 FORMAT "%13.10" /end CHARACTERISTIC
/begin CHARACTERISTIC DFES_EnvRef.DFC_ComHvbFltLvl3_C "" VALUE 0x8024DA7B Val_Wu8 29.0000000000 DFES_EnvTabVerb 0.00 29.0000000000 FORMAT "%13.10" /end CHARACTERISTIC
/begin CHARACTERISTIC DFES_EnvRef.DFC_ComHvbFltLvl4_C "" VALUE 0x8024DA7C Val_Wu8 29.0000000000 DFES_EnvTabVerb 0.00 29.0000000000 FORMAT "%13.10" /end CHARACTERISTIC
/begin CHARACTERISTIC DFES_EnvRef.DFC_ComHvbFltLvl5_C "" VALUE 0x8024DA7D Val_Wu8 29.0000000000 DFES_EnvTabVerb 0.00 29.0000000000 FORMAT "%13.10" /end CHARACTERISTIC
/begin CHARACTERISTIC DFES_EnvRef.DFC_ComHvbFltLvlRes_C "" VALUE 0x8024DA7E Val_Wu8 29.0000000000 DFES_EnvTabVerb 0.00 29.0000000000 FORMAT "%13.10" /end CHARACTERISTIC
/begin CHARACTERISTIC DFES_EnvRef.DFC_ComHvbMstBlink_C "" VALUE 0x8024DA7F Val_Wu8 29.0000000000 DFES_EnvTabVerb 0.00 29.0000000000 FORMAT "%13.10" /end CHARACTERISTIC
/begin CHARACTERISTIC DFES_EnvRef.DFC_ComHvbMstCont_C "" VALUE 0x8024DA80 Val_Wu8 29.0000000000 DFES_EnvTabVerb 0.00 29.0000000000 FORMAT "%13.10" /end CHARACTERISTIC
/begin CHARACTERISTIC DFES_EnvRef.DFC_ComImmoUnlockWkuReq_C "" VALUE 0x8024DA81 Val_Wu8 29.0000000000 DFES_EnvTabVerb 0.00 29.0000000000 FORMAT "%13.10" /end CHARACTERISTIC
/begin CHARACTERISTIC DFES_EnvRef.DFC_ComInfoReqPtlWkuReq_C "" VALUE 0x8024DA82 Val_Wu8 29.0000000000 DFES_EnvTabVerb 0.00 29.0000000000 FORMAT "%13.10" /end CHARACTERISTIC
/begin CHARACTERISTIC DFES_EnvRef.DFC_ComOBCFltLvl2_C "" VALUE 0x8024DA83 Val_Wu8 29.0000000000 DFES_EnvTabVerb 0.00 29.0000000000 FORMAT "%13.10" /end CHARACTERISTIC
/begin CHARACTERISTIC DFES_EnvRef.DFC_ComOBCFltLvl3_C "" VALUE 0x8024DA84 Val_Wu8 29.0000000000 DFES_EnvTabVerb 0.00 29.0000000000 FORMAT "%13.10" /end CHARACTERISTIC
/begin CHARACTERISTIC DFES_EnvRef.DFC_ComOBCFltLvl4_C "" VALUE 0x8024DA85 Val_Wu8 29.0000000000 DFES_EnvTabVerb 0.00 29.0000000000 FORMAT "%13.10" /end CHARACTERISTIC
/begin CHARACTERISTIC DFES_EnvRef.DFC_ComOBCFltLvl5_C "" VALUE 0x8024DA86 Val_Wu8 29.0000000000 DFES_EnvTabVerb 0.00 29.0000000000 FORMAT "%13.10" /end CHARACTERISTIC
/begin CHARACTERISTIC DFES_EnvRef.DFC_ComOBCFltLvlRes_C "" VALUE 0x8024DA87 Val_Wu8 29.0000000000 DFES_EnvTabVerb 0.00 29.0000000000 FORMAT "%13.10" /end CHARACTERISTIC
/begin CHARACTERISTIC DFES_EnvRef.DFC_ComPostOperationWkuReq_C "" VALUE 0x8024DA88 Val_Wu8 29.0000000000 DFES_EnvTabVerb 0.00 29.0000000000 FORMAT "%13.10" /end CHARACTERISTIC
/begin CHARACTERISTIC DFES_EnvRef.DFC_ComPreCondElecWkuReq_C "" VALUE 0x8024DA89 Val_Wu8 29.0000000000 DFES_EnvTabVerb 0.00 29.0000000000 FORMAT "%13.10" /end CHARACTERISTIC
/begin CHARACTERISTIC DFES_EnvRef.DFC_ComRemUnlckWkuReq_C "" VALUE 0x8024DA8A Val_Wu8 29.0000000000 DFES_EnvTabVerb 0.00 29.0000000000 FORMAT "%13.10" /end CHARACTERISTIC
/begin CHARACTERISTIC DFES_EnvRef.DFC_ComStpDlyHMIWkuReq_C "" VALUE 0x8024DA8B Val_Wu8 29.0000000000 DFES_EnvTabVerb 0.00 29.0000000000 FORMAT "%13.10" /end CHARACTERISTIC
/begin CHARACTERISTIC DFES_EnvRef.DFC_ComflgCurMeasmtErr_C "" VALUE 0x8024DA8C Val_Wu8 29.0000000000 DFES_EnvTabVerb 0.00 29.0000000000 FORMAT "%13.10" /end CHARACTERISTIC
/begin CHARACTERISTIC DFES_EnvRef.DFC_ComflgCurMeasmtSysErr_C "" VALUE 0x8024DA8D Val_Wu8 29.0000000000 DFES_EnvTabVerb 0.00 29.0000000000 FORMAT "%13.10" /end CHARACTERISTIC
/begin CHARACTERISTIC DFES_EnvRef.DFC_ComflgCurMeasmtVld_C "" VALUE 0x8024DA8E Val_Wu8 29.0000000000 DFES_EnvTabVerb 0.00 29.0000000000 FORMAT "%13.10" /end CHARACTERISTIC
/begin CHARACTERISTIC DFES_EnvRef.DFC_ComflgCurRngErr_C "" VALUE 0x8024DA8F Val_Wu8 29.0000000000 DFES_EnvTabVerb 0.00 29.0000000000 FORMAT "%13.10" /end CHARACTERISTIC
/begin CHARACTERISTIC DFES_EnvRef.DFC_ComflgTPcbMeasmtErr_C "" VALUE 0x8024DA90 Val_Wu8 29.0000000000 DFES_EnvTabVerb 0.00 29.0000000000 FORMAT "%13.10" /end CHARACTERISTIC
/begin CHARACTERISTIC DFES_EnvRef.DFC_ComflgTPcbMeasmtVld_C "" VALUE 0x8024DA91 Val_Wu8 29.0000000000 DFES_EnvTabVerb 0.00 29.0000000000 FORMAT "%13.10" /end CHARACTERISTIC
/begin CHARACTERISTIC DFES_EnvRef.DFC_ComflgTPcbRngErr_C "" VALUE 0x8024DA92 Val_Wu8 29.0000000000 DFES_EnvTabVerb 0.00 29.0000000000 FORMAT "%13.10" /end CHARACTERISTIC
/begin CHARACTERISTIC DFES_EnvRef.DFC_ComflgTPcbSysErr_C "" VALUE 0x8024DA93 Val_Wu8 29.0000000000 DFES_EnvTabVerb 0.00 29.0000000000 FORMAT "%13.10" /end CHARACTERISTIC
/begin CHARACTERISTIC DFES_EnvRef.DFC_ComflgTShntMeasmtErr_C "" VALUE 0x8024DA94 Val_Wu8 29.0000000000 DFES_EnvTabVerb 0.00 29.0000000000 FORMAT "%13.10" /end CHARACTERISTIC
/begin CHARACTERISTIC DFES_EnvRef.DFC_ComflgTShntMeasmtVld_C "" VALUE 0x8024DA95 Val_Wu8 29.0000000000 DFES_EnvTabVerb 0.00 29.0000000000 FORMAT "%13.10" /end CHARACTERISTIC
/begin CHARACTERISTIC DFES_EnvRef.DFC_ComflgTShntRngErr_C "" VALUE 0x8024DA96 Val_Wu8 29.0000000000 DFES_EnvTabVerb 0.00 29.0000000000 FORMAT "%13.10" /end CHARACTERISTIC
/begin CHARACTERISTIC DFES_EnvRef.DFC_ComflgTShntSysErr_C "" VALUE 0x8024DA97 Val_Wu8 29.0000000000 DFES_EnvTabVerb 0.00 29.0000000000 FORMAT "%13.10" /end CHARACTERISTIC
/begin CHARACTERISTIC DFES_EnvRef.DFC_ComflgVoltMeasmtErr_C "" VALUE 0x8024DA98 Val_Wu8 29.0000000000 DFES_EnvTabVerb 0.00 29.0000000000 FORMAT "%13.10" /end CHARACTERISTIC
/begin CHARACTERISTIC DFES_EnvRef.DFC_ComflgVoltMeasmtSysErr_C "" VALUE 0x8024DA99 Val_Wu8 29.0000000000 DFES_EnvTabVerb 0.00 29.0000000000 FORMAT "%13.10" /end CHARACTERISTIC
/begin CHARACTERISTIC DFES_EnvRef.DFC_ComflgVoltMeasmtVld_C "" VALUE 0x8024DA9A Val_Wu8 29.0000000000 DFES_EnvTabVerb 0.00 29.0000000000 FORMAT "%13.10" /end CHARACTERISTIC
/begin CHARACTERISTIC DFES_EnvRef.DFC_ComflgVoltRngErr_C "" VALUE 0x8024DA9B Val_Wu8 29.0000000000 DFES_EnvTabVerb 0.00 29.0000000000 FORMAT "%13.10" /end CHARACTERISTIC
/begin CHARACTERISTIC DFES_EnvRef.DFC_CrashEveOcc_C "" VALUE 0x8024DA9C Val_Wu8 29.0000000000 DFES_EnvTabVerb 0.00 29.0000000000 FORMAT "%13.10" /end CHARACTERISTIC
/begin CHARACTERISTIC DFES_EnvRef.DFC_DcdcFwdModStuck_C "" VALUE 0x8024DA9D Val_Wu8 29.0000000000 DFES_EnvTabVerb 0.00 29.0000000000 FORMAT "%13.10" /end CHARACTERISTIC
/begin CHARACTERISTIC DFES_EnvRef.DFC_DcdcLvUDifMaxFlt_C "" VALUE 0x8024DA9E Val_Wu8 29.0000000000 DFES_EnvTabVerb 0.00 29.0000000000 FORMAT "%13.10" /end CHARACTERISTIC
/begin CHARACTERISTIC DFES_EnvRef.DFC_DcdcOffModStuck_C "" VALUE 0x8024DA9F Val_Wu8 29.0000000000 DFES_EnvTabVerb 0.00 29.0000000000 FORMAT "%13.10" /end CHARACTERISTIC
/begin CHARACTERISTIC DFES_EnvRef.DFC_DcdcOperModFailr_C "" VALUE 0x8024DAA0 Val_Wu8 29.0000000000 DFES_EnvTabVerb 0.00 29.0000000000 FORMAT "%13.10" /end CHARACTERISTIC
/begin CHARACTERISTIC DFES_EnvRef.DFC_DcdcPrecModStuck_C "" VALUE 0x8024DAA1 Val_Wu8 29.0000000000 DFES_EnvTabVerb 0.00 29.0000000000 FORMAT "%13.10" /end CHARACTERISTIC
/begin CHARACTERISTIC DFES_EnvRef.DFC_DrvDoorOpn_C "" VALUE 0x8024DAA2 Val_Wu8 29.0000000000 DFES_EnvTabVerb 0.00 29.0000000000 FORMAT "%13.10" /end CHARACTERISTIC
/begin CHARACTERISTIC DFES_EnvRef.DFC_DrvModPosnDfct_C "" VALUE 0x8024DAA3 Val_Wu8 29.0000000000 DFES_EnvTabVerb 0.00 29.0000000000 FORMAT "%13.10" /end CHARACTERISTIC
/begin CHARACTERISTIC DFES_EnvRef.DFC_DrvStbltOpn_C "" VALUE 0x8024DAA4 Val_Wu8 29.0000000000 DFES_EnvTabVerb 0.00 29.0000000000 FORMAT "%13.10" /end CHARACTERISTIC
/begin CHARACTERISTIC DFES_EnvRef.DFC_ETogFailrLvl3_C "" VALUE 0x8024DAA5 Val_Wu8 29.0000000000 DFES_EnvTabVerb 0.00 29.0000000000 FORMAT "%13.10" /end CHARACTERISTIC
/begin CHARACTERISTIC DFES_EnvRef.DFC_ETogFailrLvl4_C "" VALUE 0x8024DAA6 Val_Wu8 29.0000000000 DFES_EnvTabVerb 0.00 29.0000000000 FORMAT "%13.10" /end CHARACTERISTIC
/begin CHARACTERISTIC DFES_EnvRef.DFC_EbsLvBattSocDiagLo_C "" VALUE 0x8024DAA7 Val_Wu8 29.0000000000 DFES_EnvTabVerb 0.00 29.0000000000 FORMAT "%13.10" /end CHARACTERISTIC
/begin CHARACTERISTIC DFES_EnvRef.DFC_EbsLvBattUDiagDiOper_C "" VALUE 0x8024DAA8 Val_Wu8 29.0000000000 DFES_EnvTabVerb 0.00 29.0000000000 FORMAT "%13.10" /end CHARACTERISTIC
/begin CHARACTERISTIC DFES_EnvRef.DFC_EbsLvBattUDiagFltLvl1_C "" VALUE 0x8024DAA9 Val_Wu8 29.0000000000 DFES_EnvTabVerb 0.00 29.0000000000 FORMAT "%13.10" /end CHARACTERISTIC
/begin CHARACTERISTIC DFES_EnvRef.DFC_EbsLvBattUDiagFltLvl2_C "" VALUE 0x8024DAAA Val_Wu8 29.0000000000 DFES_EnvTabVerb 0.00 29.0000000000 FORMAT "%13.10" /end CHARACTERISTIC
/begin CHARACTERISTIC DFES_EnvRef.DFC_EbsLvBattUDiagLo_C "" VALUE 0x8024DAAB Val_Wu8 29.0000000000 DFES_EnvTabVerb 0.00 29.0000000000 FORMAT "%13.10" /end CHARACTERISTIC
/begin CHARACTERISTIC DFES_EnvRef.DFC_EbsSnsrSt_C "" VALUE 0x8024DAAC Val_Wu8 29.0000000000 DFES_EnvTabVerb 0.00 29.0000000000 FORMAT "%13.10" /end CHARACTERISTIC
/begin CHARACTERISTIC DFES_EnvRef.DFC_EbsSofASILErr_C "" VALUE 0x8024DAAD Val_Wu8 29.0000000000 DFES_EnvTabVerb 0.00 29.0000000000 FORMAT "%13.10" /end CHARACTERISTIC
/begin CHARACTERISTIC DFES_EnvRef.DFC_ElTSPtSysLimDrvErr_C "" VALUE 0x8024DAAE Val_Wu8 29.0000000000 DFES_EnvTabVerb 0.00 29.0000000000 FORMAT "%13.10" /end CHARACTERISTIC
/begin CHARACTERISTIC DFES_EnvRef.DFC_ElTSPtSysLimRgnErr_C "" VALUE 0x8024DAAF Val_Wu8 29.0000000000 DFES_EnvTabVerb 0.00 29.0000000000 FORMAT "%13.10" /end CHARACTERISTIC
/begin CHARACTERISTIC DFES_EnvRef.DFC_HLCCcsFwDwnl_C "" VALUE 0x8024DAB0 Val_Wu8 29.0000000000 DFES_EnvTabVerb 0.00 29.0000000000 FORMAT "%13.10" /end CHARACTERISTIC
/begin CHARACTERISTIC DFES_EnvRef.DFC_HvBattChrgPwrMax_C "" VALUE 0x8024DAB1 Val_Wu8 29.0000000000 DFES_EnvTabVerb 0.00 29.0000000000 FORMAT "%13.10" /end CHARACTERISTIC
/begin CHARACTERISTIC DFES_EnvRef.DFC_HvBattCrashDetd_C "" VALUE 0x8024DAB2 Val_Wu8 29.0000000000 DFES_EnvTabVerb 0.00 29.0000000000 FORMAT "%13.10" /end CHARACTERISTIC
/begin CHARACTERISTIC DFES_EnvRef.DFC_HvBattDchaPwrMax_C "" VALUE 0x8024DAB3 Val_Wu8 29.0000000000 DFES_EnvTabVerb 0.00 29.0000000000 FORMAT "%13.10" /end CHARACTERISTIC
/begin CHARACTERISTIC DFES_EnvRef.DFC_HvBattEmgyOff_C "" VALUE 0x8024DAB4 Val_Wu8 29.0000000000 DFES_EnvTabVerb 0.00 29.0000000000 FORMAT "%13.10" /end CHARACTERISTIC
/begin CHARACTERISTIC DFES_EnvRef.DFC_HvBattEmgyOffIntlck_C "" VALUE 0x8024DAB5 Val_Wu8 29.0000000000 DFES_EnvTabVerb 0.00 29.0000000000 FORMAT "%13.10" /end CHARACTERISTIC
/begin CHARACTERISTIC DFES_EnvRef.DFC_HvBattEmgyOffReq_C "" VALUE 0x8024DAB6 Val_Wu8 29.0000000000 DFES_EnvTabVerb 0.00 29.0000000000 FORMAT "%13.10" /end CHARACTERISTIC
/begin CHARACTERISTIC DFES_EnvRef.DFC_HvBattFltMod_C "" VALUE 0x8024DAB7 Val_Wu8 29.0000000000 DFES_EnvTabVerb 0.00 29.0000000000 FORMAT "%13.10" /end CHARACTERISTIC
/begin CHARACTERISTIC DFES_EnvRef.DFC_HvBattIReqToChrgrErr_C "" VALUE 0x8024DAB8 Val_Wu8 29.0000000000 DFES_EnvTabVerb 0.00 29.0000000000 FORMAT "%13.10" /end CHARACTERISTIC
/begin CHARACTERISTIC DFES_EnvRef.DFC_HvBattIReqToChrgrIni_C "" VALUE 0x8024DAB9 Val_Wu8 29.0000000000 DFES_EnvTabVerb 0.00 29.0000000000 FORMAT "%13.10" /end CHARACTERISTIC
/begin CHARACTERISTIC DFES_EnvRef.DFC_HvBattIninTout_C "" VALUE 0x8024DABA Val_Wu8 29.0000000000 DFES_EnvTabVerb 0.00 29.0000000000 FORMAT "%13.10" /end CHARACTERISTIC
/begin CHARACTERISTIC DFES_EnvRef.DFC_HvBattIntlckSt_C "" VALUE 0x8024DABB Val_Wu8 29.0000000000 DFES_EnvTabVerb 0.00 29.0000000000 FORMAT "%13.10" /end CHARACTERISTIC
/begin CHARACTERISTIC DFES_EnvRef.DFC_HvBattIsoFlt_C "" VALUE 0x8024DABC Val_Wu8 29.0000000000 DFES_EnvTabVerb 0.00 29.0000000000 FORMAT "%13.10" /end CHARACTERISTIC
/begin CHARACTERISTIC DFES_EnvRef.DFC_HvBattLimdPwr_C "" VALUE 0x8024DABD Val_Wu8 29.0000000000 DFES_EnvTabVerb 0.00 29.0000000000 FORMAT "%13.10" /end CHARACTERISTIC
/begin CHARACTERISTIC DFES_EnvRef.DFC_HvBattMaiSwtClsngFlt_C "" VALUE 0x8024DABE Val_Wu8 29.0000000000 DFES_EnvTabVerb 0.00 29.0000000000 FORMAT "%13.10" /end CHARACTERISTIC
/begin CHARACTERISTIC DFES_EnvRef.DFC_HvBattMaiSwtFlt_C "" VALUE 0x8024DABF Val_Wu8 29.0000000000 DFES_EnvTabVerb 0.00 29.0000000000 FORMAT "%13.10" /end CHARACTERISTIC
/begin CHARACTERISTIC DFES_EnvRef.DFC_HvBattMaiSwtOpen_C "" VALUE 0x8024DAC0 Val_Wu8 29.0000000000 DFES_EnvTabVerb 0.00 29.0000000000 FORMAT "%13.10" /end CHARACTERISTIC
/begin CHARACTERISTIC DFES_EnvRef.DFC_HvBattMaiSwtOpngFlt_C "" VALUE 0x8024DAC1 Val_Wu8 29.0000000000 DFES_EnvTabVerb 0.00 29.0000000000 FORMAT "%13.10" /end CHARACTERISTIC
/begin CHARACTERISTIC DFES_EnvRef.DFC_HvBattMaiSwtWldd_C "" VALUE 0x8024DAC2 Val_Wu8 29.0000000000 DFES_EnvTabVerb 0.00 29.0000000000 FORMAT "%13.10" /end CHARACTERISTIC
/begin CHARACTERISTIC DFES_EnvRef.DFC_HvBattNegCntctrCntErr_C "" VALUE 0x8024DAC3 Val_Wu8 29.0000000000 DFES_EnvTabVerb 0.00 29.0000000000 FORMAT "%13.10" /end CHARACTERISTIC
/begin CHARACTERISTIC DFES_EnvRef.DFC_HvBattOperModChrgPlausy_C "" VALUE 0x8024DAC4 Val_Wu8 29.0000000000 DFES_EnvTabVerb 0.00 29.0000000000 FORMAT "%13.10" /end CHARACTERISTIC
/begin CHARACTERISTIC DFES_EnvRef.DFC_HvBattOverTDern_C "" VALUE 0x8024DAC5 Val_Wu8 29.0000000000 DFES_EnvTabVerb 0.00 29.0000000000 FORMAT "%13.10" /end CHARACTERISTIC
/begin CHARACTERISTIC DFES_EnvRef.DFC_HvBattPosCntctrCntErr_C "" VALUE 0x8024DAC6 Val_Wu8 29.0000000000 DFES_EnvTabVerb 0.00 29.0000000000 FORMAT "%13.10" /end CHARACTERISTIC
/begin CHARACTERISTIC DFES_EnvRef.DFC_HvBattPrecCntctrCntErr_C "" VALUE 0x8024DAC7 Val_Wu8 29.0000000000 DFES_EnvTabVerb 0.00 29.0000000000 FORMAT "%13.10" /end CHARACTERISTIC
/begin CHARACTERISTIC DFES_EnvRef.DFC_HvBattPwrDistbnTDern_C "" VALUE 0x8024DAC8 Val_Wu8 29.0000000000 DFES_EnvTabVerb 0.00 29.0000000000 FORMAT "%13.10" /end CHARACTERISTIC
/begin CHARACTERISTIC DFES_EnvRef.DFC_HvBattPwrDistbnTInhbn_C "" VALUE 0x8024DAC9 Val_Wu8 29.0000000000 DFES_EnvTabVerb 0.00 29.0000000000 FORMAT "%13.10" /end CHARACTERISTIC
/begin CHARACTERISTIC DFES_EnvRef.DFC_HvBattRatRSohErr_C "" VALUE 0x8024DACA Val_Wu8 29.0000000000 DFES_EnvTabVerb 0.00 29.0000000000 FORMAT "%13.10" /end CHARACTERISTIC
/begin CHARACTERISTIC DFES_EnvRef.DFC_HvBattRatSohErr_C "" VALUE 0x8024DACB Val_Wu8 29.0000000000 DFES_EnvTabVerb 0.00 29.0000000000 FORMAT "%13.10" /end CHARACTERISTIC
/begin CHARACTERISTIC DFES_EnvRef.DFC_HvBattSngIsoWarn_C "" VALUE 0x8024DACC Val_Wu8 29.0000000000 DFES_EnvTabVerb 0.00 29.0000000000 FORMAT "%13.10" /end CHARACTERISTIC
/begin FUNCTION DFES "30000.70.0Diagnostic Fault Event Storage"
 /begin DEF_CHARACTERISTIC DFES_DTCO.DFC_VehVCanAvl_C DFES_DTCO.DFC_VehVCanErr_C DFES_DTCO.DFC_eTogFailrLvlRes_C DFES_DTCO.DFC_flgBrkMaiDiag_C DFES_DTCO.DFC_stHvbIsoMeasmtRes_C DFES_DTCO.DFC_BrkBstPmpPLeakDfct_C DFES_DTCO.DFC_Com082hTooShort_C DFES_DTCO.DFC_Com092hTooShort_C DFES_DTCO.DFC_Com205hAbsent_C DFES_DTCO.DFC_Com205hChecksum_C DFES_DTCO.DFC_Com205hCounter_C DFES_DTCO.DFC_Com205hTooShort_C DFES_DTCO.DFC_Com217hAbsent_C DFES_DTCO.DFC_Com217hChecksum_C DFES_DTCO.DFC_Com217hCounter_C DFES_DTCO.DFC_Com217hTooShort_C DFES_DTCO.DFC_Com227hAbsent_C DFES_DTCO.DFC_Com227hTooShort_C DFES_DTCO.DFC_Com237hAbsent_C DFES_DTCO.DFC_Com237hChecksum_C DFES_DTCO.DFC_Com237hCounter_C DFES_DTCO.DFC_Com237hTooShort_C DFES_DTCO.DFC_Com259hAbsent_C DFES_DTCO.DFC_Com259hChecksum_C DFES_DTCO.DFC_Com259hCounter_C DFES_DTCO.DFC_Com259hTooShort_C DFES_DTCO.DFC_Com26hAbsent_C DFES_DTCO.DFC_Com26hTooShort_C DFES_DTCO.DFC_Com273hAbsent_C DFES_DTCO.DFC_Com273hChecksum_C DFES_DTCO.DFC_Com273hCounter_C DFES_DTCO.DFC_Com273hTooShort_C DFES_DTCO.DFC_Com275hAbsent_C DFES_DTCO.DFC_Com275hChecksum_C DFES_DTCO.DFC_Com275hCounter_C DFES_DTCO.DFC_Com275hTooShort_C DFES_DTCO.DFC_Com283hAbsent_C DFES_DTCO.DFC_Com283hTooShort_C DFES_DTCO.DFC_Com285hAbsent_C DFES_DTCO.DFC_Com285hChecksum_C DFES_DTCO.DFC_Com285hCounter_C DFES_DTCO.DFC_Com285hTooShort_C DFES_DTCO.DFC_Com293hAbsent_C DFES_DTCO.DFC_Com293hChecksum_C DFES_DTCO.DFC_Com293hCounter_C DFES_DTCO.DFC_Com293hTooShort_C DFES_DTCO.DFC_Com308hAbsent_C DFES_DTCO.DFC_Com308hChecksum_C DFES_DTCO.DFC_Com308hCounter_C DFES_DTCO.DFC_Com308hTooShort_C DFES_DTCO.DFC_Com318hAbsent_C DFES_DTCO.DFC_Com318hChecksum_C DFES_DTCO.DFC_Com318hCounter_C DFES_DTCO.DFC_Com318hTooShort_C DFES_DTCO.DFC_Com325hAbsent_C DFES_DTCO.DFC_Com325hChecksum_C DFES_DTCO.DFC_Com325hCounter_C DFES_DTCO.DFC_Com325hTooShort_C DFES_DTCO.DFC_Com335hAbsent_C DFES_DTCO.DFC_Com335hChecksum_C DFES_DTCO.DFC_Com335hCounter_C DFES_DTCO.DFC_Com335hTooShort_C DFES_DTCO.DFC_Com351hAbsent_C DFES_DTCO.DFC_Com351hTooShort_C DFES_DTCO.DFC_Com38DhAbsent_C DFES_DTCO.DFC_Com38DhChecksum_C DFES_DTCO.DFC_Com38DhCounter_C DFES_DTCO.DFC_Com38DhTooShort_C DFES_DTCO.DFC_Com412hAbsent_C DFES_DTCO.DFC_Com412hChecksum_C DFES_DTCO.DFC_Com412hCounter_C DFES_DTCO.DFC_Com412hTooShort_C DFES_DTCO.DFC_Com427hAbsent_C DFES_DTCO.DFC_Com427hTooShort_C DFES_DTCO.DFC_Com432hAbsent_C DFES_DTCO.DFC_Com432hChecksum_C DFES_DTCO.DFC_Com432hCounter_C DFES_DTCO.DFC_Com432hTooShort_C DFES_DTCO.DFC_Com435hAbsent_C DFES_DTCO.DFC_Com435hTooShort_C DFES_DTCO.DFC_Com442hAbsent_C DFES_DTCO.DFC_Com442hTooShort_C DFES_DTCO.DFC_Com453hAbsent_C DFES_DTCO.DFC_Com453hTooShort_C DFES_DTCO.DFC_Com455hAbsent_C DFES_DTCO.DFC_Com455hTooShort_C DFES_DTCO.DFC_Com463hAbsent_C DFES_DTCO.DFC_Com463hTooShort_C DFES_DTCO.DFC_Com473hAbsent_C DFES_DTCO.DFC_Com473hTooShort_C DFES_DTCO.DFC_Com47BhAbsent_C DFES_DTCO.DFC_Com47BhTooShort_C DFES_DTCO.DFC_Com48BhAbsent_C DFES_DTCO.DFC_Com48BhTooShort_C DFES_DTCO.DFC_Com497hTooShort_C DFES_DTCO.DFC_Com4F2hAbsent_C DFES_DTCO.DFC_Com4F2hChecksum_C DFES_DTCO.DFC_Com4F2hCounter_C DFES_DTCO.DFC_Com4F2hTooShort_C DFES_DTCO.DFC_Com50DhAbsent_C DFES_DTCO.DFC_Com50DhTooShort_C DFES_DTCO.DFC_Com535hAbsent_C DFES_DTCO.DFC_Com535hTooShort_C DFES_DTCO.DFC_Com543hAbsent_C DFES_DTCO.DFC_Com543hTooShort_C DFES_DTCO.DFC_Com552hAbsent_C DFES_DTCO.DFC_Com552hTooShort_C DFES_DTCO.DFC_Com583hAbsent_C DFES_DTCO.DFC_Com583hTooShort_C DFES_DTCO.DFC_Com592hAbsent_C DFES_DTCO.DFC_Com592hChecksum_C DFES_DTCO.DFC_Com592hCounter_C DFES_DTCO.DFC_Com592hTooShort_C DFES_DTCO.DFC_Com595hAbsent_C DFES_DTCO.DFC_Com595hChecksum_C DFES_DTCO.DFC_Com595hCounter_C DFES_DTCO.DFC_Com595hTooShort_C DFES_DTCO.DFC_Com5B2hAbsent_C DFES_DTCO.DFC_Com5B2hTooShort_C DFES_DTCO.DFC_Com5B5hAbsent_C DFES_DTCO.DFC_Com5B5hChecksum_C DFES_DTCO.DFC_Com5B5hCounter_C DFES_DTCO.DFC_Com5B5hTooShort_C DFES_DTCO.DFC_Com5C7hTooShort_C DFES_DTCO.DFC_Com5E7hAbsent_C DFES_DTCO.DFC_Com5E7hTooShort_C DFES_DTCO.DFC_Com635hTooShort_C DFES_DTCO.DFC_Com645hTooShort_C DFES_DTCO.DFC_Com663hAbsent_C DFES_DTCO.DFC_Com663hTooShort_C DFES_DTCO.DFC_Com665hAbsent_C DFES_DTCO.DFC_Com665hTooShort_C DFES_DTCO.DFC_Com675hAbsent_C DFES_DTCO.DFC_Com675hTooShort_C DFES_DTCO.DFC_ComFrbd_205h_HVBAT_PACK_CURRENT_C DFES_DTCO.DFC_ComFrbd_205h_HVBAT_SOC_DISPLAY_C DFES_DTCO.DFC_ComFrbd_205h_HVBAT_VOLTAGE_C DFES_DTCO.DFC_ComFrbd_217h_INV_DC_BUS_VOLTAGE_C DFES_DTCO.DFC_ComFrbd_217h_INV_MTR_ACTUAL_TRQ_C DFES_DTCO.DFC_ComFrbd_217h_INV_MTR_SPEED_C DFES_DTCO.DFC_ComFrbd_217h_INV_MTR_TRQ_C DFES_DTCO.DFC_ComFrbd_227h_INV_DC_CURRENT_C DFES_DTCO.DFC_ComFrbd_227h_INV_MOTORING_PEAK_TRQ_C DFES_DTCO.DFC_ComFrbd_227h_INV_MTR_INST_INPUT_POWER_C DFES_DTCO.DFC_ComFrbd_227h_INV_REGEN_PEAK_TRQ_C DFES_DTCO.DFC_ComFrbd_237h_INV_ACTIVE_DISCHARGE_STATUS_C DFES_DTCO.DFC_ComFrbd_237h_INV_CTRL_MODE_ACK_C DFES_DTCO.DFC_ComFrbd_237h_INV_EV_WARNING_C DFES_DTCO.DFC_ComFrbd_237h_INV_FAULT_LEVEL_C DFES_DTCO.DFC_ComFrbd_237h_INV_MASTER_STOP_C DFES_DTCO.DFC_ComFrbd_237h_INV_SERVICE_DUE_C DFES_DTCO.DFC_ComFrbd_237h_INV_STAB_MIN_TRQ_C DFES_DTCO.DFC_ComFrbd_259h_TGLM_FAILURE_STATE_C DFES_DTCO.DFC_ComFrbd_259h_TGLM_MODE_PUSH_C DFES_DTCO.DFC_ComFrbd_259h_TOGGLE_MONOSTABLE_POS_C DFES_DTCO.DFC_ComFrbd_273h_OBC_outputpower_capability_C DFES_DTCO.DFC_ComFrbd_275h_HVBAT_DISCHARGE_30S_AVAILABLE_CURRENT_C DFES_DTCO.DFC_ComFrbd_275h_HVBAT_DISCHARGE_30S_AVAILABLE_POWER_C DFES_DTCO.DFC_ComFrbd_283h_DCDC_IN_CURRENT_C DFES_DTCO.DFC_ComFrbd_283h_DCDC_IN_VOLTAGE_C DFES_DTCO.DFC_ComFrbd_283h_DCDC_OUT_CURRENT_C DFES_DTCO.DFC_ComFrbd_283h_DCDC_OUT_VOLTAGE_C DFES_DTCO.DFC_ComFrbd_285h_HVBAT_REGEN_CHG_30S_CURRENT_LIMIT_C DFES_DTCO.DFC_ComFrbd_285h_HVBAT_REGEN_CHRG_30S_POWER_LIMIT_C DFES_DTCO.DFC_ComFrbd_293h_DCDC_outputpower_capability_C DFES_DTCO.DFC_ComFrbd_325h_HVBAT_INSULATION_RESISTANCE_C DFES_DTCO.DFC_ComFrbd_325h_HVBAT_TEMPERATURE_C DFES_DTCO.DFC_ComFrbd_335h_HVBAT_CHRG_CONTINUOUS_CURR_MAX_C DFES_DTCO.DFC_ComFrbd_335h_HVBAT_CHRG_COTINUOUS_CURR_REQ_C DFES_DTCO.DFC_ComFrbd_335h_HVBAT_CHRG_MAX_VOLT_C DFES_DTCO.DFC_ComFrbd_335h_HVBAT_DC_BUS_VOLTAGE_C DFES_DTCO.DFC_ComFrbd_427h_INV_OP_MODE_C DFES_DTCO.DFC_ComFrbd_427h_INV_PERMISIBLE_TORQUE_C DFES_DTCO.DFC_ComFrbd_435h_HVBAT_MAX_CELL_VOLT_C DFES_DTCO.DFC_ComFrbd_435h_HVBAT_MAX_CELL_VOLT_NUM_C DFES_DTCO.DFC_ComFrbd_435h_HVBAT_MAX_SENSOR_TEMP_C DFES_DTCO.DFC_ComFrbd_435h_HVBAT_MIN_CELL_VOLT_C DFES_DTCO.DFC_ComFrbd_435h_HVBAT_MIN_CELL_VOLT_NUM_C DFES_DTCO.DFC_ComFrbd_453h_OBC_IN_CURRENT_C DFES_DTCO.DFC_ComFrbd_453h_OBC_IN_VOLTAGE_C DFES_DTCO.DFC_ComFrbd_453h_OBC_IP_POWER_C DFES_DTCO.DFC_ComFrbd_455h_HVBAT_NOMINAL_VOLTAGE_C DFES_DTCO.DFC_ComFrbd_463h_OBC_OUT_CURRENT_C DFES_DTCO.DFC_ComFrbd_463h_OBC_OUT_VOLTAGE_C DFES_DTCO.DFC_ComFrbd_463h_OBC_TEMPERATURE_C DFES_DTCO.DFC_ComFrbd_473h_DCDC_Coolant_Temperature_C DFES_DTCO.DFC_ComFrbd_473h_DCDC_TEMPERATURE_C DFES_DTCO.DFC_ComFrbd_47Bh_eCOMP_BusBarCurrent_C DFES_DTCO.DFC_ComFrbd_47Bh_eCOMP_BusBarVoltage_C DFES_DTCO.DFC_ComFrbd_47Bh_eCOMP_CompressorSpeed_C DFES_DTCO.DFC_ComFrbd_47Bh_eCOMP_IGBT_Temp_C DFES_DTCO.DFC_ComFrbd_47Bh_eCOMP_PeakPhaCurrent_C DFES_DTCO.DFC_ComFrbd_47Bh_eCOMP_Power_consumption_C DFES_DTCO.DFC_ComFrbd_48Bh_eCOMP_Fault_Level_C DFES_DTCO.DFC_ComFrbd_4F2h_VALEUR_SOC_ETENDUE_C DFES_DTCO.DFC_ComFrbd_535h_HV_BATT_TEMP_AVG_C DFES_DTCO.DFC_ComFrbd_543h_HVBAT_RESTBATTENERGY_C DFES_DTCO.DFC_ComFrbd_543h_HVBAT_SOH_C DFES_DTCO.DFC_ComFrbd_543h_HV_BATT_SOH_RES_C DFES_DTCO.DFC_ComFrbd_592h_IBATT_1_C DFES_DTCO.DFC_ComFrbd_592h_IBATT_2_C DFES_DTCO.DFC_ComFrbd_592h_IBATT_3_C DFES_DTCO.DFC_ComFrbd_592h_TEMP_BATT_C DFES_DTCO.DFC_ComFrbd_592h_U_BATT_BECB_C DFES_DTCO.DFC_ComFrbd_595h_HVBAT_TIME_TO_CHRG_80_C DFES_DTCO.DFC_ComFrbd_5B2h_TEMP_AIR_EXT_C DFES_DTCO.DFC_ComFrbd_635h_HVBAT_NEG_CONT_COUNT_SEG1_C DFES_DTCO.DFC_ComFrbd_635h_HVBAT_NEG_CONT_COUNT_SEG3_C DFES_DTCO.DFC_ComFrbd_635h_HVBAT_NEG_CONT_COUNT_SEG4_C DFES_DTCO.DFC_ComFrbd_635h_HVBAT_PST_CONT_COUNT_SEG1_C DFES_DTCO.DFC_ComFrbd_635h_HVBAT_PST_CONT_COUNT_SEG3_C DFES_DTCO.DFC_ComFrbd_635h_HVBAT_PST_CONT_COUNT_SEG4_C DFES_DTCO.DFC_ComFrbd_645h_HVBAT_PRECHRGE_CONT_COUNT_SEG1_C DFES_DTCO.DFC_ComFrbd_645h_HVBAT_PRECHRGE_CONT_COUNT_SEG2_C DFES_DTCO.DFC_ComFrbd_675h_HVBAT_REMAININGBATTCAPACITY_C DFES_DTCO.DFC_ComInvld_205h_HVBAT_CHARGING_STATUS_C DFES_DTCO.DFC_ComInvld_205h_HVBAT_PACK_CURRENT_C DFES_DTCO.DFC_ComInvld_205h_HVBAT_SOC_DISPLAY_C DFES_DTCO.DFC_ComInvld_205h_HVBAT_VOLTAGE_C DFES_DTCO.DFC_ComInvld_217h_INV_DC_BUS_VOLTAGE_C DFES_DTCO.DFC_ComInvld_217h_INV_MTR_ACTUAL_TRQ_C DFES_DTCO.DFC_ComInvld_217h_INV_MTR_SPEED_C DFES_DTCO.DFC_ComInvld_217h_INV_MTR_TRQ_C DFES_DTCO.DFC_ComInvld_227h_INV_DC_CURRENT_C DFES_DTCO.DFC_ComInvld_227h_INV_MOTORING_PEAK_TRQ_C DFES_DTCO.DFC_ComInvld_227h_INV_MTR_INST_INPUT_POWER_C DFES_DTCO.DFC_ComInvld_227h_INV_REGEN_PEAK_TRQ_C DFES_DTCO.DFC_ComInvld_237h_INV_ACTIVE_DISCHARGE_STATUS_C DFES_DTCO.DFC_ComInvld_237h_INV_FAULT_LEVEL_C DFES_DTCO.DFC_ComInvld_237h_INV_STAB_MIN_TRQ_C DFES_DTCO.DFC_ComInvld_259h_TGLM_MODE_PUSH_C DFES_DTCO.DFC_ComInvld_259h_TOGGLE_MONOSTABLE_POS_C DFES_DTCO.DFC_ComInvld_26h_AC_SWITCH_REQ_C DFES_DTCO.DFC_ComInvld_26h_BLOWER_POSITION_C DFES_DTCO.DFC_ComInvld_26h_EVAP_SENSOR_FAULT_C DFES_DTCO.DFC_ComInvld_26h_EVAP_SENSOR_VALUE_C DFES_DTCO.DFC_ComInvld_26h_POTENTIOMETER_FAULT_C DFES_DTCO.DFC_ComInvld_26h_REAR_DEFOG_REQ_C DFES_DTCO.DFC_ComInvld_26h_TEMP_POSITION_C DFES_DTCO.DFC_ComInvld_273h_OBC_FAULT_LEVEL_C DFES_DTCO.DFC_ComInvld_273h_OBC_outputpower_capability_C DFES_DTCO.DFC_ComInvld_275h_HVBAT_DISCHARGE_30S_AVAILABLE_CURRENT_C DFES_DTCO.DFC_ComInvld_275h_HVBAT_DISCHARGE_30S_AVAILABLE_POWER_C DFES_DTCO.DFC_ComInvld_283h_DCDC_IN_CURRENT_C DFES_DTCO.DFC_ComInvld_283h_DCDC_IN_VOLTAGE_C DFES_DTCO.DFC_ComInvld_283h_DCDC_OUT_CURRENT_C DFES_DTCO.DFC_ComInvld_283h_DCDC_OUT_VOLTAGE_C DFES_DTCO.DFC_ComInvld_285h_HVBAT_REGEN_CHG_30S_CURRENT_LIMIT_C DFES_DTCO.DFC_ComInvld_285h_HVBAT_REGEN_CHRG_30S_POWER_LIMIT_C DFES_DTCO.DFC_ComInvld_293h_DCDC_FAULT_LEVEL_C DFES_DTCO.DFC_ComInvld_293h_DCDC_outputpower_capability_C DFES_DTCO.DFC_ComInvld_325h_HVBAT_EPLUG_STATUS_C DFES_DTCO.DFC_ComInvld_325h_HVBAT_HVIL_STS_C DFES_DTCO.DFC_ComInvld_325h_HVBAT_INSULATION_FAULT_C DFES_DTCO.DFC_ComInvld_325h_HVBAT_INSULATION_RESISTANCE_C DFES_DTCO.DFC_ComInvld_325h_HVBAT_TEMPERATURE_C DFES_DTCO.DFC_ComInvld_335h_HVBAT_CHRG_CONTINUOUS_CURR_MAX_C DFES_DTCO.DFC_ComInvld_335h_HVBAT_CHRG_COTINUOUS_CURR_REQ_C DFES_DTCO.DFC_ComInvld_335h_HVBAT_CHRG_MAX_VOLT_C DFES_DTCO.DFC_ComInvld_335h_HVBAT_DC_BUS_VOLTAGE_C DFES_DTCO.DFC_ComInvld_38Dh_VITESSE_VEHICULE_ROUES_C DFES_DTCO.DFC_ComInvld_38Dh_VVH_INDISP_C DFES_DTCO.DFC_ComInvld_427h_INV_COOLANT_TEMP_C DFES_DTCO.DFC_ComInvld_427h_INV_MOTOR_TEMP_C DFES_DTCO.DFC_ComInvld_427h_INV_OP_MODE_C DFES_DTCO.DFC_ComInvld_427h_INV_PERMISIBLE_TORQUE_C DFES_DTCO.DFC_ComInvld_427h_INV_TEMP_C DFES_DTCO.DFC_ComInvld_432h_REVEIL_PRINCIPAL_C DFES_DTCO.DFC_ComInvld_435h_HVBAT_MAX_CELL_VOLT_C DFES_DTCO.DFC_ComInvld_435h_HVBAT_MAX_CELL_VOLT_NUM_C DFES_DTCO.DFC_ComInvld_435h_HVBAT_MAX_SENSOR_TEMP_C DFES_DTCO.DFC_ComInvld_435h_HVBAT_MIN_CELL_VOLT_C DFES_DTCO.DFC_ComInvld_435h_HVBAT_MIN_CELL_VOLT_NUM_C DFES_DTCO.DFC_ComInvld_442h_BCCM_BLOWER_RELAY_STS_C DFES_DTCO.DFC_ComInvld_453h_OBC_IN_CURRENT_C DFES_DTCO.DFC_ComInvld_453h_OBC_IN_VOLTAGE_C DFES_DTCO.DFC_ComInvld_453h_OBC_IP_POWER_C DFES_DTCO.DFC_ComInvld_455h_HVBAT_NOMINAL_VOLTAGE_C DFES_DTCO.DFC_ComInvld_463h_OBC_OUT_CURRENT_C DFES_DTCO.DFC_ComInvld_463h_OBC_OUT_VOLTAGE_C DFES_DTCO.DFC_ComInvld_463h_OBC_TEMPERATURE_C DFES_DTCO.DFC_ComInvld_473h_DCDC_Coolant_Temperature_C DFES_DTCO.DFC_ComInvld_473h_DCDC_TEMPERATURE_C DFES_DTCO.DFC_ComInvld_47Bh_eCOMP_BusBarCurrent_C DFES_DTCO.DFC_ComInvld_47Bh_eCOMP_BusBarVoltage_C DFES_DTCO.DFC_ComInvld_47Bh_eCOMP_CompressorSpeed_C DFES_DTCO.DFC_ComInvld_47Bh_eCOMP_IGBT_Temp_C DFES_DTCO.DFC_ComInvld_47Bh_eCOMP_PeakPhaCurrent_C DFES_DTCO.DFC_ComInvld_47Bh_eCOMP_Power_consumption_C DFES_DTCO.DFC_ComInvld_4F2h_STATUS_SOC_C DFES_DTCO.DFC_ComInvld_4F2h_TEMP_BATT_STATUS_C DFES_DTCO.DFC_ComInvld_4F2h_VALEUR_SOC_ETENDUE_C DFES_DTCO.DFC_ComInvld_535h_HV_BATT_TEMP_AVG_C DFES_DTCO.DFC_ComInvld_543h_HVBAT_RESTBATTENERGY_C DFES_DTCO.DFC_ComInvld_543h_HVBAT_SOH_C DFES_DTCO.DFC_ComInvld_543h_HV_BATT_SOH_RES_C DFES_DTCO.DFC_ComInvld_552h_CPT_TEMPOREL_C DFES_DTCO.DFC_ComInvld_552h_KILOMETRAGE_C DFES_DTCO.DFC_ComInvld_583h_HV_BATT_DISCONT_CSE_OPEN_C DFES_DTCO.DFC_ComInvld_592h_CALIBRE_IBATT_C DFES_DTCO.DFC_ComInvld_592h_IBATT_1_C DFES_DTCO.DFC_ComInvld_592h_IBATT_2_C DFES_DTCO.DFC_ComInvld_592h_IBATT_3_C DFES_DTCO.DFC_ComInvld_592h_TEMP_BATT_C DFES_DTCO.DFC_ComInvld_592h_U_BATT_BECB_C DFES_DTCO.DFC_ComInvld_595h_HVBAT_TIME_TO_CHRG_80_C DFES_DTCO.DFC_ComInvld_5B2h_TEMP_AIR_EXT_C DFES_DTCO.DFC_ComInvld_5B5h_HVBAT_THERMAL_RUNAWAY_C DFES_DTCO.DFC_ComInvld_635h_HVBAT_NEG_CONT_COUNT_SEG1_C DFES_DTCO.DFC_ComInvld_635h_HVBAT_NEG_CONT_COUNT_SEG3_C DFES_DTCO.DFC_ComInvld_635h_HVBAT_NEG_CONT_COUNT_SEG4_C DFES_DTCO.DFC_ComInvld_635h_HVBAT_PST_CONT_COUNT_SEG1_C DFES_DTCO.DFC_ComInvld_635h_HVBAT_PST_CONT_COUNT_SEG3_C DFES_DTCO.DFC_ComInvld_635h_HVBAT_PST_CONT_COUNT_SEG4_C DFES_DTCO.DFC_ComInvld_645h_HVBAT_PRECHRGE_CONT_COUNT_SEG1_C DFES_DTCO.DFC_ComInvld_645h_HVBAT_PRECHRGE_CONT_COUNT_SEG2_C DFES_DTCO.DFC_ComInvld_675h_HVBAT_REMAININGBATTCAPACITY_C DFES_DTCO.DFC_ACCmprFltLvl1_C DFES_DTCO.DFC_ACCmprFltLvl2_C DFES_DTCO.DFC_ACCmprFltLvl3_C DFES_DTCO.DFC_ACCmprFltLvl4_C DFES_DTCO.DFC_ACCmprHiPFlt_C DFES_DTCO.DFC_ACCmprInvldCmprSt_C DFES_DTCO.DFC_ACCmprInvldElecActPwr_C DFES_DTCO.DFC_ACCmprLoPFlt_C DFES_DTCO.DFC_AcChrgrIntkTSRCMin_C DFES_DTCO.DFC_BattUBMaxBatt_C DFES_DTCO.DFC_BattUBMaxNoBatt_C DFES_DTCO.DFC_BattUBMinBatt_C DFES_DTCO.DFC_BattUBMinNoBatt_C DFES_DTCO.DFC_BattUSRCMax_C DFES_DTCO.DFC_BattUSRCMin_C DFES_DTCO.DFC_BrkBstPHiCautionDfct_C DFES_DTCO.DFC_BrkBstPHiWarnDfct_C DFES_DTCO.DFC_BrkBstPSnsr12PlausDfct_C DFES_DTCO.DFC_BrkBstPSnsr1Scb_C DFES_DTCO.DFC_BrkBstPSnsr1Scg_C DFES_DTCO.DFC_BrkBstPSnsr2Scb_C DFES_DTCO.DFC_BrkBstPSnsr2Scg_C DFES_DTCO.DFC_BrkBstPSnsrMax_C DFES_DTCO.DFC_BrkBstPSnsrMin_C DFES_DTCO.DFC_BrkBstPhyRngChkMax_C DFES_DTCO.DFC_BrkBstPhyRngChkMin_C DFES_DTCO.DFC_BrkBstPmpHsScb_C DFES_DTCO.DFC_BrkBstPmpHsScg_C DFES_DTCO.DFC_BrkBstPmpLsOl_C DFES_DTCO.DFC_BrkBstPmpLsScb_C DFES_DTCO.DFC_BrkBstPmpLsScg_C DFES_DTCO.DFC_CbnHeatgHeatrRlyOpend_C DFES_DTCO.DFC_CbnHeatgHeatrRlyWldd_C DFES_DTCO.DFC_CcsDcIBattExcdd_C DFES_DTCO.DFC_CcsDcIEvseOutDe_C DFES_DTCO.DFC_CcsDcIOutDe_C DFES_DTCO.DFC_CcsDcIOutExcdd_C DFES_DTCO.DFC_CcsDcUOutDe_C DFES_DTCO.DFC_CcsDcUOutExcdd_C DFES_DTCO.DFC_CcsPwrLineChpRstOL_C DFES_DTCO.DFC_CcsPwrLineChpRstOvrTemp_C DFES_DTCO.DFC_CcsPwrLineChpRstSCB_C DFES_DTCO.DFC_CcsPwrLineChpRstSCG_C DFES_DTCO.DFC_CcsPwrLineChpVccEnaOL_C DFES_DTCO.DFC_CcsPwrLineChpVccEnaOvrTemp_C DFES_DTCO.DFC_CcsPwrLineChpVccEnaSCB_C DFES_DTCO.DFC_CcsPwrLineChpVccEnaSCG_C DFES_DTCO.DFC_CcsPwrLineChpVccSRCMin_C DFES_DTCO.DFC_CcsPwrLineComChpTSRCMin_C DFES_DTCO.DFC_CtPSwtActrOL_C DFES_DTCO.DFC_CtPSwtActrOvrTemp_C DFES_DTCO.DFC_CtPSwtActrSCB_C DFES_DTCO.DFC_CtPSwtActrSCG_C DFES_DTCO.DFC_CtPSwtDiagSRCMin_C DFES_DTCO.DFC_CtpCarrFrqSRCMin_C DFES_DTCO.DFC_DcChrgrIntkT2SRCMin_C DFES_DTCO.DFC_DcChrgrIntkTSRCMin_C DFES_DTCO.DFC_DevLibBattUHi_C DFES_DTCO.DFC_DevLibBattULo_C DFES_DTCO.DFC_EmWakeupSigOL_C DFES_DTCO.DFC_EmWakeupSigOvrTemp_C DFES_DTCO.DFC_EmWakeupSigSCB_C DFES_DTCO.DFC_EmWakeupSigSCG_C DFES_DTCO.DFC_Fan1OL_C DFES_DTCO.DFC_Fan1OvrTemp_C DFES_DTCO.DFC_Fan1SCB_C DFES_DTCO.DFC_FanRlySCB_C DFES_DTCO.DFC_FanRlySCG_C DFES_DTCO.DFC_FanSpdSRCMin_C DFES_DTCO.DFC_FreonPSRCMin_C DFES_DTCO.DFC_HLCCcsPLnCChipTHi_C DFES_DTCO.DFC_HeatrCoreTSRCMin_C DFES_DTCO.DFC_PwmCtPSRCMin_C DFES_DTCO.DFC_PwrDistbnUnitTSRCMin_C DFES_DTCO.DFC_SCtPmp1OL_C DFES_DTCO.DFC_SCtPmp1OvrTemp_C DFES_DTCO.DFC_SCtPmp1SCB_C DFES_DTCO.DFC_SCtPmpRlyOL_C DFES_DTCO.DFC_SCtPmpRlyOvrTemp_C DFES_DTCO.DFC_SCtPmpRlySCB_C DFES_DTCO.DFC_SpplCooltPmpRlyOL_C DFES_DTCO.DFC_SpplCooltPmpRlyOvrTemp_C DFES_DTCO.DFC_SpplCooltPmpRlySCB_C DFES_DTCO.DFC_UCtPSRCMin_C DFES_DTCO.DFC_UPxP1SRCMin_C DFES_DTCO.DFC_ComHSN1CANMute_C DFES_DTCO.DFC_ComHSN3CANMute_C DFES_DTCO.DFC_AcChrgrIntkTPhysRngHi_C DFES_DTCO.DFC_AcChrgrIntkTPhysRngLo_C DFES_DTCO.DFC_AcChrgrIntkTSRCOpn_C DFES_DTCO.DFC_CcsPwrLineChpVccPhysRngHi_C DFES_DTCO.DFC_CcsPwrLineChpVccPhysRngLo_C DFES_DTCO.DFC_CcsPwrLineChpVccSRCOpn_C DFES_DTCO.DFC_CcsPwrLineComChpTPhysRngHi_C DFES_DTCO.DFC_CcsPwrLineComChpTPhysRngLo_C DFES_DTCO.DFC_CcsPwrLineComChpTSRCOpn_C DFES_DTCO.DFC_CtPSwtDiagPhysRngHi_C DFES_DTCO.DFC_CtPSwtDiagPhysRngLo_C DFES_DTCO.DFC_CtPSwtDiagSRCOpn_C DFES_DTCO.DFC_CtpCarrFrqPhysRngHi_C DFES_DTCO.DFC_CtpCarrFrqPhysRngLo_C DFES_DTCO.DFC_CtpCarrFrqSRCMax_C DFES_DTCO.DFC_DcChrgrIntkT2PhysRngHi_C DFES_DTCO.DFC_DcChrgrIntkT2PhysRngLo_C DFES_DTCO.DFC_DcChrgrIntkT2SRCOpn_C DFES_DTCO.DFC_DcChrgrIntkTPhysRngHi_C DFES_DTCO.DFC_DcChrgrIntkTPhysRngLo_C DFES_DTCO.DFC_DcChrgrIntkTSRCOpn_C DFES_DTCO.DFC_Fan1SCG_C DFES_DTCO.DFC_FanSpdPhysRngHi_C DFES_DTCO.DFC_FanSpdPhysRngLo_C DFES_DTCO.DFC_FanSpdSRCOpn_C DFES_DTCO.DFC_FreonPPhysRngHi_C DFES_DTCO.DFC_FreonPPhysRngLo_C DFES_DTCO.DFC_FreonPSRCOpn_C DFES_DTCO.DFC_HeatrCoreTPhysRngHi_C DFES_DTCO.DFC_HeatrCoreTPhysRngLo_C DFES_DTCO.DFC_HeatrCoreTSRCOpn_C DFES_DTCO.DFC_HvGridUMaxSftyLim_C DFES_DTCO.DFC_HvGridUMinSftyLim_C DFES_DTCO.DFC_HvGridUPlausy_C DFES_DTCO.DFC_IntlckChrgPlgHBrgOpnLd_C DFES_DTCO.DFC_IntlckChrgPlgHBrgOvrCurr_C DFES_DTCO.DFC_IntlckChrgPlgHBrgOvrTemp_C DFES_DTCO.DFC_IntlckChrgPlgHBrgShCirBatt1_C DFES_DTCO.DFC_IntlckChrgPlgHBrgShCirBatt2_C DFES_DTCO.DFC_IntlckChrgPlgHBrgShCirGnd1_C DFES_DTCO.DFC_IntlckChrgPlgHBrgShCirGnd2_C DFES_DTCO.DFC_IntlckChrgPlgHBrgShCirOvrLd_C DFES_DTCO.DFC_IntlckChrgPlgHBrgTempOvrCurr_C DFES_DTCO.DFC_IntlckChrgPlgHBrgUndrVltg_C DFES_DTCO.DFC_IntlckChrgPlgPosnRngFlt_C DFES_DTCO.DFC_IntlckChrgPlgPosnSrcMax_C DFES_DTCO.DFC_IntlckChrgPlgPosnSrcMin_C DFES_DTCO.DFC_PwmCtPPhysRngHi_C DFES_DTCO.DFC_PwmCtPPhysRngLo_C DFES_DTCO.DFC_PwmCtPSRCMax_C DFES_DTCO.DFC_PwrDistbnUnitTPhysRngHi_C DFES_DTCO.DFC_PwrDistbnUnitTPhysRngLo_C DFES_DTCO.DFC_PwrDistbnUnitTSRCOpn_C DFES_DTCO.DFC_SCtPmpRlySCG_C DFES_DTCO.DFC_SpplCooltPmpRlySCG_C DFES_DTCO.DFC_UCtPPhysRngHi_C DFES_DTCO.DFC_UCtPPhysRngLo_C DFES_DTCO.DFC_UCtPSRCOpn_C DFES_DTCO.DFC_UPxP1PhysRngHi_C DFES_DTCO.DFC_UPxP1PhysRngLo_C DFES_DTCO.DFC_UPxP1SRCOpn_C DFES_DTCO.DFC_VehVPhysRngHi_C DFES_DTCO.DFC_VehVPhysRngLo_C DFES_DTCO.DFC_VehVSigCan_C DFES_DTCO.DFC_VehVSigCanSafe_C DFES_DTCO.DFC_SCtPmp1DiagGrdKey1_C DFES_DTCO.DFC_SCtPmp1DiagGrdKey2_C DFES_DTCO.DFC_SCtPmp1DiagGrdKey3_C DFES_DTCO.DFC_SCtPmp1DiagGrdKey4_C DFES_DTCO.DFC_SCtPmp1DiagGrdKey5_C DFES_DTCO.DFC_ChrgPlgLiveCntctHzrdCcs_C DFES_DTCO.DFC_ChrgPlgProxPltImps_C DFES_DTCO.DFC_ChrgPlgTHiCcsDc_C DFES_DTCO.DFC_ElMActvDchaFailr_C DFES_DTCO.DFC_ElMActvDchaFlt_C DFES_DTCO.DFC_ElMFbdnIvtrModDrv01_C DFES_DTCO.DFC_ElMImobAuthent_C DFES_DTCO.DFC_ElMIsoMonFlt_C DFES_DTCO.DFC_ElMIsoMonPlausyFlt_C DFES_DTCO.DFC_ElMIvtrCooltT01_C DFES_DTCO.DFC_ElMIvtrEmgyShtDwn01_C DFES_DTCO.DFC_ElMIvtrFailr01_C DFES_DTCO.DFC_ElMIvtrIntlck01_C DFES_DTCO.DFC_ElMIvtrTErr01_C DFES_DTCO.DFC_ElMOverSpdNeg01_C DFES_DTCO.DFC_ElMOverSpdPos01_C DFES_DTCO.DFC_ElMOverTqNeg01_C DFES_DTCO.DFC_ElMOverTqPos01_C DFES_DTCO.DFC_ElMPwrAuthn_C DFES_DTCO.DFC_ElMSpdErr01_C DFES_DTCO.DFC_ElMSvs01_C DFES_DTCO.DFC_PEnvCcMax_C DFES_DTCO.DFC_PEnvCcMin_C DFES_DTCO.DFC_PEnvRngChkMax_C DFES_DTCO.DFC_PEnvRngChkMin_C DFES_DTCO.DFC_PEnvSnsrPlaus_C DFES_DTCO.DFC_BrkBstPmpPlausGenn_C DFES_DTCO.DFC_CbnHeatrRlyLfLoWarn_C DFES_DTCO.DFC_ChgrPlugLockPinByndClsd_C DFES_DTCO.DFC_ChgrPlugLockPinMoveWoCmd_C DFES_DTCO.DFC_ChgrPlugLockPinStuckInClsd_C DFES_DTCO.DFC_ChgrPlugLockPinStuckInOpen_C DFES_DTCO.DFC_ChrgrStErr_C DFES_DTCO.DFC_ComHSN1BusOff_C DFES_DTCO.DFC_ComHSN3BusOff_C DFES_DTCO.DFC_ComVCInval_C DFES_DTCO.DFC_EemDcdcPrecSpdInhb_C DFES_DTCO.DFC_ExpPwrLatch_C DFES_DTCO.DFC_FanMaxOvrd_C DFES_DTCO.DFC_HLCCcsGnrlComErr_C DFES_DTCO.DFC_InmLINNodeHVACPanelAbsnt_C DFES_DTCO.DFC_ResetRcvNotAllwd_C DFES_DTCO.DFC_TelltlCooltPlaus_C DFES_DTCO.DFC_MRlyOL_C DFES_DTCO.DFC_MRlySCB_C DFES_DTCO.DFC_MRlySCG_C DFES_DTCO.DFC_SSpMon1_C DFES_DTCO.DFC_SSpMon1OV_C DFES_DTCO.DFC_SSpMon1SCG_C DFES_DTCO.DFC_SSpMon1UV_C DFES_DTCO.DFC_SSpMon2_C DFES_DTCO.DFC_SSpMon2OV_C DFES_DTCO.DFC_SSpMon2SCG_C DFES_DTCO.DFC_SSpMon2UV_C DFES_DTCO.DFC_SSpMon3_C DFES_DTCO.DFC_SSpMon3OV_C DFES_DTCO.DFC_SSpMon3SCG_C DFES_DTCO.DFC_SSpMon3UV_C DFES_DTCO.DFC_CANSM_E_BUS_OFF_NETWORK_HSN1_CAN_C DFES_DTCO.DFC_CANSM_E_BUS_OFF_NETWORK_HSN3_CAN_C DFES_DTCO.DFC_CANSM_E_BUS_OFF_NETWORK_HSN4_CAN_C DFES_DTCO.DFC_CANSM_E_BUS_OFF_NETWORK_XCP_CAN_C DFES_DTCO.DFC_CANTRCV_E_NO_TRCV_CONTROL_0_C DFES_DTCO.DFC_CAN_E_TIMEOUT_C DFES_DTCO.DFC_COMM_E_NET_START_IND_CHANNEL_0_C DFES_DTCO.DFC_COMM_E_NET_START_IND_CHANNEL_1_C DFES_DTCO.DFC_COMM_E_NET_START_IND_CHANNEL_2_C DFES_DTCO.DFC_COMM_E_NET_START_IND_CHANNEL_3_C DFES_DTCO.DFC_COMM_E_NET_START_IND_CHANNEL_4_C DFES_DTCO.DFC_COMM_E_NET_START_IND_CHANNEL_5_C DFES_DTCO.DFC_LIN_E_TIMEOUT_C DFES_DTCO.DFC_rba_EcuCtrl_TOMaxProlg_C DFES_DTCO.DFC_rba_EcuCtrl_TOMaxShutDwn_C DFES_DTCO.DFC_rba_MultiStackTrace_Threshold_C DFES_DTCO.DFC_rba_SyC_CustStates_Degraded_disord_Event_C DFES_DTCO.DFC_rba_SyC_CustStates_Degraded_incst_Event_C DFES_DTCO.DFC_rba_SyC_CustStates_TransNoWakReq_Event_C DFES_DTCO.DFC_RBA_IOEXTLIB_KEEPALIVE_DRV_C DFES_DTCO.DFC_RBA_IOEXTLIB_KEEPALIVE_INI_C DFES_DTCO.DFC_rba_IoSigRtc_StopCounter_C DFES_DTCO.DFC_rba_MRly_Diag_Stk_Event_C DFES_DTCO.DFC_rba_MemDiag_MemReadErr_C DFES_DTCO.DFC_rba_MemDiag_MemWrErr_C DFES_DTCO.DFC_rba_SyC_IrrSwOffTrigEngRun_Event_C DFES_DTCO.DFC_AcChrgrIntkTSRCMax_C DFES_DTCO.DFC_AcChrgrIntkTTmpErr_C DFES_DTCO.DFC_AcFlt_C DFES_DTCO.DFC_AppAllSnsrDfct_C DFES_DTCO.DFC_BattUPwrFail_C DFES_DTCO.DFC_BrkBstBkupOvrn_C DFES_DTCO.DFC_BrkBstPmpOvld_C DFES_DTCO.DFC_BrkPlausChk_C DFES_DTCO.DFC_CbnHeatgSwtTmpErr_C DFES_DTCO.DFC_CcsPwrLineChpVccSRCMax_C DFES_DTCO.DFC_CcsPwrLineChpVccTmpErr_C DFES_DTCO.DFC_CcsPwrLineComChpTSRCMax_C DFES_DTCO.DFC_CcsPwrLineComChpTTmpErr_C DFES_DTCO.DFC_ChgrPlugCtpCarrFrqErr_C DFES_DTCO.DFC_ChgrPlugCtpSwtStuckClsd_C DFES_DTCO.DFC_ChgrPlugCtpSwtStuckOpen_C DFES_DTCO.DFC_ChgrPlugCtpUErrHi_C DFES_DTCO.DFC_ChgrPlugPxp1SrcErr_C DFES_DTCO.DFC_ChrgCntctAllWldd_C DFES_DTCO.DFC_ChrgCntctNegOperErr_C DFES_DTCO.DFC_ChrgCntctNegOperWarn_C DFES_DTCO.DFC_ChrgCntctNegWldd_C DFES_DTCO.DFC_ChrgCntctPosOperErr_C DFES_DTCO.DFC_ChrgCntctPosOperWarn_C DFES_DTCO.DFC_ChrgCntctPosWldd_C DFES_DTCO.DFC_ChrgCntctStuckOpen_C DFES_DTCO.DFC_ChrgPlgIntlckFaild_C DFES_DTCO.DFC_ChrgnUnplRqrd_C DFES_DTCO.DFC_CoElMOffsCalibActv01_C DFES_DTCO.DFC_CtPSwtDiagSRCMax_C DFES_DTCO.DFC_CtPSwtDiagTmpErr_C DFES_DTCO.DFC_CtpCarrFrqTmpErr_C DFES_DTCO.DFC_DcChrgrIntkT2SRCMax_C DFES_DTCO.DFC_DcChrgrIntkT2TmpErr_C DFES_DTCO.DFC_DcChrgrIntkTSRCMax_C DFES_DTCO.DFC_DcChrgrIntkTTmpErr_C DFES_DTCO.DFC_EChrDvPlinCntrThdExcdd_C DFES_DTCO.DFC_EemDiagCtctrClsTout_C DFES_DTCO.DFC_EemDiagDcdcOffTOut_C DFES_DTCO.DFC_EemDiagHvCnsrOffTOut_C DFES_DTCO.DFC_EemDiagHvbOffTOut_C DFES_DTCO.DFC_FanSpdSRCMax_C DFES_DTCO.DFC_FanSpdTmpErr_C DFES_DTCO.DFC_FreonPSRCMax_C DFES_DTCO.DFC_FreonPTmpErr_C DFES_DTCO.DFC_HeatrCoreTSRCMax_C DFES_DTCO.DFC_HeatrCoreTTmpErr_C DFES_DTCO.DFC_HvGridSocMinLim_C DFES_DTCO.DFC_HvacBlwrFrntFlt_C DFES_DTCO.DFC_HvacEvapElecFlt_C DFES_DTCO.DFC_HvacEvapElecFltGnd_C DFES_DTCO.DFC_HvacKnobPosnFlt_C DFES_DTCO.DFC_InvBinID_C DFES_DTCO.DFC_InvCalID_C DFES_DTCO.DFC_InvErotan_C DFES_DTCO.DFC_InvVinID_C DFES_DTCO.DFC_MOXEMM_SMU_ALM0_0_C DFES_DTCO.DFC_MOXEMM_SMU_ALM0_1_C DFES_DTCO.DFC_MOXEMM_SMU_ALM0_10_C DFES_DTCO.DFC_MOXEMM_SMU_ALM0_11_C DFES_DTCO.DFC_MOXEMM_SMU_ALM0_13_C DFES_DTCO.DFC_MOXEMM_SMU_ALM0_14_C DFES_DTCO.DFC_MOXEMM_SMU_ALM0_2_C DFES_DTCO.DFC_MOXEMM_SMU_ALM0_22_C DFES_DTCO.DFC_MOXEMM_SMU_ALM0_23_C DFES_DTCO.DFC_MOXEMM_SMU_ALM0_4_C DFES_DTCO.DFC_MOXEMM_SMU_ALM0_5_C DFES_DTCO.DFC_MOXEMM_SMU_ALM0_7_C DFES_DTCO.DFC_MOXEMM_SMU_ALM0_8_C DFES_DTCO.DFC_MOXEMM_SMU_ALM10_16_C DFES_DTCO.DFC_MOXEMM_SMU_ALM10_17_C DFES_DTCO.DFC_MOXEMM_SMU_ALM10_21_C DFES_DTCO.DFC_MOXEMM_SMU_ALM11_0_C DFES_DTCO.DFC_MOXEMM_SMU_ALM11_1_C DFES_DTCO.DFC_MOXEMM_SMU_ALM11_2_C DFES_DTCO.DFC_MOXEMM_SMU_ALM11_3_C DFES_DTCO.DFC_MOXEMM_SMU_ALM11_4_C DFES_DTCO.DFC_MOXEMM_SMU_ALM11_5_C DFES_DTCO.DFC_MOXEMM_SMU_ALM11_8_C DFES_DTCO.DFC_MOXEMM_SMU_ALM11_9_C DFES_DTCO.DFC_MOXEMM_SMU_ALM1_0_C DFES_DTCO.DFC_MOXEMM_SMU_ALM1_1_C DFES_DTCO.DFC_MOXEMM_SMU_ALM1_10_C DFES_DTCO.DFC_MOXEMM_SMU_ALM1_11_C DFES_DTCO.DFC_MOXEMM_SMU_ALM1_13_C DFES_DTCO.DFC_MOXEMM_SMU_ALM1_14_C DFES_DTCO.DFC_MOXEMM_SMU_ALM1_2_C DFES_DTCO.DFC_MOXEMM_SMU_ALM1_22_C DFES_DTCO.DFC_MOXEMM_SMU_ALM1_23_C DFES_DTCO.DFC_MOXEMM_SMU_ALM1_4_C DFES_DTCO.DFC_MOXEMM_SMU_ALM1_5_C DFES_DTCO.DFC_MOXEMM_SMU_ALM1_7_C DFES_DTCO.DFC_MOXEMM_SMU_ALM1_8_C DFES_DTCO.DFC_MOXEMM_SMU_ALM21_0_C DFES_DTCO.DFC_MOXEMM_SMU_ALM21_16_C DFES_DTCO.DFC_MOXEMM_SMU_ALM21_3_C DFES_DTCO.DFC_MOXEMM_SMU_ALM2_1_C DFES_DTCO.DFC_MOXEMM_SMU_ALM2_10_C DFES_DTCO.DFC_MOXEMM_SMU_ALM2_11_C DFES_DTCO.DFC_MOXEMM_SMU_ALM2_13_C DFES_DTCO.DFC_MOXEMM_SMU_ALM2_14_C DFES_DTCO.DFC_MOXEMM_SMU_ALM2_22_C DFES_DTCO.DFC_MOXEMM_SMU_ALM2_23_C DFES_DTCO.DFC_MOXEMM_SMU_ALM2_4_C DFES_DTCO.DFC_MOXEMM_SMU_ALM2_5_C DFES_DTCO.DFC_MOXEMM_SMU_ALM2_7_C DFES_DTCO.DFC_MOXEMM_SMU_ALM2_8_C DFES_DTCO.DFC_MOXEMM_SMU_ALM6_0_C DFES_DTCO.DFC_MOXEMM_SMU_ALM6_11_C DFES_DTCO.DFC_MOXEMM_SMU_ALM6_12_C DFES_DTCO.DFC_MOXEMM_SMU_ALM6_14_C DFES_DTCO.DFC_MOXEMM_SMU_ALM6_15_C DFES_DTCO.DFC_MOXEMM_SMU_ALM6_17_C DFES_DTCO.DFC_MOXEMM_SMU_ALM6_18_C DFES_DTCO.DFC_MOXEMM_SMU_ALM6_20_C DFES_DTCO.DFC_MOXEMM_SMU_ALM6_21_C DFES_DTCO.DFC_MOXEMM_SMU_ALM6_25_C DFES_DTCO.DFC_MOXEMM_SMU_ALM6_4_C DFES_DTCO.DFC_MOXEMM_SMU_ALM6_5_C DFES_DTCO.DFC_MOXEMM_SMU_ALM6_7_C DFES_DTCO.DFC_MOXEMM_SMU_ALM6_8_C DFES_DTCO.DFC_MOXEMM_SMU_ALM7_1_C DFES_DTCO.DFC_MOXEMM_SMU_ALM7_12_C DFES_DTCO.DFC_MOXEMM_SMU_ALM7_13_C DFES_DTCO.DFC_MOXEMM_SMU_ALM7_14_C DFES_DTCO.DFC_MOXEMM_SMU_ALM7_15_C DFES_DTCO.DFC_MOXEMM_SMU_ALM7_16_C DFES_DTCO.DFC_MOXEMM_SMU_ALM7_17_C DFES_DTCO.DFC_MOXEMM_SMU_ALM7_2_C DFES_DTCO.DFC_MOXEMM_SMU_ALM7_20_C DFES_DTCO.DFC_MOXEMM_SMU_ALM7_25_C DFES_DTCO.DFC_MOXEMM_SMU_ALM7_26_C DFES_DTCO.DFC_MOXEMM_SMU_ALM7_28_C DFES_DTCO.DFC_MOXEMM_SMU_ALM7_29_C DFES_DTCO.DFC_MOXEMM_SMU_ALM7_30_C DFES_DTCO.DFC_MOXEMM_SMU_ALM7_31_C DFES_DTCO.DFC_MOXEMM_SMU_ALM8_0_C DFES_DTCO.DFC_MOXEMM_SMU_ALM8_1_C DFES_DTCO.DFC_MOXEMM_SMU_ALM8_10_C DFES_DTCO.DFC_MOXEMM_SMU_ALM8_11_C DFES_DTCO.DFC_MOXEMM_SMU_ALM8_12_C DFES_DTCO.DFC_MOXEMM_SMU_ALM8_16_C DFES_DTCO.DFC_MOXEMM_SMU_ALM8_18_C DFES_DTCO.DFC_MOXEMM_SMU_ALM8_2_C DFES_DTCO.DFC_MOXEMM_SMU_ALM8_3_C DFES_DTCO.DFC_MOXEMM_SMU_ALM8_31_C DFES_DTCO.DFC_MOXEMM_SMU_ALM8_4_C DFES_DTCO.DFC_MOXEMM_SMU_ALM9_0_C DFES_DTCO.DFC_MOXEMM_SMU_ALM9_15_C DFES_DTCO.DFC_MOXEMM_SMU_ALM9_3_C DFES_DTCO.DFC_MoCADCNTPBnk1_C DFES_DTCO.DFC_MoCADCTestVoltBnk1_C DFES_DTCO.DFC_MoCSOPICO_C DFES_DTCO.DFC_MoFAccr_C DFES_DTCO.DFC_MoFCbnPreCdngOvrheat_C DFES_DTCO.DFC_MoFCbnPreCdngTmrExpi_C DFES_DTCO.DFC_MoFEvMngtBms_C DFES_DTCO.DFC_MoFEvMngtDcdc_C DFES_DTCO.DFC_MoFEvMngtEm01_C DFES_DTCO.DFC_MoFEvMngtEm01BrkgToZr_C DFES_DTCO.DFC_MoFEvMngtEm01EngSpd_C DFES_DTCO.DFC_MoFEvMngtEm02EngSpd_C DFES_DTCO.DFC_MoFEvMngtEm02Lvl1_C DFES_DTCO.DFC_MoFEvMngtEm02Lvl2_C DFES_DTCO.DFC_MoFExtCptAuxCpt_C DFES_DTCO.DFC_MoFExtCptVacPmpErr_C DFES_DTCO.DFC_MoFTqPtdAxle_C DFES_DTCO.DFC_MoFTqPtdAxleSec_C DFES_DTCO.DFC_MoFTqPtdEmPtRels_C DFES_DTCO.DFC_MoFTqPtdEmPtRelsSec_C DFES_DTCO.DFC_MoFTqPtdEmSign_C DFES_DTCO.DFC_MoFTqPtdEmSignSec_C DFES_DTCO.DFC_MoFTqPtdEmTq_C DFES_DTCO.DFC_MoFTqPtdEmTqSec_C DFES_DTCO.DFC_MoFTqPtdVeh_C DFES_DTCO.DFC_MoFVarPostBldSel_C DFES_DTCO.DFC_MoSysCtrlReIni_C DFES_DTCO.DFC_MoXEMMHwLTMCUFW_C DFES_DTCO.DFC_MoXEMMHwLTMonBIST_C DFES_DTCO.DFC_MoXEMMHwLTRegMonTest_C DFES_DTCO.DFC_MoXEMMHwLTStbySMUAlvTest_C DFES_DTCO.DFC_MoXEMMHwLTTempSens_C DFES_DTCO.DFC_MoXEMMHwLTUCBCfg_C DFES_DTCO.DFC_MonEgyChrgnCoorr_AcChrgnWoMofRels_C DFES_DTCO.DFC_MonEgyChrgnCoorr_ChrgnAbortIgr_C DFES_DTCO.DFC_MonEgyChrgnCoorr_DcCntctFailr_C DFES_DTCO.DFC_MonEgyChrgnCoorr_ExtChrgnShtOffReq_C DFES_DTCO.DFC_MonEgyChrgnCoorr_ImpsChrgnMod_C DFES_DTCO.DFC_MonEgyChrgnCoorr_ImpsChrgnPrms_C DFES_DTCO.DFC_MonEgyChrgnCoorr_ImpsUDcIntk_C DFES_DTCO.DFC_MonEgyChrgnCoorr_PlgLockMovmt_C DFES_DTCO.DFC_MonEgyChrgnCoorr_VehCrashDetn_C DFES_DTCO.DFC_MonEgyChrgnErrReactn_SftySwt_C DFES_DTCO.DFC_MonEgyChrgnInlet_CcsPlgCtp_C DFES_DTCO.DFC_MonEgyChrgnInlet_CcsPlgCtpPwm_C DFES_DTCO.DFC_MonEgyChrgnInlet_CcsPlgLockCtrlImpsAtmpt_C DFES_DTCO.DFC_MonEgyChrgnInlet_CcsPlgLockSnsrSigRngChk_C DFES_DTCO.DFC_MonEgyChrgnInlet_CcsPlgLockStImps_C DFES_DTCO.DFC_MonEgyChrgnInlet_CcsPlgPxp_C DFES_DTCO.DFC_MonEgyChrgnT_Snsr1GrdtChk_C DFES_DTCO.DFC_MonEgyChrgnT_Snsr1SigRngChk_C DFES_DTCO.DFC_MonEgyChrgnT_Snsr2GrdtChk_C DFES_DTCO.DFC_MonEgyChrgnT_Snsr2SigRngChk_C DFES_DTCO.DFC_MonEgyChrgnT_SnsrDif_C DFES_DTCO.DFC_OCWDAABEActv_C DFES_DTCO.DFC_OCWDACom_C DFES_DTCO.DFC_OCWDAErrPin_C DFES_DTCO.DFC_OCWDAOvrVltg_C DFES_DTCO.DFC_PUmax_C DFES_DTCO.DFC_PwmCtPTmpErr_C DFES_DTCO.DFC_PwrDistbnUnitTSRCMax_C DFES_DTCO.DFC_PwrDistbnUnitTTmpErr_C DFES_DTCO.DFC_SCtPmp1DiagGrdKeyErr_C DFES_DTCO.DFC_SRCHighAPP1_C DFES_DTCO.DFC_SRCHighAPP2_C DFES_DTCO.DFC_SRCLowAPP1_C DFES_DTCO.DFC_SRCLowAPP2_C DFES_DTCO.DFC_SWReset_0_C DFES_DTCO.DFC_SWReset_1_C DFES_DTCO.DFC_SWReset_2_C DFES_DTCO.DFC_Sia_InvldCode_C DFES_DTCO.DFC_Sia_InvldKey_C DFES_DTCO.DFC_Sia_NoRespUCx_C DFES_DTCO.DFC_Sia_TprotRttp_C DFES_DTCO.DFC_StrtUpEvStandStillDeactvn_C DFES_DTCO.DFC_SyncAPP_C DFES_DTCO.DFC_UCtPSRCMax_C DFES_DTCO.DFC_UCtPTmpErr_C DFES_DTCO.DFC_UPxP1SRCMax_C DFES_DTCO.DFC_UPxP1TmpErr_C DFES_DTCO.DFC_VehVObd_C DFES_EnvDid.xSet1_CA DFES_EnvDid.xSet2_CA DFES_EnvDid.xSet3_CA DFES_EnvDid.xSet4_CA DFES_EnvDid.xSet5_CA DFES_EnvDid.xSet6_CA DFES_EnvDid.xSet7_CA DFES_EnvDid.xSet8_CA DFES_EnvDid.xSet9_CA DFES_EnvDid.xSet10_CA DFES_EnvDid.xSet11_CA DFES_EnvDid.xSet12_CA DFES_EnvDid.xSet13_CA DFES_EnvDid.xSet14_CA DFES_EnvDid.xSet15_CA DFES_EnvDid.xSet16_CA DFES_EnvDid.xSet17_CA DFES_EnvDid.xSet18_CA DFES_EnvDid.xSet19_CA DFES_EnvDid.xSet20_CA DFES_EnvDid.xSet21_CA DFES_EnvDid.xSet22_CA DFES_EnvDid.xSet23_CA DFES_EnvDid.xSet24_CA DFES_EnvDid.xSet25_CA DFES_EnvDid.xSet26_CA DFES_EnvDid.xSet27_CA DFES_EnvDid.xSet28_CA DFES_EnvDid.xSet29_CA DFES_EnvDid.xSet30_CA DFES_EnvRef.DFC_Unused_C DFES_EnvRef.DFC_ACCmprFltLvlRes_C DFES_EnvRef.DFC_AbgHiSigFlt_C DFES_EnvRef.DFC_AbgIntPatFlt_C DFES_EnvRef.DFC_AbgLoSigFlt_C DFES_EnvRef.DFC_AbgUnkwnErrSigFlt_C DFES_EnvRef.DFC_AcExtChrgrIBattExcdd_C DFES_EnvRef.DFC_AcExtChrgrIInExcdd_C DFES_EnvRef.DFC_AcExtChrgrIOutDe_C DFES_EnvRef.DFC_AcExtChrgrIOutExcdd_C DFES_EnvRef.DFC_AcExtChrgrUOutDe_C DFES_EnvRef.DFC_AdpActvDChaFailr_C DFES_EnvRef.DFC_AirbcuFlt_C DFES_EnvRef.DFC_Airbg_C DFES_EnvRef.DFC_AirbgCan_C DFES_EnvRef.DFC_AirbgCanHWPlaus_C DFES_EnvRef.DFC_AirbgHWCanPlaus_C DFES_EnvRef.DFC_AirbgMnr_C DFES_EnvRef.DFC_AirbgPerHi_C DFES_EnvRef.DFC_AirbgPerdRngFlt_C DFES_EnvRef.DFC_BlowrRlyErr_C DFES_EnvRef.DFC_BrkBstPmpActtnDfct_C DFES_EnvRef.DFC_BrkBstPmpDeactvnDfct_C DFES_EnvRef.DFC_BrkSwtFlt_C DFES_EnvRef.DFC_CbnHeatgHeatrHsScb_C DFES_EnvRef.DFC_CbnHeatgHeatrHsScg_C DFES_EnvRef.DFC_CbnHeatgHeatrLsOl_C DFES_EnvRef.DFC_CbnHeatgHeatrLsScb_C DFES_EnvRef.DFC_CbnHeatgHeatrLsScg_C DFES_EnvRef.DFC_CbnHeatgHeatrUnUsed_C DFES_EnvRef.DFC_ChrgnCntctHsOt_C DFES_EnvRef.DFC_ChrgnCntctHsScb_C DFES_EnvRef.DFC_ChrgnCntctHsScg_C DFES_EnvRef.DFC_ChrgnCntctLsNegOl_C DFES_EnvRef.DFC_ChrgnCntctLsNegOt_C DFES_EnvRef.DFC_ChrgnCntctLsNegScb_C DFES_EnvRef.DFC_ChrgnCntctLsNegScg_C DFES_EnvRef.DFC_ChrgnCntctLsPosOl_C DFES_EnvRef.DFC_ChrgnCntctLsPosOt_C DFES_EnvRef.DFC_ChrgnCntctLsPosScb_C DFES_EnvRef.DFC_ChrgnCntctLsPosScg_C DFES_EnvRef.DFC_ChrgnCntctUnUsed_C DFES_EnvRef.DFC_ComBrkMai_C DFES_EnvRef.DFC_ComChrgrEVCont_C DFES_EnvRef.DFC_ComChrgrEVtBlink_C DFES_EnvRef.DFC_ComChrgrMstBlink_C DFES_EnvRef.DFC_ComChrgrMstCont_C DFES_EnvRef.DFC_ComChrgrSVSBlink_C DFES_EnvRef.DFC_ComChrgrSVSCont_C DFES_EnvRef.DFC_ComDcdcEVBlink_C DFES_EnvRef.DFC_ComDcdcEVCont_C DFES_EnvRef.DFC_ComDcdcFltLvl2_C DFES_EnvRef.DFC_ComDcdcFltLvl3_C DFES_EnvRef.DFC_ComDcdcFltLvl4_C DFES_EnvRef.DFC_ComDcdcFltLvl5_C DFES_EnvRef.DFC_ComDcdcFltLvlRes_C DFES_EnvRef.DFC_ComDcdcMstBlink_C DFES_EnvRef.DFC_ComDcdcMstCont_C DFES_EnvRef.DFC_ComDcdcSVSBlink_C DFES_EnvRef.DFC_ComDcdcSVSCont_C DFES_EnvRef.DFC_ComElMIIvtrFltLvl2_C DFES_EnvRef.DFC_ComElMIIvtrFltLvl3_C DFES_EnvRef.DFC_ComElMIIvtrFltLvl4_C DFES_EnvRef.DFC_ComElMIIvtrFltLvl5_C DFES_EnvRef.DFC_ComElMIIvtrFltLvlRes_C DFES_EnvRef.DFC_ComEmacEVBlink_C DFES_EnvRef.DFC_ComEmacEVCont_C DFES_EnvRef.DFC_ComEmacMstCont_C DFES_EnvRef.DFC_ComEmacMsttBlink_C DFES_EnvRef.DFC_ComEmacSVSBlink_C DFES_EnvRef.DFC_ComEmacSVSCont_C DFES_EnvRef.DFC_ComGunCntInfoWkuReq_C DFES_EnvRef.DFC_ComHillHldFlt_C DFES_EnvRef.DFC_ComHvBattRchrgWkuReq_C DFES_EnvRef.DFC_ComHvbFltLvl2_C DFES_EnvRef.DFC_ComHvbFltLvl3_C DFES_EnvRef.DFC_ComHvbFltLvl4_C DFES_EnvRef.DFC_ComHvbFltLvl5_C DFES_EnvRef.DFC_ComHvbFltLvlRes_C DFES_EnvRef.DFC_ComHvbMstBlink_C DFES_EnvRef.DFC_ComHvbMstCont_C DFES_EnvRef.DFC_ComImmoUnlockWkuReq_C DFES_EnvRef.DFC_ComInfoReqPtlWkuReq_C DFES_EnvRef.DFC_ComOBCFltLvl2_C DFES_EnvRef.DFC_ComOBCFltLvl3_C DFES_EnvRef.DFC_ComOBCFltLvl4_C DFES_EnvRef.DFC_ComOBCFltLvl5_C DFES_EnvRef.DFC_ComOBCFltLvlRes_C DFES_EnvRef.DFC_ComPostOperationWkuReq_C DFES_EnvRef.DFC_ComPreCondElecWkuReq_C DFES_EnvRef.DFC_ComRemUnlckWkuReq_C DFES_EnvRef.DFC_ComStpDlyHMIWkuReq_C DFES_EnvRef.DFC_ComflgCurMeasmtErr_C DFES_EnvRef.DFC_ComflgCurMeasmtSysErr_C DFES_EnvRef.DFC_ComflgCurMeasmtVld_C DFES_EnvRef.DFC_ComflgCurRngErr_C DFES_EnvRef.DFC_ComflgTPcbMeasmtErr_C DFES_EnvRef.DFC_ComflgTPcbMeasmtVld_C DFES_EnvRef.DFC_ComflgTPcbRngErr_C DFES_EnvRef.DFC_ComflgTPcbSysErr_C DFES_EnvRef.DFC_ComflgTShntMeasmtErr_C DFES_EnvRef.DFC_ComflgTShntMeasmtVld_C DFES_EnvRef.DFC_ComflgTShntRngErr_C DFES_EnvRef.DFC_ComflgTShntSysErr_C DFES_EnvRef.DFC_ComflgVoltMeasmtErr_C DFES_EnvRef.DFC_ComflgVoltMeasmtSysErr_C DFES_EnvRef.DFC_ComflgVoltMeasmtVld_C DFES_EnvRef.DFC_ComflgVoltRngErr_C DFES_EnvRef.DFC_CrashEveOcc_C DFES_EnvRef.DFC_DcdcFwdModStuck_C DFES_EnvRef.DFC_DcdcLvUDifMaxFlt_C DFES_EnvRef.DFC_DcdcOffModStuck_C DFES_EnvRef.DFC_DcdcOperModFailr_C DFES_EnvRef.DFC_DcdcPrecModStuck_C DFES_EnvRef.DFC_DrvDoorOpn_C DFES_EnvRef.DFC_DrvModPosnDfct_C DFES_EnvRef.DFC_DrvStbltOpn_C DFES_EnvRef.DFC_ETogFailrLvl3_C DFES_EnvRef.DFC_ETogFailrLvl4_C DFES_EnvRef.DFC_EbsLvBattSocDiagLo_C DFES_EnvRef.DFC_EbsLvBattUDiagDiOper_C DFES_EnvRef.DFC_EbsLvBattUDiagFltLvl1_C DFES_EnvRef.DFC_EbsLvBattUDiagFltLvl2_C DFES_EnvRef.DFC_EbsLvBattUDiagLo_C DFES_EnvRef.DFC_EbsSnsrSt_C DFES_EnvRef.DFC_EbsSofASILErr_C DFES_EnvRef.DFC_ElTSPtSysLimDrvErr_C DFES_EnvRef.DFC_ElTSPtSysLimRgnErr_C DFES_EnvRef.DFC_HLCCcsFwDwnl_C DFES_EnvRef.DFC_HvBattChrgPwrMax_C DFES_EnvRef.DFC_HvBattCrashDetd_C DFES_EnvRef.DFC_HvBattDchaPwrMax_C DFES_EnvRef.DFC_HvBattEmgyOff_C DFES_EnvRef.DFC_HvBattEmgyOffIntlck_C DFES_EnvRef.DFC_HvBattEmgyOffReq_C DFES_EnvRef.DFC_HvBattFltMod_C DFES_EnvRef.DFC_HvBattIReqToChrgrErr_C DFES_EnvRef.DFC_HvBattIReqToChrgrIni_C DFES_EnvRef.DFC_HvBattIninTout_C DFES_EnvRef.DFC_HvBattIntlckSt_C DFES_EnvRef.DFC_HvBattIsoFlt_C DFES_EnvRef.DFC_HvBattLimdPwr_C DFES_EnvRef.DFC_HvBattMaiSwtClsngFlt_C DFES_EnvRef.DFC_HvBattMaiSwtFlt_C DFES_EnvRef.DFC_HvBattMaiSwtOpen_C DFES_EnvRef.DFC_HvBattMaiSwtOpngFlt_C DFES_EnvRef.DFC_HvBattMaiSwtWldd_C DFES_EnvRef.DFC_HvBattNegCntctrCntErr_C DFES_EnvRef.DFC_HvBattOperModChrgPlausy_C DFES_EnvRef.DFC_HvBattOverTDern_C DFES_EnvRef.DFC_HvBattPosCntctrCntErr_C DFES_EnvRef.DFC_HvBattPrecCntctrCntErr_C DFES_EnvRef.DFC_HvBattPwrDistbnTDern_C DFES_EnvRef.DFC_HvBattPwrDistbnTInhbn_C DFES_EnvRef.DFC_HvBattRatRSohErr_C DFES_EnvRef.DFC_HvBattRatSohErr_C DFES_EnvRef.DFC_HvBattSngIsoWarn_C /end DEF_CHARACTERISTIC
 FUNCTION_VERSION "30000.70.0" /end FUNCTION
/begin COMPU_METHOD DFES_EnvTabVerb "" TAB_VERB "%6.3" "-" COMPU_TAB_REF DFES_EnvTabVerb /end COMPU_METHOD
/begin COMPU_VTAB DFES_EnvTabVerb "" TAB_VERB 30 0 "xSet1" 1 "xSet2" 2 "xSet3" 3 "xSet4" 4 "xSet5" 5 "xSet6" 6 "xSet7" 7 "xSet8" 8 "xSet9" 9 "xSet10" 10 "xSet11" 11 "xSet12" 12 "xSet13" 13 "xSet14" 14 "xSet15" 15 "xSet16" 16 "xSet17" 17 "xSet18" 18 "xSet19" 19 "xSet20" 20 "xSet21" 21 "xSet22" 22 "xSet23" 23 "xSet24" 24 "xSet25" 25 "xSet26" 26 "xSet27" 27 "xSet28" 28 "xSet29" 29 "xSet30" DEFAULT_VALUE "---" /end COMPU_VTAB
/begin COMPU_METHOD DFES_OneToOne "" RAT_FUNC "%6.2" "-" COEFFS 0 1 0 0 0 1 /end COMPU_METHOD
/begin COMPU_METHOD DID_Verb "" TAB_VERB "%6.3" "" COMPU_TAB_REF DID_Verb /end COMPU_METHOD
/begin COMPU_VTAB DID_Verb "" TAB_VERB 253 0 "Unused" 256 "DID 0x0100" 3328 "DID 0x0D00" 3329 "DID 0x0D01" 4352 "DID 0x1100" 8448 "DID 0x2100" 8449 "DID 0x2101" 49154 "DID 0xC002" 54272 "DID 0xD400" 54273 "DID 0xD401" 54274 "DID 0xD402" 54275 "DID 0xD403" 54276 "DID 0xD404" 54278 "DID 0xD406" 54280 "DID 0xD408" 54281 "DID 0xD409" 54282 "DID 0xD40A" 54283 "DID 0xD40B" 54284 "DID 0xD40C" 54288 "DID 0xD410" 54289 "DID 0xD411" 54290 "DID 0xD412" 54291 "DID 0xD413" 54294 "DID 0xD416" 54298 "DID 0xD41A" 54304 "DID 0xD420" 54305 "DID 0xD421" 54307 "DID 0xD423" 54309 "DID 0xD425" 54312 "DID 0xD428" 54313 "DID 0xD429" 54315 "DID 0xD42B" 54316 "DID 0xD42C" 54318 "DID 0xD42E" 54319 "DID 0xD42F" 54322 "DID 0xD432" 54324 "DID 0xD434" 54330 "DID 0xD43A" 54341 "DID 0xD445" 54342 "DID 0xD446" 54343 "DID 0xD447" 54344 "DID 0xD448" 54345 "DID 0xD449" 54346 "DID 0xD44A" 54347 "DID 0xD44B" 54348 "DID 0xD44C" 54351 "DID 0xD44F" 54356 "DID 0xD454" 54357 "DID 0xD455" 54358 "DID 0xD456" 54359 "DID 0xD457" 54360 "DID 0xD458" 54361 "DID 0xD459" 54362 "DID 0xD45A" 54363 "DID 0xD45B" 54364 "DID 0xD45C" 54366 "DID 0xD45E" 54367 "DID 0xD45F" 54368 "DID 0xD460" 54374 "DID 0xD466" 54380 "DID 0xD46C" 54381 "DID 0xD46D" 54387 "DID 0xD473" 54388 "DID 0xD474" 54389 "DID 0xD475" 54390 "DID 0xD476" 54391 "DID 0xD477" 54393 "DID 0xD479" 54395 "DID 0xD47B" 54397 "DID 0xD47D" 54398 "DID 0xD47E" 54400 "DID 0xD480" 54403 "DID 0xD483" 54405 "DID 0xD485" 54412 "DID 0xD48C" 54413 "DID 0xD48D" 54420 "DID 0xD494" 54421 "DID 0xD495" 54422 "DID 0xD496" 54424 "DID 0xD498" 54425 "DID 0xD499" 54426 "DID 0xD49A" 54428 "DID 0xD49C" 54530 "DID 0xD502" 54531 "DID 0xD503" 54532 "DID 0xD504" 54533 "DID 0xD505" 54534 "DID 0xD506" 54535 "DID 0xD507" 54536 "DID 0xD508" 54538 "DID 0xD50A" 54550 "DID 0xD516" 54551 "DID 0xD517" 54553 "DID 0xD519" 54554 "DID 0xD51A" 54555 "DID 0xD51B" 54556 "DID 0xD51C" 54560 "DID 0xD520" 54561 "DID 0xD521" 54562 "DID 0xD522" 54563 "DID 0xD523" 54565 "DID 0xD525" 54566 "DID 0xD526" 54567 "DID 0xD527" 54570 "DID 0xD52A" 54572 "DID 0xD52C" 54575 "DID 0xD52F" 54576 "DID 0xD530" 54577 "DID 0xD531" 54578 "DID 0xD532" 54581 "DID 0xD535" 54586 "DID 0xD53A" 54587 "DID 0xD53B" 54589 "DID 0xD53D" 54590 "DID 0xD53E" 54591 "DID 0xD53F" 54592 "DID 0xD540" 54593 "DID 0xD541" 54596 "DID 0xD544" 54597 "DID 0xD545" 54598 "DID 0xD546" 54599 "DID 0xD547" 54600 "DID 0xD548" 54601 "DID 0xD549" 54604 "DID 0xD54C" 54605 "DID 0xD54D" 54606 "DID 0xD54E" 54607 "DID 0xD54F" 54608 "DID 0xD550" 54610 "DID 0xD552" 54611 "DID 0xD553" 54612 "DID 0xD554" 54613 "DID 0xD555" 54614 "DID 0xD556" 54615 "DID 0xD557" 54616 "DID 0xD558" 54617 "DID 0xD559" 54618 "DID 0xD55A" 54619 "DID 0xD55B" 54621 "DID 0xD55D" 54622 "DID 0xD55E" 54623 "DID 0xD55F" 54624 "DID 0xD560" 54625 "DID 0xD561" 54626 "DID 0xD562" 54627 "DID 0xD563" 54628 "DID 0xD564" 54629 "DID 0xD565" 54632 "DID 0xD568" 54633 "DID 0xD569" 54634 "DID 0xD56A" 54635 "DID 0xD56B" 54636 "DID 0xD56C" 54637 "DID 0xD56D" 54638 "DID 0xD56E" 54639 "DID 0xD56F" 54640 "DID 0xD570" 54641 "DID 0xD571" 54642 "DID 0xD572" 54643 "DID 0xD573" 54644 "DID 0xD574" 54647 "DID 0xD577" 54648 "DID 0xD578" 54650 "DID 0xD57A" 54651 "DID 0xD57B" 54652 "DID 0xD57C" 54653 "DID 0xD57D" 54654 "DID 0xD57E" 54655 "DID 0xD57F" 54656 "DID 0xD580" 54657 "DID 0xD581" 54658 "DID 0xD582" 54659 "DID 0xD583" 54660 "DID 0xD584" 54661 "DID 0xD585" 54662 "DID 0xD586" 54663 "DID 0xD587" 54664 "DID 0xD588" 54666 "DID 0xD58A" 54667 "DID 0xD58B" 54668 "DID 0xD58C" 54669 "DID 0xD58D" 54670 "DID 0xD58E" 54673 "DID 0xD591" 54676 "DID 0xD594" 54677 "DID 0xD595" 54678 "DID 0xD596" 54679 "DID 0xD597" 54680 "DID 0xD598" 54681 "DID 0xD599" 54682 "DID 0xD59A" 54683 "DID 0xD59B" 54684 "DID 0xD59C" 54685 "DID 0xD59D" 54686 "DID 0xD59E" 54691 "DID 0xD5A3" 54692 "DID 0xD5A4" 54694 "DID 0xD5A6" 54696 "DID 0xD5A8" 54697 "DID 0xD5A9" 54700 "DID 0xD5AC" 54701 "DID 0xD5AD" 54702 "DID 0xD5AE" 54703 "DID 0xD5AF" 54704 "DID 0xD5B0" 54705 "DID 0xD5B1" 54706 "DID 0xD5B2" 54707 "DID 0xD5B3" 54708 "DID 0xD5B4" 54709 "DID 0xD5B5" 54710 "DID 0xD5B6" 54711 "DID 0xD5B7" 54712 "DID 0xD5B8" 54713 "DID 0xD5B9" 54714 "DID 0xD5BA" 54715 "DID 0xD5BB" 54717 "DID 0xD5BD" 54719 "DID 0xD5BF" 54721 "DID 0xD5C1" 54725 "DID 0xD5C5" 54726 "DID 0xD5C6" 54727 "DID 0xD5C7" 54728 "DID 0xD5C8" 54730 "DID 0xD5CA" 54731 "DID 0xD5CB" 54732 "DID 0xD5CC" 54733 "DID 0xD5CD" 54734 "DID 0xD5CE" 54737 "DID 0xD5D1" 54738 "DID 0xD5D2" 54739 "DID 0xD5D3" 54741 "DID 0xD5D5" 54742 "DID 0xD5D6" 54743 "DID 0xD5D7" 54744 "DID 0xD5D8" 54745 "DID 0xD5D9" 54746 "DID 0xD5DA" 54747 "DID 0xD5DB" 56321 "DID 0xDC01" 56322 "DID 0xDC02" 56323 "DID 0xDC03" 61456 "DID 0xF010" 61457 "DID 0xF011" 61458 "DID 0xF012" 61568 "DID 0xF080" 61693 "DID 0xF0FD" 61694 "DID 0xF0FE" 61824 "DID 0xF180" 61830 "DID 0xF186" 61835 "DID 0xF18B" 61836 "DID 0xF18C" 61840 "DID 0xF190" 61846 "DID 0xF196" /end COMPU_VTAB
/begin RECORD_LAYOUT ValA_Wu16 FNC_VALUES 1 UWORD COLUMN_DIR DIRECT /end RECORD_LAYOUT
/begin RECORD_LAYOUT Val_Wu16 FNC_VALUES 1 UWORD COLUMN_DIR DIRECT /end RECORD_LAYOUT
/begin RECORD_LAYOUT Val_Wu8 FNC_VALUES 1 UBYTE COLUMN_DIR DIRECT /end RECORD_LAYOUT
/end MODULE
/end PROJECT

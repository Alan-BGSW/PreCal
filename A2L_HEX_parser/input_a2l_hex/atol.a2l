ASAP2_VERSION 1 70
/begin PROJECT MDG1C "VC1CP091_STLA_N_D061I3"
/begin HEADER "" VERSION "VC1CP091_STLA_N_D061I3" PROJECT_NO MDG1C /end HEADER
/begin MODULE DIM ""
/begin MOD_COMMON "" BYTE_ORDER MSB_LAST ALIGNMENT_BYTE 1 ALIGNMENT_WORD 2 ALIGNMENT_LONG 4 ALIGNMENT_INT64 4 ALIGNMENT_FLOAT32_IEEE 4 ALIGNMENT_FLOAT64_IEEE 4 DATA_SIZE 32 /end MOD_COMMON
/begin CHARACTERISTIC DINH_FId.DFC_CANSM_E_BUS_OFF_NETWORK_XCP_CAN_CA "" VAL_BLK 0x80246ED6 ValA_Wu16 1139.00000000 DINH_FIdVerb 0.00 1139.00000000 FORMAT "%13.8" MATRIX_DIM 13 /end CHARACTERISTIC
/begin CHARACTERISTIC DINH_FId.DFC_CANTRCV_E_NO_TRCV_CONTROL_0_CA "" VAL_BLK 0x80246EF0 ValA_Wu16 1139.00000000 DINH_FIdVerb 0.00 1139.00000000 FORMAT "%13.8" MATRIX_DIM 13 /end CHARACTERISTIC
/begin CHARACTERISTIC DINH_FId.DFC_CAN_E_TIMEOUT_CA "" VAL_BLK 0x80246F0A ValA_Wu16 1139.00000000 DINH_FIdVerb 0.00 1139.00000000 FORMAT "%13.8" MATRIX_DIM 13 /end CHARACTERISTIC
/begin CHARACTERISTIC DINH_FId.DFC_COMM_E_NET_START_IND_CHANNEL_0_CA "" VAL_BLK 0x80246F24 ValA_Wu16 1139.00000000 DINH_FIdVerb 0.00 1139.00000000 FORMAT "%13.8" MATRIX_DIM 13 /end CHARACTERISTIC
/begin CHARACTERISTIC DINH_FId.DFC_COMM_E_NET_START_IND_CHANNEL_1_CA "" VAL_BLK 0x80246F3E ValA_Wu16 1139.00000000 DINH_FIdVerb 0.00 1139.00000000 FORMAT "%13.8" MATRIX_DIM 14 /end CHARACTERISTIC
/begin CHARACTERISTIC DINH_FId.DFC_COMM_E_NET_START_IND_CHANNEL_2_CA "" VAL_BLK 0x80246F5A ValA_Wu16 1139.00000000 DINH_FIdVerb 0.00 1139.00000000 FORMAT "%13.8" MATRIX_DIM 13 /end CHARACTERISTIC
/begin CHARACTERISTIC DINH_FId.DFC_COMM_E_NET_START_IND_CHANNEL_3_CA "" VAL_BLK 0x80246F74 ValA_Wu16 1139.00000000 DINH_FIdVerb 0.00 1139.00000000 FORMAT "%13.8" MATRIX_DIM 13 /end CHARACTERISTIC
/begin CHARACTERISTIC DINH_FId.DFC_COMM_E_NET_START_IND_CHANNEL_4_CA "" VAL_BLK 0x80246F8E ValA_Wu16 1139.00000000 DINH_FIdVerb 0.00 1139.00000000 FORMAT "%13.8" MATRIX_DIM 13 /end CHARACTERISTIC
/begin CHARACTERISTIC DINH_FId.DFC_COMM_E_NET_START_IND_CHANNEL_5_CA "" VAL_BLK 0x80246FA8 ValA_Wu16 1139.00000000 DINH_FIdVerb 0.00 1139.00000000 FORMAT "%13.8" MATRIX_DIM 13 /end CHARACTERISTIC
/begin CHARACTERISTIC DINH_FId.DFC_LIN_E_TIMEOUT_CA "" VAL_BLK 0x80246FC2 ValA_Wu16 1139.00000000 DINH_FIdVerb 0.00 1139.00000000 FORMAT "%13.8" MATRIX_DIM 13 /end CHARACTERISTIC
/begin CHARACTERISTIC DINH_FId.DFC_rba_EcuCtrl_TOMaxProlg_CA "" VAL_BLK 0x80246FDC ValA_Wu16 1139.00000000 DINH_FIdVerb 0.00 1139.00000000 FORMAT "%13.8" MATRIX_DIM 13 /end CHARACTERISTIC
/begin CHARACTERISTIC DINH_FId.DFC_rba_EcuCtrl_TOMaxShutDwn_CA "" VAL_BLK 0x80246FF6 ValA_Wu16 1139.00000000 DINH_FIdVerb 0.00 1139.00000000 FORMAT "%13.8" MATRIX_DIM 13 /end CHARACTERISTIC
/begin CHARACTERISTIC DINH_FId.DFC_rba_MultiStackTrace_Threshold_CA "" VAL_BLK 0x80247010 ValA_Wu16 1139.00000000 DINH_FIdVerb 0.00 1139.00000000 FORMAT "%13.8" MATRIX_DIM 13 /end CHARACTERISTIC
/begin CHARACTERISTIC DINH_FId.DFC_rba_SyC_CustStates_Degraded_disord_Event_CA "" VAL_BLK 0x8024702A ValA_Wu16 1139.00000000 DINH_FIdVerb 0.00 1139.00000000 FORMAT "%13.8" MATRIX_DIM 13 /end CHARACTERISTIC
/begin CHARACTERISTIC DINH_FId.DFC_rba_SyC_CustStates_Degraded_incst_Event_CA "" VAL_BLK 0x80247044 ValA_Wu16 1139.00000000 DINH_FIdVerb 0.00 1139.00000000 FORMAT "%13.8" MATRIX_DIM 13 /end CHARACTERISTIC
/begin CHARACTERISTIC DINH_FId.DFC_rba_SyC_CustStates_TransNoWakReq_Event_CA "" VAL_BLK 0x8024705E ValA_Wu16 1139.00000000 DINH_FIdVerb 0.00 1139.00000000 FORMAT "%13.8" MATRIX_DIM 13 /end CHARACTERISTIC
/begin CHARACTERISTIC DINH_FId.DFC_RBA_IOEXTLIB_KEEPALIVE_DRV_CA "" VAL_BLK 0x80247078 ValA_Wu16 1139.00000000 DINH_FIdVerb 0.00 1139.00000000 FORMAT "%13.8" MATRIX_DIM 13 /end CHARACTERISTIC
/begin CHARACTERISTIC DINH_FId.DFC_RBA_IOEXTLIB_KEEPALIVE_INI_CA "" VAL_BLK 0x80247092 ValA_Wu16 1139.00000000 DINH_FIdVerb 0.00 1139.00000000 FORMAT "%13.8" MATRIX_DIM 13 /end CHARACTERISTIC
/begin CHARACTERISTIC DINH_FId.DFC_rba_IoSigRtc_StopCounter_CA "" VAL_BLK 0x802470AC ValA_Wu16 1139.00000000 DINH_FIdVerb 0.00 1139.00000000 FORMAT "%13.8" MATRIX_DIM 13 /end CHARACTERISTIC
/begin CHARACTERISTIC DINH_FId.DFC_rba_MRly_Diag_Stk_Event_CA "" VAL_BLK 0x802470C6 ValA_Wu16 1139.00000000 DINH_FIdVerb 0.00 1139.00000000 FORMAT "%13.8" MATRIX_DIM 13 /end CHARACTERISTIC
/begin CHARACTERISTIC DINH_FId.DFC_rba_MemDiag_MemReadErr_CA "" VAL_BLK 0x802470E0 ValA_Wu16 1139.00000000 DINH_FIdVerb 0.00 1139.00000000 FORMAT "%13.8" MATRIX_DIM 13 /end CHARACTERISTIC
/begin CHARACTERISTIC DINH_FId.DFC_rba_MemDiag_MemWrErr_CA "" VAL_BLK 0x802470FA ValA_Wu16 1139.00000000 DINH_FIdVerb 0.00 1139.00000000 FORMAT "%13.8" MATRIX_DIM 13 /end CHARACTERISTIC
/begin CHARACTERISTIC DINH_FId.DFC_rba_SyC_IrrSwOffTrigEngRun_Event_CA "" VAL_BLK 0x80247114 ValA_Wu16 1139.00000000 DINH_FIdVerb 0.00 1139.00000000 FORMAT "%13.8" MATRIX_DIM 13 /end CHARACTERISTIC
/begin CHARACTERISTIC DINH_FId.DFC_AcChrgrIntkTSRCMax_CA "" VAL_BLK 0x8024712E ValA_Wu16 1139.00000000 DINH_FIdVerb 0.00 1139.00000000 FORMAT "%13.8" MATRIX_DIM 17 /end CHARACTERISTIC
/begin CHARACTERISTIC DINH_FId.DFC_AcChrgrIntkTTmpErr_CA "" VAL_BLK 0x80247150 ValA_Wu16 1139.00000000 DINH_FIdVerb 0.00 1139.00000000 FORMAT "%13.8" MATRIX_DIM 13 /end CHARACTERISTIC
/begin CHARACTERISTIC DINH_FId.DFC_AcFlt_CA "" VAL_BLK 0x8024716A ValA_Wu16 1139.00000000 DINH_FIdVerb 0.00 1139.00000000 FORMAT "%13.8" MATRIX_DIM 14 /end CHARACTERISTIC
/begin CHARACTERISTIC DINH_FId.DFC_AppAllSnsrDfct_CA "" VAL_BLK 0x80247186 ValA_Wu16 1139.00000000 DINH_FIdVerb 0.00 1139.00000000 FORMAT "%13.8" MATRIX_DIM 18 /end CHARACTERISTIC
/begin CHARACTERISTIC DINH_FId.DFC_BattUPwrFail_CA "" VAL_BLK 0x802471AA ValA_Wu16 1139.00000000 DINH_FIdVerb 0.00 1139.00000000 FORMAT "%13.8" MATRIX_DIM 13 /end CHARACTERISTIC
/begin CHARACTERISTIC DINH_FId.DFC_BrkBstBkupOvrn_CA "" VAL_BLK 0x802471C4 ValA_Wu16 1139.00000000 DINH_FIdVerb 0.00 1139.00000000 FORMAT "%13.8" MATRIX_DIM 13 /end CHARACTERISTIC
/begin CHARACTERISTIC DINH_FId.DFC_BrkBstPmpOvld_CA "" VAL_BLK 0x802471DE ValA_Wu16 1139.00000000 DINH_FIdVerb 0.00 1139.00000000 FORMAT "%13.8" MATRIX_DIM 15 /end CHARACTERISTIC
/begin CHARACTERISTIC DINH_FId.DFC_BrkPlausChk_CA "" VAL_BLK 0x802471FC ValA_Wu16 1139.00000000 DINH_FIdVerb 0.00 1139.00000000 FORMAT "%13.8" MATRIX_DIM 19 /end CHARACTERISTIC
/begin CHARACTERISTIC DINH_FId.DFC_CbnHeatgSwtTmpErr_CA "" VAL_BLK 0x80247222 ValA_Wu16 1139.00000000 DINH_FIdVerb 0.00 1139.00000000 FORMAT "%13.8" MATRIX_DIM 13 /end CHARACTERISTIC
/begin CHARACTERISTIC DINH_FId.DFC_CcsPwrLineChpVccSRCMax_CA "" VAL_BLK 0x8024723C ValA_Wu16 1139.00000000 DINH_FIdVerb 0.00 1139.00000000 FORMAT "%13.8" MATRIX_DIM 17 /end CHARACTERISTIC
/begin CHARACTERISTIC DINH_FId.DFC_CcsPwrLineChpVccTmpErr_CA "" VAL_BLK 0x8024725E ValA_Wu16 1139.00000000 DINH_FIdVerb 0.00 1139.00000000 FORMAT "%13.8" MATRIX_DIM 13 /end CHARACTERISTIC
/begin CHARACTERISTIC DINH_FId.DFC_CcsPwrLineComChpTSRCMax_CA "" VAL_BLK 0x80247278 ValA_Wu16 1139.00000000 DINH_FIdVerb 0.00 1139.00000000 FORMAT "%13.8" MATRIX_DIM 18 /end CHARACTERISTIC
/begin CHARACTERISTIC DINH_FId.DFC_CcsPwrLineComChpTTmpErr_CA "" VAL_BLK 0x8024729C ValA_Wu16 1139.00000000 DINH_FIdVerb 0.00 1139.00000000 FORMAT "%13.8" MATRIX_DIM 14 /end CHARACTERISTIC
/begin CHARACTERISTIC DINH_FId.DFC_ChgrPlugCtpCarrFrqErr_CA "" VAL_BLK 0x802472B8 ValA_Wu16 1139.00000000 DINH_FIdVerb 0.00 1139.00000000 FORMAT "%13.8" MATRIX_DIM 13 /end CHARACTERISTIC
/begin CHARACTERISTIC DINH_FId.DFC_ChgrPlugCtpSwtStuckClsd_CA "" VAL_BLK 0x802472D2 ValA_Wu16 1139.00000000 DINH_FIdVerb 0.00 1139.00000000 FORMAT "%13.8" MATRIX_DIM 13 /end CHARACTERISTIC
/begin CHARACTERISTIC DINH_FId.DFC_ChgrPlugCtpSwtStuckOpen_CA "" VAL_BLK 0x802472EC ValA_Wu16 1139.00000000 DINH_FIdVerb 0.00 1139.00000000 FORMAT "%13.8" MATRIX_DIM 13 /end CHARACTERISTIC
/begin CHARACTERISTIC DINH_FId.DFC_ChgrPlugCtpUErrHi_CA "" VAL_BLK 0x80247306 ValA_Wu16 1139.00000000 DINH_FIdVerb 0.00 1139.00000000 FORMAT "%13.8" MATRIX_DIM 13 /end CHARACTERISTIC
/begin CHARACTERISTIC DINH_FId.DFC_ChgrPlugPxp1SrcErr_CA "" VAL_BLK 0x80247320 ValA_Wu16 1139.00000000 DINH_FIdVerb 0.00 1139.00000000 FORMAT "%13.8" MATRIX_DIM 13 /end CHARACTERISTIC
/begin CHARACTERISTIC DINH_FId.DFC_ChrgCntctAllWldd_CA "" VAL_BLK 0x8024733A ValA_Wu16 1139.00000000 DINH_FIdVerb 0.00 1139.00000000 FORMAT "%13.8" MATRIX_DIM 16 /end CHARACTERISTIC
/begin CHARACTERISTIC DINH_FId.DFC_ChrgCntctNegOperErr_CA "" VAL_BLK 0x8024735A ValA_Wu16 1139.00000000 DINH_FIdVerb 0.00 1139.00000000 FORMAT "%13.8" MATRIX_DIM 13 /end CHARACTERISTIC
/begin CHARACTERISTIC DINH_FId.DFC_ChrgCntctNegOperWarn_CA "" VAL_BLK 0x80247374 ValA_Wu16 1139.00000000 DINH_FIdVerb 0.00 1139.00000000 FORMAT "%13.8" MATRIX_DIM 13 /end CHARACTERISTIC
/begin CHARACTERISTIC DINH_FId.DFC_ChrgCntctNegWldd_CA "" VAL_BLK 0x8024738E ValA_Wu16 1139.00000000 DINH_FIdVerb 0.00 1139.00000000 FORMAT "%13.8" MATRIX_DIM 16 /end CHARACTERISTIC
/begin CHARACTERISTIC DINH_FId.DFC_ChrgCntctPosOperErr_CA "" VAL_BLK 0x802473AE ValA_Wu16 1139.00000000 DINH_FIdVerb 0.00 1139.00000000 FORMAT "%13.8" MATRIX_DIM 13 /end CHARACTERISTIC
/begin CHARACTERISTIC DINH_FId.DFC_ChrgCntctPosOperWarn_CA "" VAL_BLK 0x802473C8 ValA_Wu16 1139.00000000 DINH_FIdVerb 0.00 1139.00000000 FORMAT "%13.8" MATRIX_DIM 13 /end CHARACTERISTIC
/begin CHARACTERISTIC DINH_FId.DFC_ChrgCntctPosWldd_CA "" VAL_BLK 0x802473E2 ValA_Wu16 1139.00000000 DINH_FIdVerb 0.00 1139.00000000 FORMAT "%13.8" MATRIX_DIM 16 /end CHARACTERISTIC
/begin CHARACTERISTIC DINH_FId.DFC_ChrgCntctStuckOpen_CA "" VAL_BLK 0x80247402 ValA_Wu16 1139.00000000 DINH_FIdVerb 0.00 1139.00000000 FORMAT "%13.8" MATRIX_DIM 14 /end CHARACTERISTIC
/begin CHARACTERISTIC DINH_FId.DFC_ChrgPlgIntlckFaild_CA "" VAL_BLK 0x8024741E ValA_Wu16 1139.00000000 DINH_FIdVerb 0.00 1139.00000000 FORMAT "%13.8" MATRIX_DIM 13 /end CHARACTERISTIC
/begin CHARACTERISTIC DINH_FId.DFC_ChrgnUnplRqrd_CA "" VAL_BLK 0x80247438 ValA_Wu16 1139.00000000 DINH_FIdVerb 0.00 1139.00000000 FORMAT "%13.8" MATRIX_DIM 13 /end CHARACTERISTIC
/begin CHARACTERISTIC DINH_FId.DFC_CoElMOffsCalibActv01_CA "" VAL_BLK 0x80247452 ValA_Wu16 1139.00000000 DINH_FIdVerb 0.00 1139.00000000 FORMAT "%13.8" MATRIX_DIM 13 /end CHARACTERISTIC
/begin CHARACTERISTIC DINH_FId.DFC_CtPSwtDiagSRCMax_CA "" VAL_BLK 0x8024746C ValA_Wu16 1139.00000000 DINH_FIdVerb 0.00 1139.00000000 FORMAT "%13.8" MATRIX_DIM 17 /end CHARACTERISTIC
/begin CHARACTERISTIC DINH_FId.DFC_CtPSwtDiagTmpErr_CA "" VAL_BLK 0x8024748E ValA_Wu16 1139.00000000 DINH_FIdVerb 0.00 1139.00000000 FORMAT "%13.8" MATRIX_DIM 13 /end CHARACTERISTIC
/begin CHARACTERISTIC DINH_FId.DFC_CtpCarrFrqTmpErr_CA "" VAL_BLK 0x802474A8 ValA_Wu16 1139.00000000 DINH_FIdVerb 0.00 1139.00000000 FORMAT "%13.8" MATRIX_DIM 13 /end CHARACTERISTIC
/begin CHARACTERISTIC DINH_FId.DFC_DcChrgrIntkT2SRCMax_CA "" VAL_BLK 0x802474C2 ValA_Wu16 1139.00000000 DINH_FIdVerb 0.00 1139.00000000 FORMAT "%13.8" MATRIX_DIM 18 /end CHARACTERISTIC
/begin CHARACTERISTIC DINH_FId.DFC_DcChrgrIntkT2TmpErr_CA "" VAL_BLK 0x802474E6 ValA_Wu16 1139.00000000 DINH_FIdVerb 0.00 1139.00000000 FORMAT "%13.8" MATRIX_DIM 13 /end CHARACTERISTIC
/begin CHARACTERISTIC DINH_FId.DFC_DcChrgrIntkTSRCMax_CA "" VAL_BLK 0x80247500 ValA_Wu16 1139.00000000 DINH_FIdVerb 0.00 1139.00000000 FORMAT "%13.8" MATRIX_DIM 18 /end CHARACTERISTIC
/begin CHARACTERISTIC DINH_FId.DFC_DcChrgrIntkTTmpErr_CA "" VAL_BLK 0x80247524 ValA_Wu16 1139.00000000 DINH_FIdVerb 0.00 1139.00000000 FORMAT "%13.8" MATRIX_DIM 13 /end CHARACTERISTIC
/begin CHARACTERISTIC DINH_FId.DFC_EChrDvPlinCntrThdExcdd_CA "" VAL_BLK 0x8024753E ValA_Wu16 1139.00000000 DINH_FIdVerb 0.00 1139.00000000 FORMAT "%13.8" MATRIX_DIM 13 /end CHARACTERISTIC
/begin CHARACTERISTIC DINH_FId.DFC_EemDiagCtctrClsTout_CA "" VAL_BLK 0x80247558 ValA_Wu16 1139.00000000 DINH_FIdVerb 0.00 1139.00000000 FORMAT "%13.8" MATRIX_DIM 13 /end CHARACTERISTIC
/begin CHARACTERISTIC DINH_FId.DFC_EemDiagDcdcOffTOut_CA "" VAL_BLK 0x80247572 ValA_Wu16 1139.00000000 DINH_FIdVerb 0.00 1139.00000000 FORMAT "%13.8" MATRIX_DIM 14 /end CHARACTERISTIC
/begin CHARACTERISTIC DINH_FId.DFC_EemDiagHvCnsrOffTOut_CA "" VAL_BLK 0x8024758E ValA_Wu16 1139.00000000 DINH_FIdVerb 0.00 1139.00000000 FORMAT "%13.8" MATRIX_DIM 14 /end CHARACTERISTIC
/begin CHARACTERISTIC DINH_FId.DFC_EemDiagHvbOffTOut_CA "" VAL_BLK 0x802475AA ValA_Wu16 1139.00000000 DINH_FIdVerb 0.00 1139.00000000 FORMAT "%13.8" MATRIX_DIM 15 /end CHARACTERISTIC
/begin CHARACTERISTIC DINH_FId.DFC_FanSpdSRCMax_CA "" VAL_BLK 0x802475C8 ValA_Wu16 1139.00000000 DINH_FIdVerb 0.00 1139.00000000 FORMAT "%13.8" MATRIX_DIM 17 /end CHARACTERISTIC
/begin CHARACTERISTIC DINH_FId.DFC_FanSpdTmpErr_CA "" VAL_BLK 0x802475EA ValA_Wu16 1139.00000000 DINH_FIdVerb 0.00 1139.00000000 FORMAT "%13.8" MATRIX_DIM 13 /end CHARACTERISTIC
/begin CHARACTERISTIC DINH_FId.DFC_FreonPSRCMax_CA "" VAL_BLK 0x80247604 ValA_Wu16 1139.00000000 DINH_FIdVerb 0.00 1139.00000000 FORMAT "%13.8" MATRIX_DIM 19 /end CHARACTERISTIC
/begin CHARACTERISTIC DINH_FId.DFC_FreonPTmpErr_CA "" VAL_BLK 0x8024762A ValA_Wu16 1139.00000000 DINH_FIdVerb 0.00 1139.00000000 FORMAT "%13.8" MATRIX_DIM 15 /end CHARACTERISTIC
/begin CHARACTERISTIC DINH_FId.DFC_HeatrCoreTSRCMax_CA "" VAL_BLK 0x80247648 ValA_Wu16 1139.00000000 DINH_FIdVerb 0.00 1139.00000000 FORMAT "%13.8" MATRIX_DIM 17 /end CHARACTERISTIC
/begin CHARACTERISTIC DINH_FId.DFC_HeatrCoreTTmpErr_CA "" VAL_BLK 0x8024766A ValA_Wu16 1139.00000000 DINH_FIdVerb 0.00 1139.00000000 FORMAT "%13.8" MATRIX_DIM 13 /end CHARACTERISTIC
/begin CHARACTERISTIC DINH_FId.DFC_HvGridSocMinLim_CA "" VAL_BLK 0x80247684 ValA_Wu16 1139.00000000 DINH_FIdVerb 0.00 1139.00000000 FORMAT "%13.8" MATRIX_DIM 14 /end CHARACTERISTIC
/begin CHARACTERISTIC DINH_FId.DFC_HvacBlwrFrntFlt_CA "" VAL_BLK 0x802476A0 ValA_Wu16 1139.00000000 DINH_FIdVerb 0.00 1139.00000000 FORMAT "%13.8" MATRIX_DIM 14 /end CHARACTERISTIC
/begin CHARACTERISTIC DINH_FId.DFC_HvacEvapElecFlt_CA "" VAL_BLK 0x802476BC ValA_Wu16 1139.00000000 DINH_FIdVerb 0.00 1139.00000000 FORMAT "%13.8" MATRIX_DIM 14 /end CHARACTERISTIC
/begin CHARACTERISTIC DINH_FId.DFC_HvacEvapElecFltGnd_CA "" VAL_BLK 0x802476D8 ValA_Wu16 1139.00000000 DINH_FIdVerb 0.00 1139.00000000 FORMAT "%13.8" MATRIX_DIM 14 /end CHARACTERISTIC
/begin CHARACTERISTIC DINH_FId.DFC_HvacKnobPosnFlt_CA "" VAL_BLK 0x802476F4 ValA_Wu16 1139.00000000 DINH_FIdVerb 0.00 1139.00000000 FORMAT "%13.8" MATRIX_DIM 14 /end CHARACTERISTIC
/begin CHARACTERISTIC DINH_FId.DFC_InvBinID_CA "" VAL_BLK 0x80247710 ValA_Wu16 1139.00000000 DINH_FIdVerb 0.00 1139.00000000 FORMAT "%13.8" MATRIX_DIM 13 /end CHARACTERISTIC
/begin CHARACTERISTIC DINH_FId.DFC_InvCalID_CA "" VAL_BLK 0x8024772A ValA_Wu16 1139.00000000 DINH_FIdVerb 0.00 1139.00000000 FORMAT "%13.8" MATRIX_DIM 13 /end CHARACTERISTIC
/begin CHARACTERISTIC DINH_FId.DFC_InvErotan_CA "" VAL_BLK 0x80247744 ValA_Wu16 1139.00000000 DINH_FIdVerb 0.00 1139.00000000 FORMAT "%13.8" MATRIX_DIM 13 /end CHARACTERISTIC
/begin CHARACTERISTIC DINH_FId.DFC_InvVinID_CA "" VAL_BLK 0x8024775E ValA_Wu16 1139.00000000 DINH_FIdVerb 0.00 1139.00000000 FORMAT "%13.8" MATRIX_DIM 13 /end CHARACTERISTIC
/begin CHARACTERISTIC DINH_FId.DFC_MOXEMM_SMU_ALM0_0_CA "" VAL_BLK 0x80247778 ValA_Wu16 1139.00000000 DINH_FIdVerb 0.00 1139.00000000 FORMAT "%13.8" MATRIX_DIM 13 /end CHARACTERISTIC
/begin CHARACTERISTIC DINH_FId.DFC_MOXEMM_SMU_ALM0_1_CA "" VAL_BLK 0x80247792 ValA_Wu16 1139.00000000 DINH_FIdVerb 0.00 1139.00000000 FORMAT "%13.8" MATRIX_DIM 13 /end CHARACTERISTIC
/begin CHARACTERISTIC DINH_FId.DFC_MOXEMM_SMU_ALM0_10_CA "" VAL_BLK 0x802477AC ValA_Wu16 1139.00000000 DINH_FIdVerb 0.00 1139.00000000 FORMAT "%13.8" MATRIX_DIM 13 /end CHARACTERISTIC
/begin CHARACTERISTIC DINH_FId.DFC_MOXEMM_SMU_ALM0_11_CA "" VAL_BLK 0x802477C6 ValA_Wu16 1139.00000000 DINH_FIdVerb 0.00 1139.00000000 FORMAT "%13.8" MATRIX_DIM 13 /end CHARACTERISTIC
/begin CHARACTERISTIC DINH_FId.DFC_MOXEMM_SMU_ALM0_13_CA "" VAL_BLK 0x802477E0 ValA_Wu16 1139.00000000 DINH_FIdVerb 0.00 1139.00000000 FORMAT "%13.8" MATRIX_DIM 13 /end CHARACTERISTIC
/begin CHARACTERISTIC DINH_FId.DFC_MOXEMM_SMU_ALM0_14_CA "" VAL_BLK 0x802477FA ValA_Wu16 1139.00000000 DINH_FIdVerb 0.00 1139.00000000 FORMAT "%13.8" MATRIX_DIM 13 /end CHARACTERISTIC
/begin CHARACTERISTIC DINH_FId.DFC_MOXEMM_SMU_ALM0_2_CA "" VAL_BLK 0x80247814 ValA_Wu16 1139.00000000 DINH_FIdVerb 0.00 1139.00000000 FORMAT "%13.8" MATRIX_DIM 13 /end CHARACTERISTIC
/begin CHARACTERISTIC DINH_FId.DFC_MOXEMM_SMU_ALM0_22_CA "" VAL_BLK 0x8024782E ValA_Wu16 1139.00000000 DINH_FIdVerb 0.00 1139.00000000 FORMAT "%13.8" MATRIX_DIM 13 /end CHARACTERISTIC
/begin CHARACTERISTIC DINH_FId.DFC_MOXEMM_SMU_ALM0_23_CA "" VAL_BLK 0x80247848 ValA_Wu16 1139.00000000 DINH_FIdVerb 0.00 1139.00000000 FORMAT "%13.8" MATRIX_DIM 13 /end CHARACTERISTIC
/begin CHARACTERISTIC DINH_FId.DFC_MOXEMM_SMU_ALM0_4_CA "" VAL_BLK 0x80247862 ValA_Wu16 1139.00000000 DINH_FIdVerb 0.00 1139.00000000 FORMAT "%13.8" MATRIX_DIM 13 /end CHARACTERISTIC
/begin CHARACTERISTIC DINH_FId.DFC_MOXEMM_SMU_ALM0_5_CA "" VAL_BLK 0x8024787C ValA_Wu16 1139.00000000 DINH_FIdVerb 0.00 1139.00000000 FORMAT "%13.8" MATRIX_DIM 13 /end CHARACTERISTIC
/begin CHARACTERISTIC DINH_FId.DFC_MOXEMM_SMU_ALM0_7_CA "" VAL_BLK 0x80247896 ValA_Wu16 1139.00000000 DINH_FIdVerb 0.00 1139.00000000 FORMAT "%13.8" MATRIX_DIM 13 /end CHARACTERISTIC
/begin CHARACTERISTIC DINH_FId.DFC_MOXEMM_SMU_ALM0_8_CA "" VAL_BLK 0x802478B0 ValA_Wu16 1139.00000000 DINH_FIdVerb 0.00 1139.00000000 FORMAT "%13.8" MATRIX_DIM 13 /end CHARACTERISTIC
/begin CHARACTERISTIC DINH_FId.DFC_MOXEMM_SMU_ALM10_16_CA "" VAL_BLK 0x802478CA ValA_Wu16 1139.00000000 DINH_FIdVerb 0.00 1139.00000000 FORMAT "%13.8" MATRIX_DIM 13 /end CHARACTERISTIC
/begin CHARACTERISTIC DINH_FId.DFC_MOXEMM_SMU_ALM10_17_CA "" VAL_BLK 0x802478E4 ValA_Wu16 1139.00000000 DINH_FIdVerb 0.00 1139.00000000 FORMAT "%13.8" MATRIX_DIM 13 /end CHARACTERISTIC
/begin CHARACTERISTIC DINH_FId.DFC_MOXEMM_SMU_ALM10_21_CA "" VAL_BLK 0x802478FE ValA_Wu16 1139.00000000 DINH_FIdVerb 0.00 1139.00000000 FORMAT "%13.8" MATRIX_DIM 13 /end CHARACTERISTIC
/begin CHARACTERISTIC DINH_FId.DFC_MOXEMM_SMU_ALM11_0_CA "" VAL_BLK 0x80247918 ValA_Wu16 1139.00000000 DINH_FIdVerb 0.00 1139.00000000 FORMAT "%13.8" MATRIX_DIM 13 /end CHARACTERISTIC
/begin CHARACTERISTIC DINH_FId.DFC_MOXEMM_SMU_ALM11_1_CA "" VAL_BLK 0x80247932 ValA_Wu16 1139.00000000 DINH_FIdVerb 0.00 1139.00000000 FORMAT "%13.8" MATRIX_DIM 13 /end CHARACTERISTIC
/begin CHARACTERISTIC DINH_FId.DFC_MOXEMM_SMU_ALM11_2_CA "" VAL_BLK 0x8024794C ValA_Wu16 1139.00000000 DINH_FIdVerb 0.00 1139.00000000 FORMAT "%13.8" MATRIX_DIM 13 /end CHARACTERISTIC
/begin CHARACTERISTIC DINH_FId.DFC_MOXEMM_SMU_ALM11_3_CA "" VAL_BLK 0x80247966 ValA_Wu16 1139.00000000 DINH_FIdVerb 0.00 1139.00000000 FORMAT "%13.8" MATRIX_DIM 13 /end CHARACTERISTIC
/begin CHARACTERISTIC DINH_FId.DFC_MOXEMM_SMU_ALM11_4_CA "" VAL_BLK 0x80247980 ValA_Wu16 1139.00000000 DINH_FIdVerb 0.00 1139.00000000 FORMAT "%13.8" MATRIX_DIM 13 /end CHARACTERISTIC
/begin CHARACTERISTIC DINH_FId.DFC_MOXEMM_SMU_ALM11_5_CA "" VAL_BLK 0x8024799A ValA_Wu16 1139.00000000 DINH_FIdVerb 0.00 1139.00000000 FORMAT "%13.8" MATRIX_DIM 13 /end CHARACTERISTIC
/begin CHARACTERISTIC DINH_FId.DFC_MOXEMM_SMU_ALM11_8_CA "" VAL_BLK 0x802479B4 ValA_Wu16 1139.00000000 DINH_FIdVerb 0.00 1139.00000000 FORMAT "%13.8" MATRIX_DIM 13 /end CHARACTERISTIC
/begin CHARACTERISTIC DINH_FId.DFC_MOXEMM_SMU_ALM11_9_CA "" VAL_BLK 0x802479CE ValA_Wu16 1139.00000000 DINH_FIdVerb 0.00 1139.00000000 FORMAT "%13.8" MATRIX_DIM 13 /end CHARACTERISTIC
/begin CHARACTERISTIC DINH_FId.DFC_MOXEMM_SMU_ALM1_0_CA "" VAL_BLK 0x802479E8 ValA_Wu16 1139.00000000 DINH_FIdVerb 0.00 1139.00000000 FORMAT "%13.8" MATRIX_DIM 13 /end CHARACTERISTIC
/begin CHARACTERISTIC DINH_FId.DFC_MOXEMM_SMU_ALM1_1_CA "" VAL_BLK 0x80247A02 ValA_Wu16 1139.00000000 DINH_FIdVerb 0.00 1139.00000000 FORMAT "%13.8" MATRIX_DIM 13 /end CHARACTERISTIC
/begin CHARACTERISTIC DINH_FId.DFC_MOXEMM_SMU_ALM1_10_CA "" VAL_BLK 0x80247A1C ValA_Wu16 1139.00000000 DINH_FIdVerb 0.00 1139.00000000 FORMAT "%13.8" MATRIX_DIM 13 /end CHARACTERISTIC
/begin CHARACTERISTIC DINH_FId.DFC_MOXEMM_SMU_ALM1_11_CA "" VAL_BLK 0x80247A36 ValA_Wu16 1139.00000000 DINH_FIdVerb 0.00 1139.00000000 FORMAT "%13.8" MATRIX_DIM 13 /end CHARACTERISTIC
/begin CHARACTERISTIC DINH_FId.DFC_MOXEMM_SMU_ALM1_13_CA "" VAL_BLK 0x80247A50 ValA_Wu16 1139.00000000 DINH_FIdVerb 0.00 1139.00000000 FORMAT "%13.8" MATRIX_DIM 13 /end CHARACTERISTIC
/begin CHARACTERISTIC DINH_FId.DFC_MOXEMM_SMU_ALM1_14_CA "" VAL_BLK 0x80247A6A ValA_Wu16 1139.00000000 DINH_FIdVerb 0.00 1139.00000000 FORMAT "%13.8" MATRIX_DIM 13 /end CHARACTERISTIC
/begin CHARACTERISTIC DINH_FId.DFC_MOXEMM_SMU_ALM1_2_CA "" VAL_BLK 0x80247A84 ValA_Wu16 1139.00000000 DINH_FIdVerb 0.00 1139.00000000 FORMAT "%13.8" MATRIX_DIM 13 /end CHARACTERISTIC
/begin CHARACTERISTIC DINH_FId.DFC_MOXEMM_SMU_ALM1_22_CA "" VAL_BLK 0x80247A9E ValA_Wu16 1139.00000000 DINH_FIdVerb 0.00 1139.00000000 FORMAT "%13.8" MATRIX_DIM 13 /end CHARACTERISTIC
/begin CHARACTERISTIC DINH_FId.DFC_MOXEMM_SMU_ALM1_23_CA "" VAL_BLK 0x80247AB8 ValA_Wu16 1139.00000000 DINH_FIdVerb 0.00 1139.00000000 FORMAT "%13.8" MATRIX_DIM 13 /end CHARACTERISTIC
/begin CHARACTERISTIC DINH_FId.DFC_MOXEMM_SMU_ALM1_4_CA "" VAL_BLK 0x80247AD2 ValA_Wu16 1139.00000000 DINH_FIdVerb 0.00 1139.00000000 FORMAT "%13.8" MATRIX_DIM 13 /end CHARACTERISTIC
/begin CHARACTERISTIC DINH_FId.DFC_MOXEMM_SMU_ALM1_5_CA "" VAL_BLK 0x80247AEC ValA_Wu16 1139.00000000 DINH_FIdVerb 0.00 1139.00000000 FORMAT "%13.8" MATRIX_DIM 13 /end CHARACTERISTIC
/begin CHARACTERISTIC DINH_FId.DFC_MOXEMM_SMU_ALM1_7_CA "" VAL_BLK 0x80247B06 ValA_Wu16 1139.00000000 DINH_FIdVerb 0.00 1139.00000000 FORMAT "%13.8" MATRIX_DIM 13 /end CHARACTERISTIC
/begin CHARACTERISTIC DINH_FId.DFC_MOXEMM_SMU_ALM1_8_CA "" VAL_BLK 0x80247B20 ValA_Wu16 1139.00000000 DINH_FIdVerb 0.00 1139.00000000 FORMAT "%13.8" MATRIX_DIM 13 /end CHARACTERISTIC
/begin CHARACTERISTIC DINH_FId.DFC_MOXEMM_SMU_ALM21_0_CA "" VAL_BLK 0x80247B3A ValA_Wu16 1139.00000000 DINH_FIdVerb 0.00 1139.00000000 FORMAT "%13.8" MATRIX_DIM 13 /end CHARACTERISTIC
/begin CHARACTERISTIC DINH_FId.DFC_MOXEMM_SMU_ALM21_16_CA "" VAL_BLK 0x80247B54 ValA_Wu16 1139.00000000 DINH_FIdVerb 0.00 1139.00000000 FORMAT "%13.8" MATRIX_DIM 13 /end CHARACTERISTIC
/begin CHARACTERISTIC DINH_FId.DFC_MOXEMM_SMU_ALM21_3_CA "" VAL_BLK 0x80247B6E ValA_Wu16 1139.00000000 DINH_FIdVerb 0.00 1139.00000000 FORMAT "%13.8" MATRIX_DIM 13 /end CHARACTERISTIC
/begin CHARACTERISTIC DINH_FId.DFC_MOXEMM_SMU_ALM2_1_CA "" VAL_BLK 0x80247B88 ValA_Wu16 1139.00000000 DINH_FIdVerb 0.00 1139.00000000 FORMAT "%13.8" MATRIX_DIM 13 /end CHARACTERISTIC
/begin CHARACTERISTIC DINH_FId.DFC_MOXEMM_SMU_ALM2_10_CA "" VAL_BLK 0x80247BA2 ValA_Wu16 1139.00000000 DINH_FIdVerb 0.00 1139.00000000 FORMAT "%13.8" MATRIX_DIM 13 /end CHARACTERISTIC
/begin CHARACTERISTIC DINH_FId.DFC_MOXEMM_SMU_ALM2_11_CA "" VAL_BLK 0x80247BBC ValA_Wu16 1139.00000000 DINH_FIdVerb 0.00 1139.00000000 FORMAT "%13.8" MATRIX_DIM 13 /end CHARACTERISTIC
/begin CHARACTERISTIC DINH_FId.DFC_MOXEMM_SMU_ALM2_13_CA "" VAL_BLK 0x80247BD6 ValA_Wu16 1139.00000000 DINH_FIdVerb 0.00 1139.00000000 FORMAT "%13.8" MATRIX_DIM 13 /end CHARACTERISTIC
/begin CHARACTERISTIC DINH_FId.DFC_MOXEMM_SMU_ALM2_14_CA "" VAL_BLK 0x80247BF0 ValA_Wu16 1139.00000000 DINH_FIdVerb 0.00 1139.00000000 FORMAT "%13.8" MATRIX_DIM 13 /end CHARACTERISTIC
/begin CHARACTERISTIC DINH_FId.DFC_MOXEMM_SMU_ALM2_22_CA "" VAL_BLK 0x80247C0A ValA_Wu16 1139.00000000 DINH_FIdVerb 0.00 1139.00000000 FORMAT "%13.8" MATRIX_DIM 13 /end CHARACTERISTIC
/begin CHARACTERISTIC DINH_FId.DFC_MOXEMM_SMU_ALM2_23_CA "" VAL_BLK 0x80247C24 ValA_Wu16 1139.00000000 DINH_FIdVerb 0.00 1139.00000000 FORMAT "%13.8" MATRIX_DIM 13 /end CHARACTERISTIC
/begin CHARACTERISTIC DINH_FId.DFC_MOXEMM_SMU_ALM2_4_CA "" VAL_BLK 0x80247C3E ValA_Wu16 1139.00000000 DINH_FIdVerb 0.00 1139.00000000 FORMAT "%13.8" MATRIX_DIM 13 /end CHARACTERISTIC
/begin CHARACTERISTIC DINH_FId.DFC_MOXEMM_SMU_ALM2_5_CA "" VAL_BLK 0x80247C58 ValA_Wu16 1139.00000000 DINH_FIdVerb 0.00 1139.00000000 FORMAT "%13.8" MATRIX_DIM 13 /end CHARACTERISTIC
/begin CHARACTERISTIC DINH_FId.DFC_MOXEMM_SMU_ALM2_7_CA "" VAL_BLK 0x80247C72 ValA_Wu16 1139.00000000 DINH_FIdVerb 0.00 1139.00000000 FORMAT "%13.8" MATRIX_DIM 13 /end CHARACTERISTIC
/begin CHARACTERISTIC DINH_FId.DFC_MOXEMM_SMU_ALM2_8_CA "" VAL_BLK 0x80247C8C ValA_Wu16 1139.00000000 DINH_FIdVerb 0.00 1139.00000000 FORMAT "%13.8" MATRIX_DIM 13 /end CHARACTERISTIC
/begin CHARACTERISTIC DINH_FId.DFC_MOXEMM_SMU_ALM6_0_CA "" VAL_BLK 0x80247CA6 ValA_Wu16 1139.00000000 DINH_FIdVerb 0.00 1139.00000000 FORMAT "%13.8" MATRIX_DIM 13 /end CHARACTERISTIC
/begin CHARACTERISTIC DINH_FId.DFC_MOXEMM_SMU_ALM6_11_CA "" VAL_BLK 0x80247CC0 ValA_Wu16 1139.00000000 DINH_FIdVerb 0.00 1139.00000000 FORMAT "%13.8" MATRIX_DIM 13 /end CHARACTERISTIC
/begin CHARACTERISTIC DINH_FId.DFC_MOXEMM_SMU_ALM6_12_CA "" VAL_BLK 0x80247CDA ValA_Wu16 1139.00000000 DINH_FIdVerb 0.00 1139.00000000 FORMAT "%13.8" MATRIX_DIM 13 /end CHARACTERISTIC
/begin CHARACTERISTIC DINH_FId.DFC_MOXEMM_SMU_ALM6_14_CA "" VAL_BLK 0x80247CF4 ValA_Wu16 1139.00000000 DINH_FIdVerb 0.00 1139.00000000 FORMAT "%13.8" MATRIX_DIM 13 /end CHARACTERISTIC
/begin CHARACTERISTIC DINH_FId.DFC_MOXEMM_SMU_ALM6_15_CA "" VAL_BLK 0x80247D0E ValA_Wu16 1139.00000000 DINH_FIdVerb 0.00 1139.00000000 FORMAT "%13.8" MATRIX_DIM 13 /end CHARACTERISTIC
/begin CHARACTERISTIC DINH_FId.DFC_MOXEMM_SMU_ALM6_17_CA "" VAL_BLK 0x80247D28 ValA_Wu16 1139.00000000 DINH_FIdVerb 0.00 1139.00000000 FORMAT "%13.8" MATRIX_DIM 13 /end CHARACTERISTIC
/begin CHARACTERISTIC DINH_FId.DFC_MOXEMM_SMU_ALM6_18_CA "" VAL_BLK 0x80247D42 ValA_Wu16 1139.00000000 DINH_FIdVerb 0.00 1139.00000000 FORMAT "%13.8" MATRIX_DIM 13 /end CHARACTERISTIC
/begin CHARACTERISTIC DINH_FId.DFC_MOXEMM_SMU_ALM6_20_CA "" VAL_BLK 0x80247D5C ValA_Wu16 1139.00000000 DINH_FIdVerb 0.00 1139.00000000 FORMAT "%13.8" MATRIX_DIM 13 /end CHARACTERISTIC
/begin CHARACTERISTIC DINH_FId.DFC_MOXEMM_SMU_ALM6_21_CA "" VAL_BLK 0x80247D76 ValA_Wu16 1139.00000000 DINH_FIdVerb 0.00 1139.00000000 FORMAT "%13.8" MATRIX_DIM 13 /end CHARACTERISTIC
/begin CHARACTERISTIC DINH_FId.DFC_MOXEMM_SMU_ALM6_25_CA "" VAL_BLK 0x80247D90 ValA_Wu16 1139.00000000 DINH_FIdVerb 0.00 1139.00000000 FORMAT "%13.8" MATRIX_DIM 13 /end CHARACTERISTIC
/begin CHARACTERISTIC DINH_FId.DFC_MOXEMM_SMU_ALM6_4_CA "" VAL_BLK 0x80247DAA ValA_Wu16 1139.00000000 DINH_FIdVerb 0.00 1139.00000000 FORMAT "%13.8" MATRIX_DIM 13 /end CHARACTERISTIC
/begin CHARACTERISTIC DINH_FId.DFC_MOXEMM_SMU_ALM6_5_CA "" VAL_BLK 0x80247DC4 ValA_Wu16 1139.00000000 DINH_FIdVerb 0.00 1139.00000000 FORMAT "%13.8" MATRIX_DIM 13 /end CHARACTERISTIC
/begin CHARACTERISTIC DINH_FId.DFC_MOXEMM_SMU_ALM6_7_CA "" VAL_BLK 0x80247DDE ValA_Wu16 1139.00000000 DINH_FIdVerb 0.00 1139.00000000 FORMAT "%13.8" MATRIX_DIM 13 /end CHARACTERISTIC
/begin CHARACTERISTIC DINH_FId.DFC_MOXEMM_SMU_ALM6_8_CA "" VAL_BLK 0x80247DF8 ValA_Wu16 1139.00000000 DINH_FIdVerb 0.00 1139.00000000 FORMAT "%13.8" MATRIX_DIM 13 /end CHARACTERISTIC
/begin CHARACTERISTIC DINH_FId.DFC_MOXEMM_SMU_ALM7_1_CA "" VAL_BLK 0x80247E12 ValA_Wu16 1139.00000000 DINH_FIdVerb 0.00 1139.00000000 FORMAT "%13.8" MATRIX_DIM 13 /end CHARACTERISTIC
/begin CHARACTERISTIC DINH_FId.DFC_MOXEMM_SMU_ALM7_12_CA "" VAL_BLK 0x80247E2C ValA_Wu16 1139.00000000 DINH_FIdVerb 0.00 1139.00000000 FORMAT "%13.8" MATRIX_DIM 13 /end CHARACTERISTIC
/begin CHARACTERISTIC DINH_FId.DFC_MOXEMM_SMU_ALM7_13_CA "" VAL_BLK 0x80247E46 ValA_Wu16 1139.00000000 DINH_FIdVerb 0.00 1139.00000000 FORMAT "%13.8" MATRIX_DIM 13 /end CHARACTERISTIC
/begin CHARACTERISTIC DINH_FId.DFC_MOXEMM_SMU_ALM7_14_CA "" VAL_BLK 0x80247E60 ValA_Wu16 1139.00000000 DINH_FIdVerb 0.00 1139.00000000 FORMAT "%13.8" MATRIX_DIM 13 /end CHARACTERISTIC
/begin CHARACTERISTIC DINH_FId.DFC_MOXEMM_SMU_ALM7_15_CA "" VAL_BLK 0x80247E7A ValA_Wu16 1139.00000000 DINH_FIdVerb 0.00 1139.00000000 FORMAT "%13.8" MATRIX_DIM 13 /end CHARACTERISTIC
/begin CHARACTERISTIC DINH_FId.DFC_MOXEMM_SMU_ALM7_16_CA "" VAL_BLK 0x80247E94 ValA_Wu16 1139.00000000 DINH_FIdVerb 0.00 1139.00000000 FORMAT "%13.8" MATRIX_DIM 13 /end CHARACTERISTIC
/begin CHARACTERISTIC DINH_FId.DFC_MOXEMM_SMU_ALM7_17_CA "" VAL_BLK 0x80247EAE ValA_Wu16 1139.00000000 DINH_FIdVerb 0.00 1139.00000000 FORMAT "%13.8" MATRIX_DIM 13 /end CHARACTERISTIC
/begin CHARACTERISTIC DINH_FId.DFC_MOXEMM_SMU_ALM7_2_CA "" VAL_BLK 0x80247EC8 ValA_Wu16 1139.00000000 DINH_FIdVerb 0.00 1139.00000000 FORMAT "%13.8" MATRIX_DIM 13 /end CHARACTERISTIC
/begin CHARACTERISTIC DINH_FId.DFC_MOXEMM_SMU_ALM7_20_CA "" VAL_BLK 0x80247EE2 ValA_Wu16 1139.00000000 DINH_FIdVerb 0.00 1139.00000000 FORMAT "%13.8" MATRIX_DIM 13 /end CHARACTERISTIC
/begin CHARACTERISTIC DINH_FId.DFC_MOXEMM_SMU_ALM7_25_CA "" VAL_BLK 0x80247EFC ValA_Wu16 1139.00000000 DINH_FIdVerb 0.00 1139.00000000 FORMAT "%13.8" MATRIX_DIM 13 /end CHARACTERISTIC
/begin CHARACTERISTIC DINH_FId.DFC_MOXEMM_SMU_ALM7_26_CA "" VAL_BLK 0x80247F16 ValA_Wu16 1139.00000000 DINH_FIdVerb 0.00 1139.00000000 FORMAT "%13.8" MATRIX_DIM 13 /end CHARACTERISTIC
/begin CHARACTERISTIC DINH_FId.DFC_MOXEMM_SMU_ALM7_28_CA "" VAL_BLK 0x80247F30 ValA_Wu16 1139.00000000 DINH_FIdVerb 0.00 1139.00000000 FORMAT "%13.8" MATRIX_DIM 13 /end CHARACTERISTIC
/begin CHARACTERISTIC DINH_FId.DFC_MOXEMM_SMU_ALM7_29_CA "" VAL_BLK 0x80247F4A ValA_Wu16 1139.00000000 DINH_FIdVerb 0.00 1139.00000000 FORMAT "%13.8" MATRIX_DIM 13 /end CHARACTERISTIC
/begin CHARACTERISTIC DINH_FId.DFC_MOXEMM_SMU_ALM7_30_CA "" VAL_BLK 0x80247F64 ValA_Wu16 1139.00000000 DINH_FIdVerb 0.00 1139.00000000 FORMAT "%13.8" MATRIX_DIM 13 /end CHARACTERISTIC
/begin CHARACTERISTIC DINH_FId.DFC_MOXEMM_SMU_ALM7_31_CA "" VAL_BLK 0x80247F7E ValA_Wu16 1139.00000000 DINH_FIdVerb 0.00 1139.00000000 FORMAT "%13.8" MATRIX_DIM 13 /end CHARACTERISTIC
/begin CHARACTERISTIC DINH_FId.DFC_MOXEMM_SMU_ALM8_0_CA "" VAL_BLK 0x80247F98 ValA_Wu16 1139.00000000 DINH_FIdVerb 0.00 1139.00000000 FORMAT "%13.8" MATRIX_DIM 13 /end CHARACTERISTIC
/begin CHARACTERISTIC DINH_FId.DFC_MOXEMM_SMU_ALM8_1_CA "" VAL_BLK 0x80247FB2 ValA_Wu16 1139.00000000 DINH_FIdVerb 0.00 1139.00000000 FORMAT "%13.8" MATRIX_DIM 13 /end CHARACTERISTIC
/begin CHARACTERISTIC DINH_FId.DFC_MOXEMM_SMU_ALM8_10_CA "" VAL_BLK 0x80247FCC ValA_Wu16 1139.00000000 DINH_FIdVerb 0.00 1139.00000000 FORMAT "%13.8" MATRIX_DIM 13 /end CHARACTERISTIC
/begin CHARACTERISTIC DINH_FId.DFC_MOXEMM_SMU_ALM8_11_CA "" VAL_BLK 0x80247FE6 ValA_Wu16 1139.00000000 DINH_FIdVerb 0.00 1139.00000000 FORMAT "%13.8" MATRIX_DIM 13 /end CHARACTERISTIC
/begin CHARACTERISTIC DINH_FId.DFC_MOXEMM_SMU_ALM8_12_CA "" VAL_BLK 0x80248000 ValA_Wu16 1139.00000000 DINH_FIdVerb 0.00 1139.00000000 FORMAT "%13.8" MATRIX_DIM 13 /end CHARACTERISTIC
/begin CHARACTERISTIC DINH_FId.DFC_MOXEMM_SMU_ALM8_16_CA "" VAL_BLK 0x8024801A ValA_Wu16 1139.00000000 DINH_FIdVerb 0.00 1139.00000000 FORMAT "%13.8" MATRIX_DIM 13 /end CHARACTERISTIC
/begin CHARACTERISTIC DINH_FId.DFC_MOXEMM_SMU_ALM8_18_CA "" VAL_BLK 0x80248034 ValA_Wu16 1139.00000000 DINH_FIdVerb 0.00 1139.00000000 FORMAT "%13.8" MATRIX_DIM 13 /end CHARACTERISTIC
/begin CHARACTERISTIC DINH_FId.DFC_MOXEMM_SMU_ALM8_2_CA "" VAL_BLK 0x8024804E ValA_Wu16 1139.00000000 DINH_FIdVerb 0.00 1139.00000000 FORMAT "%13.8" MATRIX_DIM 13 /end CHARACTERISTIC
/begin CHARACTERISTIC DINH_FId.DFC_MOXEMM_SMU_ALM8_3_CA "" VAL_BLK 0x80248068 ValA_Wu16 1139.00000000 DINH_FIdVerb 0.00 1139.00000000 FORMAT "%13.8" MATRIX_DIM 13 /end CHARACTERISTIC
/begin CHARACTERISTIC DINH_FId.DFC_MOXEMM_SMU_ALM8_31_CA "" VAL_BLK 0x80248082 ValA_Wu16 1139.00000000 DINH_FIdVerb 0.00 1139.00000000 FORMAT "%13.8" MATRIX_DIM 13 /end CHARACTERISTIC
/begin CHARACTERISTIC DINH_FId.DFC_MOXEMM_SMU_ALM8_4_CA "" VAL_BLK 0x8024809C ValA_Wu16 1139.00000000 DINH_FIdVerb 0.00 1139.00000000 FORMAT "%13.8" MATRIX_DIM 13 /end CHARACTERISTIC
/begin CHARACTERISTIC DINH_FId.DFC_MOXEMM_SMU_ALM9_0_CA "" VAL_BLK 0x802480B6 ValA_Wu16 1139.00000000 DINH_FIdVerb 0.00 1139.00000000 FORMAT "%13.8" MATRIX_DIM 13 /end CHARACTERISTIC
/begin CHARACTERISTIC DINH_FId.DFC_MOXEMM_SMU_ALM9_15_CA "" VAL_BLK 0x802480D0 ValA_Wu16 1139.00000000 DINH_FIdVerb 0.00 1139.00000000 FORMAT "%13.8" MATRIX_DIM 13 /end CHARACTERISTIC
/begin CHARACTERISTIC DINH_FId.DFC_MOXEMM_SMU_ALM9_3_CA "" VAL_BLK 0x802480EA ValA_Wu16 1139.00000000 DINH_FIdVerb 0.00 1139.00000000 FORMAT "%13.8" MATRIX_DIM 13 /end CHARACTERISTIC
/begin CHARACTERISTIC DINH_FId.DFC_MoCADCNTPBnk1_CA "" VAL_BLK 0x80248104 ValA_Wu16 1139.00000000 DINH_FIdVerb 0.00 1139.00000000 FORMAT "%13.8" MATRIX_DIM 13 /end CHARACTERISTIC
/begin CHARACTERISTIC DINH_FId.DFC_MoCADCTestVoltBnk1_CA "" VAL_BLK 0x8024811E ValA_Wu16 1139.00000000 DINH_FIdVerb 0.00 1139.00000000 FORMAT "%13.8" MATRIX_DIM 13 /end CHARACTERISTIC
/begin CHARACTERISTIC DINH_FId.DFC_MoCSOPICO_CA "" VAL_BLK 0x80248138 ValA_Wu16 1139.00000000 DINH_FIdVerb 0.00 1139.00000000 FORMAT "%13.8" MATRIX_DIM 13 /end CHARACTERISTIC
/begin CHARACTERISTIC DINH_FId.DFC_MoFAccr_CA "" VAL_BLK 0x80248152 ValA_Wu16 1139.00000000 DINH_FIdVerb 0.00 1139.00000000 FORMAT "%13.8" MATRIX_DIM 13 /end CHARACTERISTIC
/begin CHARACTERISTIC DINH_FId.DFC_MoFCbnPreCdngOvrheat_CA "" VAL_BLK 0x8024816C ValA_Wu16 1139.00000000 DINH_FIdVerb 0.00 1139.00000000 FORMAT "%13.8" MATRIX_DIM 13 /end CHARACTERISTIC
/begin CHARACTERISTIC DINH_FId.DFC_MoFCbnPreCdngTmrExpi_CA "" VAL_BLK 0x80248186 ValA_Wu16 1139.00000000 DINH_FIdVerb 0.00 1139.00000000 FORMAT "%13.8" MATRIX_DIM 13 /end CHARACTERISTIC
/begin CHARACTERISTIC DINH_FId.DFC_MoFEvMngtBms_CA "" VAL_BLK 0x802481A0 ValA_Wu16 1139.00000000 DINH_FIdVerb 0.00 1139.00000000 FORMAT "%13.8" MATRIX_DIM 13 /end CHARACTERISTIC
/begin CHARACTERISTIC DINH_FId.DFC_MoFEvMngtDcdc_CA "" VAL_BLK 0x802481BA ValA_Wu16 1139.00000000 DINH_FIdVerb 0.00 1139.00000000 FORMAT "%13.8" MATRIX_DIM 13 /end CHARACTERISTIC
/begin CHARACTERISTIC DINH_FId.DFC_MoFEvMngtEm01_CA "" VAL_BLK 0x802481D4 ValA_Wu16 1139.00000000 DINH_FIdVerb 0.00 1139.00000000 FORMAT "%13.8" MATRIX_DIM 13 /end CHARACTERISTIC
/begin CHARACTERISTIC DINH_FId.DFC_MoFEvMngtEm01BrkgToZr_CA "" VAL_BLK 0x802481EE ValA_Wu16 1139.00000000 DINH_FIdVerb 0.00 1139.00000000 FORMAT "%13.8" MATRIX_DIM 13 /end CHARACTERISTIC
/begin CHARACTERISTIC DINH_FId.DFC_MoFEvMngtEm01EngSpd_CA "" VAL_BLK 0x80248208 ValA_Wu16 1139.00000000 DINH_FIdVerb 0.00 1139.00000000 FORMAT "%13.8" MATRIX_DIM 13 /end CHARACTERISTIC
/begin CHARACTERISTIC DINH_FId.DFC_MoFEvMngtEm02EngSpd_CA "" VAL_BLK 0x80248222 ValA_Wu16 1139.00000000 DINH_FIdVerb 0.00 1139.00000000 FORMAT "%13.8" MATRIX_DIM 13 /end CHARACTERISTIC
/begin CHARACTERISTIC DINH_FId.DFC_MoFEvMngtEm02Lvl1_CA "" VAL_BLK 0x8024823C ValA_Wu16 1139.00000000 DINH_FIdVerb 0.00 1139.00000000 FORMAT "%13.8" MATRIX_DIM 13 /end CHARACTERISTIC
/begin CHARACTERISTIC DINH_FId.DFC_MoFEvMngtEm02Lvl2_CA "" VAL_BLK 0x80248256 ValA_Wu16 1139.00000000 DINH_FIdVerb 0.00 1139.00000000 FORMAT "%13.8" MATRIX_DIM 13 /end CHARACTERISTIC
/begin CHARACTERISTIC DINH_FId.DFC_MoFExtCptAuxCpt_CA "" VAL_BLK 0x80248270 ValA_Wu16 1139.00000000 DINH_FIdVerb 0.00 1139.00000000 FORMAT "%13.8" MATRIX_DIM 13 /end CHARACTERISTIC
/begin CHARACTERISTIC DINH_FId.DFC_MoFExtCptVacPmpErr_CA "" VAL_BLK 0x8024828A ValA_Wu16 1139.00000000 DINH_FIdVerb 0.00 1139.00000000 FORMAT "%13.8" MATRIX_DIM 13 /end CHARACTERISTIC
/begin CHARACTERISTIC DINH_FId.DFC_MoFTqPtdAxle_CA "" VAL_BLK 0x802482A4 ValA_Wu16 1139.00000000 DINH_FIdVerb 0.00 1139.00000000 FORMAT "%13.8" MATRIX_DIM 13 /end CHARACTERISTIC
/begin CHARACTERISTIC DINH_FId.DFC_MoFTqPtdAxleSec_CA "" VAL_BLK 0x802482BE ValA_Wu16 1139.00000000 DINH_FIdVerb 0.00 1139.00000000 FORMAT "%13.8" MATRIX_DIM 13 /end CHARACTERISTIC
/begin CHARACTERISTIC DINH_FId.DFC_MoFTqPtdEmPtRels_CA "" VAL_BLK 0x802482D8 ValA_Wu16 1139.00000000 DINH_FIdVerb 0.00 1139.00000000 FORMAT "%13.8" MATRIX_DIM 13 /end CHARACTERISTIC
/begin CHARACTERISTIC DINH_FId.DFC_MoFTqPtdEmPtRelsSec_CA "" VAL_BLK 0x802482F2 ValA_Wu16 1139.00000000 DINH_FIdVerb 0.00 1139.00000000 FORMAT "%13.8" MATRIX_DIM 13 /end CHARACTERISTIC
/begin CHARACTERISTIC DINH_FId.DFC_MoFTqPtdEmSign_CA "" VAL_BLK 0x8024830C ValA_Wu16 1139.00000000 DINH_FIdVerb 0.00 1139.00000000 FORMAT "%13.8" MATRIX_DIM 13 /end CHARACTERISTIC
/begin CHARACTERISTIC DINH_FId.DFC_MoFTqPtdEmSignSec_CA "" VAL_BLK 0x80248326 ValA_Wu16 1139.00000000 DINH_FIdVerb 0.00 1139.00000000 FORMAT "%13.8" MATRIX_DIM 13 /end CHARACTERISTIC
/begin CHARACTERISTIC DINH_FId.DFC_MoFTqPtdEmTq_CA "" VAL_BLK 0x80248340 ValA_Wu16 1139.00000000 DINH_FIdVerb 0.00 1139.00000000 FORMAT "%13.8" MATRIX_DIM 13 /end CHARACTERISTIC
/begin CHARACTERISTIC DINH_FId.DFC_MoFTqPtdEmTqSec_CA "" VAL_BLK 0x8024835A ValA_Wu16 1139.00000000 DINH_FIdVerb 0.00 1139.00000000 FORMAT "%13.8" MATRIX_DIM 13 /end CHARACTERISTIC
/begin CHARACTERISTIC DINH_FId.DFC_MoFTqPtdVeh_CA "" VAL_BLK 0x80248374 ValA_Wu16 1139.00000000 DINH_FIdVerb 0.00 1139.00000000 FORMAT "%13.8" MATRIX_DIM 13 /end CHARACTERISTIC
/begin CHARACTERISTIC DINH_FId.DFC_MoFVarPostBldSel_CA "" VAL_BLK 0x8024838E ValA_Wu16 1139.00000000 DINH_FIdVerb 0.00 1139.00000000 FORMAT "%13.8" MATRIX_DIM 13 /end CHARACTERISTIC
/begin CHARACTERISTIC DINH_FId.DFC_MoSysCtrlReIni_CA "" VAL_BLK 0x802483A8 ValA_Wu16 1139.00000000 DINH_FIdVerb 0.00 1139.00000000 FORMAT "%13.8" MATRIX_DIM 13 /end CHARACTERISTIC
/begin CHARACTERISTIC DINH_FId.DFC_MoXEMMHwLTMCUFW_CA "" VAL_BLK 0x802483C2 ValA_Wu16 1139.00000000 DINH_FIdVerb 0.00 1139.00000000 FORMAT "%13.8" MATRIX_DIM 13 /end CHARACTERISTIC
/begin CHARACTERISTIC DINH_FId.DFC_MoXEMMHwLTMonBIST_CA "" VAL_BLK 0x802483DC ValA_Wu16 1139.00000000 DINH_FIdVerb 0.00 1139.00000000 FORMAT "%13.8" MATRIX_DIM 13 /end CHARACTERISTIC
/begin CHARACTERISTIC DINH_FId.DFC_MoXEMMHwLTRegMonTest_CA "" VAL_BLK 0x802483F6 ValA_Wu16 1139.00000000 DINH_FIdVerb 0.00 1139.00000000 FORMAT "%13.8" MATRIX_DIM 13 /end CHARACTERISTIC
/begin CHARACTERISTIC DINH_FId.DFC_MoXEMMHwLTStbySMUAlvTest_CA "" VAL_BLK 0x80248410 ValA_Wu16 1139.00000000 DINH_FIdVerb 0.00 1139.00000000 FORMAT "%13.8" MATRIX_DIM 13 /end CHARACTERISTIC
/begin CHARACTERISTIC DINH_FId.DFC_MoXEMMHwLTTempSens_CA "" VAL_BLK 0x8024842A ValA_Wu16 1139.00000000 DINH_FIdVerb 0.00 1139.00000000 FORMAT "%13.8" MATRIX_DIM 13 /end CHARACTERISTIC
/begin CHARACTERISTIC DINH_FId.DFC_MoXEMMHwLTUCBCfg_CA "" VAL_BLK 0x80248444 ValA_Wu16 1139.00000000 DINH_FIdVerb 0.00 1139.00000000 FORMAT "%13.8" MATRIX_DIM 13 /end CHARACTERISTIC
/begin CHARACTERISTIC DINH_FId.DFC_MonEgyChrgnCoorr_AcChrgnWoMofRels_CA "" VAL_BLK 0x8024845E ValA_Wu16 1139.00000000 DINH_FIdVerb 0.00 1139.00000000 FORMAT "%13.8" MATRIX_DIM 13 /end CHARACTERISTIC
/begin CHARACTERISTIC DINH_FId.DFC_MonEgyChrgnCoorr_ChrgnAbortIgr_CA "" VAL_BLK 0x80248478 ValA_Wu16 1139.00000000 DINH_FIdVerb 0.00 1139.00000000 FORMAT "%13.8" MATRIX_DIM 13 /end CHARACTERISTIC
/begin CHARACTERISTIC DINH_FId.DFC_MonEgyChrgnCoorr_DcCntctFailr_CA "" VAL_BLK 0x80248492 ValA_Wu16 1139.00000000 DINH_FIdVerb 0.00 1139.00000000 FORMAT "%13.8" MATRIX_DIM 13 /end CHARACTERISTIC
/begin CHARACTERISTIC DINH_FId.DFC_MonEgyChrgnCoorr_ExtChrgnShtOffReq_CA "" VAL_BLK 0x802484AC ValA_Wu16 1139.00000000 DINH_FIdVerb 0.00 1139.00000000 FORMAT "%13.8" MATRIX_DIM 13 /end CHARACTERISTIC
/begin CHARACTERISTIC DINH_FId.DFC_MonEgyChrgnCoorr_ImpsChrgnMod_CA "" VAL_BLK 0x802484C6 ValA_Wu16 1139.00000000 DINH_FIdVerb 0.00 1139.00000000 FORMAT "%13.8" MATRIX_DIM 13 /end CHARACTERISTIC
/begin CHARACTERISTIC DINH_FId.DFC_MonEgyChrgnCoorr_ImpsChrgnPrms_CA "" VAL_BLK 0x802484E0 ValA_Wu16 1139.00000000 DINH_FIdVerb 0.00 1139.00000000 FORMAT "%13.8" MATRIX_DIM 13 /end CHARACTERISTIC
/begin CHARACTERISTIC DINH_FId.DFC_MonEgyChrgnCoorr_ImpsUDcIntk_CA "" VAL_BLK 0x802484FA ValA_Wu16 1139.00000000 DINH_FIdVerb 0.00 1139.00000000 FORMAT "%13.8" MATRIX_DIM 13 /end CHARACTERISTIC
/begin CHARACTERISTIC DINH_FId.DFC_MonEgyChrgnCoorr_PlgLockMovmt_CA "" VAL_BLK 0x80248514 ValA_Wu16 1139.00000000 DINH_FIdVerb 0.00 1139.00000000 FORMAT "%13.8" MATRIX_DIM 13 /end CHARACTERISTIC
/begin CHARACTERISTIC DINH_FId.DFC_MonEgyChrgnCoorr_VehCrashDetn_CA "" VAL_BLK 0x8024852E ValA_Wu16 1139.00000000 DINH_FIdVerb 0.00 1139.00000000 FORMAT "%13.8" MATRIX_DIM 13 /end CHARACTERISTIC
/begin CHARACTERISTIC DINH_FId.DFC_MonEgyChrgnErrReactn_SftySwt_CA "" VAL_BLK 0x80248548 ValA_Wu16 1139.00000000 DINH_FIdVerb 0.00 1139.00000000 FORMAT "%13.8" MATRIX_DIM 13 /end CHARACTERISTIC
/begin CHARACTERISTIC DINH_FId.DFC_MonEgyChrgnInlet_CcsPlgCtp_CA "" VAL_BLK 0x80248562 ValA_Wu16 1139.00000000 DINH_FIdVerb 0.00 1139.00000000 FORMAT "%13.8" MATRIX_DIM 13 /end CHARACTERISTIC
/begin CHARACTERISTIC DINH_FId.DFC_MonEgyChrgnInlet_CcsPlgCtpPwm_CA "" VAL_BLK 0x8024857C ValA_Wu16 1139.00000000 DINH_FIdVerb 0.00 1139.00000000 FORMAT "%13.8" MATRIX_DIM 13 /end CHARACTERISTIC
/begin CHARACTERISTIC DINH_FId.DFC_MonEgyChrgnInlet_CcsPlgLockCtrlImpsAtmpt_CA "" VAL_BLK 0x80248596 ValA_Wu16 1139.00000000 DINH_FIdVerb 0.00 1139.00000000 FORMAT "%13.8" MATRIX_DIM 13 /end CHARACTERISTIC
/begin CHARACTERISTIC DINH_FId.DFC_MonEgyChrgnInlet_CcsPlgLockSnsrSigRngChk_CA "" VAL_BLK 0x802485B0 ValA_Wu16 1139.00000000 DINH_FIdVerb 0.00 1139.00000000 FORMAT "%13.8" MATRIX_DIM 13 /end CHARACTERISTIC
/begin CHARACTERISTIC DINH_FId.DFC_MonEgyChrgnInlet_CcsPlgLockStImps_CA "" VAL_BLK 0x802485CA ValA_Wu16 1139.00000000 DINH_FIdVerb 0.00 1139.00000000 FORMAT "%13.8" MATRIX_DIM 13 /end CHARACTERISTIC
/begin CHARACTERISTIC DINH_FId.DFC_MonEgyChrgnInlet_CcsPlgPxp_CA "" VAL_BLK 0x802485E4 ValA_Wu16 1139.00000000 DINH_FIdVerb 0.00 1139.00000000 FORMAT "%13.8" MATRIX_DIM 13 /end CHARACTERISTIC
/begin CHARACTERISTIC DINH_FId.DFC_MonEgyChrgnT_Snsr1GrdtChk_CA "" VAL_BLK 0x802485FE ValA_Wu16 1139.00000000 DINH_FIdVerb 0.00 1139.00000000 FORMAT "%13.8" MATRIX_DIM 13 /end CHARACTERISTIC
/begin CHARACTERISTIC DINH_FId.DFC_MonEgyChrgnT_Snsr1SigRngChk_CA "" VAL_BLK 0x80248618 ValA_Wu16 1139.00000000 DINH_FIdVerb 0.00 1139.00000000 FORMAT "%13.8" MATRIX_DIM 13 /end CHARACTERISTIC
/begin CHARACTERISTIC DINH_FId.DFC_MonEgyChrgnT_Snsr2GrdtChk_CA "" VAL_BLK 0x80248632 ValA_Wu16 1139.00000000 DINH_FIdVerb 0.00 1139.00000000 FORMAT "%13.8" MATRIX_DIM 13 /end CHARACTERISTIC
/begin CHARACTERISTIC DINH_FId.DFC_MonEgyChrgnT_Snsr2SigRngChk_CA "" VAL_BLK 0x8024864C ValA_Wu16 1139.00000000 DINH_FIdVerb 0.00 1139.00000000 FORMAT "%13.8" MATRIX_DIM 13 /end CHARACTERISTIC
/begin CHARACTERISTIC DINH_FId.DFC_MonEgyChrgnT_SnsrDif_CA "" VAL_BLK 0x80248666 ValA_Wu16 1139.00000000 DINH_FIdVerb 0.00 1139.00000000 FORMAT "%13.8" MATRIX_DIM 13 /end CHARACTERISTIC
/begin CHARACTERISTIC DINH_FId.DFC_OCWDAABEActv_CA "" VAL_BLK 0x80248680 ValA_Wu16 1139.00000000 DINH_FIdVerb 0.00 1139.00000000 FORMAT "%13.8" MATRIX_DIM 13 /end CHARACTERISTIC
/begin CHARACTERISTIC DINH_FId.DFC_OCWDACom_CA "" VAL_BLK 0x8024869A ValA_Wu16 1139.00000000 DINH_FIdVerb 0.00 1139.00000000 FORMAT "%13.8" MATRIX_DIM 13 /end CHARACTERISTIC
/begin CHARACTERISTIC DINH_FId.DFC_OCWDAErrPin_CA "" VAL_BLK 0x802486B4 ValA_Wu16 1139.00000000 DINH_FIdVerb 0.00 1139.00000000 FORMAT "%13.8" MATRIX_DIM 13 /end CHARACTERISTIC
/begin CHARACTERISTIC DINH_FId.DFC_OCWDAOvrVltg_CA "" VAL_BLK 0x802486CE ValA_Wu16 1139.00000000 DINH_FIdVerb 0.00 1139.00000000 FORMAT "%13.8" MATRIX_DIM 13 /end CHARACTERISTIC
/begin CHARACTERISTIC DINH_FId.DFC_PUmax_CA "" VAL_BLK 0x802486E8 ValA_Wu16 1139.00000000 DINH_FIdVerb 0.00 1139.00000000 FORMAT "%13.8" MATRIX_DIM 13 /end CHARACTERISTIC
/begin CHARACTERISTIC DINH_FId.DFC_PwmCtPTmpErr_CA "" VAL_BLK 0x80248702 ValA_Wu16 1139.00000000 DINH_FIdVerb 0.00 1139.00000000 FORMAT "%13.8" MATRIX_DIM 13 /end CHARACTERISTIC
/begin CHARACTERISTIC DINH_FId.DFC_PwrDistbnUnitTSRCMax_CA "" VAL_BLK 0x8024871C ValA_Wu16 1139.00000000 DINH_FIdVerb 0.00 1139.00000000 FORMAT "%13.8" MATRIX_DIM 21 /end CHARACTERISTIC
/begin CHARACTERISTIC DINH_FId.DFC_PwrDistbnUnitTTmpErr_CA "" VAL_BLK 0x80248746 ValA_Wu16 1139.00000000 DINH_FIdVerb 0.00 1139.00000000 FORMAT "%13.8" MATRIX_DIM 17 /end CHARACTERISTIC
/begin CHARACTERISTIC DINH_FId.DFC_SCtPmp1DiagGrdKeyErr_CA "" VAL_BLK 0x80248768 ValA_Wu16 1139.00000000 DINH_FIdVerb 0.00 1139.00000000 FORMAT "%13.8" MATRIX_DIM 14 /end CHARACTERISTIC
/begin CHARACTERISTIC DINH_FId.DFC_SRCHighAPP1_CA "" VAL_BLK 0x80248784 ValA_Wu16 1139.00000000 DINH_FIdVerb 0.00 1139.00000000 FORMAT "%13.8" MATRIX_DIM 15 /end CHARACTERISTIC
/begin CHARACTERISTIC DINH_FId.DFC_SRCHighAPP2_CA "" VAL_BLK 0x802487A2 ValA_Wu16 1139.00000000 DINH_FIdVerb 0.00 1139.00000000 FORMAT "%13.8" MATRIX_DIM 15 /end CHARACTERISTIC
/begin CHARACTERISTIC DINH_FId.DFC_SRCLowAPP1_CA "" VAL_BLK 0x802487C0 ValA_Wu16 1139.00000000 DINH_FIdVerb 0.00 1139.00000000 FORMAT "%13.8" MATRIX_DIM 15 /end CHARACTERISTIC
/begin CHARACTERISTIC DINH_FId.DFC_SRCLowAPP2_CA "" VAL_BLK 0x802487DE ValA_Wu16 1139.00000000 DINH_FIdVerb 0.00 1139.00000000 FORMAT "%13.8" MATRIX_DIM 15 /end CHARACTERISTIC
/begin CHARACTERISTIC DINH_FId.DFC_SWReset_0_CA "" VAL_BLK 0x802487FC ValA_Wu16 1139.00000000 DINH_FIdVerb 0.00 1139.00000000 FORMAT "%13.8" MATRIX_DIM 13 /end CHARACTERISTIC
/begin CHARACTERISTIC DINH_FId.DFC_SWReset_1_CA "" VAL_BLK 0x80248816 ValA_Wu16 1139.00000000 DINH_FIdVerb 0.00 1139.00000000 FORMAT "%13.8" MATRIX_DIM 13 /end CHARACTERISTIC
/begin CHARACTERISTIC DINH_FId.DFC_SWReset_2_CA "" VAL_BLK 0x80248830 ValA_Wu16 1139.00000000 DINH_FIdVerb 0.00 1139.00000000 FORMAT "%13.8" MATRIX_DIM 13 /end CHARACTERISTIC
/begin CHARACTERISTIC DINH_FId.DFC_Sia_InvldCode_CA "" VAL_BLK 0x8024884A ValA_Wu16 1139.00000000 DINH_FIdVerb 0.00 1139.00000000 FORMAT "%13.8" MATRIX_DIM 13 /end CHARACTERISTIC
/begin CHARACTERISTIC DINH_FId.DFC_Sia_InvldKey_CA "" VAL_BLK 0x80248864 ValA_Wu16 1139.00000000 DINH_FIdVerb 0.00 1139.00000000 FORMAT "%13.8" MATRIX_DIM 13 /end CHARACTERISTIC
/begin CHARACTERISTIC DINH_FId.DFC_Sia_NoRespUCx_CA "" VAL_BLK 0x8024887E ValA_Wu16 1139.00000000 DINH_FIdVerb 0.00 1139.00000000 FORMAT "%13.8" MATRIX_DIM 13 /end CHARACTERISTIC
/begin CHARACTERISTIC DINH_FId.DFC_Sia_TprotRttp_CA "" VAL_BLK 0x80248898 ValA_Wu16 1139.00000000 DINH_FIdVerb 0.00 1139.00000000 FORMAT "%13.8" MATRIX_DIM 13 /end CHARACTERISTIC
/begin CHARACTERISTIC DINH_FId.DFC_StrtUpEvStandStillDeactvn_CA "" VAL_BLK 0x802488B2 ValA_Wu16 1139.00000000 DINH_FIdVerb 0.00 1139.00000000 FORMAT "%13.8" MATRIX_DIM 13 /end CHARACTERISTIC
/begin CHARACTERISTIC DINH_FId.DFC_SyncAPP_CA "" VAL_BLK 0x802488CC ValA_Wu16 1139.00000000 DINH_FIdVerb 0.00 1139.00000000 FORMAT "%13.8" MATRIX_DIM 15 /end CHARACTERISTIC
/begin CHARACTERISTIC DINH_FId.DFC_UCtPSRCMax_CA "" VAL_BLK 0x802488EA ValA_Wu16 1139.00000000 DINH_FIdVerb 0.00 1139.00000000 FORMAT "%13.8" MATRIX_DIM 17 /end CHARACTERISTIC
/begin CHARACTERISTIC DINH_FId.DFC_UCtPTmpErr_CA "" VAL_BLK 0x8024890C ValA_Wu16 1139.00000000 DINH_FIdVerb 0.00 1139.00000000 FORMAT "%13.8" MATRIX_DIM 13 /end CHARACTERISTIC
/begin CHARACTERISTIC DINH_FId.DFC_UPxP1SRCMax_CA "" VAL_BLK 0x80248926 ValA_Wu16 1139.00000000 DINH_FIdVerb 0.00 1139.00000000 FORMAT "%13.8" MATRIX_DIM 17 /end CHARACTERISTIC
/begin CHARACTERISTIC DINH_FId.DFC_UPxP1TmpErr_CA "" VAL_BLK 0x80248948 ValA_Wu16 1139.00000000 DINH_FIdVerb 0.00 1139.00000000 FORMAT "%13.8" MATRIX_DIM 13 /end CHARACTERISTIC
/begin CHARACTERISTIC DINH_FId.DFC_VehVObd_CA "" VAL_BLK 0x80248962 ValA_Wu16 1139.00000000 DINH_FIdVerb 0.00 1139.00000000 FORMAT "%13.8" MATRIX_DIM 13 /end CHARACTERISTIC
/begin CHARACTERISTIC DINH_FId.DSQ_ACCmprPwrConsol_CA "" VAL_BLK 0x8024897C ValA_Wu16 1139.00000000 DINH_FIdVerb 0.00 1139.00000000 FORMAT "%13.8" MATRIX_DIM 14 /end CHARACTERISTIC
/begin CHARACTERISTIC DINH_FId.DSQ_ACCmprUConsol_CA "" VAL_BLK 0x80248998 ValA_Wu16 1139.00000000 DINH_FIdVerb 0.00 1139.00000000 FORMAT "%13.8" MATRIX_DIM 14 /end CHARACTERISTIC
/begin CHARACTERISTIC DINH_FId.DSQ_BattU_CA "" VAL_BLK 0x802489B4 ValA_Wu16 1139.00000000 DINH_FIdVerb 0.00 1139.00000000 FORMAT "%13.8" MATRIX_DIM 15 /end CHARACTERISTIC
/begin CHARACTERISTIC DINH_FId.DSQ_DSMInhibitAlways_CA "" VAL_BLK 0x802489D2 ValA_Wu16 1139.00000000 DINH_FIdVerb 0.00 1139.00000000 FORMAT "%13.8" MATRIX_DIM 14 /end CHARACTERISTIC
/begin CHARACTERISTIC DINH_FId.DSQ_T15TurnOfDly_CA "" VAL_BLK 0x802489EE ValA_Wu16 1139.00000000 DINH_FIdVerb 0.00 1139.00000000 FORMAT "%13.8" MATRIX_DIM 13 /end CHARACTERISTIC
/begin CHARACTERISTIC DINH_Lim.DFC_ACCmprFltLvlRes_CA "" VAL_BLK 0x802499D2 ValA_Wu8 17.0000000000 DINH_LimDFCVerb 0.00 17.0000000000 FORMAT "%13.10" MATRIX_DIM 13 /end CHARACTERISTIC
/begin CHARACTERISTIC DINH_Lim.DFC_AbgHiSigFlt_CA "" VAL_BLK 0x802499DF ValA_Wu8 17.0000000000 DINH_LimDFCVerb 0.00 17.0000000000 FORMAT "%13.10" MATRIX_DIM 17 /end CHARACTERISTIC
/begin CHARACTERISTIC DINH_Lim.DFC_AbgIntPatFlt_CA "" VAL_BLK 0x802499F0 ValA_Wu8 17.0000000000 DINH_LimDFCVerb 0.00 17.0000000000 FORMAT "%13.10" MATRIX_DIM 16 /end CHARACTERISTIC
/begin CHARACTERISTIC DINH_Lim.DFC_AbgLoSigFlt_CA "" VAL_BLK 0x80249A00 ValA_Wu8 17.0000000000 DINH_LimDFCVerb 0.00 17.0000000000 FORMAT "%13.10" MATRIX_DIM 17 /end CHARACTERISTIC
/begin CHARACTERISTIC DINH_Lim.DFC_AbgUnkwnErrSigFlt_CA "" VAL_BLK 0x80249A11 ValA_Wu8 17.0000000000 DINH_LimDFCVerb 0.00 17.0000000000 FORMAT "%13.10" MATRIX_DIM 16 /end CHARACTERISTIC
/begin CHARACTERISTIC DINH_Lim.DFC_AcExtChrgrIBattExcdd_CA "" VAL_BLK 0x80249A21 ValA_Wu8 17.0000000000 DINH_LimDFCVerb 0.00 17.0000000000 FORMAT "%13.10" MATRIX_DIM 13 /end CHARACTERISTIC
/begin CHARACTERISTIC DINH_Lim.DFC_AcExtChrgrIInExcdd_CA "" VAL_BLK 0x80249A2E ValA_Wu8 17.0000000000 DINH_LimDFCVerb 0.00 17.0000000000 FORMAT "%13.10" MATRIX_DIM 13 /end CHARACTERISTIC
/begin CHARACTERISTIC DINH_Lim.DFC_AcExtChrgrIOutDe_CA "" VAL_BLK 0x80249A3B ValA_Wu8 17.0000000000 DINH_LimDFCVerb 0.00 17.0000000000 FORMAT "%13.10" MATRIX_DIM 13 /end CHARACTERISTIC
/begin CHARACTERISTIC DINH_Lim.DFC_AcExtChrgrIOutExcdd_CA "" VAL_BLK 0x80249A48 ValA_Wu8 17.0000000000 DINH_LimDFCVerb 0.00 17.0000000000 FORMAT "%13.10" MATRIX_DIM 13 /end CHARACTERISTIC
/begin CHARACTERISTIC DINH_Lim.DFC_AcExtChrgrUOutDe_CA "" VAL_BLK 0x80249A55 ValA_Wu8 17.0000000000 DINH_LimDFCVerb 0.00 17.0000000000 FORMAT "%13.10" MATRIX_DIM 13 /end CHARACTERISTIC
/begin CHARACTERISTIC DINH_Lim.DFC_AdpActvDChaFailr_CA "" VAL_BLK 0x80249A62 ValA_Wu8 17.0000000000 DINH_LimDFCVerb 0.00 17.0000000000 FORMAT "%13.10" MATRIX_DIM 13 /end CHARACTERISTIC
/begin CHARACTERISTIC DINH_Lim.DFC_AirbcuFlt_CA "" VAL_BLK 0x80249A6F ValA_Wu8 17.0000000000 DINH_LimDFCVerb 0.00 17.0000000000 FORMAT "%13.10" MATRIX_DIM 13 /end CHARACTERISTIC
/begin CHARACTERISTIC DINH_Lim.DFC_Airbg_CA "" VAL_BLK 0x80249A7C ValA_Wu8 17.0000000000 DINH_LimDFCVerb 0.00 17.0000000000 FORMAT "%13.10" MATRIX_DIM 13 /end CHARACTERISTIC
/begin CHARACTERISTIC DINH_Lim.DFC_AirbgCan_CA "" VAL_BLK 0x80249A89 ValA_Wu8 17.0000000000 DINH_LimDFCVerb 0.00 17.0000000000 FORMAT "%13.10" MATRIX_DIM 13 /end CHARACTERISTIC
/begin CHARACTERISTIC DINH_Lim.DFC_AirbgCanHWPlaus_CA "" VAL_BLK 0x80249A96 ValA_Wu8 17.0000000000 DINH_LimDFCVerb 0.00 17.0000000000 FORMAT "%13.10" MATRIX_DIM 13 /end CHARACTERISTIC
/begin CHARACTERISTIC DINH_Lim.DFC_AirbgHWCanPlaus_CA "" VAL_BLK 0x80249AA3 ValA_Wu8 17.0000000000 DINH_LimDFCVerb 0.00 17.0000000000 FORMAT "%13.10" MATRIX_DIM 13 /end CHARACTERISTIC
/begin CHARACTERISTIC DINH_Lim.DFC_AirbgMnr_CA "" VAL_BLK 0x80249AB0 ValA_Wu8 17.0000000000 DINH_LimDFCVerb 0.00 17.0000000000 FORMAT "%13.10" MATRIX_DIM 13 /end CHARACTERISTIC
/begin CHARACTERISTIC DINH_Lim.DFC_AirbgPerHi_CA "" VAL_BLK 0x80249ABD ValA_Wu8 17.0000000000 DINH_LimDFCVerb 0.00 17.0000000000 FORMAT "%13.10" MATRIX_DIM 16 /end CHARACTERISTIC
/begin CHARACTERISTIC DINH_Lim.DFC_AirbgPerdRngFlt_CA "" VAL_BLK 0x80249ACD ValA_Wu8 17.0000000000 DINH_LimDFCVerb 0.00 17.0000000000 FORMAT "%13.10" MATRIX_DIM 16 /end CHARACTERISTIC
/begin CHARACTERISTIC DINH_Lim.DFC_BlowrRlyErr_CA "" VAL_BLK 0x80249ADD ValA_Wu8 17.0000000000 DINH_LimDFCVerb 0.00 17.0000000000 FORMAT "%13.10" MATRIX_DIM 13 /end CHARACTERISTIC
/begin CHARACTERISTIC DINH_Lim.DFC_BrkBstPmpActtnDfct_CA "" VAL_BLK 0x80249AEA ValA_Wu8 17.0000000000 DINH_LimDFCVerb 0.00 17.0000000000 FORMAT "%13.10" MATRIX_DIM 14 /end CHARACTERISTIC
/begin CHARACTERISTIC DINH_Lim.DFC_BrkBstPmpDeactvnDfct_CA "" VAL_BLK 0x80249AF8 ValA_Wu8 17.0000000000 DINH_LimDFCVerb 0.00 17.0000000000 FORMAT "%13.10" MATRIX_DIM 14 /end CHARACTERISTIC
/begin CHARACTERISTIC DINH_Lim.DFC_BrkSwtFlt_CA "" VAL_BLK 0x80249B06 ValA_Wu8 17.0000000000 DINH_LimDFCVerb 0.00 17.0000000000 FORMAT "%13.10" MATRIX_DIM 13 /end CHARACTERISTIC
/begin CHARACTERISTIC DINH_Lim.DFC_CbnHeatgHeatrHsScb_CA "" VAL_BLK 0x80249B13 ValA_Wu8 17.0000000000 DINH_LimDFCVerb 0.00 17.0000000000 FORMAT "%13.10" MATRIX_DIM 14 /end CHARACTERISTIC
/begin CHARACTERISTIC DINH_Lim.DFC_CbnHeatgHeatrHsScg_CA "" VAL_BLK 0x80249B21 ValA_Wu8 17.0000000000 DINH_LimDFCVerb 0.00 17.0000000000 FORMAT "%13.10" MATRIX_DIM 14 /end CHARACTERISTIC
/begin CHARACTERISTIC DINH_Lim.DFC_CbnHeatgHeatrLsOl_CA "" VAL_BLK 0x80249B2F ValA_Wu8 17.0000000000 DINH_LimDFCVerb 0.00 17.0000000000 FORMAT "%13.10" MATRIX_DIM 14 /end CHARACTERISTIC
/begin CHARACTERISTIC DINH_Lim.DFC_CbnHeatgHeatrLsScb_CA "" VAL_BLK 0x80249B3D ValA_Wu8 17.0000000000 DINH_LimDFCVerb 0.00 17.0000000000 FORMAT "%13.10" MATRIX_DIM 14 /end CHARACTERISTIC
/begin CHARACTERISTIC DINH_Lim.DFC_CbnHeatgHeatrLsScg_CA "" VAL_BLK 0x80249B4B ValA_Wu8 17.0000000000 DINH_LimDFCVerb 0.00 17.0000000000 FORMAT "%13.10" MATRIX_DIM 14 /end CHARACTERISTIC
/begin CHARACTERISTIC DINH_Lim.DFC_CbnHeatgHeatrUnUsed_CA "" VAL_BLK 0x80249B59 ValA_Wu8 17.0000000000 DINH_LimDFCVerb 0.00 17.0000000000 FORMAT "%13.10" MATRIX_DIM 13 /end CHARACTERISTIC
/begin CHARACTERISTIC DINH_Lim.DFC_ChrgnCntctHsOt_CA "" VAL_BLK 0x80249B66 ValA_Wu8 17.0000000000 DINH_LimDFCVerb 0.00 17.0000000000 FORMAT "%13.10" MATRIX_DIM 13 /end CHARACTERISTIC
/begin CHARACTERISTIC DINH_Lim.DFC_ChrgnCntctHsScb_CA "" VAL_BLK 0x80249B73 ValA_Wu8 17.0000000000 DINH_LimDFCVerb 0.00 17.0000000000 FORMAT "%13.10" MATRIX_DIM 13 /end CHARACTERISTIC
/begin CHARACTERISTIC DINH_Lim.DFC_ChrgnCntctHsScg_CA "" VAL_BLK 0x80249B80 ValA_Wu8 17.0000000000 DINH_LimDFCVerb 0.00 17.0000000000 FORMAT "%13.10" MATRIX_DIM 13 /end CHARACTERISTIC
/begin CHARACTERISTIC DINH_Lim.DFC_ChrgnCntctLsNegOl_CA "" VAL_BLK 0x80249B8D ValA_Wu8 17.0000000000 DINH_LimDFCVerb 0.00 17.0000000000 FORMAT "%13.10" MATRIX_DIM 13 /end CHARACTERISTIC
/begin CHARACTERISTIC DINH_Lim.DFC_ChrgnCntctLsNegOt_CA "" VAL_BLK 0x80249B9A ValA_Wu8 17.0000000000 DINH_LimDFCVerb 0.00 17.0000000000 FORMAT "%13.10" MATRIX_DIM 13 /end CHARACTERISTIC
/begin CHARACTERISTIC DINH_Lim.DFC_ChrgnCntctLsNegScb_CA "" VAL_BLK 0x80249BA7 ValA_Wu8 17.0000000000 DINH_LimDFCVerb 0.00 17.0000000000 FORMAT "%13.10" MATRIX_DIM 13 /end CHARACTERISTIC
/begin CHARACTERISTIC DINH_Lim.DFC_ChrgnCntctLsNegScg_CA "" VAL_BLK 0x80249BB4 ValA_Wu8 17.0000000000 DINH_LimDFCVerb 0.00 17.0000000000 FORMAT "%13.10" MATRIX_DIM 13 /end CHARACTERISTIC
/begin CHARACTERISTIC DINH_Lim.DFC_ChrgnCntctLsPosOl_CA "" VAL_BLK 0x80249BC1 ValA_Wu8 17.0000000000 DINH_LimDFCVerb 0.00 17.0000000000 FORMAT "%13.10" MATRIX_DIM 13 /end CHARACTERISTIC
/begin CHARACTERISTIC DINH_Lim.DFC_ChrgnCntctLsPosOt_CA "" VAL_BLK 0x80249BCE ValA_Wu8 17.0000000000 DINH_LimDFCVerb 0.00 17.0000000000 FORMAT "%13.10" MATRIX_DIM 13 /end CHARACTERISTIC
/begin CHARACTERISTIC DINH_Lim.DFC_ChrgnCntctLsPosScb_CA "" VAL_BLK 0x80249BDB ValA_Wu8 17.0000000000 DINH_LimDFCVerb 0.00 17.0000000000 FORMAT "%13.10" MATRIX_DIM 13 /end CHARACTERISTIC
/begin CHARACTERISTIC DINH_Lim.DFC_ChrgnCntctLsPosScg_CA "" VAL_BLK 0x80249BE8 ValA_Wu8 17.0000000000 DINH_LimDFCVerb 0.00 17.0000000000 FORMAT "%13.10" MATRIX_DIM 13 /end CHARACTERISTIC
/begin CHARACTERISTIC DINH_Lim.DFC_ChrgnCntctUnUsed_CA "" VAL_BLK 0x80249BF5 ValA_Wu8 17.0000000000 DINH_LimDFCVerb 0.00 17.0000000000 FORMAT "%13.10" MATRIX_DIM 13 /end CHARACTERISTIC
/begin CHARACTERISTIC DINH_Lim.DFC_ComBrkMai_CA "" VAL_BLK 0x80249C02 ValA_Wu8 17.0000000000 DINH_LimDFCVerb 0.00 17.0000000000 FORMAT "%13.10" MATRIX_DIM 13 /end CHARACTERISTIC
/begin CHARACTERISTIC DINH_Lim.DFC_ComChrgrEVCont_CA "" VAL_BLK 0x80249C0F ValA_Wu8 17.0000000000 DINH_LimDFCVerb 0.00 17.0000000000 FORMAT "%13.10" MATRIX_DIM 13 /end CHARACTERISTIC
/begin CHARACTERISTIC DINH_Lim.DFC_ComChrgrEVtBlink_CA "" VAL_BLK 0x80249C1C ValA_Wu8 17.0000000000 DINH_LimDFCVerb 0.00 17.0000000000 FORMAT "%13.10" MATRIX_DIM 13 /end CHARACTERISTIC
/begin CHARACTERISTIC DINH_Lim.DFC_ComChrgrMstBlink_CA "" VAL_BLK 0x80249C29 ValA_Wu8 17.0000000000 DINH_LimDFCVerb 0.00 17.0000000000 FORMAT "%13.10" MATRIX_DIM 13 /end CHARACTERISTIC
/begin CHARACTERISTIC DINH_Lim.DFC_ComChrgrMstCont_CA "" VAL_BLK 0x80249C36 ValA_Wu8 17.0000000000 DINH_LimDFCVerb 0.00 17.0000000000 FORMAT "%13.10" MATRIX_DIM 13 /end CHARACTERISTIC
/begin CHARACTERISTIC DINH_Lim.DFC_ComChrgrSVSBlink_CA "" VAL_BLK 0x80249C43 ValA_Wu8 17.0000000000 DINH_LimDFCVerb 0.00 17.0000000000 FORMAT "%13.10" MATRIX_DIM 13 /end CHARACTERISTIC
/begin CHARACTERISTIC DINH_Lim.DFC_ComChrgrSVSCont_CA "" VAL_BLK 0x80249C50 ValA_Wu8 17.0000000000 DINH_LimDFCVerb 0.00 17.0000000000 FORMAT "%13.10" MATRIX_DIM 13 /end CHARACTERISTIC
/begin CHARACTERISTIC DINH_Lim.DFC_ComDcdcEVBlink_CA "" VAL_BLK 0x80249C5D ValA_Wu8 17.0000000000 DINH_LimDFCVerb 0.00 17.0000000000 FORMAT "%13.10" MATRIX_DIM 13 /end CHARACTERISTIC
/begin CHARACTERISTIC DINH_Lim.DFC_ComDcdcEVCont_CA "" VAL_BLK 0x80249C6A ValA_Wu8 17.0000000000 DINH_LimDFCVerb 0.00 17.0000000000 FORMAT "%13.10" MATRIX_DIM 13 /end CHARACTERISTIC
/begin CHARACTERISTIC DINH_Lim.DFC_ComDcdcFltLvl2_CA "" VAL_BLK 0x80249C77 ValA_Wu8 17.0000000000 DINH_LimDFCVerb 0.00 17.0000000000 FORMAT "%13.10" MATRIX_DIM 13 /end CHARACTERISTIC
/begin CHARACTERISTIC DINH_Lim.DFC_ComDcdcFltLvl3_CA "" VAL_BLK 0x80249C84 ValA_Wu8 17.0000000000 DINH_LimDFCVerb 0.00 17.0000000000 FORMAT "%13.10" MATRIX_DIM 13 /end CHARACTERISTIC
/begin CHARACTERISTIC DINH_Lim.DFC_ComDcdcFltLvl4_CA "" VAL_BLK 0x80249C91 ValA_Wu8 17.0000000000 DINH_LimDFCVerb 0.00 17.0000000000 FORMAT "%13.10" MATRIX_DIM 13 /end CHARACTERISTIC
/begin CHARACTERISTIC DINH_Lim.DFC_ComDcdcFltLvl5_CA "" VAL_BLK 0x80249C9E ValA_Wu8 17.0000000000 DINH_LimDFCVerb 0.00 17.0000000000 FORMAT "%13.10" MATRIX_DIM 13 /end CHARACTERISTIC
/begin CHARACTERISTIC DINH_Lim.DFC_ComDcdcFltLvlRes_CA "" VAL_BLK 0x80249CAB ValA_Wu8 17.0000000000 DINH_LimDFCVerb 0.00 17.0000000000 FORMAT "%13.10" MATRIX_DIM 13 /end CHARACTERISTIC
/begin CHARACTERISTIC DINH_Lim.DFC_ComDcdcMstBlink_CA "" VAL_BLK 0x80249CB8 ValA_Wu8 17.0000000000 DINH_LimDFCVerb 0.00 17.0000000000 FORMAT "%13.10" MATRIX_DIM 13 /end CHARACTERISTIC
/begin CHARACTERISTIC DINH_Lim.DFC_ComDcdcMstCont_CA "" VAL_BLK 0x80249CC5 ValA_Wu8 17.0000000000 DINH_LimDFCVerb 0.00 17.0000000000 FORMAT "%13.10" MATRIX_DIM 13 /end CHARACTERISTIC
/begin CHARACTERISTIC DINH_Lim.DFC_ComDcdcSVSBlink_CA "" VAL_BLK 0x80249CD2 ValA_Wu8 17.0000000000 DINH_LimDFCVerb 0.00 17.0000000000 FORMAT "%13.10" MATRIX_DIM 13 /end CHARACTERISTIC
/begin CHARACTERISTIC DINH_Lim.DFC_ComDcdcSVSCont_CA "" VAL_BLK 0x80249CDF ValA_Wu8 17.0000000000 DINH_LimDFCVerb 0.00 17.0000000000 FORMAT "%13.10" MATRIX_DIM 13 /end CHARACTERISTIC
/begin CHARACTERISTIC DINH_Lim.DFC_ComElMIIvtrFltLvl2_CA "" VAL_BLK 0x80249CEC ValA_Wu8 17.0000000000 DINH_LimDFCVerb 0.00 17.0000000000 FORMAT "%13.10" MATRIX_DIM 13 /end CHARACTERISTIC
/begin CHARACTERISTIC DINH_Lim.DFC_ComElMIIvtrFltLvl3_CA "" VAL_BLK 0x80249CF9 ValA_Wu8 17.0000000000 DINH_LimDFCVerb 0.00 17.0000000000 FORMAT "%13.10" MATRIX_DIM 15 /end CHARACTERISTIC
/begin CHARACTERISTIC DINH_Lim.DFC_ComElMIIvtrFltLvl4_CA "" VAL_BLK 0x80249D08 ValA_Wu8 17.0000000000 DINH_LimDFCVerb 0.00 17.0000000000 FORMAT "%13.10" MATRIX_DIM 13 /end CHARACTERISTIC
/begin CHARACTERISTIC DINH_Lim.DFC_ComElMIIvtrFltLvl5_CA "" VAL_BLK 0x80249D15 ValA_Wu8 17.0000000000 DINH_LimDFCVerb 0.00 17.0000000000 FORMAT "%13.10" MATRIX_DIM 13 /end CHARACTERISTIC
/begin CHARACTERISTIC DINH_Lim.DFC_ComElMIIvtrFltLvlRes_CA "" VAL_BLK 0x80249D22 ValA_Wu8 17.0000000000 DINH_LimDFCVerb 0.00 17.0000000000 FORMAT "%13.10" MATRIX_DIM 13 /end CHARACTERISTIC
/begin CHARACTERISTIC DINH_Lim.DFC_ComEmacEVBlink_CA "" VAL_BLK 0x80249D2F ValA_Wu8 17.0000000000 DINH_LimDFCVerb 0.00 17.0000000000 FORMAT "%13.10" MATRIX_DIM 13 /end CHARACTERISTIC
/begin CHARACTERISTIC DINH_Lim.DFC_ComEmacEVCont_CA "" VAL_BLK 0x80249D3C ValA_Wu8 17.0000000000 DINH_LimDFCVerb 0.00 17.0000000000 FORMAT "%13.10" MATRIX_DIM 13 /end CHARACTERISTIC
/begin CHARACTERISTIC DINH_Lim.DFC_ComEmacMstCont_CA "" VAL_BLK 0x80249D49 ValA_Wu8 17.0000000000 DINH_LimDFCVerb 0.00 17.0000000000 FORMAT "%13.10" MATRIX_DIM 13 /end CHARACTERISTIC
/begin CHARACTERISTIC DINH_Lim.DFC_ComEmacMsttBlink_CA "" VAL_BLK 0x80249D56 ValA_Wu8 17.0000000000 DINH_LimDFCVerb 0.00 17.0000000000 FORMAT "%13.10" MATRIX_DIM 13 /end CHARACTERISTIC
/begin CHARACTERISTIC DINH_Lim.DFC_ComEmacSVSBlink_CA "" VAL_BLK 0x80249D63 ValA_Wu8 17.0000000000 DINH_LimDFCVerb 0.00 17.0000000000 FORMAT "%13.10" MATRIX_DIM 13 /end CHARACTERISTIC
/begin CHARACTERISTIC DINH_Lim.DFC_ComEmacSVSCont_CA "" VAL_BLK 0x80249D70 ValA_Wu8 17.0000000000 DINH_LimDFCVerb 0.00 17.0000000000 FORMAT "%13.10" MATRIX_DIM 13 /end CHARACTERISTIC
/begin CHARACTERISTIC DINH_Lim.DFC_ComGunCntInfoWkuReq_CA "" VAL_BLK 0x80249D7D ValA_Wu8 17.0000000000 DINH_LimDFCVerb 0.00 17.0000000000 FORMAT "%13.10" MATRIX_DIM 13 /end CHARACTERISTIC
/begin CHARACTERISTIC DINH_Lim.DFC_ComHillHldFlt_CA "" VAL_BLK 0x80249D8A ValA_Wu8 17.0000000000 DINH_LimDFCVerb 0.00 17.0000000000 FORMAT "%13.10" MATRIX_DIM 13 /end CHARACTERISTIC
/begin CHARACTERISTIC DINH_Lim.DFC_ComHvBattRchrgWkuReq_CA "" VAL_BLK 0x80249D97 ValA_Wu8 17.0000000000 DINH_LimDFCVerb 0.00 17.0000000000 FORMAT "%13.10" MATRIX_DIM 13 /end CHARACTERISTIC
/begin CHARACTERISTIC DINH_Lim.DFC_ComHvbFltLvl2_CA "" VAL_BLK 0x80249DA4 ValA_Wu8 17.0000000000 DINH_LimDFCVerb 0.00 17.0000000000 FORMAT "%13.10" MATRIX_DIM 13 /end CHARACTERISTIC
/begin CHARACTERISTIC DINH_Lim.DFC_ComHvbFltLvl3_CA "" VAL_BLK 0x80249DB1 ValA_Wu8 17.0000000000 DINH_LimDFCVerb 0.00 17.0000000000 FORMAT "%13.10" MATRIX_DIM 13 /end CHARACTERISTIC
/begin CHARACTERISTIC DINH_Lim.DFC_ComHvbFltLvl4_CA "" VAL_BLK 0x80249DBE ValA_Wu8 17.0000000000 DINH_LimDFCVerb 0.00 17.0000000000 FORMAT "%13.10" MATRIX_DIM 13 /end CHARACTERISTIC
/begin CHARACTERISTIC DINH_Lim.DFC_ComHvbFltLvl5_CA "" VAL_BLK 0x80249DCB ValA_Wu8 17.0000000000 DINH_LimDFCVerb 0.00 17.0000000000 FORMAT "%13.10" MATRIX_DIM 13 /end CHARACTERISTIC
/begin CHARACTERISTIC DINH_Lim.DFC_ComHvbFltLvlRes_CA "" VAL_BLK 0x80249DD8 ValA_Wu8 17.0000000000 DINH_LimDFCVerb 0.00 17.0000000000 FORMAT "%13.10" MATRIX_DIM 13 /end CHARACTERISTIC
/begin CHARACTERISTIC DINH_Lim.DFC_ComHvbMstBlink_CA "" VAL_BLK 0x80249DE5 ValA_Wu8 17.0000000000 DINH_LimDFCVerb 0.00 17.0000000000 FORMAT "%13.10" MATRIX_DIM 13 /end CHARACTERISTIC
/begin CHARACTERISTIC DINH_Lim.DFC_ComHvbMstCont_CA "" VAL_BLK 0x80249DF2 ValA_Wu8 17.0000000000 DINH_LimDFCVerb 0.00 17.0000000000 FORMAT "%13.10" MATRIX_DIM 13 /end CHARACTERISTIC
/begin CHARACTERISTIC DINH_Lim.DFC_ComImmoUnlockWkuReq_CA "" VAL_BLK 0x80249DFF ValA_Wu8 17.0000000000 DINH_LimDFCVerb 0.00 17.0000000000 FORMAT "%13.10" MATRIX_DIM 13 /end CHARACTERISTIC
/begin CHARACTERISTIC DINH_Lim.DFC_ComInfoReqPtlWkuReq_CA "" VAL_BLK 0x80249E0C ValA_Wu8 17.0000000000 DINH_LimDFCVerb 0.00 17.0000000000 FORMAT "%13.10" MATRIX_DIM 13 /end CHARACTERISTIC
/begin CHARACTERISTIC DINH_Lim.DFC_ComOBCFltLvl2_CA "" VAL_BLK 0x80249E19 ValA_Wu8 17.0000000000 DINH_LimDFCVerb 0.00 17.0000000000 FORMAT "%13.10" MATRIX_DIM 13 /end CHARACTERISTIC
/begin CHARACTERISTIC DINH_Lim.DFC_ComOBCFltLvl3_CA "" VAL_BLK 0x80249E26 ValA_Wu8 17.0000000000 DINH_LimDFCVerb 0.00 17.0000000000 FORMAT "%13.10" MATRIX_DIM 13 /end CHARACTERISTIC
/begin CHARACTERISTIC DINH_Lim.DFC_ComOBCFltLvl4_CA "" VAL_BLK 0x80249E33 ValA_Wu8 17.0000000000 DINH_LimDFCVerb 0.00 17.0000000000 FORMAT "%13.10" MATRIX_DIM 13 /end CHARACTERISTIC
/begin CHARACTERISTIC DINH_Lim.DFC_ComOBCFltLvl5_CA "" VAL_BLK 0x80249E40 ValA_Wu8 17.0000000000 DINH_LimDFCVerb 0.00 17.0000000000 FORMAT "%13.10" MATRIX_DIM 13 /end CHARACTERISTIC
/begin CHARACTERISTIC DINH_Lim.DFC_ComOBCFltLvlRes_CA "" VAL_BLK 0x80249E4D ValA_Wu8 17.0000000000 DINH_LimDFCVerb 0.00 17.0000000000 FORMAT "%13.10" MATRIX_DIM 13 /end CHARACTERISTIC
/begin CHARACTERISTIC DINH_Lim.DFC_ComPostOperationWkuReq_CA "" VAL_BLK 0x80249E5A ValA_Wu8 17.0000000000 DINH_LimDFCVerb 0.00 17.0000000000 FORMAT "%13.10" MATRIX_DIM 13 /end CHARACTERISTIC
/begin CHARACTERISTIC DINH_Lim.DFC_ComPreCondElecWkuReq_CA "" VAL_BLK 0x80249E67 ValA_Wu8 17.0000000000 DINH_LimDFCVerb 0.00 17.0000000000 FORMAT "%13.10" MATRIX_DIM 13 /end CHARACTERISTIC
/begin CHARACTERISTIC DINH_Lim.DFC_ComRemUnlckWkuReq_CA "" VAL_BLK 0x80249E74 ValA_Wu8 17.0000000000 DINH_LimDFCVerb 0.00 17.0000000000 FORMAT "%13.10" MATRIX_DIM 13 /end CHARACTERISTIC
/begin CHARACTERISTIC DINH_Lim.DFC_ComStpDlyHMIWkuReq_CA "" VAL_BLK 0x80249E81 ValA_Wu8 17.0000000000 DINH_LimDFCVerb 0.00 17.0000000000 FORMAT "%13.10" MATRIX_DIM 13 /end CHARACTERISTIC
/begin CHARACTERISTIC DINH_Lim.DFC_ComflgCurMeasmtErr_CA "" VAL_BLK 0x80249E8E ValA_Wu8 17.0000000000 DINH_LimDFCVerb 0.00 17.0000000000 FORMAT "%13.10" MATRIX_DIM 13 /end CHARACTERISTIC
/begin CHARACTERISTIC DINH_Lim.DFC_ComflgCurMeasmtSysErr_CA "" VAL_BLK 0x80249E9B ValA_Wu8 17.0000000000 DINH_LimDFCVerb 0.00 17.0000000000 FORMAT "%13.10" MATRIX_DIM 13 /end CHARACTERISTIC
/begin CHARACTERISTIC DINH_Lim.DFC_ComflgCurMeasmtVld_CA "" VAL_BLK 0x80249EA8 ValA_Wu8 17.0000000000 DINH_LimDFCVerb 0.00 17.0000000000 FORMAT "%13.10" MATRIX_DIM 13 /end CHARACTERISTIC
/begin CHARACTERISTIC DINH_Lim.DFC_ComflgCurRngErr_CA "" VAL_BLK 0x80249EB5 ValA_Wu8 17.0000000000 DINH_LimDFCVerb 0.00 17.0000000000 FORMAT "%13.10" MATRIX_DIM 13 /end CHARACTERISTIC
/begin CHARACTERISTIC DINH_Lim.DFC_ComflgTPcbMeasmtErr_CA "" VAL_BLK 0x80249EC2 ValA_Wu8 17.0000000000 DINH_LimDFCVerb 0.00 17.0000000000 FORMAT "%13.10" MATRIX_DIM 13 /end CHARACTERISTIC
/begin CHARACTERISTIC DINH_Lim.DFC_ComflgTPcbMeasmtVld_CA "" VAL_BLK 0x80249ECF ValA_Wu8 17.0000000000 DINH_LimDFCVerb 0.00 17.0000000000 FORMAT "%13.10" MATRIX_DIM 13 /end CHARACTERISTIC
/begin CHARACTERISTIC DINH_Lim.DFC_ComflgTPcbRngErr_CA "" VAL_BLK 0x80249EDC ValA_Wu8 17.0000000000 DINH_LimDFCVerb 0.00 17.0000000000 FORMAT "%13.10" MATRIX_DIM 13 /end CHARACTERISTIC
/begin CHARACTERISTIC DINH_Lim.DFC_ComflgTPcbSysErr_CA "" VAL_BLK 0x80249EE9 ValA_Wu8 17.0000000000 DINH_LimDFCVerb 0.00 17.0000000000 FORMAT "%13.10" MATRIX_DIM 13 /end CHARACTERISTIC
/begin CHARACTERISTIC DINH_Lim.DFC_ComflgTShntMeasmtErr_CA "" VAL_BLK 0x80249EF6 ValA_Wu8 17.0000000000 DINH_LimDFCVerb 0.00 17.0000000000 FORMAT "%13.10" MATRIX_DIM 13 /end CHARACTERISTIC
/begin CHARACTERISTIC DINH_Lim.DFC_ComflgTShntMeasmtVld_CA "" VAL_BLK 0x80249F03 ValA_Wu8 17.0000000000 DINH_LimDFCVerb 0.00 17.0000000000 FORMAT "%13.10" MATRIX_DIM 13 /end CHARACTERISTIC
/begin CHARACTERISTIC DINH_Lim.DFC_ComflgTShntRngErr_CA "" VAL_BLK 0x80249F10 ValA_Wu8 17.0000000000 DINH_LimDFCVerb 0.00 17.0000000000 FORMAT "%13.10" MATRIX_DIM 13 /end CHARACTERISTIC
/begin CHARACTERISTIC DINH_Lim.DFC_ComflgTShntSysErr_CA "" VAL_BLK 0x80249F1D ValA_Wu8 17.0000000000 DINH_LimDFCVerb 0.00 17.0000000000 FORMAT "%13.10" MATRIX_DIM 13 /end CHARACTERISTIC
/begin CHARACTERISTIC DINH_Lim.DFC_ComflgVoltMeasmtErr_CA "" VAL_BLK 0x80249F2A ValA_Wu8 17.0000000000 DINH_LimDFCVerb 0.00 17.0000000000 FORMAT "%13.10" MATRIX_DIM 13 /end CHARACTERISTIC
/begin CHARACTERISTIC DINH_Lim.DFC_ComflgVoltMeasmtSysErr_CA "" VAL_BLK 0x80249F37 ValA_Wu8 17.0000000000 DINH_LimDFCVerb 0.00 17.0000000000 FORMAT "%13.10" MATRIX_DIM 13 /end CHARACTERISTIC
/begin CHARACTERISTIC DINH_Lim.DFC_ComflgVoltMeasmtVld_CA "" VAL_BLK 0x80249F44 ValA_Wu8 17.0000000000 DINH_LimDFCVerb 0.00 17.0000000000 FORMAT "%13.10" MATRIX_DIM 13 /end CHARACTERISTIC
/begin CHARACTERISTIC DINH_Lim.DFC_ComflgVoltRngErr_CA "" VAL_BLK 0x80249F51 ValA_Wu8 17.0000000000 DINH_LimDFCVerb 0.00 17.0000000000 FORMAT "%13.10" MATRIX_DIM 13 /end CHARACTERISTIC
/begin CHARACTERISTIC DINH_Lim.DFC_CrashEveOcc_CA "" VAL_BLK 0x80249F5E ValA_Wu8 17.0000000000 DINH_LimDFCVerb 0.00 17.0000000000 FORMAT "%13.10" MATRIX_DIM 13 /end CHARACTERISTIC
/begin CHARACTERISTIC DINH_Lim.DFC_DcdcFwdModStuck_CA "" VAL_BLK 0x80249F6B ValA_Wu8 17.0000000000 DINH_LimDFCVerb 0.00 17.0000000000 FORMAT "%13.10" MATRIX_DIM 13 /end CHARACTERISTIC
/begin CHARACTERISTIC DINH_Lim.DFC_DcdcLvUDifMaxFlt_CA "" VAL_BLK 0x80249F78 ValA_Wu8 17.0000000000 DINH_LimDFCVerb 0.00 17.0000000000 FORMAT "%13.10" MATRIX_DIM 13 /end CHARACTERISTIC
/begin CHARACTERISTIC DINH_Lim.DFC_DcdcOffModStuck_CA "" VAL_BLK 0x80249F85 ValA_Wu8 17.0000000000 DINH_LimDFCVerb 0.00 17.0000000000 FORMAT "%13.10" MATRIX_DIM 13 /end CHARACTERISTIC
/begin CHARACTERISTIC DINH_Lim.DFC_DcdcOperModFailr_CA "" VAL_BLK 0x80249F92 ValA_Wu8 17.0000000000 DINH_LimDFCVerb 0.00 17.0000000000 FORMAT "%13.10" MATRIX_DIM 15 /end CHARACTERISTIC
/begin CHARACTERISTIC DINH_Lim.DFC_DcdcPrecModStuck_CA "" VAL_BLK 0x80249FA1 ValA_Wu8 17.0000000000 DINH_LimDFCVerb 0.00 17.0000000000 FORMAT "%13.10" MATRIX_DIM 13 /end CHARACTERISTIC
/begin CHARACTERISTIC DINH_Lim.DFC_DrvDoorOpn_CA "" VAL_BLK 0x80249FAE ValA_Wu8 17.0000000000 DINH_LimDFCVerb 0.00 17.0000000000 FORMAT "%13.10" MATRIX_DIM 13 /end CHARACTERISTIC
/begin CHARACTERISTIC DINH_Lim.DFC_DrvModPosnDfct_CA "" VAL_BLK 0x80249FBB ValA_Wu8 17.0000000000 DINH_LimDFCVerb 0.00 17.0000000000 FORMAT "%13.10" MATRIX_DIM 14 /end CHARACTERISTIC
/begin CHARACTERISTIC DINH_Lim.DFC_DrvStbltOpn_CA "" VAL_BLK 0x80249FC9 ValA_Wu8 17.0000000000 DINH_LimDFCVerb 0.00 17.0000000000 FORMAT "%13.10" MATRIX_DIM 13 /end CHARACTERISTIC
/begin CHARACTERISTIC DINH_Lim.DFC_ETogFailrLvl3_CA "" VAL_BLK 0x80249FD6 ValA_Wu8 17.0000000000 DINH_LimDFCVerb 0.00 17.0000000000 FORMAT "%13.10" MATRIX_DIM 13 /end CHARACTERISTIC
/begin CHARACTERISTIC DINH_Lim.DFC_ETogFailrLvl4_CA "" VAL_BLK 0x80249FE3 ValA_Wu8 17.0000000000 DINH_LimDFCVerb 0.00 17.0000000000 FORMAT "%13.10" MATRIX_DIM 14 /end CHARACTERISTIC
/begin CHARACTERISTIC DINH_Lim.DFC_EbsLvBattSocDiagLo_CA "" VAL_BLK 0x80249FF1 ValA_Wu8 17.0000000000 DINH_LimDFCVerb 0.00 17.0000000000 FORMAT "%13.10" MATRIX_DIM 14 /end CHARACTERISTIC
/begin CHARACTERISTIC DINH_Lim.DFC_EbsLvBattUDiagDiOper_CA "" VAL_BLK 0x80249FFF ValA_Wu8 17.0000000000 DINH_LimDFCVerb 0.00 17.0000000000 FORMAT "%13.10" MATRIX_DIM 13 /end CHARACTERISTIC
/begin CHARACTERISTIC DINH_Lim.DFC_EbsLvBattUDiagFltLvl1_CA "" VAL_BLK 0x8024A00C ValA_Wu8 17.0000000000 DINH_LimDFCVerb 0.00 17.0000000000 FORMAT "%13.10" MATRIX_DIM 13 /end CHARACTERISTIC
/begin CHARACTERISTIC DINH_Lim.DFC_EbsLvBattUDiagFltLvl2_CA "" VAL_BLK 0x8024A019 ValA_Wu8 17.0000000000 DINH_LimDFCVerb 0.00 17.0000000000 FORMAT "%13.10" MATRIX_DIM 13 /end CHARACTERISTIC
/begin CHARACTERISTIC DINH_Lim.DFC_EbsLvBattUDiagLo_CA "" VAL_BLK 0x8024A026 ValA_Wu8 17.0000000000 DINH_LimDFCVerb 0.00 17.0000000000 FORMAT "%13.10" MATRIX_DIM 13 /end CHARACTERISTIC
/begin CHARACTERISTIC DINH_Lim.DFC_EbsSnsrSt_CA "" VAL_BLK 0x8024A033 ValA_Wu8 17.0000000000 DINH_LimDFCVerb 0.00 17.0000000000 FORMAT "%13.10" MATRIX_DIM 13 /end CHARACTERISTIC
/begin CHARACTERISTIC DINH_Lim.DFC_EbsSofASILErr_CA "" VAL_BLK 0x8024A040 ValA_Wu8 17.0000000000 DINH_LimDFCVerb 0.00 17.0000000000 FORMAT "%13.10" MATRIX_DIM 13 /end CHARACTERISTIC
/begin CHARACTERISTIC DINH_Lim.DFC_ElTSPtSysLimDrvErr_CA "" VAL_BLK 0x8024A04D ValA_Wu8 17.0000000000 DINH_LimDFCVerb 0.00 17.0000000000 FORMAT "%13.10" MATRIX_DIM 13 /end CHARACTERISTIC
/begin CHARACTERISTIC DINH_Lim.DFC_ElTSPtSysLimRgnErr_CA "" VAL_BLK 0x8024A05A ValA_Wu8 17.0000000000 DINH_LimDFCVerb 0.00 17.0000000000 FORMAT "%13.10" MATRIX_DIM 13 /end CHARACTERISTIC
/begin CHARACTERISTIC DINH_Lim.DFC_HLCCcsFwDwnl_CA "" VAL_BLK 0x8024A067 ValA_Wu8 17.0000000000 DINH_LimDFCVerb 0.00 17.0000000000 FORMAT "%13.10" MATRIX_DIM 13 /end CHARACTERISTIC
/begin CHARACTERISTIC DINH_Lim.DFC_HvBattChrgPwrMax_CA "" VAL_BLK 0x8024A074 ValA_Wu8 17.0000000000 DINH_LimDFCVerb 0.00 17.0000000000 FORMAT "%13.10" MATRIX_DIM 13 /end CHARACTERISTIC
/begin CHARACTERISTIC DINH_Lim.DFC_HvBattCrashDetd_CA "" VAL_BLK 0x8024A081 ValA_Wu8 17.0000000000 DINH_LimDFCVerb 0.00 17.0000000000 FORMAT "%13.10" MATRIX_DIM 14 /end CHARACTERISTIC
/begin CHARACTERISTIC DINH_Lim.DFC_HvBattDchaPwrMax_CA "" VAL_BLK 0x8024A08F ValA_Wu8 17.0000000000 DINH_LimDFCVerb 0.00 17.0000000000 FORMAT "%13.10" MATRIX_DIM 13 /end CHARACTERISTIC
/begin CHARACTERISTIC DINH_Lim.DFC_HvBattEmgyOff_CA "" VAL_BLK 0x8024A09C ValA_Wu8 17.0000000000 DINH_LimDFCVerb 0.00 17.0000000000 FORMAT "%13.10" MATRIX_DIM 14 /end CHARACTERISTIC
/begin CHARACTERISTIC DINH_Lim.DFC_HvBattEmgyOffIntlck_CA "" VAL_BLK 0x8024A0AA ValA_Wu8 17.0000000000 DINH_LimDFCVerb 0.00 17.0000000000 FORMAT "%13.10" MATRIX_DIM 14 /end CHARACTERISTIC
/begin CHARACTERISTIC DINH_Lim.DFC_HvBattEmgyOffReq_CA "" VAL_BLK 0x8024A0B8 ValA_Wu8 17.0000000000 DINH_LimDFCVerb 0.00 17.0000000000 FORMAT "%13.10" MATRIX_DIM 17 /end CHARACTERISTIC
/begin CHARACTERISTIC DINH_Lim.DFC_HvBattFltMod_CA "" VAL_BLK 0x8024A0C9 ValA_Wu8 17.0000000000 DINH_LimDFCVerb 0.00 17.0000000000 FORMAT "%13.10" MATRIX_DIM 17 /end CHARACTERISTIC
/begin CHARACTERISTIC DINH_Lim.DFC_HvBattIReqToChrgrErr_CA "" VAL_BLK 0x8024A0DA ValA_Wu8 17.0000000000 DINH_LimDFCVerb 0.00 17.0000000000 FORMAT "%13.10" MATRIX_DIM 14 /end CHARACTERISTIC
/begin CHARACTERISTIC DINH_Lim.DFC_HvBattIReqToChrgrIni_CA "" VAL_BLK 0x8024A0E8 ValA_Wu8 17.0000000000 DINH_LimDFCVerb 0.00 17.0000000000 FORMAT "%13.10" MATRIX_DIM 14 /end CHARACTERISTIC
/begin CHARACTERISTIC DINH_Lim.DFC_HvBattIninTout_CA "" VAL_BLK 0x8024A0F6 ValA_Wu8 17.0000000000 DINH_LimDFCVerb 0.00 17.0000000000 FORMAT "%13.10" MATRIX_DIM 13 /end CHARACTERISTIC
/begin CHARACTERISTIC DINH_Lim.DFC_HvBattIntlckSt_CA "" VAL_BLK 0x8024A103 ValA_Wu8 17.0000000000 DINH_LimDFCVerb 0.00 17.0000000000 FORMAT "%13.10" MATRIX_DIM 19 /end CHARACTERISTIC
/begin CHARACTERISTIC DINH_Lim.DFC_HvBattIsoFlt_CA "" VAL_BLK 0x8024A116 ValA_Wu8 17.0000000000 DINH_LimDFCVerb 0.00 17.0000000000 FORMAT "%13.10" MATRIX_DIM 18 /end CHARACTERISTIC
/begin CHARACTERISTIC DINH_Lim.DFC_HvBattLimdPwr_CA "" VAL_BLK 0x8024A128 ValA_Wu8 17.0000000000 DINH_LimDFCVerb 0.00 17.0000000000 FORMAT "%13.10" MATRIX_DIM 13 /end CHARACTERISTIC
/begin CHARACTERISTIC DINH_Lim.DFC_HvBattMaiSwtClsngFlt_CA "" VAL_BLK 0x8024A135 ValA_Wu8 17.0000000000 DINH_LimDFCVerb 0.00 17.0000000000 FORMAT "%13.10" MATRIX_DIM 16 /end CHARACTERISTIC
/begin CHARACTERISTIC DINH_Lim.DFC_HvBattMaiSwtFlt_CA "" VAL_BLK 0x8024A145 ValA_Wu8 17.0000000000 DINH_LimDFCVerb 0.00 17.0000000000 FORMAT "%13.10" MATRIX_DIM 16 /end CHARACTERISTIC
/begin CHARACTERISTIC DINH_Lim.DFC_HvBattMaiSwtOpen_CA "" VAL_BLK 0x8024A155 ValA_Wu8 17.0000000000 DINH_LimDFCVerb 0.00 17.0000000000 FORMAT "%13.10" MATRIX_DIM 15 /end CHARACTERISTIC
/begin CHARACTERISTIC DINH_Lim.DFC_HvBattMaiSwtOpngFlt_CA "" VAL_BLK 0x8024A164 ValA_Wu8 17.0000000000 DINH_LimDFCVerb 0.00 17.0000000000 FORMAT "%13.10" MATRIX_DIM 13 /end CHARACTERISTIC
/begin CHARACTERISTIC DINH_Lim.DFC_HvBattMaiSwtWldd_CA "" VAL_BLK 0x8024A171 ValA_Wu8 17.0000000000 DINH_LimDFCVerb 0.00 17.0000000000 FORMAT "%13.10" MATRIX_DIM 14 /end CHARACTERISTIC
/begin CHARACTERISTIC DINH_Lim.DFC_HvBattNegCntctrCntErr_CA "" VAL_BLK 0x8024A17F ValA_Wu8 17.0000000000 DINH_LimDFCVerb 0.00 17.0000000000 FORMAT "%13.10" MATRIX_DIM 13 /end CHARACTERISTIC
/begin CHARACTERISTIC DINH_Lim.DFC_HvBattOperModChrgPlausy_CA "" VAL_BLK 0x8024A18C ValA_Wu8 17.0000000000 DINH_LimDFCVerb 0.00 17.0000000000 FORMAT "%13.10" MATRIX_DIM 13 /end CHARACTERISTIC
/begin CHARACTERISTIC DINH_Lim.DFC_HvBattOverTDern_CA "" VAL_BLK 0x8024A199 ValA_Wu8 17.0000000000 DINH_LimDFCVerb 0.00 17.0000000000 FORMAT "%13.10" MATRIX_DIM 13 /end CHARACTERISTIC
/begin CHARACTERISTIC DINH_Lim.DFC_HvBattPosCntctrCntErr_CA "" VAL_BLK 0x8024A1A6 ValA_Wu8 17.0000000000 DINH_LimDFCVerb 0.00 17.0000000000 FORMAT "%13.10" MATRIX_DIM 13 /end CHARACTERISTIC
/begin CHARACTERISTIC DINH_Lim.DFC_HvBattPrecCntctrCntErr_CA "" VAL_BLK 0x8024A1B3 ValA_Wu8 17.0000000000 DINH_LimDFCVerb 0.00 17.0000000000 FORMAT "%13.10" MATRIX_DIM 13 /end CHARACTERISTIC
/begin CHARACTERISTIC DINH_Lim.DFC_HvBattPwrDistbnTDern_CA "" VAL_BLK 0x8024A1C0 ValA_Wu8 17.0000000000 DINH_LimDFCVerb 0.00 17.0000000000 FORMAT "%13.10" MATRIX_DIM 13 /end CHARACTERISTIC
/begin CHARACTERISTIC DINH_Lim.DFC_HvBattPwrDistbnTInhbn_CA "" VAL_BLK 0x8024A1CD ValA_Wu8 17.0000000000 DINH_LimDFCVerb 0.00 17.0000000000 FORMAT "%13.10" MATRIX_DIM 13 /end CHARACTERISTIC
/begin CHARACTERISTIC DINH_Lim.DFC_HvBattRatRSohErr_CA "" VAL_BLK 0x8024A1DA ValA_Wu8 17.0000000000 DINH_LimDFCVerb 0.00 17.0000000000 FORMAT "%13.10" MATRIX_DIM 13 /end CHARACTERISTIC
/begin CHARACTERISTIC DINH_Lim.DFC_HvBattRatSohErr_CA "" VAL_BLK 0x8024A1E7 ValA_Wu8 17.0000000000 DINH_LimDFCVerb 0.00 17.0000000000 FORMAT "%13.10" MATRIX_DIM 13 /end CHARACTERISTIC
/begin CHARACTERISTIC DINH_Lim.DFC_HvBattSngIsoWarn_CA "" VAL_BLK 0x8024A1F4 ValA_Wu8 17.0000000000 DINH_LimDFCVerb 0.00 17.0000000000 FORMAT "%13.10" MATRIX_DIM 16 /end CHARACTERISTIC
/begin CHARACTERISTIC DINH_Lim.DFC_HvBattSrvPlgDiscnct_CA "" VAL_BLK 0x8024A204 ValA_Wu8 17.0000000000 DINH_LimDFCVerb 0.00 17.0000000000 FORMAT "%13.10" MATRIX_DIM 14 /end CHARACTERISTIC
/begin CHARACTERISTIC DINH_Lim.DFC_HvBattUNomChrgnErr_CA "" VAL_BLK 0x8024A212 ValA_Wu8 17.0000000000 DINH_LimDFCVerb 0.00 17.0000000000 FORMAT "%13.10" MATRIX_DIM 14 /end CHARACTERISTIC
/begin CHARACTERISTIC DINH_Lim.DFC_HvBattUNomChrgnIni_CA "" VAL_BLK 0x8024A220 ValA_Wu8 17.0000000000 DINH_LimDFCVerb 0.00 17.0000000000 FORMAT "%13.10" MATRIX_DIM 14 /end CHARACTERISTIC
/begin CHARACTERISTIC DINH_Lim.DFC_HvBattUnderTDern_CA "" VAL_BLK 0x8024A22E ValA_Wu8 17.0000000000 DINH_LimDFCVerb 0.00 17.0000000000 FORMAT "%13.10" MATRIX_DIM 13 /end CHARACTERISTIC
/begin CHARACTERISTIC DINH_Lim.DFC_HvbEVLmpBlink_CA "" VAL_BLK 0x8024A23B ValA_Wu8 17.0000000000 DINH_LimDFCVerb 0.00 17.0000000000 FORMAT "%13.10" MATRIX_DIM 13 /end CHARACTERISTIC
/begin CHARACTERISTIC DINH_Lim.DFC_HvbEVLmpCont_CA "" VAL_BLK 0x8024A248 ValA_Wu8 17.0000000000 DINH_LimDFCVerb 0.00 17.0000000000 FORMAT "%13.10" MATRIX_DIM 13 /end CHARACTERISTIC
/begin CHARACTERISTIC DINH_Lim.DFC_HvbSVSBlink_CA "" VAL_BLK 0x8024A255 ValA_Wu8 17.0000000000 DINH_LimDFCVerb 0.00 17.0000000000 FORMAT "%13.10" MATRIX_DIM 13 /end CHARACTERISTIC
/begin CHARACTERISTIC DINH_Lim.DFC_HvbSVSCont_CA "" VAL_BLK 0x8024A262 ValA_Wu8 17.0000000000 DINH_LimDFCVerb 0.00 17.0000000000 FORMAT "%13.10" MATRIX_DIM 13 /end CHARACTERISTIC
/begin CHARACTERISTIC DINH_Lim.DFC_InmLINBusBlk_CA "" VAL_BLK 0x8024A26F ValA_Wu8 17.0000000000 DINH_LimDFCVerb 0.00 17.0000000000 FORMAT "%13.10" MATRIX_DIM 13 /end CHARACTERISTIC
/begin CHARACTERISTIC DINH_Lim.DFC_PDUProgmFailr_CA "" VAL_BLK 0x8024A27C ValA_Wu8 17.0000000000 DINH_LimDFCVerb 0.00 17.0000000000 FORMAT "%13.10" MATRIX_DIM 13 /end CHARACTERISTIC
/begin CHARACTERISTIC DINH_Lim.DFC_PEnvSigRngMax_CA "" VAL_BLK 0x8024A289 ValA_Wu8 17.0000000000 DINH_LimDFCVerb 0.00 17.0000000000 FORMAT "%13.10" MATRIX_DIM 20 /end CHARACTERISTIC
/begin CHARACTERISTIC DINH_Lim.DFC_PEnvSigRngMin_CA "" VAL_BLK 0x8024A29D ValA_Wu8 17.0000000000 DINH_LimDFCVerb 0.00 17.0000000000 FORMAT "%13.10" MATRIX_DIM 20 /end CHARACTERISTIC
/begin CHARACTERISTIC DINH_Lim.DFC_PLnCChpDeactvnFaild_CA "" VAL_BLK 0x8024A2B1 ValA_Wu8 17.0000000000 DINH_LimDFCVerb 0.00 17.0000000000 FORMAT "%13.10" MATRIX_DIM 13 /end CHARACTERISTIC
/begin CHARACTERISTIC DINH_Lim.DFC_PrkgBrkFailr_CA "" VAL_BLK 0x8024A2BE ValA_Wu8 17.0000000000 DINH_LimDFCVerb 0.00 17.0000000000 FORMAT "%13.10" MATRIX_DIM 13 /end CHARACTERISTIC
/begin CHARACTERISTIC DINH_Lim.DFC_PtSysLimErr_CA "" VAL_BLK 0x8024A2CB ValA_Wu8 17.0000000000 DINH_LimDFCVerb 0.00 17.0000000000 FORMAT "%13.10" MATRIX_DIM 13 /end CHARACTERISTIC
/begin CHARACTERISTIC DINH_Lim.DFC_PwrMaxDchaShoLo_CA "" VAL_BLK 0x8024A2D8 ValA_Wu8 17.0000000000 DINH_LimDFCVerb 0.00 17.0000000000 FORMAT "%13.10" MATRIX_DIM 13 /end CHARACTERISTIC
/begin CHARACTERISTIC DINH_Lim.DFC_SCtPmp1FailSafeNotSuc_CA "" VAL_BLK 0x8024A2E5 ValA_Wu8 17.0000000000 DINH_LimDFCVerb 0.00 17.0000000000 FORMAT "%13.10" MATRIX_DIM 13 /end CHARACTERISTIC
/begin CHARACTERISTIC DINH_Lim.DFC_SCtPmp1SCG_CA "" VAL_BLK 0x8024A2F2 ValA_Wu8 17.0000000000 DINH_LimDFCVerb 0.00 17.0000000000 FORMAT "%13.10" MATRIX_DIM 18 /end CHARACTERISTIC
/begin CHARACTERISTIC DINH_Lim.DFC_VehCoornDrvrNotPrsnt_CA "" VAL_BLK 0x8024A304 ValA_Wu8 17.0000000000 DINH_LimDFCVerb 0.00 17.0000000000 FORMAT "%13.10" MATRIX_DIM 13 /end CHARACTERISTIC
/begin CHARACTERISTIC DINH_Lim.DFC_VehVCanAvl_CA "" VAL_BLK 0x8024A311 ValA_Wu8 17.0000000000 DINH_LimDFCVerb 0.00 17.0000000000 FORMAT "%13.10" MATRIX_DIM 16 /end CHARACTERISTIC
/begin CHARACTERISTIC DINH_Lim.DFC_VehVCanErr_CA "" VAL_BLK 0x8024A321 ValA_Wu8 17.0000000000 DINH_LimDFCVerb 0.00 17.0000000000 FORMAT "%13.10" MATRIX_DIM 13 /end CHARACTERISTIC
/begin CHARACTERISTIC DINH_Lim.DFC_eTogFailrLvlRes_CA "" VAL_BLK 0x8024A32E ValA_Wu8 17.0000000000 DINH_LimDFCVerb 0.00 17.0000000000 FORMAT "%13.10" MATRIX_DIM 13 /end CHARACTERISTIC
/begin CHARACTERISTIC DINH_Lim.DFC_flgBrkMaiDiag_CA "" VAL_BLK 0x8024A33B ValA_Wu8 17.0000000000 DINH_LimDFCVerb 0.00 17.0000000000 FORMAT "%13.10" MATRIX_DIM 15 /end CHARACTERISTIC
/begin CHARACTERISTIC DINH_Lim.DFC_stHvbIsoMeasmtRes_CA "" VAL_BLK 0x8024A34A ValA_Wu8 17.0000000000 DINH_LimDFCVerb 0.00 17.0000000000 FORMAT "%13.10" MATRIX_DIM 13 /end CHARACTERISTIC
/begin CHARACTERISTIC DINH_Lim.DFC_BrkBstPmpPLeakDfct_CA "" VAL_BLK 0x8024A357 ValA_Wu8 17.0000000000 DINH_LimDFCVerb 0.00 17.0000000000 FORMAT "%13.10" MATRIX_DIM 15 /end CHARACTERISTIC
/begin CHARACTERISTIC DINH_Lim.DFC_Com082hTooShort_CA "" VAL_BLK 0x8024A366 ValA_Wu8 17.0000000000 DINH_LimDFCVerb 0.00 17.0000000000 FORMAT "%13.10" MATRIX_DIM 15 /end CHARACTERISTIC
/begin CHARACTERISTIC DINH_Lim.DFC_Com092hTooShort_CA "" VAL_BLK 0x8024A375 ValA_Wu8 17.0000000000 DINH_LimDFCVerb 0.00 17.0000000000 FORMAT "%13.10" MATRIX_DIM 15 /end CHARACTERISTIC
/begin CHARACTERISTIC DINH_Lim.DFC_Com205hAbsent_CA "" VAL_BLK 0x8024A384 ValA_Wu8 17.0000000000 DINH_LimDFCVerb 0.00 17.0000000000 FORMAT "%13.10" MATRIX_DIM 29 /end CHARACTERISTIC
/begin CHARACTERISTIC DINH_Lim.DFC_Com205hChecksum_CA "" VAL_BLK 0x8024A3A1 ValA_Wu8 17.0000000000 DINH_LimDFCVerb 0.00 17.0000000000 FORMAT "%13.10" MATRIX_DIM 26 /end CHARACTERISTIC
/begin CHARACTERISTIC DINH_Lim.DFC_Com205hCounter_CA "" VAL_BLK 0x8024A3BB ValA_Wu8 17.0000000000 DINH_LimDFCVerb 0.00 17.0000000000 FORMAT "%13.10" MATRIX_DIM 26 /end CHARACTERISTIC
/begin CHARACTERISTIC DINH_Lim.DFC_Com205hTooShort_CA "" VAL_BLK 0x8024A3D5 ValA_Wu8 17.0000000000 DINH_LimDFCVerb 0.00 17.0000000000 FORMAT "%13.10" MATRIX_DIM 26 /end CHARACTERISTIC
/begin CHARACTERISTIC DINH_Lim.DFC_Com217hAbsent_CA "" VAL_BLK 0x8024A3EF ValA_Wu8 17.0000000000 DINH_LimDFCVerb 0.00 17.0000000000 FORMAT "%13.10" MATRIX_DIM 20 /end CHARACTERISTIC
/begin CHARACTERISTIC DINH_Lim.DFC_Com217hChecksum_CA "" VAL_BLK 0x8024A403 ValA_Wu8 17.0000000000 DINH_LimDFCVerb 0.00 17.0000000000 FORMAT "%13.10" MATRIX_DIM 15 /end CHARACTERISTIC
/begin CHARACTERISTIC DINH_Lim.DFC_Com217hCounter_CA "" VAL_BLK 0x8024A412 ValA_Wu8 17.0000000000 DINH_LimDFCVerb 0.00 17.0000000000 FORMAT "%13.10" MATRIX_DIM 15 /end CHARACTERISTIC
/begin CHARACTERISTIC DINH_Lim.DFC_Com217hTooShort_CA "" VAL_BLK 0x8024A421 ValA_Wu8 17.0000000000 DINH_LimDFCVerb 0.00 17.0000000000 FORMAT "%13.10" MATRIX_DIM 20 /end CHARACTERISTIC
/begin CHARACTERISTIC DINH_Lim.DFC_Com227hAbsent_CA "" VAL_BLK 0x8024A435 ValA_Wu8 17.0000000000 DINH_LimDFCVerb 0.00 17.0000000000 FORMAT "%13.10" MATRIX_DIM 16 /end CHARACTERISTIC
/begin CHARACTERISTIC DINH_Lim.DFC_Com227hTooShort_CA "" VAL_BLK 0x8024A445 ValA_Wu8 17.0000000000 DINH_LimDFCVerb 0.00 17.0000000000 FORMAT "%13.10" MATRIX_DIM 16 /end CHARACTERISTIC
/begin CHARACTERISTIC DINH_Lim.DFC_Com237hAbsent_CA "" VAL_BLK 0x8024A455 ValA_Wu8 17.0000000000 DINH_LimDFCVerb 0.00 17.0000000000 FORMAT "%13.10" MATRIX_DIM 16 /end CHARACTERISTIC
/begin CHARACTERISTIC DINH_Lim.DFC_Com237hChecksum_CA "" VAL_BLK 0x8024A465 ValA_Wu8 17.0000000000 DINH_LimDFCVerb 0.00 17.0000000000 FORMAT "%13.10" MATRIX_DIM 13 /end CHARACTERISTIC
/begin CHARACTERISTIC DINH_Lim.DFC_Com237hCounter_CA "" VAL_BLK 0x8024A472 ValA_Wu8 17.0000000000 DINH_LimDFCVerb 0.00 17.0000000000 FORMAT "%13.10" MATRIX_DIM 13 /end CHARACTERISTIC
/begin CHARACTERISTIC DINH_Lim.DFC_Com237hTooShort_CA "" VAL_BLK 0x8024A47F ValA_Wu8 17.0000000000 DINH_LimDFCVerb 0.00 17.0000000000 FORMAT "%13.10" MATRIX_DIM 16 /end CHARACTERISTIC
/begin CHARACTERISTIC DINH_Lim.DFC_Com259hAbsent_CA "" VAL_BLK 0x8024A48F ValA_Wu8 17.0000000000 DINH_LimDFCVerb 0.00 17.0000000000 FORMAT "%13.10" MATRIX_DIM 15 /end CHARACTERISTIC
/begin CHARACTERISTIC DINH_Lim.DFC_Com259hChecksum_CA "" VAL_BLK 0x8024A49E ValA_Wu8 17.0000000000 DINH_LimDFCVerb 0.00 17.0000000000 FORMAT "%13.10" MATRIX_DIM 15 /end CHARACTERISTIC
/begin CHARACTERISTIC DINH_Lim.DFC_Com259hCounter_CA "" VAL_BLK 0x8024A4AD ValA_Wu8 17.0000000000 DINH_LimDFCVerb 0.00 17.0000000000 FORMAT "%13.10" MATRIX_DIM 15 /end CHARACTERISTIC
/begin CHARACTERISTIC DINH_Lim.DFC_Com259hTooShort_CA "" VAL_BLK 0x8024A4BC ValA_Wu8 17.0000000000 DINH_LimDFCVerb 0.00 17.0000000000 FORMAT "%13.10" MATRIX_DIM 15 /end CHARACTERISTIC
/begin CHARACTERISTIC DINH_Lim.DFC_Com26hAbsent_CA "" VAL_BLK 0x8024A4CB ValA_Wu8 17.0000000000 DINH_LimDFCVerb 0.00 17.0000000000 FORMAT "%13.10" MATRIX_DIM 13 /end CHARACTERISTIC
/begin CHARACTERISTIC DINH_Lim.DFC_Com26hTooShort_CA "" VAL_BLK 0x8024A4D8 ValA_Wu8 17.0000000000 DINH_LimDFCVerb 0.00 17.0000000000 FORMAT "%13.10" MATRIX_DIM 13 /end CHARACTERISTIC
/begin CHARACTERISTIC DINH_Lim.DFC_Com273hAbsent_CA "" VAL_BLK 0x8024A4E5 ValA_Wu8 17.0000000000 DINH_LimDFCVerb 0.00 17.0000000000 FORMAT "%13.10" MATRIX_DIM 15 /end CHARACTERISTIC
/begin CHARACTERISTIC DINH_Lim.DFC_Com273hChecksum_CA "" VAL_BLK 0x8024A4F4 ValA_Wu8 17.0000000000 DINH_LimDFCVerb 0.00 17.0000000000 FORMAT "%13.10" MATRIX_DIM 13 /end CHARACTERISTIC
/begin CHARACTERISTIC DINH_Lim.DFC_Com273hCounter_CA "" VAL_BLK 0x8024A501 ValA_Wu8 17.0000000000 DINH_LimDFCVerb 0.00 17.0000000000 FORMAT "%13.10" MATRIX_DIM 13 /end CHARACTERISTIC
/begin CHARACTERISTIC DINH_Lim.DFC_Com273hTooShort_CA "" VAL_BLK 0x8024A50E ValA_Wu8 17.0000000000 DINH_LimDFCVerb 0.00 17.0000000000 FORMAT "%13.10" MATRIX_DIM 15 /end CHARACTERISTIC
/begin CHARACTERISTIC DINH_Lim.DFC_Com275hAbsent_CA "" VAL_BLK 0x8024A51D ValA_Wu8 17.0000000000 DINH_LimDFCVerb 0.00 17.0000000000 FORMAT "%13.10" MATRIX_DIM 15 /end CHARACTERISTIC
/begin CHARACTERISTIC DINH_Lim.DFC_Com275hChecksum_CA "" VAL_BLK 0x8024A52C ValA_Wu8 17.0000000000 DINH_LimDFCVerb 0.00 17.0000000000 FORMAT "%13.10" MATRIX_DIM 15 /end CHARACTERISTIC
/begin CHARACTERISTIC DINH_Lim.DFC_Com275hCounter_CA "" VAL_BLK 0x8024A53B ValA_Wu8 17.0000000000 DINH_LimDFCVerb 0.00 17.0000000000 FORMAT "%13.10" MATRIX_DIM 15 /end CHARACTERISTIC
/begin CHARACTERISTIC DINH_Lim.DFC_Com275hTooShort_CA "" VAL_BLK 0x8024A54A ValA_Wu8 17.0000000000 DINH_LimDFCVerb 0.00 17.0000000000 FORMAT "%13.10" MATRIX_DIM 15 /end CHARACTERISTIC
/begin CHARACTERISTIC DINH_Lim.DFC_Com283hAbsent_CA "" VAL_BLK 0x8024A559 ValA_Wu8 17.0000000000 DINH_LimDFCVerb 0.00 17.0000000000 FORMAT "%13.10" MATRIX_DIM 16 /end CHARACTERISTIC
/begin CHARACTERISTIC DINH_Lim.DFC_Com283hTooShort_CA "" VAL_BLK 0x8024A569 ValA_Wu8 17.0000000000 DINH_LimDFCVerb 0.00 17.0000000000 FORMAT "%13.10" MATRIX_DIM 16 /end CHARACTERISTIC
/begin CHARACTERISTIC DINH_Lim.DFC_Com285hAbsent_CA "" VAL_BLK 0x8024A579 ValA_Wu8 17.0000000000 DINH_LimDFCVerb 0.00 17.0000000000 FORMAT "%13.10" MATRIX_DIM 15 /end CHARACTERISTIC
/begin CHARACTERISTIC DINH_Lim.DFC_Com285hChecksum_CA "" VAL_BLK 0x8024A588 ValA_Wu8 17.0000000000 DINH_LimDFCVerb 0.00 17.0000000000 FORMAT "%13.10" MATRIX_DIM 15 /end CHARACTERISTIC
/begin CHARACTERISTIC DINH_Lim.DFC_Com285hCounter_CA "" VAL_BLK 0x8024A597 ValA_Wu8 17.0000000000 DINH_LimDFCVerb 0.00 17.0000000000 FORMAT "%13.10" MATRIX_DIM 15 /end CHARACTERISTIC
/begin CHARACTERISTIC DINH_Lim.DFC_Com285hTooShort_CA "" VAL_BLK 0x8024A5A6 ValA_Wu8 17.0000000000 DINH_LimDFCVerb 0.00 17.0000000000 FORMAT "%13.10" MATRIX_DIM 15 /end CHARACTERISTIC
/begin CHARACTERISTIC DINH_Lim.DFC_Com293hAbsent_CA "" VAL_BLK 0x8024A5B5 ValA_Wu8 17.0000000000 DINH_LimDFCVerb 0.00 17.0000000000 FORMAT "%13.10" MATRIX_DIM 15 /end CHARACTERISTIC
/begin CHARACTERISTIC DINH_Lim.DFC_Com293hChecksum_CA "" VAL_BLK 0x8024A5C4 ValA_Wu8 17.0000000000 DINH_LimDFCVerb 0.00 17.0000000000 FORMAT "%13.10" MATRIX_DIM 13 /end CHARACTERISTIC
/begin CHARACTERISTIC DINH_Lim.DFC_Com293hCounter_CA "" VAL_BLK 0x8024A5D1 ValA_Wu8 17.0000000000 DINH_LimDFCVerb 0.00 17.0000000000 FORMAT "%13.10" MATRIX_DIM 13 /end CHARACTERISTIC
/begin CHARACTERISTIC DINH_Lim.DFC_Com293hTooShort_CA "" VAL_BLK 0x8024A5DE ValA_Wu8 17.0000000000 DINH_LimDFCVerb 0.00 17.0000000000 FORMAT "%13.10" MATRIX_DIM 15 /end CHARACTERISTIC
/begin CHARACTERISTIC DINH_Lim.DFC_Com308hAbsent_CA "" VAL_BLK 0x8024A5ED ValA_Wu8 17.0000000000 DINH_LimDFCVerb 0.00 17.0000000000 FORMAT "%13.10" MATRIX_DIM 16 /end CHARACTERISTIC
/begin CHARACTERISTIC DINH_Lim.DFC_Com308hChecksum_CA "" VAL_BLK 0x8024A5FD ValA_Wu8 17.0000000000 DINH_LimDFCVerb 0.00 17.0000000000 FORMAT "%13.10" MATRIX_DIM 16 /end CHARACTERISTIC
/begin CHARACTERISTIC DINH_Lim.DFC_Com308hCounter_CA "" VAL_BLK 0x8024A60D ValA_Wu8 17.0000000000 DINH_LimDFCVerb 0.00 17.0000000000 FORMAT "%13.10" MATRIX_DIM 16 /end CHARACTERISTIC
/begin CHARACTERISTIC DINH_Lim.DFC_Com308hTooShort_CA "" VAL_BLK 0x8024A61D ValA_Wu8 17.0000000000 DINH_LimDFCVerb 0.00 17.0000000000 FORMAT "%13.10" MATRIX_DIM 16 /end CHARACTERISTIC
/begin CHARACTERISTIC DINH_Lim.DFC_Com318hAbsent_CA "" VAL_BLK 0x8024A62D ValA_Wu8 17.0000000000 DINH_LimDFCVerb 0.00 17.0000000000 FORMAT "%13.10" MATRIX_DIM 16 /end CHARACTERISTIC
/begin CHARACTERISTIC DINH_Lim.DFC_Com318hChecksum_CA "" VAL_BLK 0x8024A63D ValA_Wu8 17.0000000000 DINH_LimDFCVerb 0.00 17.0000000000 FORMAT "%13.10" MATRIX_DIM 16 /end CHARACTERISTIC
/begin CHARACTERISTIC DINH_Lim.DFC_Com318hCounter_CA "" VAL_BLK 0x8024A64D ValA_Wu8 17.0000000000 DINH_LimDFCVerb 0.00 17.0000000000 FORMAT "%13.10" MATRIX_DIM 16 /end CHARACTERISTIC
/begin CHARACTERISTIC DINH_Lim.DFC_Com318hTooShort_CA "" VAL_BLK 0x8024A65D ValA_Wu8 17.0000000000 DINH_LimDFCVerb 0.00 17.0000000000 FORMAT "%13.10" MATRIX_DIM 16 /end CHARACTERISTIC
/begin CHARACTERISTIC DINH_Lim.DFC_Com325hAbsent_CA "" VAL_BLK 0x8024A66D ValA_Wu8 17.0000000000 DINH_LimDFCVerb 0.00 17.0000000000 FORMAT "%13.10" MATRIX_DIM 19 /end CHARACTERISTIC
/begin CHARACTERISTIC DINH_Lim.DFC_Com325hChecksum_CA "" VAL_BLK 0x8024A680 ValA_Wu8 17.0000000000 DINH_LimDFCVerb 0.00 17.0000000000 FORMAT "%13.10" MATRIX_DIM 19 /end CHARACTERISTIC
/begin CHARACTERISTIC DINH_Lim.DFC_Com325hCounter_CA "" VAL_BLK 0x8024A693 ValA_Wu8 17.0000000000 DINH_LimDFCVerb 0.00 17.0000000000 FORMAT "%13.10" MATRIX_DIM 19 /end CHARACTERISTIC
/begin CHARACTERISTIC DINH_Lim.DFC_Com325hTooShort_CA "" VAL_BLK 0x8024A6A6 ValA_Wu8 17.0000000000 DINH_LimDFCVerb 0.00 17.0000000000 FORMAT "%13.10" MATRIX_DIM 19 /end CHARACTERISTIC
/begin CHARACTERISTIC DINH_Lim.DFC_Com335hAbsent_CA "" VAL_BLK 0x8024A6B9 ValA_Wu8 17.0000000000 DINH_LimDFCVerb 0.00 17.0000000000 FORMAT "%13.10" MATRIX_DIM 20 /end CHARACTERISTIC
/begin CHARACTERISTIC DINH_Lim.DFC_Com335hChecksum_CA "" VAL_BLK 0x8024A6CD ValA_Wu8 17.0000000000 DINH_LimDFCVerb 0.00 17.0000000000 FORMAT "%13.10" MATRIX_DIM 19 /end CHARACTERISTIC
/begin CHARACTERISTIC DINH_Lim.DFC_Com335hCounter_CA "" VAL_BLK 0x8024A6E0 ValA_Wu8 17.0000000000 DINH_LimDFCVerb 0.00 17.0000000000 FORMAT "%13.10" MATRIX_DIM 19 /end CHARACTERISTIC
/begin CHARACTERISTIC DINH_Lim.DFC_Com335hTooShort_CA "" VAL_BLK 0x8024A6F3 ValA_Wu8 17.0000000000 DINH_LimDFCVerb 0.00 17.0000000000 FORMAT "%13.10" MATRIX_DIM 20 /end CHARACTERISTIC
/begin CHARACTERISTIC DINH_Lim.DFC_Com351hAbsent_CA "" VAL_BLK 0x8024A707 ValA_Wu8 17.0000000000 DINH_LimDFCVerb 0.00 17.0000000000 FORMAT "%13.10" MATRIX_DIM 16 /end CHARACTERISTIC
/begin CHARACTERISTIC DINH_Lim.DFC_Com351hTooShort_CA "" VAL_BLK 0x8024A717 ValA_Wu8 17.0000000000 DINH_LimDFCVerb 0.00 17.0000000000 FORMAT "%13.10" MATRIX_DIM 16 /end CHARACTERISTIC
/begin CHARACTERISTIC DINH_Lim.DFC_Com38DhAbsent_CA "" VAL_BLK 0x8024A727 ValA_Wu8 17.0000000000 DINH_LimDFCVerb 0.00 17.0000000000 FORMAT "%13.10" MATRIX_DIM 22 /end CHARACTERISTIC
/begin CHARACTERISTIC DINH_Lim.DFC_Com38DhChecksum_CA "" VAL_BLK 0x8024A73D ValA_Wu8 17.0000000000 DINH_LimDFCVerb 0.00 17.0000000000 FORMAT "%13.10" MATRIX_DIM 18 /end CHARACTERISTIC
/begin CHARACTERISTIC DINH_Lim.DFC_Com38DhCounter_CA "" VAL_BLK 0x8024A74F ValA_Wu8 17.0000000000 DINH_LimDFCVerb 0.00 17.0000000000 FORMAT "%13.10" MATRIX_DIM 18 /end CHARACTERISTIC
/begin CHARACTERISTIC DINH_Lim.DFC_Com38DhTooShort_CA "" VAL_BLK 0x8024A761 ValA_Wu8 17.0000000000 DINH_LimDFCVerb 0.00 17.0000000000 FORMAT "%13.10" MATRIX_DIM 23 /end CHARACTERISTIC
/begin CHARACTERISTIC DINH_Lim.DFC_Com412hAbsent_CA "" VAL_BLK 0x8024A778 ValA_Wu8 17.0000000000 DINH_LimDFCVerb 0.00 17.0000000000 FORMAT "%13.10" MATRIX_DIM 20 /end CHARACTERISTIC
/begin CHARACTERISTIC DINH_Lim.DFC_Com412hChecksum_CA "" VAL_BLK 0x8024A78C ValA_Wu8 17.0000000000 DINH_LimDFCVerb 0.00 17.0000000000 FORMAT "%13.10" MATRIX_DIM 16 /end CHARACTERISTIC
/begin CHARACTERISTIC DINH_Lim.DFC_Com412hCounter_CA "" VAL_BLK 0x8024A79C ValA_Wu8 17.0000000000 DINH_LimDFCVerb 0.00 17.0000000000 FORMAT "%13.10" MATRIX_DIM 16 /end CHARACTERISTIC
/begin CHARACTERISTIC DINH_Lim.DFC_Com412hTooShort_CA "" VAL_BLK 0x8024A7AC ValA_Wu8 17.0000000000 DINH_LimDFCVerb 0.00 17.0000000000 FORMAT "%13.10" MATRIX_DIM 20 /end CHARACTERISTIC
/begin CHARACTERISTIC DINH_Lim.DFC_Com427hAbsent_CA "" VAL_BLK 0x8024A7C0 ValA_Wu8 17.0000000000 DINH_LimDFCVerb 0.00 17.0000000000 FORMAT "%13.10" MATRIX_DIM 20 /end CHARACTERISTIC
/begin CHARACTERISTIC DINH_Lim.DFC_Com427hTooShort_CA "" VAL_BLK 0x8024A7D4 ValA_Wu8 17.0000000000 DINH_LimDFCVerb 0.00 17.0000000000 FORMAT "%13.10" MATRIX_DIM 20 /end CHARACTERISTIC
/begin CHARACTERISTIC DINH_Lim.DFC_Com432hAbsent_CA "" VAL_BLK 0x8024A7E8 ValA_Wu8 17.0000000000 DINH_LimDFCVerb 0.00 17.0000000000 FORMAT "%13.10" MATRIX_DIM 16 /end CHARACTERISTIC
/begin CHARACTERISTIC DINH_Lim.DFC_Com432hChecksum_CA "" VAL_BLK 0x8024A7F8 ValA_Wu8 17.0000000000 DINH_LimDFCVerb 0.00 17.0000000000 FORMAT "%13.10" MATRIX_DIM 15 /end CHARACTERISTIC
/begin CHARACTERISTIC DINH_Lim.DFC_Com432hCounter_CA "" VAL_BLK 0x8024A807 ValA_Wu8 17.0000000000 DINH_LimDFCVerb 0.00 17.0000000000 FORMAT "%13.10" MATRIX_DIM 15 /end CHARACTERISTIC
/begin CHARACTERISTIC DINH_Lim.DFC_Com432hTooShort_CA "" VAL_BLK 0x8024A816 ValA_Wu8 17.0000000000 DINH_LimDFCVerb 0.00 17.0000000000 FORMAT "%13.10" MATRIX_DIM 15 /end CHARACTERISTIC
/begin CHARACTERISTIC DINH_Lim.DFC_Com435hAbsent_CA "" VAL_BLK 0x8024A825 ValA_Wu8 17.0000000000 DINH_LimDFCVerb 0.00 17.0000000000 FORMAT "%13.10" MATRIX_DIM 19 /end CHARACTERISTIC
/begin CHARACTERISTIC DINH_Lim.DFC_Com435hTooShort_CA "" VAL_BLK 0x8024A838 ValA_Wu8 17.0000000000 DINH_LimDFCVerb 0.00 17.0000000000 FORMAT "%13.10" MATRIX_DIM 19 /end CHARACTERISTIC
/begin CHARACTERISTIC DINH_Lim.DFC_Com442hAbsent_CA "" VAL_BLK 0x8024A84B ValA_Wu8 17.0000000000 DINH_LimDFCVerb 0.00 17.0000000000 FORMAT "%13.10" MATRIX_DIM 16 /end CHARACTERISTIC
/begin CHARACTERISTIC DINH_Lim.DFC_Com442hTooShort_CA "" VAL_BLK 0x8024A85B ValA_Wu8 17.0000000000 DINH_LimDFCVerb 0.00 17.0000000000 FORMAT "%13.10" MATRIX_DIM 16 /end CHARACTERISTIC
/begin CHARACTERISTIC DINH_Lim.DFC_Com453hAbsent_CA "" VAL_BLK 0x8024A86B ValA_Wu8 17.0000000000 DINH_LimDFCVerb 0.00 17.0000000000 FORMAT "%13.10" MATRIX_DIM 24 /end CHARACTERISTIC
/begin CHARACTERISTIC DINH_Lim.DFC_Com453hTooShort_CA "" VAL_BLK 0x8024A883 ValA_Wu8 17.0000000000 DINH_LimDFCVerb 0.00 17.0000000000 FORMAT "%13.10" MATRIX_DIM 24 /end CHARACTERISTIC
/begin CHARACTERISTIC DINH_Lim.DFC_Com455hAbsent_CA "" VAL_BLK 0x8024A89B ValA_Wu8 17.0000000000 DINH_LimDFCVerb 0.00 17.0000000000 FORMAT "%13.10" MATRIX_DIM 18 /end CHARACTERISTIC
/begin CHARACTERISTIC DINH_Lim.DFC_Com455hTooShort_CA "" VAL_BLK 0x8024A8AD ValA_Wu8 17.0000000000 DINH_LimDFCVerb 0.00 17.0000000000 FORMAT "%13.10" MATRIX_DIM 18 /end CHARACTERISTIC
/begin CHARACTERISTIC DINH_Lim.DFC_Com463hAbsent_CA "" VAL_BLK 0x8024A8BF ValA_Wu8 17.0000000000 DINH_LimDFCVerb 0.00 17.0000000000 FORMAT "%13.10" MATRIX_DIM 18 /end CHARACTERISTIC
/begin CHARACTERISTIC DINH_Lim.DFC_Com463hTooShort_CA "" VAL_BLK 0x8024A8D1 ValA_Wu8 17.0000000000 DINH_LimDFCVerb 0.00 17.0000000000 FORMAT "%13.10" MATRIX_DIM 18 /end CHARACTERISTIC
/begin CHARACTERISTIC DINH_Lim.DFC_Com473hAbsent_CA "" VAL_BLK 0x8024A8E3 ValA_Wu8 17.0000000000 DINH_LimDFCVerb 0.00 17.0000000000 FORMAT "%13.10" MATRIX_DIM 17 /end CHARACTERISTIC
/begin CHARACTERISTIC DINH_Lim.DFC_Com473hTooShort_CA "" VAL_BLK 0x8024A8F4 ValA_Wu8 17.0000000000 DINH_LimDFCVerb 0.00 17.0000000000 FORMAT "%13.10" MATRIX_DIM 17 /end CHARACTERISTIC
/begin CHARACTERISTIC DINH_Lim.DFC_Com47BhAbsent_CA "" VAL_BLK 0x8024A905 ValA_Wu8 17.0000000000 DINH_LimDFCVerb 0.00 17.0000000000 FORMAT "%13.10" MATRIX_DIM 17 /end CHARACTERISTIC
/begin CHARACTERISTIC DINH_Lim.DFC_Com47BhTooShort_CA "" VAL_BLK 0x8024A916 ValA_Wu8 17.0000000000 DINH_LimDFCVerb 0.00 17.0000000000 FORMAT "%13.10" MATRIX_DIM 17 /end CHARACTERISTIC
/begin CHARACTERISTIC DINH_Lim.DFC_Com48BhAbsent_CA "" VAL_BLK 0x8024A927 ValA_Wu8 17.0000000000 DINH_LimDFCVerb 0.00 17.0000000000 FORMAT "%13.10" MATRIX_DIM 15 /end CHARACTERISTIC
/begin CHARACTERISTIC DINH_Lim.DFC_Com48BhTooShort_CA "" VAL_BLK 0x8024A936 ValA_Wu8 17.0000000000 DINH_LimDFCVerb 0.00 17.0000000000 FORMAT "%13.10" MATRIX_DIM 15 /end CHARACTERISTIC
/begin CHARACTERISTIC DINH_Lim.DFC_Com497hTooShort_CA "" VAL_BLK 0x8024A945 ValA_Wu8 17.0000000000 DINH_LimDFCVerb 0.00 17.0000000000 FORMAT "%13.10" MATRIX_DIM 15 /end CHARACTERISTIC
/begin CHARACTERISTIC DINH_Lim.DFC_Com4F2hAbsent_CA "" VAL_BLK 0x8024A954 ValA_Wu8 17.0000000000 DINH_LimDFCVerb 0.00 17.0000000000 FORMAT "%13.10" MATRIX_DIM 15 /end CHARACTERISTIC
/begin CHARACTERISTIC DINH_Lim.DFC_Com4F2hChecksum_CA "" VAL_BLK 0x8024A963 ValA_Wu8 17.0000000000 DINH_LimDFCVerb 0.00 17.0000000000 FORMAT "%13.10" MATRIX_DIM 15 /end CHARACTERISTIC
/begin CHARACTERISTIC DINH_Lim.DFC_Com4F2hCounter_CA "" VAL_BLK 0x8024A972 ValA_Wu8 17.0000000000 DINH_LimDFCVerb 0.00 17.0000000000 FORMAT "%13.10" MATRIX_DIM 15 /end CHARACTERISTIC
/begin CHARACTERISTIC DINH_Lim.DFC_Com4F2hTooShort_CA "" VAL_BLK 0x8024A981 ValA_Wu8 17.0000000000 DINH_LimDFCVerb 0.00 17.0000000000 FORMAT "%13.10" MATRIX_DIM 15 /end CHARACTERISTIC
/begin CHARACTERISTIC DINH_Lim.DFC_Com50DhAbsent_CA "" VAL_BLK 0x8024A990 ValA_Wu8 17.0000000000 DINH_LimDFCVerb 0.00 17.0000000000 FORMAT "%13.10" MATRIX_DIM 15 /end CHARACTERISTIC
/begin CHARACTERISTIC DINH_Lim.DFC_Com50DhTooShort_CA "" VAL_BLK 0x8024A99F ValA_Wu8 17.0000000000 DINH_LimDFCVerb 0.00 17.0000000000 FORMAT "%13.10" MATRIX_DIM 15 /end CHARACTERISTIC
/begin CHARACTERISTIC DINH_Lim.DFC_Com535hAbsent_CA "" VAL_BLK 0x8024A9AE ValA_Wu8 17.0000000000 DINH_LimDFCVerb 0.00 17.0000000000 FORMAT "%13.10" MATRIX_DIM 22 /end CHARACTERISTIC
/begin CHARACTERISTIC DINH_Lim.DFC_Com535hTooShort_CA "" VAL_BLK 0x8024A9C4 ValA_Wu8 17.0000000000 DINH_LimDFCVerb 0.00 17.0000000000 FORMAT "%13.10" MATRIX_DIM 22 /end CHARACTERISTIC
/begin CHARACTERISTIC DINH_Lim.DFC_Com543hAbsent_CA "" VAL_BLK 0x8024A9DA ValA_Wu8 17.0000000000 DINH_LimDFCVerb 0.00 17.0000000000 FORMAT "%13.10" MATRIX_DIM 19 /end CHARACTERISTIC
/begin CHARACTERISTIC DINH_Lim.DFC_Com543hTooShort_CA "" VAL_BLK 0x8024A9ED ValA_Wu8 17.0000000000 DINH_LimDFCVerb 0.00 17.0000000000 FORMAT "%13.10" MATRIX_DIM 19 /end CHARACTERISTIC
/begin CHARACTERISTIC DINH_Lim.DFC_Com552hAbsent_CA "" VAL_BLK 0x8024AA00 ValA_Wu8 17.0000000000 DINH_LimDFCVerb 0.00 17.0000000000 FORMAT "%13.10" MATRIX_DIM 15 /end CHARACTERISTIC
/begin CHARACTERISTIC DINH_Lim.DFC_Com552hTooShort_CA "" VAL_BLK 0x8024AA0F ValA_Wu8 17.0000000000 DINH_LimDFCVerb 0.00 17.0000000000 FORMAT "%13.10" MATRIX_DIM 15 /end CHARACTERISTIC
/begin CHARACTERISTIC DINH_Lim.DFC_Com583hAbsent_CA "" VAL_BLK 0x8024AA1E ValA_Wu8 17.0000000000 DINH_LimDFCVerb 0.00 17.0000000000 FORMAT "%13.10" MATRIX_DIM 16 /end CHARACTERISTIC
/begin CHARACTERISTIC DINH_Lim.DFC_Com583hTooShort_CA "" VAL_BLK 0x8024AA2E ValA_Wu8 17.0000000000 DINH_LimDFCVerb 0.00 17.0000000000 FORMAT "%13.10" MATRIX_DIM 16 /end CHARACTERISTIC
/begin CHARACTERISTIC DINH_Lim.DFC_Com592hAbsent_CA "" VAL_BLK 0x8024AA3E ValA_Wu8 17.0000000000 DINH_LimDFCVerb 0.00 17.0000000000 FORMAT "%13.10" MATRIX_DIM 15 /end CHARACTERISTIC
/begin CHARACTERISTIC DINH_Lim.DFC_Com592hChecksum_CA "" VAL_BLK 0x8024AA4D ValA_Wu8 17.0000000000 DINH_LimDFCVerb 0.00 17.0000000000 FORMAT "%13.10" MATRIX_DIM 15 /end CHARACTERISTIC
/begin CHARACTERISTIC DINH_Lim.DFC_Com592hCounter_CA "" VAL_BLK 0x8024AA5C ValA_Wu8 17.0000000000 DINH_LimDFCVerb 0.00 17.0000000000 FORMAT "%13.10" MATRIX_DIM 15 /end CHARACTERISTIC
/begin CHARACTERISTIC DINH_Lim.DFC_Com592hTooShort_CA "" VAL_BLK 0x8024AA6B ValA_Wu8 17.0000000000 DINH_LimDFCVerb 0.00 17.0000000000 FORMAT "%13.10" MATRIX_DIM 15 /end CHARACTERISTIC
/begin CHARACTERISTIC DINH_Lim.DFC_Com595hAbsent_CA "" VAL_BLK 0x8024AA7A ValA_Wu8 17.0000000000 DINH_LimDFCVerb 0.00 17.0000000000 FORMAT "%13.10" MATRIX_DIM 15 /end CHARACTERISTIC
/begin CHARACTERISTIC DINH_Lim.DFC_Com595hChecksum_CA "" VAL_BLK 0x8024AA89 ValA_Wu8 17.0000000000 DINH_LimDFCVerb 0.00 17.0000000000 FORMAT "%13.10" MATRIX_DIM 15 /end CHARACTERISTIC
/begin CHARACTERISTIC DINH_Lim.DFC_Com595hCounter_CA "" VAL_BLK 0x8024AA98 ValA_Wu8 17.0000000000 DINH_LimDFCVerb 0.00 17.0000000000 FORMAT "%13.10" MATRIX_DIM 15 /end CHARACTERISTIC
/begin CHARACTERISTIC DINH_Lim.DFC_Com595hTooShort_CA "" VAL_BLK 0x8024AAA7 ValA_Wu8 17.0000000000 DINH_LimDFCVerb 0.00 17.0000000000 FORMAT "%13.10" MATRIX_DIM 15 /end CHARACTERISTIC
/begin CHARACTERISTIC DINH_Lim.DFC_Com5B2hAbsent_CA "" VAL_BLK 0x8024AAB6 ValA_Wu8 17.0000000000 DINH_LimDFCVerb 0.00 17.0000000000 FORMAT "%13.10" MATRIX_DIM 15 /end CHARACTERISTIC
/begin CHARACTERISTIC DINH_Lim.DFC_Com5B2hTooShort_CA "" VAL_BLK 0x8024AAC5 ValA_Wu8 17.0000000000 DINH_LimDFCVerb 0.00 17.0000000000 FORMAT "%13.10" MATRIX_DIM 15 /end CHARACTERISTIC
/begin CHARACTERISTIC DINH_Lim.DFC_Com5B5hAbsent_CA "" VAL_BLK 0x8024AAD4 ValA_Wu8 17.0000000000 DINH_LimDFCVerb 0.00 17.0000000000 FORMAT "%13.10" MATRIX_DIM 16 /end CHARACTERISTIC
/begin CHARACTERISTIC DINH_Lim.DFC_Com5B5hChecksum_CA "" VAL_BLK 0x8024AAE4 ValA_Wu8 17.0000000000 DINH_LimDFCVerb 0.00 17.0000000000 FORMAT "%13.10" MATRIX_DIM 16 /end CHARACTERISTIC
/begin CHARACTERISTIC DINH_Lim.DFC_Com5B5hCounter_CA "" VAL_BLK 0x8024AAF4 ValA_Wu8 17.0000000000 DINH_LimDFCVerb 0.00 17.0000000000 FORMAT "%13.10" MATRIX_DIM 16 /end CHARACTERISTIC
/begin CHARACTERISTIC DINH_Lim.DFC_Com5B5hTooShort_CA "" VAL_BLK 0x8024AB04 ValA_Wu8 17.0000000000 DINH_LimDFCVerb 0.00 17.0000000000 FORMAT "%13.10" MATRIX_DIM 16 /end CHARACTERISTIC
/begin CHARACTERISTIC DINH_Lim.DFC_Com5C7hTooShort_CA "" VAL_BLK 0x8024AB14 ValA_Wu8 17.0000000000 DINH_LimDFCVerb 0.00 17.0000000000 FORMAT "%13.10" MATRIX_DIM 16 /end CHARACTERISTIC
/begin CHARACTERISTIC DINH_Lim.DFC_Com5E7hAbsent_CA "" VAL_BLK 0x8024AB24 ValA_Wu8 17.0000000000 DINH_LimDFCVerb 0.00 17.0000000000 FORMAT "%13.10" MATRIX_DIM 15 /end CHARACTERISTIC
/begin CHARACTERISTIC DINH_Lim.DFC_Com5E7hTooShort_CA "" VAL_BLK 0x8024AB33 ValA_Wu8 17.0000000000 DINH_LimDFCVerb 0.00 17.0000000000 FORMAT "%13.10" MATRIX_DIM 15 /end CHARACTERISTIC
/begin CHARACTERISTIC DINH_Lim.DFC_Com635hTooShort_CA "" VAL_BLK 0x8024AB42 ValA_Wu8 17.0000000000 DINH_LimDFCVerb 0.00 17.0000000000 FORMAT "%13.10" MATRIX_DIM 15 /end CHARACTERISTIC
/begin CHARACTERISTIC DINH_Lim.DFC_Com645hTooShort_CA "" VAL_BLK 0x8024AB51 ValA_Wu8 17.0000000000 DINH_LimDFCVerb 0.00 17.0000000000 FORMAT "%13.10" MATRIX_DIM 15 /end CHARACTERISTIC
/begin CHARACTERISTIC DINH_Lim.DFC_Com663hAbsent_CA "" VAL_BLK 0x8024AB60 ValA_Wu8 17.0000000000 DINH_LimDFCVerb 0.00 17.0000000000 FORMAT "%13.10" MATRIX_DIM 15 /end CHARACTERISTIC
/begin CHARACTERISTIC DINH_Lim.DFC_Com663hTooShort_CA "" VAL_BLK 0x8024AB6F ValA_Wu8 17.0000000000 DINH_LimDFCVerb 0.00 17.0000000000 FORMAT "%13.10" MATRIX_DIM 15 /end CHARACTERISTIC
/begin CHARACTERISTIC DINH_Lim.DFC_Com665hAbsent_CA "" VAL_BLK 0x8024AB7E ValA_Wu8 17.0000000000 DINH_LimDFCVerb 0.00 17.0000000000 FORMAT "%13.10" MATRIX_DIM 18 /end CHARACTERISTIC
/begin CHARACTERISTIC DINH_Lim.DFC_Com665hTooShort_CA "" VAL_BLK 0x8024AB90 ValA_Wu8 17.0000000000 DINH_LimDFCVerb 0.00 17.0000000000 FORMAT "%13.10" MATRIX_DIM 18 /end CHARACTERISTIC
/begin CHARACTERISTIC DINH_Lim.DFC_Com675hAbsent_CA "" VAL_BLK 0x8024ABA2 ValA_Wu8 17.0000000000 DINH_LimDFCVerb 0.00 17.0000000000 FORMAT "%13.10" MATRIX_DIM 16 /end CHARACTERISTIC
/begin CHARACTERISTIC DINH_Lim.DFC_Com675hTooShort_CA "" VAL_BLK 0x8024ABB2 ValA_Wu8 17.0000000000 DINH_LimDFCVerb 0.00 17.0000000000 FORMAT "%13.10" MATRIX_DIM 16 /end CHARACTERISTIC
/begin CHARACTERISTIC DINH_Lim.DFC_ComFrbd_205h_HVBAT_PACK_CURRENT_CA "" VAL_BLK 0x8024ABC2 ValA_Wu8 17.0000000000 DINH_LimDFCVerb 0.00 17.0000000000 FORMAT "%13.10" MATRIX_DIM 18 /end CHARACTERISTIC
/begin CHARACTERISTIC DINH_Lim.DFC_ComFrbd_205h_HVBAT_SOC_DISPLAY_CA "" VAL_BLK 0x8024ABD4 ValA_Wu8 17.0000000000 DINH_LimDFCVerb 0.00 17.0000000000 FORMAT "%13.10" MATRIX_DIM 18 /end CHARACTERISTIC
/begin CHARACTERISTIC DINH_Lim.DFC_ComFrbd_205h_HVBAT_VOLTAGE_CA "" VAL_BLK 0x8024ABE6 ValA_Wu8 17.0000000000 DINH_LimDFCVerb 0.00 17.0000000000 FORMAT "%13.10" MATRIX_DIM 19 /end CHARACTERISTIC
/begin CHARACTERISTIC DINH_Lim.DFC_ComFrbd_217h_INV_DC_BUS_VOLTAGE_CA "" VAL_BLK 0x8024ABF9 ValA_Wu8 17.0000000000 DINH_LimDFCVerb 0.00 17.0000000000 FORMAT "%13.10" MATRIX_DIM 16 /end CHARACTERISTIC
/begin CHARACTERISTIC DINH_Lim.DFC_ComFrbd_217h_INV_MTR_ACTUAL_TRQ_CA "" VAL_BLK 0x8024AC09 ValA_Wu8 17.0000000000 DINH_LimDFCVerb 0.00 17.0000000000 FORMAT "%13.10" MATRIX_DIM 15 /end CHARACTERISTIC
/begin CHARACTERISTIC DINH_Lim.DFC_ComFrbd_217h_INV_MTR_SPEED_CA "" VAL_BLK 0x8024AC18 ValA_Wu8 17.0000000000 DINH_LimDFCVerb 0.00 17.0000000000 FORMAT "%13.10" MATRIX_DIM 16 /end CHARACTERISTIC
/begin CHARACTERISTIC DINH_Lim.DFC_ComFrbd_217h_INV_MTR_TRQ_CA "" VAL_BLK 0x8024AC28 ValA_Wu8 17.0000000000 DINH_LimDFCVerb 0.00 17.0000000000 FORMAT "%13.10" MATRIX_DIM 15 /end CHARACTERISTIC
/begin CHARACTERISTIC DINH_Lim.DFC_ComFrbd_227h_INV_DC_CURRENT_CA "" VAL_BLK 0x8024AC37 ValA_Wu8 17.0000000000 DINH_LimDFCVerb 0.00 17.0000000000 FORMAT "%13.10" MATRIX_DIM 15 /end CHARACTERISTIC
/begin CHARACTERISTIC DINH_Lim.DFC_ComFrbd_227h_INV_MOTORING_PEAK_TRQ_CA "" VAL_BLK 0x8024AC46 ValA_Wu8 17.0000000000 DINH_LimDFCVerb 0.00 17.0000000000 FORMAT "%13.10" MATRIX_DIM 17 /end CHARACTERISTIC
/begin CHARACTERISTIC DINH_Lim.DFC_ComFrbd_227h_INV_MTR_INST_INPUT_POWER_CA "" VAL_BLK 0x8024AC57 ValA_Wu8 17.0000000000 DINH_LimDFCVerb 0.00 17.0000000000 FORMAT "%13.10" MATRIX_DIM 15 /end CHARACTERISTIC
/begin CHARACTERISTIC DINH_Lim.DFC_ComFrbd_227h_INV_REGEN_PEAK_TRQ_CA "" VAL_BLK 0x8024AC66 ValA_Wu8 17.0000000000 DINH_LimDFCVerb 0.00 17.0000000000 FORMAT "%13.10" MATRIX_DIM 17 /end CHARACTERISTIC
/begin CHARACTERISTIC DINH_Lim.DFC_ComFrbd_237h_INV_ACTIVE_DISCHARGE_STATUS_CA "" VAL_BLK 0x8024AC77 ValA_Wu8 17.0000000000 DINH_LimDFCVerb 0.00 17.0000000000 FORMAT "%13.10" MATRIX_DIM 15 /end CHARACTERISTIC
/begin CHARACTERISTIC DINH_Lim.DFC_ComFrbd_237h_INV_CTRL_MODE_ACK_CA "" VAL_BLK 0x8024AC86 ValA_Wu8 17.0000000000 DINH_LimDFCVerb 0.00 17.0000000000 FORMAT "%13.10" MATRIX_DIM 15 /end CHARACTERISTIC
/begin CHARACTERISTIC DINH_Lim.DFC_ComFrbd_237h_INV_EV_WARNING_CA "" VAL_BLK 0x8024AC95 ValA_Wu8 17.0000000000 DINH_LimDFCVerb 0.00 17.0000000000 FORMAT "%13.10" MATRIX_DIM 15 /end CHARACTERISTIC
/begin CHARACTERISTIC DINH_Lim.DFC_ComFrbd_237h_INV_FAULT_LEVEL_CA "" VAL_BLK 0x8024ACA4 ValA_Wu8 17.0000000000 DINH_LimDFCVerb 0.00 17.0000000000 FORMAT "%13.10" MATRIX_DIM 15 /end CHARACTERISTIC
/begin CHARACTERISTIC DINH_Lim.DFC_ComFrbd_237h_INV_MASTER_STOP_CA "" VAL_BLK 0x8024ACB3 ValA_Wu8 17.0000000000 DINH_LimDFCVerb 0.00 17.0000000000 FORMAT "%13.10" MATRIX_DIM 15 /end CHARACTERISTIC
/begin CHARACTERISTIC DINH_Lim.DFC_ComFrbd_237h_INV_SERVICE_DUE_CA "" VAL_BLK 0x8024ACC2 ValA_Wu8 17.0000000000 DINH_LimDFCVerb 0.00 17.0000000000 FORMAT "%13.10" MATRIX_DIM 15 /end CHARACTERISTIC
/begin CHARACTERISTIC DINH_Lim.DFC_ComFrbd_237h_INV_STAB_MIN_TRQ_CA "" VAL_BLK 0x8024ACD1 ValA_Wu8 17.0000000000 DINH_LimDFCVerb 0.00 17.0000000000 FORMAT "%13.10" MATRIX_DIM 15 /end CHARACTERISTIC
/begin CHARACTERISTIC DINH_Lim.DFC_ComFrbd_259h_TGLM_FAILURE_STATE_CA "" VAL_BLK 0x8024ACE0 ValA_Wu8 17.0000000000 DINH_LimDFCVerb 0.00 17.0000000000 FORMAT "%13.10" MATRIX_DIM 15 /end CHARACTERISTIC
/begin CHARACTERISTIC DINH_Lim.DFC_ComFrbd_259h_TGLM_MODE_PUSH_CA "" VAL_BLK 0x8024ACEF ValA_Wu8 17.0000000000 DINH_LimDFCVerb 0.00 17.0000000000 FORMAT "%13.10" MATRIX_DIM 15 /end CHARACTERISTIC
/begin CHARACTERISTIC DINH_Lim.DFC_ComFrbd_259h_TOGGLE_MONOSTABLE_POS_CA "" VAL_BLK 0x8024ACFE ValA_Wu8 17.0000000000 DINH_LimDFCVerb 0.00 17.0000000000 FORMAT "%13.10" MATRIX_DIM 15 /end CHARACTERISTIC
/begin CHARACTERISTIC DINH_Lim.DFC_ComFrbd_273h_OBC_outputpower_capability_CA "" VAL_BLK 0x8024AD0D ValA_Wu8 17.0000000000 DINH_LimDFCVerb 0.00 17.0000000000 FORMAT "%13.10" MATRIX_DIM 15 /end CHARACTERISTIC
/begin CHARACTERISTIC DINH_Lim.DFC_ComFrbd_275h_HVBAT_DISCHARGE_30S_AVAILABLE_CURRENT_CA "" VAL_BLK 0x8024AD1C ValA_Wu8 17.0000000000 DINH_LimDFCVerb 0.00 17.0000000000 FORMAT "%13.10" MATRIX_DIM 15 /end CHARACTERISTIC
/begin CHARACTERISTIC DINH_Lim.DFC_ComFrbd_275h_HVBAT_DISCHARGE_30S_AVAILABLE_POWER_CA "" VAL_BLK 0x8024AD2B ValA_Wu8 17.0000000000 DINH_LimDFCVerb 0.00 17.0000000000 FORMAT "%13.10" MATRIX_DIM 15 /end CHARACTERISTIC
/begin CHARACTERISTIC DINH_Lim.DFC_ComFrbd_283h_DCDC_IN_CURRENT_CA "" VAL_BLK 0x8024AD3A ValA_Wu8 17.0000000000 DINH_LimDFCVerb 0.00 17.0000000000 FORMAT "%13.10" MATRIX_DIM 15 /end CHARACTERISTIC
/begin CHARACTERISTIC DINH_Lim.DFC_ComFrbd_283h_DCDC_IN_VOLTAGE_CA "" VAL_BLK 0x8024AD49 ValA_Wu8 17.0000000000 DINH_LimDFCVerb 0.00 17.0000000000 FORMAT "%13.10" MATRIX_DIM 15 /end CHARACTERISTIC
/begin CHARACTERISTIC DINH_Lim.DFC_ComFrbd_283h_DCDC_OUT_CURRENT_CA "" VAL_BLK 0x8024AD58 ValA_Wu8 17.0000000000 DINH_LimDFCVerb 0.00 17.0000000000 FORMAT "%13.10" MATRIX_DIM 15 /end CHARACTERISTIC
/begin CHARACTERISTIC DINH_Lim.DFC_ComFrbd_283h_DCDC_OUT_VOLTAGE_CA "" VAL_BLK 0x8024AD67 ValA_Wu8 17.0000000000 DINH_LimDFCVerb 0.00 17.0000000000 FORMAT "%13.10" MATRIX_DIM 15 /end CHARACTERISTIC
/begin CHARACTERISTIC DINH_Lim.DFC_ComFrbd_285h_HVBAT_REGEN_CHG_30S_CURRENT_LIMIT_CA "" VAL_BLK 0x8024AD76 ValA_Wu8 17.0000000000 DINH_LimDFCVerb 0.00 17.0000000000 FORMAT "%13.10" MATRIX_DIM 15 /end CHARACTERISTIC
/begin CHARACTERISTIC DINH_Lim.DFC_ComFrbd_285h_HVBAT_REGEN_CHRG_30S_POWER_LIMIT_CA "" VAL_BLK 0x8024AD85 ValA_Wu8 17.0000000000 DINH_LimDFCVerb 0.00 17.0000000000 FORMAT "%13.10" MATRIX_DIM 15 /end CHARACTERISTIC
/begin CHARACTERISTIC DINH_Lim.DFC_ComFrbd_293h_DCDC_outputpower_capability_CA "" VAL_BLK 0x8024AD94 ValA_Wu8 17.0000000000 DINH_LimDFCVerb 0.00 17.0000000000 FORMAT "%13.10" MATRIX_DIM 15 /end CHARACTERISTIC
/begin CHARACTERISTIC DINH_Lim.DFC_ComFrbd_325h_HVBAT_INSULATION_RESISTANCE_CA "" VAL_BLK 0x8024ADA3 ValA_Wu8 17.0000000000 DINH_LimDFCVerb 0.00 17.0000000000 FORMAT "%13.10" MATRIX_DIM 15 /end CHARACTERISTIC
/begin CHARACTERISTIC DINH_Lim.DFC_ComFrbd_325h_HVBAT_TEMPERATURE_CA "" VAL_BLK 0x8024ADB2 ValA_Wu8 17.0000000000 DINH_LimDFCVerb 0.00 17.0000000000 FORMAT "%13.10" MATRIX_DIM 15 /end CHARACTERISTIC
/begin CHARACTERISTIC DINH_Lim.DFC_ComFrbd_335h_HVBAT_CHRG_CONTINUOUS_CURR_MAX_CA "" VAL_BLK 0x8024ADC1 ValA_Wu8 17.0000000000 DINH_LimDFCVerb 0.00 17.0000000000 FORMAT "%13.10" MATRIX_DIM 15 /end CHARACTERISTIC
/begin CHARACTERISTIC DINH_Lim.DFC_ComFrbd_335h_HVBAT_CHRG_COTINUOUS_CURR_REQ_CA "" VAL_BLK 0x8024ADD0 ValA_Wu8 17.0000000000 DINH_LimDFCVerb 0.00 17.0000000000 FORMAT "%13.10" MATRIX_DIM 18 /end CHARACTERISTIC
/begin CHARACTERISTIC DINH_Lim.DFC_ComFrbd_335h_HVBAT_CHRG_MAX_VOLT_CA "" VAL_BLK 0x8024ADE2 ValA_Wu8 17.0000000000 DINH_LimDFCVerb 0.00 17.0000000000 FORMAT "%13.10" MATRIX_DIM 18 /end CHARACTERISTIC
/begin CHARACTERISTIC DINH_Lim.DFC_ComFrbd_335h_HVBAT_DC_BUS_VOLTAGE_CA "" VAL_BLK 0x8024ADF4 ValA_Wu8 17.0000000000 DINH_LimDFCVerb 0.00 17.0000000000 FORMAT "%13.10" MATRIX_DIM 16 /end CHARACTERISTIC
/begin CHARACTERISTIC DINH_Lim.DFC_ComFrbd_427h_INV_OP_MODE_CA "" VAL_BLK 0x8024AE04 ValA_Wu8 17.0000000000 DINH_LimDFCVerb 0.00 17.0000000000 FORMAT "%13.10" MATRIX_DIM 15 /end CHARACTERISTIC
/begin CHARACTERISTIC DINH_Lim.DFC_ComFrbd_427h_INV_PERMISIBLE_TORQUE_CA "" VAL_BLK 0x8024AE13 ValA_Wu8 17.0000000000 DINH_LimDFCVerb 0.00 17.0000000000 FORMAT "%13.10" MATRIX_DIM 15 /end CHARACTERISTIC
/begin CHARACTERISTIC DINH_Lim.DFC_ComFrbd_435h_HVBAT_MAX_CELL_VOLT_CA "" VAL_BLK 0x8024AE22 ValA_Wu8 17.0000000000 DINH_LimDFCVerb 0.00 17.0000000000 FORMAT "%13.10" MATRIX_DIM 15 /end CHARACTERISTIC
/begin CHARACTERISTIC DINH_Lim.DFC_ComFrbd_435h_HVBAT_MAX_CELL_VOLT_NUM_CA "" VAL_BLK 0x8024AE31 ValA_Wu8 17.0000000000 DINH_LimDFCVerb 0.00 17.0000000000 FORMAT "%13.10" MATRIX_DIM 15 /end CHARACTERISTIC
/begin CHARACTERISTIC DINH_Lim.DFC_ComFrbd_435h_HVBAT_MAX_SENSOR_TEMP_CA "" VAL_BLK 0x8024AE40 ValA_Wu8 17.0000000000 DINH_LimDFCVerb 0.00 17.0000000000 FORMAT "%13.10" MATRIX_DIM 15 /end CHARACTERISTIC
/begin CHARACTERISTIC DINH_Lim.DFC_ComFrbd_435h_HVBAT_MIN_CELL_VOLT_CA "" VAL_BLK 0x8024AE4F ValA_Wu8 17.0000000000 DINH_LimDFCVerb 0.00 17.0000000000 FORMAT "%13.10" MATRIX_DIM 15 /end CHARACTERISTIC
/begin CHARACTERISTIC DINH_Lim.DFC_ComFrbd_435h_HVBAT_MIN_CELL_VOLT_NUM_CA "" VAL_BLK 0x8024AE5E ValA_Wu8 17.0000000000 DINH_LimDFCVerb 0.00 17.0000000000 FORMAT "%13.10" MATRIX_DIM 15 /end CHARACTERISTIC
/begin CHARACTERISTIC DINH_Lim.DFC_ComFrbd_453h_OBC_IN_CURRENT_CA "" VAL_BLK 0x8024AE6D ValA_Wu8 17.0000000000 DINH_LimDFCVerb 0.00 17.0000000000 FORMAT "%13.10" MATRIX_DIM 16 /end CHARACTERISTIC
/begin CHARACTERISTIC DINH_Lim.DFC_ComFrbd_453h_OBC_IN_VOLTAGE_CA "" VAL_BLK 0x8024AE7D ValA_Wu8 17.0000000000 DINH_LimDFCVerb 0.00 17.0000000000 FORMAT "%13.10" MATRIX_DIM 15 /end CHARACTERISTIC
/begin CHARACTERISTIC DINH_Lim.DFC_ComFrbd_453h_OBC_IP_POWER_CA "" VAL_BLK 0x8024AE8C ValA_Wu8 17.0000000000 DINH_LimDFCVerb 0.00 17.0000000000 FORMAT "%13.10" MATRIX_DIM 15 /end CHARACTERISTIC
/begin CHARACTERISTIC DINH_Lim.DFC_ComFrbd_455h_HVBAT_NOMINAL_VOLTAGE_CA "" VAL_BLK 0x8024AE9B ValA_Wu8 17.0000000000 DINH_LimDFCVerb 0.00 17.0000000000 FORMAT "%13.10" MATRIX_DIM 18 /end CHARACTERISTIC
/begin CHARACTERISTIC DINH_Lim.DFC_ComFrbd_463h_OBC_OUT_CURRENT_CA "" VAL_BLK 0x8024AEAD ValA_Wu8 17.0000000000 DINH_LimDFCVerb 0.00 17.0000000000 FORMAT "%13.10" MATRIX_DIM 16 /end CHARACTERISTIC
/begin CHARACTERISTIC DINH_Lim.DFC_ComFrbd_463h_OBC_OUT_VOLTAGE_CA "" VAL_BLK 0x8024AEBD ValA_Wu8 17.0000000000 DINH_LimDFCVerb 0.00 17.0000000000 FORMAT "%13.10" MATRIX_DIM 16 /end CHARACTERISTIC
/begin CHARACTERISTIC DINH_Lim.DFC_ComFrbd_463h_OBC_TEMPERATURE_CA "" VAL_BLK 0x8024AECD ValA_Wu8 17.0000000000 DINH_LimDFCVerb 0.00 17.0000000000 FORMAT "%13.10" MATRIX_DIM 16 /end CHARACTERISTIC
/begin CHARACTERISTIC DINH_Lim.DFC_ComFrbd_473h_DCDC_Coolant_Temperature_CA "" VAL_BLK 0x8024AEDD ValA_Wu8 17.0000000000 DINH_LimDFCVerb 0.00 17.0000000000 FORMAT "%13.10" MATRIX_DIM 15 /end CHARACTERISTIC
/begin CHARACTERISTIC DINH_Lim.DFC_ComFrbd_473h_DCDC_TEMPERATURE_CA "" VAL_BLK 0x8024AEEC ValA_Wu8 17.0000000000 DINH_LimDFCVerb 0.00 17.0000000000 FORMAT "%13.10" MATRIX_DIM 17 /end CHARACTERISTIC
/begin CHARACTERISTIC DINH_Lim.DFC_ComFrbd_47Bh_eCOMP_BusBarCurrent_CA "" VAL_BLK 0x8024AEFD ValA_Wu8 17.0000000000 DINH_LimDFCVerb 0.00 17.0000000000 FORMAT "%13.10" MATRIX_DIM 15 /end CHARACTERISTIC
/begin CHARACTERISTIC DINH_Lim.DFC_ComFrbd_47Bh_eCOMP_BusBarVoltage_CA "" VAL_BLK 0x8024AF0C ValA_Wu8 17.0000000000 DINH_LimDFCVerb 0.00 17.0000000000 FORMAT "%13.10" MATRIX_DIM 15 /end CHARACTERISTIC
/begin CHARACTERISTIC DINH_Lim.DFC_ComFrbd_47Bh_eCOMP_CompressorSpeed_CA "" VAL_BLK 0x8024AF1B ValA_Wu8 17.0000000000 DINH_LimDFCVerb 0.00 17.0000000000 FORMAT "%13.10" MATRIX_DIM 15 /end CHARACTERISTIC
/begin CHARACTERISTIC DINH_Lim.DFC_ComFrbd_47Bh_eCOMP_IGBT_Temp_CA "" VAL_BLK 0x8024AF2A ValA_Wu8 17.0000000000 DINH_LimDFCVerb 0.00 17.0000000000 FORMAT "%13.10" MATRIX_DIM 15 /end CHARACTERISTIC
/begin CHARACTERISTIC DINH_Lim.DFC_ComFrbd_47Bh_eCOMP_PeakPhaCurrent_CA "" VAL_BLK 0x8024AF39 ValA_Wu8 17.0000000000 DINH_LimDFCVerb 0.00 17.0000000000 FORMAT "%13.10" MATRIX_DIM 15 /end CHARACTERISTIC
/begin CHARACTERISTIC DINH_Lim.DFC_ComFrbd_47Bh_eCOMP_Power_consumption_CA "" VAL_BLK 0x8024AF48 ValA_Wu8 17.0000000000 DINH_LimDFCVerb 0.00 17.0000000000 FORMAT "%13.10" MATRIX_DIM 15 /end CHARACTERISTIC
/begin CHARACTERISTIC DINH_Lim.DFC_ComFrbd_48Bh_eCOMP_Fault_Level_CA "" VAL_BLK 0x8024AF57 ValA_Wu8 17.0000000000 DINH_LimDFCVerb 0.00 17.0000000000 FORMAT "%13.10" MATRIX_DIM 15 /end CHARACTERISTIC
/begin CHARACTERISTIC DINH_Lim.DFC_ComFrbd_4F2h_VALEUR_SOC_ETENDUE_CA "" VAL_BLK 0x8024AF66 ValA_Wu8 17.0000000000 DINH_LimDFCVerb 0.00 17.0000000000 FORMAT "%13.10" MATRIX_DIM 15 /end CHARACTERISTIC
/begin CHARACTERISTIC DINH_Lim.DFC_ComFrbd_535h_HV_BATT_TEMP_AVG_CA "" VAL_BLK 0x8024AF75 ValA_Wu8 17.0000000000 DINH_LimDFCVerb 0.00 17.0000000000 FORMAT "%13.10" MATRIX_DIM 15 /end CHARACTERISTIC
/begin CHARACTERISTIC DINH_Lim.DFC_ComFrbd_543h_HVBAT_RESTBATTENERGY_CA "" VAL_BLK 0x8024AF84 ValA_Wu8 17.0000000000 DINH_LimDFCVerb 0.00 17.0000000000 FORMAT "%13.10" MATRIX_DIM 15 /end CHARACTERISTIC
/begin CHARACTERISTIC DINH_Lim.DFC_ComFrbd_543h_HVBAT_SOH_CA "" VAL_BLK 0x8024AF93 ValA_Wu8 17.0000000000 DINH_LimDFCVerb 0.00 17.0000000000 FORMAT "%13.10" MATRIX_DIM 15 /end CHARACTERISTIC
/begin CHARACTERISTIC DINH_Lim.DFC_ComFrbd_543h_HV_BATT_SOH_RES_CA "" VAL_BLK 0x8024AFA2 ValA_Wu8 17.0000000000 DINH_LimDFCVerb 0.00 17.0000000000 FORMAT "%13.10" MATRIX_DIM 15 /end CHARACTERISTIC
/begin CHARACTERISTIC DINH_Lim.DFC_ComFrbd_592h_IBATT_1_CA "" VAL_BLK 0x8024AFB1 ValA_Wu8 17.0000000000 DINH_LimDFCVerb 0.00 17.0000000000 FORMAT "%13.10" MATRIX_DIM 15 /end CHARACTERISTIC
/begin CHARACTERISTIC DINH_Lim.DFC_ComFrbd_592h_IBATT_2_CA "" VAL_BLK 0x8024AFC0 ValA_Wu8 17.0000000000 DINH_LimDFCVerb 0.00 17.0000000000 FORMAT "%13.10" MATRIX_DIM 15 /end CHARACTERISTIC
/begin CHARACTERISTIC DINH_Lim.DFC_ComFrbd_592h_IBATT_3_CA "" VAL_BLK 0x8024AFCF ValA_Wu8 17.0000000000 DINH_LimDFCVerb 0.00 17.0000000000 FORMAT "%13.10" MATRIX_DIM 15 /end CHARACTERISTIC
/begin CHARACTERISTIC DINH_Lim.DFC_ComFrbd_592h_TEMP_BATT_CA "" VAL_BLK 0x8024AFDE ValA_Wu8 17.0000000000 DINH_LimDFCVerb 0.00 17.0000000000 FORMAT "%13.10" MATRIX_DIM 15 /end CHARACTERISTIC
/begin CHARACTERISTIC DINH_Lim.DFC_ComFrbd_592h_U_BATT_BECB_CA "" VAL_BLK 0x8024AFED ValA_Wu8 17.0000000000 DINH_LimDFCVerb 0.00 17.0000000000 FORMAT "%13.10" MATRIX_DIM 15 /end CHARACTERISTIC
/begin CHARACTERISTIC DINH_Lim.DFC_ComFrbd_595h_HVBAT_TIME_TO_CHRG_80_CA "" VAL_BLK 0x8024AFFC ValA_Wu8 17.0000000000 DINH_LimDFCVerb 0.00 17.0000000000 FORMAT "%13.10" MATRIX_DIM 15 /end CHARACTERISTIC
/begin CHARACTERISTIC DINH_Lim.DFC_ComFrbd_5B2h_TEMP_AIR_EXT_CA "" VAL_BLK 0x8024B00B ValA_Wu8 17.0000000000 DINH_LimDFCVerb 0.00 17.0000000000 FORMAT "%13.10" MATRIX_DIM 15 /end CHARACTERISTIC
/begin CHARACTERISTIC DINH_Lim.DFC_ComFrbd_635h_HVBAT_NEG_CONT_COUNT_SEG1_CA "" VAL_BLK 0x8024B01A ValA_Wu8 17.0000000000 DINH_LimDFCVerb 0.00 17.0000000000 FORMAT "%13.10" MATRIX_DIM 15 /end CHARACTERISTIC
/begin CHARACTERISTIC DINH_Lim.DFC_ComFrbd_635h_HVBAT_NEG_CONT_COUNT_SEG3_CA "" VAL_BLK 0x8024B029 ValA_Wu8 17.0000000000 DINH_LimDFCVerb 0.00 17.0000000000 FORMAT "%13.10" MATRIX_DIM 15 /end CHARACTERISTIC
/begin CHARACTERISTIC DINH_Lim.DFC_ComFrbd_635h_HVBAT_NEG_CONT_COUNT_SEG4_CA "" VAL_BLK 0x8024B038 ValA_Wu8 17.0000000000 DINH_LimDFCVerb 0.00 17.0000000000 FORMAT "%13.10" MATRIX_DIM 15 /end CHARACTERISTIC
/begin CHARACTERISTIC DINH_Lim.DFC_ComFrbd_635h_HVBAT_PST_CONT_COUNT_SEG1_CA "" VAL_BLK 0x8024B047 ValA_Wu8 17.0000000000 DINH_LimDFCVerb 0.00 17.0000000000 FORMAT "%13.10" MATRIX_DIM 15 /end CHARACTERISTIC
/begin CHARACTERISTIC DINH_Lim.DFC_ComFrbd_635h_HVBAT_PST_CONT_COUNT_SEG3_CA "" VAL_BLK 0x8024B056 ValA_Wu8 17.0000000000 DINH_LimDFCVerb 0.00 17.0000000000 FORMAT "%13.10" MATRIX_DIM 15 /end CHARACTERISTIC
/begin CHARACTERISTIC DINH_Lim.DFC_ComFrbd_635h_HVBAT_PST_CONT_COUNT_SEG4_CA "" VAL_BLK 0x8024B065 ValA_Wu8 17.0000000000 DINH_LimDFCVerb 0.00 17.0000000000 FORMAT "%13.10" MATRIX_DIM 15 /end CHARACTERISTIC
/begin CHARACTERISTIC DINH_Lim.DFC_ComFrbd_645h_HVBAT_PRECHRGE_CONT_COUNT_SEG1_CA "" VAL_BLK 0x8024B074 ValA_Wu8 17.0000000000 DINH_LimDFCVerb 0.00 17.0000000000 FORMAT "%13.10" MATRIX_DIM 15 /end CHARACTERISTIC
/begin CHARACTERISTIC DINH_Lim.DFC_ComFrbd_645h_HVBAT_PRECHRGE_CONT_COUNT_SEG2_CA "" VAL_BLK 0x8024B083 ValA_Wu8 17.0000000000 DINH_LimDFCVerb 0.00 17.0000000000 FORMAT "%13.10" MATRIX_DIM 15 /end CHARACTERISTIC
/begin CHARACTERISTIC DINH_Lim.DFC_ComFrbd_675h_HVBAT_REMAININGBATTCAPACITY_CA "" VAL_BLK 0x8024B092 ValA_Wu8 17.0000000000 DINH_LimDFCVerb 0.00 17.0000000000 FORMAT "%13.10" MATRIX_DIM 15 /end CHARACTERISTIC
/begin CHARACTERISTIC DINH_Lim.DFC_ComInvld_205h_HVBAT_CHARGING_STATUS_CA "" VAL_BLK 0x8024B0A1 ValA_Wu8 17.0000000000 DINH_LimDFCVerb 0.00 17.0000000000 FORMAT "%13.10" MATRIX_DIM 15 /end CHARACTERISTIC
/begin CHARACTERISTIC DINH_Lim.DFC_ComInvld_205h_HVBAT_PACK_CURRENT_CA "" VAL_BLK 0x8024B0B0 ValA_Wu8 17.0000000000 DINH_LimDFCVerb 0.00 17.0000000000 FORMAT "%13.10" MATRIX_DIM 18 /end CHARACTERISTIC
/begin CHARACTERISTIC DINH_Lim.DFC_ComInvld_205h_HVBAT_SOC_DISPLAY_CA "" VAL_BLK 0x8024B0C2 ValA_Wu8 17.0000000000 DINH_LimDFCVerb 0.00 17.0000000000 FORMAT "%13.10" MATRIX_DIM 18 /end CHARACTERISTIC
/begin CHARACTERISTIC DINH_Lim.DFC_ComInvld_205h_HVBAT_VOLTAGE_CA "" VAL_BLK 0x8024B0D4 ValA_Wu8 17.0000000000 DINH_LimDFCVerb 0.00 17.0000000000 FORMAT "%13.10" MATRIX_DIM 19 /end CHARACTERISTIC
/begin CHARACTERISTIC DINH_Lim.DFC_ComInvld_217h_INV_DC_BUS_VOLTAGE_CA "" VAL_BLK 0x8024B0E7 ValA_Wu8 17.0000000000 DINH_LimDFCVerb 0.00 17.0000000000 FORMAT "%13.10" MATRIX_DIM 16 /end CHARACTERISTIC
/begin CHARACTERISTIC DINH_Lim.DFC_ComInvld_217h_INV_MTR_ACTUAL_TRQ_CA "" VAL_BLK 0x8024B0F7 ValA_Wu8 17.0000000000 DINH_LimDFCVerb 0.00 17.0000000000 FORMAT "%13.10" MATRIX_DIM 16 /end CHARACTERISTIC
/begin CHARACTERISTIC DINH_Lim.DFC_ComInvld_217h_INV_MTR_SPEED_CA "" VAL_BLK 0x8024B107 ValA_Wu8 17.0000000000 DINH_LimDFCVerb 0.00 17.0000000000 FORMAT "%13.10" MATRIX_DIM 16 /end CHARACTERISTIC
/begin CHARACTERISTIC DINH_Lim.DFC_ComInvld_217h_INV_MTR_TRQ_CA "" VAL_BLK 0x8024B117 ValA_Wu8 17.0000000000 DINH_LimDFCVerb 0.00 17.0000000000 FORMAT "%13.10" MATRIX_DIM 15 /end CHARACTERISTIC
/begin CHARACTERISTIC DINH_Lim.DFC_ComInvld_227h_INV_DC_CURRENT_CA "" VAL_BLK 0x8024B126 ValA_Wu8 17.0000000000 DINH_LimDFCVerb 0.00 17.0000000000 FORMAT "%13.10" MATRIX_DIM 15 /end CHARACTERISTIC
/begin CHARACTERISTIC DINH_Lim.DFC_ComInvld_227h_INV_MOTORING_PEAK_TRQ_CA "" VAL_BLK 0x8024B135 ValA_Wu8 17.0000000000 DINH_LimDFCVerb 0.00 17.0000000000 FORMAT "%13.10" MATRIX_DIM 17 /end CHARACTERISTIC
/begin CHARACTERISTIC DINH_Lim.DFC_ComInvld_227h_INV_MTR_INST_INPUT_POWER_CA "" VAL_BLK 0x8024B146 ValA_Wu8 17.0000000000 DINH_LimDFCVerb 0.00 17.0000000000 FORMAT "%13.10" MATRIX_DIM 15 /end CHARACTERISTIC
/begin CHARACTERISTIC DINH_Lim.DFC_ComInvld_227h_INV_REGEN_PEAK_TRQ_CA "" VAL_BLK 0x8024B155 ValA_Wu8 17.0000000000 DINH_LimDFCVerb 0.00 17.0000000000 FORMAT "%13.10" MATRIX_DIM 17 /end CHARACTERISTIC
/begin CHARACTERISTIC DINH_Lim.DFC_ComInvld_237h_INV_ACTIVE_DISCHARGE_STATUS_CA "" VAL_BLK 0x8024B166 ValA_Wu8 17.0000000000 DINH_LimDFCVerb 0.00 17.0000000000 FORMAT "%13.10" MATRIX_DIM 15 /end CHARACTERISTIC
/begin CHARACTERISTIC DINH_Lim.DFC_ComInvld_237h_INV_FAULT_LEVEL_CA "" VAL_BLK 0x8024B175 ValA_Wu8 17.0000000000 DINH_LimDFCVerb 0.00 17.0000000000 FORMAT "%13.10" MATRIX_DIM 15 /end CHARACTERISTIC
/begin CHARACTERISTIC DINH_Lim.DFC_ComInvld_237h_INV_STAB_MIN_TRQ_CA "" VAL_BLK 0x8024B184 ValA_Wu8 17.0000000000 DINH_LimDFCVerb 0.00 17.0000000000 FORMAT "%13.10" MATRIX_DIM 15 /end CHARACTERISTIC
/begin CHARACTERISTIC DINH_Lim.DFC_ComInvld_259h_TGLM_MODE_PUSH_CA "" VAL_BLK 0x8024B193 ValA_Wu8 17.0000000000 DINH_LimDFCVerb 0.00 17.0000000000 FORMAT "%13.10" MATRIX_DIM 15 /end CHARACTERISTIC
/begin CHARACTERISTIC DINH_Lim.DFC_ComInvld_259h_TOGGLE_MONOSTABLE_POS_CA "" VAL_BLK 0x8024B1A2 ValA_Wu8 17.0000000000 DINH_LimDFCVerb 0.00 17.0000000000 FORMAT "%13.10" MATRIX_DIM 15 /end CHARACTERISTIC
/begin CHARACTERISTIC DINH_Lim.DFC_ComInvld_26h_AC_SWITCH_REQ_CA "" VAL_BLK 0x8024B1B1 ValA_Wu8 17.0000000000 DINH_LimDFCVerb 0.00 17.0000000000 FORMAT "%13.10" MATRIX_DIM 15 /end CHARACTERISTIC
/begin CHARACTERISTIC DINH_Lim.DFC_ComInvld_26h_BLOWER_POSITION_CA "" VAL_BLK 0x8024B1C0 ValA_Wu8 17.0000000000 DINH_LimDFCVerb 0.00 17.0000000000 FORMAT "%13.10" MATRIX_DIM 15 /end CHARACTERISTIC
/begin CHARACTERISTIC DINH_Lim.DFC_ComInvld_26h_EVAP_SENSOR_FAULT_CA "" VAL_BLK 0x8024B1CF ValA_Wu8 17.0000000000 DINH_LimDFCVerb 0.00 17.0000000000 FORMAT "%13.10" MATRIX_DIM 15 /end CHARACTERISTIC
/begin CHARACTERISTIC DINH_Lim.DFC_ComInvld_26h_EVAP_SENSOR_VALUE_CA "" VAL_BLK 0x8024B1DE ValA_Wu8 17.0000000000 DINH_LimDFCVerb 0.00 17.0000000000 FORMAT "%13.10" MATRIX_DIM 15 /end CHARACTERISTIC
/begin CHARACTERISTIC DINH_Lim.DFC_ComInvld_26h_POTENTIOMETER_FAULT_CA "" VAL_BLK 0x8024B1ED ValA_Wu8 17.0000000000 DINH_LimDFCVerb 0.00 17.0000000000 FORMAT "%13.10" MATRIX_DIM 15 /end CHARACTERISTIC
/begin CHARACTERISTIC DINH_Lim.DFC_ComInvld_26h_REAR_DEFOG_REQ_CA "" VAL_BLK 0x8024B1FC ValA_Wu8 17.0000000000 DINH_LimDFCVerb 0.00 17.0000000000 FORMAT "%13.10" MATRIX_DIM 15 /end CHARACTERISTIC
/begin CHARACTERISTIC DINH_Lim.DFC_ComInvld_26h_TEMP_POSITION_CA "" VAL_BLK 0x8024B20B ValA_Wu8 17.0000000000 DINH_LimDFCVerb 0.00 17.0000000000 FORMAT "%13.10" MATRIX_DIM 15 /end CHARACTERISTIC
/begin CHARACTERISTIC DINH_Lim.DFC_ComInvld_273h_OBC_FAULT_LEVEL_CA "" VAL_BLK 0x8024B21A ValA_Wu8 17.0000000000 DINH_LimDFCVerb 0.00 17.0000000000 FORMAT "%13.10" MATRIX_DIM 15 /end CHARACTERISTIC
/begin CHARACTERISTIC DINH_Lim.DFC_ComInvld_273h_OBC_outputpower_capability_CA "" VAL_BLK 0x8024B229 ValA_Wu8 17.0000000000 DINH_LimDFCVerb 0.00 17.0000000000 FORMAT "%13.10" MATRIX_DIM 15 /end CHARACTERISTIC
/begin CHARACTERISTIC DINH_Lim.DFC_ComInvld_275h_HVBAT_DISCHARGE_30S_AVAILABLE_CURRENT_CA "" VAL_BLK 0x8024B238 ValA_Wu8 17.0000000000 DINH_LimDFCVerb 0.00 17.0000000000 FORMAT "%13.10" MATRIX_DIM 15 /end CHARACTERISTIC
/begin CHARACTERISTIC DINH_Lim.DFC_ComInvld_275h_HVBAT_DISCHARGE_30S_AVAILABLE_POWER_CA "" VAL_BLK 0x8024B247 ValA_Wu8 17.0000000000 DINH_LimDFCVerb 0.00 17.0000000000 FORMAT "%13.10" MATRIX_DIM 15 /end CHARACTERISTIC
/begin CHARACTERISTIC DINH_Lim.DFC_ComInvld_283h_DCDC_IN_CURRENT_CA "" VAL_BLK 0x8024B256 ValA_Wu8 17.0000000000 DINH_LimDFCVerb 0.00 17.0000000000 FORMAT "%13.10" MATRIX_DIM 15 /end CHARACTERISTIC
/begin CHARACTERISTIC DINH_Lim.DFC_ComInvld_283h_DCDC_IN_VOLTAGE_CA "" VAL_BLK 0x8024B265 ValA_Wu8 17.0000000000 DINH_LimDFCVerb 0.00 17.0000000000 FORMAT "%13.10" MATRIX_DIM 15 /end CHARACTERISTIC
/begin CHARACTERISTIC DINH_Lim.DFC_ComInvld_283h_DCDC_OUT_CURRENT_CA "" VAL_BLK 0x8024B274 ValA_Wu8 17.0000000000 DINH_LimDFCVerb 0.00 17.0000000000 FORMAT "%13.10" MATRIX_DIM 15 /end CHARACTERISTIC
/begin CHARACTERISTIC DINH_Lim.DFC_ComInvld_283h_DCDC_OUT_VOLTAGE_CA "" VAL_BLK 0x8024B283 ValA_Wu8 17.0000000000 DINH_LimDFCVerb 0.00 17.0000000000 FORMAT "%13.10" MATRIX_DIM 15 /end CHARACTERISTIC
/begin CHARACTERISTIC DINH_Lim.DFC_ComInvld_285h_HVBAT_REGEN_CHG_30S_CURRENT_LIMIT_CA "" VAL_BLK 0x8024B292 ValA_Wu8 17.0000000000 DINH_LimDFCVerb 0.00 17.0000000000 FORMAT "%13.10" MATRIX_DIM 15 /end CHARACTERISTIC
/begin CHARACTERISTIC DINH_Lim.DFC_ComInvld_285h_HVBAT_REGEN_CHRG_30S_POWER_LIMIT_CA "" VAL_BLK 0x8024B2A1 ValA_Wu8 17.0000000000 DINH_LimDFCVerb 0.00 17.0000000000 FORMAT "%13.10" MATRIX_DIM 15 /end CHARACTERISTIC
/begin CHARACTERISTIC DINH_Lim.DFC_ComInvld_293h_DCDC_FAULT_LEVEL_CA "" VAL_BLK 0x8024B2B0 ValA_Wu8 17.0000000000 DINH_LimDFCVerb 0.00 17.0000000000 FORMAT "%13.10" MATRIX_DIM 15 /end CHARACTERISTIC
/begin CHARACTERISTIC DINH_Lim.DFC_ComInvld_293h_DCDC_outputpower_capability_CA "" VAL_BLK 0x8024B2BF ValA_Wu8 17.0000000000 DINH_LimDFCVerb 0.00 17.0000000000 FORMAT "%13.10" MATRIX_DIM 15 /end CHARACTERISTIC
/begin CHARACTERISTIC DINH_Lim.DFC_ComInvld_325h_HVBAT_EPLUG_STATUS_CA "" VAL_BLK 0x8024B2CE ValA_Wu8 17.0000000000 DINH_LimDFCVerb 0.00 17.0000000000 FORMAT "%13.10" MATRIX_DIM 15 /end CHARACTERISTIC
/begin CHARACTERISTIC DINH_Lim.DFC_ComInvld_325h_HVBAT_HVIL_STS_CA "" VAL_BLK 0x8024B2DD ValA_Wu8 17.0000000000 DINH_LimDFCVerb 0.00 17.0000000000 FORMAT "%13.10" MATRIX_DIM 15 /end CHARACTERISTIC
/begin CHARACTERISTIC DINH_Lim.DFC_ComInvld_325h_HVBAT_INSULATION_FAULT_CA "" VAL_BLK 0x8024B2EC ValA_Wu8 17.0000000000 DINH_LimDFCVerb 0.00 17.0000000000 FORMAT "%13.10" MATRIX_DIM 15 /end CHARACTERISTIC
/begin CHARACTERISTIC DINH_Lim.DFC_ComInvld_325h_HVBAT_INSULATION_RESISTANCE_CA "" VAL_BLK 0x8024B2FB ValA_Wu8 17.0000000000 DINH_LimDFCVerb 0.00 17.0000000000 FORMAT "%13.10" MATRIX_DIM 15 /end CHARACTERISTIC
/begin CHARACTERISTIC DINH_Lim.DFC_ComInvld_325h_HVBAT_TEMPERATURE_CA "" VAL_BLK 0x8024B30A ValA_Wu8 17.0000000000 DINH_LimDFCVerb 0.00 17.0000000000 FORMAT "%13.10" MATRIX_DIM 15 /end CHARACTERISTIC
/begin CHARACTERISTIC DINH_Lim.DFC_ComInvld_335h_HVBAT_CHRG_CONTINUOUS_CURR_MAX_CA "" VAL_BLK 0x8024B319 ValA_Wu8 17.0000000000 DINH_LimDFCVerb 0.00 17.0000000000 FORMAT "%13.10" MATRIX_DIM 15 /end CHARACTERISTIC
/begin CHARACTERISTIC DINH_Lim.DFC_ComInvld_335h_HVBAT_CHRG_COTINUOUS_CURR_REQ_CA "" VAL_BLK 0x8024B328 ValA_Wu8 17.0000000000 DINH_LimDFCVerb 0.00 17.0000000000 FORMAT "%13.10" MATRIX_DIM 18 /end CHARACTERISTIC
/begin CHARACTERISTIC DINH_Lim.DFC_ComInvld_335h_HVBAT_CHRG_MAX_VOLT_CA "" VAL_BLK 0x8024B33A ValA_Wu8 17.0000000000 DINH_LimDFCVerb 0.00 17.0000000000 FORMAT "%13.10" MATRIX_DIM 18 /end CHARACTERISTIC
/begin CHARACTERISTIC DINH_Lim.DFC_ComInvld_335h_HVBAT_DC_BUS_VOLTAGE_CA "" VAL_BLK 0x8024B34C ValA_Wu8 17.0000000000 DINH_LimDFCVerb 0.00 17.0000000000 FORMAT "%13.10" MATRIX_DIM 16 /end CHARACTERISTIC
/begin CHARACTERISTIC DINH_Lim.DFC_ComInvld_38Dh_VITESSE_VEHICULE_ROUES_CA "" VAL_BLK 0x8024B35C ValA_Wu8 17.0000000000 DINH_LimDFCVerb 0.00 17.0000000000 FORMAT "%13.10" MATRIX_DIM 16 /end CHARACTERISTIC
/begin CHARACTERISTIC DINH_Lim.DFC_ComInvld_38Dh_VVH_INDISP_CA "" VAL_BLK 0x8024B36C ValA_Wu8 17.0000000000 DINH_LimDFCVerb 0.00 17.0000000000 FORMAT "%13.10" MATRIX_DIM 18 /end CHARACTERISTIC
/begin CHARACTERISTIC DINH_Lim.DFC_ComInvld_427h_INV_COOLANT_TEMP_CA "" VAL_BLK 0x8024B37E ValA_Wu8 17.0000000000 DINH_LimDFCVerb 0.00 17.0000000000 FORMAT "%13.10" MATRIX_DIM 16 /end CHARACTERISTIC
/begin CHARACTERISTIC DINH_Lim.DFC_ComInvld_427h_INV_MOTOR_TEMP_CA "" VAL_BLK 0x8024B38E ValA_Wu8 17.0000000000 DINH_LimDFCVerb 0.00 17.0000000000 FORMAT "%13.10" MATRIX_DIM 16 /end CHARACTERISTIC
/begin CHARACTERISTIC DINH_Lim.DFC_ComInvld_427h_INV_OP_MODE_CA "" VAL_BLK 0x8024B39E ValA_Wu8 17.0000000000 DINH_LimDFCVerb 0.00 17.0000000000 FORMAT "%13.10" MATRIX_DIM 15 /end CHARACTERISTIC
/begin CHARACTERISTIC DINH_Lim.DFC_ComInvld_427h_INV_PERMISIBLE_TORQUE_CA "" VAL_BLK 0x8024B3AD ValA_Wu8 17.0000000000 DINH_LimDFCVerb 0.00 17.0000000000 FORMAT "%13.10" MATRIX_DIM 15 /end CHARACTERISTIC
/begin CHARACTERISTIC DINH_Lim.DFC_ComInvld_427h_INV_TEMP_CA "" VAL_BLK 0x8024B3BC ValA_Wu8 17.0000000000 DINH_LimDFCVerb 0.00 17.0000000000 FORMAT "%13.10" MATRIX_DIM 16 /end CHARACTERISTIC
/begin CHARACTERISTIC DINH_Lim.DFC_ComInvld_432h_REVEIL_PRINCIPAL_CA "" VAL_BLK 0x8024B3CC ValA_Wu8 17.0000000000 DINH_LimDFCVerb 0.00 17.0000000000 FORMAT "%13.10" MATRIX_DIM 17 /end CHARACTERISTIC
/begin CHARACTERISTIC DINH_Lim.DFC_ComInvld_435h_HVBAT_MAX_CELL_VOLT_CA "" VAL_BLK 0x8024B3DD ValA_Wu8 17.0000000000 DINH_LimDFCVerb 0.00 17.0000000000 FORMAT "%13.10" MATRIX_DIM 15 /end CHARACTERISTIC
/begin FUNCTION DINH "30000.25.0Diagnostic Inhibit Handler"
 /begin DEF_CHARACTERISTIC DINH_FId.DFC_CANSM_E_BUS_OFF_NETWORK_XCP_CAN_CA DINH_FId.DFC_CANTRCV_E_NO_TRCV_CONTROL_0_CA DINH_FId.DFC_CAN_E_TIMEOUT_CA DINH_FId.DFC_COMM_E_NET_START_IND_CHANNEL_0_CA DINH_FId.DFC_COMM_E_NET_START_IND_CHANNEL_1_CA DINH_FId.DFC_COMM_E_NET_START_IND_CHANNEL_2_CA DINH_FId.DFC_COMM_E_NET_START_IND_CHANNEL_3_CA DINH_FId.DFC_COMM_E_NET_START_IND_CHANNEL_4_CA DINH_FId.DFC_COMM_E_NET_START_IND_CHANNEL_5_CA DINH_FId.DFC_LIN_E_TIMEOUT_CA DINH_FId.DFC_rba_EcuCtrl_TOMaxProlg_CA DINH_FId.DFC_rba_EcuCtrl_TOMaxShutDwn_CA DINH_FId.DFC_rba_MultiStackTrace_Threshold_CA DINH_FId.DFC_rba_SyC_CustStates_Degraded_disord_Event_CA DINH_FId.DFC_rba_SyC_CustStates_Degraded_incst_Event_CA DINH_FId.DFC_rba_SyC_CustStates_TransNoWakReq_Event_CA DINH_FId.DFC_RBA_IOEXTLIB_KEEPALIVE_DRV_CA DINH_FId.DFC_RBA_IOEXTLIB_KEEPALIVE_INI_CA DINH_FId.DFC_rba_IoSigRtc_StopCounter_CA DINH_FId.DFC_rba_MRly_Diag_Stk_Event_CA DINH_FId.DFC_rba_MemDiag_MemReadErr_CA DINH_FId.DFC_rba_MemDiag_MemWrErr_CA DINH_FId.DFC_rba_SyC_IrrSwOffTrigEngRun_Event_CA DINH_FId.DFC_AcChrgrIntkTSRCMax_CA DINH_FId.DFC_AcChrgrIntkTTmpErr_CA DINH_FId.DFC_AcFlt_CA DINH_FId.DFC_AppAllSnsrDfct_CA DINH_FId.DFC_BattUPwrFail_CA DINH_FId.DFC_BrkBstBkupOvrn_CA DINH_FId.DFC_BrkBstPmpOvld_CA DINH_FId.DFC_BrkPlausChk_CA DINH_FId.DFC_CbnHeatgSwtTmpErr_CA DINH_FId.DFC_CcsPwrLineChpVccSRCMax_CA DINH_FId.DFC_CcsPwrLineChpVccTmpErr_CA DINH_FId.DFC_CcsPwrLineComChpTSRCMax_CA DINH_FId.DFC_CcsPwrLineComChpTTmpErr_CA DINH_FId.DFC_ChgrPlugCtpCarrFrqErr_CA DINH_FId.DFC_ChgrPlugCtpSwtStuckClsd_CA DINH_FId.DFC_ChgrPlugCtpSwtStuckOpen_CA DINH_FId.DFC_ChgrPlugCtpUErrHi_CA DINH_FId.DFC_ChgrPlugPxp1SrcErr_CA DINH_FId.DFC_ChrgCntctAllWldd_CA DINH_FId.DFC_ChrgCntctNegOperErr_CA DINH_FId.DFC_ChrgCntctNegOperWarn_CA DINH_FId.DFC_ChrgCntctNegWldd_CA DINH_FId.DFC_ChrgCntctPosOperErr_CA DINH_FId.DFC_ChrgCntctPosOperWarn_CA DINH_FId.DFC_ChrgCntctPosWldd_CA DINH_FId.DFC_ChrgCntctStuckOpen_CA DINH_FId.DFC_ChrgPlgIntlckFaild_CA DINH_FId.DFC_ChrgnUnplRqrd_CA DINH_FId.DFC_CoElMOffsCalibActv01_CA DINH_FId.DFC_CtPSwtDiagSRCMax_CA DINH_FId.DFC_CtPSwtDiagTmpErr_CA DINH_FId.DFC_CtpCarrFrqTmpErr_CA DINH_FId.DFC_DcChrgrIntkT2SRCMax_CA DINH_FId.DFC_DcChrgrIntkT2TmpErr_CA DINH_FId.DFC_DcChrgrIntkTSRCMax_CA DINH_FId.DFC_DcChrgrIntkTTmpErr_CA DINH_FId.DFC_EChrDvPlinCntrThdExcdd_CA DINH_FId.DFC_EemDiagCtctrClsTout_CA DINH_FId.DFC_EemDiagDcdcOffTOut_CA DINH_FId.DFC_EemDiagHvCnsrOffTOut_CA DINH_FId.DFC_EemDiagHvbOffTOut_CA DINH_FId.DFC_FanSpdSRCMax_CA DINH_FId.DFC_FanSpdTmpErr_CA DINH_FId.DFC_FreonPSRCMax_CA DINH_FId.DFC_FreonPTmpErr_CA DINH_FId.DFC_HeatrCoreTSRCMax_CA DINH_FId.DFC_HeatrCoreTTmpErr_CA DINH_FId.DFC_HvGridSocMinLim_CA DINH_FId.DFC_HvacBlwrFrntFlt_CA DINH_FId.DFC_HvacEvapElecFlt_CA DINH_FId.DFC_HvacEvapElecFltGnd_CA DINH_FId.DFC_HvacKnobPosnFlt_CA DINH_FId.DFC_InvBinID_CA DINH_FId.DFC_InvCalID_CA DINH_FId.DFC_InvErotan_CA DINH_FId.DFC_InvVinID_CA DINH_FId.DFC_MOXEMM_SMU_ALM0_0_CA DINH_FId.DFC_MOXEMM_SMU_ALM0_1_CA DINH_FId.DFC_MOXEMM_SMU_ALM0_10_CA DINH_FId.DFC_MOXEMM_SMU_ALM0_11_CA DINH_FId.DFC_MOXEMM_SMU_ALM0_13_CA DINH_FId.DFC_MOXEMM_SMU_ALM0_14_CA DINH_FId.DFC_MOXEMM_SMU_ALM0_2_CA DINH_FId.DFC_MOXEMM_SMU_ALM0_22_CA DINH_FId.DFC_MOXEMM_SMU_ALM0_23_CA DINH_FId.DFC_MOXEMM_SMU_ALM0_4_CA DINH_FId.DFC_MOXEMM_SMU_ALM0_5_CA DINH_FId.DFC_MOXEMM_SMU_ALM0_7_CA DINH_FId.DFC_MOXEMM_SMU_ALM0_8_CA DINH_FId.DFC_MOXEMM_SMU_ALM10_16_CA DINH_FId.DFC_MOXEMM_SMU_ALM10_17_CA DINH_FId.DFC_MOXEMM_SMU_ALM10_21_CA DINH_FId.DFC_MOXEMM_SMU_ALM11_0_CA DINH_FId.DFC_MOXEMM_SMU_ALM11_1_CA DINH_FId.DFC_MOXEMM_SMU_ALM11_2_CA DINH_FId.DFC_MOXEMM_SMU_ALM11_3_CA DINH_FId.DFC_MOXEMM_SMU_ALM11_4_CA DINH_FId.DFC_MOXEMM_SMU_ALM11_5_CA DINH_FId.DFC_MOXEMM_SMU_ALM11_8_CA DINH_FId.DFC_MOXEMM_SMU_ALM11_9_CA DINH_FId.DFC_MOXEMM_SMU_ALM1_0_CA DINH_FId.DFC_MOXEMM_SMU_ALM1_1_CA DINH_FId.DFC_MOXEMM_SMU_ALM1_10_CA DINH_FId.DFC_MOXEMM_SMU_ALM1_11_CA DINH_FId.DFC_MOXEMM_SMU_ALM1_13_CA DINH_FId.DFC_MOXEMM_SMU_ALM1_14_CA DINH_FId.DFC_MOXEMM_SMU_ALM1_2_CA DINH_FId.DFC_MOXEMM_SMU_ALM1_22_CA DINH_FId.DFC_MOXEMM_SMU_ALM1_23_CA DINH_FId.DFC_MOXEMM_SMU_ALM1_4_CA DINH_FId.DFC_MOXEMM_SMU_ALM1_5_CA DINH_FId.DFC_MOXEMM_SMU_ALM1_7_CA DINH_FId.DFC_MOXEMM_SMU_ALM1_8_CA DINH_FId.DFC_MOXEMM_SMU_ALM21_0_CA DINH_FId.DFC_MOXEMM_SMU_ALM21_16_CA DINH_FId.DFC_MOXEMM_SMU_ALM21_3_CA DINH_FId.DFC_MOXEMM_SMU_ALM2_1_CA DINH_FId.DFC_MOXEMM_SMU_ALM2_10_CA DINH_FId.DFC_MOXEMM_SMU_ALM2_11_CA DINH_FId.DFC_MOXEMM_SMU_ALM2_13_CA DINH_FId.DFC_MOXEMM_SMU_ALM2_14_CA DINH_FId.DFC_MOXEMM_SMU_ALM2_22_CA DINH_FId.DFC_MOXEMM_SMU_ALM2_23_CA DINH_FId.DFC_MOXEMM_SMU_ALM2_4_CA DINH_FId.DFC_MOXEMM_SMU_ALM2_5_CA DINH_FId.DFC_MOXEMM_SMU_ALM2_7_CA DINH_FId.DFC_MOXEMM_SMU_ALM2_8_CA DINH_FId.DFC_MOXEMM_SMU_ALM6_0_CA DINH_FId.DFC_MOXEMM_SMU_ALM6_11_CA DINH_FId.DFC_MOXEMM_SMU_ALM6_12_CA DINH_FId.DFC_MOXEMM_SMU_ALM6_14_CA DINH_FId.DFC_MOXEMM_SMU_ALM6_15_CA DINH_FId.DFC_MOXEMM_SMU_ALM6_17_CA DINH_FId.DFC_MOXEMM_SMU_ALM6_18_CA DINH_FId.DFC_MOXEMM_SMU_ALM6_20_CA DINH_FId.DFC_MOXEMM_SMU_ALM6_21_CA DINH_FId.DFC_MOXEMM_SMU_ALM6_25_CA DINH_FId.DFC_MOXEMM_SMU_ALM6_4_CA DINH_FId.DFC_MOXEMM_SMU_ALM6_5_CA DINH_FId.DFC_MOXEMM_SMU_ALM6_7_CA DINH_FId.DFC_MOXEMM_SMU_ALM6_8_CA DINH_FId.DFC_MOXEMM_SMU_ALM7_1_CA DINH_FId.DFC_MOXEMM_SMU_ALM7_12_CA DINH_FId.DFC_MOXEMM_SMU_ALM7_13_CA DINH_FId.DFC_MOXEMM_SMU_ALM7_14_CA DINH_FId.DFC_MOXEMM_SMU_ALM7_15_CA DINH_FId.DFC_MOXEMM_SMU_ALM7_16_CA DINH_FId.DFC_MOXEMM_SMU_ALM7_17_CA DINH_FId.DFC_MOXEMM_SMU_ALM7_2_CA DINH_FId.DFC_MOXEMM_SMU_ALM7_20_CA DINH_FId.DFC_MOXEMM_SMU_ALM7_25_CA DINH_FId.DFC_MOXEMM_SMU_ALM7_26_CA DINH_FId.DFC_MOXEMM_SMU_ALM7_28_CA DINH_FId.DFC_MOXEMM_SMU_ALM7_29_CA DINH_FId.DFC_MOXEMM_SMU_ALM7_30_CA DINH_FId.DFC_MOXEMM_SMU_ALM7_31_CA DINH_FId.DFC_MOXEMM_SMU_ALM8_0_CA DINH_FId.DFC_MOXEMM_SMU_ALM8_1_CA DINH_FId.DFC_MOXEMM_SMU_ALM8_10_CA DINH_FId.DFC_MOXEMM_SMU_ALM8_11_CA DINH_FId.DFC_MOXEMM_SMU_ALM8_12_CA DINH_FId.DFC_MOXEMM_SMU_ALM8_16_CA DINH_FId.DFC_MOXEMM_SMU_ALM8_18_CA DINH_FId.DFC_MOXEMM_SMU_ALM8_2_CA DINH_FId.DFC_MOXEMM_SMU_ALM8_3_CA DINH_FId.DFC_MOXEMM_SMU_ALM8_31_CA DINH_FId.DFC_MOXEMM_SMU_ALM8_4_CA DINH_FId.DFC_MOXEMM_SMU_ALM9_0_CA DINH_FId.DFC_MOXEMM_SMU_ALM9_15_CA DINH_FId.DFC_MOXEMM_SMU_ALM9_3_CA DINH_FId.DFC_MoCADCNTPBnk1_CA DINH_FId.DFC_MoCADCTestVoltBnk1_CA DINH_FId.DFC_MoCSOPICO_CA DINH_FId.DFC_MoFAccr_CA DINH_FId.DFC_MoFCbnPreCdngOvrheat_CA DINH_FId.DFC_MoFCbnPreCdngTmrExpi_CA DINH_FId.DFC_MoFEvMngtBms_CA DINH_FId.DFC_MoFEvMngtDcdc_CA DINH_FId.DFC_MoFEvMngtEm01_CA DINH_FId.DFC_MoFEvMngtEm01BrkgToZr_CA DINH_FId.DFC_MoFEvMngtEm01EngSpd_CA DINH_FId.DFC_MoFEvMngtEm02EngSpd_CA DINH_FId.DFC_MoFEvMngtEm02Lvl1_CA DINH_FId.DFC_MoFEvMngtEm02Lvl2_CA DINH_FId.DFC_MoFExtCptAuxCpt_CA DINH_FId.DFC_MoFExtCptVacPmpErr_CA DINH_FId.DFC_MoFTqPtdAxle_CA DINH_FId.DFC_MoFTqPtdAxleSec_CA DINH_FId.DFC_MoFTqPtdEmPtRels_CA DINH_FId.DFC_MoFTqPtdEmPtRelsSec_CA DINH_FId.DFC_MoFTqPtdEmSign_CA DINH_FId.DFC_MoFTqPtdEmSignSec_CA DINH_FId.DFC_MoFTqPtdEmTq_CA DINH_FId.DFC_MoFTqPtdEmTqSec_CA DINH_FId.DFC_MoFTqPtdVeh_CA DINH_FId.DFC_MoFVarPostBldSel_CA DINH_FId.DFC_MoSysCtrlReIni_CA DINH_FId.DFC_MoXEMMHwLTMCUFW_CA DINH_FId.DFC_MoXEMMHwLTMonBIST_CA DINH_FId.DFC_MoXEMMHwLTRegMonTest_CA DINH_FId.DFC_MoXEMMHwLTStbySMUAlvTest_CA DINH_FId.DFC_MoXEMMHwLTTempSens_CA DINH_FId.DFC_MoXEMMHwLTUCBCfg_CA DINH_FId.DFC_MonEgyChrgnCoorr_AcChrgnWoMofRels_CA DINH_FId.DFC_MonEgyChrgnCoorr_ChrgnAbortIgr_CA DINH_FId.DFC_MonEgyChrgnCoorr_DcCntctFailr_CA DINH_FId.DFC_MonEgyChrgnCoorr_ExtChrgnShtOffReq_CA DINH_FId.DFC_MonEgyChrgnCoorr_ImpsChrgnMod_CA DINH_FId.DFC_MonEgyChrgnCoorr_ImpsChrgnPrms_CA DINH_FId.DFC_MonEgyChrgnCoorr_ImpsUDcIntk_CA DINH_FId.DFC_MonEgyChrgnCoorr_PlgLockMovmt_CA DINH_FId.DFC_MonEgyChrgnCoorr_VehCrashDetn_CA DINH_FId.DFC_MonEgyChrgnErrReactn_SftySwt_CA DINH_FId.DFC_MonEgyChrgnInlet_CcsPlgCtp_CA DINH_FId.DFC_MonEgyChrgnInlet_CcsPlgCtpPwm_CA DINH_FId.DFC_MonEgyChrgnInlet_CcsPlgLockCtrlImpsAtmpt_CA DINH_FId.DFC_MonEgyChrgnInlet_CcsPlgLockSnsrSigRngChk_CA DINH_FId.DFC_MonEgyChrgnInlet_CcsPlgLockStImps_CA DINH_FId.DFC_MonEgyChrgnInlet_CcsPlgPxp_CA DINH_FId.DFC_MonEgyChrgnT_Snsr1GrdtChk_CA DINH_FId.DFC_MonEgyChrgnT_Snsr1SigRngChk_CA DINH_FId.DFC_MonEgyChrgnT_Snsr2GrdtChk_CA DINH_FId.DFC_MonEgyChrgnT_Snsr2SigRngChk_CA DINH_FId.DFC_MonEgyChrgnT_SnsrDif_CA DINH_FId.DFC_OCWDAABEActv_CA DINH_FId.DFC_OCWDACom_CA DINH_FId.DFC_OCWDAErrPin_CA DINH_FId.DFC_OCWDAOvrVltg_CA DINH_FId.DFC_PUmax_CA DINH_FId.DFC_PwmCtPTmpErr_CA DINH_FId.DFC_PwrDistbnUnitTSRCMax_CA DINH_FId.DFC_PwrDistbnUnitTTmpErr_CA DINH_FId.DFC_SCtPmp1DiagGrdKeyErr_CA DINH_FId.DFC_SRCHighAPP1_CA DINH_FId.DFC_SRCHighAPP2_CA DINH_FId.DFC_SRCLowAPP1_CA DINH_FId.DFC_SRCLowAPP2_CA DINH_FId.DFC_SWReset_0_CA DINH_FId.DFC_SWReset_1_CA DINH_FId.DFC_SWReset_2_CA DINH_FId.DFC_Sia_InvldCode_CA DINH_FId.DFC_Sia_InvldKey_CA DINH_FId.DFC_Sia_NoRespUCx_CA DINH_FId.DFC_Sia_TprotRttp_CA DINH_FId.DFC_StrtUpEvStandStillDeactvn_CA DINH_FId.DFC_SyncAPP_CA DINH_FId.DFC_UCtPSRCMax_CA DINH_FId.DFC_UCtPTmpErr_CA DINH_FId.DFC_UPxP1SRCMax_CA DINH_FId.DFC_UPxP1TmpErr_CA DINH_FId.DFC_VehVObd_CA DINH_FId.DSQ_ACCmprPwrConsol_CA DINH_FId.DSQ_ACCmprUConsol_CA DINH_FId.DSQ_BattU_CA DINH_FId.DSQ_DSMInhibitAlways_CA DINH_FId.DSQ_T15TurnOfDly_CA DINH_Lim.DFC_ACCmprFltLvlRes_CA DINH_Lim.DFC_AbgHiSigFlt_CA DINH_Lim.DFC_AbgIntPatFlt_CA DINH_Lim.DFC_AbgLoSigFlt_CA DINH_Lim.DFC_AbgUnkwnErrSigFlt_CA DINH_Lim.DFC_AcExtChrgrIBattExcdd_CA DINH_Lim.DFC_AcExtChrgrIInExcdd_CA DINH_Lim.DFC_AcExtChrgrIOutDe_CA DINH_Lim.DFC_AcExtChrgrIOutExcdd_CA DINH_Lim.DFC_AcExtChrgrUOutDe_CA DINH_Lim.DFC_AdpActvDChaFailr_CA DINH_Lim.DFC_AirbcuFlt_CA DINH_Lim.DFC_Airbg_CA DINH_Lim.DFC_AirbgCan_CA DINH_Lim.DFC_AirbgCanHWPlaus_CA DINH_Lim.DFC_AirbgHWCanPlaus_CA DINH_Lim.DFC_AirbgMnr_CA DINH_Lim.DFC_AirbgPerHi_CA DINH_Lim.DFC_AirbgPerdRngFlt_CA DINH_Lim.DFC_BlowrRlyErr_CA DINH_Lim.DFC_BrkBstPmpActtnDfct_CA DINH_Lim.DFC_BrkBstPmpDeactvnDfct_CA DINH_Lim.DFC_BrkSwtFlt_CA DINH_Lim.DFC_CbnHeatgHeatrHsScb_CA DINH_Lim.DFC_CbnHeatgHeatrHsScg_CA DINH_Lim.DFC_CbnHeatgHeatrLsOl_CA DINH_Lim.DFC_CbnHeatgHeatrLsScb_CA DINH_Lim.DFC_CbnHeatgHeatrLsScg_CA DINH_Lim.DFC_CbnHeatgHeatrUnUsed_CA DINH_Lim.DFC_ChrgnCntctHsOt_CA DINH_Lim.DFC_ChrgnCntctHsScb_CA DINH_Lim.DFC_ChrgnCntctHsScg_CA DINH_Lim.DFC_ChrgnCntctLsNegOl_CA DINH_Lim.DFC_ChrgnCntctLsNegOt_CA DINH_Lim.DFC_ChrgnCntctLsNegScb_CA DINH_Lim.DFC_ChrgnCntctLsNegScg_CA DINH_Lim.DFC_ChrgnCntctLsPosOl_CA DINH_Lim.DFC_ChrgnCntctLsPosOt_CA DINH_Lim.DFC_ChrgnCntctLsPosScb_CA DINH_Lim.DFC_ChrgnCntctLsPosScg_CA DINH_Lim.DFC_ChrgnCntctUnUsed_CA DINH_Lim.DFC_ComBrkMai_CA DINH_Lim.DFC_ComChrgrEVCont_CA DINH_Lim.DFC_ComChrgrEVtBlink_CA DINH_Lim.DFC_ComChrgrMstBlink_CA DINH_Lim.DFC_ComChrgrMstCont_CA DINH_Lim.DFC_ComChrgrSVSBlink_CA DINH_Lim.DFC_ComChrgrSVSCont_CA DINH_Lim.DFC_ComDcdcEVBlink_CA DINH_Lim.DFC_ComDcdcEVCont_CA DINH_Lim.DFC_ComDcdcFltLvl2_CA DINH_Lim.DFC_ComDcdcFltLvl3_CA DINH_Lim.DFC_ComDcdcFltLvl4_CA DINH_Lim.DFC_ComDcdcFltLvl5_CA DINH_Lim.DFC_ComDcdcFltLvlRes_CA DINH_Lim.DFC_ComDcdcMstBlink_CA DINH_Lim.DFC_ComDcdcMstCont_CA DINH_Lim.DFC_ComDcdcSVSBlink_CA DINH_Lim.DFC_ComDcdcSVSCont_CA DINH_Lim.DFC_ComElMIIvtrFltLvl2_CA DINH_Lim.DFC_ComElMIIvtrFltLvl3_CA DINH_Lim.DFC_ComElMIIvtrFltLvl4_CA DINH_Lim.DFC_ComElMIIvtrFltLvl5_CA DINH_Lim.DFC_ComElMIIvtrFltLvlRes_CA DINH_Lim.DFC_ComEmacEVBlink_CA DINH_Lim.DFC_ComEmacEVCont_CA DINH_Lim.DFC_ComEmacMstCont_CA DINH_Lim.DFC_ComEmacMsttBlink_CA DINH_Lim.DFC_ComEmacSVSBlink_CA DINH_Lim.DFC_ComEmacSVSCont_CA DINH_Lim.DFC_ComGunCntInfoWkuReq_CA DINH_Lim.DFC_ComHillHldFlt_CA DINH_Lim.DFC_ComHvBattRchrgWkuReq_CA DINH_Lim.DFC_ComHvbFltLvl2_CA DINH_Lim.DFC_ComHvbFltLvl3_CA DINH_Lim.DFC_ComHvbFltLvl4_CA DINH_Lim.DFC_ComHvbFltLvl5_CA DINH_Lim.DFC_ComHvbFltLvlRes_CA DINH_Lim.DFC_ComHvbMstBlink_CA DINH_Lim.DFC_ComHvbMstCont_CA DINH_Lim.DFC_ComImmoUnlockWkuReq_CA DINH_Lim.DFC_ComInfoReqPtlWkuReq_CA DINH_Lim.DFC_ComOBCFltLvl2_CA DINH_Lim.DFC_ComOBCFltLvl3_CA DINH_Lim.DFC_ComOBCFltLvl4_CA DINH_Lim.DFC_ComOBCFltLvl5_CA DINH_Lim.DFC_ComOBCFltLvlRes_CA DINH_Lim.DFC_ComPostOperationWkuReq_CA DINH_Lim.DFC_ComPreCondElecWkuReq_CA DINH_Lim.DFC_ComRemUnlckWkuReq_CA DINH_Lim.DFC_ComStpDlyHMIWkuReq_CA DINH_Lim.DFC_ComflgCurMeasmtErr_CA DINH_Lim.DFC_ComflgCurMeasmtSysErr_CA DINH_Lim.DFC_ComflgCurMeasmtVld_CA DINH_Lim.DFC_ComflgCurRngErr_CA DINH_Lim.DFC_ComflgTPcbMeasmtErr_CA DINH_Lim.DFC_ComflgTPcbMeasmtVld_CA DINH_Lim.DFC_ComflgTPcbRngErr_CA DINH_Lim.DFC_ComflgTPcbSysErr_CA DINH_Lim.DFC_ComflgTShntMeasmtErr_CA DINH_Lim.DFC_ComflgTShntMeasmtVld_CA DINH_Lim.DFC_ComflgTShntRngErr_CA DINH_Lim.DFC_ComflgTShntSysErr_CA DINH_Lim.DFC_ComflgVoltMeasmtErr_CA DINH_Lim.DFC_ComflgVoltMeasmtSysErr_CA DINH_Lim.DFC_ComflgVoltMeasmtVld_CA DINH_Lim.DFC_ComflgVoltRngErr_CA DINH_Lim.DFC_CrashEveOcc_CA DINH_Lim.DFC_DcdcFwdModStuck_CA DINH_Lim.DFC_DcdcLvUDifMaxFlt_CA DINH_Lim.DFC_DcdcOffModStuck_CA DINH_Lim.DFC_DcdcOperModFailr_CA DINH_Lim.DFC_DcdcPrecModStuck_CA DINH_Lim.DFC_DrvDoorOpn_CA DINH_Lim.DFC_DrvModPosnDfct_CA DINH_Lim.DFC_DrvStbltOpn_CA DINH_Lim.DFC_ETogFailrLvl3_CA DINH_Lim.DFC_ETogFailrLvl4_CA DINH_Lim.DFC_EbsLvBattSocDiagLo_CA DINH_Lim.DFC_EbsLvBattUDiagDiOper_CA DINH_Lim.DFC_EbsLvBattUDiagFltLvl1_CA DINH_Lim.DFC_EbsLvBattUDiagFltLvl2_CA DINH_Lim.DFC_EbsLvBattUDiagLo_CA DINH_Lim.DFC_EbsSnsrSt_CA DINH_Lim.DFC_EbsSofASILErr_CA DINH_Lim.DFC_ElTSPtSysLimDrvErr_CA DINH_Lim.DFC_ElTSPtSysLimRgnErr_CA DINH_Lim.DFC_HLCCcsFwDwnl_CA DINH_Lim.DFC_HvBattChrgPwrMax_CA DINH_Lim.DFC_HvBattCrashDetd_CA DINH_Lim.DFC_HvBattDchaPwrMax_CA DINH_Lim.DFC_HvBattEmgyOff_CA DINH_Lim.DFC_HvBattEmgyOffIntlck_CA DINH_Lim.DFC_HvBattEmgyOffReq_CA DINH_Lim.DFC_HvBattFltMod_CA DINH_Lim.DFC_HvBattIReqToChrgrErr_CA DINH_Lim.DFC_HvBattIReqToChrgrIni_CA DINH_Lim.DFC_HvBattIninTout_CA DINH_Lim.DFC_HvBattIntlckSt_CA DINH_Lim.DFC_HvBattIsoFlt_CA DINH_Lim.DFC_HvBattLimdPwr_CA DINH_Lim.DFC_HvBattMaiSwtClsngFlt_CA DINH_Lim.DFC_HvBattMaiSwtFlt_CA DINH_Lim.DFC_HvBattMaiSwtOpen_CA DINH_Lim.DFC_HvBattMaiSwtOpngFlt_CA DINH_Lim.DFC_HvBattMaiSwtWldd_CA DINH_Lim.DFC_HvBattNegCntctrCntErr_CA DINH_Lim.DFC_HvBattOperModChrgPlausy_CA DINH_Lim.DFC_HvBattOverTDern_CA DINH_Lim.DFC_HvBattPosCntctrCntErr_CA DINH_Lim.DFC_HvBattPrecCntctrCntErr_CA DINH_Lim.DFC_HvBattPwrDistbnTDern_CA DINH_Lim.DFC_HvBattPwrDistbnTInhbn_CA DINH_Lim.DFC_HvBattRatRSohErr_CA DINH_Lim.DFC_HvBattRatSohErr_CA DINH_Lim.DFC_HvBattSngIsoWarn_CA DINH_Lim.DFC_HvBattSrvPlgDiscnct_CA DINH_Lim.DFC_HvBattUNomChrgnErr_CA DINH_Lim.DFC_HvBattUNomChrgnIni_CA DINH_Lim.DFC_HvBattUnderTDern_CA DINH_Lim.DFC_HvbEVLmpBlink_CA DINH_Lim.DFC_HvbEVLmpCont_CA DINH_Lim.DFC_HvbSVSBlink_CA DINH_Lim.DFC_HvbSVSCont_CA DINH_Lim.DFC_InmLINBusBlk_CA DINH_Lim.DFC_PDUProgmFailr_CA DINH_Lim.DFC_PEnvSigRngMax_CA DINH_Lim.DFC_PEnvSigRngMin_CA DINH_Lim.DFC_PLnCChpDeactvnFaild_CA DINH_Lim.DFC_PrkgBrkFailr_CA DINH_Lim.DFC_PtSysLimErr_CA DINH_Lim.DFC_PwrMaxDchaShoLo_CA DINH_Lim.DFC_SCtPmp1FailSafeNotSuc_CA DINH_Lim.DFC_SCtPmp1SCG_CA DINH_Lim.DFC_VehCoornDrvrNotPrsnt_CA DINH_Lim.DFC_VehVCanAvl_CA DINH_Lim.DFC_VehVCanErr_CA DINH_Lim.DFC_eTogFailrLvlRes_CA DINH_Lim.DFC_flgBrkMaiDiag_CA DINH_Lim.DFC_stHvbIsoMeasmtRes_CA DINH_Lim.DFC_BrkBstPmpPLeakDfct_CA DINH_Lim.DFC_Com082hTooShort_CA DINH_Lim.DFC_Com092hTooShort_CA DINH_Lim.DFC_Com205hAbsent_CA DINH_Lim.DFC_Com205hChecksum_CA DINH_Lim.DFC_Com205hCounter_CA DINH_Lim.DFC_Com205hTooShort_CA DINH_Lim.DFC_Com217hAbsent_CA DINH_Lim.DFC_Com217hChecksum_CA DINH_Lim.DFC_Com217hCounter_CA DINH_Lim.DFC_Com217hTooShort_CA DINH_Lim.DFC_Com227hAbsent_CA DINH_Lim.DFC_Com227hTooShort_CA DINH_Lim.DFC_Com237hAbsent_CA DINH_Lim.DFC_Com237hChecksum_CA DINH_Lim.DFC_Com237hCounter_CA DINH_Lim.DFC_Com237hTooShort_CA DINH_Lim.DFC_Com259hAbsent_CA DINH_Lim.DFC_Com259hChecksum_CA DINH_Lim.DFC_Com259hCounter_CA DINH_Lim.DFC_Com259hTooShort_CA DINH_Lim.DFC_Com26hAbsent_CA DINH_Lim.DFC_Com26hTooShort_CA DINH_Lim.DFC_Com273hAbsent_CA DINH_Lim.DFC_Com273hChecksum_CA DINH_Lim.DFC_Com273hCounter_CA DINH_Lim.DFC_Com273hTooShort_CA DINH_Lim.DFC_Com275hAbsent_CA DINH_Lim.DFC_Com275hChecksum_CA DINH_Lim.DFC_Com275hCounter_CA DINH_Lim.DFC_Com275hTooShort_CA DINH_Lim.DFC_Com283hAbsent_CA DINH_Lim.DFC_Com283hTooShort_CA DINH_Lim.DFC_Com285hAbsent_CA DINH_Lim.DFC_Com285hChecksum_CA DINH_Lim.DFC_Com285hCounter_CA DINH_Lim.DFC_Com285hTooShort_CA DINH_Lim.DFC_Com293hAbsent_CA DINH_Lim.DFC_Com293hChecksum_CA DINH_Lim.DFC_Com293hCounter_CA DINH_Lim.DFC_Com293hTooShort_CA DINH_Lim.DFC_Com308hAbsent_CA DINH_Lim.DFC_Com308hChecksum_CA DINH_Lim.DFC_Com308hCounter_CA DINH_Lim.DFC_Com308hTooShort_CA DINH_Lim.DFC_Com318hAbsent_CA DINH_Lim.DFC_Com318hChecksum_CA DINH_Lim.DFC_Com318hCounter_CA DINH_Lim.DFC_Com318hTooShort_CA DINH_Lim.DFC_Com325hAbsent_CA DINH_Lim.DFC_Com325hChecksum_CA DINH_Lim.DFC_Com325hCounter_CA DINH_Lim.DFC_Com325hTooShort_CA DINH_Lim.DFC_Com335hAbsent_CA DINH_Lim.DFC_Com335hChecksum_CA DINH_Lim.DFC_Com335hCounter_CA DINH_Lim.DFC_Com335hTooShort_CA DINH_Lim.DFC_Com351hAbsent_CA DINH_Lim.DFC_Com351hTooShort_CA DINH_Lim.DFC_Com38DhAbsent_CA DINH_Lim.DFC_Com38DhChecksum_CA DINH_Lim.DFC_Com38DhCounter_CA DINH_Lim.DFC_Com38DhTooShort_CA DINH_Lim.DFC_Com412hAbsent_CA DINH_Lim.DFC_Com412hChecksum_CA DINH_Lim.DFC_Com412hCounter_CA DINH_Lim.DFC_Com412hTooShort_CA DINH_Lim.DFC_Com427hAbsent_CA DINH_Lim.DFC_Com427hTooShort_CA DINH_Lim.DFC_Com432hAbsent_CA DINH_Lim.DFC_Com432hChecksum_CA DINH_Lim.DFC_Com432hCounter_CA DINH_Lim.DFC_Com432hTooShort_CA DINH_Lim.DFC_Com435hAbsent_CA DINH_Lim.DFC_Com435hTooShort_CA DINH_Lim.DFC_Com442hAbsent_CA DINH_Lim.DFC_Com442hTooShort_CA DINH_Lim.DFC_Com453hAbsent_CA DINH_Lim.DFC_Com453hTooShort_CA DINH_Lim.DFC_Com455hAbsent_CA DINH_Lim.DFC_Com455hTooShort_CA DINH_Lim.DFC_Com463hAbsent_CA DINH_Lim.DFC_Com463hTooShort_CA DINH_Lim.DFC_Com473hAbsent_CA DINH_Lim.DFC_Com473hTooShort_CA DINH_Lim.DFC_Com47BhAbsent_CA DINH_Lim.DFC_Com47BhTooShort_CA DINH_Lim.DFC_Com48BhAbsent_CA DINH_Lim.DFC_Com48BhTooShort_CA DINH_Lim.DFC_Com497hTooShort_CA DINH_Lim.DFC_Com4F2hAbsent_CA DINH_Lim.DFC_Com4F2hChecksum_CA DINH_Lim.DFC_Com4F2hCounter_CA DINH_Lim.DFC_Com4F2hTooShort_CA DINH_Lim.DFC_Com50DhAbsent_CA DINH_Lim.DFC_Com50DhTooShort_CA DINH_Lim.DFC_Com535hAbsent_CA DINH_Lim.DFC_Com535hTooShort_CA DINH_Lim.DFC_Com543hAbsent_CA DINH_Lim.DFC_Com543hTooShort_CA DINH_Lim.DFC_Com552hAbsent_CA DINH_Lim.DFC_Com552hTooShort_CA DINH_Lim.DFC_Com583hAbsent_CA DINH_Lim.DFC_Com583hTooShort_CA DINH_Lim.DFC_Com592hAbsent_CA DINH_Lim.DFC_Com592hChecksum_CA DINH_Lim.DFC_Com592hCounter_CA DINH_Lim.DFC_Com592hTooShort_CA DINH_Lim.DFC_Com595hAbsent_CA DINH_Lim.DFC_Com595hChecksum_CA DINH_Lim.DFC_Com595hCounter_CA DINH_Lim.DFC_Com595hTooShort_CA DINH_Lim.DFC_Com5B2hAbsent_CA DINH_Lim.DFC_Com5B2hTooShort_CA DINH_Lim.DFC_Com5B5hAbsent_CA DINH_Lim.DFC_Com5B5hChecksum_CA DINH_Lim.DFC_Com5B5hCounter_CA DINH_Lim.DFC_Com5B5hTooShort_CA DINH_Lim.DFC_Com5C7hTooShort_CA DINH_Lim.DFC_Com5E7hAbsent_CA DINH_Lim.DFC_Com5E7hTooShort_CA DINH_Lim.DFC_Com635hTooShort_CA DINH_Lim.DFC_Com645hTooShort_CA DINH_Lim.DFC_Com663hAbsent_CA DINH_Lim.DFC_Com663hTooShort_CA DINH_Lim.DFC_Com665hAbsent_CA DINH_Lim.DFC_Com665hTooShort_CA DINH_Lim.DFC_Com675hAbsent_CA DINH_Lim.DFC_Com675hTooShort_CA DINH_Lim.DFC_ComFrbd_205h_HVBAT_PACK_CURRENT_CA DINH_Lim.DFC_ComFrbd_205h_HVBAT_SOC_DISPLAY_CA DINH_Lim.DFC_ComFrbd_205h_HVBAT_VOLTAGE_CA DINH_Lim.DFC_ComFrbd_217h_INV_DC_BUS_VOLTAGE_CA DINH_Lim.DFC_ComFrbd_217h_INV_MTR_ACTUAL_TRQ_CA DINH_Lim.DFC_ComFrbd_217h_INV_MTR_SPEED_CA DINH_Lim.DFC_ComFrbd_217h_INV_MTR_TRQ_CA DINH_Lim.DFC_ComFrbd_227h_INV_DC_CURRENT_CA DINH_Lim.DFC_ComFrbd_227h_INV_MOTORING_PEAK_TRQ_CA DINH_Lim.DFC_ComFrbd_227h_INV_MTR_INST_INPUT_POWER_CA DINH_Lim.DFC_ComFrbd_227h_INV_REGEN_PEAK_TRQ_CA DINH_Lim.DFC_ComFrbd_237h_INV_ACTIVE_DISCHARGE_STATUS_CA DINH_Lim.DFC_ComFrbd_237h_INV_CTRL_MODE_ACK_CA DINH_Lim.DFC_ComFrbd_237h_INV_EV_WARNING_CA DINH_Lim.DFC_ComFrbd_237h_INV_FAULT_LEVEL_CA DINH_Lim.DFC_ComFrbd_237h_INV_MASTER_STOP_CA DINH_Lim.DFC_ComFrbd_237h_INV_SERVICE_DUE_CA DINH_Lim.DFC_ComFrbd_237h_INV_STAB_MIN_TRQ_CA DINH_Lim.DFC_ComFrbd_259h_TGLM_FAILURE_STATE_CA DINH_Lim.DFC_ComFrbd_259h_TGLM_MODE_PUSH_CA DINH_Lim.DFC_ComFrbd_259h_TOGGLE_MONOSTABLE_POS_CA DINH_Lim.DFC_ComFrbd_273h_OBC_outputpower_capability_CA DINH_Lim.DFC_ComFrbd_275h_HVBAT_DISCHARGE_30S_AVAILABLE_CURRENT_CA DINH_Lim.DFC_ComFrbd_275h_HVBAT_DISCHARGE_30S_AVAILABLE_POWER_CA DINH_Lim.DFC_ComFrbd_283h_DCDC_IN_CURRENT_CA DINH_Lim.DFC_ComFrbd_283h_DCDC_IN_VOLTAGE_CA DINH_Lim.DFC_ComFrbd_283h_DCDC_OUT_CURRENT_CA DINH_Lim.DFC_ComFrbd_283h_DCDC_OUT_VOLTAGE_CA DINH_Lim.DFC_ComFrbd_285h_HVBAT_REGEN_CHG_30S_CURRENT_LIMIT_CA DINH_Lim.DFC_ComFrbd_285h_HVBAT_REGEN_CHRG_30S_POWER_LIMIT_CA DINH_Lim.DFC_ComFrbd_293h_DCDC_outputpower_capability_CA DINH_Lim.DFC_ComFrbd_325h_HVBAT_INSULATION_RESISTANCE_CA DINH_Lim.DFC_ComFrbd_325h_HVBAT_TEMPERATURE_CA DINH_Lim.DFC_ComFrbd_335h_HVBAT_CHRG_CONTINUOUS_CURR_MAX_CA DINH_Lim.DFC_ComFrbd_335h_HVBAT_CHRG_COTINUOUS_CURR_REQ_CA DINH_Lim.DFC_ComFrbd_335h_HVBAT_CHRG_MAX_VOLT_CA DINH_Lim.DFC_ComFrbd_335h_HVBAT_DC_BUS_VOLTAGE_CA DINH_Lim.DFC_ComFrbd_427h_INV_OP_MODE_CA DINH_Lim.DFC_ComFrbd_427h_INV_PERMISIBLE_TORQUE_CA DINH_Lim.DFC_ComFrbd_435h_HVBAT_MAX_CELL_VOLT_CA DINH_Lim.DFC_ComFrbd_435h_HVBAT_MAX_CELL_VOLT_NUM_CA DINH_Lim.DFC_ComFrbd_435h_HVBAT_MAX_SENSOR_TEMP_CA DINH_Lim.DFC_ComFrbd_435h_HVBAT_MIN_CELL_VOLT_CA DINH_Lim.DFC_ComFrbd_435h_HVBAT_MIN_CELL_VOLT_NUM_CA DINH_Lim.DFC_ComFrbd_453h_OBC_IN_CURRENT_CA DINH_Lim.DFC_ComFrbd_453h_OBC_IN_VOLTAGE_CA DINH_Lim.DFC_ComFrbd_453h_OBC_IP_POWER_CA DINH_Lim.DFC_ComFrbd_455h_HVBAT_NOMINAL_VOLTAGE_CA DINH_Lim.DFC_ComFrbd_463h_OBC_OUT_CURRENT_CA DINH_Lim.DFC_ComFrbd_463h_OBC_OUT_VOLTAGE_CA DINH_Lim.DFC_ComFrbd_463h_OBC_TEMPERATURE_CA DINH_Lim.DFC_ComFrbd_473h_DCDC_Coolant_Temperature_CA DINH_Lim.DFC_ComFrbd_473h_DCDC_TEMPERATURE_CA DINH_Lim.DFC_ComFrbd_47Bh_eCOMP_BusBarCurrent_CA DINH_Lim.DFC_ComFrbd_47Bh_eCOMP_BusBarVoltage_CA DINH_Lim.DFC_ComFrbd_47Bh_eCOMP_CompressorSpeed_CA DINH_Lim.DFC_ComFrbd_47Bh_eCOMP_IGBT_Temp_CA DINH_Lim.DFC_ComFrbd_47Bh_eCOMP_PeakPhaCurrent_CA DINH_Lim.DFC_ComFrbd_47Bh_eCOMP_Power_consumption_CA DINH_Lim.DFC_ComFrbd_48Bh_eCOMP_Fault_Level_CA DINH_Lim.DFC_ComFrbd_4F2h_VALEUR_SOC_ETENDUE_CA DINH_Lim.DFC_ComFrbd_535h_HV_BATT_TEMP_AVG_CA DINH_Lim.DFC_ComFrbd_543h_HVBAT_RESTBATTENERGY_CA DINH_Lim.DFC_ComFrbd_543h_HVBAT_SOH_CA DINH_Lim.DFC_ComFrbd_543h_HV_BATT_SOH_RES_CA DINH_Lim.DFC_ComFrbd_592h_IBATT_1_CA DINH_Lim.DFC_ComFrbd_592h_IBATT_2_CA DINH_Lim.DFC_ComFrbd_592h_IBATT_3_CA DINH_Lim.DFC_ComFrbd_592h_TEMP_BATT_CA DINH_Lim.DFC_ComFrbd_592h_U_BATT_BECB_CA DINH_Lim.DFC_ComFrbd_595h_HVBAT_TIME_TO_CHRG_80_CA DINH_Lim.DFC_ComFrbd_5B2h_TEMP_AIR_EXT_CA DINH_Lim.DFC_ComFrbd_635h_HVBAT_NEG_CONT_COUNT_SEG1_CA DINH_Lim.DFC_ComFrbd_635h_HVBAT_NEG_CONT_COUNT_SEG3_CA DINH_Lim.DFC_ComFrbd_635h_HVBAT_NEG_CONT_COUNT_SEG4_CA DINH_Lim.DFC_ComFrbd_635h_HVBAT_PST_CONT_COUNT_SEG1_CA DINH_Lim.DFC_ComFrbd_635h_HVBAT_PST_CONT_COUNT_SEG3_CA DINH_Lim.DFC_ComFrbd_635h_HVBAT_PST_CONT_COUNT_SEG4_CA DINH_Lim.DFC_ComFrbd_645h_HVBAT_PRECHRGE_CONT_COUNT_SEG1_CA DINH_Lim.DFC_ComFrbd_645h_HVBAT_PRECHRGE_CONT_COUNT_SEG2_CA DINH_Lim.DFC_ComFrbd_675h_HVBAT_REMAININGBATTCAPACITY_CA DINH_Lim.DFC_ComInvld_205h_HVBAT_CHARGING_STATUS_CA DINH_Lim.DFC_ComInvld_205h_HVBAT_PACK_CURRENT_CA DINH_Lim.DFC_ComInvld_205h_HVBAT_SOC_DISPLAY_CA DINH_Lim.DFC_ComInvld_205h_HVBAT_VOLTAGE_CA DINH_Lim.DFC_ComInvld_217h_INV_DC_BUS_VOLTAGE_CA DINH_Lim.DFC_ComInvld_217h_INV_MTR_ACTUAL_TRQ_CA DINH_Lim.DFC_ComInvld_217h_INV_MTR_SPEED_CA DINH_Lim.DFC_ComInvld_217h_INV_MTR_TRQ_CA DINH_Lim.DFC_ComInvld_227h_INV_DC_CURRENT_CA DINH_Lim.DFC_ComInvld_227h_INV_MOTORING_PEAK_TRQ_CA DINH_Lim.DFC_ComInvld_227h_INV_MTR_INST_INPUT_POWER_CA DINH_Lim.DFC_ComInvld_227h_INV_REGEN_PEAK_TRQ_CA DINH_Lim.DFC_ComInvld_237h_INV_ACTIVE_DISCHARGE_STATUS_CA DINH_Lim.DFC_ComInvld_237h_INV_FAULT_LEVEL_CA DINH_Lim.DFC_ComInvld_237h_INV_STAB_MIN_TRQ_CA DINH_Lim.DFC_ComInvld_259h_TGLM_MODE_PUSH_CA DINH_Lim.DFC_ComInvld_259h_TOGGLE_MONOSTABLE_POS_CA DINH_Lim.DFC_ComInvld_26h_AC_SWITCH_REQ_CA DINH_Lim.DFC_ComInvld_26h_BLOWER_POSITION_CA DINH_Lim.DFC_ComInvld_26h_EVAP_SENSOR_FAULT_CA DINH_Lim.DFC_ComInvld_26h_EVAP_SENSOR_VALUE_CA DINH_Lim.DFC_ComInvld_26h_POTENTIOMETER_FAULT_CA DINH_Lim.DFC_ComInvld_26h_REAR_DEFOG_REQ_CA DINH_Lim.DFC_ComInvld_26h_TEMP_POSITION_CA DINH_Lim.DFC_ComInvld_273h_OBC_FAULT_LEVEL_CA DINH_Lim.DFC_ComInvld_273h_OBC_outputpower_capability_CA DINH_Lim.DFC_ComInvld_275h_HVBAT_DISCHARGE_30S_AVAILABLE_CURRENT_CA DINH_Lim.DFC_ComInvld_275h_HVBAT_DISCHARGE_30S_AVAILABLE_POWER_CA DINH_Lim.DFC_ComInvld_283h_DCDC_IN_CURRENT_CA DINH_Lim.DFC_ComInvld_283h_DCDC_IN_VOLTAGE_CA DINH_Lim.DFC_ComInvld_283h_DCDC_OUT_CURRENT_CA DINH_Lim.DFC_ComInvld_283h_DCDC_OUT_VOLTAGE_CA DINH_Lim.DFC_ComInvld_285h_HVBAT_REGEN_CHG_30S_CURRENT_LIMIT_CA DINH_Lim.DFC_ComInvld_285h_HVBAT_REGEN_CHRG_30S_POWER_LIMIT_CA DINH_Lim.DFC_ComInvld_293h_DCDC_FAULT_LEVEL_CA DINH_Lim.DFC_ComInvld_293h_DCDC_outputpower_capability_CA DINH_Lim.DFC_ComInvld_325h_HVBAT_EPLUG_STATUS_CA DINH_Lim.DFC_ComInvld_325h_HVBAT_HVIL_STS_CA DINH_Lim.DFC_ComInvld_325h_HVBAT_INSULATION_FAULT_CA DINH_Lim.DFC_ComInvld_325h_HVBAT_INSULATION_RESISTANCE_CA DINH_Lim.DFC_ComInvld_325h_HVBAT_TEMPERATURE_CA DINH_Lim.DFC_ComInvld_335h_HVBAT_CHRG_CONTINUOUS_CURR_MAX_CA DINH_Lim.DFC_ComInvld_335h_HVBAT_CHRG_COTINUOUS_CURR_REQ_CA DINH_Lim.DFC_ComInvld_335h_HVBAT_CHRG_MAX_VOLT_CA DINH_Lim.DFC_ComInvld_335h_HVBAT_DC_BUS_VOLTAGE_CA DINH_Lim.DFC_ComInvld_38Dh_VITESSE_VEHICULE_ROUES_CA DINH_Lim.DFC_ComInvld_38Dh_VVH_INDISP_CA DINH_Lim.DFC_ComInvld_427h_INV_COOLANT_TEMP_CA DINH_Lim.DFC_ComInvld_427h_INV_MOTOR_TEMP_CA DINH_Lim.DFC_ComInvld_427h_INV_OP_MODE_CA DINH_Lim.DFC_ComInvld_427h_INV_PERMISIBLE_TORQUE_CA DINH_Lim.DFC_ComInvld_427h_INV_TEMP_CA DINH_Lim.DFC_ComInvld_432h_REVEIL_PRINCIPAL_CA DINH_Lim.DFC_ComInvld_435h_HVBAT_MAX_CELL_VOLT_CA /end DEF_CHARACTERISTIC
 FUNCTION_VERSION "30000.25.0" /end FUNCTION
/begin COMPU_METHOD DINH_FIdVerb "" TAB_VERB "%6.3" "-" COMPU_TAB_REF DINH_FIdVerb /end COMPU_METHOD
/begin COMPU_VTAB DINH_FIdVerb "" TAB_VERB 1140 0 "FId_Unused" 1 "FID_ElTSPwrChrgnOutErr" 2 "FID_ElTSPwrInActErr" 3 "FId_ACCmprFltPDiagEnad" 4 "FId_ACCmprInpErr" 5 "FId_ACpAC" 6 "FId_APP1SigPath" 7 "FId_APP2SigPath" 8 "FId_APPBrkErr" 9 "FId_APPVehVErr" 10 "FId_AcChrgrIntkTEnhdSRCMax" 11 "FId_AcChrgrIntkTFrzVal" 12 "FId_AcChrgrIntkTPhysRng" 13 "FId_AcChrgrIntkTRplVal" 14 "FId_AcChrgrIntkTSSpMon" 15 "FId_AcChrgrIntkTTmpErrCnt" 16 "FId_AcExtChrgrChrgn" 17 "FId_Airbg2MED" 18 "FId_AirbgAVSstCrash" 19 "FId_AirbgCan" 20 "FId_AirbgHw" 21 "FId_AirbgInpSigErr" 22 "FId_AirbgPWMErr" 23 "FId_AirbgPwmSrcErr" 24 "FId_BattUDiagEna" 25 "FId_BattUInvalid" 26 "FId_BattUReplcmt" 27 "FId_BattUVehVVld" 28 "FId_BlwrComErr" 29 "FId_BrkBstBrkSt" 30 "FId_BrkBstP" 31 "FId_BrkBstPEnaPrc" 32 "FId_BrkBstPFrzVal" 33 "FId_BrkBstPPlaus12FrznDfct" 34 "FId_BrkBstPPlaus12ReplcmtDfct" 35 "FId_BrkBstPReplVal" 36 "FId_BrkBstPSnsr1FrzDfct" 37 "FId_BrkBstPSnsr1ReplcmtDfct" 38 "FId_BrkBstPSnsr1SplyDfct" 39 "FId_BrkBstPSnsr2FrzDfct" 40 "FId_BrkBstPSnsr2ReplcmtDfct" 41 "FId_BrkBstPSnsr2SplyDfct" 42 "FId_BrkBstPmpActtnDiagEnad" 43 "FId_BrkBstPmpDeactvnDiagEnad" 44 "FId_BrkBstPmpLeakDiagEnad" 45 "FId_BrkBstPmpM1Err" 46 "FId_BrkBstPmpM2Err" 47 "FId_BrkBstPmpScgLsErr" 48 "FId_BrkBstPmpVacChkEna" 49 "FId_BrkBstTst" 50 "FId_BrkPlaus1Ena" 51 "FId_BrkPresAlrt" 52 "FId_BrkSigMaiCanFrzVal" 53 "FId_BrkSigMaiCanReplVal" 54 "FId_BrkStMnFinalDfct" 55 "FId_BrkStMnPrelDfct" 56 "FId_BrkStRdntFinalDfct" 57 "FId_BrkStRdntPrelDfct" 58 "FId_CanEifVehSpdVld" 59 "FId_CbnHeatgHeatrPsFlt" 60 "FId_CbnHeatgHeatrRlyDiagEnad" 61 "FId_CbnHeatgSwtFrzVal" 62 "FId_CbnHeatgSwtRplVal" 63 "FId_CbnHeatgSwtTmpErrCnt" 64 "FId_CcsDcStopChrgn" 65 "FId_CcsDcStopChrgnIDftl" 66 "FId_CcsPwrLineChpRstMonOff" 67 "FId_CcsPwrLineChpRstOff" 68 "FId_CcsPwrLineChpRstPsOff" 69 "FId_CcsPwrLineChpRstSnsr" 70 "FId_CcsPwrLineChpVccEnaMonOff" 71 "FId_CcsPwrLineChpVccEnaOff" 72 "FId_CcsPwrLineChpVccEnaPsOff" 73 "FId_CcsPwrLineChpVccEnaSnsr" 74 "FId_CcsPwrLineChpVccEnhdSRCMax" 75 "FId_CcsPwrLineChpVccFrzVal" 76 "FId_CcsPwrLineChpVccPhysRng" 77 "FId_CcsPwrLineChpVccRplVal" 78 "FId_CcsPwrLineChpVccSSpMon" 79 "FId_CcsPwrLineChpVccTmpErrCnt" 80 "FId_CcsPwrLineComChpTEnhdSRCMax" 81 "FId_CcsPwrLineComChpTFrzVal" 82 "FId_CcsPwrLineComChpTPhysRng" 83 "FId_CcsPwrLineComChpTRplVal" 84 "FId_CcsPwrLineComChpTSSpMon" 85 "FId_CcsPwrLineComChpTTmpErrCnt" 86 "FId_ChgrPlugCtpSwtSnsrActrErr" 87 "FId_ChgrPlugLockActrErr" 88 "FId_ChgrPlugLockSnsrErr" 89 "FId_ChgrPlugPxp1InhbDiagSrc" 90 "FId_ChgrPlugTPinDcErr" 91 "FId_ChrgPlgChrgrRlyWlddCcs" 92 "FId_ChrgPlugCtpDetnErr" 93 "FId_ChrgnCntctPsFlt" 94 "FId_ChrgnLmpChrgnFlt" 95 "FId_ChrgnLmpNoChrgn" 96 "FId_ChrgnUnplRqrd" 97 "FId_ChrgrRlyDcActNegErr" 98 "FId_ChrgrRlyDcActPosErr" 99 "FId_CmbdChrgnSysCntctErr" 100 "FId_CoElMDSQCanEMS01" 101 "FId_CoElMErr01" 102 "FId_CoPOMLimdPrpnHmi" 103 "FId_CoPOMMaxLimFltDetnPrim" 104 "FId_CoPOMMinLimFltDetnPrim" 105 "FId_CoPOMNoPrpnHmi" 106 "FId_CoPOMRecupPwrRednHmi" 107 "FId_CoPOMRgnInhbnPrim" 108 "FId_CoVMEvSysCptMaxErrPrim01" 109 "FId_CoVMEvSysCptMaxErrPrim02" 110 "FId_CoVMEvSysCptMaxErrPrim03" 111 "FId_CoVMEvSysCptMaxErrPrim04" 112 "FId_CoVMEvSysCptMaxErrPrim05" 113 "FId_CoVMEvSysCptMinErrPrim01" 114 "FId_CoVMEvSysCptMinErrPrim02" 115 "FId_CoVMEvSysCptMinErrPrim03" 116 "FId_CoVMEvVehVVld" 117 "FId_ComHillHldFrmErr" 118 "FId_Com_stMainWkuInvld" 119 "FId_CtPSwtActrMonOff" 120 "FId_CtPSwtActrOff" 121 "FId_CtPSwtActrPsOff" 122 "FId_CtPSwtActrSnsr" 123 "FId_CtPSwtDiagEnhdSRCMax" 124 "FId_CtPSwtDiagFrzVal" 125 "FId_CtPSwtDiagPhysRng" 126 "FId_CtPSwtDiagRplVal" 127 "FId_CtPSwtDiagSSpMon" 128 "FId_CtPSwtDiagTmpErrCnt" 129 "FId_CtpCarrFrqFrzVal" 130 "FId_CtpCarrFrqPhysRng" 131 "FId_CtpCarrFrqRplVal" 132 "FId_CtpCarrFrqSSpMon" 133 "FId_CtpCarrFrqTmpErrCnt" 134 "FId_DELibAcChrgrIntkT" 135 "FId_DELibDcChrgrIntkT" 136 "FId_DELibEnvP" 137 "FId_DELibEnvT" 138 "FId_DELibHeatrCoreT" 139 "FId_DSMAUXWucVrnt5" 140 "FId_DcChrgnCtrlChrgPrmExch" 141 "FId_DcChrgrIntkT2EnhdSRCMax" 142 "FId_DcChrgrIntkT2FrzVal" 143 "FId_DcChrgrIntkT2PhysRng" 144 "FId_DcChrgrIntkT2RplVal" 145 "FId_DcChrgrIntkT2SSpMon" 146 "FId_DcChrgrIntkT2TmpErrCnt" 147 "FId_DcChrgrIntkTEnhdSRCMax" 148 "FId_DcChrgrIntkTFrzVal" 149 "FId_DcChrgrIntkTPhysRng" 150 "FId_DcChrgrIntkTRplVal" 151 "FId_DcChrgrIntkTSSpMon" 152 "FId_DcChrgrIntkTTmpErrCnt" 153 "FId_DcdcDesOperModFwd" 154 "FId_DcdcPwrLoadMngtMaxPred" 155 "FId_DcdcUDesLvGrid" 156 "FId_DcmDspUDSStPwrLatch" 157 "FId_DrvDoorCANSigFault" 158 "FId_DrvInfoEgyAvlErr" 159 "FId_DrvModPosnApp" 160 "FId_DrvPrgSwtEna" 161 "FId_DrvStbltCANSigFault" 162 "FId_EBDLmpSig" 163 "FId_EVLmpBlnkIllmn" 164 "FId_EVLmpContIllmn" 165 "FId_EbsLinErr" 166 "FId_EemDcdcPrecErr" 167 "FId_EemDcdcUHVAct" 168 "FId_EemFltHvDcha" 169 "FId_EemFstHvShdwn" 170 "FId_EemHvBattMod" 171 "FId_EemHvOffTout" 172 "FId_EemHvShdwn" 173 "FId_EemNoHvStrtup" 174 "FId_ElMNoPrp01" 175 "FId_ElMnLim01" 176 "FId_ElMtrqLim01" 177 "FId_ElSSACCmprUFlt" 178 "FId_ElSSCabAirHtUFlt" 179 "FId_ElSSHvReqEna" 180 "FId_ElSSUHvDcBus" 181 "FId_ElTSHvIntlck" 182 "FId_EmWakeupSigMonOff" 183 "FId_EmWakeupSigOff" 184 "FId_EmWakeupSigPsOff" 185 "FId_EmWakeupSigSnsr" 186 "FId_EmacUDcLnk01" 187 "FId_EvThermLTClgDmdErr" 188 "FId_EvThermMTClgDmdErr" 189 "FId_Fan1ActrOff" 190 "FId_Fan1Mon" 191 "FId_Fan1Off" 192 "FId_Fan1PsSwtOff" 193 "FId_Fan1PwrStg" 194 "FId_FanCtlFan1Err" 195 "FId_FanRlyDiagEnad" 196 "FId_FanSpdEnhdSRCMax" 197 "FId_FanSpdFrzVal" 198 "FId_FanSpdPhysRng" 199 "FId_FanSpdRplVal" 200 "FId_FanSpdSSpMon" 201 "FId_FanSpdTmpErrCnt" 202 "FId_FansFacCor" 203 "FId_FiMFID_rba_MRly_Diag_Stk" 204 "FId_FiMFID_test" 205 "FId_FreonPEnhdSRCMax" 206 "FId_FreonPFrzVal" 207 "FId_FreonPPhysRng" 208 "FId_FreonPRplVal" 209 "FId_FreonPSSpMon" 210 "FId_FreonPTmpErrCnt" 211 "FId_GlbDaLSumvXPtd" 212 "FId_HLCCcs_CoornPLnCChipTHi" 213 "FId_HLCCcs_CoornPLnCChpT" 214 "FId_HeatrCoreTEnhdSRCMax" 215 "FId_HeatrCoreTFrzVal" 216 "FId_HeatrCoreTPhysRng" 217 "FId_HeatrCoreTRplVal" 218 "FId_HeatrCoreTSSpMon" 219 "FId_HeatrCoreTTmpErrCnt" 220 "FId_HvBattChrgLvl3DernFlt" 221 "FId_HvBattDchaLvl3DernFlt" 222 "FId_HvBattDesChrgIDern" 223 "FId_HvBattMaiSwtDiagEna" 224 "FId_HvBattMaxPwrBusTDern" 225 "FId_HvBattNegCntctrCnt" 226 "FId_HvBattPosCntctrCnt" 227 "FId_HvBattPrecCntctrCnt" 228 "FId_HvBattPwrDistbnTDern" 229 "FId_HvBattPwrDistbnTInhbn" 230 "FId_HvBattRatRSoh" 231 "FId_HvBattRatSoh" 232 "FId_HvGridAuxPwr01" 233 "FId_HvGridAuxPwr02" 234 "FId_HvGridAuxPwr03" 235 "FId_HvGridAuxPwr04" 236 "FId_HvGridDcdcPwr" 237 "FId_HvGridDcdcUSftyErr" 238 "FId_HvGridElM01USftyErr" 239 "FId_HvGridHvBattSftyLimErr" 240 "FId_HvGridMaiSwtErr" 241 "FId_HvGridPwrMaxChrgContnsErr" 242 "FId_HvGridPwrMaxChrgShoErr" 243 "FId_HvGridPwrMaxDchaContnsErr" 244 "FId_HvGridPwrMaxDchaShoErr" 245 "FId_HvacHmiFlt" 246 "FId_HvacModCoolgFlt" 247 "FId_HvacModHeatgFlt" 248 "FId_HvacPtcHeatrErr" 249 "FId_InhibitAlways" 250 "FId_InhibitNever" 251 "FId_IntlckChrgPlgActrOff" 252 "FId_IntlckChrgPlgHbrdgNotTstd" 253 "FId_IntlckChrgPlgHbrgOLErr" 254 "FId_IntlckChrgPlgMon" 255 "FId_IntlckChrgPlgPosnAdcInvld" 256 "FId_IntlckChrgPlgPsSwtOff" 257 "FId_IntlckChrgPlgPwrStg" 258 "FId_IntlckChrgPlg_VehvErr" 259 "FId_LvGridSocErr" 260 "FId_LvGridTErr" 261 "FId_LvGridTestPlsReq" 262 "FId_LvGridUErr" 263 "FId_MedTPmpFlt" 264 "FId_MedTPmpPwrCtrlRly" 265 "FId_MstWrnLmpBlink" 266 "FId_MstWrnLmpChime" 267 "FId_MstWrnLmpContIllmn" 268 "FId_PEnvCc" 269 "FId_PEnvEnaBndMdl" 270 "FId_PEnvMeasVld" 271 "FId_PEnvPlaus" 272 "FId_PEnvPrc" 273 "FId_PEnvRefSnsr" 274 "FId_PEnvSigRngVld" 275 "FId_PEnvSnsrPlaus" 276 "FId_PerfLimnActvLmpBlink" 277 "FId_PerfLimnActvLmpCont" 278 "FId_PerfLimnActvLmpContNoChime" 279 "FId_PwmCtPFrzVal" 280 "FId_PwmCtPPhysRng" 281 "FId_PwmCtPRplVal" 282 "FId_PwmCtPSSpMon" 283 "FId_PwmCtPTmpErrCnt" 284 "FId_PwrDistbnUnitTEnhdSRCMax" 285 "FId_PwrDistbnUnitTFrzVal" 286 "FId_PwrDistbnUnitTPhysRng" 287 "FId_PwrDistbnUnitTRplVal" 288 "FId_PwrDistbnUnitTSSpMon" 289 "FId_PwrDistbnUnitTTmpErrCnt" 290 "FId_SCtPmp1ActrOff" 291 "FId_SCtPmp1CircErr" 292 "FId_SCtPmp1Mon" 293 "FId_SCtPmp1Off" 294 "FId_SCtPmp1PsErr" 295 "FId_SCtPmp1PsSwtOff" 296 "FId_SCtPmp1PwrStg" 297 "FId_SCtPmp1QlySensFrzn" 298 "FId_SCtPmp1QlySensRplVal" 299 "FId_SCtPmp1_VehvErr" 300 "FId_SCtPmpRlyActrOff" 301 "FId_SCtPmpRlyMon" 302 "FId_SCtPmpRlyOff" 303 "FId_SCtPmpRlyPsSwtOff" 304 "FId_SCtPmpRlyPwrStg" 305 "FId_SVSWrnLmpBlnkIllmn" 306 "FId_SVSWrnLmpContIllmn" 307 "FId_SpplCooltPmpRlyActrOff" 308 "FId_SpplCooltPmpRlyMon" 309 "FId_SpplCooltPmpRlyOff" 310 "FId_SpplCooltPmpRlyPsSwtOff" 311 "FId_SpplCooltPmpRlyPwrStg" 312 "FId_StrtUpEvDrvAwy" 313 "FId_TelltlCooltTErr" 314 "FId_TelltlCooltTMon" 315 "FId_ThermHvacPreCdngFlt" 316 "FId_ThermModCritErr" 317 "FId_UCtPEnhdSRCMax" 318 "FId_UCtPFrzVal" 319 "FId_UCtPPhysRng" 320 "FId_UCtPRplVal" 321 "FId_UCtPSSpMon" 322 "FId_UCtPTmpErrCnt" 323 "FId_UPxP1EnhdSRCMax" 324 "FId_UPxP1FrzVal" 325 "FId_UPxP1PhysRng" 326 "FId_UPxP1RplVal" 327 "FId_UPxP1SSpMon" 328 "FId_UPxP1TmpErrCnt" 329 "FId_VMSIEvBrkFlt" 330 "FId_VMSIEvDCSRampShOff01" 331 "FId_VMSIEvDCSShOff01" 332 "FId_VMSIEvTCSRampShOff01" 333 "FId_VMSIEvTCSShOff01" 334 "FId_VMSIEvTVRampShOff01" 335 "FId_VMSIEvTVShOff01" 336 "FId_VacPmpErr" 337 "FId_VehCoornAuxAvrgEnvT" 338 "FId_VehCoornAuxAvrgPwr" 339 "FId_VehCoornAuxAvrgT" 340 "FId_VehCoornAuxAvrgVehV" 341 "FId_VehCoornDstRngPrdcDispDft" 342 "FId_VehCoornEgyRmn" 343 "FId_VehCoornErrExclChrg" 344 "FId_VehCoornErrExclDrv" 345 "FId_VehCoornHVErr" 346 "FId_VehCoornHvReq" 347 "FId_VehCoornImobTrqInhbn" 348 "FId_VehCoornPrpAvrg" 349 "FId_VehCoornRngPrdcAuxPwr" 350 "FId_VehCoornSigQualVehV" 351 "FId_VehVCANFrzVal" 352 "FId_VehVCANReplVal" 353 "FId_VehVCanSafeFrzVal" 354 "FId_VehVCanSafeReplVal" 355 "FId_VehVFrzVal" 356 "FId_VehVNActPhy01Dfct" 357 "FId_VehVReplVal" 358 "FId_VehVSigCan" 359 "FId_VehVSigCanSafe" 360 "FId_WtrPmp1Err" 361 "FId_bInhCanEif_HVBAT_NGTV_CONTACTOR_STS" 362 "FId_bInhCanEif_HVBAT_PRECHRG_CONTACTOR_STS" 363 "FId_bInhCanEif_HVBAT_PSTV_CONTACTOR_STS" 364 "FId_bInhCanEif_VCU_eBCCM_432h" 365 "FId_bInhCdtSpdVehImmo" 366 "FId_bInhComGw_Com_BMS_REMAININGBATTCAPACITY" 367 "FId_bInhComGw_Com_CONTACT_FREIN_PRK" 368 "FId_bInhComGw_Com_DCDC_IP_POWER" 369 "FId_bInhComGw_Com_HVBAT_ALERT_LOW_BATT_ENERGY" 370 "FId_bInhComGw_Com_HVBAT_CHARGING_STATUS" 371 "FId_bInhComGw_Com_HVBAT_SOC" 372 "FId_bInhComGw_Com_HVBAT_TEMPERATURE" 373 "FId_bInhComGw_Com_HVBAT_THERMAL_RUNAWAY" 374 "FId_bInhComGw_Com_HV_BATT_CELL_VOLT_MAX" 375 "FId_bInhComGw_Com_HV_BATT_CELL_VOLT_MIN" 376 "FId_bInhComGw_Com_HV_BATT_INSULATION_RESISTANCE" 377 "FId_bInhComGw_Com_HV_BATT_INSUL_FAILURE" 378 "FId_bInhComGw_Com_HV_BATT_INTERLOCK_LINE" 379 "FId_bInhComGw_Com_HV_BATT_MIN_VOLT_WARN" 380 "FId_bInhComGw_Com_HV_BATT_NB_CELL_VOLT_MAX" 381 "FId_bInhComGw_Com_HV_BATT_NB_CELL_VOLT_MIN" 382 "FId_bInhComGw_Com_HV_BATT_SOC" 383 "FId_bInhComGw_Com_HV_BATT_SOC_5C3" 384 "FId_bInhComGw_Com_HV_BATT_SOH_CAPA" 385 "FId_bInhComGw_Com_HV_BATT_SOH_RES" 386 "FId_bInhComGw_Com_HV_BATT_TEMP_AVG" 387 "FId_bInhComGw_Com_INV_MTR_INST_INPUT_POWER" 388 "FId_bInhComGw_Com_PEM_ENGINE_RPM" 389 "FId_bInhComGw_Com_PEM_ESTIM_TRQ" 390 "FId_bInhComGw_Com_PEM_INVERTER_TEMP" 391 "FId_bInhComGw_Com_PEM_INVERTOR_ALERT_TEMP" 392 "FId_bInhComGw_Com_PEM_OVERTEMP_FAILURE" 393 "FId_bInhComGw_Com_PEM_STATOR_TEMP" 394 "FId_bInhComGw_Com_VITESSE_VEHICULE_ROUES" 395 "FId_bInhComGw_Com_VVH_INDISP" 396 "FId_bInhComGw_Com_eCOMP_Power_consumption" 397 "FId_bInhComGw_MAIN_RELAY_ACTUATION_COUNTER" 398 "FId_bInhComGw_TIME_HV_BATT_OVER_TEMPERATURE" 399 "FId_bInhComGw_TOTAL_HV_BATT_POS_QTY_CURR" 400 "FId_bInhDiag_CLUSTER_5E7" 401 "FId_bInhDiag_CONTEXTE_1_5B2" 402 "FId_bInhDiag_DAT3_BSI_4F2h" 403 "FId_bInhDiag_DCDC_283h" 404 "FId_bInhDiag_DCDC_293h" 405 "FId_bInhDiag_DCDC_473h" 406 "FId_bInhDiag_DCDC_663h" 407 "FId_bInhDiag_HS3_AUTO_GEARBOX_SWITCH_STATUS" 408 "FId_bInhDiag_HVAC_PANEL_26h" 409 "FId_bInhDiag_HVBAT_205h" 410 "FId_bInhDiag_HVBAT_275h" 411 "FId_bInhDiag_HVBAT_285h" 412 "FId_bInhDiag_HVBAT_325h" 413 "FId_bInhDiag_HVBAT_335h" 414 "FId_bInhDiag_HVBAT_455h" 415 "FId_bInhDiag_HVBAT_535" 416 "FId_bInhDiag_HVBAT_595h" 417 "FId_bInhDiag_HVBAT_635h" 418 "FId_bInhDiag_HVBAT_645h" 419 "FId_bInhDiag_HVBAT_665h" 420 "FId_bInhDiag_HVBAT_675h" 421 "FId_bInhDiag_HVBAT_THERMAL_5B5" 422 "FId_bInhDiag_HVBAT_VCU_435h" 423 "FId_bInhDiag_HVBAT_VCU_543" 424 "FId_bInhDiag_HVBAT_VCU_583" 425 "FId_bInhDiag_INV_217h" 426 "FId_bInhDiag_INV_227h" 427 "FId_bInhDiag_INV_237" 428 "FId_bInhDiag_INV_427h" 429 "FId_bInhDiag_INV_497h" 430 "FId_bInhDiag_INV_IMMO_5C7" 431 "FId_bInhDiag_IS_DAT6_BSI_592h" 432 "FId_bInhDiag_IS_DAT_ABR_50Dh" 433 "FId_bInhDiag_IS_DAT_BSI_412h" 434 "FId_bInhDiag_IS_DYN_ABR_38Dh" 435 "FId_bInhDiag_IS_INTE_ELECTRON_BSI_092h" 436 "FId_bInhDiag_OBC_273h" 437 "FId_bInhDiag_OBC_453h" 438 "FId_bInhDiag_OBC_463h" 439 "FId_bInhDiag_PDU_BusVoltages_308" 440 "FId_bInhDiag_PDU_Current_318" 441 "FId_bInhDiag_SC_INFO_BCCM_442h" 442 "FId_bInhDiag_VCU_AIRBAG_351h" 443 "FId_bInhDiag_VCU_eBCCM_432h" 444 "FId_bInhDiag_VCU_eBCCM_552h" 445 "FId_bInhDiag_eBCCM_082h" 446 "FId_bInhDiag_eCOMP_Information_47B" 447 "FId_bInhDiag_eCOMP_Information_48B" 448 "FId_bInhFrbd_ComChrgr_iAcMax" 449 "FId_bInhFrbd_ComChrgr_iDcHvAct" 450 "FId_bInhFrbd_ComChrgr_pwrInAct" 451 "FId_bInhFrbd_ComChrgr_pwrOutpCpby" 452 "FId_bInhFrbd_ComChrgr_tChrgrMaxAct" 453 "FId_bInhFrbd_ComChrgr_uAcActL1" 454 "FId_bInhFrbd_ComChrgr_uDcHvAct" 455 "FId_bInhFrbd_ComEmac_iDcLnk01" 456 "FId_bInhFrbd_ComEmac_nAct01" 457 "FId_bInhFrbd_ComEmac_pwrInstnsInpRx" 458 "FId_bInhFrbd_ComEmac_stActvDcha" 459 "FId_bInhFrbd_ComEmac_stEVLmp" 460 "FId_bInhFrbd_ComEmac_stIvtrOpMod01" 461 "FId_bInhFrbd_ComEmac_stMod01Rx" 462 "FId_bInhFrbd_ComEmac_stMstWrnLmp" 463 "FId_bInhFrbd_ComEmac_stSVSLmp" 464 "FId_bInhFrbd_ComEmac_tqAbsltMax01" 465 "FId_bInhFrbd_ComEmac_tqAbsltMaxRx01" 466 "FId_bInhFrbd_ComEmac_tqAbsltMin01" 467 "FId_bInhFrbd_ComEmac_tqAbsltMinRx01" 468 "FId_bInhFrbd_ComEmac_tqAckd01" 469 "FId_bInhFrbd_ComEmac_tqAct01" 470 "FId_bInhFrbd_ComEmac_tqPtd01" 471 "FId_bInhFrbd_ComEmac_tqStabnMin" 472 "FId_bInhFrbd_ComEmac_uDcLnk01" 473 "FId_bInhFrbd_Com_HvbMaxSnsrTempRx" 474 "FId_bInhFrbd_Com_ctHvbNegCntctrSeg1" 475 "FId_bInhFrbd_Com_ctHvbNegCntctrSeg3" 476 "FId_bInhFrbd_Com_ctHvbNegCntctrSeg4" 477 "FId_bInhFrbd_Com_ctHvbPosCntctrSeg1" 478 "FId_bInhFrbd_Com_ctHvbPosCntctrSeg3" 479 "FId_bInhFrbd_Com_ctHvbPosCntctrSeg4" 480 "FId_bInhFrbd_Com_ctHvbPrecCntctrSeg1" 481 "FId_bInhFrbd_Com_ctHvbPrecCntctrSeg2" 482 "FId_bInhFrbd_Com_egyHvbAvl_fRx" 483 "FId_bInhFrbd_Com_flgEcoNormReqRx" 484 "FId_bInhFrbd_Com_iBattEBS1Rx" 485 "FId_bInhFrbd_Com_iBattEBS2Rx" 486 "FId_bInhFrbd_Com_iBattEBS3Rx" 487 "FId_bInhFrbd_Com_iDcdcHvActRvsn1" 488 "FId_bInhFrbd_Com_iDcdcLvActRvsn1" 489 "FId_bInhFrbd_Com_iElCmprHvAct" 490 "FId_bInhFrbd_Com_iElCmprPeakPha" 491 "FId_bInhFrbd_Com_iHvbActRx" 492 "FId_bInhFrbd_Com_iHvbChrgMaxSho" 493 "FId_bInhFrbd_Com_iHvbDchaMaxSho" 494 "FId_bInhFrbd_Com_iHvbDes" 495 "FId_bInhFrbd_Com_iHvbNomChrgn" 496 "FId_bInhFrbd_Com_nElCmprActl" 497 "FId_bInhFrbd_Com_nrSerMaxCell" 498 "FId_bInhFrbd_Com_nrSerMinCell" 499 "FId_bInhFrbd_Com_pwrDcdcOutpCpby" 500 "FId_bInhFrbd_Com_pwrElCmprActl" 501 "FId_bInhFrbd_Com_pwrMaxChrgSho" 502 "FId_bInhFrbd_Com_pwrMaxDchaSho" 503 "FId_bInhFrbd_Com_qHvbTotCpRx" 504 "FId_bInhFrbd_Com_rHvbIsoMeasmt" 505 "FId_bInhFrbd_Com_ratHvbSoc" 506 "FId_bInhFrbd_Com_ratHvbSoh" 507 "FId_bInhFrbd_Com_ratRHvbSoh" 508 "FId_bInhFrbd_Com_ratSocLvBatt" 509 "FId_bInhFrbd_Com_stElCmprFltLvl" 510 "FId_bInhFrbd_Com_stGearLvrPos" 511 "FId_bInhFrbd_Com_stIIvtrFltLvl01" 512 "FId_bInhFrbd_Com_steTogFailrLvl" 513 "FId_bInhFrbd_Com_tDcdcAct" 514 "FId_bInhFrbd_Com_tDcdcInltCoolt" 515 "FId_bInhFrbd_Com_tElCmprActl" 516 "FId_bInhFrbd_Com_tEnvT" 517 "FId_bInhFrbd_Com_tHvbAct" 518 "FId_bInhFrbd_Com_tHvbMax" 519 "FId_bInhFrbd_Com_tLvBatt" 520 "FId_bInhFrbd_Com_tiHvbChrgnHalfRx" 521 "FId_bInhFrbd_Com_uBattEBSRx" 522 "FId_bInhFrbd_Com_uDcdcHvAct" 523 "FId_bInhFrbd_Com_uDcdcLvAct" 524 "FId_bInhFrbd_Com_uElCmprHvAct" 525 "FId_bInhFrbd_Com_uHvbAct" 526 "FId_bInhFrbd_Com_uHvbDcBus" 527 "FId_bInhFrbd_Com_uHvbLimHi" 528 "FId_bInhFrbd_Com_uHvbMaxCell" 529 "FId_bInhFrbd_Com_uHvbMinCell" 530 "FId_bInhFrbd_Com_uHvbNomChrgn" 531 "FId_bInhInvld_ComChrgr_flgChrgrErrLvl" 532 "FId_bInhInvld_ComChrgr_iAcMax" 533 "FId_bInhInvld_ComChrgr_iDcHvAct" 534 "FId_bInhInvld_ComChrgr_pwrInAct" 535 "FId_bInhInvld_ComChrgr_pwrOutpCpby" 536 "FId_bInhInvld_ComChrgr_tChrgrMaxAct" 537 "FId_bInhInvld_ComChrgr_uAcActL1" 538 "FId_bInhInvld_ComChrgr_uDcHvAct" 539 "FId_bInhInvld_ComEmac_iDcLnk01" 540 "FId_bInhInvld_ComEmac_nAct01" 541 "FId_bInhInvld_ComEmac_pwrInstnsInpRx" 542 "FId_bInhInvld_ComEmac_stActvDcha" 543 "FId_bInhInvld_ComEmac_stIvtrOpMod01" 544 "FId_bInhInvld_ComEmac_tInvr01" 545 "FId_bInhInvld_ComEmac_tIvtrCooltIn01" 546 "FId_bInhInvld_ComEmac_tMac01" 547 "FId_bInhInvld_ComEmac_tqAbsltMax01" 548 "FId_bInhInvld_ComEmac_tqAbsltMaxRx01" 549 "FId_bInhInvld_ComEmac_tqAbsltMin01" 550 "FId_bInhInvld_ComEmac_tqAbsltMinRx01" 551 "FId_bInhInvld_ComEmac_tqAckd01" 552 "FId_bInhInvld_ComEmac_tqAct01" 553 "FId_bInhInvld_ComEmac_tqPtd01" 554 "FId_bInhInvld_ComEmac_tqStabnMin" 555 "FId_bInhInvld_ComEmac_uDcLnk01" 556 "FId_bInhInvld_Com_HvbMaxSnsrTempRx" 557 "FId_bInhInvld_Com_ctHvbNegCntctrSeg1" 558 "FId_bInhInvld_Com_ctHvbNegCntctrSeg3" 559 "FId_bInhInvld_Com_ctHvbNegCntctrSeg4" 560 "FId_bInhInvld_Com_ctHvbPosCntctrSeg1" 561 "FId_bInhInvld_Com_ctHvbPosCntctrSeg3" 562 "FId_bInhInvld_Com_ctHvbPosCntctrSeg4" 563 "FId_bInhInvld_Com_ctHvbPrecCntctrSeg1" 564 "FId_bInhInvld_Com_ctHvbPrecCntctrSeg2" 565 "FId_bInhInvld_Com_egyHvbAvl_fRx" 566 "FId_bInhInvld_Com_flgEcoNormReqRx" 567 "FId_bInhInvld_Com_flgVehSpdAvl" 568 "FId_bInhInvld_Com_iBattEBS1Rx" 569 "FId_bInhInvld_Com_iBattEBS2Rx" 570 "FId_bInhInvld_Com_iBattEBS3Rx" 571 "FId_bInhInvld_Com_iDcdcHvActRvsn1" 572 "FId_bInhInvld_Com_iDcdcLvActRvsn1" 573 "FId_bInhInvld_Com_iElCmprHvAct" 574 "FId_bInhInvld_Com_iElCmprPeakPha" 575 "FId_bInhInvld_Com_iHvbActRx" 576 "FId_bInhInvld_Com_iHvbChrgMaxSho" 577 "FId_bInhInvld_Com_iHvbDchaMaxSho" 578 "FId_bInhInvld_Com_iHvbDes" 579 "FId_bInhInvld_Com_iHvbNomChrgn" 580 "FId_bInhInvld_Com_lDstGlbDa" 581 "FId_bInhInvld_Com_lTotOdometer" 582 "FId_bInhInvld_Com_nElCmprActl" 583 "FId_bInhInvld_Com_nrSerMaxCell" 584 "FId_bInhInvld_Com_nrSerMinCell" 585 "FId_bInhInvld_Com_pwrDcdcOutpCpby" 586 "FId_bInhInvld_Com_pwrElCmprActl" 587 "FId_bInhInvld_Com_pwrMaxChrgSho" 588 "FId_bInhInvld_Com_pwrMaxDchaSho" 589 "FId_bInhInvld_Com_qHvbTotCpRx" 590 "FId_bInhInvld_Com_rHvbIsoMeasmt" 591 "FId_bInhInvld_Com_ratHvbSoc" 592 "FId_bInhInvld_Com_ratHvbSoh" 593 "FId_bInhInvld_Com_ratRHvbSoh" 594 "FId_bInhInvld_Com_ratSocLvBatt" 595 "FId_bInhInvld_Com_stAC" 596 "FId_bInhInvld_Com_stAlrtThermRunAwy" 597 "FId_bInhInvld_Com_stBlowrRly" 598 "FId_bInhInvld_Com_stDcdcFltLvl" 599 "FId_bInhInvld_Com_stEvapTFlt" 600 "FId_bInhInvld_Com_stGearLvrPos" 601 "FId_bInhInvld_Com_stHvacBlwrFront" 602 "FId_bInhInvld_Com_stHvacKnobPosn" 603 "FId_bInhInvld_Com_stHvacPanPotiFlt" 604 "FId_bInhInvld_Com_stHvbChrgn" 605 "FId_bInhInvld_Com_stHvbDiscnctReas" 606 "FId_bInhInvld_Com_stHvbIntlckRx" 607 "FId_bInhInvld_Com_stHvbIsoFltRx" 608 "FId_bInhInvld_Com_stHvbSrvPlgRx" 609 "FId_bInhInvld_Com_stIBattEBS" 610 "FId_bInhInvld_Com_stIIvtrFltLvl01" 611 "FId_bInhInvld_Com_stMainWkuReq" 612 "FId_bInhInvld_Com_stReFogReq" 613 "FId_bInhInvld_Com_stSocRx" 614 "FId_bInhInvld_Com_stT" 615 "FId_bInhInvld_Com_tDcdcAct" 616 "FId_bInhInvld_Com_tDcdcInltCoolt" 617 "FId_bInhInvld_Com_tElCmprActl" 618 "FId_bInhInvld_Com_tEnvT" 619 "FId_bInhInvld_Com_tEvapT" 620 "FId_bInhInvld_Com_tHvbAct" 621 "FId_bInhInvld_Com_tHvbMax" 622 "FId_bInhInvld_Com_tLvBatt" 623 "FId_bInhInvld_Com_tiCurVehTmr" 624 "FId_bInhInvld_Com_tiHvbChrgnHalfRx" 625 "FId_bInhInvld_Com_uBattEBSRx" 626 "FId_bInhInvld_Com_uDcdcHvAct" 627 "FId_bInhInvld_Com_uDcdcLvAct" 628 "FId_bInhInvld_Com_uElCmprHvAct" 629 "FId_bInhInvld_Com_uHvbAct" 630 "FId_bInhInvld_Com_uHvbDcBus" 631 "FId_bInhInvld_Com_uHvbLimHi" 632 "FId_bInhInvld_Com_uHvbMaxCell" 633 "FId_bInhInvld_Com_uHvbMinCell" 634 "FId_bInhInvld_Com_uHvbNomChrgn" 635 "FId_bInhInvld_Com_vVeh" 636 "FId_bInh_ACCmpr_pwrLimMax" 637 "FId_bInh_ACCtl_flgCmprEna" 638 "FId_bInh_ACCtl_nCmprSpdReq" 639 "FId_bInh_APP_rInp" 640 "FId_bInh_BattId_numOrganNature1" 641 "FId_bInh_BattId_numOrganNature2" 642 "FId_bInh_BattId_numOrganRef1" 643 "FId_bInh_BattId_numOrganRef2" 644 "FId_bInh_BattId_numOrganRef3" 645 "FId_bInh_BattId_numOrganRef4" 646 "FId_bInh_BattId_numSerl1" 647 "FId_bInh_BattId_numSerl2" 648 "FId_bInh_BattId_numSerl3" 649 "FId_bInh_BattId_numSerl4" 650 "FId_bInh_BattId_numSerl5" 651 "FId_bInh_BattId_numSerl6" 652 "FId_bInh_BattId_numSerl7" 653 "FId_bInh_Brk_stRed" 654 "FId_bInh_CbnHeatgHeatr_cntrRlyLf" 655 "FId_bInh_ChgrPlug_stPlgLockTx" 656 "FId_bInh_ChrgCntct_nrNegCntctElpdOper" 657 "FId_bInh_ChrgCntct_nrPosCntctElpdOper" 658 "FId_bInh_ChrgrRly_stRlyDes" 659 "FId_bInh_ChrgrVal_iChrgrDes" 660 "FId_bInh_ChrgrVal_iGridLimMax" 661 "FId_bInh_ChrgrVal_uHvMax" 662 "FId_bInh_CoDrvPITh_stEPSModeReq" 663 "FId_bInh_CoPtFH_stPwt" 664 "FId_bInh_ComChrg_stMod" 665 "FId_bInh_ComChrgn_iDcRly_Sq_Frz" 666 "FId_bInh_ComChrgn_uDcRly_Sq_Frz" 667 "FId_bInh_ComChrgr_flgChrgrErr_Sq_Frz" 668 "FId_bInh_ComChrgr_iAcMax_Sq_Frz" 669 "FId_bInh_ComChrgr_iDcHvAct_Sq_Frz" 670 "FId_bInh_ComChrgr_pwrInAct_Sq_Frz" 671 "FId_bInh_ComChrgr_stChrgnEna" 672 "FId_bInh_ComChrgr_stChrgr_Sq_Frz" 673 "FId_bInh_ComChrgr_tChrgrMaxAct_Sq_Frz" 674 "FId_bInh_ComChrgr_uAcActL1_Sq_Frz" 675 "FId_bInh_ComChrgr_uDcHvAct_Sq_Frz" 676 "FId_bInh_ComEmac_flgSvsReq01_Sq_Frz" 677 "FId_bInh_ComEmac_tIvtrCoolt01_Sq_Frz" 678 "FId_bInh_Com_25h_B1b0" 679 "FId_bInh_Com_25h_B1b2" 680 "FId_bInh_Com_25h_B1b4" 681 "FId_bInh_Com_25h_B1b6" 682 "FId_bInh_Com_HvbMaxSnsrTempTx" 683 "FId_bInh_Com_TogLedDrv" 684 "FId_bInh_Com_TogLedMod" 685 "FId_bInh_Com_TogLedNeut" 686 "FId_bInh_Com_TogLedRvs" 687 "FId_bInh_Com_bAcLedReq" 688 "FId_bInh_Com_bDiagMuxCAN" 689 "FId_bInh_Com_bGunCntInfoWkuReq" 690 "FId_bInh_Com_bHvBattRchrgWkuReq" 691 "FId_bInh_Com_bPostOperationWkuReq" 692 "FId_bInh_Com_bReFogRlySt" 693 "FId_bInh_Com_flgBlowrAuthn" 694 "FId_bInh_Com_flgBlowrRlyCtrl" 695 "FId_bInh_Com_flgBrkAlrt" 696 "FId_bInh_Com_flgDrvAwy" 697 "FId_bInh_Com_flgVehSpdQly" 698 "FId_bInh_Com_iDcdcHvActRvsn1_Sq_Frz" 699 "FId_bInh_Com_iDcdcLvActRvsn1_Sq_Frz" 700 "FId_bInh_Com_iElCmprHvAct_Sq_Frz" 701 "FId_bInh_Com_iHvbActTx" 702 "FId_bInh_Com_nElCmprActlTx" 703 "FId_bInh_Com_nIvtrMotAct01" 704 "FId_bInh_Com_noEditCal" 705 "FId_bInh_Com_noEditSw" 706 "FId_bInh_Com_noVerSysDay" 707 "FId_bInh_Com_noVersAdp" 708 "FId_bInh_Com_noVersSw" 709 "FId_bInh_Com_noVersSys" 710 "FId_bInh_Com_noVersSysMnth" 711 "FId_bInh_Com_noVersSysYr" 712 "FId_bInh_Com_ratHvbSoh_Sq_Frz" 713 "FId_bInh_Com_stACTx" 714 "FId_bInh_Com_stBrk" 715 "FId_bInh_Com_stBrkBstPFlt" 716 "FId_bInh_Com_stBrkCntctIndcn" 717 "FId_bInh_Com_stChrgPlg" 718 "FId_bInh_Com_stChrgPlgChrgn" 719 "FId_bInh_Com_stClstrStopIndcn" 720 "FId_bInh_Com_stCmdHvBattCntctr" 721 "FId_bInh_Com_stCmdOffsEM01" 722 "FId_bInh_Com_stDcdcOperModAct_Sq_Frz" 723 "FId_bInh_Com_stDrvAwyDi" 724 "FId_bInh_Com_stDrvModPosn" 725 "FId_bInh_Com_stEVLmp" 726 "FId_bInh_Com_stElCmprStatTx" 727 "FId_bInh_Com_stElMDesEem" 728 "FId_bInh_Com_stHvBattOperModDes" 729 "FId_bInh_Com_stHvacBlwrFront_CAN" 730 "FId_bInh_Com_stHvacKnobPosn_CAN" 731 "FId_bInh_Com_stMstWrnLmp" 732 "FId_bInh_Com_stNwCmdLIN" 733 "FId_bInh_Com_stPwrLimnLmp" 734 "FId_bInh_Com_stReFogReq_CAN" 735 "FId_bInh_Com_stSrvLmp" 736 "FId_bInh_Com_stVehCoorn" 737 "FId_bInh_Com_tDcdcAct_Sq_Frz" 738 "FId_bInh_Com_tDcdcInltCoolt_Sq" 739 "FId_bInh_Com_tqMotLimMax" 740 "FId_bInh_Com_uDcdcHvAct_Sq_Frz" 741 "FId_bInh_Com_uDcdcLvAct_Sq_Frz" 742 "FId_bInh_Com_uHvbActTx" 743 "FId_bInh_Com_valEepOffsEM01" 744 "FId_bInh_DcChrgnRly_ctMaxOperCyc" 745 "FId_bInh_Dcdc_flgDesLvGridULim" 746 "FId_bInh_Dcdc_iLimLvGrid" 747 "FId_bInh_Dcdc_stDesDcdc" 748 "FId_bInh_Dcdc_uDesLvGrid" 749 "FId_bInh_DrvInfo_wTotTripEgy" 750 "FId_bInh_EChrDv_cntPlin" 751 "FId_bInh_Eem_flgFstHvShdwn" 752 "FId_bInh_ElM_stDesEem01" 753 "FId_bInh_ElTS_egyTotChrgCyc" 754 "FId_bInh_ElTS_ratEmPowChrgn" 755 "FId_bInh_ElTS_ratEmPowDcha" 756 "FId_bInh_ElTS_stChrgCyc" 757 "FId_bInh_Emac_stIsoMonSwtReq" 758 "FId_bInh_Emac_tqDesCom01" 759 "FId_bInh_Ext_bSyncGPC" 760 "FId_bInh_HvBatt_flgIsoMeasmtDiReq" 761 "FId_bInh_HvBatt_ratSoc" 762 "FId_bInh_HvGrid_pwrMaxDcdc" 763 "FId_bInh_HvacPtc_stElHeatr" 764 "FId_bInh_Pdu_CLUSTER_5E7_Frz" 765 "FId_bInh_Pdu_CLUSTER_5E7_Rcf" 766 "FId_bInh_Pdu_CONTEXTE_1_5B2_Frz" 767 "FId_bInh_Pdu_CONTEXTE_1_5B2_Rcf" 768 "FId_bInh_Pdu_Com_pwrMaxChrgSho_Sq_Frz" 769 "FId_bInh_Pdu_Com_pwrMaxDchaSho_Sq_Frz" 770 "FId_bInh_Pdu_DAT3_BSI_4F2h_Frz" 771 "FId_bInh_Pdu_DAT3_BSI_4F2h_Rcf" 772 "FId_bInh_Pdu_DCDC_283h_Frz" 773 "FId_bInh_Pdu_DCDC_283h_Rcf" 774 "FId_bInh_Pdu_DCDC_293h_Frz" 775 "FId_bInh_Pdu_DCDC_293h_Rcf" 776 "FId_bInh_Pdu_DCDC_473h_Frz" 777 "FId_bInh_Pdu_DCDC_473h_Rcf" 778 "FId_bInh_Pdu_DCDC_663h_Frz" 779 "FId_bInh_Pdu_DCDC_663h_Rcf" 780 "FId_bInh_Pdu_HS3_AUTO_GEARBOX_SWITCH_STATUS_Frz" 781 "FId_bInh_Pdu_HS3_AUTO_GEARBOX_SWITCH_STATUS_Rcf" 782 "FId_bInh_Pdu_HVAC_PANEL_26h_Frz" 783 "FId_bInh_Pdu_HVAC_PANEL_26h_Rcf" 784 "FId_bInh_Pdu_HVBAT_205h_Frz" 785 "FId_bInh_Pdu_HVBAT_205h_Rcf" 786 "FId_bInh_Pdu_HVBAT_275h_Frz" 787 "FId_bInh_Pdu_HVBAT_275h_Rcf" 788 "FId_bInh_Pdu_HVBAT_285h_Frz" 789 "FId_bInh_Pdu_HVBAT_285h_Rcf" 790 "FId_bInh_Pdu_HVBAT_325h_Frz" 791 "FId_bInh_Pdu_HVBAT_325h_Rcf" 792 "FId_bInh_Pdu_HVBAT_335h_Frz" 793 "FId_bInh_Pdu_HVBAT_335h_Rcf" 794 "FId_bInh_Pdu_HVBAT_455h_Frz" 795 "FId_bInh_Pdu_HVBAT_455h_Rcf" 796 "FId_bInh_Pdu_HVBAT_535_Frz" 797 "FId_bInh_Pdu_HVBAT_535_Rcf" 798 "FId_bInh_Pdu_HVBAT_595h_Frz" 799 "FId_bInh_Pdu_HVBAT_595h_Rcf" 800 "FId_bInh_Pdu_HVBAT_635h_Frz" 801 "FId_bInh_Pdu_HVBAT_635h_Rcf" 802 "FId_bInh_Pdu_HVBAT_645h_Frz" 803 "FId_bInh_Pdu_HVBAT_645h_Rcf" 804 "FId_bInh_Pdu_HVBAT_665h_Frz" 805 "FId_bInh_Pdu_HVBAT_665h_Rcf" 806 "FId_bInh_Pdu_HVBAT_675h_Frz" 807 "FId_bInh_Pdu_HVBAT_675h_Rcf" 808 "FId_bInh_Pdu_HVBAT_THERMAL_5B5_Frz" 809 "FId_bInh_Pdu_HVBAT_THERMAL_5B5_Rcf" 810 "FId_bInh_Pdu_HVBAT_VCU_435h_Frz" 811 "FId_bInh_Pdu_HVBAT_VCU_435h_Rcf" 812 "FId_bInh_Pdu_HVBAT_VCU_543_Frz" 813 "FId_bInh_Pdu_HVBAT_VCU_543_Rcf" 814 "FId_bInh_Pdu_HVBAT_VCU_583_Frz" 815 "FId_bInh_Pdu_HVBAT_VCU_583_Rcf" 816 "FId_bInh_Pdu_INV_217h_Frz" 817 "FId_bInh_Pdu_INV_217h_Rcf" 818 "FId_bInh_Pdu_INV_227h_Frz" 819 "FId_bInh_Pdu_INV_227h_Rcf" 820 "FId_bInh_Pdu_INV_237_Frz" 821 "FId_bInh_Pdu_INV_237_Rcf" 822 "FId_bInh_Pdu_INV_427h_Frz" 823 "FId_bInh_Pdu_INV_427h_Rcf" 824 "FId_bInh_Pdu_INV_497h_Frz" 825 "FId_bInh_Pdu_INV_497h_Rcf" 826 "FId_bInh_Pdu_INV_IMMO_5C7_Frz" 827 "FId_bInh_Pdu_INV_IMMO_5C7_Rcf" 828 "FId_bInh_Pdu_IS_DAT6_BSI_592h_Frz" 829 "FId_bInh_Pdu_IS_DAT6_BSI_592h_Rcf" 830 "FId_bInh_Pdu_IS_DAT_ABR_50Dh_Frz" 831 "FId_bInh_Pdu_IS_DAT_ABR_50Dh_Rcf" 832 "FId_bInh_Pdu_IS_DAT_BSI_412h_Frz" 833 "FId_bInh_Pdu_IS_DAT_BSI_412h_Rcf" 834 "FId_bInh_Pdu_IS_DYN_ABR_38Dh_Frz" 835 "FId_bInh_Pdu_IS_DYN_ABR_38Dh_Rcf" 836 "FId_bInh_Pdu_IS_INTE_ELECTRON_BSI_092h_Frz" 837 "FId_bInh_Pdu_IS_INTE_ELECTRON_BSI_092h_Rcf" 838 "FId_bInh_Pdu_OBC_273h_Frz" 839 "FId_bInh_Pdu_OBC_273h_Rcf" 840 "FId_bInh_Pdu_OBC_453h_Frz" 841 "FId_bInh_Pdu_OBC_453h_Rcf" 842 "FId_bInh_Pdu_OBC_463h_Frz" 843 "FId_bInh_Pdu_OBC_463h_Rcf" 844 "FId_bInh_Pdu_PDU_BusVoltages_308_Frz" 845 "FId_bInh_Pdu_PDU_BusVoltages_308_Rcf" 846 "FId_bInh_Pdu_PDU_Current_318_Frz" 847 "FId_bInh_Pdu_PDU_Current_318_Rcf" 848 "FId_bInh_Pdu_SC_INFO_BCCM_442h_Frz" 849 "FId_bInh_Pdu_SC_INFO_BCCM_442h_Rcf" 850 "FId_bInh_Pdu_VCU_AIRBAG_351h_Frz" 851 "FId_bInh_Pdu_VCU_AIRBAG_351h_Rcf" 852 "FId_bInh_Pdu_VCU_AIRBAG_fault_Frz" 853 "FId_bInh_Pdu_VCU_eBCCM_432h_Frz" 854 "FId_bInh_Pdu_VCU_eBCCM_432h_Rcf" 855 "FId_bInh_Pdu_VCU_eBCCM_552h_Frz" 856 "FId_bInh_Pdu_VCU_eBCCM_552h_Rcf" 857 "FId_bInh_Pdu_eBCCM_082h_Frz" 858 "FId_bInh_Pdu_eBCCM_082h_Rcf" 859 "FId_bInh_Pdu_eCOMP_Information_47B_Frz" 860 "FId_bInh_Pdu_eCOMP_Information_47B_Rcf" 861 "FId_bInh_Pdu_eCOMP_Information_48B_Frz" 862 "FId_bInh_Pdu_eCOMP_Information_48B_Rcf" 863 "FId_bInh_Sig205h_Com_iHvbActRx_Frz" 864 "FId_bInh_Sig205h_Com_iHvbActRx_Rcf" 865 "FId_bInh_Sig205h_Com_ratHvbSoc_Frz" 866 "FId_bInh_Sig205h_Com_ratHvbSoc_Rcf" 867 "FId_bInh_Sig205h_Com_stHvbChrgn_Frz" 868 "FId_bInh_Sig205h_Com_stHvbChrgn_Rcf" 869 "FId_bInh_Sig205h_Com_uHvbAct_Frz" 870 "FId_bInh_Sig205h_Com_uHvbAct_Rcf" 871 "FId_bInh_Sig217h_ComEmac_nAct01_Frz" 872 "FId_bInh_Sig217h_ComEmac_nAct01_Rcf" 873 "FId_bInh_Sig217h_ComEmac_tqAckd01_Frz" 874 "FId_bInh_Sig217h_ComEmac_tqAckd01_Rcf" 875 "FId_bInh_Sig217h_ComEmac_tqAct01_Frz" 876 "FId_bInh_Sig217h_ComEmac_tqAct01_Rcf" 877 "FId_bInh_Sig217h_ComEmac_uDcLnk01_Frz" 878 "FId_bInh_Sig217h_ComEmac_uDcLnk01_Rcf" 879 "FId_bInh_Sig227h_ComEmac_iDcLnk01_Frz" 880 "FId_bInh_Sig227h_ComEmac_iDcLnk01_Rcf" 881 "FId_bInh_Sig227h_ComEmac_pwrInstnsInpRx_Frz" 882 "FId_bInh_Sig227h_ComEmac_pwrInstnsInpRx_Rcf" 883 "FId_bInh_Sig227h_ComEmac_tqAbsltMax01_Frz" 884 "FId_bInh_Sig227h_ComEmac_tqAbsltMax01_Rcf" 885 "FId_bInh_Sig227h_ComEmac_tqAbsltMaxRx01_Frz" 886 "FId_bInh_Sig227h_ComEmac_tqAbsltMaxRx01_Rcf" 887 "FId_bInh_Sig227h_ComEmac_tqAbsltMin01_Frz" 888 "FId_bInh_Sig227h_ComEmac_tqAbsltMin01_Rcf" 889 "FId_bInh_Sig227h_ComEmac_tqAbsltMinRx01_Frz" 890 "FId_bInh_Sig227h_ComEmac_tqAbsltMinRx01_Rcf" 891 "FId_bInh_Sig237h_ComEmac_stActvDcha_Frz" 892 "FId_bInh_Sig237h_ComEmac_stActvDcha_Rcf" 893 "FId_bInh_Sig237h_ComEmac_stEVLmp_Frz" 894 "FId_bInh_Sig237h_ComEmac_stEVLmp_Rcf" 895 "FId_bInh_Sig237h_ComEmac_stMod01Rx_Frz" 896 "FId_bInh_Sig237h_ComEmac_stMod01Rx_Rcf" 897 "FId_bInh_Sig237h_ComEmac_stMstWrnLmp_Frz" 898 "FId_bInh_Sig237h_ComEmac_stMstWrnLmp_Rcf" 899 "FId_bInh_Sig237h_ComEmac_stSVSLmp_Frz" 900 "FId_bInh_Sig237h_ComEmac_stSVSLmp_Rcf" 901 "FId_bInh_Sig237h_ComEmac_tqStabnMin_Frz" 902 "FId_bInh_Sig237h_ComEmac_tqStabnMin_Rcf" 903 "FId_bInh_Sig237h_Com_stIIvtrFltLvl01_Frz" 904 "FId_bInh_Sig237h_Com_stIIvtrFltLvl01_Rcf" 905 "FId_bInh_Sig259hFlt" 906 "FId_bInh_Sig259h_Com_flgEcoNormReqRx_Frz" 907 "FId_bInh_Sig259h_Com_flgEcoNormReqRx_Rcf" 908 "FId_bInh_Sig259h_Com_stGearLvrPos_Frz" 909 "FId_bInh_Sig259h_Com_stGearLvrPos_Rcf" 910 "FId_bInh_Sig259h_Com_steTogFailrLvl_Frz" 911 "FId_bInh_Sig259h_Com_steTogFailrLvl_Rcf" 912 "FId_bInh_Sig26h_Com_stAC_Frz" 913 "FId_bInh_Sig26h_Com_stAC_Rcf" 914 "FId_bInh_Sig26h_Com_stEvapTFlt_Frz" 915 "FId_bInh_Sig26h_Com_stEvapTFlt_Rcf" 916 "FId_bInh_Sig26h_Com_stHvacBlwrFront_Frz" 917 "FId_bInh_Sig26h_Com_stHvacBlwrFront_Rcf" 918 "FId_bInh_Sig26h_Com_stHvacKnobPosn_Frz" 919 "FId_bInh_Sig26h_Com_stHvacKnobPosn_Rcf" 920 "FId_bInh_Sig26h_Com_stHvacPanPotiFlt_Frz" 921 "FId_bInh_Sig26h_Com_stHvacPanPotiFlt_Rcf" 922 "FId_bInh_Sig26h_Com_stReFogReq_Frz" 923 "FId_bInh_Sig26h_Com_stReFogReq_Rcf" 924 "FId_bInh_Sig26h_Com_tEvapT_Frz" 925 "FId_bInh_Sig26h_Com_tEvapT_Rcf" 926 "FId_bInh_Sig273h_ComChrgr_flgChrgrErrLvl_Frz" 927 "FId_bInh_Sig273h_ComChrgr_flgChrgrErrLvl_Rcf" 928 "FId_bInh_Sig273h_ComChrgr_pwrOutpCpby_Frz" 929 "FId_bInh_Sig273h_ComChrgr_pwrOutpCpby_Rcf" 930 "FId_bInh_Sig275h_Com_iHvbDchaMaxSho_Frz" 931 "FId_bInh_Sig275h_Com_iHvbDchaMaxSho_Rcf" 932 "FId_bInh_Sig275h_Com_pwrMaxDchaSho_Frz" 933 "FId_bInh_Sig275h_Com_pwrMaxDchaSho_Rcf" 934 "FId_bInh_Sig283h_Com_iDcdcHvActRvsn1_Frz" 935 "FId_bInh_Sig283h_Com_iDcdcHvActRvsn1_Rcf" 936 "FId_bInh_Sig283h_Com_iDcdcLvActRvsn1_Frz" 937 "FId_bInh_Sig283h_Com_iDcdcLvActRvsn1_Rcf" 938 "FId_bInh_Sig283h_Com_uDcdcHvAct_Frz" 939 "FId_bInh_Sig283h_Com_uDcdcHvAct_Rcf" 940 "FId_bInh_Sig283h_Com_uDcdcLvAct_Frz" 941 "FId_bInh_Sig283h_Com_uDcdcLvAct_Rcf" 942 "FId_bInh_Sig285h_Com_iHvbChrgMaxSho_Frz" 943 "FId_bInh_Sig285h_Com_iHvbChrgMaxSho_Rcf" 944 "FId_bInh_Sig285h_Com_pwrMaxChrgSho_Frz" 945 "FId_bInh_Sig285h_Com_pwrMaxChrgSho_Rcf" 946 "FId_bInh_Sig293h_Com_pwrDcdcOutpCpby_Frz" 947 "FId_bInh_Sig293h_Com_pwrDcdcOutpCpby_Rcf" 948 "FId_bInh_Sig293h_Com_stDcdcFltLvl_Frz" 949 "FId_bInh_Sig293h_Com_stDcdcFltLvl_Rcf" 950 "FId_bInh_Sig325h_Com_rHvbIsoMeasmt_Frz" 951 "FId_bInh_Sig325h_Com_rHvbIsoMeasmt_Rcf" 952 "FId_bInh_Sig325h_Com_stHvbIntlckRx_Frz" 953 "FId_bInh_Sig325h_Com_stHvbIntlckRx_Rcf" 954 "FId_bInh_Sig325h_Com_stHvbIsoFltRx_Frz" 955 "FId_bInh_Sig325h_Com_stHvbIsoFltRx_Rcf" 956 "FId_bInh_Sig325h_Com_stHvbSrvPlgRx_Frz" 957 "FId_bInh_Sig325h_Com_stHvbSrvPlgRx_Rcf" 958 "FId_bInh_Sig325h_Com_tHvbMax_Frz" 959 "FId_bInh_Sig325h_Com_tHvbMax_Rcf" 960 "FId_bInh_Sig335h_Com_iHvbDes_Frz" 961 "FId_bInh_Sig335h_Com_iHvbDes_Rcf" 962 "FId_bInh_Sig335h_Com_iHvbNomChrgn_Frz" 963 "FId_bInh_Sig335h_Com_iHvbNomChrgn_Rcf" 964 "FId_bInh_Sig335h_Com_uHvbDcBus_Frz" 965 "FId_bInh_Sig335h_Com_uHvbDcBus_Rcf" 966 "FId_bInh_Sig335h_Com_uHvbLimHi_Frz" 967 "FId_bInh_Sig335h_Com_uHvbLimHi_Rcf" 968 "FId_bInh_Sig38Dh_Com_flgVehSpdAvl_Frz" 969 "FId_bInh_Sig38Dh_Com_flgVehSpdAvl_Rcf" 970 "FId_bInh_Sig38Dh_Com_vVeh_Frz" 971 "FId_bInh_Sig38Dh_Com_vVeh_Rcf" 972 "FId_bInh_Sig427h_ComEmac_stIvtrOpMod01_Frz" 973 "FId_bInh_Sig427h_ComEmac_stIvtrOpMod01_Rcf" 974 "FId_bInh_Sig427h_ComEmac_tInvr01_Frz" 975 "FId_bInh_Sig427h_ComEmac_tInvr01_Rcf" 976 "FId_bInh_Sig427h_ComEmac_tIvtrCooltIn01_Frz" 977 "FId_bInh_Sig427h_ComEmac_tIvtrCooltIn01_Rcf" 978 "FId_bInh_Sig427h_ComEmac_tMac01_Frz" 979 "FId_bInh_Sig427h_ComEmac_tMac01_Rcf" 980 "FId_bInh_Sig427h_ComEmac_tqPtd01_Frz" 981 "FId_bInh_Sig427h_ComEmac_tqPtd01_Rcf" 982 "FId_bInh_Sig432h_Com_stMainWkuReq_Frz" 983 "FId_bInh_Sig432h_Com_stMainWkuReq_Rcf" 984 "FId_bInh_Sig435h_Com_HvbMaxSnsrTempRx_Frz" 985 "FId_bInh_Sig435h_Com_HvbMaxSnsrTempRx_Rcf" 986 "FId_bInh_Sig435h_Com_nrSerMaxCell_Frz" 987 "FId_bInh_Sig435h_Com_nrSerMaxCell_Rcf" 988 "FId_bInh_Sig435h_Com_nrSerMinCell_Frz" 989 "FId_bInh_Sig435h_Com_nrSerMinCell_Rcf" 990 "FId_bInh_Sig435h_Com_uHvbMaxCell_Frz" 991 "FId_bInh_Sig435h_Com_uHvbMaxCell_Rcf" 992 "FId_bInh_Sig435h_Com_uHvbMinCell_Frz" 993 "FId_bInh_Sig435h_Com_uHvbMinCell_Rcf" 994 "FId_bInh_Sig442h_Com_stBlowrRly_Frz" 995 "FId_bInh_Sig442h_Com_stBlowrRly_Rcf" 996 "FId_bInh_Sig453h_ComChrgr_iAcMax_Frz" 997 "FId_bInh_Sig453h_ComChrgr_iAcMax_Rcf" 998 "FId_bInh_Sig453h_ComChrgr_pwrInAct_Frz" 999 "FId_bInh_Sig453h_ComChrgr_pwrInAct_Rcf" 1000 "FId_bInh_Sig453h_ComChrgr_uAcActL1_Frz" 1001 "FId_bInh_Sig453h_ComChrgr_uAcActL1_Rcf" 1002 "FId_bInh_Sig455h_Com_uHvbNomChrgn_Frz" 1003 "FId_bInh_Sig455h_Com_uHvbNomChrgn_Rcf" 1004 "FId_bInh_Sig463h_ComChrgr_iDcHvAct_Frz" 1005 "FId_bInh_Sig463h_ComChrgr_iDcHvAct_Rcf" 1006 "FId_bInh_Sig463h_ComChrgr_tChrgrMaxAct_Frz" 1007 "FId_bInh_Sig463h_ComChrgr_tChrgrMaxAct_Rcf" 1008 "FId_bInh_Sig463h_ComChrgr_uDcHvAct_Frz" 1009 "FId_bInh_Sig463h_ComChrgr_uDcHvAct_Rcf" 1010 "FId_bInh_Sig473h_Com_tDcdcAct_Frz" 1011 "FId_bInh_Sig473h_Com_tDcdcAct_Rcf" 1012 "FId_bInh_Sig473h_Com_tDcdcInltCoolt_Frz" 1013 "FId_bInh_Sig473h_Com_tDcdcInltCoolt_Rcf" 1014 "FId_bInh_Sig47Bh_Com_iElCmprHvAct_Frz" 1015 "FId_bInh_Sig47Bh_Com_iElCmprHvAct_Rcf" 1016 "FId_bInh_Sig47Bh_Com_iElCmprPeakPha_Frz" 1017 "FId_bInh_Sig47Bh_Com_iElCmprPeakPha_Rcf" 1018 "FId_bInh_Sig47Bh_Com_nElCmprActl_Frz" 1019 "FId_bInh_Sig47Bh_Com_nElCmprActl_Rcf" 1020 "FId_bInh_Sig47Bh_Com_pwrElCmprActl_Frz" 1021 "FId_bInh_Sig47Bh_Com_pwrElCmprActl_Rcf" 1022 "FId_bInh_Sig47Bh_Com_tElCmprActl_Frz" 1023 "FId_bInh_Sig47Bh_Com_tElCmprActl_Rcf" 1024 "FId_bInh_Sig47Bh_Com_uElCmprHvAct_Frz" 1025 "FId_bInh_Sig47Bh_Com_uElCmprHvAct_Rcf" 1026 "FId_bInh_Sig48Bh_Com_stElCmprFltLvl_Frz" 1027 "FId_bInh_Sig48Bh_Com_stElCmprFltLvl_Rcf" 1028 "FId_bInh_Sig4F2h_Com_ratSocLvBatt_Frz" 1029 "FId_bInh_Sig4F2h_Com_ratSocLvBatt_Rcf" 1030 "FId_bInh_Sig4F2h_Com_stSocRx_Frz" 1031 "FId_bInh_Sig4F2h_Com_stSocRx_Rcf" 1032 "FId_bInh_Sig4F2h_Com_stT_Frz" 1033 "FId_bInh_Sig4F2h_Com_stT_Rcf" 1034 "FId_bInh_Sig535h_Com_tHvbAct_Frz" 1035 "FId_bInh_Sig535h_Com_tHvbAct_Rcf" 1036 "FId_bInh_Sig543h_Com_egyHvbAvl_fRx_Frz" 1037 "FId_bInh_Sig543h_Com_egyHvbAvl_fRx_Rcf" 1038 "FId_bInh_Sig543h_Com_ratHvbSoh_Frz" 1039 "FId_bInh_Sig543h_Com_ratHvbSoh_Rcf" 1040 "FId_bInh_Sig543h_Com_ratRHvbSoh_Frz" 1041 "FId_bInh_Sig543h_Com_ratRHvbSoh_Rcf" 1042 "FId_bInh_Sig552h_Com_lDstGlbDa_Frz" 1043 "FId_bInh_Sig552h_Com_lDstGlbDa_Rcf" 1044 "FId_bInh_Sig552h_Com_lTotOdometer_Frz" 1045 "FId_bInh_Sig552h_Com_lTotOdometer_Rcf" 1046 "FId_bInh_Sig552h_Com_tiCurVehTmr_Frz" 1047 "FId_bInh_Sig552h_Com_tiCurVehTmr_Rcf" 1048 "FId_bInh_Sig583h_Com_stHvbDiscnctReas_Frz" 1049 "FId_bInh_Sig583h_Com_stHvbDiscnctReas_Rcf" 1050 "FId_bInh_Sig592h_Com_iBattEBS1Rx_Frz" 1051 "FId_bInh_Sig592h_Com_iBattEBS1Rx_Rcf" 1052 "FId_bInh_Sig592h_Com_iBattEBS2Rx_Frz" 1053 "FId_bInh_Sig592h_Com_iBattEBS2Rx_Rcf" 1054 "FId_bInh_Sig592h_Com_iBattEBS3Rx_Frz" 1055 "FId_bInh_Sig592h_Com_iBattEBS3Rx_Rcf" 1056 "FId_bInh_Sig592h_Com_stIBattEBS_Frz" 1057 "FId_bInh_Sig592h_Com_stIBattEBS_Rcf" 1058 "FId_bInh_Sig592h_Com_tLvBatt_Frz" 1059 "FId_bInh_Sig592h_Com_tLvBatt_Rcf" 1060 "FId_bInh_Sig592h_Com_uBattEBSRx_Frz" 1061 "FId_bInh_Sig592h_Com_uBattEBSRx_Rcf" 1062 "FId_bInh_Sig595h_Com_tiHvbChrgnHalfRx_Frz" 1063 "FId_bInh_Sig595h_Com_tiHvbChrgnHalfRx_Rcf" 1064 "FId_bInh_Sig5B2h_Com_tEnvT_Frz" 1065 "FId_bInh_Sig5B2h_Com_tEnvT_Rcf" 1066 "FId_bInh_Sig5B5h_Com_stAlrtThermRunAwy_Frz" 1067 "FId_bInh_Sig5B5h_Com_stAlrtThermRunAwy_Rcf" 1068 "FId_bInh_Sig635h_Com_ctHvbNegCntctrSeg1_Frz" 1069 "FId_bInh_Sig635h_Com_ctHvbNegCntctrSeg1_Rcf" 1070 "FId_bInh_Sig635h_Com_ctHvbNegCntctrSeg3_Frz" 1071 "FId_bInh_Sig635h_Com_ctHvbNegCntctrSeg3_Rcf" 1072 "FId_bInh_Sig635h_Com_ctHvbNegCntctrSeg4_Frz" 1073 "FId_bInh_Sig635h_Com_ctHvbNegCntctrSeg4_Rcf" 1074 "FId_bInh_Sig635h_Com_ctHvbPosCntctrSeg1_Frz" 1075 "FId_bInh_Sig635h_Com_ctHvbPosCntctrSeg1_Rcf" 1076 "FId_bInh_Sig635h_Com_ctHvbPosCntctrSeg3_Frz" 1077 "FId_bInh_Sig635h_Com_ctHvbPosCntctrSeg3_Rcf" 1078 "FId_bInh_Sig635h_Com_ctHvbPosCntctrSeg4_Frz" 1079 "FId_bInh_Sig635h_Com_ctHvbPosCntctrSeg4_Rcf" 1080 "FId_bInh_Sig645h_Com_ctHvbPrecCntctrSeg1_Frz" 1081 "FId_bInh_Sig645h_Com_ctHvbPrecCntctrSeg1_Rcf" 1082 "FId_bInh_Sig645h_Com_ctHvbPrecCntctrSeg2_Frz" 1083 "FId_bInh_Sig645h_Com_ctHvbPrecCntctrSeg2_Rcf" 1084 "FId_bInh_Sig675h_Com_qHvbTotCpRx_Frz" 1085 "FId_bInh_Sig675h_Com_qHvbTotCpRx_Rcf" 1086 "FId_bInh_Sig_ComEmac_flgImobAuthent_Sq_Frz" 1087 "FId_bInh_Sig_ComEmac_stIsoMonSwtAck_Sq_Frz" 1088 "FId_bInh_Sig_ComEmac_stPwrAuthn_Sq_Frz" 1089 "FId_bInh_Sig_Com_flgEcoNormReq_Frz" 1090 "FId_bInh_Sig_Com_pwrMaxChrgSho_Sq_Frz" 1091 "FId_bInh_Sig_Com_pwrMaxDchaSho_Sq_Frz" 1092 "FId_bInh_Sig_Com_stDcdcULimReq_Sq_Frz" 1093 "FId_bInh_Sig_Com_stGearLvrPos_Frz" 1094 "FId_bInh_Sig_Com_stIgnkeyPos_Sq_Frz" 1095 "FId_bInh_ThermHvac_stRemPrecndn" 1096 "FId_bInh_VehCoorn_dstRngPrdcDispTx" 1097 "FId_bInh_VehCoorn_wCnsTotWghtAvrgEffTripA" 1098 "FId_bInh_VehCoorn_wCnsTotWghtAvrgEffTripB" 1099 "FId_bInh_VehCoorn_wCnsTotWghtAvrgEffTx" 1100 "FId_bInh_VehCoorn_wCnsTotWghtTripAvrgEffTx" 1101 "FId_bInh_VehCoorn_wCnsWghtAvrgEffTripA" 1102 "FId_bInh_VehCoorn_wCnsWghtAvrgEffTripB" 1103 "FId_binnh_Sig_ComEmac_flgEmgyShtDwnReq01_Sq_Frz" 1104 "FId_binnh_Sig_ComEmac_flgImobAuthent_Sq_Frz" 1105 "FId_binnh_Sig_ComEmac_iDcLnk01_Sq_Frz" 1106 "FId_binnh_Sig_ComEmac_nAct01_Sq_Frz" 1107 "FId_binnh_Sig_ComEmac_stActvDcha_Sq_Frz" 1108 "FId_binnh_Sig_ComEmac_stIsoMonSwtAck_Sq_Frz" 1109 "FId_binnh_Sig_ComEmac_stMod01_Sq_Frz" 1110 "FId_binnh_Sig_ComEmac_stPwrAuthn_Sq_Frz" 1111 "FId_binnh_Sig_ComEmac_tInvr01_Sq_Frz" 1112 "FId_binnh_Sig_ComEmac_tMac01_Sq_Frz" 1113 "FId_binnh_Sig_ComEmac_tqAbsltMax01_Sq_Frz" 1114 "FId_binnh_Sig_ComEmac_tqAbsltMin01_Sq_Frz" 1115 "FId_binnh_Sig_ComEmac_tqAct01_Sq_Frz" 1116 "FId_binnh_Sig_ComEmac_uDcLnk01_sq_Frz" 1117 "FId_binnh_Sig_Com_egyHvbAvl_Sq_Frz" 1118 "FId_binnh_Sig_Com_iHvbAct_Sq_Frz" 1119 "FId_binnh_Sig_Com_iHvbChrgMaxSho_Sq_Frz" 1120 "FId_binnh_Sig_Com_iHvbDchaMaxSho_Sq_Frz" 1121 "FId_binnh_Sig_Com_iHvbDes_Sq_Frz" 1122 "FId_binnh_Sig_Com_pwrDcdcOutpCpby_Sq_Frz" 1123 "FId_binnh_Sig_Com_rHvbIsoMeasmt_Sq_Frz" 1124 "FId_binnh_Sig_Com_ratHvbSoc_Sq_Frz" 1125 "FId_binnh_Sig_Com_stDcdcULimReq_Sq_Frz" 1126 "FId_binnh_Sig_Com_stHvbCntct_Sq_Frz" 1127 "FId_binnh_Sig_Com_stHvbDernMaxT_Sq_Frz" 1128 "FId_binnh_Sig_Com_stHvbDernMinT_Sq_Frz" 1129 "FId_binnh_Sig_Com_stHvbFlt_Sq_Frz" 1130 "FId_binnh_Sig_Com_stHvbIntlck_Sq_Frz" 1131 "FId_binnh_Sig_Com_stHvbIsoFlt_Sq_Frz" 1132 "FId_binnh_Sig_Com_stHvbMod_Sq_Frz" 1133 "FId_binnh_Sig_Com_stHvbSrvPlg_Sq_Frz" 1134 "FId_binnh_Sig_Com_tHvbAct_Sq_Frz" 1135 "FId_binnh_Sig_Com_uElCmprHvAct_Sq_Frz" 1136 "FId_binnh_Sig_Com_uHvbAct_Sq_Frz" 1137 "FId_binnh_Sig_Com_uHvbDcBus_Sq_Frz" 1138 "FId_binnh_Sig_Com_uHvbLimHi_Sq_Frz" 1139 "FId_binnh_Sig_Com_uHvbNomChrgn_Sq_Frz" DEFAULT_VALUE "---" /end COMPU_VTAB
/begin COMPU_METHOD DINH_LimDFCVerb "" TAB_VERB "%6.3" "-" COMPU_TAB_REF DINH_LimDFCVerb /end COMPU_METHOD
/begin COMPU_VTAB DINH_LimDFCVerb "" TAB_VERB 18 0 "No_Inhibit" 1 "Def50_Deb100" 2 "Def100_Deb100" 3 "Def50_Deb100_Tst" 4 "Def100_Deb100_Tst" 5 "Def50_Deb100_or_NTst" 6 "Def100_Deb100_or_NTst" 7 "Tested" 8 "NotTested" 9 "Def100_Deb0" 10 "Def50_Deb0" 11 "Def25_Deb0" 12 "Def0_Deb0" 13 "Def50_Deb100_Tst_Trip" 14 "Def100_Deb100_Tst_Trip" 15 "Def50_Deb100_MILOn" 16 "Def50_Deb100_Trip" 17 "Def100_Deb100_Trip" /end COMPU_VTAB
/begin RECORD_LAYOUT ValA_Wu16 FNC_VALUES 1 UWORD COLUMN_DIR DIRECT /end RECORD_LAYOUT
/begin RECORD_LAYOUT ValA_Wu8 FNC_VALUES 1 UBYTE COLUMN_DIR DIRECT /end RECORD_LAYOUT
/end MODULE
/end PROJECT

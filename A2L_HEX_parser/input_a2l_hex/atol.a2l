ASAP2_VERSION 1 70
/begin PROJECT MDG1C "VC1CP091_STLA_N_D061I3"
/begin HEADER "" VERSION "VC1CP091_STLA_N_D061I3" PROJECT_NO MDG1C /end HEADER
/begin MODULE DIM ""
/begin MOD_COMMON "" BYTE_ORDER MSB_LAST ALIGNMENT_BYTE 1 ALIGNMENT_WORD 2 ALIGNMENT_LONG 4 ALIGNMENT_INT64 4 ALIGNMENT_FLOAT32_IEEE 4 ALIGNMENT_FLOAT64_IEEE 4 DATA_SIZE 32 /end MOD_COMMON
/begin MEASUREMENT DINH_xWhy.FId_bInhComGw_Com_PEM_ENGINE_RPM "" UWORD DFCDSQ_Verb 1 100 0.00 65535.0000000 FORMAT "%13.7" ECU_ADDRESS 0x600223BE /end MEASUREMENT
/begin MEASUREMENT DINH_xWhy.FId_bInhComGw_Com_PEM_ESTIM_TRQ "" UWORD DFCDSQ_Verb 1 100 0.00 65535.0000000 FORMAT "%13.7" ECU_ADDRESS 0x600223C0 /end MEASUREMENT
/begin MEASUREMENT DINH_xWhy.FId_bInhComGw_Com_PEM_INVERTER_TEMP "" UWORD DFCDSQ_Verb 1 100 0.00 65535.0000000 FORMAT "%13.7" ECU_ADDRESS 0x600223C2 /end MEASUREMENT
/begin MEASUREMENT DINH_xWhy.FId_bInhComGw_Com_PEM_INVERTOR_ALERT_TEMP "" UWORD DFCDSQ_Verb 1 100 0.00 65535.0000000 FORMAT "%13.7" ECU_ADDRESS 0x600223C4 /end MEASUREMENT
/begin MEASUREMENT DINH_xWhy.FId_bInhComGw_Com_PEM_OVERTEMP_FAILURE "" UWORD DFCDSQ_Verb 1 100 0.00 65535.0000000 FORMAT "%13.7" ECU_ADDRESS 0x600223C6 /end MEASUREMENT
/begin MEASUREMENT DINH_xWhy.FId_bInhComGw_Com_PEM_STATOR_TEMP "" UWORD DFCDSQ_Verb 1 100 0.00 65535.0000000 FORMAT "%13.7" ECU_ADDRESS 0x600223C8 /end MEASUREMENT
/begin MEASUREMENT DINH_xWhy.FId_bInhComGw_Com_VITESSE_VEHICULE_ROUES "" UWORD DFCDSQ_Verb 1 100 0.00 65535.0000000 FORMAT "%13.7" ECU_ADDRESS 0x600223CA /end MEASUREMENT
/begin MEASUREMENT DINH_xWhy.FId_bInhComGw_Com_VVH_INDISP "" UWORD DFCDSQ_Verb 1 100 0.00 65535.0000000 FORMAT "%13.7" ECU_ADDRESS 0x600223CC /end MEASUREMENT
/begin MEASUREMENT DINH_xWhy.FId_bInhComGw_Com_eCOMP_Power_consumption "" UWORD DFCDSQ_Verb 1 100 0.00 65535.0000000 FORMAT "%13.7" ECU_ADDRESS 0x600223CE /end MEASUREMENT
/begin MEASUREMENT DINH_xWhy.FId_bInhComGw_MAIN_RELAY_ACTUATION_COUNTER "" UWORD DFCDSQ_Verb 1 100 0.00 65535.0000000 FORMAT "%13.7" ECU_ADDRESS 0x600223D0 /end MEASUREMENT
/begin MEASUREMENT DINH_xWhy.FId_bInhComGw_TIME_HV_BATT_OVER_TEMPERATURE "" UWORD DFCDSQ_Verb 1 100 0.00 65535.0000000 FORMAT "%13.7" ECU_ADDRESS 0x600223D2 /end MEASUREMENT
/begin MEASUREMENT DINH_xWhy.FId_bInhComGw_TOTAL_HV_BATT_POS_QTY_CURR "" UWORD DFCDSQ_Verb 1 100 0.00 65535.0000000 FORMAT "%13.7" ECU_ADDRESS 0x600223D4 /end MEASUREMENT
/begin MEASUREMENT DINH_xWhy.FId_bInhDiag_CLUSTER_5E7 "" UWORD DFCDSQ_Verb 1 100 0.00 65535.0000000 FORMAT "%13.7" ECU_ADDRESS 0x600223D6 /end MEASUREMENT
/begin MEASUREMENT DINH_xWhy.FId_bInhDiag_CONTEXTE_1_5B2 "" UWORD DFCDSQ_Verb 1 100 0.00 65535.0000000 FORMAT "%13.7" ECU_ADDRESS 0x600223D8 /end MEASUREMENT
/begin MEASUREMENT DINH_xWhy.FId_bInhDiag_DAT3_BSI_4F2h "" UWORD DFCDSQ_Verb 1 100 0.00 65535.0000000 FORMAT "%13.7" ECU_ADDRESS 0x600223DA /end MEASUREMENT
/begin MEASUREMENT DINH_xWhy.FId_bInhDiag_DCDC_283h "" UWORD DFCDSQ_Verb 1 100 0.00 65535.0000000 FORMAT "%13.7" ECU_ADDRESS 0x600223DC /end MEASUREMENT
/begin MEASUREMENT DINH_xWhy.FId_bInhDiag_DCDC_293h "" UWORD DFCDSQ_Verb 1 100 0.00 65535.0000000 FORMAT "%13.7" ECU_ADDRESS 0x600223DE /end MEASUREMENT
/begin MEASUREMENT DINH_xWhy.FId_bInhDiag_DCDC_473h "" UWORD DFCDSQ_Verb 1 100 0.00 65535.0000000 FORMAT "%13.7" ECU_ADDRESS 0x600223E0 /end MEASUREMENT
/begin MEASUREMENT DINH_xWhy.FId_bInhDiag_DCDC_663h "" UWORD DFCDSQ_Verb 1 100 0.00 65535.0000000 FORMAT "%13.7" ECU_ADDRESS 0x600223E2 /end MEASUREMENT
/begin MEASUREMENT DINH_xWhy.FId_bInhDiag_HS3_AUTO_GEARBOX_SWITCH_STATUS "" UWORD DFCDSQ_Verb 1 100 0.00 65535.0000000 FORMAT "%13.7" ECU_ADDRESS 0x600223E4 /end MEASUREMENT
/begin MEASUREMENT DINH_xWhy.FId_bInhDiag_HVAC_PANEL_26h "" UWORD DFCDSQ_Verb 1 100 0.00 65535.0000000 FORMAT "%13.7" ECU_ADDRESS 0x600223E6 /end MEASUREMENT
/begin MEASUREMENT DINH_xWhy.FId_bInhDiag_HVBAT_205h "" UWORD DFCDSQ_Verb 1 100 0.00 65535.0000000 FORMAT "%13.7" ECU_ADDRESS 0x600223E8 /end MEASUREMENT
/begin MEASUREMENT DINH_xWhy.FId_bInhDiag_HVBAT_275h "" UWORD DFCDSQ_Verb 1 100 0.00 65535.0000000 FORMAT "%13.7" ECU_ADDRESS 0x600223EA /end MEASUREMENT
/begin MEASUREMENT DINH_xWhy.FId_bInhDiag_HVBAT_285h "" UWORD DFCDSQ_Verb 1 100 0.00 65535.0000000 FORMAT "%13.7" ECU_ADDRESS 0x600223EC /end MEASUREMENT
/begin MEASUREMENT DINH_xWhy.FId_bInhDiag_HVBAT_325h "" UWORD DFCDSQ_Verb 1 100 0.00 65535.0000000 FORMAT "%13.7" ECU_ADDRESS 0x600223EE /end MEASUREMENT
/begin MEASUREMENT DINH_xWhy.FId_bInhDiag_HVBAT_335h "" UWORD DFCDSQ_Verb 1 100 0.00 65535.0000000 FORMAT "%13.7" ECU_ADDRESS 0x600223F0 /end MEASUREMENT
/begin MEASUREMENT DINH_xWhy.FId_bInhDiag_HVBAT_455h "" UWORD DFCDSQ_Verb 1 100 0.00 65535.0000000 FORMAT "%13.7" ECU_ADDRESS 0x600223F2 /end MEASUREMENT
/begin MEASUREMENT DINH_xWhy.FId_bInhDiag_HVBAT_535 "" UWORD DFCDSQ_Verb 1 100 0.00 65535.0000000 FORMAT "%13.7" ECU_ADDRESS 0x600223F4 /end MEASUREMENT
/begin MEASUREMENT DINH_xWhy.FId_bInhDiag_HVBAT_595h "" UWORD DFCDSQ_Verb 1 100 0.00 65535.0000000 FORMAT "%13.7" ECU_ADDRESS 0x600223F6 /end MEASUREMENT
/begin MEASUREMENT DINH_xWhy.FId_bInhDiag_HVBAT_635h "" UWORD DFCDSQ_Verb 1 100 0.00 65535.0000000 FORMAT "%13.7" ECU_ADDRESS 0x600223F8 /end MEASUREMENT
/begin MEASUREMENT DINH_xWhy.FId_bInhDiag_HVBAT_645h "" UWORD DFCDSQ_Verb 1 100 0.00 65535.0000000 FORMAT "%13.7" ECU_ADDRESS 0x600223FA /end MEASUREMENT
/begin MEASUREMENT DINH_xWhy.FId_bInhDiag_HVBAT_665h "" UWORD DFCDSQ_Verb 1 100 0.00 65535.0000000 FORMAT "%13.7" ECU_ADDRESS 0x600223FC /end MEASUREMENT
/begin MEASUREMENT DINH_xWhy.FId_bInhDiag_HVBAT_675h "" UWORD DFCDSQ_Verb 1 100 0.00 65535.0000000 FORMAT "%13.7" ECU_ADDRESS 0x600223FE /end MEASUREMENT
/begin MEASUREMENT DINH_xWhy.FId_bInhDiag_HVBAT_THERMAL_5B5 "" UWORD DFCDSQ_Verb 1 100 0.00 65535.0000000 FORMAT "%13.7" ECU_ADDRESS 0x60022400 /end MEASUREMENT
/begin MEASUREMENT DINH_xWhy.FId_bInhDiag_HVBAT_VCU_435h "" UWORD DFCDSQ_Verb 1 100 0.00 65535.0000000 FORMAT "%13.7" ECU_ADDRESS 0x60022402 /end MEASUREMENT
/begin MEASUREMENT DINH_xWhy.FId_bInhDiag_HVBAT_VCU_543 "" UWORD DFCDSQ_Verb 1 100 0.00 65535.0000000 FORMAT "%13.7" ECU_ADDRESS 0x60022404 /end MEASUREMENT
/begin MEASUREMENT DINH_xWhy.FId_bInhDiag_HVBAT_VCU_583 "" UWORD DFCDSQ_Verb 1 100 0.00 65535.0000000 FORMAT "%13.7" ECU_ADDRESS 0x60022406 /end MEASUREMENT
/begin MEASUREMENT DINH_xWhy.FId_bInhDiag_INV_217h "" UWORD DFCDSQ_Verb 1 100 0.00 65535.0000000 FORMAT "%13.7" ECU_ADDRESS 0x60022408 /end MEASUREMENT
/begin MEASUREMENT DINH_xWhy.FId_bInhDiag_INV_227h "" UWORD DFCDSQ_Verb 1 100 0.00 65535.0000000 FORMAT "%13.7" ECU_ADDRESS 0x6002240A /end MEASUREMENT
/begin MEASUREMENT DINH_xWhy.FId_bInhDiag_INV_237 "" UWORD DFCDSQ_Verb 1 100 0.00 65535.0000000 FORMAT "%13.7" ECU_ADDRESS 0x6002240C /end MEASUREMENT
/begin MEASUREMENT DINH_xWhy.FId_bInhDiag_INV_427h "" UWORD DFCDSQ_Verb 1 100 0.00 65535.0000000 FORMAT "%13.7" ECU_ADDRESS 0x6002240E /end MEASUREMENT
/begin MEASUREMENT DINH_xWhy.FId_bInhDiag_INV_497h "" UWORD DFCDSQ_Verb 1 100 0.00 65535.0000000 FORMAT "%13.7" ECU_ADDRESS 0x60022410 /end MEASUREMENT
/begin MEASUREMENT DINH_xWhy.FId_bInhDiag_INV_IMMO_5C7 "" UWORD DFCDSQ_Verb 1 100 0.00 65535.0000000 FORMAT "%13.7" ECU_ADDRESS 0x60022412 /end MEASUREMENT
/begin MEASUREMENT DINH_xWhy.FId_bInhDiag_IS_DAT6_BSI_592h "" UWORD DFCDSQ_Verb 1 100 0.00 65535.0000000 FORMAT "%13.7" ECU_ADDRESS 0x60022414 /end MEASUREMENT
/begin MEASUREMENT DINH_xWhy.FId_bInhDiag_IS_DAT_ABR_50Dh "" UWORD DFCDSQ_Verb 1 100 0.00 65535.0000000 FORMAT "%13.7" ECU_ADDRESS 0x60022416 /end MEASUREMENT
/begin MEASUREMENT DINH_xWhy.FId_bInhDiag_IS_DAT_BSI_412h "" UWORD DFCDSQ_Verb 1 100 0.00 65535.0000000 FORMAT "%13.7" ECU_ADDRESS 0x60022418 /end MEASUREMENT
/begin MEASUREMENT DINH_xWhy.FId_bInhDiag_IS_DYN_ABR_38Dh "" UWORD DFCDSQ_Verb 1 100 0.00 65535.0000000 FORMAT "%13.7" ECU_ADDRESS 0x6002241A /end MEASUREMENT
/begin MEASUREMENT DINH_xWhy.FId_bInhDiag_IS_INTE_ELECTRON_BSI_092h "" UWORD DFCDSQ_Verb 1 100 0.00 65535.0000000 FORMAT "%13.7" ECU_ADDRESS 0x6002241C /end MEASUREMENT
/begin MEASUREMENT DINH_xWhy.FId_bInhDiag_OBC_273h "" UWORD DFCDSQ_Verb 1 100 0.00 65535.0000000 FORMAT "%13.7" ECU_ADDRESS 0x6002241E /end MEASUREMENT
/begin MEASUREMENT DINH_xWhy.FId_bInhDiag_OBC_453h "" UWORD DFCDSQ_Verb 1 100 0.00 65535.0000000 FORMAT "%13.7" ECU_ADDRESS 0x60022420 /end MEASUREMENT
/begin MEASUREMENT DINH_xWhy.FId_bInhDiag_OBC_463h "" UWORD DFCDSQ_Verb 1 100 0.00 65535.0000000 FORMAT "%13.7" ECU_ADDRESS 0x60022422 /end MEASUREMENT
/begin MEASUREMENT DINH_xWhy.FId_bInhDiag_PDU_BusVoltages_308 "" UWORD DFCDSQ_Verb 1 100 0.00 65535.0000000 FORMAT "%13.7" ECU_ADDRESS 0x60022424 /end MEASUREMENT
/begin MEASUREMENT DINH_xWhy.FId_bInhDiag_PDU_Current_318 "" UWORD DFCDSQ_Verb 1 100 0.00 65535.0000000 FORMAT "%13.7" ECU_ADDRESS 0x60022426 /end MEASUREMENT
/begin MEASUREMENT DINH_xWhy.FId_bInhDiag_SC_INFO_BCCM_442h "" UWORD DFCDSQ_Verb 1 100 0.00 65535.0000000 FORMAT "%13.7" ECU_ADDRESS 0x60022428 /end MEASUREMENT
/begin MEASUREMENT DINH_xWhy.FId_bInhDiag_VCU_AIRBAG_351h "" UWORD DFCDSQ_Verb 1 100 0.00 65535.0000000 FORMAT "%13.7" ECU_ADDRESS 0x6002242A /end MEASUREMENT
/begin MEASUREMENT DINH_xWhy.FId_bInhDiag_VCU_eBCCM_432h "" UWORD DFCDSQ_Verb 1 100 0.00 65535.0000000 FORMAT "%13.7" ECU_ADDRESS 0x6002242C /end MEASUREMENT
/begin MEASUREMENT DINH_xWhy.FId_bInhDiag_VCU_eBCCM_552h "" UWORD DFCDSQ_Verb 1 100 0.00 65535.0000000 FORMAT "%13.7" ECU_ADDRESS 0x6002242E /end MEASUREMENT
/begin MEASUREMENT DINH_xWhy.FId_bInhDiag_eBCCM_082h "" UWORD DFCDSQ_Verb 1 100 0.00 65535.0000000 FORMAT "%13.7" ECU_ADDRESS 0x60022430 /end MEASUREMENT
/begin MEASUREMENT DINH_xWhy.FId_bInhDiag_eCOMP_Information_47B "" UWORD DFCDSQ_Verb 1 100 0.00 65535.0000000 FORMAT "%13.7" ECU_ADDRESS 0x60022432 /end MEASUREMENT
/begin MEASUREMENT DINH_xWhy.FId_bInhDiag_eCOMP_Information_48B "" UWORD DFCDSQ_Verb 1 100 0.00 65535.0000000 FORMAT "%13.7" ECU_ADDRESS 0x60022434 /end MEASUREMENT
/begin MEASUREMENT DINH_xWhy.FId_bInhFrbd_ComChrgr_iAcMax "" UWORD DFCDSQ_Verb 1 100 0.00 65535.0000000 FORMAT "%13.7" ECU_ADDRESS 0x60022436 /end MEASUREMENT
/begin MEASUREMENT DINH_xWhy.FId_bInhFrbd_ComChrgr_iDcHvAct "" UWORD DFCDSQ_Verb 1 100 0.00 65535.0000000 FORMAT "%13.7" ECU_ADDRESS 0x60022438 /end MEASUREMENT
/begin MEASUREMENT DINH_xWhy.FId_bInhFrbd_ComChrgr_pwrInAct "" UWORD DFCDSQ_Verb 1 100 0.00 65535.0000000 FORMAT "%13.7" ECU_ADDRESS 0x6002243A /end MEASUREMENT
/begin MEASUREMENT DINH_xWhy.FId_bInhFrbd_ComChrgr_pwrOutpCpby "" UWORD DFCDSQ_Verb 1 100 0.00 65535.0000000 FORMAT "%13.7" ECU_ADDRESS 0x6002243C /end MEASUREMENT
/begin MEASUREMENT DINH_xWhy.FId_bInhFrbd_ComChrgr_tChrgrMaxAct "" UWORD DFCDSQ_Verb 1 100 0.00 65535.0000000 FORMAT "%13.7" ECU_ADDRESS 0x6002243E /end MEASUREMENT
/begin MEASUREMENT DINH_xWhy.FId_bInhFrbd_ComChrgr_uAcActL1 "" UWORD DFCDSQ_Verb 1 100 0.00 65535.0000000 FORMAT "%13.7" ECU_ADDRESS 0x60022440 /end MEASUREMENT
/begin MEASUREMENT DINH_xWhy.FId_bInhFrbd_ComChrgr_uDcHvAct "" UWORD DFCDSQ_Verb 1 100 0.00 65535.0000000 FORMAT "%13.7" ECU_ADDRESS 0x60022442 /end MEASUREMENT
/begin MEASUREMENT DINH_xWhy.FId_bInhFrbd_ComEmac_iDcLnk01 "" UWORD DFCDSQ_Verb 1 100 0.00 65535.0000000 FORMAT "%13.7" ECU_ADDRESS 0x60022444 /end MEASUREMENT
/begin MEASUREMENT DINH_xWhy.FId_bInhFrbd_ComEmac_nAct01 "" UWORD DFCDSQ_Verb 1 100 0.00 65535.0000000 FORMAT "%13.7" ECU_ADDRESS 0x60022446 /end MEASUREMENT
/begin MEASUREMENT DINH_xWhy.FId_bInhFrbd_ComEmac_pwrInstnsInpRx "" UWORD DFCDSQ_Verb 1 100 0.00 65535.0000000 FORMAT "%13.7" ECU_ADDRESS 0x60022448 /end MEASUREMENT
/begin MEASUREMENT DINH_xWhy.FId_bInhFrbd_ComEmac_stActvDcha "" UWORD DFCDSQ_Verb 1 100 0.00 65535.0000000 FORMAT "%13.7" ECU_ADDRESS 0x6002244A /end MEASUREMENT
/begin MEASUREMENT DINH_xWhy.FId_bInhFrbd_ComEmac_stEVLmp "" UWORD DFCDSQ_Verb 1 100 0.00 65535.0000000 FORMAT "%13.7" ECU_ADDRESS 0x6002244C /end MEASUREMENT
/begin MEASUREMENT DINH_xWhy.FId_bInhFrbd_ComEmac_stIvtrOpMod01 "" UWORD DFCDSQ_Verb 1 100 0.00 65535.0000000 FORMAT "%13.7" ECU_ADDRESS 0x6002244E /end MEASUREMENT
/begin MEASUREMENT DINH_xWhy.FId_bInhFrbd_ComEmac_stMod01Rx "" UWORD DFCDSQ_Verb 1 100 0.00 65535.0000000 FORMAT "%13.7" ECU_ADDRESS 0x60022450 /end MEASUREMENT
/begin MEASUREMENT DINH_xWhy.FId_bInhFrbd_ComEmac_stMstWrnLmp "" UWORD DFCDSQ_Verb 1 100 0.00 65535.0000000 FORMAT "%13.7" ECU_ADDRESS 0x60022452 /end MEASUREMENT
/begin MEASUREMENT DINH_xWhy.FId_bInhFrbd_ComEmac_stSVSLmp "" UWORD DFCDSQ_Verb 1 100 0.00 65535.0000000 FORMAT "%13.7" ECU_ADDRESS 0x60022454 /end MEASUREMENT
/begin MEASUREMENT DINH_xWhy.FId_bInhFrbd_ComEmac_tqAbsltMax01 "" UWORD DFCDSQ_Verb 1 100 0.00 65535.0000000 FORMAT "%13.7" ECU_ADDRESS 0x60022456 /end MEASUREMENT
/begin MEASUREMENT DINH_xWhy.FId_bInhFrbd_ComEmac_tqAbsltMaxRx01 "" UWORD DFCDSQ_Verb 1 100 0.00 65535.0000000 FORMAT "%13.7" ECU_ADDRESS 0x60022458 /end MEASUREMENT
/begin MEASUREMENT DINH_xWhy.FId_bInhFrbd_ComEmac_tqAbsltMin01 "" UWORD DFCDSQ_Verb 1 100 0.00 65535.0000000 FORMAT "%13.7" ECU_ADDRESS 0x6002245A /end MEASUREMENT
/begin MEASUREMENT DINH_xWhy.FId_bInhFrbd_ComEmac_tqAbsltMinRx01 "" UWORD DFCDSQ_Verb 1 100 0.00 65535.0000000 FORMAT "%13.7" ECU_ADDRESS 0x6002245C /end MEASUREMENT
/begin MEASUREMENT DINH_xWhy.FId_bInhFrbd_ComEmac_tqAckd01 "" UWORD DFCDSQ_Verb 1 100 0.00 65535.0000000 FORMAT "%13.7" ECU_ADDRESS 0x6002245E /end MEASUREMENT
/begin MEASUREMENT DINH_xWhy.FId_bInhFrbd_ComEmac_tqAct01 "" UWORD DFCDSQ_Verb 1 100 0.00 65535.0000000 FORMAT "%13.7" ECU_ADDRESS 0x60022460 /end MEASUREMENT
/begin MEASUREMENT DINH_xWhy.FId_bInhFrbd_ComEmac_tqPtd01 "" UWORD DFCDSQ_Verb 1 100 0.00 65535.0000000 FORMAT "%13.7" ECU_ADDRESS 0x60022462 /end MEASUREMENT
/begin MEASUREMENT DINH_xWhy.FId_bInhFrbd_ComEmac_tqStabnMin "" UWORD DFCDSQ_Verb 1 100 0.00 65535.0000000 FORMAT "%13.7" ECU_ADDRESS 0x60022464 /end MEASUREMENT
/begin MEASUREMENT DINH_xWhy.FId_bInhFrbd_ComEmac_uDcLnk01 "" UWORD DFCDSQ_Verb 1 100 0.00 65535.0000000 FORMAT "%13.7" ECU_ADDRESS 0x60022466 /end MEASUREMENT
/begin MEASUREMENT DINH_xWhy.FId_bInhFrbd_Com_HvbMaxSnsrTempRx "" UWORD DFCDSQ_Verb 1 100 0.00 65535.0000000 FORMAT "%13.7" ECU_ADDRESS 0x60022468 /end MEASUREMENT
/begin MEASUREMENT DINH_xWhy.FId_bInhFrbd_Com_ctHvbNegCntctrSeg1 "" UWORD DFCDSQ_Verb 1 100 0.00 65535.0000000 FORMAT "%13.7" ECU_ADDRESS 0x6002246A /end MEASUREMENT
/begin MEASUREMENT DINH_xWhy.FId_bInhFrbd_Com_ctHvbNegCntctrSeg3 "" UWORD DFCDSQ_Verb 1 100 0.00 65535.0000000 FORMAT "%13.7" ECU_ADDRESS 0x6002246C /end MEASUREMENT
/begin MEASUREMENT DINH_xWhy.FId_bInhFrbd_Com_ctHvbNegCntctrSeg4 "" UWORD DFCDSQ_Verb 1 100 0.00 65535.0000000 FORMAT "%13.7" ECU_ADDRESS 0x6002246E /end MEASUREMENT
/begin MEASUREMENT DINH_xWhy.FId_bInhFrbd_Com_ctHvbPosCntctrSeg1 "" UWORD DFCDSQ_Verb 1 100 0.00 65535.0000000 FORMAT "%13.7" ECU_ADDRESS 0x60022470 /end MEASUREMENT
/begin MEASUREMENT DINH_xWhy.FId_bInhFrbd_Com_ctHvbPosCntctrSeg3 "" UWORD DFCDSQ_Verb 1 100 0.00 65535.0000000 FORMAT "%13.7" ECU_ADDRESS 0x60022472 /end MEASUREMENT
/begin MEASUREMENT DINH_xWhy.FId_bInhFrbd_Com_ctHvbPosCntctrSeg4 "" UWORD DFCDSQ_Verb 1 100 0.00 65535.0000000 FORMAT "%13.7" ECU_ADDRESS 0x60022474 /end MEASUREMENT
/begin MEASUREMENT DINH_xWhy.FId_bInhFrbd_Com_ctHvbPrecCntctrSeg1 "" UWORD DFCDSQ_Verb 1 100 0.00 65535.0000000 FORMAT "%13.7" ECU_ADDRESS 0x60022476 /end MEASUREMENT
/begin MEASUREMENT DINH_xWhy.FId_bInhFrbd_Com_ctHvbPrecCntctrSeg2 "" UWORD DFCDSQ_Verb 1 100 0.00 65535.0000000 FORMAT "%13.7" ECU_ADDRESS 0x60022478 /end MEASUREMENT
/begin MEASUREMENT DINH_xWhy.FId_bInhFrbd_Com_egyHvbAvl_fRx "" UWORD DFCDSQ_Verb 1 100 0.00 65535.0000000 FORMAT "%13.7" ECU_ADDRESS 0x6002247A /end MEASUREMENT
/begin MEASUREMENT DINH_xWhy.FId_bInhFrbd_Com_flgEcoNormReqRx "" UWORD DFCDSQ_Verb 1 100 0.00 65535.0000000 FORMAT "%13.7" ECU_ADDRESS 0x6002247C /end MEASUREMENT
/begin MEASUREMENT DINH_xWhy.FId_bInhFrbd_Com_iBattEBS1Rx "" UWORD DFCDSQ_Verb 1 100 0.00 65535.0000000 FORMAT "%13.7" ECU_ADDRESS 0x6002247E /end MEASUREMENT
/begin MEASUREMENT DINH_xWhy.FId_bInhFrbd_Com_iBattEBS2Rx "" UWORD DFCDSQ_Verb 1 100 0.00 65535.0000000 FORMAT "%13.7" ECU_ADDRESS 0x60022480 /end MEASUREMENT
/begin MEASUREMENT DINH_xWhy.FId_bInhFrbd_Com_iBattEBS3Rx "" UWORD DFCDSQ_Verb 1 100 0.00 65535.0000000 FORMAT "%13.7" ECU_ADDRESS 0x60022482 /end MEASUREMENT
/begin MEASUREMENT DINH_xWhy.FId_bInhFrbd_Com_iDcdcHvActRvsn1 "" UWORD DFCDSQ_Verb 1 100 0.00 65535.0000000 FORMAT "%13.7" ECU_ADDRESS 0x60022484 /end MEASUREMENT
/begin MEASUREMENT DINH_xWhy.FId_bInhFrbd_Com_iDcdcLvActRvsn1 "" UWORD DFCDSQ_Verb 1 100 0.00 65535.0000000 FORMAT "%13.7" ECU_ADDRESS 0x60022486 /end MEASUREMENT
/begin MEASUREMENT DINH_xWhy.FId_bInhFrbd_Com_iElCmprHvAct "" UWORD DFCDSQ_Verb 1 100 0.00 65535.0000000 FORMAT "%13.7" ECU_ADDRESS 0x60022488 /end MEASUREMENT
/begin MEASUREMENT DINH_xWhy.FId_bInhFrbd_Com_iElCmprPeakPha "" UWORD DFCDSQ_Verb 1 100 0.00 65535.0000000 FORMAT "%13.7" ECU_ADDRESS 0x6002248A /end MEASUREMENT
/begin MEASUREMENT DINH_xWhy.FId_bInhFrbd_Com_iHvbActRx "" UWORD DFCDSQ_Verb 1 100 0.00 65535.0000000 FORMAT "%13.7" ECU_ADDRESS 0x6002248C /end MEASUREMENT
/begin MEASUREMENT DINH_xWhy.FId_bInhFrbd_Com_iHvbChrgMaxSho "" UWORD DFCDSQ_Verb 1 100 0.00 65535.0000000 FORMAT "%13.7" ECU_ADDRESS 0x6002248E /end MEASUREMENT
/begin MEASUREMENT DINH_xWhy.FId_bInhFrbd_Com_iHvbDchaMaxSho "" UWORD DFCDSQ_Verb 1 100 0.00 65535.0000000 FORMAT "%13.7" ECU_ADDRESS 0x60022490 /end MEASUREMENT
/begin MEASUREMENT DINH_xWhy.FId_bInhFrbd_Com_iHvbDes "" UWORD DFCDSQ_Verb 1 100 0.00 65535.0000000 FORMAT "%13.7" ECU_ADDRESS 0x60022492 /end MEASUREMENT
/begin MEASUREMENT DINH_xWhy.FId_bInhFrbd_Com_iHvbNomChrgn "" UWORD DFCDSQ_Verb 1 100 0.00 65535.0000000 FORMAT "%13.7" ECU_ADDRESS 0x60022494 /end MEASUREMENT
/begin MEASUREMENT DINH_xWhy.FId_bInhFrbd_Com_nElCmprActl "" UWORD DFCDSQ_Verb 1 100 0.00 65535.0000000 FORMAT "%13.7" ECU_ADDRESS 0x60022496 /end MEASUREMENT
/begin MEASUREMENT DINH_xWhy.FId_bInhFrbd_Com_nrSerMaxCell "" UWORD DFCDSQ_Verb 1 100 0.00 65535.0000000 FORMAT "%13.7" ECU_ADDRESS 0x60022498 /end MEASUREMENT
/begin MEASUREMENT DINH_xWhy.FId_bInhFrbd_Com_nrSerMinCell "" UWORD DFCDSQ_Verb 1 100 0.00 65535.0000000 FORMAT "%13.7" ECU_ADDRESS 0x6002249A /end MEASUREMENT
/begin MEASUREMENT DINH_xWhy.FId_bInhFrbd_Com_pwrDcdcOutpCpby "" UWORD DFCDSQ_Verb 1 100 0.00 65535.0000000 FORMAT "%13.7" ECU_ADDRESS 0x6002249C /end MEASUREMENT
/begin MEASUREMENT DINH_xWhy.FId_bInhFrbd_Com_pwrElCmprActl "" UWORD DFCDSQ_Verb 1 100 0.00 65535.0000000 FORMAT "%13.7" ECU_ADDRESS 0x6002249E /end MEASUREMENT
/begin MEASUREMENT DINH_xWhy.FId_bInhFrbd_Com_pwrMaxChrgSho "" UWORD DFCDSQ_Verb 1 100 0.00 65535.0000000 FORMAT "%13.7" ECU_ADDRESS 0x600224A0 /end MEASUREMENT
/begin MEASUREMENT DINH_xWhy.FId_bInhFrbd_Com_pwrMaxDchaSho "" UWORD DFCDSQ_Verb 1 100 0.00 65535.0000000 FORMAT "%13.7" ECU_ADDRESS 0x600224A2 /end MEASUREMENT
/begin MEASUREMENT DINH_xWhy.FId_bInhFrbd_Com_qHvbTotCpRx "" UWORD DFCDSQ_Verb 1 100 0.00 65535.0000000 FORMAT "%13.7" ECU_ADDRESS 0x600224A4 /end MEASUREMENT
/begin MEASUREMENT DINH_xWhy.FId_bInhFrbd_Com_rHvbIsoMeasmt "" UWORD DFCDSQ_Verb 1 100 0.00 65535.0000000 FORMAT "%13.7" ECU_ADDRESS 0x600224A6 /end MEASUREMENT
/begin MEASUREMENT DINH_xWhy.FId_bInhFrbd_Com_ratHvbSoc "" UWORD DFCDSQ_Verb 1 100 0.00 65535.0000000 FORMAT "%13.7" ECU_ADDRESS 0x600224A8 /end MEASUREMENT
/begin MEASUREMENT DINH_xWhy.FId_bInhFrbd_Com_ratHvbSoh "" UWORD DFCDSQ_Verb 1 100 0.00 65535.0000000 FORMAT "%13.7" ECU_ADDRESS 0x600224AA /end MEASUREMENT
/begin MEASUREMENT DINH_xWhy.FId_bInhFrbd_Com_ratRHvbSoh "" UWORD DFCDSQ_Verb 1 100 0.00 65535.0000000 FORMAT "%13.7" ECU_ADDRESS 0x600224AC /end MEASUREMENT
/begin MEASUREMENT DINH_xWhy.FId_bInhFrbd_Com_ratSocLvBatt "" UWORD DFCDSQ_Verb 1 100 0.00 65535.0000000 FORMAT "%13.7" ECU_ADDRESS 0x600224AE /end MEASUREMENT
/begin MEASUREMENT DINH_xWhy.FId_bInhFrbd_Com_stElCmprFltLvl "" UWORD DFCDSQ_Verb 1 100 0.00 65535.0000000 FORMAT "%13.7" ECU_ADDRESS 0x600224B0 /end MEASUREMENT
/begin MEASUREMENT DINH_xWhy.FId_bInhFrbd_Com_stGearLvrPos "" UWORD DFCDSQ_Verb 1 100 0.00 65535.0000000 FORMAT "%13.7" ECU_ADDRESS 0x600224B2 /end MEASUREMENT
/begin MEASUREMENT DINH_xWhy.FId_bInhFrbd_Com_stIIvtrFltLvl01 "" UWORD DFCDSQ_Verb 1 100 0.00 65535.0000000 FORMAT "%13.7" ECU_ADDRESS 0x600224B4 /end MEASUREMENT
/begin MEASUREMENT DINH_xWhy.FId_bInhFrbd_Com_steTogFailrLvl "" UWORD DFCDSQ_Verb 1 100 0.00 65535.0000000 FORMAT "%13.7" ECU_ADDRESS 0x600224B6 /end MEASUREMENT
/begin MEASUREMENT DINH_xWhy.FId_bInhFrbd_Com_tDcdcAct "" UWORD DFCDSQ_Verb 1 100 0.00 65535.0000000 FORMAT "%13.7" ECU_ADDRESS 0x600224B8 /end MEASUREMENT
/begin MEASUREMENT DINH_xWhy.FId_bInhFrbd_Com_tDcdcInltCoolt "" UWORD DFCDSQ_Verb 1 100 0.00 65535.0000000 FORMAT "%13.7" ECU_ADDRESS 0x600224BA /end MEASUREMENT
/begin MEASUREMENT DINH_xWhy.FId_bInhFrbd_Com_tElCmprActl "" UWORD DFCDSQ_Verb 1 100 0.00 65535.0000000 FORMAT "%13.7" ECU_ADDRESS 0x600224BC /end MEASUREMENT
/begin MEASUREMENT DINH_xWhy.FId_bInhFrbd_Com_tEnvT "" UWORD DFCDSQ_Verb 1 100 0.00 65535.0000000 FORMAT "%13.7" ECU_ADDRESS 0x600224BE /end MEASUREMENT
/begin MEASUREMENT DINH_xWhy.FId_bInhFrbd_Com_tHvbAct "" UWORD DFCDSQ_Verb 1 100 0.00 65535.0000000 FORMAT "%13.7" ECU_ADDRESS 0x600224C0 /end MEASUREMENT
/begin MEASUREMENT DINH_xWhy.FId_bInhFrbd_Com_tHvbMax "" UWORD DFCDSQ_Verb 1 100 0.00 65535.0000000 FORMAT "%13.7" ECU_ADDRESS 0x600224C2 /end MEASUREMENT
/begin MEASUREMENT DINH_xWhy.FId_bInhFrbd_Com_tLvBatt "" UWORD DFCDSQ_Verb 1 100 0.00 65535.0000000 FORMAT "%13.7" ECU_ADDRESS 0x600224C4 /end MEASUREMENT
/begin MEASUREMENT DINH_xWhy.FId_bInhFrbd_Com_tiHvbChrgnHalfRx "" UWORD DFCDSQ_Verb 1 100 0.00 65535.0000000 FORMAT "%13.7" ECU_ADDRESS 0x600224C6 /end MEASUREMENT
/begin MEASUREMENT DINH_xWhy.FId_bInhFrbd_Com_uBattEBSRx "" UWORD DFCDSQ_Verb 1 100 0.00 65535.0000000 FORMAT "%13.7" ECU_ADDRESS 0x600224C8 /end MEASUREMENT
/begin MEASUREMENT DINH_xWhy.FId_bInhFrbd_Com_uDcdcHvAct "" UWORD DFCDSQ_Verb 1 100 0.00 65535.0000000 FORMAT "%13.7" ECU_ADDRESS 0x600224CA /end MEASUREMENT
/begin MEASUREMENT DINH_xWhy.FId_bInhFrbd_Com_uDcdcLvAct "" UWORD DFCDSQ_Verb 1 100 0.00 65535.0000000 FORMAT "%13.7" ECU_ADDRESS 0x600224CC /end MEASUREMENT
/begin MEASUREMENT DINH_xWhy.FId_bInhFrbd_Com_uElCmprHvAct "" UWORD DFCDSQ_Verb 1 100 0.00 65535.0000000 FORMAT "%13.7" ECU_ADDRESS 0x600224CE /end MEASUREMENT
/begin MEASUREMENT DINH_xWhy.FId_bInhFrbd_Com_uHvbAct "" UWORD DFCDSQ_Verb 1 100 0.00 65535.0000000 FORMAT "%13.7" ECU_ADDRESS 0x600224D0 /end MEASUREMENT
/begin MEASUREMENT DINH_xWhy.FId_bInhFrbd_Com_uHvbDcBus "" UWORD DFCDSQ_Verb 1 100 0.00 65535.0000000 FORMAT "%13.7" ECU_ADDRESS 0x600224D2 /end MEASUREMENT
/begin MEASUREMENT DINH_xWhy.FId_bInhFrbd_Com_uHvbLimHi "" UWORD DFCDSQ_Verb 1 100 0.00 65535.0000000 FORMAT "%13.7" ECU_ADDRESS 0x600224D4 /end MEASUREMENT
/begin MEASUREMENT DINH_xWhy.FId_bInhFrbd_Com_uHvbMaxCell "" UWORD DFCDSQ_Verb 1 100 0.00 65535.0000000 FORMAT "%13.7" ECU_ADDRESS 0x600224D6 /end MEASUREMENT
/begin MEASUREMENT DINH_xWhy.FId_bInhFrbd_Com_uHvbMinCell "" UWORD DFCDSQ_Verb 1 100 0.00 65535.0000000 FORMAT "%13.7" ECU_ADDRESS 0x600224D8 /end MEASUREMENT
/begin MEASUREMENT DINH_xWhy.FId_bInhFrbd_Com_uHvbNomChrgn "" UWORD DFCDSQ_Verb 1 100 0.00 65535.0000000 FORMAT "%13.7" ECU_ADDRESS 0x600224DA /end MEASUREMENT
/begin MEASUREMENT DINH_xWhy.FId_bInhInvld_ComChrgr_flgChrgrErrLvl "" UWORD DFCDSQ_Verb 1 100 0.00 65535.0000000 FORMAT "%13.7" ECU_ADDRESS 0x600224DC /end MEASUREMENT
/begin MEASUREMENT DINH_xWhy.FId_bInhInvld_ComChrgr_iAcMax "" UWORD DFCDSQ_Verb 1 100 0.00 65535.0000000 FORMAT "%13.7" ECU_ADDRESS 0x600224DE /end MEASUREMENT
/begin MEASUREMENT DINH_xWhy.FId_bInhInvld_ComChrgr_iDcHvAct "" UWORD DFCDSQ_Verb 1 100 0.00 65535.0000000 FORMAT "%13.7" ECU_ADDRESS 0x600224E0 /end MEASUREMENT
/begin MEASUREMENT DINH_xWhy.FId_bInhInvld_ComChrgr_pwrInAct "" UWORD DFCDSQ_Verb 1 100 0.00 65535.0000000 FORMAT "%13.7" ECU_ADDRESS 0x600224E2 /end MEASUREMENT
/begin MEASUREMENT DINH_xWhy.FId_bInhInvld_ComChrgr_pwrOutpCpby "" UWORD DFCDSQ_Verb 1 100 0.00 65535.0000000 FORMAT "%13.7" ECU_ADDRESS 0x600224E4 /end MEASUREMENT
/begin MEASUREMENT DINH_xWhy.FId_bInhInvld_ComChrgr_tChrgrMaxAct "" UWORD DFCDSQ_Verb 1 100 0.00 65535.0000000 FORMAT "%13.7" ECU_ADDRESS 0x600224E6 /end MEASUREMENT
/begin MEASUREMENT DINH_xWhy.FId_bInhInvld_ComChrgr_uAcActL1 "" UWORD DFCDSQ_Verb 1 100 0.00 65535.0000000 FORMAT "%13.7" ECU_ADDRESS 0x600224E8 /end MEASUREMENT
/begin MEASUREMENT DINH_xWhy.FId_bInhInvld_ComChrgr_uDcHvAct "" UWORD DFCDSQ_Verb 1 100 0.00 65535.0000000 FORMAT "%13.7" ECU_ADDRESS 0x600224EA /end MEASUREMENT
/begin MEASUREMENT DINH_xWhy.FId_bInhInvld_ComEmac_iDcLnk01 "" UWORD DFCDSQ_Verb 1 100 0.00 65535.0000000 FORMAT "%13.7" ECU_ADDRESS 0x600224EC /end MEASUREMENT
/begin MEASUREMENT DINH_xWhy.FId_bInhInvld_ComEmac_nAct01 "" UWORD DFCDSQ_Verb 1 100 0.00 65535.0000000 FORMAT "%13.7" ECU_ADDRESS 0x600224EE /end MEASUREMENT
/begin MEASUREMENT DINH_xWhy.FId_bInhInvld_ComEmac_pwrInstnsInpRx "" UWORD DFCDSQ_Verb 1 100 0.00 65535.0000000 FORMAT "%13.7" ECU_ADDRESS 0x600224F0 /end MEASUREMENT
/begin MEASUREMENT DINH_xWhy.FId_bInhInvld_ComEmac_stActvDcha "" UWORD DFCDSQ_Verb 1 100 0.00 65535.0000000 FORMAT "%13.7" ECU_ADDRESS 0x600224F2 /end MEASUREMENT
/begin MEASUREMENT DINH_xWhy.FId_bInhInvld_ComEmac_stIvtrOpMod01 "" UWORD DFCDSQ_Verb 1 100 0.00 65535.0000000 FORMAT "%13.7" ECU_ADDRESS 0x600224F4 /end MEASUREMENT
/begin MEASUREMENT DINH_xWhy.FId_bInhInvld_ComEmac_tInvr01 "" UWORD DFCDSQ_Verb 1 100 0.00 65535.0000000 FORMAT "%13.7" ECU_ADDRESS 0x600224F6 /end MEASUREMENT
/begin MEASUREMENT DINH_xWhy.FId_bInhInvld_ComEmac_tIvtrCooltIn01 "" UWORD DFCDSQ_Verb 1 100 0.00 65535.0000000 FORMAT "%13.7" ECU_ADDRESS 0x600224F8 /end MEASUREMENT
/begin MEASUREMENT DINH_xWhy.FId_bInhInvld_ComEmac_tMac01 "" UWORD DFCDSQ_Verb 1 100 0.00 65535.0000000 FORMAT "%13.7" ECU_ADDRESS 0x600224FA /end MEASUREMENT
/begin MEASUREMENT DINH_xWhy.FId_bInhInvld_ComEmac_tqAbsltMax01 "" UWORD DFCDSQ_Verb 1 100 0.00 65535.0000000 FORMAT "%13.7" ECU_ADDRESS 0x600224FC /end MEASUREMENT
/begin MEASUREMENT DINH_xWhy.FId_bInhInvld_ComEmac_tqAbsltMaxRx01 "" UWORD DFCDSQ_Verb 1 100 0.00 65535.0000000 FORMAT "%13.7" ECU_ADDRESS 0x600224FE /end MEASUREMENT
/begin MEASUREMENT DINH_xWhy.FId_bInhInvld_ComEmac_tqAbsltMin01 "" UWORD DFCDSQ_Verb 1 100 0.00 65535.0000000 FORMAT "%13.7" ECU_ADDRESS 0x60022500 /end MEASUREMENT
/begin MEASUREMENT DINH_xWhy.FId_bInhInvld_ComEmac_tqAbsltMinRx01 "" UWORD DFCDSQ_Verb 1 100 0.00 65535.0000000 FORMAT "%13.7" ECU_ADDRESS 0x60022502 /end MEASUREMENT
/begin MEASUREMENT DINH_xWhy.FId_bInhInvld_ComEmac_tqAckd01 "" UWORD DFCDSQ_Verb 1 100 0.00 65535.0000000 FORMAT "%13.7" ECU_ADDRESS 0x60022504 /end MEASUREMENT
/begin MEASUREMENT DINH_xWhy.FId_bInhInvld_ComEmac_tqAct01 "" UWORD DFCDSQ_Verb 1 100 0.00 65535.0000000 FORMAT "%13.7" ECU_ADDRESS 0x60022506 /end MEASUREMENT
/begin MEASUREMENT DINH_xWhy.FId_bInhInvld_ComEmac_tqPtd01 "" UWORD DFCDSQ_Verb 1 100 0.00 65535.0000000 FORMAT "%13.7" ECU_ADDRESS 0x60022508 /end MEASUREMENT
/begin MEASUREMENT DINH_xWhy.FId_bInhInvld_ComEmac_tqStabnMin "" UWORD DFCDSQ_Verb 1 100 0.00 65535.0000000 FORMAT "%13.7" ECU_ADDRESS 0x6002250A /end MEASUREMENT
/begin MEASUREMENT DINH_xWhy.FId_bInhInvld_ComEmac_uDcLnk01 "" UWORD DFCDSQ_Verb 1 100 0.00 65535.0000000 FORMAT "%13.7" ECU_ADDRESS 0x6002250C /end MEASUREMENT
/begin MEASUREMENT DINH_xWhy.FId_bInhInvld_Com_HvbMaxSnsrTempRx "" UWORD DFCDSQ_Verb 1 100 0.00 65535.0000000 FORMAT "%13.7" ECU_ADDRESS 0x6002250E /end MEASUREMENT
/begin MEASUREMENT DINH_xWhy.FId_bInhInvld_Com_ctHvbNegCntctrSeg1 "" UWORD DFCDSQ_Verb 1 100 0.00 65535.0000000 FORMAT "%13.7" ECU_ADDRESS 0x60022510 /end MEASUREMENT
/begin MEASUREMENT DINH_xWhy.FId_bInhInvld_Com_ctHvbNegCntctrSeg3 "" UWORD DFCDSQ_Verb 1 100 0.00 65535.0000000 FORMAT "%13.7" ECU_ADDRESS 0x60022512 /end MEASUREMENT
/begin MEASUREMENT DINH_xWhy.FId_bInhInvld_Com_ctHvbNegCntctrSeg4 "" UWORD DFCDSQ_Verb 1 100 0.00 65535.0000000 FORMAT "%13.7" ECU_ADDRESS 0x60022514 /end MEASUREMENT
/begin MEASUREMENT DINH_xWhy.FId_bInhInvld_Com_ctHvbPosCntctrSeg1 "" UWORD DFCDSQ_Verb 1 100 0.00 65535.0000000 FORMAT "%13.7" ECU_ADDRESS 0x60022516 /end MEASUREMENT
/begin MEASUREMENT DINH_xWhy.FId_bInhInvld_Com_ctHvbPosCntctrSeg3 "" UWORD DFCDSQ_Verb 1 100 0.00 65535.0000000 FORMAT "%13.7" ECU_ADDRESS 0x60022518 /end MEASUREMENT
/begin MEASUREMENT DINH_xWhy.FId_bInhInvld_Com_ctHvbPosCntctrSeg4 "" UWORD DFCDSQ_Verb 1 100 0.00 65535.0000000 FORMAT "%13.7" ECU_ADDRESS 0x6002251A /end MEASUREMENT
/begin MEASUREMENT DINH_xWhy.FId_bInhInvld_Com_ctHvbPrecCntctrSeg1 "" UWORD DFCDSQ_Verb 1 100 0.00 65535.0000000 FORMAT "%13.7" ECU_ADDRESS 0x6002251C /end MEASUREMENT
/begin MEASUREMENT DINH_xWhy.FId_bInhInvld_Com_ctHvbPrecCntctrSeg2 "" UWORD DFCDSQ_Verb 1 100 0.00 65535.0000000 FORMAT "%13.7" ECU_ADDRESS 0x6002251E /end MEASUREMENT
/begin MEASUREMENT DINH_xWhy.FId_bInhInvld_Com_egyHvbAvl_fRx "" UWORD DFCDSQ_Verb 1 100 0.00 65535.0000000 FORMAT "%13.7" ECU_ADDRESS 0x60022520 /end MEASUREMENT
/begin MEASUREMENT DINH_xWhy.FId_bInhInvld_Com_flgEcoNormReqRx "" UWORD DFCDSQ_Verb 1 100 0.00 65535.0000000 FORMAT "%13.7" ECU_ADDRESS 0x60022522 /end MEASUREMENT
/begin MEASUREMENT DINH_xWhy.FId_bInhInvld_Com_flgVehSpdAvl "" UWORD DFCDSQ_Verb 1 100 0.00 65535.0000000 FORMAT "%13.7" ECU_ADDRESS 0x60022524 /end MEASUREMENT
/begin MEASUREMENT DINH_xWhy.FId_bInhInvld_Com_iBattEBS1Rx "" UWORD DFCDSQ_Verb 1 100 0.00 65535.0000000 FORMAT "%13.7" ECU_ADDRESS 0x60022526 /end MEASUREMENT
/begin MEASUREMENT DINH_xWhy.FId_bInhInvld_Com_iBattEBS2Rx "" UWORD DFCDSQ_Verb 1 100 0.00 65535.0000000 FORMAT "%13.7" ECU_ADDRESS 0x60022528 /end MEASUREMENT
/begin MEASUREMENT DINH_xWhy.FId_bInhInvld_Com_iBattEBS3Rx "" UWORD DFCDSQ_Verb 1 100 0.00 65535.0000000 FORMAT "%13.7" ECU_ADDRESS 0x6002252A /end MEASUREMENT
/begin MEASUREMENT DINH_xWhy.FId_bInhInvld_Com_iDcdcHvActRvsn1 "" UWORD DFCDSQ_Verb 1 100 0.00 65535.0000000 FORMAT "%13.7" ECU_ADDRESS 0x6002252C /end MEASUREMENT
/begin MEASUREMENT DINH_xWhy.FId_bInhInvld_Com_iDcdcLvActRvsn1 "" UWORD DFCDSQ_Verb 1 100 0.00 65535.0000000 FORMAT "%13.7" ECU_ADDRESS 0x6002252E /end MEASUREMENT
/begin MEASUREMENT DINH_xWhy.FId_bInhInvld_Com_iElCmprHvAct "" UWORD DFCDSQ_Verb 1 100 0.00 65535.0000000 FORMAT "%13.7" ECU_ADDRESS 0x60022530 /end MEASUREMENT
/begin MEASUREMENT DINH_xWhy.FId_bInhInvld_Com_iElCmprPeakPha "" UWORD DFCDSQ_Verb 1 100 0.00 65535.0000000 FORMAT "%13.7" ECU_ADDRESS 0x60022532 /end MEASUREMENT
/begin MEASUREMENT DINH_xWhy.FId_bInhInvld_Com_iHvbActRx "" UWORD DFCDSQ_Verb 1 100 0.00 65535.0000000 FORMAT "%13.7" ECU_ADDRESS 0x60022534 /end MEASUREMENT
/begin MEASUREMENT DINH_xWhy.FId_bInhInvld_Com_iHvbChrgMaxSho "" UWORD DFCDSQ_Verb 1 100 0.00 65535.0000000 FORMAT "%13.7" ECU_ADDRESS 0x60022536 /end MEASUREMENT
/begin MEASUREMENT DINH_xWhy.FId_bInhInvld_Com_iHvbDchaMaxSho "" UWORD DFCDSQ_Verb 1 100 0.00 65535.0000000 FORMAT "%13.7" ECU_ADDRESS 0x60022538 /end MEASUREMENT
/begin MEASUREMENT DINH_xWhy.FId_bInhInvld_Com_iHvbDes "" UWORD DFCDSQ_Verb 1 100 0.00 65535.0000000 FORMAT "%13.7" ECU_ADDRESS 0x6002253A /end MEASUREMENT
/begin MEASUREMENT DINH_xWhy.FId_bInhInvld_Com_iHvbNomChrgn "" UWORD DFCDSQ_Verb 1 100 0.00 65535.0000000 FORMAT "%13.7" ECU_ADDRESS 0x6002253C /end MEASUREMENT
/begin MEASUREMENT DINH_xWhy.FId_bInhInvld_Com_lDstGlbDa "" UWORD DFCDSQ_Verb 1 100 0.00 65535.0000000 FORMAT "%13.7" ECU_ADDRESS 0x6002253E /end MEASUREMENT
/begin MEASUREMENT DINH_xWhy.FId_bInhInvld_Com_lTotOdometer "" UWORD DFCDSQ_Verb 1 100 0.00 65535.0000000 FORMAT "%13.7" ECU_ADDRESS 0x60022540 /end MEASUREMENT
/begin MEASUREMENT DINH_xWhy.FId_bInhInvld_Com_nElCmprActl "" UWORD DFCDSQ_Verb 1 100 0.00 65535.0000000 FORMAT "%13.7" ECU_ADDRESS 0x60022542 /end MEASUREMENT
/begin MEASUREMENT DINH_xWhy.FId_bInhInvld_Com_nrSerMaxCell "" UWORD DFCDSQ_Verb 1 100 0.00 65535.0000000 FORMAT "%13.7" ECU_ADDRESS 0x60022544 /end MEASUREMENT
/begin MEASUREMENT DINH_xWhy.FId_bInhInvld_Com_nrSerMinCell "" UWORD DFCDSQ_Verb 1 100 0.00 65535.0000000 FORMAT "%13.7" ECU_ADDRESS 0x60022546 /end MEASUREMENT
/begin MEASUREMENT DINH_xWhy.FId_bInhInvld_Com_pwrDcdcOutpCpby "" UWORD DFCDSQ_Verb 1 100 0.00 65535.0000000 FORMAT "%13.7" ECU_ADDRESS 0x60022548 /end MEASUREMENT
/begin MEASUREMENT DINH_xWhy.FId_bInhInvld_Com_pwrElCmprActl "" UWORD DFCDSQ_Verb 1 100 0.00 65535.0000000 FORMAT "%13.7" ECU_ADDRESS 0x6002254A /end MEASUREMENT
/begin MEASUREMENT DINH_xWhy.FId_bInhInvld_Com_pwrMaxChrgSho "" UWORD DFCDSQ_Verb 1 100 0.00 65535.0000000 FORMAT "%13.7" ECU_ADDRESS 0x6002254C /end MEASUREMENT
/begin MEASUREMENT DINH_xWhy.FId_bInhInvld_Com_pwrMaxDchaSho "" UWORD DFCDSQ_Verb 1 100 0.00 65535.0000000 FORMAT "%13.7" ECU_ADDRESS 0x6002254E /end MEASUREMENT
/begin MEASUREMENT DINH_xWhy.FId_bInhInvld_Com_qHvbTotCpRx "" UWORD DFCDSQ_Verb 1 100 0.00 65535.0000000 FORMAT "%13.7" ECU_ADDRESS 0x60022550 /end MEASUREMENT
/begin MEASUREMENT DINH_xWhy.FId_bInhInvld_Com_rHvbIsoMeasmt "" UWORD DFCDSQ_Verb 1 100 0.00 65535.0000000 FORMAT "%13.7" ECU_ADDRESS 0x60022552 /end MEASUREMENT
/begin MEASUREMENT DINH_xWhy.FId_bInhInvld_Com_ratHvbSoc "" UWORD DFCDSQ_Verb 1 100 0.00 65535.0000000 FORMAT "%13.7" ECU_ADDRESS 0x60022554 /end MEASUREMENT
/begin MEASUREMENT DINH_xWhy.FId_bInhInvld_Com_ratHvbSoh "" UWORD DFCDSQ_Verb 1 100 0.00 65535.0000000 FORMAT "%13.7" ECU_ADDRESS 0x60022556 /end MEASUREMENT
/begin MEASUREMENT DINH_xWhy.FId_bInhInvld_Com_ratRHvbSoh "" UWORD DFCDSQ_Verb 1 100 0.00 65535.0000000 FORMAT "%13.7" ECU_ADDRESS 0x60022558 /end MEASUREMENT
/begin MEASUREMENT DINH_xWhy.FId_bInhInvld_Com_ratSocLvBatt "" UWORD DFCDSQ_Verb 1 100 0.00 65535.0000000 FORMAT "%13.7" ECU_ADDRESS 0x6002255A /end MEASUREMENT
/begin MEASUREMENT DINH_xWhy.FId_bInhInvld_Com_stAC "" UWORD DFCDSQ_Verb 1 100 0.00 65535.0000000 FORMAT "%13.7" ECU_ADDRESS 0x6002255C /end MEASUREMENT
/begin MEASUREMENT DINH_xWhy.FId_bInhInvld_Com_stAlrtThermRunAwy "" UWORD DFCDSQ_Verb 1 100 0.00 65535.0000000 FORMAT "%13.7" ECU_ADDRESS 0x6002255E /end MEASUREMENT
/begin MEASUREMENT DINH_xWhy.FId_bInhInvld_Com_stBlowrRly "" UWORD DFCDSQ_Verb 1 100 0.00 65535.0000000 FORMAT "%13.7" ECU_ADDRESS 0x60022560 /end MEASUREMENT
/begin MEASUREMENT DINH_xWhy.FId_bInhInvld_Com_stDcdcFltLvl "" UWORD DFCDSQ_Verb 1 100 0.00 65535.0000000 FORMAT "%13.7" ECU_ADDRESS 0x60022562 /end MEASUREMENT
/begin MEASUREMENT DINH_xWhy.FId_bInhInvld_Com_stEvapTFlt "" UWORD DFCDSQ_Verb 1 100 0.00 65535.0000000 FORMAT "%13.7" ECU_ADDRESS 0x60022564 /end MEASUREMENT
/begin MEASUREMENT DINH_xWhy.FId_bInhInvld_Com_stGearLvrPos "" UWORD DFCDSQ_Verb 1 100 0.00 65535.0000000 FORMAT "%13.7" ECU_ADDRESS 0x60022566 /end MEASUREMENT
/begin MEASUREMENT DINH_xWhy.FId_bInhInvld_Com_stHvacBlwrFront "" UWORD DFCDSQ_Verb 1 100 0.00 65535.0000000 FORMAT "%13.7" ECU_ADDRESS 0x60022568 /end MEASUREMENT
/begin MEASUREMENT DINH_xWhy.FId_bInhInvld_Com_stHvacKnobPosn "" UWORD DFCDSQ_Verb 1 100 0.00 65535.0000000 FORMAT "%13.7" ECU_ADDRESS 0x6002256A /end MEASUREMENT
/begin MEASUREMENT DINH_xWhy.FId_bInhInvld_Com_stHvacPanPotiFlt "" UWORD DFCDSQ_Verb 1 100 0.00 65535.0000000 FORMAT "%13.7" ECU_ADDRESS 0x6002256C /end MEASUREMENT
/begin MEASUREMENT DINH_xWhy.FId_bInhInvld_Com_stHvbChrgn "" UWORD DFCDSQ_Verb 1 100 0.00 65535.0000000 FORMAT "%13.7" ECU_ADDRESS 0x6002256E /end MEASUREMENT
/begin MEASUREMENT DINH_xWhy.FId_bInhInvld_Com_stHvbDiscnctReas "" UWORD DFCDSQ_Verb 1 100 0.00 65535.0000000 FORMAT "%13.7" ECU_ADDRESS 0x60022570 /end MEASUREMENT
/begin MEASUREMENT DINH_xWhy.FId_bInhInvld_Com_stHvbIntlckRx "" UWORD DFCDSQ_Verb 1 100 0.00 65535.0000000 FORMAT "%13.7" ECU_ADDRESS 0x60022572 /end MEASUREMENT
/begin MEASUREMENT DINH_xWhy.FId_bInhInvld_Com_stHvbIsoFltRx "" UWORD DFCDSQ_Verb 1 100 0.00 65535.0000000 FORMAT "%13.7" ECU_ADDRESS 0x60022574 /end MEASUREMENT
/begin MEASUREMENT DINH_xWhy.FId_bInhInvld_Com_stHvbSrvPlgRx "" UWORD DFCDSQ_Verb 1 100 0.00 65535.0000000 FORMAT "%13.7" ECU_ADDRESS 0x60022576 /end MEASUREMENT
/begin MEASUREMENT DINH_xWhy.FId_bInhInvld_Com_stIBattEBS "" UWORD DFCDSQ_Verb 1 100 0.00 65535.0000000 FORMAT "%13.7" ECU_ADDRESS 0x60022578 /end MEASUREMENT
/begin MEASUREMENT DINH_xWhy.FId_bInhInvld_Com_stIIvtrFltLvl01 "" UWORD DFCDSQ_Verb 1 100 0.00 65535.0000000 FORMAT "%13.7" ECU_ADDRESS 0x6002257A /end MEASUREMENT
/begin MEASUREMENT DINH_xWhy.FId_bInhInvld_Com_stMainWkuReq "" UWORD DFCDSQ_Verb 1 100 0.00 65535.0000000 FORMAT "%13.7" ECU_ADDRESS 0x6002257C /end MEASUREMENT
/begin MEASUREMENT DINH_xWhy.FId_bInhInvld_Com_stReFogReq "" UWORD DFCDSQ_Verb 1 100 0.00 65535.0000000 FORMAT "%13.7" ECU_ADDRESS 0x6002257E /end MEASUREMENT
/begin MEASUREMENT DINH_xWhy.FId_bInhInvld_Com_stSocRx "" UWORD DFCDSQ_Verb 1 100 0.00 65535.0000000 FORMAT "%13.7" ECU_ADDRESS 0x60022580 /end MEASUREMENT
/begin MEASUREMENT DINH_xWhy.FId_bInhInvld_Com_stT "" UWORD DFCDSQ_Verb 1 100 0.00 65535.0000000 FORMAT "%13.7" ECU_ADDRESS 0x60022582 /end MEASUREMENT
/begin MEASUREMENT DINH_xWhy.FId_bInhInvld_Com_tDcdcAct "" UWORD DFCDSQ_Verb 1 100 0.00 65535.0000000 FORMAT "%13.7" ECU_ADDRESS 0x60022584 /end MEASUREMENT
/begin MEASUREMENT DINH_xWhy.FId_bInhInvld_Com_tDcdcInltCoolt "" UWORD DFCDSQ_Verb 1 100 0.00 65535.0000000 FORMAT "%13.7" ECU_ADDRESS 0x60022586 /end MEASUREMENT
/begin MEASUREMENT DINH_xWhy.FId_bInhInvld_Com_tElCmprActl "" UWORD DFCDSQ_Verb 1 100 0.00 65535.0000000 FORMAT "%13.7" ECU_ADDRESS 0x60022588 /end MEASUREMENT
/begin MEASUREMENT DINH_xWhy.FId_bInhInvld_Com_tEnvT "" UWORD DFCDSQ_Verb 1 100 0.00 65535.0000000 FORMAT "%13.7" ECU_ADDRESS 0x6002258A /end MEASUREMENT
/begin MEASUREMENT DINH_xWhy.FId_bInhInvld_Com_tEvapT "" UWORD DFCDSQ_Verb 1 100 0.00 65535.0000000 FORMAT "%13.7" ECU_ADDRESS 0x6002258C /end MEASUREMENT
/begin MEASUREMENT DINH_xWhy.FId_bInhInvld_Com_tHvbAct "" UWORD DFCDSQ_Verb 1 100 0.00 65535.0000000 FORMAT "%13.7" ECU_ADDRESS 0x6002258E /end MEASUREMENT
/begin MEASUREMENT DINH_xWhy.FId_bInhInvld_Com_tHvbMax "" UWORD DFCDSQ_Verb 1 100 0.00 65535.0000000 FORMAT "%13.7" ECU_ADDRESS 0x60022590 /end MEASUREMENT
/begin MEASUREMENT DINH_xWhy.FId_bInhInvld_Com_tLvBatt "" UWORD DFCDSQ_Verb 1 100 0.00 65535.0000000 FORMAT "%13.7" ECU_ADDRESS 0x60022592 /end MEASUREMENT
/begin MEASUREMENT DINH_xWhy.FId_bInhInvld_Com_tiCurVehTmr "" UWORD DFCDSQ_Verb 1 100 0.00 65535.0000000 FORMAT "%13.7" ECU_ADDRESS 0x60022594 /end MEASUREMENT
/begin MEASUREMENT DINH_xWhy.FId_bInhInvld_Com_tiHvbChrgnHalfRx "" UWORD DFCDSQ_Verb 1 100 0.00 65535.0000000 FORMAT "%13.7" ECU_ADDRESS 0x60022596 /end MEASUREMENT
/begin MEASUREMENT DINH_xWhy.FId_bInhInvld_Com_uBattEBSRx "" UWORD DFCDSQ_Verb 1 100 0.00 65535.0000000 FORMAT "%13.7" ECU_ADDRESS 0x60022598 /end MEASUREMENT
/begin MEASUREMENT DINH_xWhy.FId_bInhInvld_Com_uDcdcHvAct "" UWORD DFCDSQ_Verb 1 100 0.00 65535.0000000 FORMAT "%13.7" ECU_ADDRESS 0x6002259A /end MEASUREMENT
/begin MEASUREMENT DINH_xWhy.FId_bInhInvld_Com_uDcdcLvAct "" UWORD DFCDSQ_Verb 1 100 0.00 65535.0000000 FORMAT "%13.7" ECU_ADDRESS 0x6002259C /end MEASUREMENT
/begin MEASUREMENT DINH_xWhy.FId_bInhInvld_Com_uElCmprHvAct "" UWORD DFCDSQ_Verb 1 100 0.00 65535.0000000 FORMAT "%13.7" ECU_ADDRESS 0x6002259E /end MEASUREMENT
/begin MEASUREMENT DINH_xWhy.FId_bInhInvld_Com_uHvbAct "" UWORD DFCDSQ_Verb 1 100 0.00 65535.0000000 FORMAT "%13.7" ECU_ADDRESS 0x600225A0 /end MEASUREMENT
/begin MEASUREMENT DINH_xWhy.FId_bInhInvld_Com_uHvbDcBus "" UWORD DFCDSQ_Verb 1 100 0.00 65535.0000000 FORMAT "%13.7" ECU_ADDRESS 0x600225A2 /end MEASUREMENT
/begin MEASUREMENT DINH_xWhy.FId_bInhInvld_Com_uHvbLimHi "" UWORD DFCDSQ_Verb 1 100 0.00 65535.0000000 FORMAT "%13.7" ECU_ADDRESS 0x600225A4 /end MEASUREMENT
/begin MEASUREMENT DINH_xWhy.FId_bInhInvld_Com_uHvbMaxCell "" UWORD DFCDSQ_Verb 1 100 0.00 65535.0000000 FORMAT "%13.7" ECU_ADDRESS 0x600225A6 /end MEASUREMENT
/begin MEASUREMENT DINH_xWhy.FId_bInhInvld_Com_uHvbMinCell "" UWORD DFCDSQ_Verb 1 100 0.00 65535.0000000 FORMAT "%13.7" ECU_ADDRESS 0x600225A8 /end MEASUREMENT
/begin MEASUREMENT DINH_xWhy.FId_bInhInvld_Com_uHvbNomChrgn "" UWORD DFCDSQ_Verb 1 100 0.00 65535.0000000 FORMAT "%13.7" ECU_ADDRESS 0x600225AA /end MEASUREMENT
/begin MEASUREMENT DINH_xWhy.FId_bInhInvld_Com_vVeh "" UWORD DFCDSQ_Verb 1 100 0.00 65535.0000000 FORMAT "%13.7" ECU_ADDRESS 0x600225AC /end MEASUREMENT
/begin MEASUREMENT DINH_xWhy.FId_bInh_ACCmpr_pwrLimMax "" UWORD DFCDSQ_Verb 1 100 0.00 65535.0000000 FORMAT "%13.7" ECU_ADDRESS 0x600225AE /end MEASUREMENT
/begin MEASUREMENT DINH_xWhy.FId_bInh_ACCtl_flgCmprEna "" UWORD DFCDSQ_Verb 1 100 0.00 65535.0000000 FORMAT "%13.7" ECU_ADDRESS 0x600225B0 /end MEASUREMENT
/begin MEASUREMENT DINH_xWhy.FId_bInh_ACCtl_nCmprSpdReq "" UWORD DFCDSQ_Verb 1 100 0.00 65535.0000000 FORMAT "%13.7" ECU_ADDRESS 0x600225B2 /end MEASUREMENT
/begin MEASUREMENT DINH_xWhy.FId_bInh_APP_rInp "" UWORD DFCDSQ_Verb 1 100 0.00 65535.0000000 FORMAT "%13.7" ECU_ADDRESS 0x600225B4 /end MEASUREMENT
/begin MEASUREMENT DINH_xWhy.FId_bInh_BattId_numOrganNature1 "" UWORD DFCDSQ_Verb 1 100 0.00 65535.0000000 FORMAT "%13.7" ECU_ADDRESS 0x600225B6 /end MEASUREMENT
/begin MEASUREMENT DINH_xWhy.FId_bInh_BattId_numOrganNature2 "" UWORD DFCDSQ_Verb 1 100 0.00 65535.0000000 FORMAT "%13.7" ECU_ADDRESS 0x600225B8 /end MEASUREMENT
/begin MEASUREMENT DINH_xWhy.FId_bInh_BattId_numOrganRef1 "" UWORD DFCDSQ_Verb 1 100 0.00 65535.0000000 FORMAT "%13.7" ECU_ADDRESS 0x600225BA /end MEASUREMENT
/begin MEASUREMENT DINH_xWhy.FId_bInh_BattId_numOrganRef2 "" UWORD DFCDSQ_Verb 1 100 0.00 65535.0000000 FORMAT "%13.7" ECU_ADDRESS 0x600225BC /end MEASUREMENT
/begin MEASUREMENT DINH_xWhy.FId_bInh_BattId_numOrganRef3 "" UWORD DFCDSQ_Verb 1 100 0.00 65535.0000000 FORMAT "%13.7" ECU_ADDRESS 0x600225BE /end MEASUREMENT
/begin MEASUREMENT DINH_xWhy.FId_bInh_BattId_numOrganRef4 "" UWORD DFCDSQ_Verb 1 100 0.00 65535.0000000 FORMAT "%13.7" ECU_ADDRESS 0x600225C0 /end MEASUREMENT
/begin MEASUREMENT DINH_xWhy.FId_bInh_BattId_numSerl1 "" UWORD DFCDSQ_Verb 1 100 0.00 65535.0000000 FORMAT "%13.7" ECU_ADDRESS 0x600225C2 /end MEASUREMENT
/begin MEASUREMENT DINH_xWhy.FId_bInh_BattId_numSerl2 "" UWORD DFCDSQ_Verb 1 100 0.00 65535.0000000 FORMAT "%13.7" ECU_ADDRESS 0x600225C4 /end MEASUREMENT
/begin MEASUREMENT DINH_xWhy.FId_bInh_BattId_numSerl3 "" UWORD DFCDSQ_Verb 1 100 0.00 65535.0000000 FORMAT "%13.7" ECU_ADDRESS 0x600225C6 /end MEASUREMENT
/begin MEASUREMENT DINH_xWhy.FId_bInh_BattId_numSerl4 "" UWORD DFCDSQ_Verb 1 100 0.00 65535.0000000 FORMAT "%13.7" ECU_ADDRESS 0x600225C8 /end MEASUREMENT
/begin MEASUREMENT DINH_xWhy.FId_bInh_BattId_numSerl5 "" UWORD DFCDSQ_Verb 1 100 0.00 65535.0000000 FORMAT "%13.7" ECU_ADDRESS 0x600225CA /end MEASUREMENT
/begin MEASUREMENT DINH_xWhy.FId_bInh_BattId_numSerl6 "" UWORD DFCDSQ_Verb 1 100 0.00 65535.0000000 FORMAT "%13.7" ECU_ADDRESS 0x600225CC /end MEASUREMENT
/begin MEASUREMENT DINH_xWhy.FId_bInh_BattId_numSerl7 "" UWORD DFCDSQ_Verb 1 100 0.00 65535.0000000 FORMAT "%13.7" ECU_ADDRESS 0x600225CE /end MEASUREMENT
/begin MEASUREMENT DINH_xWhy.FId_bInh_Brk_stRed "" UWORD DFCDSQ_Verb 1 100 0.00 65535.0000000 FORMAT "%13.7" ECU_ADDRESS 0x600225D0 /end MEASUREMENT
/begin MEASUREMENT DINH_xWhy.FId_bInh_CbnHeatgHeatr_cntrRlyLf "" UWORD DFCDSQ_Verb 1 100 0.00 65535.0000000 FORMAT "%13.7" ECU_ADDRESS 0x600225D2 /end MEASUREMENT
/begin MEASUREMENT DINH_xWhy.FId_bInh_ChgrPlug_stPlgLockTx "" UWORD DFCDSQ_Verb 1 100 0.00 65535.0000000 FORMAT "%13.7" ECU_ADDRESS 0x600225D4 /end MEASUREMENT
/begin MEASUREMENT DINH_xWhy.FId_bInh_ChrgCntct_nrNegCntctElpdOper "" UWORD DFCDSQ_Verb 1 100 0.00 65535.0000000 FORMAT "%13.7" ECU_ADDRESS 0x600225D6 /end MEASUREMENT
/begin MEASUREMENT DINH_xWhy.FId_bInh_ChrgCntct_nrPosCntctElpdOper "" UWORD DFCDSQ_Verb 1 100 0.00 65535.0000000 FORMAT "%13.7" ECU_ADDRESS 0x600225D8 /end MEASUREMENT
/begin MEASUREMENT DINH_xWhy.FId_bInh_ChrgrRly_stRlyDes "" UWORD DFCDSQ_Verb 1 100 0.00 65535.0000000 FORMAT "%13.7" ECU_ADDRESS 0x600225DA /end MEASUREMENT
/begin MEASUREMENT DINH_xWhy.FId_bInh_ChrgrVal_iChrgrDes "" UWORD DFCDSQ_Verb 1 100 0.00 65535.0000000 FORMAT "%13.7" ECU_ADDRESS 0x600225DC /end MEASUREMENT
/begin MEASUREMENT DINH_xWhy.FId_bInh_ChrgrVal_iGridLimMax "" UWORD DFCDSQ_Verb 1 100 0.00 65535.0000000 FORMAT "%13.7" ECU_ADDRESS 0x600225DE /end MEASUREMENT
/begin MEASUREMENT DINH_xWhy.FId_bInh_ChrgrVal_uHvMax "" UWORD DFCDSQ_Verb 1 100 0.00 65535.0000000 FORMAT "%13.7" ECU_ADDRESS 0x600225E0 /end MEASUREMENT
/begin MEASUREMENT DINH_xWhy.FId_bInh_CoDrvPITh_stEPSModeReq "" UWORD DFCDSQ_Verb 1 100 0.00 65535.0000000 FORMAT "%13.7" ECU_ADDRESS 0x600225E2 /end MEASUREMENT
/begin MEASUREMENT DINH_xWhy.FId_bInh_CoPtFH_stPwt "" UWORD DFCDSQ_Verb 1 100 0.00 65535.0000000 FORMAT "%13.7" ECU_ADDRESS 0x600225E4 /end MEASUREMENT
/begin MEASUREMENT DINH_xWhy.FId_bInh_ComChrg_stMod "" UWORD DFCDSQ_Verb 1 100 0.00 65535.0000000 FORMAT "%13.7" ECU_ADDRESS 0x600225E6 /end MEASUREMENT
/begin MEASUREMENT DINH_xWhy.FId_bInh_ComChrgn_iDcRly_Sq_Frz "" UWORD DFCDSQ_Verb 1 100 0.00 65535.0000000 FORMAT "%13.7" ECU_ADDRESS 0x600225E8 /end MEASUREMENT
/begin MEASUREMENT DINH_xWhy.FId_bInh_ComChrgn_uDcRly_Sq_Frz "" UWORD DFCDSQ_Verb 1 100 0.00 65535.0000000 FORMAT "%13.7" ECU_ADDRESS 0x600225EA /end MEASUREMENT
/begin MEASUREMENT DINH_xWhy.FId_bInh_ComChrgr_flgChrgrErr_Sq_Frz "" UWORD DFCDSQ_Verb 1 100 0.00 65535.0000000 FORMAT "%13.7" ECU_ADDRESS 0x600225EC /end MEASUREMENT
/begin MEASUREMENT DINH_xWhy.FId_bInh_ComChrgr_iAcMax_Sq_Frz "" UWORD DFCDSQ_Verb 1 100 0.00 65535.0000000 FORMAT "%13.7" ECU_ADDRESS 0x600225EE /end MEASUREMENT
/begin MEASUREMENT DINH_xWhy.FId_bInh_ComChrgr_iDcHvAct_Sq_Frz "" UWORD DFCDSQ_Verb 1 100 0.00 65535.0000000 FORMAT "%13.7" ECU_ADDRESS 0x600225F0 /end MEASUREMENT
/begin MEASUREMENT DINH_xWhy.FId_bInh_ComChrgr_pwrInAct_Sq_Frz "" UWORD DFCDSQ_Verb 1 100 0.00 65535.0000000 FORMAT "%13.7" ECU_ADDRESS 0x600225F2 /end MEASUREMENT
/begin MEASUREMENT DINH_xWhy.FId_bInh_ComChrgr_stChrgnEna "" UWORD DFCDSQ_Verb 1 100 0.00 65535.0000000 FORMAT "%13.7" ECU_ADDRESS 0x600225F4 /end MEASUREMENT
/begin MEASUREMENT DINH_xWhy.FId_bInh_ComChrgr_stChrgr_Sq_Frz "" UWORD DFCDSQ_Verb 1 100 0.00 65535.0000000 FORMAT "%13.7" ECU_ADDRESS 0x600225F6 /end MEASUREMENT
/begin MEASUREMENT DINH_xWhy.FId_bInh_ComChrgr_tChrgrMaxAct_Sq_Frz "" UWORD DFCDSQ_Verb 1 100 0.00 65535.0000000 FORMAT "%13.7" ECU_ADDRESS 0x600225F8 /end MEASUREMENT
/begin MEASUREMENT DINH_xWhy.FId_bInh_ComChrgr_uAcActL1_Sq_Frz "" UWORD DFCDSQ_Verb 1 100 0.00 65535.0000000 FORMAT "%13.7" ECU_ADDRESS 0x600225FA /end MEASUREMENT
/begin MEASUREMENT DINH_xWhy.FId_bInh_ComChrgr_uDcHvAct_Sq_Frz "" UWORD DFCDSQ_Verb 1 100 0.00 65535.0000000 FORMAT "%13.7" ECU_ADDRESS 0x600225FC /end MEASUREMENT
/begin MEASUREMENT DINH_xWhy.FId_bInh_ComEmac_flgSvsReq01_Sq_Frz "" UWORD DFCDSQ_Verb 1 100 0.00 65535.0000000 FORMAT "%13.7" ECU_ADDRESS 0x600225FE /end MEASUREMENT
/begin MEASUREMENT DINH_xWhy.FId_bInh_ComEmac_tIvtrCoolt01_Sq_Frz "" UWORD DFCDSQ_Verb 1 100 0.00 65535.0000000 FORMAT "%13.7" ECU_ADDRESS 0x60022600 /end MEASUREMENT
/begin MEASUREMENT DINH_xWhy.FId_bInh_Com_25h_B1b0 "" UWORD DFCDSQ_Verb 1 100 0.00 65535.0000000 FORMAT "%13.7" ECU_ADDRESS 0x60022602 /end MEASUREMENT
/begin MEASUREMENT DINH_xWhy.FId_bInh_Com_25h_B1b2 "" UWORD DFCDSQ_Verb 1 100 0.00 65535.0000000 FORMAT "%13.7" ECU_ADDRESS 0x60022604 /end MEASUREMENT
/begin MEASUREMENT DINH_xWhy.FId_bInh_Com_25h_B1b4 "" UWORD DFCDSQ_Verb 1 100 0.00 65535.0000000 FORMAT "%13.7" ECU_ADDRESS 0x60022606 /end MEASUREMENT
/begin MEASUREMENT DINH_xWhy.FId_bInh_Com_25h_B1b6 "" UWORD DFCDSQ_Verb 1 100 0.00 65535.0000000 FORMAT "%13.7" ECU_ADDRESS 0x60022608 /end MEASUREMENT
/begin MEASUREMENT DINH_xWhy.FId_bInh_Com_HvbMaxSnsrTempTx "" UWORD DFCDSQ_Verb 1 100 0.00 65535.0000000 FORMAT "%13.7" ECU_ADDRESS 0x6002260A /end MEASUREMENT
/begin MEASUREMENT DINH_xWhy.FId_bInh_Com_TogLedDrv "" UWORD DFCDSQ_Verb 1 100 0.00 65535.0000000 FORMAT "%13.7" ECU_ADDRESS 0x6002260C /end MEASUREMENT
/begin MEASUREMENT DINH_xWhy.FId_bInh_Com_TogLedMod "" UWORD DFCDSQ_Verb 1 100 0.00 65535.0000000 FORMAT "%13.7" ECU_ADDRESS 0x6002260E /end MEASUREMENT
/begin MEASUREMENT DINH_xWhy.FId_bInh_Com_TogLedNeut "" UWORD DFCDSQ_Verb 1 100 0.00 65535.0000000 FORMAT "%13.7" ECU_ADDRESS 0x60022610 /end MEASUREMENT
/begin MEASUREMENT DINH_xWhy.FId_bInh_Com_TogLedRvs "" UWORD DFCDSQ_Verb 1 100 0.00 65535.0000000 FORMAT "%13.7" ECU_ADDRESS 0x60022612 /end MEASUREMENT
/begin MEASUREMENT DINH_xWhy.FId_bInh_Com_bAcLedReq "" UWORD DFCDSQ_Verb 1 100 0.00 65535.0000000 FORMAT "%13.7" ECU_ADDRESS 0x60022614 /end MEASUREMENT
/begin MEASUREMENT DINH_xWhy.FId_bInh_Com_bDiagMuxCAN "" UWORD DFCDSQ_Verb 1 100 0.00 65535.0000000 FORMAT "%13.7" ECU_ADDRESS 0x60022616 /end MEASUREMENT
/begin MEASUREMENT DINH_xWhy.FId_bInh_Com_bGunCntInfoWkuReq "" UWORD DFCDSQ_Verb 1 100 0.00 65535.0000000 FORMAT "%13.7" ECU_ADDRESS 0x60022618 /end MEASUREMENT
/begin MEASUREMENT DINH_xWhy.FId_bInh_Com_bHvBattRchrgWkuReq "" UWORD DFCDSQ_Verb 1 100 0.00 65535.0000000 FORMAT "%13.7" ECU_ADDRESS 0x6002261A /end MEASUREMENT
/begin MEASUREMENT DINH_xWhy.FId_bInh_Com_bPostOperationWkuReq "" UWORD DFCDSQ_Verb 1 100 0.00 65535.0000000 FORMAT "%13.7" ECU_ADDRESS 0x6002261C /end MEASUREMENT
/begin MEASUREMENT DINH_xWhy.FId_bInh_Com_bReFogRlySt "" UWORD DFCDSQ_Verb 1 100 0.00 65535.0000000 FORMAT "%13.7" ECU_ADDRESS 0x6002261E /end MEASUREMENT
/begin MEASUREMENT DINH_xWhy.FId_bInh_Com_flgBlowrAuthn "" UWORD DFCDSQ_Verb 1 100 0.00 65535.0000000 FORMAT "%13.7" ECU_ADDRESS 0x60022620 /end MEASUREMENT
/begin MEASUREMENT DINH_xWhy.FId_bInh_Com_flgBlowrRlyCtrl "" UWORD DFCDSQ_Verb 1 100 0.00 65535.0000000 FORMAT "%13.7" ECU_ADDRESS 0x60022622 /end MEASUREMENT
/begin MEASUREMENT DINH_xWhy.FId_bInh_Com_flgBrkAlrt "" UWORD DFCDSQ_Verb 1 100 0.00 65535.0000000 FORMAT "%13.7" ECU_ADDRESS 0x60022624 /end MEASUREMENT
/begin MEASUREMENT DINH_xWhy.FId_bInh_Com_flgDrvAwy "" UWORD DFCDSQ_Verb 1 100 0.00 65535.0000000 FORMAT "%13.7" ECU_ADDRESS 0x60022626 /end MEASUREMENT
/begin MEASUREMENT DINH_xWhy.FId_bInh_Com_flgVehSpdQly "" UWORD DFCDSQ_Verb 1 100 0.00 65535.0000000 FORMAT "%13.7" ECU_ADDRESS 0x60022628 /end MEASUREMENT
/begin MEASUREMENT DINH_xWhy.FId_bInh_Com_iDcdcHvActRvsn1_Sq_Frz "" UWORD DFCDSQ_Verb 1 100 0.00 65535.0000000 FORMAT "%13.7" ECU_ADDRESS 0x6002262A /end MEASUREMENT
/begin MEASUREMENT DINH_xWhy.FId_bInh_Com_iDcdcLvActRvsn1_Sq_Frz "" UWORD DFCDSQ_Verb 1 100 0.00 65535.0000000 FORMAT "%13.7" ECU_ADDRESS 0x6002262C /end MEASUREMENT
/begin MEASUREMENT DINH_xWhy.FId_bInh_Com_iElCmprHvAct_Sq_Frz "" UWORD DFCDSQ_Verb 1 100 0.00 65535.0000000 FORMAT "%13.7" ECU_ADDRESS 0x6002262E /end MEASUREMENT
/begin MEASUREMENT DINH_xWhy.FId_bInh_Com_iHvbActTx "" UWORD DFCDSQ_Verb 1 100 0.00 65535.0000000 FORMAT "%13.7" ECU_ADDRESS 0x60022630 /end MEASUREMENT
/begin MEASUREMENT DINH_xWhy.FId_bInh_Com_nElCmprActlTx "" UWORD DFCDSQ_Verb 1 100 0.00 65535.0000000 FORMAT "%13.7" ECU_ADDRESS 0x60022632 /end MEASUREMENT
/begin MEASUREMENT DINH_xWhy.FId_bInh_Com_nIvtrMotAct01 "" UWORD DFCDSQ_Verb 1 100 0.00 65535.0000000 FORMAT "%13.7" ECU_ADDRESS 0x60022634 /end MEASUREMENT
/begin MEASUREMENT DINH_xWhy.FId_bInh_Com_noEditCal "" UWORD DFCDSQ_Verb 1 100 0.00 65535.0000000 FORMAT "%13.7" ECU_ADDRESS 0x60022636 /end MEASUREMENT
/begin MEASUREMENT DINH_xWhy.FId_bInh_Com_noEditSw "" UWORD DFCDSQ_Verb 1 100 0.00 65535.0000000 FORMAT "%13.7" ECU_ADDRESS 0x60022638 /end MEASUREMENT
/begin MEASUREMENT DINH_xWhy.FId_bInh_Com_noVerSysDay "" UWORD DFCDSQ_Verb 1 100 0.00 65535.0000000 FORMAT "%13.7" ECU_ADDRESS 0x6002263A /end MEASUREMENT
/begin MEASUREMENT DINH_xWhy.FId_bInh_Com_noVersAdp "" UWORD DFCDSQ_Verb 1 100 0.00 65535.0000000 FORMAT "%13.7" ECU_ADDRESS 0x6002263C /end MEASUREMENT
/begin MEASUREMENT DINH_xWhy.FId_bInh_Com_noVersSw "" UWORD DFCDSQ_Verb 1 100 0.00 65535.0000000 FORMAT "%13.7" ECU_ADDRESS 0x6002263E /end MEASUREMENT
/begin MEASUREMENT DINH_xWhy.FId_bInh_Com_noVersSys "" UWORD DFCDSQ_Verb 1 100 0.00 65535.0000000 FORMAT "%13.7" ECU_ADDRESS 0x60022640 /end MEASUREMENT
/begin MEASUREMENT DINH_xWhy.FId_bInh_Com_noVersSysMnth "" UWORD DFCDSQ_Verb 1 100 0.00 65535.0000000 FORMAT "%13.7" ECU_ADDRESS 0x60022642 /end MEASUREMENT
/begin MEASUREMENT DINH_xWhy.FId_bInh_Com_noVersSysYr "" UWORD DFCDSQ_Verb 1 100 0.00 65535.0000000 FORMAT "%13.7" ECU_ADDRESS 0x60022644 /end MEASUREMENT
/begin MEASUREMENT DINH_xWhy.FId_bInh_Com_ratHvbSoh_Sq_Frz "" UWORD DFCDSQ_Verb 1 100 0.00 65535.0000000 FORMAT "%13.7" ECU_ADDRESS 0x60022646 /end MEASUREMENT
/begin MEASUREMENT DINH_xWhy.FId_bInh_Com_stACTx "" UWORD DFCDSQ_Verb 1 100 0.00 65535.0000000 FORMAT "%13.7" ECU_ADDRESS 0x60022648 /end MEASUREMENT
/begin MEASUREMENT DINH_xWhy.FId_bInh_Com_stBrk "" UWORD DFCDSQ_Verb 1 100 0.00 65535.0000000 FORMAT "%13.7" ECU_ADDRESS 0x6002264A /end MEASUREMENT
/begin MEASUREMENT DINH_xWhy.FId_bInh_Com_stBrkBstPFlt "" UWORD DFCDSQ_Verb 1 100 0.00 65535.0000000 FORMAT "%13.7" ECU_ADDRESS 0x6002264C /end MEASUREMENT
/begin MEASUREMENT DINH_xWhy.FId_bInh_Com_stBrkCntctIndcn "" UWORD DFCDSQ_Verb 1 100 0.00 65535.0000000 FORMAT "%13.7" ECU_ADDRESS 0x6002264E /end MEASUREMENT
/begin MEASUREMENT DINH_xWhy.FId_bInh_Com_stChrgPlg "" UWORD DFCDSQ_Verb 1 100 0.00 65535.0000000 FORMAT "%13.7" ECU_ADDRESS 0x60022650 /end MEASUREMENT
/begin MEASUREMENT DINH_xWhy.FId_bInh_Com_stChrgPlgChrgn "" UWORD DFCDSQ_Verb 1 100 0.00 65535.0000000 FORMAT "%13.7" ECU_ADDRESS 0x60022652 /end MEASUREMENT
/begin MEASUREMENT DINH_xWhy.FId_bInh_Com_stClstrStopIndcn "" UWORD DFCDSQ_Verb 1 100 0.00 65535.0000000 FORMAT "%13.7" ECU_ADDRESS 0x60022654 /end MEASUREMENT
/begin MEASUREMENT DINH_xWhy.FId_bInh_Com_stCmdHvBattCntctr "" UWORD DFCDSQ_Verb 1 100 0.00 65535.0000000 FORMAT "%13.7" ECU_ADDRESS 0x60022656 /end MEASUREMENT
/begin MEASUREMENT DINH_xWhy.FId_bInh_Com_stCmdOffsEM01 "" UWORD DFCDSQ_Verb 1 100 0.00 65535.0000000 FORMAT "%13.7" ECU_ADDRESS 0x60022658 /end MEASUREMENT
/begin MEASUREMENT DINH_xWhy.FId_bInh_Com_stDcdcOperModAct_Sq_Frz "" UWORD DFCDSQ_Verb 1 100 0.00 65535.0000000 FORMAT "%13.7" ECU_ADDRESS 0x6002265A /end MEASUREMENT
/begin MEASUREMENT DINH_xWhy.FId_bInh_Com_stDrvAwyDi "" UWORD DFCDSQ_Verb 1 100 0.00 65535.0000000 FORMAT "%13.7" ECU_ADDRESS 0x6002265C /end MEASUREMENT
/begin MEASUREMENT DINH_xWhy.FId_bInh_Com_stDrvModPosn "" UWORD DFCDSQ_Verb 1 100 0.00 65535.0000000 FORMAT "%13.7" ECU_ADDRESS 0x6002265E /end MEASUREMENT
/begin MEASUREMENT DINH_xWhy.FId_bInh_Com_stEVLmp "" UWORD DFCDSQ_Verb 1 100 0.00 65535.0000000 FORMAT "%13.7" ECU_ADDRESS 0x60022660 /end MEASUREMENT
/begin MEASUREMENT DINH_xWhy.FId_bInh_Com_stElCmprStatTx "" UWORD DFCDSQ_Verb 1 100 0.00 65535.0000000 FORMAT "%13.7" ECU_ADDRESS 0x60022662 /end MEASUREMENT
/begin MEASUREMENT DINH_xWhy.FId_bInh_Com_stElMDesEem "" UWORD DFCDSQ_Verb 1 100 0.00 65535.0000000 FORMAT "%13.7" ECU_ADDRESS 0x60022664 /end MEASUREMENT
/begin MEASUREMENT DINH_xWhy.FId_bInh_Com_stHvBattOperModDes "" UWORD DFCDSQ_Verb 1 100 0.00 65535.0000000 FORMAT "%13.7" ECU_ADDRESS 0x60022666 /end MEASUREMENT
/begin MEASUREMENT DINH_xWhy.FId_bInh_Com_stHvacBlwrFront_CAN "" UWORD DFCDSQ_Verb 1 100 0.00 65535.0000000 FORMAT "%13.7" ECU_ADDRESS 0x60022668 /end MEASUREMENT
/begin MEASUREMENT DINH_xWhy.FId_bInh_Com_stHvacKnobPosn_CAN "" UWORD DFCDSQ_Verb 1 100 0.00 65535.0000000 FORMAT "%13.7" ECU_ADDRESS 0x6002266A /end MEASUREMENT
/begin MEASUREMENT DINH_xWhy.FId_bInh_Com_stMstWrnLmp "" UWORD DFCDSQ_Verb 1 100 0.00 65535.0000000 FORMAT "%13.7" ECU_ADDRESS 0x6002266C /end MEASUREMENT
/begin MEASUREMENT DINH_xWhy.FId_bInh_Com_stNwCmdLIN "" UWORD DFCDSQ_Verb 1 100 0.00 65535.0000000 FORMAT "%13.7" ECU_ADDRESS 0x6002266E /end MEASUREMENT
/begin MEASUREMENT DINH_xWhy.FId_bInh_Com_stPwrLimnLmp "" UWORD DFCDSQ_Verb 1 100 0.00 65535.0000000 FORMAT "%13.7" ECU_ADDRESS 0x60022670 /end MEASUREMENT
/begin MEASUREMENT DINH_xWhy.FId_bInh_Com_stReFogReq_CAN "" UWORD DFCDSQ_Verb 1 100 0.00 65535.0000000 FORMAT "%13.7" ECU_ADDRESS 0x60022672 /end MEASUREMENT
/begin MEASUREMENT DINH_xWhy.FId_bInh_Com_stSrvLmp "" UWORD DFCDSQ_Verb 1 100 0.00 65535.0000000 FORMAT "%13.7" ECU_ADDRESS 0x60022674 /end MEASUREMENT
/begin MEASUREMENT DINH_xWhy.FId_bInh_Com_stVehCoorn "" UWORD DFCDSQ_Verb 1 100 0.00 65535.0000000 FORMAT "%13.7" ECU_ADDRESS 0x60022676 /end MEASUREMENT
/begin MEASUREMENT DINH_xWhy.FId_bInh_Com_tDcdcAct_Sq_Frz "" UWORD DFCDSQ_Verb 1 100 0.00 65535.0000000 FORMAT "%13.7" ECU_ADDRESS 0x60022678 /end MEASUREMENT
/begin MEASUREMENT DINH_xWhy.FId_bInh_Com_tDcdcInltCoolt_Sq "" UWORD DFCDSQ_Verb 1 100 0.00 65535.0000000 FORMAT "%13.7" ECU_ADDRESS 0x6002267A /end MEASUREMENT
/begin MEASUREMENT DINH_xWhy.FId_bInh_Com_tqMotLimMax "" UWORD DFCDSQ_Verb 1 100 0.00 65535.0000000 FORMAT "%13.7" ECU_ADDRESS 0x6002267C /end MEASUREMENT
/begin MEASUREMENT DINH_xWhy.FId_bInh_Com_uDcdcHvAct_Sq_Frz "" UWORD DFCDSQ_Verb 1 100 0.00 65535.0000000 FORMAT "%13.7" ECU_ADDRESS 0x6002267E /end MEASUREMENT
/begin MEASUREMENT DINH_xWhy.FId_bInh_Com_uDcdcLvAct_Sq_Frz "" UWORD DFCDSQ_Verb 1 100 0.00 65535.0000000 FORMAT "%13.7" ECU_ADDRESS 0x60022680 /end MEASUREMENT
/begin MEASUREMENT DINH_xWhy.FId_bInh_Com_uHvbActTx "" UWORD DFCDSQ_Verb 1 100 0.00 65535.0000000 FORMAT "%13.7" ECU_ADDRESS 0x60022682 /end MEASUREMENT
/begin MEASUREMENT DINH_xWhy.FId_bInh_Com_valEepOffsEM01 "" UWORD DFCDSQ_Verb 1 100 0.00 65535.0000000 FORMAT "%13.7" ECU_ADDRESS 0x60022684 /end MEASUREMENT
/begin MEASUREMENT DINH_xWhy.FId_bInh_DcChrgnRly_ctMaxOperCyc "" UWORD DFCDSQ_Verb 1 100 0.00 65535.0000000 FORMAT "%13.7" ECU_ADDRESS 0x60022686 /end MEASUREMENT
/begin MEASUREMENT DINH_xWhy.FId_bInh_Dcdc_flgDesLvGridULim "" UWORD DFCDSQ_Verb 1 100 0.00 65535.0000000 FORMAT "%13.7" ECU_ADDRESS 0x60022688 /end MEASUREMENT
/begin MEASUREMENT DINH_xWhy.FId_bInh_Dcdc_iLimLvGrid "" UWORD DFCDSQ_Verb 1 100 0.00 65535.0000000 FORMAT "%13.7" ECU_ADDRESS 0x6002268A /end MEASUREMENT
/begin MEASUREMENT DINH_xWhy.FId_bInh_Dcdc_stDesDcdc "" UWORD DFCDSQ_Verb 1 100 0.00 65535.0000000 FORMAT "%13.7" ECU_ADDRESS 0x6002268C /end MEASUREMENT
/begin MEASUREMENT DINH_xWhy.FId_bInh_Dcdc_uDesLvGrid "" UWORD DFCDSQ_Verb 1 100 0.00 65535.0000000 FORMAT "%13.7" ECU_ADDRESS 0x6002268E /end MEASUREMENT
/begin MEASUREMENT DINH_xWhy.FId_bInh_DrvInfo_wTotTripEgy "" UWORD DFCDSQ_Verb 1 100 0.00 65535.0000000 FORMAT "%13.7" ECU_ADDRESS 0x60022690 /end MEASUREMENT
/begin MEASUREMENT DINH_xWhy.FId_bInh_EChrDv_cntPlin "" UWORD DFCDSQ_Verb 1 100 0.00 65535.0000000 FORMAT "%13.7" ECU_ADDRESS 0x60022692 /end MEASUREMENT
/begin MEASUREMENT DINH_xWhy.FId_bInh_Eem_flgFstHvShdwn "" UWORD DFCDSQ_Verb 1 100 0.00 65535.0000000 FORMAT "%13.7" ECU_ADDRESS 0x60022694 /end MEASUREMENT
/begin MEASUREMENT DINH_xWhy.FId_bInh_ElM_stDesEem01 "" UWORD DFCDSQ_Verb 1 100 0.00 65535.0000000 FORMAT "%13.7" ECU_ADDRESS 0x60022696 /end MEASUREMENT
/begin MEASUREMENT DINH_xWhy.FId_bInh_ElTS_egyTotChrgCyc "" UWORD DFCDSQ_Verb 1 100 0.00 65535.0000000 FORMAT "%13.7" ECU_ADDRESS 0x60022698 /end MEASUREMENT
/begin MEASUREMENT DINH_xWhy.FId_bInh_ElTS_ratEmPowChrgn "" UWORD DFCDSQ_Verb 1 100 0.00 65535.0000000 FORMAT "%13.7" ECU_ADDRESS 0x6002269A /end MEASUREMENT
/begin MEASUREMENT DINH_xWhy.FId_bInh_ElTS_ratEmPowDcha "" UWORD DFCDSQ_Verb 1 100 0.00 65535.0000000 FORMAT "%13.7" ECU_ADDRESS 0x6002269C /end MEASUREMENT
/begin MEASUREMENT DINH_xWhy.FId_bInh_ElTS_stChrgCyc "" UWORD DFCDSQ_Verb 1 100 0.00 65535.0000000 FORMAT "%13.7" ECU_ADDRESS 0x6002269E /end MEASUREMENT
/begin MEASUREMENT DINH_xWhy.FId_bInh_Emac_stIsoMonSwtReq "" UWORD DFCDSQ_Verb 1 100 0.00 65535.0000000 FORMAT "%13.7" ECU_ADDRESS 0x600226A0 /end MEASUREMENT
/begin MEASUREMENT DINH_xWhy.FId_bInh_Emac_tqDesCom01 "" UWORD DFCDSQ_Verb 1 100 0.00 65535.0000000 FORMAT "%13.7" ECU_ADDRESS 0x600226A2 /end MEASUREMENT
/begin MEASUREMENT DINH_xWhy.FId_bInh_Ext_bSyncGPC "" UWORD DFCDSQ_Verb 1 100 0.00 65535.0000000 FORMAT "%13.7" ECU_ADDRESS 0x600226A4 /end MEASUREMENT
/begin MEASUREMENT DINH_xWhy.FId_bInh_HvBatt_flgIsoMeasmtDiReq "" UWORD DFCDSQ_Verb 1 100 0.00 65535.0000000 FORMAT "%13.7" ECU_ADDRESS 0x600226A6 /end MEASUREMENT
/begin MEASUREMENT DINH_xWhy.FId_bInh_HvBatt_ratSoc "" UWORD DFCDSQ_Verb 1 100 0.00 65535.0000000 FORMAT "%13.7" ECU_ADDRESS 0x600226A8 /end MEASUREMENT
/begin MEASUREMENT DINH_xWhy.FId_bInh_HvGrid_pwrMaxDcdc "" UWORD DFCDSQ_Verb 1 100 0.00 65535.0000000 FORMAT "%13.7" ECU_ADDRESS 0x600226AA /end MEASUREMENT
/begin MEASUREMENT DINH_xWhy.FId_bInh_HvacPtc_stElHeatr "" UWORD DFCDSQ_Verb 1 100 0.00 65535.0000000 FORMAT "%13.7" ECU_ADDRESS 0x600226AC /end MEASUREMENT
/begin MEASUREMENT DINH_xWhy.FId_bInh_Pdu_CLUSTER_5E7_Frz "" UWORD DFCDSQ_Verb 1 100 0.00 65535.0000000 FORMAT "%13.7" ECU_ADDRESS 0x600226AE /end MEASUREMENT
/begin MEASUREMENT DINH_xWhy.FId_bInh_Pdu_CLUSTER_5E7_Rcf "" UWORD DFCDSQ_Verb 1 100 0.00 65535.0000000 FORMAT "%13.7" ECU_ADDRESS 0x600226B0 /end MEASUREMENT
/begin MEASUREMENT DINH_xWhy.FId_bInh_Pdu_CONTEXTE_1_5B2_Frz "" UWORD DFCDSQ_Verb 1 100 0.00 65535.0000000 FORMAT "%13.7" ECU_ADDRESS 0x600226B2 /end MEASUREMENT
/begin MEASUREMENT DINH_xWhy.FId_bInh_Pdu_CONTEXTE_1_5B2_Rcf "" UWORD DFCDSQ_Verb 1 100 0.00 65535.0000000 FORMAT "%13.7" ECU_ADDRESS 0x600226B4 /end MEASUREMENT
/begin MEASUREMENT DINH_xWhy.FId_bInh_Pdu_Com_pwrMaxChrgSho_Sq_Frz "" UWORD DFCDSQ_Verb 1 100 0.00 65535.0000000 FORMAT "%13.7" ECU_ADDRESS 0x600226B6 /end MEASUREMENT
/begin MEASUREMENT DINH_xWhy.FId_bInh_Pdu_Com_pwrMaxDchaSho_Sq_Frz "" UWORD DFCDSQ_Verb 1 100 0.00 65535.0000000 FORMAT "%13.7" ECU_ADDRESS 0x600226B8 /end MEASUREMENT
/begin MEASUREMENT DINH_xWhy.FId_bInh_Pdu_DAT3_BSI_4F2h_Frz "" UWORD DFCDSQ_Verb 1 100 0.00 65535.0000000 FORMAT "%13.7" ECU_ADDRESS 0x600226BA /end MEASUREMENT
/begin MEASUREMENT DINH_xWhy.FId_bInh_Pdu_DAT3_BSI_4F2h_Rcf "" UWORD DFCDSQ_Verb 1 100 0.00 65535.0000000 FORMAT "%13.7" ECU_ADDRESS 0x600226BC /end MEASUREMENT
/begin MEASUREMENT DINH_xWhy.FId_bInh_Pdu_DCDC_283h_Frz "" UWORD DFCDSQ_Verb 1 100 0.00 65535.0000000 FORMAT "%13.7" ECU_ADDRESS 0x600226BE /end MEASUREMENT
/begin MEASUREMENT DINH_xWhy.FId_bInh_Pdu_DCDC_283h_Rcf "" UWORD DFCDSQ_Verb 1 100 0.00 65535.0000000 FORMAT "%13.7" ECU_ADDRESS 0x600226C0 /end MEASUREMENT
/begin MEASUREMENT DINH_xWhy.FId_bInh_Pdu_DCDC_293h_Frz "" UWORD DFCDSQ_Verb 1 100 0.00 65535.0000000 FORMAT "%13.7" ECU_ADDRESS 0x600226C2 /end MEASUREMENT
/begin MEASUREMENT DINH_xWhy.FId_bInh_Pdu_DCDC_293h_Rcf "" UWORD DFCDSQ_Verb 1 100 0.00 65535.0000000 FORMAT "%13.7" ECU_ADDRESS 0x600226C4 /end MEASUREMENT
/begin MEASUREMENT DINH_xWhy.FId_bInh_Pdu_DCDC_473h_Frz "" UWORD DFCDSQ_Verb 1 100 0.00 65535.0000000 FORMAT "%13.7" ECU_ADDRESS 0x600226C6 /end MEASUREMENT
/begin MEASUREMENT DINH_xWhy.FId_bInh_Pdu_DCDC_473h_Rcf "" UWORD DFCDSQ_Verb 1 100 0.00 65535.0000000 FORMAT "%13.7" ECU_ADDRESS 0x600226C8 /end MEASUREMENT
/begin MEASUREMENT DINH_xWhy.FId_bInh_Pdu_DCDC_663h_Frz "" UWORD DFCDSQ_Verb 1 100 0.00 65535.0000000 FORMAT "%13.7" ECU_ADDRESS 0x600226CA /end MEASUREMENT
/begin MEASUREMENT DINH_xWhy.FId_bInh_Pdu_DCDC_663h_Rcf "" UWORD DFCDSQ_Verb 1 100 0.00 65535.0000000 FORMAT "%13.7" ECU_ADDRESS 0x600226CC /end MEASUREMENT
/begin MEASUREMENT DINH_xWhy.FId_bInh_Pdu_HS3_AUTO_GEARBOX_SWITCH_STATUS_Frz "" UWORD DFCDSQ_Verb 1 100 0.00 65535.0000000 FORMAT "%13.7" ECU_ADDRESS 0x600226CE /end MEASUREMENT
/begin MEASUREMENT DINH_xWhy.FId_bInh_Pdu_HS3_AUTO_GEARBOX_SWITCH_STATUS_Rcf "" UWORD DFCDSQ_Verb 1 100 0.00 65535.0000000 FORMAT "%13.7" ECU_ADDRESS 0x600226D0 /end MEASUREMENT
/begin MEASUREMENT DINH_xWhy.FId_bInh_Pdu_HVAC_PANEL_26h_Frz "" UWORD DFCDSQ_Verb 1 100 0.00 65535.0000000 FORMAT "%13.7" ECU_ADDRESS 0x600226D2 /end MEASUREMENT
/begin MEASUREMENT DINH_xWhy.FId_bInh_Pdu_HVAC_PANEL_26h_Rcf "" UWORD DFCDSQ_Verb 1 100 0.00 65535.0000000 FORMAT "%13.7" ECU_ADDRESS 0x600226D4 /end MEASUREMENT
/begin MEASUREMENT DINH_xWhy.FId_bInh_Pdu_HVBAT_205h_Frz "" UWORD DFCDSQ_Verb 1 100 0.00 65535.0000000 FORMAT "%13.7" ECU_ADDRESS 0x600226D6 /end MEASUREMENT
/begin MEASUREMENT DINH_xWhy.FId_bInh_Pdu_HVBAT_205h_Rcf "" UWORD DFCDSQ_Verb 1 100 0.00 65535.0000000 FORMAT "%13.7" ECU_ADDRESS 0x600226D8 /end MEASUREMENT
/begin MEASUREMENT DINH_xWhy.FId_bInh_Pdu_HVBAT_275h_Frz "" UWORD DFCDSQ_Verb 1 100 0.00 65535.0000000 FORMAT "%13.7" ECU_ADDRESS 0x600226DA /end MEASUREMENT
/begin MEASUREMENT DINH_xWhy.FId_bInh_Pdu_HVBAT_275h_Rcf "" UWORD DFCDSQ_Verb 1 100 0.00 65535.0000000 FORMAT "%13.7" ECU_ADDRESS 0x600226DC /end MEASUREMENT
/begin MEASUREMENT DINH_xWhy.FId_bInh_Pdu_HVBAT_285h_Frz "" UWORD DFCDSQ_Verb 1 100 0.00 65535.0000000 FORMAT "%13.7" ECU_ADDRESS 0x600226DE /end MEASUREMENT
/begin MEASUREMENT DINH_xWhy.FId_bInh_Pdu_HVBAT_285h_Rcf "" UWORD DFCDSQ_Verb 1 100 0.00 65535.0000000 FORMAT "%13.7" ECU_ADDRESS 0x600226E0 /end MEASUREMENT
/begin MEASUREMENT DINH_xWhy.FId_bInh_Pdu_HVBAT_325h_Frz "" UWORD DFCDSQ_Verb 1 100 0.00 65535.0000000 FORMAT "%13.7" ECU_ADDRESS 0x600226E2 /end MEASUREMENT
/begin MEASUREMENT DINH_xWhy.FId_bInh_Pdu_HVBAT_325h_Rcf "" UWORD DFCDSQ_Verb 1 100 0.00 65535.0000000 FORMAT "%13.7" ECU_ADDRESS 0x600226E4 /end MEASUREMENT
/begin MEASUREMENT DINH_xWhy.FId_bInh_Pdu_HVBAT_335h_Frz "" UWORD DFCDSQ_Verb 1 100 0.00 65535.0000000 FORMAT "%13.7" ECU_ADDRESS 0x600226E6 /end MEASUREMENT
/begin MEASUREMENT DINH_xWhy.FId_bInh_Pdu_HVBAT_335h_Rcf "" UWORD DFCDSQ_Verb 1 100 0.00 65535.0000000 FORMAT "%13.7" ECU_ADDRESS 0x600226E8 /end MEASUREMENT
/begin MEASUREMENT DINH_xWhy.FId_bInh_Pdu_HVBAT_455h_Frz "" UWORD DFCDSQ_Verb 1 100 0.00 65535.0000000 FORMAT "%13.7" ECU_ADDRESS 0x600226EA /end MEASUREMENT
/begin MEASUREMENT DINH_xWhy.FId_bInh_Pdu_HVBAT_455h_Rcf "" UWORD DFCDSQ_Verb 1 100 0.00 65535.0000000 FORMAT "%13.7" ECU_ADDRESS 0x600226EC /end MEASUREMENT
/begin MEASUREMENT DINH_xWhy.FId_bInh_Pdu_HVBAT_535_Frz "" UWORD DFCDSQ_Verb 1 100 0.00 65535.0000000 FORMAT "%13.7" ECU_ADDRESS 0x600226EE /end MEASUREMENT
/begin MEASUREMENT DINH_xWhy.FId_bInh_Pdu_HVBAT_535_Rcf "" UWORD DFCDSQ_Verb 1 100 0.00 65535.0000000 FORMAT "%13.7" ECU_ADDRESS 0x600226F0 /end MEASUREMENT
/begin MEASUREMENT DINH_xWhy.FId_bInh_Pdu_HVBAT_595h_Frz "" UWORD DFCDSQ_Verb 1 100 0.00 65535.0000000 FORMAT "%13.7" ECU_ADDRESS 0x600226F2 /end MEASUREMENT
/begin MEASUREMENT DINH_xWhy.FId_bInh_Pdu_HVBAT_595h_Rcf "" UWORD DFCDSQ_Verb 1 100 0.00 65535.0000000 FORMAT "%13.7" ECU_ADDRESS 0x600226F4 /end MEASUREMENT
/begin MEASUREMENT DINH_xWhy.FId_bInh_Pdu_HVBAT_635h_Frz "" UWORD DFCDSQ_Verb 1 100 0.00 65535.0000000 FORMAT "%13.7" ECU_ADDRESS 0x600226F6 /end MEASUREMENT
/begin MEASUREMENT DINH_xWhy.FId_bInh_Pdu_HVBAT_635h_Rcf "" UWORD DFCDSQ_Verb 1 100 0.00 65535.0000000 FORMAT "%13.7" ECU_ADDRESS 0x600226F8 /end MEASUREMENT
/begin MEASUREMENT DINH_xWhy.FId_bInh_Pdu_HVBAT_645h_Frz "" UWORD DFCDSQ_Verb 1 100 0.00 65535.0000000 FORMAT "%13.7" ECU_ADDRESS 0x600226FA /end MEASUREMENT
/begin MEASUREMENT DINH_xWhy.FId_bInh_Pdu_HVBAT_645h_Rcf "" UWORD DFCDSQ_Verb 1 100 0.00 65535.0000000 FORMAT "%13.7" ECU_ADDRESS 0x600226FC /end MEASUREMENT
/begin MEASUREMENT DINH_xWhy.FId_bInh_Pdu_HVBAT_665h_Frz "" UWORD DFCDSQ_Verb 1 100 0.00 65535.0000000 FORMAT "%13.7" ECU_ADDRESS 0x600226FE /end MEASUREMENT
/begin MEASUREMENT DINH_xWhy.FId_bInh_Pdu_HVBAT_665h_Rcf "" UWORD DFCDSQ_Verb 1 100 0.00 65535.0000000 FORMAT "%13.7" ECU_ADDRESS 0x60022700 /end MEASUREMENT
/begin MEASUREMENT DINH_xWhy.FId_bInh_Pdu_HVBAT_675h_Frz "" UWORD DFCDSQ_Verb 1 100 0.00 65535.0000000 FORMAT "%13.7" ECU_ADDRESS 0x60022702 /end MEASUREMENT
/begin MEASUREMENT DINH_xWhy.FId_bInh_Pdu_HVBAT_675h_Rcf "" UWORD DFCDSQ_Verb 1 100 0.00 65535.0000000 FORMAT "%13.7" ECU_ADDRESS 0x60022704 /end MEASUREMENT
/begin MEASUREMENT DINH_xWhy.FId_bInh_Pdu_HVBAT_THERMAL_5B5_Frz "" UWORD DFCDSQ_Verb 1 100 0.00 65535.0000000 FORMAT "%13.7" ECU_ADDRESS 0x60022706 /end MEASUREMENT
/begin MEASUREMENT DINH_xWhy.FId_bInh_Pdu_HVBAT_THERMAL_5B5_Rcf "" UWORD DFCDSQ_Verb 1 100 0.00 65535.0000000 FORMAT "%13.7" ECU_ADDRESS 0x60022708 /end MEASUREMENT
/begin MEASUREMENT DINH_xWhy.FId_bInh_Pdu_HVBAT_VCU_435h_Frz "" UWORD DFCDSQ_Verb 1 100 0.00 65535.0000000 FORMAT "%13.7" ECU_ADDRESS 0x6002270A /end MEASUREMENT
/begin MEASUREMENT DINH_xWhy.FId_bInh_Pdu_HVBAT_VCU_435h_Rcf "" UWORD DFCDSQ_Verb 1 100 0.00 65535.0000000 FORMAT "%13.7" ECU_ADDRESS 0x6002270C /end MEASUREMENT
/begin MEASUREMENT DINH_xWhy.FId_bInh_Pdu_HVBAT_VCU_543_Frz "" UWORD DFCDSQ_Verb 1 100 0.00 65535.0000000 FORMAT "%13.7" ECU_ADDRESS 0x6002270E /end MEASUREMENT
/begin MEASUREMENT DINH_xWhy.FId_bInh_Pdu_HVBAT_VCU_543_Rcf "" UWORD DFCDSQ_Verb 1 100 0.00 65535.0000000 FORMAT "%13.7" ECU_ADDRESS 0x60022710 /end MEASUREMENT
/begin MEASUREMENT DINH_xWhy.FId_bInh_Pdu_HVBAT_VCU_583_Frz "" UWORD DFCDSQ_Verb 1 100 0.00 65535.0000000 FORMAT "%13.7" ECU_ADDRESS 0x60022712 /end MEASUREMENT
/begin MEASUREMENT DINH_xWhy.FId_bInh_Pdu_HVBAT_VCU_583_Rcf "" UWORD DFCDSQ_Verb 1 100 0.00 65535.0000000 FORMAT "%13.7" ECU_ADDRESS 0x60022714 /end MEASUREMENT
/begin MEASUREMENT DINH_xWhy.FId_bInh_Pdu_INV_217h_Frz "" UWORD DFCDSQ_Verb 1 100 0.00 65535.0000000 FORMAT "%13.7" ECU_ADDRESS 0x60022716 /end MEASUREMENT
/begin MEASUREMENT DINH_xWhy.FId_bInh_Pdu_INV_217h_Rcf "" UWORD DFCDSQ_Verb 1 100 0.00 65535.0000000 FORMAT "%13.7" ECU_ADDRESS 0x60022718 /end MEASUREMENT
/begin MEASUREMENT DINH_xWhy.FId_bInh_Pdu_INV_227h_Frz "" UWORD DFCDSQ_Verb 1 100 0.00 65535.0000000 FORMAT "%13.7" ECU_ADDRESS 0x6002271A /end MEASUREMENT
/begin MEASUREMENT DINH_xWhy.FId_bInh_Pdu_INV_227h_Rcf "" UWORD DFCDSQ_Verb 1 100 0.00 65535.0000000 FORMAT "%13.7" ECU_ADDRESS 0x6002271C /end MEASUREMENT
/begin MEASUREMENT DINH_xWhy.FId_bInh_Pdu_INV_237_Frz "" UWORD DFCDSQ_Verb 1 100 0.00 65535.0000000 FORMAT "%13.7" ECU_ADDRESS 0x6002271E /end MEASUREMENT
/begin MEASUREMENT DINH_xWhy.FId_bInh_Pdu_INV_237_Rcf "" UWORD DFCDSQ_Verb 1 100 0.00 65535.0000000 FORMAT "%13.7" ECU_ADDRESS 0x60022720 /end MEASUREMENT
/begin MEASUREMENT DINH_xWhy.FId_bInh_Pdu_INV_427h_Frz "" UWORD DFCDSQ_Verb 1 100 0.00 65535.0000000 FORMAT "%13.7" ECU_ADDRESS 0x60022722 /end MEASUREMENT
/begin MEASUREMENT DINH_xWhy.FId_bInh_Pdu_INV_427h_Rcf "" UWORD DFCDSQ_Verb 1 100 0.00 65535.0000000 FORMAT "%13.7" ECU_ADDRESS 0x60022724 /end MEASUREMENT
/begin MEASUREMENT DINH_xWhy.FId_bInh_Pdu_INV_497h_Frz "" UWORD DFCDSQ_Verb 1 100 0.00 65535.0000000 FORMAT "%13.7" ECU_ADDRESS 0x60022726 /end MEASUREMENT
/begin MEASUREMENT DINH_xWhy.FId_bInh_Pdu_INV_497h_Rcf "" UWORD DFCDSQ_Verb 1 100 0.00 65535.0000000 FORMAT "%13.7" ECU_ADDRESS 0x60022728 /end MEASUREMENT
/begin MEASUREMENT DINH_xWhy.FId_bInh_Pdu_INV_IMMO_5C7_Frz "" UWORD DFCDSQ_Verb 1 100 0.00 65535.0000000 FORMAT "%13.7" ECU_ADDRESS 0x6002272A /end MEASUREMENT
/begin MEASUREMENT DINH_xWhy.FId_bInh_Pdu_INV_IMMO_5C7_Rcf "" UWORD DFCDSQ_Verb 1 100 0.00 65535.0000000 FORMAT "%13.7" ECU_ADDRESS 0x6002272C /end MEASUREMENT
/begin MEASUREMENT DINH_xWhy.FId_bInh_Pdu_IS_DAT6_BSI_592h_Frz "" UWORD DFCDSQ_Verb 1 100 0.00 65535.0000000 FORMAT "%13.7" ECU_ADDRESS 0x6002272E /end MEASUREMENT
/begin MEASUREMENT DINH_xWhy.FId_bInh_Pdu_IS_DAT6_BSI_592h_Rcf "" UWORD DFCDSQ_Verb 1 100 0.00 65535.0000000 FORMAT "%13.7" ECU_ADDRESS 0x60022730 /end MEASUREMENT
/begin MEASUREMENT DINH_xWhy.FId_bInh_Pdu_IS_DAT_ABR_50Dh_Frz "" UWORD DFCDSQ_Verb 1 100 0.00 65535.0000000 FORMAT "%13.7" ECU_ADDRESS 0x60022732 /end MEASUREMENT
/begin MEASUREMENT DINH_xWhy.FId_bInh_Pdu_IS_DAT_ABR_50Dh_Rcf "" UWORD DFCDSQ_Verb 1 100 0.00 65535.0000000 FORMAT "%13.7" ECU_ADDRESS 0x60022734 /end MEASUREMENT
/begin MEASUREMENT DINH_xWhy.FId_bInh_Pdu_IS_DAT_BSI_412h_Frz "" UWORD DFCDSQ_Verb 1 100 0.00 65535.0000000 FORMAT "%13.7" ECU_ADDRESS 0x60022736 /end MEASUREMENT
/begin MEASUREMENT DINH_xWhy.FId_bInh_Pdu_IS_DAT_BSI_412h_Rcf "" UWORD DFCDSQ_Verb 1 100 0.00 65535.0000000 FORMAT "%13.7" ECU_ADDRESS 0x60022738 /end MEASUREMENT
/begin MEASUREMENT DINH_xWhy.FId_bInh_Pdu_IS_DYN_ABR_38Dh_Frz "" UWORD DFCDSQ_Verb 1 100 0.00 65535.0000000 FORMAT "%13.7" ECU_ADDRESS 0x6002273A /end MEASUREMENT
/begin MEASUREMENT DINH_xWhy.FId_bInh_Pdu_IS_DYN_ABR_38Dh_Rcf "" UWORD DFCDSQ_Verb 1 100 0.00 65535.0000000 FORMAT "%13.7" ECU_ADDRESS 0x6002273C /end MEASUREMENT
/begin MEASUREMENT DINH_xWhy.FId_bInh_Pdu_IS_INTE_ELECTRON_BSI_092h_Frz "" UWORD DFCDSQ_Verb 1 100 0.00 65535.0000000 FORMAT "%13.7" ECU_ADDRESS 0x6002273E /end MEASUREMENT
/begin MEASUREMENT DINH_xWhy.FId_bInh_Pdu_IS_INTE_ELECTRON_BSI_092h_Rcf "" UWORD DFCDSQ_Verb 1 100 0.00 65535.0000000 FORMAT "%13.7" ECU_ADDRESS 0x60022740 /end MEASUREMENT
/begin MEASUREMENT DINH_xWhy.FId_bInh_Pdu_OBC_273h_Frz "" UWORD DFCDSQ_Verb 1 100 0.00 65535.0000000 FORMAT "%13.7" ECU_ADDRESS 0x60022742 /end MEASUREMENT
/begin MEASUREMENT DINH_xWhy.FId_bInh_Pdu_OBC_273h_Rcf "" UWORD DFCDSQ_Verb 1 100 0.00 65535.0000000 FORMAT "%13.7" ECU_ADDRESS 0x60022744 /end MEASUREMENT
/begin MEASUREMENT DINH_xWhy.FId_bInh_Pdu_OBC_453h_Frz "" UWORD DFCDSQ_Verb 1 100 0.00 65535.0000000 FORMAT "%13.7" ECU_ADDRESS 0x60022746 /end MEASUREMENT
/begin MEASUREMENT DINH_xWhy.FId_bInh_Pdu_OBC_453h_Rcf "" UWORD DFCDSQ_Verb 1 100 0.00 65535.0000000 FORMAT "%13.7" ECU_ADDRESS 0x60022748 /end MEASUREMENT
/begin MEASUREMENT DINH_xWhy.FId_bInh_Pdu_OBC_463h_Frz "" UWORD DFCDSQ_Verb 1 100 0.00 65535.0000000 FORMAT "%13.7" ECU_ADDRESS 0x6002274A /end MEASUREMENT
/begin MEASUREMENT DINH_xWhy.FId_bInh_Pdu_OBC_463h_Rcf "" UWORD DFCDSQ_Verb 1 100 0.00 65535.0000000 FORMAT "%13.7" ECU_ADDRESS 0x6002274C /end MEASUREMENT
/begin MEASUREMENT DINH_xWhy.FId_bInh_Pdu_PDU_BusVoltages_308_Frz "" UWORD DFCDSQ_Verb 1 100 0.00 65535.0000000 FORMAT "%13.7" ECU_ADDRESS 0x6002274E /end MEASUREMENT
/begin MEASUREMENT DINH_xWhy.FId_bInh_Pdu_PDU_BusVoltages_308_Rcf "" UWORD DFCDSQ_Verb 1 100 0.00 65535.0000000 FORMAT "%13.7" ECU_ADDRESS 0x60022750 /end MEASUREMENT
/begin MEASUREMENT DINH_xWhy.FId_bInh_Pdu_PDU_Current_318_Frz "" UWORD DFCDSQ_Verb 1 100 0.00 65535.0000000 FORMAT "%13.7" ECU_ADDRESS 0x60022752 /end MEASUREMENT
/begin MEASUREMENT DINH_xWhy.FId_bInh_Pdu_PDU_Current_318_Rcf "" UWORD DFCDSQ_Verb 1 100 0.00 65535.0000000 FORMAT "%13.7" ECU_ADDRESS 0x60022754 /end MEASUREMENT
/begin MEASUREMENT DINH_xWhy.FId_bInh_Pdu_SC_INFO_BCCM_442h_Frz "" UWORD DFCDSQ_Verb 1 100 0.00 65535.0000000 FORMAT "%13.7" ECU_ADDRESS 0x60022756 /end MEASUREMENT
/begin MEASUREMENT DINH_xWhy.FId_bInh_Pdu_SC_INFO_BCCM_442h_Rcf "" UWORD DFCDSQ_Verb 1 100 0.00 65535.0000000 FORMAT "%13.7" ECU_ADDRESS 0x60022758 /end MEASUREMENT
/begin MEASUREMENT DINH_xWhy.FId_bInh_Pdu_VCU_AIRBAG_351h_Frz "" UWORD DFCDSQ_Verb 1 100 0.00 65535.0000000 FORMAT "%13.7" ECU_ADDRESS 0x6002275A /end MEASUREMENT
/begin MEASUREMENT DINH_xWhy.FId_bInh_Pdu_VCU_AIRBAG_351h_Rcf "" UWORD DFCDSQ_Verb 1 100 0.00 65535.0000000 FORMAT "%13.7" ECU_ADDRESS 0x6002275C /end MEASUREMENT
/begin MEASUREMENT DINH_xWhy.FId_bInh_Pdu_VCU_AIRBAG_fault_Frz "" UWORD DFCDSQ_Verb 1 100 0.00 65535.0000000 FORMAT "%13.7" ECU_ADDRESS 0x6002275E /end MEASUREMENT
/begin MEASUREMENT DINH_xWhy.FId_bInh_Pdu_VCU_eBCCM_432h_Frz "" UWORD DFCDSQ_Verb 1 100 0.00 65535.0000000 FORMAT "%13.7" ECU_ADDRESS 0x60022760 /end MEASUREMENT
/begin MEASUREMENT DINH_xWhy.FId_bInh_Pdu_VCU_eBCCM_432h_Rcf "" UWORD DFCDSQ_Verb 1 100 0.00 65535.0000000 FORMAT "%13.7" ECU_ADDRESS 0x60022762 /end MEASUREMENT
/begin MEASUREMENT DINH_xWhy.FId_bInh_Pdu_VCU_eBCCM_552h_Frz "" UWORD DFCDSQ_Verb 1 100 0.00 65535.0000000 FORMAT "%13.7" ECU_ADDRESS 0x60022764 /end MEASUREMENT
/begin MEASUREMENT DINH_xWhy.FId_bInh_Pdu_VCU_eBCCM_552h_Rcf "" UWORD DFCDSQ_Verb 1 100 0.00 65535.0000000 FORMAT "%13.7" ECU_ADDRESS 0x60022766 /end MEASUREMENT
/begin MEASUREMENT DINH_xWhy.FId_bInh_Pdu_eBCCM_082h_Frz "" UWORD DFCDSQ_Verb 1 100 0.00 65535.0000000 FORMAT "%13.7" ECU_ADDRESS 0x60022768 /end MEASUREMENT
/begin MEASUREMENT DINH_xWhy.FId_bInh_Pdu_eBCCM_082h_Rcf "" UWORD DFCDSQ_Verb 1 100 0.00 65535.0000000 FORMAT "%13.7" ECU_ADDRESS 0x6002276A /end MEASUREMENT
/begin MEASUREMENT DINH_xWhy.FId_bInh_Pdu_eCOMP_Information_47B_Frz "" UWORD DFCDSQ_Verb 1 100 0.00 65535.0000000 FORMAT "%13.7" ECU_ADDRESS 0x6002276C /end MEASUREMENT
/begin MEASUREMENT DINH_xWhy.FId_bInh_Pdu_eCOMP_Information_47B_Rcf "" UWORD DFCDSQ_Verb 1 100 0.00 65535.0000000 FORMAT "%13.7" ECU_ADDRESS 0x6002276E /end MEASUREMENT
/begin MEASUREMENT DINH_xWhy.FId_bInh_Pdu_eCOMP_Information_48B_Frz "" UWORD DFCDSQ_Verb 1 100 0.00 65535.0000000 FORMAT "%13.7" ECU_ADDRESS 0x60022770 /end MEASUREMENT
/begin MEASUREMENT DINH_xWhy.FId_bInh_Pdu_eCOMP_Information_48B_Rcf "" UWORD DFCDSQ_Verb 1 100 0.00 65535.0000000 FORMAT "%13.7" ECU_ADDRESS 0x60022772 /end MEASUREMENT
/begin MEASUREMENT DINH_xWhy.FId_bInh_Sig205h_Com_iHvbActRx_Frz "" UWORD DFCDSQ_Verb 1 100 0.00 65535.0000000 FORMAT "%13.7" ECU_ADDRESS 0x60022774 /end MEASUREMENT
/begin MEASUREMENT DINH_xWhy.FId_bInh_Sig205h_Com_iHvbActRx_Rcf "" UWORD DFCDSQ_Verb 1 100 0.00 65535.0000000 FORMAT "%13.7" ECU_ADDRESS 0x60022776 /end MEASUREMENT
/begin MEASUREMENT DINH_xWhy.FId_bInh_Sig205h_Com_ratHvbSoc_Frz "" UWORD DFCDSQ_Verb 1 100 0.00 65535.0000000 FORMAT "%13.7" ECU_ADDRESS 0x60022778 /end MEASUREMENT
/begin MEASUREMENT DINH_xWhy.FId_bInh_Sig205h_Com_ratHvbSoc_Rcf "" UWORD DFCDSQ_Verb 1 100 0.00 65535.0000000 FORMAT "%13.7" ECU_ADDRESS 0x6002277A /end MEASUREMENT
/begin MEASUREMENT DINH_xWhy.FId_bInh_Sig205h_Com_stHvbChrgn_Frz "" UWORD DFCDSQ_Verb 1 100 0.00 65535.0000000 FORMAT "%13.7" ECU_ADDRESS 0x6002277C /end MEASUREMENT
/begin MEASUREMENT DINH_xWhy.FId_bInh_Sig205h_Com_stHvbChrgn_Rcf "" UWORD DFCDSQ_Verb 1 100 0.00 65535.0000000 FORMAT "%13.7" ECU_ADDRESS 0x6002277E /end MEASUREMENT
/begin MEASUREMENT DINH_xWhy.FId_bInh_Sig205h_Com_uHvbAct_Frz "" UWORD DFCDSQ_Verb 1 100 0.00 65535.0000000 FORMAT "%13.7" ECU_ADDRESS 0x60022780 /end MEASUREMENT
/begin MEASUREMENT DINH_xWhy.FId_bInh_Sig205h_Com_uHvbAct_Rcf "" UWORD DFCDSQ_Verb 1 100 0.00 65535.0000000 FORMAT "%13.7" ECU_ADDRESS 0x60022782 /end MEASUREMENT
/begin MEASUREMENT DINH_xWhy.FId_bInh_Sig217h_ComEmac_nAct01_Frz "" UWORD DFCDSQ_Verb 1 100 0.00 65535.0000000 FORMAT "%13.7" ECU_ADDRESS 0x60022784 /end MEASUREMENT
/begin MEASUREMENT DINH_xWhy.FId_bInh_Sig217h_ComEmac_nAct01_Rcf "" UWORD DFCDSQ_Verb 1 100 0.00 65535.0000000 FORMAT "%13.7" ECU_ADDRESS 0x60022786 /end MEASUREMENT
/begin MEASUREMENT DINH_xWhy.FId_bInh_Sig217h_ComEmac_tqAckd01_Frz "" UWORD DFCDSQ_Verb 1 100 0.00 65535.0000000 FORMAT "%13.7" ECU_ADDRESS 0x60022788 /end MEASUREMENT
/begin MEASUREMENT DINH_xWhy.FId_bInh_Sig217h_ComEmac_tqAckd01_Rcf "" UWORD DFCDSQ_Verb 1 100 0.00 65535.0000000 FORMAT "%13.7" ECU_ADDRESS 0x6002278A /end MEASUREMENT
/begin MEASUREMENT DINH_xWhy.FId_bInh_Sig217h_ComEmac_tqAct01_Frz "" UWORD DFCDSQ_Verb 1 100 0.00 65535.0000000 FORMAT "%13.7" ECU_ADDRESS 0x6002278C /end MEASUREMENT
/begin MEASUREMENT DINH_xWhy.FId_bInh_Sig217h_ComEmac_tqAct01_Rcf "" UWORD DFCDSQ_Verb 1 100 0.00 65535.0000000 FORMAT "%13.7" ECU_ADDRESS 0x6002278E /end MEASUREMENT
/begin MEASUREMENT DINH_xWhy.FId_bInh_Sig217h_ComEmac_uDcLnk01_Frz "" UWORD DFCDSQ_Verb 1 100 0.00 65535.0000000 FORMAT "%13.7" ECU_ADDRESS 0x60022790 /end MEASUREMENT
/begin MEASUREMENT DINH_xWhy.FId_bInh_Sig217h_ComEmac_uDcLnk01_Rcf "" UWORD DFCDSQ_Verb 1 100 0.00 65535.0000000 FORMAT "%13.7" ECU_ADDRESS 0x60022792 /end MEASUREMENT
/begin MEASUREMENT DINH_xWhy.FId_bInh_Sig227h_ComEmac_iDcLnk01_Frz "" UWORD DFCDSQ_Verb 1 100 0.00 65535.0000000 FORMAT "%13.7" ECU_ADDRESS 0x60022794 /end MEASUREMENT
/begin MEASUREMENT DINH_xWhy.FId_bInh_Sig227h_ComEmac_iDcLnk01_Rcf "" UWORD DFCDSQ_Verb 1 100 0.00 65535.0000000 FORMAT "%13.7" ECU_ADDRESS 0x60022796 /end MEASUREMENT
/begin MEASUREMENT DINH_xWhy.FId_bInh_Sig227h_ComEmac_pwrInstnsInpRx_Frz "" UWORD DFCDSQ_Verb 1 100 0.00 65535.0000000 FORMAT "%13.7" ECU_ADDRESS 0x60022798 /end MEASUREMENT
/begin MEASUREMENT DINH_xWhy.FId_bInh_Sig227h_ComEmac_pwrInstnsInpRx_Rcf "" UWORD DFCDSQ_Verb 1 100 0.00 65535.0000000 FORMAT "%13.7" ECU_ADDRESS 0x6002279A /end MEASUREMENT
/begin MEASUREMENT DINH_xWhy.FId_bInh_Sig227h_ComEmac_tqAbsltMax01_Frz "" UWORD DFCDSQ_Verb 1 100 0.00 65535.0000000 FORMAT "%13.7" ECU_ADDRESS 0x6002279C /end MEASUREMENT
/begin MEASUREMENT DINH_xWhy.FId_bInh_Sig227h_ComEmac_tqAbsltMax01_Rcf "" UWORD DFCDSQ_Verb 1 100 0.00 65535.0000000 FORMAT "%13.7" ECU_ADDRESS 0x6002279E /end MEASUREMENT
/begin MEASUREMENT DINH_xWhy.FId_bInh_Sig227h_ComEmac_tqAbsltMaxRx01_Frz "" UWORD DFCDSQ_Verb 1 100 0.00 65535.0000000 FORMAT "%13.7" ECU_ADDRESS 0x600227A0 /end MEASUREMENT
/begin MEASUREMENT DINH_xWhy.FId_bInh_Sig227h_ComEmac_tqAbsltMaxRx01_Rcf "" UWORD DFCDSQ_Verb 1 100 0.00 65535.0000000 FORMAT "%13.7" ECU_ADDRESS 0x600227A2 /end MEASUREMENT
/begin MEASUREMENT DINH_xWhy.FId_bInh_Sig227h_ComEmac_tqAbsltMin01_Frz "" UWORD DFCDSQ_Verb 1 100 0.00 65535.0000000 FORMAT "%13.7" ECU_ADDRESS 0x600227A4 /end MEASUREMENT
/begin MEASUREMENT DINH_xWhy.FId_bInh_Sig227h_ComEmac_tqAbsltMin01_Rcf "" UWORD DFCDSQ_Verb 1 100 0.00 65535.0000000 FORMAT "%13.7" ECU_ADDRESS 0x600227A6 /end MEASUREMENT
/begin MEASUREMENT DINH_xWhy.FId_bInh_Sig227h_ComEmac_tqAbsltMinRx01_Frz "" UWORD DFCDSQ_Verb 1 100 0.00 65535.0000000 FORMAT "%13.7" ECU_ADDRESS 0x600227A8 /end MEASUREMENT
/begin MEASUREMENT DINH_xWhy.FId_bInh_Sig227h_ComEmac_tqAbsltMinRx01_Rcf "" UWORD DFCDSQ_Verb 1 100 0.00 65535.0000000 FORMAT "%13.7" ECU_ADDRESS 0x600227AA /end MEASUREMENT
/begin MEASUREMENT DINH_xWhy.FId_bInh_Sig237h_ComEmac_stActvDcha_Frz "" UWORD DFCDSQ_Verb 1 100 0.00 65535.0000000 FORMAT "%13.7" ECU_ADDRESS 0x600227AC /end MEASUREMENT
/begin MEASUREMENT DINH_xWhy.FId_bInh_Sig237h_ComEmac_stActvDcha_Rcf "" UWORD DFCDSQ_Verb 1 100 0.00 65535.0000000 FORMAT "%13.7" ECU_ADDRESS 0x600227AE /end MEASUREMENT
/begin MEASUREMENT DINH_xWhy.FId_bInh_Sig237h_ComEmac_stEVLmp_Frz "" UWORD DFCDSQ_Verb 1 100 0.00 65535.0000000 FORMAT "%13.7" ECU_ADDRESS 0x600227B0 /end MEASUREMENT
/begin MEASUREMENT DINH_xWhy.FId_bInh_Sig237h_ComEmac_stEVLmp_Rcf "" UWORD DFCDSQ_Verb 1 100 0.00 65535.0000000 FORMAT "%13.7" ECU_ADDRESS 0x600227B2 /end MEASUREMENT
/begin MEASUREMENT DINH_xWhy.FId_bInh_Sig237h_ComEmac_stMod01Rx_Frz "" UWORD DFCDSQ_Verb 1 100 0.00 65535.0000000 FORMAT "%13.7" ECU_ADDRESS 0x600227B4 /end MEASUREMENT
/begin MEASUREMENT DINH_xWhy.FId_bInh_Sig237h_ComEmac_stMod01Rx_Rcf "" UWORD DFCDSQ_Verb 1 100 0.00 65535.0000000 FORMAT "%13.7" ECU_ADDRESS 0x600227B6 /end MEASUREMENT
/begin MEASUREMENT DINH_xWhy.FId_bInh_Sig237h_ComEmac_stMstWrnLmp_Frz "" UWORD DFCDSQ_Verb 1 100 0.00 65535.0000000 FORMAT "%13.7" ECU_ADDRESS 0x600227B8 /end MEASUREMENT
/begin MEASUREMENT DINH_xWhy.FId_bInh_Sig237h_ComEmac_stMstWrnLmp_Rcf "" UWORD DFCDSQ_Verb 1 100 0.00 65535.0000000 FORMAT "%13.7" ECU_ADDRESS 0x600227BA /end MEASUREMENT
/begin MEASUREMENT DINH_xWhy.FId_bInh_Sig237h_ComEmac_stSVSLmp_Frz "" UWORD DFCDSQ_Verb 1 100 0.00 65535.0000000 FORMAT "%13.7" ECU_ADDRESS 0x600227BC /end MEASUREMENT
/begin MEASUREMENT DINH_xWhy.FId_bInh_Sig237h_ComEmac_stSVSLmp_Rcf "" UWORD DFCDSQ_Verb 1 100 0.00 65535.0000000 FORMAT "%13.7" ECU_ADDRESS 0x600227BE /end MEASUREMENT
/begin MEASUREMENT DINH_xWhy.FId_bInh_Sig237h_ComEmac_tqStabnMin_Frz "" UWORD DFCDSQ_Verb 1 100 0.00 65535.0000000 FORMAT "%13.7" ECU_ADDRESS 0x600227C0 /end MEASUREMENT
/begin MEASUREMENT DINH_xWhy.FId_bInh_Sig237h_ComEmac_tqStabnMin_Rcf "" UWORD DFCDSQ_Verb 1 100 0.00 65535.0000000 FORMAT "%13.7" ECU_ADDRESS 0x600227C2 /end MEASUREMENT
/begin MEASUREMENT DINH_xWhy.FId_bInh_Sig237h_Com_stIIvtrFltLvl01_Frz "" UWORD DFCDSQ_Verb 1 100 0.00 65535.0000000 FORMAT "%13.7" ECU_ADDRESS 0x600227C4 /end MEASUREMENT
/begin MEASUREMENT DINH_xWhy.FId_bInh_Sig237h_Com_stIIvtrFltLvl01_Rcf "" UWORD DFCDSQ_Verb 1 100 0.00 65535.0000000 FORMAT "%13.7" ECU_ADDRESS 0x600227C6 /end MEASUREMENT
/begin MEASUREMENT DINH_xWhy.FId_bInh_Sig259hFlt "" UWORD DFCDSQ_Verb 1 100 0.00 65535.0000000 FORMAT "%13.7" ECU_ADDRESS 0x600227C8 /end MEASUREMENT
/begin MEASUREMENT DINH_xWhy.FId_bInh_Sig259h_Com_flgEcoNormReqRx_Frz "" UWORD DFCDSQ_Verb 1 100 0.00 65535.0000000 FORMAT "%13.7" ECU_ADDRESS 0x600227CA /end MEASUREMENT
/begin MEASUREMENT DINH_xWhy.FId_bInh_Sig259h_Com_flgEcoNormReqRx_Rcf "" UWORD DFCDSQ_Verb 1 100 0.00 65535.0000000 FORMAT "%13.7" ECU_ADDRESS 0x600227CC /end MEASUREMENT
/begin MEASUREMENT DINH_xWhy.FId_bInh_Sig259h_Com_stGearLvrPos_Frz "" UWORD DFCDSQ_Verb 1 100 0.00 65535.0000000 FORMAT "%13.7" ECU_ADDRESS 0x600227CE /end MEASUREMENT
/begin MEASUREMENT DINH_xWhy.FId_bInh_Sig259h_Com_stGearLvrPos_Rcf "" UWORD DFCDSQ_Verb 1 100 0.00 65535.0000000 FORMAT "%13.7" ECU_ADDRESS 0x600227D0 /end MEASUREMENT
/begin MEASUREMENT DINH_xWhy.FId_bInh_Sig259h_Com_steTogFailrLvl_Frz "" UWORD DFCDSQ_Verb 1 100 0.00 65535.0000000 FORMAT "%13.7" ECU_ADDRESS 0x600227D2 /end MEASUREMENT
/begin MEASUREMENT DINH_xWhy.FId_bInh_Sig259h_Com_steTogFailrLvl_Rcf "" UWORD DFCDSQ_Verb 1 100 0.00 65535.0000000 FORMAT "%13.7" ECU_ADDRESS 0x600227D4 /end MEASUREMENT
/begin MEASUREMENT DINH_xWhy.FId_bInh_Sig26h_Com_stAC_Frz "" UWORD DFCDSQ_Verb 1 100 0.00 65535.0000000 FORMAT "%13.7" ECU_ADDRESS 0x600227D6 /end MEASUREMENT
/begin MEASUREMENT DINH_xWhy.FId_bInh_Sig26h_Com_stAC_Rcf "" UWORD DFCDSQ_Verb 1 100 0.00 65535.0000000 FORMAT "%13.7" ECU_ADDRESS 0x600227D8 /end MEASUREMENT
/begin MEASUREMENT DINH_xWhy.FId_bInh_Sig26h_Com_stEvapTFlt_Frz "" UWORD DFCDSQ_Verb 1 100 0.00 65535.0000000 FORMAT "%13.7" ECU_ADDRESS 0x600227DA /end MEASUREMENT
/begin MEASUREMENT DINH_xWhy.FId_bInh_Sig26h_Com_stEvapTFlt_Rcf "" UWORD DFCDSQ_Verb 1 100 0.00 65535.0000000 FORMAT "%13.7" ECU_ADDRESS 0x600227DC /end MEASUREMENT
/begin MEASUREMENT DINH_xWhy.FId_bInh_Sig26h_Com_stHvacBlwrFront_Frz "" UWORD DFCDSQ_Verb 1 100 0.00 65535.0000000 FORMAT "%13.7" ECU_ADDRESS 0x600227DE /end MEASUREMENT
/begin MEASUREMENT DINH_xWhy.FId_bInh_Sig26h_Com_stHvacBlwrFront_Rcf "" UWORD DFCDSQ_Verb 1 100 0.00 65535.0000000 FORMAT "%13.7" ECU_ADDRESS 0x600227E0 /end MEASUREMENT
/begin MEASUREMENT DINH_xWhy.FId_bInh_Sig26h_Com_stHvacKnobPosn_Frz "" UWORD DFCDSQ_Verb 1 100 0.00 65535.0000000 FORMAT "%13.7" ECU_ADDRESS 0x600227E2 /end MEASUREMENT
/begin MEASUREMENT DINH_xWhy.FId_bInh_Sig26h_Com_stHvacKnobPosn_Rcf "" UWORD DFCDSQ_Verb 1 100 0.00 65535.0000000 FORMAT "%13.7" ECU_ADDRESS 0x600227E4 /end MEASUREMENT
/begin MEASUREMENT DINH_xWhy.FId_bInh_Sig26h_Com_stHvacPanPotiFlt_Frz "" UWORD DFCDSQ_Verb 1 100 0.00 65535.0000000 FORMAT "%13.7" ECU_ADDRESS 0x600227E6 /end MEASUREMENT
/begin MEASUREMENT DINH_xWhy.FId_bInh_Sig26h_Com_stHvacPanPotiFlt_Rcf "" UWORD DFCDSQ_Verb 1 100 0.00 65535.0000000 FORMAT "%13.7" ECU_ADDRESS 0x600227E8 /end MEASUREMENT
/begin MEASUREMENT DINH_xWhy.FId_bInh_Sig26h_Com_stReFogReq_Frz "" UWORD DFCDSQ_Verb 1 100 0.00 65535.0000000 FORMAT "%13.7" ECU_ADDRESS 0x600227EA /end MEASUREMENT
/begin MEASUREMENT DINH_xWhy.FId_bInh_Sig26h_Com_stReFogReq_Rcf "" UWORD DFCDSQ_Verb 1 100 0.00 65535.0000000 FORMAT "%13.7" ECU_ADDRESS 0x600227EC /end MEASUREMENT
/begin MEASUREMENT DINH_xWhy.FId_bInh_Sig26h_Com_tEvapT_Frz "" UWORD DFCDSQ_Verb 1 100 0.00 65535.0000000 FORMAT "%13.7" ECU_ADDRESS 0x600227EE /end MEASUREMENT
/begin MEASUREMENT DINH_xWhy.FId_bInh_Sig26h_Com_tEvapT_Rcf "" UWORD DFCDSQ_Verb 1 100 0.00 65535.0000000 FORMAT "%13.7" ECU_ADDRESS 0x600227F0 /end MEASUREMENT
/begin MEASUREMENT DINH_xWhy.FId_bInh_Sig273h_ComChrgr_flgChrgrErrLvl_Frz "" UWORD DFCDSQ_Verb 1 100 0.00 65535.0000000 FORMAT "%13.7" ECU_ADDRESS 0x600227F2 /end MEASUREMENT
/begin MEASUREMENT DINH_xWhy.FId_bInh_Sig273h_ComChrgr_flgChrgrErrLvl_Rcf "" UWORD DFCDSQ_Verb 1 100 0.00 65535.0000000 FORMAT "%13.7" ECU_ADDRESS 0x600227F4 /end MEASUREMENT
/begin MEASUREMENT DINH_xWhy.FId_bInh_Sig273h_ComChrgr_pwrOutpCpby_Frz "" UWORD DFCDSQ_Verb 1 100 0.00 65535.0000000 FORMAT "%13.7" ECU_ADDRESS 0x600227F6 /end MEASUREMENT
/begin MEASUREMENT DINH_xWhy.FId_bInh_Sig273h_ComChrgr_pwrOutpCpby_Rcf "" UWORD DFCDSQ_Verb 1 100 0.00 65535.0000000 FORMAT "%13.7" ECU_ADDRESS 0x600227F8 /end MEASUREMENT
/begin MEASUREMENT DINH_xWhy.FId_bInh_Sig275h_Com_iHvbDchaMaxSho_Frz "" UWORD DFCDSQ_Verb 1 100 0.00 65535.0000000 FORMAT "%13.7" ECU_ADDRESS 0x600227FA /end MEASUREMENT
/begin MEASUREMENT DINH_xWhy.FId_bInh_Sig275h_Com_iHvbDchaMaxSho_Rcf "" UWORD DFCDSQ_Verb 1 100 0.00 65535.0000000 FORMAT "%13.7" ECU_ADDRESS 0x600227FC /end MEASUREMENT
/begin MEASUREMENT DINH_xWhy.FId_bInh_Sig275h_Com_pwrMaxDchaSho_Frz "" UWORD DFCDSQ_Verb 1 100 0.00 65535.0000000 FORMAT "%13.7" ECU_ADDRESS 0x600227FE /end MEASUREMENT
/begin MEASUREMENT DINH_xWhy.FId_bInh_Sig275h_Com_pwrMaxDchaSho_Rcf "" UWORD DFCDSQ_Verb 1 100 0.00 65535.0000000 FORMAT "%13.7" ECU_ADDRESS 0x60022800 /end MEASUREMENT
/begin MEASUREMENT DINH_xWhy.FId_bInh_Sig283h_Com_iDcdcHvActRvsn1_Frz "" UWORD DFCDSQ_Verb 1 100 0.00 65535.0000000 FORMAT "%13.7" ECU_ADDRESS 0x60022802 /end MEASUREMENT
/begin MEASUREMENT DINH_xWhy.FId_bInh_Sig283h_Com_iDcdcHvActRvsn1_Rcf "" UWORD DFCDSQ_Verb 1 100 0.00 65535.0000000 FORMAT "%13.7" ECU_ADDRESS 0x60022804 /end MEASUREMENT
/begin MEASUREMENT DINH_xWhy.FId_bInh_Sig283h_Com_iDcdcLvActRvsn1_Frz "" UWORD DFCDSQ_Verb 1 100 0.00 65535.0000000 FORMAT "%13.7" ECU_ADDRESS 0x60022806 /end MEASUREMENT
/begin MEASUREMENT DINH_xWhy.FId_bInh_Sig283h_Com_iDcdcLvActRvsn1_Rcf "" UWORD DFCDSQ_Verb 1 100 0.00 65535.0000000 FORMAT "%13.7" ECU_ADDRESS 0x60022808 /end MEASUREMENT
/begin MEASUREMENT DINH_xWhy.FId_bInh_Sig283h_Com_uDcdcHvAct_Frz "" UWORD DFCDSQ_Verb 1 100 0.00 65535.0000000 FORMAT "%13.7" ECU_ADDRESS 0x6002280A /end MEASUREMENT
/begin MEASUREMENT DINH_xWhy.FId_bInh_Sig283h_Com_uDcdcHvAct_Rcf "" UWORD DFCDSQ_Verb 1 100 0.00 65535.0000000 FORMAT "%13.7" ECU_ADDRESS 0x6002280C /end MEASUREMENT
/begin MEASUREMENT DINH_xWhy.FId_bInh_Sig283h_Com_uDcdcLvAct_Frz "" UWORD DFCDSQ_Verb 1 100 0.00 65535.0000000 FORMAT "%13.7" ECU_ADDRESS 0x6002280E /end MEASUREMENT
/begin MEASUREMENT DINH_xWhy.FId_bInh_Sig283h_Com_uDcdcLvAct_Rcf "" UWORD DFCDSQ_Verb 1 100 0.00 65535.0000000 FORMAT "%13.7" ECU_ADDRESS 0x60022810 /end MEASUREMENT
/begin MEASUREMENT DINH_xWhy.FId_bInh_Sig285h_Com_iHvbChrgMaxSho_Frz "" UWORD DFCDSQ_Verb 1 100 0.00 65535.0000000 FORMAT "%13.7" ECU_ADDRESS 0x60022812 /end MEASUREMENT
/begin MEASUREMENT DINH_xWhy.FId_bInh_Sig285h_Com_iHvbChrgMaxSho_Rcf "" UWORD DFCDSQ_Verb 1 100 0.00 65535.0000000 FORMAT "%13.7" ECU_ADDRESS 0x60022814 /end MEASUREMENT
/begin MEASUREMENT DINH_xWhy.FId_bInh_Sig285h_Com_pwrMaxChrgSho_Frz "" UWORD DFCDSQ_Verb 1 100 0.00 65535.0000000 FORMAT "%13.7" ECU_ADDRESS 0x60022816 /end MEASUREMENT
/begin MEASUREMENT DINH_xWhy.FId_bInh_Sig285h_Com_pwrMaxChrgSho_Rcf "" UWORD DFCDSQ_Verb 1 100 0.00 65535.0000000 FORMAT "%13.7" ECU_ADDRESS 0x60022818 /end MEASUREMENT
/begin MEASUREMENT DINH_xWhy.FId_bInh_Sig293h_Com_pwrDcdcOutpCpby_Frz "" UWORD DFCDSQ_Verb 1 100 0.00 65535.0000000 FORMAT "%13.7" ECU_ADDRESS 0x6002281A /end MEASUREMENT
/begin MEASUREMENT DINH_xWhy.FId_bInh_Sig293h_Com_pwrDcdcOutpCpby_Rcf "" UWORD DFCDSQ_Verb 1 100 0.00 65535.0000000 FORMAT "%13.7" ECU_ADDRESS 0x6002281C /end MEASUREMENT
/begin MEASUREMENT DINH_xWhy.FId_bInh_Sig293h_Com_stDcdcFltLvl_Frz "" UWORD DFCDSQ_Verb 1 100 0.00 65535.0000000 FORMAT "%13.7" ECU_ADDRESS 0x6002281E /end MEASUREMENT
/begin MEASUREMENT DINH_xWhy.FId_bInh_Sig293h_Com_stDcdcFltLvl_Rcf "" UWORD DFCDSQ_Verb 1 100 0.00 65535.0000000 FORMAT "%13.7" ECU_ADDRESS 0x60022820 /end MEASUREMENT
/begin MEASUREMENT DINH_xWhy.FId_bInh_Sig325h_Com_rHvbIsoMeasmt_Frz "" UWORD DFCDSQ_Verb 1 100 0.00 65535.0000000 FORMAT "%13.7" ECU_ADDRESS 0x60022822 /end MEASUREMENT
/begin MEASUREMENT DINH_xWhy.FId_bInh_Sig325h_Com_rHvbIsoMeasmt_Rcf "" UWORD DFCDSQ_Verb 1 100 0.00 65535.0000000 FORMAT "%13.7" ECU_ADDRESS 0x60022824 /end MEASUREMENT
/begin MEASUREMENT DINH_xWhy.FId_bInh_Sig325h_Com_stHvbIntlckRx_Frz "" UWORD DFCDSQ_Verb 1 100 0.00 65535.0000000 FORMAT "%13.7" ECU_ADDRESS 0x60022826 /end MEASUREMENT
/begin MEASUREMENT DINH_xWhy.FId_bInh_Sig325h_Com_stHvbIntlckRx_Rcf "" UWORD DFCDSQ_Verb 1 100 0.00 65535.0000000 FORMAT "%13.7" ECU_ADDRESS 0x60022828 /end MEASUREMENT
/begin MEASUREMENT DINH_xWhy.FId_bInh_Sig325h_Com_stHvbIsoFltRx_Frz "" UWORD DFCDSQ_Verb 1 100 0.00 65535.0000000 FORMAT "%13.7" ECU_ADDRESS 0x6002282A /end MEASUREMENT
/begin MEASUREMENT DINH_xWhy.FId_bInh_Sig325h_Com_stHvbIsoFltRx_Rcf "" UWORD DFCDSQ_Verb 1 100 0.00 65535.0000000 FORMAT "%13.7" ECU_ADDRESS 0x6002282C /end MEASUREMENT
/begin MEASUREMENT DINH_xWhy.FId_bInh_Sig325h_Com_stHvbSrvPlgRx_Frz "" UWORD DFCDSQ_Verb 1 100 0.00 65535.0000000 FORMAT "%13.7" ECU_ADDRESS 0x6002282E /end MEASUREMENT
/begin MEASUREMENT DINH_xWhy.FId_bInh_Sig325h_Com_stHvbSrvPlgRx_Rcf "" UWORD DFCDSQ_Verb 1 100 0.00 65535.0000000 FORMAT "%13.7" ECU_ADDRESS 0x60022830 /end MEASUREMENT
/begin MEASUREMENT DINH_xWhy.FId_bInh_Sig325h_Com_tHvbMax_Frz "" UWORD DFCDSQ_Verb 1 100 0.00 65535.0000000 FORMAT "%13.7" ECU_ADDRESS 0x60022832 /end MEASUREMENT
/begin MEASUREMENT DINH_xWhy.FId_bInh_Sig325h_Com_tHvbMax_Rcf "" UWORD DFCDSQ_Verb 1 100 0.00 65535.0000000 FORMAT "%13.7" ECU_ADDRESS 0x60022834 /end MEASUREMENT
/begin MEASUREMENT DINH_xWhy.FId_bInh_Sig335h_Com_iHvbDes_Frz "" UWORD DFCDSQ_Verb 1 100 0.00 65535.0000000 FORMAT "%13.7" ECU_ADDRESS 0x60022836 /end MEASUREMENT
/begin MEASUREMENT DINH_xWhy.FId_bInh_Sig335h_Com_iHvbDes_Rcf "" UWORD DFCDSQ_Verb 1 100 0.00 65535.0000000 FORMAT "%13.7" ECU_ADDRESS 0x60022838 /end MEASUREMENT
/begin MEASUREMENT DINH_xWhy.FId_bInh_Sig335h_Com_iHvbNomChrgn_Frz "" UWORD DFCDSQ_Verb 1 100 0.00 65535.0000000 FORMAT "%13.7" ECU_ADDRESS 0x6002283A /end MEASUREMENT
/begin MEASUREMENT DINH_xWhy.FId_bInh_Sig335h_Com_iHvbNomChrgn_Rcf "" UWORD DFCDSQ_Verb 1 100 0.00 65535.0000000 FORMAT "%13.7" ECU_ADDRESS 0x6002283C /end MEASUREMENT
/begin MEASUREMENT DINH_xWhy.FId_bInh_Sig335h_Com_uHvbDcBus_Frz "" UWORD DFCDSQ_Verb 1 100 0.00 65535.0000000 FORMAT "%13.7" ECU_ADDRESS 0x6002283E /end MEASUREMENT
/begin MEASUREMENT DINH_xWhy.FId_bInh_Sig335h_Com_uHvbDcBus_Rcf "" UWORD DFCDSQ_Verb 1 100 0.00 65535.0000000 FORMAT "%13.7" ECU_ADDRESS 0x60022840 /end MEASUREMENT
/begin MEASUREMENT DINH_xWhy.FId_bInh_Sig335h_Com_uHvbLimHi_Frz "" UWORD DFCDSQ_Verb 1 100 0.00 65535.0000000 FORMAT "%13.7" ECU_ADDRESS 0x60022842 /end MEASUREMENT
/begin MEASUREMENT DINH_xWhy.FId_bInh_Sig335h_Com_uHvbLimHi_Rcf "" UWORD DFCDSQ_Verb 1 100 0.00 65535.0000000 FORMAT "%13.7" ECU_ADDRESS 0x60022844 /end MEASUREMENT
/begin MEASUREMENT DINH_xWhy.FId_bInh_Sig38Dh_Com_flgVehSpdAvl_Frz "" UWORD DFCDSQ_Verb 1 100 0.00 65535.0000000 FORMAT "%13.7" ECU_ADDRESS 0x60022846 /end MEASUREMENT
/begin MEASUREMENT DINH_xWhy.FId_bInh_Sig38Dh_Com_flgVehSpdAvl_Rcf "" UWORD DFCDSQ_Verb 1 100 0.00 65535.0000000 FORMAT "%13.7" ECU_ADDRESS 0x60022848 /end MEASUREMENT
/begin MEASUREMENT DINH_xWhy.FId_bInh_Sig38Dh_Com_vVeh_Frz "" UWORD DFCDSQ_Verb 1 100 0.00 65535.0000000 FORMAT "%13.7" ECU_ADDRESS 0x6002284A /end MEASUREMENT
/begin MEASUREMENT DINH_xWhy.FId_bInh_Sig38Dh_Com_vVeh_Rcf "" UWORD DFCDSQ_Verb 1 100 0.00 65535.0000000 FORMAT "%13.7" ECU_ADDRESS 0x6002284C /end MEASUREMENT
/begin MEASUREMENT DINH_xWhy.FId_bInh_Sig427h_ComEmac_stIvtrOpMod01_Frz "" UWORD DFCDSQ_Verb 1 100 0.00 65535.0000000 FORMAT "%13.7" ECU_ADDRESS 0x6002284E /end MEASUREMENT
/begin MEASUREMENT DINH_xWhy.FId_bInh_Sig427h_ComEmac_stIvtrOpMod01_Rcf "" UWORD DFCDSQ_Verb 1 100 0.00 65535.0000000 FORMAT "%13.7" ECU_ADDRESS 0x60022850 /end MEASUREMENT
/begin MEASUREMENT DINH_xWhy.FId_bInh_Sig427h_ComEmac_tInvr01_Frz "" UWORD DFCDSQ_Verb 1 100 0.00 65535.0000000 FORMAT "%13.7" ECU_ADDRESS 0x60022852 /end MEASUREMENT
/begin MEASUREMENT DINH_xWhy.FId_bInh_Sig427h_ComEmac_tInvr01_Rcf "" UWORD DFCDSQ_Verb 1 100 0.00 65535.0000000 FORMAT "%13.7" ECU_ADDRESS 0x60022854 /end MEASUREMENT
/begin MEASUREMENT DINH_xWhy.FId_bInh_Sig427h_ComEmac_tIvtrCooltIn01_Frz "" UWORD DFCDSQ_Verb 1 100 0.00 65535.0000000 FORMAT "%13.7" ECU_ADDRESS 0x60022856 /end MEASUREMENT
/begin MEASUREMENT DINH_xWhy.FId_bInh_Sig427h_ComEmac_tIvtrCooltIn01_Rcf "" UWORD DFCDSQ_Verb 1 100 0.00 65535.0000000 FORMAT "%13.7" ECU_ADDRESS 0x60022858 /end MEASUREMENT
/begin MEASUREMENT DINH_xWhy.FId_bInh_Sig427h_ComEmac_tMac01_Frz "" UWORD DFCDSQ_Verb 1 100 0.00 65535.0000000 FORMAT "%13.7" ECU_ADDRESS 0x6002285A /end MEASUREMENT
/begin MEASUREMENT DINH_xWhy.FId_bInh_Sig427h_ComEmac_tMac01_Rcf "" UWORD DFCDSQ_Verb 1 100 0.00 65535.0000000 FORMAT "%13.7" ECU_ADDRESS 0x6002285C /end MEASUREMENT
/begin MEASUREMENT DINH_xWhy.FId_bInh_Sig427h_ComEmac_tqPtd01_Frz "" UWORD DFCDSQ_Verb 1 100 0.00 65535.0000000 FORMAT "%13.7" ECU_ADDRESS 0x6002285E /end MEASUREMENT
/begin MEASUREMENT DINH_xWhy.FId_bInh_Sig427h_ComEmac_tqPtd01_Rcf "" UWORD DFCDSQ_Verb 1 100 0.00 65535.0000000 FORMAT "%13.7" ECU_ADDRESS 0x60022860 /end MEASUREMENT
/begin MEASUREMENT DINH_xWhy.FId_bInh_Sig432h_Com_stMainWkuReq_Frz "" UWORD DFCDSQ_Verb 1 100 0.00 65535.0000000 FORMAT "%13.7" ECU_ADDRESS 0x60022862 /end MEASUREMENT
/begin MEASUREMENT DINH_xWhy.FId_bInh_Sig432h_Com_stMainWkuReq_Rcf "" UWORD DFCDSQ_Verb 1 100 0.00 65535.0000000 FORMAT "%13.7" ECU_ADDRESS 0x60022864 /end MEASUREMENT
/begin MEASUREMENT DINH_xWhy.FId_bInh_Sig435h_Com_HvbMaxSnsrTempRx_Frz "" UWORD DFCDSQ_Verb 1 100 0.00 65535.0000000 FORMAT "%13.7" ECU_ADDRESS 0x60022866 /end MEASUREMENT
/begin MEASUREMENT DINH_xWhy.FId_bInh_Sig435h_Com_HvbMaxSnsrTempRx_Rcf "" UWORD DFCDSQ_Verb 1 100 0.00 65535.0000000 FORMAT "%13.7" ECU_ADDRESS 0x60022868 /end MEASUREMENT
/begin MEASUREMENT DINH_xWhy.FId_bInh_Sig435h_Com_nrSerMaxCell_Frz "" UWORD DFCDSQ_Verb 1 100 0.00 65535.0000000 FORMAT "%13.7" ECU_ADDRESS 0x6002286A /end MEASUREMENT
/begin MEASUREMENT DINH_xWhy.FId_bInh_Sig435h_Com_nrSerMaxCell_Rcf "" UWORD DFCDSQ_Verb 1 100 0.00 65535.0000000 FORMAT "%13.7" ECU_ADDRESS 0x6002286C /end MEASUREMENT
/begin MEASUREMENT DINH_xWhy.FId_bInh_Sig435h_Com_nrSerMinCell_Frz "" UWORD DFCDSQ_Verb 1 100 0.00 65535.0000000 FORMAT "%13.7" ECU_ADDRESS 0x6002286E /end MEASUREMENT
/begin MEASUREMENT DINH_xWhy.FId_bInh_Sig435h_Com_nrSerMinCell_Rcf "" UWORD DFCDSQ_Verb 1 100 0.00 65535.0000000 FORMAT "%13.7" ECU_ADDRESS 0x60022870 /end MEASUREMENT
/begin MEASUREMENT DINH_xWhy.FId_bInh_Sig435h_Com_uHvbMaxCell_Frz "" UWORD DFCDSQ_Verb 1 100 0.00 65535.0000000 FORMAT "%13.7" ECU_ADDRESS 0x60022872 /end MEASUREMENT
/begin MEASUREMENT DINH_xWhy.FId_bInh_Sig435h_Com_uHvbMaxCell_Rcf "" UWORD DFCDSQ_Verb 1 100 0.00 65535.0000000 FORMAT "%13.7" ECU_ADDRESS 0x60022874 /end MEASUREMENT
/begin MEASUREMENT DINH_xWhy.FId_bInh_Sig435h_Com_uHvbMinCell_Frz "" UWORD DFCDSQ_Verb 1 100 0.00 65535.0000000 FORMAT "%13.7" ECU_ADDRESS 0x60022876 /end MEASUREMENT
/begin MEASUREMENT DINH_xWhy.FId_bInh_Sig435h_Com_uHvbMinCell_Rcf "" UWORD DFCDSQ_Verb 1 100 0.00 65535.0000000 FORMAT "%13.7" ECU_ADDRESS 0x60022878 /end MEASUREMENT
/begin MEASUREMENT DINH_xWhy.FId_bInh_Sig442h_Com_stBlowrRly_Frz "" UWORD DFCDSQ_Verb 1 100 0.00 65535.0000000 FORMAT "%13.7" ECU_ADDRESS 0x6002287A /end MEASUREMENT
/begin MEASUREMENT DINH_xWhy.FId_bInh_Sig442h_Com_stBlowrRly_Rcf "" UWORD DFCDSQ_Verb 1 100 0.00 65535.0000000 FORMAT "%13.7" ECU_ADDRESS 0x6002287C /end MEASUREMENT
/begin MEASUREMENT DINH_xWhy.FId_bInh_Sig453h_ComChrgr_iAcMax_Frz "" UWORD DFCDSQ_Verb 1 100 0.00 65535.0000000 FORMAT "%13.7" ECU_ADDRESS 0x6002287E /end MEASUREMENT
/begin MEASUREMENT DINH_xWhy.FId_bInh_Sig453h_ComChrgr_iAcMax_Rcf "" UWORD DFCDSQ_Verb 1 100 0.00 65535.0000000 FORMAT "%13.7" ECU_ADDRESS 0x60022880 /end MEASUREMENT
/begin MEASUREMENT DINH_xWhy.FId_bInh_Sig453h_ComChrgr_pwrInAct_Frz "" UWORD DFCDSQ_Verb 1 100 0.00 65535.0000000 FORMAT "%13.7" ECU_ADDRESS 0x60022882 /end MEASUREMENT
/begin MEASUREMENT DINH_xWhy.FId_bInh_Sig453h_ComChrgr_pwrInAct_Rcf "" UWORD DFCDSQ_Verb 1 100 0.00 65535.0000000 FORMAT "%13.7" ECU_ADDRESS 0x60022884 /end MEASUREMENT
/begin MEASUREMENT DINH_xWhy.FId_bInh_Sig453h_ComChrgr_uAcActL1_Frz "" UWORD DFCDSQ_Verb 1 100 0.00 65535.0000000 FORMAT "%13.7" ECU_ADDRESS 0x60022886 /end MEASUREMENT
/begin MEASUREMENT DINH_xWhy.FId_bInh_Sig453h_ComChrgr_uAcActL1_Rcf "" UWORD DFCDSQ_Verb 1 100 0.00 65535.0000000 FORMAT "%13.7" ECU_ADDRESS 0x60022888 /end MEASUREMENT
/begin MEASUREMENT DINH_xWhy.FId_bInh_Sig455h_Com_uHvbNomChrgn_Frz "" UWORD DFCDSQ_Verb 1 100 0.00 65535.0000000 FORMAT "%13.7" ECU_ADDRESS 0x6002288A /end MEASUREMENT
/begin MEASUREMENT DINH_xWhy.FId_bInh_Sig455h_Com_uHvbNomChrgn_Rcf "" UWORD DFCDSQ_Verb 1 100 0.00 65535.0000000 FORMAT "%13.7" ECU_ADDRESS 0x6002288C /end MEASUREMENT
/begin MEASUREMENT DINH_xWhy.FId_bInh_Sig463h_ComChrgr_iDcHvAct_Frz "" UWORD DFCDSQ_Verb 1 100 0.00 65535.0000000 FORMAT "%13.7" ECU_ADDRESS 0x6002288E /end MEASUREMENT
/begin MEASUREMENT DINH_xWhy.FId_bInh_Sig463h_ComChrgr_iDcHvAct_Rcf "" UWORD DFCDSQ_Verb 1 100 0.00 65535.0000000 FORMAT "%13.7" ECU_ADDRESS 0x60022890 /end MEASUREMENT
/begin MEASUREMENT DINH_xWhy.FId_bInh_Sig463h_ComChrgr_tChrgrMaxAct_Frz "" UWORD DFCDSQ_Verb 1 100 0.00 65535.0000000 FORMAT "%13.7" ECU_ADDRESS 0x60022892 /end MEASUREMENT
/begin MEASUREMENT DINH_xWhy.FId_bInh_Sig463h_ComChrgr_tChrgrMaxAct_Rcf "" UWORD DFCDSQ_Verb 1 100 0.00 65535.0000000 FORMAT "%13.7" ECU_ADDRESS 0x60022894 /end MEASUREMENT
/begin MEASUREMENT DINH_xWhy.FId_bInh_Sig463h_ComChrgr_uDcHvAct_Frz "" UWORD DFCDSQ_Verb 1 100 0.00 65535.0000000 FORMAT "%13.7" ECU_ADDRESS 0x60022896 /end MEASUREMENT
/begin MEASUREMENT DINH_xWhy.FId_bInh_Sig463h_ComChrgr_uDcHvAct_Rcf "" UWORD DFCDSQ_Verb 1 100 0.00 65535.0000000 FORMAT "%13.7" ECU_ADDRESS 0x60022898 /end MEASUREMENT
/begin MEASUREMENT DINH_xWhy.FId_bInh_Sig473h_Com_tDcdcAct_Frz "" UWORD DFCDSQ_Verb 1 100 0.00 65535.0000000 FORMAT "%13.7" ECU_ADDRESS 0x6002289A /end MEASUREMENT
/begin MEASUREMENT DINH_xWhy.FId_bInh_Sig473h_Com_tDcdcAct_Rcf "" UWORD DFCDSQ_Verb 1 100 0.00 65535.0000000 FORMAT "%13.7" ECU_ADDRESS 0x6002289C /end MEASUREMENT
/begin MEASUREMENT DINH_xWhy.FId_bInh_Sig473h_Com_tDcdcInltCoolt_Frz "" UWORD DFCDSQ_Verb 1 100 0.00 65535.0000000 FORMAT "%13.7" ECU_ADDRESS 0x6002289E /end MEASUREMENT
/begin MEASUREMENT DINH_xWhy.FId_bInh_Sig473h_Com_tDcdcInltCoolt_Rcf "" UWORD DFCDSQ_Verb 1 100 0.00 65535.0000000 FORMAT "%13.7" ECU_ADDRESS 0x600228A0 /end MEASUREMENT
/begin MEASUREMENT DINH_xWhy.FId_bInh_Sig47Bh_Com_iElCmprHvAct_Frz "" UWORD DFCDSQ_Verb 1 100 0.00 65535.0000000 FORMAT "%13.7" ECU_ADDRESS 0x600228A2 /end MEASUREMENT
/begin MEASUREMENT DINH_xWhy.FId_bInh_Sig47Bh_Com_iElCmprHvAct_Rcf "" UWORD DFCDSQ_Verb 1 100 0.00 65535.0000000 FORMAT "%13.7" ECU_ADDRESS 0x600228A4 /end MEASUREMENT
/begin MEASUREMENT DINH_xWhy.FId_bInh_Sig47Bh_Com_iElCmprPeakPha_Frz "" UWORD DFCDSQ_Verb 1 100 0.00 65535.0000000 FORMAT "%13.7" ECU_ADDRESS 0x600228A6 /end MEASUREMENT
/begin MEASUREMENT DINH_xWhy.FId_bInh_Sig47Bh_Com_iElCmprPeakPha_Rcf "" UWORD DFCDSQ_Verb 1 100 0.00 65535.0000000 FORMAT "%13.7" ECU_ADDRESS 0x600228A8 /end MEASUREMENT
/begin MEASUREMENT DINH_xWhy.FId_bInh_Sig47Bh_Com_nElCmprActl_Frz "" UWORD DFCDSQ_Verb 1 100 0.00 65535.0000000 FORMAT "%13.7" ECU_ADDRESS 0x600228AA /end MEASUREMENT
/begin MEASUREMENT DINH_xWhy.FId_bInh_Sig47Bh_Com_nElCmprActl_Rcf "" UWORD DFCDSQ_Verb 1 100 0.00 65535.0000000 FORMAT "%13.7" ECU_ADDRESS 0x600228AC /end MEASUREMENT
/begin MEASUREMENT DINH_xWhy.FId_bInh_Sig47Bh_Com_pwrElCmprActl_Frz "" UWORD DFCDSQ_Verb 1 100 0.00 65535.0000000 FORMAT "%13.7" ECU_ADDRESS 0x600228AE /end MEASUREMENT
/begin MEASUREMENT DINH_xWhy.FId_bInh_Sig47Bh_Com_pwrElCmprActl_Rcf "" UWORD DFCDSQ_Verb 1 100 0.00 65535.0000000 FORMAT "%13.7" ECU_ADDRESS 0x600228B0 /end MEASUREMENT
/begin MEASUREMENT DINH_xWhy.FId_bInh_Sig47Bh_Com_tElCmprActl_Frz "" UWORD DFCDSQ_Verb 1 100 0.00 65535.0000000 FORMAT "%13.7" ECU_ADDRESS 0x600228B2 /end MEASUREMENT
/begin MEASUREMENT DINH_xWhy.FId_bInh_Sig47Bh_Com_tElCmprActl_Rcf "" UWORD DFCDSQ_Verb 1 100 0.00 65535.0000000 FORMAT "%13.7" ECU_ADDRESS 0x600228B4 /end MEASUREMENT
/begin MEASUREMENT DINH_xWhy.FId_bInh_Sig47Bh_Com_uElCmprHvAct_Frz "" UWORD DFCDSQ_Verb 1 100 0.00 65535.0000000 FORMAT "%13.7" ECU_ADDRESS 0x600228B6 /end MEASUREMENT
/begin MEASUREMENT DINH_xWhy.FId_bInh_Sig47Bh_Com_uElCmprHvAct_Rcf "" UWORD DFCDSQ_Verb 1 100 0.00 65535.0000000 FORMAT "%13.7" ECU_ADDRESS 0x600228B8 /end MEASUREMENT
/begin MEASUREMENT DINH_xWhy.FId_bInh_Sig48Bh_Com_stElCmprFltLvl_Frz "" UWORD DFCDSQ_Verb 1 100 0.00 65535.0000000 FORMAT "%13.7" ECU_ADDRESS 0x600228BA /end MEASUREMENT
/begin MEASUREMENT DINH_xWhy.FId_bInh_Sig48Bh_Com_stElCmprFltLvl_Rcf "" UWORD DFCDSQ_Verb 1 100 0.00 65535.0000000 FORMAT "%13.7" ECU_ADDRESS 0x600228BC /end MEASUREMENT
/begin MEASUREMENT DINH_xWhy.FId_bInh_Sig4F2h_Com_ratSocLvBatt_Frz "" UWORD DFCDSQ_Verb 1 100 0.00 65535.0000000 FORMAT "%13.7" ECU_ADDRESS 0x600228BE /end MEASUREMENT
/begin MEASUREMENT DINH_xWhy.FId_bInh_Sig4F2h_Com_ratSocLvBatt_Rcf "" UWORD DFCDSQ_Verb 1 100 0.00 65535.0000000 FORMAT "%13.7" ECU_ADDRESS 0x600228C0 /end MEASUREMENT
/begin MEASUREMENT DINH_xWhy.FId_bInh_Sig4F2h_Com_stSocRx_Frz "" UWORD DFCDSQ_Verb 1 100 0.00 65535.0000000 FORMAT "%13.7" ECU_ADDRESS 0x600228C2 /end MEASUREMENT
/begin MEASUREMENT DINH_xWhy.FId_bInh_Sig4F2h_Com_stSocRx_Rcf "" UWORD DFCDSQ_Verb 1 100 0.00 65535.0000000 FORMAT "%13.7" ECU_ADDRESS 0x600228C4 /end MEASUREMENT
/begin MEASUREMENT DINH_xWhy.FId_bInh_Sig4F2h_Com_stT_Frz "" UWORD DFCDSQ_Verb 1 100 0.00 65535.0000000 FORMAT "%13.7" ECU_ADDRESS 0x600228C6 /end MEASUREMENT
/begin MEASUREMENT DINH_xWhy.FId_bInh_Sig4F2h_Com_stT_Rcf "" UWORD DFCDSQ_Verb 1 100 0.00 65535.0000000 FORMAT "%13.7" ECU_ADDRESS 0x600228C8 /end MEASUREMENT
/begin MEASUREMENT DINH_xWhy.FId_bInh_Sig535h_Com_tHvbAct_Frz "" UWORD DFCDSQ_Verb 1 100 0.00 65535.0000000 FORMAT "%13.7" ECU_ADDRESS 0x600228CA /end MEASUREMENT
/begin MEASUREMENT DINH_xWhy.FId_bInh_Sig535h_Com_tHvbAct_Rcf "" UWORD DFCDSQ_Verb 1 100 0.00 65535.0000000 FORMAT "%13.7" ECU_ADDRESS 0x600228CC /end MEASUREMENT
/begin MEASUREMENT DINH_xWhy.FId_bInh_Sig543h_Com_egyHvbAvl_fRx_Frz "" UWORD DFCDSQ_Verb 1 100 0.00 65535.0000000 FORMAT "%13.7" ECU_ADDRESS 0x600228CE /end MEASUREMENT
/begin MEASUREMENT DINH_xWhy.FId_bInh_Sig543h_Com_egyHvbAvl_fRx_Rcf "" UWORD DFCDSQ_Verb 1 100 0.00 65535.0000000 FORMAT "%13.7" ECU_ADDRESS 0x600228D0 /end MEASUREMENT
/begin MEASUREMENT DINH_xWhy.FId_bInh_Sig543h_Com_ratHvbSoh_Frz "" UWORD DFCDSQ_Verb 1 100 0.00 65535.0000000 FORMAT "%13.7" ECU_ADDRESS 0x600228D2 /end MEASUREMENT
/begin MEASUREMENT DINH_xWhy.FId_bInh_Sig543h_Com_ratHvbSoh_Rcf "" UWORD DFCDSQ_Verb 1 100 0.00 65535.0000000 FORMAT "%13.7" ECU_ADDRESS 0x600228D4 /end MEASUREMENT
/begin MEASUREMENT DINH_xWhy.FId_bInh_Sig543h_Com_ratRHvbSoh_Frz "" UWORD DFCDSQ_Verb 1 100 0.00 65535.0000000 FORMAT "%13.7" ECU_ADDRESS 0x600228D6 /end MEASUREMENT
/begin MEASUREMENT DINH_xWhy.FId_bInh_Sig543h_Com_ratRHvbSoh_Rcf "" UWORD DFCDSQ_Verb 1 100 0.00 65535.0000000 FORMAT "%13.7" ECU_ADDRESS 0x600228D8 /end MEASUREMENT
/begin MEASUREMENT DINH_xWhy.FId_bInh_Sig552h_Com_lDstGlbDa_Frz "" UWORD DFCDSQ_Verb 1 100 0.00 65535.0000000 FORMAT "%13.7" ECU_ADDRESS 0x600228DA /end MEASUREMENT
/begin MEASUREMENT DINH_xWhy.FId_bInh_Sig552h_Com_lDstGlbDa_Rcf "" UWORD DFCDSQ_Verb 1 100 0.00 65535.0000000 FORMAT "%13.7" ECU_ADDRESS 0x600228DC /end MEASUREMENT
/begin MEASUREMENT DINH_xWhy.FId_bInh_Sig552h_Com_lTotOdometer_Frz "" UWORD DFCDSQ_Verb 1 100 0.00 65535.0000000 FORMAT "%13.7" ECU_ADDRESS 0x600228DE /end MEASUREMENT
/begin MEASUREMENT DINH_xWhy.FId_bInh_Sig552h_Com_lTotOdometer_Rcf "" UWORD DFCDSQ_Verb 1 100 0.00 65535.0000000 FORMAT "%13.7" ECU_ADDRESS 0x600228E0 /end MEASUREMENT
/begin MEASUREMENT DINH_xWhy.FId_bInh_Sig552h_Com_tiCurVehTmr_Frz "" UWORD DFCDSQ_Verb 1 100 0.00 65535.0000000 FORMAT "%13.7" ECU_ADDRESS 0x600228E2 /end MEASUREMENT
/begin MEASUREMENT DINH_xWhy.FId_bInh_Sig552h_Com_tiCurVehTmr_Rcf "" UWORD DFCDSQ_Verb 1 100 0.00 65535.0000000 FORMAT "%13.7" ECU_ADDRESS 0x600228E4 /end MEASUREMENT
/begin MEASUREMENT DINH_xWhy.FId_bInh_Sig583h_Com_stHvbDiscnctReas_Frz "" UWORD DFCDSQ_Verb 1 100 0.00 65535.0000000 FORMAT "%13.7" ECU_ADDRESS 0x600228E6 /end MEASUREMENT
/begin MEASUREMENT DINH_xWhy.FId_bInh_Sig583h_Com_stHvbDiscnctReas_Rcf "" UWORD DFCDSQ_Verb 1 100 0.00 65535.0000000 FORMAT "%13.7" ECU_ADDRESS 0x600228E8 /end MEASUREMENT
/begin MEASUREMENT DINH_xWhy.FId_bInh_Sig592h_Com_iBattEBS1Rx_Frz "" UWORD DFCDSQ_Verb 1 100 0.00 65535.0000000 FORMAT "%13.7" ECU_ADDRESS 0x600228EA /end MEASUREMENT
/begin MEASUREMENT DINH_xWhy.FId_bInh_Sig592h_Com_iBattEBS1Rx_Rcf "" UWORD DFCDSQ_Verb 1 100 0.00 65535.0000000 FORMAT "%13.7" ECU_ADDRESS 0x600228EC /end MEASUREMENT
/begin MEASUREMENT DINH_xWhy.FId_bInh_Sig592h_Com_iBattEBS2Rx_Frz "" UWORD DFCDSQ_Verb 1 100 0.00 65535.0000000 FORMAT "%13.7" ECU_ADDRESS 0x600228EE /end MEASUREMENT
/begin MEASUREMENT DINH_xWhy.FId_bInh_Sig592h_Com_iBattEBS2Rx_Rcf "" UWORD DFCDSQ_Verb 1 100 0.00 65535.0000000 FORMAT "%13.7" ECU_ADDRESS 0x600228F0 /end MEASUREMENT
/begin MEASUREMENT DINH_xWhy.FId_bInh_Sig592h_Com_iBattEBS3Rx_Frz "" UWORD DFCDSQ_Verb 1 100 0.00 65535.0000000 FORMAT "%13.7" ECU_ADDRESS 0x600228F2 /end MEASUREMENT
/begin MEASUREMENT DINH_xWhy.FId_bInh_Sig592h_Com_iBattEBS3Rx_Rcf "" UWORD DFCDSQ_Verb 1 100 0.00 65535.0000000 FORMAT "%13.7" ECU_ADDRESS 0x600228F4 /end MEASUREMENT
/begin MEASUREMENT DINH_xWhy.FId_bInh_Sig592h_Com_stIBattEBS_Frz "" UWORD DFCDSQ_Verb 1 100 0.00 65535.0000000 FORMAT "%13.7" ECU_ADDRESS 0x600228F6 /end MEASUREMENT
/begin MEASUREMENT DINH_xWhy.FId_bInh_Sig592h_Com_stIBattEBS_Rcf "" UWORD DFCDSQ_Verb 1 100 0.00 65535.0000000 FORMAT "%13.7" ECU_ADDRESS 0x600228F8 /end MEASUREMENT
/begin MEASUREMENT DINH_xWhy.FId_bInh_Sig592h_Com_tLvBatt_Frz "" UWORD DFCDSQ_Verb 1 100 0.00 65535.0000000 FORMAT "%13.7" ECU_ADDRESS 0x600228FA /end MEASUREMENT
/begin MEASUREMENT DINH_xWhy.FId_bInh_Sig592h_Com_tLvBatt_Rcf "" UWORD DFCDSQ_Verb 1 100 0.00 65535.0000000 FORMAT "%13.7" ECU_ADDRESS 0x600228FC /end MEASUREMENT
/begin MEASUREMENT DINH_xWhy.FId_bInh_Sig592h_Com_uBattEBSRx_Frz "" UWORD DFCDSQ_Verb 1 100 0.00 65535.0000000 FORMAT "%13.7" ECU_ADDRESS 0x600228FE /end MEASUREMENT
/begin MEASUREMENT DINH_xWhy.FId_bInh_Sig592h_Com_uBattEBSRx_Rcf "" UWORD DFCDSQ_Verb 1 100 0.00 65535.0000000 FORMAT "%13.7" ECU_ADDRESS 0x60022900 /end MEASUREMENT
/begin MEASUREMENT DINH_xWhy.FId_bInh_Sig595h_Com_tiHvbChrgnHalfRx_Frz "" UWORD DFCDSQ_Verb 1 100 0.00 65535.0000000 FORMAT "%13.7" ECU_ADDRESS 0x60022902 /end MEASUREMENT
/begin MEASUREMENT DINH_xWhy.FId_bInh_Sig595h_Com_tiHvbChrgnHalfRx_Rcf "" UWORD DFCDSQ_Verb 1 100 0.00 65535.0000000 FORMAT "%13.7" ECU_ADDRESS 0x60022904 /end MEASUREMENT
/begin MEASUREMENT DINH_xWhy.FId_bInh_Sig5B2h_Com_tEnvT_Frz "" UWORD DFCDSQ_Verb 1 100 0.00 65535.0000000 FORMAT "%13.7" ECU_ADDRESS 0x60022906 /end MEASUREMENT
/begin MEASUREMENT DINH_xWhy.FId_bInh_Sig5B2h_Com_tEnvT_Rcf "" UWORD DFCDSQ_Verb 1 100 0.00 65535.0000000 FORMAT "%13.7" ECU_ADDRESS 0x60022908 /end MEASUREMENT
/begin MEASUREMENT DINH_xWhy.FId_bInh_Sig5B5h_Com_stAlrtThermRunAwy_Frz "" UWORD DFCDSQ_Verb 1 100 0.00 65535.0000000 FORMAT "%13.7" ECU_ADDRESS 0x6002290A /end MEASUREMENT
/begin MEASUREMENT DINH_xWhy.FId_bInh_Sig5B5h_Com_stAlrtThermRunAwy_Rcf "" UWORD DFCDSQ_Verb 1 100 0.00 65535.0000000 FORMAT "%13.7" ECU_ADDRESS 0x6002290C /end MEASUREMENT
/begin MEASUREMENT DINH_xWhy.FId_bInh_Sig635h_Com_ctHvbNegCntctrSeg1_Frz "" UWORD DFCDSQ_Verb 1 100 0.00 65535.0000000 FORMAT "%13.7" ECU_ADDRESS 0x6002290E /end MEASUREMENT
/begin MEASUREMENT DINH_xWhy.FId_bInh_Sig635h_Com_ctHvbNegCntctrSeg1_Rcf "" UWORD DFCDSQ_Verb 1 100 0.00 65535.0000000 FORMAT "%13.7" ECU_ADDRESS 0x60022910 /end MEASUREMENT
/begin MEASUREMENT DINH_xWhy.FId_bInh_Sig635h_Com_ctHvbNegCntctrSeg3_Frz "" UWORD DFCDSQ_Verb 1 100 0.00 65535.0000000 FORMAT "%13.7" ECU_ADDRESS 0x60022912 /end MEASUREMENT
/begin MEASUREMENT DINH_xWhy.FId_bInh_Sig635h_Com_ctHvbNegCntctrSeg3_Rcf "" UWORD DFCDSQ_Verb 1 100 0.00 65535.0000000 FORMAT "%13.7" ECU_ADDRESS 0x60022914 /end MEASUREMENT
/begin MEASUREMENT DINH_xWhy.FId_bInh_Sig635h_Com_ctHvbNegCntctrSeg4_Frz "" UWORD DFCDSQ_Verb 1 100 0.00 65535.0000000 FORMAT "%13.7" ECU_ADDRESS 0x60022916 /end MEASUREMENT
/begin MEASUREMENT DINH_xWhy.FId_bInh_Sig635h_Com_ctHvbNegCntctrSeg4_Rcf "" UWORD DFCDSQ_Verb 1 100 0.00 65535.0000000 FORMAT "%13.7" ECU_ADDRESS 0x60022918 /end MEASUREMENT
/begin MEASUREMENT DINH_xWhy.FId_bInh_Sig635h_Com_ctHvbPosCntctrSeg1_Frz "" UWORD DFCDSQ_Verb 1 100 0.00 65535.0000000 FORMAT "%13.7" ECU_ADDRESS 0x6002291A /end MEASUREMENT
/begin MEASUREMENT DINH_xWhy.FId_bInh_Sig635h_Com_ctHvbPosCntctrSeg1_Rcf "" UWORD DFCDSQ_Verb 1 100 0.00 65535.0000000 FORMAT "%13.7" ECU_ADDRESS 0x6002291C /end MEASUREMENT
/begin MEASUREMENT DINH_xWhy.FId_bInh_Sig635h_Com_ctHvbPosCntctrSeg3_Frz "" UWORD DFCDSQ_Verb 1 100 0.00 65535.0000000 FORMAT "%13.7" ECU_ADDRESS 0x6002291E /end MEASUREMENT
/begin MEASUREMENT DINH_xWhy.FId_bInh_Sig635h_Com_ctHvbPosCntctrSeg3_Rcf "" UWORD DFCDSQ_Verb 1 100 0.00 65535.0000000 FORMAT "%13.7" ECU_ADDRESS 0x60022920 /end MEASUREMENT
/begin MEASUREMENT DINH_xWhy.FId_bInh_Sig635h_Com_ctHvbPosCntctrSeg4_Frz "" UWORD DFCDSQ_Verb 1 100 0.00 65535.0000000 FORMAT "%13.7" ECU_ADDRESS 0x60022922 /end MEASUREMENT
/begin MEASUREMENT DINH_xWhy.FId_bInh_Sig635h_Com_ctHvbPosCntctrSeg4_Rcf "" UWORD DFCDSQ_Verb 1 100 0.00 65535.0000000 FORMAT "%13.7" ECU_ADDRESS 0x60022924 /end MEASUREMENT
/begin MEASUREMENT DINH_xWhy.FId_bInh_Sig645h_Com_ctHvbPrecCntctrSeg1_Frz "" UWORD DFCDSQ_Verb 1 100 0.00 65535.0000000 FORMAT "%13.7" ECU_ADDRESS 0x60022926 /end MEASUREMENT
/begin MEASUREMENT DINH_xWhy.FId_bInh_Sig645h_Com_ctHvbPrecCntctrSeg1_Rcf "" UWORD DFCDSQ_Verb 1 100 0.00 65535.0000000 FORMAT "%13.7" ECU_ADDRESS 0x60022928 /end MEASUREMENT
/begin MEASUREMENT DINH_xWhy.FId_bInh_Sig645h_Com_ctHvbPrecCntctrSeg2_Frz "" UWORD DFCDSQ_Verb 1 100 0.00 65535.0000000 FORMAT "%13.7" ECU_ADDRESS 0x6002292A /end MEASUREMENT
/begin MEASUREMENT DINH_xWhy.FId_bInh_Sig645h_Com_ctHvbPrecCntctrSeg2_Rcf "" UWORD DFCDSQ_Verb 1 100 0.00 65535.0000000 FORMAT "%13.7" ECU_ADDRESS 0x6002292C /end MEASUREMENT
/begin MEASUREMENT DINH_xWhy.FId_bInh_Sig675h_Com_qHvbTotCpRx_Frz "" UWORD DFCDSQ_Verb 1 100 0.00 65535.0000000 FORMAT "%13.7" ECU_ADDRESS 0x6002292E /end MEASUREMENT
/begin MEASUREMENT DINH_xWhy.FId_bInh_Sig675h_Com_qHvbTotCpRx_Rcf "" UWORD DFCDSQ_Verb 1 100 0.00 65535.0000000 FORMAT "%13.7" ECU_ADDRESS 0x60022930 /end MEASUREMENT
/begin MEASUREMENT DINH_xWhy.FId_bInh_Sig_ComEmac_flgImobAuthent_Sq_Frz "" UWORD DFCDSQ_Verb 1 100 0.00 65535.0000000 FORMAT "%13.7" ECU_ADDRESS 0x60022932 /end MEASUREMENT
/begin MEASUREMENT DINH_xWhy.FId_bInh_Sig_ComEmac_stIsoMonSwtAck_Sq_Frz "" UWORD DFCDSQ_Verb 1 100 0.00 65535.0000000 FORMAT "%13.7" ECU_ADDRESS 0x60022934 /end MEASUREMENT
/begin MEASUREMENT DINH_xWhy.FId_bInh_Sig_ComEmac_stPwrAuthn_Sq_Frz "" UWORD DFCDSQ_Verb 1 100 0.00 65535.0000000 FORMAT "%13.7" ECU_ADDRESS 0x60022936 /end MEASUREMENT
/begin MEASUREMENT DINH_xWhy.FId_bInh_Sig_Com_flgEcoNormReq_Frz "" UWORD DFCDSQ_Verb 1 100 0.00 65535.0000000 FORMAT "%13.7" ECU_ADDRESS 0x60022938 /end MEASUREMENT
/begin MEASUREMENT DINH_xWhy.FId_bInh_Sig_Com_pwrMaxChrgSho_Sq_Frz "" UWORD DFCDSQ_Verb 1 100 0.00 65535.0000000 FORMAT "%13.7" ECU_ADDRESS 0x6002293A /end MEASUREMENT
/begin MEASUREMENT DINH_xWhy.FId_bInh_Sig_Com_pwrMaxDchaSho_Sq_Frz "" UWORD DFCDSQ_Verb 1 100 0.00 65535.0000000 FORMAT "%13.7" ECU_ADDRESS 0x6002293C /end MEASUREMENT
/begin MEASUREMENT DINH_xWhy.FId_bInh_Sig_Com_stDcdcULimReq_Sq_Frz "" UWORD DFCDSQ_Verb 1 100 0.00 65535.0000000 FORMAT "%13.7" ECU_ADDRESS 0x6002293E /end MEASUREMENT
/begin MEASUREMENT DINH_xWhy.FId_bInh_Sig_Com_stGearLvrPos_Frz "" UWORD DFCDSQ_Verb 1 100 0.00 65535.0000000 FORMAT "%13.7" ECU_ADDRESS 0x60022940 /end MEASUREMENT
/begin MEASUREMENT DINH_xWhy.FId_bInh_Sig_Com_stIgnkeyPos_Sq_Frz "" UWORD DFCDSQ_Verb 1 100 0.00 65535.0000000 FORMAT "%13.7" ECU_ADDRESS 0x60022942 /end MEASUREMENT
/begin MEASUREMENT DINH_xWhy.FId_bInh_ThermHvac_stRemPrecndn "" UWORD DFCDSQ_Verb 1 100 0.00 65535.0000000 FORMAT "%13.7" ECU_ADDRESS 0x60022944 /end MEASUREMENT
/begin MEASUREMENT DINH_xWhy.FId_bInh_VehCoorn_dstRngPrdcDispTx "" UWORD DFCDSQ_Verb 1 100 0.00 65535.0000000 FORMAT "%13.7" ECU_ADDRESS 0x60022946 /end MEASUREMENT
/begin MEASUREMENT DINH_xWhy.FId_bInh_VehCoorn_wCnsTotWghtAvrgEffTripA "" UWORD DFCDSQ_Verb 1 100 0.00 65535.0000000 FORMAT "%13.7" ECU_ADDRESS 0x60022948 /end MEASUREMENT
/begin MEASUREMENT DINH_xWhy.FId_bInh_VehCoorn_wCnsTotWghtAvrgEffTripB "" UWORD DFCDSQ_Verb 1 100 0.00 65535.0000000 FORMAT "%13.7" ECU_ADDRESS 0x6002294A /end MEASUREMENT
/begin MEASUREMENT DINH_xWhy.FId_bInh_VehCoorn_wCnsTotWghtAvrgEffTx "" UWORD DFCDSQ_Verb 1 100 0.00 65535.0000000 FORMAT "%13.7" ECU_ADDRESS 0x6002294C /end MEASUREMENT
/begin MEASUREMENT DINH_xWhy.FId_bInh_VehCoorn_wCnsTotWghtTripAvrgEffTx "" UWORD DFCDSQ_Verb 1 100 0.00 65535.0000000 FORMAT "%13.7" ECU_ADDRESS 0x6002294E /end MEASUREMENT
/begin MEASUREMENT DINH_xWhy.FId_bInh_VehCoorn_wCnsWghtAvrgEffTripA "" UWORD DFCDSQ_Verb 1 100 0.00 65535.0000000 FORMAT "%13.7" ECU_ADDRESS 0x60022950 /end MEASUREMENT
/begin MEASUREMENT DINH_xWhy.FId_bInh_VehCoorn_wCnsWghtAvrgEffTripB "" UWORD DFCDSQ_Verb 1 100 0.00 65535.0000000 FORMAT "%13.7" ECU_ADDRESS 0x60022952 /end MEASUREMENT
/begin MEASUREMENT DINH_xWhy.FId_binnh_Sig_ComEmac_flgEmgyShtDwnReq01_Sq_Frz "" UWORD DFCDSQ_Verb 1 100 0.00 65535.0000000 FORMAT "%13.7" ECU_ADDRESS 0x60022954 /end MEASUREMENT
/begin MEASUREMENT DINH_xWhy.FId_binnh_Sig_ComEmac_flgImobAuthent_Sq_Frz "" UWORD DFCDSQ_Verb 1 100 0.00 65535.0000000 FORMAT "%13.7" ECU_ADDRESS 0x60022956 /end MEASUREMENT
/begin MEASUREMENT DINH_xWhy.FId_binnh_Sig_ComEmac_iDcLnk01_Sq_Frz "" UWORD DFCDSQ_Verb 1 100 0.00 65535.0000000 FORMAT "%13.7" ECU_ADDRESS 0x60022958 /end MEASUREMENT
/begin MEASUREMENT DINH_xWhy.FId_binnh_Sig_ComEmac_nAct01_Sq_Frz "" UWORD DFCDSQ_Verb 1 100 0.00 65535.0000000 FORMAT "%13.7" ECU_ADDRESS 0x6002295A /end MEASUREMENT
/begin MEASUREMENT DINH_xWhy.FId_binnh_Sig_ComEmac_stActvDcha_Sq_Frz "" UWORD DFCDSQ_Verb 1 100 0.00 65535.0000000 FORMAT "%13.7" ECU_ADDRESS 0x6002295C /end MEASUREMENT
/begin MEASUREMENT DINH_xWhy.FId_binnh_Sig_ComEmac_stIsoMonSwtAck_Sq_Frz "" UWORD DFCDSQ_Verb 1 100 0.00 65535.0000000 FORMAT "%13.7" ECU_ADDRESS 0x6002295E /end MEASUREMENT
/begin MEASUREMENT DINH_xWhy.FId_binnh_Sig_ComEmac_stMod01_Sq_Frz "" UWORD DFCDSQ_Verb 1 100 0.00 65535.0000000 FORMAT "%13.7" ECU_ADDRESS 0x60022960 /end MEASUREMENT
/begin MEASUREMENT DINH_xWhy.FId_binnh_Sig_ComEmac_stPwrAuthn_Sq_Frz "" UWORD DFCDSQ_Verb 1 100 0.00 65535.0000000 FORMAT "%13.7" ECU_ADDRESS 0x60022962 /end MEASUREMENT
/begin MEASUREMENT DINH_xWhy.FId_binnh_Sig_ComEmac_tInvr01_Sq_Frz "" UWORD DFCDSQ_Verb 1 100 0.00 65535.0000000 FORMAT "%13.7" ECU_ADDRESS 0x60022964 /end MEASUREMENT
/begin MEASUREMENT DINH_xWhy.FId_binnh_Sig_ComEmac_tMac01_Sq_Frz "" UWORD DFCDSQ_Verb 1 100 0.00 65535.0000000 FORMAT "%13.7" ECU_ADDRESS 0x60022966 /end MEASUREMENT
/begin MEASUREMENT DINH_xWhy.FId_binnh_Sig_ComEmac_tqAbsltMax01_Sq_Frz "" UWORD DFCDSQ_Verb 1 100 0.00 65535.0000000 FORMAT "%13.7" ECU_ADDRESS 0x60022968 /end MEASUREMENT
/begin MEASUREMENT DINH_xWhy.FId_binnh_Sig_ComEmac_tqAbsltMin01_Sq_Frz "" UWORD DFCDSQ_Verb 1 100 0.00 65535.0000000 FORMAT "%13.7" ECU_ADDRESS 0x6002296A /end MEASUREMENT
/begin MEASUREMENT DINH_xWhy.FId_binnh_Sig_ComEmac_tqAct01_Sq_Frz "" UWORD DFCDSQ_Verb 1 100 0.00 65535.0000000 FORMAT "%13.7" ECU_ADDRESS 0x6002296C /end MEASUREMENT
/begin MEASUREMENT DINH_xWhy.FId_binnh_Sig_ComEmac_uDcLnk01_sq_Frz "" UWORD DFCDSQ_Verb 1 100 0.00 65535.0000000 FORMAT "%13.7" ECU_ADDRESS 0x6002296E /end MEASUREMENT
/begin MEASUREMENT DINH_xWhy.FId_binnh_Sig_Com_egyHvbAvl_Sq_Frz "" UWORD DFCDSQ_Verb 1 100 0.00 65535.0000000 FORMAT "%13.7" ECU_ADDRESS 0x60022970 /end MEASUREMENT
/begin MEASUREMENT DINH_xWhy.FId_binnh_Sig_Com_iHvbAct_Sq_Frz "" UWORD DFCDSQ_Verb 1 100 0.00 65535.0000000 FORMAT "%13.7" ECU_ADDRESS 0x60022972 /end MEASUREMENT
/begin MEASUREMENT DINH_xWhy.FId_binnh_Sig_Com_iHvbChrgMaxSho_Sq_Frz "" UWORD DFCDSQ_Verb 1 100 0.00 65535.0000000 FORMAT "%13.7" ECU_ADDRESS 0x60022974 /end MEASUREMENT
/begin MEASUREMENT DINH_xWhy.FId_binnh_Sig_Com_iHvbDchaMaxSho_Sq_Frz "" UWORD DFCDSQ_Verb 1 100 0.00 65535.0000000 FORMAT "%13.7" ECU_ADDRESS 0x60022976 /end MEASUREMENT
/begin MEASUREMENT DINH_xWhy.FId_binnh_Sig_Com_iHvbDes_Sq_Frz "" UWORD DFCDSQ_Verb 1 100 0.00 65535.0000000 FORMAT "%13.7" ECU_ADDRESS 0x60022978 /end MEASUREMENT
/begin MEASUREMENT DINH_xWhy.FId_binnh_Sig_Com_pwrDcdcOutpCpby_Sq_Frz "" UWORD DFCDSQ_Verb 1 100 0.00 65535.0000000 FORMAT "%13.7" ECU_ADDRESS 0x6002297A /end MEASUREMENT
/begin MEASUREMENT DINH_xWhy.FId_binnh_Sig_Com_rHvbIsoMeasmt_Sq_Frz "" UWORD DFCDSQ_Verb 1 100 0.00 65535.0000000 FORMAT "%13.7" ECU_ADDRESS 0x6002297C /end MEASUREMENT
/begin MEASUREMENT DINH_xWhy.FId_binnh_Sig_Com_ratHvbSoc_Sq_Frz "" UWORD DFCDSQ_Verb 1 100 0.00 65535.0000000 FORMAT "%13.7" ECU_ADDRESS 0x6002297E /end MEASUREMENT
/begin MEASUREMENT DINH_xWhy.FId_binnh_Sig_Com_stDcdcULimReq_Sq_Frz "" UWORD DFCDSQ_Verb 1 100 0.00 65535.0000000 FORMAT "%13.7" ECU_ADDRESS 0x60022980 /end MEASUREMENT
/begin MEASUREMENT DINH_xWhy.FId_binnh_Sig_Com_stHvbCntct_Sq_Frz "" UWORD DFCDSQ_Verb 1 100 0.00 65535.0000000 FORMAT "%13.7" ECU_ADDRESS 0x60022982 /end MEASUREMENT
/begin MEASUREMENT DINH_xWhy.FId_binnh_Sig_Com_stHvbDernMaxT_Sq_Frz "" UWORD DFCDSQ_Verb 1 100 0.00 65535.0000000 FORMAT "%13.7" ECU_ADDRESS 0x60022984 /end MEASUREMENT
/begin MEASUREMENT DINH_xWhy.FId_binnh_Sig_Com_stHvbDernMinT_Sq_Frz "" UWORD DFCDSQ_Verb 1 100 0.00 65535.0000000 FORMAT "%13.7" ECU_ADDRESS 0x60022986 /end MEASUREMENT
/begin MEASUREMENT DINH_xWhy.FId_binnh_Sig_Com_stHvbFlt_Sq_Frz "" UWORD DFCDSQ_Verb 1 100 0.00 65535.0000000 FORMAT "%13.7" ECU_ADDRESS 0x60022988 /end MEASUREMENT
/begin MEASUREMENT DINH_xWhy.FId_binnh_Sig_Com_stHvbIntlck_Sq_Frz "" UWORD DFCDSQ_Verb 1 100 0.00 65535.0000000 FORMAT "%13.7" ECU_ADDRESS 0x6002298A /end MEASUREMENT
/begin MEASUREMENT DINH_xWhy.FId_binnh_Sig_Com_stHvbIsoFlt_Sq_Frz "" UWORD DFCDSQ_Verb 1 100 0.00 65535.0000000 FORMAT "%13.7" ECU_ADDRESS 0x6002298C /end MEASUREMENT
/begin MEASUREMENT DINH_xWhy.FId_binnh_Sig_Com_stHvbMod_Sq_Frz "" UWORD DFCDSQ_Verb 1 100 0.00 65535.0000000 FORMAT "%13.7" ECU_ADDRESS 0x6002298E /end MEASUREMENT
/begin MEASUREMENT DINH_xWhy.FId_binnh_Sig_Com_stHvbSrvPlg_Sq_Frz "" UWORD DFCDSQ_Verb 1 100 0.00 65535.0000000 FORMAT "%13.7" ECU_ADDRESS 0x60022990 /end MEASUREMENT
/begin MEASUREMENT DINH_xWhy.FId_binnh_Sig_Com_tHvbAct_Sq_Frz "" UWORD DFCDSQ_Verb 1 100 0.00 65535.0000000 FORMAT "%13.7" ECU_ADDRESS 0x60022992 /end MEASUREMENT
/begin MEASUREMENT DINH_xWhy.FId_binnh_Sig_Com_uElCmprHvAct_Sq_Frz "" UWORD DFCDSQ_Verb 1 100 0.00 65535.0000000 FORMAT "%13.7" ECU_ADDRESS 0x60022994 /end MEASUREMENT
/begin MEASUREMENT DINH_xWhy.FId_binnh_Sig_Com_uHvbAct_Sq_Frz "" UWORD DFCDSQ_Verb 1 100 0.00 65535.0000000 FORMAT "%13.7" ECU_ADDRESS 0x60022996 /end MEASUREMENT
/begin MEASUREMENT DINH_xWhy.FId_binnh_Sig_Com_uHvbDcBus_Sq_Frz "" UWORD DFCDSQ_Verb 1 100 0.00 65535.0000000 FORMAT "%13.7" ECU_ADDRESS 0x60022998 /end MEASUREMENT
/begin MEASUREMENT DINH_xWhy.FId_binnh_Sig_Com_uHvbLimHi_Sq_Frz "" UWORD DFCDSQ_Verb 1 100 0.00 65535.0000000 FORMAT "%13.7" ECU_ADDRESS 0x6002299A /end MEASUREMENT
/begin MEASUREMENT DINH_xWhy.FId_binnh_Sig_Com_uHvbNomChrgn_Sq_Frz "" UWORD DFCDSQ_Verb 1 100 0.00 65535.0000000 FORMAT "%13.7" ECU_ADDRESS 0x6002299C /end MEASUREMENT
/begin FUNCTION DINH "30000.25.0Diagnostic Inhibit Handler"
 /begin LOC_MEASUREMENT DINH_xWhy.FId_bInhComGw_Com_PEM_ENGINE_RPM DINH_xWhy.FId_bInhComGw_Com_PEM_ESTIM_TRQ DINH_xWhy.FId_bInhComGw_Com_PEM_INVERTER_TEMP DINH_xWhy.FId_bInhComGw_Com_PEM_INVERTOR_ALERT_TEMP DINH_xWhy.FId_bInhComGw_Com_PEM_OVERTEMP_FAILURE DINH_xWhy.FId_bInhComGw_Com_PEM_STATOR_TEMP DINH_xWhy.FId_bInhComGw_Com_VITESSE_VEHICULE_ROUES DINH_xWhy.FId_bInhComGw_Com_VVH_INDISP DINH_xWhy.FId_bInhComGw_Com_eCOMP_Power_consumption DINH_xWhy.FId_bInhComGw_MAIN_RELAY_ACTUATION_COUNTER DINH_xWhy.FId_bInhComGw_TIME_HV_BATT_OVER_TEMPERATURE DINH_xWhy.FId_bInhComGw_TOTAL_HV_BATT_POS_QTY_CURR DINH_xWhy.FId_bInhDiag_CLUSTER_5E7 DINH_xWhy.FId_bInhDiag_CONTEXTE_1_5B2 DINH_xWhy.FId_bInhDiag_DAT3_BSI_4F2h DINH_xWhy.FId_bInhDiag_DCDC_283h DINH_xWhy.FId_bInhDiag_DCDC_293h DINH_xWhy.FId_bInhDiag_DCDC_473h DINH_xWhy.FId_bInhDiag_DCDC_663h DINH_xWhy.FId_bInhDiag_HS3_AUTO_GEARBOX_SWITCH_STATUS DINH_xWhy.FId_bInhDiag_HVAC_PANEL_26h DINH_xWhy.FId_bInhDiag_HVBAT_205h DINH_xWhy.FId_bInhDiag_HVBAT_275h DINH_xWhy.FId_bInhDiag_HVBAT_285h DINH_xWhy.FId_bInhDiag_HVBAT_325h DINH_xWhy.FId_bInhDiag_HVBAT_335h DINH_xWhy.FId_bInhDiag_HVBAT_455h DINH_xWhy.FId_bInhDiag_HVBAT_535 DINH_xWhy.FId_bInhDiag_HVBAT_595h DINH_xWhy.FId_bInhDiag_HVBAT_635h DINH_xWhy.FId_bInhDiag_HVBAT_645h DINH_xWhy.FId_bInhDiag_HVBAT_665h DINH_xWhy.FId_bInhDiag_HVBAT_675h DINH_xWhy.FId_bInhDiag_HVBAT_THERMAL_5B5 DINH_xWhy.FId_bInhDiag_HVBAT_VCU_435h DINH_xWhy.FId_bInhDiag_HVBAT_VCU_543 DINH_xWhy.FId_bInhDiag_HVBAT_VCU_583 DINH_xWhy.FId_bInhDiag_INV_217h DINH_xWhy.FId_bInhDiag_INV_227h DINH_xWhy.FId_bInhDiag_INV_237 DINH_xWhy.FId_bInhDiag_INV_427h DINH_xWhy.FId_bInhDiag_INV_497h DINH_xWhy.FId_bInhDiag_INV_IMMO_5C7 DINH_xWhy.FId_bInhDiag_IS_DAT6_BSI_592h DINH_xWhy.FId_bInhDiag_IS_DAT_ABR_50Dh DINH_xWhy.FId_bInhDiag_IS_DAT_BSI_412h DINH_xWhy.FId_bInhDiag_IS_DYN_ABR_38Dh DINH_xWhy.FId_bInhDiag_IS_INTE_ELECTRON_BSI_092h DINH_xWhy.FId_bInhDiag_OBC_273h DINH_xWhy.FId_bInhDiag_OBC_453h DINH_xWhy.FId_bInhDiag_OBC_463h DINH_xWhy.FId_bInhDiag_PDU_BusVoltages_308 DINH_xWhy.FId_bInhDiag_PDU_Current_318 DINH_xWhy.FId_bInhDiag_SC_INFO_BCCM_442h DINH_xWhy.FId_bInhDiag_VCU_AIRBAG_351h DINH_xWhy.FId_bInhDiag_VCU_eBCCM_432h DINH_xWhy.FId_bInhDiag_VCU_eBCCM_552h DINH_xWhy.FId_bInhDiag_eBCCM_082h DINH_xWhy.FId_bInhDiag_eCOMP_Information_47B DINH_xWhy.FId_bInhDiag_eCOMP_Information_48B DINH_xWhy.FId_bInhFrbd_ComChrgr_iAcMax DINH_xWhy.FId_bInhFrbd_ComChrgr_iDcHvAct DINH_xWhy.FId_bInhFrbd_ComChrgr_pwrInAct DINH_xWhy.FId_bInhFrbd_ComChrgr_pwrOutpCpby DINH_xWhy.FId_bInhFrbd_ComChrgr_tChrgrMaxAct DINH_xWhy.FId_bInhFrbd_ComChrgr_uAcActL1 DINH_xWhy.FId_bInhFrbd_ComChrgr_uDcHvAct DINH_xWhy.FId_bInhFrbd_ComEmac_iDcLnk01 DINH_xWhy.FId_bInhFrbd_ComEmac_nAct01 DINH_xWhy.FId_bInhFrbd_ComEmac_pwrInstnsInpRx DINH_xWhy.FId_bInhFrbd_ComEmac_stActvDcha DINH_xWhy.FId_bInhFrbd_ComEmac_stEVLmp DINH_xWhy.FId_bInhFrbd_ComEmac_stIvtrOpMod01 DINH_xWhy.FId_bInhFrbd_ComEmac_stMod01Rx DINH_xWhy.FId_bInhFrbd_ComEmac_stMstWrnLmp DINH_xWhy.FId_bInhFrbd_ComEmac_stSVSLmp DINH_xWhy.FId_bInhFrbd_ComEmac_tqAbsltMax01 DINH_xWhy.FId_bInhFrbd_ComEmac_tqAbsltMaxRx01 DINH_xWhy.FId_bInhFrbd_ComEmac_tqAbsltMin01 DINH_xWhy.FId_bInhFrbd_ComEmac_tqAbsltMinRx01 DINH_xWhy.FId_bInhFrbd_ComEmac_tqAckd01 DINH_xWhy.FId_bInhFrbd_ComEmac_tqAct01 DINH_xWhy.FId_bInhFrbd_ComEmac_tqPtd01 DINH_xWhy.FId_bInhFrbd_ComEmac_tqStabnMin DINH_xWhy.FId_bInhFrbd_ComEmac_uDcLnk01 DINH_xWhy.FId_bInhFrbd_Com_HvbMaxSnsrTempRx DINH_xWhy.FId_bInhFrbd_Com_ctHvbNegCntctrSeg1 DINH_xWhy.FId_bInhFrbd_Com_ctHvbNegCntctrSeg3 DINH_xWhy.FId_bInhFrbd_Com_ctHvbNegCntctrSeg4 DINH_xWhy.FId_bInhFrbd_Com_ctHvbPosCntctrSeg1 DINH_xWhy.FId_bInhFrbd_Com_ctHvbPosCntctrSeg3 DINH_xWhy.FId_bInhFrbd_Com_ctHvbPosCntctrSeg4 DINH_xWhy.FId_bInhFrbd_Com_ctHvbPrecCntctrSeg1 DINH_xWhy.FId_bInhFrbd_Com_ctHvbPrecCntctrSeg2 DINH_xWhy.FId_bInhFrbd_Com_egyHvbAvl_fRx DINH_xWhy.FId_bInhFrbd_Com_flgEcoNormReqRx DINH_xWhy.FId_bInhFrbd_Com_iBattEBS1Rx DINH_xWhy.FId_bInhFrbd_Com_iBattEBS2Rx DINH_xWhy.FId_bInhFrbd_Com_iBattEBS3Rx DINH_xWhy.FId_bInhFrbd_Com_iDcdcHvActRvsn1 DINH_xWhy.FId_bInhFrbd_Com_iDcdcLvActRvsn1 DINH_xWhy.FId_bInhFrbd_Com_iElCmprHvAct DINH_xWhy.FId_bInhFrbd_Com_iElCmprPeakPha DINH_xWhy.FId_bInhFrbd_Com_iHvbActRx DINH_xWhy.FId_bInhFrbd_Com_iHvbChrgMaxSho DINH_xWhy.FId_bInhFrbd_Com_iHvbDchaMaxSho DINH_xWhy.FId_bInhFrbd_Com_iHvbDes DINH_xWhy.FId_bInhFrbd_Com_iHvbNomChrgn DINH_xWhy.FId_bInhFrbd_Com_nElCmprActl DINH_xWhy.FId_bInhFrbd_Com_nrSerMaxCell DINH_xWhy.FId_bInhFrbd_Com_nrSerMinCell DINH_xWhy.FId_bInhFrbd_Com_pwrDcdcOutpCpby DINH_xWhy.FId_bInhFrbd_Com_pwrElCmprActl DINH_xWhy.FId_bInhFrbd_Com_pwrMaxChrgSho DINH_xWhy.FId_bInhFrbd_Com_pwrMaxDchaSho DINH_xWhy.FId_bInhFrbd_Com_qHvbTotCpRx DINH_xWhy.FId_bInhFrbd_Com_rHvbIsoMeasmt DINH_xWhy.FId_bInhFrbd_Com_ratHvbSoc DINH_xWhy.FId_bInhFrbd_Com_ratHvbSoh DINH_xWhy.FId_bInhFrbd_Com_ratRHvbSoh DINH_xWhy.FId_bInhFrbd_Com_ratSocLvBatt DINH_xWhy.FId_bInhFrbd_Com_stElCmprFltLvl DINH_xWhy.FId_bInhFrbd_Com_stGearLvrPos DINH_xWhy.FId_bInhFrbd_Com_stIIvtrFltLvl01 DINH_xWhy.FId_bInhFrbd_Com_steTogFailrLvl DINH_xWhy.FId_bInhFrbd_Com_tDcdcAct DINH_xWhy.FId_bInhFrbd_Com_tDcdcInltCoolt DINH_xWhy.FId_bInhFrbd_Com_tElCmprActl DINH_xWhy.FId_bInhFrbd_Com_tEnvT DINH_xWhy.FId_bInhFrbd_Com_tHvbAct DINH_xWhy.FId_bInhFrbd_Com_tHvbMax DINH_xWhy.FId_bInhFrbd_Com_tLvBatt DINH_xWhy.FId_bInhFrbd_Com_tiHvbChrgnHalfRx DINH_xWhy.FId_bInhFrbd_Com_uBattEBSRx DINH_xWhy.FId_bInhFrbd_Com_uDcdcHvAct DINH_xWhy.FId_bInhFrbd_Com_uDcdcLvAct DINH_xWhy.FId_bInhFrbd_Com_uElCmprHvAct DINH_xWhy.FId_bInhFrbd_Com_uHvbAct DINH_xWhy.FId_bInhFrbd_Com_uHvbDcBus DINH_xWhy.FId_bInhFrbd_Com_uHvbLimHi DINH_xWhy.FId_bInhFrbd_Com_uHvbMaxCell DINH_xWhy.FId_bInhFrbd_Com_uHvbMinCell DINH_xWhy.FId_bInhFrbd_Com_uHvbNomChrgn DINH_xWhy.FId_bInhInvld_ComChrgr_flgChrgrErrLvl DINH_xWhy.FId_bInhInvld_ComChrgr_iAcMax DINH_xWhy.FId_bInhInvld_ComChrgr_iDcHvAct DINH_xWhy.FId_bInhInvld_ComChrgr_pwrInAct DINH_xWhy.FId_bInhInvld_ComChrgr_pwrOutpCpby DINH_xWhy.FId_bInhInvld_ComChrgr_tChrgrMaxAct DINH_xWhy.FId_bInhInvld_ComChrgr_uAcActL1 DINH_xWhy.FId_bInhInvld_ComChrgr_uDcHvAct DINH_xWhy.FId_bInhInvld_ComEmac_iDcLnk01 DINH_xWhy.FId_bInhInvld_ComEmac_nAct01 DINH_xWhy.FId_bInhInvld_ComEmac_pwrInstnsInpRx DINH_xWhy.FId_bInhInvld_ComEmac_stActvDcha DINH_xWhy.FId_bInhInvld_ComEmac_stIvtrOpMod01 DINH_xWhy.FId_bInhInvld_ComEmac_tInvr01 DINH_xWhy.FId_bInhInvld_ComEmac_tIvtrCooltIn01 DINH_xWhy.FId_bInhInvld_ComEmac_tMac01 DINH_xWhy.FId_bInhInvld_ComEmac_tqAbsltMax01 DINH_xWhy.FId_bInhInvld_ComEmac_tqAbsltMaxRx01 DINH_xWhy.FId_bInhInvld_ComEmac_tqAbsltMin01 DINH_xWhy.FId_bInhInvld_ComEmac_tqAbsltMinRx01 DINH_xWhy.FId_bInhInvld_ComEmac_tqAckd01 DINH_xWhy.FId_bInhInvld_ComEmac_tqAct01 DINH_xWhy.FId_bInhInvld_ComEmac_tqPtd01 DINH_xWhy.FId_bInhInvld_ComEmac_tqStabnMin DINH_xWhy.FId_bInhInvld_ComEmac_uDcLnk01 DINH_xWhy.FId_bInhInvld_Com_HvbMaxSnsrTempRx DINH_xWhy.FId_bInhInvld_Com_ctHvbNegCntctrSeg1 DINH_xWhy.FId_bInhInvld_Com_ctHvbNegCntctrSeg3 DINH_xWhy.FId_bInhInvld_Com_ctHvbNegCntctrSeg4 DINH_xWhy.FId_bInhInvld_Com_ctHvbPosCntctrSeg1 DINH_xWhy.FId_bInhInvld_Com_ctHvbPosCntctrSeg3 DINH_xWhy.FId_bInhInvld_Com_ctHvbPosCntctrSeg4 DINH_xWhy.FId_bInhInvld_Com_ctHvbPrecCntctrSeg1 DINH_xWhy.FId_bInhInvld_Com_ctHvbPrecCntctrSeg2 DINH_xWhy.FId_bInhInvld_Com_egyHvbAvl_fRx DINH_xWhy.FId_bInhInvld_Com_flgEcoNormReqRx DINH_xWhy.FId_bInhInvld_Com_flgVehSpdAvl DINH_xWhy.FId_bInhInvld_Com_iBattEBS1Rx DINH_xWhy.FId_bInhInvld_Com_iBattEBS2Rx DINH_xWhy.FId_bInhInvld_Com_iBattEBS3Rx DINH_xWhy.FId_bInhInvld_Com_iDcdcHvActRvsn1 DINH_xWhy.FId_bInhInvld_Com_iDcdcLvActRvsn1 DINH_xWhy.FId_bInhInvld_Com_iElCmprHvAct DINH_xWhy.FId_bInhInvld_Com_iElCmprPeakPha DINH_xWhy.FId_bInhInvld_Com_iHvbActRx DINH_xWhy.FId_bInhInvld_Com_iHvbChrgMaxSho DINH_xWhy.FId_bInhInvld_Com_iHvbDchaMaxSho DINH_xWhy.FId_bInhInvld_Com_iHvbDes DINH_xWhy.FId_bInhInvld_Com_iHvbNomChrgn DINH_xWhy.FId_bInhInvld_Com_lDstGlbDa DINH_xWhy.FId_bInhInvld_Com_lTotOdometer DINH_xWhy.FId_bInhInvld_Com_nElCmprActl DINH_xWhy.FId_bInhInvld_Com_nrSerMaxCell DINH_xWhy.FId_bInhInvld_Com_nrSerMinCell DINH_xWhy.FId_bInhInvld_Com_pwrDcdcOutpCpby DINH_xWhy.FId_bInhInvld_Com_pwrElCmprActl DINH_xWhy.FId_bInhInvld_Com_pwrMaxChrgSho DINH_xWhy.FId_bInhInvld_Com_pwrMaxDchaSho DINH_xWhy.FId_bInhInvld_Com_qHvbTotCpRx DINH_xWhy.FId_bInhInvld_Com_rHvbIsoMeasmt DINH_xWhy.FId_bInhInvld_Com_ratHvbSoc DINH_xWhy.FId_bInhInvld_Com_ratHvbSoh DINH_xWhy.FId_bInhInvld_Com_ratRHvbSoh DINH_xWhy.FId_bInhInvld_Com_ratSocLvBatt DINH_xWhy.FId_bInhInvld_Com_stAC DINH_xWhy.FId_bInhInvld_Com_stAlrtThermRunAwy DINH_xWhy.FId_bInhInvld_Com_stBlowrRly DINH_xWhy.FId_bInhInvld_Com_stDcdcFltLvl DINH_xWhy.FId_bInhInvld_Com_stEvapTFlt DINH_xWhy.FId_bInhInvld_Com_stGearLvrPos DINH_xWhy.FId_bInhInvld_Com_stHvacBlwrFront DINH_xWhy.FId_bInhInvld_Com_stHvacKnobPosn DINH_xWhy.FId_bInhInvld_Com_stHvacPanPotiFlt DINH_xWhy.FId_bInhInvld_Com_stHvbChrgn DINH_xWhy.FId_bInhInvld_Com_stHvbDiscnctReas DINH_xWhy.FId_bInhInvld_Com_stHvbIntlckRx DINH_xWhy.FId_bInhInvld_Com_stHvbIsoFltRx DINH_xWhy.FId_bInhInvld_Com_stHvbSrvPlgRx DINH_xWhy.FId_bInhInvld_Com_stIBattEBS DINH_xWhy.FId_bInhInvld_Com_stIIvtrFltLvl01 DINH_xWhy.FId_bInhInvld_Com_stMainWkuReq DINH_xWhy.FId_bInhInvld_Com_stReFogReq DINH_xWhy.FId_bInhInvld_Com_stSocRx DINH_xWhy.FId_bInhInvld_Com_stT DINH_xWhy.FId_bInhInvld_Com_tDcdcAct DINH_xWhy.FId_bInhInvld_Com_tDcdcInltCoolt DINH_xWhy.FId_bInhInvld_Com_tElCmprActl DINH_xWhy.FId_bInhInvld_Com_tEnvT DINH_xWhy.FId_bInhInvld_Com_tEvapT DINH_xWhy.FId_bInhInvld_Com_tHvbAct DINH_xWhy.FId_bInhInvld_Com_tHvbMax DINH_xWhy.FId_bInhInvld_Com_tLvBatt DINH_xWhy.FId_bInhInvld_Com_tiCurVehTmr DINH_xWhy.FId_bInhInvld_Com_tiHvbChrgnHalfRx DINH_xWhy.FId_bInhInvld_Com_uBattEBSRx DINH_xWhy.FId_bInhInvld_Com_uDcdcHvAct DINH_xWhy.FId_bInhInvld_Com_uDcdcLvAct DINH_xWhy.FId_bInhInvld_Com_uElCmprHvAct DINH_xWhy.FId_bInhInvld_Com_uHvbAct DINH_xWhy.FId_bInhInvld_Com_uHvbDcBus DINH_xWhy.FId_bInhInvld_Com_uHvbLimHi DINH_xWhy.FId_bInhInvld_Com_uHvbMaxCell DINH_xWhy.FId_bInhInvld_Com_uHvbMinCell DINH_xWhy.FId_bInhInvld_Com_uHvbNomChrgn DINH_xWhy.FId_bInhInvld_Com_vVeh DINH_xWhy.FId_bInh_ACCmpr_pwrLimMax DINH_xWhy.FId_bInh_ACCtl_flgCmprEna DINH_xWhy.FId_bInh_ACCtl_nCmprSpdReq DINH_xWhy.FId_bInh_APP_rInp DINH_xWhy.FId_bInh_BattId_numOrganNature1 DINH_xWhy.FId_bInh_BattId_numOrganNature2 DINH_xWhy.FId_bInh_BattId_numOrganRef1 DINH_xWhy.FId_bInh_BattId_numOrganRef2 DINH_xWhy.FId_bInh_BattId_numOrganRef3 DINH_xWhy.FId_bInh_BattId_numOrganRef4 DINH_xWhy.FId_bInh_BattId_numSerl1 DINH_xWhy.FId_bInh_BattId_numSerl2 DINH_xWhy.FId_bInh_BattId_numSerl3 DINH_xWhy.FId_bInh_BattId_numSerl4 DINH_xWhy.FId_bInh_BattId_numSerl5 DINH_xWhy.FId_bInh_BattId_numSerl6 DINH_xWhy.FId_bInh_BattId_numSerl7 DINH_xWhy.FId_bInh_Brk_stRed DINH_xWhy.FId_bInh_CbnHeatgHeatr_cntrRlyLf DINH_xWhy.FId_bInh_ChgrPlug_stPlgLockTx DINH_xWhy.FId_bInh_ChrgCntct_nrNegCntctElpdOper DINH_xWhy.FId_bInh_ChrgCntct_nrPosCntctElpdOper DINH_xWhy.FId_bInh_ChrgrRly_stRlyDes DINH_xWhy.FId_bInh_ChrgrVal_iChrgrDes DINH_xWhy.FId_bInh_ChrgrVal_iGridLimMax DINH_xWhy.FId_bInh_ChrgrVal_uHvMax DINH_xWhy.FId_bInh_CoDrvPITh_stEPSModeReq DINH_xWhy.FId_bInh_CoPtFH_stPwt DINH_xWhy.FId_bInh_ComChrg_stMod DINH_xWhy.FId_bInh_ComChrgn_iDcRly_Sq_Frz DINH_xWhy.FId_bInh_ComChrgn_uDcRly_Sq_Frz DINH_xWhy.FId_bInh_ComChrgr_flgChrgrErr_Sq_Frz DINH_xWhy.FId_bInh_ComChrgr_iAcMax_Sq_Frz DINH_xWhy.FId_bInh_ComChrgr_iDcHvAct_Sq_Frz DINH_xWhy.FId_bInh_ComChrgr_pwrInAct_Sq_Frz DINH_xWhy.FId_bInh_ComChrgr_stChrgnEna DINH_xWhy.FId_bInh_ComChrgr_stChrgr_Sq_Frz DINH_xWhy.FId_bInh_ComChrgr_tChrgrMaxAct_Sq_Frz DINH_xWhy.FId_bInh_ComChrgr_uAcActL1_Sq_Frz DINH_xWhy.FId_bInh_ComChrgr_uDcHvAct_Sq_Frz DINH_xWhy.FId_bInh_ComEmac_flgSvsReq01_Sq_Frz DINH_xWhy.FId_bInh_ComEmac_tIvtrCoolt01_Sq_Frz DINH_xWhy.FId_bInh_Com_25h_B1b0 DINH_xWhy.FId_bInh_Com_25h_B1b2 DINH_xWhy.FId_bInh_Com_25h_B1b4 DINH_xWhy.FId_bInh_Com_25h_B1b6 DINH_xWhy.FId_bInh_Com_HvbMaxSnsrTempTx DINH_xWhy.FId_bInh_Com_TogLedDrv DINH_xWhy.FId_bInh_Com_TogLedMod DINH_xWhy.FId_bInh_Com_TogLedNeut DINH_xWhy.FId_bInh_Com_TogLedRvs DINH_xWhy.FId_bInh_Com_bAcLedReq DINH_xWhy.FId_bInh_Com_bDiagMuxCAN DINH_xWhy.FId_bInh_Com_bGunCntInfoWkuReq DINH_xWhy.FId_bInh_Com_bHvBattRchrgWkuReq DINH_xWhy.FId_bInh_Com_bPostOperationWkuReq DINH_xWhy.FId_bInh_Com_bReFogRlySt DINH_xWhy.FId_bInh_Com_flgBlowrAuthn DINH_xWhy.FId_bInh_Com_flgBlowrRlyCtrl DINH_xWhy.FId_bInh_Com_flgBrkAlrt DINH_xWhy.FId_bInh_Com_flgDrvAwy DINH_xWhy.FId_bInh_Com_flgVehSpdQly DINH_xWhy.FId_bInh_Com_iDcdcHvActRvsn1_Sq_Frz DINH_xWhy.FId_bInh_Com_iDcdcLvActRvsn1_Sq_Frz DINH_xWhy.FId_bInh_Com_iElCmprHvAct_Sq_Frz DINH_xWhy.FId_bInh_Com_iHvbActTx DINH_xWhy.FId_bInh_Com_nElCmprActlTx DINH_xWhy.FId_bInh_Com_nIvtrMotAct01 DINH_xWhy.FId_bInh_Com_noEditCal DINH_xWhy.FId_bInh_Com_noEditSw DINH_xWhy.FId_bInh_Com_noVerSysDay DINH_xWhy.FId_bInh_Com_noVersAdp DINH_xWhy.FId_bInh_Com_noVersSw DINH_xWhy.FId_bInh_Com_noVersSys DINH_xWhy.FId_bInh_Com_noVersSysMnth DINH_xWhy.FId_bInh_Com_noVersSysYr DINH_xWhy.FId_bInh_Com_ratHvbSoh_Sq_Frz DINH_xWhy.FId_bInh_Com_stACTx DINH_xWhy.FId_bInh_Com_stBrk DINH_xWhy.FId_bInh_Com_stBrkBstPFlt DINH_xWhy.FId_bInh_Com_stBrkCntctIndcn DINH_xWhy.FId_bInh_Com_stChrgPlg DINH_xWhy.FId_bInh_Com_stChrgPlgChrgn DINH_xWhy.FId_bInh_Com_stClstrStopIndcn DINH_xWhy.FId_bInh_Com_stCmdHvBattCntctr DINH_xWhy.FId_bInh_Com_stCmdOffsEM01 DINH_xWhy.FId_bInh_Com_stDcdcOperModAct_Sq_Frz DINH_xWhy.FId_bInh_Com_stDrvAwyDi DINH_xWhy.FId_bInh_Com_stDrvModPosn DINH_xWhy.FId_bInh_Com_stEVLmp DINH_xWhy.FId_bInh_Com_stElCmprStatTx DINH_xWhy.FId_bInh_Com_stElMDesEem DINH_xWhy.FId_bInh_Com_stHvBattOperModDes DINH_xWhy.FId_bInh_Com_stHvacBlwrFront_CAN DINH_xWhy.FId_bInh_Com_stHvacKnobPosn_CAN DINH_xWhy.FId_bInh_Com_stMstWrnLmp DINH_xWhy.FId_bInh_Com_stNwCmdLIN DINH_xWhy.FId_bInh_Com_stPwrLimnLmp DINH_xWhy.FId_bInh_Com_stReFogReq_CAN DINH_xWhy.FId_bInh_Com_stSrvLmp DINH_xWhy.FId_bInh_Com_stVehCoorn DINH_xWhy.FId_bInh_Com_tDcdcAct_Sq_Frz DINH_xWhy.FId_bInh_Com_tDcdcInltCoolt_Sq DINH_xWhy.FId_bInh_Com_tqMotLimMax DINH_xWhy.FId_bInh_Com_uDcdcHvAct_Sq_Frz DINH_xWhy.FId_bInh_Com_uDcdcLvAct_Sq_Frz DINH_xWhy.FId_bInh_Com_uHvbActTx DINH_xWhy.FId_bInh_Com_valEepOffsEM01 DINH_xWhy.FId_bInh_DcChrgnRly_ctMaxOperCyc DINH_xWhy.FId_bInh_Dcdc_flgDesLvGridULim DINH_xWhy.FId_bInh_Dcdc_iLimLvGrid DINH_xWhy.FId_bInh_Dcdc_stDesDcdc DINH_xWhy.FId_bInh_Dcdc_uDesLvGrid DINH_xWhy.FId_bInh_DrvInfo_wTotTripEgy DINH_xWhy.FId_bInh_EChrDv_cntPlin DINH_xWhy.FId_bInh_Eem_flgFstHvShdwn DINH_xWhy.FId_bInh_ElM_stDesEem01 DINH_xWhy.FId_bInh_ElTS_egyTotChrgCyc DINH_xWhy.FId_bInh_ElTS_ratEmPowChrgn DINH_xWhy.FId_bInh_ElTS_ratEmPowDcha DINH_xWhy.FId_bInh_ElTS_stChrgCyc DINH_xWhy.FId_bInh_Emac_stIsoMonSwtReq DINH_xWhy.FId_bInh_Emac_tqDesCom01 DINH_xWhy.FId_bInh_Ext_bSyncGPC DINH_xWhy.FId_bInh_HvBatt_flgIsoMeasmtDiReq DINH_xWhy.FId_bInh_HvBatt_ratSoc DINH_xWhy.FId_bInh_HvGrid_pwrMaxDcdc DINH_xWhy.FId_bInh_HvacPtc_stElHeatr DINH_xWhy.FId_bInh_Pdu_CLUSTER_5E7_Frz DINH_xWhy.FId_bInh_Pdu_CLUSTER_5E7_Rcf DINH_xWhy.FId_bInh_Pdu_CONTEXTE_1_5B2_Frz DINH_xWhy.FId_bInh_Pdu_CONTEXTE_1_5B2_Rcf DINH_xWhy.FId_bInh_Pdu_Com_pwrMaxChrgSho_Sq_Frz DINH_xWhy.FId_bInh_Pdu_Com_pwrMaxDchaSho_Sq_Frz DINH_xWhy.FId_bInh_Pdu_DAT3_BSI_4F2h_Frz DINH_xWhy.FId_bInh_Pdu_DAT3_BSI_4F2h_Rcf DINH_xWhy.FId_bInh_Pdu_DCDC_283h_Frz DINH_xWhy.FId_bInh_Pdu_DCDC_283h_Rcf DINH_xWhy.FId_bInh_Pdu_DCDC_293h_Frz DINH_xWhy.FId_bInh_Pdu_DCDC_293h_Rcf DINH_xWhy.FId_bInh_Pdu_DCDC_473h_Frz DINH_xWhy.FId_bInh_Pdu_DCDC_473h_Rcf DINH_xWhy.FId_bInh_Pdu_DCDC_663h_Frz DINH_xWhy.FId_bInh_Pdu_DCDC_663h_Rcf DINH_xWhy.FId_bInh_Pdu_HS3_AUTO_GEARBOX_SWITCH_STATUS_Frz DINH_xWhy.FId_bInh_Pdu_HS3_AUTO_GEARBOX_SWITCH_STATUS_Rcf DINH_xWhy.FId_bInh_Pdu_HVAC_PANEL_26h_Frz DINH_xWhy.FId_bInh_Pdu_HVAC_PANEL_26h_Rcf DINH_xWhy.FId_bInh_Pdu_HVBAT_205h_Frz DINH_xWhy.FId_bInh_Pdu_HVBAT_205h_Rcf DINH_xWhy.FId_bInh_Pdu_HVBAT_275h_Frz DINH_xWhy.FId_bInh_Pdu_HVBAT_275h_Rcf DINH_xWhy.FId_bInh_Pdu_HVBAT_285h_Frz DINH_xWhy.FId_bInh_Pdu_HVBAT_285h_Rcf DINH_xWhy.FId_bInh_Pdu_HVBAT_325h_Frz DINH_xWhy.FId_bInh_Pdu_HVBAT_325h_Rcf DINH_xWhy.FId_bInh_Pdu_HVBAT_335h_Frz DINH_xWhy.FId_bInh_Pdu_HVBAT_335h_Rcf DINH_xWhy.FId_bInh_Pdu_HVBAT_455h_Frz DINH_xWhy.FId_bInh_Pdu_HVBAT_455h_Rcf DINH_xWhy.FId_bInh_Pdu_HVBAT_535_Frz DINH_xWhy.FId_bInh_Pdu_HVBAT_535_Rcf DINH_xWhy.FId_bInh_Pdu_HVBAT_595h_Frz DINH_xWhy.FId_bInh_Pdu_HVBAT_595h_Rcf DINH_xWhy.FId_bInh_Pdu_HVBAT_635h_Frz DINH_xWhy.FId_bInh_Pdu_HVBAT_635h_Rcf DINH_xWhy.FId_bInh_Pdu_HVBAT_645h_Frz DINH_xWhy.FId_bInh_Pdu_HVBAT_645h_Rcf DINH_xWhy.FId_bInh_Pdu_HVBAT_665h_Frz DINH_xWhy.FId_bInh_Pdu_HVBAT_665h_Rcf DINH_xWhy.FId_bInh_Pdu_HVBAT_675h_Frz DINH_xWhy.FId_bInh_Pdu_HVBAT_675h_Rcf DINH_xWhy.FId_bInh_Pdu_HVBAT_THERMAL_5B5_Frz DINH_xWhy.FId_bInh_Pdu_HVBAT_THERMAL_5B5_Rcf DINH_xWhy.FId_bInh_Pdu_HVBAT_VCU_435h_Frz DINH_xWhy.FId_bInh_Pdu_HVBAT_VCU_435h_Rcf DINH_xWhy.FId_bInh_Pdu_HVBAT_VCU_543_Frz DINH_xWhy.FId_bInh_Pdu_HVBAT_VCU_543_Rcf DINH_xWhy.FId_bInh_Pdu_HVBAT_VCU_583_Frz DINH_xWhy.FId_bInh_Pdu_HVBAT_VCU_583_Rcf DINH_xWhy.FId_bInh_Pdu_INV_217h_Frz DINH_xWhy.FId_bInh_Pdu_INV_217h_Rcf DINH_xWhy.FId_bInh_Pdu_INV_227h_Frz DINH_xWhy.FId_bInh_Pdu_INV_227h_Rcf DINH_xWhy.FId_bInh_Pdu_INV_237_Frz DINH_xWhy.FId_bInh_Pdu_INV_237_Rcf DINH_xWhy.FId_bInh_Pdu_INV_427h_Frz DINH_xWhy.FId_bInh_Pdu_INV_427h_Rcf DINH_xWhy.FId_bInh_Pdu_INV_497h_Frz DINH_xWhy.FId_bInh_Pdu_INV_497h_Rcf DINH_xWhy.FId_bInh_Pdu_INV_IMMO_5C7_Frz DINH_xWhy.FId_bInh_Pdu_INV_IMMO_5C7_Rcf DINH_xWhy.FId_bInh_Pdu_IS_DAT6_BSI_592h_Frz DINH_xWhy.FId_bInh_Pdu_IS_DAT6_BSI_592h_Rcf DINH_xWhy.FId_bInh_Pdu_IS_DAT_ABR_50Dh_Frz DINH_xWhy.FId_bInh_Pdu_IS_DAT_ABR_50Dh_Rcf DINH_xWhy.FId_bInh_Pdu_IS_DAT_BSI_412h_Frz DINH_xWhy.FId_bInh_Pdu_IS_DAT_BSI_412h_Rcf DINH_xWhy.FId_bInh_Pdu_IS_DYN_ABR_38Dh_Frz DINH_xWhy.FId_bInh_Pdu_IS_DYN_ABR_38Dh_Rcf DINH_xWhy.FId_bInh_Pdu_IS_INTE_ELECTRON_BSI_092h_Frz DINH_xWhy.FId_bInh_Pdu_IS_INTE_ELECTRON_BSI_092h_Rcf DINH_xWhy.FId_bInh_Pdu_OBC_273h_Frz DINH_xWhy.FId_bInh_Pdu_OBC_273h_Rcf DINH_xWhy.FId_bInh_Pdu_OBC_453h_Frz DINH_xWhy.FId_bInh_Pdu_OBC_453h_Rcf DINH_xWhy.FId_bInh_Pdu_OBC_463h_Frz DINH_xWhy.FId_bInh_Pdu_OBC_463h_Rcf DINH_xWhy.FId_bInh_Pdu_PDU_BusVoltages_308_Frz DINH_xWhy.FId_bInh_Pdu_PDU_BusVoltages_308_Rcf DINH_xWhy.FId_bInh_Pdu_PDU_Current_318_Frz DINH_xWhy.FId_bInh_Pdu_PDU_Current_318_Rcf DINH_xWhy.FId_bInh_Pdu_SC_INFO_BCCM_442h_Frz DINH_xWhy.FId_bInh_Pdu_SC_INFO_BCCM_442h_Rcf DINH_xWhy.FId_bInh_Pdu_VCU_AIRBAG_351h_Frz DINH_xWhy.FId_bInh_Pdu_VCU_AIRBAG_351h_Rcf DINH_xWhy.FId_bInh_Pdu_VCU_AIRBAG_fault_Frz DINH_xWhy.FId_bInh_Pdu_VCU_eBCCM_432h_Frz DINH_xWhy.FId_bInh_Pdu_VCU_eBCCM_432h_Rcf DINH_xWhy.FId_bInh_Pdu_VCU_eBCCM_552h_Frz DINH_xWhy.FId_bInh_Pdu_VCU_eBCCM_552h_Rcf DINH_xWhy.FId_bInh_Pdu_eBCCM_082h_Frz DINH_xWhy.FId_bInh_Pdu_eBCCM_082h_Rcf DINH_xWhy.FId_bInh_Pdu_eCOMP_Information_47B_Frz DINH_xWhy.FId_bInh_Pdu_eCOMP_Information_47B_Rcf DINH_xWhy.FId_bInh_Pdu_eCOMP_Information_48B_Frz DINH_xWhy.FId_bInh_Pdu_eCOMP_Information_48B_Rcf DINH_xWhy.FId_bInh_Sig205h_Com_iHvbActRx_Frz DINH_xWhy.FId_bInh_Sig205h_Com_iHvbActRx_Rcf DINH_xWhy.FId_bInh_Sig205h_Com_ratHvbSoc_Frz DINH_xWhy.FId_bInh_Sig205h_Com_ratHvbSoc_Rcf DINH_xWhy.FId_bInh_Sig205h_Com_stHvbChrgn_Frz DINH_xWhy.FId_bInh_Sig205h_Com_stHvbChrgn_Rcf DINH_xWhy.FId_bInh_Sig205h_Com_uHvbAct_Frz DINH_xWhy.FId_bInh_Sig205h_Com_uHvbAct_Rcf DINH_xWhy.FId_bInh_Sig217h_ComEmac_nAct01_Frz DINH_xWhy.FId_bInh_Sig217h_ComEmac_nAct01_Rcf DINH_xWhy.FId_bInh_Sig217h_ComEmac_tqAckd01_Frz DINH_xWhy.FId_bInh_Sig217h_ComEmac_tqAckd01_Rcf DINH_xWhy.FId_bInh_Sig217h_ComEmac_tqAct01_Frz DINH_xWhy.FId_bInh_Sig217h_ComEmac_tqAct01_Rcf DINH_xWhy.FId_bInh_Sig217h_ComEmac_uDcLnk01_Frz DINH_xWhy.FId_bInh_Sig217h_ComEmac_uDcLnk01_Rcf DINH_xWhy.FId_bInh_Sig227h_ComEmac_iDcLnk01_Frz DINH_xWhy.FId_bInh_Sig227h_ComEmac_iDcLnk01_Rcf DINH_xWhy.FId_bInh_Sig227h_ComEmac_pwrInstnsInpRx_Frz DINH_xWhy.FId_bInh_Sig227h_ComEmac_pwrInstnsInpRx_Rcf DINH_xWhy.FId_bInh_Sig227h_ComEmac_tqAbsltMax01_Frz DINH_xWhy.FId_bInh_Sig227h_ComEmac_tqAbsltMax01_Rcf DINH_xWhy.FId_bInh_Sig227h_ComEmac_tqAbsltMaxRx01_Frz DINH_xWhy.FId_bInh_Sig227h_ComEmac_tqAbsltMaxRx01_Rcf DINH_xWhy.FId_bInh_Sig227h_ComEmac_tqAbsltMin01_Frz DINH_xWhy.FId_bInh_Sig227h_ComEmac_tqAbsltMin01_Rcf DINH_xWhy.FId_bInh_Sig227h_ComEmac_tqAbsltMinRx01_Frz DINH_xWhy.FId_bInh_Sig227h_ComEmac_tqAbsltMinRx01_Rcf DINH_xWhy.FId_bInh_Sig237h_ComEmac_stActvDcha_Frz DINH_xWhy.FId_bInh_Sig237h_ComEmac_stActvDcha_Rcf DINH_xWhy.FId_bInh_Sig237h_ComEmac_stEVLmp_Frz DINH_xWhy.FId_bInh_Sig237h_ComEmac_stEVLmp_Rcf DINH_xWhy.FId_bInh_Sig237h_ComEmac_stMod01Rx_Frz DINH_xWhy.FId_bInh_Sig237h_ComEmac_stMod01Rx_Rcf DINH_xWhy.FId_bInh_Sig237h_ComEmac_stMstWrnLmp_Frz DINH_xWhy.FId_bInh_Sig237h_ComEmac_stMstWrnLmp_Rcf DINH_xWhy.FId_bInh_Sig237h_ComEmac_stSVSLmp_Frz DINH_xWhy.FId_bInh_Sig237h_ComEmac_stSVSLmp_Rcf DINH_xWhy.FId_bInh_Sig237h_ComEmac_tqStabnMin_Frz DINH_xWhy.FId_bInh_Sig237h_ComEmac_tqStabnMin_Rcf DINH_xWhy.FId_bInh_Sig237h_Com_stIIvtrFltLvl01_Frz DINH_xWhy.FId_bInh_Sig237h_Com_stIIvtrFltLvl01_Rcf DINH_xWhy.FId_bInh_Sig259hFlt DINH_xWhy.FId_bInh_Sig259h_Com_flgEcoNormReqRx_Frz DINH_xWhy.FId_bInh_Sig259h_Com_flgEcoNormReqRx_Rcf DINH_xWhy.FId_bInh_Sig259h_Com_stGearLvrPos_Frz DINH_xWhy.FId_bInh_Sig259h_Com_stGearLvrPos_Rcf DINH_xWhy.FId_bInh_Sig259h_Com_steTogFailrLvl_Frz DINH_xWhy.FId_bInh_Sig259h_Com_steTogFailrLvl_Rcf DINH_xWhy.FId_bInh_Sig26h_Com_stAC_Frz DINH_xWhy.FId_bInh_Sig26h_Com_stAC_Rcf DINH_xWhy.FId_bInh_Sig26h_Com_stEvapTFlt_Frz DINH_xWhy.FId_bInh_Sig26h_Com_stEvapTFlt_Rcf DINH_xWhy.FId_bInh_Sig26h_Com_stHvacBlwrFront_Frz DINH_xWhy.FId_bInh_Sig26h_Com_stHvacBlwrFront_Rcf DINH_xWhy.FId_bInh_Sig26h_Com_stHvacKnobPosn_Frz DINH_xWhy.FId_bInh_Sig26h_Com_stHvacKnobPosn_Rcf DINH_xWhy.FId_bInh_Sig26h_Com_stHvacPanPotiFlt_Frz DINH_xWhy.FId_bInh_Sig26h_Com_stHvacPanPotiFlt_Rcf DINH_xWhy.FId_bInh_Sig26h_Com_stReFogReq_Frz DINH_xWhy.FId_bInh_Sig26h_Com_stReFogReq_Rcf DINH_xWhy.FId_bInh_Sig26h_Com_tEvapT_Frz DINH_xWhy.FId_bInh_Sig26h_Com_tEvapT_Rcf DINH_xWhy.FId_bInh_Sig273h_ComChrgr_flgChrgrErrLvl_Frz DINH_xWhy.FId_bInh_Sig273h_ComChrgr_flgChrgrErrLvl_Rcf DINH_xWhy.FId_bInh_Sig273h_ComChrgr_pwrOutpCpby_Frz DINH_xWhy.FId_bInh_Sig273h_ComChrgr_pwrOutpCpby_Rcf DINH_xWhy.FId_bInh_Sig275h_Com_iHvbDchaMaxSho_Frz DINH_xWhy.FId_bInh_Sig275h_Com_iHvbDchaMaxSho_Rcf DINH_xWhy.FId_bInh_Sig275h_Com_pwrMaxDchaSho_Frz DINH_xWhy.FId_bInh_Sig275h_Com_pwrMaxDchaSho_Rcf DINH_xWhy.FId_bInh_Sig283h_Com_iDcdcHvActRvsn1_Frz DINH_xWhy.FId_bInh_Sig283h_Com_iDcdcHvActRvsn1_Rcf DINH_xWhy.FId_bInh_Sig283h_Com_iDcdcLvActRvsn1_Frz DINH_xWhy.FId_bInh_Sig283h_Com_iDcdcLvActRvsn1_Rcf DINH_xWhy.FId_bInh_Sig283h_Com_uDcdcHvAct_Frz DINH_xWhy.FId_bInh_Sig283h_Com_uDcdcHvAct_Rcf DINH_xWhy.FId_bInh_Sig283h_Com_uDcdcLvAct_Frz DINH_xWhy.FId_bInh_Sig283h_Com_uDcdcLvAct_Rcf DINH_xWhy.FId_bInh_Sig285h_Com_iHvbChrgMaxSho_Frz DINH_xWhy.FId_bInh_Sig285h_Com_iHvbChrgMaxSho_Rcf DINH_xWhy.FId_bInh_Sig285h_Com_pwrMaxChrgSho_Frz DINH_xWhy.FId_bInh_Sig285h_Com_pwrMaxChrgSho_Rcf DINH_xWhy.FId_bInh_Sig293h_Com_pwrDcdcOutpCpby_Frz DINH_xWhy.FId_bInh_Sig293h_Com_pwrDcdcOutpCpby_Rcf DINH_xWhy.FId_bInh_Sig293h_Com_stDcdcFltLvl_Frz DINH_xWhy.FId_bInh_Sig293h_Com_stDcdcFltLvl_Rcf DINH_xWhy.FId_bInh_Sig325h_Com_rHvbIsoMeasmt_Frz DINH_xWhy.FId_bInh_Sig325h_Com_rHvbIsoMeasmt_Rcf DINH_xWhy.FId_bInh_Sig325h_Com_stHvbIntlckRx_Frz DINH_xWhy.FId_bInh_Sig325h_Com_stHvbIntlckRx_Rcf DINH_xWhy.FId_bInh_Sig325h_Com_stHvbIsoFltRx_Frz DINH_xWhy.FId_bInh_Sig325h_Com_stHvbIsoFltRx_Rcf DINH_xWhy.FId_bInh_Sig325h_Com_stHvbSrvPlgRx_Frz DINH_xWhy.FId_bInh_Sig325h_Com_stHvbSrvPlgRx_Rcf DINH_xWhy.FId_bInh_Sig325h_Com_tHvbMax_Frz DINH_xWhy.FId_bInh_Sig325h_Com_tHvbMax_Rcf DINH_xWhy.FId_bInh_Sig335h_Com_iHvbDes_Frz DINH_xWhy.FId_bInh_Sig335h_Com_iHvbDes_Rcf DINH_xWhy.FId_bInh_Sig335h_Com_iHvbNomChrgn_Frz DINH_xWhy.FId_bInh_Sig335h_Com_iHvbNomChrgn_Rcf DINH_xWhy.FId_bInh_Sig335h_Com_uHvbDcBus_Frz DINH_xWhy.FId_bInh_Sig335h_Com_uHvbDcBus_Rcf DINH_xWhy.FId_bInh_Sig335h_Com_uHvbLimHi_Frz DINH_xWhy.FId_bInh_Sig335h_Com_uHvbLimHi_Rcf DINH_xWhy.FId_bInh_Sig38Dh_Com_flgVehSpdAvl_Frz DINH_xWhy.FId_bInh_Sig38Dh_Com_flgVehSpdAvl_Rcf DINH_xWhy.FId_bInh_Sig38Dh_Com_vVeh_Frz DINH_xWhy.FId_bInh_Sig38Dh_Com_vVeh_Rcf DINH_xWhy.FId_bInh_Sig427h_ComEmac_stIvtrOpMod01_Frz DINH_xWhy.FId_bInh_Sig427h_ComEmac_stIvtrOpMod01_Rcf DINH_xWhy.FId_bInh_Sig427h_ComEmac_tInvr01_Frz DINH_xWhy.FId_bInh_Sig427h_ComEmac_tInvr01_Rcf DINH_xWhy.FId_bInh_Sig427h_ComEmac_tIvtrCooltIn01_Frz DINH_xWhy.FId_bInh_Sig427h_ComEmac_tIvtrCooltIn01_Rcf DINH_xWhy.FId_bInh_Sig427h_ComEmac_tMac01_Frz DINH_xWhy.FId_bInh_Sig427h_ComEmac_tMac01_Rcf DINH_xWhy.FId_bInh_Sig427h_ComEmac_tqPtd01_Frz DINH_xWhy.FId_bInh_Sig427h_ComEmac_tqPtd01_Rcf DINH_xWhy.FId_bInh_Sig432h_Com_stMainWkuReq_Frz DINH_xWhy.FId_bInh_Sig432h_Com_stMainWkuReq_Rcf DINH_xWhy.FId_bInh_Sig435h_Com_HvbMaxSnsrTempRx_Frz DINH_xWhy.FId_bInh_Sig435h_Com_HvbMaxSnsrTempRx_Rcf DINH_xWhy.FId_bInh_Sig435h_Com_nrSerMaxCell_Frz DINH_xWhy.FId_bInh_Sig435h_Com_nrSerMaxCell_Rcf DINH_xWhy.FId_bInh_Sig435h_Com_nrSerMinCell_Frz DINH_xWhy.FId_bInh_Sig435h_Com_nrSerMinCell_Rcf DINH_xWhy.FId_bInh_Sig435h_Com_uHvbMaxCell_Frz DINH_xWhy.FId_bInh_Sig435h_Com_uHvbMaxCell_Rcf DINH_xWhy.FId_bInh_Sig435h_Com_uHvbMinCell_Frz DINH_xWhy.FId_bInh_Sig435h_Com_uHvbMinCell_Rcf DINH_xWhy.FId_bInh_Sig442h_Com_stBlowrRly_Frz DINH_xWhy.FId_bInh_Sig442h_Com_stBlowrRly_Rcf DINH_xWhy.FId_bInh_Sig453h_ComChrgr_iAcMax_Frz DINH_xWhy.FId_bInh_Sig453h_ComChrgr_iAcMax_Rcf DINH_xWhy.FId_bInh_Sig453h_ComChrgr_pwrInAct_Frz DINH_xWhy.FId_bInh_Sig453h_ComChrgr_pwrInAct_Rcf DINH_xWhy.FId_bInh_Sig453h_ComChrgr_uAcActL1_Frz DINH_xWhy.FId_bInh_Sig453h_ComChrgr_uAcActL1_Rcf DINH_xWhy.FId_bInh_Sig455h_Com_uHvbNomChrgn_Frz DINH_xWhy.FId_bInh_Sig455h_Com_uHvbNomChrgn_Rcf DINH_xWhy.FId_bInh_Sig463h_ComChrgr_iDcHvAct_Frz DINH_xWhy.FId_bInh_Sig463h_ComChrgr_iDcHvAct_Rcf DINH_xWhy.FId_bInh_Sig463h_ComChrgr_tChrgrMaxAct_Frz DINH_xWhy.FId_bInh_Sig463h_ComChrgr_tChrgrMaxAct_Rcf DINH_xWhy.FId_bInh_Sig463h_ComChrgr_uDcHvAct_Frz DINH_xWhy.FId_bInh_Sig463h_ComChrgr_uDcHvAct_Rcf DINH_xWhy.FId_bInh_Sig473h_Com_tDcdcAct_Frz DINH_xWhy.FId_bInh_Sig473h_Com_tDcdcAct_Rcf DINH_xWhy.FId_bInh_Sig473h_Com_tDcdcInltCoolt_Frz DINH_xWhy.FId_bInh_Sig473h_Com_tDcdcInltCoolt_Rcf DINH_xWhy.FId_bInh_Sig47Bh_Com_iElCmprHvAct_Frz DINH_xWhy.FId_bInh_Sig47Bh_Com_iElCmprHvAct_Rcf DINH_xWhy.FId_bInh_Sig47Bh_Com_iElCmprPeakPha_Frz DINH_xWhy.FId_bInh_Sig47Bh_Com_iElCmprPeakPha_Rcf DINH_xWhy.FId_bInh_Sig47Bh_Com_nElCmprActl_Frz DINH_xWhy.FId_bInh_Sig47Bh_Com_nElCmprActl_Rcf DINH_xWhy.FId_bInh_Sig47Bh_Com_pwrElCmprActl_Frz DINH_xWhy.FId_bInh_Sig47Bh_Com_pwrElCmprActl_Rcf DINH_xWhy.FId_bInh_Sig47Bh_Com_tElCmprActl_Frz DINH_xWhy.FId_bInh_Sig47Bh_Com_tElCmprActl_Rcf DINH_xWhy.FId_bInh_Sig47Bh_Com_uElCmprHvAct_Frz DINH_xWhy.FId_bInh_Sig47Bh_Com_uElCmprHvAct_Rcf DINH_xWhy.FId_bInh_Sig48Bh_Com_stElCmprFltLvl_Frz DINH_xWhy.FId_bInh_Sig48Bh_Com_stElCmprFltLvl_Rcf DINH_xWhy.FId_bInh_Sig4F2h_Com_ratSocLvBatt_Frz DINH_xWhy.FId_bInh_Sig4F2h_Com_ratSocLvBatt_Rcf DINH_xWhy.FId_bInh_Sig4F2h_Com_stSocRx_Frz DINH_xWhy.FId_bInh_Sig4F2h_Com_stSocRx_Rcf DINH_xWhy.FId_bInh_Sig4F2h_Com_stT_Frz DINH_xWhy.FId_bInh_Sig4F2h_Com_stT_Rcf DINH_xWhy.FId_bInh_Sig535h_Com_tHvbAct_Frz DINH_xWhy.FId_bInh_Sig535h_Com_tHvbAct_Rcf DINH_xWhy.FId_bInh_Sig543h_Com_egyHvbAvl_fRx_Frz DINH_xWhy.FId_bInh_Sig543h_Com_egyHvbAvl_fRx_Rcf DINH_xWhy.FId_bInh_Sig543h_Com_ratHvbSoh_Frz DINH_xWhy.FId_bInh_Sig543h_Com_ratHvbSoh_Rcf DINH_xWhy.FId_bInh_Sig543h_Com_ratRHvbSoh_Frz DINH_xWhy.FId_bInh_Sig543h_Com_ratRHvbSoh_Rcf DINH_xWhy.FId_bInh_Sig552h_Com_lDstGlbDa_Frz DINH_xWhy.FId_bInh_Sig552h_Com_lDstGlbDa_Rcf DINH_xWhy.FId_bInh_Sig552h_Com_lTotOdometer_Frz DINH_xWhy.FId_bInh_Sig552h_Com_lTotOdometer_Rcf DINH_xWhy.FId_bInh_Sig552h_Com_tiCurVehTmr_Frz DINH_xWhy.FId_bInh_Sig552h_Com_tiCurVehTmr_Rcf DINH_xWhy.FId_bInh_Sig583h_Com_stHvbDiscnctReas_Frz DINH_xWhy.FId_bInh_Sig583h_Com_stHvbDiscnctReas_Rcf DINH_xWhy.FId_bInh_Sig592h_Com_iBattEBS1Rx_Frz DINH_xWhy.FId_bInh_Sig592h_Com_iBattEBS1Rx_Rcf DINH_xWhy.FId_bInh_Sig592h_Com_iBattEBS2Rx_Frz DINH_xWhy.FId_bInh_Sig592h_Com_iBattEBS2Rx_Rcf DINH_xWhy.FId_bInh_Sig592h_Com_iBattEBS3Rx_Frz DINH_xWhy.FId_bInh_Sig592h_Com_iBattEBS3Rx_Rcf DINH_xWhy.FId_bInh_Sig592h_Com_stIBattEBS_Frz DINH_xWhy.FId_bInh_Sig592h_Com_stIBattEBS_Rcf DINH_xWhy.FId_bInh_Sig592h_Com_tLvBatt_Frz DINH_xWhy.FId_bInh_Sig592h_Com_tLvBatt_Rcf DINH_xWhy.FId_bInh_Sig592h_Com_uBattEBSRx_Frz DINH_xWhy.FId_bInh_Sig592h_Com_uBattEBSRx_Rcf DINH_xWhy.FId_bInh_Sig595h_Com_tiHvbChrgnHalfRx_Frz DINH_xWhy.FId_bInh_Sig595h_Com_tiHvbChrgnHalfRx_Rcf DINH_xWhy.FId_bInh_Sig5B2h_Com_tEnvT_Frz DINH_xWhy.FId_bInh_Sig5B2h_Com_tEnvT_Rcf DINH_xWhy.FId_bInh_Sig5B5h_Com_stAlrtThermRunAwy_Frz DINH_xWhy.FId_bInh_Sig5B5h_Com_stAlrtThermRunAwy_Rcf DINH_xWhy.FId_bInh_Sig635h_Com_ctHvbNegCntctrSeg1_Frz DINH_xWhy.FId_bInh_Sig635h_Com_ctHvbNegCntctrSeg1_Rcf DINH_xWhy.FId_bInh_Sig635h_Com_ctHvbNegCntctrSeg3_Frz DINH_xWhy.FId_bInh_Sig635h_Com_ctHvbNegCntctrSeg3_Rcf DINH_xWhy.FId_bInh_Sig635h_Com_ctHvbNegCntctrSeg4_Frz DINH_xWhy.FId_bInh_Sig635h_Com_ctHvbNegCntctrSeg4_Rcf DINH_xWhy.FId_bInh_Sig635h_Com_ctHvbPosCntctrSeg1_Frz DINH_xWhy.FId_bInh_Sig635h_Com_ctHvbPosCntctrSeg1_Rcf DINH_xWhy.FId_bInh_Sig635h_Com_ctHvbPosCntctrSeg3_Frz DINH_xWhy.FId_bInh_Sig635h_Com_ctHvbPosCntctrSeg3_Rcf DINH_xWhy.FId_bInh_Sig635h_Com_ctHvbPosCntctrSeg4_Frz DINH_xWhy.FId_bInh_Sig635h_Com_ctHvbPosCntctrSeg4_Rcf DINH_xWhy.FId_bInh_Sig645h_Com_ctHvbPrecCntctrSeg1_Frz DINH_xWhy.FId_bInh_Sig645h_Com_ctHvbPrecCntctrSeg1_Rcf DINH_xWhy.FId_bInh_Sig645h_Com_ctHvbPrecCntctrSeg2_Frz DINH_xWhy.FId_bInh_Sig645h_Com_ctHvbPrecCntctrSeg2_Rcf DINH_xWhy.FId_bInh_Sig675h_Com_qHvbTotCpRx_Frz DINH_xWhy.FId_bInh_Sig675h_Com_qHvbTotCpRx_Rcf DINH_xWhy.FId_bInh_Sig_ComEmac_flgImobAuthent_Sq_Frz DINH_xWhy.FId_bInh_Sig_ComEmac_stIsoMonSwtAck_Sq_Frz DINH_xWhy.FId_bInh_Sig_ComEmac_stPwrAuthn_Sq_Frz DINH_xWhy.FId_bInh_Sig_Com_flgEcoNormReq_Frz DINH_xWhy.FId_bInh_Sig_Com_pwrMaxChrgSho_Sq_Frz DINH_xWhy.FId_bInh_Sig_Com_pwrMaxDchaSho_Sq_Frz DINH_xWhy.FId_bInh_Sig_Com_stDcdcULimReq_Sq_Frz DINH_xWhy.FId_bInh_Sig_Com_stGearLvrPos_Frz DINH_xWhy.FId_bInh_Sig_Com_stIgnkeyPos_Sq_Frz DINH_xWhy.FId_bInh_ThermHvac_stRemPrecndn DINH_xWhy.FId_bInh_VehCoorn_dstRngPrdcDispTx DINH_xWhy.FId_bInh_VehCoorn_wCnsTotWghtAvrgEffTripA DINH_xWhy.FId_bInh_VehCoorn_wCnsTotWghtAvrgEffTripB DINH_xWhy.FId_bInh_VehCoorn_wCnsTotWghtAvrgEffTx DINH_xWhy.FId_bInh_VehCoorn_wCnsTotWghtTripAvrgEffTx DINH_xWhy.FId_bInh_VehCoorn_wCnsWghtAvrgEffTripA DINH_xWhy.FId_bInh_VehCoorn_wCnsWghtAvrgEffTripB DINH_xWhy.FId_binnh_Sig_ComEmac_flgEmgyShtDwnReq01_Sq_Frz DINH_xWhy.FId_binnh_Sig_ComEmac_flgImobAuthent_Sq_Frz DINH_xWhy.FId_binnh_Sig_ComEmac_iDcLnk01_Sq_Frz DINH_xWhy.FId_binnh_Sig_ComEmac_nAct01_Sq_Frz DINH_xWhy.FId_binnh_Sig_ComEmac_stActvDcha_Sq_Frz DINH_xWhy.FId_binnh_Sig_ComEmac_stIsoMonSwtAck_Sq_Frz DINH_xWhy.FId_binnh_Sig_ComEmac_stMod01_Sq_Frz DINH_xWhy.FId_binnh_Sig_ComEmac_stPwrAuthn_Sq_Frz DINH_xWhy.FId_binnh_Sig_ComEmac_tInvr01_Sq_Frz DINH_xWhy.FId_binnh_Sig_ComEmac_tMac01_Sq_Frz DINH_xWhy.FId_binnh_Sig_ComEmac_tqAbsltMax01_Sq_Frz DINH_xWhy.FId_binnh_Sig_ComEmac_tqAbsltMin01_Sq_Frz DINH_xWhy.FId_binnh_Sig_ComEmac_tqAct01_Sq_Frz DINH_xWhy.FId_binnh_Sig_ComEmac_uDcLnk01_sq_Frz DINH_xWhy.FId_binnh_Sig_Com_egyHvbAvl_Sq_Frz DINH_xWhy.FId_binnh_Sig_Com_iHvbAct_Sq_Frz DINH_xWhy.FId_binnh_Sig_Com_iHvbChrgMaxSho_Sq_Frz DINH_xWhy.FId_binnh_Sig_Com_iHvbDchaMaxSho_Sq_Frz DINH_xWhy.FId_binnh_Sig_Com_iHvbDes_Sq_Frz DINH_xWhy.FId_binnh_Sig_Com_pwrDcdcOutpCpby_Sq_Frz DINH_xWhy.FId_binnh_Sig_Com_rHvbIsoMeasmt_Sq_Frz DINH_xWhy.FId_binnh_Sig_Com_ratHvbSoc_Sq_Frz DINH_xWhy.FId_binnh_Sig_Com_stDcdcULimReq_Sq_Frz DINH_xWhy.FId_binnh_Sig_Com_stHvbCntct_Sq_Frz DINH_xWhy.FId_binnh_Sig_Com_stHvbDernMaxT_Sq_Frz DINH_xWhy.FId_binnh_Sig_Com_stHvbDernMinT_Sq_Frz DINH_xWhy.FId_binnh_Sig_Com_stHvbFlt_Sq_Frz DINH_xWhy.FId_binnh_Sig_Com_stHvbIntlck_Sq_Frz DINH_xWhy.FId_binnh_Sig_Com_stHvbIsoFlt_Sq_Frz DINH_xWhy.FId_binnh_Sig_Com_stHvbMod_Sq_Frz DINH_xWhy.FId_binnh_Sig_Com_stHvbSrvPlg_Sq_Frz DINH_xWhy.FId_binnh_Sig_Com_tHvbAct_Sq_Frz DINH_xWhy.FId_binnh_Sig_Com_uElCmprHvAct_Sq_Frz DINH_xWhy.FId_binnh_Sig_Com_uHvbAct_Sq_Frz DINH_xWhy.FId_binnh_Sig_Com_uHvbDcBus_Sq_Frz DINH_xWhy.FId_binnh_Sig_Com_uHvbLimHi_Sq_Frz DINH_xWhy.FId_binnh_Sig_Com_uHvbNomChrgn_Sq_Frz /end LOC_MEASUREMENT
 FUNCTION_VERSION "30000.25.0" /end FUNCTION
/begin COMPU_METHOD DFCDSQ_Verb "" TAB_VERB "%6.3" "-" COMPU_TAB_REF DFCDSQ_Verb /end COMPU_METHOD
/begin COMPU_VTAB DFCDSQ_Verb "" TAB_VERB 971 0 "NoInhibit" 1 "DFC_ACCmprFltLvlRes" 2 "DFC_AbgHiSigFlt" 3 "DFC_AbgIntPatFlt" 4 "DFC_AbgLoSigFlt" 5 "DFC_AbgUnkwnErrSigFlt" 6 "DFC_AcExtChrgrIBattExcdd" 7 "DFC_AcExtChrgrIInExcdd" 8 "DFC_AcExtChrgrIOutDe" 9 "DFC_AcExtChrgrIOutExcdd" 10 "DFC_AcExtChrgrUOutDe" 11 "DFC_AdpActvDChaFailr" 12 "DFC_AirbcuFlt" 13 "DFC_Airbg" 14 "DFC_AirbgCan" 15 "DFC_AirbgCanHWPlaus" 16 "DFC_AirbgHWCanPlaus" 17 "DFC_AirbgMnr" 18 "DFC_AirbgPerHi" 19 "DFC_AirbgPerdRngFlt" 20 "DFC_BlowrRlyErr" 21 "DFC_BrkBstPmpActtnDfct" 22 "DFC_BrkBstPmpDeactvnDfct" 23 "DFC_BrkSwtFlt" 24 "DFC_CbnHeatgHeatrHsScb" 25 "DFC_CbnHeatgHeatrHsScg" 26 "DFC_CbnHeatgHeatrLsOl" 27 "DFC_CbnHeatgHeatrLsScb" 28 "DFC_CbnHeatgHeatrLsScg" 29 "DFC_CbnHeatgHeatrUnUsed" 30 "DFC_ChrgnCntctHsOt" 31 "DFC_ChrgnCntctHsScb" 32 "DFC_ChrgnCntctHsScg" 33 "DFC_ChrgnCntctLsNegOl" 34 "DFC_ChrgnCntctLsNegOt" 35 "DFC_ChrgnCntctLsNegScb" 36 "DFC_ChrgnCntctLsNegScg" 37 "DFC_ChrgnCntctLsPosOl" 38 "DFC_ChrgnCntctLsPosOt" 39 "DFC_ChrgnCntctLsPosScb" 40 "DFC_ChrgnCntctLsPosScg" 41 "DFC_ChrgnCntctUnUsed" 42 "DFC_ComBrkMai" 43 "DFC_ComChrgrEVCont" 44 "DFC_ComChrgrEVtBlink" 45 "DFC_ComChrgrMstBlink" 46 "DFC_ComChrgrMstCont" 47 "DFC_ComChrgrSVSBlink" 48 "DFC_ComChrgrSVSCont" 49 "DFC_ComDcdcEVBlink" 50 "DFC_ComDcdcEVCont" 51 "DFC_ComDcdcFltLvl2" 52 "DFC_ComDcdcFltLvl3" 53 "DFC_ComDcdcFltLvl4" 54 "DFC_ComDcdcFltLvl5" 55 "DFC_ComDcdcFltLvlRes" 56 "DFC_ComDcdcMstBlink" 57 "DFC_ComDcdcMstCont" 58 "DFC_ComDcdcSVSBlink" 59 "DFC_ComDcdcSVSCont" 60 "DFC_ComElMIIvtrFltLvl2" 61 "DFC_ComElMIIvtrFltLvl3" 62 "DFC_ComElMIIvtrFltLvl4" 63 "DFC_ComElMIIvtrFltLvl5" 64 "DFC_ComElMIIvtrFltLvlRes" 65 "DFC_ComEmacEVBlink" 66 "DFC_ComEmacEVCont" 67 "DFC_ComEmacMstCont" 68 "DFC_ComEmacMsttBlink" 69 "DFC_ComEmacSVSBlink" 70 "DFC_ComEmacSVSCont" 71 "DFC_ComGunCntInfoWkuReq" 72 "DFC_ComHillHldFlt" 73 "DFC_ComHvBattRchrgWkuReq" 74 "DFC_ComHvbFltLvl2" 75 "DFC_ComHvbFltLvl3" 76 "DFC_ComHvbFltLvl4" 77 "DFC_ComHvbFltLvl5" 78 "DFC_ComHvbFltLvlRes" 79 "DFC_ComHvbMstBlink" 80 "DFC_ComHvbMstCont" 81 "DFC_ComImmoUnlockWkuReq" 82 "DFC_ComInfoReqPtlWkuReq" 83 "DFC_ComOBCFltLvl2" 84 "DFC_ComOBCFltLvl3" 85 "DFC_ComOBCFltLvl4" 86 "DFC_ComOBCFltLvl5" 87 "DFC_ComOBCFltLvlRes" 88 "DFC_ComPostOperationWkuReq" 89 "DFC_ComPreCondElecWkuReq" 90 "DFC_ComRemUnlckWkuReq" 91 "DFC_ComStpDlyHMIWkuReq" 92 "DFC_ComflgCurMeasmtErr" 93 "DFC_ComflgCurMeasmtSysErr" 94 "DFC_ComflgCurMeasmtVld" 95 "DFC_ComflgCurRngErr" 96 "DFC_ComflgTPcbMeasmtErr" 97 "DFC_ComflgTPcbMeasmtVld" 98 "DFC_ComflgTPcbRngErr" 99 "DFC_ComflgTPcbSysErr" 100 "DFC_ComflgTShntMeasmtErr" 101 "DFC_ComflgTShntMeasmtVld" 102 "DFC_ComflgTShntRngErr" 103 "DFC_ComflgTShntSysErr" 104 "DFC_ComflgVoltMeasmtErr" 105 "DFC_ComflgVoltMeasmtSysErr" 106 "DFC_ComflgVoltMeasmtVld" 107 "DFC_ComflgVoltRngErr" 108 "DFC_CrashEveOcc" 109 "DFC_DcdcFwdModStuck" 110 "DFC_DcdcLvUDifMaxFlt" 111 "DFC_DcdcOffModStuck" 112 "DFC_DcdcOperModFailr" 113 "DFC_DcdcPrecModStuck" 114 "DFC_DrvDoorOpn" 115 "DFC_DrvModPosnDfct" 116 "DFC_DrvStbltOpn" 117 "DFC_ETogFailrLvl3" 118 "DFC_ETogFailrLvl4" 119 "DFC_EbsLvBattSocDiagLo" 120 "DFC_EbsLvBattUDiagDiOper" 121 "DFC_EbsLvBattUDiagFltLvl1" 122 "DFC_EbsLvBattUDiagFltLvl2" 123 "DFC_EbsLvBattUDiagLo" 124 "DFC_EbsSnsrSt" 125 "DFC_EbsSofASILErr" 126 "DFC_ElTSPtSysLimDrvErr" 127 "DFC_ElTSPtSysLimRgnErr" 128 "DFC_HLCCcsFwDwnl" 129 "DFC_HvBattChrgPwrMax" 130 "DFC_HvBattCrashDetd" 131 "DFC_HvBattDchaPwrMax" 132 "DFC_HvBattEmgyOff" 133 "DFC_HvBattEmgyOffIntlck" 134 "DFC_HvBattEmgyOffReq" 135 "DFC_HvBattFltMod" 136 "DFC_HvBattIReqToChrgrErr" 137 "DFC_HvBattIReqToChrgrIni" 138 "DFC_HvBattIninTout" 139 "DFC_HvBattIntlckSt" 140 "DFC_HvBattIsoFlt" 141 "DFC_HvBattLimdPwr" 142 "DFC_HvBattMaiSwtClsngFlt" 143 "DFC_HvBattMaiSwtFlt" 144 "DFC_HvBattMaiSwtOpen" 145 "DFC_HvBattMaiSwtOpngFlt" 146 "DFC_HvBattMaiSwtWldd" 147 "DFC_HvBattNegCntctrCntErr" 148 "DFC_HvBattOperModChrgPlausy" 149 "DFC_HvBattOverTDern" 150 "DFC_HvBattPosCntctrCntErr" 151 "DFC_HvBattPrecCntctrCntErr" 152 "DFC_HvBattPwrDistbnTDern" 153 "DFC_HvBattPwrDistbnTInhbn" 154 "DFC_HvBattRatRSohErr" 155 "DFC_HvBattRatSohErr" 156 "DFC_HvBattSngIsoWarn" 157 "DFC_HvBattSrvPlgDiscnct" 158 "DFC_HvBattUNomChrgnErr" 159 "DFC_HvBattUNomChrgnIni" 160 "DFC_HvBattUnderTDern" 161 "DFC_HvbEVLmpBlink" 162 "DFC_HvbEVLmpCont" 163 "DFC_HvbSVSBlink" 164 "DFC_HvbSVSCont" 165 "DFC_InmLINBusBlk" 166 "DFC_PDUProgmFailr" 167 "DFC_PEnvSigRngMax" 168 "DFC_PEnvSigRngMin" 169 "DFC_PLnCChpDeactvnFaild" 170 "DFC_PrkgBrkFailr" 171 "DFC_PtSysLimErr" 172 "DFC_PwrMaxDchaShoLo" 173 "DFC_SCtPmp1FailSafeNotSuc" 174 "DFC_SCtPmp1SCG" 175 "DFC_VehCoornDrvrNotPrsnt" 176 "DFC_VehVCanAvl" 177 "DFC_VehVCanErr" 178 "DFC_eTogFailrLvlRes" 179 "DFC_flgBrkMaiDiag" 180 "DFC_stHvbIsoMeasmtRes" 181 "DFC_BrkBstPmpPLeakDfct" 182 "DFC_Com082hTooShort" 183 "DFC_Com092hTooShort" 184 "DFC_Com205hAbsent" 185 "DFC_Com205hChecksum" 186 "DFC_Com205hCounter" 187 "DFC_Com205hTooShort" 188 "DFC_Com217hAbsent" 189 "DFC_Com217hChecksum" 190 "DFC_Com217hCounter" 191 "DFC_Com217hTooShort" 192 "DFC_Com227hAbsent" 193 "DFC_Com227hTooShort" 194 "DFC_Com237hAbsent" 195 "DFC_Com237hChecksum" 196 "DFC_Com237hCounter" 197 "DFC_Com237hTooShort" 198 "DFC_Com259hAbsent" 199 "DFC_Com259hChecksum" 200 "DFC_Com259hCounter" 201 "DFC_Com259hTooShort" 202 "DFC_Com26hAbsent" 203 "DFC_Com26hTooShort" 204 "DFC_Com273hAbsent" 205 "DFC_Com273hChecksum" 206 "DFC_Com273hCounter" 207 "DFC_Com273hTooShort" 208 "DFC_Com275hAbsent" 209 "DFC_Com275hChecksum" 210 "DFC_Com275hCounter" 211 "DFC_Com275hTooShort" 212 "DFC_Com283hAbsent" 213 "DFC_Com283hTooShort" 214 "DFC_Com285hAbsent" 215 "DFC_Com285hChecksum" 216 "DFC_Com285hCounter" 217 "DFC_Com285hTooShort" 218 "DFC_Com293hAbsent" 219 "DFC_Com293hChecksum" 220 "DFC_Com293hCounter" 221 "DFC_Com293hTooShort" 222 "DFC_Com308hAbsent" 223 "DFC_Com308hChecksum" 224 "DFC_Com308hCounter" 225 "DFC_Com308hTooShort" 226 "DFC_Com318hAbsent" 227 "DFC_Com318hChecksum" 228 "DFC_Com318hCounter" 229 "DFC_Com318hTooShort" 230 "DFC_Com325hAbsent" 231 "DFC_Com325hChecksum" 232 "DFC_Com325hCounter" 233 "DFC_Com325hTooShort" 234 "DFC_Com335hAbsent" 235 "DFC_Com335hChecksum" 236 "DFC_Com335hCounter" 237 "DFC_Com335hTooShort" 238 "DFC_Com351hAbsent" 239 "DFC_Com351hTooShort" 240 "DFC_Com38DhAbsent" 241 "DFC_Com38DhChecksum" 242 "DFC_Com38DhCounter" 243 "DFC_Com38DhTooShort" 244 "DFC_Com412hAbsent" 245 "DFC_Com412hChecksum" 246 "DFC_Com412hCounter" 247 "DFC_Com412hTooShort" 248 "DFC_Com427hAbsent" 249 "DFC_Com427hTooShort" 250 "DFC_Com432hAbsent" 251 "DFC_Com432hChecksum" 252 "DFC_Com432hCounter" 253 "DFC_Com432hTooShort" 254 "DFC_Com435hAbsent" 255 "DFC_Com435hTooShort" 256 "DFC_Com442hAbsent" 257 "DFC_Com442hTooShort" 258 "DFC_Com453hAbsent" 259 "DFC_Com453hTooShort" 260 "DFC_Com455hAbsent" 261 "DFC_Com455hTooShort" 262 "DFC_Com463hAbsent" 263 "DFC_Com463hTooShort" 264 "DFC_Com473hAbsent" 265 "DFC_Com473hTooShort" 266 "DFC_Com47BhAbsent" 267 "DFC_Com47BhTooShort" 268 "DFC_Com48BhAbsent" 269 "DFC_Com48BhTooShort" 270 "DFC_Com497hTooShort" 271 "DFC_Com4F2hAbsent" 272 "DFC_Com4F2hChecksum" 273 "DFC_Com4F2hCounter" 274 "DFC_Com4F2hTooShort" 275 "DFC_Com50DhAbsent" 276 "DFC_Com50DhTooShort" 277 "DFC_Com535hAbsent" 278 "DFC_Com535hTooShort" 279 "DFC_Com543hAbsent" 280 "DFC_Com543hTooShort" 281 "DFC_Com552hAbsent" 282 "DFC_Com552hTooShort" 283 "DFC_Com583hAbsent" 284 "DFC_Com583hTooShort" 285 "DFC_Com592hAbsent" 286 "DFC_Com592hChecksum" 287 "DFC_Com592hCounter" 288 "DFC_Com592hTooShort" 289 "DFC_Com595hAbsent" 290 "DFC_Com595hChecksum" 291 "DFC_Com595hCounter" 292 "DFC_Com595hTooShort" 293 "DFC_Com5B2hAbsent" 294 "DFC_Com5B2hTooShort" 295 "DFC_Com5B5hAbsent" 296 "DFC_Com5B5hChecksum" 297 "DFC_Com5B5hCounter" 298 "DFC_Com5B5hTooShort" 299 "DFC_Com5C7hTooShort" 300 "DFC_Com5E7hAbsent" 301 "DFC_Com5E7hTooShort" 302 "DFC_Com635hTooShort" 303 "DFC_Com645hTooShort" 304 "DFC_Com663hAbsent" 305 "DFC_Com663hTooShort" 306 "DFC_Com665hAbsent" 307 "DFC_Com665hTooShort" 308 "DFC_Com675hAbsent" 309 "DFC_Com675hTooShort" 310 "DFC_ComFrbd_205h_HVBAT_PACK_CURRENT" 311 "DFC_ComFrbd_205h_HVBAT_SOC_DISPLAY" 312 "DFC_ComFrbd_205h_HVBAT_VOLTAGE" 313 "DFC_ComFrbd_217h_INV_DC_BUS_VOLTAGE" 314 "DFC_ComFrbd_217h_INV_MTR_ACTUAL_TRQ" 315 "DFC_ComFrbd_217h_INV_MTR_SPEED" 316 "DFC_ComFrbd_217h_INV_MTR_TRQ" 317 "DFC_ComFrbd_227h_INV_DC_CURRENT" 318 "DFC_ComFrbd_227h_INV_MOTORING_PEAK_TRQ" 319 "DFC_ComFrbd_227h_INV_MTR_INST_INPUT_POWER" 320 "DFC_ComFrbd_227h_INV_REGEN_PEAK_TRQ" 321 "DFC_ComFrbd_237h_INV_ACTIVE_DISCHARGE_STATUS" 322 "DFC_ComFrbd_237h_INV_CTRL_MODE_ACK" 323 "DFC_ComFrbd_237h_INV_EV_WARNING" 324 "DFC_ComFrbd_237h_INV_FAULT_LEVEL" 325 "DFC_ComFrbd_237h_INV_MASTER_STOP" 326 "DFC_ComFrbd_237h_INV_SERVICE_DUE" 327 "DFC_ComFrbd_237h_INV_STAB_MIN_TRQ" 328 "DFC_ComFrbd_259h_TGLM_FAILURE_STATE" 329 "DFC_ComFrbd_259h_TGLM_MODE_PUSH" 330 "DFC_ComFrbd_259h_TOGGLE_MONOSTABLE_POS" 331 "DFC_ComFrbd_273h_OBC_outputpower_capability" 332 "DFC_ComFrbd_275h_HVBAT_DISCHARGE_30S_AVAILABLE_CURRENT" 333 "DFC_ComFrbd_275h_HVBAT_DISCHARGE_30S_AVAILABLE_POWER" 334 "DFC_ComFrbd_283h_DCDC_IN_CURRENT" 335 "DFC_ComFrbd_283h_DCDC_IN_VOLTAGE" 336 "DFC_ComFrbd_283h_DCDC_OUT_CURRENT" 337 "DFC_ComFrbd_283h_DCDC_OUT_VOLTAGE" 338 "DFC_ComFrbd_285h_HVBAT_REGEN_CHG_30S_CURRENT_LIMIT" 339 "DFC_ComFrbd_285h_HVBAT_REGEN_CHRG_30S_POWER_LIMIT" 340 "DFC_ComFrbd_293h_DCDC_outputpower_capability" 341 "DFC_ComFrbd_325h_HVBAT_INSULATION_RESISTANCE" 342 "DFC_ComFrbd_325h_HVBAT_TEMPERATURE" 343 "DFC_ComFrbd_335h_HVBAT_CHRG_CONTINUOUS_CURR_MAX" 344 "DFC_ComFrbd_335h_HVBAT_CHRG_COTINUOUS_CURR_REQ" 345 "DFC_ComFrbd_335h_HVBAT_CHRG_MAX_VOLT" 346 "DFC_ComFrbd_335h_HVBAT_DC_BUS_VOLTAGE" 347 "DFC_ComFrbd_427h_INV_OP_MODE" 348 "DFC_ComFrbd_427h_INV_PERMISIBLE_TORQUE" 349 "DFC_ComFrbd_435h_HVBAT_MAX_CELL_VOLT" 350 "DFC_ComFrbd_435h_HVBAT_MAX_CELL_VOLT_NUM" 351 "DFC_ComFrbd_435h_HVBAT_MAX_SENSOR_TEMP" 352 "DFC_ComFrbd_435h_HVBAT_MIN_CELL_VOLT" 353 "DFC_ComFrbd_435h_HVBAT_MIN_CELL_VOLT_NUM" 354 "DFC_ComFrbd_453h_OBC_IN_CURRENT" 355 "DFC_ComFrbd_453h_OBC_IN_VOLTAGE" 356 "DFC_ComFrbd_453h_OBC_IP_POWER" 357 "DFC_ComFrbd_455h_HVBAT_NOMINAL_VOLTAGE" 358 "DFC_ComFrbd_463h_OBC_OUT_CURRENT" 359 "DFC_ComFrbd_463h_OBC_OUT_VOLTAGE" 360 "DFC_ComFrbd_463h_OBC_TEMPERATURE" 361 "DFC_ComFrbd_473h_DCDC_Coolant_Temperature" 362 "DFC_ComFrbd_473h_DCDC_TEMPERATURE" 363 "DFC_ComFrbd_47Bh_eCOMP_BusBarCurrent" 364 "DFC_ComFrbd_47Bh_eCOMP_BusBarVoltage" 365 "DFC_ComFrbd_47Bh_eCOMP_CompressorSpeed" 366 "DFC_ComFrbd_47Bh_eCOMP_IGBT_Temp" 367 "DFC_ComFrbd_47Bh_eCOMP_PeakPhaCurrent" 368 "DFC_ComFrbd_47Bh_eCOMP_Power_consumption" 369 "DFC_ComFrbd_48Bh_eCOMP_Fault_Level" 370 "DFC_ComFrbd_4F2h_VALEUR_SOC_ETENDUE" 371 "DFC_ComFrbd_535h_HV_BATT_TEMP_AVG" 372 "DFC_ComFrbd_543h_HVBAT_RESTBATTENERGY" 373 "DFC_ComFrbd_543h_HVBAT_SOH" 374 "DFC_ComFrbd_543h_HV_BATT_SOH_RES" 375 "DFC_ComFrbd_592h_IBATT_1" 376 "DFC_ComFrbd_592h_IBATT_2" 377 "DFC_ComFrbd_592h_IBATT_3" 378 "DFC_ComFrbd_592h_TEMP_BATT" 379 "DFC_ComFrbd_592h_U_BATT_BECB" 380 "DFC_ComFrbd_595h_HVBAT_TIME_TO_CHRG_80" 381 "DFC_ComFrbd_5B2h_TEMP_AIR_EXT" 382 "DFC_ComFrbd_635h_HVBAT_NEG_CONT_COUNT_SEG1" 383 "DFC_ComFrbd_635h_HVBAT_NEG_CONT_COUNT_SEG3" 384 "DFC_ComFrbd_635h_HVBAT_NEG_CONT_COUNT_SEG4" 385 "DFC_ComFrbd_635h_HVBAT_PST_CONT_COUNT_SEG1" 386 "DFC_ComFrbd_635h_HVBAT_PST_CONT_COUNT_SEG3" 387 "DFC_ComFrbd_635h_HVBAT_PST_CONT_COUNT_SEG4" 388 "DFC_ComFrbd_645h_HVBAT_PRECHRGE_CONT_COUNT_SEG1" 389 "DFC_ComFrbd_645h_HVBAT_PRECHRGE_CONT_COUNT_SEG2" 390 "DFC_ComFrbd_675h_HVBAT_REMAININGBATTCAPACITY" 391 "DFC_ComInvld_205h_HVBAT_CHARGING_STATUS" 392 "DFC_ComInvld_205h_HVBAT_PACK_CURRENT" 393 "DFC_ComInvld_205h_HVBAT_SOC_DISPLAY" 394 "DFC_ComInvld_205h_HVBAT_VOLTAGE" 395 "DFC_ComInvld_217h_INV_DC_BUS_VOLTAGE" 396 "DFC_ComInvld_217h_INV_MTR_ACTUAL_TRQ" 397 "DFC_ComInvld_217h_INV_MTR_SPEED" 398 "DFC_ComInvld_217h_INV_MTR_TRQ" 399 "DFC_ComInvld_227h_INV_DC_CURRENT" 400 "DFC_ComInvld_227h_INV_MOTORING_PEAK_TRQ" 401 "DFC_ComInvld_227h_INV_MTR_INST_INPUT_POWER" 402 "DFC_ComInvld_227h_INV_REGEN_PEAK_TRQ" 403 "DFC_ComInvld_237h_INV_ACTIVE_DISCHARGE_STATUS" 404 "DFC_ComInvld_237h_INV_FAULT_LEVEL" 405 "DFC_ComInvld_237h_INV_STAB_MIN_TRQ" 406 "DFC_ComInvld_259h_TGLM_MODE_PUSH" 407 "DFC_ComInvld_259h_TOGGLE_MONOSTABLE_POS" 408 "DFC_ComInvld_26h_AC_SWITCH_REQ" 409 "DFC_ComInvld_26h_BLOWER_POSITION" 410 "DFC_ComInvld_26h_EVAP_SENSOR_FAULT" 411 "DFC_ComInvld_26h_EVAP_SENSOR_VALUE" 412 "DFC_ComInvld_26h_POTENTIOMETER_FAULT" 413 "DFC_ComInvld_26h_REAR_DEFOG_REQ" 414 "DFC_ComInvld_26h_TEMP_POSITION" 415 "DFC_ComInvld_273h_OBC_FAULT_LEVEL" 416 "DFC_ComInvld_273h_OBC_outputpower_capability" 417 "DFC_ComInvld_275h_HVBAT_DISCHARGE_30S_AVAILABLE_CURRENT" 418 "DFC_ComInvld_275h_HVBAT_DISCHARGE_30S_AVAILABLE_POWER" 419 "DFC_ComInvld_283h_DCDC_IN_CURRENT" 420 "DFC_ComInvld_283h_DCDC_IN_VOLTAGE" 421 "DFC_ComInvld_283h_DCDC_OUT_CURRENT" 422 "DFC_ComInvld_283h_DCDC_OUT_VOLTAGE" 423 "DFC_ComInvld_285h_HVBAT_REGEN_CHG_30S_CURRENT_LIMIT" 424 "DFC_ComInvld_285h_HVBAT_REGEN_CHRG_30S_POWER_LIMIT" 425 "DFC_ComInvld_293h_DCDC_FAULT_LEVEL" 426 "DFC_ComInvld_293h_DCDC_outputpower_capability" 427 "DFC_ComInvld_325h_HVBAT_EPLUG_STATUS" 428 "DFC_ComInvld_325h_HVBAT_HVIL_STS" 429 "DFC_ComInvld_325h_HVBAT_INSULATION_FAULT" 430 "DFC_ComInvld_325h_HVBAT_INSULATION_RESISTANCE" 431 "DFC_ComInvld_325h_HVBAT_TEMPERATURE" 432 "DFC_ComInvld_335h_HVBAT_CHRG_CONTINUOUS_CURR_MAX" 433 "DFC_ComInvld_335h_HVBAT_CHRG_COTINUOUS_CURR_REQ" 434 "DFC_ComInvld_335h_HVBAT_CHRG_MAX_VOLT" 435 "DFC_ComInvld_335h_HVBAT_DC_BUS_VOLTAGE" 436 "DFC_ComInvld_38Dh_VITESSE_VEHICULE_ROUES" 437 "DFC_ComInvld_38Dh_VVH_INDISP" 438 "DFC_ComInvld_427h_INV_COOLANT_TEMP" 439 "DFC_ComInvld_427h_INV_MOTOR_TEMP" 440 "DFC_ComInvld_427h_INV_OP_MODE" 441 "DFC_ComInvld_427h_INV_PERMISIBLE_TORQUE" 442 "DFC_ComInvld_427h_INV_TEMP" 443 "DFC_ComInvld_432h_REVEIL_PRINCIPAL" 444 "DFC_ComInvld_435h_HVBAT_MAX_CELL_VOLT" 445 "DFC_ComInvld_435h_HVBAT_MAX_CELL_VOLT_NUM" 446 "DFC_ComInvld_435h_HVBAT_MAX_SENSOR_TEMP" 447 "DFC_ComInvld_435h_HVBAT_MIN_CELL_VOLT" 448 "DFC_ComInvld_435h_HVBAT_MIN_CELL_VOLT_NUM" 449 "DFC_ComInvld_442h_BCCM_BLOWER_RELAY_STS" 450 "DFC_ComInvld_453h_OBC_IN_CURRENT" 451 "DFC_ComInvld_453h_OBC_IN_VOLTAGE" 452 "DFC_ComInvld_453h_OBC_IP_POWER" 453 "DFC_ComInvld_455h_HVBAT_NOMINAL_VOLTAGE" 454 "DFC_ComInvld_463h_OBC_OUT_CURRENT" 455 "DFC_ComInvld_463h_OBC_OUT_VOLTAGE" 456 "DFC_ComInvld_463h_OBC_TEMPERATURE" 457 "DFC_ComInvld_473h_DCDC_Coolant_Temperature" 458 "DFC_ComInvld_473h_DCDC_TEMPERATURE" 459 "DFC_ComInvld_47Bh_eCOMP_BusBarCurrent" 460 "DFC_ComInvld_47Bh_eCOMP_BusBarVoltage" 461 "DFC_ComInvld_47Bh_eCOMP_CompressorSpeed" 462 "DFC_ComInvld_47Bh_eCOMP_IGBT_Temp" 463 "DFC_ComInvld_47Bh_eCOMP_PeakPhaCurrent" 464 "DFC_ComInvld_47Bh_eCOMP_Power_consumption" 465 "DFC_ComInvld_4F2h_STATUS_SOC" 466 "DFC_ComInvld_4F2h_TEMP_BATT_STATUS" 467 "DFC_ComInvld_4F2h_VALEUR_SOC_ETENDUE" 468 "DFC_ComInvld_535h_HV_BATT_TEMP_AVG" 469 "DFC_ComInvld_543h_HVBAT_RESTBATTENERGY" 470 "DFC_ComInvld_543h_HVBAT_SOH" 471 "DFC_ComInvld_543h_HV_BATT_SOH_RES" 472 "DFC_ComInvld_552h_CPT_TEMPOREL" 473 "DFC_ComInvld_552h_KILOMETRAGE" 474 "DFC_ComInvld_583h_HV_BATT_DISCONT_CSE_OPEN" 475 "DFC_ComInvld_592h_CALIBRE_IBATT" 476 "DFC_ComInvld_592h_IBATT_1" 477 "DFC_ComInvld_592h_IBATT_2" 478 "DFC_ComInvld_592h_IBATT_3" 479 "DFC_ComInvld_592h_TEMP_BATT" 480 "DFC_ComInvld_592h_U_BATT_BECB" 481 "DFC_ComInvld_595h_HVBAT_TIME_TO_CHRG_80" 482 "DFC_ComInvld_5B2h_TEMP_AIR_EXT" 483 "DFC_ComInvld_5B5h_HVBAT_THERMAL_RUNAWAY" 484 "DFC_ComInvld_635h_HVBAT_NEG_CONT_COUNT_SEG1" 485 "DFC_ComInvld_635h_HVBAT_NEG_CONT_COUNT_SEG3" 486 "DFC_ComInvld_635h_HVBAT_NEG_CONT_COUNT_SEG4" 487 "DFC_ComInvld_635h_HVBAT_PST_CONT_COUNT_SEG1" 488 "DFC_ComInvld_635h_HVBAT_PST_CONT_COUNT_SEG3" 489 "DFC_ComInvld_635h_HVBAT_PST_CONT_COUNT_SEG4" 490 "DFC_ComInvld_645h_HVBAT_PRECHRGE_CONT_COUNT_SEG1" 491 "DFC_ComInvld_645h_HVBAT_PRECHRGE_CONT_COUNT_SEG2" 492 "DFC_ComInvld_675h_HVBAT_REMAININGBATTCAPACITY" 493 "DFC_ACCmprFltLvl1" 494 "DFC_ACCmprFltLvl2" 495 "DFC_ACCmprFltLvl3" 496 "DFC_ACCmprFltLvl4" 497 "DFC_ACCmprHiPFlt" 498 "DFC_ACCmprInvldCmprSt" 499 "DFC_ACCmprInvldElecActPwr" 500 "DFC_ACCmprLoPFlt" 501 "DFC_AcChrgrIntkTSRCMin" 502 "DFC_BattUBMaxBatt" 503 "DFC_BattUBMaxNoBatt" 504 "DFC_BattUBMinBatt" 505 "DFC_BattUBMinNoBatt" 506 "DFC_BattUSRCMax" 507 "DFC_BattUSRCMin" 508 "DFC_BrkBstPHiCautionDfct" 509 "DFC_BrkBstPHiWarnDfct" 510 "DFC_BrkBstPSnsr12PlausDfct" 511 "DFC_BrkBstPSnsr1Scb" 512 "DFC_BrkBstPSnsr1Scg" 513 "DFC_BrkBstPSnsr2Scb" 514 "DFC_BrkBstPSnsr2Scg" 515 "DFC_BrkBstPSnsrMax" 516 "DFC_BrkBstPSnsrMin" 517 "DFC_BrkBstPhyRngChkMax" 518 "DFC_BrkBstPhyRngChkMin" 519 "DFC_BrkBstPmpHsScb" 520 "DFC_BrkBstPmpHsScg" 521 "DFC_BrkBstPmpLsOl" 522 "DFC_BrkBstPmpLsScb" 523 "DFC_BrkBstPmpLsScg" 524 "DFC_CbnHeatgHeatrRlyOpend" 525 "DFC_CbnHeatgHeatrRlyWldd" 526 "DFC_CcsDcIBattExcdd" 527 "DFC_CcsDcIEvseOutDe" 528 "DFC_CcsDcIOutDe" 529 "DFC_CcsDcIOutExcdd" 530 "DFC_CcsDcUOutDe" 531 "DFC_CcsDcUOutExcdd" 532 "DFC_CcsPwrLineChpRstOL" 533 "DFC_CcsPwrLineChpRstOvrTemp" 534 "DFC_CcsPwrLineChpRstSCB" 535 "DFC_CcsPwrLineChpRstSCG" 536 "DFC_CcsPwrLineChpVccEnaOL" 537 "DFC_CcsPwrLineChpVccEnaOvrTemp" 538 "DFC_CcsPwrLineChpVccEnaSCB" 539 "DFC_CcsPwrLineChpVccEnaSCG" 540 "DFC_CcsPwrLineChpVccSRCMin" 541 "DFC_CcsPwrLineComChpTSRCMin" 542 "DFC_CtPSwtActrOL" 543 "DFC_CtPSwtActrOvrTemp" 544 "DFC_CtPSwtActrSCB" 545 "DFC_CtPSwtActrSCG" 546 "DFC_CtPSwtDiagSRCMin" 547 "DFC_CtpCarrFrqSRCMin" 548 "DFC_DcChrgrIntkT2SRCMin" 549 "DFC_DcChrgrIntkTSRCMin" 550 "DFC_DevLibBattUHi" 551 "DFC_DevLibBattULo" 552 "DFC_EmWakeupSigOL" 553 "DFC_EmWakeupSigOvrTemp" 554 "DFC_EmWakeupSigSCB" 555 "DFC_EmWakeupSigSCG" 556 "DFC_Fan1OL" 557 "DFC_Fan1OvrTemp" 558 "DFC_Fan1SCB" 559 "DFC_FanRlySCB" 560 "DFC_FanRlySCG" 561 "DFC_FanSpdSRCMin" 562 "DFC_FreonPSRCMin" 563 "DFC_HLCCcsPLnCChipTHi" 564 "DFC_HeatrCoreTSRCMin" 565 "DFC_PwmCtPSRCMin" 566 "DFC_PwrDistbnUnitTSRCMin" 567 "DFC_SCtPmp1OL" 568 "DFC_SCtPmp1OvrTemp" 569 "DFC_SCtPmp1SCB" 570 "DFC_SCtPmpRlyOL" 571 "DFC_SCtPmpRlyOvrTemp" 572 "DFC_SCtPmpRlySCB" 573 "DFC_SpplCooltPmpRlyOL" 574 "DFC_SpplCooltPmpRlyOvrTemp" 575 "DFC_SpplCooltPmpRlySCB" 576 "DFC_UCtPSRCMin" 577 "DFC_UPxP1SRCMin" 578 "DFC_ComHSN1CANMute" 579 "DFC_ComHSN3CANMute" 580 "DFC_AcChrgrIntkTPhysRngHi" 581 "DFC_AcChrgrIntkTPhysRngLo" 582 "DFC_AcChrgrIntkTSRCOpn" 583 "DFC_CcsPwrLineChpVccPhysRngHi" 584 "DFC_CcsPwrLineChpVccPhysRngLo" 585 "DFC_CcsPwrLineChpVccSRCOpn" 586 "DFC_CcsPwrLineComChpTPhysRngHi" 587 "DFC_CcsPwrLineComChpTPhysRngLo" 588 "DFC_CcsPwrLineComChpTSRCOpn" 589 "DFC_CtPSwtDiagPhysRngHi" 590 "DFC_CtPSwtDiagPhysRngLo" 591 "DFC_CtPSwtDiagSRCOpn" 592 "DFC_CtpCarrFrqPhysRngHi" 593 "DFC_CtpCarrFrqPhysRngLo" 594 "DFC_CtpCarrFrqSRCMax" 595 "DFC_DcChrgrIntkT2PhysRngHi" 596 "DFC_DcChrgrIntkT2PhysRngLo" 597 "DFC_DcChrgrIntkT2SRCOpn" 598 "DFC_DcChrgrIntkTPhysRngHi" 599 "DFC_DcChrgrIntkTPhysRngLo" 600 "DFC_DcChrgrIntkTSRCOpn" 601 "DFC_Fan1SCG" 602 "DFC_FanSpdPhysRngHi" 603 "DFC_FanSpdPhysRngLo" 604 "DFC_FanSpdSRCOpn" 605 "DFC_FreonPPhysRngHi" 606 "DFC_FreonPPhysRngLo" 607 "DFC_FreonPSRCOpn" 608 "DFC_HeatrCoreTPhysRngHi" 609 "DFC_HeatrCoreTPhysRngLo" 610 "DFC_HeatrCoreTSRCOpn" 611 "DFC_HvGridUMaxSftyLim" 612 "DFC_HvGridUMinSftyLim" 613 "DFC_HvGridUPlausy" 614 "DFC_IntlckChrgPlgHBrgOpnLd" 615 "DFC_IntlckChrgPlgHBrgOvrCurr" 616 "DFC_IntlckChrgPlgHBrgOvrTemp" 617 "DFC_IntlckChrgPlgHBrgShCirBatt1" 618 "DFC_IntlckChrgPlgHBrgShCirBatt2" 619 "DFC_IntlckChrgPlgHBrgShCirGnd1" 620 "DFC_IntlckChrgPlgHBrgShCirGnd2" 621 "DFC_IntlckChrgPlgHBrgShCirOvrLd" 622 "DFC_IntlckChrgPlgHBrgTempOvrCurr" 623 "DFC_IntlckChrgPlgHBrgUndrVltg" 624 "DFC_IntlckChrgPlgPosnRngFlt" 625 "DFC_IntlckChrgPlgPosnSrcMax" 626 "DFC_IntlckChrgPlgPosnSrcMin" 627 "DFC_PwmCtPPhysRngHi" 628 "DFC_PwmCtPPhysRngLo" 629 "DFC_PwmCtPSRCMax" 630 "DFC_PwrDistbnUnitTPhysRngHi" 631 "DFC_PwrDistbnUnitTPhysRngLo" 632 "DFC_PwrDistbnUnitTSRCOpn" 633 "DFC_SCtPmpRlySCG" 634 "DFC_SpplCooltPmpRlySCG" 635 "DFC_UCtPPhysRngHi" 636 "DFC_UCtPPhysRngLo" 637 "DFC_UCtPSRCOpn" 638 "DFC_UPxP1PhysRngHi" 639 "DFC_UPxP1PhysRngLo" 640 "DFC_UPxP1SRCOpn" 641 "DFC_VehVPhysRngHi" 642 "DFC_VehVPhysRngLo" 643 "DFC_VehVSigCan" 644 "DFC_VehVSigCanSafe" 645 "DFC_SCtPmp1DiagGrdKey1" 646 "DFC_SCtPmp1DiagGrdKey2" 647 "DFC_SCtPmp1DiagGrdKey3" 648 "DFC_SCtPmp1DiagGrdKey4" 649 "DFC_SCtPmp1DiagGrdKey5" 650 "DFC_ChrgPlgLiveCntctHzrdCcs" 651 "DFC_ChrgPlgProxPltImps" 652 "DFC_ChrgPlgTHiCcsDc" 653 "DFC_ElMActvDchaFailr" 654 "DFC_ElMActvDchaFlt" 655 "DFC_ElMFbdnIvtrModDrv01" 656 "DFC_ElMImobAuthent" 657 "DFC_ElMIsoMonFlt" 658 "DFC_ElMIsoMonPlausyFlt" 659 "DFC_ElMIvtrCooltT01" 660 "DFC_ElMIvtrEmgyShtDwn01" 661 "DFC_ElMIvtrFailr01" 662 "DFC_ElMIvtrIntlck01" 663 "DFC_ElMIvtrTErr01" 664 "DFC_ElMOverSpdNeg01" 665 "DFC_ElMOverSpdPos01" 666 "DFC_ElMOverTqNeg01" 667 "DFC_ElMOverTqPos01" 668 "DFC_ElMPwrAuthn" 669 "DFC_ElMSpdErr01" 670 "DFC_ElMSvs01" 671 "DFC_PEnvCcMax" 672 "DFC_PEnvCcMin" 673 "DFC_PEnvRngChkMax" 674 "DFC_PEnvRngChkMin" 675 "DFC_PEnvSnsrPlaus" 676 "DFC_BrkBstPmpPlausGenn" 677 "DFC_CbnHeatrRlyLfLoWarn" 678 "DFC_ChgrPlugLockPinByndClsd" 679 "DFC_ChgrPlugLockPinMoveWoCmd" 680 "DFC_ChgrPlugLockPinStuckInClsd" 681 "DFC_ChgrPlugLockPinStuckInOpen" 682 "DFC_ChrgrStErr" 683 "DFC_ComHSN1BusOff" 684 "DFC_ComHSN3BusOff" 685 "DFC_ComVCInval" 686 "DFC_EemDcdcPrecSpdInhb" 687 "DFC_ExpPwrLatch" 688 "DFC_FanMaxOvrd" 689 "DFC_HLCCcsGnrlComErr" 690 "DFC_InmLINNodeHVACPanelAbsnt" 691 "DFC_ResetRcvNotAllwd" 692 "DFC_TelltlCooltPlaus" 693 "DFC_MRlyOL" 694 "DFC_MRlySCB" 695 "DFC_MRlySCG" 696 "DFC_SSpMon1" 697 "DFC_SSpMon1OV" 698 "DFC_SSpMon1SCG" 699 "DFC_SSpMon1UV" 700 "DFC_SSpMon2" 701 "DFC_SSpMon2OV" 702 "DFC_SSpMon2SCG" 703 "DFC_SSpMon2UV" 704 "DFC_SSpMon3" 705 "DFC_SSpMon3OV" 706 "DFC_SSpMon3SCG" 707 "DFC_SSpMon3UV" 708 "DFC_CANSM_E_BUS_OFF_NETWORK_HSN1_CAN" 709 "DFC_CANSM_E_BUS_OFF_NETWORK_HSN3_CAN" 710 "DFC_CANSM_E_BUS_OFF_NETWORK_HSN4_CAN" 711 "DFC_CANSM_E_BUS_OFF_NETWORK_XCP_CAN" 712 "DFC_CANTRCV_E_NO_TRCV_CONTROL_0" 713 "DFC_CAN_E_TIMEOUT" 714 "DFC_COMM_E_NET_START_IND_CHANNEL_0" 715 "DFC_COMM_E_NET_START_IND_CHANNEL_1" 716 "DFC_COMM_E_NET_START_IND_CHANNEL_2" 717 "DFC_COMM_E_NET_START_IND_CHANNEL_3" 718 "DFC_COMM_E_NET_START_IND_CHANNEL_4" 719 "DFC_COMM_E_NET_START_IND_CHANNEL_5" 720 "DFC_LIN_E_TIMEOUT" 721 "DFC_rba_EcuCtrl_TOMaxProlg" 722 "DFC_rba_EcuCtrl_TOMaxShutDwn" 723 "DFC_rba_MultiStackTrace_Threshold" 724 "DFC_rba_SyC_CustStates_Degraded_disord_Event" 725 "DFC_rba_SyC_CustStates_Degraded_incst_Event" 726 "DFC_rba_SyC_CustStates_TransNoWakReq_Event" 727 "DFC_RBA_IOEXTLIB_KEEPALIVE_DRV" 728 "DFC_RBA_IOEXTLIB_KEEPALIVE_INI" 729 "DFC_rba_IoSigRtc_StopCounter" 730 "DFC_rba_MRly_Diag_Stk_Event" 731 "DFC_rba_MemDiag_MemReadErr" 732 "DFC_rba_MemDiag_MemWrErr" 733 "DFC_rba_SyC_IrrSwOffTrigEngRun_Event" 734 "DFC_AcChrgrIntkTSRCMax" 735 "DFC_AcChrgrIntkTTmpErr" 736 "DFC_AcFlt" 737 "DFC_AppAllSnsrDfct" 738 "DFC_BattUPwrFail" 739 "DFC_BrkBstBkupOvrn" 740 "DFC_BrkBstPmpOvld" 741 "DFC_BrkPlausChk" 742 "DFC_CbnHeatgSwtTmpErr" 743 "DFC_CcsPwrLineChpVccSRCMax" 744 "DFC_CcsPwrLineChpVccTmpErr" 745 "DFC_CcsPwrLineComChpTSRCMax" 746 "DFC_CcsPwrLineComChpTTmpErr" 747 "DFC_ChgrPlugCtpCarrFrqErr" 748 "DFC_ChgrPlugCtpSwtStuckClsd" 749 "DFC_ChgrPlugCtpSwtStuckOpen" 750 "DFC_ChgrPlugCtpUErrHi" 751 "DFC_ChgrPlugPxp1SrcErr" 752 "DFC_ChrgCntctAllWldd" 753 "DFC_ChrgCntctNegOperErr" 754 "DFC_ChrgCntctNegOperWarn" 755 "DFC_ChrgCntctNegWldd" 756 "DFC_ChrgCntctPosOperErr" 757 "DFC_ChrgCntctPosOperWarn" 758 "DFC_ChrgCntctPosWldd" 759 "DFC_ChrgCntctStuckOpen" 760 "DFC_ChrgPlgIntlckFaild" 761 "DFC_ChrgnUnplRqrd" 762 "DFC_CoElMOffsCalibActv01" 763 "DFC_CtPSwtDiagSRCMax" 764 "DFC_CtPSwtDiagTmpErr" 765 "DFC_CtpCarrFrqTmpErr" 766 "DFC_DcChrgrIntkT2SRCMax" 767 "DFC_DcChrgrIntkT2TmpErr" 768 "DFC_DcChrgrIntkTSRCMax" 769 "DFC_DcChrgrIntkTTmpErr" 770 "DFC_EChrDvPlinCntrThdExcdd" 771 "DFC_EemDiagCtctrClsTout" 772 "DFC_EemDiagDcdcOffTOut" 773 "DFC_EemDiagHvCnsrOffTOut" 774 "DFC_EemDiagHvbOffTOut" 775 "DFC_FanSpdSRCMax" 776 "DFC_FanSpdTmpErr" 777 "DFC_FreonPSRCMax" 778 "DFC_FreonPTmpErr" 779 "DFC_HeatrCoreTSRCMax" 780 "DFC_HeatrCoreTTmpErr" 781 "DFC_HvGridSocMinLim" 782 "DFC_HvacBlwrFrntFlt" 783 "DFC_HvacEvapElecFlt" 784 "DFC_HvacEvapElecFltGnd" 785 "DFC_HvacKnobPosnFlt" 786 "DFC_InvBinID" 787 "DFC_InvCalID" 788 "DFC_InvErotan" 789 "DFC_InvVinID" 790 "DFC_MOXEMM_SMU_ALM0_0" 791 "DFC_MOXEMM_SMU_ALM0_1" 792 "DFC_MOXEMM_SMU_ALM0_10" 793 "DFC_MOXEMM_SMU_ALM0_11" 794 "DFC_MOXEMM_SMU_ALM0_13" 795 "DFC_MOXEMM_SMU_ALM0_14" 796 "DFC_MOXEMM_SMU_ALM0_2" 797 "DFC_MOXEMM_SMU_ALM0_22" 798 "DFC_MOXEMM_SMU_ALM0_23" 799 "DFC_MOXEMM_SMU_ALM0_4" 800 "DFC_MOXEMM_SMU_ALM0_5" 801 "DFC_MOXEMM_SMU_ALM0_7" 802 "DFC_MOXEMM_SMU_ALM0_8" 803 "DFC_MOXEMM_SMU_ALM10_16" 804 "DFC_MOXEMM_SMU_ALM10_17" 805 "DFC_MOXEMM_SMU_ALM10_21" 806 "DFC_MOXEMM_SMU_ALM11_0" 807 "DFC_MOXEMM_SMU_ALM11_1" 808 "DFC_MOXEMM_SMU_ALM11_2" 809 "DFC_MOXEMM_SMU_ALM11_3" 810 "DFC_MOXEMM_SMU_ALM11_4" 811 "DFC_MOXEMM_SMU_ALM11_5" 812 "DFC_MOXEMM_SMU_ALM11_8" 813 "DFC_MOXEMM_SMU_ALM11_9" 814 "DFC_MOXEMM_SMU_ALM1_0" 815 "DFC_MOXEMM_SMU_ALM1_1" 816 "DFC_MOXEMM_SMU_ALM1_10" 817 "DFC_MOXEMM_SMU_ALM1_11" 818 "DFC_MOXEMM_SMU_ALM1_13" 819 "DFC_MOXEMM_SMU_ALM1_14" 820 "DFC_MOXEMM_SMU_ALM1_2" 821 "DFC_MOXEMM_SMU_ALM1_22" 822 "DFC_MOXEMM_SMU_ALM1_23" 823 "DFC_MOXEMM_SMU_ALM1_4" 824 "DFC_MOXEMM_SMU_ALM1_5" 825 "DFC_MOXEMM_SMU_ALM1_7" 826 "DFC_MOXEMM_SMU_ALM1_8" 827 "DFC_MOXEMM_SMU_ALM21_0" 828 "DFC_MOXEMM_SMU_ALM21_16" 829 "DFC_MOXEMM_SMU_ALM21_3" 830 "DFC_MOXEMM_SMU_ALM2_1" 831 "DFC_MOXEMM_SMU_ALM2_10" 832 "DFC_MOXEMM_SMU_ALM2_11" 833 "DFC_MOXEMM_SMU_ALM2_13" 834 "DFC_MOXEMM_SMU_ALM2_14" 835 "DFC_MOXEMM_SMU_ALM2_22" 836 "DFC_MOXEMM_SMU_ALM2_23" 837 "DFC_MOXEMM_SMU_ALM2_4" 838 "DFC_MOXEMM_SMU_ALM2_5" 839 "DFC_MOXEMM_SMU_ALM2_7" 840 "DFC_MOXEMM_SMU_ALM2_8" 841 "DFC_MOXEMM_SMU_ALM6_0" 842 "DFC_MOXEMM_SMU_ALM6_11" 843 "DFC_MOXEMM_SMU_ALM6_12" 844 "DFC_MOXEMM_SMU_ALM6_14" 845 "DFC_MOXEMM_SMU_ALM6_15" 846 "DFC_MOXEMM_SMU_ALM6_17" 847 "DFC_MOXEMM_SMU_ALM6_18" 848 "DFC_MOXEMM_SMU_ALM6_20" 849 "DFC_MOXEMM_SMU_ALM6_21" 850 "DFC_MOXEMM_SMU_ALM6_25" 851 "DFC_MOXEMM_SMU_ALM6_4" 852 "DFC_MOXEMM_SMU_ALM6_5" 853 "DFC_MOXEMM_SMU_ALM6_7" 854 "DFC_MOXEMM_SMU_ALM6_8" 855 "DFC_MOXEMM_SMU_ALM7_1" 856 "DFC_MOXEMM_SMU_ALM7_12" 857 "DFC_MOXEMM_SMU_ALM7_13" 858 "DFC_MOXEMM_SMU_ALM7_14" 859 "DFC_MOXEMM_SMU_ALM7_15" 860 "DFC_MOXEMM_SMU_ALM7_16" 861 "DFC_MOXEMM_SMU_ALM7_17" 862 "DFC_MOXEMM_SMU_ALM7_2" 863 "DFC_MOXEMM_SMU_ALM7_20" 864 "DFC_MOXEMM_SMU_ALM7_25" 865 "DFC_MOXEMM_SMU_ALM7_26" 866 "DFC_MOXEMM_SMU_ALM7_28" 867 "DFC_MOXEMM_SMU_ALM7_29" 868 "DFC_MOXEMM_SMU_ALM7_30" 869 "DFC_MOXEMM_SMU_ALM7_31" 870 "DFC_MOXEMM_SMU_ALM8_0" 871 "DFC_MOXEMM_SMU_ALM8_1" 872 "DFC_MOXEMM_SMU_ALM8_10" 873 "DFC_MOXEMM_SMU_ALM8_11" 874 "DFC_MOXEMM_SMU_ALM8_12" 875 "DFC_MOXEMM_SMU_ALM8_16" 876 "DFC_MOXEMM_SMU_ALM8_18" 877 "DFC_MOXEMM_SMU_ALM8_2" 878 "DFC_MOXEMM_SMU_ALM8_3" 879 "DFC_MOXEMM_SMU_ALM8_31" 880 "DFC_MOXEMM_SMU_ALM8_4" 881 "DFC_MOXEMM_SMU_ALM9_0" 882 "DFC_MOXEMM_SMU_ALM9_15" 883 "DFC_MOXEMM_SMU_ALM9_3" 884 "DFC_MoCADCNTPBnk1" 885 "DFC_MoCADCTestVoltBnk1" 886 "DFC_MoCSOPICO" 887 "DFC_MoFAccr" 888 "DFC_MoFCbnPreCdngOvrheat" 889 "DFC_MoFCbnPreCdngTmrExpi" 890 "DFC_MoFEvMngtBms" 891 "DFC_MoFEvMngtDcdc" 892 "DFC_MoFEvMngtEm01" 893 "DFC_MoFEvMngtEm01BrkgToZr" 894 "DFC_MoFEvMngtEm01EngSpd" 895 "DFC_MoFEvMngtEm02EngSpd" 896 "DFC_MoFEvMngtEm02Lvl1" 897 "DFC_MoFEvMngtEm02Lvl2" 898 "DFC_MoFExtCptAuxCpt" 899 "DFC_MoFExtCptVacPmpErr" 900 "DFC_MoFTqPtdAxle" 901 "DFC_MoFTqPtdAxleSec" 902 "DFC_MoFTqPtdEmPtRels" 903 "DFC_MoFTqPtdEmPtRelsSec" 904 "DFC_MoFTqPtdEmSign" 905 "DFC_MoFTqPtdEmSignSec" 906 "DFC_MoFTqPtdEmTq" 907 "DFC_MoFTqPtdEmTqSec" 908 "DFC_MoFTqPtdVeh" 909 "DFC_MoFVarPostBldSel" 910 "DFC_MoSysCtrlReIni" 911 "DFC_MoXEMMHwLTMCUFW" 912 "DFC_MoXEMMHwLTMonBIST" 913 "DFC_MoXEMMHwLTRegMonTest" 914 "DFC_MoXEMMHwLTStbySMUAlvTest" 915 "DFC_MoXEMMHwLTTempSens" 916 "DFC_MoXEMMHwLTUCBCfg" 917 "DFC_MonEgyChrgnCoorr_AcChrgnWoMofRels" 918 "DFC_MonEgyChrgnCoorr_ChrgnAbortIgr" 919 "DFC_MonEgyChrgnCoorr_DcCntctFailr" 920 "DFC_MonEgyChrgnCoorr_ExtChrgnShtOffReq" 921 "DFC_MonEgyChrgnCoorr_ImpsChrgnMod" 922 "DFC_MonEgyChrgnCoorr_ImpsChrgnPrms" 923 "DFC_MonEgyChrgnCoorr_ImpsUDcIntk" 924 "DFC_MonEgyChrgnCoorr_PlgLockMovmt" 925 "DFC_MonEgyChrgnCoorr_VehCrashDetn" 926 "DFC_MonEgyChrgnErrReactn_SftySwt" 927 "DFC_MonEgyChrgnInlet_CcsPlgCtp" 928 "DFC_MonEgyChrgnInlet_CcsPlgCtpPwm" 929 "DFC_MonEgyChrgnInlet_CcsPlgLockCtrlImpsAtmpt" 930 "DFC_MonEgyChrgnInlet_CcsPlgLockSnsrSigRngChk" 931 "DFC_MonEgyChrgnInlet_CcsPlgLockStImps" 932 "DFC_MonEgyChrgnInlet_CcsPlgPxp" 933 "DFC_MonEgyChrgnT_Snsr1GrdtChk" 934 "DFC_MonEgyChrgnT_Snsr1SigRngChk" 935 "DFC_MonEgyChrgnT_Snsr2GrdtChk" 936 "DFC_MonEgyChrgnT_Snsr2SigRngChk" 937 "DFC_MonEgyChrgnT_SnsrDif" 938 "DFC_OCWDAABEActv" 939 "DFC_OCWDACom" 940 "DFC_OCWDAErrPin" 941 "DFC_OCWDAOvrVltg" 942 "DFC_PUmax" 943 "DFC_PwmCtPTmpErr" 944 "DFC_PwrDistbnUnitTSRCMax" 945 "DFC_PwrDistbnUnitTTmpErr" 946 "DFC_SCtPmp1DiagGrdKeyErr" 947 "DFC_SRCHighAPP1" 948 "DFC_SRCHighAPP2" 949 "DFC_SRCLowAPP1" 950 "DFC_SRCLowAPP2" 951 "DFC_SWReset_0" 952 "DFC_SWReset_1" 953 "DFC_SWReset_2" 954 "DFC_Sia_InvldCode" 955 "DFC_Sia_InvldKey" 956 "DFC_Sia_NoRespUCx" 957 "DFC_Sia_TprotRttp" 958 "DFC_StrtUpEvStandStillDeactvn" 959 "DFC_SyncAPP" 960 "DFC_UCtPSRCMax" 961 "DFC_UCtPTmpErr" 962 "DFC_UPxP1SRCMax" 963 "DFC_UPxP1TmpErr" 964 "DFC_VehVObd" 965 "DSQ_ACCmprPwrConsol" 966 "DSQ_ACCmprUConsol" 967 "DSQ_BattU" 968 "DSQ_DSMInhibitAlways" 969 "DSQ_T15TurnOfDly" 65535 "Inhibited_Trip" DEFAULT_VALUE "---" /end COMPU_VTAB
/end MODULE
/end PROJECT

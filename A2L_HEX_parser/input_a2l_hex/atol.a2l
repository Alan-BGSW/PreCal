ASAP2_VERSION 1 70
/begin PROJECT MDG1C "VC1CP091_STLA_N_D061I3"
/begin HEADER "" VERSION "VC1CP091_STLA_N_D061I3" PROJECT_NO MDG1C /end HEADER
/begin MODULE DIM ""
/begin MOD_COMMON "" BYTE_ORDER MSB_LAST ALIGNMENT_BYTE 1 ALIGNMENT_WORD 2 ALIGNMENT_LONG 4 ALIGNMENT_INT64 4 ALIGNMENT_FLOAT32_IEEE 4 ALIGNMENT_FLOAT64_IEEE 4 DATA_SIZE 32 /end MOD_COMMON
/begin CHARACTERISTIC rba_Etks_swt3rdPartySupp_C "Enable 3rd party tool support for Etks" VALUE 0x802402E3 DefaultValueRecordLayout_AUTOSAR_Platform_BaseTypes_uint8 255.0 RB_RBA_Common_CentralElements_CompuMethods_Identical 0.0 255. FORMAT "%5.0" /end CHARACTERISTIC
/begin CHARACTERISTIC rba_Etks_stDisableDetection_C "Disable ETK-S detection, must be flashed to take Effect" VALUE 0x8024028F Val_Wu8 255.0 OneToOne 0 255.0 FORMAT "%13.2" /end CHARACTERISTIC
/*********** End of merged CHARACTERISTIC blocks ***********/
/begin CHARACTERISTIC AcChrgrIntkT_ADCCal.numSRCTempSel_C "Calibration structure for ADC and SENT / Selection of temperature for signal range check" VALUE 0x8024E90C RB_Val_Wu8 255.000000000 DELIB_ALLTEMP_VERB_COMPU 0.00 255.000000000 FORMAT "%13.9" /end CHARACTERISTIC
/begin CHARACTERISTIC AcChrgrIntkT_ADCCal.tiSRCMaxDebOK_C "Calibration structure for ADC and SENT / Error healing deounce time" VALUE 0x8024E910 RB_Val_Ws32 42949672950.0 Time_ms -21474836480.0 21474836470.0 FORMAT "%13.1" /end CHARACTERISTIC
/begin CHARACTERISTIC AcChrgrIntkT_ADCCal.uSRCMax_C "Calibration structure for ADC and SENT / Maximum threshold voltage for SRC" VALUE 0x8024E914 RB_Val_Ws16 13107.00 Volt -6553.600 6553.400 FORMAT "%8.3" /end CHARACTERISTIC
/begin CHARACTERISTIC AcChrgrIntkT_ADCCal.uSRCMin_C "Calibration structure for ADC and SENT / Minimum threshold voltage for SRC" VALUE 0x8024E916 RB_Val_Ws16 13107.00 Volt -6553.600 6553.400 FORMAT "%8.3" /end CHARACTERISTIC
/begin CHARACTERISTIC AcChrgrIntkT_ADCCal.uSRCOpn_C "Calibration structure for ADC and SENT / Maximum threshold for open SRC connection error." VALUE 0x8024E918 RB_Val_Ws16 13107.00 Volt -6553.600 6553.400 FORMAT "%8.3" /end CHARACTERISTIC
/begin CHARACTERISTIC AcChrgrIntkT_ADCSensTransf_f_CUR "" CURVE 0x80253040 RB_Curve_R32_R32_sao 2.00000000E+037 RBPtCel_t_1p0_3 -1.00000000E+037 1.00000000E+037 FORMAT "%13.3" EXTENDED_LIMITS -3.40282347E+038 3.40282347E+038
 /begin AXIS_DESCR STD_AXIS AcChrgrIntkT_uRaw_f RBPtCel_u_1p0_2 25 -1.00000000E+037 1.00000000E+037 FORMAT "%13.3" EXTENDED_LIMITS -3.40282347E+038 3.40282347E+038 DEPOSIT ABSOLUTE /end AXIS_DESCR
/end CHARACTERISTIC
/begin CHARACTERISTIC AcChrgrIntkT_DigSensCal.tiDebPos_C " / debounce time of rising edge" VALUE 0x802531C4 Val_Ws16 655350.0 Time_ms -327680.0 327670.0 FORMAT "%8.1" /end CHARACTERISTIC
/begin CHARACTERISTIC AcChrgrIntkT_DigSensCal.tiDebNeg_C " / debounce time of falling edge" VALUE 0x802531C6 Val_Ws16 655350.0 Time_ms -327680.0 327670.0 FORMAT "%8.1" /end CHARACTERISTIC
/begin CHARACTERISTIC AcChrgrIntkT_dtGradLim_f_C "" VALUE 0x802531C8 Val_Wr32 2.00000000E+037 RBPtCel_dt_1p0_1 -1.00000000E+037 1.00000000E+037 FORMAT "%13.3" EXTENDED_LIMITS -3.40282347E+038 3.40282347E+038 /end CHARACTERISTIC
/begin CHARACTERISTIC AcChrgrIntkT_numStdSens_C "" VALUE 0x802531EC Val_Wu32 4294967295.00 OneToOne 0.00 4294967295.00 FORMAT "%13.2" /end CHARACTERISTIC
/begin CHARACTERISTIC AcChrgrIntkT_numTempErrDef_C "" VALUE 0x802531F0 Val_Wu8 255.0 OneToOne 0.00 255.0 FORMAT "%5.1" /end CHARACTERISTIC
/begin CHARACTERISTIC AcChrgrIntkT_numtSel_C "" VALUE 0x802531F2 Val_Wu16 255.000000000 DELIB_ALLTEMP_VERB_COMPU 0.00 255.000000000 FORMAT "%13.9" /end CHARACTERISTIC
/begin CHARACTERISTIC AcChrgrIntkT_RmpSlp_f.Pos_C " / Positive ramp slope dy/dt" VALUE 0x802531CC Kw_Wr32 2.00000000E+038 RBPtCel_dt_1p0_1 -1.00000000E+038 1.00000000E+038 FORMAT "%13.3" EXTENDED_LIMITS -3.40282347E+038 3.40282347E+038 /end CHARACTERISTIC
/begin CHARACTERISTIC AcChrgrIntkT_RmpSlp_f.Neg_C " / Negative ramp slope dy/dt" VALUE 0x802531D0 Kw_Wr32 2.00000000E+038 RBPtCel_dt_1p0_1 -1.00000000E+038 1.00000000E+038 FORMAT "%13.3" EXTENDED_LIMITS -3.40282347E+038 3.40282347E+038 /end CHARACTERISTIC
/begin CHARACTERISTIC AcChrgrIntkT_stEnhPhysSRCRls_MAP "" MAP 0x802531F4 RB_Map_S16S16_U8_sao 255.0 OneToOne 0.00 255.0 FORMAT "%5.1"
 /begin AXIS_DESCR STD_AXIS Epm_nEng EngN 25 -16384.00 16383.50 FORMAT "%8.2" DEPOSIT ABSOLUTE /end AXIS_DESCR
 /begin AXIS_DESCR STD_AXIS InjCtl_qSetUnBal InjMass 25 -327.6800 327.6700 FORMAT "%8.4" DEPOSIT ABSOLUTE /end AXIS_DESCR
/end CHARACTERISTIC
/begin CHARACTERISTIC AcChrgrIntkT_swtConfStdSens2_C "" VALUE 0x802531B0 Val_Wu32 4294967295.00 OneToOne 0.00 4294967295.00 FORMAT "%13.2" /end CHARACTERISTIC
/begin CHARACTERISTIC AcChrgrIntkT_swtConfStdSensSwVers162_C "" VALUE 0x802531B4 Val_Wu32 4294967295.00 OneToOne 0.00 4294967295.00 FORMAT "%13.2" /end CHARACTERISTIC
/begin CHARACTERISTIC AcChrgrIntkT_swtConfStdSens_C "" VALUE 0x802531B8 Val_Wu32 4294967295.00 OneToOne 0.00 4294967295.00 FORMAT "%13.2" /end CHARACTERISTIC
/begin CHARACTERISTIC AcChrgrIntkT_tDflVal_f_C "" VALUE 0x802531D4 Val_Wr32 2.00000000E+037 RBPtCel_t_1p0_3 -1.00000000E+037 1.00000000E+037 FORMAT "%13.3" EXTENDED_LIMITS -3.40282347E+038 3.40282347E+038 /end CHARACTERISTIC
/begin CHARACTERISTIC AcChrgrIntkT_tEnhPhysSRCMax_f_MAP "" MAP 0x802534D0 RB_Map_S16S16_R32_sao 2.00000000E+037 RBPtCel_t_1p0_3 -1.00000000E+037 1.00000000E+037 FORMAT "%13.3" EXTENDED_LIMITS -3.40282347E+038 3.40282347E+038
 /begin AXIS_DESCR STD_AXIS Epm_nEng EngN 25 -16384.00 16383.50 FORMAT "%8.2" DEPOSIT ABSOLUTE /end AXIS_DESCR
 /begin AXIS_DESCR STD_AXIS InjCtl_qSetUnBal InjMass 25 -327.6800 327.6700 FORMAT "%8.4" DEPOSIT ABSOLUTE /end AXIS_DESCR
/end CHARACTERISTIC
/begin CHARACTERISTIC AcChrgrIntkT_tEnhPhysSRCMin_f_MAP "" MAP 0x80253EFC RB_Map_S16S16_R32_sao 2.00000000E+037 RBPtCel_t_1p0_3 -1.00000000E+037 1.00000000E+037 FORMAT "%13.3" EXTENDED_LIMITS -3.40282347E+038 3.40282347E+038
 /begin AXIS_DESCR STD_AXIS Epm_nEng EngN 25 -16384.00 16383.50 FORMAT "%8.2" DEPOSIT ABSOLUTE /end AXIS_DESCR
 /begin AXIS_DESCR STD_AXIS InjCtl_qSetUnBal InjMass 25 -327.6800 327.6700 FORMAT "%8.4" DEPOSIT ABSOLUTE /end AXIS_DESCR
/end CHARACTERISTIC
/begin CHARACTERISTIC AcChrgrIntkT_tHiLimit_f_C "" VALUE 0x802531D8 Val_Wr32 2.00000000E+037 RBPtCel_t_1p0_3 -1.00000000E+037 1.00000000E+037 FORMAT "%13.3" EXTENDED_LIMITS -3.40282347E+038 3.40282347E+038 /end CHARACTERISTIC
/begin CHARACTERISTIC AcChrgrIntkT_tiEngOnMin_C "" VALUE 0x80254928 Val_Wu32 42949672950.0 Time_ms 0.00 42949672950.0 FORMAT "%13.1" /end CHARACTERISTIC
/begin CHARACTERISTIC AcChrgrIntkT_tiPT1Fil_C "" VALUE 0x802531A4 Val_Ws32 4294.9672940000000 TimeDelay_s 0.0000020000000 4294.9672959999998 FORMAT "%19.14" EXTENDED_LIMITS 0.000002000000001 4294.9672959999998 /end CHARACTERISTIC
/begin CHARACTERISTIC AcChrgrIntkT_tiPT1_f_C "" VALUE 0x802531DC Val_Wr32 2.00000000E+037 RBPtCel_ti_1p0_2 -1.00000000E+037 1.00000000E+037 FORMAT "%13.3" EXTENDED_LIMITS -3.40282347E+038 3.40282347E+038 /end CHARACTERISTIC
/begin CHARACTERISTIC AcChrgrIntkT_tiSRCMaxDefDeb_CUR "" CURVE 0x8025310C RB_Curve_S16_S32_sao 42949672950.0 Time_ms -21474836480.0 21474836470.0 FORMAT "%13.1"
 /begin AXIS_DESCR STD_AXIS AcChrgrIntkT_tRefSnsr_mp Temp_Cels 25 -3549.940 3003.560 FORMAT "%8.3" DEPOSIT ABSOLUTE /end AXIS_DESCR
/end CHARACTERISTIC
/begin CHARACTERISTIC AcChrgrIntkT_tiTempErrOk_C "" VALUE 0x8025492C Val_Ws16 655350.0 Time_ms -327680.0 327670.0 FORMAT "%8.1" /end CHARACTERISTIC
/begin CHARACTERISTIC AcChrgrIntkT_tLoLimit_f_C "" VALUE 0x802531E0 Val_Wr32 2.00000000E+037 RBPtCel_t_1p0_3 -1.00000000E+037 1.00000000E+037 FORMAT "%13.3" EXTENDED_LIMITS -3.40282347E+038 3.40282347E+038 /end CHARACTERISTIC
/begin CHARACTERISTIC AcChrgrIntkT_TransStg_f.Dfl_r32_C " / This is SW-CALPRM-PROTOTYPE" VALUE 0x802531E4 Kw_Wr32 2.00000000E+037 RBPtCel_t_1p0_3 -1.00000000E+037 1.00000000E+037 FORMAT "%13.3" EXTENDED_LIMITS -3.40282347E+038 3.40282347E+038 /end CHARACTERISTIC
/begin CHARACTERISTIC AcChrgrIntkT_TransStg_f.stSensId_C " / This is SW-CALPRM-PROTOTYPE" VALUE 0x802531E8 Kw_Wu8 255.0 OneToOne 0.00 255.0 FORMAT "%5.1" /end CHARACTERISTIC
/begin CHARACTERISTIC AcChrgrIntkT_tSnsrMax_f_C "" VALUE 0x80254930 Val_Wr32 2.00000000E+037 RBPtCel_t_1p0_3 -1.00000000E+037 1.00000000E+037 FORMAT "%13.3" EXTENDED_LIMITS -3.40282347E+038 3.40282347E+038 /end CHARACTERISTIC
/begin CHARACTERISTIC AcChrgrIntkT_tSnsrMin_f_C "" VALUE 0x80254934 Val_Wr32 2.00000000E+037 RBPtCel_t_1p0_3 -1.00000000E+037 1.00000000E+037 FORMAT "%13.3" EXTENDED_LIMITS -3.40282347E+038 3.40282347E+038 /end CHARACTERISTIC
/begin CHARACTERISTIC DDRC_DurDeb.AcChrgrIntkT_tiSRCMinDebOk_C "" VALUE 0x802408C0 Val_Wu16 655350.0 DDRCTime_ms 0.00 655350.0 FORMAT "%8.1" /end CHARACTERISTIC
/begin CHARACTERISTIC DDRC_DurDeb.AcChrgrIntkT_tiSRCMinDebDef_C "" VALUE 0x802408C2 Val_Wu16 655350.0 DDRCTime_ms 0.00 655350.0 FORMAT "%8.1" /end CHARACTERISTIC
/begin CHARACTERISTIC DDRC_DurDeb.AcChrgrIntkT_tiPhysRngHiDebOk_C "" VALUE 0x802409CC Val_Wu16 655350.0 DDRCTime_ms 0.00 655350.0 FORMAT "%8.1" /end CHARACTERISTIC
/begin CHARACTERISTIC DDRC_DurDeb.AcChrgrIntkT_tiPhysRngHiDebDef_C "" VALUE 0x802409CE Val_Wu16 655350.0 DDRCTime_ms 0.00 655350.0 FORMAT "%8.1" /end CHARACTERISTIC
/begin CHARACTERISTIC DDRC_DurDeb.AcChrgrIntkT_tiPhysRngLoDebOk_C "" VALUE 0x802409D0 Val_Wu16 655350.0 DDRCTime_ms 0.00 655350.0 FORMAT "%8.1" /end CHARACTERISTIC
/begin CHARACTERISTIC DDRC_DurDeb.AcChrgrIntkT_tiPhysRngLoDebDef_C "" VALUE 0x802409D2 Val_Wu16 655350.0 DDRCTime_ms 0.00 655350.0 FORMAT "%8.1" /end CHARACTERISTIC
/begin CHARACTERISTIC DDRC_DurDeb.AcChrgrIntkT_tiSRCOpnDebOk_C "" VALUE 0x802409D4 Val_Wu16 655350.0 DDRCTime_ms 0.00 655350.0 FORMAT "%8.1" /end CHARACTERISTIC
/begin CHARACTERISTIC DDRC_DurDeb.AcChrgrIntkT_tiSRCOpnDebDef_C "" VALUE 0x802409D6 Val_Wu16 655350.0 DDRCTime_ms 0.00 655350.0 FORMAT "%8.1" /end CHARACTERISTIC
/begin CHARACTERISTIC DDRC_RatDeb.AcChrgrIntkT_tiSRCMinUDRat_C "" VALUE 0x80248A34 Val_Wu8 3.00000000000 DDRC_Ratio 1.00000000000 4.00000000000 FORMAT "%13.11" /end CHARACTERISTIC
/begin CHARACTERISTIC DDRC_RatDeb.AcChrgrIntkT_tiPhysRngHiUDRat_C "" VALUE 0x80248A77 Val_Wu8 3.00000000000 DDRC_Ratio 1.00000000000 4.00000000000 FORMAT "%13.11" /end CHARACTERISTIC
/begin CHARACTERISTIC DDRC_RatDeb.AcChrgrIntkT_tiPhysRngLoUDRat_C "" VALUE 0x80248A78 Val_Wu8 3.00000000000 DDRC_Ratio 1.00000000000 4.00000000000 FORMAT "%13.11" /end CHARACTERISTIC
/begin CHARACTERISTIC DDRC_RatDeb.AcChrgrIntkT_tiSRCOpnUDRat_C "" VALUE 0x80248A79 Val_Wu8 3.00000000000 DDRC_Ratio 1.00000000000 4.00000000000 FORMAT "%13.11" /end CHARACTERISTIC
/begin CHARACTERISTIC DFC_CtlMsk2.DFC_AcChrgrIntkTSRCMin_C "" VALUE 0x802414E1 Val_Wu8 255.0 DFES_OneToOne 0.00 255.0 FORMAT "%5.1" /end CHARACTERISTIC
/begin CHARACTERISTIC DFC_CtlMsk2.DFC_AcChrgrIntkTPhysRngHi_C "" VALUE 0x80241530 Val_Wu8 255.0 DFES_OneToOne 0.00 255.0 FORMAT "%5.1" /end CHARACTERISTIC
/begin CHARACTERISTIC DFC_CtlMsk2.DFC_AcChrgrIntkTPhysRngLo_C "" VALUE 0x80241531 Val_Wu8 255.0 DFES_OneToOne 0.00 255.0 FORMAT "%5.1" /end CHARACTERISTIC
/begin CHARACTERISTIC DFC_CtlMsk2.DFC_AcChrgrIntkTSRCOpn_C "" VALUE 0x80241532 Val_Wu8 255.0 DFES_OneToOne 0.00 255.0 FORMAT "%5.1" /end CHARACTERISTIC
/begin CHARACTERISTIC DFC_CtlMsk2.DFC_COMM_E_NET_START_IND_CHANNEL_3_C "" VALUE 0x802415B9 Val_Wu8 255.0 DFES_OneToOne 0.00 255.0 FORMAT "%5.1" /end CHARACTERISTIC
/begin CHARACTERISTIC DFC_CtlMsk2.DFC_COMM_E_NET_START_IND_CHANNEL_4_C "" VALUE 0x802415BA Val_Wu8 255.0 DFES_OneToOne 0.00 255.0 FORMAT "%5.1" /end CHARACTERISTIC
/begin CHARACTERISTIC DFC_CtlMsk2.DFC_COMM_E_NET_START_IND_CHANNEL_5_C "" VALUE 0x802415BB Val_Wu8 255.0 DFES_OneToOne 0.00 255.0 FORMAT "%5.1" /end CHARACTERISTIC
/begin CHARACTERISTIC DFC_CtlMsk2.DFC_RBA_IOEXTLIB_KEEPALIVE_DRV_C "" VALUE 0x802415C3 Val_Wu8 255.0 DFES_OneToOne 0.00 255.0 FORMAT "%5.1" /end CHARACTERISTIC
/begin CHARACTERISTIC DFC_CtlMsk2.DFC_RBA_IOEXTLIB_KEEPALIVE_INI_C "" VALUE 0x802415C4 Val_Wu8 255.0 DFES_OneToOne 0.00 255.0 FORMAT "%5.1" /end CHARACTERISTIC
/begin CHARACTERISTIC DFC_CtlMsk2.DFC_rba_SyC_IrrSwOffTrigEngRun_Event_C "" VALUE 0x802415C9 Val_Wu8 255.0 DFES_OneToOne 0.00 255.0 FORMAT "%5.1" /end CHARACTERISTIC
/begin CHARACTERISTIC DFC_CtlMsk2.DFC_AcChrgrIntkTSRCMax_C "" VALUE 0x802415CA Val_Wu8 255.0 DFES_OneToOne 0.00 255.0 FORMAT "%5.1" /end CHARACTERISTIC
/begin CHARACTERISTIC DFC_CtlMsk2.DFC_AcChrgrIntkTTmpErr_C "" VALUE 0x802415CB Val_Wu8 255.0 DFES_OneToOne 0.00 255.0 FORMAT "%5.1" /end CHARACTERISTIC
/begin CHARACTERISTIC DFC_DisblMsk2.DFC_AcChrgrIntkTSRCMin_C "" VALUE 0x80248EA8 Val_Wu16 65535.00 DFES_OneToOne 0.00 65535.00 FORMAT "%8.2" /end CHARACTERISTIC
/begin CHARACTERISTIC DFC_DisblMsk2.DFC_AcChrgrIntkTPhysRngHi_C "" VALUE 0x80248F46 Val_Wu16 65535.00 DFES_OneToOne 0.00 65535.00 FORMAT "%8.2" /end CHARACTERISTIC
/begin CHARACTERISTIC DFC_DisblMsk2.DFC_AcChrgrIntkTPhysRngLo_C "" VALUE 0x80248F48 Val_Wu16 65535.00 DFES_OneToOne 0.00 65535.00 FORMAT "%8.2" /end CHARACTERISTIC
/begin CHARACTERISTIC DFC_DisblMsk2.DFC_AcChrgrIntkTSRCOpn_C "" VALUE 0x80248F4A Val_Wu16 65535.00 DFES_OneToOne 0.00 65535.00 FORMAT "%8.2" /end CHARACTERISTIC
/begin CHARACTERISTIC DFC_DisblMsk2.DFC_COMM_E_NET_START_IND_CHANNEL_3_C "" VALUE 0x80249058 Val_Wu16 65535.00 DFES_OneToOne 0.00 65535.00 FORMAT "%8.2" /end CHARACTERISTIC
/begin CHARACTERISTIC DFC_DisblMsk2.DFC_COMM_E_NET_START_IND_CHANNEL_4_C "" VALUE 0x8024905A Val_Wu16 65535.00 DFES_OneToOne 0.00 65535.00 FORMAT "%8.2" /end CHARACTERISTIC
/begin CHARACTERISTIC DFC_DisblMsk2.DFC_COMM_E_NET_START_IND_CHANNEL_5_C "" VALUE 0x8024905C Val_Wu16 65535.00 DFES_OneToOne 0.00 65535.00 FORMAT "%8.2" /end CHARACTERISTIC
/begin CHARACTERISTIC DFC_DisblMsk2.DFC_RBA_IOEXTLIB_KEEPALIVE_DRV_C "" VALUE 0x8024906C Val_Wu16 65535.00 DFES_OneToOne 0.00 65535.00 FORMAT "%8.2" /end CHARACTERISTIC
/begin CHARACTERISTIC DFC_DisblMsk2.DFC_RBA_IOEXTLIB_KEEPALIVE_INI_C "" VALUE 0x8024906E Val_Wu16 65535.00 DFES_OneToOne 0.00 65535.00 FORMAT "%8.2" /end CHARACTERISTIC
/begin CHARACTERISTIC DFC_DisblMsk2.DFC_rba_SyC_IrrSwOffTrigEngRun_Event_C "" VALUE 0x80249078 Val_Wu16 65535.00 DFES_OneToOne 0.00 65535.00 FORMAT "%8.2" /end CHARACTERISTIC
/begin CHARACTERISTIC DFC_DisblMsk2.DFC_AcChrgrIntkTSRCMax_C "" VALUE 0x8024907A Val_Wu16 65535.00 DFES_OneToOne 0.00 65535.00 FORMAT "%8.2" /end CHARACTERISTIC
/begin CHARACTERISTIC DFC_DisblMsk2.DFC_AcChrgrIntkTTmpErr_C "" VALUE 0x8024907C Val_Wu16 65535.00 DFES_OneToOne 0.00 65535.00 FORMAT "%8.2" /end CHARACTERISTIC
/*********** Start of merged MEASUREMENT blocks ***********/
/begin MEASUREMENT CanIf_Prv_ControllerState_ast[0].Ctrl_Pdu_mode "Can Interface controller State[0]/" UBYTE RB_RBA_Common_CentralElements_CompuMethods_Identical 1 100 0.0 255. FORMAT "%5.0" ECU_ADDRESS 0x6002794C /end MEASUREMENT
/begin MEASUREMENT CanIf_Prv_ControllerState_ast[1].Ctrl_Pdu_mode "Can Interface controller State[1]/" UBYTE RB_RBA_Common_CentralElements_CompuMethods_Identical 1 100 0.0 255. FORMAT "%5.0" ECU_ADDRESS 0x6002794D /end MEASUREMENT
/begin MEASUREMENT CanIf_Prv_ControllerState_ast[2].Ctrl_Pdu_mode "Can Interface controller State[2]/" UBYTE RB_RBA_Common_CentralElements_CompuMethods_Identical 1 100 0.0 255. FORMAT "%5.0" ECU_ADDRESS 0x6002794E /end MEASUREMENT
/begin MEASUREMENT CanIf_Prv_ControllerState_ast[3].Ctrl_Pdu_mode "Can Interface controller State[3]/" UBYTE RB_RBA_Common_CentralElements_CompuMethods_Identical 1 100 0.0 255. FORMAT "%5.0" ECU_ADDRESS 0x6002794F /end MEASUREMENT
/begin MEASUREMENT CanIf_Prv_InitStatus_b "Flag to check if CANIF is Initialized(TRUE) or Not Initialized (FALSE)" UBYTE RB_RBA_Common_CentralElements_CompuMethods_Identical 1 100 0.0 1. FORMAT "%5.0" ECU_ADDRESS 0x60027950 /end MEASUREMENT
/begin MEASUREMENT CanIf_Prv_TxBufferRam_ast[0].last_index "Can Interface Buffer Status[0]/" UBYTE RB_RBA_Common_CentralElements_CompuMethods_Identical 1 100 0.0 255. FORMAT "%5.0" ECU_ADDRESS 0x60029106 /end MEASUREMENT
/begin MEASUREMENT CanIf_Prv_TxBufferRam_ast[1].last_index "Can Interface Buffer Status[1]/" UBYTE RB_RBA_Common_CentralElements_CompuMethods_Identical 1 100 0.0 255. FORMAT "%5.0" ECU_ADDRESS 0x60029108 /end MEASUREMENT
/begin MEASUREMENT CanIf_Prv_TxBufferRam_ast[2].last_index "Can Interface Buffer Status[2]/" UBYTE RB_RBA_Common_CentralElements_CompuMethods_Identical 1 100 0.0 255. FORMAT "%5.0" ECU_ADDRESS 0x6002910A /end MEASUREMENT
/begin MEASUREMENT CanIf_Prv_TxBufferRam_ast[3].last_index "Can Interface Buffer Status[3]/" UBYTE RB_RBA_Common_CentralElements_CompuMethods_Identical 1 100 0.0 255. FORMAT "%5.0" ECU_ADDRESS 0x6002910C /end MEASUREMENT
/begin MEASUREMENT CanIf_Prv_TxBufferRam_ast[4].last_index "Can Interface Buffer Status[4]/" UBYTE RB_RBA_Common_CentralElements_CompuMethods_Identical 1 100 0.0 255. FORMAT "%5.0" ECU_ADDRESS 0x6002910E /end MEASUREMENT
/begin MEASUREMENT CanIf_Prv_TxBufferRam_ast[5].last_index "Can Interface Buffer Status[5]/" UBYTE RB_RBA_Common_CentralElements_CompuMethods_Identical 1 100 0.0 255. FORMAT "%5.0" ECU_ADDRESS 0x60029110 /end MEASUREMENT
/begin MEASUREMENT CanIf_Prv_TxBufferRam_ast[6].last_index "Can Interface Buffer Status[6]/" UBYTE RB_RBA_Common_CentralElements_CompuMethods_Identical 1 100 0.0 255. FORMAT "%5.0" ECU_ADDRESS 0x60029112 /end MEASUREMENT
/begin MEASUREMENT CanIf_Prv_TxBufferRam_ast[7].last_index "Can Interface Buffer Status[7]/" UBYTE RB_RBA_Common_CentralElements_CompuMethods_Identical 1 100 0.0 255. FORMAT "%5.0" ECU_ADDRESS 0x60029114 /end MEASUREMENT
/begin MEASUREMENT CanIf_Prv_TxBufferRam_ast[8].last_index "Can Interface Buffer Status[8]/" UBYTE RB_RBA_Common_CentralElements_CompuMethods_Identical 1 100 0.0 255. FORMAT "%5.0" ECU_ADDRESS 0x60029116 /end MEASUREMENT
/begin MEASUREMENT CanIf_Prv_TxBufferRam_ast[9].last_index "Can Interface Buffer Status[9]/" UBYTE RB_RBA_Common_CentralElements_CompuMethods_Identical 1 100 0.0 255. FORMAT "%5.0" ECU_ADDRESS 0x60029118 /end MEASUREMENT
/begin MEASUREMENT CanIf_Prv_TxBufferRam_ast[10].last_index "Can Interface Buffer Status[10]/" UBYTE RB_RBA_Common_CentralElements_CompuMethods_Identical 1 100 0.0 255. FORMAT "%5.0" ECU_ADDRESS 0x6002911A /end MEASUREMENT
/begin MEASUREMENT CanIf_Prv_TxBufferRam_ast[11].last_index "Can Interface Buffer Status[11]/" UBYTE RB_RBA_Common_CentralElements_CompuMethods_Identical 1 100 0.0 255. FORMAT "%5.0" ECU_ADDRESS 0x6002911C /end MEASUREMENT
/begin MEASUREMENT CanIf_Prv_TxBufferRam_ast[12].last_index "Can Interface Buffer Status[12]/" UBYTE RB_RBA_Common_CentralElements_CompuMethods_Identical 1 100 0.0 255. FORMAT "%5.0" ECU_ADDRESS 0x6002911E /end MEASUREMENT
/begin MEASUREMENT CanIf_Prv_TxBufferRam_ast[13].last_index "Can Interface Buffer Status[13]/" UBYTE RB_RBA_Common_CentralElements_CompuMethods_Identical 1 100 0.0 255. FORMAT "%5.0" ECU_ADDRESS 0x60029120 /end MEASUREMENT
/begin MEASUREMENT CanIf_Prv_TxBufferRam_ast[14].last_index "Can Interface Buffer Status[14]/" UBYTE RB_RBA_Common_CentralElements_CompuMethods_Identical 1 100 0.0 255. FORMAT "%5.0" ECU_ADDRESS 0x60029122 /end MEASUREMENT
/begin MEASUREMENT CanIf_Prv_TxBufferRam_ast[15].last_index "Can Interface Buffer Status[15]/" UBYTE RB_RBA_Common_CentralElements_CompuMethods_Identical 1 100 0.0 255. FORMAT "%5.0" ECU_ADDRESS 0x60029124 /end MEASUREMENT
/begin MEASUREMENT CanIf_Prv_TxBufferRam_ast[16].last_index "Can Interface Buffer Status[16]/" UBYTE RB_RBA_Common_CentralElements_CompuMethods_Identical 1 100 0.0 255. FORMAT "%5.0" ECU_ADDRESS 0x60029126 /end MEASUREMENT
/begin MEASUREMENT CanIf_Prv_TxBufferRam_ast[17].last_index "Can Interface Buffer Status[17]/" UBYTE RB_RBA_Common_CentralElements_CompuMethods_Identical 1 100 0.0 255. FORMAT "%5.0" ECU_ADDRESS 0x60029128 /end MEASUREMENT
/begin MEASUREMENT CanIf_Prv_TxBufferRam_ast[18].last_index "Can Interface Buffer Status[18]/" UBYTE RB_RBA_Common_CentralElements_CompuMethods_Identical 1 100 0.0 255. FORMAT "%5.0" ECU_ADDRESS 0x6002912A /end MEASUREMENT
/begin MEASUREMENT CanIf_Prv_TxBufferRam_ast[19].last_index "Can Interface Buffer Status[19]/" UBYTE RB_RBA_Common_CentralElements_CompuMethods_Identical 1 100 0.0 255. FORMAT "%5.0" ECU_ADDRESS 0x6002912C /end MEASUREMENT
/begin MEASUREMENT CanIf_Prv_TxBufferRam_ast[20].last_index "Can Interface Buffer Status[20]/" UBYTE RB_RBA_Common_CentralElements_CompuMethods_Identical 1 100 0.0 255. FORMAT "%5.0" ECU_ADDRESS 0x6002912E /end MEASUREMENT
/begin MEASUREMENT CanIf_Prv_TxBufferRam_ast[21].last_index "Can Interface Buffer Status[21]/" UBYTE RB_RBA_Common_CentralElements_CompuMethods_Identical 1 100 0.0 255. FORMAT "%5.0" ECU_ADDRESS 0x60029130 /end MEASUREMENT
/begin MEASUREMENT CanIf_Prv_TxBufferRam_ast[22].last_index "Can Interface Buffer Status[22]/" UBYTE RB_RBA_Common_CentralElements_CompuMethods_Identical 1 100 0.0 255. FORMAT "%5.0" ECU_ADDRESS 0x60029132 /end MEASUREMENT
/begin MEASUREMENT CanIf_Prv_TxBufferRam_ast[23].last_index "Can Interface Buffer Status[23]/" UBYTE RB_RBA_Common_CentralElements_CompuMethods_Identical 1 100 0.0 255. FORMAT "%5.0" ECU_ADDRESS 0x60029134 /end MEASUREMENT
/begin MEASUREMENT CanIf_Prv_TxBufferRam_ast[24].last_index "Can Interface Buffer Status[24]/" UBYTE RB_RBA_Common_CentralElements_CompuMethods_Identical 1 100 0.0 255. FORMAT "%5.0" ECU_ADDRESS 0x60029136 /end MEASUREMENT
/begin MEASUREMENT CanIf_Prv_TxBufferRam_ast[25].last_index "Can Interface Buffer Status[25]/" UBYTE RB_RBA_Common_CentralElements_CompuMethods_Identical 1 100 0.0 255. FORMAT "%5.0" ECU_ADDRESS 0x60029138 /end MEASUREMENT
/begin MEASUREMENT CanIf_Prv_TxBufferRam_ast[26].last_index "Can Interface Buffer Status[26]/" UBYTE RB_RBA_Common_CentralElements_CompuMethods_Identical 1 100 0.0 255. FORMAT "%5.0" ECU_ADDRESS 0x6002913A /end MEASUREMENT
/begin MEASUREMENT CanIf_Prv_TxBufferRam_ast[27].last_index "Can Interface Buffer Status[27]/" UBYTE RB_RBA_Common_CentralElements_CompuMethods_Identical 1 100 0.0 255. FORMAT "%5.0" ECU_ADDRESS 0x6002913C /end MEASUREMENT
/begin MEASUREMENT CanIf_Prv_TxBufferRam_ast[28].last_index "Can Interface Buffer Status[28]/" UBYTE RB_RBA_Common_CentralElements_CompuMethods_Identical 1 100 0.0 255. FORMAT "%5.0" ECU_ADDRESS 0x6002913E /end MEASUREMENT
/begin MEASUREMENT CanIf_Prv_TxBufferRam_ast[29].last_index "Can Interface Buffer Status[29]/" UBYTE RB_RBA_Common_CentralElements_CompuMethods_Identical 1 100 0.0 255. FORMAT "%5.0" ECU_ADDRESS 0x60029140 /end MEASUREMENT
/begin MEASUREMENT CanIf_Prv_TxBufferRam_ast[30].last_index "Can Interface Buffer Status[30]/" UBYTE RB_RBA_Common_CentralElements_CompuMethods_Identical 1 100 0.0 255. FORMAT "%5.0" ECU_ADDRESS 0x60029142 /end MEASUREMENT
/begin MEASUREMENT CanIf_Prv_TxBufferRam_ast[31].last_index "Can Interface Buffer Status[31]/" UBYTE RB_RBA_Common_CentralElements_CompuMethods_Identical 1 100 0.0 255. FORMAT "%5.0" ECU_ADDRESS 0x60029144 /end MEASUREMENT
/begin MEASUREMENT CanIf_Prv_TxBufferRam_ast[32].last_index "Can Interface Buffer Status[32]/" UBYTE RB_RBA_Common_CentralElements_CompuMethods_Identical 1 100 0.0 255. FORMAT "%5.0" ECU_ADDRESS 0x60029146 /end MEASUREMENT
/begin MEASUREMENT CanIf_Prv_TxBufferRam_ast[33].last_index "Can Interface Buffer Status[33]/" UBYTE RB_RBA_Common_CentralElements_CompuMethods_Identical 1 100 0.0 255. FORMAT "%5.0" ECU_ADDRESS 0x60029148 /end MEASUREMENT
/begin MEASUREMENT CanIf_Prv_TxBufferRam_ast[34].last_index "Can Interface Buffer Status[34]/" UBYTE RB_RBA_Common_CentralElements_CompuMethods_Identical 1 100 0.0 255. FORMAT "%5.0" ECU_ADDRESS 0x6002914A /end MEASUREMENT
/begin MEASUREMENT CanIf_Prv_TxBufferRam_ast[35].last_index "Can Interface Buffer Status[35]/" UBYTE RB_RBA_Common_CentralElements_CompuMethods_Identical 1 100 0.0 255. FORMAT "%5.0" ECU_ADDRESS 0x6002914C /end MEASUREMENT
/begin MEASUREMENT CanIf_Prv_TxBufferRam_ast[36].last_index "Can Interface Buffer Status[36]/" UBYTE RB_RBA_Common_CentralElements_CompuMethods_Identical 1 100 0.0 255. FORMAT "%5.0" ECU_ADDRESS 0x6002914E /end MEASUREMENT
/begin MEASUREMENT CanIf_Prv_TxBufferRam_ast[37].last_index "Can Interface Buffer Status[37]/" UBYTE RB_RBA_Common_CentralElements_CompuMethods_Identical 1 100 0.0 255. FORMAT "%5.0" ECU_ADDRESS 0x60029150 /end MEASUREMENT
/begin MEASUREMENT CanIf_Prv_TxBufferRam_ast[38].last_index "Can Interface Buffer Status[38]/" UBYTE RB_RBA_Common_CentralElements_CompuMethods_Identical 1 100 0.0 255. FORMAT "%5.0" ECU_ADDRESS 0x60029152 /end MEASUREMENT
/begin MEASUREMENT CanIf_Prv_TxBufferRam_ast[39].last_index "Can Interface Buffer Status[39]/" UBYTE RB_RBA_Common_CentralElements_CompuMethods_Identical 1 100 0.0 255. FORMAT "%5.0" ECU_ADDRESS 0x60029154 /end MEASUREMENT
/begin MEASUREMENT CanIf_Prv_TxBufferRam_ast[40].last_index "Can Interface Buffer Status[40]/" UBYTE RB_RBA_Common_CentralElements_CompuMethods_Identical 1 100 0.0 255. FORMAT "%5.0" ECU_ADDRESS 0x60029156 /end MEASUREMENT
/begin MEASUREMENT CanIf_Prv_TxBufferRam_ast[41].last_index "Can Interface Buffer Status[41]/" UBYTE RB_RBA_Common_CentralElements_CompuMethods_Identical 1 100 0.0 255. FORMAT "%5.0" ECU_ADDRESS 0x60029158 /end MEASUREMENT
/begin MEASUREMENT CanIf_Prv_TxBufferRam_ast[42].last_index "Can Interface Buffer Status[42]/" UBYTE RB_RBA_Common_CentralElements_CompuMethods_Identical 1 100 0.0 255. FORMAT "%5.0" ECU_ADDRESS 0x6002915A /end MEASUREMENT
/begin MEASUREMENT CanIf_Prv_TxBufferRam_ast[43].last_index "Can Interface Buffer Status[43]/" UBYTE RB_RBA_Common_CentralElements_CompuMethods_Identical 1 100 0.0 255. FORMAT "%5.0" ECU_ADDRESS 0x6002915C /end MEASUREMENT
/begin MEASUREMENT CanIf_Prv_TxBufferRam_ast[44].last_index "Can Interface Buffer Status[44]/" UBYTE RB_RBA_Common_CentralElements_CompuMethods_Identical 1 100 0.0 255. FORMAT "%5.0" ECU_ADDRESS 0x6002915E /end MEASUREMENT
/begin MEASUREMENT CanIf_Prv_TxBufferRam_ast[45].last_index "Can Interface Buffer Status[45]/" UBYTE RB_RBA_Common_CentralElements_CompuMethods_Identical 1 100 0.0 255. FORMAT "%5.0" ECU_ADDRESS 0x60029160 /end MEASUREMENT
/begin MEASUREMENT CanIf_Prv_TxBufferRam_ast[46].last_index "Can Interface Buffer Status[46]/" UBYTE RB_RBA_Common_CentralElements_CompuMethods_Identical 1 100 0.0 255. FORMAT "%5.0" ECU_ADDRESS 0x60029162 /end MEASUREMENT
/begin MEASUREMENT CanIf_Prv_TxBufferRam_ast[47].last_index "Can Interface Buffer Status[47]/" UBYTE RB_RBA_Common_CentralElements_CompuMethods_Identical 1 100 0.0 255. FORMAT "%5.0" ECU_ADDRESS 0x60029164 /end MEASUREMENT
/begin MEASUREMENT CanIf_Prv_TxBufferRam_ast[48].last_index "Can Interface Buffer Status[48]/" UBYTE RB_RBA_Common_CentralElements_CompuMethods_Identical 1 100 0.0 255. FORMAT "%5.0" ECU_ADDRESS 0x60029166 /end MEASUREMENT
/begin MEASUREMENT CanIf_Prv_TxBufferRam_ast[49].last_index "Can Interface Buffer Status[49]/" UBYTE RB_RBA_Common_CentralElements_CompuMethods_Identical 1 100 0.0 255. FORMAT "%5.0" ECU_ADDRESS 0x60029168 /end MEASUREMENT
/begin MEASUREMENT CanIf_Prv_TxBufferRam_ast[50].last_index "Can Interface Buffer Status[50]/" UBYTE RB_RBA_Common_CentralElements_CompuMethods_Identical 1 100 0.0 255. FORMAT "%5.0" ECU_ADDRESS 0x6002916A /end MEASUREMENT
/begin MEASUREMENT CanIf_Prv_TxBufferRam_ast[51].last_index "Can Interface Buffer Status[51]/" UBYTE RB_RBA_Common_CentralElements_CompuMethods_Identical 1 100 0.0 255. FORMAT "%5.0" ECU_ADDRESS 0x6002916C /end MEASUREMENT
/begin MEASUREMENT CanIf_Prv_TxBufferRam_ast[52].last_index "Can Interface Buffer Status[52]/" UBYTE RB_RBA_Common_CentralElements_CompuMethods_Identical 1 100 0.0 255. FORMAT "%5.0" ECU_ADDRESS 0x6002916E /end MEASUREMENT
/begin MEASUREMENT CanIf_Prv_TxBufferRam_ast[53].last_index "Can Interface Buffer Status[53]/" UBYTE RB_RBA_Common_CentralElements_CompuMethods_Identical 1 100 0.0 255. FORMAT "%5.0" ECU_ADDRESS 0x60029170 /end MEASUREMENT
/begin MEASUREMENT CanIf_Prv_TxBufferRam_ast[54].last_index "Can Interface Buffer Status[54]/" UBYTE RB_RBA_Common_CentralElements_CompuMethods_Identical 1 100 0.0 255. FORMAT "%5.0" ECU_ADDRESS 0x60029172 /end MEASUREMENT
/begin MEASUREMENT CanIf_Prv_TxBufferRam_ast[55].last_index "Can Interface Buffer Status[55]/" UBYTE RB_RBA_Common_CentralElements_CompuMethods_Identical 1 100 0.0 255. FORMAT "%5.0" ECU_ADDRESS 0x60029174 /end MEASUREMENT
/begin MEASUREMENT CanIf_Prv_TxBufferRam_ast[56].last_index "Can Interface Buffer Status[56]/" UBYTE RB_RBA_Common_CentralElements_CompuMethods_Identical 1 100 0.0 255. FORMAT "%5.0" ECU_ADDRESS 0x60029176 /end MEASUREMENT
/begin MEASUREMENT CanIf_Prv_TxBufferRam_ast[57].last_index "Can Interface Buffer Status[57]/" UBYTE RB_RBA_Common_CentralElements_CompuMethods_Identical 1 100 0.0 255. FORMAT "%5.0" ECU_ADDRESS 0x60029178 /end MEASUREMENT
/begin MEASUREMENT CanIf_Prv_TxBufferRam_ast[58].last_index "Can Interface Buffer Status[58]/" UBYTE RB_RBA_Common_CentralElements_CompuMethods_Identical 1 100 0.0 255. FORMAT "%5.0" ECU_ADDRESS 0x6002917A /end MEASUREMENT
/begin MEASUREMENT CanIf_Prv_TxBufferRam_ast[59].last_index "Can Interface Buffer Status[59]/" UBYTE RB_RBA_Common_CentralElements_CompuMethods_Identical 1 100 0.0 255. FORMAT "%5.0" ECU_ADDRESS 0x6002917C /end MEASUREMENT
/begin MEASUREMENT CanIf_Prv_TxBufferRam_ast[60].last_index "Can Interface Buffer Status[60]/" UBYTE RB_RBA_Common_CentralElements_CompuMethods_Identical 1 100 0.0 255. FORMAT "%5.0" ECU_ADDRESS 0x6002917E /end MEASUREMENT
/begin MEASUREMENT CanIf_Prv_TxBufferRam_ast[61].last_index "Can Interface Buffer Status[61]/" UBYTE RB_RBA_Common_CentralElements_CompuMethods_Identical 1 100 0.0 255. FORMAT "%5.0" ECU_ADDRESS 0x60029180 /end MEASUREMENT
/begin MEASUREMENT CanIf_Prv_TxBufferRam_ast[62].last_index "Can Interface Buffer Status[62]/" UBYTE RB_RBA_Common_CentralElements_CompuMethods_Identical 1 100 0.0 255. FORMAT "%5.0" ECU_ADDRESS 0x60029182 /end MEASUREMENT
/begin MEASUREMENT CanIf_Prv_TxBufferRam_ast[63].last_index "Can Interface Buffer Status[63]/" UBYTE RB_RBA_Common_CentralElements_CompuMethods_Identical 1 100 0.0 255. FORMAT "%5.0" ECU_ADDRESS 0x60029184 /end MEASUREMENT
/begin MEASUREMENT CanIf_Prv_TxBufferRam_ast[64].last_index "Can Interface Buffer Status[64]/" UBYTE RB_RBA_Common_CentralElements_CompuMethods_Identical 1 100 0.0 255. FORMAT "%5.0" ECU_ADDRESS 0x60029186 /end MEASUREMENT
/begin MEASUREMENT CanIf_Prv_TxBufferRam_ast[65].last_index "Can Interface Buffer Status[65]/" UBYTE RB_RBA_Common_CentralElements_CompuMethods_Identical 1 100 0.0 255. FORMAT "%5.0" ECU_ADDRESS 0x60029188 /end MEASUREMENT
/begin MEASUREMENT CanIf_Prv_TxBufferRam_ast[66].last_index "Can Interface Buffer Status[66]/" UBYTE RB_RBA_Common_CentralElements_CompuMethods_Identical 1 100 0.0 255. FORMAT "%5.0" ECU_ADDRESS 0x6002918A /end MEASUREMENT
/begin MEASUREMENT CanIf_Prv_TxBufferRam_ast[67].last_index "Can Interface Buffer Status[67]/" UBYTE RB_RBA_Common_CentralElements_CompuMethods_Identical 1 100 0.0 255. FORMAT "%5.0" ECU_ADDRESS 0x6002918C /end MEASUREMENT
/begin MEASUREMENT CanIf_Prv_TxBufferRam_ast[68].last_index "Can Interface Buffer Status[68]/" UBYTE RB_RBA_Common_CentralElements_CompuMethods_Identical 1 100 0.0 255. FORMAT "%5.0" ECU_ADDRESS 0x6002918E /end MEASUREMENT
/begin MEASUREMENT CanIf_Prv_TxBufferRam_ast[69].last_index "Can Interface Buffer Status[69]/" UBYTE RB_RBA_Common_CentralElements_CompuMethods_Identical 1 100 0.0 255. FORMAT "%5.0" ECU_ADDRESS 0x60029190 /end MEASUREMENT
/begin MEASUREMENT CanIf_Prv_TxBufferRam_ast[70].last_index "Can Interface Buffer Status[70]/" UBYTE RB_RBA_Common_CentralElements_CompuMethods_Identical 1 100 0.0 255. FORMAT "%5.0" ECU_ADDRESS 0x60029192 /end MEASUREMENT
/begin MEASUREMENT CanIf_Prv_TxBufferRam_ast[71].last_index "Can Interface Buffer Status[71]/" UBYTE RB_RBA_Common_CentralElements_CompuMethods_Identical 1 100 0.0 255. FORMAT "%5.0" ECU_ADDRESS 0x60029194 /end MEASUREMENT
/begin MEASUREMENT CanIf_Prv_TxBufferRam_ast[72].last_index "Can Interface Buffer Status[72]/" UBYTE RB_RBA_Common_CentralElements_CompuMethods_Identical 1 100 0.0 255. FORMAT "%5.0" ECU_ADDRESS 0x60029196 /end MEASUREMENT
/begin MEASUREMENT CanIf_Prv_TxBufferRam_ast[73].last_index "Can Interface Buffer Status[73]/" UBYTE RB_RBA_Common_CentralElements_CompuMethods_Identical 1 100 0.0 255. FORMAT "%5.0" ECU_ADDRESS 0x60029198 /end MEASUREMENT
/begin MEASUREMENT CanIf_Prv_TxBufferRam_ast[74].last_index "Can Interface Buffer Status[74]/" UBYTE RB_RBA_Common_CentralElements_CompuMethods_Identical 1 100 0.0 255. FORMAT "%5.0" ECU_ADDRESS 0x6002919A /end MEASUREMENT
/begin MEASUREMENT CanIf_Prv_TxBufferRam_ast[75].last_index "Can Interface Buffer Status[75]/" UBYTE RB_RBA_Common_CentralElements_CompuMethods_Identical 1 100 0.0 255. FORMAT "%5.0" ECU_ADDRESS 0x6002919C /end MEASUREMENT
/begin MEASUREMENT CanIf_Prv_TxBufferRam_ast[76].last_index "Can Interface Buffer Status[76]/" UBYTE RB_RBA_Common_CentralElements_CompuMethods_Identical 1 100 0.0 255. FORMAT "%5.0" ECU_ADDRESS 0x6002919E /end MEASUREMENT
/begin MEASUREMENT CanIf_Prv_TxBufferRam_ast[77].last_index "Can Interface Buffer Status[77]/" UBYTE RB_RBA_Common_CentralElements_CompuMethods_Identical 1 100 0.0 255. FORMAT "%5.0" ECU_ADDRESS 0x600291A0 /end MEASUREMENT
/begin MEASUREMENT CanIf_Prv_TxBufferRam_ast[0].bufferstatus "Can Interface Buffer Status[0]/" UBYTE RB_RBA_Common_CentralElements_CompuMethods_Identical 1 100 0.0 255. FORMAT "%5.0" ECU_ADDRESS 0x60029107 /end MEASUREMENT
/begin MEASUREMENT CanIf_Prv_TxBufferRam_ast[1].bufferstatus "Can Interface Buffer Status[1]/" UBYTE RB_RBA_Common_CentralElements_CompuMethods_Identical 1 100 0.0 255. FORMAT "%5.0" ECU_ADDRESS 0x60029109 /end MEASUREMENT
/begin MEASUREMENT CanIf_Prv_TxBufferRam_ast[2].bufferstatus "Can Interface Buffer Status[2]/" UBYTE RB_RBA_Common_CentralElements_CompuMethods_Identical 1 100 0.0 255. FORMAT "%5.0" ECU_ADDRESS 0x6002910B /end MEASUREMENT
/begin MEASUREMENT CanIf_Prv_TxBufferRam_ast[3].bufferstatus "Can Interface Buffer Status[3]/" UBYTE RB_RBA_Common_CentralElements_CompuMethods_Identical 1 100 0.0 255. FORMAT "%5.0" ECU_ADDRESS 0x6002910D /end MEASUREMENT
/begin MEASUREMENT CanIf_Prv_TxBufferRam_ast[4].bufferstatus "Can Interface Buffer Status[4]/" UBYTE RB_RBA_Common_CentralElements_CompuMethods_Identical 1 100 0.0 255. FORMAT "%5.0" ECU_ADDRESS 0x6002910F /end MEASUREMENT
/begin MEASUREMENT CanIf_Prv_TxBufferRam_ast[5].bufferstatus "Can Interface Buffer Status[5]/" UBYTE RB_RBA_Common_CentralElements_CompuMethods_Identical 1 100 0.0 255. FORMAT "%5.0" ECU_ADDRESS 0x60029111 /end MEASUREMENT
/begin MEASUREMENT CanIf_Prv_TxBufferRam_ast[6].bufferstatus "Can Interface Buffer Status[6]/" UBYTE RB_RBA_Common_CentralElements_CompuMethods_Identical 1 100 0.0 255. FORMAT "%5.0" ECU_ADDRESS 0x60029113 /end MEASUREMENT
/begin MEASUREMENT CanIf_Prv_TxBufferRam_ast[7].bufferstatus "Can Interface Buffer Status[7]/" UBYTE RB_RBA_Common_CentralElements_CompuMethods_Identical 1 100 0.0 255. FORMAT "%5.0" ECU_ADDRESS 0x60029115 /end MEASUREMENT
/begin MEASUREMENT CanIf_Prv_TxBufferRam_ast[8].bufferstatus "Can Interface Buffer Status[8]/" UBYTE RB_RBA_Common_CentralElements_CompuMethods_Identical 1 100 0.0 255. FORMAT "%5.0" ECU_ADDRESS 0x60029117 /end MEASUREMENT
/begin MEASUREMENT CanIf_Prv_TxBufferRam_ast[9].bufferstatus "Can Interface Buffer Status[9]/" UBYTE RB_RBA_Common_CentralElements_CompuMethods_Identical 1 100 0.0 255. FORMAT "%5.0" ECU_ADDRESS 0x60029119 /end MEASUREMENT
/begin MEASUREMENT CanIf_Prv_TxBufferRam_ast[10].bufferstatus "Can Interface Buffer Status[10]/" UBYTE RB_RBA_Common_CentralElements_CompuMethods_Identical 1 100 0.0 255. FORMAT "%5.0" ECU_ADDRESS 0x6002911B /end MEASUREMENT
/begin MEASUREMENT CanIf_Prv_TxBufferRam_ast[11].bufferstatus "Can Interface Buffer Status[11]/" UBYTE RB_RBA_Common_CentralElements_CompuMethods_Identical 1 100 0.0 255. FORMAT "%5.0" ECU_ADDRESS 0x6002911D /end MEASUREMENT
/begin MEASUREMENT CanIf_Prv_TxBufferRam_ast[12].bufferstatus "Can Interface Buffer Status[12]/" UBYTE RB_RBA_Common_CentralElements_CompuMethods_Identical 1 100 0.0 255. FORMAT "%5.0" ECU_ADDRESS 0x6002911F /end MEASUREMENT
/begin MEASUREMENT CanIf_Prv_TxBufferRam_ast[13].bufferstatus "Can Interface Buffer Status[13]/" UBYTE RB_RBA_Common_CentralElements_CompuMethods_Identical 1 100 0.0 255. FORMAT "%5.0" ECU_ADDRESS 0x60029121 /end MEASUREMENT
/begin MEASUREMENT CanIf_Prv_TxBufferRam_ast[14].bufferstatus "Can Interface Buffer Status[14]/" UBYTE RB_RBA_Common_CentralElements_CompuMethods_Identical 1 100 0.0 255. FORMAT "%5.0" ECU_ADDRESS 0x60029123 /end MEASUREMENT
/begin MEASUREMENT CanIf_Prv_TxBufferRam_ast[15].bufferstatus "Can Interface Buffer Status[15]/" UBYTE RB_RBA_Common_CentralElements_CompuMethods_Identical 1 100 0.0 255. FORMAT "%5.0" ECU_ADDRESS 0x60029125 /end MEASUREMENT
/begin MEASUREMENT CanIf_Prv_TxBufferRam_ast[16].bufferstatus "Can Interface Buffer Status[16]/" UBYTE RB_RBA_Common_CentralElements_CompuMethods_Identical 1 100 0.0 255. FORMAT "%5.0" ECU_ADDRESS 0x60029127 /end MEASUREMENT
/begin MEASUREMENT CanIf_Prv_TxBufferRam_ast[17].bufferstatus "Can Interface Buffer Status[17]/" UBYTE RB_RBA_Common_CentralElements_CompuMethods_Identical 1 100 0.0 255. FORMAT "%5.0" ECU_ADDRESS 0x60029129 /end MEASUREMENT
/begin MEASUREMENT CanIf_Prv_TxBufferRam_ast[18].bufferstatus "Can Interface Buffer Status[18]/" UBYTE RB_RBA_Common_CentralElements_CompuMethods_Identical 1 100 0.0 255. FORMAT "%5.0" ECU_ADDRESS 0x6002912B /end MEASUREMENT
/begin MEASUREMENT CanIf_Prv_TxBufferRam_ast[19].bufferstatus "Can Interface Buffer Status[19]/" UBYTE RB_RBA_Common_CentralElements_CompuMethods_Identical 1 100 0.0 255. FORMAT "%5.0" ECU_ADDRESS 0x6002912D /end MEASUREMENT
/begin MEASUREMENT CanIf_Prv_TxBufferRam_ast[20].bufferstatus "Can Interface Buffer Status[20]/" UBYTE RB_RBA_Common_CentralElements_CompuMethods_Identical 1 100 0.0 255. FORMAT "%5.0" ECU_ADDRESS 0x6002912F /end MEASUREMENT
/begin MEASUREMENT CanIf_Prv_TxBufferRam_ast[21].bufferstatus "Can Interface Buffer Status[21]/" UBYTE RB_RBA_Common_CentralElements_CompuMethods_Identical 1 100 0.0 255. FORMAT "%5.0" ECU_ADDRESS 0x60029131 /end MEASUREMENT
/begin MEASUREMENT CanIf_Prv_TxBufferRam_ast[22].bufferstatus "Can Interface Buffer Status[22]/" UBYTE RB_RBA_Common_CentralElements_CompuMethods_Identical 1 100 0.0 255. FORMAT "%5.0" ECU_ADDRESS 0x60029133 /end MEASUREMENT
/begin MEASUREMENT CanIf_Prv_TxBufferRam_ast[23].bufferstatus "Can Interface Buffer Status[23]/" UBYTE RB_RBA_Common_CentralElements_CompuMethods_Identical 1 100 0.0 255. FORMAT "%5.0" ECU_ADDRESS 0x60029135 /end MEASUREMENT
/begin MEASUREMENT CanIf_Prv_TxBufferRam_ast[24].bufferstatus "Can Interface Buffer Status[24]/" UBYTE RB_RBA_Common_CentralElements_CompuMethods_Identical 1 100 0.0 255. FORMAT "%5.0" ECU_ADDRESS 0x60029137 /end MEASUREMENT
/begin MEASUREMENT CanIf_Prv_TxBufferRam_ast[25].bufferstatus "Can Interface Buffer Status[25]/" UBYTE RB_RBA_Common_CentralElements_CompuMethods_Identical 1 100 0.0 255. FORMAT "%5.0" ECU_ADDRESS 0x60029139 /end MEASUREMENT
/begin MEASUREMENT CanIf_Prv_TxBufferRam_ast[26].bufferstatus "Can Interface Buffer Status[26]/" UBYTE RB_RBA_Common_CentralElements_CompuMethods_Identical 1 100 0.0 255. FORMAT "%5.0" ECU_ADDRESS 0x6002913B /end MEASUREMENT
/begin MEASUREMENT CanIf_Prv_TxBufferRam_ast[27].bufferstatus "Can Interface Buffer Status[27]/" UBYTE RB_RBA_Common_CentralElements_CompuMethods_Identical 1 100 0.0 255. FORMAT "%5.0" ECU_ADDRESS 0x6002913D /end MEASUREMENT
/begin MEASUREMENT CanIf_Prv_TxBufferRam_ast[28].bufferstatus "Can Interface Buffer Status[28]/" UBYTE RB_RBA_Common_CentralElements_CompuMethods_Identical 1 100 0.0 255. FORMAT "%5.0" ECU_ADDRESS 0x6002913F /end MEASUREMENT
/begin MEASUREMENT CanIf_Prv_TxBufferRam_ast[29].bufferstatus "Can Interface Buffer Status[29]/" UBYTE RB_RBA_Common_CentralElements_CompuMethods_Identical 1 100 0.0 255. FORMAT "%5.0" ECU_ADDRESS 0x60029141 /end MEASUREMENT
/begin MEASUREMENT CanIf_Prv_TxBufferRam_ast[30].bufferstatus "Can Interface Buffer Status[30]/" UBYTE RB_RBA_Common_CentralElements_CompuMethods_Identical 1 100 0.0 255. FORMAT "%5.0" ECU_ADDRESS 0x60029143 /end MEASUREMENT
/begin MEASUREMENT CanIf_Prv_TxBufferRam_ast[31].bufferstatus "Can Interface Buffer Status[31]/" UBYTE RB_RBA_Common_CentralElements_CompuMethods_Identical 1 100 0.0 255. FORMAT "%5.0" ECU_ADDRESS 0x60029145 /end MEASUREMENT
/begin MEASUREMENT CanIf_Prv_TxBufferRam_ast[32].bufferstatus "Can Interface Buffer Status[32]/" UBYTE RB_RBA_Common_CentralElements_CompuMethods_Identical 1 100 0.0 255. FORMAT "%5.0" ECU_ADDRESS 0x60029147 /end MEASUREMENT
/begin MEASUREMENT CanIf_Prv_TxBufferRam_ast[33].bufferstatus "Can Interface Buffer Status[33]/" UBYTE RB_RBA_Common_CentralElements_CompuMethods_Identical 1 100 0.0 255. FORMAT "%5.0" ECU_ADDRESS 0x60029149 /end MEASUREMENT
/begin MEASUREMENT CanIf_Prv_TxBufferRam_ast[34].bufferstatus "Can Interface Buffer Status[34]/" UBYTE RB_RBA_Common_CentralElements_CompuMethods_Identical 1 100 0.0 255. FORMAT "%5.0" ECU_ADDRESS 0x6002914B /end MEASUREMENT
/begin MEASUREMENT CanIf_Prv_TxBufferRam_ast[35].bufferstatus "Can Interface Buffer Status[35]/" UBYTE RB_RBA_Common_CentralElements_CompuMethods_Identical 1 100 0.0 255. FORMAT "%5.0" ECU_ADDRESS 0x6002914D /end MEASUREMENT
/begin MEASUREMENT CanIf_Prv_TxBufferRam_ast[36].bufferstatus "Can Interface Buffer Status[36]/" UBYTE RB_RBA_Common_CentralElements_CompuMethods_Identical 1 100 0.0 255. FORMAT "%5.0" ECU_ADDRESS 0x6002914F /end MEASUREMENT
/begin MEASUREMENT CanIf_Prv_TxBufferRam_ast[37].bufferstatus "Can Interface Buffer Status[37]/" UBYTE RB_RBA_Common_CentralElements_CompuMethods_Identical 1 100 0.0 255. FORMAT "%5.0" ECU_ADDRESS 0x60029151 /end MEASUREMENT
/begin MEASUREMENT CanIf_Prv_TxBufferRam_ast[38].bufferstatus "Can Interface Buffer Status[38]/" UBYTE RB_RBA_Common_CentralElements_CompuMethods_Identical 1 100 0.0 255. FORMAT "%5.0" ECU_ADDRESS 0x60029153 /end MEASUREMENT
/begin MEASUREMENT CanIf_Prv_TxBufferRam_ast[39].bufferstatus "Can Interface Buffer Status[39]/" UBYTE RB_RBA_Common_CentralElements_CompuMethods_Identical 1 100 0.0 255. FORMAT "%5.0" ECU_ADDRESS 0x60029155 /end MEASUREMENT
/begin MEASUREMENT CanIf_Prv_TxBufferRam_ast[40].bufferstatus "Can Interface Buffer Status[40]/" UBYTE RB_RBA_Common_CentralElements_CompuMethods_Identical 1 100 0.0 255. FORMAT "%5.0" ECU_ADDRESS 0x60029157 /end MEASUREMENT
/begin MEASUREMENT CanIf_Prv_TxBufferRam_ast[41].bufferstatus "Can Interface Buffer Status[41]/" UBYTE RB_RBA_Common_CentralElements_CompuMethods_Identical 1 100 0.0 255. FORMAT "%5.0" ECU_ADDRESS 0x60029159 /end MEASUREMENT
/begin MEASUREMENT CanIf_Prv_TxBufferRam_ast[42].bufferstatus "Can Interface Buffer Status[42]/" UBYTE RB_RBA_Common_CentralElements_CompuMethods_Identical 1 100 0.0 255. FORMAT "%5.0" ECU_ADDRESS 0x6002915B /end MEASUREMENT
/begin MEASUREMENT CanIf_Prv_TxBufferRam_ast[43].bufferstatus "Can Interface Buffer Status[43]/" UBYTE RB_RBA_Common_CentralElements_CompuMethods_Identical 1 100 0.0 255. FORMAT "%5.0" ECU_ADDRESS 0x6002915D /end MEASUREMENT
/begin MEASUREMENT CanIf_Prv_TxBufferRam_ast[44].bufferstatus "Can Interface Buffer Status[44]/" UBYTE RB_RBA_Common_CentralElements_CompuMethods_Identical 1 100 0.0 255. FORMAT "%5.0" ECU_ADDRESS 0x6002915F /end MEASUREMENT
/begin MEASUREMENT CanIf_Prv_TxBufferRam_ast[45].bufferstatus "Can Interface Buffer Status[45]/" UBYTE RB_RBA_Common_CentralElements_CompuMethods_Identical 1 100 0.0 255. FORMAT "%5.0" ECU_ADDRESS 0x60029161 /end MEASUREMENT
/begin MEASUREMENT CanIf_Prv_TxBufferRam_ast[46].bufferstatus "Can Interface Buffer Status[46]/" UBYTE RB_RBA_Common_CentralElements_CompuMethods_Identical 1 100 0.0 255. FORMAT "%5.0" ECU_ADDRESS 0x60029163 /end MEASUREMENT
/begin MEASUREMENT CanIf_Prv_TxBufferRam_ast[47].bufferstatus "Can Interface Buffer Status[47]/" UBYTE RB_RBA_Common_CentralElements_CompuMethods_Identical 1 100 0.0 255. FORMAT "%5.0" ECU_ADDRESS 0x60029165 /end MEASUREMENT
/begin MEASUREMENT CanIf_Prv_TxBufferRam_ast[48].bufferstatus "Can Interface Buffer Status[48]/" UBYTE RB_RBA_Common_CentralElements_CompuMethods_Identical 1 100 0.0 255. FORMAT "%5.0" ECU_ADDRESS 0x60029167 /end MEASUREMENT
/begin MEASUREMENT CanIf_Prv_TxBufferRam_ast[49].bufferstatus "Can Interface Buffer Status[49]/" UBYTE RB_RBA_Common_CentralElements_CompuMethods_Identical 1 100 0.0 255. FORMAT "%5.0" ECU_ADDRESS 0x60029169 /end MEASUREMENT
/begin MEASUREMENT CanIf_Prv_TxBufferRam_ast[50].bufferstatus "Can Interface Buffer Status[50]/" UBYTE RB_RBA_Common_CentralElements_CompuMethods_Identical 1 100 0.0 255. FORMAT "%5.0" ECU_ADDRESS 0x6002916B /end MEASUREMENT
/begin MEASUREMENT CanIf_Prv_TxBufferRam_ast[51].bufferstatus "Can Interface Buffer Status[51]/" UBYTE RB_RBA_Common_CentralElements_CompuMethods_Identical 1 100 0.0 255. FORMAT "%5.0" ECU_ADDRESS 0x6002916D /end MEASUREMENT
/begin MEASUREMENT CanIf_Prv_TxBufferRam_ast[52].bufferstatus "Can Interface Buffer Status[52]/" UBYTE RB_RBA_Common_CentralElements_CompuMethods_Identical 1 100 0.0 255. FORMAT "%5.0" ECU_ADDRESS 0x6002916F /end MEASUREMENT
/begin MEASUREMENT CanIf_Prv_TxBufferRam_ast[53].bufferstatus "Can Interface Buffer Status[53]/" UBYTE RB_RBA_Common_CentralElements_CompuMethods_Identical 1 100 0.0 255. FORMAT "%5.0" ECU_ADDRESS 0x60029171 /end MEASUREMENT
/begin MEASUREMENT CanIf_Prv_TxBufferRam_ast[54].bufferstatus "Can Interface Buffer Status[54]/" UBYTE RB_RBA_Common_CentralElements_CompuMethods_Identical 1 100 0.0 255. FORMAT "%5.0" ECU_ADDRESS 0x60029173 /end MEASUREMENT
/begin MEASUREMENT CanIf_Prv_TxBufferRam_ast[55].bufferstatus "Can Interface Buffer Status[55]/" UBYTE RB_RBA_Common_CentralElements_CompuMethods_Identical 1 100 0.0 255. FORMAT "%5.0" ECU_ADDRESS 0x60029175 /end MEASUREMENT
/begin MEASUREMENT CanIf_Prv_TxBufferRam_ast[56].bufferstatus "Can Interface Buffer Status[56]/" UBYTE RB_RBA_Common_CentralElements_CompuMethods_Identical 1 100 0.0 255. FORMAT "%5.0" ECU_ADDRESS 0x60029177 /end MEASUREMENT
/begin MEASUREMENT CanIf_Prv_TxBufferRam_ast[57].bufferstatus "Can Interface Buffer Status[57]/" UBYTE RB_RBA_Common_CentralElements_CompuMethods_Identical 1 100 0.0 255. FORMAT "%5.0" ECU_ADDRESS 0x60029179 /end MEASUREMENT
/begin MEASUREMENT CanIf_Prv_TxBufferRam_ast[58].bufferstatus "Can Interface Buffer Status[58]/" UBYTE RB_RBA_Common_CentralElements_CompuMethods_Identical 1 100 0.0 255. FORMAT "%5.0" ECU_ADDRESS 0x6002917B /end MEASUREMENT
/begin MEASUREMENT CanIf_Prv_TxBufferRam_ast[59].bufferstatus "Can Interface Buffer Status[59]/" UBYTE RB_RBA_Common_CentralElements_CompuMethods_Identical 1 100 0.0 255. FORMAT "%5.0" ECU_ADDRESS 0x6002917D /end MEASUREMENT
/begin MEASUREMENT CanIf_Prv_TxBufferRam_ast[60].bufferstatus "Can Interface Buffer Status[60]/" UBYTE RB_RBA_Common_CentralElements_CompuMethods_Identical 1 100 0.0 255. FORMAT "%5.0" ECU_ADDRESS 0x6002917F /end MEASUREMENT
/begin MEASUREMENT CanIf_Prv_TxBufferRam_ast[61].bufferstatus "Can Interface Buffer Status[61]/" UBYTE RB_RBA_Common_CentralElements_CompuMethods_Identical 1 100 0.0 255. FORMAT "%5.0" ECU_ADDRESS 0x60029181 /end MEASUREMENT
/begin MEASUREMENT CanIf_Prv_TxBufferRam_ast[62].bufferstatus "Can Interface Buffer Status[62]/" UBYTE RB_RBA_Common_CentralElements_CompuMethods_Identical 1 100 0.0 255. FORMAT "%5.0" ECU_ADDRESS 0x60029183 /end MEASUREMENT
/begin MEASUREMENT CanIf_Prv_TxBufferRam_ast[63].bufferstatus "Can Interface Buffer Status[63]/" UBYTE RB_RBA_Common_CentralElements_CompuMethods_Identical 1 100 0.0 255. FORMAT "%5.0" ECU_ADDRESS 0x60029185 /end MEASUREMENT
/begin MEASUREMENT CanIf_Prv_TxBufferRam_ast[64].bufferstatus "Can Interface Buffer Status[64]/" UBYTE RB_RBA_Common_CentralElements_CompuMethods_Identical 1 100 0.0 255. FORMAT "%5.0" ECU_ADDRESS 0x60029187 /end MEASUREMENT
/begin MEASUREMENT CanIf_Prv_TxBufferRam_ast[65].bufferstatus "Can Interface Buffer Status[65]/" UBYTE RB_RBA_Common_CentralElements_CompuMethods_Identical 1 100 0.0 255. FORMAT "%5.0" ECU_ADDRESS 0x60029189 /end MEASUREMENT
/begin MEASUREMENT CanIf_Prv_TxBufferRam_ast[66].bufferstatus "Can Interface Buffer Status[66]/" UBYTE RB_RBA_Common_CentralElements_CompuMethods_Identical 1 100 0.0 255. FORMAT "%5.0" ECU_ADDRESS 0x6002918B /end MEASUREMENT
/begin MEASUREMENT CanIf_Prv_TxBufferRam_ast[67].bufferstatus "Can Interface Buffer Status[67]/" UBYTE RB_RBA_Common_CentralElements_CompuMethods_Identical 1 100 0.0 255. FORMAT "%5.0" ECU_ADDRESS 0x6002918D /end MEASUREMENT
/begin MEASUREMENT CanIf_Prv_TxBufferRam_ast[68].bufferstatus "Can Interface Buffer Status[68]/" UBYTE RB_RBA_Common_CentralElements_CompuMethods_Identical 1 100 0.0 255. FORMAT "%5.0" ECU_ADDRESS 0x6002918F /end MEASUREMENT
/begin MEASUREMENT CanIf_Prv_TxBufferRam_ast[69].bufferstatus "Can Interface Buffer Status[69]/" UBYTE RB_RBA_Common_CentralElements_CompuMethods_Identical 1 100 0.0 255. FORMAT "%5.0" ECU_ADDRESS 0x60029191 /end MEASUREMENT
/begin MEASUREMENT CanIf_Prv_TxBufferRam_ast[70].bufferstatus "Can Interface Buffer Status[70]/" UBYTE RB_RBA_Common_CentralElements_CompuMethods_Identical 1 100 0.0 255. FORMAT "%5.0" ECU_ADDRESS 0x60029193 /end MEASUREMENT
/begin MEASUREMENT CanIf_Prv_TxBufferRam_ast[71].bufferstatus "Can Interface Buffer Status[71]/" UBYTE RB_RBA_Common_CentralElements_CompuMethods_Identical 1 100 0.0 255. FORMAT "%5.0" ECU_ADDRESS 0x60029195 /end MEASUREMENT
/begin MEASUREMENT CanIf_Prv_TxBufferRam_ast[72].bufferstatus "Can Interface Buffer Status[72]/" UBYTE RB_RBA_Common_CentralElements_CompuMethods_Identical 1 100 0.0 255. FORMAT "%5.0" ECU_ADDRESS 0x60029197 /end MEASUREMENT
/begin MEASUREMENT CanIf_Prv_TxBufferRam_ast[73].bufferstatus "Can Interface Buffer Status[73]/" UBYTE RB_RBA_Common_CentralElements_CompuMethods_Identical 1 100 0.0 255. FORMAT "%5.0" ECU_ADDRESS 0x60029199 /end MEASUREMENT
/begin MEASUREMENT CanIf_Prv_TxBufferRam_ast[74].bufferstatus "Can Interface Buffer Status[74]/" UBYTE RB_RBA_Common_CentralElements_CompuMethods_Identical 1 100 0.0 255. FORMAT "%5.0" ECU_ADDRESS 0x6002919B /end MEASUREMENT
/begin MEASUREMENT CanIf_Prv_TxBufferRam_ast[75].bufferstatus "Can Interface Buffer Status[75]/" UBYTE RB_RBA_Common_CentralElements_CompuMethods_Identical 1 100 0.0 255. FORMAT "%5.0" ECU_ADDRESS 0x6002919D /end MEASUREMENT
/begin MEASUREMENT CanIf_Prv_TxBufferRam_ast[76].bufferstatus "Can Interface Buffer Status[76]/" UBYTE RB_RBA_Common_CentralElements_CompuMethods_Identical 1 100 0.0 255. FORMAT "%5.0" ECU_ADDRESS 0x6002919F /end MEASUREMENT
/begin MEASUREMENT CanIf_Prv_TxBufferRam_ast[77].bufferstatus "Can Interface Buffer Status[77]/" UBYTE RB_RBA_Common_CentralElements_CompuMethods_Identical 1 100 0.0 255. FORMAT "%5.0" ECU_ADDRESS 0x600291A1 /end MEASUREMENT
/begin MEASUREMENT CanSM_BORMode_au8 "Variable to SET/RESET the BOR mode" UBYTE RB_RBA_Common_CentralElements_CompuMethods_Identical 1 100 0.0 255. FORMAT "%5.0" ECU_ADDRESS 0x60023F94 MATRIX_DIM 4 /end MEASUREMENT
/begin MEASUREMENT CanSM_BusOffISRPend_ab "To Set the BOR ISR Pending Request to True or False" UBYTE RB_RBA_Common_CentralElements_CompuMethods_Identical 1 100 0.0 255. FORMAT "%5.0" ECU_ADDRESS 0x60027998 MATRIX_DIM 4 /end MEASUREMENT
/begin MEASUREMENT CanSM_BusOff_Cntr_au8 "Bus-Off counter for CanSM" UBYTE RB_RBA_Common_CentralElements_CompuMethods_Identical 1 100 0.0 255. FORMAT "%5.0" ECU_ADDRESS 0x60023F98 MATRIX_DIM 4 /end MEASUREMENT
/begin MEASUREMENT CanSM_CurrNw_Mode_en "current ComM mode" UBYTE AUTOSAR_CanSM_CompuMethods_CanSM_NetworkModeStateType_Enum_comp 1 100 0.0 255. FORMAT "%5.0" ECU_ADDRESS 0x600279AC MATRIX_DIM 4 /end MEASUREMENT
/begin MEASUREMENT CanSM_MutexMode_au8 "Used to set" UBYTE RB_RBA_Common_CentralElements_CompuMethods_Identical 1 100 0.0 255. FORMAT "%5.0" ECU_ADDRESS 0x60023F90 MATRIX_DIM 4 /end MEASUREMENT
/begin MEASUREMENT CanSM_Network_Init_ab "Setting this leads to initialisation of the network" UBYTE RB_RBA_Common_CentralElements_CompuMethods_Identical 1 100 0.0 255. FORMAT "%5.0" ECU_ADDRESS 0x6002796C MATRIX_DIM 4 /end MEASUREMENT
/begin MEASUREMENT CanSM_ReqComM_Mode_en "stores the requested communication mode" UBYTE RB_RBA_Common_CentralElements_CompuMethods_Identical 1 100 0.0 255. FORMAT "%5.0" ECU_ADDRESS 0x600279A0 MATRIX_DIM 4 /end MEASUREMENT
/begin MEASUREMENT CanSM_TimerConfig_ast[0].cntTick_u16 "CanSM timer configuration[0]/" UWORD RB_RBA_Common_CentralElements_CompuMethods_Identical 1 100 0.0 65535. FORMAT "%5.0" ECU_ADDRESS 0x600279B4 /end MEASUREMENT
/begin MEASUREMENT CanSM_TimerConfig_ast[1].cntTick_u16 "CanSM timer configuration[1]/" UWORD RB_RBA_Common_CentralElements_CompuMethods_Identical 1 100 0.0 65535. FORMAT "%5.0" ECU_ADDRESS 0x600279B8 /end MEASUREMENT
/begin MEASUREMENT CanSM_TimerConfig_ast[2].cntTick_u16 "CanSM timer configuration[2]/" UWORD RB_RBA_Common_CentralElements_CompuMethods_Identical 1 100 0.0 65535. FORMAT "%5.0" ECU_ADDRESS 0x600279BC /end MEASUREMENT
/begin MEASUREMENT CanSM_TimerConfig_ast[3].cntTick_u16 "CanSM timer configuration[3]/" UWORD RB_RBA_Common_CentralElements_CompuMethods_Identical 1 100 0.0 65535. FORMAT "%5.0" ECU_ADDRESS 0x600279C0 /end MEASUREMENT
/begin MEASUREMENT CanSM_TimerConfig_ast[0].stTimer "CanSM timer configuration[0]/" UBYTE AUTOSAR_CanSM_CompuMethods_CanSM_TimerStateType_Enum_comp 1 100 0.0 255. FORMAT "%5.0" ECU_ADDRESS 0x600279B2 /end MEASUREMENT
/begin MEASUREMENT CanSM_TimerConfig_ast[1].stTimer "CanSM timer configuration[1]/" UBYTE AUTOSAR_CanSM_CompuMethods_CanSM_TimerStateType_Enum_comp 1 100 0.0 255. FORMAT "%5.0" ECU_ADDRESS 0x600279B6 /end MEASUREMENT
/begin MEASUREMENT CanSM_TimerConfig_ast[2].stTimer "CanSM timer configuration[2]/" UBYTE AUTOSAR_CanSM_CompuMethods_CanSM_TimerStateType_Enum_comp 1 100 0.0 255. FORMAT "%5.0" ECU_ADDRESS 0x600279BA /end MEASUREMENT
/begin MEASUREMENT CanSM_TimerConfig_ast[3].stTimer "CanSM timer configuration[3]/" UBYTE AUTOSAR_CanSM_CompuMethods_CanSM_TimerStateType_Enum_comp 1 100 0.0 255. FORMAT "%5.0" ECU_ADDRESS 0x600279BE /end MEASUREMENT
/begin MEASUREMENT CanSM_currBOR_State_en "Current Bus-Off recovery state for CanSM" UBYTE AUTOSAR_CanSM_CompuMethods_CanSM_BusOffRecoveryStateType_Enum_comp 1 100 0.0 255. FORMAT "%5.0" ECU_ADDRESS 0x600279A8 MATRIX_DIM 4 /end MEASUREMENT
/begin MEASUREMENT CanTp_MainState "MainState of CanTp indicating whether Tp Communication on CanStack is possible." UBYTE DefaultIdenticalCompu 1 100 0.0 255.0 FORMAT "%5.1" ECU_ADDRESS 0x60022F55 /end MEASUREMENT
/begin MEASUREMENT ComM_ChannelStruct[0].ChannelState_e "ComM Channel structure[0]/" ULONG RB_RBA_Common_CentralElements_CompuMethods_Identical 1 100 0.0 4.E9 FORMAT "%5.0" ECU_ADDRESS 0x600291E0 /end MEASUREMENT
/begin MEASUREMENT ComM_ChannelStruct[1].ChannelState_e "ComM Channel structure[1]/" ULONG RB_RBA_Common_CentralElements_CompuMethods_Identical 1 100 0.0 4.E9 FORMAT "%5.0" ECU_ADDRESS 0x600291F8 /end MEASUREMENT
/begin MEASUREMENT ComM_ChannelStruct[2].ChannelState_e "ComM Channel structure[2]/" ULONG RB_RBA_Common_CentralElements_CompuMethods_Identical 1 100 0.0 4.E9 FORMAT "%5.0" ECU_ADDRESS 0x60029210 /end MEASUREMENT
/begin MEASUREMENT ComM_ChannelStruct[3].ChannelState_e "ComM Channel structure[3]/" ULONG RB_RBA_Common_CentralElements_CompuMethods_Identical 1 100 0.0 4.E9 FORMAT "%5.0" ECU_ADDRESS 0x60029228 /end MEASUREMENT
/begin MEASUREMENT ComM_ChannelStruct[4].ChannelState_e "ComM Channel structure[4]/" ULONG RB_RBA_Common_CentralElements_CompuMethods_Identical 1 100 0.0 4.E9 FORMAT "%5.0" ECU_ADDRESS 0x60029240 /end MEASUREMENT
/begin MEASUREMENT ComM_ChannelStruct[5].ChannelState_e "ComM Channel structure[5]/" ULONG RB_RBA_Common_CentralElements_CompuMethods_Identical 1 100 0.0 4.E9 FORMAT "%5.0" ECU_ADDRESS 0x60029258 /end MEASUREMENT
/begin MEASUREMENT ComM_ChannelStruct[0].LightTimeoutCtr_u32 "ComM Channel structure[0]/" ULONG RB_RBA_Common_CentralElements_CompuMethods_Identical 1 100 0.0 4.E9 FORMAT "%5.0" ECU_ADDRESS 0x600291E4 /end MEASUREMENT
/begin MEASUREMENT ComM_ChannelStruct[1].LightTimeoutCtr_u32 "ComM Channel structure[1]/" ULONG RB_RBA_Common_CentralElements_CompuMethods_Identical 1 100 0.0 4.E9 FORMAT "%5.0" ECU_ADDRESS 0x600291FC /end MEASUREMENT
/begin MEASUREMENT ComM_ChannelStruct[2].LightTimeoutCtr_u32 "ComM Channel structure[2]/" ULONG RB_RBA_Common_CentralElements_CompuMethods_Identical 1 100 0.0 4.E9 FORMAT "%5.0" ECU_ADDRESS 0x60029214 /end MEASUREMENT
/begin MEASUREMENT ComM_ChannelStruct[3].LightTimeoutCtr_u32 "ComM Channel structure[3]/" ULONG RB_RBA_Common_CentralElements_CompuMethods_Identical 1 100 0.0 4.E9 FORMAT "%5.0" ECU_ADDRESS 0x6002922C /end MEASUREMENT
/begin MEASUREMENT ComM_ChannelStruct[4].LightTimeoutCtr_u32 "ComM Channel structure[4]/" ULONG RB_RBA_Common_CentralElements_CompuMethods_Identical 1 100 0.0 4.E9 FORMAT "%5.0" ECU_ADDRESS 0x60029244 /end MEASUREMENT
/begin MEASUREMENT ComM_ChannelStruct[5].LightTimeoutCtr_u32 "ComM Channel structure[5]/" ULONG RB_RBA_Common_CentralElements_CompuMethods_Identical 1 100 0.0 4.E9 FORMAT "%5.0" ECU_ADDRESS 0x6002925C /end MEASUREMENT
/begin MEASUREMENT ComM_ChannelStruct[0].MinFullComTimeoutCtr_u16 "ComM Channel structure[0]/" UWORD RB_RBA_Common_CentralElements_CompuMethods_Identical 1 100 0.0 65535. FORMAT "%5.0" ECU_ADDRESS 0x600291E8 /end MEASUREMENT
/begin MEASUREMENT ComM_ChannelStruct[1].MinFullComTimeoutCtr_u16 "ComM Channel structure[1]/" UWORD RB_RBA_Common_CentralElements_CompuMethods_Identical 1 100 0.0 65535. FORMAT "%5.0" ECU_ADDRESS 0x60029200 /end MEASUREMENT
/begin MEASUREMENT ComM_ChannelStruct[2].MinFullComTimeoutCtr_u16 "ComM Channel structure[2]/" UWORD RB_RBA_Common_CentralElements_CompuMethods_Identical 1 100 0.0 65535. FORMAT "%5.0" ECU_ADDRESS 0x60029218 /end MEASUREMENT
/begin MEASUREMENT ComM_ChannelStruct[3].MinFullComTimeoutCtr_u16 "ComM Channel structure[3]/" UWORD RB_RBA_Common_CentralElements_CompuMethods_Identical 1 100 0.0 65535. FORMAT "%5.0" ECU_ADDRESS 0x60029230 /end MEASUREMENT
/begin MEASUREMENT ComM_ChannelStruct[4].MinFullComTimeoutCtr_u16 "ComM Channel structure[4]/" UWORD RB_RBA_Common_CentralElements_CompuMethods_Identical 1 100 0.0 65535. FORMAT "%5.0" ECU_ADDRESS 0x60029248 /end MEASUREMENT
/begin MEASUREMENT ComM_ChannelStruct[5].MinFullComTimeoutCtr_u16 "ComM Channel structure[5]/" UWORD RB_RBA_Common_CentralElements_CompuMethods_Identical 1 100 0.0 65535. FORMAT "%5.0" ECU_ADDRESS 0x60029260 /end MEASUREMENT
/begin MEASUREMENT ComM_ChannelStruct[0].UserRequestCtr_u16 "ComM Channel structure[0]/" UWORD RB_RBA_Common_CentralElements_CompuMethods_Identical 1 100 0.0 65535. FORMAT "%5.0" ECU_ADDRESS 0x600291EA /end MEASUREMENT
/begin MEASUREMENT ComM_ChannelStruct[1].UserRequestCtr_u16 "ComM Channel structure[1]/" UWORD RB_RBA_Common_CentralElements_CompuMethods_Identical 1 100 0.0 65535. FORMAT "%5.0" ECU_ADDRESS 0x60029202 /end MEASUREMENT
/begin MEASUREMENT ComM_ChannelStruct[2].UserRequestCtr_u16 "ComM Channel structure[2]/" UWORD RB_RBA_Common_CentralElements_CompuMethods_Identical 1 100 0.0 65535. FORMAT "%5.0" ECU_ADDRESS 0x6002921A /end MEASUREMENT
/begin MEASUREMENT ComM_ChannelStruct[3].UserRequestCtr_u16 "ComM Channel structure[3]/" UWORD RB_RBA_Common_CentralElements_CompuMethods_Identical 1 100 0.0 65535. FORMAT "%5.0" ECU_ADDRESS 0x60029232 /end MEASUREMENT
/begin MEASUREMENT ComM_ChannelStruct[4].UserRequestCtr_u16 "ComM Channel structure[4]/" UWORD RB_RBA_Common_CentralElements_CompuMethods_Identical 1 100 0.0 65535. FORMAT "%5.0" ECU_ADDRESS 0x6002924A /end MEASUREMENT
/begin MEASUREMENT ComM_ChannelStruct[5].UserRequestCtr_u16 "ComM Channel structure[5]/" UWORD RB_RBA_Common_CentralElements_CompuMethods_Identical 1 100 0.0 65535. FORMAT "%5.0" ECU_ADDRESS 0x60029262 /end MEASUREMENT
/begin MEASUREMENT ComM_ChannelStruct[0].ChannelMode_u8 "ComM Channel structure[0]/" UBYTE RB_RBA_Common_CentralElements_CompuMethods_Identical 1 100 0.0 255. FORMAT "%5.0" ECU_ADDRESS 0x600291EC /end MEASUREMENT
/begin MEASUREMENT ComM_ChannelStruct[1].ChannelMode_u8 "ComM Channel structure[1]/" UBYTE RB_RBA_Common_CentralElements_CompuMethods_Identical 1 100 0.0 255. FORMAT "%5.0" ECU_ADDRESS 0x60029204 /end MEASUREMENT
/begin MEASUREMENT ComM_ChannelStruct[2].ChannelMode_u8 "ComM Channel structure[2]/" UBYTE RB_RBA_Common_CentralElements_CompuMethods_Identical 1 100 0.0 255. FORMAT "%5.0" ECU_ADDRESS 0x6002921C /end MEASUREMENT
/begin MEASUREMENT ComM_ChannelStruct[3].ChannelMode_u8 "ComM Channel structure[3]/" UBYTE RB_RBA_Common_CentralElements_CompuMethods_Identical 1 100 0.0 255. FORMAT "%5.0" ECU_ADDRESS 0x60029234 /end MEASUREMENT
/begin MEASUREMENT ComM_ChannelStruct[4].ChannelMode_u8 "ComM Channel structure[4]/" UBYTE RB_RBA_Common_CentralElements_CompuMethods_Identical 1 100 0.0 255. FORMAT "%5.0" ECU_ADDRESS 0x6002924C /end MEASUREMENT
/begin MEASUREMENT ComM_ChannelStruct[5].ChannelMode_u8 "ComM Channel structure[5]/" UBYTE RB_RBA_Common_CentralElements_CompuMethods_Identical 1 100 0.0 255. FORMAT "%5.0" ECU_ADDRESS 0x60029264 /end MEASUREMENT
/begin MEASUREMENT ComM_ChannelStruct[0].BusSmMode_u8 "ComM Channel structure[0]/" UBYTE RB_RBA_Common_CentralElements_CompuMethods_Identical 1 100 0.0 255. FORMAT "%5.0" ECU_ADDRESS 0x600291ED /end MEASUREMENT
/begin MEASUREMENT ComM_ChannelStruct[1].BusSmMode_u8 "ComM Channel structure[1]/" UBYTE RB_RBA_Common_CentralElements_CompuMethods_Identical 1 100 0.0 255. FORMAT "%5.0" ECU_ADDRESS 0x60029205 /end MEASUREMENT
/begin MEASUREMENT ComM_ChannelStruct[2].BusSmMode_u8 "ComM Channel structure[2]/" UBYTE RB_RBA_Common_CentralElements_CompuMethods_Identical 1 100 0.0 255. FORMAT "%5.0" ECU_ADDRESS 0x6002921D /end MEASUREMENT
/begin MEASUREMENT ComM_ChannelStruct[3].BusSmMode_u8 "ComM Channel structure[3]/" UBYTE RB_RBA_Common_CentralElements_CompuMethods_Identical 1 100 0.0 255. FORMAT "%5.0" ECU_ADDRESS 0x60029235 /end MEASUREMENT
/begin MEASUREMENT ComM_ChannelStruct[4].BusSmMode_u8 "ComM Channel structure[4]/" UBYTE RB_RBA_Common_CentralElements_CompuMethods_Identical 1 100 0.0 255. FORMAT "%5.0" ECU_ADDRESS 0x6002924D /end MEASUREMENT
/begin MEASUREMENT ComM_ChannelStruct[5].BusSmMode_u8 "ComM Channel structure[5]/" UBYTE RB_RBA_Common_CentralElements_CompuMethods_Identical 1 100 0.0 255. FORMAT "%5.0" ECU_ADDRESS 0x60029265 /end MEASUREMENT
/begin MEASUREMENT ComM_ChannelStruct[0].PassiveRequestState_u8 "ComM Channel structure[0]/" UBYTE RB_RBA_Common_CentralElements_CompuMethods_Identical 1 100 0.0 255. FORMAT "%5.0" ECU_ADDRESS 0x600291EE /end MEASUREMENT
/begin MEASUREMENT ComM_ChannelStruct[1].PassiveRequestState_u8 "ComM Channel structure[1]/" UBYTE RB_RBA_Common_CentralElements_CompuMethods_Identical 1 100 0.0 255. FORMAT "%5.0" ECU_ADDRESS 0x60029206 /end MEASUREMENT
/begin MEASUREMENT ComM_ChannelStruct[2].PassiveRequestState_u8 "ComM Channel structure[2]/" UBYTE RB_RBA_Common_CentralElements_CompuMethods_Identical 1 100 0.0 255. FORMAT "%5.0" ECU_ADDRESS 0x6002921E /end MEASUREMENT
/begin MEASUREMENT ComM_ChannelStruct[3].PassiveRequestState_u8 "ComM Channel structure[3]/" UBYTE RB_RBA_Common_CentralElements_CompuMethods_Identical 1 100 0.0 255. FORMAT "%5.0" ECU_ADDRESS 0x60029236 /end MEASUREMENT
/begin MEASUREMENT ComM_ChannelStruct[4].PassiveRequestState_u8 "ComM Channel structure[4]/" UBYTE RB_RBA_Common_CentralElements_CompuMethods_Identical 1 100 0.0 255. FORMAT "%5.0" ECU_ADDRESS 0x6002924E /end MEASUREMENT
/begin MEASUREMENT ComM_ChannelStruct[5].PassiveRequestState_u8 "ComM Channel structure[5]/" UBYTE RB_RBA_Common_CentralElements_CompuMethods_Identical 1 100 0.0 255. FORMAT "%5.0" ECU_ADDRESS 0x60029266 /end MEASUREMENT
/begin MEASUREMENT ComM_ChannelStruct[0].PncRequestCtr_u8 "ComM Channel structure[0]/" UBYTE RB_RBA_Common_CentralElements_CompuMethods_Identical 1 100 0.0 255. FORMAT "%5.0" ECU_ADDRESS 0x600291EF /end MEASUREMENT
/begin MEASUREMENT ComM_ChannelStruct[1].PncRequestCtr_u8 "ComM Channel structure[1]/" UBYTE RB_RBA_Common_CentralElements_CompuMethods_Identical 1 100 0.0 255. FORMAT "%5.0" ECU_ADDRESS 0x60029207 /end MEASUREMENT
/begin MEASUREMENT ComM_ChannelStruct[2].PncRequestCtr_u8 "ComM Channel structure[2]/" UBYTE RB_RBA_Common_CentralElements_CompuMethods_Identical 1 100 0.0 255. FORMAT "%5.0" ECU_ADDRESS 0x6002921F /end MEASUREMENT
/begin MEASUREMENT ComM_ChannelStruct[3].PncRequestCtr_u8 "ComM Channel structure[3]/" UBYTE RB_RBA_Common_CentralElements_CompuMethods_Identical 1 100 0.0 255. FORMAT "%5.0" ECU_ADDRESS 0x60029237 /end MEASUREMENT
/begin MEASUREMENT ComM_ChannelStruct[4].PncRequestCtr_u8 "ComM Channel structure[4]/" UBYTE RB_RBA_Common_CentralElements_CompuMethods_Identical 1 100 0.0 255. FORMAT "%5.0" ECU_ADDRESS 0x6002924F /end MEASUREMENT
/begin MEASUREMENT ComM_ChannelStruct[5].PncRequestCtr_u8 "ComM Channel structure[5]/" UBYTE RB_RBA_Common_CentralElements_CompuMethods_Identical 1 100 0.0 255. FORMAT "%5.0" ECU_ADDRESS 0x60029267 /end MEASUREMENT
/begin MEASUREMENT ComM_ChannelStruct[0].InhibitionReqStatus_u8 "ComM Channel structure[0]/" UBYTE RB_RBA_Common_CentralElements_CompuMethods_Identical 1 100 0.0 255. FORMAT "%5.0" ECU_ADDRESS 0x600291F0 /end MEASUREMENT
/begin MEASUREMENT ComM_ChannelStruct[1].InhibitionReqStatus_u8 "ComM Channel structure[1]/" UBYTE RB_RBA_Common_CentralElements_CompuMethods_Identical 1 100 0.0 255. FORMAT "%5.0" ECU_ADDRESS 0x60029208 /end MEASUREMENT
/begin MEASUREMENT ComM_ChannelStruct[2].InhibitionReqStatus_u8 "ComM Channel structure[2]/" UBYTE RB_RBA_Common_CentralElements_CompuMethods_Identical 1 100 0.0 255. FORMAT "%5.0" ECU_ADDRESS 0x60029220 /end MEASUREMENT
/begin MEASUREMENT ComM_ChannelStruct[3].InhibitionReqStatus_u8 "ComM Channel structure[3]/" UBYTE RB_RBA_Common_CentralElements_CompuMethods_Identical 1 100 0.0 255. FORMAT "%5.0" ECU_ADDRESS 0x60029238 /end MEASUREMENT
/begin MEASUREMENT ComM_ChannelStruct[4].InhibitionReqStatus_u8 "ComM Channel structure[4]/" UBYTE RB_RBA_Common_CentralElements_CompuMethods_Identical 1 100 0.0 255. FORMAT "%5.0" ECU_ADDRESS 0x60029250 /end MEASUREMENT
/begin MEASUREMENT ComM_ChannelStruct[5].InhibitionReqStatus_u8 "ComM Channel structure[5]/" UBYTE RB_RBA_Common_CentralElements_CompuMethods_Identical 1 100 0.0 255. FORMAT "%5.0" ECU_ADDRESS 0x60029268 /end MEASUREMENT
/begin MEASUREMENT ComM_ChannelStruct[0].NmNetworkRequestStatus_b "ComM Channel structure[0]/" UBYTE RB_RBA_Common_CentralElements_CompuMethods_Identical 1 100 0.0 255. FORMAT "%5.0" ECU_ADDRESS 0x600291F1 /end MEASUREMENT
/begin MEASUREMENT ComM_ChannelStruct[1].NmNetworkRequestStatus_b "ComM Channel structure[1]/" UBYTE RB_RBA_Common_CentralElements_CompuMethods_Identical 1 100 0.0 255. FORMAT "%5.0" ECU_ADDRESS 0x60029209 /end MEASUREMENT
/begin MEASUREMENT ComM_ChannelStruct[2].NmNetworkRequestStatus_b "ComM Channel structure[2]/" UBYTE RB_RBA_Common_CentralElements_CompuMethods_Identical 1 100 0.0 255. FORMAT "%5.0" ECU_ADDRESS 0x60029221 /end MEASUREMENT
/begin MEASUREMENT ComM_ChannelStruct[3].NmNetworkRequestStatus_b "ComM Channel structure[3]/" UBYTE RB_RBA_Common_CentralElements_CompuMethods_Identical 1 100 0.0 255. FORMAT "%5.0" ECU_ADDRESS 0x60029239 /end MEASUREMENT
/begin MEASUREMENT ComM_ChannelStruct[4].NmNetworkRequestStatus_b "ComM Channel structure[4]/" UBYTE RB_RBA_Common_CentralElements_CompuMethods_Identical 1 100 0.0 255. FORMAT "%5.0" ECU_ADDRESS 0x60029251 /end MEASUREMENT
/begin MEASUREMENT ComM_ChannelStruct[5].NmNetworkRequestStatus_b "ComM Channel structure[5]/" UBYTE RB_RBA_Common_CentralElements_CompuMethods_Identical 1 100 0.0 255. FORMAT "%5.0" ECU_ADDRESS 0x60029269 /end MEASUREMENT
/begin MEASUREMENT ComM_ChannelStruct[0].DiagnosticRequestState_b "ComM Channel structure[0]/" UBYTE RB_RBA_Common_CentralElements_CompuMethods_Identical 1 100 0.0 255. FORMAT "%5.0" ECU_ADDRESS 0x600291F2 /end MEASUREMENT
/begin MEASUREMENT ComM_ChannelStruct[1].DiagnosticRequestState_b "ComM Channel structure[1]/" UBYTE RB_RBA_Common_CentralElements_CompuMethods_Identical 1 100 0.0 255. FORMAT "%5.0" ECU_ADDRESS 0x6002920A /end MEASUREMENT
/begin MEASUREMENT ComM_ChannelStruct[2].DiagnosticRequestState_b "ComM Channel structure[2]/" UBYTE RB_RBA_Common_CentralElements_CompuMethods_Identical 1 100 0.0 255. FORMAT "%5.0" ECU_ADDRESS 0x60029222 /end MEASUREMENT
/begin MEASUREMENT ComM_ChannelStruct[3].DiagnosticRequestState_b "ComM Channel structure[3]/" UBYTE RB_RBA_Common_CentralElements_CompuMethods_Identical 1 100 0.0 255. FORMAT "%5.0" ECU_ADDRESS 0x6002923A /end MEASUREMENT
/begin MEASUREMENT ComM_ChannelStruct[4].DiagnosticRequestState_b "ComM Channel structure[4]/" UBYTE RB_RBA_Common_CentralElements_CompuMethods_Identical 1 100 0.0 255. FORMAT "%5.0" ECU_ADDRESS 0x60029252 /end MEASUREMENT
/begin MEASUREMENT ComM_ChannelStruct[5].DiagnosticRequestState_b "ComM Channel structure[5]/" UBYTE RB_RBA_Common_CentralElements_CompuMethods_Identical 1 100 0.0 255. FORMAT "%5.0" ECU_ADDRESS 0x6002926A /end MEASUREMENT
/begin MEASUREMENT ComM_ChannelStruct[0].CommunicationAllowed_b "ComM Channel structure[0]/" UBYTE RB_RBA_Common_CentralElements_CompuMethods_Identical 1 100 0.0 255. FORMAT "%5.0" ECU_ADDRESS 0x600291F3 /end MEASUREMENT
/begin MEASUREMENT ComM_ChannelStruct[1].CommunicationAllowed_b "ComM Channel structure[1]/" UBYTE RB_RBA_Common_CentralElements_CompuMethods_Identical 1 100 0.0 255. FORMAT "%5.0" ECU_ADDRESS 0x6002920B /end MEASUREMENT
/begin MEASUREMENT ComM_ChannelStruct[2].CommunicationAllowed_b "ComM Channel structure[2]/" UBYTE RB_RBA_Common_CentralElements_CompuMethods_Identical 1 100 0.0 255. FORMAT "%5.0" ECU_ADDRESS 0x60029223 /end MEASUREMENT
/begin MEASUREMENT ComM_ChannelStruct[3].CommunicationAllowed_b "ComM Channel structure[3]/" UBYTE RB_RBA_Common_CentralElements_CompuMethods_Identical 1 100 0.0 255. FORMAT "%5.0" ECU_ADDRESS 0x6002923B /end MEASUREMENT
/begin MEASUREMENT ComM_ChannelStruct[4].CommunicationAllowed_b "ComM Channel structure[4]/" UBYTE RB_RBA_Common_CentralElements_CompuMethods_Identical 1 100 0.0 255. FORMAT "%5.0" ECU_ADDRESS 0x60029253 /end MEASUREMENT
/begin MEASUREMENT ComM_ChannelStruct[5].CommunicationAllowed_b "ComM Channel structure[5]/" UBYTE RB_RBA_Common_CentralElements_CompuMethods_Identical 1 100 0.0 255. FORMAT "%5.0" ECU_ADDRESS 0x6002926B /end MEASUREMENT
/begin MEASUREMENT ComM_ChannelStruct[0].NmBusSleepIndicationStatus_b "ComM Channel structure[0]/" UBYTE RB_RBA_Common_CentralElements_CompuMethods_Identical 1 100 0.0 255. FORMAT "%5.0" ECU_ADDRESS 0x600291F4 /end MEASUREMENT
/begin MEASUREMENT ComM_ChannelStruct[1].NmBusSleepIndicationStatus_b "ComM Channel structure[1]/" UBYTE RB_RBA_Common_CentralElements_CompuMethods_Identical 1 100 0.0 255. FORMAT "%5.0" ECU_ADDRESS 0x6002920C /end MEASUREMENT
/begin MEASUREMENT ComM_ChannelStruct[2].NmBusSleepIndicationStatus_b "ComM Channel structure[2]/" UBYTE RB_RBA_Common_CentralElements_CompuMethods_Identical 1 100 0.0 255. FORMAT "%5.0" ECU_ADDRESS 0x60029224 /end MEASUREMENT
/begin MEASUREMENT ComM_ChannelStruct[3].NmBusSleepIndicationStatus_b "ComM Channel structure[3]/" UBYTE RB_RBA_Common_CentralElements_CompuMethods_Identical 1 100 0.0 255. FORMAT "%5.0" ECU_ADDRESS 0x6002923C /end MEASUREMENT
/begin MEASUREMENT ComM_ChannelStruct[4].NmBusSleepIndicationStatus_b "ComM Channel structure[4]/" UBYTE RB_RBA_Common_CentralElements_CompuMethods_Identical 1 100 0.0 255. FORMAT "%5.0" ECU_ADDRESS 0x60029254 /end MEASUREMENT
/begin MEASUREMENT ComM_ChannelStruct[5].NmBusSleepIndicationStatus_b "ComM Channel structure[5]/" UBYTE RB_RBA_Common_CentralElements_CompuMethods_Identical 1 100 0.0 255. FORMAT "%5.0" ECU_ADDRESS 0x6002926C /end MEASUREMENT
/begin MEASUREMENT ComM_ChannelStruct[0].NmPrepareBusSleepIndicationStatus_b "ComM Channel structure[0]/" UBYTE RB_RBA_Common_CentralElements_CompuMethods_Identical 1 100 0.0 255. FORMAT "%5.0" ECU_ADDRESS 0x600291F5 /end MEASUREMENT
/begin MEASUREMENT ComM_ChannelStruct[1].NmPrepareBusSleepIndicationStatus_b "ComM Channel structure[1]/" UBYTE RB_RBA_Common_CentralElements_CompuMethods_Identical 1 100 0.0 255. FORMAT "%5.0" ECU_ADDRESS 0x6002920D /end MEASUREMENT
/begin MEASUREMENT ComM_ChannelStruct[2].NmPrepareBusSleepIndicationStatus_b "ComM Channel structure[2]/" UBYTE RB_RBA_Common_CentralElements_CompuMethods_Identical 1 100 0.0 255. FORMAT "%5.0" ECU_ADDRESS 0x60029225 /end MEASUREMENT
/begin MEASUREMENT ComM_ChannelStruct[3].NmPrepareBusSleepIndicationStatus_b "ComM Channel structure[3]/" UBYTE RB_RBA_Common_CentralElements_CompuMethods_Identical 1 100 0.0 255. FORMAT "%5.0" ECU_ADDRESS 0x6002923D /end MEASUREMENT
/begin MEASUREMENT ComM_ChannelStruct[4].NmPrepareBusSleepIndicationStatus_b "ComM Channel structure[4]/" UBYTE RB_RBA_Common_CentralElements_CompuMethods_Identical 1 100 0.0 255. FORMAT "%5.0" ECU_ADDRESS 0x60029255 /end MEASUREMENT
/begin MEASUREMENT ComM_ChannelStruct[5].NmPrepareBusSleepIndicationStatus_b "ComM Channel structure[5]/" UBYTE RB_RBA_Common_CentralElements_CompuMethods_Identical 1 100 0.0 255. FORMAT "%5.0" ECU_ADDRESS 0x6002926D /end MEASUREMENT
/begin MEASUREMENT ComM_ChannelStruct[0].NmNetworkModeStatus_b "ComM Channel structure[0]/" UBYTE RB_RBA_Common_CentralElements_CompuMethods_Identical 1 100 0.0 255. FORMAT "%5.0" ECU_ADDRESS 0x600291F6 /end MEASUREMENT
/begin MEASUREMENT ComM_ChannelStruct[1].NmNetworkModeStatus_b "ComM Channel structure[1]/" UBYTE RB_RBA_Common_CentralElements_CompuMethods_Identical 1 100 0.0 255. FORMAT "%5.0" ECU_ADDRESS 0x6002920E /end MEASUREMENT
/begin MEASUREMENT ComM_ChannelStruct[2].NmNetworkModeStatus_b "ComM Channel structure[2]/" UBYTE RB_RBA_Common_CentralElements_CompuMethods_Identical 1 100 0.0 255. FORMAT "%5.0" ECU_ADDRESS 0x60029226 /end MEASUREMENT
/begin MEASUREMENT ComM_ChannelStruct[3].NmNetworkModeStatus_b "ComM Channel structure[3]/" UBYTE RB_RBA_Common_CentralElements_CompuMethods_Identical 1 100 0.0 255. FORMAT "%5.0" ECU_ADDRESS 0x6002923E /end MEASUREMENT
/begin MEASUREMENT ComM_ChannelStruct[4].NmNetworkModeStatus_b "ComM Channel structure[4]/" UBYTE RB_RBA_Common_CentralElements_CompuMethods_Identical 1 100 0.0 255. FORMAT "%5.0" ECU_ADDRESS 0x60029256 /end MEASUREMENT
/begin MEASUREMENT ComM_ChannelStruct[5].NmNetworkModeStatus_b "ComM Channel structure[5]/" UBYTE RB_RBA_Common_CentralElements_CompuMethods_Identical 1 100 0.0 255. FORMAT "%5.0" ECU_ADDRESS 0x6002926E /end MEASUREMENT
/begin MEASUREMENT ComM_UserStruct[0].WakeUpInhibitionCtr_u16 "ComM user structure[0]/" UWORD RB_RBA_Common_CentralElements_CompuMethods_Identical 1 100 0.0 65535. FORMAT "%5.0" ECU_ADDRESS 0x60029270 /end MEASUREMENT
/begin MEASUREMENT ComM_UserStruct[1].WakeUpInhibitionCtr_u16 "ComM user structure[1]/" UWORD RB_RBA_Common_CentralElements_CompuMethods_Identical 1 100 0.0 65535. FORMAT "%5.0" ECU_ADDRESS 0x6002927A /end MEASUREMENT
/begin MEASUREMENT ComM_UserStruct[2].WakeUpInhibitionCtr_u16 "ComM user structure[2]/" UWORD RB_RBA_Common_CentralElements_CompuMethods_Identical 1 100 0.0 65535. FORMAT "%5.0" ECU_ADDRESS 0x60029284 /end MEASUREMENT
/begin MEASUREMENT ComM_UserStruct[3].WakeUpInhibitionCtr_u16 "ComM user structure[3]/" UWORD RB_RBA_Common_CentralElements_CompuMethods_Identical 1 100 0.0 65535. FORMAT "%5.0" ECU_ADDRESS 0x6002928E /end MEASUREMENT
/begin MEASUREMENT ComM_UserStruct[4].WakeUpInhibitionCtr_u16 "ComM user structure[4]/" UWORD RB_RBA_Common_CentralElements_CompuMethods_Identical 1 100 0.0 65535. FORMAT "%5.0" ECU_ADDRESS 0x60029298 /end MEASUREMENT
/begin MEASUREMENT ComM_UserStruct[5].WakeUpInhibitionCtr_u16 "ComM user structure[5]/" UWORD RB_RBA_Common_CentralElements_CompuMethods_Identical 1 100 0.0 65535. FORMAT "%5.0" ECU_ADDRESS 0x600292A2 /end MEASUREMENT
/begin MEASUREMENT ComM_UserStruct[0].LimitToNoComCtr_u16 "ComM user structure[0]/" UWORD RB_RBA_Common_CentralElements_CompuMethods_Identical 1 100 0.0 65535. FORMAT "%5.0" ECU_ADDRESS 0x60029272 /end MEASUREMENT
/begin MEASUREMENT ComM_UserStruct[1].LimitToNoComCtr_u16 "ComM user structure[1]/" UWORD RB_RBA_Common_CentralElements_CompuMethods_Identical 1 100 0.0 65535. FORMAT "%5.0" ECU_ADDRESS 0x6002927C /end MEASUREMENT
/begin MEASUREMENT ComM_UserStruct[2].LimitToNoComCtr_u16 "ComM user structure[2]/" UWORD RB_RBA_Common_CentralElements_CompuMethods_Identical 1 100 0.0 65535. FORMAT "%5.0" ECU_ADDRESS 0x60029286 /end MEASUREMENT
/begin MEASUREMENT ComM_UserStruct[3].LimitToNoComCtr_u16 "ComM user structure[3]/" UWORD RB_RBA_Common_CentralElements_CompuMethods_Identical 1 100 0.0 65535. FORMAT "%5.0" ECU_ADDRESS 0x60029290 /end MEASUREMENT
/begin MEASUREMENT ComM_UserStruct[4].LimitToNoComCtr_u16 "ComM user structure[4]/" UWORD RB_RBA_Common_CentralElements_CompuMethods_Identical 1 100 0.0 65535. FORMAT "%5.0" ECU_ADDRESS 0x6002929A /end MEASUREMENT
/begin MEASUREMENT ComM_UserStruct[5].LimitToNoComCtr_u16 "ComM user structure[5]/" UWORD RB_RBA_Common_CentralElements_CompuMethods_Identical 1 100 0.0 65535. FORMAT "%5.0" ECU_ADDRESS 0x600292A4 /end MEASUREMENT
/begin MEASUREMENT ComM_UserStruct[0].RequestedUserMode_u8 "ComM user structure[0]/" UBYTE RB_RBA_Common_CentralElements_CompuMethods_Identical 1 100 0.0 255. FORMAT "%5.0" ECU_ADDRESS 0x60029274 /end MEASUREMENT
/begin MEASUREMENT ComM_UserStruct[1].RequestedUserMode_u8 "ComM user structure[1]/" UBYTE RB_RBA_Common_CentralElements_CompuMethods_Identical 1 100 0.0 255. FORMAT "%5.0" ECU_ADDRESS 0x6002927E /end MEASUREMENT
/begin MEASUREMENT ComM_UserStruct[2].RequestedUserMode_u8 "ComM user structure[2]/" UBYTE RB_RBA_Common_CentralElements_CompuMethods_Identical 1 100 0.0 255. FORMAT "%5.0" ECU_ADDRESS 0x60029288 /end MEASUREMENT
/begin MEASUREMENT ComM_UserStruct[3].RequestedUserMode_u8 "ComM user structure[3]/" UBYTE RB_RBA_Common_CentralElements_CompuMethods_Identical 1 100 0.0 255. FORMAT "%5.0" ECU_ADDRESS 0x60029292 /end MEASUREMENT
/begin MEASUREMENT ComM_UserStruct[4].RequestedUserMode_u8 "ComM user structure[4]/" UBYTE RB_RBA_Common_CentralElements_CompuMethods_Identical 1 100 0.0 255. FORMAT "%5.0" ECU_ADDRESS 0x6002929C /end MEASUREMENT
/begin MEASUREMENT ComM_UserStruct[5].RequestedUserMode_u8 "ComM user structure[5]/" UBYTE RB_RBA_Common_CentralElements_CompuMethods_Identical 1 100 0.0 255. FORMAT "%5.0" ECU_ADDRESS 0x600292A6 /end MEASUREMENT
/begin MEASUREMENT ComM_UserStruct[0].IndicatedUserMode_u8 "ComM user structure[0]/" UBYTE RB_RBA_Common_CentralElements_CompuMethods_Identical 1 100 0.0 255. FORMAT "%5.0" ECU_ADDRESS 0x60029275 /end MEASUREMENT
/begin MEASUREMENT ComM_UserStruct[1].IndicatedUserMode_u8 "ComM user structure[1]/" UBYTE RB_RBA_Common_CentralElements_CompuMethods_Identical 1 100 0.0 255. FORMAT "%5.0" ECU_ADDRESS 0x6002927F /end MEASUREMENT
/begin MEASUREMENT ComM_UserStruct[2].IndicatedUserMode_u8 "ComM user structure[2]/" UBYTE RB_RBA_Common_CentralElements_CompuMethods_Identical 1 100 0.0 255. FORMAT "%5.0" ECU_ADDRESS 0x60029289 /end MEASUREMENT
/begin MEASUREMENT ComM_UserStruct[3].IndicatedUserMode_u8 "ComM user structure[3]/" UBYTE RB_RBA_Common_CentralElements_CompuMethods_Identical 1 100 0.0 255. FORMAT "%5.0" ECU_ADDRESS 0x60029293 /end MEASUREMENT
/begin MEASUREMENT ComM_UserStruct[4].IndicatedUserMode_u8 "ComM user structure[4]/" UBYTE RB_RBA_Common_CentralElements_CompuMethods_Identical 1 100 0.0 255. FORMAT "%5.0" ECU_ADDRESS 0x6002929D /end MEASUREMENT
/begin MEASUREMENT ComM_UserStruct[5].IndicatedUserMode_u8 "ComM user structure[5]/" UBYTE RB_RBA_Common_CentralElements_CompuMethods_Identical 1 100 0.0 255. FORMAT "%5.0" ECU_ADDRESS 0x600292A7 /end MEASUREMENT
/begin MEASUREMENT ComM_UserStruct[0].numChannelsInFullCom_u8 "ComM user structure[0]/" UBYTE RB_RBA_Common_CentralElements_CompuMethods_Identical 1 100 0.0 255. FORMAT "%5.0" ECU_ADDRESS 0x60029276 /end MEASUREMENT
/begin MEASUREMENT ComM_UserStruct[1].numChannelsInFullCom_u8 "ComM user structure[1]/" UBYTE RB_RBA_Common_CentralElements_CompuMethods_Identical 1 100 0.0 255. FORMAT "%5.0" ECU_ADDRESS 0x60029280 /end MEASUREMENT
/begin MEASUREMENT ComM_UserStruct[2].numChannelsInFullCom_u8 "ComM user structure[2]/" UBYTE RB_RBA_Common_CentralElements_CompuMethods_Identical 1 100 0.0 255. FORMAT "%5.0" ECU_ADDRESS 0x6002928A /end MEASUREMENT
/begin MEASUREMENT ComM_UserStruct[3].numChannelsInFullCom_u8 "ComM user structure[3]/" UBYTE RB_RBA_Common_CentralElements_CompuMethods_Identical 1 100 0.0 255. FORMAT "%5.0" ECU_ADDRESS 0x60029294 /end MEASUREMENT
/begin MEASUREMENT ComM_UserStruct[4].numChannelsInFullCom_u8 "ComM user structure[4]/" UBYTE RB_RBA_Common_CentralElements_CompuMethods_Identical 1 100 0.0 255. FORMAT "%5.0" ECU_ADDRESS 0x6002929E /end MEASUREMENT
/begin MEASUREMENT ComM_UserStruct[5].numChannelsInFullCom_u8 "ComM user structure[5]/" UBYTE RB_RBA_Common_CentralElements_CompuMethods_Identical 1 100 0.0 255. FORMAT "%5.0" ECU_ADDRESS 0x600292A8 /end MEASUREMENT
/begin MEASUREMENT ComM_UserStruct[0].numChannelsInSilentCom_u8 "ComM user structure[0]/" UBYTE RB_RBA_Common_CentralElements_CompuMethods_Identical 1 100 0.0 255. FORMAT "%5.0" ECU_ADDRESS 0x60029277 /end MEASUREMENT
/begin MEASUREMENT ComM_UserStruct[1].numChannelsInSilentCom_u8 "ComM user structure[1]/" UBYTE RB_RBA_Common_CentralElements_CompuMethods_Identical 1 100 0.0 255. FORMAT "%5.0" ECU_ADDRESS 0x60029281 /end MEASUREMENT
/begin MEASUREMENT ComM_UserStruct[2].numChannelsInSilentCom_u8 "ComM user structure[2]/" UBYTE RB_RBA_Common_CentralElements_CompuMethods_Identical 1 100 0.0 255. FORMAT "%5.0" ECU_ADDRESS 0x6002928B /end MEASUREMENT
/begin MEASUREMENT ComM_UserStruct[3].numChannelsInSilentCom_u8 "ComM user structure[3]/" UBYTE RB_RBA_Common_CentralElements_CompuMethods_Identical 1 100 0.0 255. FORMAT "%5.0" ECU_ADDRESS 0x60029295 /end MEASUREMENT
/begin MEASUREMENT ComM_UserStruct[4].numChannelsInSilentCom_u8 "ComM user structure[4]/" UBYTE RB_RBA_Common_CentralElements_CompuMethods_Identical 1 100 0.0 255. FORMAT "%5.0" ECU_ADDRESS 0x6002929F /end MEASUREMENT
/begin MEASUREMENT ComM_UserStruct[5].numChannelsInSilentCom_u8 "ComM user structure[5]/" UBYTE RB_RBA_Common_CentralElements_CompuMethods_Identical 1 100 0.0 255. FORMAT "%5.0" ECU_ADDRESS 0x600292A9 /end MEASUREMENT
/begin MEASUREMENT ComM_UserStruct[0].numChannelsInNoCom_u8 "ComM user structure[0]/" UBYTE RB_RBA_Common_CentralElements_CompuMethods_Identical 1 100 0.0 255. FORMAT "%5.0" ECU_ADDRESS 0x60029278 /end MEASUREMENT
/begin MEASUREMENT ComM_UserStruct[1].numChannelsInNoCom_u8 "ComM user structure[1]/" UBYTE RB_RBA_Common_CentralElements_CompuMethods_Identical 1 100 0.0 255. FORMAT "%5.0" ECU_ADDRESS 0x60029282 /end MEASUREMENT
/begin MEASUREMENT ComM_UserStruct[2].numChannelsInNoCom_u8 "ComM user structure[2]/" UBYTE RB_RBA_Common_CentralElements_CompuMethods_Identical 1 100 0.0 255. FORMAT "%5.0" ECU_ADDRESS 0x6002928C /end MEASUREMENT
/begin MEASUREMENT ComM_UserStruct[3].numChannelsInNoCom_u8 "ComM user structure[3]/" UBYTE RB_RBA_Common_CentralElements_CompuMethods_Identical 1 100 0.0 255. FORMAT "%5.0" ECU_ADDRESS 0x60029296 /end MEASUREMENT
/begin MEASUREMENT ComM_UserStruct[4].numChannelsInNoCom_u8 "ComM user structure[4]/" UBYTE RB_RBA_Common_CentralElements_CompuMethods_Identical 1 100 0.0 255. FORMAT "%5.0" ECU_ADDRESS 0x600292A0 /end MEASUREMENT
/begin MEASUREMENT ComM_UserStruct[5].numChannelsInNoCom_u8 "ComM user structure[5]/" UBYTE RB_RBA_Common_CentralElements_CompuMethods_Identical 1 100 0.0 255. FORMAT "%5.0" ECU_ADDRESS 0x600292AA /end MEASUREMENT
/begin MEASUREMENT Fee_SecChngCnt_u32 "Current Sector Change Counter of the Flash EEPROM Emulation" ULONG RB_RBA_Common_CentralElements_CompuMethods_Identical 1 100 0.0 1.7E7 FORMAT "%5.1" ECU_ADDRESS 0x6000137C /end MEASUREMENT
/begin MEASUREMENT Lin_ChnlVar_MP[0].Status "Lin Channel context information which provides the status of individual frames[0]/" UBYTE AUTOSAR_Lin_CompuMethods_Lin_Enum_Status_type 1 100 0.0 10. FORMAT "%5.0" ECU_ADDRESS 0x60028048 /end MEASUREMENT
/begin MEASUREMENT Lin_ChnlVar_MP[0].Length "Lin Channel context information which provides the status of individual frames[0]/" UBYTE RB_RBA_Common_CentralElements_CompuMethods_Identical 1 100 0.0 255. FORMAT "%5.0" ECU_ADDRESS 0x60028049 /end MEASUREMENT
/begin MEASUREMENT Lin_ChnlVar_MP[0].CSmodel "Lin Channel context information which provides the status of individual frames[0]/" UBYTE AUTOSAR_Lin_CompuMethods_Lin_Enum_CheckSum_Type 1 100 0.0 1. FORMAT "%5.0" ECU_ADDRESS 0x6002804A /end MEASUREMENT
/begin MEASUREMENT Lin_ChnlVar_MP[0].GotoSleepCtr "Lin Channel context information which provides the status of individual frames[0]/" UBYTE AUTOSAR_Lin_CompuMethods_Lin_Enum_FrameRespType 1 100 0.0 3. FORMAT "%5.0" ECU_ADDRESS 0x6002804D /end MEASUREMENT
/begin MEASUREMENT Lin_ChnlVar_MP[0].FrameType "Lin Channel context information which provides the status of individual frames[0]/" UBYTE RB_RBA_Common_CentralElements_CompuMethods_Identical 1 100 0.0 255. FORMAT "%5.0" ECU_ADDRESS 0x6002804B /end MEASUREMENT
/begin MEASUREMENT Lin_ChnlVar_MP[0].FramePid "Lin Channel context information which provides the status of individual frames[0]/" UBYTE AUTOSAR_Lin_CompuMethods_Lin_Enum_ChannelStateType 1 100 0.0 7. FORMAT "%5.0" ECU_ADDRESS 0x6002804E /end MEASUREMENT
/begin MEASUREMENT Lin_ChnlVar_MP[0].ChannelState "Lin Channel context information which provides the status of individual frames[0]/" UBYTE RB_RBA_Common_CentralElements_CompuMethods_Identical 1 100 0.0 255. FORMAT "%5.0" ECU_ADDRESS 0x6002804C /end MEASUREMENT
/begin MEASUREMENT Lin_ChnlVar_MP[0].Lin_Buf_au8 "Lin Channel context information which provides the status of individual frames[0]/" UBYTE RB_RBA_Common_CentralElements_CompuMethods_Identical 1 100 0.0 255. FORMAT "%5.0" ECU_ADDRESS 0x6002804F MATRIX_DIM 8 /end MEASUREMENT
/begin MEASUREMENT Lin_DrvFlags_MP "Lin driver state i.e TRUE (Iinitilased) FALSE (Uninitialised)" UBYTE RB_RBA_Common_CentralElements_CompuMethods_Identical 1 100 0.0 1. FORMAT "%5.0" ECU_ADDRESS 0x70002026 /end MEASUREMENT
/begin MEASUREMENT LinIf_ChnlVar_as[0].ChannelStateFlag_u8 "Lin Interface channel status structure[0]/" UBYTE RB_RBA_Common_CentralElements_CompuMethods_Identical 1 100 0.0 255. FORMAT "%5.0" ECU_ADDRESS 0x60029360 /end MEASUREMENT
/begin MEASUREMENT LinIf_ChnlVar_as[0].ChannelStatusFlags_u8 "Lin Interface channel status structure[0]/" UBYTE RB_RBA_Common_CentralElements_CompuMethods_Identical 1 100 0.0 255. FORMAT "%5.0" ECU_ADDRESS 0x60029361 /end MEASUREMENT
/begin MEASUREMENT LinIf_ChnlVar_as[0].DelayCount_u8 "Lin Interface channel status structure[0]/" UBYTE RB_RBA_Common_CentralElements_CompuMethods_Identical 1 100 0.0 255. FORMAT "%5.0" ECU_ADDRESS 0x60029362 /end MEASUREMENT
/begin MEASUREMENT LinIf_ChnlVar_as[0].CurrentScheduleTable_u8 "Lin Interface channel status structure[0]/" UBYTE RB_RBA_Common_CentralElements_CompuMethods_Identical 1 100 0.0 255. FORMAT "%5.0" ECU_ADDRESS 0x60029363 /end MEASUREMENT
/begin MEASUREMENT LinIf_ChnlVar_as[0].CurrentIndex_u8 "Lin Interface channel status structure[0]/" UBYTE RB_RBA_Common_CentralElements_CompuMethods_Identical 1 100 0.0 255. FORMAT "%5.0" ECU_ADDRESS 0x60029365 /end MEASUREMENT
/begin MEASUREMENT LinIf_ChnlVar_as[0].SavedScheduleTable_u8 "Lin Interface channel status structure[0]/" UBYTE RB_RBA_Common_CentralElements_CompuMethods_Identical 1 100 0.0 255. FORMAT "%5.0" ECU_ADDRESS 0x60029366 /end MEASUREMENT
/begin MEASUREMENT LinIf_ChnlVar_as[0].SavedIndex_u8 "Lin Interface channel status structure[0]/" UBYTE RB_RBA_Common_CentralElements_CompuMethods_Identical 1 100 0.0 255. FORMAT "%5.0" ECU_ADDRESS 0x60029367 /end MEASUREMENT
/begin MEASUREMENT LinIf_ChnlVar_as[0].Temp_SpoFrmCount_u8 "Lin Interface channel status structure[0]/" UBYTE RB_RBA_Common_CentralElements_CompuMethods_Identical 1 100 0.0 255. FORMAT "%5.0" ECU_ADDRESS 0x60029368 /end MEASUREMENT
/begin MEASUREMENT LinIf_ChnlVar_as[0].SpoETIndex_u8 "Lin Interface channel status structure[0]/" UBYTE RB_RBA_Common_CentralElements_CompuMethods_Identical 1 100 0.0 255. FORMAT "%5.0" ECU_ADDRESS 0x60029369 /end MEASUREMENT
/begin MEASUREMENT LinIf_ChnlVar_as[0].Wakeup_u8 "Lin Interface channel status structure[0]/" UBYTE RB_RBA_Common_CentralElements_CompuMethods_Identical 1 100 0.0 255. FORMAT "%5.0" ECU_ADDRESS 0x6002936C /end MEASUREMENT
/begin MEASUREMENT LinIf_ChnlVar_as[0].TransmitSRF_u8 "Lin Interface channel status structure[0]/" UBYTE RB_RBA_Common_CentralElements_CompuMethods_Identical 1 100 0.0 255. FORMAT "%5.0" ECU_ADDRESS 0x6002936F /end MEASUREMENT
/begin MEASUREMENT LinIf_ChnlVar_as[0].SlpGetStatus_u8 "Lin Interface channel status structure[0]/" UBYTE RB_RBA_Common_CentralElements_CompuMethods_Identical 1 100 0.0 255. FORMAT "%5.0" ECU_ADDRESS 0x60029370 /end MEASUREMENT
/begin MEASUREMENT LinIf_ChnlVar_as[0].NewScheduleTable_u8 "Lin Interface channel status structure[0]/" UBYTE RB_RBA_Common_CentralElements_CompuMethods_Identical 1 100 0.0 255. FORMAT "%5.0" ECU_ADDRESS 0x60029364 /end MEASUREMENT
/begin MEASUREMENT LinIf_ChnlVar_as[0].GotoSleepCtr "Lin Interface channel status structure[0]/" UBYTE RB_RBA_Common_CentralElements_CompuMethods_Identical 1 100 0.0 255. FORMAT "%5.0" ECU_ADDRESS 0x6002936B /end MEASUREMENT
/begin MEASUREMENT LinIf_Status_u8 "Lin Interface status variable" UBYTE RB_RBA_Common_CentralElements_CompuMethods_Identical 1 100 0.0 255. FORMAT "%5.0" ECU_ADDRESS 0x60029358 /end MEASUREMENT
/begin MEASUREMENT LinSM_ModeRepeatReq_Max_u8 "Maximum Tries for Same Mode Request Possible in LinSM" UBYTE RB_RBA_Common_CentralElements_CompuMethods_Identical 1 100 0.0 255. FORMAT "%5.0" ECU_ADDRESS 0x60024811 /end MEASUREMENT
/begin MEASUREMENT LinSM_RamVar_ast[0].ChnlState "LinSM type variable[0]/" UBYTE AUTOSAR_LinSM_CompuMethods_LinSM_CompuMethod_OperationalMode 1 100 0.0 255. FORMAT "%5.0" ECU_ADDRESS 0x60029378 /end MEASUREMENT
/begin MEASUREMENT LinSM_RamVar_ast[0].TimeOutCounter "LinSM type variable[0]/" ULONG RB_RBA_Common_CentralElements_CompuMethods_Identical 1 100 0.0 4.E9 FORMAT "%5.0" ECU_ADDRESS 0x6002937C /end MEASUREMENT
/begin MEASUREMENT LinSM_RamVar_ast[0].TimeoutFlag "LinSM type variable[0]/" UBYTE RB_RBA_Common_CentralElements_CompuMethods_Identical 1 100 0.0 255. FORMAT "%5.0" ECU_ADDRESS 0x60029380 /end MEASUREMENT
/begin MEASUREMENT LinSM_RamVar_ast[0].StoredSchdTab "LinSM type variable[0]/" UBYTE RB_RBA_Common_CentralElements_CompuMethods_Identical 1 100 0.0 255. FORMAT "%5.0" ECU_ADDRESS 0x60029381 /end MEASUREMENT
/begin MEASUREMENT LinSM_RamVar_ast[0].LinSm_SchdReq_E_NOT_OK "LinSM type variable[0]/" UBYTE RB_RBA_Common_CentralElements_CompuMethods_Identical 1 100 0.0 255. FORMAT "%5.0" ECU_ADDRESS 0x60029382 /end MEASUREMENT
/begin MEASUREMENT LinSM_RamVar_ast[0].LinSm_Conf_Status "LinSM type variable[0]/" UBYTE RB_RBA_Common_CentralElements_CompuMethods_Identical 1 100 0.0 255. FORMAT "%5.0" ECU_ADDRESS 0x60029383 /end MEASUREMENT
/begin MEASUREMENT LinSM_RamVar_ast[0].LinSm_Request_Status "LinSM type variable[0]/" UBYTE RB_RBA_Common_CentralElements_CompuMethods_Identical 1 100 0.0 255. FORMAT "%5.0" ECU_ADDRESS 0x60029384 /end MEASUREMENT
/begin MEASUREMENT LinSM_RamVar_ast[0].LinSm_Sleep_Status "LinSM type variable[0]/" UBYTE RB_RBA_Common_CentralElements_CompuMethods_Identical 1 100 0.0 255. FORMAT "%5.0" ECU_ADDRESS 0x60029385 /end MEASUREMENT
/begin MEASUREMENT LinSM_RamVar_ast[0].LinSmModReqRepMax "LinSM type variable[0]/" UBYTE RB_RBA_Common_CentralElements_CompuMethods_Identical 1 100 0.0 255. FORMAT "%5.0" ECU_ADDRESS 0x60029386 /end MEASUREMENT
/begin MEASUREMENT LinSM_State_en "State variable of LINSM" UBYTE RB_RBA_Common_CentralElements_CompuMethods_Identical 1 100 0.0 255. FORMAT "%5.0" ECU_ADDRESS 0x60029388 /end MEASUREMENT
/begin MEASUREMENT PduR_State "State information of Pdur module" UBYTE RB_RBA_Common_CentralElements_CompuMethods_Identical 1 100 0.0 255. FORMAT "%5.0" ECU_ADDRESS 0x60026038 /end MEASUREMENT
/begin MEASUREMENT rba_CanMcan_DriverState_MP "Flag to check if CAN driver is Initialized(CAN_READY(TRUE)) or Not Initialized (CAN_UNINIT(FALSE))" UBYTE RB_RBA_Common_CentralElements_CompuMethods_Identical 1 100 0.0 1. FORMAT "%5.0" ECU_ADDRESS 0x70002024 /end MEASUREMENT
/begin MEASUREMENT rba_CanMcan_MsgStatus_MP "This variable value describes the CAN message buffer status. The value is 1 if the message transmission is initiated and is reset(value 0) after the confirmation is given for the same." UBYTE RB_RBA_Common_CentralElements_CompuMethods_Identical 1 100 0.0 255. FORMAT "%5.0" ECU_ADDRESS 0x60023ED5 MATRIX_DIM 78 /end MEASUREMENT
/begin MEASUREMENT rba_Dme_Ovl_stEnable "Overlay state" UBYTE RB_RBA_Common_CentralElements_CompuMethods_Identical 1 100 0.0 255. FORMAT "%5.0" ECU_ADDRESS 0x60023929 /end MEASUREMENT
/begin MEASUREMENT rba_Dme_adrError "address of vector causing error" ULONG RB_RBA_Common_CentralElements_CompuMethods_Identical 1 100 0.0 4.E9 FORMAT "%10.0" ECU_ADDRESS 0x6000136C /end MEASUREMENT
/begin MEASUREMENT rba_Dme_numBytesAvailable "number of bytes available for calibration" ULONG RB_RBA_Common_CentralElements_CompuMethods_Identical 1 100 0.0 4.E9 FORMAT "%10.0" ECU_ADDRESS 0x60001374 /end MEASUREMENT
/begin MEASUREMENT rba_Dme_numBytesAvailableOvl "number of bytes available for calibration" ULONG RB_RBA_Common_CentralElements_CompuMethods_Identical 1 100 0.0 4.E9 FORMAT "%10.0" ECU_ADDRESS 0x60001370 /end MEASUREMENT
/begin MEASUREMENT rba_IoDiagHlfBr_dataDiagInfo_MP "Array of 32-bit diagnosis information" ULONG DefaultIdenticalCompu 1 100 0.0 4.294967295E9 ECU_ADDRESS 0x6001E4BC /end MEASUREMENT
/begin MEASUREMENT rba_IoDiagHlfBr_idDbgSignal "Signal Id of half-bridge signal that needs to be debugged" UWORD DefaultIdenticalCompu 1 100 0.0 65535.0 ECU_ADDRESS 0x70001FD8 /end MEASUREMENT
/begin MEASUREMENT rba_IoDiagHlfBr_stDiagCtrl_MP "The status of diagnosis control" UBYTE DefaultIdenticalCompu 1 100 0.0 255.0 ECU_ADDRESS 0x600255BD /end MEASUREMENT
/begin MEASUREMENT rba_IoDiagHlfBr_stDiagDi_MP "The status of diagnosis disabled" UBYTE AUTOSAR_Platform_CompuMethods_boolean 1 100 0.0 255.0 ECU_ADDRESS 0x600255BE /end MEASUREMENT
/begin MEASUREMENT rba_IoDiagHlfBr_stSwtOffDiag_MP "The status of switch-off mode diagnosis" UBYTE RB_RBA_rba_IoDiagHlfBr_CompuMethods_rba_IoDiagHlfBr_SwtOffDiagSts_tu8_CompuMethod 1 100 0.0 5. FORMAT "%9.0" ECU_ADDRESS 0x600255BC /end MEASUREMENT
/begin MEASUREMENT rba_IoDiagHlfBr_stTstPlsReq_MP "The status of test pulse request" UBYTE DefaultIdenticalCompu 1 100 0.0 255.0 ECU_ADDRESS 0x600255BB /end MEASUREMENT
/begin MEASUREMENT rba_IoDiagHlfBr_xReasSwtOffDiagAbort_MP "The reason for switch-off mode diagnosis aborted" UBYTE DefaultIdenticalCompu 1 100 0.0 255.0 ECU_ADDRESS 0x600255BA /end MEASUREMENT
/begin MEASUREMENT rba_IoExtLib_KeepAliveDrvErrCyc_u32 "KeepAlive measurement variable" ULONG RB_RBA_Common_CentralElements_CompuMethods_Identical 1 100 0.0 4.E9 FORMAT "%9.0" ECU_ADDRESS 0x6003407C /end MEASUREMENT
/begin MEASUREMENT rba_IoExtLib_KeepAliveDrvErrPerm_u32 "KeepAlive measurement variable" ULONG RB_RBA_Common_CentralElements_CompuMethods_Identical 1 100 0.0 4.E9 FORMAT "%9.0" ECU_ADDRESS 0x60034204 /end MEASUREMENT
/begin MEASUREMENT rba_IoExtLib_KeepAliveIniErrCyc_u32 "KeepAlive measurement variable" ULONG RB_RBA_Common_CentralElements_CompuMethods_Identical 1 100 0.0 4.E9 FORMAT "%9.0" ECU_ADDRESS 0x60034078 /end MEASUREMENT
/begin MEASUREMENT rba_IoExtLib_KeepAliveIniErrPerm_u32 "KeepAlive measurement variable" ULONG RB_RBA_Common_CentralElements_CompuMethods_Identical 1 100 0.0 4.E9 FORMAT "%9.0" ECU_ADDRESS 0x60034200 /end MEASUREMENT
/begin MEASUREMENT rba_OsShell_Cntr1000msTask "OS task counter for the OS_1000ms_Task" UWORD RB_RBA_Common_CentralElements_CompuMethods_Identical 1 100 0.0 65535. FORMAT "%5.0" ECU_ADDRESS 0x60029714 /end MEASUREMENT
/begin MEASUREMENT rba_OsShell_Cntr100msTask "OS task counter for the OS_100ms_Task" UWORD RB_RBA_Common_CentralElements_CompuMethods_Identical 1 100 0.0 65535. FORMAT "%5.0" ECU_ADDRESS 0x6002970E /end MEASUREMENT
/begin MEASUREMENT rba_OsShell_Cntr10msTask "OS task counter for the OS_10ms_Task" UWORD RB_RBA_Common_CentralElements_CompuMethods_Identical 1 100 0.0 65535. FORMAT "%5.0" ECU_ADDRESS 0x60029708 /end MEASUREMENT
/begin MEASUREMENT rba_OsShell_Cntr1msTask "OS task counter for the OS_1ms_Task" UWORD RB_RBA_Common_CentralElements_CompuMethods_Identical 1 100 0.0 65535. FORMAT "%5.0" ECU_ADDRESS 0x50000104 /end MEASUREMENT
/begin MEASUREMENT rba_OsShell_Cntr200msTask "OS task counter for the OS_200ms_Task" UWORD RB_RBA_Common_CentralElements_CompuMethods_Identical 1 100 0.0 65535. FORMAT "%5.0" ECU_ADDRESS 0x60029710 /end MEASUREMENT
/begin MEASUREMENT rba_OsShell_Cntr20msTask "OS task counter for the OS_20ms_Task" UWORD RB_RBA_Common_CentralElements_CompuMethods_Identical 1 100 0.0 65535. FORMAT "%5.0" ECU_ADDRESS 0x6002970A /end MEASUREMENT
/begin MEASUREMENT rba_OsShell_Cntr2msTask "OS task counter for the OS_2ms_Task" UWORD RB_RBA_Common_CentralElements_CompuMethods_Identical 1 100 0.0 65535. FORMAT "%5.0" ECU_ADDRESS 0x50000106 /end MEASUREMENT
/begin MEASUREMENT rba_OsShell_Cntr50msTask "OS task counter for the OS_50ms_Task" UWORD RB_RBA_Common_CentralElements_CompuMethods_Identical 1 100 0.0 65535. FORMAT "%5.0" ECU_ADDRESS 0x6002970C /end MEASUREMENT
/begin MEASUREMENT rba_OsShell_Cntr5msTask "OS task counter for the OS_5ms_Task" UWORD RB_RBA_Common_CentralElements_CompuMethods_Identical 1 100 0.0 65535. FORMAT "%5.0" ECU_ADDRESS 0x700030E0 /end MEASUREMENT
/begin MEASUREMENT rba_OsShell_CntrAsw1BgTask "OS task counter for the OS_Asw1Bg_Task" UWORD RB_RBA_Common_CentralElements_CompuMethods_Identical 1 100 0.0 65535. FORMAT "%5.0" ECU_ADDRESS 0x6002971E /end MEASUREMENT
/begin MEASUREMENT rba_OsShell_CntrAsw2BgTask "OS task counter for the OS_Asw2Bg_Task" UWORD RB_RBA_Common_CentralElements_CompuMethods_Identical 1 100 0.0 65535. FORMAT "%5.0" ECU_ADDRESS 0x5000010E /end MEASUREMENT
/begin MEASUREMENT rba_OsShell_CntrBswBgTask "OS task counter for the OS_BswBg_Task" UWORD RB_RBA_Common_CentralElements_CompuMethods_Identical 1 100 0.0 65535. FORMAT "%5.0" ECU_ADDRESS 0x700030F2 /end MEASUREMENT
/begin MEASUREMENT rba_OsShell_CntrCalWup100msTask "OS task counter for the OS_CalWup_100ms_Task" UWORD RB_RBA_Common_CentralElements_CompuMethods_Identical 1 100 0.0 65535. FORMAT "%5.0" ECU_ADDRESS 0x700030E8 /end MEASUREMENT
/begin MEASUREMENT rba_OsShell_CntrCalWup10msTask "OS task counter for the OS_CalWup_10ms_Task" UWORD RB_RBA_Common_CentralElements_CompuMethods_Identical 1 100 0.0 65535. FORMAT "%5.0" ECU_ADDRESS 0x700030E4 /end MEASUREMENT
/begin MEASUREMENT rba_OsShell_CntrCalWup20msTask "OS task counter for the OS_CalWup_20ms_Task" UWORD RB_RBA_Common_CentralElements_CompuMethods_Identical 1 100 0.0 65535. FORMAT "%5.0" ECU_ADDRESS 0x700030E6 /end MEASUREMENT
/begin MEASUREMENT rba_OsShell_CntrCalWup2msTask "OS task counter for the OS_CalWup_2ms_Task" UWORD RB_RBA_Common_CentralElements_CompuMethods_Identical 1 100 0.0 65535. FORMAT "%5.0" ECU_ADDRESS 0x700030DE /end MEASUREMENT
/begin MEASUREMENT rba_OsShell_CntrCalWupAsw110msTask "OS task counter for the OS_CalWupAsw1_10ms_Task" UWORD RB_RBA_Common_CentralElements_CompuMethods_Identical 1 100 0.0 65535. FORMAT "%5.0" ECU_ADDRESS 0x60029706 /end MEASUREMENT
/begin MEASUREMENT rba_OsShell_CntrCalWupAsw210msTask "OS task counter for the OS_CalWupAsw2_10ms_Task" UWORD RB_RBA_Common_CentralElements_CompuMethods_Identical 1 100 0.0 65535. FORMAT "%5.0" ECU_ADDRESS 0x5000010A /end MEASUREMENT
/begin MEASUREMENT rba_OsShell_CntrCalWupBgTask "OS task counter for the OS_CalWup_Bg_Task" UWORD RB_RBA_Common_CentralElements_CompuMethods_Identical 1 100 0.0 65535. FORMAT "%5.0" ECU_ADDRESS 0x700030F0 /end MEASUREMENT
/begin MEASUREMENT rba_OsShell_CntrCalWupIniEndTask "OS task counter for the OS_CalWup_IniEnd_Task" UWORD RB_RBA_Common_CentralElements_CompuMethods_Identical 1 100 0.0 65535. FORMAT "%5.0" ECU_ADDRESS 0x700030EE /end MEASUREMENT
/begin MEASUREMENT rba_OsShell_CntrCalWupIniTask "OS task counter for the OS_CalWup_Ini_Task" UWORD RB_RBA_Common_CentralElements_CompuMethods_Identical 1 100 0.0 65535. FORMAT "%5.0" ECU_ADDRESS 0x700030EC /end MEASUREMENT
/begin MEASUREMENT rba_OsShell_CntrCanTpburstTask "OS task counter for the OS_CanTpburst_Task" UWORD RB_RBA_Common_CentralElements_CompuMethods_Identical 1 100 0.0 65535. FORMAT "%5.0" ECU_ADDRESS 0x50000102 /end MEASUREMENT
/begin MEASUREMENT rba_OsShell_CntrDSMClearTask "OS task counter for the OS_DSM_Clear_Task" UWORD RB_RBA_Common_CentralElements_CompuMethods_Identical 1 100 0.0 65535. FORMAT "%5.0" ECU_ADDRESS 0x60029712 /end MEASUREMENT
/begin MEASUREMENT rba_OsShell_CntrDSMReiniTask "OS task counter for the OS_DSM_Reini_Task" UWORD RB_RBA_Common_CentralElements_CompuMethods_Identical 1 100 0.0 65535. FORMAT "%5.0" ECU_ADDRESS 0x6002971C /end MEASUREMENT
/begin MEASUREMENT rba_OsShell_CntrEngReStrtExampleTask "OS task counter for the OS_EngReStrt_Example_Task" UWORD RB_RBA_Common_CentralElements_CompuMethods_Identical 1 100 0.0 65535. FORMAT "%5.0" ECU_ADDRESS 0x5000010C /end MEASUREMENT
/begin MEASUREMENT rba_OsShell_CntrErrLimit1000msTask "Limit error counter for OS_1000ms_Task" UBYTE RB_RBA_Common_CentralElements_CompuMethods_Identical 1 100 0.0 255. FORMAT "%5.0" ECU_ADDRESS 0x60025657 /end MEASUREMENT
/begin MEASUREMENT rba_OsShell_CntrErrLimit100msTask "Limit error counter for OS_100ms_Task" UBYTE RB_RBA_Common_CentralElements_CompuMethods_Identical 1 100 0.0 255. FORMAT "%5.0" ECU_ADDRESS 0x60025653 /end MEASUREMENT
/begin MEASUREMENT rba_OsShell_CntrErrLimit10msTask "Limit error counter for OS_10ms_Task" UBYTE RB_RBA_Common_CentralElements_CompuMethods_Identical 1 100 0.0 255. FORMAT "%5.0" ECU_ADDRESS 0x6002564E /end MEASUREMENT
/begin MEASUREMENT rba_OsShell_CntrErrLimit1msTask "Limit error counter for OS_1ms_Task" UBYTE RB_RBA_Common_CentralElements_CompuMethods_Identical 1 100 0.0 255. FORMAT "%5.0" ECU_ADDRESS 0x60025643 /end MEASUREMENT
/begin MEASUREMENT rba_OsShell_CntrErrLimit200msTask "Limit error counter for OS_200ms_Task" UBYTE RB_RBA_Common_CentralElements_CompuMethods_Identical 1 100 0.0 255. FORMAT "%5.0" ECU_ADDRESS 0x60025654 /end MEASUREMENT
/begin MEASUREMENT rba_OsShell_CntrErrLimit20msTask "Limit error counter for OS_20ms_Task" UBYTE RB_RBA_Common_CentralElements_CompuMethods_Identical 1 100 0.0 255. FORMAT "%5.0" ECU_ADDRESS 0x60025650 /end MEASUREMENT
/begin MEASUREMENT rba_OsShell_CntrErrLimit2msTask "Limit error counter for OS_2ms_Task" UBYTE RB_RBA_Common_CentralElements_CompuMethods_Identical 1 100 0.0 255. FORMAT "%5.0" ECU_ADDRESS 0x60025646 /end MEASUREMENT
/begin MEASUREMENT rba_OsShell_CntrErrLimit50msTask "Limit error counter for OS_50ms_Task" UBYTE RB_RBA_Common_CentralElements_CompuMethods_Identical 1 100 0.0 255. FORMAT "%5.0" ECU_ADDRESS 0x60025651 /end MEASUREMENT
/begin MEASUREMENT rba_OsShell_CntrErrLimit5msTask "Limit error counter for OS_5ms_Task" UBYTE RB_RBA_Common_CentralElements_CompuMethods_Identical 1 100 0.0 255. FORMAT "%5.0" ECU_ADDRESS 0x60025647 /end MEASUREMENT
/begin MEASUREMENT rba_OsShell_CntrErrLimitAsw1BgTask "Limit error counter for OS_Asw1Bg_Task" UBYTE RB_RBA_Common_CentralElements_CompuMethods_Identical 1 100 0.0 255. FORMAT "%5.0" ECU_ADDRESS 0x60025662 /end MEASUREMENT
/begin MEASUREMENT rba_OsShell_CntrErrLimitAsw2BgTask "Limit error counter for OS_Asw2Bg_Task" UBYTE RB_RBA_Common_CentralElements_CompuMethods_Identical 1 100 0.0 255. FORMAT "%5.0" ECU_ADDRESS 0x60025661 /end MEASUREMENT
/begin MEASUREMENT rba_OsShell_CntrErrLimitBswBgTask "Limit error counter for OS_BswBg_Task" UBYTE RB_RBA_Common_CentralElements_CompuMethods_Identical 1 100 0.0 255. FORMAT "%5.0" ECU_ADDRESS 0x60025660 /end MEASUREMENT
/begin MEASUREMENT rba_OsShell_CntrErrLimitCalWup100msTask "Limit error counter for OS_CalWup_100ms_Task" UBYTE RB_RBA_Common_CentralElements_CompuMethods_Identical 1 100 0.0 255. FORMAT "%5.0" ECU_ADDRESS 0x60025652 /end MEASUREMENT
/begin MEASUREMENT rba_OsShell_CntrErrLimitCalWup10msTask "Limit error counter for OS_CalWup_10ms_Task" UBYTE RB_RBA_Common_CentralElements_CompuMethods_Identical 1 100 0.0 255. FORMAT "%5.0" ECU_ADDRESS 0x6002564B /end MEASUREMENT
/begin MEASUREMENT rba_OsShell_CntrErrLimitCalWup20msTask "Limit error counter for OS_CalWup_20ms_Task" UBYTE RB_RBA_Common_CentralElements_CompuMethods_Identical 1 100 0.0 255. FORMAT "%5.0" ECU_ADDRESS 0x6002564F /end MEASUREMENT
/begin MEASUREMENT rba_OsShell_CntrErrLimitCalWup2msTask "Limit error counter for OS_CalWup_2ms_Task" UBYTE RB_RBA_Common_CentralElements_CompuMethods_Identical 1 100 0.0 255. FORMAT "%5.0" ECU_ADDRESS 0x60025645 /end MEASUREMENT
/begin MEASUREMENT rba_OsShell_CntrErrLimitCalWupAsw110msTask "Limit error counter for OS_CalWupAsw1_10ms_Task" UBYTE RB_RBA_Common_CentralElements_CompuMethods_Identical 1 100 0.0 255. FORMAT "%5.0" ECU_ADDRESS 0x6002564D /end MEASUREMENT
/begin MEASUREMENT rba_OsShell_CntrErrLimitCalWupAsw210msTask "Limit error counter for OS_CalWupAsw2_10ms_Task" UBYTE RB_RBA_Common_CentralElements_CompuMethods_Identical 1 100 0.0 255. FORMAT "%5.0" ECU_ADDRESS 0x6002564C /end MEASUREMENT
/begin MEASUREMENT rba_OsShell_CntrErrLimitCalWupBgTask "Limit error counter for OS_CalWup_Bg_Task" UBYTE RB_RBA_Common_CentralElements_CompuMethods_Identical 1 100 0.0 255. FORMAT "%5.0" ECU_ADDRESS 0x6002565F /end MEASUREMENT
/begin MEASUREMENT rba_OsShell_CntrErrLimitCalWupIniEndTask "Limit error counter for OS_CalWup_IniEnd_Task" UBYTE RB_RBA_Common_CentralElements_CompuMethods_Identical 1 100 0.0 255. FORMAT "%5.0" ECU_ADDRESS 0x6002565E /end MEASUREMENT
/begin MEASUREMENT rba_OsShell_CntrErrLimitCalWupIniTask "Limit error counter for OS_CalWup_Ini_Task" UBYTE RB_RBA_Common_CentralElements_CompuMethods_Identical 1 100 0.0 255. FORMAT "%5.0" ECU_ADDRESS 0x6002565D /end MEASUREMENT
/begin MEASUREMENT rba_OsShell_CntrErrLimitCanTpburstTask "Limit error counter for OS_CanTpburst_Task" UBYTE RB_RBA_Common_CentralElements_CompuMethods_Identical 1 100 0.0 255. FORMAT "%5.0" ECU_ADDRESS 0x60025642 /end MEASUREMENT
/begin MEASUREMENT rba_OsShell_CntrErrLimitDSMClearTask "Limit error counter for OS_DSM_Clear_Task" UBYTE RB_RBA_Common_CentralElements_CompuMethods_Identical 1 100 0.0 255. FORMAT "%5.0" ECU_ADDRESS 0x60025656 /end MEASUREMENT
/begin MEASUREMENT rba_OsShell_CntrErrLimitDSMReiniTask "Limit error counter for OS_DSM_Reini_Task" UBYTE RB_RBA_Common_CentralElements_CompuMethods_Identical 1 100 0.0 255. FORMAT "%5.0" ECU_ADDRESS 0x6002565C /end MEASUREMENT
/begin MEASUREMENT rba_OsShell_CntrErrLimitEngReStrtExampleTask "Limit error counter for OS_EngReStrt_Example_Task" UBYTE RB_RBA_Common_CentralElements_CompuMethods_Identical 1 100 0.0 255. FORMAT "%5.0" ECU_ADDRESS 0x60025655 /end MEASUREMENT
/begin MEASUREMENT rba_OsShell_CntrErrLimitInfraAsw1App10msTask "Limit error counter for OS_InfraAsw1App_10ms_Task" UBYTE RB_RBA_Common_CentralElements_CompuMethods_Identical 1 100 0.0 255. FORMAT "%5.0" ECU_ADDRESS 0x6002564A /end MEASUREMENT
/begin MEASUREMENT rba_OsShell_CntrErrLimitInfraAsw2App10msTask "Limit error counter for OS_InfraAsw2App_10ms_Task" UBYTE RB_RBA_Common_CentralElements_CompuMethods_Identical 1 100 0.0 255. FORMAT "%5.0" ECU_ADDRESS 0x60025649 /end MEASUREMENT
/begin MEASUREMENT rba_OsShell_CntrErrLimitInfraBswApp10msTask "Limit error counter for OS_InfraBswApp_10ms_Task" UBYTE RB_RBA_Common_CentralElements_CompuMethods_Identical 1 100 0.0 255. FORMAT "%5.0" ECU_ADDRESS 0x60025648 /end MEASUREMENT
/begin MEASUREMENT rba_OsShell_CntrErrLimitIniEndTask "Limit error counter for OS_IniEnd_Task" UBYTE RB_RBA_Common_CentralElements_CompuMethods_Identical 1 100 0.0 255. FORMAT "%5.0" ECU_ADDRESS 0x6002565B /end MEASUREMENT
/begin MEASUREMENT rba_OsShell_CntrErrLimitIniTask "Limit error counter for OS_Ini_Task" UBYTE RB_RBA_Common_CentralElements_CompuMethods_Identical 1 100 0.0 255. FORMAT "%5.0" ECU_ADDRESS 0x6002565A /end MEASUREMENT
/begin MEASUREMENT rba_OsShell_CntrErrLimitIniTaskCore0 "Limit error counter for OS_Ini_Task_Core0" UBYTE RB_RBA_Common_CentralElements_CompuMethods_Identical 1 100 0.0 255. FORMAT "%5.0" ECU_ADDRESS 0x60025659 /end MEASUREMENT
/begin MEASUREMENT rba_OsShell_CntrErrLimitMoTask "Limit error counter for OS_Mo_Task" UBYTE RB_RBA_Common_CentralElements_CompuMethods_Identical 1 100 0.0 255. FORMAT "%5.0" ECU_ADDRESS 0x60025644 /end MEASUREMENT
/begin MEASUREMENT rba_OsShell_CntrErrLimitReIniModeMTask "Limit error counter for OS_ReIniModeM_Task" UBYTE RB_RBA_Common_CentralElements_CompuMethods_Identical 1 100 0.0 255. FORMAT "%5.0" ECU_ADDRESS 0x60025658 /end MEASUREMENT
/begin MEASUREMENT rba_OsShell_CntrErrLimitShutdown10msTask "Limit error counter for OS_Shutdown_10ms_Task" UBYTE RB_RBA_Common_CentralElements_CompuMethods_Identical 1 100 0.0 255. FORMAT "%5.0" ECU_ADDRESS 0x6002563D /end MEASUREMENT
/begin MEASUREMENT rba_OsShell_CntrErrLimitShutdownAsw1Task "Limit error counter for OS_Shutdown_Asw1_Task" UBYTE RB_RBA_Common_CentralElements_CompuMethods_Identical 1 100 0.0 255. FORMAT "%5.0" ECU_ADDRESS 0x60025641 /end MEASUREMENT
/begin MEASUREMENT rba_OsShell_CntrErrLimitShutdownAsw2Task "Limit error counter for OS_Shutdown_Asw2_Task" UBYTE RB_RBA_Common_CentralElements_CompuMethods_Identical 1 100 0.0 255. FORMAT "%5.0" ECU_ADDRESS 0x60025640 /end MEASUREMENT
/begin MEASUREMENT rba_OsShell_CntrErrLimitShutdownBswTask "Limit error counter for OS_Shutdown_Bsw_Task" UBYTE RB_RBA_Common_CentralElements_CompuMethods_Identical 1 100 0.0 255. FORMAT "%5.0" ECU_ADDRESS 0x6002563F /end MEASUREMENT
/begin MEASUREMENT rba_OsShell_CntrErrLimitShutdownSeqTask "Limit error counter for OS_Shutdown_Seq_Task" UBYTE RB_RBA_Common_CentralElements_CompuMethods_Identical 1 100 0.0 255. FORMAT "%5.0" ECU_ADDRESS 0x6002563E /end MEASUREMENT
/begin MEASUREMENT rba_OsShell_CntrInfraAsw1App10msTask "OS task counter for the OS_InfraAsw1App_10ms_Task" UWORD RB_RBA_Common_CentralElements_CompuMethods_Identical 1 100 0.0 65535. FORMAT "%5.0" ECU_ADDRESS 0x60029704 /end MEASUREMENT
/begin MEASUREMENT rba_OsShell_CntrInfraAsw2App10msTask "OS task counter for the OS_InfraAsw2App_10ms_Task" UWORD RB_RBA_Common_CentralElements_CompuMethods_Identical 1 100 0.0 65535. FORMAT "%5.0" ECU_ADDRESS 0x50000108 /end MEASUREMENT
/begin MEASUREMENT rba_OsShell_CntrInfraBswApp10msTask "OS task counter for the OS_InfraBswApp_10ms_Task" UWORD RB_RBA_Common_CentralElements_CompuMethods_Identical 1 100 0.0 65535. FORMAT "%5.0" ECU_ADDRESS 0x700030E2 /end MEASUREMENT
/begin MEASUREMENT rba_OsShell_CntrIniEndTask "OS task counter for the OS_IniEnd_Task" UWORD RB_RBA_Common_CentralElements_CompuMethods_Identical 1 100 0.0 65535. FORMAT "%5.0" ECU_ADDRESS 0x6002971A /end MEASUREMENT
/begin MEASUREMENT rba_OsShell_CntrIniTask "OS task counter for the OS_Ini_Task" UWORD RB_RBA_Common_CentralElements_CompuMethods_Identical 1 100 0.0 65535. FORMAT "%5.0" ECU_ADDRESS 0x60029718 /end MEASUREMENT
/begin MEASUREMENT rba_OsShell_CntrIniTaskCore0 "OS task counter for the OS_Ini_Task_Core0" UWORD RB_RBA_Common_CentralElements_CompuMethods_Identical 1 100 0.0 65535. FORMAT "%5.0" ECU_ADDRESS 0x700030EA /end MEASUREMENT
/begin MEASUREMENT rba_OsShell_CntrMoTask "OS task counter for the OS_Mo_Task" UWORD RB_RBA_Common_CentralElements_CompuMethods_Identical 1 100 0.0 65535. FORMAT "%5.0" ECU_ADDRESS 0x60029702 /end MEASUREMENT
/begin MEASUREMENT rba_OsShell_CntrReIniModeMTask "OS task counter for the OS_ReIniModeM_Task" UWORD RB_RBA_Common_CentralElements_CompuMethods_Identical 1 100 0.0 65535. FORMAT "%5.0" ECU_ADDRESS 0x60029716 /end MEASUREMENT
/begin MEASUREMENT rba_OsShell_CntrShutdown10msTask "OS task counter for the OS_Shutdown_10ms_Task" UWORD RB_RBA_Common_CentralElements_CompuMethods_Identical 1 100 0.0 65535. FORMAT "%5.0" ECU_ADDRESS 0x700030D8 /end MEASUREMENT
/begin MEASUREMENT rba_OsShell_CntrShutdownAsw1Task "OS task counter for the OS_Shutdown_Asw1_Task" UWORD RB_RBA_Common_CentralElements_CompuMethods_Identical 1 100 0.0 65535. FORMAT "%5.0" ECU_ADDRESS 0x60029700 /end MEASUREMENT
/begin MEASUREMENT rba_OsShell_CntrShutdownAsw2Task "OS task counter for the OS_Shutdown_Asw2_Task" UWORD RB_RBA_Common_CentralElements_CompuMethods_Identical 1 100 0.0 65535. FORMAT "%5.0" ECU_ADDRESS 0x50000100 /end MEASUREMENT
/begin MEASUREMENT rba_OsShell_CntrShutdownBswTask "OS task counter for the OS_Shutdown_Bsw_Task" UWORD RB_RBA_Common_CentralElements_CompuMethods_Identical 1 100 0.0 65535. FORMAT "%5.0" ECU_ADDRESS 0x700030DC /end MEASUREMENT
/begin MEASUREMENT rba_OsShell_CntrShutdownSeqTask "OS task counter for the OS_Shutdown_Seq_Task" UWORD RB_RBA_Common_CentralElements_CompuMethods_Identical 1 100 0.0 65535. FORMAT "%5.0" ECU_ADDRESS 0x700030DA /end MEASUREMENT
/begin MEASUREMENT rba_OsShell_cntrErrAccess "OS E_OS_ACCESS error counter" UBYTE RB_RBA_Common_CentralElements_CompuMethods_Identical 1 100 0.0 255. FORMAT "%5.0" ECU_ADDRESS 0x6002563B /end MEASUREMENT
/begin MEASUREMENT rba_OsShell_cntrErrCallevel "OS E_OS_CALLEVEL error counter" UBYTE RB_RBA_Common_CentralElements_CompuMethods_Identical 1 100 0.0 255. FORMAT "%5.0" ECU_ADDRESS 0x6002563A /end MEASUREMENT
/begin MEASUREMENT rba_OsShell_cntrErrId "OS E_OS_ID error counter" UBYTE RB_RBA_Common_CentralElements_CompuMethods_Identical 1 100 0.0 255. FORMAT "%5.0" ECU_ADDRESS 0x60025639 /end MEASUREMENT
/begin MEASUREMENT rba_OsShell_cntrErrLimitSum "OS E_OS_LIMIT error counter" UBYTE RB_RBA_Common_CentralElements_CompuMethods_Identical 1 100 0.0 255. FORMAT "%5.0" ECU_ADDRESS 0x60025638 /end MEASUREMENT
/begin MEASUREMENT rba_OsShell_cntrErrNoFunc "OS E_OS_NOFUNC error counter" UBYTE RB_RBA_Common_CentralElements_CompuMethods_Identical 1 100 0.0 255. FORMAT "%5.0" ECU_ADDRESS 0x60025637 /end MEASUREMENT
/begin MEASUREMENT rba_OsShell_cntrErrResource "OS E_OS_RESOURCE error counter" UBYTE RB_RBA_Common_CentralElements_CompuMethods_Identical 1 100 0.0 255. FORMAT "%5.0" ECU_ADDRESS 0x60025636 /end MEASUREMENT
/begin MEASUREMENT rba_OsShell_cntrErrState "OS E_OS_STATE error counter" UBYTE RB_RBA_Common_CentralElements_CompuMethods_Identical 1 100 0.0 255. FORMAT "%5.0" ECU_ADDRESS 0x60025635 /end MEASUREMENT
/begin MEASUREMENT rba_OsShell_cntrErrSum "OS overall error counter" UBYTE RB_RBA_Common_CentralElements_CompuMethods_Identical 1 100 0.0 255. FORMAT "%5.0" ECU_ADDRESS 0x60025620 /end MEASUREMENT
/begin MEASUREMENT rba_OsShell_cntrErrValue "OS E_OS_VALUE error counter" UBYTE RB_RBA_Common_CentralElements_CompuMethods_Identical 1 100 0.0 255. FORMAT "%5.0" ECU_ADDRESS 0x60025634 /end MEASUREMENT
/begin MEASUREMENT rba_OsShell_tiPowerOnFrst10ms "Time from last Power on Reset to first 10ms-Raster" UWORD RB_RBA_Common_CentralElements_CompuMethods_Identical 1 100 0.0 65535. FORMAT "%5.0" ECU_ADDRESS 0x60022AC2 /end MEASUREMENT
/begin MEASUREMENT rba_OsShell_tiResetFrst10ms "Time from last Reset to first 10ms-Raster" UWORD RB_RBA_Common_CentralElements_CompuMethods_Identical 1 100 0.0 65535. FORMAT "%5.0" ECU_ADDRESS 0x60022AC4 /end MEASUREMENT
/begin MEASUREMENT rba_SyC_ObservationCounters_IrrSwOffTrigEngRun_Value_MP "ObservationCounter: Irregular Switch Off Counter Triggered by Engine Running" UBYTE DefaultIdenticalCompu 1 100 0.0 255.0 ECU_ADDRESS 0x70001FF0
 /begin ANNOTATION ANNOTATION_LABEL "Description (coming from AUTOSAR DESC field)"
  /begin ANNOTATION_TEXT "ObservationCounter: Irregular Switch Off Counter Triggered by Engine Running\r\n" /end ANNOTATION_TEXT
 /end ANNOTATION
/end MEASUREMENT
/begin MEASUREMENT rba_SyC_ObservationCounters_IrrSwOff_Value_MP "ObservationCounter: Irregular SwitchOff Counter" UBYTE DefaultIdenticalCompu 1 100 0.0 255.0 ECU_ADDRESS 0x70001FF1
 /begin ANNOTATION ANNOTATION_LABEL "Description (coming from AUTOSAR DESC field)" /begin ANNOTATION_TEXT "ObservationCounter: Irregular SwitchOff Counter\r\n" /end ANNOTATION_TEXT /end ANNOTATION
/end MEASUREMENT
/begin MEASUREMENT rba_SyC_PowerOn_Reasons_MP "Switch on reasons of the ECU" UWORD DefaultIdenticalCompu 1 100 0.0 65535.0 ECU_ADDRESS 0x70006C38
 /begin ANNOTATION ANNOTATION_LABEL "Description (coming from AUTOSAR DESC field)" /begin ANNOTATION_TEXT "Switch on reasons of the ECU\r\n" /end ANNOTATION_TEXT /end ANNOTATION
/end MEASUREMENT
/begin MEASUREMENT rba_SyC_Rtc_EcuOffTime_Validity_MP "Indicate the validity of the ECU Off Time" UBYTE RB_RBA_rba_SyC_Rtc_BswModuleDescriptions_rba_SyC_Rtc_EcuOffTime_CompuMethod 1 100 0.0 11.000 FORMAT "%8.3" ECU_ADDRESS 0x70006C40
 /begin ANNOTATION ANNOTATION_LABEL "Description (coming from AUTOSAR DESC field)" /begin ANNOTATION_TEXT "Indicate the validity of the ECU Off Time\r\n" /end ANNOTATION_TEXT /end ANNOTATION
/end MEASUREMENT
/begin MEASUREMENT rba_SyC_Rtc_EcuOffTime_Value_MP "ECU Off Time in seconds" ULONG DefaultIdenticalCompu 1 100 0.0 4.294967295E9 ECU_ADDRESS 0x70006C34
 /begin ANNOTATION ANNOTATION_LABEL "Description (coming from AUTOSAR DESC field)" /begin ANNOTATION_TEXT "ECU Off Time in seconds\r\n" /end ANNOTATION_TEXT /end ANNOTATION
/end MEASUREMENT
/*********** End of merged MEASUREMENT blocks ***********/
/begin MEASUREMENT AcChrgrIntkT_DDstSnsrState_mp "" UBYTE OneToOne 1 100 0.00 255.0 FORMAT "%5.1" ECU_ADDRESS 0x70006C2A /end MEASUREMENT
/begin MEASUREMENT AcChrgrIntkT_FirCalc.cntrAvrgZr " / Counter for 0-division in FIR (indicates failure)" UBYTE OneToOne 1 100 0.00 255.0 FORMAT "%5.1" ECU_ADDRESS 0x6001F688 /end MEASUREMENT
/begin MEASUREMENT AcChrgrIntkT_FirCalc.flgRdDne " / FIR: reading from uRaw-sum done" UBYTE OneToOne 1 100 0.00 1.000 BIT_MASK 0x1 FORMAT "%5.3" ECU_ADDRESS 0x6001F689 /end MEASUREMENT
/begin MEASUREMENT AcChrgrIntkT_FirCalc.uRawAvrg " / FIR: simple average calculated uRaw" SWORD Volt 1 100 -6553.600 6553.400 FORMAT "%8.3" ECU_ADDRESS 0x6001F68A /end MEASUREMENT
/begin MEASUREMENT AcChrgrIntkT_FirCalc.uRawFir " / FIR: Calculated uRaw" SWORD Volt 1 100 -6553.600 6553.400 FORMAT "%8.3" ECU_ADDRESS 0x6001F68C /end MEASUREMENT
/begin MEASUREMENT AcChrgrIntkT_FirRead.cntr " / Counter for simple average FIR" UBYTE OneToOne 1 100 0.00 255.0 FORMAT "%5.1" ECU_ADDRESS 0x60000C5C /end MEASUREMENT
/begin MEASUREMENT AcChrgrIntkT_FirRead.flgFirstRun " / FIR: 1st run after init" UBYTE OneToOne 1 100 0.00 1.000 BIT_MASK 0x1 FORMAT "%5.3" ECU_ADDRESS 0x60000C5D /end MEASUREMENT
/begin MEASUREMENT AcChrgrIntkT_FirRead.idxArr " / FIR ringbuffer: actual index" UBYTE OneToOne 1 100 0.00 255.0 FORMAT "%5.1" ECU_ADDRESS 0x60000C5E /end MEASUREMENT
/begin MEASUREMENT AcChrgrIntkT_FirRead.uSum " / Simple average FIR: sum of uRaws" SLONG Volt 1 100 -429496729.600 429496729.400 FORMAT "%13.3" ECU_ADDRESS 0x60000C60 /end MEASUREMENT
/begin MEASUREMENT AcChrgrIntkT_stMonStdSens "" ULONG OneToOne 1 100 0.00 4294967295.00 FORMAT "%13.2" ECU_ADDRESS 0x60001094
 /begin IF_DATA XCPplus 0x0102
  /begin DAQ_EVENT VARIABLE /end DAQ_EVENT
 /end IF_DATA
/end MEASUREMENT
/begin MEASUREMENT AcChrgrIntkT_stSnsrActv "" UBYTE OneToOne 1 100 0.00 255.0 BIT_MASK 0x1 FORMAT "%5.1" ECU_ADDRESS 0x6002374E
 /begin IF_DATA XCPplus 0x0102
  /begin DAQ_EVENT VARIABLE /end DAQ_EVENT
 /end IF_DATA
/end MEASUREMENT
/begin MEASUREMENT AcChrgrIntkT_stSnsrDdCalc "" UBYTE OneToOne 1 100 0.00 255.0 BIT_MASK 0x1 FORMAT "%5.1" ECU_ADDRESS 0x6002374D
 /begin IF_DATA XCPplus 0x0102
  /begin DAQ_EVENT VARIABLE /end DAQ_EVENT
 /end IF_DATA
/end MEASUREMENT
/begin MEASUREMENT AcChrgrIntkT_stSnsrDdReadCalc "" UBYTE OneToOne 1 100 0.00 255.0 BIT_MASK 0x1 FORMAT "%5.1" ECU_ADDRESS 0x6002374C
 /begin IF_DATA XCPplus 0x0102
  /begin DAQ_EVENT VARIABLE /end DAQ_EVENT
 /end IF_DATA
/end MEASUREMENT
/begin MEASUREMENT AcChrgrIntkT_swtConfStdSens2C "" ULONG OneToOne 1 100 0.00 4294967295.00 FORMAT "%13.2" ECU_ADDRESS 0x60000C58 /end MEASUREMENT
/begin MEASUREMENT AcChrgrIntkT_swtConfStdSensC "" ULONG OneToOne 1 100 0.00 4294967295.00 FORMAT "%13.2" ECU_ADDRESS 0x60000C54 /end MEASUREMENT
/begin MEASUREMENT AcChrgrIntkT_swtConfStdSensSwVersC "" ULONG OneToOne 1 100 0.00 4294967295.00 FORMAT "%13.2" ECU_ADDRESS 0x60000C50 /end MEASUREMENT
/begin MEASUREMENT AcChrgrIntkT_swtSensMode "" UBYTE OneToOne 1 100 0.00 255.0 FORMAT "%5.1" ECU_ADDRESS 0x6002387D /end MEASUREMENT
/begin MEASUREMENT AcChrgrIntkT_swtSensPres "" UBYTE OneToOne 1 100 0.00 255.0 FORMAT "%5.1" ECU_ADDRESS 0x6002387C
 /begin IF_DATA XCPplus 0x0102
  /begin DAQ_EVENT VARIABLE /end DAQ_EVENT
 /end IF_DATA
/end MEASUREMENT
/begin MEASUREMENT AcChrgrIntkT_tDynThresPhysRngHi_f_mp "" FLOAT32_IEEE RBPtCel_t_1p0_3 1 100 -1.00000000E+037 1.00000000E+037 FORMAT "%13.3" ECU_ADDRESS 0x70006930 /end MEASUREMENT
/begin MEASUREMENT AcChrgrIntkT_tDynThresPhysRngLo_f_mp "" FLOAT32_IEEE RBPtCel_t_1p0_3 1 100 -1.00000000E+037 1.00000000E+037 FORMAT "%13.3" ECU_ADDRESS 0x7000692C /end MEASUREMENT
/begin MEASUREMENT AcChrgrIntkT_tiSRCMaxDefDeb "" SLONG Time_ms 1 100 -21474836480.0 21474836470.0 FORMAT "%13.1" ECU_ADDRESS 0x600010C8
 /begin IF_DATA XCPplus 0x0102
  /begin DAQ_EVENT VARIABLE /end DAQ_EVENT
 /end IF_DATA
/end MEASUREMENT
/begin MEASUREMENT AcChrgrIntkT_tRefSnsr_mp "" SWORD Temp_Cels 1 100 -3549.940 3003.560 FORMAT "%8.3" ECU_ADDRESS 0x70006B52 /end MEASUREMENT
/begin MEASUREMENT AcChrgrIntkT_tSensCpl "" SWORD OneToOne 1 100 -32768.00 32767.00 FORMAT "%8.2" ECU_ADDRESS 0x6001FEB8
 /begin IF_DATA XCPplus 0x0102
  /begin DAQ_EVENT VARIABLE /end DAQ_EVENT
 /end IF_DATA
/end MEASUREMENT
/begin MEASUREMENT AcChrgrIntkT_tSensGradLim_f_mp "" FLOAT32_IEEE RBPtCel_t_1p0_3 1 100 -1.00000000E+037 1.00000000E+037 FORMAT "%13.3" ECU_ADDRESS 0x70006934
 /begin IF_DATA XCPplus 0x0102
  /begin DAQ_EVENT VARIABLE /end DAQ_EVENT
 /end IF_DATA
/end MEASUREMENT
/begin MEASUREMENT AcChrgrIntkT_tSensOffsCorrd_f "" FLOAT32_IEEE RBPtCel_t_1p0_3 1 100 -1.00000000E+037 1.00000000E+037 FORMAT "%13.3" ECU_ADDRESS 0x60001304
 /begin IF_DATA XCPplus 0x0102
  /begin DAQ_EVENT VARIABLE /end DAQ_EVENT
 /end IF_DATA
/end MEASUREMENT
/begin MEASUREMENT AcChrgrIntkT_tSensPT1Fltd_mp "" SWORD RBPtCel_t_1p0_3 1 100 -32768.00 32767.00 FORMAT "%8.2" ECU_ADDRESS 0x70006B50 /end MEASUREMENT
/begin MEASUREMENT AcChrgrIntkT_tSensUnFltd "" SWORD RBPtCel_t_1p0_3 1 100 -32768.00 32767.00 FORMAT "%8.2" ECU_ADDRESS 0x6001FEB4
 /begin IF_DATA XCPplus 0x0102
  /begin DAQ_EVENT VARIABLE /end DAQ_EVENT
 /end IF_DATA
/end MEASUREMENT
/begin MEASUREMENT AcChrgrIntkT_tSens_f "" FLOAT32_IEEE RBPtCel_t_1p0_3 1 100 -1.00000000E+037 1.00000000E+037 FORMAT "%13.3" ECU_ADDRESS 0x60001300
 /begin IF_DATA XCPplus 0x0102
  /begin DAQ_EVENT VARIABLE /end DAQ_EVENT
 /end IF_DATA
/end MEASUREMENT
/begin MEASUREMENT AcChrgrIntkT_tUnFlt_f "" FLOAT32_IEEE RBPtCel_t_1p0_3 1 100 -1.00000000E+037 1.00000000E+037 FORMAT "%13.3" ECU_ADDRESS 0x600012FC
 /begin IF_DATA XCPplus 0x0102
  /begin DAQ_EVENT VARIABLE /end DAQ_EVENT
 /end IF_DATA
/end MEASUREMENT
/begin MEASUREMENT AcChrgrIntkT_t_f "Actual physical value" FLOAT32_IEEE RBPtCel_t_1p0_3 1 100 -1.00000000E+037 1.00000000E+037 FORMAT "%13.3" ECU_ADDRESS 0x600012F8
 /begin IF_DATA XCPplus 0x0102
  /begin DAQ_EVENT VARIABLE /end DAQ_EVENT
 /end IF_DATA
/end MEASUREMENT
/begin MEASUREMENT AcChrgrIntkT_t_f_Sq "" UBYTE SigQly_COMPU_VERB 1 100 0.00 15.0000000000 FORMAT "%13.10" ECU_ADDRESS 0x6002387B
 /begin IF_DATA XCPplus 0x0102
  /begin DAQ_EVENT VARIABLE /end DAQ_EVENT
 /end IF_DATA
/end MEASUREMENT
/begin MEASUREMENT AcChrgrIntkT_uRaw "" SWORD Volt 1 100 -6553.600 6553.400 FORMAT "%8.3" ECU_ADDRESS 0x6001FEB2
 /begin IF_DATA XCPplus 0x0102
  /begin DAQ_EVENT VARIABLE /end DAQ_EVENT
 /end IF_DATA
/end MEASUREMENT
/begin MEASUREMENT AcChrgrIntkT_uRawPT1Fltd "" SWORD Volt 1 100 -6553.600 6553.400 FORMAT "%8.3" ECU_ADDRESS 0x6001FEB0
 /begin IF_DATA XCPplus 0x0102
  /begin DAQ_EVENT VARIABLE /end DAQ_EVENT
 /end IF_DATA
/end MEASUREMENT
/begin MEASUREMENT AcChrgrIntkT_uRawPT1FltdSens "" SWORD Volt 1 100 -6553.600 6553.400 FORMAT "%8.3" ECU_ADDRESS 0x6001FEAE
 /begin IF_DATA XCPplus 0x0102
  /begin DAQ_EVENT VARIABLE /end DAQ_EVENT
 /end IF_DATA
/end MEASUREMENT
/begin MEASUREMENT AcChrgrIntkT_uRawUnFltd "" SWORD Volt 1 100 -6553.600 6553.400 FORMAT "%8.3" ECU_ADDRESS 0x6001FEAC
 /begin IF_DATA XCPplus 0x0102
  /begin DAQ_EVENT VARIABLE /end DAQ_EVENT
 /end IF_DATA
/end MEASUREMENT
/begin MEASUREMENT AcChrgrIntkT_uRaw_f "" FLOAT32_IEEE RBPtCel_u_1p0_2 1 100 -1.00000000E+037 1.00000000E+037 FORMAT "%13.3" ECU_ADDRESS 0x600012F4
 /begin IF_DATA XCPplus 0x0102
  /begin DAQ_EVENT VARIABLE /end DAQ_EVENT
 /end IF_DATA
/end MEASUREMENT
/begin MEASUREMENT DDRC_ctArDebLvl.DFC_COMM_E_NET_START_IND_CHANNEL_3 "" SWORD DFC_OneToOne 1 100 -32768.00 32767.00 FORMAT "%8.2" ECU_ADDRESS 0x60021F62 /end MEASUREMENT
/begin MEASUREMENT DDRC_ctArDebLvl.DFC_COMM_E_NET_START_IND_CHANNEL_4 "" SWORD DFC_OneToOne 1 100 -32768.00 32767.00 FORMAT "%8.2" ECU_ADDRESS 0x60021F64 /end MEASUREMENT
/begin MEASUREMENT DDRC_ctArDebLvl.DFC_COMM_E_NET_START_IND_CHANNEL_5 "" SWORD DFC_OneToOne 1 100 -32768.00 32767.00 FORMAT "%8.2" ECU_ADDRESS 0x60021F66 /end MEASUREMENT
/begin MEASUREMENT DDRC_St.DFC_AcChrgrIntkTSRCMin "" ULONG DFC_OneToOne 1 100 0.00 536870911.000 BIT_MASK 0x1fffffff FORMAT "%13.3" ECU_ADDRESS 0x6001C980 /end MEASUREMENT
/begin MEASUREMENT DDRC_St.DFC_AcChrgrIntkTPhysRngHi "" UWORD DFC_OneToOne 1 100 0.00 8191.000 BIT_MASK 0x1fff FORMAT "%8.3" ECU_ADDRESS 0x60021F76 /end MEASUREMENT
/begin MEASUREMENT DDRC_St.DFC_AcChrgrIntkTPhysRngLo "" UWORD DFC_OneToOne 1 100 0.00 8191.000 BIT_MASK 0x1fff FORMAT "%8.3" ECU_ADDRESS 0x60021F78 /end MEASUREMENT
/begin MEASUREMENT DDRC_St.DFC_AcChrgrIntkTSRCOpn "" UWORD DFC_OneToOne 1 100 0.00 8191.000 BIT_MASK 0x1fff FORMAT "%8.3" ECU_ADDRESS 0x60021F7A /end MEASUREMENT
/begin MEASUREMENT DDRC_stLstRprtEve.DFC_COMM_E_NET_START_IND_CHANNEL_3 "" UBYTE DDRC_LstRprtEve_VERB 1 100 0.00 255.000000000 FORMAT "%13.9" ECU_ADDRESS 0x6002496F /end MEASUREMENT
/begin MEASUREMENT DDRC_stLstRprtEve.DFC_COMM_E_NET_START_IND_CHANNEL_4 "" UBYTE DDRC_LstRprtEve_VERB 1 100 0.00 255.000000000 FORMAT "%13.9" ECU_ADDRESS 0x60024970 /end MEASUREMENT
/begin MEASUREMENT DDRC_stLstRprtEve.DFC_COMM_E_NET_START_IND_CHANNEL_5 "" UBYTE DDRC_LstRprtEve_VERB 1 100 0.00 255.000000000 FORMAT "%13.9" ECU_ADDRESS 0x60024971 /end MEASUREMENT
/begin MEASUREMENT DFC_st.DFC_AcChrgrIntkTSRCMin "" UBYTE DFC_OneToOne 1 100 0.00 255.0 FORMAT "%5.1" ECU_ADDRESS 0x60034BC3 /end MEASUREMENT
/begin MEASUREMENT DFC_st.DFC_AcChrgrIntkTPhysRngHi "" UBYTE DFC_OneToOne 1 100 0.00 255.0 FORMAT "%5.1" ECU_ADDRESS 0x60034C12 /end MEASUREMENT
/begin MEASUREMENT DFC_st.DFC_AcChrgrIntkTPhysRngLo "" UBYTE DFC_OneToOne 1 100 0.00 255.0 FORMAT "%5.1" ECU_ADDRESS 0x60034C13 /end MEASUREMENT
/begin MEASUREMENT DFC_st.DFC_AcChrgrIntkTSRCOpn "" UBYTE DFC_OneToOne 1 100 0.00 255.0 FORMAT "%5.1" ECU_ADDRESS 0x60034C14 /end MEASUREMENT
/begin MEASUREMENT DFC_st.DFC_COMM_E_NET_START_IND_CHANNEL_3 "" UBYTE DFC_OneToOne 1 100 0.00 255.0 FORMAT "%5.1" ECU_ADDRESS 0x60034C9B /end MEASUREMENT
/begin MEASUREMENT DFC_st.DFC_COMM_E_NET_START_IND_CHANNEL_4 "" UBYTE DFC_OneToOne 1 100 0.00 255.0 FORMAT "%5.1" ECU_ADDRESS 0x60034C9C /end MEASUREMENT
/begin MEASUREMENT DFC_st.DFC_COMM_E_NET_START_IND_CHANNEL_5 "" UBYTE DFC_OneToOne 1 100 0.00 255.0 FORMAT "%5.1" ECU_ADDRESS 0x60034C9D /end MEASUREMENT
/begin MEASUREMENT DFC_st.DFC_RBA_IOEXTLIB_KEEPALIVE_DRV "" UBYTE DFC_OneToOne 1 100 0.00 255.0 FORMAT "%5.1" ECU_ADDRESS 0x60034CA5 /end MEASUREMENT
/begin MEASUREMENT DFC_st.DFC_RBA_IOEXTLIB_KEEPALIVE_INI "" UBYTE DFC_OneToOne 1 100 0.00 255.0 FORMAT "%5.1" ECU_ADDRESS 0x60034CA6 /end MEASUREMENT
/begin MEASUREMENT DFC_st.DFC_rba_SyC_IrrSwOffTrigEngRun_Event "" UBYTE DFC_OneToOne 1 100 0.00 255.0 FORMAT "%5.1" ECU_ADDRESS 0x60034CAB /end MEASUREMENT
/begin MEASUREMENT DFC_st.DFC_AcChrgrIntkTSRCMax "" UBYTE DFC_OneToOne 1 100 0.00 255.0 FORMAT "%5.1" ECU_ADDRESS 0x60034CAC /end MEASUREMENT
/begin MEASUREMENT DFC_st.DFC_AcChrgrIntkTTmpErr "" UBYTE DFC_OneToOne 1 100 0.00 255.0 FORMAT "%5.1" ECU_ADDRESS 0x60034CAD /end MEASUREMENT
/begin MEASUREMENT DINH_nrActvInhReas.FId_AcChrgrIntkTEnhdSRCMax "" UWORD DINH_ct_Compu 1 100 -4095.000 4096.000 BIT_MASK 0x1fff FORMAT "%8.3" ECU_ADDRESS 0x60021306 /end MEASUREMENT
/begin MEASUREMENT DINH_nrActvInhReas.FId_AcChrgrIntkTFrzVal "" UWORD DINH_ct_Compu 1 100 -4095.000 4096.000 BIT_MASK 0x1fff FORMAT "%8.3" ECU_ADDRESS 0x60021308 /end MEASUREMENT
/begin MEASUREMENT DINH_nrActvInhReas.FId_AcChrgrIntkTPhysRng "" UWORD DINH_ct_Compu 1 100 -4095.000 4096.000 BIT_MASK 0x1fff FORMAT "%8.3" ECU_ADDRESS 0x6002130A /end MEASUREMENT
/begin MEASUREMENT DINH_nrActvInhReas.FId_AcChrgrIntkTRplVal "" UWORD DINH_ct_Compu 1 100 -4095.000 4096.000 BIT_MASK 0x1fff FORMAT "%8.3" ECU_ADDRESS 0x6002130C /end MEASUREMENT
/begin MEASUREMENT DINH_nrActvInhReas.FId_AcChrgrIntkTSSpMon "" UWORD DINH_ct_Compu 1 100 -4095.000 4096.000 BIT_MASK 0x1fff FORMAT "%8.3" ECU_ADDRESS 0x6002130E /end MEASUREMENT
/begin MEASUREMENT DINH_nrActvInhReas.FId_AcChrgrIntkTTmpErrCnt "" UWORD DINH_ct_Compu 1 100 -4095.000 4096.000 BIT_MASK 0x1fff FORMAT "%8.3" ECU_ADDRESS 0x60021310 /end MEASUREMENT
/begin MEASUREMENT DINH_stFId.FId_AcChrgrIntkTEnhdSRCMax "" UWORD DFC_OneToOne 1 100 0.00 65535.00 FORMAT "%8.2" ECU_ADDRESS 0x60021306 /end MEASUREMENT
/begin MEASUREMENT DINH_stFId.FId_AcChrgrIntkTFrzVal "" UWORD DFC_OneToOne 1 100 0.00 65535.00 FORMAT "%8.2" ECU_ADDRESS 0x60021308 /end MEASUREMENT
/begin MEASUREMENT DINH_stFId.FId_AcChrgrIntkTPhysRng "" UWORD DFC_OneToOne 1 100 0.00 65535.00 FORMAT "%8.2" ECU_ADDRESS 0x6002130A /end MEASUREMENT
/begin MEASUREMENT DINH_stFId.FId_AcChrgrIntkTRplVal "" UWORD DFC_OneToOne 1 100 0.00 65535.00 FORMAT "%8.2" ECU_ADDRESS 0x6002130C /end MEASUREMENT
/begin MEASUREMENT DINH_stFId.FId_AcChrgrIntkTSSpMon "" UWORD DFC_OneToOne 1 100 0.00 65535.00 FORMAT "%8.2" ECU_ADDRESS 0x6002130E /end MEASUREMENT
/begin MEASUREMENT DINH_stFId.FId_AcChrgrIntkTTmpErrCnt "" UWORD DFC_OneToOne 1 100 0.00 65535.00 FORMAT "%8.2" ECU_ADDRESS 0x60021310 /end MEASUREMENT
/begin FUNCTION CanIf "15.16.3  McFunction CanIf Created by MCFunctionUpdater"
 /begin LOC_MEASUREMENT CanIf_Prv_ControllerState_ast[0].Ctrl_Pdu_mode CanIf_Prv_ControllerState_ast[1].Ctrl_Pdu_mode CanIf_Prv_ControllerState_ast[2].Ctrl_Pdu_mode CanIf_Prv_ControllerState_ast[3].Ctrl_Pdu_mode CanIf_Prv_InitStatus_b CanIf_Prv_TxBufferRam_ast[0].bufferstatus CanIf_Prv_TxBufferRam_ast[0].last_index CanIf_Prv_TxBufferRam_ast[10].bufferstatus CanIf_Prv_TxBufferRam_ast[10].last_index CanIf_Prv_TxBufferRam_ast[11].bufferstatus CanIf_Prv_TxBufferRam_ast[11].last_index CanIf_Prv_TxBufferRam_ast[12].bufferstatus CanIf_Prv_TxBufferRam_ast[12].last_index CanIf_Prv_TxBufferRam_ast[13].bufferstatus CanIf_Prv_TxBufferRam_ast[13].last_index CanIf_Prv_TxBufferRam_ast[14].bufferstatus CanIf_Prv_TxBufferRam_ast[14].last_index CanIf_Prv_TxBufferRam_ast[15].bufferstatus CanIf_Prv_TxBufferRam_ast[15].last_index CanIf_Prv_TxBufferRam_ast[16].bufferstatus CanIf_Prv_TxBufferRam_ast[16].last_index CanIf_Prv_TxBufferRam_ast[17].bufferstatus CanIf_Prv_TxBufferRam_ast[17].last_index CanIf_Prv_TxBufferRam_ast[18].bufferstatus CanIf_Prv_TxBufferRam_ast[18].last_index CanIf_Prv_TxBufferRam_ast[19].bufferstatus CanIf_Prv_TxBufferRam_ast[19].last_index CanIf_Prv_TxBufferRam_ast[1].bufferstatus CanIf_Prv_TxBufferRam_ast[1].last_index CanIf_Prv_TxBufferRam_ast[20].bufferstatus CanIf_Prv_TxBufferRam_ast[20].last_index CanIf_Prv_TxBufferRam_ast[21].bufferstatus CanIf_Prv_TxBufferRam_ast[21].last_index CanIf_Prv_TxBufferRam_ast[22].bufferstatus CanIf_Prv_TxBufferRam_ast[22].last_index CanIf_Prv_TxBufferRam_ast[23].bufferstatus CanIf_Prv_TxBufferRam_ast[23].last_index CanIf_Prv_TxBufferRam_ast[24].bufferstatus CanIf_Prv_TxBufferRam_ast[24].last_index CanIf_Prv_TxBufferRam_ast[25].bufferstatus CanIf_Prv_TxBufferRam_ast[25].last_index CanIf_Prv_TxBufferRam_ast[26].bufferstatus CanIf_Prv_TxBufferRam_ast[26].last_index CanIf_Prv_TxBufferRam_ast[27].bufferstatus CanIf_Prv_TxBufferRam_ast[27].last_index CanIf_Prv_TxBufferRam_ast[28].bufferstatus CanIf_Prv_TxBufferRam_ast[28].last_index CanIf_Prv_TxBufferRam_ast[29].bufferstatus CanIf_Prv_TxBufferRam_ast[29].last_index CanIf_Prv_TxBufferRam_ast[2].bufferstatus CanIf_Prv_TxBufferRam_ast[2].last_index CanIf_Prv_TxBufferRam_ast[30].bufferstatus CanIf_Prv_TxBufferRam_ast[30].last_index CanIf_Prv_TxBufferRam_ast[31].bufferstatus CanIf_Prv_TxBufferRam_ast[31].last_index CanIf_Prv_TxBufferRam_ast[32].bufferstatus CanIf_Prv_TxBufferRam_ast[32].last_index CanIf_Prv_TxBufferRam_ast[33].bufferstatus CanIf_Prv_TxBufferRam_ast[33].last_index CanIf_Prv_TxBufferRam_ast[34].bufferstatus CanIf_Prv_TxBufferRam_ast[34].last_index CanIf_Prv_TxBufferRam_ast[35].bufferstatus CanIf_Prv_TxBufferRam_ast[35].last_index CanIf_Prv_TxBufferRam_ast[36].bufferstatus CanIf_Prv_TxBufferRam_ast[36].last_index CanIf_Prv_TxBufferRam_ast[37].bufferstatus CanIf_Prv_TxBufferRam_ast[37].last_index CanIf_Prv_TxBufferRam_ast[38].bufferstatus CanIf_Prv_TxBufferRam_ast[38].last_index CanIf_Prv_TxBufferRam_ast[39].bufferstatus CanIf_Prv_TxBufferRam_ast[39].last_index CanIf_Prv_TxBufferRam_ast[3].bufferstatus CanIf_Prv_TxBufferRam_ast[3].last_index CanIf_Prv_TxBufferRam_ast[40].bufferstatus CanIf_Prv_TxBufferRam_ast[40].last_index CanIf_Prv_TxBufferRam_ast[41].bufferstatus CanIf_Prv_TxBufferRam_ast[41].last_index CanIf_Prv_TxBufferRam_ast[42].bufferstatus CanIf_Prv_TxBufferRam_ast[42].last_index CanIf_Prv_TxBufferRam_ast[43].bufferstatus CanIf_Prv_TxBufferRam_ast[43].last_index CanIf_Prv_TxBufferRam_ast[44].bufferstatus CanIf_Prv_TxBufferRam_ast[44].last_index CanIf_Prv_TxBufferRam_ast[45].bufferstatus CanIf_Prv_TxBufferRam_ast[45].last_index CanIf_Prv_TxBufferRam_ast[46].bufferstatus CanIf_Prv_TxBufferRam_ast[46].last_index CanIf_Prv_TxBufferRam_ast[47].bufferstatus CanIf_Prv_TxBufferRam_ast[47].last_index CanIf_Prv_TxBufferRam_ast[48].bufferstatus CanIf_Prv_TxBufferRam_ast[48].last_index CanIf_Prv_TxBufferRam_ast[49].bufferstatus CanIf_Prv_TxBufferRam_ast[49].last_index CanIf_Prv_TxBufferRam_ast[4].bufferstatus CanIf_Prv_TxBufferRam_ast[4].last_index CanIf_Prv_TxBufferRam_ast[50].bufferstatus CanIf_Prv_TxBufferRam_ast[50].last_index CanIf_Prv_TxBufferRam_ast[51].bufferstatus CanIf_Prv_TxBufferRam_ast[51].last_index CanIf_Prv_TxBufferRam_ast[52].bufferstatus CanIf_Prv_TxBufferRam_ast[52].last_index CanIf_Prv_TxBufferRam_ast[53].bufferstatus CanIf_Prv_TxBufferRam_ast[53].last_index CanIf_Prv_TxBufferRam_ast[54].bufferstatus CanIf_Prv_TxBufferRam_ast[54].last_index CanIf_Prv_TxBufferRam_ast[55].bufferstatus CanIf_Prv_TxBufferRam_ast[55].last_index CanIf_Prv_TxBufferRam_ast[56].bufferstatus CanIf_Prv_TxBufferRam_ast[56].last_index CanIf_Prv_TxBufferRam_ast[57].bufferstatus CanIf_Prv_TxBufferRam_ast[57].last_index CanIf_Prv_TxBufferRam_ast[58].bufferstatus CanIf_Prv_TxBufferRam_ast[58].last_index CanIf_Prv_TxBufferRam_ast[59].bufferstatus CanIf_Prv_TxBufferRam_ast[59].last_index CanIf_Prv_TxBufferRam_ast[5].bufferstatus CanIf_Prv_TxBufferRam_ast[5].last_index CanIf_Prv_TxBufferRam_ast[60].bufferstatus CanIf_Prv_TxBufferRam_ast[60].last_index CanIf_Prv_TxBufferRam_ast[61].bufferstatus CanIf_Prv_TxBufferRam_ast[61].last_index CanIf_Prv_TxBufferRam_ast[62].bufferstatus CanIf_Prv_TxBufferRam_ast[62].last_index CanIf_Prv_TxBufferRam_ast[63].bufferstatus CanIf_Prv_TxBufferRam_ast[63].last_index CanIf_Prv_TxBufferRam_ast[64].bufferstatus CanIf_Prv_TxBufferRam_ast[64].last_index CanIf_Prv_TxBufferRam_ast[65].bufferstatus CanIf_Prv_TxBufferRam_ast[65].last_index CanIf_Prv_TxBufferRam_ast[66].bufferstatus CanIf_Prv_TxBufferRam_ast[66].last_index CanIf_Prv_TxBufferRam_ast[67].bufferstatus CanIf_Prv_TxBufferRam_ast[67].last_index CanIf_Prv_TxBufferRam_ast[68].bufferstatus CanIf_Prv_TxBufferRam_ast[68].last_index CanIf_Prv_TxBufferRam_ast[69].bufferstatus CanIf_Prv_TxBufferRam_ast[69].last_index CanIf_Prv_TxBufferRam_ast[6].bufferstatus CanIf_Prv_TxBufferRam_ast[6].last_index CanIf_Prv_TxBufferRam_ast[70].bufferstatus CanIf_Prv_TxBufferRam_ast[70].last_index CanIf_Prv_TxBufferRam_ast[71].bufferstatus CanIf_Prv_TxBufferRam_ast[71].last_index CanIf_Prv_TxBufferRam_ast[72].bufferstatus CanIf_Prv_TxBufferRam_ast[72].last_index CanIf_Prv_TxBufferRam_ast[73].bufferstatus CanIf_Prv_TxBufferRam_ast[73].last_index CanIf_Prv_TxBufferRam_ast[74].bufferstatus CanIf_Prv_TxBufferRam_ast[74].last_index CanIf_Prv_TxBufferRam_ast[75].bufferstatus CanIf_Prv_TxBufferRam_ast[75].last_index CanIf_Prv_TxBufferRam_ast[76].bufferstatus CanIf_Prv_TxBufferRam_ast[76].last_index CanIf_Prv_TxBufferRam_ast[77].bufferstatus CanIf_Prv_TxBufferRam_ast[77].last_index CanIf_Prv_TxBufferRam_ast[7].bufferstatus CanIf_Prv_TxBufferRam_ast[7].last_index CanIf_Prv_TxBufferRam_ast[8].bufferstatus CanIf_Prv_TxBufferRam_ast[8].last_index CanIf_Prv_TxBufferRam_ast[9].bufferstatus CanIf_Prv_TxBufferRam_ast[9].last_index /end LOC_MEASUREMENT
 FUNCTION_VERSION "15.16.3" /end FUNCTION
/begin FUNCTION CanSM "11.16.2  McFunction CanSM Created by MCFunctionUpdater"
 /begin LOC_MEASUREMENT CanSM_BORMode_au8 CanSM_BusOffISRPend_ab CanSM_BusOff_Cntr_au8 CanSM_CurrNw_Mode_en CanSM_MutexMode_au8 CanSM_Network_Init_ab CanSM_ReqComM_Mode_en CanSM_TimerConfig_ast[0].cntTick_u16 CanSM_TimerConfig_ast[0].stTimer CanSM_TimerConfig_ast[1].cntTick_u16 CanSM_TimerConfig_ast[1].stTimer CanSM_TimerConfig_ast[2].cntTick_u16 CanSM_TimerConfig_ast[2].stTimer CanSM_TimerConfig_ast[3].cntTick_u16 CanSM_TimerConfig_ast[3].stTimer CanSM_currBOR_State_en /end LOC_MEASUREMENT
 FUNCTION_VERSION "11.16.2" /end FUNCTION
/begin FUNCTION CanTp "54.0.0  McFunction CanTp Created by MCFunctionUpdater" /begin LOC_MEASUREMENT CanTp_MainState /end LOC_MEASUREMENT FUNCTION_VERSION "54.0.0" /end FUNCTION
/begin FUNCTION ComM "9.16.1    Communication Manager"
 /begin DEF_CHARACTERISTIC DFC_CtlMsk2.DFC_COMM_E_NET_START_IND_CHANNEL_3_C DFC_CtlMsk2.DFC_COMM_E_NET_START_IND_CHANNEL_4_C DFC_CtlMsk2.DFC_COMM_E_NET_START_IND_CHANNEL_5_C DFC_DisblMsk2.DFC_COMM_E_NET_START_IND_CHANNEL_3_C DFC_DisblMsk2.DFC_COMM_E_NET_START_IND_CHANNEL_4_C DFC_DisblMsk2.DFC_COMM_E_NET_START_IND_CHANNEL_5_C /end DEF_CHARACTERISTIC
 /begin OUT_MEASUREMENT DDRC_ctArDebLvl.DFC_COMM_E_NET_START_IND_CHANNEL_3 DDRC_ctArDebLvl.DFC_COMM_E_NET_START_IND_CHANNEL_4 DDRC_ctArDebLvl.DFC_COMM_E_NET_START_IND_CHANNEL_5 DDRC_stLstRprtEve.DFC_COMM_E_NET_START_IND_CHANNEL_3 DDRC_stLstRprtEve.DFC_COMM_E_NET_START_IND_CHANNEL_4 DDRC_stLstRprtEve.DFC_COMM_E_NET_START_IND_CHANNEL_5 DFC_st.DFC_COMM_E_NET_START_IND_CHANNEL_3 DFC_st.DFC_COMM_E_NET_START_IND_CHANNEL_4 DFC_st.DFC_COMM_E_NET_START_IND_CHANNEL_5 /end OUT_MEASUREMENT
 /begin LOC_MEASUREMENT ComM_ChannelStruct[0].BusSmMode_u8 ComM_ChannelStruct[0].ChannelMode_u8 ComM_ChannelStruct[0].ChannelState_e ComM_ChannelStruct[0].CommunicationAllowed_b ComM_ChannelStruct[0].DiagnosticRequestState_b ComM_ChannelStruct[0].InhibitionReqStatus_u8 ComM_ChannelStruct[0].LightTimeoutCtr_u32 ComM_ChannelStruct[0].MinFullComTimeoutCtr_u16 ComM_ChannelStruct[0].NmBusSleepIndicationStatus_b ComM_ChannelStruct[0].NmNetworkModeStatus_b ComM_ChannelStruct[0].NmNetworkRequestStatus_b ComM_ChannelStruct[0].NmPrepareBusSleepIndicationStatus_b ComM_ChannelStruct[0].PassiveRequestState_u8 ComM_ChannelStruct[0].PncRequestCtr_u8 ComM_ChannelStruct[0].UserRequestCtr_u16 ComM_ChannelStruct[1].BusSmMode_u8 ComM_ChannelStruct[1].ChannelMode_u8 ComM_ChannelStruct[1].ChannelState_e ComM_ChannelStruct[1].CommunicationAllowed_b ComM_ChannelStruct[1].DiagnosticRequestState_b ComM_ChannelStruct[1].InhibitionReqStatus_u8 ComM_ChannelStruct[1].LightTimeoutCtr_u32 ComM_ChannelStruct[1].MinFullComTimeoutCtr_u16 ComM_ChannelStruct[1].NmBusSleepIndicationStatus_b ComM_ChannelStruct[1].NmNetworkModeStatus_b ComM_ChannelStruct[1].NmNetworkRequestStatus_b ComM_ChannelStruct[1].NmPrepareBusSleepIndicationStatus_b ComM_ChannelStruct[1].PassiveRequestState_u8 ComM_ChannelStruct[1].PncRequestCtr_u8 ComM_ChannelStruct[1].UserRequestCtr_u16 ComM_ChannelStruct[2].BusSmMode_u8 ComM_ChannelStruct[2].ChannelMode_u8 ComM_ChannelStruct[2].ChannelState_e ComM_ChannelStruct[2].CommunicationAllowed_b ComM_ChannelStruct[2].DiagnosticRequestState_b ComM_ChannelStruct[2].InhibitionReqStatus_u8 ComM_ChannelStruct[2].LightTimeoutCtr_u32 ComM_ChannelStruct[2].MinFullComTimeoutCtr_u16 ComM_ChannelStruct[2].NmBusSleepIndicationStatus_b ComM_ChannelStruct[2].NmNetworkModeStatus_b ComM_ChannelStruct[2].NmNetworkRequestStatus_b ComM_ChannelStruct[2].NmPrepareBusSleepIndicationStatus_b ComM_ChannelStruct[2].PassiveRequestState_u8 ComM_ChannelStruct[2].PncRequestCtr_u8 ComM_ChannelStruct[2].UserRequestCtr_u16 ComM_ChannelStruct[3].BusSmMode_u8 ComM_ChannelStruct[3].ChannelMode_u8 ComM_ChannelStruct[3].ChannelState_e ComM_ChannelStruct[3].CommunicationAllowed_b ComM_ChannelStruct[3].DiagnosticRequestState_b ComM_ChannelStruct[3].InhibitionReqStatus_u8 ComM_ChannelStruct[3].LightTimeoutCtr_u32 ComM_ChannelStruct[3].MinFullComTimeoutCtr_u16 ComM_ChannelStruct[3].NmBusSleepIndicationStatus_b ComM_ChannelStruct[3].NmNetworkModeStatus_b ComM_ChannelStruct[3].NmNetworkRequestStatus_b ComM_ChannelStruct[3].NmPrepareBusSleepIndicationStatus_b ComM_ChannelStruct[3].PassiveRequestState_u8 ComM_ChannelStruct[3].PncRequestCtr_u8 ComM_ChannelStruct[3].UserRequestCtr_u16 ComM_ChannelStruct[4].BusSmMode_u8 ComM_ChannelStruct[4].ChannelMode_u8 ComM_ChannelStruct[4].ChannelState_e ComM_ChannelStruct[4].CommunicationAllowed_b ComM_ChannelStruct[4].DiagnosticRequestState_b ComM_ChannelStruct[4].InhibitionReqStatus_u8 ComM_ChannelStruct[4].LightTimeoutCtr_u32 ComM_ChannelStruct[4].MinFullComTimeoutCtr_u16 ComM_ChannelStruct[4].NmBusSleepIndicationStatus_b ComM_ChannelStruct[4].NmNetworkModeStatus_b ComM_ChannelStruct[4].NmNetworkRequestStatus_b ComM_ChannelStruct[4].NmPrepareBusSleepIndicationStatus_b ComM_ChannelStruct[4].PassiveRequestState_u8 ComM_ChannelStruct[4].PncRequestCtr_u8 ComM_ChannelStruct[4].UserRequestCtr_u16 ComM_ChannelStruct[5].BusSmMode_u8 ComM_ChannelStruct[5].ChannelMode_u8 ComM_ChannelStruct[5].ChannelState_e ComM_ChannelStruct[5].CommunicationAllowed_b ComM_ChannelStruct[5].DiagnosticRequestState_b ComM_ChannelStruct[5].InhibitionReqStatus_u8 ComM_ChannelStruct[5].LightTimeoutCtr_u32 ComM_ChannelStruct[5].MinFullComTimeoutCtr_u16 ComM_ChannelStruct[5].NmBusSleepIndicationStatus_b ComM_ChannelStruct[5].NmNetworkModeStatus_b ComM_ChannelStruct[5].NmNetworkRequestStatus_b ComM_ChannelStruct[5].NmPrepareBusSleepIndicationStatus_b ComM_ChannelStruct[5].PassiveRequestState_u8 ComM_ChannelStruct[5].PncRequestCtr_u8 ComM_ChannelStruct[5].UserRequestCtr_u16 ComM_UserStruct[0].IndicatedUserMode_u8 ComM_UserStruct[0].LimitToNoComCtr_u16 ComM_UserStruct[0].RequestedUserMode_u8 ComM_UserStruct[0].WakeUpInhibitionCtr_u16 ComM_UserStruct[0].numChannelsInFullCom_u8 ComM_UserStruct[0].numChannelsInNoCom_u8 ComM_UserStruct[0].numChannelsInSilentCom_u8 ComM_UserStruct[1].IndicatedUserMode_u8 ComM_UserStruct[1].LimitToNoComCtr_u16 ComM_UserStruct[1].RequestedUserMode_u8 ComM_UserStruct[1].WakeUpInhibitionCtr_u16 ComM_UserStruct[1].numChannelsInFullCom_u8 ComM_UserStruct[1].numChannelsInNoCom_u8 ComM_UserStruct[1].numChannelsInSilentCom_u8 ComM_UserStruct[2].IndicatedUserMode_u8 ComM_UserStruct[2].LimitToNoComCtr_u16 ComM_UserStruct[2].RequestedUserMode_u8 ComM_UserStruct[2].WakeUpInhibitionCtr_u16 ComM_UserStruct[2].numChannelsInFullCom_u8 ComM_UserStruct[2].numChannelsInNoCom_u8 ComM_UserStruct[2].numChannelsInSilentCom_u8 ComM_UserStruct[3].IndicatedUserMode_u8 ComM_UserStruct[3].LimitToNoComCtr_u16 ComM_UserStruct[3].RequestedUserMode_u8 ComM_UserStruct[3].WakeUpInhibitionCtr_u16 ComM_UserStruct[3].numChannelsInFullCom_u8 ComM_UserStruct[3].numChannelsInNoCom_u8 ComM_UserStruct[3].numChannelsInSilentCom_u8 ComM_UserStruct[4].IndicatedUserMode_u8 ComM_UserStruct[4].LimitToNoComCtr_u16 ComM_UserStruct[4].RequestedUserMode_u8 ComM_UserStruct[4].WakeUpInhibitionCtr_u16 ComM_UserStruct[4].numChannelsInFullCom_u8 ComM_UserStruct[4].numChannelsInNoCom_u8 ComM_UserStruct[4].numChannelsInSilentCom_u8 ComM_UserStruct[5].IndicatedUserMode_u8 ComM_UserStruct[5].LimitToNoComCtr_u16 ComM_UserStruct[5].RequestedUserMode_u8 ComM_UserStruct[5].WakeUpInhibitionCtr_u16 ComM_UserStruct[5].numChannelsInFullCom_u8 ComM_UserStruct[5].numChannelsInNoCom_u8 ComM_UserStruct[5].numChannelsInSilentCom_u8 /end LOC_MEASUREMENT
 FUNCTION_VERSION "9.16.1" /end FUNCTION
/begin FUNCTION Fee "5.37.1  McFunction Fee Created by MCFunctionUpdater" /begin LOC_MEASUREMENT Fee_SecChngCnt_u32 /end LOC_MEASUREMENT FUNCTION_VERSION "5.37.1" /end FUNCTION
/begin FUNCTION Lin "8.11.0  McFunction Lin Created by MCFunctionUpdater"
 /begin LOC_MEASUREMENT Lin_ChnlVar_MP[0].CSmodel Lin_ChnlVar_MP[0].ChannelState Lin_ChnlVar_MP[0].FramePid Lin_ChnlVar_MP[0].FrameType Lin_ChnlVar_MP[0].GotoSleepCtr Lin_ChnlVar_MP[0].Length Lin_ChnlVar_MP[0].Lin_Buf_au8 Lin_ChnlVar_MP[0].Status Lin_DrvFlags_MP /end LOC_MEASUREMENT
 FUNCTION_VERSION "8.11.0" /end FUNCTION
/begin FUNCTION LinIf "9.16.2  McFunction LinIf Created by MCFunctionUpdater"
 /begin LOC_MEASUREMENT LinIf_ChnlVar_as[0].ChannelStateFlag_u8 LinIf_ChnlVar_as[0].ChannelStatusFlags_u8 LinIf_ChnlVar_as[0].CurrentIndex_u8 LinIf_ChnlVar_as[0].CurrentScheduleTable_u8 LinIf_ChnlVar_as[0].DelayCount_u8 LinIf_ChnlVar_as[0].GotoSleepCtr LinIf_ChnlVar_as[0].NewScheduleTable_u8 LinIf_ChnlVar_as[0].SavedIndex_u8 LinIf_ChnlVar_as[0].SavedScheduleTable_u8 LinIf_ChnlVar_as[0].SlpGetStatus_u8 LinIf_ChnlVar_as[0].SpoETIndex_u8 LinIf_ChnlVar_as[0].Temp_SpoFrmCount_u8 LinIf_ChnlVar_as[0].TransmitSRF_u8 LinIf_ChnlVar_as[0].Wakeup_u8 LinIf_Status_u8 /end LOC_MEASUREMENT
 FUNCTION_VERSION "9.16.2" /end FUNCTION
/begin FUNCTION LinSM "5.13.0  McFunction LinSM Created by MCFunctionUpdater"
 /begin LOC_MEASUREMENT LinSM_ModeRepeatReq_Max_u8 LinSM_RamVar_ast[0].ChnlState LinSM_RamVar_ast[0].LinSmModReqRepMax LinSM_RamVar_ast[0].LinSm_Conf_Status LinSM_RamVar_ast[0].LinSm_Request_Status LinSM_RamVar_ast[0].LinSm_SchdReq_E_NOT_OK LinSM_RamVar_ast[0].LinSm_Sleep_Status LinSM_RamVar_ast[0].StoredSchdTab LinSM_RamVar_ast[0].TimeOutCounter LinSM_RamVar_ast[0].TimeoutFlag LinSM_State_en /end LOC_MEASUREMENT
 FUNCTION_VERSION "5.13.0" /end FUNCTION
/begin FUNCTION PduR "15.16.2  McFunction PduR Created by MCFunctionUpdater" /begin LOC_MEASUREMENT PduR_State /end LOC_MEASUREMENT FUNCTION_VERSION "15.16.2" /end FUNCTION
/begin FUNCTION Can "McFunction Can Created by MCFunctionUpdater" /begin LOC_MEASUREMENT rba_CanMcan_DriverState_MP rba_CanMcan_MsgStatus_MP /end LOC_MEASUREMENT /end FUNCTION
/begin FUNCTION rba_Dme "1.45.0  McFunction rba_Dme Created by MCFunctionUpdater"
 /begin LOC_MEASUREMENT rba_Dme_Ovl_stEnable rba_Dme_adrError rba_Dme_numBytesAvailable rba_Dme_numBytesAvailableOvl /end LOC_MEASUREMENT
 FUNCTION_VERSION "1.45.0" /end FUNCTION
/begin FUNCTION rba_IoDiagHlfBr "1.15.0  McFunction rba_IoDiagHlfBr Created by MCFunctionUpdater"
 /begin LOC_MEASUREMENT rba_IoDiagHlfBr_dataDiagInfo_MP rba_IoDiagHlfBr_idDbgSignal rba_IoDiagHlfBr_stDiagCtrl_MP rba_IoDiagHlfBr_stDiagDi_MP rba_IoDiagHlfBr_stSwtOffDiag_MP rba_IoDiagHlfBr_stTstPlsReq_MP rba_IoDiagHlfBr_xReasSwtOffDiagAbort_MP /end LOC_MEASUREMENT
 FUNCTION_VERSION "1.15.0" /end FUNCTION
/begin FUNCTION rba_IoExtLib "1.24.1    Library for external devices"
 /begin DEF_CHARACTERISTIC DFC_CtlMsk2.DFC_RBA_IOEXTLIB_KEEPALIVE_DRV_C DFC_CtlMsk2.DFC_RBA_IOEXTLIB_KEEPALIVE_INI_C DFC_DisblMsk2.DFC_RBA_IOEXTLIB_KEEPALIVE_DRV_C DFC_DisblMsk2.DFC_RBA_IOEXTLIB_KEEPALIVE_INI_C /end DEF_CHARACTERISTIC
 /begin OUT_MEASUREMENT DFC_st.DFC_RBA_IOEXTLIB_KEEPALIVE_DRV DFC_st.DFC_RBA_IOEXTLIB_KEEPALIVE_INI /end OUT_MEASUREMENT
 /begin LOC_MEASUREMENT rba_IoExtLib_KeepAliveDrvErrCyc_u32 rba_IoExtLib_KeepAliveDrvErrPerm_u32 rba_IoExtLib_KeepAliveIniErrCyc_u32 rba_IoExtLib_KeepAliveIniErrPerm_u32 /end LOC_MEASUREMENT
 FUNCTION_VERSION "1.24.1" /end FUNCTION
/begin FUNCTION rba_OsShell "1.42.0  McFunction rba_OsShell Created by MCFunctionUpdater"
 /begin LOC_MEASUREMENT rba_OsShell_Cntr1000msTask rba_OsShell_Cntr100msTask rba_OsShell_Cntr10msTask rba_OsShell_Cntr1msTask rba_OsShell_Cntr200msTask rba_OsShell_Cntr20msTask rba_OsShell_Cntr2msTask rba_OsShell_Cntr50msTask rba_OsShell_Cntr5msTask rba_OsShell_CntrAsw1BgTask rba_OsShell_CntrAsw2BgTask rba_OsShell_CntrBswBgTask rba_OsShell_CntrCalWup100msTask rba_OsShell_CntrCalWup10msTask rba_OsShell_CntrCalWup20msTask rba_OsShell_CntrCalWup2msTask rba_OsShell_CntrCalWupAsw110msTask rba_OsShell_CntrCalWupAsw210msTask rba_OsShell_CntrCalWupBgTask rba_OsShell_CntrCalWupIniEndTask rba_OsShell_CntrCalWupIniTask rba_OsShell_CntrCanTpburstTask rba_OsShell_CntrDSMClearTask rba_OsShell_CntrDSMReiniTask rba_OsShell_CntrEngReStrtExampleTask rba_OsShell_CntrErrLimit1000msTask rba_OsShell_CntrErrLimit100msTask rba_OsShell_CntrErrLimit10msTask rba_OsShell_CntrErrLimit1msTask rba_OsShell_CntrErrLimit200msTask rba_OsShell_CntrErrLimit20msTask rba_OsShell_CntrErrLimit2msTask rba_OsShell_CntrErrLimit50msTask rba_OsShell_CntrErrLimit5msTask rba_OsShell_CntrErrLimitAsw1BgTask rba_OsShell_CntrErrLimitAsw2BgTask rba_OsShell_CntrErrLimitBswBgTask rba_OsShell_CntrErrLimitCalWup100msTask rba_OsShell_CntrErrLimitCalWup10msTask rba_OsShell_CntrErrLimitCalWup20msTask rba_OsShell_CntrErrLimitCalWup2msTask rba_OsShell_CntrErrLimitCalWupAsw110msTask rba_OsShell_CntrErrLimitCalWupAsw210msTask rba_OsShell_CntrErrLimitCalWupBgTask rba_OsShell_CntrErrLimitCalWupIniEndTask rba_OsShell_CntrErrLimitCalWupIniTask rba_OsShell_CntrErrLimitCanTpburstTask rba_OsShell_CntrErrLimitDSMClearTask rba_OsShell_CntrErrLimitDSMReiniTask rba_OsShell_CntrErrLimitEngReStrtExampleTask rba_OsShell_CntrErrLimitInfraAsw1App10msTask rba_OsShell_CntrErrLimitInfraAsw2App10msTask rba_OsShell_CntrErrLimitInfraBswApp10msTask rba_OsShell_CntrErrLimitIniEndTask rba_OsShell_CntrErrLimitIniTask rba_OsShell_CntrErrLimitIniTaskCore0 rba_OsShell_CntrErrLimitMoTask rba_OsShell_CntrErrLimitReIniModeMTask rba_OsShell_CntrErrLimitShutdown10msTask rba_OsShell_CntrErrLimitShutdownAsw1Task rba_OsShell_CntrErrLimitShutdownAsw2Task rba_OsShell_CntrErrLimitShutdownBswTask rba_OsShell_CntrErrLimitShutdownSeqTask rba_OsShell_CntrInfraAsw1App10msTask rba_OsShell_CntrInfraAsw2App10msTask rba_OsShell_CntrInfraBswApp10msTask rba_OsShell_CntrIniEndTask rba_OsShell_CntrIniTask rba_OsShell_CntrIniTaskCore0 rba_OsShell_CntrMoTask rba_OsShell_CntrReIniModeMTask rba_OsShell_CntrShutdown10msTask rba_OsShell_CntrShutdownAsw1Task rba_OsShell_CntrShutdownAsw2Task rba_OsShell_CntrShutdownBswTask rba_OsShell_CntrShutdownSeqTask rba_OsShell_cntrErrAccess rba_OsShell_cntrErrCallevel rba_OsShell_cntrErrId rba_OsShell_cntrErrLimitSum rba_OsShell_cntrErrNoFunc rba_OsShell_cntrErrResource rba_OsShell_cntrErrState rba_OsShell_cntrErrSum rba_OsShell_cntrErrValue rba_OsShell_tiPowerOnFrst10ms rba_OsShell_tiResetFrst10ms /end LOC_MEASUREMENT
 FUNCTION_VERSION "1.42.0" /end FUNCTION
/begin FUNCTION rba_SyC_ObservationCounter "1.11.1    System Control Observation Counter"
 /begin DEF_CHARACTERISTIC DFC_CtlMsk2.DFC_rba_SyC_IrrSwOffTrigEngRun_Event_C DFC_DisblMsk2.DFC_rba_SyC_IrrSwOffTrigEngRun_Event_C /end DEF_CHARACTERISTIC
 /begin OUT_MEASUREMENT DFC_st.DFC_rba_SyC_IrrSwOffTrigEngRun_Event /end OUT_MEASUREMENT
 /begin LOC_MEASUREMENT rba_SyC_ObservationCounters_IrrSwOffTrigEngRun_Value_MP rba_SyC_ObservationCounters_IrrSwOff_Value_MP /end LOC_MEASUREMENT
 FUNCTION_VERSION "1.11.1" /end FUNCTION
/begin FUNCTION rba_SyC_Power "1.6.0  McFunction rba_SyC_Power Created by MCFunctionUpdater" /begin LOC_MEASUREMENT rba_SyC_PowerOn_Reasons_MP /end LOC_MEASUREMENT FUNCTION_VERSION "1.6.0" /end FUNCTION
/begin FUNCTION rba_SyC_Rtc "1.5.0  McFunction rba_SyC_Rtc Created by MCFunctionUpdater"
 /begin LOC_MEASUREMENT rba_SyC_Rtc_EcuOffTime_Validity_MP rba_SyC_Rtc_EcuOffTime_Value_MP /end LOC_MEASUREMENT
 FUNCTION_VERSION "1.5.0" /end FUNCTION
/begin FUNCTION rba_Etks "rba_Etks ETK-S Driver" /begin DEF_CHARACTERISTIC rba_Etks_stDisableDetection_C rba_Etks_swt3rdPartySupp_C /end DEF_CHARACTERISTIC FUNCTION_VERSION "0.0.0" /end FUNCTION
/*********** End of merged FUNCTION blocks ***********/
/begin FUNCTION AcChrgrIntkT_DELib_StdSensDd "10.2.0"
 /begin DEF_CHARACTERISTIC AcChrgrIntkT_ADCCal.numSRCTempSel_C AcChrgrIntkT_ADCCal.tiSRCMaxDebOK_C AcChrgrIntkT_ADCCal.uSRCMax_C AcChrgrIntkT_ADCCal.uSRCMin_C AcChrgrIntkT_ADCCal.uSRCOpn_C AcChrgrIntkT_ADCSensTransf_f_CUR AcChrgrIntkT_tiSRCMaxDefDeb_CUR DDRC_DurDeb.AcChrgrIntkT_tiSRCMinDebOk_C DDRC_DurDeb.AcChrgrIntkT_tiSRCMinDebDef_C DDRC_DurDeb.AcChrgrIntkT_tiSRCOpnDebOk_C DDRC_DurDeb.AcChrgrIntkT_tiSRCOpnDebDef_C DDRC_RatDeb.AcChrgrIntkT_tiSRCMinUDRat_C DDRC_RatDeb.AcChrgrIntkT_tiSRCOpnUDRat_C DFC_CtlMsk2.DFC_AcChrgrIntkTSRCMin_C DFC_CtlMsk2.DFC_AcChrgrIntkTSRCOpn_C DFC_CtlMsk2.DFC_AcChrgrIntkTSRCMax_C DFC_DisblMsk2.DFC_AcChrgrIntkTSRCMin_C DFC_DisblMsk2.DFC_AcChrgrIntkTSRCOpn_C DFC_DisblMsk2.DFC_AcChrgrIntkTSRCMax_C /end DEF_CHARACTERISTIC
 /begin REF_CHARACTERISTIC AcChrgrIntkT_tiPT1Fil_C AcChrgrIntkT_TransStg_f.Dfl_r32_C AcChrgrIntkT_TransStg_f.stSensId_C /end REF_CHARACTERISTIC
 /begin IN_MEASUREMENT AcChrgrIntkT_FirRead.cntr AcChrgrIntkT_FirRead.flgFirstRun AcChrgrIntkT_FirRead.idxArr AcChrgrIntkT_FirRead.uSum AcChrgrIntkT_stSnsrDdReadCalc AcChrgrIntkT_swtConfStdSens2C AcChrgrIntkT_swtConfStdSensC AcChrgrIntkT_swtConfStdSensSwVersC AcChrgrIntkT_uRawPT1FltdSens AcChrgrIntkT_uRawUnFltd DELib_idxArrSnsr DELib_xArrSnsr /end IN_MEASUREMENT
 /begin OUT_MEASUREMENT AcChrgrIntkT_FirCalc.cntrAvrgZr AcChrgrIntkT_FirCalc.flgRdDne AcChrgrIntkT_FirCalc.uRawAvrg AcChrgrIntkT_FirCalc.uRawFir AcChrgrIntkT_stSnsrDdCalc AcChrgrIntkT_swtSensPres AcChrgrIntkT_tiSRCMaxDefDeb AcChrgrIntkT_tSensCpl AcChrgrIntkT_tSensUnFltd AcChrgrIntkT_tSens_f AcChrgrIntkT_uRaw AcChrgrIntkT_uRaw_f DDRC_St.DFC_AcChrgrIntkTSRCMin DDRC_St.DFC_AcChrgrIntkTSRCOpn DFC_st.DFC_AcChrgrIntkTSRCMin DFC_st.DFC_AcChrgrIntkTSRCOpn DFC_st.DFC_AcChrgrIntkTSRCMax DINH_nrActvInhReas.FId_AcChrgrIntkTEnhdSRCMax DINH_nrActvInhReas.FId_AcChrgrIntkTSSpMon DINH_stFId.FId_AcChrgrIntkTEnhdSRCMax DINH_stFId.FId_AcChrgrIntkTSSpMon /end OUT_MEASUREMENT
 /begin LOC_MEASUREMENT AcChrgrIntkT_DDstSnsrState_mp AcChrgrIntkT_tRefSnsr_mp AcChrgrIntkT_tSensPT1Fltd_mp /end LOC_MEASUREMENT
 FUNCTION_VERSION "10.2.0" /end FUNCTION
/begin FUNCTION AcChrgrIntkT_DELib_StdSensDdRead "10.4.0" /begin DEF_CHARACTERISTIC AcChrgrIntkT_tiPT1Fil_C /end DEF_CHARACTERISTIC
 /begin IN_MEASUREMENT AcChrgrIntkT_FirCalc.cntrAvrgZr AcChrgrIntkT_FirCalc.flgRdDne AcChrgrIntkT_FirCalc.uRawAvrg AcChrgrIntkT_FirCalc.uRawFir AcChrgrIntkT_swtConfStdSens2C AcChrgrIntkT_swtConfStdSensC /end IN_MEASUREMENT
 /begin OUT_MEASUREMENT AcChrgrIntkT_FirRead.cntr AcChrgrIntkT_FirRead.flgFirstRun AcChrgrIntkT_FirRead.idxArr AcChrgrIntkT_FirRead.uSum AcChrgrIntkT_stSnsrDdReadCalc AcChrgrIntkT_uRawPT1Fltd AcChrgrIntkT_uRawPT1FltdSens AcChrgrIntkT_uRawUnFltd /end OUT_MEASUREMENT
 FUNCTION_VERSION "10.4.0" /end FUNCTION
/begin FUNCTION AcChrgrIntkT_DELib_StdSensDdSENTSlowRead "3.2.0"
 /begin IN_MEASUREMENT AcChrgrIntkT_swtConfStdSens2C AcChrgrIntkT_swtConfStdSensC AcChrgrIntkT_swtConfStdSensSwVersC /end IN_MEASUREMENT
 FUNCTION_VERSION "3.2.0" /end FUNCTION
/begin FUNCTION AcChrgrIntkT_DELib_StdSensExtDiag "8.1.0"
 /begin IN_MEASUREMENT AcChrgrIntkT_swtConfStdSensC AcChrgrIntkT_swtConfStdSensSwVersC DELib_idxArrSnsr DELib_xArrSnsr DSM_TripChgFinshd SyC_stSub /end IN_MEASUREMENT
 FUNCTION_VERSION "8.1.0" /end FUNCTION
/begin FUNCTION AcChrgrIntkT_DELib_StdSensInin "8.2.0"
 /begin DEF_CHARACTERISTIC AcChrgrIntkT_swtConfStdSens2_C AcChrgrIntkT_swtConfStdSensSwVers162_C AcChrgrIntkT_swtConfStdSens_C /end DEF_CHARACTERISTIC
 /begin REF_CHARACTERISTIC AcChrgrIntkT_tiPT1Fil_C /end REF_CHARACTERISTIC
 /begin OUT_MEASUREMENT AcChrgrIntkT_swtConfStdSens2C AcChrgrIntkT_swtConfStdSensC AcChrgrIntkT_swtConfStdSensSwVersC AcChrgrIntkT_swtSensMode /end OUT_MEASUREMENT
 FUNCTION_VERSION "8.2.0" /end FUNCTION
/begin FUNCTION AcChrgrIntkT_DELib_StdSensVd "11.0.0"
 /begin DEF_CHARACTERISTIC AcChrgrIntkT_DigSensCal.tiDebPos_C AcChrgrIntkT_DigSensCal.tiDebNeg_C AcChrgrIntkT_dtGradLim_f_C AcChrgrIntkT_RmpSlp_f.Pos_C AcChrgrIntkT_RmpSlp_f.Neg_C AcChrgrIntkT_tDflVal_f_C AcChrgrIntkT_tHiLimit_f_C AcChrgrIntkT_tiPT1_f_C AcChrgrIntkT_tLoLimit_f_C AcChrgrIntkT_TransStg_f.Dfl_r32_C AcChrgrIntkT_TransStg_f.stSensId_C /end DEF_CHARACTERISTIC
 /begin IN_MEASUREMENT AcChrgrIntkT_stSnsrDdCalc AcChrgrIntkT_swtConfStdSensC AcChrgrIntkT_swtConfStdSensSwVersC AcChrgrIntkT_tSens_f /end IN_MEASUREMENT
 /begin OUT_MEASUREMENT AcChrgrIntkT_tSensOffsCorrd_f AcChrgrIntkT_tUnFlt_f AcChrgrIntkT_t_f AcChrgrIntkT_t_f_Sq DINH_nrActvInhReas.FId_AcChrgrIntkTFrzVal DINH_nrActvInhReas.FId_AcChrgrIntkTRplVal DINH_stFId.FId_AcChrgrIntkTFrzVal DINH_stFId.FId_AcChrgrIntkTRplVal /end OUT_MEASUREMENT
 /begin LOC_MEASUREMENT AcChrgrIntkT_tSensGradLim_f_mp /end LOC_MEASUREMENT
 FUNCTION_VERSION "11.0.0" /end FUNCTION
/begin FUNCTION AcChrgrIntkT_DELib_StdSensVdMon "9.2.0"
 /begin DEF_CHARACTERISTIC AcChrgrIntkT_numStdSens_C AcChrgrIntkT_numTempErrDef_C AcChrgrIntkT_numtSel_C AcChrgrIntkT_stEnhPhysSRCRls_MAP AcChrgrIntkT_tEnhPhysSRCMax_f_MAP AcChrgrIntkT_tEnhPhysSRCMin_f_MAP AcChrgrIntkT_tiEngOnMin_C AcChrgrIntkT_tiTempErrOk_C AcChrgrIntkT_tSnsrMax_f_C AcChrgrIntkT_tSnsrMin_f_C DDRC_DurDeb.AcChrgrIntkT_tiPhysRngHiDebOk_C DDRC_DurDeb.AcChrgrIntkT_tiPhysRngHiDebDef_C DDRC_DurDeb.AcChrgrIntkT_tiPhysRngLoDebOk_C DDRC_DurDeb.AcChrgrIntkT_tiPhysRngLoDebDef_C DDRC_RatDeb.AcChrgrIntkT_tiPhysRngHiUDRat_C DDRC_RatDeb.AcChrgrIntkT_tiPhysRngLoUDRat_C DFC_CtlMsk2.DFC_AcChrgrIntkTPhysRngHi_C DFC_CtlMsk2.DFC_AcChrgrIntkTPhysRngLo_C DFC_CtlMsk2.DFC_AcChrgrIntkTTmpErr_C DFC_DisblMsk2.DFC_AcChrgrIntkTPhysRngHi_C DFC_DisblMsk2.DFC_AcChrgrIntkTPhysRngLo_C DFC_DisblMsk2.DFC_AcChrgrIntkTTmpErr_C /end DEF_CHARACTERISTIC
 /begin IN_MEASUREMENT AcChrgrIntkT_stSnsrDdCalc AcChrgrIntkT_swtConfStdSensC AcChrgrIntkT_swtConfStdSensSwVersC AcChrgrIntkT_tSens_f CoEng_tiNormal DELib_idxArrSnsr DELib_xArrSnsr DSM_TripChgFinshd Epm_nEng InjCtl_qSetUnBal /end IN_MEASUREMENT
 /begin OUT_MEASUREMENT AcChrgrIntkT_stSnsrActv DDRC_St.DFC_AcChrgrIntkTPhysRngHi DDRC_St.DFC_AcChrgrIntkTPhysRngLo DFC_st.DFC_AcChrgrIntkTPhysRngHi DFC_st.DFC_AcChrgrIntkTPhysRngLo DFC_st.DFC_AcChrgrIntkTTmpErr DINH_nrActvInhReas.FId_AcChrgrIntkTPhysRng DINH_nrActvInhReas.FId_AcChrgrIntkTTmpErrCnt DINH_stFId.FId_AcChrgrIntkTPhysRng DINH_stFId.FId_AcChrgrIntkTTmpErrCnt /end OUT_MEASUREMENT
 /begin LOC_MEASUREMENT AcChrgrIntkT_stMonStdSens AcChrgrIntkT_tDynThresPhysRngHi_f_mp AcChrgrIntkT_tDynThresPhysRngLo_f_mp /end LOC_MEASUREMENT
 FUNCTION_VERSION "9.2.0" /end FUNCTION
/*********** Start of merged COMPU_METHOD blocks ***********/
/begin COMPU_METHOD RB_RBA_Common_CentralElements_CompuMethods_Identical "The internal value and the physical one are identical. No physical unit available" RAT_FUNC "%10.5" "noUnit" COEFFS 0.0 1.0 0.0 0.0 0.0 1.0 REF_UNIT RB_RBA_Common_CentralElements_Units_NoUnit /end COMPU_METHOD
/begin COMPU_METHOD AUTOSAR_CanSM_CompuMethods_CanSM_NetworkModeStateType_Enum_comp "Computation method for the enum CanSM_NetworkModeStateType" TAB_VERB "%10.5" "noUnit" COMPU_TAB_REF AUTOSAR_CanSM_CompuMethods_CanSM_NetworkModeStateType_Enum_comp REF_UNIT AUTOSAR_CanSM_Units_NoUnit /end COMPU_METHOD
/begin COMPU_METHOD AUTOSAR_CanSM_CompuMethods_CanSM_TimerStateType_Enum_comp "Computation method for the enum CanSM_TimerStateType" TAB_VERB "%10.5" "noUnit" COMPU_TAB_REF AUTOSAR_CanSM_CompuMethods_CanSM_TimerStateType_Enum_comp REF_UNIT AUTOSAR_CanSM_Units_NoUnit /end COMPU_METHOD
/begin COMPU_METHOD AUTOSAR_CanSM_CompuMethods_CanSM_BusOffRecoveryStateType_Enum_comp "Computation method for the enum CanSM_BusOffRecoveryStateType" TAB_VERB "%10.5" "noUnit" COMPU_TAB_REF AUTOSAR_CanSM_CompuMethods_CanSM_BusOffRecoveryStateType_Enum_comp REF_UNIT AUTOSAR_CanSM_Units_NoUnit /end COMPU_METHOD
/begin COMPU_METHOD AUTOSAR_Lin_CompuMethods_Lin_Enum_Status_type "Enumeration for status type" TAB_VERB "%10.5" "noUnit" COMPU_TAB_REF AUTOSAR_Lin_CompuMethods_Lin_Enum_Status_type REF_UNIT AUTOSAR_Lin_Units_NoUnit /end COMPU_METHOD
/begin COMPU_METHOD AUTOSAR_Lin_CompuMethods_Lin_Enum_CheckSum_Type "Enumeration for Checksum model" TAB_VERB "%10.5" "noUnit" COMPU_TAB_REF AUTOSAR_Lin_CompuMethods_Lin_Enum_CheckSum_Type REF_UNIT AUTOSAR_Lin_Units_NoUnit /end COMPU_METHOD
/begin COMPU_METHOD AUTOSAR_Lin_CompuMethods_Lin_Enum_FrameRespType "Enumeration for frame responce type" TAB_VERB "%10.5" "noUnit" COMPU_TAB_REF AUTOSAR_Lin_CompuMethods_Lin_Enum_FrameRespType REF_UNIT AUTOSAR_Lin_Units_NoUnit /end COMPU_METHOD
/begin COMPU_METHOD AUTOSAR_Lin_CompuMethods_Lin_Enum_ChannelStateType "Enumeration for channel state" TAB_VERB "%10.5" "noUnit" COMPU_TAB_REF AUTOSAR_Lin_CompuMethods_Lin_Enum_ChannelStateType REF_UNIT AUTOSAR_Lin_Units_NoUnit /end COMPU_METHOD
/begin COMPU_METHOD AUTOSAR_LinSM_CompuMethods_LinSM_CompuMethod_OperationalMode "computation method displaying the Operational modes of LinSM" TAB_VERB "%10.5" "noUnit" COMPU_TAB_REF AUTOSAR_LinSM_CompuMethods_LinSM_CompuMethod_OperationalMode REF_UNIT AUTOSAR_LinSM_Units_NoUnit /end COMPU_METHOD
/begin COMPU_METHOD AUTOSAR_Platform_CompuMethods_boolean "" TAB_VERB "%10.5" "" COMPU_TAB_REF AUTOSAR_Platform_CompuMethods_boolean /end COMPU_METHOD
/begin COMPU_METHOD RB_RBA_rba_IoDiagHlfBr_CompuMethods_rba_IoDiagHlfBr_SwtOffDiagSts_tu8_CompuMethod "CompuMethod for state of switch-off mode diagnosis" TAB_VERB "%10.5" "noUnit" COMPU_TAB_REF RB_RBA_rba_IoDiagHlfBr_CompuMethods_rba_IoDiagHlfBr_SwtOffDiagSts_tu8_CompuMethod REF_UNIT RB_RBA_rba_IoDiagHlfBr_Units_NoUnit /end COMPU_METHOD
/begin COMPU_METHOD RB_RBA_rba_SyC_Rtc_BswModuleDescriptions_rba_SyC_Rtc_EcuOffTime_CompuMethod "CompuMethod for EcuOffTime in System Control" TAB_VERB "%10.5" "nounit" COMPU_TAB_REF RB_RBA_rba_SyC_Rtc_BswModuleDescriptions_rba_SyC_Rtc_EcuOffTime_CompuMethod REF_UNIT RB_RBA_rba_SyC_Rtc_Units_NoUnit /end COMPU_METHOD
/begin COMPU_METHOD DefaultIdenticalCompu "" RAT_FUNC "%10.5" "" COEFFS 0.0 1.0 0.0 0.0 0.0 1.0 /end COMPU_METHOD
/*********** Start of merged COMPU_VTAB blocks ***********/
/begin COMPU_VTAB AUTOSAR_CanSM_CompuMethods_CanSM_NetworkModeStateType_Enum_comp "Computation method for the enum CanSM_NetworkModeStateType" TAB_VERB 10 0 "CANSM_BSM_S_NOCOM" 1 "CANSM_BSM_S_SILENTCOM" 2 "CANSM_BSM_S_FULLCOM" 3 "CANSM_BSM_S_NOT_INITIALIZED" 4 "CANSM_BSM_S_PRE_NOCOM" 5 "CANSM_BSM_WUVALIDATION" 6 "CANSM_BSM_S_PRE_FULLCOM" 7 "CANSM_BSM_S_SET_BAUDRATE" 8 "CANSM_BSM_S_SILENTCOM_BOR" 9 "CANSM_BSM_S_TX_TIMEOUT_EXCEPTION" /end COMPU_VTAB
/begin COMPU_VTAB AUTOSAR_CanSM_CompuMethods_CanSM_TimerStateType_Enum_comp "Computation method for the enum CanSM_TimerStateType" TAB_VERB 4 1 "CANSM_TIMER_INIT" 2 "CANSM_TIMER_RUNNING" 3 "CANSM_TIMER_ELAPSED" 4 "CANSM_TIMER_CANCELLED" /end COMPU_VTAB
/begin COMPU_VTAB AUTOSAR_CanSM_CompuMethods_CanSM_BusOffRecoveryStateType_Enum_comp "Computation method for the enum CanSM_BusOffRecoveryStateType" TAB_VERB 6 1 "CANSM_BOR_IDLE" 2 "CANSM_S_BUS_OFF_CHECK" 3 "CANSM_S_NO_BUS_OFF" 4 "CANSM_S_TX_OFF" 5 "CANSM_S_RESTART_CC" 6 "CANSM_S_RESTART_CC_WAIT" /end COMPU_VTAB
/begin COMPU_VTAB AUTOSAR_Lin_CompuMethods_Lin_Enum_Status_type "Enumeration for status type" TAB_VERB 11 0 "LIN_NOT_OK" 1 "LIN_TX_OK" 2 "LIN_TX_BUSY" 3 "LIN_TX_HEADER_ERROR" 4 "LIN_TX_ERROR" 5 "LIN_RX_OK" 6 "LIN_RX_BUSY" 7 "LIN_RX_ERROR" 8 "LIN_RX_NO_RESPONSE" 9 "LIN_OPERATIONAL" 10 "LIN_CH_SLEEP" /end COMPU_VTAB
/begin COMPU_VTAB AUTOSAR_Lin_CompuMethods_Lin_Enum_CheckSum_Type "Enumeration for Checksum model" TAB_VERB 2 0 "LIN_ENHANCED_CS" 1 "LIN_CLASSIC_CS" /end COMPU_VTAB
/begin COMPU_VTAB AUTOSAR_Lin_CompuMethods_Lin_Enum_FrameRespType "Enumeration for frame responce type" TAB_VERB 4 0 "LIN_MASTER_RESPONSE" 1 "LIN_SLAVE_RESPONSE" 2 "LIN_SLAVE_TO_SLAVE" 3 "LIN_UNKNOWN_RESPONSE" /end COMPU_VTAB
/begin COMPU_VTAB AUTOSAR_Lin_CompuMethods_Lin_Enum_ChannelStateType "Enumeration for channel state" TAB_VERB 8 0 "LIN_CH_UNINIT_E" 1 "LIN_CH_SLEEP_E" 2 "LIN_CH_IDLE_E" 3 "LIN_CH_SENDFRAME_E" 4 "LIN_CH_RECEIVEHEADER_E" 5 "LIN_CH_RECEIVERESPONSE_E" 6 "LIN_CH_RECEIVESENTCS_E" 7 "LIN_CH_RECEIVESELFWAKEUP_E" /end COMPU_VTAB
/begin COMPU_VTAB AUTOSAR_LinSM_CompuMethods_LinSM_CompuMethod_OperationalMode "computation method displaying the Operational modes of LinSM" TAB_VERB 2 1 "LINSM_FULL_COM" 2 "LINSM_NO_COM" /end COMPU_VTAB
/begin COMPU_VTAB AUTOSAR_Platform_CompuMethods_boolean "" TAB_VERB 2 0 "FALSE" 1 "TRUE" /end COMPU_VTAB
/begin COMPU_VTAB RB_RBA_rba_IoDiagHlfBr_CompuMethods_rba_IoDiagHlfBr_SwtOffDiagSts_tu8_CompuMethod "CompuMethod for state of switch-off mode diagnosis" TAB_VERB 6 0 "RBA_IODIAGHLFBR_SWTOFFDIAG_NOTREQ" 1 "RBA_IODIAGHLFBR_SWTOFFDIAG_START_REQD" 2 "RBA_IODIAGHLFBR_SWTOFFDIAG_ABORT_REQD" 3 "RBA_IODIAGHLFBR_SWTOFFDIAG_RUNNG" 4 "RBA_IODIAGHLFBR_SWTOFFDIAG_ABORTED" 5 "RBA_IODIAGHLFBR_SWTOFFDIAG_FINSHD" /end COMPU_VTAB
/begin COMPU_VTAB RB_RBA_rba_SyC_Rtc_BswModuleDescriptions_rba_SyC_Rtc_EcuOffTime_CompuMethod "CompuMethod for EcuOffTime in System Control" TAB_VERB 12 0 "RBA_SYC_RTC_ECUOFFTIME_VALIDITY_UNKNOWN" 1 "RBA_SYC_RTC_ECUOFFTIME_VALIDITY_VALID" 2 "RBA_SYC_RTC_ECUOFFTIME_VALIDITY_INVALID_DISABLED" 3 "RBA_SYC_RTC_ECUOFFTIME_VALIDITY_INVALID_READ_ERROR" 4 "RBA_SYC_RTC_ECUOFFTIME_VALIDITY_INVALID_IRRSWOFF" 5 "RBA_SYC_RTC_ECUOFFTIME_VALIDITY_INVALID_POWERFAIL" 6 "RBA_SYC_RTC_ECUOFFTIME_VALIDITY_INVALID_WRONG_MODE" 7 "RBA_SYC_RTC_ECUOFFTIME_VALIDITY_INVALID_NOT_RUNNING" 8 "RBA_SYC_RTC_ECUOFFTIME_VALIDITY_INVALID_STORAGE_ERROR" 9 "RBA_SYC_RTC_ECUOFFTIME_VALIDITY_INVALID_EXTERNAL" 10 "RBA_SYC_RTC_ECUOFFTIME_VALIDITY_VALID_EXPIRED" 11 "RBA_SYC_RTC_ECUOFFTIME_VALIDITY_INVALID_DATA" /end COMPU_VTAB
/begin COMPU_METHOD AFST_SY_Compu "" TAB_VERB "%6.3" "" COMPU_TAB_REF AFST_SY_Compu /end COMPU_METHOD
/begin COMPU_VTAB AFST_SY_Compu "" TAB_VERB 2 0 "False" 1 "True" /end COMPU_VTAB
/begin COMPU_METHOD AFST_TYPAVL_SY_Compu "" TAB_VERB "%6.3" "" COMPU_TAB_REF AFST_TYPAVL_SY_Compu /end COMPU_METHOD
/begin COMPU_VTAB AFST_TYPAVL_SY_Compu "" TAB_VERB 2 0 "False" 1 "True" /end COMPU_VTAB
/begin COMPU_METHOD AFS_Rmp "" RAT_FUNC "%6.3" "1/s" COEFFS 0 6.5536 0 0 0 1 /end COMPU_METHOD
/begin COMPU_METHOD AgPrTime_COMPU "" RAT_FUNC "%6.4" "deg CrS/s" COEFFS 0 100 0 0 0 1 /end COMPU_METHOD
/begin COMPU_METHOD AIRBENA_SC_Compu "" TAB_VERB "%6.3" "" COMPU_TAB_REF AIRBENA_SC_Compu /end COMPU_METHOD
/begin COMPU_VTAB AIRBENA_SC_Compu "" TAB_VERB 2 0 "False" 1 "True" /end COMPU_VTAB
/begin COMPU_METHOD AIRBG_ATS_SC_Compu "" TAB_VERB "%6.3" "" COMPU_TAB_REF AIRBG_ATS_SC_Compu /end COMPU_METHOD
/begin COMPU_VTAB AIRBG_ATS_SC_Compu "" TAB_VERB 2 0 "False" 1 "True" /end COMPU_VTAB
/begin COMPU_METHOD AIRBG_AVS_SC_Compu "" TAB_VERB "%6.3" "" COMPU_TAB_REF AIRBG_AVS_SC_Compu /end COMPU_METHOD
/begin COMPU_VTAB AIRBG_AVS_SC_Compu "" TAB_VERB 2 0 "False" 1 "True" /end COMPU_VTAB
/begin COMPU_METHOD AIRBG_SIGTYP_SY_Compu "" TAB_VERB "%6.3" "" COMPU_TAB_REF AIRBG_SIGTYP_SY_Compu /end COMPU_METHOD
/begin COMPU_VTAB AIRBG_SIGTYP_SY_Compu "" TAB_VERB 4 0 "0" 1 "1" 2 "2" 3 "3" /end COMPU_VTAB
/begin COMPU_METHOD AirFlRat "" RAT_FUNC "%6.4" "-" COEFFS 0 200 0 0 0 1 /end COMPU_METHOD
/begin COMPU_METHOD AIRHUMT_TYPAVL_SC_Compu "" TAB_VERB "%6.3" "" COMPU_TAB_REF AIRHUMT_TYPAVL_SC_Compu /end COMPU_METHOD
/begin COMPU_VTAB AIRHUMT_TYPAVL_SC_Compu "" TAB_VERB 2 0 "False" 1 "True" /end COMPU_VTAB
/begin COMPU_METHOD AirMass "" RAT_FUNC "%6.4" "g" COEFFS 0 100 0 0 0 1 /end COMPU_METHOD
/begin COMPU_METHOD AirMassPerTime "" RAT_FUNC "%6.3" "Kg/h" COEFFS 0 10 0 0 0 1 /end COMPU_METHOD
/begin COMPU_METHOD AirMassPerTimeMgScnd "" RAT_FUNC "%6.3" "mg/s" COEFFS 0 10 0 0 0 1 /end COMPU_METHOD
/begin COMPU_METHOD AirMassPerTime_2 "" RAT_FUNC "%7.6" "g/s" COEFFS 0 31250 0 0 0 1 /end COMPU_METHOD
/begin COMPU_METHOD AirMass_2 "" RAT_FUNC "%6.3" "g" COEFFS 0 10 0 0 0 1 /end COMPU_METHOD
/begin COMPU_METHOD AirMsPrTime_q0p0003_COMPU "" RAT_FUNC "%6.5" "g/s" COEFFS 0 3333.33333333333 0 0 0 1 /end COMPU_METHOD
/begin COMPU_METHOD AirMs_q0p1_COMPU "" RAT_FUNC "%6.3" "g" COEFFS 0 10 0 0 0 1 /end COMPU_METHOD
/begin COMPU_METHOD AIRPIN_TYPAVL_SY_Compu "" TAB_VERB "%6.3" "" COMPU_TAB_REF AIRPIN_TYPAVL_SY_Compu /end COMPU_METHOD
/begin COMPU_VTAB AIRPIN_TYPAVL_SY_Compu "" TAB_VERB 2 0 "False" 1 "True" /end COMPU_VTAB
/begin COMPU_METHOD AIRPOUT_TYPAVL_SC_Compu "" TAB_VERB "%6.3" "" COMPU_TAB_REF AIRPOUT_TYPAVL_SC_Compu /end COMPU_METHOD
/begin COMPU_VTAB AIRPOUT_TYPAVL_SC_Compu "" TAB_VERB 2 0 "False" 1 "True" /end COMPU_VTAB
/begin COMPU_METHOD AIRSNSR_DSQACTVT_SC_Compu "" TAB_VERB "%6.3" "" COMPU_TAB_REF AIRSNSR_DSQACTVT_SC_Compu /end COMPU_METHOD
/begin COMPU_VTAB AIRSNSR_DSQACTVT_SC_Compu "" TAB_VERB 2 0 "False" 1 "True" /end COMPU_VTAB
/begin COMPU_METHOD AIRSNSR_PSCCENGSTRT_SC_Compu "" TAB_VERB "%6.3" "" COMPU_TAB_REF AIRSNSR_PSCCENGSTRT_SC_Compu /end COMPU_METHOD
/begin COMPU_VTAB AIRSNSR_PSCCENGSTRT_SC_Compu "" TAB_VERB 2 0 "False" 1 "True" /end COMPU_VTAB
/begin COMPU_METHOD AIRSNSR_VAR_SY_Compu "" TAB_VERB "%6.3" "" COMPU_TAB_REF AIRSNSR_VAR_SY_Compu /end COMPU_METHOD
/begin COMPU_VTAB AIRSNSR_VAR_SY_Compu "" TAB_VERB 58 0 "kein Kundenbezug" 1 "DAI" 3 "VWW" 4 "POR" 5 "AUD" 6 "OPE" 9 "FIA" 11 "BMW" 14 "PSA" 15 "REN" 17 "ALF" 18 "SAB" 19 "VOL" 20 "NIS" 21 "GMU" 22 "FOR" 26 "IMJ" 36 "MAN" 51 "SEA" 53 "CHR" 54 "JAG" 55 "ROL" 69 "FER" 72 "TOY" 123 "MIT" 147 "HYU" 159 "HON" 160 "MAZ" 183 "CU" 190 "LRG" 204 "VVW" 214 "AVT" 242 "Iveco" 243 "DMC" 248 "SUZ" 267 "SSANGYONG" 270 "KEF" 289 "AMG" 308 "TAT" 319 "MVM" 325 "GAZ" 327 "OTOSAN" 328 "MM" 385 "UAES" 590 "Scania" 609 "Deutz" 720 "Greatwall" 745 "JMC Ford" 788 "Saic Motor" 828 "RBCD" 898 "MFTBC" 936 "Anhui_Quanchai" 944 "DOOSAN Infracore" 984 "FAW - Wuxi" 999 "ALL" 2887 "Nonox" 9454 "Fuso" 9707 "Hatz" /end COMPU_VTAB
/begin COMPU_METHOD AirSysDdT_ms "" RAT_FUNC "%13.3" "ms" COEFFS 0 0 1 0 9.31322574615479e-006 0 /end COMPU_METHOD
/begin COMPU_METHOD AirSysSwt "" RAT_FUNC "%10.9" "-" COEFFS 0 16384000 0 0 0 1 /end COMPU_METHOD
/begin COMPU_METHOD AirSysSwt_S16 "" RAT_FUNC "%7.6" "-" COEFFS 0 16384 0 0 0 1 /end COMPU_METHOD
/begin COMPU_METHOD AIRSYS_ASYMC_SC_Compu "" TAB_VERB "%6.3" "" COMPU_TAB_REF AIRSYS_ASYMC_SC_Compu /end COMPU_METHOD
/begin COMPU_VTAB AIRSYS_ASYMC_SC_Compu "" TAB_VERB 2 0 "False" 1 "True" /end COMPU_VTAB
/begin COMPU_METHOD AIRTIN_TYPAVL_SC_Compu "" TAB_VERB "%6.3" "" COMPU_TAB_REF AIRTIN_TYPAVL_SC_Compu /end COMPU_METHOD
/begin COMPU_VTAB AIRTIN_TYPAVL_SC_Compu "" TAB_VERB 2 0 "False" 1 "True" /end COMPU_VTAB
/begin COMPU_METHOD AIRTOUT_TYPAVL_SY_Compu "" TAB_VERB "%6.3" "" COMPU_TAB_REF AIRTOUT_TYPAVL_SY_Compu /end COMPU_METHOD
/begin COMPU_VTAB AIRTOUT_TYPAVL_SY_Compu "" TAB_VERB 2 0 "False" 1 "True" /end COMPU_VTAB
/begin COMPU_METHOD AirVolPerTime "" RAT_FUNC "%6.3" "m^3/h" COEFFS 0 10 0 0 0 1 /end COMPU_METHOD
/begin COMPU_METHOD AltChpTemp_q8p0_COMPU "" RAT_FUNC "%6.2" "deg C" COEFFS 0 0.125 4 0 0 1 /end COMPU_METHOD
/begin COMPU_METHOD AltCrntLim_A_q0p25_COMPU "" RAT_FUNC "%6.3" "A" COEFFS 0 4 0 0 0 1 /end COMPU_METHOD
/begin COMPU_METHOD AltCrntOut_A_q0p125_COMPU "" RAT_FUNC "%6.3" "A" COEFFS 0 8 0 0 0 1 /end COMPU_METHOD
/begin COMPU_METHOD AltLd_q3p125_COMPU "" RAT_FUNC "%6.2" "%" COEFFS 0 0.32 0 0 0 1 /end COMPU_METHOD
/begin COMPU_METHOD AltVltg_V_q0p1_COMPU "" RAT_FUNC "%6.2" "V" COEFFS 0 10 -106 0 0 1 /end COMPU_METHOD
/begin COMPU_METHOD Ampere "" RAT_FUNC "%6.3" "mA" COEFFS 0 5 0 0 0 1 /end COMPU_METHOD
/begin COMPU_METHOD Ampere_q0p1_COMPU "" RAT_FUNC "%6.3" "uA" COEFFS 0 10 0 0 0 1 /end COMPU_METHOD
/begin COMPU_METHOD AMPT2NOxMPT_COMPU "" RAT_FUNC "%6.5" "(mg/s)/(Kg/h)" COEFFS 0 1000 0 0 0 1 /end COMPU_METHOD
/begin COMPU_METHOD AMPTDer_COMPU "" RAT_FUNC "%6.4" "(Kg/h)/s" COEFFS 0 100 0 0 0 1 /end COMPU_METHOD
/begin COMPU_METHOD AMPTgPerSec "" RAT_FUNC "%6.4" "g/s" COEFFS 0 20 0 0 0 1 /end COMPU_METHOD
/begin COMPU_METHOD AMPT_NOx "" RAT_FUNC "%8.7" "g/s" COEFFS 0 100000 0 0 0 1 /end COMPU_METHOD
/begin COMPU_METHOD AMPT_NOxLdUnld "" RAT_FUNC "%7.6" "g/s" COEFFS 0 10000 0 0 0 1 /end COMPU_METHOD
/begin COMPU_METHOD DDRCTime_ms "" RAT_FUNC "%6.1" "ms" COEFFS 0 1 0 0 0 10 /end COMPU_METHOD
/begin COMPU_METHOD DDRC_LstRprtEve_VERB "" TAB_VERB "%6.3" "" COMPU_TAB_REF DDRC_LstRprtEve_VERB /end COMPU_METHOD
/begin COMPU_VTAB DDRC_LstRprtEve_VERB "" TAB_VERB 5 0 "PASSED" 1 "FAILED" 2 "PREPASSED" 3 "PREFAILED" 255 "INVALID" /end COMPU_VTAB
/begin COMPU_METHOD DDRC_Ratio "" TAB_VERB "%6.3" "-" COMPU_TAB_REF DDRC_Ratio /end COMPU_METHOD
/begin COMPU_VTAB DDRC_Ratio "" TAB_VERB 4 1 "Ratio1" 2 "Ratio2" 3 "Ratio3" 4 "Ratio4" /end COMPU_VTAB
/begin COMPU_METHOD DELIB_ALLTEMP_VERB_COMPU "" TAB_VERB "%6.3" "" COMPU_TAB_REF DELIB_ALLTEMP_VERB_COMPU /end COMPU_METHOD
/begin COMPU_VTAB DELIB_ALLTEMP_VERB_COMPU "" TAB_VERB 6 85 "ACCHRGRINTKT" 86 "DCCHRGRINTKT" 0 "ENVT" 89 "HEATRCORET" 254 "DFLTEMP" 255 "NOTEMP" /end COMPU_VTAB
/begin COMPU_METHOD DFC_OneToOne "" RAT_FUNC "%6.2" "-" COEFFS 0 1 0 0 0 1 /end COMPU_METHOD
/begin COMPU_METHOD DFES_OneToOne "" RAT_FUNC "%6.2" "-" COEFFS 0 1 0 0 0 1 /end COMPU_METHOD
/begin COMPU_METHOD DINH_ct_Compu "" RAT_FUNC "%6.0" "" COEFFS 0 -1 4096 0 0 1 /end COMPU_METHOD
/begin COMPU_METHOD EngN "" RAT_FUNC "%6.3" "rpm" COEFFS 0 2 0 0 0 1 /end COMPU_METHOD
/begin COMPU_METHOD InjMass "" RAT_FUNC "%6.4" "mg/hub" COEFFS 0 100 0 0 0 1 /end COMPU_METHOD
/begin COMPU_METHOD OneToOne "" RAT_FUNC "%6.2" "-" COEFFS 0 1 0 0 0 1 /end COMPU_METHOD
/begin COMPU_METHOD RBPtCel_dt_1p0_1 "" RAT_FUNC "%6.2" "K/s" COEFFS 0 1 0 0 0 1 /end COMPU_METHOD
/begin COMPU_METHOD RBPtCel_ti_1p0_2 "" RAT_FUNC "%6.2" "s" COEFFS 0 1 0 0 0 1 /end COMPU_METHOD
/begin COMPU_METHOD RBPtCel_t_1p0_3 "" RAT_FUNC "%6.2" "Deg C" COEFFS 0 1 0 0 0 1 /end COMPU_METHOD
/begin COMPU_METHOD RBPtCel_u_1p0_2 "" RAT_FUNC "%6.2" "mV" COEFFS 0 1 0 0 0 1 /end COMPU_METHOD
/begin COMPU_METHOD SigQly_COMPU_VERB "" TAB_VERB "%6.3" "" COMPU_TAB_REF SigQly_COMPU_VERB /end COMPU_METHOD
/begin COMPU_VTAB SigQly_COMPU_VERB "" TAB_VERB 16 0 "SIGQLY_NOTCALC" 1 "SIGQLY_INIT" 2 "SIGQLY_OK" 3 "SIGQLY_MODEL" 4 "SIGQLY_REPLACEMENT" 5 "SIGQLY_FROZEN" 6 "SIGQLY_INVALID" 7 "SIGQLY_RESERVED_7" 8 "SIGQLY_RESERVED_8" 9 "SIGQLY_RESERVED_9" 10 "SIGQLY_RESERVED_10" 11 "SIGQLY_RESERVED_11" 12 "SIGQLY_RESERVED_12" 13 "SIGQLY_RESERVED_13" 14 "SIGQLY_RESERVED_14" 15 "SIGQLY_RESERVED_15" /end COMPU_VTAB
/begin COMPU_METHOD Temp_Cels "" RAT_FUNC "%6.1" "deg C" COEFFS 0 10 2731.4 0 0 1 /end COMPU_METHOD
/begin COMPU_METHOD TimeDelay_s "" RAT_FUNC "%6.1" "s" COEFFS 0 0 1 0 0.00023283064365387 0 /end COMPU_METHOD
/begin COMPU_METHOD Time_ms "" RAT_FUNC "%6.1" "ms" COEFFS 0 0.1 0 0 0 1 /end COMPU_METHOD
/begin COMPU_METHOD Volt "" RAT_FUNC "%6.3" "mV" COEFFS 0 5 0 0 0 1 /end COMPU_METHOD
/begin RECORD_LAYOUT DefaultValueRecordLayout_AUTOSAR_Platform_BaseTypes_uint8 FNC_VALUES 1 UBYTE COLUMN_DIR DIRECT STATIC_ADDRESS_OFFSETS /end RECORD_LAYOUT
/begin RECORD_LAYOUT Kw_Wr32 FNC_VALUES 1 FLOAT32_IEEE COLUMN_DIR DIRECT /end RECORD_LAYOUT
/begin RECORD_LAYOUT Kw_Wu8 FNC_VALUES 1 UBYTE COLUMN_DIR DIRECT /end RECORD_LAYOUT
/begin RECORD_LAYOUT RB_Curve_R32_R32_sao NO_AXIS_PTS_X 1 ULONG AXIS_PTS_X 2 FLOAT32_IEEE INDEX_INCR DIRECT FNC_VALUES 3 FLOAT32_IEEE COLUMN_DIR DIRECT STATIC_ADDRESS_OFFSETS /end RECORD_LAYOUT
/begin RECORD_LAYOUT RB_Curve_S16_S32_sao NO_AXIS_PTS_X 1 SWORD AXIS_PTS_X 2 SWORD INDEX_INCR DIRECT FNC_VALUES 3 SLONG COLUMN_DIR DIRECT STATIC_ADDRESS_OFFSETS /end RECORD_LAYOUT
/begin RECORD_LAYOUT RB_Map_S16S16_R32_sao NO_AXIS_PTS_X 1 SWORD NO_AXIS_PTS_Y 2 SWORD AXIS_PTS_X 3 SWORD INDEX_INCR DIRECT AXIS_PTS_Y 4 SWORD INDEX_INCR DIRECT FNC_VALUES 5 FLOAT32_IEEE COLUMN_DIR DIRECT STATIC_ADDRESS_OFFSETS /end RECORD_LAYOUT
/begin RECORD_LAYOUT RB_Map_S16S16_U8_sao NO_AXIS_PTS_X 1 SWORD NO_AXIS_PTS_Y 2 SWORD AXIS_PTS_X 3 SWORD INDEX_INCR DIRECT AXIS_PTS_Y 4 SWORD INDEX_INCR DIRECT FNC_VALUES 5 UBYTE COLUMN_DIR DIRECT STATIC_ADDRESS_OFFSETS /end RECORD_LAYOUT
/begin RECORD_LAYOUT RB_Val_Ws16 FNC_VALUES 1 SWORD COLUMN_DIR DIRECT /end RECORD_LAYOUT
/begin RECORD_LAYOUT RB_Val_Ws32 FNC_VALUES 1 SLONG COLUMN_DIR DIRECT /end RECORD_LAYOUT
/begin RECORD_LAYOUT RB_Val_Wu8 FNC_VALUES 1 UBYTE COLUMN_DIR DIRECT /end RECORD_LAYOUT
/begin RECORD_LAYOUT Val_Wr32 FNC_VALUES 1 FLOAT32_IEEE COLUMN_DIR DIRECT /end RECORD_LAYOUT
/begin RECORD_LAYOUT Val_Ws16 FNC_VALUES 1 SWORD COLUMN_DIR DIRECT /end RECORD_LAYOUT
/begin RECORD_LAYOUT Val_Ws32 FNC_VALUES 1 SLONG COLUMN_DIR DIRECT /end RECORD_LAYOUT
/begin RECORD_LAYOUT Val_Wu16 FNC_VALUES 1 UWORD COLUMN_DIR DIRECT /end RECORD_LAYOUT
/begin RECORD_LAYOUT Val_Wu32 FNC_VALUES 1 ULONG COLUMN_DIR DIRECT /end RECORD_LAYOUT
/begin RECORD_LAYOUT Val_Wu8 FNC_VALUES 1 UBYTE COLUMN_DIR DIRECT /end RECORD_LAYOUT
/*********** Start of merged UNIT blocks ***********/
/begin UNIT RB_RBA_Common_CentralElements_Units_NoUnit "No Unit" "noUnit" EXTENDED_SI SI_EXPONENTS 0 0 0 0 0 0 0 /end UNIT
/begin UNIT AUTOSAR_CanSM_Units_NoUnit "No Unit" "noUnit" EXTENDED_SI SI_EXPONENTS 0 0 0 0 0 0 0 /end UNIT
/begin UNIT AUTOSAR_Lin_Units_NoUnit "No Unit" "noUnit" EXTENDED_SI SI_EXPONENTS 0 0 0 0 0 0 0 /end UNIT
/begin UNIT AUTOSAR_LinSM_Units_NoUnit "No Unit" "noUnit" EXTENDED_SI SI_EXPONENTS 0 0 0 0 0 0 0 /end UNIT
/begin UNIT RB_RBA_rba_IoDiagHlfBr_Units_NoUnit "No Unit" "noUnit" EXTENDED_SI SI_EXPONENTS 0 0 0 0 0 0 0 /end UNIT
/begin UNIT RB_RBA_rba_SyC_Rtc_Units_NoUnit "No Unit" "nounit" EXTENDED_SI SI_EXPONENTS 0 0 0 0 0 0 0 /end UNIT
/end MODULE
/end PROJECT

ASAP2_VERSION 1 70
/begin PROJECT MDG1C "VC1CP091_STLA_N_D061I3"
/begin HEADER "" VERSION "VC1CP091_STLA_N_D061I3" PROJECT_NO MDG1C /end HEADER
/begin MODULE DIM ""
/begin MOD_COMMON "" BYTE_ORDER MSB_LAST ALIGNMENT_BYTE 1 ALIGNMENT_WORD 2 ALIGNMENT_LONG 4 ALIGNMENT_INT64 4 ALIGNMENT_FLOAT32_IEEE 4 ALIGNMENT_FLOAT64_IEEE 4 DATA_SIZE 32 /end MOD_COMMON
/begin CHARACTERISTIC Afts_tiDlyLgTout_C "Necessary long delay between the routine starting and the function return flow" VALUE 0x80250308 RB_Val_Wu8 4000. Time_msec_q100_COMPU 0.00 4000. FORMAT "%5.0" EXTENDED_LIMITS 0.00 25500. /end CHARACTERISTIC
/begin CHARACTERISTIC Afts_tiDlyShoTout_C "Maximum Calibration Value of the Timer for the Customer Actuator test routines." VALUE 0x80250309 RB_Val_Wu8 2000. Time_msec_q100_COMPU 0.00 2000. FORMAT "%5.0" EXTENDED_LIMITS 0.00 25500. /end CHARACTERISTIC
/begin CHARACTERISTIC Dcdc_maskErrorSq_C "mask for signal quality for setting failures" VALUE 0x8025027C RB_Val_Wu16 65535.00 OneToOne 0.00 65535.00 FORMAT "%8.2" /end CHARACTERISTIC
/begin CHARACTERISTIC Dcdc_maskPwrDcdcOutpSq_C "Dcdc output power masking calibration" VALUE 0x8025027E RB_Val_Wu16 65535.00 OneToOne 0.00 65535.00 FORMAT "%8.2" /end CHARACTERISTIC
/begin CHARACTERISTIC Dcdc_maskT30ErrorSq_C "Mask for T30C communication error" VALUE 0x80250280 RB_Val_Wu16 65535.00 OneToOne 0.00 65535.00 FORMAT "%8.2" /end CHARACTERISTIC
/begin CHARACTERISTIC Dcdc_OperVd_Class01_I.iLimHvGrid_C "Class Instance Primary Dcdc / Parameter to calibrate the maximum allowed current on the HV side of Dcdc converter" VALUE 0x8025028C RB_Val_Ws16 2047.969 Curr_A_q0p03125_COMPU -1024.000 1023.969 FORMAT "%8.3" /end CHARACTERISTIC
/begin CHARACTERISTIC Dcdc_OperVd_Class01_I.iLimLvGridTSoc_M "Class Instance Primary Dcdc / Class Instance Primary Dcdc Map to calibrate the maximum allowed current on the HV side of Dcdc converter based on LV battery temperature and State of Charge" MAP 0x8025028E RB_Map_S16U8_S16_sao 2047.969 Curr_A_q0p03125_COMPU -1024.000 1023.969 FORMAT "%8.3"
 /begin AXIS_DESCR STD_AXIS NO_INPUT_QUANTITY Temp_Cels 6 -3549.940 3003.560 FORMAT "%8.3" DEPOSIT ABSOLUTE /end AXIS_DESCR
 /begin AXIS_DESCR STD_AXIS NO_INPUT_QUANTITY rel_q1 6 0.00 255.0 FORMAT "%5.1" DEPOSIT ABSOLUTE /end AXIS_DESCR
/end CHARACTERISTIC
/begin CHARACTERISTIC Dcdc_OperVd_Class01_I.iLimLvGrid_C "Class Instance Primary Dcdc / Parameter to calibrate the maximum allowed current on the LV side of Dcdc converter" VALUE 0x802502EC RB_Val_Ws16 2047.969 Curr_A_q0p03125_COMPU -1024.000 1023.969 FORMAT "%8.3" /end CHARACTERISTIC
/begin CHARACTERISTIC Dcdc_OperVd_Class01_I.stActvDchaAct_T "Class Instance Primary Dcdc / Calibration Parameter of Active Discharge Status" CURVE 0x802502EE RB_Curve_U8_U8 255.0 OneToOne 0.00 255.0 FORMAT "%5.1"
 /begin AXIS_DESCR STD_AXIS NO_INPUT_QUANTITY OneToOne 8 0.00 255.0 FORMAT "%5.1" DEPOSIT ABSOLUTE /end AXIS_DESCR
/end CHARACTERISTIC
/begin CHARACTERISTIC Dcdc_OperVd_Class01_I.uDesHvGrid_C "Class Instance Primary Dcdc / Parameter to calibrate the desired voltage on the HV side of DCDC converter" VALUE 0x80250300 RB_Val_Ws16 2047.969 Volt_V_q0p03125_COMPU -1024.000 1023.969 FORMAT "%8.3" /end CHARACTERISTIC
/begin CHARACTERISTIC Dcdc_ThermVd_Class01_I.tActFlt_C "Primary Dcdc Instance / Calibration for actual temperature fault" VALUE 0x80250304 RB_Val_Ws16 6553.500 Temp_Cels -3549.940 3003.560 FORMAT "%8.3" /end CHARACTERISTIC
/begin CHARACTERISTIC Dcdc_ThermVd_Class01_I.tActIni_C "Primary Dcdc Instance / Calibration for actual temperature initialization" VALUE 0x80250306 RB_Val_Ws16 6553.500 Temp_Cels -3549.940 3003.560 FORMAT "%8.3" /end CHARACTERISTIC
/begin CHARACTERISTIC Dcdc_tiThdT30CErr_C "T30C error debounce time" VALUE 0x80250282 RB_Val_Wu16 655.3500 Time_s 0.00 655.3500 FORMAT "%8.4" /end CHARACTERISTIC
/begin CHARACTERISTIC Dcdc_vThdT30CErr_C "30C error vehicle speed threshold" VALUE 0x80250284 RB_Val_Ws16 655.3500 Vel -327.6800 327.6700 FORMAT "%8.4" /end CHARACTERISTIC
/begin CHARACTERISTIC DcmAppl_MSRConf_ATS.DcChrgnRlyNeg_Profile_C "Labels for the configuration of a MSR Routine / profile configuration for the Fast Charge Contactor actuation routine" VALUE 0x8025ED38 Val_Wu8 255.0 OneToOne 0.00 255.0 FORMAT "%5.1" /end CHARACTERISTIC
/begin CHARACTERISTIC DcmAppl_MSRConf_ATS.DcChrgnRlyPos_Profile_C "Labels for the configuration of a MSR Routine / profile configuration for the Fast Charge Contactor actuation routine" VALUE 0x8025ED39 Val_Wu8 255.0 OneToOne 0.00 255.0 FORMAT "%5.1" /end CHARACTERISTIC
/begin CHARACTERISTIC DcmAppl_MSRConf_ATS.IntlckChrgPlg_Profile_C "Labels for the configuration of a MSR Routine / profile configuration for the charge port actuator control routine" VALUE 0x8025ED3A Val_Wu8 255.0 OneToOne 0.00 255.0 FORMAT "%5.1" /end CHARACTERISTIC
/begin CHARACTERISTIC DcmAppl_MSRConf_ATS.SCtPmp1_Profile_C "Labels for the configuration of a MSR Routine / profile configuration for the Coolant PUMP De-areation Routine" VALUE 0x8025ED3B Val_Wu8 255.0 OneToOne 0.00 255.0 FORMAT "%5.1" /end CHARACTERISTIC
/begin CHARACTERISTIC DcmAppl_MSR_ATS.numATSRtnMaxCyc_CA "Structure that defines the parameters for Actuators tested via routine profiles / maximum test cycles for a particular configuration" VAL_BLK 0x8025ED3C ValA_Wu8 255.0 OneToOne 0.00 255.0 FORMAT "%5.1" MATRIX_DIM 23 /end CHARACTERISTIC
/begin CHARACTERISTIC DcmAppl_MSR_ATS.ratATSRtnDCycOff_CA "Structure that defines the parameters for Actuators tested via routine profiles / intevention value during the OFF cycle" VAL_BLK 0x8025ED54 ValA_Wu16 65535.00 OneToOne 0.00 65535.00 FORMAT "%8.2" MATRIX_DIM 23 /end CHARACTERISTIC
/begin CHARACTERISTIC DcmAppl_MSR_ATS.ratATSRtnDCycOn_CA "Structure that defines the parameters for Actuators tested via routine profiles / intevention value during the ON cycle" VAL_BLK 0x8025ED82 ValA_Wu16 65535.00 OneToOne 0.00 65535.00 FORMAT "%8.2" MATRIX_DIM 23 /end CHARACTERISTIC
/begin CHARACTERISTIC DcmAppl_MSR_ATS.tiATSRtnOff_CA "Structure that defines the parameters for Actuators tested via routine profiles / OFF cycle time for a particular configuration" VAL_BLK 0x8025EDB0 ValA_Wu16 655350.0 Time_ms 0.00 655350.0 FORMAT "%8.1" MATRIX_DIM 23 /end CHARACTERISTIC
/begin CHARACTERISTIC DcmAppl_MSR_ATS.tiATSRtnOn_CA "Structure that defines the parameters for Actuators tested via routine profiles / ON cycle time for a particular configuration" VAL_BLK 0x8025EDDE ValA_Wu16 655340.0 Time_ms 10.0 655350.0 FORMAT "%8.1" EXTENDED_LIMITS 0.00 655350.0 MATRIX_DIM 23 /end CHARACTERISTIC
/begin CHARACTERISTIC DcmAppl_MSR_ATS.tiRampStep_CA "Structure that defines the parameters for Actuators tested via routine profiles / Duration of the step incase of Ramp Profile" VAL_BLK 0x8025EE0C ValA_Wu8 2540. Time_ms 10. 2550. FORMAT "%5.0" EXTENDED_LIMITS 0.00 2550. MATRIX_DIM 23 /end CHARACTERISTIC
/begin CHARACTERISTIC DcmAppl_Rc_tiMaxMSRDCDCVltCntrl_C "End Timer for DCDC Converter Output Voltage Control" VALUE 0x8025030A Val_Wu16 65535.00 Time_msec_q1_COMPU 0.00 65535.00 FORMAT "%8.2" /end CHARACTERISTIC
/begin CHARACTERISTIC DcmAppl_Rc_tiMaxMSRLrnRstStrt_C "Calibration for the threshold of the time for which DCM will wait for the MSR Learning Reset routines to start" VALUE 0x8025EE24 Val_Ws32 65535.0000000 Time_msec_q1_COMPU 0.00 65535.0000000 FORMAT "%13.7" EXTENDED_LIMITS -2147483648.00 2147483647.00 /end CHARACTERISTIC
/begin CHARACTERISTIC DcmAppl_Rc_tiMSRDCDCVltCntrl_C "Wait activation timer for DCDC Converter Output Voltage Control" VALUE 0x8025030C Val_Wu16 65535.00 Time_msec_q1_COMPU 0.00 65535.00 FORMAT "%8.2" /end CHARACTERISTIC
/begin CHARACTERISTIC DcmAppl_Rc_tiMSRHvbusActvDcha_C "Timer calibration for HVBUS Active Discharge" VALUE 0x8025030E Val_Wu16 655.3500 Time_s 0.00 655.3500 FORMAT "%8.4" /end CHARACTERISTIC
/begin CHARACTERISTIC DcmAppl_Rc_tiMSRIvtrOffsVal_C "Timer calibration for DF0A RC" VALUE 0x80250310 Val_Wu16 65535.00 Time_msec_q1_COMPU 0.00 65535.00 FORMAT "%8.2" /end CHARACTERISTIC
/begin CHARACTERISTIC DcmAppl_tiMaxWaitComCond_C "Maximum delay during which the DSL wait for the activation of the main wake-up state after having requested the RCD to force the transition on a tester request" VALUE 0x8025ED2C Val_Wu32 120.000000000 C126_Time_ms_q0p001_COMPU 60.000000000 180.000000000 FORMAT "%13.9" EXTENDED_LIMITS 0.00 4294967.29500 /end CHARACTERISTIC
/begin CHARACTERISTIC DcmAppl_uBattMax_C "Maximum authorized battery voltage which can be checked by the DSD before authorizing some UDS services" VALUE 0x8025ED30 Val_Ws16 8000.000 Volt_Batt 8000.00 16000.00 FORMAT "%8.2" EXTENDED_LIMITS -655360.0 655340.0 /end CHARACTERISTIC
/begin CHARACTERISTIC DcmAppl_uBattMin_C "Minimum authorized battery voltage which can be checked by the DSD before authorizing some UDS services" VALUE 0x8025ED32 Val_Ws16 8000.000 Volt_Batt 8000.00 16000.00 FORMAT "%8.2" EXTENDED_LIMITS -655360.0 655340.0 /end CHARACTERISTIC
/begin CHARACTERISTIC DcmAppl_vVehVMaxLim_C "Maximum authorized vehicle speed which may be checked by the DSD before authorizing some UDS services" VALUE 0x8025ED34 Val_Ws16 5.000000 Vel 0.00 5.000000 FORMAT "%8.6" EXTENDED_LIMITS -327.6800 327.6700 /end CHARACTERISTIC
/begin CHARACTERISTIC DcmDspUds_DcRly_IntvVal_C "Timer intervention value for DCDCrly" VALUE 0x8025EE28 Val_Ws16 65535.00 OneToOne -32768.00 32767.00 FORMAT "%8.2" /end CHARACTERISTIC
/begin CHARACTERISTIC DcmDspUds_SpplPmpRly_IntvVal_C "Timer intervention value for SpplPmpRly" VALUE 0x8025EE2A Val_Ws16 65535.00 OneToOne -32768.00 32767.00 FORMAT "%8.2" /end CHARACTERISTIC
/begin CHARACTERISTIC DcmDspUDS_uDCDCOpVoltMax_C "DCDC maximum threshold tester voltage value" VALUE 0x80250312 Val_Wu8 255.0 RBPtCel_u_1p0_1 0.00 255.0 FORMAT "%5.1" /end CHARACTERISTIC
/begin CHARACTERISTIC DcmDspUDS_uDCDCOpVoltMin_C "DCDC minimum threshold tester voltage value" VALUE 0x80250313 Val_Wu8 255.0 RBPtCel_u_1p0_1 0.00 255.0 FORMAT "%5.1" /end CHARACTERISTIC
/begin CHARACTERISTIC DDRC_DebArCtrBase.MyCtrBasedClass_2.isJmpDwnActv_C "" VALUE 0x80250160 RB_Val_Wu8 1.000 OneToOne 0.00 1.000 FORMAT "%5.3" EXTENDED_LIMITS 0.00 255.0 /end CHARACTERISTIC
/begin CHARACTERISTIC DDRC_DebArCtrBase.MyCtrBasedClass_2.isJmpUpActv_C "" VALUE 0x80250161 RB_Val_Wu8 1.000 OneToOne 0.00 1.000 FORMAT "%5.3" EXTENDED_LIMITS 0.00 255.0 /end CHARACTERISTIC
/begin CHARACTERISTIC DDRC_DebArCtrBase.MyCtrBasedClass_2.limPassd_C "" VALUE 0x80250162 RB_Val_Ws16 32767.00 OneToOne -32768.00 -1.00 FORMAT "%8.2" EXTENDED_LIMITS -32768.00 32767.00 /end CHARACTERISTIC
/begin CHARACTERISTIC DDRC_DebArCtrBase.MyCtrBasedClass_2.limFaild_C "" VALUE 0x80250164 RB_Val_Ws16 32766.00 OneToOne 1.00 32767.00 FORMAT "%8.2" EXTENDED_LIMITS -32768.00 32767.00 /end CHARACTERISTIC
/begin CHARACTERISTIC DDRC_DebArCtrBase.MyCtrBasedClass_2.jmpUpVal_C "" VALUE 0x80250166 RB_Val_Ws16 65535.00 OneToOne -32768.00 32767.00 FORMAT "%8.2" /end CHARACTERISTIC
/begin CHARACTERISTIC DDRC_DebArCtrBase.MyCtrBasedClass_2.jmpDwnVal_C "" VALUE 0x80250168 RB_Val_Ws16 65535.00 OneToOne -32768.00 32767.00 FORMAT "%8.2" /end CHARACTERISTIC
/begin CHARACTERISTIC DDRC_DebArCtrBase.MyCtrBasedClass_2.stepUp_C "" VALUE 0x8025016A RB_Val_Ws16 32766.00 OneToOne 1.00 32767.00 FORMAT "%8.2" EXTENDED_LIMITS -32768.00 32767.00 /end CHARACTERISTIC
/begin CHARACTERISTIC DDRC_DebArCtrBase.MyCtrBasedClass_2.stepDwn_C "" VALUE 0x8025016C RB_Val_Ws16 32767.00 OneToOne -32768.00 -1.00 FORMAT "%8.2" EXTENDED_LIMITS -32768.00 32767.00 /end CHARACTERISTIC
/begin CHARACTERISTIC DDRC_DebArCtrBase.MyCtrBasedClass_1.isJmpDwnActv_C "" VALUE 0x8025016E RB_Val_Wu8 1.000 OneToOne 0.00 1.000 FORMAT "%5.3" EXTENDED_LIMITS 0.00 255.0 /end CHARACTERISTIC
/begin CHARACTERISTIC DDRC_DebArCtrBase.MyCtrBasedClass_1.isJmpUpActv_C "" VALUE 0x8025016F RB_Val_Wu8 1.000 OneToOne 0.00 1.000 FORMAT "%5.3" EXTENDED_LIMITS 0.00 255.0 /end CHARACTERISTIC
/begin CHARACTERISTIC DDRC_DebArCtrBase.MyCtrBasedClass_1.limPassd_C "" VALUE 0x80250170 RB_Val_Ws16 32767.00 OneToOne -32768.00 -1.00 FORMAT "%8.2" EXTENDED_LIMITS -32768.00 32767.00 /end CHARACTERISTIC
/begin CHARACTERISTIC DDRC_DebArCtrBase.MyCtrBasedClass_1.limFaild_C "" VALUE 0x80250172 RB_Val_Ws16 32766.00 OneToOne 1.00 32767.00 FORMAT "%8.2" EXTENDED_LIMITS -32768.00 32767.00 /end CHARACTERISTIC
/begin CHARACTERISTIC DDRC_DebArCtrBase.MyCtrBasedClass_1.jmpUpVal_C "" VALUE 0x80250174 RB_Val_Ws16 65535.00 OneToOne -32768.00 32767.00 FORMAT "%8.2" /end CHARACTERISTIC
/begin CHARACTERISTIC DDRC_DebArCtrBase.MyCtrBasedClass_1.jmpDwnVal_C "" VALUE 0x80250176 RB_Val_Ws16 65535.00 OneToOne -32768.00 32767.00 FORMAT "%8.2" /end CHARACTERISTIC
/begin CHARACTERISTIC DDRC_DebArCtrBase.MyCtrBasedClass_1.stepUp_C "" VALUE 0x80250178 RB_Val_Ws16 32766.00 OneToOne 1.00 32767.00 FORMAT "%8.2" EXTENDED_LIMITS -32768.00 32767.00 /end CHARACTERISTIC
/begin CHARACTERISTIC DDRC_DebArCtrBase.MyCtrBasedClass_1.stepDwn_C "" VALUE 0x8025017A RB_Val_Ws16 32767.00 OneToOne -32768.00 -1.00 FORMAT "%8.2" EXTENDED_LIMITS -32768.00 32767.00 /end CHARACTERISTIC
/begin CHARACTERISTIC DDRC_DebArCtrBase.DemDebounceCounterBasedClass_standard.isJmpDwnActv_C "" VALUE 0x8025017C RB_Val_Wu8 1.000 OneToOne 0.00 1.000 FORMAT "%5.3" EXTENDED_LIMITS 0.00 255.0 /end CHARACTERISTIC
/begin CHARACTERISTIC DDRC_DebArCtrBase.DemDebounceCounterBasedClass_standard.isJmpUpActv_C "" VALUE 0x8025017D RB_Val_Wu8 1.000 OneToOne 0.00 1.000 FORMAT "%5.3" EXTENDED_LIMITS 0.00 255.0 /end CHARACTERISTIC
/begin CHARACTERISTIC DDRC_DebArCtrBase.DemDebounceCounterBasedClass_standard.limPassd_C "" VALUE 0x8025017E RB_Val_Ws16 32767.00 OneToOne -32768.00 -1.00 FORMAT "%8.2" EXTENDED_LIMITS -32768.00 32767.00 /end CHARACTERISTIC
/begin CHARACTERISTIC DDRC_DebArCtrBase.DemDebounceCounterBasedClass_standard.limFaild_C "" VALUE 0x80250180 RB_Val_Ws16 32766.00 OneToOne 1.00 32767.00 FORMAT "%8.2" EXTENDED_LIMITS -32768.00 32767.00 /end CHARACTERISTIC
/begin CHARACTERISTIC DDRC_DebArCtrBase.DemDebounceCounterBasedClass_standard.jmpUpVal_C "" VALUE 0x80250182 RB_Val_Ws16 65535.00 OneToOne -32768.00 32767.00 FORMAT "%8.2" /end CHARACTERISTIC
/begin CHARACTERISTIC DDRC_DebArCtrBase.DemDebounceCounterBasedClass_standard.jmpDwnVal_C "" VALUE 0x80250184 RB_Val_Ws16 65535.00 OneToOne -32768.00 32767.00 FORMAT "%8.2" /end CHARACTERISTIC
/begin CHARACTERISTIC DDRC_DebArCtrBase.DemDebounceCounterBasedClass_standard.stepUp_C "" VALUE 0x80250186 RB_Val_Ws16 32766.00 OneToOne 1.00 32767.00 FORMAT "%8.2" EXTENDED_LIMITS -32768.00 32767.00 /end CHARACTERISTIC
/begin CHARACTERISTIC DDRC_DebArCtrBase.DemDebounceCounterBasedClass_standard.stepDwn_C "" VALUE 0x80250188 RB_Val_Ws16 32767.00 OneToOne -32768.00 -1.00 FORMAT "%8.2" EXTENDED_LIMITS -32768.00 32767.00 /end CHARACTERISTIC
/begin CHARACTERISTIC DDRC_DebArCtrBase.DemDebounceCounterBasedClass_EcuCtrl.isJmpDwnActv_C "" VALUE 0x8025018A RB_Val_Wu8 1.000 OneToOne 0.00 1.000 FORMAT "%5.3" EXTENDED_LIMITS 0.00 255.0 /end CHARACTERISTIC
/begin CHARACTERISTIC DDRC_DebArCtrBase.DemDebounceCounterBasedClass_EcuCtrl.isJmpUpActv_C "" VALUE 0x8025018B RB_Val_Wu8 1.000 OneToOne 0.00 1.000 FORMAT "%5.3" EXTENDED_LIMITS 0.00 255.0 /end CHARACTERISTIC
/begin CHARACTERISTIC DDRC_DebArCtrBase.DemDebounceCounterBasedClass_EcuCtrl.limPassd_C "" VALUE 0x8025018C RB_Val_Ws16 32767.00 OneToOne -32768.00 -1.00 FORMAT "%8.2" EXTENDED_LIMITS -32768.00 32767.00 /end CHARACTERISTIC
/begin CHARACTERISTIC DDRC_DebArCtrBase.DemDebounceCounterBasedClass_EcuCtrl.limFaild_C "" VALUE 0x8025018E RB_Val_Ws16 32766.00 OneToOne 1.00 32767.00 FORMAT "%8.2" EXTENDED_LIMITS -32768.00 32767.00 /end CHARACTERISTIC
/begin CHARACTERISTIC DDRC_DebArCtrBase.DemDebounceCounterBasedClass_EcuCtrl.jmpUpVal_C "" VALUE 0x80250190 RB_Val_Ws16 65535.00 OneToOne -32768.00 32767.00 FORMAT "%8.2" /end CHARACTERISTIC
/begin CHARACTERISTIC DDRC_DebArCtrBase.DemDebounceCounterBasedClass_EcuCtrl.jmpDwnVal_C "" VALUE 0x80250192 RB_Val_Ws16 65535.00 OneToOne -32768.00 32767.00 FORMAT "%8.2" /end CHARACTERISTIC
/begin CHARACTERISTIC DDRC_DebArCtrBase.DemDebounceCounterBasedClass_EcuCtrl.stepUp_C "" VALUE 0x80250194 RB_Val_Ws16 32766.00 OneToOne 1.00 32767.00 FORMAT "%8.2" EXTENDED_LIMITS -32768.00 32767.00 /end CHARACTERISTIC
/begin CHARACTERISTIC DDRC_DebArCtrBase.DemDebounceCounterBasedClass_EcuCtrl.stepDwn_C "" VALUE 0x80250196 RB_Val_Ws16 32767.00 OneToOne -32768.00 -1.00 FORMAT "%8.2" EXTENDED_LIMITS -32768.00 32767.00 /end CHARACTERISTIC
/begin CHARACTERISTIC DDRC_DurDeb.Dcdc_tiFwdModStuckDebOk_C "" VALUE 0x80240CD8 Val_Wu16 655350.0 DDRCTime_ms 0.00 655350.0 FORMAT "%8.1" /end CHARACTERISTIC
/begin CHARACTERISTIC DDRC_DurDeb.Dcdc_tiFwdModStuckDebDef_C "" VALUE 0x80240CDA Val_Wu16 655350.0 DDRCTime_ms 0.00 655350.0 FORMAT "%8.1" /end CHARACTERISTIC
/begin CHARACTERISTIC DDRC_DurDeb.Dcdc_tiOffModStuckDebOk_C "" VALUE 0x80240CE0 Val_Wu16 655350.0 DDRCTime_ms 0.00 655350.0 FORMAT "%8.1" /end CHARACTERISTIC
/begin CHARACTERISTIC DDRC_DurDeb.Dcdc_tiOffModStuckDebDef_C "" VALUE 0x80240CE2 Val_Wu16 655350.0 DDRCTime_ms 0.00 655350.0 FORMAT "%8.1" /end CHARACTERISTIC
/begin CHARACTERISTIC DDRC_DurDeb.Dcdc_tiOperModFailrDebOk_C "" VALUE 0x80240CE4 Val_Wu16 655350.0 DDRCTime_ms 0.00 655350.0 FORMAT "%8.1" /end CHARACTERISTIC
/begin CHARACTERISTIC DDRC_DurDeb.Dcdc_tiOperModFailrDebDef_C "" VALUE 0x80240CE6 Val_Wu16 655350.0 DDRCTime_ms 0.00 655350.0 FORMAT "%8.1" /end CHARACTERISTIC
/begin CHARACTERISTIC DDRC_DurDeb.Dcdc_tiPrecModStuckDebOk_C "" VALUE 0x80240CE8 Val_Wu16 655350.0 DDRCTime_ms 0.00 655350.0 FORMAT "%8.1" /end CHARACTERISTIC
/begin CHARACTERISTIC DDRC_DurDeb.Dcdc_tiPrecModStuckDebDef_C "" VALUE 0x80240CEA Val_Wu16 655350.0 DDRCTime_ms 0.00 655350.0 FORMAT "%8.1" /end CHARACTERISTIC
/begin CHARACTERISTIC Dem_xCalEvtListTrg_C "calibration to trigger the recalculation of Event-DTCl list" VALUE 0x8024E6DC Val_Wu8 255.0 OneToOne 0.00 255.0 FORMAT "%5.1" /end CHARACTERISTIC
/begin CHARACTERISTIC DevLib_DigOutDbgSig_C "Calibration parameter to select the Digital out signal for which the debugging information is to be updated into the measuring points" VALUE 0x8025EE2C Val_Wu16 65535.00 OneToOne 0.00 65535.00 FORMAT "%8.2" /end CHARACTERISTIC
/begin CHARACTERISTIC DevLib_PWMOutDbgSig_C "Calibration parameter to select the PWM out signal for which the debugging information is to be updated into the measuring points" VALUE 0x8025EE2E Val_Wu16 65535.00 OneToOne 0.00 65535.00 FORMAT "%8.2" /end CHARACTERISTIC
/begin CHARACTERISTIC DFC_CtlMsk2.DFC_DcdcFwdModStuck_C "" VALUE 0x80241359 Val_Wu8 255.0 DFES_OneToOne 0.00 255.0 FORMAT "%5.1" /end CHARACTERISTIC
/begin CHARACTERISTIC DFC_CtlMsk2.DFC_DcdcOffModStuck_C "" VALUE 0x8024135B Val_Wu8 255.0 DFES_OneToOne 0.00 255.0 FORMAT "%5.1" /end CHARACTERISTIC
/begin CHARACTERISTIC DFC_CtlMsk2.DFC_DcdcOperModFailr_C "" VALUE 0x8024135C Val_Wu8 255.0 DFES_OneToOne 0.00 255.0 FORMAT "%5.1" /end CHARACTERISTIC
/begin CHARACTERISTIC DFC_CtlMsk2.DFC_DcdcPrecModStuck_C "" VALUE 0x8024135D Val_Wu8 255.0 DFES_OneToOne 0.00 255.0 FORMAT "%5.1" /end CHARACTERISTIC
/begin CHARACTERISTIC DFC_CtlMsk2.DFC_ExpPwrLatch_C "" VALUE 0x8024159B Val_Wu8 255.0 DFES_OneToOne 0.00 255.0 FORMAT "%5.1" /end CHARACTERISTIC
/begin CHARACTERISTIC DFC_CtlMsk2.DFC_InvBinID_C "" VALUE 0x802415FE Val_Wu8 255.0 DFES_OneToOne 0.00 255.0 FORMAT "%5.1" /end CHARACTERISTIC
/begin CHARACTERISTIC DFC_CtlMsk2.DFC_InvCalID_C "" VALUE 0x802415FF Val_Wu8 255.0 DFES_OneToOne 0.00 255.0 FORMAT "%5.1" /end CHARACTERISTIC
/begin CHARACTERISTIC DFC_CtlMsk2.DFC_InvErotan_C "" VALUE 0x80241600 Val_Wu8 255.0 DFES_OneToOne 0.00 255.0 FORMAT "%5.1" /end CHARACTERISTIC
/begin CHARACTERISTIC DFC_CtlMsk2.DFC_InvVinID_C "" VALUE 0x80241601 Val_Wu8 255.0 DFES_OneToOne 0.00 255.0 FORMAT "%5.1" /end CHARACTERISTIC
/begin CHARACTERISTIC DFC_DisblMsk2.DFC_DcdcFwdModStuck_C "" VALUE 0x80248B98 Val_Wu16 65535.00 DFES_OneToOne 0.00 65535.00 FORMAT "%8.2" /end CHARACTERISTIC
/begin CHARACTERISTIC DFC_DisblMsk2.DFC_DcdcOffModStuck_C "" VALUE 0x80248B9C Val_Wu16 65535.00 DFES_OneToOne 0.00 65535.00 FORMAT "%8.2" /end CHARACTERISTIC
/begin CHARACTERISTIC DFC_DisblMsk2.DFC_DcdcOperModFailr_C "" VALUE 0x80248B9E Val_Wu16 65535.00 DFES_OneToOne 0.00 65535.00 FORMAT "%8.2" /end CHARACTERISTIC
/begin CHARACTERISTIC DFC_DisblMsk2.DFC_DcdcPrecModStuck_C "" VALUE 0x80248BA0 Val_Wu16 65535.00 DFES_OneToOne 0.00 65535.00 FORMAT "%8.2" /end CHARACTERISTIC
/begin CHARACTERISTIC DFC_DisblMsk2.DFC_ExpPwrLatch_C "" VALUE 0x8024901C Val_Wu16 65535.00 DFES_OneToOne 0.00 65535.00 FORMAT "%8.2" /end CHARACTERISTIC
/begin CHARACTERISTIC DFC_DisblMsk2.DFC_InvBinID_C "" VALUE 0x802490E2 Val_Wu16 65535.00 DFES_OneToOne 0.00 65535.00 FORMAT "%8.2" /end CHARACTERISTIC
/begin CHARACTERISTIC DFC_DisblMsk2.DFC_InvCalID_C "" VALUE 0x802490E4 Val_Wu16 65535.00 DFES_OneToOne 0.00 65535.00 FORMAT "%8.2" /end CHARACTERISTIC
/begin CHARACTERISTIC DFC_DisblMsk2.DFC_InvErotan_C "" VALUE 0x802490E6 Val_Wu16 65535.00 DFES_OneToOne 0.00 65535.00 FORMAT "%8.2" /end CHARACTERISTIC
/begin CHARACTERISTIC DFC_DisblMsk2.DFC_InvVinID_C "" VALUE 0x802490E8 Val_Wu16 65535.00 DFES_OneToOne 0.00 65535.00 FORMAT "%8.2" /end CHARACTERISTIC
/begin CHARACTERISTIC NDECJ "Engine speed threshold for power stage diagnosis" VALUE 0x80252E68 KwWU8 10200. EngN_LRes 0.00 10200. FORMAT "%5.0" /end CHARACTERISTIC
/begin CHARACTERISTIC UBCJMN "Min. Ubat-threshold for release of the power stage diagnosis" VALUE 0x80252E6A KwWU16 15000.00 Volt_Batt 0.00 15000.00 FORMAT "%8.2" EXTENDED_LIMITS 0.00 1310700. /end CHARACTERISTIC
/begin CHARACTERISTIC UBCJMX "Max. Ubat-threshold f. release of the BSP 752 R-power stage diagnosis" VALUE 0x80252E6C KwWU16 25500.00 Volt_Batt 0.00 25500.00 FORMAT "%8.2" EXTENDED_LIMITS 0.00 1310700. /end CHARACTERISTIC
/begin MEASUREMENT Afts_bAcvModAfts "Aftersale mode activation flow" UBYTE B_TRUE 1 100 0.00 1.00000000000 BIT_MASK 0x1 FORMAT "%13.11" ECU_ADDRESS 0x600234E9
 /begin IF_DATA XCPplus 0x0102
  /begin DAQ_EVENT VARIABLE /end DAQ_EVENT
 /end IF_DATA
/end MEASUREMENT
/begin MEASUREMENT Afts_bEngCtlDiagRun "State in which is the CMM screw - screw dune session of diagnosis" UBYTE B_TRUE 1 100 0.00 1.00000000000 BIT_MASK 0x1 FORMAT "%13.11" ECU_ADDRESS 0x600234E8
 /begin IF_DATA XCPplus 0x0102
  /begin DAQ_EVENT VARIABLE /end DAQ_EVENT
 /end IF_DATA
/end MEASUREMENT
/begin MEASUREMENT B_deseehr_msg "Diagnosis power stage after the main Relay: entry conditions fulfilled" UBYTE B_TRUE 1 100 0.00 1.00000000000 BIT_MASK 0x1 FORMAT "%13.11" ECU_ADDRESS 0x7000025F
 /begin IF_DATA XCPplus 0x0102
  /begin DAQ_EVENT VARIABLE /end DAQ_EVENT
 /end IF_DATA
/end MEASUREMENT
/begin MEASUREMENT B_desee_msg "Diagnosis power stages, entry conditions fulfilled" UBYTE B_TRUE 1 100 0.00 1.00000000000 BIT_MASK 0x1 FORMAT "%13.11" ECU_ADDRESS 0x70000260
 /begin IF_DATA XCPplus 0x0102
  /begin DAQ_EVENT VARIABLE /end DAQ_EVENT
 /end IF_DATA
/end MEASUREMENT
/begin MEASUREMENT B_PmdInit_msg "Reset of standard powerstage diagnosis required" UBYTE B_TRUE 1 100 0.00 1.00000000000 BIT_MASK 0x1 FORMAT "%13.11" ECU_ADDRESS 0x70000262
 /begin IF_DATA XCPplus 0x0102
  /begin DAQ_EVENT VARIABLE /end DAQ_EVENT
 /end IF_DATA
/end MEASUREMENT
/begin MEASUREMENT Dcdc_iLimHvGrid "COM interface desired HV current limit" SWORD Curr_A_q0p03125_COMPU 1 100 -1024.000 1023.969 FORMAT "%8.3" ECU_ADDRESS 0x6001FBA0
 /begin IF_DATA XCPplus 0x0102
  /begin DAQ_EVENT VARIABLE /end DAQ_EVENT
 /end IF_DATA
/end MEASUREMENT
/begin MEASUREMENT Dcdc_iLimLvGrid "COM interface DCDC current limit on LV side" SWORD Curr_A_q0p03125_COMPU 1 100 -1024.000 1023.969 FORMAT "%8.3" ECU_ADDRESS 0x6001FB9E
 /begin IF_DATA XCPplus 0x0102
  /begin DAQ_EVENT VARIABLE /end DAQ_EVENT
 /end IF_DATA
/end MEASUREMENT
/begin MEASUREMENT Dcdc_OperVd_Class01_I.T30CTonD_I.XOld "Class Instance Primary Dcdc / T30C Turn On Delay / old input value from previous call" UBYTE B_TRUE 1 100 0.00 1.00000000000 BIT_MASK 0x1 FORMAT "%13.11" ECU_ADDRESS 0x7000130C /end MEASUREMENT
/begin MEASUREMENT Dcdc_OperVd_Class01_I.T30CTonD_I.Timer "Class Instance Primary Dcdc / T30C Turn On Delay / Timer for internal state" SLONG OneToOne 1 100 -2147483648.00 2147483647.00 FORMAT "%13.2" ECU_ADDRESS 0x70001310 /end MEASUREMENT
/begin MEASUREMENT Dcdc_stDesDcdc "Desired operating mode of the DCDC converter." UBYTE OneToOne 1 100 0.00 255.0 FORMAT "%5.1" ECU_ADDRESS 0x600235C4
 /begin IF_DATA XCPplus 0x0102
  /begin DAQ_EVENT VARIABLE /end DAQ_EVENT
 /end IF_DATA
/end MEASUREMENT
/begin MEASUREMENT Dcdc_stEem "HV-State of DCDC converter for handshake with EEM (Electric Energy Management)" UBYTE OneToOne 1 100 0.00 255.0 FORMAT "%5.1" ECU_ADDRESS 0x600235C3
 /begin IF_DATA XCPplus 0x0102
  /begin DAQ_EVENT VARIABLE /end DAQ_EVENT
 /end IF_DATA
/end MEASUREMENT
/begin MEASUREMENT Dcdc_stOperModAct "Actual operating mode of the DCDC converter." UBYTE OneToOne 1 100 0.00 255.0 FORMAT "%5.1" ECU_ADDRESS 0x600235C2
 /begin IF_DATA XCPplus 0x0102
  /begin DAQ_EVENT VARIABLE /end DAQ_EVENT
 /end IF_DATA
/end MEASUREMENT
/begin MEASUREMENT Dcdc_stOperModAct_Sq "SQ for DCDC_stOperModAct" UBYTE SigQly_COMPU_VERB 1 100 0.00 15.0000000000 FORMAT "%13.10" ECU_ADDRESS 0x600235C1
 /begin IF_DATA XCPplus 0x0102
  /begin DAQ_EVENT VARIABLE /end DAQ_EVENT
 /end IF_DATA
/end MEASUREMENT
/begin MEASUREMENT Dcdc_stT15 "T15 Status for DCDC" UBYTE B_TRUE 1 100 0.00 1.00000000000 BIT_MASK 0x1 FORMAT "%13.11" ECU_ADDRESS 0x70000283
 /begin IF_DATA XCPplus 0x0102
  /begin DAQ_EVENT VARIABLE /end DAQ_EVENT
 /end IF_DATA
/end MEASUREMENT
/begin MEASUREMENT Dcdc_tAct "Temperature of DcDc-converter." SWORD Temp_Cels 1 100 -3549.940 3003.560 FORMAT "%8.3" ECU_ADDRESS 0x6001FB96
 /begin IF_DATA XCPplus 0x0102
  /begin DAQ_EVENT VARIABLE /end DAQ_EVENT
 /end IF_DATA
/end MEASUREMENT
/begin MEASUREMENT Dcdc_tAct_Sq "Signal quality of the Temperature of the DCDC converter" UBYTE SigQly_COMPU_VERB 1 100 0.00 15.0000000000 FORMAT "%13.10" ECU_ADDRESS 0x600235C0
 /begin IF_DATA XCPplus 0x0102
  /begin DAQ_EVENT VARIABLE /end DAQ_EVENT
 /end IF_DATA
/end MEASUREMENT
/begin MEASUREMENT Dcdc_tInCoolt "Inlet coolant temperature of DcDc" SWORD Temp_Cels 1 100 -3549.940 3003.560 FORMAT "%8.3" ECU_ADDRESS 0x6001FB94
 /begin IF_DATA XCPplus 0x0102
  /begin DAQ_EVENT VARIABLE /end DAQ_EVENT
 /end IF_DATA
/end MEASUREMENT
/begin MEASUREMENT Dcdc_tInCoolt_Sq "Temperature of dcdc coolant inlet signal quality" UBYTE SigQly_COMPU_VERB 1 100 0.00 15.0000000000 FORMAT "%13.10" ECU_ADDRESS 0x600235BF
 /begin IF_DATA XCPplus 0x0102
  /begin DAQ_EVENT VARIABLE /end DAQ_EVENT
 /end IF_DATA
/end MEASUREMENT
/begin MEASUREMENT Dcdc_uDesHvGrid "Desired voltage set point on HV side of the DCDC converter" SWORD Volt_V_q0p03125_COMPU 1 100 -1024.000 1023.969 FORMAT "%8.3" ECU_ADDRESS 0x6001FB92
 /begin IF_DATA XCPplus 0x0102
  /begin DAQ_EVENT VARIABLE /end DAQ_EVENT
 /end IF_DATA
/end MEASUREMENT
/begin MEASUREMENT Dcdc_uDesLvGrid "Desired voltage set point on LV side of the DCDC converter." SWORD spg_q0p0039 1 100 -128.0000 127.9961 FORMAT "%8.4" ECU_ADDRESS 0x6001FB90
 /begin IF_DATA XCPplus 0x0102
  /begin DAQ_EVENT VARIABLE /end DAQ_EVENT
 /end IF_DATA
/end MEASUREMENT
/begin MEASUREMENT DcmAppl_bDiagToolReq "Request from diagnosis tool" UBYTE OneToOne 1 100 0.00 255.0 BIT_MASK 0x1 FORMAT "%5.1" ECU_ADDRESS 0x600234A7
 /begin IF_DATA XCPplus 0x0102
  /begin DAQ_EVENT VARIABLE /end DAQ_EVENT
 /end IF_DATA
/end MEASUREMENT
/begin MEASUREMENT DcmAppl_bDiagToolRly "DCM request to close the actuator relay" UBYTE B_TRUE 1 100 0.00 1.00000000000 BIT_MASK 0x1 FORMAT "%13.11" ECU_ADDRESS 0x600234A6
 /begin IF_DATA XCPplus 0x0102
  /begin DAQ_EVENT VARIABLE /end DAQ_EVENT
 /end IF_DATA
/end MEASUREMENT
/begin MEASUREMENT DcmAppl_stChkComCond_b_msg "Message to Monitor the communication conditions in process DcmAppl_Proc_10ms" UBYTE B_TRUE 1 100 0.00 1.00000000000 BIT_MASK 0x1 FORMAT "%13.11" ECU_ADDRESS 0x70000255
 /begin IF_DATA XCPplus 0x0102
  /begin DAQ_EVENT VARIABLE /end DAQ_EVENT
 /end IF_DATA
/end MEASUREMENT
/begin MEASUREMENT DcmAppl_StCondn_mp "Measuremnet point to check the access conditions" UWORD rel_q0p1 1 100 0.00 6553.500 FORMAT "%8.3" ECU_ADDRESS 0x70006B36 /end MEASUREMENT
/begin MEASUREMENT DcmDspUDS_bDCDCOpVoltFlg "Tester flag to indicate DCDC voltage control" UBYTE B_TRUE 1 100 0.00 1.00000000000 BIT_MASK 0x1 FORMAT "%13.11" ECU_ADDRESS 0x70001495
 /begin IF_DATA XCPplus 0x0102
  /begin DAQ_EVENT VARIABLE /end DAQ_EVENT
 /end IF_DATA
/end MEASUREMENT
/begin MEASUREMENT DcmDspUDS_bHvbusDchaFlg "Flag to indicate Hv bus discharge" UBYTE B_TRUE 1 100 0.00 1.00000000000 BIT_MASK 0x1 FORMAT "%13.11" ECU_ADDRESS 0x70001494
 /begin IF_DATA XCPplus 0x0102
  /begin DAQ_EVENT VARIABLE /end DAQ_EVENT
 /end IF_DATA
/end MEASUREMENT
/begin MEASUREMENT DcmDspUDS_bIvtrOffsReqFlg "Tester flag indicating the start of RC DF0A" UBYTE B_TRUE 1 100 0.00 1.00000000000 BIT_MASK 0x1 FORMAT "%13.11" ECU_ADDRESS 0x70001493
 /begin IF_DATA XCPplus 0x0102
  /begin DAQ_EVENT VARIABLE /end DAQ_EVENT
 /end IF_DATA
/end MEASUREMENT
/begin MEASUREMENT DcmDspUDS_bPwrLatchFlg "Flag to incate the DFC is set" UBYTE B_TRUE 1 100 0.00 1.00000000000 BIT_MASK 0x1 FORMAT "%13.11" ECU_ADDRESS 0x70001492
 /begin IF_DATA XCPplus 0x0102
  /begin DAQ_EVENT VARIABLE /end DAQ_EVENT
 /end IF_DATA
/end MEASUREMENT
/begin MEASUREMENT DcmDspUDS_uDCDCOpVolt "CUBAS DCM DSP for UDS, Routine Control" UBYTE RBPtCel_u_1p0_1 1 100 0.00 255.0 FORMAT "%5.1" ECU_ADDRESS 0x600235BC
 /begin IF_DATA XCPplus 0x0102
  /begin DAQ_EVENT VARIABLE /end DAQ_EVENT
 /end IF_DATA
/end MEASUREMENT
/begin MEASUREMENT Dcm_stCallWr "Call state of writing information into EEPROM" UBYTE OneToOne 1 100 0.00 255.0 FORMAT "%5.1" ECU_ADDRESS 0x600235BB
 /begin IF_DATA XCPplus 0x0102
  /begin DAQ_EVENT VARIABLE /end DAQ_EVENT
 /end IF_DATA
/end MEASUREMENT
/begin MEASUREMENT Dcm_stEepOrder "EEPROM order state of writing information into EEPROM" UBYTE OneToOne 1 100 0.00 255.0 FORMAT "%5.1" ECU_ADDRESS 0x600235BA /end MEASUREMENT
/begin MEASUREMENT DDRC_ctArDebLvl.DFC_CANSM_E_BUS_OFF_NETWORK_HSN1_CAN "" SWORD DFC_OneToOne 1 100 -32768.00 32767.00 FORMAT "%8.2" ECU_ADDRESS 0x60021F50 /end MEASUREMENT
/begin MEASUREMENT DDRC_ctArDebLvl.DFC_CANSM_E_BUS_OFF_NETWORK_HSN3_CAN "" SWORD DFC_OneToOne 1 100 -32768.00 32767.00 FORMAT "%8.2" ECU_ADDRESS 0x60021F52 /end MEASUREMENT
/begin MEASUREMENT DDRC_ctArDebLvl.DFC_CANSM_E_BUS_OFF_NETWORK_HSN4_CAN "" SWORD DFC_OneToOne 1 100 -32768.00 32767.00 FORMAT "%8.2" ECU_ADDRESS 0x60021F54 /end MEASUREMENT
/begin MEASUREMENT DDRC_ctArDebLvl.DFC_CANSM_E_BUS_OFF_NETWORK_XCP_CAN "" SWORD DFC_OneToOne 1 100 -32768.00 32767.00 FORMAT "%8.2" ECU_ADDRESS 0x60021F56 /end MEASUREMENT
/begin MEASUREMENT DDRC_ctArDebLvl.DFC_COMM_E_NET_START_IND_CHANNEL_0 "" SWORD DFC_OneToOne 1 100 -32768.00 32767.00 FORMAT "%8.2" ECU_ADDRESS 0x60021F5C /end MEASUREMENT
/begin MEASUREMENT DDRC_ctArDebLvl.DFC_COMM_E_NET_START_IND_CHANNEL_1 "" SWORD DFC_OneToOne 1 100 -32768.00 32767.00 FORMAT "%8.2" ECU_ADDRESS 0x60021F5E /end MEASUREMENT
/begin MEASUREMENT DDRC_ctArDebLvl.DFC_COMM_E_NET_START_IND_CHANNEL_2 "" SWORD DFC_OneToOne 1 100 -32768.00 32767.00 FORMAT "%8.2" ECU_ADDRESS 0x60021F60 /end MEASUREMENT
/begin MEASUREMENT DDRC_ctArDebLvl.DFC_LIN_E_TIMEOUT "" SWORD DFC_OneToOne 1 100 -32768.00 32767.00 FORMAT "%8.2" ECU_ADDRESS 0x60021F68 /end MEASUREMENT
/begin MEASUREMENT DDRC_ctArDebLvl.DFC_rba_SyC_CustStates_Degraded_disord_Event "" SWORD DFC_OneToOne 1 100 -32768.00 32767.00 FORMAT "%8.2" ECU_ADDRESS 0x60021F70 /end MEASUREMENT
/begin MEASUREMENT DDRC_ctArDebLvl.DFC_rba_SyC_CustStates_Degraded_incst_Event "" SWORD DFC_OneToOne 1 100 -32768.00 32767.00 FORMAT "%8.2" ECU_ADDRESS 0x60021F72 /end MEASUREMENT
/begin MEASUREMENT DDRC_ctArDebLvl.DFC_rba_SyC_CustStates_TransNoWakReq_Event "" SWORD DFC_OneToOne 1 100 -32768.00 32767.00 FORMAT "%8.2" ECU_ADDRESS 0x60021F74 /end MEASUREMENT
/begin MEASUREMENT DDRC_St.DFC_DcdcFwdModStuck "" ULONG DFC_OneToOne 1 100 0.00 536870911.000 BIT_MASK 0x1fffffff FORMAT "%13.3" ECU_ADDRESS 0x6001C360 /end MEASUREMENT
/begin MEASUREMENT DDRC_St.DFC_DcdcOffModStuck "" ULONG DFC_OneToOne 1 100 0.00 536870911.000 BIT_MASK 0x1fffffff FORMAT "%13.3" ECU_ADDRESS 0x6001C368 /end MEASUREMENT
/begin MEASUREMENT DDRC_St.DFC_DcdcOperModFailr "" ULONG DFC_OneToOne 1 100 0.00 536870911.000 BIT_MASK 0x1fffffff FORMAT "%13.3" ECU_ADDRESS 0x6001C36C /end MEASUREMENT
/begin MEASUREMENT DDRC_St.DFC_DcdcPrecModStuck "" ULONG DFC_OneToOne 1 100 0.00 536870911.000 BIT_MASK 0x1fffffff FORMAT "%13.3" ECU_ADDRESS 0x6001C370 /end MEASUREMENT
/begin MEASUREMENT DDRC_stLstRprtEve.DFC_CANSM_E_BUS_OFF_NETWORK_HSN1_CAN "" UBYTE DDRC_LstRprtEve_VERB 1 100 0.00 255.000000000 FORMAT "%13.9" ECU_ADDRESS 0x60024966 /end MEASUREMENT
/begin MEASUREMENT DDRC_stLstRprtEve.DFC_CANSM_E_BUS_OFF_NETWORK_HSN3_CAN "" UBYTE DDRC_LstRprtEve_VERB 1 100 0.00 255.000000000 FORMAT "%13.9" ECU_ADDRESS 0x60024967 /end MEASUREMENT
/begin MEASUREMENT DDRC_stLstRprtEve.DFC_CANSM_E_BUS_OFF_NETWORK_HSN4_CAN "" UBYTE DDRC_LstRprtEve_VERB 1 100 0.00 255.000000000 FORMAT "%13.9" ECU_ADDRESS 0x60024968 /end MEASUREMENT
/begin MEASUREMENT DDRC_stLstRprtEve.DFC_CANSM_E_BUS_OFF_NETWORK_XCP_CAN "" UBYTE DDRC_LstRprtEve_VERB 1 100 0.00 255.000000000 FORMAT "%13.9" ECU_ADDRESS 0x60024969 /end MEASUREMENT
/begin MEASUREMENT DDRC_stLstRprtEve.DFC_COMM_E_NET_START_IND_CHANNEL_0 "" UBYTE DDRC_LstRprtEve_VERB 1 100 0.00 255.000000000 FORMAT "%13.9" ECU_ADDRESS 0x6002496C /end MEASUREMENT
/begin MEASUREMENT DDRC_stLstRprtEve.DFC_COMM_E_NET_START_IND_CHANNEL_1 "" UBYTE DDRC_LstRprtEve_VERB 1 100 0.00 255.000000000 FORMAT "%13.9" ECU_ADDRESS 0x6002496D /end MEASUREMENT
/begin MEASUREMENT DDRC_stLstRprtEve.DFC_COMM_E_NET_START_IND_CHANNEL_2 "" UBYTE DDRC_LstRprtEve_VERB 1 100 0.00 255.000000000 FORMAT "%13.9" ECU_ADDRESS 0x6002496E /end MEASUREMENT
/begin MEASUREMENT DDRC_stLstRprtEve.DFC_LIN_E_TIMEOUT "" UBYTE DDRC_LstRprtEve_VERB 1 100 0.00 255.000000000 FORMAT "%13.9" ECU_ADDRESS 0x60024972 /end MEASUREMENT
/begin MEASUREMENT DDRC_stLstRprtEve.DFC_rba_SyC_CustStates_Degraded_disord_Event "" UBYTE DDRC_LstRprtEve_VERB 1 100 0.00 255.000000000 FORMAT "%13.9" ECU_ADDRESS 0x60024976 /end MEASUREMENT
/begin MEASUREMENT DDRC_stLstRprtEve.DFC_rba_SyC_CustStates_Degraded_incst_Event "" UBYTE DDRC_LstRprtEve_VERB 1 100 0.00 255.000000000 FORMAT "%13.9" ECU_ADDRESS 0x60024977 /end MEASUREMENT
/begin MEASUREMENT DDRC_stLstRprtEve.DFC_rba_SyC_CustStates_TransNoWakReq_Event "" UBYTE DDRC_LstRprtEve_VERB 1 100 0.00 255.000000000 FORMAT "%13.9" ECU_ADDRESS 0x60024978 /end MEASUREMENT
/begin MEASUREMENT DELib_idxArrSnsr "e_:SW Version of DELib calibration data:_e;d_:SW Version der Applikationsdaten:_d" UWORD OneToOne 1 100 0.00 65535.00 FORMAT "%8.2" MATRIX_DIM 10 ECU_ADDRESS 0x6001FCA2
 /begin IF_DATA XCPplus 0x0102
  /begin DAQ_EVENT VARIABLE /end DAQ_EVENT
 /end IF_DATA
/end MEASUREMENT
/begin MEASUREMENT DELib_numVar_mp "SW Version variant of DELibPackage (110 = DELibPackage_1.1.0)" UWORD OneToOne 1 100 0. 65535. FORMAT "%10.0" ECU_ADDRESS 0x6001FED4 /end MEASUREMENT
/begin MEASUREMENT DELib_num_mp "e_:SW Version of DELibPackage (1110 = DELibPackage.1.11.0):_e;d_:SW Version der DELibPackage 1110 = DELibPackage.1.11.0):_d" UWORD OneToOne 1 100 0. 65535. FORMAT "%10.0" ECU_ADDRESS 0x6001FED2 /end MEASUREMENT
/begin MEASUREMENT DELib_stArrSnsr "e_:SW Version of DELib calibration data:_e;d_:SW Version der Applikationsdaten:_d" UBYTE OneToOne 1 100 0.00 255.0 FORMAT "%5.1" MATRIX_DIM 10 ECU_ADDRESS 0x600237F7
 /begin IF_DATA XCPplus 0x0102
  /begin DAQ_EVENT VARIABLE /end DAQ_EVENT
 /end IF_DATA
/end MEASUREMENT
/begin MEASUREMENT DELib_stFirstPreDrvOverCopy "status of First Pre Drive over copy" UBYTE OneToOne 1 100 0.00 255.0 FORMAT "%5.1" ECU_ADDRESS 0x600237F6
 /begin IF_DATA XCPplus 0x0102
  /begin DAQ_EVENT VARIABLE /end DAQ_EVENT
 /end IF_DATA
/end MEASUREMENT
/begin MEASUREMENT DELib_xArrSnsr "e_:Array to hold float values of sensors:_e;d_:SW Version der Applikationsdaten:_d" FLOAT32_IEEE OneToOne 1 100 -1.00000000E+037 1.00000000E+037 FORMAT "%13.3" MATRIX_DIM 10 ECU_ADDRESS 0x600011FC
 /begin IF_DATA XCPplus 0x0102
  /begin DAQ_EVENT VARIABLE /end DAQ_EVENT
 /end IF_DATA
/end MEASUREMENT
/begin MEASUREMENT DemDcmIf_eventlistvalid "message to check the validity of event list" UBYTE OneToOne 1 100 0.00 255.0 BIT_MASK 0x1 FORMAT "%5.1" ECU_ADDRESS 0x70004146 /end MEASUREMENT
/begin MEASUREMENT Dem_disableEventStatusUpdateGroup "Bit encoded DTCGroups disabled for EventStatusUpdate" UBYTE OneToOne 1 100 0.00 255.0 FORMAT "%5.1" ECU_ADDRESS 0x70004148 /end MEASUREMENT
/begin MEASUREMENT Dem_DTCFltForFDC "FilterForFaultDetectionCounter parameter of current Dem_SetDTCFilter()" UBYTE OneToOne 1 100 0.00 255.0 FORMAT "%5.1" ECU_ADDRESS 0x7000414B /end MEASUREMENT
/begin MEASUREMENT Dem_DTCFltFormat "DTCFormat parameter of current Dem_SetDTCFilter() request" UBYTE OneToOne 1 100 0.00 255.0 FORMAT "%5.1" ECU_ADDRESS 0x7000414F /end MEASUREMENT
/begin MEASUREMENT Dem_DTCFltKind "DTCKind parameter of current Dem_SetDTCFilter() request" UBYTE OneToOne 1 100 0.00 255.0 FORMAT "%5.1" ECU_ADDRESS 0x70004150 /end MEASUREMENT
/begin MEASUREMENT Dem_DTCFltOrigin "DTCOrigin parameter of current Dem_SetDTCFilter() request" UBYTE OneToOne 1 100 0.00 255.0 FORMAT "%5.1" ECU_ADDRESS 0x7000414E /end MEASUREMENT
/begin MEASUREMENT Dem_DTCFltProcCnt "Number of DTCs found to current Dem_SetDTCFilter() request" UWORD OneToOne 1 100 0.00 65535.00 FORMAT "%8.2" ECU_ADDRESS 0x7000288C /end MEASUREMENT
/begin MEASUREMENT Dem_DTCFltProcIdx "Loop index for asynchron Dem_SetDTCFilter() processing" UWORD OneToOne 1 100 0.00 65535.00 FORMAT "%8.2" ECU_ADDRESS 0x7000288E /end MEASUREMENT
/begin MEASUREMENT Dem_DTCFltRecFormat "DTCFormat parameter of current Dem_SetFreezeFrameRecordFilter() request" UBYTE OneToOne 1 100 0.00 255.0 FORMAT "%5.1" ECU_ADDRESS 0x7000414A /end MEASUREMENT
/begin MEASUREMENT Dem_DTCFltRecRsltIdx "Index variable for incremental GetNextFilteredRecord output" UWORD OneToOne 1 100 0.00 65535.00 FORMAT "%8.2" ECU_ADDRESS 0x70002888 /end MEASUREMENT
/begin MEASUREMENT Dem_DTCFltRsltIdx "Index variable for incremental GetNextFilteredDTCxxx output" UWORD OneToOne 1 100 0.00 65535.00 FORMAT "%8.2" ECU_ADDRESS 0x7000288A /end MEASUREMENT
/begin MEASUREMENT Dem_DTCFltSeverity "DTCSeverity parameter of current Dem_SetDTCFilter() request" UBYTE OneToOne 1 100 0.00 255.0 FORMAT "%5.1" ECU_ADDRESS 0x7000414C /end MEASUREMENT
/begin MEASUREMENT Dem_DTCFltSt "Current state of Dem_SetDTCFilter() processing" UBYTE Dem_DTCFltSt_Verb 1 100 0.00 5.00000000000 FORMAT "%13.11" ECU_ADDRESS 0x70004149 /end MEASUREMENT
/begin MEASUREMENT Dem_DTCFltStatusMask "DTCStatusMask parameter of current Dem_SetDTCFilter() request" UBYTE OneToOne 1 100 0.00 255.0 FORMAT "%5.1" ECU_ADDRESS 0x70004151 /end MEASUREMENT
/begin MEASUREMENT Dem_DTCFltWithSeverity "FilterWithSeverity parameter of current Dem_SetDTCFilter() request" UBYTE OneToOne 1 100 0.00 255.0 FORMAT "%5.1" ECU_ADDRESS 0x7000414D /end MEASUREMENT
/begin MEASUREMENT Dem_xCalEvtListTrg_Old "old value of Dem_xCalEvtListTrg_C" UBYTE OneToOne 1 100 0.00 255.0 FORMAT "%5.1" ECU_ADDRESS 0x70004147 /end MEASUREMENT
/begin MEASUREMENT DevLib_stDigOutErr_mp "Measuring point that contains the error information received from HWE for the digital out signal selected by DevLib_DigOutDbgSig_C" ULONG OneToOne 1 100 0.00 4294967295.00 FORMAT "%13.2" ECU_ADDRESS 0x700068DC /end MEASUREMENT
/begin MEASUREMENT DevLib_stDigOutPrevTst_mp "Measuring point for the previous test result for the digital out signal selected by DevLib_DigOutDbgSig_C" UWORD OneToOne 1 100 0.00 65535.00 FORMAT "%8.2" ECU_ADDRESS 0x70006B34 /end MEASUREMENT
/begin MEASUREMENT DevLib_stDigOutTstImp_mp "Measuring point for the frequency of the test impulse sent to the digital out powerstage selected by DevLib_DigOutDbgSig_C" UBYTE OneToOne 1 100 0.00 255.0 FORMAT "%5.1" ECU_ADDRESS 0x70006C21 /end MEASUREMENT
/begin MEASUREMENT DevLib_stPWMOutErr_mp "Measuring point that contains the error information received from HWE for the PWM out signal selected by DevLib_PWMOutDbgSig_C" ULONG OneToOne 1 100 0.00 4294967295.00 FORMAT "%13.2" ECU_ADDRESS 0x700068D8 /end MEASUREMENT
/begin MEASUREMENT DevLib_stPWMOutPrevTst_mp "Measuring point for the previous test result for the PWM out signal selected by DevLib_PWMOutDbgSig_C" UWORD OneToOne 1 100 0.00 65535.00 FORMAT "%8.2" ECU_ADDRESS 0x70006B32 /end MEASUREMENT
/begin MEASUREMENT DevLib_stPWMOutTstImp_mp "Measuring point for the frequency of the test impulse sent to the PWM out powerstage selected by DevLib_PWMOutDbgSig_C" UBYTE OneToOne 1 100 0.00 255.0 FORMAT "%5.1" ECU_ADDRESS 0x70006C20 /end MEASUREMENT
/begin MEASUREMENT DFC_st.DFC_DcdcFwdModStuck "" UBYTE DFC_OneToOne 1 100 0.00 255.0 FORMAT "%5.1" ECU_ADDRESS 0x60034A3B /end MEASUREMENT
/begin MEASUREMENT DFC_st.DFC_DcdcOffModStuck "" UBYTE DFC_OneToOne 1 100 0.00 255.0 FORMAT "%5.1" ECU_ADDRESS 0x60034A3D /end MEASUREMENT
/begin MEASUREMENT DFC_st.DFC_DcdcOperModFailr "" UBYTE DFC_OneToOne 1 100 0.00 255.0 FORMAT "%5.1" ECU_ADDRESS 0x60034A3E /end MEASUREMENT
/begin MEASUREMENT DFC_st.DFC_DcdcPrecModStuck "" UBYTE DFC_OneToOne 1 100 0.00 255.0 FORMAT "%5.1" ECU_ADDRESS 0x60034A3F /end MEASUREMENT
/begin MEASUREMENT DFC_st.DFC_ExpPwrLatch "" UBYTE DFC_OneToOne 1 100 0.00 255.0 FORMAT "%5.1" ECU_ADDRESS 0x60034C7D /end MEASUREMENT
/begin MEASUREMENT DFC_st.DFC_InvBinID "" UBYTE DFC_OneToOne 1 100 0.00 255.0 FORMAT "%5.1" ECU_ADDRESS 0x60034CE0 /end MEASUREMENT
/begin MEASUREMENT DFC_st.DFC_InvCalID "" UBYTE DFC_OneToOne 1 100 0.00 255.0 FORMAT "%5.1" ECU_ADDRESS 0x60034CE1 /end MEASUREMENT
/begin MEASUREMENT DFC_st.DFC_InvErotan "" UBYTE DFC_OneToOne 1 100 0.00 255.0 FORMAT "%5.1" ECU_ADDRESS 0x60034CE2 /end MEASUREMENT
/begin MEASUREMENT DFC_st.DFC_InvVinID "" UBYTE DFC_OneToOne 1 100 0.00 255.0 FORMAT "%5.1" ECU_ADDRESS 0x60034CE3 /end MEASUREMENT
/begin MEASUREMENT DINH_nrActvInhReas.FId_BattUInvalid "" UWORD DINH_ct_Compu 1 100 -4095.000 4096.000 BIT_MASK 0x1fff FORMAT "%8.3" ECU_ADDRESS 0x60021324 /end MEASUREMENT
/begin MEASUREMENT DINH_nrActvInhReas.FId_DELibAcChrgrIntkT "" UWORD DINH_ct_Compu 1 100 -4095.000 4096.000 BIT_MASK 0x1fff FORMAT "%8.3" ECU_ADDRESS 0x600213FE /end MEASUREMENT
/begin MEASUREMENT DINH_nrActvInhReas.FId_DELibDcChrgrIntkT "" UWORD DINH_ct_Compu 1 100 -4095.000 4096.000 BIT_MASK 0x1fff FORMAT "%8.3" ECU_ADDRESS 0x60021400 /end MEASUREMENT
/begin MEASUREMENT DINH_nrActvInhReas.FId_DELibEnvP "" UWORD DINH_ct_Compu 1 100 -4095.000 4096.000 BIT_MASK 0x1fff FORMAT "%8.3" ECU_ADDRESS 0x60021402 /end MEASUREMENT
/begin MEASUREMENT DINH_nrActvInhReas.FId_DELibEnvT "" UWORD DINH_ct_Compu 1 100 -4095.000 4096.000 BIT_MASK 0x1fff FORMAT "%8.3" ECU_ADDRESS 0x60021404 /end MEASUREMENT
/begin MEASUREMENT DINH_nrActvInhReas.FId_DELibHeatrCoreT "" UWORD DINH_ct_Compu 1 100 -4095.000 4096.000 BIT_MASK 0x1fff FORMAT "%8.3" ECU_ADDRESS 0x60021406 /end MEASUREMENT
/begin MEASUREMENT DINH_nrActvInhReas.FId_DcdcDesOperModFwd "" UWORD DINH_ct_Compu 1 100 -4095.000 4096.000 BIT_MASK 0x1fff FORMAT "%8.3" ECU_ADDRESS 0x60021424 /end MEASUREMENT
/begin MEASUREMENT DINH_nrActvInhReas.FId_DcdcUDesLvGrid "" UWORD DINH_ct_Compu 1 100 -4095.000 4096.000 BIT_MASK 0x1fff FORMAT "%8.3" ECU_ADDRESS 0x60021428 /end MEASUREMENT
/begin MEASUREMENT DINH_nrActvInhReas.FId_DcmDspUDSStPwrLatch "" UWORD DINH_ct_Compu 1 100 -4095.000 4096.000 BIT_MASK 0x1fff FORMAT "%8.3" ECU_ADDRESS 0x6002142A /end MEASUREMENT
/begin MEASUREMENT DINH_stFId.FId_BattUInvalid "" UWORD DFC_OneToOne 1 100 0.00 65535.00 FORMAT "%8.2" ECU_ADDRESS 0x60021324 /end MEASUREMENT
/begin MEASUREMENT DINH_stFId.FId_DELibAcChrgrIntkT "" UWORD DFC_OneToOne 1 100 0.00 65535.00 FORMAT "%8.2" ECU_ADDRESS 0x600213FE /end MEASUREMENT
/begin MEASUREMENT DINH_stFId.FId_DELibDcChrgrIntkT "" UWORD DFC_OneToOne 1 100 0.00 65535.00 FORMAT "%8.2" ECU_ADDRESS 0x60021400 /end MEASUREMENT
/begin MEASUREMENT DINH_stFId.FId_DELibEnvP "" UWORD DFC_OneToOne 1 100 0.00 65535.00 FORMAT "%8.2" ECU_ADDRESS 0x60021402 /end MEASUREMENT
/begin MEASUREMENT DINH_stFId.FId_DELibEnvT "" UWORD DFC_OneToOne 1 100 0.00 65535.00 FORMAT "%8.2" ECU_ADDRESS 0x60021404 /end MEASUREMENT
/begin MEASUREMENT DINH_stFId.FId_DELibHeatrCoreT "" UWORD DFC_OneToOne 1 100 0.00 65535.00 FORMAT "%8.2" ECU_ADDRESS 0x60021406 /end MEASUREMENT
/begin MEASUREMENT DINH_stFId.FId_DcdcDesOperModFwd "" UWORD DFC_OneToOne 1 100 0.00 65535.00 FORMAT "%8.2" ECU_ADDRESS 0x60021424 /end MEASUREMENT
/begin MEASUREMENT DINH_stFId.FId_DcdcUDesLvGrid "" UWORD DFC_OneToOne 1 100 0.00 65535.00 FORMAT "%8.2" ECU_ADDRESS 0x60021428 /end MEASUREMENT
/begin MEASUREMENT DINH_stFId.FId_DcmDspUDSStPwrLatch "" UWORD DFC_OneToOne 1 100 0.00 65535.00 FORMAT "%8.2" ECU_ADDRESS 0x6002142A /end MEASUREMENT
/begin MEASUREMENT DSM_xTabVersion "DSM version indentification signature" UWORD DFC_OneToOne 1 100 0.00 65535.00 FORMAT "%8.2" ECU_ADDRESS 0x60022CF6 /end MEASUREMENT
/begin MEASUREMENT EnvP_p_f "Actual physical value" FLOAT32_IEEE RBPtCel_p_1p0_1 1 100 -1.00000000E+037 1.00000000E+037 FORMAT "%13.3" ECU_ADDRESS 0x600011D0
 /begin IF_DATA XCPplus 0x0102
  /begin DAQ_EVENT VARIABLE /end DAQ_EVENT
 /end IF_DATA
/end MEASUREMENT
/begin MEASUREMENT EnvT_t_f "envt" FLOAT32_IEEE RBPtCel_t_1p0_3 1 100 -1.00000000E+037 1.00000000E+037 FORMAT "%13.3" ECU_ADDRESS 0x600011CC
 /begin IF_DATA XCPplus 0x0102
  /begin DAQ_EVENT VARIABLE /end DAQ_EVENT
 /end IF_DATA
/end MEASUREMENT
/begin MEASUREMENT EnvT_t_f_Sq "" UBYTE SigQly_COMPU_VERB 1 100 0.00 15.0000000000 FORMAT "%13.10" ECU_ADDRESS 0x60023579
 /begin IF_DATA XCPplus 0x0102
  /begin DAQ_EVENT VARIABLE /end DAQ_EVENT
 /end IF_DATA
/end MEASUREMENT
/begin FUNCTION Dcdc_OperVd "1400.4.0  DCDC Converter Virtual Device Operation"
 /begin DEF_CHARACTERISTIC Dcdc_maskErrorSq_C Dcdc_maskPwrDcdcOutpSq_C Dcdc_maskT30ErrorSq_C Dcdc_tiThdT30CErr_C Dcdc_vThdT30CErr_C Dcdc_OperVd_Class01_I.iLimHvGrid_C Dcdc_OperVd_Class01_I.iLimLvGridTSoc_M Dcdc_OperVd_Class01_I.iLimLvGrid_C Dcdc_OperVd_Class01_I.stActvDchaAct_T Dcdc_OperVd_Class01_I.uDesHvGrid_C DDRC_DurDeb.Dcdc_tiFwdModStuckDebOk_C DDRC_DurDeb.Dcdc_tiFwdModStuckDebDef_C DDRC_DurDeb.Dcdc_tiOffModStuckDebOk_C DDRC_DurDeb.Dcdc_tiOffModStuckDebDef_C DDRC_DurDeb.Dcdc_tiOperModFailrDebOk_C DDRC_DurDeb.Dcdc_tiOperModFailrDebDef_C DDRC_DurDeb.Dcdc_tiPrecModStuckDebOk_C DDRC_DurDeb.Dcdc_tiPrecModStuckDebDef_C DFC_CtlMsk2.DFC_DcdcFwdModStuck_C DFC_CtlMsk2.DFC_DcdcOffModStuck_C DFC_CtlMsk2.DFC_DcdcOperModFailr_C DFC_CtlMsk2.DFC_DcdcPrecModStuck_C DFC_DisblMsk2.DFC_DcdcFwdModStuck_C DFC_DisblMsk2.DFC_DcdcOffModStuck_C DFC_DisblMsk2.DFC_DcdcOperModFailr_C DFC_DisblMsk2.DFC_DcdcPrecModStuck_C /end DEF_CHARACTERISTIC
 /begin IN_MEASUREMENT Com_pwrDcdcOutpCpby Com_pwrDcdcOutpCpby_Sq Com_stDcdcOperModAct Com_stDcdcOperModAct_Sq Com_stDcdcShutoffErr Com_stDcdcShutoffErr_Sq Com_stDcdcVltgErr Com_stDcdcVltgErr_Sq Dcdc_iLvAct Dcdc_uHvAct Dcdc_uLvAct DcmDspUDS_bDCDCOpVoltFlg DcmDspUDS_uDCDCOpVolt Ebs_iBattFild Ebs_ratSocFild Ebs_tLvBatt Eem_pwrMaxLimDcdc Eem_stDesDcdc LvGrid_uDesDcdc T15_st /end IN_MEASUREMENT
 /begin OUT_MEASUREMENT Dcdc_iLimHvGrid Dcdc_iLimLvGrid Dcdc_stDesDcdc Dcdc_stEem Dcdc_stOperModAct Dcdc_stOperModAct_Sq Dcdc_stT15 Dcdc_uDesHvGrid Dcdc_uDesLvGrid DDRC_St.DFC_DcdcFwdModStuck DDRC_St.DFC_DcdcOffModStuck DDRC_St.DFC_DcdcOperModFailr DDRC_St.DFC_DcdcPrecModStuck DFC_st.DFC_DcdcFwdModStuck DFC_st.DFC_DcdcOffModStuck DFC_st.DFC_DcdcOperModFailr DFC_st.DFC_DcdcPrecModStuck DINH_nrActvInhReas.FId_DcdcDesOperModFwd DINH_nrActvInhReas.FId_DcdcUDesLvGrid DINH_stFId.FId_DcdcDesOperModFwd DINH_stFId.FId_DcdcUDesLvGrid /end OUT_MEASUREMENT
 /begin LOC_MEASUREMENT Dcdc_OperVd_Class01_I.T30CTonD_I.XOld Dcdc_OperVd_Class01_I.T30CTonD_I.Timer /end LOC_MEASUREMENT
 FUNCTION_VERSION "1400.4.0" /end FUNCTION
/begin FUNCTION Dcdc_ThermVd "1400.1.0  DCDC Converter Virtual Device Thermal Functions"
 /begin DEF_CHARACTERISTIC Dcdc_ThermVd_Class01_I.tActFlt_C Dcdc_ThermVd_Class01_I.tActIni_C /end DEF_CHARACTERISTIC
 /begin IN_MEASUREMENT Com_tDcdcAct Com_tDcdcAct_Sq Com_tDcdcInltCoolt Com_tDcdcInltCoolt_Sq /end IN_MEASUREMENT
 /begin OUT_MEASUREMENT Dcdc_tAct Dcdc_tAct_Sq Dcdc_tInCoolt Dcdc_tInCoolt_Sq /end OUT_MEASUREMENT
 FUNCTION_VERSION "1400.1.0" /end FUNCTION
/begin FUNCTION DcmCore_DslDsd_Appl "75.4.0    Adaptions of DcmCore Dsl and Dsd"
 /begin DEF_CHARACTERISTIC DcmAppl_tiMaxWaitComCond_C DcmAppl_uBattMax_C DcmAppl_uBattMin_C DcmAppl_vVehVMaxLim_C /end DEF_CHARACTERISTIC
 /begin IN_MEASUREMENT BattU_u CanEif_bMode Com_stChrgPlg Com_stHvbNegCntct Com_stHvbPosCntct Com_stHvbPrecCntct CoPtFH_stPwt rba_SyC_bWkuMain T15_bRCDLine VehV_v VehV_v_Sq /end IN_MEASUREMENT
 /begin OUT_MEASUREMENT Afts_bEngCtlDiagRun DcmAppl_bDiagToolReq DcmAppl_bDiagToolRly DINH_nrActvInhReas.FId_BattUInvalid DINH_stFId.FId_BattUInvalid /end OUT_MEASUREMENT
 /begin LOC_MEASUREMENT DcmAppl_stChkComCond_b_msg DcmAppl_StCondn_mp /end LOC_MEASUREMENT
 FUNCTION_VERSION "75.4.0" /end FUNCTION
/begin FUNCTION DcmDspUDS_CDTCS "12.5.0    DCM UDS Control DTC Setting" FUNCTION_VERSION "12.5.0" /end FUNCTION
/begin FUNCTION DcmDspUDS_DID "286.7.0   Configuration and Implementation of the DIDs for the DCM UDS Services (RDBI, WDBI, IOCBI)"
 /begin DEF_CHARACTERISTIC DFC_CtlMsk2.DFC_InvBinID_C DFC_CtlMsk2.DFC_InvCalID_C DFC_CtlMsk2.DFC_InvErotan_C DFC_CtlMsk2.DFC_InvVinID_C DFC_DisblMsk2.DFC_InvBinID_C DFC_DisblMsk2.DFC_InvCalID_C DFC_DisblMsk2.DFC_InvErotan_C DFC_DisblMsk2.DFC_InvVinID_C /end DEF_CHARACTERISTIC
 /begin REF_CHARACTERISTIC GlbDa_numVarcodeTLC_C /end REF_CHARACTERISTIC
 /begin IN_MEASUREMENT ACCtl_flgCmprEna ACCtl_nCmprSpdReq ACCtl_nPwrLim AcExtChrgr_pwrChrgnOut AcExtChrgr_pwrChrgrIn Airbg_rPwmInpRat Airbg_st AirC_pClnt APP_r APP_uRaw1ADC APP_uRaw2ADC BrkBstPmp_bPmpStrt BrkBstPmp_flgHsActr BrkBstPmp_flgLsActr BrkBstP_p BrkBstP_uRaw1 BrkBstP_uRaw2 BrkBst_flgBkupModActv Brk_stRed CbnHeatgHeatr_flgHsActr CbnHeatgHeatr_flgLsActr CbnHeatgSwt_stRaw ChgrPlug_stCtpSwtActr ChgrPlug_stPlgLockTx ChrgMod_iChrgnMaxAvl ChrgnCntct_flgHsActr ChrgnCntct_flgLsNegActr ChrgnCntct_flgLsPosActr ChrgrRly_stRlyDes ChrgrVal_iChrgrDes ChrgrVal_uHvMax CoDrvPITh_stEPSModeReq ComChrgn_iDcRly ComChrgn_uDcRly ComChrgr_flgChrgrErrLvl ComChrgr_iAcMax ComChrgr_iDcHvAct ComChrgr_pwrOutpCpby ComChrgr_stChrgrRx ComChrgr_stEVLmp ComChrgr_stMstWrnLmp ComChrgr_stSVSLmp ComChrgr_tChrgrMaxAct ComChrgr_uAcActL1 ComChrgr_uDcHvAct ComEmac_flgImobAuthent ComEmac_iDcLnk01 ComEmac_nAct01 ComEmac_pwrInstnsInp ComEmac_stActvDcha ComEmac_stEVLmp ComEmac_stHillHld ComEmac_stIsoMonSwtAck ComEmac_stIvtrOpMod01 ComEmac_stMod01Rx ComEmac_stMstWrnLmp ComEmac_stPwrAuthn ComEmac_stSVSLmp ComEmac_tInvr01 ComEmac_tIvtrCooltIn01 ComEmac_tMac01 ComEmac_tqAbsltMax01 ComEmac_tqAbsltMin01 ComEmac_tqAckd01 ComEmac_tqAct01 ComEmac_tqPtd01 ComEmac_tqStabnMin ComEmac_uDcLnk01 Com_bPreCondElecWkuReq Com_bReFogRlySt Com_bStpDlyHMIWkuReq Com_flgBlowrAuthn Com_flgBrkAlrt Com_flgBrkMai Com_flgBrkMaiDiag Com_flgCurMeasmtVld Com_flgDrvAwy Com_flgEcoNormReqRx Com_flgGearLvrMovmt Com_flgGunUnlckReq Com_flgHvBattAuthn Com_flgRstTripAEE Com_flgTPcbMeasmtVld Com_iDcdcHvActRvsn1 Com_iDcdcLvActRvsn1 Com_iElCmprHvAct Com_iElCmprPeakPha Com_iHvbAct Com_iHvbChrgMaxSho Com_iHvbDchaMaxSho Com_iHvbDes Com_iHvbNomChrgn Com_lTotDstkm Com_lTotOdometer Com_nElCmprActl Com_nElCmprActlTx Com_numBSIEnv Com_pwrDcdcOutpCpby Com_pwrElCmprActl Com_pwrMaxChrgSho Com_pwrMaxDchaSho Com_ratSocLvBatt Com_stABSActv Com_stAC Com_stACTx Com_stAirbCrashSev Com_stAlrtThermRunAwy Com_stBrk Com_stBrkBstPFlt Com_stBrkCntctIndcn Com_stChrgnSpstReq Com_stChrgPlg Com_stChrgPlgChrgn Com_stClstrStopIndcn Com_stCmdHvBattCntctr Com_stCmdOffsEM01 Com_stDayNight Com_stDcdcEVLmp Com_stDcdcFltLvl Com_stDcdcMstWrnLmp Com_stDcdcOperModActRx Com_stDcdcSVSLmp Com_stDcdcULimReq Com_stDoor1 Com_stDoor2 Com_stDoor3 Com_stDoor4 Com_stDrvAwyDi Com_stDrvModPosn Com_stDrvStBltRx Com_stElCmprFltLvl Com_stElCmprStat Com_stElCmprStatTx Com_stElMDesEem Com_steTogFailrLvl Com_stEVLmp Com_stGearLvrPos Com_stHvacBlwrFront Com_stHvacKnobPosn Com_stHvBattOperModDes Com_stHvbChrgFltRx Com_stHvbChrgn Com_stHvbCnctn Com_stHvbEVLmp Com_stHvbFltLvl Com_stHvbIntlckRx Com_stHvbIsoMeasmtActv Com_stHvbModRx Com_stHvbMstWrnLmp Com_stHvbNegCntct Com_stHvbPosCntct Com_stHvbSVSLmp Com_stIgnkeyPos Com_stIIvtrFltLvl01 Com_stMstWrnLmp Com_stPrkBrkRx Com_stPwrLimnLmp Com_stReFogReq_CAN Com_stSocRx Com_stSrvLmp Com_stT Com_stT50 Com_stVehCoorn Com_tDcdcAct Com_tDcdcInltCoolt Com_tElCmprActl Com_tEvapT Com_tiCurVehTmr Com_tiRef Com_tLvBatt Com_uBattEBSRx Com_uDcdcHvAct Com_uDcdcLvAct Com_uElCmprHvAct Com_uHvbAct Com_uHvbDcBus Com_uHvbLimHi Com_uHvbNomChrgn Com_vVeh CoPtFH_stPwt DcChrgnRlyNegPosn_st DcChrgnRlyPosPosn_st DcChrgnRly_ctMaxOperCyc DcChrgrIntkT2_t DcChrgrIntkT_t Dcdc_flgDesLvGridULim Dcdc_iLimLvGrid Dcdc_stDesDcdc Dcdc_uDesLvGrid EChrDv_cntPlin Eem_flgFstHvShdwn ElM_stDesEem01 ElTS_ratEmPowChrgn ElTS_ratEmPowDcha Emac_stIsoMonSwtReq Emac_tqDesCom01 Emac_tqMaxLimCom01 EmWakeupSig_r Ext_bCalidEmCf Fan1_r FanRly1Posn_st HeatrRly1_st HLCCcs_iEvseDcPrsnt HvBatt_flgIsoMeasmtDiReq HvBatt_ratSoc HvGrid_pwrMaxDcdc IntlckChrgPlgPosn_st IntlckChrgPlg_rActr MedTPmp_st MRly_stActDid PEnv_p PwmCtP_rRaw PwrDistbnUnitT_t SCtPmp1_r SCtPmp1_rPs SpplCooltPmpRly_r ThermHvac_stRemPrecndn UCtP_uSens UPxP1_u VehCoorn_dstRngPrdcDispTx VehCoorn_st VehCoorn_wCnsTotWghtAvrgEffTx VehCoorn_wCnsTotWghtTripAvrgEffTx /end IN_MEASUREMENT
 /begin OUT_MEASUREMENT DFC_st.DFC_InvBinID DFC_st.DFC_InvCalID DFC_st.DFC_InvErotan DFC_st.DFC_InvVinID DINH_nrActvInhReas.FId_DcmDspUDSStPwrLatch DINH_stFId.FId_DcmDspUDSStPwrLatch /end OUT_MEASUREMENT
 /begin LOC_MEASUREMENT Dcm_stCallWr Dcm_stEepOrder /end LOC_MEASUREMENT
 FUNCTION_VERSION "286.7.0" /end FUNCTION
/begin FUNCTION DcmDspUDS_DSC "55.2.0    DCM UDS DiagnosticSessionControl" FUNCTION_VERSION "55.2.0" /end FUNCTION
/begin FUNCTION DcmDspUDS_ER "53.2.0    DCM UDS ECUReset" FUNCTION_VERSION "53.2.0" /end FUNCTION
/begin FUNCTION DcmDspUDS_RC "133.4.0   DCM UDS Routine Control"
 /begin DEF_CHARACTERISTIC Afts_tiDlyLgTout_C Afts_tiDlyShoTout_C DcmAppl_MSRConf_ATS.DcChrgnRlyNeg_Profile_C DcmAppl_MSRConf_ATS.DcChrgnRlyPos_Profile_C DcmAppl_MSRConf_ATS.IntlckChrgPlg_Profile_C DcmAppl_MSRConf_ATS.SCtPmp1_Profile_C DcmAppl_MSR_ATS.numATSRtnMaxCyc_CA DcmAppl_MSR_ATS.ratATSRtnDCycOff_CA DcmAppl_MSR_ATS.ratATSRtnDCycOn_CA DcmAppl_MSR_ATS.tiATSRtnOff_CA DcmAppl_MSR_ATS.tiATSRtnOn_CA DcmAppl_MSR_ATS.tiRampStep_CA DcmAppl_Rc_tiMaxMSRDCDCVltCntrl_C DcmAppl_Rc_tiMaxMSRLrnRstStrt_C DcmAppl_Rc_tiMSRDCDCVltCntrl_C DcmAppl_Rc_tiMSRHvbusActvDcha_C DcmAppl_Rc_tiMSRIvtrOffsVal_C DcmDspUds_DcRly_IntvVal_C DcmDspUds_SpplPmpRly_IntvVal_C DcmDspUDS_uDCDCOpVoltMax_C DcmDspUDS_uDCDCOpVoltMin_C DFC_CtlMsk2.DFC_ExpPwrLatch_C DFC_DisblMsk2.DFC_ExpPwrLatch_C /end DEF_CHARACTERISTIC
 /begin REF_CHARACTERISTIC DcmAppl_vVehVMaxLim_C /end REF_CHARACTERISTIC
 /begin IN_MEASUREMENT Airbg_st BattU_u CanEif_bDiag CanEif_bMode ComEmac_stActvDcha Com_cntrRxFrm0x497 Com_stChrgPlg Com_stHvbNegCntct Com_stHvbPosCntct Com_stHvbPrecCntct Com_stOffsEm01 Com_stPrkBrk Com_valOffsEm01 CoPtFH_stPwt DcChrgnRlyNegPosn_st DcChrgnRlyPosPosn_st Dcdc_stOperModAct DrvMod_stPosn Ebs_ratSocFild IntlckChrgPlgPosn_st SyC_ctIrrSwOff VehCoorn_st VehV_v VehV_v_Sq /end IN_MEASUREMENT
 /begin OUT_MEASUREMENT Afts_bAcvModAfts DcmDspUDS_bDCDCOpVoltFlg DcmDspUDS_bHvbusDchaFlg DcmDspUDS_bIvtrOffsReqFlg DcmDspUDS_uDCDCOpVolt DFC_st.DFC_ExpPwrLatch /end OUT_MEASUREMENT
 /begin LOC_MEASUREMENT DcmDspUDS_bPwrLatchFlg /end LOC_MEASUREMENT
 FUNCTION_VERSION "133.4.0" /end FUNCTION
/begin FUNCTION DcmDspUDS_SecA "19.16.0   DCM UDS SecurityAccess" FUNCTION_VERSION "19.16.0" /end FUNCTION
/begin FUNCTION DDRC "30000.21.1Diagnostic Debounce and Report of Check"
 /begin REF_CHARACTERISTIC DDRC_DurDeb.ACCmpr_tiFltLvl1DebOk_C DDRC_DurDeb.ACCmpr_tiFltLvl1DebDef_C DDRC_DurDeb.ACCmpr_tiFltLvl2DebOk_C DDRC_DurDeb.ACCmpr_tiFltLvl2DebDef_C DDRC_DurDeb.ACCmpr_tiFltLvl3DebOk_C DDRC_DurDeb.ACCmpr_tiFltLvl3DebDef_C DDRC_DurDeb.ACCmpr_tiFltLvl4DebOk_C DDRC_DurDeb.ACCmpr_tiFltLvl4DebDef_C DDRC_DurDeb.ACCmpr_tiHiPFltDebOk_C DDRC_DurDeb.ACCmpr_tiHiPFltDebDef_C DDRC_DurDeb.ACCmpr_tiInvldCmprStDebOk_C DDRC_DurDeb.ACCmpr_tiInvldCmprStDebDef_C DDRC_DurDeb.ACCmpr_tiInvldElecActPwrDebOk_C DDRC_DurDeb.ACCmpr_tiInvldElecActPwrDebDef_C DDRC_DurDeb.ACCmpr_tiLoPFltDebOk_C DDRC_DurDeb.ACCmpr_tiLoPFltDebDef_C DDRC_DurDeb.AcChrgrIntkT_tiSRCMinDebOk_C DDRC_DurDeb.AcChrgrIntkT_tiSRCMinDebDef_C DDRC_DurDeb.BattU_tiMaxDebOk_C DDRC_DurDeb.BattU_tiMaxDebDef_C DDRC_DurDeb.BattU_tiMaxBattDebOk_C DDRC_DurDeb.BattU_tiMaxBattDebDef_C DDRC_DurDeb.BattU_tiMaxNoBattDebOk_C DDRC_DurDeb.BattU_tiMaxNoBattDebDef_C DDRC_DurDeb.BattU_tiMinDebOk_C DDRC_DurDeb.BattU_tiMinDebDef_C DDRC_DurDeb.BattU_tiMinBattDebOk_C DDRC_DurDeb.BattU_tiMinBattDebDef_C DDRC_DurDeb.BattU_tiMinNoBattDebOk_C DDRC_DurDeb.BattU_tiMinNoBattDebDef_C DDRC_DurDeb.BrkBstP_tiHiCautionDfctDebOk_C DDRC_DurDeb.BrkBstP_tiHiCautionDfctDebDef_C DDRC_DurDeb.BrkBstP_tiHiWarnDfctDebOk_C DDRC_DurDeb.BrkBstP_tiHiWarnDfctDebDef_C DDRC_DurDeb.BrkBstP_tiPhyRngChkMaxDebOk_C DDRC_DurDeb.BrkBstP_tiPhyRngChkMaxDebDef_C DDRC_DurDeb.BrkBstP_tiPhyRngChkMinDebOk_C DDRC_DurDeb.BrkBstP_tiPhyRngChkMinDebDef_C DDRC_DurDeb.BrkBstP_tiSnsr12PlausDebOk_C DDRC_DurDeb.BrkBstP_tiSnsr12PlausDebDef_C DDRC_DurDeb.BrkBstP_tiSnsr1ScbDebOk_C DDRC_DurDeb.BrkBstP_tiSnsr1ScbDebDef_C DDRC_DurDeb.BrkBstP_tiSnsr1ScgDebOk_C DDRC_DurDeb.BrkBstP_tiSnsr1ScgDebDef_C DDRC_DurDeb.BrkBstP_tiSnsr2ScbDebOk_C DDRC_DurDeb.BrkBstP_tiSnsr2ScbDebDef_C DDRC_DurDeb.BrkBstP_tiSnsr2ScgDebOk_C DDRC_DurDeb.BrkBstP_tiSnsr2ScgDebDef_C DDRC_DurDeb.BrkBstP_tiSnsrPMaxDebOk_C DDRC_DurDeb.BrkBstP_tiSnsrPMaxDebDef_C DDRC_DurDeb.BrkBstP_tiSnsrPMinDebOk_C DDRC_DurDeb.BrkBstP_tiSnsrPMinDebDef_C DDRC_DurDeb.BrkBstPmp_tiHsScbDebOk_C DDRC_DurDeb.BrkBstPmp_tiHsScbDebDef_C DDRC_DurDeb.BrkBstPmp_tiHsScgDebOk_C DDRC_DurDeb.BrkBstPmp_tiHsScgDebDef_C DDRC_DurDeb.BrkBstPmp_tiLsOlDebOk_C DDRC_DurDeb.BrkBstPmp_tiLsOlDebDef_C DDRC_DurDeb.BrkBstPmp_tiLsScbDebOk_C DDRC_DurDeb.BrkBstPmp_tiLsScbDebDef_C DDRC_DurDeb.BrkBstPmp_tiLsScgDebOk_C DDRC_DurDeb.BrkBstPmp_tiLsScgDebDef_C DDRC_DurDeb.CbnHeatgHeatr_tiRlyOpendDebOk_C DDRC_DurDeb.CbnHeatgHeatr_tiRlyOpendDebDef_C DDRC_DurDeb.CbnHeatgHeatr_tiRlyWlddDebOk_C DDRC_DurDeb.CbnHeatgHeatr_tiRlyWlddDebDef_C DDRC_DurDeb.CcsPwrLineChpRst_tiMonDFCDebOk_C DDRC_DurDeb.CcsPwrLineChpRst_tiMonDFCDebDef_C DDRC_DurDeb.CcsPwrLineChpVccEna_tiMonDFCDebOk_C DDRC_DurDeb.CcsPwrLineChpVccEna_tiMonDFCDebDef_C DDRC_DurDeb.CcsPwrLineChpVcc_tiSRCMinDebOk_C DDRC_DurDeb.CcsPwrLineChpVcc_tiSRCMinDebDef_C DDRC_DurDeb.CcsPwrLineComChpT_tiSRCMinDebOk_C DDRC_DurDeb.CcsPwrLineComChpT_tiSRCMinDebDef_C DDRC_DurDeb.CmbdChrgnSys_tiIBattExcddDebOk_C DDRC_DurDeb.CmbdChrgnSys_tiIBattExcddDebDef_C DDRC_DurDeb.CmbdChrgnSys_tiIEvseOutDeDebOk_C DDRC_DurDeb.CmbdChrgnSys_tiIEvseOutDeDebDef_C DDRC_DurDeb.CmbdChrgnSys_tiIOutDeDebOk_C DDRC_DurDeb.CmbdChrgnSys_tiIOutDeDebDef_C DDRC_DurDeb.CmbdChrgnSys_tiIOutExcddDebOk_C DDRC_DurDeb.CmbdChrgnSys_tiIOutExcddDebDef_C DDRC_DurDeb.CmbdChrgnSys_tiUOutDeDebOk_C DDRC_DurDeb.CmbdChrgnSys_tiUOutDeDebDef_C DDRC_DurDeb.CmbdChrgnSys_tiUOutExcddDebOk_C DDRC_DurDeb.CmbdChrgnSys_tiUOutExcddDebDef_C DDRC_DurDeb.CtPSwtActr_tiMonDFCDebOk_C DDRC_DurDeb.CtPSwtActr_tiMonDFCDebDef_C DDRC_DurDeb.CtPSwtDiag_tiSRCMinDebOk_C DDRC_DurDeb.CtPSwtDiag_tiSRCMinDebDef_C DDRC_DurDeb.CtpCarrFrq_tiSRCMinDebOk_C DDRC_DurDeb.CtpCarrFrq_tiSRCMinDebDef_C DDRC_DurDeb.DcChrgrIntkT2_tiSRCMinDebOk_C DDRC_DurDeb.DcChrgrIntkT2_tiSRCMinDebDef_C DDRC_DurDeb.DcChrgrIntkT_tiSRCMinDebOk_C DDRC_DurDeb.DcChrgrIntkT_tiSRCMinDebDef_C DDRC_DurDeb.DevLib_tiBattUHiDebOk_C DDRC_DurDeb.DevLib_tiBattUHiDebDef_C DDRC_DurDeb.DevLib_tiBattULoDebOk_C DDRC_DurDeb.DevLib_tiBattULoDebDef_C DDRC_DurDeb.EmWakeupSig_tiMonDFCDebOk_C DDRC_DurDeb.EmWakeupSig_tiMonDFCDebDef_C DDRC_DurDeb.Fan1_tiOLDebOk_C DDRC_DurDeb.Fan1_tiOLDebDef_C DDRC_DurDeb.Fan1_tiOvrTempDebOk_C DDRC_DurDeb.Fan1_tiOvrTempDebDef_C DDRC_DurDeb.Fan1_tiSCBDebOk_C DDRC_DurDeb.Fan1_tiSCBDebDef_C DDRC_DurDeb.FanSpd_tiSRCMinDebOk_C DDRC_DurDeb.FanSpd_tiSRCMinDebDef_C DDRC_DurDeb.Fan_tiRlySCBDebOk_C DDRC_DurDeb.Fan_tiRlySCBDebDef_C DDRC_DurDeb.Fan_tiRlySCGDebOk_C DDRC_DurDeb.Fan_tiRlySCGDebDef_C DDRC_DurDeb.FreonP_tiSRCMinDebOk_C DDRC_DurDeb.FreonP_tiSRCMinDebDef_C DDRC_DurDeb.HLCCcs_tiPLnCChipTHiDebOk_C DDRC_DurDeb.HLCCcs_tiPLnCChipTHiDebDef_C DDRC_DurDeb.HeatrCoreT_tiSRCMinDebOk_C DDRC_DurDeb.HeatrCoreT_tiSRCMinDebDef_C DDRC_DurDeb.PwmCtP_tiSRCMinDebOk_C DDRC_DurDeb.PwmCtP_tiSRCMinDebDef_C DDRC_DurDeb.PwrDistbnUnitT_tiSRCMinDebOk_C DDRC_DurDeb.PwrDistbnUnitT_tiSRCMinDebDef_C DDRC_DurDeb.SCtPmp1_tiOLDebOk_C DDRC_DurDeb.SCtPmp1_tiOLDebDef_C DDRC_DurDeb.SCtPmp1_tiOvrTempDebOk_C DDRC_DurDeb.SCtPmp1_tiOvrTempDebDef_C DDRC_DurDeb.SCtPmp1_tiSCBDebOk_C DDRC_DurDeb.SCtPmp1_tiSCBDebDef_C DDRC_DurDeb.SCtPmpRly_tiOLDebOk_C DDRC_DurDeb.SCtPmpRly_tiOLDebDef_C DDRC_DurDeb.SCtPmpRly_tiOvrTempDebOk_C DDRC_DurDeb.SCtPmpRly_tiOvrTempDebDef_C DDRC_DurDeb.SCtPmpRly_tiSCBDebOk_C DDRC_DurDeb.SCtPmpRly_tiSCBDebDef_C DDRC_DurDeb.SpplCooltPmpRly_tiOLDebOk_C DDRC_DurDeb.SpplCooltPmpRly_tiOLDebDef_C DDRC_DurDeb.SpplCooltPmpRly_tiOvrTempDebOk_C DDRC_DurDeb.SpplCooltPmpRly_tiOvrTempDebDef_C DDRC_DurDeb.SpplCooltPmpRly_tiSCBDebOk_C DDRC_DurDeb.SpplCooltPmpRly_tiSCBDebDef_C DDRC_DurDeb.UCtP_tiSRCMinDebOk_C DDRC_DurDeb.UCtP_tiSRCMinDebDef_C DDRC_DurDeb.UPxP1_tiSRCMinDebOk_C DDRC_DurDeb.UPxP1_tiSRCMinDebDef_C DDRC_DurDeb.Inm_numHSN1MuteDebOk_C DDRC_DurDeb.Inm_numHSN1MuteDebDef_C DDRC_DurDeb.Inm_numHSN3MuteDebOk_C DDRC_DurDeb.Inm_numHSN3MuteDebDef_C DDRC_DurDeb.AcChrgrIntkT_tiPhysRngHiDebOk_C DDRC_DurDeb.AcChrgrIntkT_tiPhysRngHiDebDef_C DDRC_DurDeb.AcChrgrIntkT_tiPhysRngLoDebOk_C DDRC_DurDeb.AcChrgrIntkT_tiPhysRngLoDebDef_C DDRC_DurDeb.AcChrgrIntkT_tiSRCOpnDebOk_C DDRC_DurDeb.AcChrgrIntkT_tiSRCOpnDebDef_C DDRC_DurDeb.CcsPwrLineChpVcc_tiPhysRngHiDebOk_C DDRC_DurDeb.CcsPwrLineChpVcc_tiPhysRngHiDebDef_C DDRC_DurDeb.CcsPwrLineChpVcc_tiPhysRngLoDebOk_C DDRC_DurDeb.CcsPwrLineChpVcc_tiPhysRngLoDebDef_C DDRC_DurDeb.CcsPwrLineChpVcc_tiSRCOpnDebOk_C DDRC_DurDeb.CcsPwrLineChpVcc_tiSRCOpnDebDef_C DDRC_DurDeb.CcsPwrLineComChpT_tiPhysRngHiDebOk_C DDRC_DurDeb.CcsPwrLineComChpT_tiPhysRngHiDebDef_C DDRC_DurDeb.CcsPwrLineComChpT_tiPhysRngLoDebOk_C DDRC_DurDeb.CcsPwrLineComChpT_tiPhysRngLoDebDef_C DDRC_DurDeb.CcsPwrLineComChpT_tiSRCOpnDebOk_C DDRC_DurDeb.CcsPwrLineComChpT_tiSRCOpnDebDef_C DDRC_DurDeb.CtPSwtDiag_tiPhysRngHiDebOk_C DDRC_DurDeb.CtPSwtDiag_tiPhysRngHiDebDef_C DDRC_DurDeb.CtPSwtDiag_tiPhysRngLoDebOk_C DDRC_DurDeb.CtPSwtDiag_tiPhysRngLoDebDef_C DDRC_DurDeb.CtPSwtDiag_tiSRCOpnDebOk_C DDRC_DurDeb.CtPSwtDiag_tiSRCOpnDebDef_C DDRC_DurDeb.CtpCarrFrq_tiPhysRngHiDebOk_C DDRC_DurDeb.CtpCarrFrq_tiPhysRngHiDebDef_C DDRC_DurDeb.CtpCarrFrq_tiPhysRngLoDebOk_C DDRC_DurDeb.CtpCarrFrq_tiPhysRngLoDebDef_C DDRC_DurDeb.CtpCarrFrq_tiSRCMaxDebOk_C DDRC_DurDeb.CtpCarrFrq_tiSRCMaxDebDef_C DDRC_DurDeb.DcChrgrIntkT2_tiPhysRngHiDebOk_C DDRC_DurDeb.DcChrgrIntkT2_tiPhysRngHiDebDef_C DDRC_DurDeb.DcChrgrIntkT2_tiPhysRngLoDebOk_C DDRC_DurDeb.DcChrgrIntkT2_tiPhysRngLoDebDef_C DDRC_DurDeb.DcChrgrIntkT2_tiSRCOpnDebOk_C DDRC_DurDeb.DcChrgrIntkT2_tiSRCOpnDebDef_C DDRC_DurDeb.DcChrgrIntkT_tiPhysRngHiDebOk_C DDRC_DurDeb.DcChrgrIntkT_tiPhysRngHiDebDef_C DDRC_DurDeb.DcChrgrIntkT_tiPhysRngLoDebOk_C DDRC_DurDeb.DcChrgrIntkT_tiPhysRngLoDebDef_C DDRC_DurDeb.DcChrgrIntkT_tiSRCOpnDebOk_C DDRC_DurDeb.DcChrgrIntkT_tiSRCOpnDebDef_C DDRC_DurDeb.Fan1_tiSCGDebOk_C DDRC_DurDeb.Fan1_tiSCGDebDef_C DDRC_DurDeb.FanSpd_tiPhysRngHiDebOk_C DDRC_DurDeb.FanSpd_tiPhysRngHiDebDef_C DDRC_DurDeb.FanSpd_tiPhysRngLoDebOk_C DDRC_DurDeb.FanSpd_tiPhysRngLoDebDef_C DDRC_DurDeb.FanSpd_tiSRCOpnDebOk_C DDRC_DurDeb.FanSpd_tiSRCOpnDebDef_C DDRC_DurDeb.FreonP_tiPhysRngHiDebOk_C DDRC_DurDeb.FreonP_tiPhysRngHiDebDef_C DDRC_DurDeb.FreonP_tiPhysRngLoDebOk_C DDRC_DurDeb.FreonP_tiPhysRngLoDebDef_C DDRC_DurDeb.FreonP_tiSRCOpnDebOk_C DDRC_DurDeb.FreonP_tiSRCOpnDebDef_C DDRC_DurDeb.HeatrCoreT_tiPhysRngHiDebOk_C DDRC_DurDeb.HeatrCoreT_tiPhysRngHiDebDef_C DDRC_DurDeb.HeatrCoreT_tiPhysRngLoDebOk_C DDRC_DurDeb.HeatrCoreT_tiPhysRngLoDebDef_C DDRC_DurDeb.HeatrCoreT_tiSRCOpnDebOk_C DDRC_DurDeb.HeatrCoreT_tiSRCOpnDebDef_C DDRC_DurDeb.HvGrid_tiUMaxSdtyLimThdDebOk_C DDRC_DurDeb.HvGrid_tiUMaxSdtyLimThdDebDef_C DDRC_DurDeb.HvGrid_tiUMinSftyLimThdDebOk_C DDRC_DurDeb.HvGrid_tiUMinSftyLimThdDebDef_C DDRC_DurDeb.HvGrid_tiUPlausyThdDebOk_C DDRC_DurDeb.HvGrid_tiUPlausyThdDebDef_C DDRC_DurDeb.IntlckChrgPlgPosn_tiRngFltDebOk_C DDRC_DurDeb.IntlckChrgPlgPosn_tiRngFltDebDef_C DDRC_DurDeb.IntlckChrgPlgPosn_tiSrcMaxDebOk_C DDRC_DurDeb.IntlckChrgPlgPosn_tiSrcMaxDebDef_C DDRC_DurDeb.IntlckChrgPlgPosn_tiSrcMinDebOk_C DDRC_DurDeb.IntlckChrgPlgPosn_tiSrcMinDebDef_C DDRC_DurDeb.IntlckChrgPlg_tiHBrgOpnLdDebOk_C DDRC_DurDeb.IntlckChrgPlg_tiHBrgOpnLdDebDef_C DDRC_DurDeb.IntlckChrgPlg_tiHBrgOvrCurrDebOk_C DDRC_DurDeb.IntlckChrgPlg_tiHBrgOvrCurrDebDef_C DDRC_DurDeb.IntlckChrgPlg_tiHBrgOvrTempDebOk_C DDRC_DurDeb.IntlckChrgPlg_tiHBrgOvrTempDebDef_C DDRC_DurDeb.IntlckChrgPlg_tiHBrgShCirBatt1DebOk_C DDRC_DurDeb.IntlckChrgPlg_tiHBrgShCirBatt1DebDef_C DDRC_DurDeb.IntlckChrgPlg_tiHBrgShCirBatt2DebOk_C DDRC_DurDeb.IntlckChrgPlg_tiHBrgShCirBatt2DebDef_C DDRC_DurDeb.IntlckChrgPlg_tiHBrgShCirGnd1DebOk_C DDRC_DurDeb.IntlckChrgPlg_tiHBrgShCirGnd1DebDef_C DDRC_DurDeb.IntlckChrgPlg_tiHBrgShCirGnd2DebOk_C DDRC_DurDeb.IntlckChrgPlg_tiHBrgShCirGnd2DebDef_C DDRC_DurDeb.IntlckChrgPlg_tiHBrgShCirOvrLdDebOk_C DDRC_DurDeb.IntlckChrgPlg_tiHBrgShCirOvrLdDebDef_C DDRC_DurDeb.IntlckChrgPlg_tiHBrgTempOvrCurrDebOk_C DDRC_DurDeb.IntlckChrgPlg_tiHBrgTempOvrCurrDebDef_C DDRC_DurDeb.IntlckChrgPlg_tiHBrgUndrVltgDebOk_C DDRC_DurDeb.IntlckChrgPlg_tiHBrgUndrVltgDebDef_C DDRC_DurDeb.PwmCtP_tiPhysRngHiDebOk_C DDRC_DurDeb.PwmCtP_tiPhysRngHiDebDef_C DDRC_DurDeb.PwmCtP_tiPhysRngLoDebOk_C DDRC_DurDeb.PwmCtP_tiPhysRngLoDebDef_C DDRC_DurDeb.PwmCtP_tiSRCMaxDebOk_C DDRC_DurDeb.PwmCtP_tiSRCMaxDebDef_C DDRC_DurDeb.PwrDistbnUnitT_tiPhysRngHiDebOk_C DDRC_DurDeb.PwrDistbnUnitT_tiPhysRngHiDebDef_C DDRC_DurDeb.PwrDistbnUnitT_tiPhysRngLoDebOk_C DDRC_DurDeb.PwrDistbnUnitT_tiPhysRngLoDebDef_C DDRC_DurDeb.PwrDistbnUnitT_tiSRCOpnDebOk_C DDRC_DurDeb.PwrDistbnUnitT_tiSRCOpnDebDef_C DDRC_DurDeb.SCtPmpRly_tiSCGDebOk_C DDRC_DurDeb.SCtPmpRly_tiSCGDebDef_C DDRC_DurDeb.SpplCooltPmpRly_tiSCGDebOk_C DDRC_DurDeb.SpplCooltPmpRly_tiSCGDebDef_C DDRC_DurDeb.UCtP_tiPhysRngHiDebOk_C DDRC_DurDeb.UCtP_tiPhysRngHiDebDef_C DDRC_DurDeb.UCtP_tiPhysRngLoDebOk_C DDRC_DurDeb.UCtP_tiPhysRngLoDebDef_C DDRC_DurDeb.UCtP_tiSRCOpnDebOk_C DDRC_DurDeb.UCtP_tiSRCOpnDebDef_C DDRC_DurDeb.UPxP1_tiPhysRngHiDebOk_C DDRC_DurDeb.UPxP1_tiPhysRngHiDebDef_C DDRC_DurDeb.UPxP1_tiPhysRngLoDebOk_C DDRC_DurDeb.UPxP1_tiPhysRngLoDebDef_C DDRC_DurDeb.UPxP1_tiSRCOpnDebOk_C DDRC_DurDeb.UPxP1_tiSRCOpnDebDef_C DDRC_DurDeb.VehV_tiPhysRngHiDebOk_C DDRC_DurDeb.VehV_tiPhysRngHiDebDef_C DDRC_DurDeb.VehV_tiPhysRngLoDebOk_C DDRC_DurDeb.VehV_tiPhysRngLoDebDef_C DDRC_DurDeb.VehV_tiSigCanDebOk_C DDRC_DurDeb.VehV_tiSigCanDebDef_C DDRC_DurDeb.VehV_tiSigCanSafeDebOk_C DDRC_DurDeb.VehV_tiSigCanSafeDebDef_C DDRC_DurDeb.SCtPmp1_numDiagGrdKey1DebOk_C DDRC_DurDeb.SCtPmp1_numDiagGrdKey1DebDef_C DDRC_DurDeb.SCtPmp1_numDiagGrdKey2DebOk_C DDRC_DurDeb.SCtPmp1_numDiagGrdKey2DebDef_C DDRC_DurDeb.SCtPmp1_numDiagGrdKey3DebOk_C DDRC_DurDeb.SCtPmp1_numDiagGrdKey3DebDef_C DDRC_DurDeb.SCtPmp1_numDiagGrdKey4DebOk_C DDRC_DurDeb.SCtPmp1_numDiagGrdKey4DebDef_C DDRC_DurDeb.SCtPmp1_numDiagGrdKey5DebOk_C DDRC_DurDeb.SCtPmp1_numDiagGrdKey5DebDef_C DDRC_DurDeb.AcExtChrgr_tiIBattExcddDebOk_C DDRC_DurDeb.AcExtChrgr_tiIBattExcddDebDef_C DDRC_DurDeb.AcExtChrgr_tiIInExcddDebOk_C DDRC_DurDeb.AcExtChrgr_tiIInExcddDebDef_C DDRC_DurDeb.AcExtChrgr_tiIOutDeDebOk_C DDRC_DurDeb.AcExtChrgr_tiIOutDeDebDef_C DDRC_DurDeb.AcExtChrgr_tiIOutExcddDebOk_C DDRC_DurDeb.AcExtChrgr_tiIOutExcddDebDef_C DDRC_DurDeb.AcExtChrgr_tiUOutDeDebOk_C DDRC_DurDeb.AcExtChrgr_tiUOutDeDebDef_C DDRC_DurDeb.Airbg_tiAbgHiSigFltDebOk_C DDRC_DurDeb.Airbg_tiAbgHiSigFltDebDef_C DDRC_DurDeb.Airbg_tiAbgIntPatFltDebOk_C DDRC_DurDeb.Airbg_tiAbgIntPatFltDebDef_C DDRC_DurDeb.Airbg_tiAbgLoSigFltDebOk_C DDRC_DurDeb.Airbg_tiAbgLoSigFltDebDef_C DDRC_DurDeb.Airbg_tiAbgUnkwnErrSigFltDebOk_C DDRC_DurDeb.Airbg_tiAbgUnkwnErrSigFltDebDef_C DDRC_DurDeb.Airbg_tiAirbgCanHWPlausDebOk_C DDRC_DurDeb.Airbg_tiAirbgCanHWPlausDebDef_C DDRC_DurDeb.Airbg_tiAirbgHWCanPlausDebOk_C DDRC_DurDeb.Airbg_tiAirbgHWCanPlausDebDef_C DDRC_DurDeb.Airbg_tiCrashEveOccDebOk_C DDRC_DurDeb.Airbg_tiCrashEveOccDebDef_C DDRC_DurDeb.Airbg_tiImpactDebOk_C DDRC_DurDeb.Airbg_tiImpactDebDef_C DDRC_DurDeb.Airbg_tiImpactMinorDebOk_C DDRC_DurDeb.Airbg_tiImpactMinorDebDef_C DDRC_DurDeb.Airbg_tiPerHiDebOk_C DDRC_DurDeb.Airbg_tiPerHiDebDef_C DDRC_DurDeb.Airbg_tiPerdRangeDebOk_C DDRC_DurDeb.Airbg_tiPerdRangeDebDef_C DDRC_DurDeb.BrkBstPmp_tiActtnDfctDebOk_C DDRC_DurDeb.BrkBstPmp_tiActtnDfctDebDef_C DDRC_DurDeb.BrkBstPmp_tiDeactvnDfctDebOk_C DDRC_DurDeb.BrkBstPmp_tiDeactvnDfctDebDef_C DDRC_DurDeb.CbnHeatgHeatr_tiHsScbDebOk_C DDRC_DurDeb.CbnHeatgHeatr_tiHsScbDebDef_C DDRC_DurDeb.CbnHeatgHeatr_tiHsScgDebOk_C DDRC_DurDeb.CbnHeatgHeatr_tiHsScgDebDef_C DDRC_DurDeb.CbnHeatgHeatr_tiLsOlDebOk_C DDRC_DurDeb.CbnHeatgHeatr_tiLsOlDebDef_C DDRC_DurDeb.CbnHeatgHeatr_tiLsScbDebOk_C DDRC_DurDeb.CbnHeatgHeatr_tiLsScbDebDef_C DDRC_DurDeb.CbnHeatgHeatr_tiLsScgDebOk_C DDRC_DurDeb.CbnHeatgHeatr_tiLsScgDebDef_C DDRC_DurDeb.CbnHeatgHeatr_tiUnUsedDebOk_C DDRC_DurDeb.CbnHeatgHeatr_tiUnUsedDebDef_C DDRC_DurDeb.ChrgnCntct_tiHsOtDebOk_C DDRC_DurDeb.ChrgnCntct_tiHsOtDebDef_C DDRC_DurDeb.ChrgnCntct_tiHsScbDebOk_C DDRC_DurDeb.ChrgnCntct_tiHsScbDebDef_C DDRC_DurDeb.ChrgnCntct_tiHsScgDebOk_C DDRC_DurDeb.ChrgnCntct_tiHsScgDebDef_C DDRC_DurDeb.ChrgnCntct_tiLsNegOlDebOk_C DDRC_DurDeb.ChrgnCntct_tiLsNegOlDebDef_C DDRC_DurDeb.ChrgnCntct_tiLsNegOtDebOk_C DDRC_DurDeb.ChrgnCntct_tiLsNegOtDebDef_C DDRC_DurDeb.ChrgnCntct_tiLsNegScbDebOk_C DDRC_DurDeb.ChrgnCntct_tiLsNegScbDebDef_C DDRC_DurDeb.ChrgnCntct_tiLsNegScgDebOk_C DDRC_DurDeb.ChrgnCntct_tiLsNegScgDebDef_C DDRC_DurDeb.ChrgnCntct_tiLsPosOlDebOk_C DDRC_DurDeb.ChrgnCntct_tiLsPosOlDebDef_C DDRC_DurDeb.ChrgnCntct_tiLsPosOtDebOk_C DDRC_DurDeb.ChrgnCntct_tiLsPosOtDebDef_C DDRC_DurDeb.ChrgnCntct_tiLsPosScbDebOk_C DDRC_DurDeb.ChrgnCntct_tiLsPosScbDebDef_C DDRC_DurDeb.ChrgnCntct_tiLsPosScgDebOk_C DDRC_DurDeb.ChrgnCntct_tiLsPosScgDebDef_C DDRC_DurDeb.ChrgnCntct_tiUnUsedDebOk_C DDRC_DurDeb.ChrgnCntct_tiUnUsedDebDef_C DDRC_DurDeb.Com_tiACCmprFltLvlRes_CDebOk_C DDRC_DurDeb.Com_tiACCmprFltLvlRes_CDebDef_C DDRC_DurDeb.Com_tiAdpActvDChaFailr_CDebOk_C DDRC_DurDeb.Com_tiAdpActvDChaFailr_CDebDef_C DDRC_DurDeb.Com_tiAirbcuFlt_CDebOk_C DDRC_DurDeb.Com_tiAirbcuFlt_CDebDef_C DDRC_DurDeb.Com_tiAirbgCan_CDebOk_C DDRC_DurDeb.Com_tiAirbgCan_CDebDef_C DDRC_DurDeb.Com_tiBlowrRlyErrDebOk_C DDRC_DurDeb.Com_tiBlowrRlyErrDebDef_C DDRC_DurDeb.Com_tiBrkSwtFlt_CDebOk_C DDRC_DurDeb.Com_tiBrkSwtFlt_CDebDef_C DDRC_DurDeb.Com_tiComBrkMai_CDebOk_C DDRC_DurDeb.Com_tiComBrkMai_CDebDef_C DDRC_DurDeb.Com_tiComChrgrEVCont_CDebOk_C DDRC_DurDeb.Com_tiComChrgrEVCont_CDebDef_C DDRC_DurDeb.Com_tiComChrgrEVtBlink_CDebOk_C DDRC_DurDeb.Com_tiComChrgrEVtBlink_CDebDef_C DDRC_DurDeb.Com_tiComChrgrMstBlink_CDebOk_C DDRC_DurDeb.Com_tiComChrgrMstBlink_CDebDef_C DDRC_DurDeb.Com_tiComChrgrMstCont_CDebOk_C DDRC_DurDeb.Com_tiComChrgrMstCont_CDebDef_C DDRC_DurDeb.Com_tiComChrgrSVSBlink_CDebOk_C DDRC_DurDeb.Com_tiComChrgrSVSBlink_CDebDef_C DDRC_DurDeb.Com_tiComChrgrSVSCont_CDebOk_C DDRC_DurDeb.Com_tiComChrgrSVSCont_CDebDef_C DDRC_DurDeb.Com_tiComDcdcEVBlink_CDebOk_C DDRC_DurDeb.Com_tiComDcdcEVBlink_CDebDef_C DDRC_DurDeb.Com_tiComDcdcEVCont_CDebOk_C DDRC_DurDeb.Com_tiComDcdcEVCont_CDebDef_C DDRC_DurDeb.Com_tiComDcdcFltLvl2_CDebOk_C DDRC_DurDeb.Com_tiComDcdcFltLvl2_CDebDef_C DDRC_DurDeb.Com_tiComDcdcFltLvl3_CDebOk_C DDRC_DurDeb.Com_tiComDcdcFltLvl3_CDebDef_C DDRC_DurDeb.Com_tiComDcdcFltLvl4_CDebOk_C DDRC_DurDeb.Com_tiComDcdcFltLvl4_CDebDef_C DDRC_DurDeb.Com_tiComDcdcFltLvl5_CDebOk_C DDRC_DurDeb.Com_tiComDcdcFltLvl5_CDebDef_C DDRC_DurDeb.Com_tiComDcdcFltLvlRes_CDebOk_C DDRC_DurDeb.Com_tiComDcdcFltLvlRes_CDebDef_C DDRC_DurDeb.Com_tiComDcdcMstBlink_CDebOk_C DDRC_DurDeb.Com_tiComDcdcMstBlink_CDebDef_C DDRC_DurDeb.Com_tiComDcdcMstCont_CDebOk_C DDRC_DurDeb.Com_tiComDcdcMstCont_CDebDef_C DDRC_DurDeb.Com_tiComDcdcSVSBlink_CDebOk_C DDRC_DurDeb.Com_tiComDcdcSVSBlink_CDebDef_C DDRC_DurDeb.Com_tiComDcdcSVSCont_CDebOk_C DDRC_DurDeb.Com_tiComDcdcSVSCont_CDebDef_C DDRC_DurDeb.Com_tiComElMIIvtrFltLvl2_CDebOk_C DDRC_DurDeb.Com_tiComElMIIvtrFltLvl2_CDebDef_C DDRC_DurDeb.Com_tiComElMIIvtrFltLvl3_CDebOk_C DDRC_DurDeb.Com_tiComElMIIvtrFltLvl3_CDebDef_C DDRC_DurDeb.Com_tiComElMIIvtrFltLvl4DebOk_C DDRC_DurDeb.Com_tiComElMIIvtrFltLvl4DebDef_C DDRC_DurDeb.Com_tiComElMIIvtrFltLvl5DebOk_C DDRC_DurDeb.Com_tiComElMIIvtrFltLvl5DebDef_C DDRC_DurDeb.Com_tiComElMIIvtrFltLvlRes_CDebOk_C DDRC_DurDeb.Com_tiComElMIIvtrFltLvlRes_CDebDef_C DDRC_DurDeb.Com_tiComEmacEVBlink_CDebOk_C DDRC_DurDeb.Com_tiComEmacEVBlink_CDebDef_C DDRC_DurDeb.Com_tiComEmacEVCont_CDebOk_C DDRC_DurDeb.Com_tiComEmacEVCont_CDebDef_C DDRC_DurDeb.Com_tiComEmacMstCont_CDebOk_C DDRC_DurDeb.Com_tiComEmacMstCont_CDebDef_C DDRC_DurDeb.Com_tiComEmacMsttBlink_CDebOk_C DDRC_DurDeb.Com_tiComEmacMsttBlink_CDebDef_C DDRC_DurDeb.Com_tiComEmacSVSBlink_CDebOk_C DDRC_DurDeb.Com_tiComEmacSVSBlink_CDebDef_C DDRC_DurDeb.Com_tiComEmacSVSCont_CDebOk_C DDRC_DurDeb.Com_tiComEmacSVSCont_CDebDef_C DDRC_DurDeb.Com_tiComGunCntInfoWkuReq_CDebOk_C DDRC_DurDeb.Com_tiComGunCntInfoWkuReq_CDebDef_C DDRC_DurDeb.Com_tiComHillHldFlt_CDebOk_C DDRC_DurDeb.Com_tiComHillHldFlt_CDebDef_C DDRC_DurDeb.Com_tiComHvBattRchrgWkuReq_CDebOk_C DDRC_DurDeb.Com_tiComHvBattRchrgWkuReq_CDebDef_C DDRC_DurDeb.Com_tiComHvbFltLvl2_CDebOk_C DDRC_DurDeb.Com_tiComHvbFltLvl2_CDebDef_C DDRC_DurDeb.Com_tiComHvbFltLvl3_CDebOk_C DDRC_DurDeb.Com_tiComHvbFltLvl3_CDebDef_C DDRC_DurDeb.Com_tiComHvbFltLvl4_CDebOk_C DDRC_DurDeb.Com_tiComHvbFltLvl4_CDebDef_C DDRC_DurDeb.Com_tiComHvbFltLvl5_CDebOk_C DDRC_DurDeb.Com_tiComHvbFltLvl5_CDebDef_C DDRC_DurDeb.Com_tiComHvbFltLvlRes_CDebOk_C DDRC_DurDeb.Com_tiComHvbFltLvlRes_CDebDef_C DDRC_DurDeb.Com_tiComHvbMstBlink_CDebOk_C DDRC_DurDeb.Com_tiComHvbMstBlink_CDebDef_C DDRC_DurDeb.Com_tiComHvbMstCont_CDebOk_C DDRC_DurDeb.Com_tiComHvbMstCont_CDebDef_C DDRC_DurDeb.Com_tiComImmoUnlockWkuReq_CDebOk_C DDRC_DurDeb.Com_tiComImmoUnlockWkuReq_CDebDef_C DDRC_DurDeb.Com_tiComInfoReqPtlWkuReq_CDebOk_C DDRC_DurDeb.Com_tiComInfoReqPtlWkuReq_CDebDef_C DDRC_DurDeb.Com_tiComOBCFltLvl2_CDebOk_C DDRC_DurDeb.Com_tiComOBCFltLvl2_CDebDef_C DDRC_DurDeb.Com_tiComOBCFltLvl3_CDebOk_C DDRC_DurDeb.Com_tiComOBCFltLvl3_CDebDef_C DDRC_DurDeb.Com_tiComOBCFltLvl4_CDebOk_C DDRC_DurDeb.Com_tiComOBCFltLvl4_CDebDef_C DDRC_DurDeb.Com_tiComOBCFltLvl5_CDebOk_C DDRC_DurDeb.Com_tiComOBCFltLvl5_CDebDef_C DDRC_DurDeb.Com_tiComOBCFltLvlRes_CDebOk_C DDRC_DurDeb.Com_tiComOBCFltLvlRes_CDebDef_C DDRC_DurDeb.Com_tiComPostOperationWkuReq_CDebOk_C DDRC_DurDeb.Com_tiComPostOperationWkuReq_CDebDef_C DDRC_DurDeb.Com_tiComPreCondElecWkuReq_CDebOk_C DDRC_DurDeb.Com_tiComPreCondElecWkuReq_CDebDef_C DDRC_DurDeb.Com_tiComRemUnlckWkuReq_CDebOk_C DDRC_DurDeb.Com_tiComRemUnlckWkuReq_CDebDef_C DDRC_DurDeb.Com_tiComStpDlyHMIWkuReq_CDebOk_C DDRC_DurDeb.Com_tiComStpDlyHMIWkuReq_CDebDef_C DDRC_DurDeb.Com_tiComVehVCanErr_CDebOk_C DDRC_DurDeb.Com_tiComVehVCanErr_CDebDef_C DDRC_DurDeb.Com_tiComflgCurMeasmtErr_CDebOk_C DDRC_DurDeb.Com_tiComflgCurMeasmtErr_CDebDef_C DDRC_DurDeb.Com_tiComflgCurMeasmtSysErr_CDebOk_C DDRC_DurDeb.Com_tiComflgCurMeasmtSysErr_CDebDef_C DDRC_DurDeb.Com_tiComflgCurMeasmtVld_CDebOk_C DDRC_DurDeb.Com_tiComflgCurMeasmtVld_CDebDef_C DDRC_DurDeb.Com_tiComflgCurRngErr_CDebOk_C DDRC_DurDeb.Com_tiComflgCurRngErr_CDebDef_C DDRC_DurDeb.Com_tiComflgTPcbMeasmtErr_CDebOk_C DDRC_DurDeb.Com_tiComflgTPcbMeasmtErr_CDebDef_C DDRC_DurDeb.Com_tiComflgTPcbMeasmtVld_CDebOk_C DDRC_DurDeb.Com_tiComflgTPcbMeasmtVld_CDebDef_C DDRC_DurDeb.Com_tiComflgTPcbRngErr_CDebOk_C DDRC_DurDeb.Com_tiComflgTPcbRngErr_CDebDef_C DDRC_DurDeb.Com_tiComflgTPcbSysErr_CDebOk_C DDRC_DurDeb.Com_tiComflgTPcbSysErr_CDebDef_C DDRC_DurDeb.Com_tiComflgTShntMeasmtErr_CDebOk_C DDRC_DurDeb.Com_tiComflgTShntMeasmtErr_CDebDef_C DDRC_DurDeb.Com_tiComflgTShntMeasmtVld_CDebOk_C DDRC_DurDeb.Com_tiComflgTShntMeasmtVld_CDebDef_C DDRC_DurDeb.Com_tiComflgTShntRngErr_CDebOk_C DDRC_DurDeb.Com_tiComflgTShntRngErr_CDebDef_C DDRC_DurDeb.Com_tiComflgTShntSysErr_CDebOk_C DDRC_DurDeb.Com_tiComflgTShntSysErr_CDebDef_C DDRC_DurDeb.Com_tiComflgVoltMeasmtErr_CDebOk_C DDRC_DurDeb.Com_tiComflgVoltMeasmtErr_CDebDef_C DDRC_DurDeb.Com_tiComflgVoltMeasmtSysErr_CDebOk_C DDRC_DurDeb.Com_tiComflgVoltMeasmtSysErr_CDebDef_C DDRC_DurDeb.Com_tiComflgVoltMeasmtVld_CDebOk_C DDRC_DurDeb.Com_tiComflgVoltMeasmtVld_CDebDef_C DDRC_DurDeb.Com_tiComflgVoltRngErr_CDebOk_C DDRC_DurDeb.Com_tiComflgVoltRngErr_CDebDef_C DDRC_DurDeb.Com_tiETogFailrLvl3_CDebOk_C DDRC_DurDeb.Com_tiETogFailrLvl3_CDebDef_C DDRC_DurDeb.Com_tiETogFailrLvl4_CDebOk_C DDRC_DurDeb.Com_tiETogFailrLvl4_CDebDef_C DDRC_DurDeb.Com_tiHvbEVLmpBlink_CDebOk_C DDRC_DurDeb.Com_tiHvbEVLmpBlink_CDebDef_C DDRC_DurDeb.Com_tiHvbEVLmpCont_CDebOk_C DDRC_DurDeb.Com_tiHvbEVLmpCont_CDebDef_C DDRC_DurDeb.Com_tiHvbSVSBlink_CDebOk_C DDRC_DurDeb.Com_tiHvbSVSBlink_CDebDef_C DDRC_DurDeb.Com_tiHvbSVSCont_CDebOk_C DDRC_DurDeb.Com_tiHvbSVSCont_CDebDef_C DDRC_DurDeb.Com_tiLINBusBlkDebOk_C DDRC_DurDeb.Com_tiLINBusBlkDebDef_C DDRC_DurDeb.Com_tiPDUProgmFailr_CDebOk_C DDRC_DurDeb.Com_tiPDUProgmFailr_CDebDef_C DDRC_DurDeb.Com_tiPrkgBrkFailrDebOk_C DDRC_DurDeb.Com_tiPrkgBrkFailrDebDef_C DDRC_DurDeb.Com_tiPtSysLimErrDebOk_C DDRC_DurDeb.Com_tiPtSysLimErrDebDef_C DDRC_DurDeb.Com_tiPwrMaxDchaShoLo_CDebOk_C DDRC_DurDeb.Com_tiPwrMaxDchaShoLo_CDebDef_C DDRC_DurDeb.Com_tiVehVCanAvl_CDebOk_C DDRC_DurDeb.Com_tiVehVCanAvl_CDebDef_C DDRC_DurDeb.Com_tieTogFailrLvlRes_CDebOk_C DDRC_DurDeb.Com_tieTogFailrLvlRes_CDebDef_C DDRC_DurDeb.Com_tiflgBrkMaiDiag_CDebOk_C DDRC_DurDeb.Com_tiflgBrkMaiDiag_CDebDef_C DDRC_DurDeb.Com_tistHvbIsoMeasmtRes_CDebOk_C DDRC_DurDeb.Com_tistHvbIsoMeasmtRes_CDebDef_C DDRC_DurDeb.DFC_tiDrvModPosnDfctDebOk_C DDRC_DurDeb.DFC_tiDrvModPosnDfctDebDef_C DDRC_DurDeb.Dcdc_tiFwdModStuckDebOk_C DDRC_DurDeb.Dcdc_tiFwdModStuckDebDef_C DDRC_DurDeb.Dcdc_tiLvUDifMaxFltDebOk_C DDRC_DurDeb.Dcdc_tiLvUDifMaxFltDebDef_C DDRC_DurDeb.Dcdc_tiOffModStuckDebOk_C DDRC_DurDeb.Dcdc_tiOffModStuckDebDef_C DDRC_DurDeb.Dcdc_tiOperModFailrDebOk_C DDRC_DurDeb.Dcdc_tiOperModFailrDebDef_C DDRC_DurDeb.Dcdc_tiPrecModStuckDebOk_C DDRC_DurDeb.Dcdc_tiPrecModStuckDebDef_C DDRC_DurDeb.DrvDoor_tiOpnDebOk_C DDRC_DurDeb.DrvDoor_tiOpnDebDef_C DDRC_DurDeb.DrvStblt_tiOpnDebOk_C DDRC_DurDeb.DrvStblt_tiOpnDebDef_C DDRC_DurDeb.Ebs_tiEbsSnsrStDebOk_C DDRC_DurDeb.Ebs_tiEbsSnsrStDebDef_C DDRC_DurDeb.Ebs_tiLvBattSocDiagLoDebOk_C DDRC_DurDeb.Ebs_tiLvBattSocDiagLoDebDef_C DDRC_DurDeb.Ebs_tiLvBattUDiagFltLvl1DebOk_C DDRC_DurDeb.Ebs_tiLvBattUDiagFltLvl1DebDef_C DDRC_DurDeb.Ebs_tiLvBattUDiagFltLvl2DebOk_C DDRC_DurDeb.Ebs_tiLvBattUDiagFltLvl2DebDef_C DDRC_DurDeb.Ebs_tiLvBattUDiagLoDebOk_C DDRC_DurDeb.Ebs_tiLvBattUDiagLoDebDef_C DDRC_DurDeb.Ebs_tiLvBusUDiagDiOperDebOk_C DDRC_DurDeb.Ebs_tiLvBusUDiagDiOperDebDef_C DDRC_DurDeb.Ebs_tiSofASILErrDebOk_C DDRC_DurDeb.Ebs_tiSofASILErrDebDef_C DDRC_DurDeb.ElTS_tiPtSysLimDrvErrDebOk_C DDRC_DurDeb.ElTS_tiPtSysLimDrvErrDebDef_C DDRC_DurDeb.ElTS_tiPtSysLimRgnErrDebOk_C DDRC_DurDeb.ElTS_tiPtSysLimRgnErrDebDef_C DDRC_DurDeb.HLCCcs_tiFwDwnlDebOk_C DDRC_DurDeb.HLCCcs_tiFwDwnlDebDef_C DDRC_DurDeb.HvBatt_tiChrgPwrMaxDebOk_C DDRC_DurDeb.HvBatt_tiChrgPwrMaxDebDef_C DDRC_DurDeb.HvBatt_tiCrashDetdDebOk_C DDRC_DurDeb.HvBatt_tiCrashDetdDebDef_C DDRC_DurDeb.HvBatt_tiDchaPwrMaxDebOk_C DDRC_DurDeb.HvBatt_tiDchaPwrMaxDebDef_C DDRC_DurDeb.HvBatt_tiEmgyOffDebOk_C DDRC_DurDeb.HvBatt_tiEmgyOffDebDef_C DDRC_DurDeb.HvBatt_tiEmgyOffIntlckDebOk_C DDRC_DurDeb.HvBatt_tiEmgyOffIntlckDebDef_C DDRC_DurDeb.HvBatt_tiEmgyOffReqDebOk_C DDRC_DurDeb.HvBatt_tiEmgyOffReqDebDef_C DDRC_DurDeb.HvBatt_tiFltModDebOk_C DDRC_DurDeb.HvBatt_tiFltModDebDef_C DDRC_DurDeb.HvBatt_tiIReqToChrgrErrDebOk_C DDRC_DurDeb.HvBatt_tiIReqToChrgrErrDebDef_C DDRC_DurDeb.HvBatt_tiIReqToChrgrIniDebOk_C DDRC_DurDeb.HvBatt_tiIReqToChrgrIniDebDef_C DDRC_DurDeb.HvBatt_tiIninToutDebOk_C DDRC_DurDeb.HvBatt_tiIninToutDebDef_C DDRC_DurDeb.HvBatt_tiIntlckStDebOk_C DDRC_DurDeb.HvBatt_tiIntlckStDebDef_C DDRC_DurDeb.HvBatt_tiIsoFltDebOk_C DDRC_DurDeb.HvBatt_tiIsoFltDebDef_C DDRC_DurDeb.HvBatt_tiLimdPwrDebOk_C DDRC_DurDeb.HvBatt_tiLimdPwrDebDef_C DDRC_DurDeb.HvBatt_tiMaiSwtClsngDebOk_C DDRC_DurDeb.HvBatt_tiMaiSwtClsngDebDef_C DDRC_DurDeb.HvBatt_tiMaiSwtFltDebOk_C DDRC_DurDeb.HvBatt_tiMaiSwtFltDebDef_C DDRC_DurDeb.HvBatt_tiMaiSwtOpenDebOk_C DDRC_DurDeb.HvBatt_tiMaiSwtOpenDebDef_C DDRC_DurDeb.HvBatt_tiMaiSwtOpngDebOk_C DDRC_DurDeb.HvBatt_tiMaiSwtOpngDebDef_C DDRC_DurDeb.HvBatt_tiMaiSwtWlddDebOk_C DDRC_DurDeb.HvBatt_tiMaiSwtWlddDebDef_C DDRC_DurDeb.HvBatt_tiNegCntctrCntErrDebOk_C DDRC_DurDeb.HvBatt_tiNegCntctrCntErrDebDef_C DDRC_DurDeb.HvBatt_tiOperModChrgPlausyDebOk_C DDRC_DurDeb.HvBatt_tiOperModChrgPlausyDebDef_C DDRC_DurDeb.HvBatt_tiOverTDernDebOk_C DDRC_DurDeb.HvBatt_tiOverTDernDebDef_C DDRC_DurDeb.HvBatt_tiPosCntctrCntErrDebOk_C DDRC_DurDeb.HvBatt_tiPosCntctrCntErrDebDef_C DDRC_DurDeb.HvBatt_tiPrecCntctrCntErrDebOk_C DDRC_DurDeb.HvBatt_tiPrecCntctrCntErrDebDef_C DDRC_DurDeb.HvBatt_tiPwrDistbnTDernDebOk_C DDRC_DurDeb.HvBatt_tiPwrDistbnTDernDebDef_C DDRC_DurDeb.HvBatt_tiPwrDistbnTInhbnDebOk_C DDRC_DurDeb.HvBatt_tiPwrDistbnTInhbnDebDef_C DDRC_DurDeb.HvBatt_tiRatRSohErrDebOk_C DDRC_DurDeb.HvBatt_tiRatRSohErrDebDef_C DDRC_DurDeb.HvBatt_tiRatSohErrDebOk_C DDRC_DurDeb.HvBatt_tiRatSohErrDebDef_C DDRC_DurDeb.HvBatt_tiSngIsoWarnDebOk_C DDRC_DurDeb.HvBatt_tiSngIsoWarnDebDef_C DDRC_DurDeb.HvBatt_tiSrvPlgDiscntDebOk_C DDRC_DurDeb.HvBatt_tiSrvPlgDiscntDebDef_C DDRC_DurDeb.HvBatt_tiUNomChrgnErrDebOk_C DDRC_DurDeb.HvBatt_tiUNomChrgnErrDebDef_C DDRC_DurDeb.HvBatt_tiUNomChrgnIniDebOk_C DDRC_DurDeb.HvBatt_tiUNomChrgnIniDebDef_C DDRC_DurDeb.HvBatt_tiUnderTDernDebOk_C DDRC_DurDeb.HvBatt_tiUnderTDernDebDef_C DDRC_DurDeb.PEnv_tiSigRngChkDebOk_C DDRC_DurDeb.PEnv_tiSigRngChkDebDef_C DDRC_DurDeb.PLnCChp_tiPLnCDeactvnFaildDebOk_C DDRC_DurDeb.PLnCChp_tiPLnCDeactvnFaildDebDef_C DDRC_DurDeb.SCtPmp1_tiFailSafeNotSucDebOk_C DDRC_DurDeb.SCtPmp1_tiFailSafeNotSucDebDef_C DDRC_DurDeb.SCtPmp1_tiSCGDebOk_C DDRC_DurDeb.SCtPmp1_tiSCGDebDef_C DDRC_DurDeb.VehCoorn_tiDrvrNotPrsntDebOk_C DDRC_DurDeb.VehCoorn_tiDrvrNotPrsntDebDef_C DDRC_DurDeb.BrkBstPmp_numPLeakDfctDebOk_C DDRC_DurDeb.BrkBstPmp_numPLeakDfctDebDef_C DDRC_DurDeb.Com_numCom082hTooShortDebOk_C DDRC_DurDeb.Com_numCom082hTooShortDebDef_C DDRC_DurDeb.Com_numCom092hTooShortDebOk_C DDRC_DurDeb.Com_numCom092hTooShortDebDef_C DDRC_DurDeb.Com_numCom205hAbsentDebOk_C DDRC_DurDeb.Com_numCom205hAbsentDebDef_C DDRC_DurDeb.Com_numCom205hChecksumDebOk_C DDRC_DurDeb.Com_numCom205hChecksumDebDef_C DDRC_DurDeb.Com_numCom205hCounterDebOk_C DDRC_DurDeb.Com_numCom205hCounterDebDef_C DDRC_DurDeb.Com_numCom205hTooShortDebOk_C DDRC_DurDeb.Com_numCom205hTooShortDebDef_C DDRC_DurDeb.Com_numCom217hAbsentDebOk_C DDRC_DurDeb.Com_numCom217hAbsentDebDef_C DDRC_DurDeb.Com_numCom217hChecksumDebOk_C DDRC_DurDeb.Com_numCom217hChecksumDebDef_C DDRC_DurDeb.Com_numCom217hCounterDebOk_C DDRC_DurDeb.Com_numCom217hCounterDebDef_C DDRC_DurDeb.Com_numCom217hTooShortDebOk_C DDRC_DurDeb.Com_numCom217hTooShortDebDef_C DDRC_DurDeb.Com_numCom227hAbsentDebOk_C DDRC_DurDeb.Com_numCom227hAbsentDebDef_C DDRC_DurDeb.Com_numCom227hTooShortDebOk_C DDRC_DurDeb.Com_numCom227hTooShortDebDef_C DDRC_DurDeb.Com_numCom237hAbsentDebOk_C DDRC_DurDeb.Com_numCom237hAbsentDebDef_C DDRC_DurDeb.Com_numCom237hChecksumDebOk_C DDRC_DurDeb.Com_numCom237hChecksumDebDef_C DDRC_DurDeb.Com_numCom237hCounterDebOk_C DDRC_DurDeb.Com_numCom237hCounterDebDef_C DDRC_DurDeb.Com_numCom237hTooShortDebOk_C DDRC_DurDeb.Com_numCom237hTooShortDebDef_C DDRC_DurDeb.Com_numCom259hAbsentDebOk_C DDRC_DurDeb.Com_numCom259hAbsentDebDef_C DDRC_DurDeb.Com_numCom259hChecksumDebOk_C DDRC_DurDeb.Com_numCom259hChecksumDebDef_C DDRC_DurDeb.Com_numCom259hCounterDebOk_C DDRC_DurDeb.Com_numCom259hCounterDebDef_C DDRC_DurDeb.Com_numCom259hTooShortDebOk_C DDRC_DurDeb.Com_numCom259hTooShortDebDef_C DDRC_DurDeb.Com_numCom273hAbsentDebOk_C DDRC_DurDeb.Com_numCom273hAbsentDebDef_C DDRC_DurDeb.Com_numCom273hChecksumDebOk_C DDRC_DurDeb.Com_numCom273hChecksumDebDef_C DDRC_DurDeb.Com_numCom273hCounterDebOk_C DDRC_DurDeb.Com_numCom273hCounterDebDef_C DDRC_DurDeb.Com_numCom273hTooShortDebOk_C DDRC_DurDeb.Com_numCom273hTooShortDebDef_C DDRC_DurDeb.Com_numCom275hAbsentDebOk_C DDRC_DurDeb.Com_numCom275hAbsentDebDef_C DDRC_DurDeb.Com_numCom275hChecksumDebOk_C DDRC_DurDeb.Com_numCom275hChecksumDebDef_C DDRC_DurDeb.Com_numCom275hCounterDebOk_C DDRC_DurDeb.Com_numCom275hCounterDebDef_C DDRC_DurDeb.Com_numCom275hTooShortDebOk_C DDRC_DurDeb.Com_numCom275hTooShortDebDef_C DDRC_DurDeb.Com_numCom283hAbsentDebOk_C DDRC_DurDeb.Com_numCom283hAbsentDebDef_C DDRC_DurDeb.Com_numCom283hTooShortDebOk_C DDRC_DurDeb.Com_numCom283hTooShortDebDef_C DDRC_DurDeb.Com_numCom285hAbsentDebOk_C DDRC_DurDeb.Com_numCom285hAbsentDebDef_C DDRC_DurDeb.Com_numCom285hChecksumDebOk_C DDRC_DurDeb.Com_numCom285hChecksumDebDef_C DDRC_DurDeb.Com_numCom285hCounterDebOk_C DDRC_DurDeb.Com_numCom285hCounterDebDef_C DDRC_DurDeb.Com_numCom285hTooShortDebOk_C DDRC_DurDeb.Com_numCom285hTooShortDebDef_C DDRC_DurDeb.Com_numCom293hAbsentDebOk_C DDRC_DurDeb.Com_numCom293hAbsentDebDef_C DDRC_DurDeb.Com_numCom293hChecksumDebOk_C DDRC_DurDeb.Com_numCom293hChecksumDebDef_C DDRC_DurDeb.Com_numCom293hCounterDebOk_C DDRC_DurDeb.Com_numCom293hCounterDebDef_C DDRC_DurDeb.Com_numCom293hTooShortDebOk_C DDRC_DurDeb.Com_numCom293hTooShortDebDef_C DDRC_DurDeb.Com_numCom308hAbsentDebOk_C DDRC_DurDeb.Com_numCom308hAbsentDebDef_C DDRC_DurDeb.Com_numCom308hChecksumDebOk_C DDRC_DurDeb.Com_numCom308hChecksumDebDef_C DDRC_DurDeb.Com_numCom308hCounterDebOk_C DDRC_DurDeb.Com_numCom308hCounterDebDef_C DDRC_DurDeb.Com_numCom308hTooShortDebOk_C DDRC_DurDeb.Com_numCom308hTooShortDebDef_C DDRC_DurDeb.Com_numCom318hAbsentDebOk_C DDRC_DurDeb.Com_numCom318hAbsentDebDef_C DDRC_DurDeb.Com_numCom318hChecksumDebOk_C DDRC_DurDeb.Com_numCom318hChecksumDebDef_C DDRC_DurDeb.Com_numCom318hCounterDebOk_C DDRC_DurDeb.Com_numCom318hCounterDebDef_C DDRC_DurDeb.Com_numCom318hTooShortDebOk_C DDRC_DurDeb.Com_numCom318hTooShortDebDef_C DDRC_DurDeb.Com_numCom325hAbsentDebOk_C DDRC_DurDeb.Com_numCom325hAbsentDebDef_C DDRC_DurDeb.Com_numCom325hChecksumDebOk_C DDRC_DurDeb.Com_numCom325hChecksumDebDef_C DDRC_DurDeb.Com_numCom325hCounterDebOk_C DDRC_DurDeb.Com_numCom325hCounterDebDef_C DDRC_DurDeb.Com_numCom325hTooShortDebOk_C DDRC_DurDeb.Com_numCom325hTooShortDebDef_C DDRC_DurDeb.Com_numCom335hAbsentDebOk_C DDRC_DurDeb.Com_numCom335hAbsentDebDef_C DDRC_DurDeb.Com_numCom335hChecksumDebOk_C DDRC_DurDeb.Com_numCom335hChecksumDebDef_C DDRC_DurDeb.Com_numCom335hCounterDebOk_C DDRC_DurDeb.Com_numCom335hCounterDebDef_C DDRC_DurDeb.Com_numCom335hTooShortDebOk_C DDRC_DurDeb.Com_numCom335hTooShortDebDef_C DDRC_DurDeb.Com_numCom351hAbsentDebOk_C DDRC_DurDeb.Com_numCom351hAbsentDebDef_C DDRC_DurDeb.Com_numCom351hTooShortDebOk_C DDRC_DurDeb.Com_numCom351hTooShortDebDef_C DDRC_DurDeb.Com_numCom38DhAbsentDebOk_C DDRC_DurDeb.Com_numCom38DhAbsentDebDef_C DDRC_DurDeb.Com_numCom38DhChecksumDebOk_C DDRC_DurDeb.Com_numCom38DhChecksumDebDef_C DDRC_DurDeb.Com_numCom38DhCounterDebOk_C DDRC_DurDeb.Com_numCom38DhCounterDebDef_C DDRC_DurDeb.Com_numCom38DhTooShortDebOk_C DDRC_DurDeb.Com_numCom38DhTooShortDebDef_C DDRC_DurDeb.Com_numCom412hAbsentDebOk_C DDRC_DurDeb.Com_numCom412hAbsentDebDef_C DDRC_DurDeb.Com_numCom412hChecksumDebOk_C DDRC_DurDeb.Com_numCom412hChecksumDebDef_C DDRC_DurDeb.Com_numCom412hCounterDebOk_C DDRC_DurDeb.Com_numCom412hCounterDebDef_C DDRC_DurDeb.Com_numCom412hTooShortDebOk_C DDRC_DurDeb.Com_numCom412hTooShortDebDef_C DDRC_DurDeb.Com_numCom427hAbsentDebOk_C DDRC_DurDeb.Com_numCom427hAbsentDebDef_C DDRC_DurDeb.Com_numCom427hTooShortDebOk_C DDRC_DurDeb.Com_numCom427hTooShortDebDef_C DDRC_DurDeb.Com_numCom432hAbsentDebOk_C DDRC_DurDeb.Com_numCom432hAbsentDebDef_C DDRC_DurDeb.Com_numCom432hChecksumDebOk_C DDRC_DurDeb.Com_numCom432hChecksumDebDef_C DDRC_DurDeb.Com_numCom432hCounterDebOk_C DDRC_DurDeb.Com_numCom432hCounterDebDef_C DDRC_DurDeb.Com_numCom432hTooShortDebOk_C DDRC_DurDeb.Com_numCom432hTooShortDebDef_C DDRC_DurDeb.Com_numCom435hAbsentDebOk_C DDRC_DurDeb.Com_numCom435hAbsentDebDef_C DDRC_DurDeb.Com_numCom435hTooShortDebOk_C DDRC_DurDeb.Com_numCom435hTooShortDebDef_C DDRC_DurDeb.Com_numCom442hAbsentDebOk_C DDRC_DurDeb.Com_numCom442hAbsentDebDef_C DDRC_DurDeb.Com_numCom442hTooShortDebOk_C DDRC_DurDeb.Com_numCom442hTooShortDebDef_C DDRC_DurDeb.Com_numCom453hAbsentDebOk_C DDRC_DurDeb.Com_numCom453hAbsentDebDef_C DDRC_DurDeb.Com_numCom453hTooShortDebOk_C DDRC_DurDeb.Com_numCom453hTooShortDebDef_C DDRC_DurDeb.Com_numCom455hAbsentDebOk_C DDRC_DurDeb.Com_numCom455hAbsentDebDef_C DDRC_DurDeb.Com_numCom455hTooShortDebOk_C DDRC_DurDeb.Com_numCom455hTooShortDebDef_C DDRC_DurDeb.Com_numCom463hAbsentDebOk_C DDRC_DurDeb.Com_numCom463hAbsentDebDef_C DDRC_DurDeb.Com_numCom463hTooShortDebOk_C DDRC_DurDeb.Com_numCom463hTooShortDebDef_C DDRC_DurDeb.Com_numCom473hAbsentDebOk_C DDRC_DurDeb.Com_numCom473hAbsentDebDef_C DDRC_DurDeb.Com_numCom473hTooShortDebOk_C DDRC_DurDeb.Com_numCom473hTooShortDebDef_C DDRC_DurDeb.Com_numCom47BhAbsentDebOk_C DDRC_DurDeb.Com_numCom47BhAbsentDebDef_C DDRC_DurDeb.Com_numCom47BhTooShortDebOk_C DDRC_DurDeb.Com_numCom47BhTooShortDebDef_C DDRC_DurDeb.Com_numCom48BhAbsentDebOk_C DDRC_DurDeb.Com_numCom48BhAbsentDebDef_C DDRC_DurDeb.Com_numCom48BhTooShortDebOk_C DDRC_DurDeb.Com_numCom48BhTooShortDebDef_C DDRC_DurDeb.Com_numCom497hTooShortDebOk_C DDRC_DurDeb.Com_numCom497hTooShortDebDef_C DDRC_DurDeb.Com_numCom4F2hAbsentDebOk_C DDRC_DurDeb.Com_numCom4F2hAbsentDebDef_C DDRC_DurDeb.Com_numCom4F2hChecksumDebOk_C DDRC_DurDeb.Com_numCom4F2hChecksumDebDef_C DDRC_DurDeb.Com_numCom4F2hCounterDebOk_C DDRC_DurDeb.Com_numCom4F2hCounterDebDef_C DDRC_DurDeb.Com_numCom4F2hTooShortDebOk_C DDRC_DurDeb.Com_numCom4F2hTooShortDebDef_C DDRC_DurDeb.Com_numCom50DhAbsentDebOk_C DDRC_DurDeb.Com_numCom50DhAbsentDebDef_C DDRC_DurDeb.Com_numCom50DhTooShortDebOk_C DDRC_DurDeb.Com_numCom50DhTooShortDebDef_C DDRC_DurDeb.Com_numCom535hAbsentDebOk_C DDRC_DurDeb.Com_numCom535hAbsentDebDef_C DDRC_DurDeb.Com_numCom535hTooShortDebOk_C DDRC_DurDeb.Com_numCom535hTooShortDebDef_C DDRC_DurDeb.Com_numCom543hAbsentDebOk_C DDRC_DurDeb.Com_numCom543hAbsentDebDef_C DDRC_DurDeb.Com_numCom543hTooShortDebOk_C DDRC_DurDeb.Com_numCom543hTooShortDebDef_C DDRC_DurDeb.Com_numCom552hAbsentDebOk_C DDRC_DurDeb.Com_numCom552hAbsentDebDef_C DDRC_DurDeb.Com_numCom552hTooShortDebOk_C DDRC_DurDeb.Com_numCom552hTooShortDebDef_C DDRC_DurDeb.Com_numCom583hAbsentDebOk_C DDRC_DurDeb.Com_numCom583hAbsentDebDef_C DDRC_DurDeb.Com_numCom583hTooShortDebOk_C DDRC_DurDeb.Com_numCom583hTooShortDebDef_C DDRC_DurDeb.Com_numCom592hAbsentDebOk_C DDRC_DurDeb.Com_numCom592hAbsentDebDef_C DDRC_DurDeb.Com_numCom592hChecksumDebOk_C DDRC_DurDeb.Com_numCom592hChecksumDebDef_C DDRC_DurDeb.Com_numCom592hCounterDebOk_C DDRC_DurDeb.Com_numCom592hCounterDebDef_C DDRC_DurDeb.Com_numCom592hTooShortDebOk_C DDRC_DurDeb.Com_numCom592hTooShortDebDef_C DDRC_DurDeb.Com_numCom595hAbsentDebOk_C DDRC_DurDeb.Com_numCom595hAbsentDebDef_C DDRC_DurDeb.Com_numCom595hChecksumDebOk_C DDRC_DurDeb.Com_numCom595hChecksumDebDef_C DDRC_DurDeb.Com_numCom595hCounterDebOk_C DDRC_DurDeb.Com_numCom595hCounterDebDef_C DDRC_DurDeb.Com_numCom595hTooShortDebOk_C DDRC_DurDeb.Com_numCom595hTooShortDebDef_C DDRC_DurDeb.Com_numCom5B2hTooShortDebOk_C DDRC_DurDeb.Com_numCom5B2hTooShortDebDef_C DDRC_DurDeb.Com_numCom5B5hAbsentDebOk_C DDRC_DurDeb.Com_numCom5B5hAbsentDebDef_C DDRC_DurDeb.Com_numCom5B5hChecksumDebOk_C DDRC_DurDeb.Com_numCom5B5hChecksumDebDef_C DDRC_DurDeb.Com_numCom5B5hCounterDebOk_C DDRC_DurDeb.Com_numCom5B5hCounterDebDef_C DDRC_DurDeb.Com_numCom5B5hTooShortDebOk_C DDRC_DurDeb.Com_numCom5B5hTooShortDebDef_C DDRC_DurDeb.Com_numCom5C7hTooShortDebOk_C DDRC_DurDeb.Com_numCom5C7hTooShortDebDef_C DDRC_DurDeb.Com_numCom5E7hAbsentDebOk_C DDRC_DurDeb.Com_numCom5E7hAbsentDebDef_C DDRC_DurDeb.Com_numCom5E7hTooShortDebOk_C DDRC_DurDeb.Com_numCom5E7hTooShortDebDef_C DDRC_DurDeb.Com_numCom635hTooShortDebOk_C DDRC_DurDeb.Com_numCom635hTooShortDebDef_C DDRC_DurDeb.Com_numCom645hTooShortDebOk_C DDRC_DurDeb.Com_numCom645hTooShortDebDef_C DDRC_DurDeb.Com_numCom663hAbsentDebOk_C DDRC_DurDeb.Com_numCom663hAbsentDebDef_C DDRC_DurDeb.Com_numCom663hTooShortDebOk_C DDRC_DurDeb.Com_numCom663hTooShortDebDef_C DDRC_DurDeb.Com_numCom665hAbsentDebOk_C DDRC_DurDeb.Com_numCom665hAbsentDebDef_C DDRC_DurDeb.Com_numCom665hTooShortDebOk_C DDRC_DurDeb.Com_numCom665hTooShortDebDef_C DDRC_DurDeb.Com_numCom675hAbsentDebOk_C DDRC_DurDeb.Com_numCom675hAbsentDebDef_C DDRC_DurDeb.Com_numCom675hTooShortDebOk_C DDRC_DurDeb.Com_numCom675hTooShortDebDef_C DDRC_DurDeb.Com_numComFrbd_205h_HVBAT_PACK_CURRENTDebOk_C DDRC_DurDeb.Com_numComFrbd_205h_HVBAT_PACK_CURRENTDebDef_C DDRC_DurDeb.Com_numComFrbd_205h_HVBAT_SOC_DISPLAYDebOk_C DDRC_DurDeb.Com_numComFrbd_205h_HVBAT_SOC_DISPLAYDebDef_C DDRC_DurDeb.Com_numComFrbd_205h_HVBAT_VOLTAGEDebOk_C DDRC_DurDeb.Com_numComFrbd_205h_HVBAT_VOLTAGEDebDef_C DDRC_DurDeb.Com_numComFrbd_217h_INV_DC_BUS_VOLTAGEDebOk_C DDRC_DurDeb.Com_numComFrbd_217h_INV_DC_BUS_VOLTAGEDebDef_C DDRC_DurDeb.Com_numComFrbd_217h_INV_MTR_ACTUAL_TRQDebOk_C DDRC_DurDeb.Com_numComFrbd_217h_INV_MTR_ACTUAL_TRQDebDef_C DDRC_DurDeb.Com_numComFrbd_217h_INV_MTR_SPEEDDebOk_C DDRC_DurDeb.Com_numComFrbd_217h_INV_MTR_SPEEDDebDef_C DDRC_DurDeb.Com_numComFrbd_217h_INV_MTR_TRQDebOk_C DDRC_DurDeb.Com_numComFrbd_217h_INV_MTR_TRQDebDef_C DDRC_DurDeb.Com_numComFrbd_227h_INV_DC_CURRENTDebOk_C DDRC_DurDeb.Com_numComFrbd_227h_INV_DC_CURRENTDebDef_C DDRC_DurDeb.Com_numComFrbd_227h_INV_MOTORING_PEAK_TRQDebOk_C DDRC_DurDeb.Com_numComFrbd_227h_INV_MOTORING_PEAK_TRQDebDef_C DDRC_DurDeb.Com_numComFrbd_227h_INV_MTR_INST_INPUT_POWERDebOk_C DDRC_DurDeb.Com_numComFrbd_227h_INV_MTR_INST_INPUT_POWERDebDef_C DDRC_DurDeb.Com_numComFrbd_227h_INV_REGEN_PEAK_TRQDebOk_C DDRC_DurDeb.Com_numComFrbd_227h_INV_REGEN_PEAK_TRQDebDef_C DDRC_DurDeb.Com_numComFrbd_237h_INV_ACTIVE_DISCHARGE_STATUSDebOk_C DDRC_DurDeb.Com_numComFrbd_237h_INV_ACTIVE_DISCHARGE_STATUSDebDef_C DDRC_DurDeb.Com_numComFrbd_237h_INV_CTRL_MODE_ACKDebOk_C DDRC_DurDeb.Com_numComFrbd_237h_INV_CTRL_MODE_ACKDebDef_C DDRC_DurDeb.Com_numComFrbd_237h_INV_EV_WARNINGDebOk_C DDRC_DurDeb.Com_numComFrbd_237h_INV_EV_WARNINGDebDef_C DDRC_DurDeb.Com_numComFrbd_237h_INV_FAULT_LEVELDebOk_C DDRC_DurDeb.Com_numComFrbd_237h_INV_FAULT_LEVELDebDef_C DDRC_DurDeb.Com_numComFrbd_237h_INV_MASTER_STOPDebOk_C DDRC_DurDeb.Com_numComFrbd_237h_INV_MASTER_STOPDebDef_C DDRC_DurDeb.Com_numComFrbd_237h_INV_SERVICE_DUEDebOk_C DDRC_DurDeb.Com_numComFrbd_237h_INV_SERVICE_DUEDebDef_C DDRC_DurDeb.Com_numComFrbd_237h_INV_STAB_MIN_TRQDebOk_C DDRC_DurDeb.Com_numComFrbd_237h_INV_STAB_MIN_TRQDebDef_C DDRC_DurDeb.Com_numComFrbd_259h_TGLM_FAILURE_STATEDebOk_C DDRC_DurDeb.Com_numComFrbd_259h_TGLM_FAILURE_STATEDebDef_C DDRC_DurDeb.Com_numComFrbd_259h_TGLM_MODE_PUSHDebOk_C DDRC_DurDeb.Com_numComFrbd_259h_TGLM_MODE_PUSHDebDef_C DDRC_DurDeb.Com_numComFrbd_259h_TOGGLE_MONOSTABLE_POSDebOk_C DDRC_DurDeb.Com_numComFrbd_259h_TOGGLE_MONOSTABLE_POSDebDef_C DDRC_DurDeb.Com_numComFrbd_273h_OBC_outputpower_capabilityDebOk_C DDRC_DurDeb.Com_numComFrbd_273h_OBC_outputpower_capabilityDebDef_C DDRC_DurDeb.Com_numComFrbd_275h_HVBAT_DISCHARGE_30S_AVAILABLE_CURRENTDebOk_C DDRC_DurDeb.Com_numComFrbd_275h_HVBAT_DISCHARGE_30S_AVAILABLE_CURRENTDebDef_C DDRC_DurDeb.Com_numComFrbd_275h_HVBAT_DISCHARGE_30S_AVAILABLE_POWERDebOk_C DDRC_DurDeb.Com_numComFrbd_275h_HVBAT_DISCHARGE_30S_AVAILABLE_POWERDebDef_C DDRC_DurDeb.Com_numComFrbd_283h_DCDC_IN_CURRENTDebOk_C DDRC_DurDeb.Com_numComFrbd_283h_DCDC_IN_CURRENTDebDef_C DDRC_DurDeb.Com_numComFrbd_283h_DCDC_IN_VOLTAGEDebOk_C DDRC_DurDeb.Com_numComFrbd_283h_DCDC_IN_VOLTAGEDebDef_C DDRC_DurDeb.Com_numComFrbd_283h_DCDC_OUT_CURRENTDebOk_C DDRC_DurDeb.Com_numComFrbd_283h_DCDC_OUT_CURRENTDebDef_C DDRC_DurDeb.Com_numComFrbd_283h_DCDC_OUT_VOLTAGEDebOk_C DDRC_DurDeb.Com_numComFrbd_283h_DCDC_OUT_VOLTAGEDebDef_C DDRC_DurDeb.Com_numComFrbd_285h_HVBAT_REGEN_CHG_30S_CURRENT_LIMITDebOk_C DDRC_DurDeb.Com_numComFrbd_285h_HVBAT_REGEN_CHG_30S_CURRENT_LIMITDebDef_C DDRC_DurDeb.Com_numComFrbd_285h_HVBAT_REGEN_CHRG_30S_POWER_LIMITDebOk_C DDRC_DurDeb.Com_numComFrbd_285h_HVBAT_REGEN_CHRG_30S_POWER_LIMITDebDef_C DDRC_DurDeb.Com_numComFrbd_293h_DCDC_outputpower_capabilityDebOk_C DDRC_DurDeb.Com_numComFrbd_293h_DCDC_outputpower_capabilityDebDef_C DDRC_DurDeb.Com_numComFrbd_325h_HVBAT_INSULATION_RESISTANCEDebOk_C DDRC_DurDeb.Com_numComFrbd_325h_HVBAT_INSULATION_RESISTANCEDebDef_C DDRC_DurDeb.Com_numComFrbd_325h_HVBAT_TEMPERATUREDebOk_C DDRC_DurDeb.Com_numComFrbd_325h_HVBAT_TEMPERATUREDebDef_C DDRC_DurDeb.Com_numComFrbd_335h_HVBAT_CHRG_CONTINUOUS_CURR_MAXDebOk_C DDRC_DurDeb.Com_numComFrbd_335h_HVBAT_CHRG_CONTINUOUS_CURR_MAXDebDef_C DDRC_DurDeb.Com_numComFrbd_335h_HVBAT_CHRG_COTINUOUS_CURR_REQDebOk_C DDRC_DurDeb.Com_numComFrbd_335h_HVBAT_CHRG_COTINUOUS_CURR_REQDebDef_C DDRC_DurDeb.Com_numComFrbd_335h_HVBAT_CHRG_MAX_VOLTDebOk_C DDRC_DurDeb.Com_numComFrbd_335h_HVBAT_CHRG_MAX_VOLTDebDef_C DDRC_DurDeb.Com_numComFrbd_335h_HVBAT_DC_BUS_VOLTAGEDebOk_C DDRC_DurDeb.Com_numComFrbd_335h_HVBAT_DC_BUS_VOLTAGEDebDef_C DDRC_DurDeb.Com_numComFrbd_427h_INV_OP_MODEDebOk_C DDRC_DurDeb.Com_numComFrbd_427h_INV_OP_MODEDebDef_C DDRC_DurDeb.Com_numComFrbd_427h_INV_PERMISIBLE_TORQUEDebOk_C DDRC_DurDeb.Com_numComFrbd_427h_INV_PERMISIBLE_TORQUEDebDef_C DDRC_DurDeb.Com_numComFrbd_435h_HVBAT_MAX_CELL_VOLTDebOk_C DDRC_DurDeb.Com_numComFrbd_435h_HVBAT_MAX_CELL_VOLTDebDef_C DDRC_DurDeb.Com_numComFrbd_435h_HVBAT_MAX_CELL_VOLT_NUMDebOk_C DDRC_DurDeb.Com_numComFrbd_435h_HVBAT_MAX_CELL_VOLT_NUMDebDef_C DDRC_DurDeb.Com_numComFrbd_435h_HVBAT_MAX_SENSOR_TEMPDebOk_C DDRC_DurDeb.Com_numComFrbd_435h_HVBAT_MAX_SENSOR_TEMPDebDef_C DDRC_DurDeb.Com_numComFrbd_435h_HVBAT_MIN_CELL_VOLTDebOk_C DDRC_DurDeb.Com_numComFrbd_435h_HVBAT_MIN_CELL_VOLTDebDef_C DDRC_DurDeb.Com_numComFrbd_435h_HVBAT_MIN_CELL_VOLT_NUMDebOk_C DDRC_DurDeb.Com_numComFrbd_435h_HVBAT_MIN_CELL_VOLT_NUMDebDef_C DDRC_DurDeb.Com_numComFrbd_453h_OBC_IN_CURRENTDebOk_C DDRC_DurDeb.Com_numComFrbd_453h_OBC_IN_CURRENTDebDef_C DDRC_DurDeb.Com_numComFrbd_453h_OBC_IN_VOLTAGEDebOk_C DDRC_DurDeb.Com_numComFrbd_453h_OBC_IN_VOLTAGEDebDef_C DDRC_DurDeb.Com_numComFrbd_453h_OBC_IP_POWERDebOk_C DDRC_DurDeb.Com_numComFrbd_453h_OBC_IP_POWERDebDef_C DDRC_DurDeb.Com_numComFrbd_455h_HVBAT_NOMINAL_VOLTAGEDebOk_C DDRC_DurDeb.Com_numComFrbd_455h_HVBAT_NOMINAL_VOLTAGEDebDef_C DDRC_DurDeb.Com_numComFrbd_463h_OBC_OUT_CURRENTDebOk_C DDRC_DurDeb.Com_numComFrbd_463h_OBC_OUT_CURRENTDebDef_C DDRC_DurDeb.Com_numComFrbd_463h_OBC_OUT_VOLTAGEDebOk_C DDRC_DurDeb.Com_numComFrbd_463h_OBC_OUT_VOLTAGEDebDef_C DDRC_DurDeb.Com_numComFrbd_463h_OBC_TEMPERATUREDebOk_C DDRC_DurDeb.Com_numComFrbd_463h_OBC_TEMPERATUREDebDef_C DDRC_DurDeb.Com_numComFrbd_473h_DCDC_Coolant_TemperatureDebOk_C DDRC_DurDeb.Com_numComFrbd_473h_DCDC_Coolant_TemperatureDebDef_C DDRC_DurDeb.Com_numComFrbd_473h_DCDC_TEMPERATUREDebOk_C DDRC_DurDeb.Com_numComFrbd_473h_DCDC_TEMPERATUREDebDef_C DDRC_DurDeb.Com_numComFrbd_47Bh_eCOMP_BusBarCurrentDebOk_C DDRC_DurDeb.Com_numComFrbd_47Bh_eCOMP_BusBarCurrentDebDef_C DDRC_DurDeb.Com_numComFrbd_47Bh_eCOMP_BusBarVoltageDebOk_C DDRC_DurDeb.Com_numComFrbd_47Bh_eCOMP_BusBarVoltageDebDef_C DDRC_DurDeb.Com_numComFrbd_47Bh_eCOMP_CompressorSpeedDebOk_C DDRC_DurDeb.Com_numComFrbd_47Bh_eCOMP_CompressorSpeedDebDef_C DDRC_DurDeb.Com_numComFrbd_47Bh_eCOMP_IGBT_TempDebOk_C DDRC_DurDeb.Com_numComFrbd_47Bh_eCOMP_IGBT_TempDebDef_C DDRC_DurDeb.Com_numComFrbd_47Bh_eCOMP_PeakPhaCurrentDebOk_C DDRC_DurDeb.Com_numComFrbd_47Bh_eCOMP_PeakPhaCurrentDebDef_C DDRC_DurDeb.Com_numComFrbd_47Bh_eCOMP_Power_consumptionDebOk_C DDRC_DurDeb.Com_numComFrbd_47Bh_eCOMP_Power_consumptionDebDef_C DDRC_DurDeb.Com_numComFrbd_48Bh_eCOMP_Fault_LevelDebOk_C DDRC_DurDeb.Com_numComFrbd_48Bh_eCOMP_Fault_LevelDebDef_C DDRC_DurDeb.Com_numComFrbd_4F2h_VALEUR_SOC_ETENDUEDebOk_C DDRC_DurDeb.Com_numComFrbd_4F2h_VALEUR_SOC_ETENDUEDebDef_C DDRC_DurDeb.Com_numComFrbd_535h_HV_BATT_TEMP_AVGDebOk_C DDRC_DurDeb.Com_numComFrbd_535h_HV_BATT_TEMP_AVGDebDef_C DDRC_DurDeb.Com_numComFrbd_543h_HVBAT_RESTBATTENERGYDebOk_C DDRC_DurDeb.Com_numComFrbd_543h_HVBAT_RESTBATTENERGYDebDef_C DDRC_DurDeb.Com_numComFrbd_543h_HVBAT_SOHDebOk_C DDRC_DurDeb.Com_numComFrbd_543h_HVBAT_SOHDebDef_C DDRC_DurDeb.Com_numComFrbd_543h_HV_BATT_SOH_RESDebOk_C DDRC_DurDeb.Com_numComFrbd_543h_HV_BATT_SOH_RESDebDef_C DDRC_DurDeb.Com_numComFrbd_592h_IBATT_1DebOk_C DDRC_DurDeb.Com_numComFrbd_592h_IBATT_1DebDef_C DDRC_DurDeb.Com_numComFrbd_592h_IBATT_2DebOk_C DDRC_DurDeb.Com_numComFrbd_592h_IBATT_2DebDef_C DDRC_DurDeb.Com_numComFrbd_592h_IBATT_3DebOk_C DDRC_DurDeb.Com_numComFrbd_592h_IBATT_3DebDef_C DDRC_DurDeb.Com_numComFrbd_592h_TEMP_BATTDebOk_C DDRC_DurDeb.Com_numComFrbd_592h_TEMP_BATTDebDef_C DDRC_DurDeb.Com_numComFrbd_592h_U_BATT_BECBDebOk_C DDRC_DurDeb.Com_numComFrbd_592h_U_BATT_BECBDebDef_C DDRC_DurDeb.Com_numComFrbd_595h_HVBAT_TIME_TO_CHRG_80DebOk_C DDRC_DurDeb.Com_numComFrbd_595h_HVBAT_TIME_TO_CHRG_80DebDef_C DDRC_DurDeb.Com_numComFrbd_5B2h_TEMP_AIR_EXTDebOk_C DDRC_DurDeb.Com_numComFrbd_5B2h_TEMP_AIR_EXTDebDef_C DDRC_DurDeb.Com_numComFrbd_635h_HVBAT_NEG_CONT_COUNT_SEG1DebOk_C DDRC_DurDeb.Com_numComFrbd_635h_HVBAT_NEG_CONT_COUNT_SEG1DebDef_C DDRC_DurDeb.Com_numComFrbd_635h_HVBAT_NEG_CONT_COUNT_SEG3DebOk_C DDRC_DurDeb.Com_numComFrbd_635h_HVBAT_NEG_CONT_COUNT_SEG3DebDef_C DDRC_DurDeb.Com_numComFrbd_635h_HVBAT_NEG_CONT_COUNT_SEG4DebOk_C DDRC_DurDeb.Com_numComFrbd_635h_HVBAT_NEG_CONT_COUNT_SEG4DebDef_C DDRC_DurDeb.Com_numComFrbd_635h_HVBAT_PST_CONT_COUNT_SEG1DebOk_C DDRC_DurDeb.Com_numComFrbd_635h_HVBAT_PST_CONT_COUNT_SEG1DebDef_C DDRC_DurDeb.Com_numComFrbd_635h_HVBAT_PST_CONT_COUNT_SEG3DebOk_C DDRC_DurDeb.Com_numComFrbd_635h_HVBAT_PST_CONT_COUNT_SEG3DebDef_C DDRC_DurDeb.Com_numComFrbd_635h_HVBAT_PST_CONT_COUNT_SEG4DebOk_C DDRC_DurDeb.Com_numComFrbd_635h_HVBAT_PST_CONT_COUNT_SEG4DebDef_C DDRC_DurDeb.Com_numComFrbd_645h_HVBAT_PRECHRGE_CONT_COUNT_SEG1DebOk_C DDRC_DurDeb.Com_numComFrbd_645h_HVBAT_PRECHRGE_CONT_COUNT_SEG1DebDef_C DDRC_DurDeb.Com_numComFrbd_645h_HVBAT_PRECHRGE_CONT_COUNT_SEG2DebOk_C DDRC_DurDeb.Com_numComFrbd_645h_HVBAT_PRECHRGE_CONT_COUNT_SEG2DebDef_C DDRC_DurDeb.Com_numComFrbd_675h_HVBAT_REMAININGBATTCAPACITYDebOk_C DDRC_DurDeb.Com_numComFrbd_675h_HVBAT_REMAININGBATTCAPACITYDebDef_C DDRC_DurDeb.Com_numComInvld_205h_HVBAT_CHARGING_STATUSDebOk_C DDRC_DurDeb.Com_numComInvld_205h_HVBAT_CHARGING_STATUSDebDef_C DDRC_DurDeb.Com_numComInvld_205h_HVBAT_PACK_CURRENTDebOk_C DDRC_DurDeb.Com_numComInvld_205h_HVBAT_PACK_CURRENTDebDef_C DDRC_DurDeb.Com_numComInvld_205h_HVBAT_SOC_DISPLAYDebOk_C DDRC_DurDeb.Com_numComInvld_205h_HVBAT_SOC_DISPLAYDebDef_C DDRC_DurDeb.Com_numComInvld_205h_HVBAT_VOLTAGEDebOk_C DDRC_DurDeb.Com_numComInvld_205h_HVBAT_VOLTAGEDebDef_C DDRC_DurDeb.Com_numComInvld_217h_INV_DC_BUS_VOLTAGEDebOk_C DDRC_DurDeb.Com_numComInvld_217h_INV_DC_BUS_VOLTAGEDebDef_C DDRC_DurDeb.Com_numComInvld_217h_INV_MTR_ACTUAL_TRQDebOk_C DDRC_DurDeb.Com_numComInvld_217h_INV_MTR_ACTUAL_TRQDebDef_C DDRC_DurDeb.Com_numComInvld_217h_INV_MTR_SPEEDDebOk_C DDRC_DurDeb.Com_numComInvld_217h_INV_MTR_SPEEDDebDef_C DDRC_DurDeb.Com_numComInvld_217h_INV_MTR_TRQDebOk_C DDRC_DurDeb.Com_numComInvld_217h_INV_MTR_TRQDebDef_C DDRC_DurDeb.Com_numComInvld_227h_INV_DC_CURRENTDebOk_C DDRC_DurDeb.Com_numComInvld_227h_INV_DC_CURRENTDebDef_C DDRC_DurDeb.Com_numComInvld_227h_INV_MOTORING_PEAK_TRQDebOk_C DDRC_DurDeb.Com_numComInvld_227h_INV_MOTORING_PEAK_TRQDebDef_C DDRC_DurDeb.Com_numComInvld_227h_INV_MTR_INST_INPUT_POWERDebOk_C DDRC_DurDeb.Com_numComInvld_227h_INV_MTR_INST_INPUT_POWERDebDef_C DDRC_DurDeb.Com_numComInvld_227h_INV_REGEN_PEAK_TRQDebOk_C DDRC_DurDeb.Com_numComInvld_227h_INV_REGEN_PEAK_TRQDebDef_C DDRC_DurDeb.Com_numComInvld_237h_INV_ACTIVE_DISCHARGE_STATUSDebOk_C DDRC_DurDeb.Com_numComInvld_237h_INV_ACTIVE_DISCHARGE_STATUSDebDef_C DDRC_DurDeb.Com_numComInvld_237h_INV_FAULT_LEVELDebOk_C DDRC_DurDeb.Com_numComInvld_237h_INV_FAULT_LEVELDebDef_C DDRC_DurDeb.Com_numComInvld_237h_INV_STAB_MIN_TRQDebOk_C DDRC_DurDeb.Com_numComInvld_237h_INV_STAB_MIN_TRQDebDef_C DDRC_DurDeb.Com_numComInvld_259h_TGLM_MODE_PUSHDebOk_C DDRC_DurDeb.Com_numComInvld_259h_TGLM_MODE_PUSHDebDef_C DDRC_DurDeb.Com_numComInvld_259h_TOGGLE_MONOSTABLE_POSDebOk_C DDRC_DurDeb.Com_numComInvld_259h_TOGGLE_MONOSTABLE_POSDebDef_C DDRC_DurDeb.Com_numComInvld_273h_OBC_FAULT_LEVELDebOk_C DDRC_DurDeb.Com_numComInvld_273h_OBC_FAULT_LEVELDebDef_C DDRC_DurDeb.Com_numComInvld_273h_OBC_outputpower_capabilityDebOk_C DDRC_DurDeb.Com_numComInvld_273h_OBC_outputpower_capabilityDebDef_C DDRC_DurDeb.Com_numComInvld_275h_HVBAT_DISCHARGE_30S_AVAILABLE_CURRENTDebOk_C DDRC_DurDeb.Com_numComInvld_275h_HVBAT_DISCHARGE_30S_AVAILABLE_CURRENTDebDef_C DDRC_DurDeb.Com_numComInvld_275h_HVBAT_DISCHARGE_30S_AVAILABLE_POWERDebOk_C DDRC_DurDeb.Com_numComInvld_275h_HVBAT_DISCHARGE_30S_AVAILABLE_POWERDebDef_C DDRC_DurDeb.Com_numComInvld_283h_DCDC_IN_CURRENTDebOk_C DDRC_DurDeb.Com_numComInvld_283h_DCDC_IN_CURRENTDebDef_C DDRC_DurDeb.Com_numComInvld_283h_DCDC_IN_VOLTAGEDebOk_C DDRC_DurDeb.Com_numComInvld_283h_DCDC_IN_VOLTAGEDebDef_C DDRC_DurDeb.Com_numComInvld_283h_DCDC_OUT_CURRENTDebOk_C DDRC_DurDeb.Com_numComInvld_283h_DCDC_OUT_CURRENTDebDef_C DDRC_DurDeb.Com_numComInvld_283h_DCDC_OUT_VOLTAGEDebOk_C DDRC_DurDeb.Com_numComInvld_283h_DCDC_OUT_VOLTAGEDebDef_C DDRC_DurDeb.Com_numComInvld_285h_HVBAT_REGEN_CHG_30S_CURRENT_LIMITDebOk_C DDRC_DurDeb.Com_numComInvld_285h_HVBAT_REGEN_CHG_30S_CURRENT_LIMITDebDef_C DDRC_DurDeb.Com_numComInvld_285h_HVBAT_REGEN_CHRG_30S_POWER_LIMITDebOk_C DDRC_DurDeb.Com_numComInvld_285h_HVBAT_REGEN_CHRG_30S_POWER_LIMITDebDef_C DDRC_DurDeb.Com_numComInvld_293h_DCDC_FAULT_LEVELDebOk_C DDRC_DurDeb.Com_numComInvld_293h_DCDC_FAULT_LEVELDebDef_C DDRC_DurDeb.Com_numComInvld_293h_DCDC_outputpower_capabilityDebOk_C DDRC_DurDeb.Com_numComInvld_293h_DCDC_outputpower_capabilityDebDef_C DDRC_DurDeb.Com_numComInvld_325h_HVBAT_EPLUG_STATUSDebOk_C DDRC_DurDeb.Com_numComInvld_325h_HVBAT_EPLUG_STATUSDebDef_C DDRC_DurDeb.Com_numComInvld_325h_HVBAT_HVIL_STSDebOk_C DDRC_DurDeb.Com_numComInvld_325h_HVBAT_HVIL_STSDebDef_C DDRC_DurDeb.Com_numComInvld_325h_HVBAT_INSULATION_FAULTDebOk_C DDRC_DurDeb.Com_numComInvld_325h_HVBAT_INSULATION_FAULTDebDef_C DDRC_DurDeb.Com_numComInvld_325h_HVBAT_INSULATION_RESISTANCEDebOk_C DDRC_DurDeb.Com_numComInvld_325h_HVBAT_INSULATION_RESISTANCEDebDef_C DDRC_DurDeb.Com_numComInvld_325h_HVBAT_TEMPERATUREDebOk_C DDRC_DurDeb.Com_numComInvld_325h_HVBAT_TEMPERATUREDebDef_C DDRC_DurDeb.Com_numComInvld_335h_HVBAT_CHRG_CONTINUOUS_CURR_MAXDebOk_C DDRC_DurDeb.Com_numComInvld_335h_HVBAT_CHRG_CONTINUOUS_CURR_MAXDebDef_C DDRC_DurDeb.Com_numComInvld_335h_HVBAT_CHRG_COTINUOUS_CURR_REQDebOk_C DDRC_DurDeb.Com_numComInvld_335h_HVBAT_CHRG_COTINUOUS_CURR_REQDebDef_C DDRC_DurDeb.Com_numComInvld_335h_HVBAT_CHRG_MAX_VOLTDebOk_C DDRC_DurDeb.Com_numComInvld_335h_HVBAT_CHRG_MAX_VOLTDebDef_C DDRC_DurDeb.Com_numComInvld_335h_HVBAT_DC_BUS_VOLTAGEDebOk_C DDRC_DurDeb.Com_numComInvld_335h_HVBAT_DC_BUS_VOLTAGEDebDef_C DDRC_DurDeb.Com_numComInvld_38Dh_VITESSE_VEHICULE_ROUESDebOk_C DDRC_DurDeb.Com_numComInvld_38Dh_VITESSE_VEHICULE_ROUESDebDef_C DDRC_DurDeb.Com_numComInvld_38Dh_VVH_INDISPDebOk_C DDRC_DurDeb.Com_numComInvld_38Dh_VVH_INDISPDebDef_C DDRC_DurDeb.Com_numComInvld_427h_INV_COOLANT_TEMPDebOk_C DDRC_DurDeb.Com_numComInvld_427h_INV_COOLANT_TEMPDebDef_C DDRC_DurDeb.Com_numComInvld_427h_INV_MOTOR_TEMPDebOk_C DDRC_DurDeb.Com_numComInvld_427h_INV_MOTOR_TEMPDebDef_C DDRC_DurDeb.Com_numComInvld_427h_INV_OP_MODEDebOk_C DDRC_DurDeb.Com_numComInvld_427h_INV_OP_MODEDebDef_C DDRC_DurDeb.Com_numComInvld_427h_INV_PERMISIBLE_TORQUEDebOk_C DDRC_DurDeb.Com_numComInvld_427h_INV_PERMISIBLE_TORQUEDebDef_C DDRC_DurDeb.Com_numComInvld_427h_INV_TEMPDebOk_C DDRC_DurDeb.Com_numComInvld_427h_INV_TEMPDebDef_C DDRC_DurDeb.Com_numComInvld_432h_REVEIL_PRINCIPALDebOk_C DDRC_DurDeb.Com_numComInvld_432h_REVEIL_PRINCIPALDebDef_C DDRC_DurDeb.Com_numComInvld_435h_HVBAT_MAX_CELL_VOLTDebOk_C DDRC_DurDeb.Com_numComInvld_435h_HVBAT_MAX_CELL_VOLTDebDef_C DDRC_DurDeb.Com_numComInvld_435h_HVBAT_MAX_CELL_VOLT_NUMDebOk_C DDRC_DurDeb.Com_numComInvld_435h_HVBAT_MAX_CELL_VOLT_NUMDebDef_C DDRC_DurDeb.Com_numComInvld_435h_HVBAT_MAX_SENSOR_TEMPDebOk_C DDRC_DurDeb.Com_numComInvld_435h_HVBAT_MAX_SENSOR_TEMPDebDef_C DDRC_DurDeb.Com_numComInvld_435h_HVBAT_MIN_CELL_VOLTDebOk_C DDRC_DurDeb.Com_numComInvld_435h_HVBAT_MIN_CELL_VOLTDebDef_C DDRC_DurDeb.Com_numComInvld_435h_HVBAT_MIN_CELL_VOLT_NUMDebOk_C DDRC_DurDeb.Com_numComInvld_435h_HVBAT_MIN_CELL_VOLT_NUMDebDef_C DDRC_DurDeb.Com_numComInvld_442h_BCCM_BLOWER_RELAY_STSDebOk_C DDRC_DurDeb.Com_numComInvld_442h_BCCM_BLOWER_RELAY_STSDebDef_C DDRC_DurDeb.Com_numComInvld_453h_OBC_IN_CURRENTDebOk_C DDRC_DurDeb.Com_numComInvld_453h_OBC_IN_CURRENTDebDef_C DDRC_DurDeb.Com_numComInvld_453h_OBC_IN_VOLTAGEDebOk_C DDRC_DurDeb.Com_numComInvld_453h_OBC_IN_VOLTAGEDebDef_C DDRC_DurDeb.Com_numComInvld_453h_OBC_IP_POWERDebOk_C DDRC_DurDeb.Com_numComInvld_453h_OBC_IP_POWERDebDef_C DDRC_DurDeb.Com_numComInvld_455h_HVBAT_NOMINAL_VOLTAGEDebOk_C DDRC_DurDeb.Com_numComInvld_455h_HVBAT_NOMINAL_VOLTAGEDebDef_C DDRC_DurDeb.Com_numComInvld_463h_OBC_OUT_CURRENTDebOk_C DDRC_DurDeb.Com_numComInvld_463h_OBC_OUT_CURRENTDebDef_C DDRC_DurDeb.Com_numComInvld_463h_OBC_OUT_VOLTAGEDebOk_C DDRC_DurDeb.Com_numComInvld_463h_OBC_OUT_VOLTAGEDebDef_C DDRC_DurDeb.Com_numComInvld_463h_OBC_TEMPERATUREDebOk_C DDRC_DurDeb.Com_numComInvld_463h_OBC_TEMPERATUREDebDef_C DDRC_DurDeb.Com_numComInvld_473h_DCDC_Coolant_TemperatureDebOk_C DDRC_DurDeb.Com_numComInvld_473h_DCDC_Coolant_TemperatureDebDef_C DDRC_DurDeb.Com_numComInvld_473h_DCDC_TEMPERATUREDebOk_C DDRC_DurDeb.Com_numComInvld_473h_DCDC_TEMPERATUREDebDef_C DDRC_DurDeb.Com_numComInvld_47Bh_eCOMP_BusBarCurrentDebOk_C DDRC_DurDeb.Com_numComInvld_47Bh_eCOMP_BusBarCurrentDebDef_C DDRC_DurDeb.Com_numComInvld_47Bh_eCOMP_BusBarVoltageDebOk_C DDRC_DurDeb.Com_numComInvld_47Bh_eCOMP_BusBarVoltageDebDef_C DDRC_DurDeb.Com_numComInvld_47Bh_eCOMP_CompressorSpeedDebOk_C DDRC_DurDeb.Com_numComInvld_47Bh_eCOMP_CompressorSpeedDebDef_C DDRC_DurDeb.Com_numComInvld_47Bh_eCOMP_IGBT_TempDebOk_C DDRC_DurDeb.Com_numComInvld_47Bh_eCOMP_IGBT_TempDebDef_C DDRC_DurDeb.Com_numComInvld_47Bh_eCOMP_PeakPhaCurrentDebOk_C DDRC_DurDeb.Com_numComInvld_47Bh_eCOMP_PeakPhaCurrentDebDef_C DDRC_DurDeb.Com_numComInvld_47Bh_eCOMP_Power_consumptionDebOk_C DDRC_DurDeb.Com_numComInvld_47Bh_eCOMP_Power_consumptionDebDef_C DDRC_DurDeb.Com_numComInvld_4F2h_STATUS_SOCDebOk_C DDRC_DurDeb.Com_numComInvld_4F2h_STATUS_SOCDebDef_C DDRC_DurDeb.Com_numComInvld_4F2h_TEMP_BATT_STATUSDebOk_C DDRC_DurDeb.Com_numComInvld_4F2h_TEMP_BATT_STATUSDebDef_C DDRC_DurDeb.Com_numComInvld_4F2h_VALEUR_SOC_ETENDUEDebOk_C DDRC_DurDeb.Com_numComInvld_4F2h_VALEUR_SOC_ETENDUEDebDef_C DDRC_DurDeb.Com_numComInvld_535h_HV_BATT_TEMP_AVGDebOk_C DDRC_DurDeb.Com_numComInvld_535h_HV_BATT_TEMP_AVGDebDef_C DDRC_DurDeb.Com_numComInvld_543h_HVBAT_RESTBATTENERGYDebOk_C DDRC_DurDeb.Com_numComInvld_543h_HVBAT_RESTBATTENERGYDebDef_C DDRC_DurDeb.Com_numComInvld_543h_HVBAT_SOHDebOk_C DDRC_DurDeb.Com_numComInvld_543h_HVBAT_SOHDebDef_C DDRC_DurDeb.Com_numComInvld_543h_HV_BATT_SOH_RESDebOk_C DDRC_DurDeb.Com_numComInvld_543h_HV_BATT_SOH_RESDebDef_C DDRC_DurDeb.Com_numComInvld_552h_CPT_TEMPORELDebOk_C DDRC_DurDeb.Com_numComInvld_552h_CPT_TEMPORELDebDef_C DDRC_DurDeb.Com_numComInvld_552h_KILOMETRAGEDebOk_C DDRC_DurDeb.Com_numComInvld_552h_KILOMETRAGEDebDef_C DDRC_DurDeb.Com_numComInvld_583h_HV_BATT_DISCONT_CSE_OPENDebOk_C DDRC_DurDeb.Com_numComInvld_583h_HV_BATT_DISCONT_CSE_OPENDebDef_C DDRC_DurDeb.Com_numComInvld_592h_CALIBRE_IBATTDebOk_C DDRC_DurDeb.Com_numComInvld_592h_CALIBRE_IBATTDebDef_C DDRC_DurDeb.Com_numComInvld_592h_IBATT_1DebOk_C DDRC_DurDeb.Com_numComInvld_592h_IBATT_1DebDef_C DDRC_DurDeb.Com_numComInvld_592h_IBATT_2DebOk_C DDRC_DurDeb.Com_numComInvld_592h_IBATT_2DebDef_C DDRC_DurDeb.Com_numComInvld_592h_IBATT_3DebOk_C DDRC_DurDeb.Com_numComInvld_592h_IBATT_3DebDef_C DDRC_DurDeb.Com_numComInvld_592h_TEMP_BATTDebOk_C DDRC_DurDeb.Com_numComInvld_592h_TEMP_BATTDebDef_C DDRC_DurDeb.Com_numComInvld_592h_U_BATT_BECBDebOk_C DDRC_DurDeb.Com_numComInvld_592h_U_BATT_BECBDebDef_C DDRC_DurDeb.Com_numComInvld_595h_HVBAT_TIME_TO_CHRG_80DebOk_C DDRC_DurDeb.Com_numComInvld_595h_HVBAT_TIME_TO_CHRG_80DebDef_C DDRC_DurDeb.Com_numComInvld_5B2h_TEMP_AIR_EXTDebOk_C DDRC_DurDeb.Com_numComInvld_5B2h_TEMP_AIR_EXTDebDef_C DDRC_DurDeb.Com_numComInvld_5B5h_HVBAT_THERMAL_RUNAWAYDebOk_C DDRC_DurDeb.Com_numComInvld_5B5h_HVBAT_THERMAL_RUNAWAYDebDef_C DDRC_DurDeb.Com_numComInvld_635h_HVBAT_NEG_CONT_COUNT_SEG1DebOk_C DDRC_DurDeb.Com_numComInvld_635h_HVBAT_NEG_CONT_COUNT_SEG1DebDef_C DDRC_DurDeb.Com_numComInvld_635h_HVBAT_NEG_CONT_COUNT_SEG3DebOk_C DDRC_DurDeb.Com_numComInvld_635h_HVBAT_NEG_CONT_COUNT_SEG3DebDef_C DDRC_DurDeb.Com_numComInvld_635h_HVBAT_NEG_CONT_COUNT_SEG4DebOk_C DDRC_DurDeb.Com_numComInvld_635h_HVBAT_NEG_CONT_COUNT_SEG4DebDef_C DDRC_DurDeb.Com_numComInvld_635h_HVBAT_PST_CONT_COUNT_SEG1DebOk_C DDRC_DurDeb.Com_numComInvld_635h_HVBAT_PST_CONT_COUNT_SEG1DebDef_C DDRC_DurDeb.Com_numComInvld_635h_HVBAT_PST_CONT_COUNT_SEG3DebOk_C DDRC_DurDeb.Com_numComInvld_635h_HVBAT_PST_CONT_COUNT_SEG3DebDef_C DDRC_DurDeb.Com_numComInvld_635h_HVBAT_PST_CONT_COUNT_SEG4DebOk_C DDRC_DurDeb.Com_numComInvld_635h_HVBAT_PST_CONT_COUNT_SEG4DebDef_C DDRC_DurDeb.Com_numComInvld_645h_HVBAT_PRECHRGE_CONT_COUNT_SEG1DebOk_C DDRC_DurDeb.Com_numComInvld_645h_HVBAT_PRECHRGE_CONT_COUNT_SEG1DebDef_C DDRC_DurDeb.Com_numComInvld_645h_HVBAT_PRECHRGE_CONT_COUNT_SEG2DebOk_C DDRC_DurDeb.Com_numComInvld_645h_HVBAT_PRECHRGE_CONT_COUNT_SEG2DebDef_C DDRC_DurDeb.Com_numComInvld_675h_HVBAT_REMAININGBATTCAPACITYDebOk_C DDRC_DurDeb.Com_numComInvld_675h_HVBAT_REMAININGBATTCAPACITYDebDef_C DDRC_DurDeb.Com_tiDFC_Com26hAbsentDebOk_C DDRC_DurDeb.Com_tiDFC_Com26hAbsentDebDef_C DDRC_DurDeb.Com_tiDFC_Com26hTooShortDebOk_C DDRC_DurDeb.Com_tiDFC_Com26hTooShortDebDef_C DDRC_DurDeb.Com_tiDFC_Com5B2hAbsentDebDef_CDebOk_C DDRC_DurDeb.Com_tiDFC_Com5B2hAbsentDebDef_CDebDef_C DDRC_DurDeb.Com_tiDFC_ComInvld_26h_AC_SWITCH_REQDebOk_C DDRC_DurDeb.Com_tiDFC_ComInvld_26h_AC_SWITCH_REQDebDef_C DDRC_DurDeb.Com_tiDFC_ComInvld_26h_BLOWER_POSITIONDebOk_C DDRC_DurDeb.Com_tiDFC_ComInvld_26h_BLOWER_POSITIONDebDef_C DDRC_DurDeb.Com_tiDFC_ComInvld_26h_EVAP_SENSOR_FAULTDebOk_C DDRC_DurDeb.Com_tiDFC_ComInvld_26h_EVAP_SENSOR_FAULTDebDef_C DDRC_DurDeb.Com_tiDFC_ComInvld_26h_EVAP_SENSOR_VALUEDebOk_C DDRC_DurDeb.Com_tiDFC_ComInvld_26h_EVAP_SENSOR_VALUEDebDef_C DDRC_DurDeb.Com_tiDFC_ComInvld_26h_POTENTIOMETER_FAULTDebOk_C DDRC_DurDeb.Com_tiDFC_ComInvld_26h_POTENTIOMETER_FAULTDebDef_C DDRC_DurDeb.Com_tiDFC_ComInvld_26h_REAR_DEFOG_REQDebOk_C DDRC_DurDeb.Com_tiDFC_ComInvld_26h_REAR_DEFOG_REQDebDef_C DDRC_DurDeb.Com_tiDFC_ComInvld_26h_TEMP_POSITIONDebOk_C DDRC_DurDeb.Com_tiDFC_ComInvld_26h_TEMP_POSITIONDebDef_C DDRC_DurDeb.ChrgPlg_tiLiveCntctHzrdCcsDebOk_C DDRC_DurDeb.ChrgPlg_tiLiveCntctHzrdCcsDebDef_C DDRC_DurDeb.ChrgPlg_tiProxPltImpsDebOk_C DDRC_DurDeb.ChrgPlg_tiProxPltImpsDebDef_C DDRC_DurDeb.ChrgPlg_tiTHiCcsDcDebOk_C DDRC_DurDeb.ChrgPlg_tiTHiCcsDcDebDef_C DDRC_DurDeb.ElM_tiActvDchaFailrDebOk_C DDRC_DurDeb.ElM_tiActvDchaFailrDebDef_C DDRC_DurDeb.ElM_tiActvDchaFltDebOk_C DDRC_DurDeb.ElM_tiActvDchaFltDebDef_C DDRC_DurDeb.ElM_tiFbdnInvtrModDrv01DebOk_C DDRC_DurDeb.ElM_tiFbdnInvtrModDrv01DebDef_C DDRC_DurDeb.ElM_tiImobAuthentDebOk_C DDRC_DurDeb.ElM_tiImobAuthentDebDef_C DDRC_DurDeb.ElM_tiIsoMonFltDebOk_C DDRC_DurDeb.ElM_tiIsoMonFltDebDef_C DDRC_DurDeb.ElM_tiIsoMonPlausyFltDebOk_C DDRC_DurDeb.ElM_tiIsoMonPlausyFltDebDef_C DDRC_DurDeb.ElM_tiIvtrCooltTDebOk_C DDRC_DurDeb.ElM_tiIvtrCooltTDebDef_C DDRC_DurDeb.ElM_tiIvtrEmgyShtDwnDebOk_C DDRC_DurDeb.ElM_tiIvtrEmgyShtDwnDebDef_C DDRC_DurDeb.ElM_tiIvtrFailrDebOk_C DDRC_DurDeb.ElM_tiIvtrFailrDebDef_C DDRC_DurDeb.ElM_tiIvtrIntlckDebOk_C DDRC_DurDeb.ElM_tiIvtrIntlckDebDef_C DDRC_DurDeb.ElM_tiIvtrTErrDebOk_C DDRC_DurDeb.ElM_tiIvtrTErrDebDef_C DDRC_DurDeb.ElM_tiOverSpdNeg01DebOk_C DDRC_DurDeb.ElM_tiOverSpdNeg01DebDef_C DDRC_DurDeb.ElM_tiOverSpdPos01DebOk_C DDRC_DurDeb.ElM_tiOverSpdPos01DebDef_C DDRC_DurDeb.ElM_tiOverTqNeg01DebOk_C DDRC_DurDeb.ElM_tiOverTqNeg01DebDef_C DDRC_DurDeb.ElM_tiOverTqPos01DebOk_C DDRC_DurDeb.ElM_tiOverTqPos01DebDef_C DDRC_DurDeb.ElM_tiPwrAuthnDebOk_C DDRC_DurDeb.ElM_tiPwrAuthnDebDef_C DDRC_DurDeb.ElM_tiSpdErrDebOk_C DDRC_DurDeb.ElM_tiSpdErrDebDef_C DDRC_DurDeb.ElM_tiSvsDebOk_C DDRC_DurDeb.ElM_tiSvsDebDef_C DDRC_DurDeb.PEnv_tiVDDiagDebOk_C DDRC_DurDeb.PEnv_tiVDDiagDebDef_C DDRC_DurDeb.BrkBstPmp_numPlausGennDebOk_C DDRC_DurDeb.BrkBstPmp_numPlausGennDebDef_C DDRC_RatDeb.ACCmpr_tiFltLvl1UDRat_C DDRC_RatDeb.ACCmpr_tiFltLvl2UDRat_C DDRC_RatDeb.ACCmpr_tiFltLvl3UDRat_C DDRC_RatDeb.ACCmpr_tiFltLvl4UDRat_C DDRC_RatDeb.ACCmpr_tiHiPFltUDRat_C DDRC_RatDeb.ACCmpr_tiInvldCmprStUDRat_C DDRC_RatDeb.ACCmpr_tiInvldElecActPwrUDRat_C DDRC_RatDeb.ACCmpr_tiLoPFltUDRat_C DDRC_RatDeb.AcChrgrIntkT_tiSRCMinUDRat_C DDRC_RatDeb.BattU_tiMaxUDRat_C DDRC_RatDeb.BattU_tiMaxBattUDRat_C DDRC_RatDeb.BattU_tiMaxNoBattUDRat_C DDRC_RatDeb.BattU_tiMinUDRat_C DDRC_RatDeb.BattU_tiMinBattUDRat_C DDRC_RatDeb.BattU_tiMinNoBattUDRat_C DDRC_RatDeb.BrkBstP_tiHiCautionDfctUDRat_C DDRC_RatDeb.BrkBstP_tiHiWarnDfctUDRat_C DDRC_RatDeb.BrkBstP_tiPhyRngChkMaxUDRat_C DDRC_RatDeb.BrkBstP_tiPhyRngChkMinUDRat_C DDRC_RatDeb.BrkBstP_tiSnsr12PlausUDRat_C DDRC_RatDeb.BrkBstP_tiSnsr1ScbUDRat_C DDRC_RatDeb.BrkBstP_tiSnsr1ScgUDRat_C DDRC_RatDeb.BrkBstP_tiSnsr2ScbUDRat_C DDRC_RatDeb.BrkBstP_tiSnsr2ScgUDRat_C DDRC_RatDeb.BrkBstP_tiSnsrPMaxUDRat_C DDRC_RatDeb.BrkBstP_tiSnsrPMinUDRat_C DDRC_RatDeb.BrkBstPmp_tiHsScbUDRat_C DDRC_RatDeb.BrkBstPmp_tiHsScgUDRat_C DDRC_RatDeb.BrkBstPmp_tiLsOlUDRat_C DDRC_RatDeb.BrkBstPmp_tiLsScbUDRat_C DDRC_RatDeb.BrkBstPmp_tiLsScgUDRat_C DDRC_RatDeb.CbnHeatgHeatr_tiRlyOpendUDRat_C DDRC_RatDeb.CbnHeatgHeatr_tiRlyWlddUDRat_C DDRC_RatDeb.CcsPwrLineChpRst_tiMonDFCUDRat_C DDRC_RatDeb.CcsPwrLineChpVccEna_tiMonDFCUDRat_C DDRC_RatDeb.CcsPwrLineChpVcc_tiSRCMinUDRat_C DDRC_RatDeb.CcsPwrLineComChpT_tiSRCMinUDRat_C DDRC_RatDeb.CmbdChrgnSys_tiIBattExcddUDRat_C DDRC_RatDeb.CmbdChrgnSys_tiIEvseOutDeUDRat_C DDRC_RatDeb.CmbdChrgnSys_tiIOutDeUDRat_C DDRC_RatDeb.CmbdChrgnSys_tiIOutExcddUDRat_C DDRC_RatDeb.CmbdChrgnSys_tiUOutDeUDRat_C DDRC_RatDeb.CmbdChrgnSys_tiUOutExcddUDRat_C DDRC_RatDeb.CtPSwtActr_tiMonDFCUDRat_C DDRC_RatDeb.CtPSwtDiag_tiSRCMinUDRat_C DDRC_RatDeb.CtpCarrFrq_tiSRCMinUDRat_C DDRC_RatDeb.DcChrgrIntkT2_tiSRCMinUDRat_C DDRC_RatDeb.DcChrgrIntkT_tiSRCMinUDRat_C DDRC_RatDeb.DevLib_tiBattUHiUDRat_C DDRC_RatDeb.DevLib_tiBattULoUDRat_C DDRC_RatDeb.EmWakeupSig_tiMonDFCUDRat_C DDRC_RatDeb.Fan1_tiOLUDRat_C DDRC_RatDeb.Fan1_tiOvrTempUDRat_C DDRC_RatDeb.Fan1_tiSCBUDRat_C DDRC_RatDeb.FanSpd_tiSRCMinUDRat_C DDRC_RatDeb.Fan_tiRlySCBUDRat_C DDRC_RatDeb.Fan_tiRlySCGUDRat_C DDRC_RatDeb.FreonP_tiSRCMinUDRat_C DDRC_RatDeb.HLCCcs_tiPLnCChipTHiUDRat_C DDRC_RatDeb.HeatrCoreT_tiSRCMinUDRat_C DDRC_RatDeb.PwmCtP_tiSRCMinUDRat_C DDRC_RatDeb.PwrDistbnUnitT_tiSRCMinUDRat_C DDRC_RatDeb.SCtPmp1_tiOLUDRat_C DDRC_RatDeb.SCtPmp1_tiOvrTempUDRat_C DDRC_RatDeb.SCtPmp1_tiSCBUDRat_C DDRC_RatDeb.SCtPmpRly_tiOLUDRat_C DDRC_RatDeb.SCtPmpRly_tiOvrTempUDRat_C DDRC_RatDeb.SCtPmpRly_tiSCBUDRat_C DDRC_RatDeb.SpplCooltPmpRly_tiOLUDRat_C DDRC_RatDeb.SpplCooltPmpRly_tiOvrTempUDRat_C DDRC_RatDeb.SpplCooltPmpRly_tiSCBUDRat_C DDRC_RatDeb.UCtP_tiSRCMinUDRat_C DDRC_RatDeb.UPxP1_tiSRCMinUDRat_C DDRC_RatDeb.Inm_numHSN1MuteUDRat_C DDRC_RatDeb.Inm_numHSN3MuteUDRat_C DDRC_RatDeb.AcChrgrIntkT_tiPhysRngHiUDRat_C DDRC_RatDeb.AcChrgrIntkT_tiPhysRngLoUDRat_C DDRC_RatDeb.AcChrgrIntkT_tiSRCOpnUDRat_C DDRC_RatDeb.CcsPwrLineChpVcc_tiPhysRngHiUDRat_C DDRC_RatDeb.CcsPwrLineChpVcc_tiPhysRngLoUDRat_C DDRC_RatDeb.CcsPwrLineChpVcc_tiSRCOpnUDRat_C DDRC_RatDeb.CcsPwrLineComChpT_tiPhysRngHiUDRat_C DDRC_RatDeb.CcsPwrLineComChpT_tiPhysRngLoUDRat_C DDRC_RatDeb.CcsPwrLineComChpT_tiSRCOpnUDRat_C DDRC_RatDeb.CtPSwtDiag_tiPhysRngHiUDRat_C DDRC_RatDeb.CtPSwtDiag_tiPhysRngLoUDRat_C DDRC_RatDeb.CtPSwtDiag_tiSRCOpnUDRat_C DDRC_RatDeb.CtpCarrFrq_tiPhysRngHiUDRat_C DDRC_RatDeb.CtpCarrFrq_tiPhysRngLoUDRat_C DDRC_RatDeb.CtpCarrFrq_tiSRCMaxUDRat_C DDRC_RatDeb.DcChrgrIntkT2_tiPhysRngHiUDRat_C DDRC_RatDeb.DcChrgrIntkT2_tiPhysRngLoUDRat_C DDRC_RatDeb.DcChrgrIntkT2_tiSRCOpnUDRat_C DDRC_RatDeb.DcChrgrIntkT_tiPhysRngHiUDRat_C DDRC_RatDeb.DcChrgrIntkT_tiPhysRngLoUDRat_C DDRC_RatDeb.DcChrgrIntkT_tiSRCOpnUDRat_C DDRC_RatDeb.Fan1_tiSCGUDRat_C DDRC_RatDeb.FanSpd_tiPhysRngHiUDRat_C DDRC_RatDeb.FanSpd_tiPhysRngLoUDRat_C DDRC_RatDeb.FanSpd_tiSRCOpnUDRat_C DDRC_RatDeb.FreonP_tiPhysRngHiUDRat_C DDRC_RatDeb.FreonP_tiPhysRngLoUDRat_C DDRC_RatDeb.FreonP_tiSRCOpnUDRat_C DDRC_RatDeb.HeatrCoreT_tiPhysRngHiUDRat_C DDRC_RatDeb.HeatrCoreT_tiPhysRngLoUDRat_C DDRC_RatDeb.HeatrCoreT_tiSRCOpnUDRat_C DDRC_RatDeb.HvGrid_tiUMaxSdtyLimThdUDRat_C DDRC_RatDeb.HvGrid_tiUMinSftyLimThdUDRat_C DDRC_RatDeb.HvGrid_tiUPlausyThdUDRat_C DDRC_RatDeb.IntlckChrgPlgPosn_tiRngFltUDRat_C DDRC_RatDeb.IntlckChrgPlgPosn_tiSrcMaxUDRat_C DDRC_RatDeb.IntlckChrgPlgPosn_tiSrcMinUDRat_C DDRC_RatDeb.IntlckChrgPlg_tiHBrgOpnLdUDRat_C DDRC_RatDeb.IntlckChrgPlg_tiHBrgOvrCurrUDRat_C DDRC_RatDeb.IntlckChrgPlg_tiHBrgOvrTempUDRat_C DDRC_RatDeb.IntlckChrgPlg_tiHBrgShCirBatt1UDRat_C DDRC_RatDeb.IntlckChrgPlg_tiHBrgShCirBatt2UDRat_C DDRC_RatDeb.IntlckChrgPlg_tiHBrgShCirGnd1UDRat_C DDRC_RatDeb.IntlckChrgPlg_tiHBrgShCirGnd2UDRat_C DDRC_RatDeb.IntlckChrgPlg_tiHBrgShCirOvrLdUDRat_C DDRC_RatDeb.IntlckChrgPlg_tiHBrgTempOvrCurrUDRat_C DDRC_RatDeb.IntlckChrgPlg_tiHBrgUndrVltgUDRat_C DDRC_RatDeb.PwmCtP_tiPhysRngHiUDRat_C DDRC_RatDeb.PwmCtP_tiPhysRngLoUDRat_C DDRC_RatDeb.PwmCtP_tiSRCMaxUDRat_C DDRC_RatDeb.PwrDistbnUnitT_tiPhysRngHiUDRat_C DDRC_RatDeb.PwrDistbnUnitT_tiPhysRngLoUDRat_C DDRC_RatDeb.PwrDistbnUnitT_tiSRCOpnUDRat_C DDRC_RatDeb.SCtPmpRly_tiSCGUDRat_C DDRC_RatDeb.SpplCooltPmpRly_tiSCGUDRat_C DDRC_RatDeb.UCtP_tiPhysRngHiUDRat_C DDRC_RatDeb.UCtP_tiPhysRngLoUDRat_C DDRC_RatDeb.UCtP_tiSRCOpnUDRat_C DDRC_RatDeb.UPxP1_tiPhysRngHiUDRat_C DDRC_RatDeb.UPxP1_tiPhysRngLoUDRat_C DDRC_RatDeb.UPxP1_tiSRCOpnUDRat_C DDRC_RatDeb.VehV_tiPhysRngHiUDRat_C DDRC_RatDeb.VehV_tiPhysRngLoUDRat_C DDRC_RatDeb.VehV_tiSigCanUDRat_C DDRC_RatDeb.VehV_tiSigCanSafeUDRat_C DDRC_RatDeb.SCtPmp1_numDiagGrdKey1UDRat_C DDRC_RatDeb.SCtPmp1_numDiagGrdKey2UDRat_C DDRC_RatDeb.SCtPmp1_numDiagGrdKey3UDRat_C DDRC_RatDeb.SCtPmp1_numDiagGrdKey4UDRat_C DDRC_RatDeb.SCtPmp1_numDiagGrdKey5UDRat_C /end REF_CHARACTERISTIC
 /begin IN_MEASUREMENT DDRC_St.DFC_ACCmprFltLvlRes DDRC_St.DFC_AbgHiSigFlt DDRC_St.DFC_AbgIntPatFlt DDRC_St.DFC_AbgLoSigFlt DDRC_St.DFC_AbgUnkwnErrSigFlt DDRC_St.DFC_AcExtChrgrIBattExcdd DDRC_St.DFC_AcExtChrgrIInExcdd DDRC_St.DFC_AcExtChrgrIOutDe DDRC_St.DFC_AcExtChrgrIOutExcdd DDRC_St.DFC_AcExtChrgrUOutDe DDRC_St.DFC_AdpActvDChaFailr DDRC_St.DFC_AirbcuFlt DDRC_St.DFC_Airbg DDRC_St.DFC_AirbgCan DDRC_St.DFC_AirbgCanHWPlaus DDRC_St.DFC_AirbgHWCanPlaus DDRC_St.DFC_AirbgMnr DDRC_St.DFC_AirbgPerHi DDRC_St.DFC_AirbgPerdRngFlt DDRC_St.DFC_BlowrRlyErr DDRC_St.DFC_BrkBstPmpActtnDfct DDRC_St.DFC_BrkBstPmpDeactvnDfct DDRC_St.DFC_BrkSwtFlt DDRC_St.DFC_CbnHeatgHeatrHsScb DDRC_St.DFC_CbnHeatgHeatrHsScg DDRC_St.DFC_CbnHeatgHeatrLsOl DDRC_St.DFC_CbnHeatgHeatrLsScb DDRC_St.DFC_CbnHeatgHeatrLsScg DDRC_St.DFC_CbnHeatgHeatrUnUsed DDRC_St.DFC_ChrgnCntctHsOt DDRC_St.DFC_ChrgnCntctHsScb DDRC_St.DFC_ChrgnCntctHsScg DDRC_St.DFC_ChrgnCntctLsNegOl DDRC_St.DFC_ChrgnCntctLsNegOt DDRC_St.DFC_ChrgnCntctLsNegScb DDRC_St.DFC_ChrgnCntctLsNegScg DDRC_St.DFC_ChrgnCntctLsPosOl DDRC_St.DFC_ChrgnCntctLsPosOt DDRC_St.DFC_ChrgnCntctLsPosScb DDRC_St.DFC_ChrgnCntctLsPosScg DDRC_St.DFC_ChrgnCntctUnUsed DDRC_St.DFC_ComBrkMai DDRC_St.DFC_ComChrgrEVCont DDRC_St.DFC_ComChrgrEVtBlink DDRC_St.DFC_ComChrgrMstBlink DDRC_St.DFC_ComChrgrMstCont DDRC_St.DFC_ComChrgrSVSBlink DDRC_St.DFC_ComChrgrSVSCont DDRC_St.DFC_ComDcdcEVBlink DDRC_St.DFC_ComDcdcEVCont DDRC_St.DFC_ComDcdcFltLvl2 DDRC_St.DFC_ComDcdcFltLvl3 DDRC_St.DFC_ComDcdcFltLvl4 DDRC_St.DFC_ComDcdcFltLvl5 DDRC_St.DFC_ComDcdcFltLvlRes DDRC_St.DFC_ComDcdcMstBlink DDRC_St.DFC_ComDcdcMstCont DDRC_St.DFC_ComDcdcSVSBlink DDRC_St.DFC_ComDcdcSVSCont DDRC_St.DFC_ComElMIIvtrFltLvl2 DDRC_St.DFC_ComElMIIvtrFltLvl3 DDRC_St.DFC_ComElMIIvtrFltLvl4 DDRC_St.DFC_ComElMIIvtrFltLvl5 DDRC_St.DFC_ComElMIIvtrFltLvlRes DDRC_St.DFC_ComEmacEVBlink DDRC_St.DFC_ComEmacEVCont DDRC_St.DFC_ComEmacMstCont DDRC_St.DFC_ComEmacMsttBlink DDRC_St.DFC_ComEmacSVSBlink DDRC_St.DFC_ComEmacSVSCont DDRC_St.DFC_ComGunCntInfoWkuReq DDRC_St.DFC_ComHillHldFlt DDRC_St.DFC_ComHvBattRchrgWkuReq DDRC_St.DFC_ComHvbFltLvl2 DDRC_St.DFC_ComHvbFltLvl3 DDRC_St.DFC_ComHvbFltLvl4 DDRC_St.DFC_ComHvbFltLvl5 DDRC_St.DFC_ComHvbFltLvlRes DDRC_St.DFC_ComHvbMstBlink DDRC_St.DFC_ComHvbMstCont DDRC_St.DFC_ComImmoUnlockWkuReq DDRC_St.DFC_ComInfoReqPtlWkuReq DDRC_St.DFC_ComOBCFltLvl2 DDRC_St.DFC_ComOBCFltLvl3 DDRC_St.DFC_ComOBCFltLvl4 DDRC_St.DFC_ComOBCFltLvl5 DDRC_St.DFC_ComOBCFltLvlRes DDRC_St.DFC_ComPostOperationWkuReq DDRC_St.DFC_ComPreCondElecWkuReq DDRC_St.DFC_ComRemUnlckWkuReq DDRC_St.DFC_ComStpDlyHMIWkuReq DDRC_St.DFC_ComflgCurMeasmtErr DDRC_St.DFC_ComflgCurMeasmtSysErr DDRC_St.DFC_ComflgCurMeasmtVld DDRC_St.DFC_ComflgCurRngErr DDRC_St.DFC_ComflgTPcbMeasmtErr DDRC_St.DFC_ComflgTPcbMeasmtVld DDRC_St.DFC_ComflgTPcbRngErr DDRC_St.DFC_ComflgTPcbSysErr DDRC_St.DFC_ComflgTShntMeasmtErr DDRC_St.DFC_ComflgTShntMeasmtVld DDRC_St.DFC_ComflgTShntRngErr DDRC_St.DFC_ComflgTShntSysErr DDRC_St.DFC_ComflgVoltMeasmtErr DDRC_St.DFC_ComflgVoltMeasmtSysErr DDRC_St.DFC_ComflgVoltMeasmtVld DDRC_St.DFC_ComflgVoltRngErr DDRC_St.DFC_CrashEveOcc DDRC_St.DFC_DcdcFwdModStuck DDRC_St.DFC_DcdcLvUDifMaxFlt DDRC_St.DFC_DcdcOffModStuck DDRC_St.DFC_DcdcOperModFailr DDRC_St.DFC_DcdcPrecModStuck DDRC_St.DFC_DrvDoorOpn DDRC_St.DFC_DrvModPosnDfct DDRC_St.DFC_DrvStbltOpn DDRC_St.DFC_ETogFailrLvl3 DDRC_St.DFC_ETogFailrLvl4 DDRC_St.DFC_EbsLvBattSocDiagLo DDRC_St.DFC_EbsLvBattUDiagDiOper DDRC_St.DFC_EbsLvBattUDiagFltLvl1 DDRC_St.DFC_EbsLvBattUDiagFltLvl2 DDRC_St.DFC_EbsLvBattUDiagLo DDRC_St.DFC_EbsSnsrSt DDRC_St.DFC_EbsSofASILErr DDRC_St.DFC_ElTSPtSysLimDrvErr DDRC_St.DFC_ElTSPtSysLimRgnErr DDRC_St.DFC_HLCCcsFwDwnl DDRC_St.DFC_HvBattChrgPwrMax DDRC_St.DFC_HvBattCrashDetd DDRC_St.DFC_HvBattDchaPwrMax DDRC_St.DFC_HvBattEmgyOff DDRC_St.DFC_HvBattEmgyOffIntlck DDRC_St.DFC_HvBattEmgyOffReq DDRC_St.DFC_HvBattFltMod DDRC_St.DFC_HvBattIReqToChrgrErr DDRC_St.DFC_HvBattIReqToChrgrIni DDRC_St.DFC_HvBattIninTout DDRC_St.DFC_HvBattIntlckSt DDRC_St.DFC_HvBattIsoFlt DDRC_St.DFC_HvBattLimdPwr DDRC_St.DFC_HvBattMaiSwtClsngFlt DDRC_St.DFC_HvBattMaiSwtFlt DDRC_St.DFC_HvBattMaiSwtOpen DDRC_St.DFC_HvBattMaiSwtOpngFlt DDRC_St.DFC_HvBattMaiSwtWldd DDRC_St.DFC_HvBattNegCntctrCntErr DDRC_St.DFC_HvBattOperModChrgPlausy DDRC_St.DFC_HvBattOverTDern DDRC_St.DFC_HvBattPosCntctrCntErr DDRC_St.DFC_HvBattPrecCntctrCntErr DDRC_St.DFC_HvBattPwrDistbnTDern DDRC_St.DFC_HvBattPwrDistbnTInhbn DDRC_St.DFC_HvBattRatRSohErr DDRC_St.DFC_HvBattRatSohErr DDRC_St.DFC_HvBattSngIsoWarn DDRC_St.DFC_HvBattSrvPlgDiscnct DDRC_St.DFC_HvBattUNomChrgnErr DDRC_St.DFC_HvBattUNomChrgnIni DDRC_St.DFC_HvBattUnderTDern DDRC_St.DFC_HvbEVLmpBlink DDRC_St.DFC_HvbEVLmpCont DDRC_St.DFC_HvbSVSBlink DDRC_St.DFC_HvbSVSCont DDRC_St.DFC_InmLINBusBlk DDRC_St.DFC_PDUProgmFailr DDRC_St.DFC_PEnvSigRngMax DDRC_St.DFC_PEnvSigRngMin DDRC_St.DFC_PLnCChpDeactvnFaild DDRC_St.DFC_PrkgBrkFailr DDRC_St.DFC_PtSysLimErr DDRC_St.DFC_PwrMaxDchaShoLo DDRC_St.DFC_SCtPmp1FailSafeNotSuc DDRC_St.DFC_SCtPmp1SCG DDRC_St.DFC_VehCoornDrvrNotPrsnt DDRC_St.DFC_VehVCanAvl DDRC_St.DFC_VehVCanErr DDRC_St.DFC_eTogFailrLvlRes DDRC_St.DFC_flgBrkMaiDiag DDRC_St.DFC_stHvbIsoMeasmtRes DDRC_St.DFC_BrkBstPmpPLeakDfct DDRC_St.DFC_Com082hTooShort DDRC_St.DFC_Com092hTooShort DDRC_St.DFC_Com205hAbsent DDRC_St.DFC_Com205hChecksum DDRC_St.DFC_Com205hCounter DDRC_St.DFC_Com205hTooShort DDRC_St.DFC_Com217hAbsent DDRC_St.DFC_Com217hChecksum DDRC_St.DFC_Com217hCounter DDRC_St.DFC_Com217hTooShort DDRC_St.DFC_Com227hAbsent DDRC_St.DFC_Com227hTooShort DDRC_St.DFC_Com237hAbsent DDRC_St.DFC_Com237hChecksum DDRC_St.DFC_Com237hCounter DDRC_St.DFC_Com237hTooShort DDRC_St.DFC_Com259hAbsent DDRC_St.DFC_Com259hChecksum DDRC_St.DFC_Com259hCounter DDRC_St.DFC_Com259hTooShort DDRC_St.DFC_Com26hAbsent DDRC_St.DFC_Com26hTooShort DDRC_St.DFC_Com273hAbsent DDRC_St.DFC_Com273hChecksum DDRC_St.DFC_Com273hCounter DDRC_St.DFC_Com273hTooShort DDRC_St.DFC_Com275hAbsent DDRC_St.DFC_Com275hChecksum DDRC_St.DFC_Com275hCounter DDRC_St.DFC_Com275hTooShort DDRC_St.DFC_Com283hAbsent DDRC_St.DFC_Com283hTooShort DDRC_St.DFC_Com285hAbsent DDRC_St.DFC_Com285hChecksum DDRC_St.DFC_Com285hCounter DDRC_St.DFC_Com285hTooShort DDRC_St.DFC_Com293hAbsent DDRC_St.DFC_Com293hChecksum DDRC_St.DFC_Com293hCounter DDRC_St.DFC_Com293hTooShort DDRC_St.DFC_Com308hAbsent DDRC_St.DFC_Com308hChecksum DDRC_St.DFC_Com308hCounter DDRC_St.DFC_Com308hTooShort DDRC_St.DFC_Com318hAbsent DDRC_St.DFC_Com318hChecksum DDRC_St.DFC_Com318hCounter DDRC_St.DFC_Com318hTooShort DDRC_St.DFC_Com325hAbsent DDRC_St.DFC_Com325hChecksum DDRC_St.DFC_Com325hCounter DDRC_St.DFC_Com325hTooShort DDRC_St.DFC_Com335hAbsent DDRC_St.DFC_Com335hChecksum DDRC_St.DFC_Com335hCounter DDRC_St.DFC_Com335hTooShort DDRC_St.DFC_Com351hAbsent DDRC_St.DFC_Com351hTooShort DDRC_St.DFC_Com38DhAbsent DDRC_St.DFC_Com38DhChecksum DDRC_St.DFC_Com38DhCounter DDRC_St.DFC_Com38DhTooShort DDRC_St.DFC_Com412hAbsent DDRC_St.DFC_Com412hChecksum DDRC_St.DFC_Com412hCounter DDRC_St.DFC_Com412hTooShort DDRC_St.DFC_Com427hAbsent DDRC_St.DFC_Com427hTooShort DDRC_St.DFC_Com432hAbsent DDRC_St.DFC_Com432hChecksum DDRC_St.DFC_Com432hCounter DDRC_St.DFC_Com432hTooShort DDRC_St.DFC_Com435hAbsent DDRC_St.DFC_Com435hTooShort DDRC_St.DFC_Com442hAbsent DDRC_St.DFC_Com442hTooShort DDRC_St.DFC_Com453hAbsent DDRC_St.DFC_Com453hTooShort DDRC_St.DFC_Com455hAbsent DDRC_St.DFC_Com455hTooShort DDRC_St.DFC_Com463hAbsent DDRC_St.DFC_Com463hTooShort DDRC_St.DFC_Com473hAbsent DDRC_St.DFC_Com473hTooShort DDRC_St.DFC_Com47BhAbsent DDRC_St.DFC_Com47BhTooShort DDRC_St.DFC_Com48BhAbsent DDRC_St.DFC_Com48BhTooShort DDRC_St.DFC_Com497hTooShort DDRC_St.DFC_Com4F2hAbsent DDRC_St.DFC_Com4F2hChecksum DDRC_St.DFC_Com4F2hCounter DDRC_St.DFC_Com4F2hTooShort DDRC_St.DFC_Com50DhAbsent DDRC_St.DFC_Com50DhTooShort DDRC_St.DFC_Com535hAbsent DDRC_St.DFC_Com535hTooShort DDRC_St.DFC_Com543hAbsent DDRC_St.DFC_Com543hTooShort DDRC_St.DFC_Com552hAbsent DDRC_St.DFC_Com552hTooShort DDRC_St.DFC_Com583hAbsent DDRC_St.DFC_Com583hTooShort DDRC_St.DFC_Com592hAbsent DDRC_St.DFC_Com592hChecksum DDRC_St.DFC_Com592hCounter DDRC_St.DFC_Com592hTooShort DDRC_St.DFC_Com595hAbsent DDRC_St.DFC_Com595hChecksum DDRC_St.DFC_Com595hCounter DDRC_St.DFC_Com595hTooShort DDRC_St.DFC_Com5B2hAbsent DDRC_St.DFC_Com5B2hTooShort DDRC_St.DFC_Com5B5hAbsent DDRC_St.DFC_Com5B5hChecksum DDRC_St.DFC_Com5B5hCounter DDRC_St.DFC_Com5B5hTooShort DDRC_St.DFC_Com5C7hTooShort DDRC_St.DFC_Com5E7hAbsent DDRC_St.DFC_Com5E7hTooShort DDRC_St.DFC_Com635hTooShort DDRC_St.DFC_Com645hTooShort DDRC_St.DFC_Com663hAbsent DDRC_St.DFC_Com663hTooShort DDRC_St.DFC_Com665hAbsent DDRC_St.DFC_Com665hTooShort DDRC_St.DFC_Com675hAbsent DDRC_St.DFC_Com675hTooShort DDRC_St.DFC_ComFrbd_205h_HVBAT_PACK_CURRENT DDRC_St.DFC_ComFrbd_205h_HVBAT_SOC_DISPLAY DDRC_St.DFC_ComFrbd_205h_HVBAT_VOLTAGE DDRC_St.DFC_ComFrbd_217h_INV_DC_BUS_VOLTAGE DDRC_St.DFC_ComFrbd_217h_INV_MTR_ACTUAL_TRQ DDRC_St.DFC_ComFrbd_217h_INV_MTR_SPEED DDRC_St.DFC_ComFrbd_217h_INV_MTR_TRQ DDRC_St.DFC_ComFrbd_227h_INV_DC_CURRENT DDRC_St.DFC_ComFrbd_227h_INV_MOTORING_PEAK_TRQ DDRC_St.DFC_ComFrbd_227h_INV_MTR_INST_INPUT_POWER DDRC_St.DFC_ComFrbd_227h_INV_REGEN_PEAK_TRQ DDRC_St.DFC_ComFrbd_237h_INV_ACTIVE_DISCHARGE_STATUS DDRC_St.DFC_ComFrbd_237h_INV_CTRL_MODE_ACK DDRC_St.DFC_ComFrbd_237h_INV_EV_WARNING DDRC_St.DFC_ComFrbd_237h_INV_FAULT_LEVEL DDRC_St.DFC_ComFrbd_237h_INV_MASTER_STOP DDRC_St.DFC_ComFrbd_237h_INV_SERVICE_DUE DDRC_St.DFC_ComFrbd_237h_INV_STAB_MIN_TRQ DDRC_St.DFC_ComFrbd_259h_TGLM_FAILURE_STATE DDRC_St.DFC_ComFrbd_259h_TGLM_MODE_PUSH DDRC_St.DFC_ComFrbd_259h_TOGGLE_MONOSTABLE_POS DDRC_St.DFC_ComFrbd_273h_OBC_outputpower_capability DDRC_St.DFC_ComFrbd_275h_HVBAT_DISCHARGE_30S_AVAILABLE_CURRENT DDRC_St.DFC_ComFrbd_275h_HVBAT_DISCHARGE_30S_AVAILABLE_POWER DDRC_St.DFC_ComFrbd_283h_DCDC_IN_CURRENT DDRC_St.DFC_ComFrbd_283h_DCDC_IN_VOLTAGE DDRC_St.DFC_ComFrbd_283h_DCDC_OUT_CURRENT DDRC_St.DFC_ComFrbd_283h_DCDC_OUT_VOLTAGE DDRC_St.DFC_ComFrbd_285h_HVBAT_REGEN_CHG_30S_CURRENT_LIMIT DDRC_St.DFC_ComFrbd_285h_HVBAT_REGEN_CHRG_30S_POWER_LIMIT DDRC_St.DFC_ComFrbd_293h_DCDC_outputpower_capability DDRC_St.DFC_ComFrbd_325h_HVBAT_INSULATION_RESISTANCE DDRC_St.DFC_ComFrbd_325h_HVBAT_TEMPERATURE DDRC_St.DFC_ComFrbd_335h_HVBAT_CHRG_CONTINUOUS_CURR_MAX DDRC_St.DFC_ComFrbd_335h_HVBAT_CHRG_COTINUOUS_CURR_REQ DDRC_St.DFC_ComFrbd_335h_HVBAT_CHRG_MAX_VOLT DDRC_St.DFC_ComFrbd_335h_HVBAT_DC_BUS_VOLTAGE DDRC_St.DFC_ComFrbd_427h_INV_OP_MODE DDRC_St.DFC_ComFrbd_427h_INV_PERMISIBLE_TORQUE DDRC_St.DFC_ComFrbd_435h_HVBAT_MAX_CELL_VOLT DDRC_St.DFC_ComFrbd_435h_HVBAT_MAX_CELL_VOLT_NUM DDRC_St.DFC_ComFrbd_435h_HVBAT_MAX_SENSOR_TEMP DDRC_St.DFC_ComFrbd_435h_HVBAT_MIN_CELL_VOLT DDRC_St.DFC_ComFrbd_435h_HVBAT_MIN_CELL_VOLT_NUM DDRC_St.DFC_ComFrbd_453h_OBC_IN_CURRENT DDRC_St.DFC_ComFrbd_453h_OBC_IN_VOLTAGE DDRC_St.DFC_ComFrbd_453h_OBC_IP_POWER DDRC_St.DFC_ComFrbd_455h_HVBAT_NOMINAL_VOLTAGE DDRC_St.DFC_ComFrbd_463h_OBC_OUT_CURRENT DDRC_St.DFC_ComFrbd_463h_OBC_OUT_VOLTAGE DDRC_St.DFC_ComFrbd_463h_OBC_TEMPERATURE DDRC_St.DFC_ComFrbd_473h_DCDC_Coolant_Temperature DDRC_St.DFC_ComFrbd_473h_DCDC_TEMPERATURE DDRC_St.DFC_ComFrbd_47Bh_eCOMP_BusBarCurrent DDRC_St.DFC_ComFrbd_47Bh_eCOMP_BusBarVoltage DDRC_St.DFC_ComFrbd_47Bh_eCOMP_CompressorSpeed DDRC_St.DFC_ComFrbd_47Bh_eCOMP_IGBT_Temp DDRC_St.DFC_ComFrbd_47Bh_eCOMP_PeakPhaCurrent DDRC_St.DFC_ComFrbd_47Bh_eCOMP_Power_consumption DDRC_St.DFC_ComFrbd_48Bh_eCOMP_Fault_Level DDRC_St.DFC_ComFrbd_4F2h_VALEUR_SOC_ETENDUE DDRC_St.DFC_ComFrbd_535h_HV_BATT_TEMP_AVG DDRC_St.DFC_ComFrbd_543h_HVBAT_RESTBATTENERGY DDRC_St.DFC_ComFrbd_543h_HVBAT_SOH DDRC_St.DFC_ComFrbd_543h_HV_BATT_SOH_RES DDRC_St.DFC_ComFrbd_592h_IBATT_1 DDRC_St.DFC_ComFrbd_592h_IBATT_2 DDRC_St.DFC_ComFrbd_592h_IBATT_3 DDRC_St.DFC_ComFrbd_592h_TEMP_BATT DDRC_St.DFC_ComFrbd_592h_U_BATT_BECB DDRC_St.DFC_ComFrbd_595h_HVBAT_TIME_TO_CHRG_80 DDRC_St.DFC_ComFrbd_5B2h_TEMP_AIR_EXT DDRC_St.DFC_ComFrbd_635h_HVBAT_NEG_CONT_COUNT_SEG1 DDRC_St.DFC_ComFrbd_635h_HVBAT_NEG_CONT_COUNT_SEG3 DDRC_St.DFC_ComFrbd_635h_HVBAT_NEG_CONT_COUNT_SEG4 DDRC_St.DFC_ComFrbd_635h_HVBAT_PST_CONT_COUNT_SEG1 DDRC_St.DFC_ComFrbd_635h_HVBAT_PST_CONT_COUNT_SEG3 DDRC_St.DFC_ComFrbd_635h_HVBAT_PST_CONT_COUNT_SEG4 DDRC_St.DFC_ComFrbd_645h_HVBAT_PRECHRGE_CONT_COUNT_SEG1 DDRC_St.DFC_ComFrbd_645h_HVBAT_PRECHRGE_CONT_COUNT_SEG2 DDRC_St.DFC_ComFrbd_675h_HVBAT_REMAININGBATTCAPACITY DDRC_St.DFC_ComInvld_205h_HVBAT_CHARGING_STATUS DDRC_St.DFC_ComInvld_205h_HVBAT_PACK_CURRENT DDRC_St.DFC_ComInvld_205h_HVBAT_SOC_DISPLAY DDRC_St.DFC_ComInvld_205h_HVBAT_VOLTAGE DDRC_St.DFC_ComInvld_217h_INV_DC_BUS_VOLTAGE DDRC_St.DFC_ComInvld_217h_INV_MTR_ACTUAL_TRQ DDRC_St.DFC_ComInvld_217h_INV_MTR_SPEED DDRC_St.DFC_ComInvld_217h_INV_MTR_TRQ DDRC_St.DFC_ComInvld_227h_INV_DC_CURRENT DDRC_St.DFC_ComInvld_227h_INV_MOTORING_PEAK_TRQ DDRC_St.DFC_ComInvld_227h_INV_MTR_INST_INPUT_POWER DDRC_St.DFC_ComInvld_227h_INV_REGEN_PEAK_TRQ DDRC_St.DFC_ComInvld_237h_INV_ACTIVE_DISCHARGE_STATUS DDRC_St.DFC_ComInvld_237h_INV_FAULT_LEVEL DDRC_St.DFC_ComInvld_237h_INV_STAB_MIN_TRQ DDRC_St.DFC_ComInvld_259h_TGLM_MODE_PUSH DDRC_St.DFC_ComInvld_259h_TOGGLE_MONOSTABLE_POS DDRC_St.DFC_ComInvld_26h_AC_SWITCH_REQ DDRC_St.DFC_ComInvld_26h_BLOWER_POSITION DDRC_St.DFC_ComInvld_26h_EVAP_SENSOR_FAULT DDRC_St.DFC_ComInvld_26h_EVAP_SENSOR_VALUE DDRC_St.DFC_ComInvld_26h_POTENTIOMETER_FAULT DDRC_St.DFC_ComInvld_26h_REAR_DEFOG_REQ DDRC_St.DFC_ComInvld_26h_TEMP_POSITION DDRC_St.DFC_ComInvld_273h_OBC_FAULT_LEVEL DDRC_St.DFC_ComInvld_273h_OBC_outputpower_capability DDRC_St.DFC_ComInvld_275h_HVBAT_DISCHARGE_30S_AVAILABLE_CURRENT DDRC_St.DFC_ComInvld_275h_HVBAT_DISCHARGE_30S_AVAILABLE_POWER DDRC_St.DFC_ComInvld_283h_DCDC_IN_CURRENT DDRC_St.DFC_ComInvld_283h_DCDC_IN_VOLTAGE DDRC_St.DFC_ComInvld_283h_DCDC_OUT_CURRENT DDRC_St.DFC_ComInvld_283h_DCDC_OUT_VOLTAGE DDRC_St.DFC_ComInvld_285h_HVBAT_REGEN_CHG_30S_CURRENT_LIMIT DDRC_St.DFC_ComInvld_285h_HVBAT_REGEN_CHRG_30S_POWER_LIMIT DDRC_St.DFC_ComInvld_293h_DCDC_FAULT_LEVEL DDRC_St.DFC_ComInvld_293h_DCDC_outputpower_capability DDRC_St.DFC_ComInvld_325h_HVBAT_EPLUG_STATUS DDRC_St.DFC_ComInvld_325h_HVBAT_HVIL_STS DDRC_St.DFC_ComInvld_325h_HVBAT_INSULATION_FAULT DDRC_St.DFC_ComInvld_325h_HVBAT_INSULATION_RESISTANCE DDRC_St.DFC_ComInvld_325h_HVBAT_TEMPERATURE DDRC_St.DFC_ComInvld_335h_HVBAT_CHRG_CONTINUOUS_CURR_MAX DDRC_St.DFC_ComInvld_335h_HVBAT_CHRG_COTINUOUS_CURR_REQ DDRC_St.DFC_ComInvld_335h_HVBAT_CHRG_MAX_VOLT DDRC_St.DFC_ComInvld_335h_HVBAT_DC_BUS_VOLTAGE DDRC_St.DFC_ComInvld_38Dh_VITESSE_VEHICULE_ROUES DDRC_St.DFC_ComInvld_38Dh_VVH_INDISP DDRC_St.DFC_ComInvld_427h_INV_COOLANT_TEMP DDRC_St.DFC_ComInvld_427h_INV_MOTOR_TEMP DDRC_St.DFC_ComInvld_427h_INV_OP_MODE DDRC_St.DFC_ComInvld_427h_INV_PERMISIBLE_TORQUE DDRC_St.DFC_ComInvld_427h_INV_TEMP DDRC_St.DFC_ComInvld_432h_REVEIL_PRINCIPAL DDRC_St.DFC_ComInvld_435h_HVBAT_MAX_CELL_VOLT DDRC_St.DFC_ComInvld_435h_HVBAT_MAX_CELL_VOLT_NUM DDRC_St.DFC_ComInvld_435h_HVBAT_MAX_SENSOR_TEMP DDRC_St.DFC_ComInvld_435h_HVBAT_MIN_CELL_VOLT DDRC_St.DFC_ComInvld_435h_HVBAT_MIN_CELL_VOLT_NUM DDRC_St.DFC_ComInvld_442h_BCCM_BLOWER_RELAY_STS DDRC_St.DFC_ComInvld_453h_OBC_IN_CURRENT DDRC_St.DFC_ComInvld_453h_OBC_IN_VOLTAGE DDRC_St.DFC_ComInvld_453h_OBC_IP_POWER DDRC_St.DFC_ComInvld_455h_HVBAT_NOMINAL_VOLTAGE DDRC_St.DFC_ComInvld_463h_OBC_OUT_CURRENT DDRC_St.DFC_ComInvld_463h_OBC_OUT_VOLTAGE DDRC_St.DFC_ComInvld_463h_OBC_TEMPERATURE DDRC_St.DFC_ComInvld_473h_DCDC_Coolant_Temperature DDRC_St.DFC_ComInvld_473h_DCDC_TEMPERATURE DDRC_St.DFC_ComInvld_47Bh_eCOMP_BusBarCurrent DDRC_St.DFC_ComInvld_47Bh_eCOMP_BusBarVoltage DDRC_St.DFC_ComInvld_47Bh_eCOMP_CompressorSpeed DDRC_St.DFC_ComInvld_47Bh_eCOMP_IGBT_Temp DDRC_St.DFC_ComInvld_47Bh_eCOMP_PeakPhaCurrent DDRC_St.DFC_ComInvld_47Bh_eCOMP_Power_consumption DDRC_St.DFC_ComInvld_4F2h_STATUS_SOC DDRC_St.DFC_ComInvld_4F2h_TEMP_BATT_STATUS DDRC_St.DFC_ComInvld_4F2h_VALEUR_SOC_ETENDUE DDRC_St.DFC_ComInvld_535h_HV_BATT_TEMP_AVG DDRC_St.DFC_ComInvld_543h_HVBAT_RESTBATTENERGY DDRC_St.DFC_ComInvld_543h_HVBAT_SOH DDRC_St.DFC_ComInvld_543h_HV_BATT_SOH_RES DDRC_St.DFC_ComInvld_552h_CPT_TEMPOREL DDRC_St.DFC_ComInvld_552h_KILOMETRAGE DDRC_St.DFC_ComInvld_583h_HV_BATT_DISCONT_CSE_OPEN DDRC_St.DFC_ComInvld_592h_CALIBRE_IBATT DDRC_St.DFC_ComInvld_592h_IBATT_1 DDRC_St.DFC_ComInvld_592h_IBATT_2 DDRC_St.DFC_ComInvld_592h_IBATT_3 DDRC_St.DFC_ComInvld_592h_TEMP_BATT DDRC_St.DFC_ComInvld_592h_U_BATT_BECB DDRC_St.DFC_ComInvld_595h_HVBAT_TIME_TO_CHRG_80 DDRC_St.DFC_ComInvld_5B2h_TEMP_AIR_EXT DDRC_St.DFC_ComInvld_5B5h_HVBAT_THERMAL_RUNAWAY DDRC_St.DFC_ComInvld_635h_HVBAT_NEG_CONT_COUNT_SEG1 DDRC_St.DFC_ComInvld_635h_HVBAT_NEG_CONT_COUNT_SEG3 DDRC_St.DFC_ComInvld_635h_HVBAT_NEG_CONT_COUNT_SEG4 DDRC_St.DFC_ComInvld_635h_HVBAT_PST_CONT_COUNT_SEG1 DDRC_St.DFC_ComInvld_635h_HVBAT_PST_CONT_COUNT_SEG3 DDRC_St.DFC_ComInvld_635h_HVBAT_PST_CONT_COUNT_SEG4 DDRC_St.DFC_ComInvld_645h_HVBAT_PRECHRGE_CONT_COUNT_SEG1 DDRC_St.DFC_ComInvld_645h_HVBAT_PRECHRGE_CONT_COUNT_SEG2 DDRC_St.DFC_ComInvld_675h_HVBAT_REMAININGBATTCAPACITY DDRC_St.DFC_ACCmprFltLvl1 DDRC_St.DFC_ACCmprFltLvl2 DDRC_St.DFC_ACCmprFltLvl3 DDRC_St.DFC_ACCmprFltLvl4 DDRC_St.DFC_ACCmprHiPFlt DDRC_St.DFC_ACCmprInvldCmprSt DDRC_St.DFC_ACCmprInvldElecActPwr DDRC_St.DFC_ACCmprLoPFlt DDRC_St.DFC_AcChrgrIntkTSRCMin DDRC_St.DFC_BattUBMaxBatt DDRC_St.DFC_BattUBMaxNoBatt DDRC_St.DFC_BattUBMinBatt DDRC_St.DFC_BattUBMinNoBatt DDRC_St.DFC_BattUSRCMax DDRC_St.DFC_BattUSRCMin DDRC_St.DFC_BrkBstPHiCautionDfct DDRC_St.DFC_BrkBstPHiWarnDfct DDRC_St.DFC_BrkBstPSnsr12PlausDfct DDRC_St.DFC_BrkBstPSnsr1Scb DDRC_St.DFC_BrkBstPSnsr1Scg DDRC_St.DFC_BrkBstPSnsr2Scb DDRC_St.DFC_BrkBstPSnsr2Scg DDRC_St.DFC_BrkBstPSnsrMax DDRC_St.DFC_BrkBstPSnsrMin DDRC_St.DFC_BrkBstPhyRngChkMax DDRC_St.DFC_BrkBstPhyRngChkMin DDRC_St.DFC_BrkBstPmpHsScb DDRC_St.DFC_BrkBstPmpHsScg DDRC_St.DFC_BrkBstPmpLsOl DDRC_St.DFC_BrkBstPmpLsScb DDRC_St.DFC_BrkBstPmpLsScg DDRC_St.DFC_CbnHeatgHeatrRlyOpend DDRC_St.DFC_CbnHeatgHeatrRlyWldd DDRC_St.DFC_CcsDcIBattExcdd DDRC_St.DFC_CcsDcIEvseOutDe DDRC_St.DFC_CcsDcIOutDe DDRC_St.DFC_CcsDcIOutExcdd DDRC_St.DFC_CcsDcUOutDe DDRC_St.DFC_CcsDcUOutExcdd DDRC_St.DFC_CcsPwrLineChpRstOL DDRC_St.DFC_CcsPwrLineChpRstOvrTemp DDRC_St.DFC_CcsPwrLineChpRstSCB DDRC_St.DFC_CcsPwrLineChpRstSCG DDRC_St.DFC_CcsPwrLineChpVccEnaOL DDRC_St.DFC_CcsPwrLineChpVccEnaOvrTemp DDRC_St.DFC_CcsPwrLineChpVccEnaSCB DDRC_St.DFC_CcsPwrLineChpVccEnaSCG DDRC_St.DFC_CcsPwrLineChpVccSRCMin DDRC_St.DFC_CcsPwrLineComChpTSRCMin DDRC_St.DFC_CtPSwtActrOL DDRC_St.DFC_CtPSwtActrOvrTemp DDRC_St.DFC_CtPSwtActrSCB DDRC_St.DFC_CtPSwtActrSCG DDRC_St.DFC_CtPSwtDiagSRCMin DDRC_St.DFC_CtpCarrFrqSRCMin DDRC_St.DFC_DcChrgrIntkT2SRCMin DDRC_St.DFC_DcChrgrIntkTSRCMin DDRC_St.DFC_DevLibBattUHi DDRC_St.DFC_DevLibBattULo DDRC_St.DFC_EmWakeupSigOL DDRC_St.DFC_EmWakeupSigOvrTemp DDRC_St.DFC_EmWakeupSigSCB DDRC_St.DFC_EmWakeupSigSCG DDRC_St.DFC_Fan1OL DDRC_St.DFC_Fan1OvrTemp DDRC_St.DFC_Fan1SCB DDRC_St.DFC_FanRlySCB DDRC_St.DFC_FanRlySCG DDRC_St.DFC_FanSpdSRCMin DDRC_St.DFC_FreonPSRCMin DDRC_St.DFC_HLCCcsPLnCChipTHi DDRC_St.DFC_HeatrCoreTSRCMin DDRC_St.DFC_PwmCtPSRCMin DDRC_St.DFC_PwrDistbnUnitTSRCMin DDRC_St.DFC_SCtPmp1OL DDRC_St.DFC_SCtPmp1OvrTemp DDRC_St.DFC_SCtPmp1SCB DDRC_St.DFC_SCtPmpRlyOL DDRC_St.DFC_SCtPmpRlyOvrTemp DDRC_St.DFC_SCtPmpRlySCB DDRC_St.DFC_SpplCooltPmpRlyOL DDRC_St.DFC_SpplCooltPmpRlyOvrTemp DDRC_St.DFC_SpplCooltPmpRlySCB DDRC_St.DFC_UCtPSRCMin DDRC_St.DFC_UPxP1SRCMin DDRC_St.DFC_ComHSN1CANMute DDRC_St.DFC_ComHSN3CANMute DDRC_St.DFC_AcChrgrIntkTPhysRngHi DDRC_St.DFC_AcChrgrIntkTPhysRngLo DDRC_St.DFC_AcChrgrIntkTSRCOpn DDRC_St.DFC_CcsPwrLineChpVccPhysRngHi DDRC_St.DFC_CcsPwrLineChpVccPhysRngLo DDRC_St.DFC_CcsPwrLineChpVccSRCOpn DDRC_St.DFC_CcsPwrLineComChpTPhysRngHi DDRC_St.DFC_CcsPwrLineComChpTPhysRngLo DDRC_St.DFC_CcsPwrLineComChpTSRCOpn DDRC_St.DFC_CtPSwtDiagPhysRngHi DDRC_St.DFC_CtPSwtDiagPhysRngLo DDRC_St.DFC_CtPSwtDiagSRCOpn DDRC_St.DFC_CtpCarrFrqPhysRngHi DDRC_St.DFC_CtpCarrFrqPhysRngLo DDRC_St.DFC_CtpCarrFrqSRCMax DDRC_St.DFC_DcChrgrIntkT2PhysRngHi DDRC_St.DFC_DcChrgrIntkT2PhysRngLo DDRC_St.DFC_DcChrgrIntkT2SRCOpn DDRC_St.DFC_DcChrgrIntkTPhysRngHi DDRC_St.DFC_DcChrgrIntkTPhysRngLo DDRC_St.DFC_DcChrgrIntkTSRCOpn DDRC_St.DFC_Fan1SCG DDRC_St.DFC_FanSpdPhysRngHi DDRC_St.DFC_FanSpdPhysRngLo DDRC_St.DFC_FanSpdSRCOpn DDRC_St.DFC_FreonPPhysRngHi DDRC_St.DFC_FreonPPhysRngLo DDRC_St.DFC_FreonPSRCOpn DDRC_St.DFC_HeatrCoreTPhysRngHi DDRC_St.DFC_HeatrCoreTPhysRngLo DDRC_St.DFC_HeatrCoreTSRCOpn DDRC_St.DFC_HvGridUMaxSftyLim DDRC_St.DFC_HvGridUMinSftyLim DDRC_St.DFC_HvGridUPlausy DDRC_St.DFC_IntlckChrgPlgHBrgOpnLd DDRC_St.DFC_IntlckChrgPlgHBrgOvrCurr DDRC_St.DFC_IntlckChrgPlgHBrgOvrTemp DDRC_St.DFC_IntlckChrgPlgHBrgShCirBatt1 DDRC_St.DFC_IntlckChrgPlgHBrgShCirBatt2 DDRC_St.DFC_IntlckChrgPlgHBrgShCirGnd1 DDRC_St.DFC_IntlckChrgPlgHBrgShCirGnd2 DDRC_St.DFC_IntlckChrgPlgHBrgShCirOvrLd DDRC_St.DFC_IntlckChrgPlgHBrgTempOvrCurr DDRC_St.DFC_IntlckChrgPlgHBrgUndrVltg DDRC_St.DFC_IntlckChrgPlgPosnRngFlt DDRC_St.DFC_IntlckChrgPlgPosnSrcMax DDRC_St.DFC_IntlckChrgPlgPosnSrcMin DDRC_St.DFC_PwmCtPPhysRngHi DDRC_St.DFC_PwmCtPPhysRngLo DDRC_St.DFC_PwmCtPSRCMax DDRC_St.DFC_PwrDistbnUnitTPhysRngHi DDRC_St.DFC_PwrDistbnUnitTPhysRngLo DDRC_St.DFC_PwrDistbnUnitTSRCOpn DDRC_St.DFC_SCtPmpRlySCG DDRC_St.DFC_SpplCooltPmpRlySCG DDRC_St.DFC_UCtPPhysRngHi DDRC_St.DFC_UCtPPhysRngLo DDRC_St.DFC_UCtPSRCOpn DDRC_St.DFC_UPxP1PhysRngHi DDRC_St.DFC_UPxP1PhysRngLo DDRC_St.DFC_UPxP1SRCOpn DDRC_St.DFC_VehVPhysRngHi DDRC_St.DFC_VehVPhysRngLo DDRC_St.DFC_VehVSigCan DDRC_St.DFC_VehVSigCanSafe DDRC_St.DFC_SCtPmp1DiagGrdKey1 DDRC_St.DFC_SCtPmp1DiagGrdKey2 DDRC_St.DFC_SCtPmp1DiagGrdKey3 DDRC_St.DFC_SCtPmp1DiagGrdKey4 DDRC_St.DFC_SCtPmp1DiagGrdKey5 DDRC_St.DFC_ChrgPlgLiveCntctHzrdCcs DDRC_St.DFC_ChrgPlgProxPltImps DDRC_St.DFC_ChrgPlgTHiCcsDc DDRC_St.DFC_ElMActvDchaFailr DDRC_St.DFC_ElMActvDchaFlt DDRC_St.DFC_ElMFbdnIvtrModDrv01 DDRC_St.DFC_ElMImobAuthent DDRC_St.DFC_ElMIsoMonFlt DDRC_St.DFC_ElMIsoMonPlausyFlt DDRC_St.DFC_ElMIvtrCooltT01 DDRC_St.DFC_ElMIvtrEmgyShtDwn01 DDRC_St.DFC_ElMIvtrFailr01 DDRC_St.DFC_ElMIvtrIntlck01 DDRC_St.DFC_ElMIvtrTErr01 DDRC_St.DFC_ElMOverSpdNeg01 DDRC_St.DFC_ElMOverSpdPos01 DDRC_St.DFC_ElMOverTqNeg01 DDRC_St.DFC_ElMOverTqPos01 DDRC_St.DFC_ElMPwrAuthn DDRC_St.DFC_ElMSpdErr01 DDRC_St.DFC_ElMSvs01 DDRC_St.DFC_PEnvCcMax DDRC_St.DFC_PEnvCcMin DDRC_St.DFC_PEnvRngChkMax DDRC_St.DFC_PEnvRngChkMin DDRC_St.DFC_PEnvSnsrPlaus DDRC_St.DFC_BrkBstPmpPlausGenn Dem_disableEventStatusUpdateGroup /end IN_MEASUREMENT
 /begin LOC_MEASUREMENT DSM_xTabVersion /end LOC_MEASUREMENT
 FUNCTION_VERSION "30000.21.1" /end FUNCTION
/begin FUNCTION DDRC_DemDeb ""
 /begin DEF_CHARACTERISTIC DDRC_DebArCtrBase.MyCtrBasedClass_2.isJmpDwnActv_C DDRC_DebArCtrBase.MyCtrBasedClass_2.isJmpUpActv_C DDRC_DebArCtrBase.MyCtrBasedClass_2.limPassd_C DDRC_DebArCtrBase.MyCtrBasedClass_2.limFaild_C DDRC_DebArCtrBase.MyCtrBasedClass_2.jmpUpVal_C DDRC_DebArCtrBase.MyCtrBasedClass_2.jmpDwnVal_C DDRC_DebArCtrBase.MyCtrBasedClass_2.stepUp_C DDRC_DebArCtrBase.MyCtrBasedClass_2.stepDwn_C DDRC_DebArCtrBase.MyCtrBasedClass_1.isJmpDwnActv_C DDRC_DebArCtrBase.MyCtrBasedClass_1.isJmpUpActv_C DDRC_DebArCtrBase.MyCtrBasedClass_1.limPassd_C DDRC_DebArCtrBase.MyCtrBasedClass_1.limFaild_C DDRC_DebArCtrBase.MyCtrBasedClass_1.jmpUpVal_C DDRC_DebArCtrBase.MyCtrBasedClass_1.jmpDwnVal_C DDRC_DebArCtrBase.MyCtrBasedClass_1.stepUp_C DDRC_DebArCtrBase.MyCtrBasedClass_1.stepDwn_C DDRC_DebArCtrBase.DemDebounceCounterBasedClass_standard.isJmpDwnActv_C DDRC_DebArCtrBase.DemDebounceCounterBasedClass_standard.isJmpUpActv_C DDRC_DebArCtrBase.DemDebounceCounterBasedClass_standard.limPassd_C DDRC_DebArCtrBase.DemDebounceCounterBasedClass_standard.limFaild_C DDRC_DebArCtrBase.DemDebounceCounterBasedClass_standard.jmpUpVal_C DDRC_DebArCtrBase.DemDebounceCounterBasedClass_standard.jmpDwnVal_C DDRC_DebArCtrBase.DemDebounceCounterBasedClass_standard.stepUp_C DDRC_DebArCtrBase.DemDebounceCounterBasedClass_standard.stepDwn_C DDRC_DebArCtrBase.DemDebounceCounterBasedClass_EcuCtrl.isJmpDwnActv_C DDRC_DebArCtrBase.DemDebounceCounterBasedClass_EcuCtrl.isJmpUpActv_C DDRC_DebArCtrBase.DemDebounceCounterBasedClass_EcuCtrl.limPassd_C DDRC_DebArCtrBase.DemDebounceCounterBasedClass_EcuCtrl.limFaild_C DDRC_DebArCtrBase.DemDebounceCounterBasedClass_EcuCtrl.jmpUpVal_C DDRC_DebArCtrBase.DemDebounceCounterBasedClass_EcuCtrl.jmpDwnVal_C DDRC_DebArCtrBase.DemDebounceCounterBasedClass_EcuCtrl.stepUp_C DDRC_DebArCtrBase.DemDebounceCounterBasedClass_EcuCtrl.stepDwn_C /end DEF_CHARACTERISTIC
 /begin REF_CHARACTERISTIC DDRC_DebArTime.DFC_MRlyOL.tiLimFaild_C DDRC_DebArTime.DFC_MRlyOL.tiLimPassd_C DDRC_DebArTime.DFC_MRlySCB.tiLimFaild_C DDRC_DebArTime.DFC_MRlySCB.tiLimPassd_C DDRC_DebArTime.DFC_MRlySCG.tiLimFaild_C DDRC_DebArTime.DFC_MRlySCG.tiLimPassd_C DDRC_DebArTime.DFC_SSpMon1.tiLimFaild_C DDRC_DebArTime.DFC_SSpMon1.tiLimPassd_C DDRC_DebArTime.DFC_SSpMon1OV.tiLimFaild_C DDRC_DebArTime.DFC_SSpMon1OV.tiLimPassd_C DDRC_DebArTime.DFC_SSpMon1SCG.tiLimFaild_C DDRC_DebArTime.DFC_SSpMon1SCG.tiLimPassd_C DDRC_DebArTime.DFC_SSpMon1UV.tiLimFaild_C DDRC_DebArTime.DFC_SSpMon1UV.tiLimPassd_C DDRC_DebArTime.DFC_SSpMon2.tiLimFaild_C DDRC_DebArTime.DFC_SSpMon2.tiLimPassd_C DDRC_DebArTime.DFC_SSpMon2OV.tiLimFaild_C DDRC_DebArTime.DFC_SSpMon2OV.tiLimPassd_C DDRC_DebArTime.DFC_SSpMon2SCG.tiLimFaild_C DDRC_DebArTime.DFC_SSpMon2SCG.tiLimPassd_C DDRC_DebArTime.DFC_SSpMon2UV.tiLimFaild_C DDRC_DebArTime.DFC_SSpMon2UV.tiLimPassd_C DDRC_DebArTime.DFC_SSpMon3.tiLimFaild_C DDRC_DebArTime.DFC_SSpMon3.tiLimPassd_C DDRC_DebArTime.DFC_SSpMon3OV.tiLimFaild_C DDRC_DebArTime.DFC_SSpMon3OV.tiLimPassd_C DDRC_DebArTime.DFC_SSpMon3SCG.tiLimFaild_C DDRC_DebArTime.DFC_SSpMon3SCG.tiLimPassd_C DDRC_DebArTime.DFC_SSpMon3UV.tiLimFaild_C DDRC_DebArTime.DFC_SSpMon3UV.tiLimPassd_C /end REF_CHARACTERISTIC
 /begin IN_MEASUREMENT DDRC_ctArDebLvl.DFC_MRlyOL DDRC_ctArDebLvl.DFC_MRlySCB DDRC_ctArDebLvl.DFC_MRlySCG DDRC_ctArDebLvl.DFC_SSpMon1 DDRC_ctArDebLvl.DFC_SSpMon1OV DDRC_ctArDebLvl.DFC_SSpMon1SCG DDRC_ctArDebLvl.DFC_SSpMon1UV DDRC_ctArDebLvl.DFC_SSpMon2 DDRC_ctArDebLvl.DFC_SSpMon2OV DDRC_ctArDebLvl.DFC_SSpMon2SCG DDRC_ctArDebLvl.DFC_SSpMon2UV DDRC_ctArDebLvl.DFC_SSpMon3 DDRC_ctArDebLvl.DFC_SSpMon3OV DDRC_ctArDebLvl.DFC_SSpMon3SCG DDRC_ctArDebLvl.DFC_SSpMon3UV DDRC_ctArDebLvl.DFC_CANTRCV_E_NO_TRCV_CONTROL_0 DDRC_ctArDebLvl.DFC_CAN_E_TIMEOUT DDRC_ctArDebLvl.DFC_COMM_E_NET_START_IND_CHANNEL_3 DDRC_ctArDebLvl.DFC_COMM_E_NET_START_IND_CHANNEL_4 DDRC_ctArDebLvl.DFC_COMM_E_NET_START_IND_CHANNEL_5 DDRC_ctArDebLvl.DFC_rba_EcuCtrl_TOMaxProlg DDRC_ctArDebLvl.DFC_rba_EcuCtrl_TOMaxShutDwn DDRC_ctArDebLvl.DFC_rba_MultiStackTrace_Threshold DDRC_stLstRprtEve.DFC_MRlyOL DDRC_stLstRprtEve.DFC_MRlySCB DDRC_stLstRprtEve.DFC_MRlySCG DDRC_stLstRprtEve.DFC_SSpMon1 DDRC_stLstRprtEve.DFC_SSpMon1OV DDRC_stLstRprtEve.DFC_SSpMon1SCG DDRC_stLstRprtEve.DFC_SSpMon1UV DDRC_stLstRprtEve.DFC_SSpMon2 DDRC_stLstRprtEve.DFC_SSpMon2OV DDRC_stLstRprtEve.DFC_SSpMon2SCG DDRC_stLstRprtEve.DFC_SSpMon2UV DDRC_stLstRprtEve.DFC_SSpMon3 DDRC_stLstRprtEve.DFC_SSpMon3OV DDRC_stLstRprtEve.DFC_SSpMon3SCG DDRC_stLstRprtEve.DFC_SSpMon3UV DDRC_stLstRprtEve.DFC_CANTRCV_E_NO_TRCV_CONTROL_0 DDRC_stLstRprtEve.DFC_CAN_E_TIMEOUT DDRC_stLstRprtEve.DFC_COMM_E_NET_START_IND_CHANNEL_3 DDRC_stLstRprtEve.DFC_COMM_E_NET_START_IND_CHANNEL_4 DDRC_stLstRprtEve.DFC_COMM_E_NET_START_IND_CHANNEL_5 DDRC_stLstRprtEve.DFC_rba_EcuCtrl_TOMaxProlg DDRC_stLstRprtEve.DFC_rba_EcuCtrl_TOMaxShutDwn DDRC_stLstRprtEve.DFC_rba_MultiStackTrace_Threshold /end IN_MEASUREMENT
 /begin LOC_MEASUREMENT DDRC_ctArDebLvl.DFC_CANSM_E_BUS_OFF_NETWORK_HSN1_CAN DDRC_ctArDebLvl.DFC_CANSM_E_BUS_OFF_NETWORK_HSN3_CAN DDRC_ctArDebLvl.DFC_CANSM_E_BUS_OFF_NETWORK_HSN4_CAN DDRC_ctArDebLvl.DFC_CANSM_E_BUS_OFF_NETWORK_XCP_CAN DDRC_ctArDebLvl.DFC_COMM_E_NET_START_IND_CHANNEL_0 DDRC_ctArDebLvl.DFC_COMM_E_NET_START_IND_CHANNEL_1 DDRC_ctArDebLvl.DFC_COMM_E_NET_START_IND_CHANNEL_2 DDRC_ctArDebLvl.DFC_LIN_E_TIMEOUT DDRC_ctArDebLvl.DFC_rba_SyC_CustStates_Degraded_disord_Event DDRC_ctArDebLvl.DFC_rba_SyC_CustStates_Degraded_incst_Event DDRC_ctArDebLvl.DFC_rba_SyC_CustStates_TransNoWakReq_Event DDRC_stLstRprtEve.DFC_CANSM_E_BUS_OFF_NETWORK_HSN1_CAN DDRC_stLstRprtEve.DFC_CANSM_E_BUS_OFF_NETWORK_HSN3_CAN DDRC_stLstRprtEve.DFC_CANSM_E_BUS_OFF_NETWORK_HSN4_CAN DDRC_stLstRprtEve.DFC_CANSM_E_BUS_OFF_NETWORK_XCP_CAN DDRC_stLstRprtEve.DFC_COMM_E_NET_START_IND_CHANNEL_0 DDRC_stLstRprtEve.DFC_COMM_E_NET_START_IND_CHANNEL_1 DDRC_stLstRprtEve.DFC_COMM_E_NET_START_IND_CHANNEL_2 DDRC_stLstRprtEve.DFC_LIN_E_TIMEOUT DDRC_stLstRprtEve.DFC_rba_SyC_CustStates_Degraded_disord_Event DDRC_stLstRprtEve.DFC_rba_SyC_CustStates_Degraded_incst_Event DDRC_stLstRprtEve.DFC_rba_SyC_CustStates_TransNoWakReq_Event /end LOC_MEASUREMENT
/end FUNCTION
/begin FUNCTION DECJ "100.4.0   standard powerstage diagnosis enabling" /begin DEF_CHARACTERISTIC NDECJ UBCJMN UBCJMX /end DEF_CHARACTERISTIC /begin IN_MEASUREMENT BattU_u Epm_nEngLRes SyC_stSub /end IN_MEASUREMENT /begin OUT_MEASUREMENT B_deseehr_msg B_desee_msg B_PmdInit_msg /end OUT_MEASUREMENT FUNCTION_VERSION "100.4.0" /end FUNCTION
/begin FUNCTION DELib "1.62.1_1.17.0Library Device Encapsulation" FUNCTION_VERSION "1.62.1_1.17.0" /end FUNCTION
/begin FUNCTION DELib_ActrCoorrSimple "1.3.0     Simple Coordinator Layer for Actuators" FUNCTION_VERSION "1.3.0" /end FUNCTION
/begin FUNCTION DELib_ActrElecDrvrSimple "1.4.0     Simple Electrical Driver Layer for Actuators" FUNCTION_VERSION "1.4.0" /end FUNCTION
/begin FUNCTION DELib_ActrElecMonSimple "1.4.0     Simple Electrical Monitoring Layer for Actuators" FUNCTION_VERSION "1.4.0" /end FUNCTION
/begin FUNCTION DELib_ActrHldILimnSimple "1.3.0     Simple Holding Current Limitation for Actuators" FUNCTION_VERSION "1.3.0" /end FUNCTION
/begin FUNCTION DELib_ActrPsDrvrSimple "1.5.0     Simple Power Stage Driver for Actuators" FUNCTION_VERSION "1.5.0" /end FUNCTION
/begin FUNCTION DELib_ActrPwrStgDrvr "2.2.0     Actuator power stage driver" FUNCTION_VERSION "2.2.0" /end FUNCTION
/begin FUNCTION DELib_ActrRCalcn "2.1.0     Electrical resistance calculation of coils" FUNCTION_VERSION "2.1.0" /end FUNCTION
/begin FUNCTION DELib_ActvnDeactvnCdn "1.2.0     Activation and Deactivation Conditions" FUNCTION_VERSION "1.2.0" /end FUNCTION
/begin FUNCTION DELib_DevDrvrOutpDutyCycRamp "2.1.0     Device Driver - Duty Cycle Ramp" FUNCTION_VERSION "2.1.0" /end FUNCTION
/begin FUNCTION DELib_ElecActr "23.9.0    single source library for closed loop controlled actuators" FUNCTION_VERSION "23.9.0" /end FUNCTION
/begin FUNCTION DELib_ElecActrAdpvPosnCtrlInp "2.1.0     Function to handle the input calculation of the adaptive position governor" FUNCTION_VERSION "2.1.0" /end FUNCTION
/begin FUNCTION DELib_ElecActrAvs "1.1.0     AVS Functions for ElecActr" FUNCTION_VERSION "1.1.0" /end FUNCTION
/begin FUNCTION DELib_ElecActrCoorrLib "11.2.0    Electrical Actuator Coordinator Library" FUNCTION_VERSION "11.2.0" /end FUNCTION
/begin FUNCTION DELib_ElecactrDdSnsrReadLib "1.25.0    Library to support the Reading of Raw values from Sensor" FUNCTION_VERSION "1.25.0" /end FUNCTION
/begin FUNCTION DELib_ElecActrElecDiagLib "3.3.0     Library for Electrical diagnosis support" FUNCTION_VERSION "3.3.0" /end FUNCTION
/begin FUNCTION DELib_ElecActrGovrLib "12.3.0    Governor library for closed loop controlled actuators" FUNCTION_VERSION "12.3.0" /end FUNCTION
/begin FUNCTION DELib_ElecActrSpArbn "2.2.0     FC for actuator set-point arbitration" FUNCTION_VERSION "2.2.0" /end FUNCTION
/begin FUNCTION DELib_ElecActrVdMonLib "12.4.0    Library to support the Monitoring functions of Electrical Actuator" FUNCTION_VERSION "12.4.0" /end FUNCTION
/begin FUNCTION DELib_ElecActrVdPosnGovrInpLib "10.11.0   Library to support the Positition governor input functions" FUNCTION_VERSION "10.11.0" /end FUNCTION
/begin FUNCTION DELib_ElecActrVdPosnGovrLib "9.6.0     Library to support the Position Governor" FUNCTION_VERSION "9.6.0" /end FUNCTION
/begin FUNCTION DELib_ElecActrVdSnsrLib "10.3.0    Device Encapsulation Library - Electrical Actuators VdSnsr" FUNCTION_VERSION "10.3.0" /end FUNCTION
/begin FUNCTION DELib_Fir "2.0.0     Fir" FUNCTION_VERSION "2.0.0" /end FUNCTION
/begin FUNCTION DELib_GlbActrLimnCntr "1.0.0     Actuator Limitation Counter" FUNCTION_VERSION "1.0.0" /end FUNCTION
/begin FUNCTION DELib_GlbAdp "5.21.0    DELib Adapter" /begin IN_MEASUREMENT EnvP_p EnvT_t EnvT_t_Sq /end IN_MEASUREMENT /begin OUT_MEASUREMENT EnvP_p_f EnvT_t_f EnvT_t_f_Sq /end OUT_MEASUREMENT FUNCTION_VERSION "5.21.0" /end FUNCTION
/begin FUNCTION DELib_GlbDef "22.16.0   DELib Definitions" FUNCTION_VERSION "22.16.0" /end FUNCTION
/begin FUNCTION DELib_GlbDefAc "14.1.0    Autocode of Global Functions of DELib" FUNCTION_VERSION "14.1.0" /end FUNCTION
/begin FUNCTION DELib_GlbSrvAdvTstrSrvRels "5.0.0     Global Function for Advanced Tester Service release" FUNCTION_VERSION "5.0.0" /end FUNCTION
/begin FUNCTION DELib_GlbSrvDdReadFil "5.0.0     Global Function for Device Library Filter read" FUNCTION_VERSION "5.0.0" /end FUNCTION
/begin FUNCTION DELib_GlbSrvDesValCntr "1.1.0     Global Service for the Desired Value Counter" FUNCTION_VERSION "1.1.0" /end FUNCTION
/begin FUNCTION DELib_GlbSrvEcuModDetn "2.0.0     Function for ECU mode detection" FUNCTION_VERSION "2.0.0" /end FUNCTION
/begin FUNCTION DELib_GlbSrvElecDd "2.0.0     Internal Library for DELib Electrical Layer driving" FUNCTION_VERSION "2.0.0" /end FUNCTION
/begin FUNCTION DELib_GlbSrvFloat "1.3.0     Global Function for Float" FUNCTION_VERSION "1.3.0" /end FUNCTION
/begin FUNCTION DELib_GlbSrvGovrOutpRamp "2.1.0     Global Service Governor Output Ramp" FUNCTION_VERSION "2.1.0" /end FUNCTION
/begin FUNCTION DELib_GlbSrvGrdtLimn "3.3.0     DELib Service Library for gradient limitation" FUNCTION_VERSION "3.3.0" /end FUNCTION
/begin FUNCTION DELib_GlbSrvHldgILimn "1.8.0     Global Function for Holding Current Limitation" FUNCTION_VERSION "1.8.0" /end FUNCTION
/begin FUNCTION DELib_GlbSrvJamHeal "2.3.0     DELib Global Service Library for jam healing" FUNCTION_VERSION "2.3.0" /end FUNCTION
/begin FUNCTION DELib_GlbSrvObd "1.12.0    Global Function for On Board Diagnosis" FUNCTION_VERSION "1.12.0" /end FUNCTION
/begin FUNCTION DELib_GlbSrvPosnChgCntr "2.2.0     Global Service for the Position Change Counter" FUNCTION_VERSION "2.2.0" /end FUNCTION
/begin FUNCTION DELib_GlbSrvSnsrSeln "7.2.0     Global Function for Sensor Selection"
 /begin IN_MEASUREMENT AcChrgrIntkT_t_f DcChrgrIntkT_t_f DELib_idxArrSnsr DELib_stArrSnsr DELib_xArrSnsr EnvP_p_f EnvT_t_f HeatrCoreT_t_f SyC_stSub T15_st /end IN_MEASUREMENT
 /begin OUT_MEASUREMENT DELib_numVar_mp DELib_num_mp DELib_stFirstPreDrvOverCopy DINH_nrActvInhReas.FId_DELibAcChrgrIntkT DINH_nrActvInhReas.FId_DELibDcChrgrIntkT DINH_nrActvInhReas.FId_DELibEnvP DINH_nrActvInhReas.FId_DELibEnvT DINH_nrActvInhReas.FId_DELibHeatrCoreT DINH_stFId.FId_DELibAcChrgrIntkT DINH_stFId.FId_DELibDcChrgrIntkT DINH_stFId.FId_DELibEnvP DINH_stFId.FId_DELibEnvT DINH_stFId.FId_DELibHeatrCoreT /end OUT_MEASUREMENT
 FUNCTION_VERSION "7.2.0" /end FUNCTION
/begin FUNCTION DELib_GlbSrvSnsrSeln_Auto "" /begin OUT_MEASUREMENT DELib_idxArrSnsr DELib_stArrSnsr DELib_xArrSnsr /end OUT_MEASUREMENT /end FUNCTION
/begin FUNCTION DELib_GlbSrvSpFil "2.1.0     DELib Global Service Library for set-point filtering" FUNCTION_VERSION "2.1.0" /end FUNCTION
/begin FUNCTION DELib_GovrDeMonLib "3.6.0     Library for Governor Deviation Monitoring" FUNCTION_VERSION "3.6.0" /end FUNCTION
/begin FUNCTION DELib_Pll "1.0.0     PLL - Phase Locked Loop" FUNCTION_VERSION "1.0.0" /end FUNCTION
/begin FUNCTION DELib_StcFctActr "2.0.0     Statistic Functions Actuator" FUNCTION_VERSION "2.0.0" /end FUNCTION
/begin FUNCTION DELib_StdActr "19.6.0    Single source library for standardized digital and PWM actuators" FUNCTION_VERSION "19.6.0" /end FUNCTION
/begin FUNCTION DELib_StdActrCoorrLib "8.1.0     Library for the Coordinator functions in Standard Actuator" FUNCTION_VERSION "8.1.0" /end FUNCTION
/begin FUNCTION DELib_StdActrDdLib "8.3.0     Library for the driver layer functions of Standard Actuarors" FUNCTION_VERSION "8.3.0" /end FUNCTION
/begin FUNCTION DELib_StdActrLib "1.36.0    Device Encapsulation Library - Standard Actuator Library" FUNCTION_VERSION "1.36.0" /end FUNCTION
/begin FUNCTION DELib_StdActrSnsrDdLib "6.1.0     Library for Sensor feedback handling of Standard Actuators" FUNCTION_VERSION "6.1.0" /end FUNCTION
/begin FUNCTION DELib_StdActrVdLib "1.14.0    Library functions to support the virtual driver of actuator" FUNCTION_VERSION "1.14.0" /end FUNCTION
/begin FUNCTION DELib_StdActrVdMonLib "9.7.0     Library for Monitor function for Standard Actuator" FUNCTION_VERSION "9.7.0" /end FUNCTION
/begin FUNCTION DELib_StdSens "17.6.0    single source library for standardized temperature and pressure sensors" FUNCTION_VERSION "17.6.0" /end FUNCTION
/begin FUNCTION DELib_StdSensDdLib "9.3.0     Device Driver component for Standard Sensor Library" FUNCTION_VERSION "9.3.0" /end FUNCTION
/begin FUNCTION DELib_StdSensDdReadLib "1.19.0    Device Driver Read Component for Standard Sensor Library" FUNCTION_VERSION "1.19.0" /end FUNCTION
/begin FUNCTION DELib_StdSensExtDiagLib "8.1.0     DELib Standard Sensor Extended Diagnostics Library" FUNCTION_VERSION "8.1.0" /end FUNCTION
/begin FUNCTION DELib_StdSensVdLib "10.2.0    Virtual Driver component for Standard Sensor Library" FUNCTION_VERSION "10.2.0" /end FUNCTION
/begin FUNCTION DELib_StdSensVdMonLib "8.4.0     Virtual Driver Monitor component for Standard Sensor Library" FUNCTION_VERSION "8.4.0" /end FUNCTION
/begin FUNCTION DELib_VrntCodSimple "1.3.0     Simple Variant Coding" FUNCTION_VERSION "1.3.0" /end FUNCTION
/begin FUNCTION DemDcmIf "30150.1.0 Dem-Dcm Interfaces" /begin DEF_CHARACTERISTIC Dem_xCalEvtListTrg_C /end DEF_CHARACTERISTIC
 /begin IN_MEASUREMENT DFES_stOutstate DSMAUX_ctWUC DSMAUX_stTranGlbJob DSMRdy_xPId1 /end IN_MEASUREMENT
 /begin OUT_MEASUREMENT Dem_disableEventStatusUpdateGroup /end OUT_MEASUREMENT
 /begin LOC_MEASUREMENT DemDcmIf_eventlistvalid Dem_DTCFltForFDC Dem_DTCFltFormat Dem_DTCFltKind Dem_DTCFltOrigin Dem_DTCFltProcCnt Dem_DTCFltProcIdx Dem_DTCFltRecFormat Dem_DTCFltRecRsltIdx Dem_DTCFltRsltIdx Dem_DTCFltSeverity Dem_DTCFltSt Dem_DTCFltStatusMask Dem_DTCFltWithSeverity Dem_xCalEvtListTrg_Old /end LOC_MEASUREMENT
 FUNCTION_VERSION "30150.1.0" /end FUNCTION
/begin FUNCTION DevLib_DigOutErrHndlr "1.147.0   Digital Output Error handling module" /begin DEF_CHARACTERISTIC DevLib_DigOutDbgSig_C /end DEF_CHARACTERISTIC
 /begin LOC_MEASUREMENT DevLib_stDigOutErr_mp DevLib_stDigOutPrevTst_mp DevLib_stDigOutTstImp_mp /end LOC_MEASUREMENT
 FUNCTION_VERSION "1.147.0" /end FUNCTION
/begin FUNCTION DevLib_PhysRngChk "1.145.0   Device library for physical range check" FUNCTION_VERSION "1.145.0" /end FUNCTION
/begin FUNCTION DevLib_PsDiag "1.148.0   Common part of Digital and PWM powerstage diagnosis" FUNCTION_VERSION "1.148.0" /end FUNCTION
/begin FUNCTION DevLib_PWMOutErrHndlr "100.1.0   PWM Output error handling module" /begin DEF_CHARACTERISTIC DevLib_PWMOutDbgSig_C /end DEF_CHARACTERISTIC
 /begin LOC_MEASUREMENT DevLib_stPWMOutErr_mp DevLib_stPWMOutPrevTst_mp DevLib_stPWMOutTstImp_mp /end LOC_MEASUREMENT
 FUNCTION_VERSION "100.1.0" /end FUNCTION
/begin COMPU_METHOD B_TRUE "" TAB_VERB "%6.3" "" COMPU_TAB_REF B_TRUE /end COMPU_METHOD
/begin COMPU_VTAB B_TRUE "" TAB_VERB 2 0 "FALSE" 1 "TRUE" /end COMPU_VTAB
/begin COMPU_METHOD C126_Time_ms_q0p001_COMPU "" RAT_FUNC "%6.5" "ms" COEFFS 0 1000 0 0 0 1 /end COMPU_METHOD
/begin COMPU_METHOD Curr_A_q0p03125_COMPU "" RAT_FUNC "%6.4" "A" COEFFS 0 32 0 0 0 1 /end COMPU_METHOD
/begin COMPU_METHOD DDRCTime_ms "" RAT_FUNC "%6.1" "ms" COEFFS 0 1 0 0 0 10 /end COMPU_METHOD
/begin COMPU_METHOD DDRC_LstRprtEve_VERB "" TAB_VERB "%6.3" "" COMPU_TAB_REF DDRC_LstRprtEve_VERB /end COMPU_METHOD
/begin COMPU_VTAB DDRC_LstRprtEve_VERB "" TAB_VERB 5 0 "PASSED" 1 "FAILED" 2 "PREPASSED" 3 "PREFAILED" 255 "INVALID" /end COMPU_VTAB
/begin COMPU_METHOD Dem_DTCFltSt_Verb "" TAB_VERB "%6.3" "NO" COMPU_TAB_REF Dem_DTCFltSt_Verb /end COMPU_METHOD
/begin COMPU_VTAB Dem_DTCFltSt_Verb "" TAB_VERB 6 0 "IDLE" 1 "UDS_ENTRIES_PENDING" 2 "UDS_DTCS_PENDING" 3 "UDS_ENTRIES_RSLT" 4 "OBD_ENTRIES_RSLT" 5 "UDS_DTCS_RSLT" /end COMPU_VTAB
/begin COMPU_METHOD DFC_OneToOne "" RAT_FUNC "%6.2" "-" COEFFS 0 1 0 0 0 1 /end COMPU_METHOD
/begin COMPU_METHOD DFES_OneToOne "" RAT_FUNC "%6.2" "-" COEFFS 0 1 0 0 0 1 /end COMPU_METHOD
/begin COMPU_METHOD DINH_ct_Compu "" RAT_FUNC "%6.0" "" COEFFS 0 -1 4096 0 0 1 /end COMPU_METHOD
/begin COMPU_METHOD DRVPRGSWT_RCPTSWT_SC_Compu "" TAB_VERB "%6.3" "" COMPU_TAB_REF DRVPRGSWT_RCPTSWT_SC_Compu /end COMPU_METHOD
/begin COMPU_VTAB DRVPRGSWT_RCPTSWT_SC_Compu "" TAB_VERB 4 0 "Recuperation_switch_not_available" 1 "Recuperation_switch_information_available_via_ADC" 2 "Recuperation_switch_information_available_via_DIO" 3 "Recuperation_switch_information_available_via_CAN" /end COMPU_VTAB
/begin COMPU_METHOD DRVPRGSWT_SPTSWT_SC_Compu "" TAB_VERB "%6.3" "" COMPU_TAB_REF DRVPRGSWT_SPTSWT_SC_Compu /end COMPU_METHOD
/begin COMPU_VTAB DRVPRGSWT_SPTSWT_SC_Compu "" TAB_VERB 4 0 "Sport_mode_not_available" 1 "Sport_mode_available_via_ADC" 2 "Sport_mode_available_via_DIO" 3 "Sport_mode_available_via_CAN" /end COMPU_VTAB
/begin COMPU_METHOD DRVPRG_SC_Compu "" TAB_VERB "%6.3" "" COMPU_TAB_REF DRVPRG_SC_Compu /end COMPU_METHOD
/begin COMPU_VTAB DRVPRG_SC_Compu "" TAB_VERB 2 0 "False" 1 "True" /end COMPU_VTAB
/begin COMPU_METHOD DRVPROGCOORR_SC_Compu "" TAB_VERB "%6.3" "" COMPU_TAB_REF DRVPROGCOORR_SC_Compu /end COMPU_METHOD
/begin COMPU_VTAB DRVPROGCOORR_SC_Compu "" TAB_VERB 2 0 "False" 1 "True" /end COMPU_VTAB
/begin COMPU_METHOD DRVRBLTIFTYP_SC_Compu "" TAB_VERB "%6.3" "" COMPU_TAB_REF DRVRBLTIFTYP_SC_Compu /end COMPU_METHOD
/begin COMPU_VTAB DRVRBLTIFTYP_SC_Compu "" TAB_VERB 7 0 "DRVRBLTIFTYP_NON" 1 "DRVRBLTIFTYP_DIG" 2 "DRVRBLTIFTYP_ADC" 3 "DRVRBLTIFTYP_MISC" 4 "DRVRBLTIFTYP_BUS" 5 "DRVRBLTIFTYP_BUS_DIG" 6 "DRVRBLTIFTYP_BUS_ADC" /end COMPU_VTAB
/begin COMPU_METHOD DRVRDOORIFTYP_SC_Compu "" TAB_VERB "%6.3" "" COMPU_TAB_REF DRVRDOORIFTYP_SC_Compu /end COMPU_METHOD
/begin COMPU_VTAB DRVRDOORIFTYP_SC_Compu "" TAB_VERB 7 0 "DRVRDOORIFTYP_NON" 1 "DRVRDOORIFTYP_DIG" 2 "DRVRDOORIFTYP_ADC" 3 "DRVRDOORIFTYP_MISC" 4 "DRVRDOORIFTYP_BUS" 5 "DRVRDOORIFTYP_BUS_DIG" 6 "DRVRDOORIFTYP_BUS_ADC" /end COMPU_VTAB
/begin COMPU_METHOD DSCHED_COEOMEXT_SC_Compu "" TAB_VERB "%6.3" "" COMPU_TAB_REF DSCHED_COEOMEXT_SC_Compu /end COMPU_METHOD
/begin COMPU_VTAB DSCHED_COEOMEXT_SC_Compu "" TAB_VERB 10 0 "Standard_Only" 1 "Extended_SubModes" 2 "Extended_Modes2" 3 "Extended_Modes3" 4 "Extended_Modes4" 5 "Extended_Modes5" 6 "Extended_Modes6" 7 "Extended_Modes7" 8 "Extended_Modes8" 9 "Extended_Modes9" /end COMPU_VTAB
/begin COMPU_METHOD DSCHED_COEOM_SY_Compu "" TAB_VERB "%6.3" "" COMPU_TAB_REF DSCHED_COEOM_SY_Compu /end COMPU_METHOD
/begin COMPU_VTAB DSCHED_COEOM_SY_Compu "" TAB_VERB 2 0 "False" 1 "True" /end COMPU_VTAB
/begin COMPU_METHOD DSCHED_FIDMAXPRIOLST_SY_Compu "" RAT_FUNC "%6.2" "" COEFFS 0 1 0 0 0 1 /end COMPU_METHOD
/begin COMPU_METHOD DSCHED_FTI_SY_Compu "" TAB_VERB "%6.3" "" COMPU_TAB_REF DSCHED_FTI_SY_Compu /end COMPU_METHOD
/begin COMPU_VTAB DSCHED_FTI_SY_Compu "" TAB_VERB 2 0 "DSCHED_FTI_DISBL" 1 "DSCHED_FTI_ENA" /end COMPU_VTAB
/begin COMPU_METHOD DSCHED_PRIOACTVJMP_SY_Compu "" TAB_VERB "%6.3" "" COMPU_TAB_REF DSCHED_PRIOACTVJMP_SY_Compu /end COMPU_METHOD
/begin COMPU_VTAB DSCHED_PRIOACTVJMP_SY_Compu "" TAB_VERB 2 0 "DSCHED_PRIOACTVJMP_DISBL" 1 "DSCHED_PRIOACTVJMP_ENA" /end COMPU_VTAB
/begin COMPU_METHOD DSCHED_PRIODFCSTLDF_SY_Compu "" TAB_VERB "%6.3" "" COMPU_TAB_REF DSCHED_PRIODFCSTLDF_SY_Compu /end COMPU_METHOD
/begin COMPU_VTAB DSCHED_PRIODFCSTLDF_SY_Compu "" TAB_VERB 3 0 "DSCHED_DFCSTLDF_DISBL" 1 "DSCHED_DFCSTLDF_ENA_UNIF" 2 "DSCHED_DFCSTLDF_ENA_INDIV" /end COMPU_VTAB
/begin COMPU_METHOD DSCHED_PRIODFCSTTST_SY_Compu "" TAB_VERB "%6.3" "" COMPU_TAB_REF DSCHED_PRIODFCSTTST_SY_Compu /end COMPU_METHOD
/begin COMPU_VTAB DSCHED_PRIODFCSTTST_SY_Compu "" TAB_VERB 3 0 "DSCHED_DFCSTTST_DISBL" 1 "DSCHED_DFCSTTST_ENA_UNIF" 2 "DSCHED_DFCSTTST_ENA_INDIV" /end COMPU_VTAB
/begin COMPU_METHOD DSCHED_PRIOPHYSURGENCY_SY_Compu "" TAB_VERB "%6.3" "" COMPU_TAB_REF DSCHED_PRIOPHYSURGENCY_SY_Compu /end COMPU_METHOD
/begin COMPU_VTAB DSCHED_PRIOPHYSURGENCY_SY_Compu "" TAB_VERB 2 0 "DSCHED_PHYSURGENCY_DISBL" 1 "DSCHED_PHYSURGENCY_ENA" /end COMPU_VTAB
/begin COMPU_METHOD DSCHED_PRIORMPCALC_SY_Compu "" TAB_VERB "%6.3" "" COMPU_TAB_REF DSCHED_PRIORMPCALC_SY_Compu /end COMPU_METHOD
/begin COMPU_VTAB DSCHED_PRIORMPCALC_SY_Compu "" TAB_VERB 2 0 "DSCHED_PRIORMPCALC_DISBL" 1 "DSCHED_PRIORMPCALC_ENA" /end COMPU_VTAB
/begin COMPU_METHOD DSCHED_RATECALC_SY_Compu "" TAB_VERB "%6.3" "" COMPU_TAB_REF DSCHED_RATECALC_SY_Compu /end COMPU_METHOD
/begin COMPU_VTAB DSCHED_RATECALC_SY_Compu "" TAB_VERB 2 0 "DSCHED_RATECALC_DISBL" 1 "DSCHED_RATECALC_ENA" /end COMPU_VTAB
/begin COMPU_METHOD DSCHED_WTT_SY_Compu "" TAB_VERB "%6.3" "" COMPU_TAB_REF DSCHED_WTT_SY_Compu /end COMPU_METHOD
/begin COMPU_VTAB DSCHED_WTT_SY_Compu "" TAB_VERB 2 0 "DSCHED_WTT_DISBL" 1 "DSCHED_WTT_ENA" /end COMPU_VTAB
/begin COMPU_METHOD DSHBTESTSUPRT_SC_Compu "" TAB_VERB "%6.3" "" COMPU_TAB_REF DSHBTESTSUPRT_SC_Compu /end COMPU_METHOD
/begin COMPU_VTAB DSHBTESTSUPRT_SC_Compu "" TAB_VERB 2 0 "False" 1 "True" /end COMPU_VTAB
/begin COMPU_METHOD DSM2AUTOSAR_ASWPF_SC_Compu "" TAB_VERB "%6.3" "" COMPU_TAB_REF DSM2AUTOSAR_ASWPF_SC_Compu /end COMPU_METHOD
/begin COMPU_VTAB DSM2AUTOSAR_ASWPF_SC_Compu "" TAB_VERB 2 0 "No_Support" 1 "Support_BAC" /end COMPU_VTAB
/begin COMPU_METHOD DSM2AUTOSAR_DCMIF_SC_Compu "" TAB_VERB "%6.3" "" COMPU_TAB_REF DSM2AUTOSAR_DCMIF_SC_Compu /end COMPU_METHOD
/begin COMPU_VTAB DSM2AUTOSAR_DCMIF_SC_Compu "" TAB_VERB 9 0 "Platform" 1 "Volvo" 2 "BMW" 3 "VW" 4 "FORD" 5 "DAI" 6 "FPT" 425 "Polaris" 582 "FPT_AR4.3" /end COMPU_VTAB
/begin COMPU_METHOD DSM2AUTOSAR_SC_Compu "" TAB_VERB "%6.3" "" COMPU_TAB_REF DSM2AUTOSAR_SC_Compu /end COMPU_METHOD
/begin COMPU_VTAB DSM2AUTOSAR_SC_Compu "" TAB_VERB 2 0 "False" 1 "True" /end COMPU_VTAB
/begin COMPU_METHOD DSM2AUTOSAR_SECFCM_SC_Compu "" TAB_VERB "%6.3" "" COMPU_TAB_REF DSM2AUTOSAR_SECFCM_SC_Compu /end COMPU_METHOD
/begin COMPU_VTAB DSM2AUTOSAR_SECFCM_SC_Compu "" TAB_VERB 2 0 "No_Support" 1 "Support_3_Cond" /end COMPU_VTAB
/begin COMPU_METHOD DSM2SG_EXCH_SC_Compu "" TAB_VERB "%6.3" "" COMPU_TAB_REF DSM2SG_EXCH_SC_Compu /end COMPU_METHOD
/begin COMPU_VTAB DSM2SG_EXCH_SC_Compu "" TAB_VERB 2 0 "FALSE" 1 "TRUE" /end COMPU_VTAB
/begin COMPU_METHOD DSMAUX_TCSORT_SY_Compu "" TAB_VERB "%6.3" "" COMPU_TAB_REF DSMAUX_TCSORT_SY_Compu /end COMPU_METHOD
/begin COMPU_VTAB DSMAUX_TCSORT_SY_Compu "" TAB_VERB 2 0 "TCSORT_disabled" 1 "TCSORT_enabled" /end COMPU_VTAB
/begin COMPU_METHOD DSMBAS_CENSUPPDIUMPR_SC_Compu "" TAB_VERB "%6.3" "" COMPU_TAB_REF DSMBAS_CENSUPPDIUMPR_SC_Compu /end COMPU_METHOD
/begin COMPU_VTAB DSMBAS_CENSUPPDIUMPR_SC_Compu "" TAB_VERB 2 0 "Disabled" 1 "Enabled" /end COMPU_VTAB
/begin COMPU_METHOD DSMBAS_CENSUPPDTR_SC_Compu "" TAB_VERB "%6.3" "" COMPU_TAB_REF DSMBAS_CENSUPPDTR_SC_Compu /end COMPU_METHOD
/begin COMPU_VTAB DSMBAS_CENSUPPDTR_SC_Compu "" TAB_VERB 2 0 "Disabled" 1 "Enabled" /end COMPU_VTAB
/begin COMPU_METHOD DSMBAS_ENACFMDFLTCNTR_SC_Compu "" TAB_VERB "%6.3" "" COMPU_TAB_REF DSMBAS_ENACFMDFLTCNTR_SC_Compu /end COMPU_METHOD
/begin COMPU_VTAB DSMBAS_ENACFMDFLTCNTR_SC_Compu "" TAB_VERB 2 0 "DISABLE" 1 "ENABLE" /end COMPU_VTAB
/begin COMPU_METHOD DSMBAS_ENAOPTMZDRDNFORCMPHCPT_SC_Compu "" TAB_VERB "%6.3" "" COMPU_TAB_REF DSMBAS_ENAOPTMZDRDNFORCMPHCPT_SC_Compu /end COMPU_METHOD
/begin COMPU_VTAB DSMBAS_ENAOPTMZDRDNFORCMPHCPT_SC_Compu "" TAB_VERB 2 0 "DSMRDN_STDRDN" 1 "DSMRDN_OPTMZDRDN" /end COMPU_VTAB
/begin COMPU_METHOD DSMBAS_ENASIMRCDN_SC_Compu "" TAB_VERB "%6.3" "" COMPU_TAB_REF DSMBAS_ENASIMRCDN_SC_Compu /end COMPU_METHOD
/begin COMPU_VTAB DSMBAS_ENASIMRCDN_SC_Compu "" TAB_VERB 2 0 "False" 1 "True" /end COMPU_VTAB
/begin COMPU_METHOD DSMBAS_ENASVS_SC_Compu "" TAB_VERB "%6.3" "" COMPU_TAB_REF DSMBAS_ENASVS_SC_Compu /end COMPU_METHOD
/begin COMPU_VTAB DSMBAS_ENASVS_SC_Compu "" TAB_VERB 3 0 "No_SVS" 1 "Single_SVS" 2 "Multiple_SVS" /end COMPU_VTAB
/begin COMPU_METHOD DSMBAS_ENVTLBLKUPD_SC_Compu "" TAB_VERB "%6.3" "" COMPU_TAB_REF DSMBAS_ENVTLBLKUPD_SC_Compu /end COMPU_METHOD
/begin COMPU_VTAB DSMBAS_ENVTLBLKUPD_SC_Compu "" TAB_VERB 2 0 "Frequency_Count" 1 "Fail_Count" /end COMPU_VTAB
/begin COMPU_METHOD DSMBAS_KEYONCYCFLCTRIG_SC_Compu "" TAB_VERB "%6.3" "" COMPU_TAB_REF DSMBAS_KEYONCYCFLCTRIG_SC_Compu /end COMPU_METHOD
/begin COMPU_VTAB DSMBAS_KEYONCYCFLCTRIG_SC_Compu "" TAB_VERB 2 0 "False" 1 "True" /end COMPU_VTAB
/begin COMPU_METHOD DSMBAS_MILWODEV_SC_Compu "" TAB_VERB "%6.3" "" COMPU_TAB_REF DSMBAS_MILWODEV_SC_Compu /end COMPU_METHOD
/begin COMPU_VTAB DSMBAS_MILWODEV_SC_Compu "" TAB_VERB 2 0 "False" 1 "True" /end COMPU_VTAB
/begin COMPU_METHOD DSMBAS_NEWDCYCWITHFCMCLR_SC_Compu "" TAB_VERB "%6.3" "" COMPU_TAB_REF DSMBAS_NEWDCYCWITHFCMCLR_SC_Compu /end COMPU_METHOD
/begin COMPU_VTAB DSMBAS_NEWDCYCWITHFCMCLR_SC_Compu "" TAB_VERB 2 0 "False" 1 "True" /end COMPU_VTAB
/begin COMPU_METHOD DSMBAS_NODFP_SC_Compu "" TAB_VERB "%6.3" "" COMPU_TAB_REF DSMBAS_NODFP_SC_Compu /end COMPU_METHOD
/begin COMPU_VTAB DSMBAS_NODFP_SC_Compu "" TAB_VERB 2 0 "False" 1 "True" /end COMPU_VTAB
/begin COMPU_METHOD DSMBAS_NODIAGCSDL_SC_Compu "" TAB_VERB "%6.3" "" COMPU_TAB_REF DSMBAS_NODIAGCSDL_SC_Compu /end COMPU_METHOD
/begin COMPU_VTAB DSMBAS_NODIAGCSDL_SC_Compu "" TAB_VERB 2 0 "False" 1 "True" /end COMPU_VTAB
/begin COMPU_METHOD DSMBAS_NODTR_SC_Compu "" TAB_VERB "%6.3" "" COMPU_TAB_REF DSMBAS_NODTR_SC_Compu /end COMPU_METHOD
/begin COMPU_VTAB DSMBAS_NODTR_SC_Compu "" TAB_VERB 2 0 "False" 1 "True" /end COMPU_VTAB
/begin COMPU_METHOD DSMBAS_PNDRPRTMOD2_SC_Compu "" TAB_VERB "%6.3" "" COMPU_TAB_REF DSMBAS_PNDRPRTMOD2_SC_Compu /end COMPU_METHOD
/begin COMPU_VTAB DSMBAS_PNDRPRTMOD2_SC_Compu "" TAB_VERB 2 0 "CONFIRMED" 1 "PENDING" /end COMPU_VTAB
/begin COMPU_METHOD DSMBAS_PREFAILDINTDEB_SC_Compu "" TAB_VERB "%6.3" "" COMPU_TAB_REF DSMBAS_PREFAILDINTDEB_SC_Compu /end COMPU_METHOD
/begin COMPU_VTAB DSMBAS_PREFAILDINTDEB_SC_Compu "" TAB_VERB 2 0 "Disable" 1 "Enable" /end COMPU_VTAB
/begin COMPU_METHOD DSMBAS_REINIMETHSELN_SC_Compu "" TAB_VERB "%6.3" "" COMPU_TAB_REF DSMBAS_REINIMETHSELN_SC_Compu /end COMPU_METHOD
/begin COMPU_VTAB DSMBAS_REINIMETHSELN_SC_Compu "" TAB_VERB 2 0 "CYCLIC_TASK" 1 "INIDRV_TASK" /end COMPU_VTAB
/begin COMPU_METHOD DSMBAS_SELNPID93BHVR_SC_Compu "" TAB_VERB "%6.3" "" COMPU_TAB_REF DSMBAS_SELNPID93BHVR_SC_Compu /end COMPU_METHOD
/begin COMPU_VTAB DSMBAS_SELNPID93BHVR_SC_Compu "" TAB_VERB 3 0 "DISABLE" 1 "READY_TO_DRIVE" 2 "ENGINE_RUNNING" /end COMPU_VTAB
/begin COMPU_METHOD DSMBAS_SELPID41BHVR_SC_Compu "" TAB_VERB "%6.3" "" COMPU_TAB_REF DSMBAS_SELPID41BHVR_SC_Compu /end COMPU_METHOD
/begin COMPU_VTAB DSMBAS_SELPID41BHVR_SC_Compu "" TAB_VERB 2 0 "PID41_DCYBASED" 1 "PID41_KEYONBASED" /end COMPU_VTAB
/begin COMPU_METHOD DSMBAS_TESTFAILDSNCELSTCLR_SC_Compu "" TAB_VERB "%6.3" "" COMPU_TAB_REF DSMBAS_TESTFAILDSNCELSTCLR_SC_Compu /end COMPU_METHOD
/begin COMPU_VTAB DSMBAS_TESTFAILDSNCELSTCLR_SC_Compu "" TAB_VERB 2 0 "False" 1 "True" /end COMPU_VTAB
/begin COMPU_METHOD DSMBAS_VAR_SY_Compu "" TAB_VERB "%6.3" "" COMPU_TAB_REF DSMBAS_VAR_SY_Compu /end COMPU_METHOD
/begin COMPU_VTAB DSMBAS_VAR_SY_Compu "" TAB_VERB 56 0 "kein Kundenbezug" 1 "DAI" 3 "VWW" 4 "POR" 5 "AUD" 6 "OPE" 9 "FIA" 11 "BMW" 14 "PSA" 15 "REN" 17 "ALF" 18 "SAB" 19 "VOL" 20 "NIS" 21 "GMU" 22 "FOR" 26 "IMJ" 36 "MAN" 51 "SEA" 53 "CHR" 54 "JAG" 55 "ROL" 69 "FER" 72 "TOY" 123 "MIT" 147 "HYU" 159 "HON" 160 "MAZ" 183 "CU" 190 "LRG" 204 "VVW" 214 "AVT" 242 "Iveco" 243 "DMC" 248 "SUZ" 267 "SSANGYONG" 270 "KEF" 289 "AMG" 308 "TAT" 319 "MVM" 328 "MM" 385 "UAES" 578 "AL" 590 "SCANIA" 609 "Deutz" 760 "WEICHAI" 828 "RBCD" 858 "Kubota" 898 "MFTBC" 973 "YANMARJP" 984 "FAW" 999 "ALL" 2887 "Nonox" 9407 "DHC" 9454 "Fuso" 9740 "Navistar" /end COMPU_VTAB
/begin COMPU_METHOD DSMCONF_DEBMULDCY_SC_Compu "" TAB_VERB "%6.3" "" COMPU_TAB_REF DSMCONF_DEBMULDCY_SC_Compu /end COMPU_METHOD
/begin COMPU_VTAB DSMCONF_DEBMULDCY_SC_Compu "" TAB_VERB 2 0 "False" 1 "True" /end COMPU_VTAB
/begin COMPU_METHOD DSMDUR_MIL_GLB_SY_Compu "" TAB_VERB "%6.3" "" COMPU_TAB_REF DSMDUR_MIL_GLB_SY_Compu /end COMPU_METHOD
/begin COMPU_VTAB DSMDUR_MIL_GLB_SY_Compu "" TAB_VERB 2 0 "FALSE" 1 "TRUE" /end COMPU_VTAB
/begin COMPU_METHOD DSMDUR_SUPPID4D_SC_Compu "" TAB_VERB "%6.3" "" COMPU_TAB_REF DSMDUR_SUPPID4D_SC_Compu /end COMPU_METHOD
/begin COMPU_VTAB DSMDUR_SUPPID4D_SC_Compu "" TAB_VERB 2 0 "False" 1 "True" /end COMPU_VTAB
/begin COMPU_METHOD DSMDUR_SUPPID4E_SC_Compu "" TAB_VERB "%6.3" "" COMPU_TAB_REF DSMDUR_SUPPID4E_SC_Compu /end COMPU_METHOD
/begin COMPU_VTAB DSMDUR_SUPPID4E_SC_Compu "" TAB_VERB 2 0 "False" 1 "True" /end COMPU_VTAB
/begin COMPU_METHOD DSMRDY_ENA_FLSYSFORCELABEL_SC_Compu "" TAB_VERB "%6.3" "" COMPU_TAB_REF DSMRDY_ENA_FLSYSFORCELABEL_SC_Compu /end COMPU_METHOD
/begin COMPU_VTAB DSMRDY_ENA_FLSYSFORCELABEL_SC_Compu "" TAB_VERB 2 0 "False" 1 "True" /end COMPU_VTAB
/begin COMPU_METHOD DSMRDY_ENGSPEC_SY_Compu "" TAB_VERB "%6.3" "" COMPU_TAB_REF DSMRDY_ENGSPEC_SY_Compu /end COMPU_METHOD
/begin COMPU_VTAB DSMRDY_ENGSPEC_SY_Compu "" TAB_VERB 2 0 "FALSE" 1 "TRUE" /end COMPU_VTAB
/begin COMPU_METHOD DSMRDY_INHP41_SY_Compu "" RAT_FUNC "%6.2" "" COEFFS 0 1 0 0 0 1 /end COMPU_METHOD
/begin COMPU_METHOD DSMRDY_SUPPID41_SY_Compu "" TAB_VERB "%6.3" "" COMPU_TAB_REF DSMRDY_SUPPID41_SY_Compu /end COMPU_METHOD
/begin COMPU_VTAB DSMRDY_SUPPID41_SY_Compu "" TAB_VERB 2 0 "FALSE" 1 "TRUE" /end COMPU_VTAB
/begin COMPU_METHOD DSMRDY_VERS_SC_Compu "" TAB_VERB "%6.3" "" COMPU_TAB_REF DSMRDY_VERS_SC_Compu /end COMPU_METHOD
/begin COMPU_VTAB DSMRDY_VERS_SC_Compu "" TAB_VERB 3 0 "DSMRDY_PRE_2009" 1 "DSMRDY_2009" 2 "DSMRDY_2020" /end COMPU_VTAB
/begin COMPU_METHOD DSM_DISBLGRPSIZE_SY_Compu "" RAT_FUNC "%6.2" "" COEFFS 0 1 0 0 0 1 /end COMPU_METHOD
/begin COMPU_METHOD DSM_DOBD_SC_Compu "" TAB_VERB "%6.3" "" COMPU_TAB_REF DSM_DOBD_SC_Compu /end COMPU_METHOD
/begin COMPU_VTAB DSM_DOBD_SC_Compu "" TAB_VERB 2 0 "False" 1 "True" /end COMPU_VTAB
/begin COMPU_METHOD DSM_DSM2SG_SY_Compu "" TAB_VERB "%6.3" "" COMPU_TAB_REF DSM_DSM2SG_SY_Compu /end COMPU_METHOD
/begin COMPU_VTAB DSM_DSM2SG_SY_Compu "" TAB_VERB 2 0 "False" 1 "True" /end COMPU_VTAB
/begin COMPU_METHOD DSM_DSMAPLCTRLDDIAGCYC_SC_Compu "" TAB_VERB "%6.3" "" COMPU_TAB_REF DSM_DSMAPLCTRLDDIAGCYC_SC_Compu /end COMPU_METHOD
/begin COMPU_VTAB DSM_DSMAPLCTRLDDIAGCYC_SC_Compu "" TAB_VERB 2 0 "False" 1 "True" /end COMPU_VTAB
/begin COMPU_METHOD DSM_FAILCNT_SY_Compu "" TAB_VERB "%6.3" "" COMPU_TAB_REF DSM_FAILCNT_SY_Compu /end COMPU_METHOD
/begin COMPU_VTAB DSM_FAILCNT_SY_Compu "" TAB_VERB 2 0 "False" 1 "True" /end COMPU_VTAB
/begin COMPU_METHOD DSM_FAULTSEQ_SY_Compu "" TAB_VERB "%6.3" "" COMPU_TAB_REF DSM_FAULTSEQ_SY_Compu /end COMPU_METHOD
/begin COMPU_VTAB DSM_FAULTSEQ_SY_Compu "" TAB_VERB 2 0 "False" 1 "True" /end COMPU_VTAB
/begin COMPU_METHOD DSM_INHRLS_SY_Compu "" TAB_VERB "%6.3" "" COMPU_TAB_REF DSM_INHRLS_SY_Compu /end COMPU_METHOD
/begin COMPU_VTAB DSM_INHRLS_SY_Compu "" TAB_VERB 2 0 "0" 1 "1" /end COMPU_VTAB
/begin COMPU_METHOD DSM_WUCDET_SY_Compu "" TAB_VERB "%6.3" "" COMPU_TAB_REF DSM_WUCDET_SY_Compu /end COMPU_METHOD
/begin COMPU_VTAB DSM_WUCDET_SY_Compu "" TAB_VERB 7 0 "0" 1 "1" 2 "2" 3 "3" 4 "4" 5 "5" 255 "255" /end COMPU_VTAB
/begin COMPU_METHOD dTrq "" RAT_FUNC "%6.3" "Nm/s" COEFFS 0 10 0 0 0 1 /end COMPU_METHOD
/begin COMPU_METHOD DTR_LEGIFC_SY_Compu "" TAB_VERB "%6.3" "" COMPU_TAB_REF DTR_LEGIFC_SY_Compu /end COMPU_METHOD
/begin COMPU_VTAB DTR_LEGIFC_SY_Compu "" TAB_VERB 2 0 "DISABLED" 1 "ENABLED" /end COMPU_VTAB
/begin COMPU_METHOD DtTemp_KPerSec_q0p01_COMPU "" RAT_FUNC "%6.4" "K/s" COEFFS 0 100 0 0 0 1 /end COMPU_METHOD
/begin COMPU_METHOD DtyCycSlp "" RAT_FUNC "%6.5" "%/s" COEFFS 0 1000 0 0 0 1 /end COMPU_METHOD
/begin COMPU_METHOD dt_TempKelv_p_s "" RAT_FUNC "%6.3" "K/s" COEFFS 0 10 0 0 0 1 /end COMPU_METHOD
/begin COMPU_METHOD ECBVLV_TYPAVL_SY_Compu "" TAB_VERB "%6.3" "" COMPU_TAB_REF ECBVLV_TYPAVL_SY_Compu /end COMPU_METHOD
/begin COMPU_VTAB ECBVLV_TYPAVL_SY_Compu "" TAB_VERB 2 0 "FALSE" 1 "TRUE" /end COMPU_VTAB
/begin COMPU_METHOD ECUOFF_TMR_SY_Compu "" TAB_VERB "%6.3" "" COMPU_TAB_REF ECUOFF_TMR_SY_Compu /end COMPU_METHOD
/begin COMPU_VTAB ECUOFF_TMR_SY_Compu "" TAB_VERB 7 0 "0" 1 "1" 2 "2" 3 "3" 4 "4" 5 "5" 6 "6" /end COMPU_VTAB
/begin COMPU_METHOD ECUTYP_SC_Compu "" TAB_VERB "%6.3" "" COMPU_TAB_REF ECUTYP_SC_Compu /end COMPU_METHOD
/begin COMPU_VTAB ECUTYP_SC_Compu "" TAB_VERB 8 0 "EngEcu" 1 "InvrEcu" 2 "VehEcu" 3 "BattEcu" 4 "DosECU" 6 "PmpECU" 7 "TCMEcu" 8 "FuCellEcu" /end COMPU_VTAB
/begin COMPU_METHOD ECU_GENR_SY_Compu "" TAB_VERB "%6.3" "" COMPU_TAB_REF ECU_GENR_SY_Compu /end COMPU_METHOD
/begin COMPU_VTAB ECU_GENR_SY_Compu "" TAB_VERB 8 0 "Mx7" 1 "Mx9" 2 "Mx17" 3 "EDC17" 4 "VMx17" 5 "DCU17" 6 "MDG1C" 7 "MDG2" /end COMPU_VTAB
/begin COMPU_METHOD EDRVMULTIGEARTRSM_SC_Compu "" TAB_VERB "%6.3" "" COMPU_TAB_REF EDRVMULTIGEARTRSM_SC_Compu /end COMPU_METHOD
/begin COMPU_VTAB EDRVMULTIGEARTRSM_SC_Compu "" TAB_VERB 2 0 "False" 1 "True" /end COMPU_VTAB
/begin COMPU_METHOD EffGrad "" RAT_FUNC "%7.6" "1/s" COEFFS 0 10000 0 0 0 1 /end COMPU_METHOD
/begin COMPU_METHOD EffGradAr "" RAT_FUNC "%8.7" "1/s" COEFFS 0 100000 0 0 0 1 /end COMPU_METHOD
/begin COMPU_METHOD EffGradPrc "" RAT_FUNC "%8.7" "1/s" COEFFS 0 819200 0 0 0 1 /end COMPU_METHOD
/begin COMPU_METHOD EGREVAPRUSFLDP_TYPAVL_SC_Compu "" TAB_VERB "%6.3" "" COMPU_TAB_REF EGREVAPRUSFLDP_TYPAVL_SC_Compu /end COMPU_METHOD
/begin COMPU_VTAB EGREVAPRUSFLDP_TYPAVL_SC_Compu "" TAB_VERB 2 0 "False" 1 "True" /end COMPU_VTAB
/begin COMPU_METHOD EGRVLVINSDT_TYPAVL_SC_Compu "" TAB_VERB "%6.3" "" COMPU_TAB_REF EGRVLVINSDT_TYPAVL_SC_Compu /end COMPU_METHOD
/begin COMPU_VTAB EGRVLVINSDT_TYPAVL_SC_Compu "" TAB_VERB 2 0 "False" 1 "True" /end COMPU_VTAB
/begin COMPU_METHOD EGRVLVI_TYPAVL_SC_Compu "" TAB_VERB "%6.3" "" COMPU_TAB_REF EGRVLVI_TYPAVL_SC_Compu /end COMPU_METHOD
/begin COMPU_VTAB EGRVLVI_TYPAVL_SC_Compu "" TAB_VERB 2 0 "False" 1 "True" /end COMPU_VTAB
/begin COMPU_METHOD EGRVLVLPI_TYPAVL_SC_Compu "" TAB_VERB "%6.3" "" COMPU_TAB_REF EGRVLVLPI_TYPAVL_SC_Compu /end COMPU_METHOD
/begin COMPU_VTAB EGRVLVLPI_TYPAVL_SC_Compu "" TAB_VERB 2 0 "False" 1 "True" /end COMPU_VTAB
/begin COMPU_METHOD EGTFact "" RAT_FUNC "%6.5" "-" COEFFS 0 1000 0 0 0 1 /end COMPU_METHOD
/begin COMPU_METHOD EGTSwt "" RAT_FUNC "%10.9" "-" COEFFS 0 16384000 0 0 0 1 /end COMPU_METHOD
/begin COMPU_METHOD EGTSwt_S16 "" RAT_FUNC "%7.6" "-" COEFFS 0 16384 0 0 0 1 /end COMPU_METHOD
/begin COMPU_METHOD ELDEV_DSQACTVT_SC_Compu "" TAB_VERB "%6.3" "" COMPU_TAB_REF ELDEV_DSQACTVT_SC_Compu /end COMPU_METHOD
/begin COMPU_VTAB ELDEV_DSQACTVT_SC_Compu "" TAB_VERB 2 0 "Inactive" 1 "Active" /end COMPU_VTAB
/begin COMPU_METHOD ELSS_HVENA_SC_Compu "" TAB_VERB "%6.3" "" COMPU_TAB_REF ELSS_HVENA_SC_Compu /end COMPU_METHOD
/begin COMPU_VTAB ELSS_HVENA_SC_Compu "" TAB_VERB 2 0 "No_HV_supply" 1 "HV_supply_active" /end COMPU_VTAB
/begin COMPU_METHOD ElSS_HVVAR_SC_Compu "" TAB_VERB "%6.3" "" COMPU_TAB_REF ElSS_HVVAR_SC_Compu /end COMPU_METHOD
/begin COMPU_VTAB ElSS_HVVAR_SC_Compu "" TAB_VERB 14 0 "ElSS_HVVAR_TEMPLATE" 1 "ElSS_HVVAR_TREXD18" 2 "ElSS_HVVAR_TREXE18" 6 "ElSS_HVVAR_STSC17" 7 "ElSS_HVVAR_STSC18" 11 "ElSS_HVVAR_NIKOLAUTV18" 12 "ElSS_HVVAR_NIKOLAONE18" 16 "ElSS_HVVAR_BYTON18" 21 "ElSS_HVVAR_EGOLFDEMO" 26 "ElSS_HVVAR_EGO2018" 31 "ElSS_HVVAR_ROLCHASSIS2019" 36 "EISS_HVVAR_MAN" 41 "EISS_HVVAR_ JMCV348" 46 "ElSS_HVVAR_NAVISTAR2020" /end COMPU_VTAB
/begin COMPU_METHOD ELSS_LVBATTTESTPLS_SC_Compu "" TAB_VERB "%6.3" "" COMPU_TAB_REF ELSS_LVBATTTESTPLS_SC_Compu /end COMPU_METHOD
/begin COMPU_VTAB ELSS_LVBATTTESTPLS_SC_Compu "" TAB_VERB 2 0 "NO_TESTPLS" 1 "TESTPLS" /end COMPU_VTAB
/begin COMPU_METHOD ELTS_EVINFOENA_SC_Compu "" TAB_VERB "%6.3" "" COMPU_TAB_REF ELTS_EVINFOENA_SC_Compu /end COMPU_METHOD
/begin COMPU_VTAB ELTS_EVINFOENA_SC_Compu "" TAB_VERB 2 0 "Disable" 1 "Enable" /end COMPU_VTAB
/begin COMPU_METHOD EM01PRSNT_SC_Compu "" TAB_VERB "%6.3" "" COMPU_TAB_REF EM01PRSNT_SC_Compu /end COMPU_METHOD
/begin COMPU_VTAB EM01PRSNT_SC_Compu "" TAB_VERB 2 0 "False" 1 "True" /end COMPU_VTAB
/begin COMPU_METHOD EM02PRSNT_SC_Compu "" TAB_VERB "%6.3" "" COMPU_TAB_REF EM02PRSNT_SC_Compu /end COMPU_METHOD
/begin COMPU_VTAB EM02PRSNT_SC_Compu "" TAB_VERB 2 0 "False" 1 "True" /end COMPU_VTAB
/begin COMPU_METHOD EM03PRSNT_SC_Compu "" TAB_VERB "%6.3" "" COMPU_TAB_REF EM03PRSNT_SC_Compu /end COMPU_METHOD
/begin COMPU_VTAB EM03PRSNT_SC_Compu "" TAB_VERB 2 0 "False" 1 "True" /end COMPU_VTAB
/begin COMPU_METHOD EM04PRSNT_SC_Compu "" TAB_VERB "%6.3" "" COMPU_TAB_REF EM04PRSNT_SC_Compu /end COMPU_METHOD
/begin COMPU_VTAB EM04PRSNT_SC_Compu "" TAB_VERB 2 0 "False" 1 "True" /end COMPU_VTAB
/begin COMPU_METHOD EM05PRSNT_SC_Compu "" TAB_VERB "%6.3" "" COMPU_TAB_REF EM05PRSNT_SC_Compu /end COMPU_METHOD
/begin COMPU_VTAB EM05PRSNT_SC_Compu "" TAB_VERB 2 0 "False" 1 "True" /end COMPU_VTAB
/begin COMPU_METHOD EMGYSHOFFIN2_TYPAVL_SC_Compu "" TAB_VERB "%6.3" "" COMPU_TAB_REF EMGYSHOFFIN2_TYPAVL_SC_Compu /end COMPU_METHOD
/begin COMPU_VTAB EMGYSHOFFIN2_TYPAVL_SC_Compu "" TAB_VERB 2 0 "FALSE" 1 "TRUE" /end COMPU_VTAB
/begin COMPU_METHOD EMGYSTRTSWT2_TYPAVL_SC_Compu "" TAB_VERB "%6.3" "" COMPU_TAB_REF EMGYSTRTSWT2_TYPAVL_SC_Compu /end COMPU_METHOD
/begin COMPU_VTAB EMGYSTRTSWT2_TYPAVL_SC_Compu "" TAB_VERB 2 0 "False" 1 "True" /end COMPU_VTAB
/begin COMPU_METHOD EMWAKEUPSIG_TYPAVL_SC_Compu "" TAB_VERB "%6.3" "" COMPU_TAB_REF EMWAKEUPSIG_TYPAVL_SC_Compu /end COMPU_METHOD
/begin COMPU_VTAB EMWAKEUPSIG_TYPAVL_SC_Compu "" TAB_VERB 2 0 "False" 1 "True" /end COMPU_VTAB
/begin COMPU_METHOD ENADATASETID_CALPAR_SC_Compu "" TAB_VERB "%6.3" "" COMPU_TAB_REF ENADATASETID_CALPAR_SC_Compu /end COMPU_METHOD
/begin COMPU_VTAB ENADATASETID_CALPAR_SC_Compu "" TAB_VERB 2 0 "False" 1 "True" /end COMPU_VTAB
/begin COMPU_METHOD Energy "" RAT_FUNC "%6.2" "kJ" COEFFS 0 1 0 0 0 1 /end COMPU_METHOD
/begin COMPU_METHOD Energy_J_HiRes "" RAT_FUNC "%6.2" "J" COEFFS 0 1 0 0 0 1 /end COMPU_METHOD
/begin COMPU_METHOD Energy_q0p0001 "" RAT_FUNC "%7.6" "kJ" COEFFS 0 10000 0 0 0 1 /end COMPU_METHOD
/begin COMPU_METHOD Energy_q0p001_COMPU "" RAT_FUNC "%6.5" "kJ" COEFFS 0 1000 0 0 0 1 /end COMPU_METHOD
/begin COMPU_METHOD ENGCMPTMTT_TYPAVL_SY_Compu "" TAB_VERB "%6.3" "" COMPU_TAB_REF ENGCMPTMTT_TYPAVL_SY_Compu /end COMPU_METHOD
/begin COMPU_VTAB ENGCMPTMTT_TYPAVL_SY_Compu "" TAB_VERB 2 0 "False" 1 "True" /end COMPU_VTAB
/begin COMPU_METHOD ENGDA_CTFLD_NUM_Compu "" RAT_FUNC "%6.2" "" COEFFS 0 1 0 0 0 1 /end COMPU_METHOD
/begin COMPU_METHOD ENGMIDT_TYPAVL_SC_Compu "" TAB_VERB "%6.3" "" COMPU_TAB_REF ENGMIDT_TYPAVL_SC_Compu /end COMPU_METHOD
/begin COMPU_VTAB ENGMIDT_TYPAVL_SC_Compu "" TAB_VERB 2 0 "False" 1 "True" /end COMPU_VTAB
/begin COMPU_METHOD EngNRmp_Hi "" RAT_FUNC "%6.3" "rpm" COEFFS 0 10 0 0 0 1 /end COMPU_METHOD
/begin COMPU_METHOD EngN_HiRes "" RAT_FUNC "%6.4" "rpm" COEFFS 0 32 0 0 0 1 /end COMPU_METHOD
/begin COMPU_METHOD EngN_LRes "" RAT_FUNC "%6.1" "rpm" COEFFS 0 0.025 0 0 0 1 /end COMPU_METHOD
/begin COMPU_METHOD ENGOILT_TYPAVL_SC_Compu "" TAB_VERB "%6.3" "" COMPU_TAB_REF ENGOILT_TYPAVL_SC_Compu /end COMPU_METHOD
/begin COMPU_VTAB ENGOILT_TYPAVL_SC_Compu "" TAB_VERB 2 0 "False" 1 "True" /end COMPU_VTAB
/begin COMPU_METHOD EnrgPerMass "" RAT_FUNC "%6.3" "MJ/Kg" COEFFS 0 10 0 0 0 1 /end COMPU_METHOD
/begin COMPU_METHOD EnrgPrMol_q0p001_COMPU "" RAT_FUNC "%6.5" "J/mol" COEFFS 0 1000 0 0 0 1 /end COMPU_METHOD
/begin COMPU_METHOD ENVP_ATS_SY_Compu "" TAB_VERB "%6.3" "" COMPU_TAB_REF ENVP_ATS_SY_Compu /end COMPU_METHOD
/begin COMPU_VTAB ENVP_ATS_SY_Compu "" TAB_VERB 2 0 "ATS_DISABLED" 1 "ATS_ENABLED" /end COMPU_VTAB
/begin COMPU_METHOD ENVP_TYPAVL_SY_Compu "" TAB_VERB "%6.3" "" COMPU_TAB_REF ENVP_TYPAVL_SY_Compu /end COMPU_METHOD
/begin COMPU_VTAB ENVP_TYPAVL_SY_Compu "" TAB_VERB 2 0 "False" 1 "True" /end COMPU_VTAB
/begin COMPU_METHOD ENVT_TYPAVL_SY_Compu "" TAB_VERB "%6.3" "" COMPU_TAB_REF ENVT_TYPAVL_SY_Compu /end COMPU_METHOD
/begin COMPU_VTAB ENVT_TYPAVL_SY_Compu "" TAB_VERB 2 0 "False" 1 "True" /end COMPU_VTAB
/begin COMPU_METHOD EPM_TDCDSTCLB_SC_Compu "" TAB_VERB "%6.3" "" COMPU_TAB_REF EPM_TDCDSTCLB_SC_Compu /end COMPU_METHOD
/begin COMPU_VTAB EPM_TDCDSTCLB_SC_Compu "" TAB_VERB 2 0 "STANDARD" 1 "ARRAY" /end COMPU_VTAB
/begin COMPU_METHOD ERCLNTVLVI_TYPAVL_SC_Compu "" TAB_VERB "%6.3" "" COMPU_TAB_REF ERCLNTVLVI_TYPAVL_SC_Compu /end COMPU_METHOD
/begin COMPU_VTAB ERCLNTVLVI_TYPAVL_SC_Compu "" TAB_VERB 2 0 "False" 1 "True" /end COMPU_VTAB
/begin COMPU_METHOD ERCLNTVLVT_TYPAVL_SC_Compu "" TAB_VERB "%6.3" "" COMPU_TAB_REF ERCLNTVLVT_TYPAVL_SC_Compu /end COMPU_METHOD
/begin COMPU_VTAB ERCLNTVLVT_TYPAVL_SC_Compu "" TAB_VERB 2 0 "False" 1 "True" /end COMPU_VTAB
/begin COMPU_METHOD ERRLMP_ATSINTVMOD_SY_Compu "" TAB_VERB "%6.3" "" COMPU_TAB_REF ERRLMP_ATSINTVMOD_SY_Compu /end COMPU_METHOD
/begin COMPU_VTAB ERRLMP_ATSINTVMOD_SY_Compu "" TAB_VERB 2 0 "FALSE" 1 "TRUE" /end COMPU_VTAB
/begin COMPU_METHOD ERRLMP_UNIFY_SC_Compu "" TAB_VERB "%6.3" "" COMPU_TAB_REF ERRLMP_UNIFY_SC_Compu /end COMPU_METHOD
/begin COMPU_VTAB ERRLMP_UNIFY_SC_Compu "" TAB_VERB 2 0 "False" 1 "True" /end COMPU_VTAB
/begin COMPU_METHOD ESC_ACTVTSYNCHAINCFG_SC_Compu "" TAB_VERB "%6.3" "" COMPU_TAB_REF ESC_ACTVTSYNCHAINCFG_SC_Compu /end COMPU_METHOD
/begin COMPU_VTAB ESC_ACTVTSYNCHAINCFG_SC_Compu "" TAB_VERB 3 0 "ACTVTSYNCHAIN_NONE" 1 "ACTVTSYNCHAIN_EBOS" 2 "ACTVTSYNCHAIN_ESC" /end COMPU_VTAB
/begin COMPU_METHOD ESC_ENAPROCGROUP_SC_Compu "" TAB_VERB "%6.3" "" COMPU_TAB_REF ESC_ENAPROCGROUP_SC_Compu /end COMPU_METHOD
/begin COMPU_VTAB ESC_ENAPROCGROUP_SC_Compu "" TAB_VERB 2 0 "DISABLED" 1 "ENABLED" /end COMPU_VTAB
/begin COMPU_METHOD ESC_NRAGEVEWCYC_SC_Compu "" RAT_FUNC "%6.2" "" COEFFS 0 1 0 0 0 1 /end COMPU_METHOD
/begin COMPU_METHOD ESC_NRTSKAGEVE_SC_Compu "" RAT_FUNC "%6.2" "" COEFFS 0 1 0 0 0 1 /end COMPU_METHOD
/begin COMPU_METHOD ESC_SAMPLETICALCN_SC_Compu "" TAB_VERB "%6.3" "" COMPU_TAB_REF ESC_SAMPLETICALCN_SC_Compu /end COMPU_METHOD
/begin COMPU_VTAB ESC_SAMPLETICALCN_SC_Compu "" TAB_VERB 2 0 "SEG_AG_BASD" 1 "TSK_TI_STAMP_BASD" /end COMPU_VTAB
/begin COMPU_METHOD ESC_SELNCAMSFTTSKACTVN_SC_Compu "" TAB_VERB "%6.3" "" COMPU_TAB_REF ESC_SELNCAMSFTTSKACTVN_SC_Compu /end COMPU_METHOD
/begin COMPU_VTAB ESC_SELNCAMSFTTSKACTVN_SC_Compu "" TAB_VERB 3 0 "NO_CAMSFTTSKACTVN" 1 "PLAT_CAMSFTTSKACTVN" 2 "HDP_CAMSFTTSKACTVN" /end COMPU_VTAB
/begin COMPU_METHOD ESC_SELNMETHSYNSDL_SC_Compu "" TAB_VERB "%6.3" "" COMPU_TAB_REF ESC_SELNMETHSYNSDL_SC_Compu /end COMPU_METHOD
/begin COMPU_VTAB ESC_SELNMETHSYNSDL_SC_Compu "" TAB_VERB 2 0 "OS_TSK_BASD_SDL" 1 "ESC_CNTNR_BASD_SDL" /end COMPU_VTAB
/begin COMPU_METHOD ESC_SELNNOTSTDTISYNCNTSK_SC_Compu "" TAB_VERB "%6.3" "" COMPU_TAB_REF ESC_SELNNOTSTDTISYNCNTSK_SC_Compu /end COMPU_METHOD
/begin COMPU_VTAB ESC_SELNNOTSTDTISYNCNTSK_SC_Compu "" TAB_VERB 2 0 "NO_SELN" 1 "40ms" /end COMPU_VTAB
/begin COMPU_METHOD ESC_SELSAMPLETICFGMETHOD_SC_Compu "" TAB_VERB "%6.3" "" COMPU_TAB_REF ESC_SELSAMPLETICFGMETHOD_SC_Compu /end COMPU_METHOD
/begin COMPU_VTAB ESC_SELSAMPLETICFGMETHOD_SC_Compu "" TAB_VERB 2 0 "MAN_CFG_METHOD" 1 "AUT_CFG_METHOD" /end COMPU_VTAB
/begin COMPU_METHOD ESC_SYNCTASK_SC_Compu "" TAB_VERB "%6.3" "" COMPU_TAB_REF ESC_SYNCTASK_SC_Compu /end COMPU_METHOD
/begin COMPU_VTAB ESC_SYNCTASK_SC_Compu "" TAB_VERB 3 0 "0" 1 "1" 2 "2" /end COMPU_VTAB
/begin COMPU_METHOD OneToOne "" RAT_FUNC "%6.2" "-" COEFFS 0 1 0 0 0 1 /end COMPU_METHOD
/begin COMPU_METHOD RBPtCel_p_1p0_1 "" RAT_FUNC "%6.2" "hPa" COEFFS 0 1 0 0 0 1 /end COMPU_METHOD
/begin COMPU_METHOD RBPtCel_t_1p0_3 "" RAT_FUNC "%6.2" "Deg C" COEFFS 0 1 0 0 0 1 /end COMPU_METHOD
/begin COMPU_METHOD RBPtCel_u_1p0_1 "" RAT_FUNC "%6.2" "V" COEFFS 0 1 0 0 0 1 /end COMPU_METHOD
/begin COMPU_METHOD rel_q0p1 "" RAT_FUNC "%6.3" "%" COEFFS 0 10 0 0 0 1 /end COMPU_METHOD
/begin COMPU_METHOD rel_q1 "" RAT_FUNC "%6.2" "%" COEFFS 0 1 0 0 0 1 /end COMPU_METHOD
/begin COMPU_METHOD SigQly_COMPU_VERB "" TAB_VERB "%6.3" "" COMPU_TAB_REF SigQly_COMPU_VERB /end COMPU_METHOD
/begin COMPU_VTAB SigQly_COMPU_VERB "" TAB_VERB 16 0 "SIGQLY_NOTCALC" 1 "SIGQLY_INIT" 2 "SIGQLY_OK" 3 "SIGQLY_MODEL" 4 "SIGQLY_REPLACEMENT" 5 "SIGQLY_FROZEN" 6 "SIGQLY_INVALID" 7 "SIGQLY_RESERVED_7" 8 "SIGQLY_RESERVED_8" 9 "SIGQLY_RESERVED_9" 10 "SIGQLY_RESERVED_10" 11 "SIGQLY_RESERVED_11" 12 "SIGQLY_RESERVED_12" 13 "SIGQLY_RESERVED_13" 14 "SIGQLY_RESERVED_14" 15 "SIGQLY_RESERVED_15" /end COMPU_VTAB
/begin COMPU_METHOD spg_q0p0039 "" RAT_FUNC "%6.4" "V" COEFFS 0 256 0 0 0 1 /end COMPU_METHOD
/begin COMPU_METHOD Temp_Cels "" RAT_FUNC "%6.1" "deg C" COEFFS 0 10 2731.4 0 0 1 /end COMPU_METHOD
/begin COMPU_METHOD Time_ms "" RAT_FUNC "%6.1" "ms" COEFFS 0 0.1 0 0 0 1 /end COMPU_METHOD
/begin COMPU_METHOD Time_msec_q100_COMPU "" RAT_FUNC "%6.0" "ms" COEFFS 0 1 0 0 0 100 /end COMPU_METHOD
/begin COMPU_METHOD Time_msec_q1_COMPU "" RAT_FUNC "%6.2" "ms" COEFFS 0 1 0 0 0 1 /end COMPU_METHOD
/begin COMPU_METHOD Time_s "" RAT_FUNC "%6.4" "s" COEFFS 0 100 0 0 0 1 /end COMPU_METHOD
/begin COMPU_METHOD Vel "" RAT_FUNC "%6.4" "km/h" COEFFS 0 100 0 0 0 1 /end COMPU_METHOD
/begin COMPU_METHOD Volt_Batt "" RAT_FUNC "%6.1" "mV" COEFFS 0 0.05 0 0 0 1 /end COMPU_METHOD
/begin COMPU_METHOD Volt_V_q0p03125_COMPU "" RAT_FUNC "%6.4" "V" COEFFS 0 32 0 0 0 1 /end COMPU_METHOD
/begin RECORD_LAYOUT KwWU16 FNC_VALUES 1 UWORD COLUMN_DIR DIRECT /end RECORD_LAYOUT
/begin RECORD_LAYOUT KwWU8 FNC_VALUES 1 UBYTE COLUMN_DIR DIRECT /end RECORD_LAYOUT
/begin RECORD_LAYOUT RB_Curve_U8_U8 NO_AXIS_PTS_X 1 UBYTE AXIS_PTS_X 2 UBYTE INDEX_INCR DIRECT FNC_VALUES 3 UBYTE COLUMN_DIR DIRECT /end RECORD_LAYOUT
/begin RECORD_LAYOUT RB_Map_S16U8_S16_sao NO_AXIS_PTS_X 1 SWORD NO_AXIS_PTS_Y 2 SWORD AXIS_PTS_X 3 SWORD INDEX_INCR DIRECT AXIS_PTS_Y 4 UBYTE INDEX_INCR DIRECT FNC_VALUES 5 SWORD COLUMN_DIR DIRECT STATIC_ADDRESS_OFFSETS /end RECORD_LAYOUT
/begin RECORD_LAYOUT RB_Val_Ws16 FNC_VALUES 1 SWORD COLUMN_DIR DIRECT /end RECORD_LAYOUT
/begin RECORD_LAYOUT RB_Val_Wu16 FNC_VALUES 1 UWORD COLUMN_DIR DIRECT /end RECORD_LAYOUT
/begin RECORD_LAYOUT RB_Val_Wu8 FNC_VALUES 1 UBYTE COLUMN_DIR DIRECT /end RECORD_LAYOUT
/begin RECORD_LAYOUT ValA_Wu16 FNC_VALUES 1 UWORD COLUMN_DIR DIRECT /end RECORD_LAYOUT
/begin RECORD_LAYOUT ValA_Wu8 FNC_VALUES 1 UBYTE COLUMN_DIR DIRECT /end RECORD_LAYOUT
/begin RECORD_LAYOUT Val_Ws16 FNC_VALUES 1 SWORD COLUMN_DIR DIRECT /end RECORD_LAYOUT
/begin RECORD_LAYOUT Val_Ws32 FNC_VALUES 1 SLONG COLUMN_DIR DIRECT /end RECORD_LAYOUT
/begin RECORD_LAYOUT Val_Wu16 FNC_VALUES 1 UWORD COLUMN_DIR DIRECT /end RECORD_LAYOUT
/begin RECORD_LAYOUT Val_Wu32 FNC_VALUES 1 ULONG COLUMN_DIR DIRECT /end RECORD_LAYOUT
/begin RECORD_LAYOUT Val_Wu8 FNC_VALUES 1 UBYTE COLUMN_DIR DIRECT /end RECORD_LAYOUT
/end MODULE
/end PROJECT

ASAP2_VERSION 1 70
/begin PROJECT MDG1C "VC1CP091_STLA_N_D061I3"
/begin HEADER "" VERSION "VC1CP091_STLA_N_D061I3" PROJECT_NO MDG1C /end HEADER
/begin MODULE DIM ""
/begin MOD_COMMON "" BYTE_ORDER MSB_LAST ALIGNMENT_BYTE 1 ALIGNMENT_WORD 2 ALIGNMENT_LONG 4 ALIGNMENT_INT64 4 ALIGNMENT_FLOAT32_IEEE 4 ALIGNMENT_FLOAT64_IEEE 4 DATA_SIZE 32 /end MOD_COMMON
/begin CHARACTERISTIC DDRC_DurDeb.Fan_tiRlySCBDebOk_C "" VALUE 0x8024097C Val_Wu16 655350.0 DDRCTime_ms 0.00 655350.0 FORMAT "%8.1" /end CHARACTERISTIC
/begin CHARACTERISTIC DDRC_DurDeb.Fan_tiRlySCBDebDef_C "" VALUE 0x8024097E Val_Wu16 655350.0 DDRCTime_ms 0.00 655350.0 FORMAT "%8.1" /end CHARACTERISTIC
/begin CHARACTERISTIC DDRC_DurDeb.Fan_tiRlySCGDebOk_C "" VALUE 0x80240980 Val_Wu16 655350.0 DDRCTime_ms 0.00 655350.0 FORMAT "%8.1" /end CHARACTERISTIC
/begin CHARACTERISTIC DDRC_DurDeb.Fan_tiRlySCGDebDef_C "" VALUE 0x80240982 Val_Wu16 655350.0 DDRCTime_ms 0.00 655350.0 FORMAT "%8.1" /end CHARACTERISTIC
/begin CHARACTERISTIC DDRC_DurDeb.FreonP_tiSRCMinDebOk_C "" VALUE 0x80240984 Val_Wu16 655350.0 DDRCTime_ms 0.00 655350.0 FORMAT "%8.1" /end CHARACTERISTIC
/begin CHARACTERISTIC DDRC_DurDeb.FreonP_tiSRCMinDebDef_C "" VALUE 0x80240986 Val_Wu16 655350.0 DDRCTime_ms 0.00 655350.0 FORMAT "%8.1" /end CHARACTERISTIC
/begin CHARACTERISTIC DDRC_DurDeb.HLCCcs_tiPLnCChipTHiDebOk_C "" VALUE 0x80240988 Val_Wu16 655350.0 DDRCTime_ms 0.00 655350.0 FORMAT "%8.1" /end CHARACTERISTIC
/begin CHARACTERISTIC DDRC_DurDeb.HLCCcs_tiPLnCChipTHiDebDef_C "" VALUE 0x8024098A Val_Wu16 655350.0 DDRCTime_ms 0.00 655350.0 FORMAT "%8.1" /end CHARACTERISTIC
/begin CHARACTERISTIC DDRC_DurDeb.HeatrCoreT_tiSRCMinDebOk_C "" VALUE 0x8024098C Val_Wu16 655350.0 DDRCTime_ms 0.00 655350.0 FORMAT "%8.1" /end CHARACTERISTIC
/begin CHARACTERISTIC DDRC_DurDeb.HeatrCoreT_tiSRCMinDebDef_C "" VALUE 0x8024098E Val_Wu16 655350.0 DDRCTime_ms 0.00 655350.0 FORMAT "%8.1" /end CHARACTERISTIC
/begin CHARACTERISTIC DDRC_DurDeb.FanSpd_tiPhysRngHiDebOk_C "" VALUE 0x80240A24 Val_Wu16 655350.0 DDRCTime_ms 0.00 655350.0 FORMAT "%8.1" /end CHARACTERISTIC
/begin CHARACTERISTIC DDRC_DurDeb.FanSpd_tiPhysRngHiDebDef_C "" VALUE 0x80240A26 Val_Wu16 655350.0 DDRCTime_ms 0.00 655350.0 FORMAT "%8.1" /end CHARACTERISTIC
/begin CHARACTERISTIC DDRC_DurDeb.FanSpd_tiPhysRngLoDebOk_C "" VALUE 0x80240A28 Val_Wu16 655350.0 DDRCTime_ms 0.00 655350.0 FORMAT "%8.1" /end CHARACTERISTIC
/begin CHARACTERISTIC DDRC_DurDeb.FanSpd_tiPhysRngLoDebDef_C "" VALUE 0x80240A2A Val_Wu16 655350.0 DDRCTime_ms 0.00 655350.0 FORMAT "%8.1" /end CHARACTERISTIC
/begin CHARACTERISTIC DDRC_DurDeb.FreonP_tiPhysRngHiDebOk_C "" VALUE 0x80240A30 Val_Wu16 655350.0 DDRCTime_ms 0.00 655350.0 FORMAT "%8.1" /end CHARACTERISTIC
/begin CHARACTERISTIC DDRC_DurDeb.FreonP_tiPhysRngHiDebDef_C "" VALUE 0x80240A32 Val_Wu16 655350.0 DDRCTime_ms 0.00 655350.0 FORMAT "%8.1" /end CHARACTERISTIC
/begin CHARACTERISTIC DDRC_DurDeb.FreonP_tiPhysRngLoDebOk_C "" VALUE 0x80240A34 Val_Wu16 655350.0 DDRCTime_ms 0.00 655350.0 FORMAT "%8.1" /end CHARACTERISTIC
/begin CHARACTERISTIC DDRC_DurDeb.FreonP_tiPhysRngLoDebDef_C "" VALUE 0x80240A36 Val_Wu16 655350.0 DDRCTime_ms 0.00 655350.0 FORMAT "%8.1" /end CHARACTERISTIC
/begin CHARACTERISTIC DDRC_DurDeb.FreonP_tiSRCOpnDebOk_C "" VALUE 0x80240A38 Val_Wu16 655350.0 DDRCTime_ms 0.00 655350.0 FORMAT "%8.1" /end CHARACTERISTIC
/begin CHARACTERISTIC DDRC_DurDeb.FreonP_tiSRCOpnDebDef_C "" VALUE 0x80240A3A Val_Wu16 655350.0 DDRCTime_ms 0.00 655350.0 FORMAT "%8.1" /end CHARACTERISTIC
/begin CHARACTERISTIC DDRC_DurDeb.HeatrCoreT_tiPhysRngHiDebOk_C "" VALUE 0x80240A3C Val_Wu16 655350.0 DDRCTime_ms 0.00 655350.0 FORMAT "%8.1" /end CHARACTERISTIC
/begin CHARACTERISTIC DDRC_DurDeb.HeatrCoreT_tiPhysRngHiDebDef_C "" VALUE 0x80240A3E Val_Wu16 655350.0 DDRCTime_ms 0.00 655350.0 FORMAT "%8.1" /end CHARACTERISTIC
/begin CHARACTERISTIC DDRC_DurDeb.HeatrCoreT_tiPhysRngLoDebOk_C "" VALUE 0x80240A40 Val_Wu16 655350.0 DDRCTime_ms 0.00 655350.0 FORMAT "%8.1" /end CHARACTERISTIC
/begin CHARACTERISTIC DDRC_DurDeb.HeatrCoreT_tiPhysRngLoDebDef_C "" VALUE 0x80240A42 Val_Wu16 655350.0 DDRCTime_ms 0.00 655350.0 FORMAT "%8.1" /end CHARACTERISTIC
/begin CHARACTERISTIC DDRC_DurDeb.HeatrCoreT_tiSRCOpnDebOk_C "" VALUE 0x80240A44 Val_Wu16 655350.0 DDRCTime_ms 0.00 655350.0 FORMAT "%8.1" /end CHARACTERISTIC
/begin CHARACTERISTIC DDRC_DurDeb.HeatrCoreT_tiSRCOpnDebDef_C "" VALUE 0x80240A46 Val_Wu16 655350.0 DDRCTime_ms 0.00 655350.0 FORMAT "%8.1" /end CHARACTERISTIC
/begin CHARACTERISTIC DDRC_DurDeb.HLCCcs_tiFwDwnlDebOk_C "" VALUE 0x80240D18 Val_Wu16 655350.0 DDRCTime_ms 0.00 655350.0 FORMAT "%8.1" /end CHARACTERISTIC
/begin CHARACTERISTIC DDRC_DurDeb.HLCCcs_tiFwDwnlDebDef_C "" VALUE 0x80240D1A Val_Wu16 655350.0 DDRCTime_ms 0.00 655350.0 FORMAT "%8.1" /end CHARACTERISTIC
/begin CHARACTERISTIC DDRC_DurDeb.HvBatt_tiIReqToChrgrErrDebOk_C "" VALUE 0x80240D38 Val_Wu16 655350.0 DDRCTime_ms 0.00 655350.0 FORMAT "%8.1" /end CHARACTERISTIC
/begin CHARACTERISTIC DDRC_DurDeb.HvBatt_tiIReqToChrgrErrDebDef_C "" VALUE 0x80240D3A Val_Wu16 655350.0 DDRCTime_ms 0.00 655350.0 FORMAT "%8.1" /end CHARACTERISTIC
/begin CHARACTERISTIC DDRC_DurDeb.HvBatt_tiIReqToChrgrIniDebOk_C "" VALUE 0x80240D3C Val_Wu16 655350.0 DDRCTime_ms 0.00 655350.0 FORMAT "%8.1" /end CHARACTERISTIC
/begin CHARACTERISTIC DDRC_DurDeb.HvBatt_tiIReqToChrgrIniDebDef_C "" VALUE 0x80240D3E Val_Wu16 655350.0 DDRCTime_ms 0.00 655350.0 FORMAT "%8.1" /end CHARACTERISTIC
/begin CHARACTERISTIC DDRC_DurDeb.HvBatt_tiUNomChrgnErrDebOk_C "" VALUE 0x80240D90 Val_Wu16 655350.0 DDRCTime_ms 0.00 655350.0 FORMAT "%8.1" /end CHARACTERISTIC
/begin CHARACTERISTIC DDRC_DurDeb.HvBatt_tiUNomChrgnErrDebDef_C "" VALUE 0x80240D92 Val_Wu16 655350.0 DDRCTime_ms 0.00 655350.0 FORMAT "%8.1" /end CHARACTERISTIC
/begin CHARACTERISTIC DDRC_DurDeb.HvBatt_tiUNomChrgnIniDebOk_C "" VALUE 0x80240D94 Val_Wu16 655350.0 DDRCTime_ms 0.00 655350.0 FORMAT "%8.1" /end CHARACTERISTIC
/begin CHARACTERISTIC DDRC_DurDeb.HvBatt_tiUNomChrgnIniDebDef_C "" VALUE 0x80240D96 Val_Wu16 655350.0 DDRCTime_ms 0.00 655350.0 FORMAT "%8.1" /end CHARACTERISTIC
/begin CHARACTERISTIC DDRC_RatDeb.Fan_tiRlySCBUDRat_C "" VALUE 0x80248A63 Val_Wu8 3.00000000000 DDRC_Ratio 1.00000000000 4.00000000000 FORMAT "%13.11" /end CHARACTERISTIC
/begin CHARACTERISTIC DDRC_RatDeb.Fan_tiRlySCGUDRat_C "" VALUE 0x80248A64 Val_Wu8 3.00000000000 DDRC_Ratio 1.00000000000 4.00000000000 FORMAT "%13.11" /end CHARACTERISTIC
/begin CHARACTERISTIC DDRC_RatDeb.FreonP_tiSRCMinUDRat_C "" VALUE 0x80248A65 Val_Wu8 3.00000000000 DDRC_Ratio 1.00000000000 4.00000000000 FORMAT "%13.11" /end CHARACTERISTIC
/begin CHARACTERISTIC DDRC_RatDeb.HLCCcs_tiPLnCChipTHiUDRat_C "" VALUE 0x80248A66 Val_Wu8 3.00000000000 DDRC_Ratio 1.00000000000 4.00000000000 FORMAT "%13.11" /end CHARACTERISTIC
/begin CHARACTERISTIC DDRC_RatDeb.HeatrCoreT_tiSRCMinUDRat_C "" VALUE 0x80248A67 Val_Wu8 3.00000000000 DDRC_Ratio 1.00000000000 4.00000000000 FORMAT "%13.11" /end CHARACTERISTIC
/begin CHARACTERISTIC DDRC_RatDeb.FanSpd_tiPhysRngHiUDRat_C "" VALUE 0x80248A8D Val_Wu8 3.00000000000 DDRC_Ratio 1.00000000000 4.00000000000 FORMAT "%13.11" /end CHARACTERISTIC
/begin CHARACTERISTIC DDRC_RatDeb.FanSpd_tiPhysRngLoUDRat_C "" VALUE 0x80248A8E Val_Wu8 3.00000000000 DDRC_Ratio 1.00000000000 4.00000000000 FORMAT "%13.11" /end CHARACTERISTIC
/begin CHARACTERISTIC DDRC_RatDeb.FreonP_tiPhysRngHiUDRat_C "" VALUE 0x80248A90 Val_Wu8 3.00000000000 DDRC_Ratio 1.00000000000 4.00000000000 FORMAT "%13.11" /end CHARACTERISTIC
/begin CHARACTERISTIC DDRC_RatDeb.FreonP_tiPhysRngLoUDRat_C "" VALUE 0x80248A91 Val_Wu8 3.00000000000 DDRC_Ratio 1.00000000000 4.00000000000 FORMAT "%13.11" /end CHARACTERISTIC
/begin CHARACTERISTIC DDRC_RatDeb.FreonP_tiSRCOpnUDRat_C "" VALUE 0x80248A92 Val_Wu8 3.00000000000 DDRC_Ratio 1.00000000000 4.00000000000 FORMAT "%13.11" /end CHARACTERISTIC
/begin CHARACTERISTIC DDRC_RatDeb.HeatrCoreT_tiPhysRngHiUDRat_C "" VALUE 0x80248A93 Val_Wu8 3.00000000000 DDRC_Ratio 1.00000000000 4.00000000000 FORMAT "%13.11" /end CHARACTERISTIC
/begin CHARACTERISTIC DDRC_RatDeb.HeatrCoreT_tiPhysRngLoUDRat_C "" VALUE 0x80248A94 Val_Wu8 3.00000000000 DDRC_Ratio 1.00000000000 4.00000000000 FORMAT "%13.11" /end CHARACTERISTIC
/begin CHARACTERISTIC DDRC_RatDeb.HeatrCoreT_tiSRCOpnUDRat_C "" VALUE 0x80248A95 Val_Wu8 3.00000000000 DDRC_Ratio 1.00000000000 4.00000000000 FORMAT "%13.11" /end CHARACTERISTIC
/begin CHARACTERISTIC DFC_CtlMsk2.DFC_HLCCcsFwDwnl_C "" VALUE 0x8024136C Val_Wu8 255.0 DFES_OneToOne 0.00 255.0 FORMAT "%5.1" /end CHARACTERISTIC
/begin CHARACTERISTIC DFC_CtlMsk2.DFC_HvBattIReqToChrgrErr_C "" VALUE 0x80241374 Val_Wu8 255.0 DFES_OneToOne 0.00 255.0 FORMAT "%5.1" /end CHARACTERISTIC
/begin CHARACTERISTIC DFC_CtlMsk2.DFC_HvBattIReqToChrgrIni_C "" VALUE 0x80241375 Val_Wu8 255.0 DFES_OneToOne 0.00 255.0 FORMAT "%5.1" /end CHARACTERISTIC
/begin CHARACTERISTIC DFC_CtlMsk2.DFC_HvBattUNomChrgnErr_C "" VALUE 0x8024138A Val_Wu8 255.0 DFES_OneToOne 0.00 255.0 FORMAT "%5.1" /end CHARACTERISTIC
/begin CHARACTERISTIC DFC_CtlMsk2.DFC_HvBattUNomChrgnIni_C "" VALUE 0x8024138B Val_Wu8 255.0 DFES_OneToOne 0.00 255.0 FORMAT "%5.1" /end CHARACTERISTIC
/begin CHARACTERISTIC DFC_CtlMsk2.DFC_FanRlySCB_C "" VALUE 0x8024151B Val_Wu8 255.0 DFES_OneToOne 0.00 255.0 FORMAT "%5.1" /end CHARACTERISTIC
/begin CHARACTERISTIC DFC_CtlMsk2.DFC_FanRlySCG_C "" VALUE 0x8024151C Val_Wu8 255.0 DFES_OneToOne 0.00 255.0 FORMAT "%5.1" /end CHARACTERISTIC
/begin CHARACTERISTIC DFC_CtlMsk2.DFC_FreonPSRCMin_C "" VALUE 0x8024151E Val_Wu8 255.0 DFES_OneToOne 0.00 255.0 FORMAT "%5.1" /end CHARACTERISTIC
/begin CHARACTERISTIC DFC_CtlMsk2.DFC_HLCCcsPLnCChipTHi_C "" VALUE 0x8024151F Val_Wu8 255.0 DFES_OneToOne 0.00 255.0 FORMAT "%5.1" /end CHARACTERISTIC
/begin CHARACTERISTIC DFC_CtlMsk2.DFC_HeatrCoreTSRCMin_C "" VALUE 0x80241520 Val_Wu8 255.0 DFES_OneToOne 0.00 255.0 FORMAT "%5.1" /end CHARACTERISTIC
/begin CHARACTERISTIC DFC_CtlMsk2.DFC_FanSpdPhysRngHi_C "" VALUE 0x80241546 Val_Wu8 255.0 DFES_OneToOne 0.00 255.0 FORMAT "%5.1" /end CHARACTERISTIC
/begin CHARACTERISTIC DFC_CtlMsk2.DFC_FanSpdPhysRngLo_C "" VALUE 0x80241547 Val_Wu8 255.0 DFES_OneToOne 0.00 255.0 FORMAT "%5.1" /end CHARACTERISTIC
/begin CHARACTERISTIC DFC_CtlMsk2.DFC_FreonPPhysRngHi_C "" VALUE 0x80241549 Val_Wu8 255.0 DFES_OneToOne 0.00 255.0 FORMAT "%5.1" /end CHARACTERISTIC
/begin CHARACTERISTIC DFC_CtlMsk2.DFC_FreonPPhysRngLo_C "" VALUE 0x8024154A Val_Wu8 255.0 DFES_OneToOne 0.00 255.0 FORMAT "%5.1" /end CHARACTERISTIC
/begin CHARACTERISTIC DFC_CtlMsk2.DFC_FreonPSRCOpn_C "" VALUE 0x8024154B Val_Wu8 255.0 DFES_OneToOne 0.00 255.0 FORMAT "%5.1" /end CHARACTERISTIC
/begin CHARACTERISTIC DFC_CtlMsk2.DFC_HeatrCoreTPhysRngHi_C "" VALUE 0x8024154C Val_Wu8 255.0 DFES_OneToOne 0.00 255.0 FORMAT "%5.1" /end CHARACTERISTIC
/begin CHARACTERISTIC DFC_CtlMsk2.DFC_HeatrCoreTPhysRngLo_C "" VALUE 0x8024154D Val_Wu8 255.0 DFES_OneToOne 0.00 255.0 FORMAT "%5.1" /end CHARACTERISTIC
/begin CHARACTERISTIC DFC_CtlMsk2.DFC_HeatrCoreTSRCOpn_C "" VALUE 0x8024154E Val_Wu8 255.0 DFES_OneToOne 0.00 255.0 FORMAT "%5.1" /end CHARACTERISTIC
/begin CHARACTERISTIC DFC_CtlMsk2.DFC_ComVCInval_C "" VALUE 0x80241599 Val_Wu8 255.0 DFES_OneToOne 0.00 255.0 FORMAT "%5.1" /end CHARACTERISTIC
/begin CHARACTERISTIC DFC_CtlMsk2.DFC_FanMaxOvrd_C "" VALUE 0x8024159C Val_Wu8 255.0 DFES_OneToOne 0.00 255.0 FORMAT "%5.1" /end CHARACTERISTIC
/begin CHARACTERISTIC DFC_CtlMsk2.DFC_HLCCcsGnrlComErr_C "" VALUE 0x8024159D Val_Wu8 255.0 DFES_OneToOne 0.00 255.0 FORMAT "%5.1" /end CHARACTERISTIC
/begin CHARACTERISTIC DFC_CtlMsk2.DFC_AcFlt_C "" VALUE 0x802415CC Val_Wu8 255.0 DFES_OneToOne 0.00 255.0 FORMAT "%5.1" /end CHARACTERISTIC
/begin CHARACTERISTIC DFC_CtlMsk2.DFC_FanSpdTmpErr_C "" VALUE 0x802415F4 Val_Wu8 255.0 DFES_OneToOne 0.00 255.0 FORMAT "%5.1" /end CHARACTERISTIC
/begin CHARACTERISTIC DFC_CtlMsk2.DFC_FreonPSRCMax_C "" VALUE 0x802415F5 Val_Wu8 255.0 DFES_OneToOne 0.00 255.0 FORMAT "%5.1" /end CHARACTERISTIC
/begin CHARACTERISTIC DFC_CtlMsk2.DFC_FreonPTmpErr_C "" VALUE 0x802415F6 Val_Wu8 255.0 DFES_OneToOne 0.00 255.0 FORMAT "%5.1" /end CHARACTERISTIC
/begin CHARACTERISTIC DFC_CtlMsk2.DFC_HeatrCoreTSRCMax_C "" VALUE 0x802415F7 Val_Wu8 255.0 DFES_OneToOne 0.00 255.0 FORMAT "%5.1" /end CHARACTERISTIC
/begin CHARACTERISTIC DFC_CtlMsk2.DFC_HeatrCoreTTmpErr_C "" VALUE 0x802415F8 Val_Wu8 255.0 DFES_OneToOne 0.00 255.0 FORMAT "%5.1" /end CHARACTERISTIC
/begin CHARACTERISTIC DFC_CtlMsk2.DFC_HvacBlwrFrntFlt_C "" VALUE 0x802415FA Val_Wu8 255.0 DFES_OneToOne 0.00 255.0 FORMAT "%5.1" /end CHARACTERISTIC
/begin CHARACTERISTIC DFC_CtlMsk2.DFC_HvacEvapElecFlt_C "" VALUE 0x802415FB Val_Wu8 255.0 DFES_OneToOne 0.00 255.0 FORMAT "%5.1" /end CHARACTERISTIC
/begin CHARACTERISTIC DFC_CtlMsk2.DFC_HvacEvapElecFltGnd_C "" VALUE 0x802415FC Val_Wu8 255.0 DFES_OneToOne 0.00 255.0 FORMAT "%5.1" /end CHARACTERISTIC
/begin CHARACTERISTIC DFC_CtlMsk2.DFC_HvacKnobPosnFlt_C "" VALUE 0x802415FD Val_Wu8 255.0 DFES_OneToOne 0.00 255.0 FORMAT "%5.1" /end CHARACTERISTIC
/begin CHARACTERISTIC DFC_DisblMsk2.DFC_HLCCcsFwDwnl_C "" VALUE 0x80248BBE Val_Wu16 65535.00 DFES_OneToOne 0.00 65535.00 FORMAT "%8.2" /end CHARACTERISTIC
/begin CHARACTERISTIC DFC_DisblMsk2.DFC_HvBattIReqToChrgrErr_C "" VALUE 0x80248BCE Val_Wu16 65535.00 DFES_OneToOne 0.00 65535.00 FORMAT "%8.2" /end CHARACTERISTIC
/begin CHARACTERISTIC DFC_DisblMsk2.DFC_HvBattIReqToChrgrIni_C "" VALUE 0x80248BD0 Val_Wu16 65535.00 DFES_OneToOne 0.00 65535.00 FORMAT "%8.2" /end CHARACTERISTIC
/begin CHARACTERISTIC DFC_DisblMsk2.DFC_HvBattUNomChrgnErr_C "" VALUE 0x80248BFA Val_Wu16 65535.00 DFES_OneToOne 0.00 65535.00 FORMAT "%8.2" /end CHARACTERISTIC
/begin CHARACTERISTIC DFC_DisblMsk2.DFC_HvBattUNomChrgnIni_C "" VALUE 0x80248BFC Val_Wu16 65535.00 DFES_OneToOne 0.00 65535.00 FORMAT "%8.2" /end CHARACTERISTIC
/begin CHARACTERISTIC DFC_DisblMsk2.DFC_FanRlySCB_C "" VALUE 0x80248F1C Val_Wu16 65535.00 DFES_OneToOne 0.00 65535.00 FORMAT "%8.2" /end CHARACTERISTIC
/begin CHARACTERISTIC DFC_DisblMsk2.DFC_FanRlySCG_C "" VALUE 0x80248F1E Val_Wu16 65535.00 DFES_OneToOne 0.00 65535.00 FORMAT "%8.2" /end CHARACTERISTIC
/begin CHARACTERISTIC DFC_DisblMsk2.DFC_FreonPSRCMin_C "" VALUE 0x80248F22 Val_Wu16 65535.00 DFES_OneToOne 0.00 65535.00 FORMAT "%8.2" /end CHARACTERISTIC
/begin CHARACTERISTIC DFC_DisblMsk2.DFC_HLCCcsPLnCChipTHi_C "" VALUE 0x80248F24 Val_Wu16 65535.00 DFES_OneToOne 0.00 65535.00 FORMAT "%8.2" /end CHARACTERISTIC
/begin CHARACTERISTIC DFC_DisblMsk2.DFC_HeatrCoreTSRCMin_C "" VALUE 0x80248F26 Val_Wu16 65535.00 DFES_OneToOne 0.00 65535.00 FORMAT "%8.2" /end CHARACTERISTIC
/begin CHARACTERISTIC DFC_DisblMsk2.DFC_FanSpdPhysRngHi_C "" VALUE 0x80248F72 Val_Wu16 65535.00 DFES_OneToOne 0.00 65535.00 FORMAT "%8.2" /end CHARACTERISTIC
/begin CHARACTERISTIC DFC_DisblMsk2.DFC_FanSpdPhysRngLo_C "" VALUE 0x80248F74 Val_Wu16 65535.00 DFES_OneToOne 0.00 65535.00 FORMAT "%8.2" /end CHARACTERISTIC
/begin CHARACTERISTIC DFC_DisblMsk2.DFC_FreonPPhysRngHi_C "" VALUE 0x80248F78 Val_Wu16 65535.00 DFES_OneToOne 0.00 65535.00 FORMAT "%8.2" /end CHARACTERISTIC
/begin CHARACTERISTIC DFC_DisblMsk2.DFC_FreonPPhysRngLo_C "" VALUE 0x80248F7A Val_Wu16 65535.00 DFES_OneToOne 0.00 65535.00 FORMAT "%8.2" /end CHARACTERISTIC
/begin CHARACTERISTIC DFC_DisblMsk2.DFC_FreonPSRCOpn_C "" VALUE 0x80248F7C Val_Wu16 65535.00 DFES_OneToOne 0.00 65535.00 FORMAT "%8.2" /end CHARACTERISTIC
/begin CHARACTERISTIC DFC_DisblMsk2.DFC_HeatrCoreTPhysRngHi_C "" VALUE 0x80248F7E Val_Wu16 65535.00 DFES_OneToOne 0.00 65535.00 FORMAT "%8.2" /end CHARACTERISTIC
/begin CHARACTERISTIC DFC_DisblMsk2.DFC_HeatrCoreTPhysRngLo_C "" VALUE 0x80248F80 Val_Wu16 65535.00 DFES_OneToOne 0.00 65535.00 FORMAT "%8.2" /end CHARACTERISTIC
/begin CHARACTERISTIC DFC_DisblMsk2.DFC_HeatrCoreTSRCOpn_C "" VALUE 0x80248F82 Val_Wu16 65535.00 DFES_OneToOne 0.00 65535.00 FORMAT "%8.2" /end CHARACTERISTIC
/begin CHARACTERISTIC DFC_DisblMsk2.DFC_ComVCInval_C "" VALUE 0x80249018 Val_Wu16 65535.00 DFES_OneToOne 0.00 65535.00 FORMAT "%8.2" /end CHARACTERISTIC
/begin CHARACTERISTIC DFC_DisblMsk2.DFC_FanMaxOvrd_C "" VALUE 0x8024901E Val_Wu16 65535.00 DFES_OneToOne 0.00 65535.00 FORMAT "%8.2" /end CHARACTERISTIC
/begin CHARACTERISTIC DFC_DisblMsk2.DFC_HLCCcsGnrlComErr_C "" VALUE 0x80249020 Val_Wu16 65535.00 DFES_OneToOne 0.00 65535.00 FORMAT "%8.2" /end CHARACTERISTIC
/begin CHARACTERISTIC DFC_DisblMsk2.DFC_AcFlt_C "" VALUE 0x8024907E Val_Wu16 65535.00 DFES_OneToOne 0.00 65535.00 FORMAT "%8.2" /end CHARACTERISTIC
/begin CHARACTERISTIC DFC_DisblMsk2.DFC_FanSpdTmpErr_C "" VALUE 0x802490CE Val_Wu16 65535.00 DFES_OneToOne 0.00 65535.00 FORMAT "%8.2" /end CHARACTERISTIC
/begin CHARACTERISTIC DFC_DisblMsk2.DFC_FreonPSRCMax_C "" VALUE 0x802490D0 Val_Wu16 65535.00 DFES_OneToOne 0.00 65535.00 FORMAT "%8.2" /end CHARACTERISTIC
/begin CHARACTERISTIC DFC_DisblMsk2.DFC_FreonPTmpErr_C "" VALUE 0x802490D2 Val_Wu16 65535.00 DFES_OneToOne 0.00 65535.00 FORMAT "%8.2" /end CHARACTERISTIC
/begin CHARACTERISTIC DFC_DisblMsk2.DFC_HeatrCoreTSRCMax_C "" VALUE 0x802490D4 Val_Wu16 65535.00 DFES_OneToOne 0.00 65535.00 FORMAT "%8.2" /end CHARACTERISTIC
/begin CHARACTERISTIC DFC_DisblMsk2.DFC_HeatrCoreTTmpErr_C "" VALUE 0x802490D6 Val_Wu16 65535.00 DFES_OneToOne 0.00 65535.00 FORMAT "%8.2" /end CHARACTERISTIC
/begin CHARACTERISTIC DFC_DisblMsk2.DFC_HvacBlwrFrntFlt_C "" VALUE 0x802490DA Val_Wu16 65535.00 DFES_OneToOne 0.00 65535.00 FORMAT "%8.2" /end CHARACTERISTIC
/begin CHARACTERISTIC DFC_DisblMsk2.DFC_HvacEvapElecFlt_C "" VALUE 0x802490DC Val_Wu16 65535.00 DFES_OneToOne 0.00 65535.00 FORMAT "%8.2" /end CHARACTERISTIC
/begin CHARACTERISTIC DFC_DisblMsk2.DFC_HvacEvapElecFltGnd_C "" VALUE 0x802490DE Val_Wu16 65535.00 DFES_OneToOne 0.00 65535.00 FORMAT "%8.2" /end CHARACTERISTIC
/begin CHARACTERISTIC DFC_DisblMsk2.DFC_HvacKnobPosnFlt_C "" VALUE 0x802490E0 Val_Wu16 65535.00 DFES_OneToOne 0.00 65535.00 FORMAT "%8.2" /end CHARACTERISTIC
/begin CHARACTERISTIC FanSpd_DigSensCal.tiDebPos_C " / debounce time of rising edge" VALUE 0x8025F660 Val_Ws16 655350.0 Time_ms -327680.0 327670.0 FORMAT "%8.1" /end CHARACTERISTIC
/begin CHARACTERISTIC FanSpd_DigSensCal.tiDebNeg_C " / debounce time of falling edge" VALUE 0x8025F662 Val_Ws16 655350.0 Time_ms -327680.0 327670.0 FORMAT "%8.1" /end CHARACTERISTIC
/begin CHARACTERISTIC FanSpd_dnActGradLim_f_C "" VALUE 0x8025F664 Val_Wr32 2.00000000E+037 RBPtCel_nGrdt_1p0_1 -1.00000000E+037 1.00000000E+037 FORMAT "%13.3" EXTENDED_LIMITS -3.40282347E+038 3.40282347E+038 /end CHARACTERISTIC
/begin CHARACTERISTIC FanSpd_nActDflVal_f_C "" VALUE 0x8025F668 Val_Wr32 2.00000000E+037 RBPtCel_n_1p0_1 -1.00000000E+037 1.00000000E+037 FORMAT "%13.3" EXTENDED_LIMITS -3.40282347E+038 3.40282347E+038 /end CHARACTERISTIC
/begin CHARACTERISTIC FanSpd_nActEnhPhysSRCMax_f_MAP "" MAP 0x8025F688 RB_Map_S16S16_R32_sao 2.00000000E+037 RBPtCel_n_1p0_1 -1.00000000E+037 1.00000000E+037 FORMAT "%13.3" EXTENDED_LIMITS -3.40282347E+038 3.40282347E+038
 /begin AXIS_DESCR STD_AXIS Epm_nEng EngN 25 -16384.00 16383.50 FORMAT "%8.2" DEPOSIT ABSOLUTE /end AXIS_DESCR
 /begin AXIS_DESCR STD_AXIS InjCtl_qSetUnBal InjMass 25 -327.6800 327.6700 FORMAT "%8.4" DEPOSIT ABSOLUTE /end AXIS_DESCR
/end CHARACTERISTIC
/begin CHARACTERISTIC FanSpd_nActEnhPhysSRCMin_f_MAP "" MAP 0x802600B4 RB_Map_S16S16_R32_sao 2.00000000E+037 RBPtCel_n_1p0_1 -1.00000000E+037 1.00000000E+037 FORMAT "%13.3" EXTENDED_LIMITS -3.40282347E+038 3.40282347E+038
 /begin AXIS_DESCR STD_AXIS Epm_nEng EngN 25 -16384.00 16383.50 FORMAT "%8.2" DEPOSIT ABSOLUTE /end AXIS_DESCR
 /begin AXIS_DESCR STD_AXIS InjCtl_qSetUnBal InjMass 25 -327.6800 327.6700 FORMAT "%8.4" DEPOSIT ABSOLUTE /end AXIS_DESCR
/end CHARACTERISTIC
/begin CHARACTERISTIC FanSpd_nActHiLimit_f_C "" VALUE 0x8025F66C Val_Wr32 2.00000000E+037 RBPtCel_n_1p0_1 -1.00000000E+037 1.00000000E+037 FORMAT "%13.3" EXTENDED_LIMITS -3.40282347E+038 3.40282347E+038 /end CHARACTERISTIC
/begin CHARACTERISTIC FanSpd_nActLoLimit_f_C "" VALUE 0x8025F670 Val_Wr32 2.00000000E+037 RBPtCel_n_1p0_1 -1.00000000E+037 1.00000000E+037 FORMAT "%13.3" EXTENDED_LIMITS -3.40282347E+038 3.40282347E+038 /end CHARACTERISTIC
/begin CHARACTERISTIC FanSpd_numStdSens_C "" VALUE 0x80260AE0 Val_Wu32 4294967295.00 OneToOne 0.00 4294967295.00 FORMAT "%13.2" /end CHARACTERISTIC
/begin CHARACTERISTIC FanSpd_numTempErrDef_C "" VALUE 0x80260AE4 Val_Wu8 255.0 OneToOne 0.00 255.0 FORMAT "%5.1" /end CHARACTERISTIC
/begin CHARACTERISTIC FanSpd_numtSel_C "" VALUE 0x80260AE6 Val_Wu16 255.000000000 DELIB_ALLTEMP_VERB_COMPU 0.00 255.000000000 FORMAT "%13.9" /end CHARACTERISTIC
/begin CHARACTERISTIC FanSpd_RmpSlp_f.Pos_C " / Positive ramp slope dy/dt" VALUE 0x8025F674 Kw_Wr32 2.00000000E+038 RBPtCel_nGrdt_1p0_1 -1.00000000E+038 1.00000000E+038 FORMAT "%13.3" EXTENDED_LIMITS -3.40282347E+038 3.40282347E+038 /end CHARACTERISTIC
/begin CHARACTERISTIC FanSpd_RmpSlp_f.Neg_C " / Negative ramp slope dy/dt" VALUE 0x8025F678 Kw_Wr32 2.00000000E+038 RBPtCel_nGrdt_1p0_1 -1.00000000E+038 1.00000000E+038 FORMAT "%13.3" EXTENDED_LIMITS -3.40282347E+038 3.40282347E+038 /end CHARACTERISTIC
/begin CHARACTERISTIC FanSpd_stEnhPhysSRCRls_MAP "" MAP 0x80260AE8 RB_Map_S16S16_U8_sao 255.0 OneToOne 0.00 255.0 FORMAT "%5.1"
 /begin AXIS_DESCR STD_AXIS Epm_nEng EngN 25 -16384.00 16383.50 FORMAT "%8.2" DEPOSIT ABSOLUTE /end AXIS_DESCR
 /begin AXIS_DESCR STD_AXIS InjCtl_qSetUnBal InjMass 25 -327.6800 327.6700 FORMAT "%8.4" DEPOSIT ABSOLUTE /end AXIS_DESCR
/end CHARACTERISTIC
/begin CHARACTERISTIC FanSpd_swtConfStdSens2_C "" VALUE 0x8025F64C Val_Wu32 4294967295.00 OneToOne 0.00 4294967295.00 FORMAT "%13.2" /end CHARACTERISTIC
/begin CHARACTERISTIC FanSpd_swtConfStdSensSwVers162_C "" VALUE 0x8025F650 Val_Wu32 4294967295.00 OneToOne 0.00 4294967295.00 FORMAT "%13.2" /end CHARACTERISTIC
/begin CHARACTERISTIC FanSpd_swtConfStdSens_C "" VALUE 0x8025F654 Val_Wu32 4294967295.00 OneToOne 0.00 4294967295.00 FORMAT "%13.2" /end CHARACTERISTIC
/begin CHARACTERISTIC FanSpd_tiEngOnMin_C "" VALUE 0x80260DC4 Val_Wu32 42949672950.0 Time_ms 0.00 42949672950.0 FORMAT "%13.1" /end CHARACTERISTIC
/begin CHARACTERISTIC FanSpd_tiPT1_f_C "" VALUE 0x8025F67C Val_Wr32 2.00000000E+037 RBPtCel_ti_1p0_2 -1.00000000E+037 1.00000000E+037 FORMAT "%13.3" EXTENDED_LIMITS -3.40282347E+038 3.40282347E+038 /end CHARACTERISTIC
/begin CHARACTERISTIC FanSpd_tiTempErrOk_C "" VALUE 0x80260DC8 Val_Ws16 655350.0 Time_ms -327680.0 327670.0 FORMAT "%8.1" /end CHARACTERISTIC
/begin CHARACTERISTIC FanSpd_TransStg_f.Dfl_r32_C " / This is SW-CALPRM-PROTOTYPE" VALUE 0x8025F680 Kw_Wr32 2.00000000E+037 RBPtCel_n_1p0_1 -1.00000000E+037 1.00000000E+037 FORMAT "%13.3" EXTENDED_LIMITS -3.40282347E+038 3.40282347E+038 /end CHARACTERISTIC
/begin CHARACTERISTIC FanSpd_TransStg_f.stSensId_C " / This is SW-CALPRM-PROTOTYPE" VALUE 0x8025F684 Kw_Wu8 255.0 OneToOne 0.00 255.0 FORMAT "%5.1" /end CHARACTERISTIC
/begin CHARACTERISTIC FanSpd_tSnsrMax_f_C "" VALUE 0x80260DCC Val_Wr32 2.00000000E+037 RBPtCel_t_1p0_3 -1.00000000E+037 1.00000000E+037 FORMAT "%13.3" EXTENDED_LIMITS -3.40282347E+038 3.40282347E+038 /end CHARACTERISTIC
/begin CHARACTERISTIC FanSpd_tSnsrMin_f_C "" VALUE 0x80260DD0 Val_Wr32 2.00000000E+037 RBPtCel_t_1p0_3 -1.00000000E+037 1.00000000E+037 FORMAT "%13.3" EXTENDED_LIMITS -3.40282347E+038 3.40282347E+038 /end CHARACTERISTIC
/begin CHARACTERISTIC Fans_facAmbCorrn_T "Ambient temperature correction factor" CURVE 0x80250950 RB_Curve_S16_U8_sao 2.550 RBPtCel_fac_0p01_1 0.00 2.550 FORMAT "%5.3"
 /begin AXIS_DESCR STD_AXIS EnvT_t Temp_Cels 4 -3549.940 3003.560 FORMAT "%8.3" DEPOSIT ABSOLUTE /end AXIS_DESCR
/end CHARACTERISTIC
/begin CHARACTERISTIC Fans_facVelCorrn_T "Vehicle speed correction factor" CURVE 0x8025095E RB_Curve_S16_U8_sao 2.550 RBPtCel_fac_0p01_1 0.00 2.550 FORMAT "%5.3"
 /begin AXIS_DESCR STD_AXIS VehV_v Vel 4 -327.6800 327.6700 FORMAT "%8.4" DEPOSIT ABSOLUTE /end AXIS_DESCR
/end CHARACTERISTIC
/begin CHARACTERISTIC Fans_maskEnvTVldySq_C "Calibration mask to calculate validity of environment temperature." VALUE 0x8025096C RB_Val_Wu16 65535.00 OneToOne 0.00 65535.00 FORMAT "%8.2" /end CHARACTERISTIC
/begin CHARACTERISTIC Fans_maskVehSpdVldySq_C "Calibration mask to calculate validity of vehicle speed." VALUE 0x8025096E RB_Val_Wu16 65535.00 OneToOne 0.00 65535.00 FORMAT "%8.2" /end CHARACTERISTIC
/begin CHARACTERISTIC Fans_NegVal_C "Negative slope for fan cooling demand." VALUE 0x80250970 RB_Val_Wu32 65535.9999847 q1p52588Em5_Perc_DIV_s 0.00 65535.9999847 FORMAT "%13.7" /end CHARACTERISTIC
/begin CHARACTERISTIC Fans_PosVal_C "Positive slope for fan cooling demand." VALUE 0x80250974 RB_Val_Wu32 65535.9999847 q1p52588Em5_Perc_DIV_s 0.00 65535.9999847 FORMAT "%13.7" /end CHARACTERISTIC
/begin CHARACTERISTIC Fans_stFan1Alc_C "state to select the fan requests for fan 1" VALUE 0x80250978 RB_Val_Wu16 65535.00 OneToOne 0.00 65535.00 FORMAT "%8.2" /end CHARACTERISTIC
/begin CHARACTERISTIC Fan_stVehStDiagEna_C "Vehicle state selection to activate diagnosis" VALUE 0x8025094C RB_Val_Wu8 255.0 q1 0.00 255.0 FORMAT "%5.1" /end CHARACTERISTIC
/begin CHARACTERISTIC Fan_tiActvnIniDly_C "Calibration of Activation init Delay" VALUE 0x8025094D RB_Val_Ws8 25.5000 q0p1_s -12.8000 12.7000 FORMAT "%8.4" /end CHARACTERISTIC
/begin CHARACTERISTIC Fan_tiDeactvnDly_C "Calibration of Deactivation init Delay" VALUE 0x8025094E RB_Val_Ws8 25.5000 q0p1_s -12.8000 12.7000 FORMAT "%8.4" /end CHARACTERISTIC
/begin CHARACTERISTIC FreonP_ADCCal.numSRCTempSel_C "Calibration structure for ADC and SENT / Selection of temperature for signal range check" VALUE 0x8025097C RB_Val_Wu8 255.000000000 DELIB_ALLTEMP_VERB_COMPU 0.00 255.000000000 FORMAT "%13.9" /end CHARACTERISTIC
/begin CHARACTERISTIC FreonP_ADCCal.tiSRCMaxDebOK_C "Calibration structure for ADC and SENT / Error healing deounce time" VALUE 0x80250980 RB_Val_Ws32 42949672950.0 Time_ms -21474836480.0 21474836470.0 FORMAT "%13.1" /end CHARACTERISTIC
/begin CHARACTERISTIC FreonP_ADCCal.uSRCMax_C "Calibration structure for ADC and SENT / Maximum threshold voltage for SRC" VALUE 0x80250984 RB_Val_Ws16 13107.00 Volt -6553.600 6553.400 FORMAT "%8.3" /end CHARACTERISTIC
/begin CHARACTERISTIC FreonP_ADCCal.uSRCMin_C "Calibration structure for ADC and SENT / Minimum threshold voltage for SRC" VALUE 0x80250986 RB_Val_Ws16 13107.00 Volt -6553.600 6553.400 FORMAT "%8.3" /end CHARACTERISTIC
/begin CHARACTERISTIC FreonP_ADCCal.uSRCOpn_C "Calibration structure for ADC and SENT / Maximum threshold for open SRC connection error." VALUE 0x80250988 RB_Val_Ws16 13107.00 Volt -6553.600 6553.400 FORMAT "%8.3" /end CHARACTERISTIC
/begin CHARACTERISTIC FreonP_ADCSensTransf_f_CUR "" CURVE 0x80260DD4 RB_Curve_R32_R32_sao 2.00000000E+037 RBPtCel_p_1p0_1 -1.00000000E+037 1.00000000E+037 FORMAT "%13.3" EXTENDED_LIMITS -3.40282347E+038 3.40282347E+038
 /begin AXIS_DESCR STD_AXIS FreonP_uRaw_f RBPtCel_u_1p0_2 25 -1.00000000E+037 1.00000000E+037 FORMAT "%13.3" EXTENDED_LIMITS -3.40282347E+038 3.40282347E+038 DEPOSIT ABSOLUTE /end AXIS_DESCR
/end CHARACTERISTIC
/begin CHARACTERISTIC FreonP_DigSensCal.tiDebPos_C " / debounce time of rising edge" VALUE 0x80260F58 Val_Ws16 655350.0 Time_ms -327680.0 327670.0 FORMAT "%8.1" /end CHARACTERISTIC
/begin CHARACTERISTIC FreonP_DigSensCal.tiDebNeg_C " / debounce time of falling edge" VALUE 0x80260F5A Val_Ws16 655350.0 Time_ms -327680.0 327670.0 FORMAT "%8.1" /end CHARACTERISTIC
/begin CHARACTERISTIC FreonP_dpGradLim_f_C "" VALUE 0x80260F5C Val_Wr32 2.00000000E+037 RBPtCel_dp_1p0_3 -1.00000000E+037 1.00000000E+037 FORMAT "%13.3" EXTENDED_LIMITS -3.40282347E+038 3.40282347E+038 /end CHARACTERISTIC
/begin CHARACTERISTIC FreonP_numStdSens_C "" VALUE 0x80260F80 Val_Wu32 4294967295.00 OneToOne 0.00 4294967295.00 FORMAT "%13.2" /end CHARACTERISTIC
/begin CHARACTERISTIC FreonP_numTempErrDef_C "" VALUE 0x80260F84 Val_Wu8 255.0 OneToOne 0.00 255.0 FORMAT "%5.1" /end CHARACTERISTIC
/begin CHARACTERISTIC FreonP_numtSel_C "" VALUE 0x80260F86 Val_Wu16 255.000000000 DELIB_ALLTEMP_VERB_COMPU 0.00 255.000000000 FORMAT "%13.9" /end CHARACTERISTIC
/begin CHARACTERISTIC FreonP_pDflVal_f_C "" VALUE 0x80260F60 Val_Wr32 2.00000000E+037 RBPtCel_p_1p0_1 -1.00000000E+037 1.00000000E+037 FORMAT "%13.3" EXTENDED_LIMITS -3.40282347E+038 3.40282347E+038 /end CHARACTERISTIC
/begin CHARACTERISTIC FreonP_pEnhPhysSRCMax_f_MAP "" MAP 0x80260F88 RB_Map_S16S16_R32_sao 2.00000000E+037 RBPtCel_p_1p0_1 -1.00000000E+037 1.00000000E+037 FORMAT "%13.3" EXTENDED_LIMITS -3.40282347E+038 3.40282347E+038
 /begin AXIS_DESCR STD_AXIS Epm_nEng EngN 25 -16384.00 16383.50 FORMAT "%8.2" DEPOSIT ABSOLUTE /end AXIS_DESCR
 /begin AXIS_DESCR STD_AXIS InjCtl_qSetUnBal InjMass 25 -327.6800 327.6700 FORMAT "%8.4" DEPOSIT ABSOLUTE /end AXIS_DESCR
/end CHARACTERISTIC
/begin CHARACTERISTIC FreonP_pEnhPhysSRCMin_f_MAP "" MAP 0x802619B4 RB_Map_S16S16_R32_sao 2.00000000E+037 RBPtCel_p_1p0_1 -1.00000000E+037 1.00000000E+037 FORMAT "%13.3" EXTENDED_LIMITS -3.40282347E+038 3.40282347E+038
 /begin AXIS_DESCR STD_AXIS Epm_nEng EngN 25 -16384.00 16383.50 FORMAT "%8.2" DEPOSIT ABSOLUTE /end AXIS_DESCR
 /begin AXIS_DESCR STD_AXIS InjCtl_qSetUnBal InjMass 25 -327.6800 327.6700 FORMAT "%8.4" DEPOSIT ABSOLUTE /end AXIS_DESCR
/end CHARACTERISTIC
/begin CHARACTERISTIC FreonP_pHiLimit_f_C "" VALUE 0x80260F64 Val_Wr32 2.00000000E+037 RBPtCel_p_1p0_1 -1.00000000E+037 1.00000000E+037 FORMAT "%13.3" EXTENDED_LIMITS -3.40282347E+038 3.40282347E+038 /end CHARACTERISTIC
/begin CHARACTERISTIC FreonP_pLoLimit_f_C "" VALUE 0x80260F68 Val_Wr32 2.00000000E+037 RBPtCel_p_1p0_1 -1.00000000E+037 1.00000000E+037 FORMAT "%13.3" EXTENDED_LIMITS -3.40282347E+038 3.40282347E+038 /end CHARACTERISTIC
/begin CHARACTERISTIC FreonP_RmpSlp_f.Pos_C " / Positive ramp slope dy/dt" VALUE 0x80260F6C Kw_Wr32 2.00000000E+038 RBPtCel_dp_1p0_3 -1.00000000E+038 1.00000000E+038 FORMAT "%13.3" EXTENDED_LIMITS -3.40282347E+038 3.40282347E+038 /end CHARACTERISTIC
/begin CHARACTERISTIC FreonP_RmpSlp_f.Neg_C " / Negative ramp slope dy/dt" VALUE 0x80260F70 Kw_Wr32 2.00000000E+038 RBPtCel_dp_1p0_3 -1.00000000E+038 1.00000000E+038 FORMAT "%13.3" EXTENDED_LIMITS -3.40282347E+038 3.40282347E+038 /end CHARACTERISTIC
/begin CHARACTERISTIC FreonP_stEnhPhysSRCRls_MAP "" MAP 0x802623E0 RB_Map_S16S16_U8_sao 255.0 OneToOne 0.00 255.0 FORMAT "%5.1"
 /begin AXIS_DESCR STD_AXIS Epm_nEng EngN 25 -16384.00 16383.50 FORMAT "%8.2" DEPOSIT ABSOLUTE /end AXIS_DESCR
 /begin AXIS_DESCR STD_AXIS InjCtl_qSetUnBal InjMass 25 -327.6800 327.6700 FORMAT "%8.4" DEPOSIT ABSOLUTE /end AXIS_DESCR
/end CHARACTERISTIC
/begin CHARACTERISTIC FreonP_swtConfStdSens2_C "" VALUE 0x80260F44 Val_Wu32 4294967295.00 OneToOne 0.00 4294967295.00 FORMAT "%13.2" /end CHARACTERISTIC
/begin CHARACTERISTIC FreonP_swtConfStdSensSwVers162_C "" VALUE 0x80260F48 Val_Wu32 4294967295.00 OneToOne 0.00 4294967295.00 FORMAT "%13.2" /end CHARACTERISTIC
/begin CHARACTERISTIC FreonP_swtConfStdSens_C "" VALUE 0x80260F4C Val_Wu32 4294967295.00 OneToOne 0.00 4294967295.00 FORMAT "%13.2" /end CHARACTERISTIC
/begin CHARACTERISTIC FreonP_tiEngOnMin_C "" VALUE 0x802626BC Val_Wu32 42949672950.0 Time_ms 0.00 42949672950.0 FORMAT "%13.1" /end CHARACTERISTIC
/begin CHARACTERISTIC FreonP_tiPT1Fil_C "" VALUE 0x80260F38 Val_Ws32 4294.9672940000000 TimeDelay_s 0.0000020000000 4294.9672959999998 FORMAT "%19.14" EXTENDED_LIMITS 0.000002000000001 4294.9672959999998 /end CHARACTERISTIC
/begin CHARACTERISTIC FreonP_tiPT1_f_C "" VALUE 0x80260F74 Val_Wr32 2.00000000E+037 RBPtCel_ti_1p0_2 -1.00000000E+037 1.00000000E+037 FORMAT "%13.3" EXTENDED_LIMITS -3.40282347E+038 3.40282347E+038 /end CHARACTERISTIC
/begin CHARACTERISTIC FreonP_tiSRCMaxDefDeb_CUR "" CURVE 0x80260EA0 RB_Curve_S16_S32_sao 42949672950.0 Time_ms -21474836480.0 21474836470.0 FORMAT "%13.1"
 /begin AXIS_DESCR STD_AXIS FreonP_tRefSnsr_mp Temp_Cels 25 -3549.940 3003.560 FORMAT "%8.3" DEPOSIT ABSOLUTE /end AXIS_DESCR
/end CHARACTERISTIC
/begin CHARACTERISTIC FreonP_tiTempErrOk_C "" VALUE 0x802626C0 Val_Ws16 655350.0 Time_ms -327680.0 327670.0 FORMAT "%8.1" /end CHARACTERISTIC
/begin CHARACTERISTIC FreonP_TransStg_f.Dfl_r32_C " / This is SW-CALPRM-PROTOTYPE" VALUE 0x80260F78 Kw_Wr32 2.00000000E+037 RBPtCel_p_1p0_1 -1.00000000E+037 1.00000000E+037 FORMAT "%13.3" EXTENDED_LIMITS -3.40282347E+038 3.40282347E+038 /end CHARACTERISTIC
/begin CHARACTERISTIC FreonP_TransStg_f.stSensId_C " / This is SW-CALPRM-PROTOTYPE" VALUE 0x80260F7C Kw_Wu8 255.0 OneToOne 0.00 255.0 FORMAT "%5.1" /end CHARACTERISTIC
/begin CHARACTERISTIC FreonP_tSnsrMax_f_C "" VALUE 0x802626C4 Val_Wr32 2.00000000E+037 RBPtCel_t_1p0_3 -1.00000000E+037 1.00000000E+037 FORMAT "%13.3" EXTENDED_LIMITS -3.40282347E+038 3.40282347E+038 /end CHARACTERISTIC
/begin CHARACTERISTIC FreonP_tSnsrMin_f_C "" VALUE 0x802626C8 Val_Wr32 2.00000000E+037 RBPtCel_t_1p0_3 -1.00000000E+037 1.00000000E+037 FORMAT "%13.3" EXTENDED_LIMITS -3.40282347E+038 3.40282347E+038 /end CHARACTERISTIC
/begin CHARACTERISTIC GlbDa_lDstLim_C "travelled distance, after which value will be written into EEPROM" VALUE 0x8025098C RB_Val_Ws32 2147473647.00 Length 10000.00 2147483647.00 FORMAT "%13.2" EXTENDED_LIMITS -2147483648.00 2147483647.00 /end CHARACTERISTIC
/begin CHARACTERISTIC GlbDa_maskVehVVldySq_C "Calibration mask to determine the vehicle speed signal validity" VALUE 0x80250990 RB_Val_Wu16 65535.00 OneToOne 0.00 65535.00 FORMAT "%8.2" /end CHARACTERISTIC
/begin CHARACTERISTIC GlbDa_numVarcodeTLC_C "Variantenkodierung Applikation für Telecoding Spezifikation" VALUE 0x80250994 Val_Wu8 255.0 OneToOne 0.00 255.0 FORMAT "%5.1" /end CHARACTERISTIC
/begin CHARACTERISTIC GlbDa_numVarcodeUCFrc_C "Calibration to allow selection of an option without doing a variant coding." VALUE 0x80250995 Val_Wu8 255.0 OneToOne 0.00 255.0 FORMAT "%5.1" /end CHARACTERISTIC
/begin CHARACTERISTIC GlbDa_numVarcodeUCPO_C "Variant coding Calibration for UCPO" VALUE 0x80250996 Val_Wu8 255.0 OneToOne 0.00 255.0 FORMAT "%5.1" /end CHARACTERISTIC
/begin CHARACTERISTIC HeatrCoreT_ADCCal.numSRCTempSel_C "Calibration structure for ADC and SENT / Selection of temperature for signal range check" VALUE 0x802509B8 RB_Val_Wu8 255.000000000 DELIB_ALLTEMP_VERB_COMPU 0.00 255.000000000 FORMAT "%13.9" /end CHARACTERISTIC
/begin CHARACTERISTIC HeatrCoreT_ADCCal.tiSRCMaxDebOK_C "Calibration structure for ADC and SENT / Error healing deounce time" VALUE 0x802509BC RB_Val_Ws32 42949672950.0 Time_ms -21474836480.0 21474836470.0 FORMAT "%13.1" /end CHARACTERISTIC
/begin CHARACTERISTIC HeatrCoreT_ADCCal.uSRCMax_C "Calibration structure for ADC and SENT / Maximum threshold voltage for SRC" VALUE 0x802509C0 RB_Val_Ws16 13107.00 Volt -6553.600 6553.400 FORMAT "%8.3" /end CHARACTERISTIC
/begin CHARACTERISTIC HeatrCoreT_ADCCal.uSRCMin_C "Calibration structure for ADC and SENT / Minimum threshold voltage for SRC" VALUE 0x802509C2 RB_Val_Ws16 13107.00 Volt -6553.600 6553.400 FORMAT "%8.3" /end CHARACTERISTIC
/begin CHARACTERISTIC HeatrCoreT_ADCCal.uSRCOpn_C "Calibration structure for ADC and SENT / Maximum threshold for open SRC connection error." VALUE 0x802509C4 RB_Val_Ws16 13107.00 Volt -6553.600 6553.400 FORMAT "%8.3" /end CHARACTERISTIC
/begin CHARACTERISTIC HeatrCoreT_ADCSensTransf_f_CUR "" CURVE 0x802626CC RB_Curve_R32_R32_sao 2.00000000E+037 RBPtCel_t_1p0_3 -1.00000000E+037 1.00000000E+037 FORMAT "%13.3" EXTENDED_LIMITS -3.40282347E+038 3.40282347E+038
 /begin AXIS_DESCR STD_AXIS HeatrCoreT_uRaw_f RBPtCel_u_1p0_2 25 -1.00000000E+037 1.00000000E+037 FORMAT "%13.3" EXTENDED_LIMITS -3.40282347E+038 3.40282347E+038 DEPOSIT ABSOLUTE /end AXIS_DESCR
/end CHARACTERISTIC
/begin CHARACTERISTIC HeatrCoreT_DigSensCal.tiDebPos_C " / debounce time of rising edge" VALUE 0x80262850 Val_Ws16 655350.0 Time_ms -327680.0 327670.0 FORMAT "%8.1" /end CHARACTERISTIC
/begin CHARACTERISTIC HeatrCoreT_DigSensCal.tiDebNeg_C " / debounce time of falling edge" VALUE 0x80262852 Val_Ws16 655350.0 Time_ms -327680.0 327670.0 FORMAT "%8.1" /end CHARACTERISTIC
/begin CHARACTERISTIC HeatrCoreT_dtGradLim_f_C "" VALUE 0x80262854 Val_Wr32 2.00000000E+037 RBPtCel_dt_1p0_1 -1.00000000E+037 1.00000000E+037 FORMAT "%13.3" EXTENDED_LIMITS -3.40282347E+038 3.40282347E+038 /end CHARACTERISTIC
/begin CHARACTERISTIC HeatrCoreT_numStdSens_C "" VALUE 0x80262878 Val_Wu32 4294967295.00 OneToOne 0.00 4294967295.00 FORMAT "%13.2" /end CHARACTERISTIC
/begin CHARACTERISTIC HeatrCoreT_numTempErrDef_C "" VALUE 0x8026287C Val_Wu8 255.0 OneToOne 0.00 255.0 FORMAT "%5.1" /end CHARACTERISTIC
/begin CHARACTERISTIC HeatrCoreT_numtSel_C "" VALUE 0x8026287E Val_Wu16 255.000000000 DELIB_ALLTEMP_VERB_COMPU 0.00 255.000000000 FORMAT "%13.9" /end CHARACTERISTIC
/begin CHARACTERISTIC HeatrCoreT_RmpSlp_f.Pos_C " / Positive ramp slope dy/dt" VALUE 0x80262858 Kw_Wr32 2.00000000E+038 RBPtCel_dt_1p0_1 -1.00000000E+038 1.00000000E+038 FORMAT "%13.3" EXTENDED_LIMITS -3.40282347E+038 3.40282347E+038 /end CHARACTERISTIC
/begin CHARACTERISTIC HeatrCoreT_RmpSlp_f.Neg_C " / Negative ramp slope dy/dt" VALUE 0x8026285C Kw_Wr32 2.00000000E+038 RBPtCel_dt_1p0_1 -1.00000000E+038 1.00000000E+038 FORMAT "%13.3" EXTENDED_LIMITS -3.40282347E+038 3.40282347E+038 /end CHARACTERISTIC
/begin CHARACTERISTIC HeatrCoreT_stEnhPhysSRCRls_MAP "" MAP 0x80262880 RB_Map_S16S16_U8_sao 255.0 OneToOne 0.00 255.0 FORMAT "%5.1"
 /begin AXIS_DESCR STD_AXIS Epm_nEng EngN 25 -16384.00 16383.50 FORMAT "%8.2" DEPOSIT ABSOLUTE /end AXIS_DESCR
 /begin AXIS_DESCR STD_AXIS InjCtl_qSetUnBal InjMass 25 -327.6800 327.6700 FORMAT "%8.4" DEPOSIT ABSOLUTE /end AXIS_DESCR
/end CHARACTERISTIC
/begin CHARACTERISTIC HeatrCoreT_swtConfStdSens2_C "" VALUE 0x8026283C Val_Wu32 4294967295.00 OneToOne 0.00 4294967295.00 FORMAT "%13.2" /end CHARACTERISTIC
/begin CHARACTERISTIC HeatrCoreT_swtConfStdSensSwVers162_C "" VALUE 0x80262840 Val_Wu32 4294967295.00 OneToOne 0.00 4294967295.00 FORMAT "%13.2" /end CHARACTERISTIC
/begin CHARACTERISTIC HeatrCoreT_swtConfStdSens_C "" VALUE 0x80262844 Val_Wu32 4294967295.00 OneToOne 0.00 4294967295.00 FORMAT "%13.2" /end CHARACTERISTIC
/begin CHARACTERISTIC HeatrCoreT_tDflVal_f_C "" VALUE 0x80262860 Val_Wr32 2.00000000E+037 RBPtCel_t_1p0_3 -1.00000000E+037 1.00000000E+037 FORMAT "%13.3" EXTENDED_LIMITS -3.40282347E+038 3.40282347E+038 /end CHARACTERISTIC
/begin CHARACTERISTIC HeatrCoreT_tEnhPhysSRCMax_f_MAP "" MAP 0x80262B5C RB_Map_S16S16_R32_sao 2.00000000E+037 RBPtCel_t_1p0_3 -1.00000000E+037 1.00000000E+037 FORMAT "%13.3" EXTENDED_LIMITS -3.40282347E+038 3.40282347E+038
 /begin AXIS_DESCR STD_AXIS Epm_nEng EngN 25 -16384.00 16383.50 FORMAT "%8.2" DEPOSIT ABSOLUTE /end AXIS_DESCR
 /begin AXIS_DESCR STD_AXIS InjCtl_qSetUnBal InjMass 25 -327.6800 327.6700 FORMAT "%8.4" DEPOSIT ABSOLUTE /end AXIS_DESCR
/end CHARACTERISTIC
/begin CHARACTERISTIC HeatrCoreT_tEnhPhysSRCMin_f_MAP "" MAP 0x80263588 RB_Map_S16S16_R32_sao 2.00000000E+037 RBPtCel_t_1p0_3 -1.00000000E+037 1.00000000E+037 FORMAT "%13.3" EXTENDED_LIMITS -3.40282347E+038 3.40282347E+038
 /begin AXIS_DESCR STD_AXIS Epm_nEng EngN 25 -16384.00 16383.50 FORMAT "%8.2" DEPOSIT ABSOLUTE /end AXIS_DESCR
 /begin AXIS_DESCR STD_AXIS InjCtl_qSetUnBal InjMass 25 -327.6800 327.6700 FORMAT "%8.4" DEPOSIT ABSOLUTE /end AXIS_DESCR
/end CHARACTERISTIC
/begin CHARACTERISTIC HeatrCoreT_tHiLimit_f_C "" VALUE 0x80262864 Val_Wr32 2.00000000E+037 RBPtCel_t_1p0_3 -1.00000000E+037 1.00000000E+037 FORMAT "%13.3" EXTENDED_LIMITS -3.40282347E+038 3.40282347E+038 /end CHARACTERISTIC
/begin CHARACTERISTIC HeatrCoreT_tiEngOnMin_C "" VALUE 0x80263FB4 Val_Wu32 42949672950.0 Time_ms 0.00 42949672950.0 FORMAT "%13.1" /end CHARACTERISTIC
/begin CHARACTERISTIC HeatrCoreT_tiPT1Fil_C "" VALUE 0x80262830 Val_Ws32 4294.9672940000000 TimeDelay_s 0.0000020000000 4294.9672959999998 FORMAT "%19.14" EXTENDED_LIMITS 0.000002000000001 4294.9672959999998 /end CHARACTERISTIC
/begin CHARACTERISTIC HeatrCoreT_tiPT1_f_C "" VALUE 0x80262868 Val_Wr32 2.00000000E+037 RBPtCel_ti_1p0_2 -1.00000000E+037 1.00000000E+037 FORMAT "%13.3" EXTENDED_LIMITS -3.40282347E+038 3.40282347E+038 /end CHARACTERISTIC
/begin CHARACTERISTIC HeatrCoreT_tiSRCMaxDefDeb_CUR "" CURVE 0x80262798 RB_Curve_S16_S32_sao 42949672950.0 Time_ms -21474836480.0 21474836470.0 FORMAT "%13.1"
 /begin AXIS_DESCR STD_AXIS HeatrCoreT_tRefSnsr_mp Temp_Cels 25 -3549.940 3003.560 FORMAT "%8.3" DEPOSIT ABSOLUTE /end AXIS_DESCR
/end CHARACTERISTIC
/begin CHARACTERISTIC HeatrCoreT_tiTempErrOk_C "" VALUE 0x80263FB8 Val_Ws16 655350.0 Time_ms -327680.0 327670.0 FORMAT "%8.1" /end CHARACTERISTIC
/begin CHARACTERISTIC HeatrCoreT_tLoLimit_f_C "" VALUE 0x8026286C Val_Wr32 2.00000000E+037 RBPtCel_t_1p0_3 -1.00000000E+037 1.00000000E+037 FORMAT "%13.3" EXTENDED_LIMITS -3.40282347E+038 3.40282347E+038 /end CHARACTERISTIC
/begin CHARACTERISTIC HeatrCoreT_TransStg_f.Dfl_r32_C " / This is SW-CALPRM-PROTOTYPE" VALUE 0x80262870 Kw_Wr32 2.00000000E+037 RBPtCel_t_1p0_3 -1.00000000E+037 1.00000000E+037 FORMAT "%13.3" EXTENDED_LIMITS -3.40282347E+038 3.40282347E+038 /end CHARACTERISTIC
/begin CHARACTERISTIC HeatrCoreT_TransStg_f.stSensId_C " / This is SW-CALPRM-PROTOTYPE" VALUE 0x80262874 Kw_Wu8 255.0 OneToOne 0.00 255.0 FORMAT "%5.1" /end CHARACTERISTIC
/begin CHARACTERISTIC HeatrCoreT_tSnsrMax_f_C "" VALUE 0x80263FBC Val_Wr32 2.00000000E+037 RBPtCel_t_1p0_3 -1.00000000E+037 1.00000000E+037 FORMAT "%13.3" EXTENDED_LIMITS -3.40282347E+038 3.40282347E+038 /end CHARACTERISTIC
/begin CHARACTERISTIC HeatrCoreT_tSnsrMin_f_C "" VALUE 0x80263FC0 Val_Wr32 2.00000000E+037 RBPtCel_t_1p0_3 -1.00000000E+037 1.00000000E+037 FORMAT "%13.3" EXTENDED_LIMITS -3.40282347E+038 3.40282347E+038 /end CHARACTERISTIC
/begin CHARACTERISTIC HeatrRly1_SwtGDD_I.flgIvt_C "class for digital input acquisition / flag for inverting the status" VALUE 0x802509CC RB_Val_Wu8 255.0 boolean 0.00 255.0 FORMAT "%5.1" /end CHARACTERISTIC
/begin CHARACTERISTIC HeatrRly1_SwtGDD_I.tiDebHiLo_C "class for digital input acquisition / debounce time for high to low transitions" VALUE 0x802509CE RB_Val_Ws16 655350.0 RBPtCel_ti_10p0_1 -327680.0 327670.0 FORMAT "%8.1" /end CHARACTERISTIC
/begin CHARACTERISTIC HeatrRly1_SwtGDD_I.tiDebLoHi_C "class for digital input acquisition / debounce time for low to high transitions" VALUE 0x802509D0 RB_Val_Ws16 655350.0 RBPtCel_ti_10p0_1 -327680.0 327670.0 FORMAT "%8.1" /end CHARACTERISTIC
/begin CHARACTERISTIC HLCCcs_flgFwDwnlRstrtEna_C "switch to enable the QCA firmware download restart" VALUE 0x80250998 RB_Val_Wu8 1.00000000000 B_TRUE 0.00 1.00000000000 FORMAT "%13.11" /end CHARACTERISTIC
/begin CHARACTERISTIC HLCCcs_idxStatEvErrCod_C "Defines the setting of the EVErrorCode in the context of DIN SPEC 70121" VALUE 0x802509B0 RB_Val_Wu8 1.000 OneToOne 0.00 1.000 FORMAT "%5.3" EXTENDED_LIMITS 0.00 255.0 /end CHARACTERISTIC
/begin CHARACTERISTIC HLCCcs_ratSocFull_C "Calibratable threshold for full SOC" VALUE 0x802509B2 RB_Val_Ws16 799.9878 Prc -400.0000 399.9878 FORMAT "%8.4" /end CHARACTERISTIC
/begin CHARACTERISTIC HLCCcs_ratSocStrt_C "Maximum state of charge for which the PLC chip will be enabled" VALUE 0x8025099A RB_Val_Ws16 799.9878 Prc -400.0000 399.9878 FORMAT "%8.4" /end CHARACTERISTIC
/begin CHARACTERISTIC HLCCcs_stEgyTrfModMskAc_C "AC mask of energy transfer mode" VALUE 0x8025099C RB_Val_Wu8 255.0 OneToOne 0.00 255.0 FORMAT "%5.1" /end CHARACTERISTIC
/begin CHARACTERISTIC HLCCcs_stEgyTrfModMskDc_C "DC mask of energy transfer mode" VALUE 0x8025099D RB_Val_Wu8 255.0 OneToOne 0.00 255.0 FORMAT "%5.1" /end CHARACTERISTIC
/begin CHARACTERISTIC HLCCcs_stPhyAdrSeln_C "Select persistant memory address, where the physical address (MAC address) is stored" VALUE 0x802509B4 RB_Val_Wu8 255.0 OneToOne 0.00 255.0 FORMAT "%5.1" /end CHARACTERISTIC
/begin CHARACTERISTIC HLCCcs_stSlacVldnMod_C "Slac validation mode" VALUE 0x802509B5 RB_Val_Wu8 2.00000000000 HLCCcs_stSlacVldnMod_VERB 0.00 2.00000000000 FORMAT "%13.11" /end CHARACTERISTIC
/begin CHARACTERISTIC HLCCcs_tiDlyChrgnRdy_C "Time delay between S2 close request and CP C-D" VALUE 0x8025099E RB_Val_Ws16 655.3500 RBPtCel_ti_0p01_1 -327.6800 327.6700 FORMAT "%8.4" /end CHARACTERISTIC
/begin CHARACTERISTIC HLCCcs_tiDlyFctCtrlEthStrt_C "Time delay until ethernet communication is enabled" VALUE 0x802509A0 RB_Val_Ws16 655.3500 RBPtCel_ti_0p01_1 -327.6800 327.6700 FORMAT "%8.4" /end CHARACTERISTIC
/begin CHARACTERISTIC HLCCcs_tiDlyFctCtrlRst_C "Time delay for reseting the PLC Chip" VALUE 0x802509A2 RB_Val_Ws16 655.3500 RBPtCel_ti_0p01_1 -327.6800 327.6700 FORMAT "%8.4" /end CHARACTERISTIC
/begin CHARACTERISTIC HLCCcs_tiDlyPLnCDi_C "Delay time for disabling the power line communication chip" VALUE 0x802509A4 RB_Val_Ws16 655.3500 RBPtCel_ti_0p01_1 -327.6800 327.6700 FORMAT "%8.4" /end CHARACTERISTIC
/begin CHARACTERISTIC HLCCcs_tiDlyRestrtAllwd_C "Delay time to disable the reset of charging process" VALUE 0x802509A6 RB_Val_Ws16 655.3500 RBPtCel_ti_0p01_1 -327.6800 327.6700 FORMAT "%8.4" /end CHARACTERISTIC
/begin CHARACTERISTIC HLCCcs_tiEvseNotifMaxDlyOfs_C "Maximum time delay offset for EVSE notification message." VALUE 0x802509A8 RB_Val_Ws16 65535.00 RBPtCel_ti_1p0_2 -32768.00 32767.00 FORMAT "%8.2" /end CHARACTERISTIC
/begin CHARACTERISTIC HLCCcs_tPwrLineChp_f_C "Maximum power line communication chip temperature" VALUE 0x802509AC RB_Val_Wr32 2.000E+037 RBPtCel_t_1p0_3 -1.000E+037 1.000E+037 FORMAT "%5.3" EXTENDED_LIMITS -3.403E+038 3.403E+038 /end CHARACTERISTIC
/begin CHARACTERISTIC HvacHmi_stVehStDiagEna_C "Vehicle state selection to activate diagnosis" VALUE 0x80251204 RB_Val_Wu8 255.0 q1 0.00 255.0 FORMAT "%5.1" /end CHARACTERISTIC
/begin CHARACTERISTIC HvacHmi_tEvaprFlt_C "Substitute temperature of evaporator in case of faulty signal." VALUE 0x80251206 RB_Val_Ws16 6553.500 Temp_Cels -3549.940 3003.560 FORMAT "%8.3" /end CHARACTERISTIC
/begin CHARACTERISTIC HvacLvl_maskRatSocVldSq_C "Bit-coded mask calibration to check validity of signal: SOC of HV battery" VALUE 0x80251208 RB_Val_Wu16 65535.00 OneToOne 0.00 65535.00 FORMAT "%8.2" /end CHARACTERISTIC
/begin CHARACTERISTIC HvacLvl_pwrDesCoolgSaveDelta_C "Delta power which is used to reduce desired eco cooling power in power saving mode ofHVAC e-compressor" VALUE 0x8025120A RB_Val_Ws16 1638375. RBPtCel_pwr_25p0_1 -819200.0 819175.0 FORMAT "%8.1" /end CHARACTERISTIC
/begin CHARACTERISTIC HvacLvl_pwrDesCoolgSaveMax_C "Maximum desired cooling power in power saving mode ofHVAC e-compressor" VALUE 0x8025120C RB_Val_Ws16 1638375. RBPtCel_pwr_25p0_1 -819200.0 819175.0 FORMAT "%8.1" /end CHARACTERISTIC
/begin CHARACTERISTIC HvacLvl_pwrDesDefogSaveDelta_C "Delta power which is used to reduce desired eco heating power in power saving mode ofHVAC e-compressor" VALUE 0x8025120E RB_Val_Ws16 1638375. RBPtCel_pwr_25p0_1 -819200.0 819175.0 FORMAT "%8.1" /end CHARACTERISTIC
/begin CHARACTERISTIC HvacLvl_pwrDesDefogSaveMax_C "Maximum desired heating power in power saving mode of HVAC e-compressor" VALUE 0x80251210 RB_Val_Ws16 1638375. RBPtCel_pwr_25p0_1 -819200.0 819175.0 FORMAT "%8.1" /end CHARACTERISTIC
/begin CHARACTERISTIC HvacLvl_pwrLoRefgntDes_C "Low speed desired refrigerant power in case of desired temperature targets are reached" VALUE 0x80251212 RB_Val_Ws16 1638375. RBPtCel_pwr_25p0_1 -819200.0 819175.0 FORMAT "%8.1" /end CHARACTERISTIC
/begin CHARACTERISTIC HvacLvl_pwrRefgntDesDern_C "Desired refrigerent power in case of HV battery derating factors" VALUE 0x80251214 RB_Val_Ws16 1638375. RBPtCel_pwr_25p0_1 -819200.0 819175.0 FORMAT "%8.1" /end CHARACTERISTIC
/begin CHARACTERISTIC HvacLvl_pwrRefgntDesEcoCoolg_T "Calibration curve for desired refrigerent cooling power in ECO mode based on required cooling state" CURVE 0x80251216 RB_Curve_U8_S16_sao 1638375. RBPtCel_pwr_25p0_1 -819200.0 819175.0 FORMAT "%8.1"
 /begin AXIS_DESCR STD_AXIS ThermHvac_stFrntCoolgReq q1 7 0.00 255.0 FORMAT "%5.1" DEPOSIT ABSOLUTE /end AXIS_DESCR
/end CHARACTERISTIC
/begin CHARACTERISTIC HvacLvl_pwrRefgntDesEcoDefog_T "Calibration curve for desired refrigerent heating power in ECO mode based on required heating state" CURVE 0x8025122C RB_Curve_U8_S16_sao 1638375. RBPtCel_pwr_25p0_1 -819200.0 819175.0 FORMAT "%8.1"
 /begin AXIS_DESCR STD_AXIS ThermHvac_stFrntHeatgReq q1 7 0.00 255.0 FORMAT "%5.1" DEPOSIT ABSOLUTE /end AXIS_DESCR
/end CHARACTERISTIC
/begin CHARACTERISTIC HvacLvl_pwrRefgntDesNormCoolg_T "Calibration curve for desired refrigerent cooling power in Normal mode based on required cooling state" CURVE 0x80251242 RB_Curve_U8_S16_sao 1638375. RBPtCel_pwr_25p0_1 -819200.0 819175.0 FORMAT "%8.1"
 /begin AXIS_DESCR STD_AXIS ThermHvac_stFrntCoolgReq q1 7 0.00 255.0 FORMAT "%5.1" DEPOSIT ABSOLUTE /end AXIS_DESCR
/end CHARACTERISTIC
/begin CHARACTERISTIC HvacLvl_pwrRefgntDesNormDefog_T "Calibration curve for desired refrigerent heating power in Normal mode based on required heating state" CURVE 0x80251258 RB_Curve_U8_S16_sao 1638375. RBPtCel_pwr_25p0_1 -819200.0 819175.0 FORMAT "%8.1"
 /begin AXIS_DESCR STD_AXIS ThermHvac_stFrntHeatgReq q1 7 0.00 255.0 FORMAT "%5.1" DEPOSIT ABSOLUTE /end AXIS_DESCR
/end CHARACTERISTIC
/begin CHARACTERISTIC HvacLvl_ratSocDeltaPwrSave_C "Delta SOC ratio of HV Battery to determine the power saving mode" VALUE 0x8025126E RB_Val_Ws16 799.9878 Prc -400.0000 399.9878 FORMAT "%8.4" /end CHARACTERISTIC
/begin CHARACTERISTIC HvacLvl_ratSocLePwrSave_C "Minimum SOC ratio of HV Battery below which HVAC e-compressor should be operated in the power saving mode" VALUE 0x80251270 RB_Val_Ws16 799.9878 Prc -400.0000 399.9878 FORMAT "%8.4" /end CHARACTERISTIC
/begin CHARACTERISTIC HvacLvl_tTarHeatrEco_C "Desired Cabin heater temperature in ECO mode" VALUE 0x80251272 RB_Val_Ws16 6553.500 Temp_Cels -3549.940 3003.560 FORMAT "%8.3" /end CHARACTERISTIC
/begin CHARACTERISTIC HvacLvl_tTarHeatr_C "Desired Cabin heater temperature in normal mode" VALUE 0x80251274 RB_Val_Ws16 6553.500 Temp_Cels -3549.940 3003.560 FORMAT "%8.3" /end CHARACTERISTIC
/begin CHARACTERISTIC HvacMod_maskRatSocVldy_C "Validity of mask SOC ratio" VALUE 0x80251276 RB_Val_Wu16 65535.00 OneToOne 0.00 65535.00 FORMAT "%8.2" /end CHARACTERISTIC
/begin CHARACTERISTIC HvacMod_ratHvBattSocDelta_C "Delta SOC ratio of HV battery" VALUE 0x80251278 RB_Val_Ws16 799.9878 Prc -400.0000 399.9878 FORMAT "%8.4" /end CHARACTERISTIC
/begin CHARACTERISTIC HvacMod_ratHvBattSocHi_C "High SOC ratio of HV battery" VALUE 0x8025127A RB_Val_Ws16 799.9878 Prc -400.0000 399.9878 FORMAT "%8.4" /end CHARACTERISTIC
/begin CHARACTERISTIC HvacMod_ratHvBattSocLo_C "Low SOC ratio of HV battery" VALUE 0x8025127C RB_Val_Ws16 799.9878 Prc -400.0000 399.9878 FORMAT "%8.4" /end CHARACTERISTIC
/begin CHARACTERISTIC HvacMod_tEvaprVeryColdDelta_C "Very cold delta evaporator temperature" VALUE 0x8025127E RB_Val_Ws16 6553.500 RBPtCel_t_0p1_1 -3276.800 3276.700 FORMAT "%8.3" /end CHARACTERISTIC
/begin CHARACTERISTIC HvacMod_tEvaprVeryCold_C "Very cold evaporator temperature" VALUE 0x80251280 RB_Val_Ws16 6553.500 Temp_Cels -3549.940 3003.560 FORMAT "%8.3" /end CHARACTERISTIC
/begin CHARACTERISTIC HvacMod_tiCbnBlowrDebHiLo_C "High to low Cabin blower debounce time" VALUE 0x80251282 RB_Val_Ws16 655.3500 RBPtCel_ti_0p01_1 -327.6800 327.6700 FORMAT "%8.4" /end CHARACTERISTIC
/begin CHARACTERISTIC HvacMod_tiCbnBlowrDebLoHi_C "Low to high Cabin blower debounce time" VALUE 0x80251284 RB_Val_Ws16 655.3500 RBPtCel_ti_0p01_1 -327.6800 327.6700 FORMAT "%8.4" /end CHARACTERISTIC
/begin CHARACTERISTIC HvacPtc_pwrHeatrOff_C "Heater power off calibration threshold for desired heater power calculation" VALUE 0x80251286 RB_Val_Ws16 65535.00 RBPtCel_pwr_1p0_1 -32768.00 32767.00 FORMAT "%8.2" /end CHARACTERISTIC
/begin CHARACTERISTIC HvacPtc_pwrHeatrOn_C "Heater power on calibration threshold for desired heater power calculation" VALUE 0x80251288 RB_Val_Ws16 65535.00 RBPtCel_pwr_1p0_1 -32768.00 32767.00 FORMAT "%8.2" /end CHARACTERISTIC
/begin CHARACTERISTIC HvacPtc_tHeatrOnDeltaEcoMax_C "set point heater temperature during Eco mode" VALUE 0x8025128A RB_Val_Ws16 6553.500 RBPtCel_t_0p1_1 -3276.800 3276.700 FORMAT "%8.3" /end CHARACTERISTIC
/begin CHARACTERISTIC HvacPtc_tHeatrOnDeltaMax_C "set point heater temperature during normal mode" VALUE 0x8025128C RB_Val_Ws16 6553.500 RBPtCel_t_0p1_1 -3276.800 3276.700 FORMAT "%8.3" /end CHARACTERISTIC
/begin CHARACTERISTIC HvacPtc_tiMinOff_C "Minimum off time heater calibration threshold" VALUE 0x8025128E RB_Val_Wu16 655.3500 RBPtCel_ti_0p01_1 0.00 655.3500 FORMAT "%8.4" /end CHARACTERISTIC
/begin CHARACTERISTIC HvacPtc_tiMinOn_C "Minimum on time heater calibration threshold" VALUE 0x80251290 RB_Val_Wu16 655.3500 RBPtCel_ti_0p01_1 0.00 655.3500 FORMAT "%8.4" /end CHARACTERISTIC
/begin CHARACTERISTIC HvBatt_facChrgIReqDern_T "chage current request fac" CURVE 0x802509D4 RB_Curve_R32_S16_sao 655.3500 Fact100 -327.6800 327.6700 FORMAT "%8.4"
 /begin AXIS_DESCR STD_AXIS PwrDistbnUnitT_t_f RBPtCel_t_1p0_3 11 -1.00000000E+037 1.00000000E+037 FORMAT "%13.3" EXTENDED_LIMITS -3.40282347E+038 3.40282347E+038 DEPOSIT ABSOLUTE /end AXIS_DESCR
/end CHARACTERISTIC
/begin CHARACTERISTIC HvBatt_flgNomChrgnUSeln_C "HV Battery Nominal Charging Voltage Selection flag" VALUE 0x80250A1C RB_Val_Wu8 1.00000000000 B_TRUE 0.00 1.00000000000 FORMAT "%13.11" /end CHARACTERISTIC
/begin CHARACTERISTIC HvBatt_iReqToChrgrErr_C "Replacement value for HV Battery Current request to the charger incase of sender fault" VALUE 0x80250A1E RB_Val_Ws16 2047.969 Curr_A_q0p03125_COMPU -1024.000 1023.969 FORMAT "%8.3" /end CHARACTERISTIC
/begin CHARACTERISTIC HvBatt_iReqToChrgrIni_C "Replacement value for HV Battery Current request to the charger incase of sender Init" VALUE 0x80250A20 RB_Val_Ws16 2047.969 Curr_A_q0p03125_COMPU -1024.000 1023.969 FORMAT "%8.3" /end CHARACTERISTIC
/begin CHARACTERISTIC HvBatt_maskUHvbLimHiSq_C "Masking calibration value for Maximum HV battery voltage" VALUE 0x80250A22 RB_Val_Wu16 65535.00 OneToOne 0.00 65535.00 FORMAT "%8.2" /end CHARACTERISTIC
/begin CHARACTERISTIC HvBatt_uHvbLimHiErr_C "Replacement value for HV Battery Maximum Voltage during sender fault" VALUE 0x80250A24 RB_Val_Ws16 2047.969 Volt_V_q0p03125_COMPU -1024.000 1023.969 FORMAT "%8.3" /end CHARACTERISTIC
/begin CHARACTERISTIC HvBatt_uNomChrgnErr_C "Replacement value for the nominal charging voltage during sender fault" VALUE 0x80250A26 RB_Val_Ws16 2047.969 Volt_V_q0p03125_COMPU -1024.000 1023.969 FORMAT "%8.3" /end CHARACTERISTIC
/begin CHARACTERISTIC HvBatt_uNomChrgnIni_C "Replacement value for the nominal charging voltage during sender init" VALUE 0x80250A28 RB_Val_Ws16 2047.969 Volt_V_q0p03125_COMPU -1024.000 1023.969 FORMAT "%8.3" /end CHARACTERISTIC
/begin MEASUREMENT DDRC_St.DFC_HLCCcsFwDwnl "" ULONG DFC_OneToOne 1 100 0.00 536870911.000 BIT_MASK 0x1fffffff FORMAT "%13.3" ECU_ADDRESS 0x6001C3AC /end MEASUREMENT
/begin MEASUREMENT DDRC_St.DFC_HvBattIReqToChrgrErr "" ULONG DFC_OneToOne 1 100 0.00 536870911.000 BIT_MASK 0x1fffffff FORMAT "%13.3" ECU_ADDRESS 0x6001C3CC /end MEASUREMENT
/begin MEASUREMENT DDRC_St.DFC_HvBattIReqToChrgrIni "" ULONG DFC_OneToOne 1 100 0.00 536870911.000 BIT_MASK 0x1fffffff FORMAT "%13.3" ECU_ADDRESS 0x6001C3D0 /end MEASUREMENT
/begin MEASUREMENT DDRC_St.DFC_HvBattUNomChrgnErr "" ULONG DFC_OneToOne 1 100 0.00 536870911.000 BIT_MASK 0x1fffffff FORMAT "%13.3" ECU_ADDRESS 0x6001C424 /end MEASUREMENT
/begin MEASUREMENT DDRC_St.DFC_HvBattUNomChrgnIni "" ULONG DFC_OneToOne 1 100 0.00 536870911.000 BIT_MASK 0x1fffffff FORMAT "%13.3" ECU_ADDRESS 0x6001C428 /end MEASUREMENT
/begin MEASUREMENT DDRC_St.DFC_FanRlySCB "" ULONG DFC_OneToOne 1 100 0.00 536870911.000 BIT_MASK 0x1fffffff FORMAT "%13.3" ECU_ADDRESS 0x6001CA68 /end MEASUREMENT
/begin MEASUREMENT DDRC_St.DFC_FanRlySCG "" ULONG DFC_OneToOne 1 100 0.00 536870911.000 BIT_MASK 0x1fffffff FORMAT "%13.3" ECU_ADDRESS 0x6001CA6C /end MEASUREMENT
/begin MEASUREMENT DDRC_St.DFC_FreonPSRCMin "" ULONG DFC_OneToOne 1 100 0.00 536870911.000 BIT_MASK 0x1fffffff FORMAT "%13.3" ECU_ADDRESS 0x6001CA74 /end MEASUREMENT
/begin MEASUREMENT DDRC_St.DFC_HLCCcsPLnCChipTHi "" ULONG DFC_OneToOne 1 100 0.00 536870911.000 BIT_MASK 0x1fffffff FORMAT "%13.3" ECU_ADDRESS 0x6001CA78 /end MEASUREMENT
/begin MEASUREMENT DDRC_St.DFC_HeatrCoreTSRCMin "" ULONG DFC_OneToOne 1 100 0.00 536870911.000 BIT_MASK 0x1fffffff FORMAT "%13.3" ECU_ADDRESS 0x6001CA7C /end MEASUREMENT
/begin MEASUREMENT DDRC_St.DFC_FanSpdPhysRngHi "" UWORD DFC_OneToOne 1 100 0.00 8191.000 BIT_MASK 0x1fff FORMAT "%8.3" ECU_ADDRESS 0x60021FA2 /end MEASUREMENT
/begin MEASUREMENT DDRC_St.DFC_FanSpdPhysRngLo "" UWORD DFC_OneToOne 1 100 0.00 8191.000 BIT_MASK 0x1fff FORMAT "%8.3" ECU_ADDRESS 0x60021FA4 /end MEASUREMENT
/begin MEASUREMENT DDRC_St.DFC_FreonPPhysRngHi "" UWORD DFC_OneToOne 1 100 0.00 8191.000 BIT_MASK 0x1fff FORMAT "%8.3" ECU_ADDRESS 0x60021FA8 /end MEASUREMENT
/begin MEASUREMENT DDRC_St.DFC_FreonPPhysRngLo "" UWORD DFC_OneToOne 1 100 0.00 8191.000 BIT_MASK 0x1fff FORMAT "%8.3" ECU_ADDRESS 0x60021FAA /end MEASUREMENT
/begin MEASUREMENT DDRC_St.DFC_FreonPSRCOpn "" UWORD DFC_OneToOne 1 100 0.00 8191.000 BIT_MASK 0x1fff FORMAT "%8.3" ECU_ADDRESS 0x60021FAC /end MEASUREMENT
/begin MEASUREMENT DDRC_St.DFC_HeatrCoreTPhysRngHi "" UWORD DFC_OneToOne 1 100 0.00 8191.000 BIT_MASK 0x1fff FORMAT "%8.3" ECU_ADDRESS 0x60021FAE /end MEASUREMENT
/begin MEASUREMENT DDRC_St.DFC_HeatrCoreTPhysRngLo "" UWORD DFC_OneToOne 1 100 0.00 8191.000 BIT_MASK 0x1fff FORMAT "%8.3" ECU_ADDRESS 0x60021FB0 /end MEASUREMENT
/begin MEASUREMENT DDRC_St.DFC_HeatrCoreTSRCOpn "" UWORD DFC_OneToOne 1 100 0.00 8191.000 BIT_MASK 0x1fff FORMAT "%8.3" ECU_ADDRESS 0x60021FB2 /end MEASUREMENT
/begin MEASUREMENT DFC_st.DFC_HLCCcsFwDwnl "" UBYTE DFC_OneToOne 1 100 0.00 255.0 FORMAT "%5.1" ECU_ADDRESS 0x60034A4E /end MEASUREMENT
/begin MEASUREMENT DFC_st.DFC_HvBattIReqToChrgrErr "" UBYTE DFC_OneToOne 1 100 0.00 255.0 FORMAT "%5.1" ECU_ADDRESS 0x60034A56 /end MEASUREMENT
/begin MEASUREMENT DFC_st.DFC_HvBattIReqToChrgrIni "" UBYTE DFC_OneToOne 1 100 0.00 255.0 FORMAT "%5.1" ECU_ADDRESS 0x60034A57 /end MEASUREMENT
/begin MEASUREMENT DFC_st.DFC_HvBattUNomChrgnErr "" UBYTE DFC_OneToOne 1 100 0.00 255.0 FORMAT "%5.1" ECU_ADDRESS 0x60034A6C /end MEASUREMENT
/begin MEASUREMENT DFC_st.DFC_HvBattUNomChrgnIni "" UBYTE DFC_OneToOne 1 100 0.00 255.0 FORMAT "%5.1" ECU_ADDRESS 0x60034A6D /end MEASUREMENT
/begin MEASUREMENT DFC_st.DFC_FanRlySCB "" UBYTE DFC_OneToOne 1 100 0.00 255.0 FORMAT "%5.1" ECU_ADDRESS 0x60034BFD /end MEASUREMENT
/begin MEASUREMENT DFC_st.DFC_FanRlySCG "" UBYTE DFC_OneToOne 1 100 0.00 255.0 FORMAT "%5.1" ECU_ADDRESS 0x60034BFE /end MEASUREMENT
/begin MEASUREMENT DFC_st.DFC_FreonPSRCMin "" UBYTE DFC_OneToOne 1 100 0.00 255.0 FORMAT "%5.1" ECU_ADDRESS 0x60034C00 /end MEASUREMENT
/begin MEASUREMENT DFC_st.DFC_HLCCcsPLnCChipTHi "" UBYTE DFC_OneToOne 1 100 0.00 255.0 FORMAT "%5.1" ECU_ADDRESS 0x60034C01 /end MEASUREMENT
/begin MEASUREMENT DFC_st.DFC_HeatrCoreTSRCMin "" UBYTE DFC_OneToOne 1 100 0.00 255.0 FORMAT "%5.1" ECU_ADDRESS 0x60034C02 /end MEASUREMENT
/begin MEASUREMENT DFC_st.DFC_FanSpdPhysRngHi "" UBYTE DFC_OneToOne 1 100 0.00 255.0 FORMAT "%5.1" ECU_ADDRESS 0x60034C28 /end MEASUREMENT
/begin MEASUREMENT DFC_st.DFC_FanSpdPhysRngLo "" UBYTE DFC_OneToOne 1 100 0.00 255.0 FORMAT "%5.1" ECU_ADDRESS 0x60034C29 /end MEASUREMENT
/begin MEASUREMENT DFC_st.DFC_FreonPPhysRngHi "" UBYTE DFC_OneToOne 1 100 0.00 255.0 FORMAT "%5.1" ECU_ADDRESS 0x60034C2B /end MEASUREMENT
/begin MEASUREMENT DFC_st.DFC_FreonPPhysRngLo "" UBYTE DFC_OneToOne 1 100 0.00 255.0 FORMAT "%5.1" ECU_ADDRESS 0x60034C2C /end MEASUREMENT
/begin MEASUREMENT DFC_st.DFC_FreonPSRCOpn "" UBYTE DFC_OneToOne 1 100 0.00 255.0 FORMAT "%5.1" ECU_ADDRESS 0x60034C2D /end MEASUREMENT
/begin MEASUREMENT DFC_st.DFC_HeatrCoreTPhysRngHi "" UBYTE DFC_OneToOne 1 100 0.00 255.0 FORMAT "%5.1" ECU_ADDRESS 0x60034C2E /end MEASUREMENT
/begin MEASUREMENT DFC_st.DFC_HeatrCoreTPhysRngLo "" UBYTE DFC_OneToOne 1 100 0.00 255.0 FORMAT "%5.1" ECU_ADDRESS 0x60034C2F /end MEASUREMENT
/begin MEASUREMENT DFC_st.DFC_HeatrCoreTSRCOpn "" UBYTE DFC_OneToOne 1 100 0.00 255.0 FORMAT "%5.1" ECU_ADDRESS 0x60034C30 /end MEASUREMENT
/begin MEASUREMENT DFC_st.DFC_ComVCInval "" UBYTE DFC_OneToOne 1 100 0.00 255.0 FORMAT "%5.1" ECU_ADDRESS 0x60034C7B /end MEASUREMENT
/begin MEASUREMENT DFC_st.DFC_FanMaxOvrd "" UBYTE DFC_OneToOne 1 100 0.00 255.0 FORMAT "%5.1" ECU_ADDRESS 0x60034C7E /end MEASUREMENT
/begin MEASUREMENT DFC_st.DFC_HLCCcsGnrlComErr "" UBYTE DFC_OneToOne 1 100 0.00 255.0 FORMAT "%5.1" ECU_ADDRESS 0x60034C7F /end MEASUREMENT
/begin MEASUREMENT DFC_st.DFC_AcFlt "" UBYTE DFC_OneToOne 1 100 0.00 255.0 FORMAT "%5.1" ECU_ADDRESS 0x60034CAE /end MEASUREMENT
/begin MEASUREMENT DFC_st.DFC_FanSpdTmpErr "" UBYTE DFC_OneToOne 1 100 0.00 255.0 FORMAT "%5.1" ECU_ADDRESS 0x60034CD6 /end MEASUREMENT
/begin MEASUREMENT DFC_st.DFC_FreonPSRCMax "" UBYTE DFC_OneToOne 1 100 0.00 255.0 FORMAT "%5.1" ECU_ADDRESS 0x60034CD7 /end MEASUREMENT
/begin MEASUREMENT DFC_st.DFC_FreonPTmpErr "" UBYTE DFC_OneToOne 1 100 0.00 255.0 FORMAT "%5.1" ECU_ADDRESS 0x60034CD8 /end MEASUREMENT
/begin MEASUREMENT DFC_st.DFC_HeatrCoreTSRCMax "" UBYTE DFC_OneToOne 1 100 0.00 255.0 FORMAT "%5.1" ECU_ADDRESS 0x60034CD9 /end MEASUREMENT
/begin MEASUREMENT DFC_st.DFC_HeatrCoreTTmpErr "" UBYTE DFC_OneToOne 1 100 0.00 255.0 FORMAT "%5.1" ECU_ADDRESS 0x60034CDA /end MEASUREMENT
/begin MEASUREMENT DFC_st.DFC_HvacBlwrFrntFlt "" UBYTE DFC_OneToOne 1 100 0.00 255.0 FORMAT "%5.1" ECU_ADDRESS 0x60034CDC /end MEASUREMENT
/begin MEASUREMENT DFC_st.DFC_HvacEvapElecFlt "" UBYTE DFC_OneToOne 1 100 0.00 255.0 FORMAT "%5.1" ECU_ADDRESS 0x60034CDD /end MEASUREMENT
/begin MEASUREMENT DFC_st.DFC_HvacEvapElecFltGnd "" UBYTE DFC_OneToOne 1 100 0.00 255.0 FORMAT "%5.1" ECU_ADDRESS 0x60034CDE /end MEASUREMENT
/begin MEASUREMENT DFC_st.DFC_HvacKnobPosnFlt "" UBYTE DFC_OneToOne 1 100 0.00 255.0 FORMAT "%5.1" ECU_ADDRESS 0x60034CDF /end MEASUREMENT
/begin MEASUREMENT DINH_nrActvInhReas.FId_FanRlyDiagEnad "" UWORD DINH_ct_Compu 1 100 -4095.000 4096.000 BIT_MASK 0x1fff FORMAT "%8.3" ECU_ADDRESS 0x60021478 /end MEASUREMENT
/begin MEASUREMENT DINH_nrActvInhReas.FId_FanSpdFrzVal "" UWORD DINH_ct_Compu 1 100 -4095.000 4096.000 BIT_MASK 0x1fff FORMAT "%8.3" ECU_ADDRESS 0x6002147C /end MEASUREMENT
/begin MEASUREMENT DINH_nrActvInhReas.FId_FanSpdPhysRng "" UWORD DINH_ct_Compu 1 100 -4095.000 4096.000 BIT_MASK 0x1fff FORMAT "%8.3" ECU_ADDRESS 0x6002147E /end MEASUREMENT
/begin MEASUREMENT DINH_nrActvInhReas.FId_FanSpdRplVal "" UWORD DINH_ct_Compu 1 100 -4095.000 4096.000 BIT_MASK 0x1fff FORMAT "%8.3" ECU_ADDRESS 0x60021480 /end MEASUREMENT
/begin MEASUREMENT DINH_nrActvInhReas.FId_FanSpdTmpErrCnt "" UWORD DINH_ct_Compu 1 100 -4095.000 4096.000 BIT_MASK 0x1fff FORMAT "%8.3" ECU_ADDRESS 0x60021484 /end MEASUREMENT
/begin MEASUREMENT DINH_nrActvInhReas.FId_FansFacCor "" UWORD DINH_ct_Compu 1 100 -4095.000 4096.000 BIT_MASK 0x1fff FORMAT "%8.3" ECU_ADDRESS 0x60021486 /end MEASUREMENT
/begin MEASUREMENT DINH_nrActvInhReas.FId_FreonPEnhdSRCMax "" UWORD DINH_ct_Compu 1 100 -4095.000 4096.000 BIT_MASK 0x1fff FORMAT "%8.3" ECU_ADDRESS 0x6002148C /end MEASUREMENT
/begin MEASUREMENT DINH_nrActvInhReas.FId_FreonPFrzVal "" UWORD DINH_ct_Compu 1 100 -4095.000 4096.000 BIT_MASK 0x1fff FORMAT "%8.3" ECU_ADDRESS 0x6002148E /end MEASUREMENT
/begin MEASUREMENT DINH_nrActvInhReas.FId_FreonPPhysRng "" UWORD DINH_ct_Compu 1 100 -4095.000 4096.000 BIT_MASK 0x1fff FORMAT "%8.3" ECU_ADDRESS 0x60021490 /end MEASUREMENT
/begin MEASUREMENT DINH_nrActvInhReas.FId_FreonPRplVal "" UWORD DINH_ct_Compu 1 100 -4095.000 4096.000 BIT_MASK 0x1fff FORMAT "%8.3" ECU_ADDRESS 0x60021492 /end MEASUREMENT
/begin MEASUREMENT DINH_nrActvInhReas.FId_FreonPSSpMon "" UWORD DINH_ct_Compu 1 100 -4095.000 4096.000 BIT_MASK 0x1fff FORMAT "%8.3" ECU_ADDRESS 0x60021494 /end MEASUREMENT
/begin MEASUREMENT DINH_nrActvInhReas.FId_FreonPTmpErrCnt "" UWORD DINH_ct_Compu 1 100 -4095.000 4096.000 BIT_MASK 0x1fff FORMAT "%8.3" ECU_ADDRESS 0x60021496 /end MEASUREMENT
/begin MEASUREMENT DINH_nrActvInhReas.FId_GlbDaLSumvXPtd "" UWORD DINH_ct_Compu 1 100 -4095.000 4096.000 BIT_MASK 0x1fff FORMAT "%8.3" ECU_ADDRESS 0x60021498 /end MEASUREMENT
/begin MEASUREMENT DINH_nrActvInhReas.FId_HLCCcs_CoornPLnCChipTHi "" UWORD DINH_ct_Compu 1 100 -4095.000 4096.000 BIT_MASK 0x1fff FORMAT "%8.3" ECU_ADDRESS 0x6002149A /end MEASUREMENT
/begin MEASUREMENT DINH_nrActvInhReas.FId_HLCCcs_CoornPLnCChpT "" UWORD DINH_ct_Compu 1 100 -4095.000 4096.000 BIT_MASK 0x1fff FORMAT "%8.3" ECU_ADDRESS 0x6002149C /end MEASUREMENT
/begin MEASUREMENT DINH_nrActvInhReas.FId_HeatrCoreTEnhdSRCMax "" UWORD DINH_ct_Compu 1 100 -4095.000 4096.000 BIT_MASK 0x1fff FORMAT "%8.3" ECU_ADDRESS 0x6002149E /end MEASUREMENT
/begin MEASUREMENT DINH_nrActvInhReas.FId_HeatrCoreTFrzVal "" UWORD DINH_ct_Compu 1 100 -4095.000 4096.000 BIT_MASK 0x1fff FORMAT "%8.3" ECU_ADDRESS 0x600214A0 /end MEASUREMENT
/begin MEASUREMENT DINH_nrActvInhReas.FId_HeatrCoreTPhysRng "" UWORD DINH_ct_Compu 1 100 -4095.000 4096.000 BIT_MASK 0x1fff FORMAT "%8.3" ECU_ADDRESS 0x600214A2 /end MEASUREMENT
/begin MEASUREMENT DINH_nrActvInhReas.FId_HeatrCoreTRplVal "" UWORD DINH_ct_Compu 1 100 -4095.000 4096.000 BIT_MASK 0x1fff FORMAT "%8.3" ECU_ADDRESS 0x600214A4 /end MEASUREMENT
/begin MEASUREMENT DINH_nrActvInhReas.FId_HeatrCoreTSSpMon "" UWORD DINH_ct_Compu 1 100 -4095.000 4096.000 BIT_MASK 0x1fff FORMAT "%8.3" ECU_ADDRESS 0x600214A6 /end MEASUREMENT
/begin MEASUREMENT DINH_nrActvInhReas.FId_HeatrCoreTTmpErrCnt "" UWORD DINH_ct_Compu 1 100 -4095.000 4096.000 BIT_MASK 0x1fff FORMAT "%8.3" ECU_ADDRESS 0x600214A8 /end MEASUREMENT
/begin MEASUREMENT DINH_nrActvInhReas.FId_HvBattDesChrgIDern "" UWORD DINH_ct_Compu 1 100 -4095.000 4096.000 BIT_MASK 0x1fff FORMAT "%8.3" ECU_ADDRESS 0x600214AE /end MEASUREMENT
/begin MEASUREMENT DINH_nrActvInhReas.FId_HvacHmiFlt "" UWORD DINH_ct_Compu 1 100 -4095.000 4096.000 BIT_MASK 0x1fff FORMAT "%8.3" ECU_ADDRESS 0x600214DC /end MEASUREMENT
/begin MEASUREMENT DINH_nrActvInhReas.FId_HvacModCoolgFlt "" UWORD DINH_ct_Compu 1 100 -4095.000 4096.000 BIT_MASK 0x1fff FORMAT "%8.3" ECU_ADDRESS 0x600214DE /end MEASUREMENT
/begin MEASUREMENT DINH_nrActvInhReas.FId_HvacModHeatgFlt "" UWORD DINH_ct_Compu 1 100 -4095.000 4096.000 BIT_MASK 0x1fff FORMAT "%8.3" ECU_ADDRESS 0x600214E0 /end MEASUREMENT
/begin MEASUREMENT DINH_nrActvInhReas.FId_HvacPtcHeatrErr "" UWORD DINH_ct_Compu 1 100 -4095.000 4096.000 BIT_MASK 0x1fff FORMAT "%8.3" ECU_ADDRESS 0x600214E2 /end MEASUREMENT
/begin MEASUREMENT DINH_stFId.FId_FanRlyDiagEnad "" UWORD DFC_OneToOne 1 100 0.00 65535.00 FORMAT "%8.2" ECU_ADDRESS 0x60021478 /end MEASUREMENT
/begin MEASUREMENT DINH_stFId.FId_FanSpdFrzVal "" UWORD DFC_OneToOne 1 100 0.00 65535.00 FORMAT "%8.2" ECU_ADDRESS 0x6002147C /end MEASUREMENT
/begin MEASUREMENT DINH_stFId.FId_FanSpdPhysRng "" UWORD DFC_OneToOne 1 100 0.00 65535.00 FORMAT "%8.2" ECU_ADDRESS 0x6002147E /end MEASUREMENT
/begin MEASUREMENT DINH_stFId.FId_FanSpdRplVal "" UWORD DFC_OneToOne 1 100 0.00 65535.00 FORMAT "%8.2" ECU_ADDRESS 0x60021480 /end MEASUREMENT
/begin MEASUREMENT DINH_stFId.FId_FanSpdTmpErrCnt "" UWORD DFC_OneToOne 1 100 0.00 65535.00 FORMAT "%8.2" ECU_ADDRESS 0x60021484 /end MEASUREMENT
/begin MEASUREMENT DINH_stFId.FId_FansFacCor "" UWORD DFC_OneToOne 1 100 0.00 65535.00 FORMAT "%8.2" ECU_ADDRESS 0x60021486 /end MEASUREMENT
/begin MEASUREMENT DINH_stFId.FId_FreonPEnhdSRCMax "" UWORD DFC_OneToOne 1 100 0.00 65535.00 FORMAT "%8.2" ECU_ADDRESS 0x6002148C /end MEASUREMENT
/begin MEASUREMENT DINH_stFId.FId_FreonPFrzVal "" UWORD DFC_OneToOne 1 100 0.00 65535.00 FORMAT "%8.2" ECU_ADDRESS 0x6002148E /end MEASUREMENT
/begin MEASUREMENT DINH_stFId.FId_FreonPPhysRng "" UWORD DFC_OneToOne 1 100 0.00 65535.00 FORMAT "%8.2" ECU_ADDRESS 0x60021490 /end MEASUREMENT
/begin MEASUREMENT DINH_stFId.FId_FreonPRplVal "" UWORD DFC_OneToOne 1 100 0.00 65535.00 FORMAT "%8.2" ECU_ADDRESS 0x60021492 /end MEASUREMENT
/begin MEASUREMENT DINH_stFId.FId_FreonPSSpMon "" UWORD DFC_OneToOne 1 100 0.00 65535.00 FORMAT "%8.2" ECU_ADDRESS 0x60021494 /end MEASUREMENT
/begin MEASUREMENT DINH_stFId.FId_FreonPTmpErrCnt "" UWORD DFC_OneToOne 1 100 0.00 65535.00 FORMAT "%8.2" ECU_ADDRESS 0x60021496 /end MEASUREMENT
/begin MEASUREMENT DINH_stFId.FId_GlbDaLSumvXPtd "" UWORD DFC_OneToOne 1 100 0.00 65535.00 FORMAT "%8.2" ECU_ADDRESS 0x60021498 /end MEASUREMENT
/begin MEASUREMENT DINH_stFId.FId_HLCCcs_CoornPLnCChipTHi "" UWORD DFC_OneToOne 1 100 0.00 65535.00 FORMAT "%8.2" ECU_ADDRESS 0x6002149A /end MEASUREMENT
/begin MEASUREMENT DINH_stFId.FId_HLCCcs_CoornPLnCChpT "" UWORD DFC_OneToOne 1 100 0.00 65535.00 FORMAT "%8.2" ECU_ADDRESS 0x6002149C /end MEASUREMENT
/begin MEASUREMENT DINH_stFId.FId_HeatrCoreTEnhdSRCMax "" UWORD DFC_OneToOne 1 100 0.00 65535.00 FORMAT "%8.2" ECU_ADDRESS 0x6002149E /end MEASUREMENT
/begin MEASUREMENT DINH_stFId.FId_HeatrCoreTFrzVal "" UWORD DFC_OneToOne 1 100 0.00 65535.00 FORMAT "%8.2" ECU_ADDRESS 0x600214A0 /end MEASUREMENT
/begin MEASUREMENT DINH_stFId.FId_HeatrCoreTPhysRng "" UWORD DFC_OneToOne 1 100 0.00 65535.00 FORMAT "%8.2" ECU_ADDRESS 0x600214A2 /end MEASUREMENT
/begin MEASUREMENT DINH_stFId.FId_HeatrCoreTRplVal "" UWORD DFC_OneToOne 1 100 0.00 65535.00 FORMAT "%8.2" ECU_ADDRESS 0x600214A4 /end MEASUREMENT
/begin MEASUREMENT DINH_stFId.FId_HeatrCoreTSSpMon "" UWORD DFC_OneToOne 1 100 0.00 65535.00 FORMAT "%8.2" ECU_ADDRESS 0x600214A6 /end MEASUREMENT
/begin MEASUREMENT DINH_stFId.FId_HeatrCoreTTmpErrCnt "" UWORD DFC_OneToOne 1 100 0.00 65535.00 FORMAT "%8.2" ECU_ADDRESS 0x600214A8 /end MEASUREMENT
/begin MEASUREMENT DINH_stFId.FId_HvBattDesChrgIDern "" UWORD DFC_OneToOne 1 100 0.00 65535.00 FORMAT "%8.2" ECU_ADDRESS 0x600214AE /end MEASUREMENT
/begin MEASUREMENT DINH_stFId.FId_HvacHmiFlt "" UWORD DFC_OneToOne 1 100 0.00 65535.00 FORMAT "%8.2" ECU_ADDRESS 0x600214DC /end MEASUREMENT
/begin MEASUREMENT DINH_stFId.FId_HvacModCoolgFlt "" UWORD DFC_OneToOne 1 100 0.00 65535.00 FORMAT "%8.2" ECU_ADDRESS 0x600214DE /end MEASUREMENT
/begin MEASUREMENT DINH_stFId.FId_HvacModHeatgFlt "" UWORD DFC_OneToOne 1 100 0.00 65535.00 FORMAT "%8.2" ECU_ADDRESS 0x600214E0 /end MEASUREMENT
/begin MEASUREMENT DINH_stFId.FId_HvacPtcHeatrErr "" UWORD DFC_OneToOne 1 100 0.00 65535.00 FORMAT "%8.2" ECU_ADDRESS 0x600214E2 /end MEASUREMENT
/begin MEASUREMENT FanSpd_nActDynThresPhysRngHi_f_mp "" FLOAT32_IEEE RBPtCel_n_1p0_1 1 100 -1.00000000E+037 1.00000000E+037 FORMAT "%13.3" ECU_ADDRESS 0x70006890 /end MEASUREMENT
/begin MEASUREMENT FanSpd_nActDynThresPhysRngLo_f_mp "" FLOAT32_IEEE RBPtCel_n_1p0_1 1 100 -1.00000000E+037 1.00000000E+037 FORMAT "%13.3" ECU_ADDRESS 0x7000688C /end MEASUREMENT
/begin MEASUREMENT FanSpd_nActSensGradLim_f_mp "" FLOAT32_IEEE RBPtCel_n_1p0_1 1 100 -1.00000000E+037 1.00000000E+037 FORMAT "%13.3" ECU_ADDRESS 0x70006894
 /begin IF_DATA XCPplus 0x0102
  /begin DAQ_EVENT VARIABLE /end DAQ_EVENT
 /end IF_DATA
/end MEASUREMENT
/begin MEASUREMENT FanSpd_nActSensOffsCorrd_f "" FLOAT32_IEEE RBPtCel_n_1p0_1 1 100 -1.00000000E+037 1.00000000E+037 FORMAT "%13.3" ECU_ADDRESS 0x600011A8
 /begin IF_DATA XCPplus 0x0102
  /begin DAQ_EVENT VARIABLE /end DAQ_EVENT
 /end IF_DATA
/end MEASUREMENT
/begin MEASUREMENT FanSpd_nActUnFlt_f "" FLOAT32_IEEE RBPtCel_n_1p0_1 1 100 -1.00000000E+037 1.00000000E+037 FORMAT "%13.3" ECU_ADDRESS 0x600011A0
 /begin IF_DATA XCPplus 0x0102
  /begin DAQ_EVENT VARIABLE /end DAQ_EVENT
 /end IF_DATA
/end MEASUREMENT
/begin MEASUREMENT FanSpd_nAct_f "" FLOAT32_IEEE RBPtCel_n_1p0_1 1 100 -1.00000000E+037 1.00000000E+037 FORMAT "%13.3" ECU_ADDRESS 0x6000119C
 /begin IF_DATA XCPplus 0x0102
  /begin DAQ_EVENT VARIABLE /end DAQ_EVENT
 /end IF_DATA
/end MEASUREMENT
/begin MEASUREMENT FanSpd_nAct_f_Sq "" UBYTE SigQly_COMPU_VERB 1 100 0.00 15.0000000000 FORMAT "%13.10" ECU_ADDRESS 0x600237E7
 /begin IF_DATA XCPplus 0x0102
  /begin DAQ_EVENT VARIABLE /end DAQ_EVENT
 /end IF_DATA
/end MEASUREMENT
/begin MEASUREMENT FanSpd_stMonStdSens "" ULONG OneToOne 1 100 0.00 4294967295.00 FORMAT "%13.2" ECU_ADDRESS 0x60001048
 /begin IF_DATA XCPplus 0x0102
  /begin DAQ_EVENT VARIABLE /end DAQ_EVENT
 /end IF_DATA
/end MEASUREMENT
/begin MEASUREMENT FanSpd_stSnsrActv "" UBYTE OneToOne 1 100 0.00 255.0 BIT_MASK 0x1 FORMAT "%5.1" ECU_ADDRESS 0x600236B4
 /begin IF_DATA XCPplus 0x0102
  /begin DAQ_EVENT VARIABLE /end DAQ_EVENT
 /end IF_DATA
/end MEASUREMENT
/begin MEASUREMENT FanSpd_swtConfStdSens2C "" ULONG OneToOne 1 100 0.00 4294967295.00 FORMAT "%13.2" ECU_ADDRESS 0x60000868 /end MEASUREMENT
/begin MEASUREMENT FanSpd_swtConfStdSensC "" ULONG OneToOne 1 100 0.00 4294967295.00 FORMAT "%13.2" ECU_ADDRESS 0x60000864 /end MEASUREMENT
/begin MEASUREMENT FanSpd_swtConfStdSensSwVersC "" ULONG OneToOne 1 100 0.00 4294967295.00 FORMAT "%13.2" ECU_ADDRESS 0x60000860 /end MEASUREMENT
/begin MEASUREMENT FanSpd_swtSensMode "" UBYTE OneToOne 1 100 0.00 255.0 FORMAT "%5.1" ECU_ADDRESS 0x600237E6 /end MEASUREMENT
/begin MEASUREMENT Fans_facCor "Correction factor" UWORD RBPtCel_fac_0p0001_2 1 100 0.00 6.553500 FORMAT "%8.6" ECU_ADDRESS 0x6001F4BC
 /begin IF_DATA XCPplus 0x0102
  /begin DAQ_EVENT VARIABLE /end DAQ_EVENT
 /end IF_DATA
/end MEASUREMENT
/begin MEASUREMENT Fans_Ramp_I.State "Ramp for first fan path / State of the ramp" SLONG OneToOne 1 100 -2147483648.00 2147483647.00 FORMAT "%13.2" ECU_ADDRESS 0x60000854 /end MEASUREMENT
/begin MEASUREMENT Fans_Ramp_I.Dir "Ramp for first fan path / Ramp Direction" SBYTE OneToOne 1 100 -128.0 127.0 FORMAT "%5.1" ECU_ADDRESS 0x60000858 /end MEASUREMENT
/begin MEASUREMENT Fans_Ramp_I.Switch "Ramp for first fan path / Position of switch" SBYTE OneToOne 1 100 -128.0 127.0 FORMAT "%5.1" ECU_ADDRESS 0x60000859 /end MEASUREMENT
/begin MEASUREMENT Fans_ratClgDemFan1 "desired ratio for fan 1" UBYTE RBPtCel_Perc_1p0_1 1 100 0.00 255.0 FORMAT "%5.1" ECU_ADDRESS 0x6002314C
 /begin IF_DATA XCPplus 0x0102
  /begin DAQ_EVENT VARIABLE /end DAQ_EVENT
 /end IF_DATA
/end MEASUREMENT
/begin MEASUREMENT Fans_ratCoolgDes1 "raw requeted ratio for fan 1" UBYTE RBPtCel_Perc_1p0_1 1 100 0.00 255.0 FORMAT "%5.1" ECU_ADDRESS 0x6002344E
 /begin IF_DATA XCPplus 0x0102
  /begin DAQ_EVENT VARIABLE /end DAQ_EVENT
 /end IF_DATA
/end MEASUREMENT
/begin MEASUREMENT Fans_ratCorFan1 "corrected fan ratio of fan 1" SLONG RBPtCel_fac_0p001_2 1 100 -2147483.64800 2147483.64700 FORMAT "%13.5" ECU_ADDRESS 0x6000085C
 /begin IF_DATA XCPplus 0x0102
  /begin DAQ_EVENT VARIABLE /end DAQ_EVENT
 /end IF_DATA
/end MEASUREMENT
/begin MEASUREMENT FreonP_DDstSnsrState_mp "" UBYTE OneToOne 1 100 0.00 255.0 FORMAT "%5.1" ECU_ADDRESS 0x70006C07 /end MEASUREMENT
/begin MEASUREMENT FreonP_FirCalc.cntrAvrgZr " / Counter for 0-division in FIR (indicates failure)" UBYTE OneToOne 1 100 0.00 255.0 FORMAT "%5.1" ECU_ADDRESS 0x6001F4B6 /end MEASUREMENT
/begin MEASUREMENT FreonP_FirCalc.flgRdDne " / FIR: reading from uRaw-sum done" UBYTE OneToOne 1 100 0.00 1.000 BIT_MASK 0x1 FORMAT "%5.3" ECU_ADDRESS 0x6001F4B7 /end MEASUREMENT
/begin MEASUREMENT FreonP_FirCalc.uRawAvrg " / FIR: simple average calculated uRaw" SWORD Volt 1 100 -6553.600 6553.400 FORMAT "%8.3" ECU_ADDRESS 0x6001F4B8 /end MEASUREMENT
/begin MEASUREMENT FreonP_FirCalc.uRawFir " / FIR: Calculated uRaw" SWORD Volt 1 100 -6553.600 6553.400 FORMAT "%8.3" ECU_ADDRESS 0x6001F4BA /end MEASUREMENT
/begin MEASUREMENT FreonP_FirRead.cntr " / Counter for simple average FIR" UBYTE OneToOne 1 100 0.00 255.0 FORMAT "%5.1" ECU_ADDRESS 0x60000848 /end MEASUREMENT
/begin MEASUREMENT FreonP_FirRead.flgFirstRun " / FIR: 1st run after init" UBYTE OneToOne 1 100 0.00 1.000 BIT_MASK 0x1 FORMAT "%5.3" ECU_ADDRESS 0x60000849 /end MEASUREMENT
/begin MEASUREMENT FreonP_FirRead.idxArr " / FIR ringbuffer: actual index" UBYTE OneToOne 1 100 0.00 255.0 FORMAT "%5.1" ECU_ADDRESS 0x6000084A /end MEASUREMENT
/begin MEASUREMENT FreonP_FirRead.uSum " / Simple average FIR: sum of uRaws" SLONG Volt 1 100 -429496729.600 429496729.400 FORMAT "%13.3" ECU_ADDRESS 0x6000084C /end MEASUREMENT
/begin MEASUREMENT FreonP_p "" SWORD p_q0p1_bar 1 100 -3276.800 3276.700 FORMAT "%8.3" ECU_ADDRESS 0x6001FDD0
 /begin IF_DATA XCPplus 0x0102
  /begin DAQ_EVENT VARIABLE /end DAQ_EVENT
 /end IF_DATA
/end MEASUREMENT
/begin MEASUREMENT FreonP_pDynThresPhysRngHi_f_mp "" FLOAT32_IEEE RBPtCel_p_1p0_1 1 100 -1.00000000E+037 1.00000000E+037 FORMAT "%13.3" ECU_ADDRESS 0x70006884 /end MEASUREMENT
/begin MEASUREMENT FreonP_pDynThresPhysRngLo_f_mp "" FLOAT32_IEEE RBPtCel_p_1p0_1 1 100 -1.00000000E+037 1.00000000E+037 FORMAT "%13.3" ECU_ADDRESS 0x70006880 /end MEASUREMENT
/begin MEASUREMENT FreonP_pSens "" SWORD p_q0p1_bar 1 100 -3276.800 3276.700 FORMAT "%8.3" ECU_ADDRESS 0x6001FDCE
 /begin IF_DATA XCPplus 0x0102
  /begin DAQ_EVENT VARIABLE /end DAQ_EVENT
 /end IF_DATA
/end MEASUREMENT
/begin MEASUREMENT FreonP_pSensCpl "" SWORD OneToOne 1 100 -32768.00 32767.00 FORMAT "%8.2" ECU_ADDRESS 0x6001FDCC
 /begin IF_DATA XCPplus 0x0102
  /begin DAQ_EVENT VARIABLE /end DAQ_EVENT
 /end IF_DATA
/end MEASUREMENT
/begin MEASUREMENT FreonP_pSensGradLim_f_mp "" FLOAT32_IEEE RBPtCel_p_1p0_1 1 100 -1.00000000E+037 1.00000000E+037 FORMAT "%13.3" ECU_ADDRESS 0x70006888
 /begin IF_DATA XCPplus 0x0102
  /begin DAQ_EVENT VARIABLE /end DAQ_EVENT
 /end IF_DATA
/end MEASUREMENT
/begin MEASUREMENT FreonP_pSensOffsCorrd_f "" FLOAT32_IEEE RBPtCel_p_1p0_1 1 100 -1.00000000E+037 1.00000000E+037 FORMAT "%13.3" ECU_ADDRESS 0x60001194
 /begin IF_DATA XCPplus 0x0102
  /begin DAQ_EVENT VARIABLE /end DAQ_EVENT
 /end IF_DATA
/end MEASUREMENT
/begin MEASUREMENT FreonP_pSensUnFltd "" SWORD RBPtCel_p_1p0_1 1 100 -32768.00 32767.00 FORMAT "%8.2" ECU_ADDRESS 0x6001FDCA
 /begin IF_DATA XCPplus 0x0102
  /begin DAQ_EVENT VARIABLE /end DAQ_EVENT
 /end IF_DATA
/end MEASUREMENT
/begin MEASUREMENT FreonP_pSens_f "" FLOAT32_IEEE RBPtCel_p_1p0_1 1 100 -1.00000000E+037 1.00000000E+037 FORMAT "%13.3" ECU_ADDRESS 0x60001190
 /begin IF_DATA XCPplus 0x0102
  /begin DAQ_EVENT VARIABLE /end DAQ_EVENT
 /end IF_DATA
/end MEASUREMENT
/begin MEASUREMENT FreonP_pUnFlt_f "" FLOAT32_IEEE RBPtCel_p_1p0_1 1 100 -1.00000000E+037 1.00000000E+037 FORMAT "%13.3" ECU_ADDRESS 0x6000118C
 /begin IF_DATA XCPplus 0x0102
  /begin DAQ_EVENT VARIABLE /end DAQ_EVENT
 /end IF_DATA
/end MEASUREMENT
/begin MEASUREMENT FreonP_p_f "Actual physical value" FLOAT32_IEEE RBPtCel_p_1p0_1 1 100 -1.00000000E+037 1.00000000E+037 FORMAT "%13.3" ECU_ADDRESS 0x60001188
 /begin IF_DATA XCPplus 0x0102
  /begin DAQ_EVENT VARIABLE /end DAQ_EVENT
 /end IF_DATA
/end MEASUREMENT
/begin MEASUREMENT FreonP_p_f_Sq "" UBYTE SigQly_COMPU_VERB 1 100 0.00 15.0000000000 FORMAT "%13.10" ECU_ADDRESS 0x600237E4
 /begin IF_DATA XCPplus 0x0102
  /begin DAQ_EVENT VARIABLE /end DAQ_EVENT
 /end IF_DATA
/end MEASUREMENT
/begin MEASUREMENT FreonP_stMonStdSens "" ULONG OneToOne 1 100 0.00 4294967295.00 FORMAT "%13.2" ECU_ADDRESS 0x60001044
 /begin IF_DATA XCPplus 0x0102
  /begin DAQ_EVENT VARIABLE /end DAQ_EVENT
 /end IF_DATA
/end MEASUREMENT
/begin MEASUREMENT FreonP_stSnsrActv "" UBYTE OneToOne 1 100 0.00 255.0 BIT_MASK 0x1 FORMAT "%5.1" ECU_ADDRESS 0x600236B1
 /begin IF_DATA XCPplus 0x0102
  /begin DAQ_EVENT VARIABLE /end DAQ_EVENT
 /end IF_DATA
/end MEASUREMENT
/begin MEASUREMENT FreonP_stSnsrDdCalc "" UBYTE OneToOne 1 100 0.00 255.0 BIT_MASK 0x1 FORMAT "%5.1" ECU_ADDRESS 0x600236B0
 /begin IF_DATA XCPplus 0x0102
  /begin DAQ_EVENT VARIABLE /end DAQ_EVENT
 /end IF_DATA
/end MEASUREMENT
/begin MEASUREMENT FreonP_stSnsrDdReadCalc "" UBYTE OneToOne 1 100 0.00 255.0 BIT_MASK 0x1 FORMAT "%5.1" ECU_ADDRESS 0x600236AF
 /begin IF_DATA XCPplus 0x0102
  /begin DAQ_EVENT VARIABLE /end DAQ_EVENT
 /end IF_DATA
/end MEASUREMENT
/begin MEASUREMENT FreonP_swtConfStdSens2C "" ULONG OneToOne 1 100 0.00 4294967295.00 FORMAT "%13.2" ECU_ADDRESS 0x60000844 /end MEASUREMENT
/begin MEASUREMENT FreonP_swtConfStdSensC "" ULONG OneToOne 1 100 0.00 4294967295.00 FORMAT "%13.2" ECU_ADDRESS 0x60000840 /end MEASUREMENT
/begin MEASUREMENT FreonP_swtConfStdSensSwVersC "" ULONG OneToOne 1 100 0.00 4294967295.00 FORMAT "%13.2" ECU_ADDRESS 0x6000083C /end MEASUREMENT
/begin MEASUREMENT FreonP_swtSensMode "" UBYTE OneToOne 1 100 0.00 255.0 FORMAT "%5.1" ECU_ADDRESS 0x600237E3 /end MEASUREMENT
/begin MEASUREMENT FreonP_swtSensPres "" UBYTE OneToOne 1 100 0.00 255.0 FORMAT "%5.1" ECU_ADDRESS 0x600237E2
 /begin IF_DATA XCPplus 0x0102
  /begin DAQ_EVENT VARIABLE /end DAQ_EVENT
 /end IF_DATA
/end MEASUREMENT
/begin MEASUREMENT FreonP_tiSRCMaxDefDeb "" SLONG Time_ms 1 100 -21474836480.0 21474836470.0 FORMAT "%13.1" ECU_ADDRESS 0x600010AC
 /begin IF_DATA XCPplus 0x0102
  /begin DAQ_EVENT VARIABLE /end DAQ_EVENT
 /end IF_DATA
/end MEASUREMENT
/begin MEASUREMENT FreonP_tRefSnsr_mp "" SWORD Temp_Cels 1 100 -3549.940 3003.560 FORMAT "%8.3" ECU_ADDRESS 0x7000698A /end MEASUREMENT
/begin MEASUREMENT FreonP_tSensPT1Fltd_mp "" SWORD RBPtCel_p_1p0_1 1 100 -32768.00 32767.00 FORMAT "%8.2" ECU_ADDRESS 0x70006988 /end MEASUREMENT
/begin MEASUREMENT FreonP_uRaw "" SWORD Volt 1 100 -6553.600 6553.400 FORMAT "%8.3" ECU_ADDRESS 0x6001FDC6
 /begin IF_DATA XCPplus 0x0102
  /begin DAQ_EVENT VARIABLE /end DAQ_EVENT
 /end IF_DATA
/end MEASUREMENT
/begin MEASUREMENT FreonP_uRawPT1Fltd "" SWORD Volt 1 100 -6553.600 6553.400 FORMAT "%8.3" ECU_ADDRESS 0x6001FDC4
 /begin IF_DATA XCPplus 0x0102
  /begin DAQ_EVENT VARIABLE /end DAQ_EVENT
 /end IF_DATA
/end MEASUREMENT
/begin MEASUREMENT FreonP_uRawPT1FltdSens "" SWORD Volt 1 100 -6553.600 6553.400 FORMAT "%8.3" ECU_ADDRESS 0x6001FDC2
 /begin IF_DATA XCPplus 0x0102
  /begin DAQ_EVENT VARIABLE /end DAQ_EVENT
 /end IF_DATA
/end MEASUREMENT
/begin MEASUREMENT FreonP_uRawUnFltd "" SWORD Volt 1 100 -6553.600 6553.400 FORMAT "%8.3" ECU_ADDRESS 0x6001FDC0
 /begin IF_DATA XCPplus 0x0102
  /begin DAQ_EVENT VARIABLE /end DAQ_EVENT
 /end IF_DATA
/end MEASUREMENT
/begin MEASUREMENT FreonP_uRaw_f "" FLOAT32_IEEE RBPtCel_u_1p0_2 1 100 -1.00000000E+037 1.00000000E+037 FORMAT "%13.3" ECU_ADDRESS 0x60001184
 /begin IF_DATA XCPplus 0x0102
  /begin DAQ_EVENT VARIABLE /end DAQ_EVENT
 /end IF_DATA
/end MEASUREMENT
/begin MEASUREMENT GlbDa_bChrgnSockCfg "Chanrging Socket configuration" UBYTE OneToOne 1 100 0.00 1.000 BIT_MASK 0x1 FORMAT "%5.3" ECU_ADDRESS 0x70000281 /end MEASUREMENT
/begin MEASUREMENT GlbDa_cntVarCodNum "number of successful codings" UBYTE OneToOne 1 100 0.00 255.0 FORMAT "%5.1" ECU_ADDRESS 0x60023571 /end MEASUREMENT
/begin MEASUREMENT GlbDa_codVarCodUC "The various coding field groups several smaller configurations field, that are mainly options that might be existing in the configured vehicle" UBYTE OneToOne 1 100 0.00 255.0 FORMAT "%5.1" ECU_ADDRESS 0x60023570 /end MEASUREMENT
/begin MEASUREMENT GlbDa_lDst "total travelled distance" SLONG Length 1 100 -2147483648.00 2147483647.00 FORMAT "%13.2" ECU_ADDRESS 0x60000F68
 /begin IF_DATA XCPplus 0x0102
  /begin DAQ_EVENT VARIABLE /end DAQ_EVENT
 /end IF_DATA
/end MEASUREMENT
/begin MEASUREMENT GlbDa_lDstLstStored "last value of total distance in EEP" SLONG Length 1 100 -2147483648.00 2147483647.00 FORMAT "%13.2" ECU_ADDRESS 0x60000838
 /begin IF_DATA XCPplus 0x0102
  /begin DAQ_EVENT VARIABLE /end DAQ_EVENT
 /end IF_DATA
/end MEASUREMENT
/begin MEASUREMENT GlbDa_lDstLstStoredProtd "last value of total distance in EEP" SLONG Length 1 100 -2147483648.00 2147483647.00 FORMAT "%13.2" ECU_ADDRESS 0x600347DC
 /begin IF_DATA XCPplus 0x0102
  /begin DAQ_EVENT VARIABLE /end DAQ_EVENT
 /end IF_DATA
/end MEASUREMENT
/begin MEASUREMENT GlbDa_lTotDst "total distance since first start" SLONG Length 1 100 -2147483648.00 2147483647.00 FORMAT "%13.2" ECU_ADDRESS 0x60000F64
 /begin IF_DATA XCPplus 0x0102
  /begin DAQ_EVENT VARIABLE /end DAQ_EVENT
 /end IF_DATA
/end MEASUREMENT
/begin MEASUREMENT GlbDa_lTotDstProtd "total distance since first start" SLONG Length 1 100 -2147483648.00 2147483647.00 FORMAT "%13.2" ECU_ADDRESS 0x600347D8
 /begin IF_DATA XCPplus 0x0102
  /begin DAQ_EVENT VARIABLE /end DAQ_EVENT
 /end IF_DATA
/end MEASUREMENT
/begin MEASUREMENT GlbDa_stEepOrder "return value of EEP write function" UBYTE OneToOne 1 100 0.00 255.0 FORMAT "%5.1" ECU_ADDRESS 0x60023148 /end MEASUREMENT
/begin MEASUREMENT GlbDa_stEepWrite "state machine for direct write to EEP" UBYTE OneToOne 1 100 0.00 255.0 FORMAT "%5.1" ECU_ADDRESS 0x60023147
 /begin IF_DATA XCPplus 0x0102
  /begin DAQ_EVENT VARIABLE /end DAQ_EVENT
 /end IF_DATA
/end MEASUREMENT
/begin MEASUREMENT GlbDa_stErrVarCod "error state of varinat coding" UBYTE OneToOne 1 100 0.00 255.0 FORMAT "%5.1" ECU_ADDRESS 0x6002356F
 /begin IF_DATA XCPplus 0x0102
  /begin DAQ_EVENT VARIABLE /end DAQ_EVENT
 /end IF_DATA
/end MEASUREMENT
/begin MEASUREMENT GlbDa_versVarCod "Remote Coding Index" UBYTE OneToOne 1 100 0.00 255.0 FORMAT "%5.1" ECU_ADDRESS 0x6002356E /end MEASUREMENT
/begin MEASUREMENT HeatrCoreT_DDstSnsrState_mp "" UBYTE OneToOne 1 100 0.00 255.0 FORMAT "%5.1" ECU_ADDRESS 0x70006C06 /end MEASUREMENT
/begin MEASUREMENT HeatrCoreT_FirCalc.cntrAvrgZr " / Counter for 0-division in FIR (indicates failure)" UBYTE OneToOne 1 100 0.00 255.0 FORMAT "%5.1" ECU_ADDRESS 0x6001F4B0 /end MEASUREMENT
/begin MEASUREMENT HeatrCoreT_FirCalc.flgRdDne " / FIR: reading from uRaw-sum done" UBYTE OneToOne 1 100 0.00 1.000 BIT_MASK 0x1 FORMAT "%5.3" ECU_ADDRESS 0x6001F4B1 /end MEASUREMENT
/begin MEASUREMENT HeatrCoreT_FirCalc.uRawAvrg " / FIR: simple average calculated uRaw" SWORD Volt 1 100 -6553.600 6553.400 FORMAT "%8.3" ECU_ADDRESS 0x6001F4B2 /end MEASUREMENT
/begin MEASUREMENT HeatrCoreT_FirCalc.uRawFir " / FIR: Calculated uRaw" SWORD Volt 1 100 -6553.600 6553.400 FORMAT "%8.3" ECU_ADDRESS 0x6001F4B4 /end MEASUREMENT
/begin MEASUREMENT HeatrCoreT_FirRead.cntr " / Counter for simple average FIR" UBYTE OneToOne 1 100 0.00 255.0 FORMAT "%5.1" ECU_ADDRESS 0x6000082C /end MEASUREMENT
/begin MEASUREMENT HeatrCoreT_FirRead.flgFirstRun " / FIR: 1st run after init" UBYTE OneToOne 1 100 0.00 1.000 BIT_MASK 0x1 FORMAT "%5.3" ECU_ADDRESS 0x6000082D /end MEASUREMENT
/begin MEASUREMENT HeatrCoreT_FirRead.idxArr " / FIR ringbuffer: actual index" UBYTE OneToOne 1 100 0.00 255.0 FORMAT "%5.1" ECU_ADDRESS 0x6000082E /end MEASUREMENT
/begin MEASUREMENT HeatrCoreT_FirRead.uSum " / Simple average FIR: sum of uRaws" SLONG Volt 1 100 -429496729.600 429496729.400 FORMAT "%13.3" ECU_ADDRESS 0x60000830 /end MEASUREMENT
/begin MEASUREMENT HeatrCoreT_stMonStdSens "" ULONG OneToOne 1 100 0.00 4294967295.00 FORMAT "%13.2" ECU_ADDRESS 0x60001040
 /begin IF_DATA XCPplus 0x0102
  /begin DAQ_EVENT VARIABLE /end DAQ_EVENT
 /end IF_DATA
/end MEASUREMENT
/begin MEASUREMENT HeatrCoreT_stSnsrActv "" UBYTE OneToOne 1 100 0.00 255.0 BIT_MASK 0x1 FORMAT "%5.1" ECU_ADDRESS 0x600236AE
 /begin IF_DATA XCPplus 0x0102
  /begin DAQ_EVENT VARIABLE /end DAQ_EVENT
 /end IF_DATA
/end MEASUREMENT
/begin MEASUREMENT HeatrCoreT_stSnsrDdCalc "" UBYTE OneToOne 1 100 0.00 255.0 BIT_MASK 0x1 FORMAT "%5.1" ECU_ADDRESS 0x600236AD
 /begin IF_DATA XCPplus 0x0102
  /begin DAQ_EVENT VARIABLE /end DAQ_EVENT
 /end IF_DATA
/end MEASUREMENT
/begin MEASUREMENT HeatrCoreT_stSnsrDdReadCalc "" UBYTE OneToOne 1 100 0.00 255.0 BIT_MASK 0x1 FORMAT "%5.1" ECU_ADDRESS 0x600236AC
 /begin IF_DATA XCPplus 0x0102
  /begin DAQ_EVENT VARIABLE /end DAQ_EVENT
 /end IF_DATA
/end MEASUREMENT
/begin MEASUREMENT HeatrCoreT_swtConfStdSens2C "" ULONG OneToOne 1 100 0.00 4294967295.00 FORMAT "%13.2" ECU_ADDRESS 0x60000828 /end MEASUREMENT
/begin MEASUREMENT HeatrCoreT_swtConfStdSensC "" ULONG OneToOne 1 100 0.00 4294967295.00 FORMAT "%13.2" ECU_ADDRESS 0x60000824 /end MEASUREMENT
/begin MEASUREMENT HeatrCoreT_swtConfStdSensSwVersC "" ULONG OneToOne 1 100 0.00 4294967295.00 FORMAT "%13.2" ECU_ADDRESS 0x60000820 /end MEASUREMENT
/begin MEASUREMENT HeatrCoreT_swtSensMode "" UBYTE OneToOne 1 100 0.00 255.0 FORMAT "%5.1" ECU_ADDRESS 0x600237E1 /end MEASUREMENT
/begin MEASUREMENT HeatrCoreT_swtSensPres "" UBYTE OneToOne 1 100 0.00 255.0 FORMAT "%5.1" ECU_ADDRESS 0x600237E0
 /begin IF_DATA XCPplus 0x0102
  /begin DAQ_EVENT VARIABLE /end DAQ_EVENT
 /end IF_DATA
/end MEASUREMENT
/begin MEASUREMENT HeatrCoreT_tDynThresPhysRngHi_f_mp "" FLOAT32_IEEE RBPtCel_t_1p0_3 1 100 -1.00000000E+037 1.00000000E+037 FORMAT "%13.3" ECU_ADDRESS 0x70006878 /end MEASUREMENT
/begin MEASUREMENT HeatrCoreT_tDynThresPhysRngLo_f_mp "" FLOAT32_IEEE RBPtCel_t_1p0_3 1 100 -1.00000000E+037 1.00000000E+037 FORMAT "%13.3" ECU_ADDRESS 0x70006874 /end MEASUREMENT
/begin MEASUREMENT HeatrCoreT_tiSRCMaxDefDeb "" SLONG Time_ms 1 100 -21474836480.0 21474836470.0 FORMAT "%13.1" ECU_ADDRESS 0x600010A8
 /begin IF_DATA XCPplus 0x0102
  /begin DAQ_EVENT VARIABLE /end DAQ_EVENT
 /end IF_DATA
/end MEASUREMENT
/begin MEASUREMENT HeatrCoreT_tRefSnsr_mp "" SWORD Temp_Cels 1 100 -3549.940 3003.560 FORMAT "%8.3" ECU_ADDRESS 0x70006986 /end MEASUREMENT
/begin MEASUREMENT HeatrCoreT_tSensCpl "" SWORD OneToOne 1 100 -32768.00 32767.00 FORMAT "%8.2" ECU_ADDRESS 0x6001FDBE
 /begin IF_DATA XCPplus 0x0102
  /begin DAQ_EVENT VARIABLE /end DAQ_EVENT
 /end IF_DATA
/end MEASUREMENT
/begin MEASUREMENT HeatrCoreT_tSensGradLim_f_mp "" FLOAT32_IEEE RBPtCel_t_1p0_3 1 100 -1.00000000E+037 1.00000000E+037 FORMAT "%13.3" ECU_ADDRESS 0x7000687C
 /begin IF_DATA XCPplus 0x0102
  /begin DAQ_EVENT VARIABLE /end DAQ_EVENT
 /end IF_DATA
/end MEASUREMENT
/begin MEASUREMENT HeatrCoreT_tSensOffsCorrd_f "" FLOAT32_IEEE RBPtCel_t_1p0_3 1 100 -1.00000000E+037 1.00000000E+037 FORMAT "%13.3" ECU_ADDRESS 0x60001170
 /begin IF_DATA XCPplus 0x0102
  /begin DAQ_EVENT VARIABLE /end DAQ_EVENT
 /end IF_DATA
/end MEASUREMENT
/begin MEASUREMENT HeatrCoreT_tSensPT1Fltd_mp "" SWORD RBPtCel_t_1p0_3 1 100 -32768.00 32767.00 FORMAT "%8.2" ECU_ADDRESS 0x70006984 /end MEASUREMENT
/begin MEASUREMENT HeatrCoreT_tSensUnFltd "" SWORD RBPtCel_t_1p0_3 1 100 -32768.00 32767.00 FORMAT "%8.2" ECU_ADDRESS 0x6001FDBA
 /begin IF_DATA XCPplus 0x0102
  /begin DAQ_EVENT VARIABLE /end DAQ_EVENT
 /end IF_DATA
/end MEASUREMENT
/begin MEASUREMENT HeatrCoreT_tSens_f "" FLOAT32_IEEE RBPtCel_t_1p0_3 1 100 -1.00000000E+037 1.00000000E+037 FORMAT "%13.3" ECU_ADDRESS 0x6000116C
 /begin IF_DATA XCPplus 0x0102
  /begin DAQ_EVENT VARIABLE /end DAQ_EVENT
 /end IF_DATA
/end MEASUREMENT
/begin MEASUREMENT HeatrCoreT_tUnFlt_f "" FLOAT32_IEEE RBPtCel_t_1p0_3 1 100 -1.00000000E+037 1.00000000E+037 FORMAT "%13.3" ECU_ADDRESS 0x60001168
 /begin IF_DATA XCPplus 0x0102
  /begin DAQ_EVENT VARIABLE /end DAQ_EVENT
 /end IF_DATA
/end MEASUREMENT
/begin MEASUREMENT HeatrCoreT_t_f "Actual physical value" FLOAT32_IEEE RBPtCel_t_1p0_3 1 100 -1.00000000E+037 1.00000000E+037 FORMAT "%13.3" ECU_ADDRESS 0x60001164
 /begin IF_DATA XCPplus 0x0102
  /begin DAQ_EVENT VARIABLE /end DAQ_EVENT
 /end IF_DATA
/end MEASUREMENT
/begin MEASUREMENT HeatrCoreT_t_f_Sq "" UBYTE SigQly_COMPU_VERB 1 100 0.00 15.0000000000 FORMAT "%13.10" ECU_ADDRESS 0x600237DF
 /begin IF_DATA XCPplus 0x0102
  /begin DAQ_EVENT VARIABLE /end DAQ_EVENT
 /end IF_DATA
/end MEASUREMENT
/begin MEASUREMENT HeatrCoreT_uRaw "" SWORD Volt 1 100 -6553.600 6553.400 FORMAT "%8.3" ECU_ADDRESS 0x6001FDB8
 /begin IF_DATA XCPplus 0x0102
  /begin DAQ_EVENT VARIABLE /end DAQ_EVENT
 /end IF_DATA
/end MEASUREMENT
/begin MEASUREMENT HeatrCoreT_uRawPT1Fltd "" SWORD Volt 1 100 -6553.600 6553.400 FORMAT "%8.3" ECU_ADDRESS 0x6001FDB6
 /begin IF_DATA XCPplus 0x0102
  /begin DAQ_EVENT VARIABLE /end DAQ_EVENT
 /end IF_DATA
/end MEASUREMENT
/begin MEASUREMENT HeatrCoreT_uRawPT1FltdSens "" SWORD Volt 1 100 -6553.600 6553.400 FORMAT "%8.3" ECU_ADDRESS 0x6001FDB4
 /begin IF_DATA XCPplus 0x0102
  /begin DAQ_EVENT VARIABLE /end DAQ_EVENT
 /end IF_DATA
/end MEASUREMENT
/begin MEASUREMENT HeatrCoreT_uRawUnFltd "" SWORD Volt 1 100 -6553.600 6553.400 FORMAT "%8.3" ECU_ADDRESS 0x6001FDB2
 /begin IF_DATA XCPplus 0x0102
  /begin DAQ_EVENT VARIABLE /end DAQ_EVENT
 /end IF_DATA
/end MEASUREMENT
/begin MEASUREMENT HeatrCoreT_uRaw_f "" FLOAT32_IEEE RBPtCel_u_1p0_2 1 100 -1.00000000E+037 1.00000000E+037 FORMAT "%13.3" ECU_ADDRESS 0x60001160
 /begin IF_DATA XCPplus 0x0102
  /begin DAQ_EVENT VARIABLE /end DAQ_EVENT
 /end IF_DATA
/end MEASUREMENT
/begin MEASUREMENT HeatrRly1_st "e_:Final switch status:_e;d_:Schalterzustand:_d" UBYTE B_TRUE 1 100 0.00 1.00000000000 BIT_MASK 0x1 FORMAT "%13.11" ECU_ADDRESS 0x70000252
 /begin IF_DATA XCPplus 0x0102
  /begin DAQ_EVENT VARIABLE /end DAQ_EVENT
 /end IF_DATA
/end MEASUREMENT
/begin MEASUREMENT HeatrRly1_stRaw "" UBYTE B_TRUE 1 100 0.00 1.00000000000 BIT_MASK 0x1 FORMAT "%13.11" ECU_ADDRESS 0x70000251
 /begin IF_DATA XCPplus 0x0102
  /begin DAQ_EVENT VARIABLE /end DAQ_EVENT
 /end IF_DATA
/end MEASUREMENT
/begin MEASUREMENT HeatrRly1_st_Sq "" UBYTE SigQly_COMPU_VERB 1 100 0.00 15.0000000000 FORMAT "%13.10" ECU_ADDRESS 0x700014B8
 /begin IF_DATA XCPplus 0x0102
  /begin DAQ_EVENT VARIABLE /end DAQ_EVENT
 /end IF_DATA
/end MEASUREMENT
/begin MEASUREMENT HLCCcs_cntrChrgnSdlEntry "Number of power entryes for power schaduling" UWORD OneToOne 1 100 0.00 65535.00 FORMAT "%8.2" ECU_ADDRESS 0x6001F4AE
 /begin IF_DATA XCPplus 0x0102
  /begin DAQ_EVENT VARIABLE /end DAQ_EVENT
 /end IF_DATA
/end MEASUREMENT
/begin MEASUREMENT HLCCcs_cntrPwrEntrySdlTpl1 "Total number of power entries" UWORD OneToOne 1 100 0.00 65535.00 FORMAT "%8.2" ECU_ADDRESS 0x6001FA34
 /begin IF_DATA XCPplus 0x0102
  /begin DAQ_EVENT VARIABLE /end DAQ_EVENT
 /end IF_DATA
/end MEASUREMENT
/begin MEASUREMENT HLCCcs_flgCcsDcAvl "CCS DC available" UBYTE B_TRUE 1 100 0.00 1.00000000000 BIT_MASK 0x1 FORMAT "%13.11" ECU_ADDRESS 0x70000280
 /begin IF_DATA XCPplus 0x0102
  /begin DAQ_EVENT VARIABLE /end DAQ_EVENT
 /end IF_DATA
/end MEASUREMENT
/begin MEASUREMENT HLCCcs_flgChrgnSdlEntryExcdd "Elapsed charging time exceeded charging time slot of one entry given by charging schedule. Next charging time slot will be taken." UBYTE B_TRUE 1 100 0.00 1.00000000000 BIT_MASK 0x1 FORMAT "%13.11" ECU_ADDRESS 0x7000017B
 /begin IF_DATA XCPplus 0x0102
  /begin DAQ_EVENT VARIABLE /end DAQ_EVENT
 /end IF_DATA
/end MEASUREMENT
/begin MEASUREMENT HLCCcs_flgChrgnSdlTiEna "Enable charging schedule timer" UBYTE B_TRUE 1 100 0.00 1.00000000000 BIT_MASK 0x1 FORMAT "%13.11" ECU_ADDRESS 0x7000017A
 /begin IF_DATA XCPplus 0x0102
  /begin DAQ_EVENT VARIABLE /end DAQ_EVENT
 /end IF_DATA
/end MEASUREMENT
/begin MEASUREMENT HLCCcs_flgChrgnStopReq "Charging stop requested by EVSE" UBYTE B_TRUE 1 100 0.00 1.00000000000 BIT_MASK 0x1 FORMAT "%13.11" ECU_ADDRESS 0x7000027F
 /begin IF_DATA XCPplus 0x0102
  /begin DAQ_EVENT VARIABLE /end DAQ_EVENT
 /end IF_DATA
/end MEASUREMENT
/begin MEASUREMENT HLCCcs_flgChrgnStopReqDIN "Charging stop requested by EVSE for DIN" UBYTE B_TRUE 1 100 0.00 1.00000000000 BIT_MASK 0x1 FORMAT "%13.11" ECU_ADDRESS 0x7000027E
 /begin IF_DATA XCPplus 0x0102
  /begin DAQ_EVENT VARIABLE /end DAQ_EVENT
 /end IF_DATA
/end MEASUREMENT
/begin MEASUREMENT HLCCcs_flgCtpSwtTogActvOld "Previous value of the flag that indicates if toggling of S2 switch is active" UBYTE B_TRUE 1 100 0.00 1.00000000000 BIT_MASK 0x1 FORMAT "%13.11" ECU_ADDRESS 0x60023146
 /begin IF_DATA XCPplus 0x0102
  /begin DAQ_EVENT VARIABLE /end DAQ_EVENT
 /end IF_DATA
/end MEASUREMENT
/begin MEASUREMENT HLCCcs_flgEgyTrfModNotCmpbl "Available energy transfer mode is not compatible" UBYTE B_TRUE 1 100 0.00 1.00000000000 BIT_MASK 0x1 FORMAT "%13.11" ECU_ADDRESS 0x7000027D
 /begin IF_DATA XCPplus 0x0102
  /begin DAQ_EVENT VARIABLE /end DAQ_EVENT
 /end IF_DATA
/end MEASUREMENT
/begin MEASUREMENT HLCCcs_flgEthStrt "Communication control state between microcontroller and power line communication chip" UBYTE B_TRUE 1 100 0.00 1.00000000000 BIT_MASK 0x1 FORMAT "%13.11" ECU_ADDRESS 0x7000027C
 /begin IF_DATA XCPplus 0x0102
  /begin DAQ_EVENT VARIABLE /end DAQ_EVENT
 /end IF_DATA
/end MEASUREMENT
/begin MEASUREMENT HLCCcs_flgEthStrtOld "Previous communication control state between microcontroller and power line communication chip" UBYTE B_TRUE 1 100 0.00 1.00000000000 BIT_MASK 0x1 FORMAT "%13.11" ECU_ADDRESS 0x60023145
 /begin IF_DATA XCPplus 0x0102
  /begin DAQ_EVENT VARIABLE /end DAQ_EVENT
 /end IF_DATA
/end MEASUREMENT
/begin MEASUREMENT HLCCcs_flgEvRdy "EV ready" UBYTE B_TRUE 1 100 0.00 1.00000000000 BIT_MASK 0x1 FORMAT "%13.11" ECU_ADDRESS 0x7000027B
 /begin IF_DATA XCPplus 0x0102
  /begin DAQ_EVENT VARIABLE /end DAQ_EVENT
 /end IF_DATA
/end MEASUREMENT
/begin MEASUREMENT HLCCcs_flgFctCtrlRSFFLoc "Function Control RSFF local" UBYTE B_TRUE 1 100 0.00 1.00000000000 BIT_MASK 0x1 FORMAT "%13.11" ECU_ADDRESS 0x70000179
 /begin IF_DATA XCPplus 0x0102
  /begin DAQ_EVENT VARIABLE /end DAQ_EVENT
 /end IF_DATA
/end MEASUREMENT
/begin MEASUREMENT HLCCcs_flgPLnCEna "Enable PLC chip" UBYTE B_TRUE 1 100 0.00 1.00000000000 BIT_MASK 0x1 FORMAT "%13.11" ECU_ADDRESS 0x7000027A
 /begin IF_DATA XCPplus 0x0102
  /begin DAQ_EVENT VARIABLE /end DAQ_EVENT
 /end IF_DATA
/end MEASUREMENT
/begin MEASUREMENT HLCCcs_flgRestrtAllwd "Flag which represents if reset of charging process is allowed" UBYTE B_TRUE 1 100 0.00 1.00000000000 BIT_MASK 0x1 FORMAT "%13.11" ECU_ADDRESS 0x70000178
 /begin IF_DATA XCPplus 0x0102
  /begin DAQ_EVENT VARIABLE /end DAQ_EVENT
 /end IF_DATA
/end MEASUREMENT
/begin MEASUREMENT HLCCcs_flgTogCfmRqrd "BCB toggle confirmation required" UBYTE B_TRUE 1 100 0.00 1.00000000000 BIT_MASK 0x1 FORMAT "%13.11" ECU_ADDRESS 0x60023144
 /begin IF_DATA XCPplus 0x0102
  /begin DAQ_EVENT VARIABLE /end DAQ_EVENT
 /end IF_DATA
/end MEASUREMENT
/begin MEASUREMENT HLCCcs_flgTogReq "BCB toggle requested" UBYTE B_TRUE 1 100 0.00 1.00000000000 BIT_MASK 0x1 FORMAT "%13.11" ECU_ADDRESS 0x60023493
 /begin IF_DATA XCPplus 0x0102
  /begin DAQ_EVENT VARIABLE /end DAQ_EVENT
 /end IF_DATA
/end MEASUREMENT
/begin MEASUREMENT HLCCcs_flgTogSet "Number of BCB toggles is set" UBYTE B_TRUE 1 100 0.00 1.00000000000 BIT_MASK 0x1 FORMAT "%13.11" ECU_ADDRESS 0x60023143
 /begin IF_DATA XCPplus 0x0102
  /begin DAQ_EVENT VARIABLE /end DAQ_EVENT
 /end IF_DATA
/end MEASUREMENT
/begin MEASUREMENT HLCCcs_idSdlTpl1 "SAScheduleTupleID of SAScheduleTuple 1" SWORD OneToOne 1 100 -32768.00 32767.00 FORMAT "%8.2" ECU_ADDRESS 0x6001F4AA
 /begin IF_DATA XCPplus 0x0102
  /begin DAQ_EVENT VARIABLE /end DAQ_EVENT
 /end IF_DATA
/end MEASUREMENT
/begin MEASUREMENT HLCCcs_iEvseDcMax "EVSEMaximumCurrentLimit" SWORD RBPtCel_i_0p03125_1 1 100 -1024.000 1023.969 FORMAT "%8.3" ECU_ADDRESS 0x6001FAF6
 /begin IF_DATA XCPplus 0x0102
  /begin DAQ_EVENT VARIABLE /end DAQ_EVENT
 /end IF_DATA
/end MEASUREMENT
/begin MEASUREMENT HLCCcs_iEvseDcMin "EVSEMinimumCurrentLimit" SWORD RBPtCel_i_0p03125_1 1 100 -1024.000 1023.969 FORMAT "%8.3" ECU_ADDRESS 0x6001FAF4
 /begin IF_DATA XCPplus 0x0102
  /begin DAQ_EVENT VARIABLE /end DAQ_EVENT
 /end IF_DATA
/end MEASUREMENT
/begin MEASUREMENT HLCCcs_iEvseDcPeakRpl "EVSEPeakCurrentRipple" SWORD RBPtCel_i_0p03125_1 1 100 -1024.000 1023.969 FORMAT "%8.3" ECU_ADDRESS 0x6001FAF2
 /begin IF_DATA XCPplus 0x0102
  /begin DAQ_EVENT VARIABLE /end DAQ_EVENT
 /end IF_DATA
/end MEASUREMENT
/begin MEASUREMENT HLCCcs_iEvseDcPrsnt "EVSEPresentCurrent" SWORD RBPtCel_i_0p03125_1 1 100 -1024.000 1023.969 FORMAT "%8.3" ECU_ADDRESS 0x6001FAF0
 /begin IF_DATA XCPplus 0x0102
  /begin DAQ_EVENT VARIABLE /end DAQ_EVENT
 /end IF_DATA
/end MEASUREMENT
/begin MEASUREMENT HLCCcs_iEvseDcRglnTolr "EVSECurrentRegulationTolerance" SWORD RBPtCel_i_0p03125_1 1 100 -1024.000 1023.969 FORMAT "%8.3" ECU_ADDRESS 0x6001FAEE
 /begin IF_DATA XCPplus 0x0102
  /begin DAQ_EVENT VARIABLE /end DAQ_EVENT
 /end IF_DATA
/end MEASUREMENT
/begin MEASUREMENT HLCCcs_nrTogReq "Number of requested BCB toggles" UBYTE OneToOne 1 100 0.00 255.0 FORMAT "%5.1" ECU_ADDRESS 0x6002356D
 /begin IF_DATA XCPplus 0x0102
  /begin DAQ_EVENT VARIABLE /end DAQ_EVENT
 /end IF_DATA
/end MEASUREMENT
/begin MEASUREMENT HLCCcs_pwrAvlDcMax "CCS DC Maximum available charging power" SWORD RBPtCel_pwr_10p0_1 1 100 -327680.0 327670.0 FORMAT "%8.1" ECU_ADDRESS 0x6001FAEC
 /begin IF_DATA XCPplus 0x0102
  /begin DAQ_EVENT VARIABLE /end DAQ_EVENT
 /end IF_DATA
/end MEASUREMENT
/begin MEASUREMENT HLCCcs_pwrChrgnSdlEntry "Power of one entry given by charging schadule" SWORD RBPtCel_pwr_10p0_1 1 100 -327680.0 327670.0 FORMAT "%8.1" ECU_ADDRESS 0x6001F4AC
 /begin IF_DATA XCPplus 0x0102
  /begin DAQ_EVENT VARIABLE /end DAQ_EVENT
 /end IF_DATA
/end MEASUREMENT
/begin MEASUREMENT HLCCcs_pwrEvseDcMax "EVSEMaximumPowerLimit" SWORD RBPtCel_pwr_10p0_1 1 100 -327680.0 327670.0 FORMAT "%8.1" ECU_ADDRESS 0x6001FAEA
 /begin IF_DATA XCPplus 0x0102
  /begin DAQ_EVENT VARIABLE /end DAQ_EVENT
 /end IF_DATA
/end MEASUREMENT
/begin MEASUREMENT HLCCcs_pwrMaxSdlTpl1 "PMaxSchedule of SAScheduleTuple 1" SWORD RBPtCel_pwr_10p0_1 1 100 -327680.0 327670.0 FORMAT "%8.1" MATRIX_DIM 12 ECU_ADDRESS 0x6001FEBA
 /begin IF_DATA XCPplus 0x0102
  /begin DAQ_EVENT VARIABLE /end DAQ_EVENT
 /end IF_DATA
/end MEASUREMENT
/begin MEASUREMENT HLCCcs_st "Status of high level communication" UBYTE ChrgIf_stHLCCcs_VERB 1 100 0.00 9.00000000000 FORMAT "%13.11" ECU_ADDRESS 0x6002356C
 /begin IF_DATA XCPplus 0x0102
  /begin DAQ_EVENT VARIABLE /end DAQ_EVENT
 /end IF_DATA
/end MEASUREMENT
/begin MEASUREMENT HLCCcs_stApplPtcol "V2G application protocol" UBYTE HLCCcs_stApplPtcol_VERB 1 100 0.00 2.00000000000 FORMAT "%13.11" ECU_ADDRESS 0x6002356B
 /begin IF_DATA XCPplus 0x0102
  /begin DAQ_EVENT VARIABLE /end DAQ_EVENT
 /end IF_DATA
/end MEASUREMENT
/begin MEASUREMENT HLCCcs_stApplPtcolRespCod "Application protocol response code" UBYTE OneToOne 1 100 0.00 255.0 FORMAT "%5.1" ECU_ADDRESS 0x6002356A
 /begin IF_DATA XCPplus 0x0102
  /begin DAQ_EVENT VARIABLE /end DAQ_EVENT
 /end IF_DATA
/end MEASUREMENT
/begin MEASUREMENT HLCCcs_stChrgnCtrl "Charging control of V2G stack" UBYTE OneToOne 1 100 0.00 255.0 FORMAT "%5.1" ECU_ADDRESS 0x60023569
 /begin IF_DATA XCPplus 0x0102
  /begin DAQ_EVENT VARIABLE /end DAQ_EVENT
 /end IF_DATA
/end MEASUREMENT
/begin MEASUREMENT HLCCcs_stCtrlPlt "State of control pilot" UBYTE OneToOne 1 100 0.00 255.0 FORMAT "%5.1" ECU_ADDRESS 0x60023568
 /begin IF_DATA XCPplus 0x0102
  /begin DAQ_EVENT VARIABLE /end DAQ_EVENT
 /end IF_DATA
/end MEASUREMENT
/begin MEASUREMENT HLCCcs_stCtrlPltPwm "State of control pilot PWM" UBYTE OneToOne 1 100 0.00 255.0 FORMAT "%5.1" ECU_ADDRESS 0x60023567
 /begin IF_DATA XCPplus 0x0102
  /begin DAQ_EVENT VARIABLE /end DAQ_EVENT
 /end IF_DATA
/end MEASUREMENT
/begin MEASUREMENT HLCCcs_stEgyTrfModAvl "SupportedEnergyTransferMode" UBYTE OneToOne 1 100 0.00 255.0 FORMAT "%5.1" ECU_ADDRESS 0x60023566
 /begin IF_DATA XCPplus 0x0102
  /begin DAQ_EVENT VARIABLE /end DAQ_EVENT
 /end IF_DATA
/end MEASUREMENT
/begin MEASUREMENT HLCCcs_stEgyTrfModSeld "RequestedEnergyTransferMode" UBYTE OneToOne 1 100 0.00 255.0 FORMAT "%5.1" ECU_ADDRESS 0x60023565
 /begin IF_DATA XCPplus 0x0102
  /begin DAQ_EVENT VARIABLE /end DAQ_EVENT
 /end IF_DATA
/end MEASUREMENT
/begin MEASUREMENT HLCCcs_stEvseCmpblty "EVSE compatibility" UBYTE ChrgIf_stEvseCmpblty_VERB 1 100 0.00 2.00000000000 FORMAT "%13.11" ECU_ADDRESS 0x60023564
 /begin IF_DATA XCPplus 0x0102
  /begin DAQ_EVENT VARIABLE /end DAQ_EVENT
 /end IF_DATA
/end MEASUREMENT
/begin MEASUREMENT HLCCcs_stEvseDcCod "EVSEStatusCode" UBYTE OneToOne 1 100 0.00 255.0 FORMAT "%5.1" ECU_ADDRESS 0x60023563
 /begin IF_DATA XCPplus 0x0102
  /begin DAQ_EVENT VARIABLE /end DAQ_EVENT
 /end IF_DATA
/end MEASUREMENT
/begin MEASUREMENT HLCCcs_stEvseDcIso "EVSEIsolationStatus" UBYTE HLCCcs_stEvseDcIso_VERB 1 100 0.00 5.00000000000 FORMAT "%13.11" ECU_ADDRESS 0x60023562
 /begin IF_DATA XCPplus 0x0102
  /begin DAQ_EVENT VARIABLE /end DAQ_EVENT
 /end IF_DATA
/end MEASUREMENT
/begin MEASUREMENT HLCCcs_stEvseNotif "EVSENotification" UBYTE OneToOne 1 100 0.00 255.0 FORMAT "%5.1" ECU_ADDRESS 0x60023561
 /begin IF_DATA XCPplus 0x0102
  /begin DAQ_EVENT VARIABLE /end DAQ_EVENT
 /end IF_DATA
/end MEASUREMENT
/begin MEASUREMENT HLCCcs_stEvseProcn "EVSEProcessing" UBYTE OneToOne 1 100 0.00 255.0 FORMAT "%5.1" ECU_ADDRESS 0x60023560
 /begin IF_DATA XCPplus 0x0102
  /begin DAQ_EVENT VARIABLE /end DAQ_EVENT
 /end IF_DATA
/end MEASUREMENT
/begin MEASUREMENT HLCCcs_stEvseRespCod "ResponseCode" UBYTE OneToOne 1 100 0.00 255.0 FORMAT "%5.1" ECU_ADDRESS 0x6002355F
 /begin IF_DATA XCPplus 0x0102
  /begin DAQ_EVENT VARIABLE /end DAQ_EVENT
 /end IF_DATA
/end MEASUREMENT
/begin MEASUREMENT HLCCcs_stFctCtrl "Function control of V2G stack" UBYTE OneToOne 1 100 0.00 255.0 FORMAT "%5.1" ECU_ADDRESS 0x6002355E
 /begin IF_DATA XCPplus 0x0102
  /begin DAQ_EVENT VARIABLE /end DAQ_EVENT
 /end IF_DATA
/end MEASUREMENT
/begin MEASUREMENT HLCCcs_stFwDwnl "PLC chip firmware download status" UBYTE HLCCcs_stFwDwnl_VERB 1 100 0.00 3.00000000000 FORMAT "%13.11" ECU_ADDRESS 0x6002355D
 /begin IF_DATA XCPplus 0x0102
  /begin DAQ_EVENT VARIABLE /end DAQ_EVENT
 /end IF_DATA
/end MEASUREMENT
/begin MEASUREMENT HLCCcs_stMsgHdrNotifFltCod "Message header notification fault code" UBYTE OneToOne 1 100 0.00 255.0 FORMAT "%5.1" ECU_ADDRESS 0x6002355C
 /begin IF_DATA XCPplus 0x0102
  /begin DAQ_EVENT VARIABLE /end DAQ_EVENT
 /end IF_DATA
/end MEASUREMENT
/begin MEASUREMENT HLCCcs_stSlacEve "Slac event" UBYTE HLCCcs_stSlacEve_VERB 1 100 0.00 27.0000000000 FORMAT "%13.10" ECU_ADDRESS 0x6002355B
 /begin IF_DATA XCPplus 0x0102
  /begin DAQ_EVENT VARIABLE /end DAQ_EVENT
 /end IF_DATA
/end MEASUREMENT
/begin MEASUREMENT HLCCcs_stSlacRdy "Slac readiness" UBYTE HLCCcs_stSlacRdy_VERB 1 100 0.00 2.00000000000 FORMAT "%13.11" ECU_ADDRESS 0x6002355A
 /begin IF_DATA XCPplus 0x0102
  /begin DAQ_EVENT VARIABLE /end DAQ_EVENT
 /end IF_DATA
/end MEASUREMENT
/begin MEASUREMENT HLCCcs_stSlacStep "Slac step" UBYTE HLCCcs_stSlacStep_VERB 1 100 0.00 14.0000000000 FORMAT "%13.10" ECU_ADDRESS 0x60023559
 /begin IF_DATA XCPplus 0x0102
  /begin DAQ_EVENT VARIABLE /end DAQ_EVENT
 /end IF_DATA
/end MEASUREMENT
/begin MEASUREMENT HLCCcs_stV2G "V2G status" UBYTE OneToOne 1 100 0.00 255.0 FORMAT "%5.1" ECU_ADDRESS 0x60023558
 /begin IF_DATA XCPplus 0x0102
  /begin DAQ_EVENT VARIABLE /end DAQ_EVENT
 /end IF_DATA
/end MEASUREMENT
/begin MEASUREMENT HLCCcs_stV2GErr "V2G error status" UBYTE OneToOne 1 100 0.00 255.0 FORMAT "%5.1" ECU_ADDRESS 0x60023557
 /begin IF_DATA XCPplus 0x0102
  /begin DAQ_EVENT VARIABLE /end DAQ_EVENT
 /end IF_DATA
/end MEASUREMENT
/begin MEASUREMENT HLCCcs_stV2GMsg "V2G message status" UBYTE HLCCcs_stV2GMsg_VERB 1 100 0.00 2.00000000000 FORMAT "%13.11" ECU_ADDRESS 0x60023556
 /begin IF_DATA XCPplus 0x0102
  /begin DAQ_EVENT VARIABLE /end DAQ_EVENT
 /end IF_DATA
/end MEASUREMENT
/begin MEASUREMENT HLCCcs_stV2GStckErr "V2G stack error status" UBYTE OneToOne 1 100 0.00 255.0 FORMAT "%5.1" ECU_ADDRESS 0x60023555
 /begin IF_DATA XCPplus 0x0102
  /begin DAQ_EVENT VARIABLE /end DAQ_EVENT
 /end IF_DATA
/end MEASUREMENT
/begin MEASUREMENT HLCCcs_stV2GTcpSock "V2G TCP socket status" UBYTE HLCCcs_stV2GTcpSock_VERB 1 100 0.00 3.00000000000 FORMAT "%13.11" ECU_ADDRESS 0x60023554
 /begin IF_DATA XCPplus 0x0102
  /begin DAQ_EVENT VARIABLE /end DAQ_EVENT
 /end IF_DATA
/end MEASUREMENT
/begin MEASUREMENT HLCCcs_tiChrgnSdlElpd "Elapsed charging time" ULONG RBPtCel_ti_0p01_1 1 100 0.00 42949672.9500 FORMAT "%13.4" ECU_ADDRESS 0x6000081C
 /begin IF_DATA XCPplus 0x0102
  /begin DAQ_EVENT VARIABLE /end DAQ_EVENT
 /end IF_DATA
/end MEASUREMENT
/begin MEASUREMENT HLCCcs_tiChrgnSdlEntry "Charge time slot of one entry given by charging schadule" ULONG RBPtCel_ti_1p0_2 1 100 0.00 4294967295.00 FORMAT "%13.2" ECU_ADDRESS 0x60000818
 /begin IF_DATA XCPplus 0x0102
  /begin DAQ_EVENT VARIABLE /end DAQ_EVENT
 /end IF_DATA
/end MEASUREMENT
/begin MEASUREMENT HLCCcs_tiEvseNotifMaxDly "NotificationMaxDelay" UWORD RBPtCel_ti_1p0_2 1 100 0.00 65535.00 FORMAT "%8.2" ECU_ADDRESS 0x6001FA32
 /begin IF_DATA XCPplus 0x0102
  /begin DAQ_EVENT VARIABLE /end DAQ_EVENT
 /end IF_DATA
/end MEASUREMENT
/begin MEASUREMENT HLCCcs_tiPwrDurnSdlTpl1 "Duration time of last entry of schedule tuple 1" ULONG RBPtCel_ti_1p0_2 1 100 0.00 4294967295.00 FORMAT "%13.2" ECU_ADDRESS 0x60000EF0
 /begin IF_DATA XCPplus 0x0102
  /begin DAQ_EVENT VARIABLE /end DAQ_EVENT
 /end IF_DATA
/end MEASUREMENT
/begin MEASUREMENT HLCCcs_tiPwrStrtSdlTpl1 "Start time of schedule tuple 1" ULONG RBPtCel_ti_1p0_2 1 100 0.00 4294967295.00 FORMAT "%13.2" MATRIX_DIM 12 ECU_ADDRESS 0x60001318
 /begin IF_DATA XCPplus 0x0102
  /begin DAQ_EVENT VARIABLE /end DAQ_EVENT
 /end IF_DATA
/end MEASUREMENT
/begin MEASUREMENT HLCCcs_uEvseDcMax "EVSEMaximumVoltageLimit" SWORD RBPtCel_u_0p1_1 1 100 -3276.800 3276.700 FORMAT "%8.3" ECU_ADDRESS 0x6001FAE8
 /begin IF_DATA XCPplus 0x0102
  /begin DAQ_EVENT VARIABLE /end DAQ_EVENT
 /end IF_DATA
/end MEASUREMENT
/begin MEASUREMENT HLCCcs_uEvseDcMin "EVSEMinimumVoltageLimit" SWORD RBPtCel_u_0p1_1 1 100 -3276.800 3276.700 FORMAT "%8.3" ECU_ADDRESS 0x6001FAE6
 /begin IF_DATA XCPplus 0x0102
  /begin DAQ_EVENT VARIABLE /end DAQ_EVENT
 /end IF_DATA
/end MEASUREMENT
/begin MEASUREMENT HLCCcs_uEvseDcPrsnt "EVSEPresentVoltage" SWORD RBPtCel_u_0p1_1 1 100 -3276.800 3276.700 FORMAT "%8.3" ECU_ADDRESS 0x6001FAE4
 /begin IF_DATA XCPplus 0x0102
  /begin DAQ_EVENT VARIABLE /end DAQ_EVENT
 /end IF_DATA
/end MEASUREMENT
/begin MEASUREMENT HvacHmi_flgDiagEna "Diagnostic enable flag" UBYTE B_TRUE 1 100 0.00 1.00000000000 BIT_MASK 0x1 FORMAT "%13.11" ECU_ADDRESS 0x70000174
 /begin IF_DATA XCPplus 0x0102
  /begin DAQ_EVENT VARIABLE /end DAQ_EVENT
 /end IF_DATA
/end MEASUREMENT
/begin MEASUREMENT HvacHmi_flgEvapTFlt "Flag indicate faulty evaporator temperature signal" UBYTE B_TRUE 1 100 0.00 1.00000000000 BIT_MASK 0x1 FORMAT "%13.11" ECU_ADDRESS 0x70000173
 /begin IF_DATA XCPplus 0x0102
  /begin DAQ_EVENT VARIABLE /end DAQ_EVENT
 /end IF_DATA
/end MEASUREMENT
/begin MEASUREMENT HvacHmi_ratBlowrSpd "Cabin blower speed" SBYTE RBPtCel_Perc_1p0_1 1 100 -128.0 127.0 FORMAT "%5.1" ECU_ADDRESS 0x60023474
 /begin IF_DATA XCPplus 0x0102
  /begin DAQ_EVENT VARIABLE /end DAQ_EVENT
 /end IF_DATA
/end MEASUREMENT
/begin MEASUREMENT HvacHmi_stAc "AC request" UBYTE q1 1 100 0.00 255.0 FORMAT "%5.1" ECU_ADDRESS 0x6002344D
 /begin IF_DATA XCPplus 0x0102
  /begin DAQ_EVENT VARIABLE /end DAQ_EVENT
 /end IF_DATA
/end MEASUREMENT
/begin MEASUREMENT HvacHmi_stCoolgReq "Cabin cooling request" UBYTE q1 1 100 0.00 255.0 FORMAT "%5.1" ECU_ADDRESS 0x6002344C
 /begin IF_DATA XCPplus 0x0102
  /begin DAQ_EVENT VARIABLE /end DAQ_EVENT
 /end IF_DATA
/end MEASUREMENT
/begin MEASUREMENT HvacHmi_stHeatgReq "Cabin heating request" UBYTE q1 1 100 0.00 255.0 FORMAT "%5.1" ECU_ADDRESS 0x6002344B
 /begin IF_DATA XCPplus 0x0102
  /begin DAQ_EVENT VARIABLE /end DAQ_EVENT
 /end IF_DATA
/end MEASUREMENT
/begin MEASUREMENT HvacLvl_dTEvaprSp "Evaporator temperature deviation" SWORD RBPtCel_t_0p1_1 1 100 -3276.800 3276.700 FORMAT "%8.3" ECU_ADDRESS 0x6001F9E6
 /begin IF_DATA XCPplus 0x0102
  /begin DAQ_EVENT VARIABLE /end DAQ_EVENT
 /end IF_DATA
/end MEASUREMENT
/begin MEASUREMENT HvacLvl_dTEvaprSpDelta "Evaporator temperature setpoint range" SWORD RBPtCel_t_0p1_1 1 100 -3276.800 3276.700 FORMAT "%8.3" ECU_ADDRESS 0x6001F9E4
 /begin IF_DATA XCPplus 0x0102
  /begin DAQ_EVENT VARIABLE /end DAQ_EVENT
 /end IF_DATA
/end MEASUREMENT
/begin MEASUREMENT HvacLvl_dTHeatrSp "Tempeature deviation heater core (setpoint to actual)" SWORD RBPtCel_t_0p1_1 1 100 -3276.800 3276.700 FORMAT "%8.3" ECU_ADDRESS 0x6001F9E2
 /begin IF_DATA XCPplus 0x0102
  /begin DAQ_EVENT VARIABLE /end DAQ_EVENT
 /end IF_DATA
/end MEASUREMENT
/begin MEASUREMENT HvacLvl_flgSocPwrSaveActv "flag for SOC of Power save mode active" UBYTE B_TRUE 1 100 0.00 1.00000000000 BIT_MASK 0x1 FORMAT "%13.11" ECU_ADDRESS 0x70000172
 /begin IF_DATA XCPplus 0x0102
  /begin DAQ_EVENT VARIABLE /end DAQ_EVENT
 /end IF_DATA
/end MEASUREMENT
/begin MEASUREMENT HvacLvl_pwrCoolgSaveModDes "Desired power cooling save mode" SWORD RBPtCel_pwr_25p0_1 1 100 -819200.0 819175.0 FORMAT "%8.1" ECU_ADDRESS 0x6001F4A8
 /begin IF_DATA XCPplus 0x0102
  /begin DAQ_EVENT VARIABLE /end DAQ_EVENT
 /end IF_DATA
/end MEASUREMENT
/begin MEASUREMENT HvacLvl_pwrDefogSaveModDes "Desired power defog save mode" SWORD RBPtCel_pwr_25p0_1 1 100 -819200.0 819175.0 FORMAT "%8.1" ECU_ADDRESS 0x6001F4A6
 /begin IF_DATA XCPplus 0x0102
  /begin DAQ_EVENT VARIABLE /end DAQ_EVENT
 /end IF_DATA
/end MEASUREMENT
/begin MEASUREMENT HvacLvl_pwrRefgntCoolgDes "Desired power refrigerant cooling" SWORD RBPtCel_pwr_25p0_1 1 100 -819200.0 819175.0 FORMAT "%8.1" ECU_ADDRESS 0x6001F4A4
 /begin IF_DATA XCPplus 0x0102
  /begin DAQ_EVENT VARIABLE /end DAQ_EVENT
 /end IF_DATA
/end MEASUREMENT
/begin MEASUREMENT HvacLvl_pwrRefgntDefogDes "Desired power refrigerant defog" SWORD RBPtCel_pwr_25p0_1 1 100 -819200.0 819175.0 FORMAT "%8.1" ECU_ADDRESS 0x6001F4A2
 /begin IF_DATA XCPplus 0x0102
  /begin DAQ_EVENT VARIABLE /end DAQ_EVENT
 /end IF_DATA
/end MEASUREMENT
/begin MEASUREMENT HvacLvl_pwrRefgntDes "tempeature deviation evaporator (setpoint to actual)" SWORD RBPtCel_pwr_25p0_1 1 100 -819200.0 819175.0 FORMAT "%8.1" ECU_ADDRESS 0x6001F9E0
 /begin IF_DATA XCPplus 0x0102
  /begin DAQ_EVENT VARIABLE /end DAQ_EVENT
 /end IF_DATA
/end MEASUREMENT
/begin MEASUREMENT HvacMod_flgAcDes "AC control mode" UBYTE B_TRUE 1 100 0.00 1.00000000000 BIT_MASK 0x1 FORMAT "%13.11" ECU_ADDRESS 0x70000276
 /begin IF_DATA XCPplus 0x0102
  /begin DAQ_EVENT VARIABLE /end DAQ_EVENT
 /end IF_DATA
/end MEASUREMENT
/begin MEASUREMENT HvacMod_flgBlowrOn "flag for blower ON" UBYTE B_TRUE 1 100 0.00 1.00000000000 BIT_MASK 0x1 FORMAT "%13.11" ECU_ADDRESS 0x7000016E
 /begin IF_DATA XCPplus 0x0102
  /begin DAQ_EVENT VARIABLE /end DAQ_EVENT
 /end IF_DATA
/end MEASUREMENT
/begin MEASUREMENT HvacMod_flgCoolgRels "flag for Cooling release" UBYTE B_TRUE 1 100 0.00 1.00000000000 BIT_MASK 0x1 FORMAT "%13.11" ECU_ADDRESS 0x7000016D
 /begin IF_DATA XCPplus 0x0102
  /begin DAQ_EVENT VARIABLE /end DAQ_EVENT
 /end IF_DATA
/end MEASUREMENT
/begin MEASUREMENT HvacMod_flgHeatgRels "flag for Heating release" UBYTE B_TRUE 1 100 0.00 1.00000000000 BIT_MASK 0x1 FORMAT "%13.11" ECU_ADDRESS 0x7000016C
 /begin IF_DATA XCPplus 0x0102
  /begin DAQ_EVENT VARIABLE /end DAQ_EVENT
 /end IF_DATA
/end MEASUREMENT
/begin MEASUREMENT HvacMod_flgHvAvl "flag for High voltage availability" UBYTE B_TRUE 1 100 0.00 1.00000000000 BIT_MASK 0x1 FORMAT "%13.11" ECU_ADDRESS 0x7000016B
 /begin IF_DATA XCPplus 0x0102
  /begin DAQ_EVENT VARIABLE /end DAQ_EVENT
 /end IF_DATA
/end MEASUREMENT
/begin MEASUREMENT HvacMod_st "Current selected mode of Hvac" UBYTE HvacMod_st_VERB 1 100 0.00 6.00000000000 FORMAT "%13.11" ECU_ADDRESS 0x6002344A
 /begin IF_DATA XCPplus 0x0102
  /begin DAQ_EVENT VARIABLE /end DAQ_EVENT
 /end IF_DATA
/end MEASUREMENT
/begin MEASUREMENT HvacMod_stAcReq "AC control mode" UBYTE q1 1 100 0.00 255.0 FORMAT "%5.1" ECU_ADDRESS 0x60023449
 /begin IF_DATA XCPplus 0x0102
  /begin DAQ_EVENT VARIABLE /end DAQ_EVENT
 /end IF_DATA
/end MEASUREMENT
/begin MEASUREMENT HvacMod_stEvaprSpT "Evaporator state" UBYTE q1 1 100 0.00 255.0 FORMAT "%5.1" ECU_ADDRESS 0x60023142
 /begin IF_DATA XCPplus 0x0102
  /begin DAQ_EVENT VARIABLE /end DAQ_EVENT
 /end IF_DATA
/end MEASUREMENT
/begin MEASUREMENT HvacMod_stHvSocLvl "SOC level for HV state" UBYTE q1 1 100 0.00 255.0 FORMAT "%5.1" ECU_ADDRESS 0x60023141
 /begin IF_DATA XCPplus 0x0102
  /begin DAQ_EVENT VARIABLE /end DAQ_EVENT
 /end IF_DATA
/end MEASUREMENT
/begin MEASUREMENT HvacMod_stKnobPosn "Knob position state" UBYTE q1 1 100 0.00 255.0 FORMAT "%5.1" ECU_ADDRESS 0x60023140
 /begin IF_DATA XCPplus 0x0102
  /begin DAQ_EVENT VARIABLE /end DAQ_EVENT
 /end IF_DATA
/end MEASUREMENT
/begin MEASUREMENT HvacMod_stPtc "PTC heater control mode" UBYTE q1 1 100 0.00 255.0 FORMAT "%5.1" ECU_ADDRESS 0x60023448
 /begin IF_DATA XCPplus 0x0102
  /begin DAQ_EVENT VARIABLE /end DAQ_EVENT
 /end IF_DATA
/end MEASUREMENT
/begin MEASUREMENT HvacMod_stRefgntTar "Refrigerant target state" UBYTE HvacMod_stRefgntTar_VERB 1 100 0.00 4.00000000000 FORMAT "%13.11" ECU_ADDRESS 0x60023447
 /begin IF_DATA XCPplus 0x0102
  /begin DAQ_EVENT VARIABLE /end DAQ_EVENT
 /end IF_DATA
/end MEASUREMENT
/begin MEASUREMENT HvacPtc_flgHeatrDes "flag for PTC Heater desired power calculation" UBYTE B_TRUE 1 100 0.00 1.00000000000 BIT_MASK 0x1 FORMAT "%13.11" ECU_ADDRESS 0x70000168
 /begin IF_DATA XCPplus 0x0102
  /begin DAQ_EVENT VARIABLE /end DAQ_EVENT
 /end IF_DATA
/end MEASUREMENT
/begin MEASUREMENT HvacPtc_flgHeatrReq "flag for requested PTC heater for desired power calculation" UBYTE B_TRUE 1 100 0.00 1.00000000000 BIT_MASK 0x1 FORMAT "%13.11" ECU_ADDRESS 0x70000167
 /begin IF_DATA XCPplus 0x0102
  /begin DAQ_EVENT VARIABLE /end DAQ_EVENT
 /end IF_DATA
/end MEASUREMENT
/begin MEASUREMENT HvacPtc_pwrDes "power setpoint for HV PTC" SWORD RBPtCel_pwr_1p0_1 1 100 -32768.00 32767.00 FORMAT "%8.2" ECU_ADDRESS 0x6001F9DE
 /begin IF_DATA XCPplus 0x0102
  /begin DAQ_EVENT VARIABLE /end DAQ_EVENT
 /end IF_DATA
/end MEASUREMENT
/begin MEASUREMENT HvacPtc_tiStTmr "state timer for cabin heater" SLONG RBPtCel_ti_0p01_1 1 100 -21474836.4800 21474836.4700 FORMAT "%13.4" ECU_ADDRESS 0x600007DC
 /begin IF_DATA XCPplus 0x0102
  /begin DAQ_EVENT VARIABLE /end DAQ_EVENT
 /end IF_DATA
/end MEASUREMENT
/begin MEASUREMENT HvBatt_flgChrgTarRea "Charge Target Reached Indication of HV Battery" UBYTE B_TRUE 1 100 0.00 1.00000000000 BIT_MASK 0x1 FORMAT "%13.11" ECU_ADDRESS 0x70000279
 /begin IF_DATA XCPplus 0x0102
  /begin DAQ_EVENT VARIABLE /end DAQ_EVENT
 /end IF_DATA
/end MEASUREMENT
/begin MEASUREMENT HvBatt_flgIsoMeasmtDiReq "HV batt Flag" UBYTE B_TRUE 1 100 0.00 1.00000000000 BIT_MASK 0x1 FORMAT "%13.11" ECU_ADDRESS 0x70000277
 /begin IF_DATA XCPplus 0x0102
  /begin DAQ_EVENT VARIABLE /end DAQ_EVENT
 /end IF_DATA
/end MEASUREMENT
/begin MEASUREMENT HvBatt_iMaxExtChrg "HV Battery nominal external external charging current" SWORD Curr_A_q0p03125_COMPU 1 100 -1024.000 1023.969 FORMAT "%8.3" ECU_ADDRESS 0x6001FAD8
 /begin IF_DATA XCPplus 0x0102
  /begin DAQ_EVENT VARIABLE /end DAQ_EVENT
 /end IF_DATA
/end MEASUREMENT
/begin MEASUREMENT HvBatt_iReqToChrgr "HV Battery Current request to the charger" SWORD Curr_A_q0p03125_COMPU 1 100 -1024.000 1023.969 FORMAT "%8.3" ECU_ADDRESS 0x6001FAD6
 /begin IF_DATA XCPplus 0x0102
  /begin DAQ_EVENT VARIABLE /end DAQ_EVENT
 /end IF_DATA
/end MEASUREMENT
/begin MEASUREMENT HvBatt_qTotCp "Total capacity of HV Battery" SWORD RBPtCel_q_0p125_1 1 100 -4096.000 4095.875 FORMAT "%8.3" ECU_ADDRESS 0x6001FACA
 /begin IF_DATA XCPplus 0x0102
  /begin DAQ_EVENT VARIABLE /end DAQ_EVENT
 /end IF_DATA
/end MEASUREMENT
/begin MEASUREMENT HvBatt_stFlt "HV-battery error state" UWORD OneToOne 1 100 0.00 65535.00 FORMAT "%8.2" ECU_ADDRESS 0x6001FA24
 /begin IF_DATA XCPplus 0x0102
  /begin DAQ_EVENT VARIABLE /end DAQ_EVENT
 /end IF_DATA
/end MEASUREMENT
/begin MEASUREMENT HvBatt_stIsoMeasmtActv "Isolation measurement active status" UBYTE OneToOne 1 100 0.00 255.0 FORMAT "%5.1" ECU_ADDRESS 0x60023543
 /begin IF_DATA XCPplus 0x0102
  /begin DAQ_EVENT VARIABLE /end DAQ_EVENT
 /end IF_DATA
/end MEASUREMENT
/begin MEASUREMENT HvBatt_stPckCnctn "HV Battery pack connection state" UBYTE OneToOne 1 100 0.00 255.0 FORMAT "%5.1" ECU_ADDRESS 0x60023540
 /begin IF_DATA XCPplus 0x0102
  /begin DAQ_EVENT VARIABLE /end DAQ_EVENT
 /end IF_DATA
/end MEASUREMENT
/begin MEASUREMENT HvBatt_uNomChrgn "Nominal charging voltage of HV Battery" SWORD Volt_V_q0p03125_COMPU 1 100 -1024.000 1023.969 FORMAT "%8.3" ECU_ADDRESS 0x6001FAB8
 /begin IF_DATA XCPplus 0x0102
  /begin DAQ_EVENT VARIABLE /end DAQ_EVENT
 /end IF_DATA
/end MEASUREMENT
/begin MEASUREMENT RefgntCirc_tEvaprAct "Actual evaporator temperature" SWORD Temp_Cels 1 100 -3549.940 3003.560 FORMAT "%8.3" ECU_ADDRESS 0x6001F9DA
 /begin IF_DATA XCPplus 0x0102
  /begin DAQ_EVENT VARIABLE /end DAQ_EVENT
 /end IF_DATA
/end MEASUREMENT
/begin FUNCTION FanSpd_DELib_StdSensExtDiag "8.1.0"
 /begin IN_MEASUREMENT DELib_idxArrSnsr DELib_xArrSnsr DSM_TripChgFinshd FanSpd_swtConfStdSensC FanSpd_swtConfStdSensSwVersC SyC_stSub /end IN_MEASUREMENT
 FUNCTION_VERSION "8.1.0" /end FUNCTION
/begin FUNCTION FanSpd_DELib_StdSensInin "8.2.0"
 /begin DEF_CHARACTERISTIC FanSpd_swtConfStdSens2_C FanSpd_swtConfStdSensSwVers162_C FanSpd_swtConfStdSens_C /end DEF_CHARACTERISTIC
 /begin REF_CHARACTERISTIC FanSpd_tiPT1Fil_C /end REF_CHARACTERISTIC
 /begin OUT_MEASUREMENT FanSpd_swtConfStdSens2C FanSpd_swtConfStdSensC FanSpd_swtConfStdSensSwVersC FanSpd_swtSensMode /end OUT_MEASUREMENT
 FUNCTION_VERSION "8.2.0" /end FUNCTION
/begin FUNCTION FanSpd_DELib_StdSensVd "11.0.0"
 /begin DEF_CHARACTERISTIC FanSpd_DigSensCal.tiDebPos_C FanSpd_DigSensCal.tiDebNeg_C FanSpd_dnActGradLim_f_C FanSpd_nActDflVal_f_C FanSpd_nActHiLimit_f_C FanSpd_nActLoLimit_f_C FanSpd_RmpSlp_f.Pos_C FanSpd_RmpSlp_f.Neg_C FanSpd_tiPT1_f_C FanSpd_TransStg_f.Dfl_r32_C FanSpd_TransStg_f.stSensId_C /end DEF_CHARACTERISTIC
 /begin IN_MEASUREMENT FanSpd_nActSens_f FanSpd_stSnsrDdCalc FanSpd_swtConfStdSensC FanSpd_swtConfStdSensSwVersC /end IN_MEASUREMENT
 /begin OUT_MEASUREMENT DINH_nrActvInhReas.FId_FanSpdFrzVal DINH_nrActvInhReas.FId_FanSpdRplVal DINH_stFId.FId_FanSpdFrzVal DINH_stFId.FId_FanSpdRplVal FanSpd_nActSensOffsCorrd_f FanSpd_nActUnFlt_f FanSpd_nAct_f FanSpd_nAct_f_Sq /end OUT_MEASUREMENT
 /begin LOC_MEASUREMENT FanSpd_nActSensGradLim_f_mp /end LOC_MEASUREMENT
 FUNCTION_VERSION "11.0.0" /end FUNCTION
/begin FUNCTION FanSpd_DELib_StdSensVdMon "9.2.0"
 /begin DEF_CHARACTERISTIC DDRC_DurDeb.FanSpd_tiPhysRngHiDebOk_C DDRC_DurDeb.FanSpd_tiPhysRngHiDebDef_C DDRC_DurDeb.FanSpd_tiPhysRngLoDebOk_C DDRC_DurDeb.FanSpd_tiPhysRngLoDebDef_C DDRC_RatDeb.FanSpd_tiPhysRngHiUDRat_C DDRC_RatDeb.FanSpd_tiPhysRngLoUDRat_C DFC_CtlMsk2.DFC_FanSpdPhysRngHi_C DFC_CtlMsk2.DFC_FanSpdPhysRngLo_C DFC_CtlMsk2.DFC_FanSpdTmpErr_C DFC_DisblMsk2.DFC_FanSpdPhysRngHi_C DFC_DisblMsk2.DFC_FanSpdPhysRngLo_C DFC_DisblMsk2.DFC_FanSpdTmpErr_C FanSpd_nActEnhPhysSRCMax_f_MAP FanSpd_nActEnhPhysSRCMin_f_MAP FanSpd_numStdSens_C FanSpd_numTempErrDef_C FanSpd_numtSel_C FanSpd_stEnhPhysSRCRls_MAP FanSpd_tiEngOnMin_C FanSpd_tiTempErrOk_C FanSpd_tSnsrMax_f_C FanSpd_tSnsrMin_f_C /end DEF_CHARACTERISTIC
 /begin IN_MEASUREMENT CoEng_tiNormal DELib_idxArrSnsr DELib_xArrSnsr DSM_TripChgFinshd Epm_nEng FanSpd_nActSens_f FanSpd_stSnsrDdCalc FanSpd_swtConfStdSensC FanSpd_swtConfStdSensSwVersC InjCtl_qSetUnBal /end IN_MEASUREMENT
 /begin OUT_MEASUREMENT DDRC_St.DFC_FanSpdPhysRngHi DDRC_St.DFC_FanSpdPhysRngLo DFC_st.DFC_FanSpdPhysRngHi DFC_st.DFC_FanSpdPhysRngLo DFC_st.DFC_FanSpdTmpErr DINH_nrActvInhReas.FId_FanSpdPhysRng DINH_nrActvInhReas.FId_FanSpdTmpErrCnt DINH_stFId.FId_FanSpdPhysRng DINH_stFId.FId_FanSpdTmpErrCnt FanSpd_stSnsrActv /end OUT_MEASUREMENT
 /begin LOC_MEASUREMENT FanSpd_nActDynThresPhysRngHi_f_mp FanSpd_nActDynThresPhysRngLo_f_mp FanSpd_stMonStdSens /end LOC_MEASUREMENT
 FUNCTION_VERSION "9.2.0" /end FUNCTION
/begin FUNCTION Fans_ClgDem "49.2.0    Fan"
 /begin DEF_CHARACTERISTIC Fans_facAmbCorrn_T Fans_facVelCorrn_T Fans_maskEnvTVldySq_C Fans_maskVehSpdVldySq_C Fans_NegVal_C Fans_PosVal_C Fans_stFan1Alc_C /end DEF_CHARACTERISTIC
 /begin IN_MEASUREMENT AC_rClgDem EnvT_t EnvT_t_Sq EVTherm_ratLTClgDmd EVTherm_ratMTClgDmd VehV_v VehV_v_Sq /end IN_MEASUREMENT
 /begin OUT_MEASUREMENT DINH_nrActvInhReas.FId_FansFacCor DINH_stFId.FId_FansFacCor Fans_ratCoolgDes1 /end OUT_MEASUREMENT
 /begin LOC_MEASUREMENT Fans_facCor Fans_Ramp_I.State Fans_Ramp_I.Dir Fans_Ramp_I.Switch Fans_ratClgDemFan1 Fans_ratCorFan1 /end LOC_MEASUREMENT
 FUNCTION_VERSION "49.2.0" /end FUNCTION
/begin FUNCTION Fan_DD "86.4.0    Fan Device Driver"
 /begin DEF_CHARACTERISTIC DDRC_DurDeb.Fan_tiRlySCBDebOk_C DDRC_DurDeb.Fan_tiRlySCBDebDef_C DDRC_DurDeb.Fan_tiRlySCGDebOk_C DDRC_DurDeb.Fan_tiRlySCGDebDef_C DDRC_RatDeb.Fan_tiRlySCBUDRat_C DDRC_RatDeb.Fan_tiRlySCGUDRat_C DFC_CtlMsk2.DFC_FanRlySCB_C DFC_CtlMsk2.DFC_FanRlySCG_C DFC_CtlMsk2.DFC_FanMaxOvrd_C DFC_DisblMsk2.DFC_FanRlySCB_C DFC_DisblMsk2.DFC_FanRlySCG_C DFC_DisblMsk2.DFC_FanMaxOvrd_C Fan_stVehStDiagEna_C Fan_tiActvnIniDly_C Fan_tiDeactvnDly_C /end DEF_CHARACTERISTIC
 /begin IN_MEASUREMENT Dcdc_stOperModAct Fan1_stPs FanRly1Posn_st VehCoorn_st /end IN_MEASUREMENT
 /begin OUT_MEASUREMENT DDRC_St.DFC_FanRlySCB DDRC_St.DFC_FanRlySCG DFC_st.DFC_FanRlySCB DFC_st.DFC_FanRlySCG DFC_st.DFC_FanMaxOvrd DINH_nrActvInhReas.FId_FanRlyDiagEnad DINH_stFId.FId_FanRlyDiagEnad /end OUT_MEASUREMENT
 FUNCTION_VERSION "86.4.0" /end FUNCTION
/begin FUNCTION FreonP_DELib_GlbAdprOutp "1.1.0" /begin IN_MEASUREMENT FreonP_pSens_f FreonP_p_f /end IN_MEASUREMENT /begin OUT_MEASUREMENT FreonP_p FreonP_pSens /end OUT_MEASUREMENT FUNCTION_VERSION "1.1.0" /end FUNCTION
/begin FUNCTION FreonP_DELib_StdSensDd "10.2.0"
 /begin DEF_CHARACTERISTIC DDRC_DurDeb.FreonP_tiSRCMinDebOk_C DDRC_DurDeb.FreonP_tiSRCMinDebDef_C DDRC_DurDeb.FreonP_tiSRCOpnDebOk_C DDRC_DurDeb.FreonP_tiSRCOpnDebDef_C DDRC_RatDeb.FreonP_tiSRCMinUDRat_C DDRC_RatDeb.FreonP_tiSRCOpnUDRat_C DFC_CtlMsk2.DFC_FreonPSRCMin_C DFC_CtlMsk2.DFC_FreonPSRCOpn_C DFC_CtlMsk2.DFC_FreonPSRCMax_C DFC_DisblMsk2.DFC_FreonPSRCMin_C DFC_DisblMsk2.DFC_FreonPSRCOpn_C DFC_DisblMsk2.DFC_FreonPSRCMax_C FreonP_ADCCal.numSRCTempSel_C FreonP_ADCCal.tiSRCMaxDebOK_C FreonP_ADCCal.uSRCMax_C FreonP_ADCCal.uSRCMin_C FreonP_ADCCal.uSRCOpn_C FreonP_ADCSensTransf_f_CUR FreonP_tiSRCMaxDefDeb_CUR /end DEF_CHARACTERISTIC
 /begin REF_CHARACTERISTIC FreonP_tiPT1Fil_C FreonP_TransStg_f.Dfl_r32_C FreonP_TransStg_f.stSensId_C /end REF_CHARACTERISTIC
 /begin IN_MEASUREMENT DELib_idxArrSnsr DELib_xArrSnsr FreonP_FirRead.cntr FreonP_FirRead.flgFirstRun FreonP_FirRead.idxArr FreonP_FirRead.uSum FreonP_stSnsrDdReadCalc FreonP_swtConfStdSens2C FreonP_swtConfStdSensC FreonP_swtConfStdSensSwVersC FreonP_uRawPT1FltdSens FreonP_uRawUnFltd /end IN_MEASUREMENT
 /begin OUT_MEASUREMENT DDRC_St.DFC_FreonPSRCMin DDRC_St.DFC_FreonPSRCOpn DFC_st.DFC_FreonPSRCMin DFC_st.DFC_FreonPSRCOpn DFC_st.DFC_FreonPSRCMax DINH_nrActvInhReas.FId_FreonPEnhdSRCMax DINH_nrActvInhReas.FId_FreonPSSpMon DINH_stFId.FId_FreonPEnhdSRCMax DINH_stFId.FId_FreonPSSpMon FreonP_FirCalc.cntrAvrgZr FreonP_FirCalc.flgRdDne FreonP_FirCalc.uRawAvrg FreonP_FirCalc.uRawFir FreonP_pSensCpl FreonP_pSensUnFltd FreonP_pSens_f FreonP_stSnsrDdCalc FreonP_swtSensPres FreonP_tiSRCMaxDefDeb FreonP_uRaw FreonP_uRaw_f /end OUT_MEASUREMENT
 /begin LOC_MEASUREMENT FreonP_DDstSnsrState_mp FreonP_tRefSnsr_mp FreonP_tSensPT1Fltd_mp /end LOC_MEASUREMENT
 FUNCTION_VERSION "10.2.0" /end FUNCTION
/begin FUNCTION FreonP_DELib_StdSensDdRead "10.4.0" /begin DEF_CHARACTERISTIC FreonP_tiPT1Fil_C /end DEF_CHARACTERISTIC
 /begin IN_MEASUREMENT FreonP_FirCalc.cntrAvrgZr FreonP_FirCalc.flgRdDne FreonP_FirCalc.uRawAvrg FreonP_FirCalc.uRawFir FreonP_swtConfStdSens2C FreonP_swtConfStdSensC /end IN_MEASUREMENT
 /begin OUT_MEASUREMENT FreonP_FirRead.cntr FreonP_FirRead.flgFirstRun FreonP_FirRead.idxArr FreonP_FirRead.uSum FreonP_stSnsrDdReadCalc FreonP_uRawPT1Fltd FreonP_uRawPT1FltdSens FreonP_uRawUnFltd /end OUT_MEASUREMENT
 FUNCTION_VERSION "10.4.0" /end FUNCTION
/begin FUNCTION FreonP_DELib_StdSensDdSENTSlowRead "3.2.0"
 /begin IN_MEASUREMENT FreonP_swtConfStdSens2C FreonP_swtConfStdSensC FreonP_swtConfStdSensSwVersC /end IN_MEASUREMENT
 FUNCTION_VERSION "3.2.0" /end FUNCTION
/begin FUNCTION FreonP_DELib_StdSensExtDiag "8.1.0"
 /begin IN_MEASUREMENT DELib_idxArrSnsr DELib_xArrSnsr DSM_TripChgFinshd FreonP_swtConfStdSensC FreonP_swtConfStdSensSwVersC SyC_stSub /end IN_MEASUREMENT
 FUNCTION_VERSION "8.1.0" /end FUNCTION
/begin FUNCTION FreonP_DELib_StdSensInin "8.2.0"
 /begin DEF_CHARACTERISTIC FreonP_swtConfStdSens2_C FreonP_swtConfStdSensSwVers162_C FreonP_swtConfStdSens_C /end DEF_CHARACTERISTIC
 /begin REF_CHARACTERISTIC FreonP_tiPT1Fil_C /end REF_CHARACTERISTIC
 /begin OUT_MEASUREMENT FreonP_swtConfStdSens2C FreonP_swtConfStdSensC FreonP_swtConfStdSensSwVersC FreonP_swtSensMode /end OUT_MEASUREMENT
 FUNCTION_VERSION "8.2.0" /end FUNCTION
/begin FUNCTION FreonP_DELib_StdSensVd "11.0.0"
 /begin DEF_CHARACTERISTIC FreonP_DigSensCal.tiDebPos_C FreonP_DigSensCal.tiDebNeg_C FreonP_dpGradLim_f_C FreonP_pDflVal_f_C FreonP_pHiLimit_f_C FreonP_pLoLimit_f_C FreonP_RmpSlp_f.Pos_C FreonP_RmpSlp_f.Neg_C FreonP_tiPT1_f_C FreonP_TransStg_f.Dfl_r32_C FreonP_TransStg_f.stSensId_C /end DEF_CHARACTERISTIC
 /begin IN_MEASUREMENT FreonP_pSens_f FreonP_stSnsrDdCalc FreonP_swtConfStdSensC FreonP_swtConfStdSensSwVersC /end IN_MEASUREMENT
 /begin OUT_MEASUREMENT DINH_nrActvInhReas.FId_FreonPFrzVal DINH_nrActvInhReas.FId_FreonPRplVal DINH_stFId.FId_FreonPFrzVal DINH_stFId.FId_FreonPRplVal FreonP_pSensOffsCorrd_f FreonP_pUnFlt_f FreonP_p_f FreonP_p_f_Sq /end OUT_MEASUREMENT
 /begin LOC_MEASUREMENT FreonP_pSensGradLim_f_mp /end LOC_MEASUREMENT
 FUNCTION_VERSION "11.0.0" /end FUNCTION
/begin FUNCTION FreonP_DELib_StdSensVdMon "9.2.0"
 /begin DEF_CHARACTERISTIC DDRC_DurDeb.FreonP_tiPhysRngHiDebOk_C DDRC_DurDeb.FreonP_tiPhysRngHiDebDef_C DDRC_DurDeb.FreonP_tiPhysRngLoDebOk_C DDRC_DurDeb.FreonP_tiPhysRngLoDebDef_C DDRC_RatDeb.FreonP_tiPhysRngHiUDRat_C DDRC_RatDeb.FreonP_tiPhysRngLoUDRat_C DFC_CtlMsk2.DFC_FreonPPhysRngHi_C DFC_CtlMsk2.DFC_FreonPPhysRngLo_C DFC_CtlMsk2.DFC_FreonPTmpErr_C DFC_DisblMsk2.DFC_FreonPPhysRngHi_C DFC_DisblMsk2.DFC_FreonPPhysRngLo_C DFC_DisblMsk2.DFC_FreonPTmpErr_C FreonP_numStdSens_C FreonP_numTempErrDef_C FreonP_numtSel_C FreonP_pEnhPhysSRCMax_f_MAP FreonP_pEnhPhysSRCMin_f_MAP FreonP_stEnhPhysSRCRls_MAP FreonP_tiEngOnMin_C FreonP_tiTempErrOk_C FreonP_tSnsrMax_f_C FreonP_tSnsrMin_f_C /end DEF_CHARACTERISTIC
 /begin IN_MEASUREMENT CoEng_tiNormal DELib_idxArrSnsr DELib_xArrSnsr DSM_TripChgFinshd Epm_nEng FreonP_pSens_f FreonP_stSnsrDdCalc FreonP_swtConfStdSensC FreonP_swtConfStdSensSwVersC InjCtl_qSetUnBal /end IN_MEASUREMENT
 /begin OUT_MEASUREMENT DDRC_St.DFC_FreonPPhysRngHi DDRC_St.DFC_FreonPPhysRngLo DFC_st.DFC_FreonPPhysRngHi DFC_st.DFC_FreonPPhysRngLo DFC_st.DFC_FreonPTmpErr DINH_nrActvInhReas.FId_FreonPPhysRng DINH_nrActvInhReas.FId_FreonPTmpErrCnt DINH_stFId.FId_FreonPPhysRng DINH_stFId.FId_FreonPTmpErrCnt FreonP_stSnsrActv /end OUT_MEASUREMENT
 /begin LOC_MEASUREMENT FreonP_pDynThresPhysRngHi_f_mp FreonP_pDynThresPhysRngLo_f_mp FreonP_stMonStdSens /end LOC_MEASUREMENT
 FUNCTION_VERSION "9.2.0" /end FUNCTION
/begin FUNCTION GConf_Sy "VC1CP091_STLA_N_D060I1" FUNCTION_VERSION "VC1CP091_STLA_N_D060I1" /end FUNCTION
/begin FUNCTION GlbDa_LSum "2.24.0    Global Data Total Distance" /begin DEF_CHARACTERISTIC GlbDa_lDstLim_C GlbDa_maskVehVVldySq_C /end DEF_CHARACTERISTIC /begin IN_MEASUREMENT VehV_v VehV_v_Sq /end IN_MEASUREMENT
 /begin OUT_MEASUREMENT DINH_nrActvInhReas.FId_GlbDaLSumvXPtd DINH_stFId.FId_GlbDaLSumvXPtd GlbDa_lDst GlbDa_lTotDst /end OUT_MEASUREMENT
 /begin LOC_MEASUREMENT GlbDa_lDstLstStored GlbDa_lDstLstStoredProtd GlbDa_lTotDstProtd GlbDa_stEepOrder GlbDa_stEepWrite /end LOC_MEASUREMENT
 FUNCTION_VERSION "2.24.0" /end FUNCTION
/begin FUNCTION GlbDa_SetData "1400.0.0  Global Data Set Data"
 /begin DEF_CHARACTERISTIC DFC_CtlMsk2.DFC_ComVCInval_C DFC_DisblMsk2.DFC_ComVCInval_C GlbDa_numVarcodeTLC_C GlbDa_numVarcodeUCFrc_C GlbDa_numVarcodeUCPO_C /end DEF_CHARACTERISTIC
 /begin REF_CHARACTERISTIC SSwtS_swtGlbTyp_C /end REF_CHARACTERISTIC
 /begin OUT_MEASUREMENT DFC_st.DFC_ComVCInval GlbDa_bChrgnSockCfg GlbDa_cntVarCodNum GlbDa_codVarCodUC GlbDa_stErrVarCod GlbDa_versVarCod /end OUT_MEASUREMENT
 FUNCTION_VERSION "1400.0.0" /end FUNCTION
/begin FUNCTION HeatrCoreT_DELib_StdSensDd "10.2.0"
 /begin DEF_CHARACTERISTIC DDRC_DurDeb.HeatrCoreT_tiSRCMinDebOk_C DDRC_DurDeb.HeatrCoreT_tiSRCMinDebDef_C DDRC_DurDeb.HeatrCoreT_tiSRCOpnDebOk_C DDRC_DurDeb.HeatrCoreT_tiSRCOpnDebDef_C DDRC_RatDeb.HeatrCoreT_tiSRCMinUDRat_C DDRC_RatDeb.HeatrCoreT_tiSRCOpnUDRat_C DFC_CtlMsk2.DFC_HeatrCoreTSRCMin_C DFC_CtlMsk2.DFC_HeatrCoreTSRCOpn_C DFC_CtlMsk2.DFC_HeatrCoreTSRCMax_C DFC_DisblMsk2.DFC_HeatrCoreTSRCMin_C DFC_DisblMsk2.DFC_HeatrCoreTSRCOpn_C DFC_DisblMsk2.DFC_HeatrCoreTSRCMax_C HeatrCoreT_ADCCal.numSRCTempSel_C HeatrCoreT_ADCCal.tiSRCMaxDebOK_C HeatrCoreT_ADCCal.uSRCMax_C HeatrCoreT_ADCCal.uSRCMin_C HeatrCoreT_ADCCal.uSRCOpn_C HeatrCoreT_ADCSensTransf_f_CUR HeatrCoreT_tiSRCMaxDefDeb_CUR /end DEF_CHARACTERISTIC
 /begin REF_CHARACTERISTIC HeatrCoreT_tiPT1Fil_C HeatrCoreT_TransStg_f.Dfl_r32_C HeatrCoreT_TransStg_f.stSensId_C /end REF_CHARACTERISTIC
 /begin IN_MEASUREMENT DELib_idxArrSnsr DELib_xArrSnsr HeatrCoreT_FirRead.cntr HeatrCoreT_FirRead.flgFirstRun HeatrCoreT_FirRead.idxArr HeatrCoreT_FirRead.uSum HeatrCoreT_stSnsrDdReadCalc HeatrCoreT_swtConfStdSens2C HeatrCoreT_swtConfStdSensC HeatrCoreT_swtConfStdSensSwVersC HeatrCoreT_uRawPT1FltdSens HeatrCoreT_uRawUnFltd /end IN_MEASUREMENT
 /begin OUT_MEASUREMENT DDRC_St.DFC_HeatrCoreTSRCMin DDRC_St.DFC_HeatrCoreTSRCOpn DFC_st.DFC_HeatrCoreTSRCMin DFC_st.DFC_HeatrCoreTSRCOpn DFC_st.DFC_HeatrCoreTSRCMax DINH_nrActvInhReas.FId_HeatrCoreTEnhdSRCMax DINH_nrActvInhReas.FId_HeatrCoreTSSpMon DINH_stFId.FId_HeatrCoreTEnhdSRCMax DINH_stFId.FId_HeatrCoreTSSpMon HeatrCoreT_FirCalc.cntrAvrgZr HeatrCoreT_FirCalc.flgRdDne HeatrCoreT_FirCalc.uRawAvrg HeatrCoreT_FirCalc.uRawFir HeatrCoreT_stSnsrDdCalc HeatrCoreT_swtSensPres HeatrCoreT_tiSRCMaxDefDeb HeatrCoreT_tSensCpl HeatrCoreT_tSensUnFltd HeatrCoreT_tSens_f HeatrCoreT_uRaw HeatrCoreT_uRaw_f /end OUT_MEASUREMENT
 /begin LOC_MEASUREMENT HeatrCoreT_DDstSnsrState_mp HeatrCoreT_tRefSnsr_mp HeatrCoreT_tSensPT1Fltd_mp /end LOC_MEASUREMENT
 FUNCTION_VERSION "10.2.0" /end FUNCTION
/begin FUNCTION HeatrCoreT_DELib_StdSensDdRead "10.4.0" /begin DEF_CHARACTERISTIC HeatrCoreT_tiPT1Fil_C /end DEF_CHARACTERISTIC
 /begin IN_MEASUREMENT HeatrCoreT_FirCalc.cntrAvrgZr HeatrCoreT_FirCalc.flgRdDne HeatrCoreT_FirCalc.uRawAvrg HeatrCoreT_FirCalc.uRawFir HeatrCoreT_swtConfStdSens2C HeatrCoreT_swtConfStdSensC /end IN_MEASUREMENT
 /begin OUT_MEASUREMENT HeatrCoreT_FirRead.cntr HeatrCoreT_FirRead.flgFirstRun HeatrCoreT_FirRead.idxArr HeatrCoreT_FirRead.uSum HeatrCoreT_stSnsrDdReadCalc HeatrCoreT_uRawPT1Fltd HeatrCoreT_uRawPT1FltdSens HeatrCoreT_uRawUnFltd /end OUT_MEASUREMENT
 FUNCTION_VERSION "10.4.0" /end FUNCTION
/begin FUNCTION HeatrCoreT_DELib_StdSensDdSENTSlowRead "3.2.0"
 /begin IN_MEASUREMENT HeatrCoreT_swtConfStdSens2C HeatrCoreT_swtConfStdSensC HeatrCoreT_swtConfStdSensSwVersC /end IN_MEASUREMENT
 FUNCTION_VERSION "3.2.0" /end FUNCTION
/begin FUNCTION HeatrCoreT_DELib_StdSensExtDiag "8.1.0"
 /begin IN_MEASUREMENT DELib_idxArrSnsr DELib_xArrSnsr DSM_TripChgFinshd HeatrCoreT_swtConfStdSensC HeatrCoreT_swtConfStdSensSwVersC SyC_stSub /end IN_MEASUREMENT
 FUNCTION_VERSION "8.1.0" /end FUNCTION
/begin FUNCTION HeatrCoreT_DELib_StdSensInin "8.2.0"
 /begin DEF_CHARACTERISTIC HeatrCoreT_swtConfStdSens2_C HeatrCoreT_swtConfStdSensSwVers162_C HeatrCoreT_swtConfStdSens_C /end DEF_CHARACTERISTIC
 /begin REF_CHARACTERISTIC HeatrCoreT_tiPT1Fil_C /end REF_CHARACTERISTIC
 /begin OUT_MEASUREMENT HeatrCoreT_swtConfStdSens2C HeatrCoreT_swtConfStdSensC HeatrCoreT_swtConfStdSensSwVersC HeatrCoreT_swtSensMode /end OUT_MEASUREMENT
 FUNCTION_VERSION "8.2.0" /end FUNCTION
/begin FUNCTION HeatrCoreT_DELib_StdSensVd "11.0.0"
 /begin DEF_CHARACTERISTIC HeatrCoreT_DigSensCal.tiDebPos_C HeatrCoreT_DigSensCal.tiDebNeg_C HeatrCoreT_dtGradLim_f_C HeatrCoreT_RmpSlp_f.Pos_C HeatrCoreT_RmpSlp_f.Neg_C HeatrCoreT_tDflVal_f_C HeatrCoreT_tHiLimit_f_C HeatrCoreT_tiPT1_f_C HeatrCoreT_tLoLimit_f_C HeatrCoreT_TransStg_f.Dfl_r32_C HeatrCoreT_TransStg_f.stSensId_C /end DEF_CHARACTERISTIC
 /begin IN_MEASUREMENT HeatrCoreT_stSnsrDdCalc HeatrCoreT_swtConfStdSensC HeatrCoreT_swtConfStdSensSwVersC HeatrCoreT_tSens_f /end IN_MEASUREMENT
 /begin OUT_MEASUREMENT DINH_nrActvInhReas.FId_HeatrCoreTFrzVal DINH_nrActvInhReas.FId_HeatrCoreTRplVal DINH_stFId.FId_HeatrCoreTFrzVal DINH_stFId.FId_HeatrCoreTRplVal HeatrCoreT_tSensOffsCorrd_f HeatrCoreT_tUnFlt_f HeatrCoreT_t_f HeatrCoreT_t_f_Sq /end OUT_MEASUREMENT
 /begin LOC_MEASUREMENT HeatrCoreT_tSensGradLim_f_mp /end LOC_MEASUREMENT
 FUNCTION_VERSION "11.0.0" /end FUNCTION
/begin FUNCTION HeatrCoreT_DELib_StdSensVdMon "9.2.0"
 /begin DEF_CHARACTERISTIC DDRC_DurDeb.HeatrCoreT_tiPhysRngHiDebOk_C DDRC_DurDeb.HeatrCoreT_tiPhysRngHiDebDef_C DDRC_DurDeb.HeatrCoreT_tiPhysRngLoDebOk_C DDRC_DurDeb.HeatrCoreT_tiPhysRngLoDebDef_C DDRC_RatDeb.HeatrCoreT_tiPhysRngHiUDRat_C DDRC_RatDeb.HeatrCoreT_tiPhysRngLoUDRat_C DFC_CtlMsk2.DFC_HeatrCoreTPhysRngHi_C DFC_CtlMsk2.DFC_HeatrCoreTPhysRngLo_C DFC_CtlMsk2.DFC_HeatrCoreTTmpErr_C DFC_DisblMsk2.DFC_HeatrCoreTPhysRngHi_C DFC_DisblMsk2.DFC_HeatrCoreTPhysRngLo_C DFC_DisblMsk2.DFC_HeatrCoreTTmpErr_C HeatrCoreT_numStdSens_C HeatrCoreT_numTempErrDef_C HeatrCoreT_numtSel_C HeatrCoreT_stEnhPhysSRCRls_MAP HeatrCoreT_tEnhPhysSRCMax_f_MAP HeatrCoreT_tEnhPhysSRCMin_f_MAP HeatrCoreT_tiEngOnMin_C HeatrCoreT_tiTempErrOk_C HeatrCoreT_tSnsrMax_f_C HeatrCoreT_tSnsrMin_f_C /end DEF_CHARACTERISTIC
 /begin IN_MEASUREMENT CoEng_tiNormal DELib_idxArrSnsr DELib_xArrSnsr DSM_TripChgFinshd Epm_nEng HeatrCoreT_stSnsrDdCalc HeatrCoreT_swtConfStdSensC HeatrCoreT_swtConfStdSensSwVersC HeatrCoreT_tSens_f InjCtl_qSetUnBal /end IN_MEASUREMENT
 /begin OUT_MEASUREMENT DDRC_St.DFC_HeatrCoreTPhysRngHi DDRC_St.DFC_HeatrCoreTPhysRngLo DFC_st.DFC_HeatrCoreTPhysRngHi DFC_st.DFC_HeatrCoreTPhysRngLo DFC_st.DFC_HeatrCoreTTmpErr DINH_nrActvInhReas.FId_HeatrCoreTPhysRng DINH_nrActvInhReas.FId_HeatrCoreTTmpErrCnt DINH_stFId.FId_HeatrCoreTPhysRng DINH_stFId.FId_HeatrCoreTTmpErrCnt HeatrCoreT_stSnsrActv /end OUT_MEASUREMENT
 /begin LOC_MEASUREMENT HeatrCoreT_stMonStdSens HeatrCoreT_tDynThresPhysRngHi_f_mp HeatrCoreT_tDynThresPhysRngLo_f_mp /end LOC_MEASUREMENT
 FUNCTION_VERSION "9.2.0" /end FUNCTION
/begin FUNCTION HeatrRly1_DELib_SimpleSwt "4.6.0"
 /begin DEF_CHARACTERISTIC HeatrRly1_SwtGDD_I.flgIvt_C HeatrRly1_SwtGDD_I.tiDebHiLo_C HeatrRly1_SwtGDD_I.tiDebLoHi_C /end DEF_CHARACTERISTIC
 /begin OUT_MEASUREMENT HeatrRly1_st HeatrRly1_stRaw HeatrRly1_st_Sq /end OUT_MEASUREMENT
 FUNCTION_VERSION "4.6.0" /end FUNCTION
/begin FUNCTION HLCCcs_Coorn "5500.6.0  Coordination of High Level Charging Commuication CCS"
 /begin DEF_CHARACTERISTIC DDRC_DurDeb.HLCCcs_tiPLnCChipTHiDebOk_C DDRC_DurDeb.HLCCcs_tiPLnCChipTHiDebDef_C DDRC_DurDeb.HLCCcs_tiFwDwnlDebOk_C DDRC_DurDeb.HLCCcs_tiFwDwnlDebDef_C DDRC_RatDeb.HLCCcs_tiPLnCChipTHiUDRat_C DFC_CtlMsk2.DFC_HLCCcsFwDwnl_C DFC_CtlMsk2.DFC_HLCCcsPLnCChipTHi_C DFC_CtlMsk2.DFC_HLCCcsGnrlComErr_C DFC_DisblMsk2.DFC_HLCCcsFwDwnl_C DFC_DisblMsk2.DFC_HLCCcsPLnCChipTHi_C DFC_DisblMsk2.DFC_HLCCcsGnrlComErr_C HLCCcs_flgFwDwnlRstrtEna_C HLCCcs_ratSocStrt_C HLCCcs_stEgyTrfModMskAc_C HLCCcs_stEgyTrfModMskDc_C HLCCcs_tiDlyChrgnRdy_C HLCCcs_tiDlyFctCtrlEthStrt_C HLCCcs_tiDlyFctCtrlRst_C HLCCcs_tiDlyPLnCDi_C HLCCcs_tiDlyRestrtAllwd_C HLCCcs_tiEvseNotifMaxDlyOfs_C HLCCcs_tPwrLineChp_f_C /end DEF_CHARACTERISTIC
 /begin IN_MEASUREMENT CcsPwrLineComChpT_t_f ChgrPlug_flgDigComRqrd ChgrPlug_stCtP ChrgMod_flgChrgnRdy ChrgMod_stChrgn ChrgMod_stMod ChrgPlg_stPlg DcChrgnCtrl_flgV2GDiReq DcChrgnCtrl_stChrgnSub HLCCcs_cntrPwrEntrySdlTpl1 HLCCcs_pwrEvseDcMax HLCCcs_pwrMaxSdlTpl1 HLCCcs_stApplPtcol HLCCcs_stEgyTrfModAvl HLCCcs_stEvseDcCod HLCCcs_stEvseNotif HLCCcs_stEvseRespCod HLCCcs_stFwDwnl HLCCcs_stV2G HLCCcs_tiEvseNotifMaxDly HLCCcs_tiPwrStrtSdlTpl1 HLCCcs_uEvseDcMax HLCCcs_uEvseDcMin HvBatt_ratSoc HvBatt_uActMeasd HvBatt_uNomChrgn /end IN_MEASUREMENT
 /begin OUT_MEASUREMENT DDRC_St.DFC_HLCCcsFwDwnl DDRC_St.DFC_HLCCcsPLnCChipTHi DFC_st.DFC_HLCCcsFwDwnl DFC_st.DFC_HLCCcsPLnCChipTHi DFC_st.DFC_HLCCcsGnrlComErr DINH_nrActvInhReas.FId_HLCCcs_CoornPLnCChipTHi DINH_nrActvInhReas.FId_HLCCcs_CoornPLnCChpT DINH_stFId.FId_HLCCcs_CoornPLnCChipTHi DINH_stFId.FId_HLCCcs_CoornPLnCChpT HLCCcs_flgCcsDcAvl HLCCcs_flgChrgnStopReq HLCCcs_flgEgyTrfModNotCmpbl HLCCcs_flgEthStrt HLCCcs_flgEvRdy HLCCcs_flgPLnCEna HLCCcs_pwrAvlDcMax HLCCcs_st HLCCcs_stChrgnCtrl HLCCcs_stCtrlPlt HLCCcs_stCtrlPltPwm HLCCcs_stEgyTrfModSeld HLCCcs_stEvseCmpblty HLCCcs_stFctCtrl /end OUT_MEASUREMENT
 /begin LOC_MEASUREMENT HLCCcs_cntrChrgnSdlEntry HLCCcs_flgChrgnSdlEntryExcdd HLCCcs_flgChrgnSdlTiEna HLCCcs_flgChrgnStopReqDIN HLCCcs_flgFctCtrlRSFFLoc HLCCcs_flgRestrtAllwd HLCCcs_pwrChrgnSdlEntry HLCCcs_tiChrgnSdlElpd HLCCcs_tiChrgnSdlEntry /end LOC_MEASUREMENT
 FUNCTION_VERSION "5500.6.0" /end FUNCTION
/begin FUNCTION HLCCcs_V2GAppl "5500.8.0  V2G Application of High Level Charging Communication CCS"
 /begin DEF_CHARACTERISTIC HLCCcs_idxStatEvErrCod_C HLCCcs_ratSocFull_C HLCCcs_stPhyAdrSeln_C HLCCcs_stSlacVldnMod_C /end DEF_CHARACTERISTIC
 /begin IN_MEASUREMENT ChrgMod_iChrgnReq ChrgMod_uChrgnReq CmbdChrgnSys_iEvMax CmbdChrgnSys_stEvErrCodCcsDc HLCCcs_flgEgyTrfModNotCmpbl HLCCcs_flgEthStrt HLCCcs_flgEvRdy HLCCcs_stChrgnCtrl HLCCcs_stCtrlPlt HLCCcs_stCtrlPltPwm HLCCcs_stEgyTrfModSeld HLCCcs_stFctCtrl HvBatt_ratSoc HvBatt_uMaxLim /end IN_MEASUREMENT
 /begin OUT_MEASUREMENT HLCCcs_cntrPwrEntrySdlTpl1 HLCCcs_flgTogReq HLCCcs_iEvseDcMax HLCCcs_iEvseDcMin HLCCcs_iEvseDcPeakRpl HLCCcs_iEvseDcPrsnt HLCCcs_iEvseDcRglnTolr HLCCcs_nrTogReq HLCCcs_pwrEvseDcMax HLCCcs_pwrMaxSdlTpl1 HLCCcs_stApplPtcol HLCCcs_stApplPtcolRespCod HLCCcs_stEgyTrfModAvl HLCCcs_stEvseDcCod HLCCcs_stEvseDcIso HLCCcs_stEvseNotif HLCCcs_stEvseProcn HLCCcs_stEvseRespCod HLCCcs_stFwDwnl HLCCcs_stMsgHdrNotifFltCod HLCCcs_stSlacEve HLCCcs_stSlacRdy HLCCcs_stSlacStep HLCCcs_stV2G HLCCcs_stV2GErr HLCCcs_stV2GMsg HLCCcs_stV2GStckErr HLCCcs_stV2GTcpSock HLCCcs_tiEvseNotifMaxDly HLCCcs_tiPwrDurnSdlTpl1 HLCCcs_tiPwrStrtSdlTpl1 HLCCcs_uEvseDcMax HLCCcs_uEvseDcMin HLCCcs_uEvseDcPrsnt /end OUT_MEASUREMENT
 /begin LOC_MEASUREMENT HLCCcs_flgCtpSwtTogActvOld HLCCcs_flgEthStrtOld HLCCcs_flgTogCfmRqrd HLCCcs_flgTogSet HLCCcs_idSdlTpl1 /end LOC_MEASUREMENT
 FUNCTION_VERSION "5500.8.0" /end FUNCTION
/begin FUNCTION HvacHmi_Vd "3.2.0     Heating Ventilation and Air Conditioning human interface virtual driver"
 /begin DEF_CHARACTERISTIC DFC_CtlMsk2.DFC_AcFlt_C DFC_CtlMsk2.DFC_HvacBlwrFrntFlt_C DFC_CtlMsk2.DFC_HvacEvapElecFlt_C DFC_CtlMsk2.DFC_HvacEvapElecFltGnd_C DFC_CtlMsk2.DFC_HvacKnobPosnFlt_C DFC_DisblMsk2.DFC_AcFlt_C DFC_DisblMsk2.DFC_HvacBlwrFrntFlt_C DFC_DisblMsk2.DFC_HvacEvapElecFlt_C DFC_DisblMsk2.DFC_HvacEvapElecFltGnd_C DFC_DisblMsk2.DFC_HvacKnobPosnFlt_C HvacHmi_stVehStDiagEna_C HvacHmi_tEvaprFlt_C /end DEF_CHARACTERISTIC
 /begin IN_MEASUREMENT Com_stAC Com_stBlowrRly Com_stEvapTFlt Com_stHvacBlwrFront Com_stHvacKnobPosn Com_tEvapT VehCoorn_st /end IN_MEASUREMENT
 /begin OUT_MEASUREMENT DFC_st.DFC_AcFlt DFC_st.DFC_HvacBlwrFrntFlt DFC_st.DFC_HvacEvapElecFlt DFC_st.DFC_HvacEvapElecFltGnd DFC_st.DFC_HvacKnobPosnFlt DINH_nrActvInhReas.FId_HvacHmiFlt DINH_stFId.FId_HvacHmiFlt HvacHmi_ratBlowrSpd HvacHmi_stAc HvacHmi_stCoolgReq HvacHmi_stHeatgReq RefgntCirc_tEvaprAct /end OUT_MEASUREMENT
 /begin LOC_MEASUREMENT HvacHmi_flgDiagEna HvacHmi_flgEvapTFlt /end LOC_MEASUREMENT
 FUNCTION_VERSION "3.2.0" /end FUNCTION
/begin FUNCTION HvacLvl_Detrm "6.2.0     Heating Ventilation and Air Conditioning temperature level determination"
 /begin DEF_CHARACTERISTIC HvacLvl_maskRatSocVldSq_C HvacLvl_pwrDesCoolgSaveDelta_C HvacLvl_pwrDesCoolgSaveMax_C HvacLvl_pwrDesDefogSaveDelta_C HvacLvl_pwrDesDefogSaveMax_C HvacLvl_pwrLoRefgntDes_C HvacLvl_pwrRefgntDesDern_C HvacLvl_pwrRefgntDesEcoCoolg_T HvacLvl_pwrRefgntDesEcoDefog_T HvacLvl_pwrRefgntDesNormCoolg_T HvacLvl_pwrRefgntDesNormDefog_T HvacLvl_ratSocDeltaPwrSave_C HvacLvl_ratSocLePwrSave_C HvacLvl_tTarHeatrEco_C HvacLvl_tTarHeatr_C /end DEF_CHARACTERISTIC
 /begin IN_MEASUREMENT DrvPrgSwt_stReq HvacMod_stRefgntTar HvBatt_ratSoc HvBatt_ratSoc_Sq RefgntCirc_tEvaprAct ThermHvac_stFrntCoolgReq ThermHvac_stFrntHeatgReq ThermHvac_tEvaprSpMax ThermHvac_tEvaprSpMin /end IN_MEASUREMENT
 /begin OUT_MEASUREMENT HvacLvl_dTEvaprSp HvacLvl_dTEvaprSpDelta HvacLvl_dTHeatrSp HvacLvl_pwrRefgntDes /end OUT_MEASUREMENT
 /begin LOC_MEASUREMENT HvacLvl_flgSocPwrSaveActv HvacLvl_pwrCoolgSaveModDes HvacLvl_pwrDefogSaveModDes HvacLvl_pwrRefgntCoolgDes HvacLvl_pwrRefgntDefogDes /end LOC_MEASUREMENT
 FUNCTION_VERSION "6.2.0" /end FUNCTION
/begin FUNCTION HvacMod_Detrm "6.5.0     Heating Ventilation and Air Conditioning operation mode determination"
 /begin DEF_CHARACTERISTIC HvacMod_maskRatSocVldy_C HvacMod_ratHvBattSocDelta_C HvacMod_ratHvBattSocHi_C HvacMod_ratHvBattSocLo_C HvacMod_tEvaprVeryColdDelta_C HvacMod_tEvaprVeryCold_C HvacMod_tiCbnBlowrDebHiLo_C HvacMod_tiCbnBlowrDebLoHi_C /end DEF_CHARACTERISTIC
 /begin IN_MEASUREMENT HvacLvl_dTEvaprSp HvacLvl_dTEvaprSpDelta HvBatt_ratSoc HvBatt_ratSoc_Sq RefgntCirc_tEvaprAct ThermHvac_flgRemPrecndnActv ThermHvac_ratBlowrSpd ThermHvac_stAc ThermHvac_stFrntCoolgReq ThermHvac_stFrntHeatgReq VehCoorn_st /end IN_MEASUREMENT
 /begin OUT_MEASUREMENT DINH_nrActvInhReas.FId_HvacModCoolgFlt DINH_nrActvInhReas.FId_HvacModHeatgFlt DINH_stFId.FId_HvacModCoolgFlt DINH_stFId.FId_HvacModHeatgFlt HvacMod_flgAcDes HvacMod_st HvacMod_stAcReq HvacMod_stPtc HvacMod_stRefgntTar /end OUT_MEASUREMENT
 /begin LOC_MEASUREMENT HvacMod_flgBlowrOn HvacMod_flgCoolgRels HvacMod_flgHeatgRels HvacMod_flgHvAvl HvacMod_stEvaprSpT HvacMod_stHvSocLvl HvacMod_stKnobPosn /end LOC_MEASUREMENT
 FUNCTION_VERSION "6.5.0" /end FUNCTION
/begin FUNCTION HvacPtc_Ctrl "6.3.0     PTC heater for cabin heating"
 /begin DEF_CHARACTERISTIC HvacPtc_pwrHeatrOff_C HvacPtc_pwrHeatrOn_C HvacPtc_tHeatrOnDeltaEcoMax_C HvacPtc_tHeatrOnDeltaMax_C HvacPtc_tiMinOff_C HvacPtc_tiMinOn_C /end DEF_CHARACTERISTIC
 /begin IN_MEASUREMENT CbnHeatgSwt_stAct DrvPrgSwt_stReq HvacLvl_dTHeatrSp HvacMod_stPtc MoFCbnPreCdng_flgPreHeatDioCfmMsg /end IN_MEASUREMENT
 /begin OUT_MEASUREMENT DINH_nrActvInhReas.FId_HvacPtcHeatrErr DINH_stFId.FId_HvacPtcHeatrErr HvacPtc_pwrDes /end OUT_MEASUREMENT
 /begin LOC_MEASUREMENT HvacPtc_flgHeatrDes HvacPtc_flgHeatrReq HvacPtc_tiStTmr /end LOC_MEASUREMENT
 FUNCTION_VERSION "6.3.0" /end FUNCTION
/begin FUNCTION HvBatt_ChrgrVd "1400.2.0  Virtual Driver of High Voltage Battery Charger Functions"
 /begin DEF_CHARACTERISTIC DDRC_DurDeb.HvBatt_tiIReqToChrgrErrDebOk_C DDRC_DurDeb.HvBatt_tiIReqToChrgrErrDebDef_C DDRC_DurDeb.HvBatt_tiIReqToChrgrIniDebOk_C DDRC_DurDeb.HvBatt_tiIReqToChrgrIniDebDef_C DDRC_DurDeb.HvBatt_tiUNomChrgnErrDebOk_C DDRC_DurDeb.HvBatt_tiUNomChrgnErrDebDef_C DDRC_DurDeb.HvBatt_tiUNomChrgnIniDebOk_C DDRC_DurDeb.HvBatt_tiUNomChrgnIniDebDef_C DFC_CtlMsk2.DFC_HvBattIReqToChrgrErr_C DFC_CtlMsk2.DFC_HvBattIReqToChrgrIni_C DFC_CtlMsk2.DFC_HvBattUNomChrgnErr_C DFC_CtlMsk2.DFC_HvBattUNomChrgnIni_C DFC_DisblMsk2.DFC_HvBattIReqToChrgrErr_C DFC_DisblMsk2.DFC_HvBattIReqToChrgrIni_C DFC_DisblMsk2.DFC_HvBattUNomChrgnErr_C DFC_DisblMsk2.DFC_HvBattUNomChrgnIni_C HvBatt_facChrgIReqDern_T HvBatt_flgNomChrgnUSeln_C HvBatt_iReqToChrgrErr_C HvBatt_iReqToChrgrIni_C HvBatt_maskUHvbLimHiSq_C HvBatt_uHvbLimHiErr_C HvBatt_uNomChrgnErr_C HvBatt_uNomChrgnIni_C /end DEF_CHARACTERISTIC
 /begin IN_MEASUREMENT ChrgMod_flgIsoMeasmtDiReq Com_flgChrgTarRea Com_iHvbDes Com_iHvbDes_Sq Com_iHvbNomChrgn Com_qHvbTotCp Com_stHvbChrgFlt Com_stHvbIsoMeasmtActv Com_stPckCnctn Com_uHvbLimHi Com_uHvbLimHi_Sq Com_uHvbNomChrgn Com_uHvbNomChrgn_Sq PwrDistbnUnitT_t_f /end IN_MEASUREMENT
 /begin OUT_MEASUREMENT DDRC_St.DFC_HvBattIReqToChrgrErr DDRC_St.DFC_HvBattIReqToChrgrIni DDRC_St.DFC_HvBattUNomChrgnErr DDRC_St.DFC_HvBattUNomChrgnIni DFC_st.DFC_HvBattIReqToChrgrErr DFC_st.DFC_HvBattIReqToChrgrIni DFC_st.DFC_HvBattUNomChrgnErr DFC_st.DFC_HvBattUNomChrgnIni DINH_nrActvInhReas.FId_HvBattDesChrgIDern DINH_stFId.FId_HvBattDesChrgIDern HvBatt_flgChrgTarRea HvBatt_flgIsoMeasmtDiReq HvBatt_iMaxExtChrg HvBatt_iReqToChrgr HvBatt_qTotCp HvBatt_stFlt HvBatt_stIsoMeasmtActv HvBatt_stPckCnctn HvBatt_uNomChrgn /end OUT_MEASUREMENT
 FUNCTION_VERSION "1400.2.0" /end FUNCTION
/begin COMPU_METHOD boolean "" RAT_FUNC "%6.2" "-" COEFFS 0 1 0 0 0 1 /end COMPU_METHOD
/begin COMPU_METHOD B_TRUE "" TAB_VERB "%6.3" "" COMPU_TAB_REF B_TRUE /end COMPU_METHOD
/begin COMPU_VTAB B_TRUE "" TAB_VERB 2 0 "FALSE" 1 "TRUE" /end COMPU_VTAB
/begin COMPU_METHOD ChrgIf_stEvseCmpblty_VERB "" TAB_VERB "%6.3" "" COMPU_TAB_REF ChrgIf_stEvseCmpblty_VERB /end COMPU_METHOD
/begin COMPU_VTAB ChrgIf_stEvseCmpblty_VERB "" TAB_VERB 3 0 "HLCCCS_CMPBLTY_INI" 1 "HLCCCS_CMPBLTY_CMPBL" 2 "HLCCCS_CMPBLTY_NOTCMPBL" /end COMPU_VTAB
/begin COMPU_METHOD ChrgIf_stHLCCcs_VERB "" TAB_VERB "%6.3" "" COMPU_TAB_REF ChrgIf_stHLCCcs_VERB /end COMPU_METHOD
/begin COMPU_VTAB ChrgIf_stHLCCcs_VERB "" TAB_VERB 10 0 "HLCCCS_INI" 1 "HLCCCS_SETUP" 2 "HLCCCS_CHRGPRM" 3 "HLCCCS_CBLCHK" 4 "HLCCCS_PREC" 5 "HLCCCS_PWRDLV" 6 "HLCCCS_WLDCHK" 7 "HLCCCS_STOP" 8 "HLCCCS_FINSH" 9 "HLCCCS_ERR" /end COMPU_VTAB
/begin COMPU_METHOD Curr_A_q0p03125_COMPU "" RAT_FUNC "%6.4" "A" COEFFS 0 32 0 0 0 1 /end COMPU_METHOD
/begin COMPU_METHOD DDRCTime_ms "" RAT_FUNC "%6.1" "ms" COEFFS 0 1 0 0 0 10 /end COMPU_METHOD
/begin COMPU_METHOD DDRC_Ratio "" TAB_VERB "%6.3" "-" COMPU_TAB_REF DDRC_Ratio /end COMPU_METHOD
/begin COMPU_VTAB DDRC_Ratio "" TAB_VERB 4 1 "Ratio1" 2 "Ratio2" 3 "Ratio3" 4 "Ratio4" /end COMPU_VTAB
/begin COMPU_METHOD DELIB_ALLTEMP_VERB_COMPU "" TAB_VERB "%6.3" "" COMPU_TAB_REF DELIB_ALLTEMP_VERB_COMPU /end COMPU_METHOD
/begin COMPU_VTAB DELIB_ALLTEMP_VERB_COMPU "" TAB_VERB 6 85 "ACCHRGRINTKT" 86 "DCCHRGRINTKT" 0 "ENVT" 89 "HEATRCORET" 254 "DFLTEMP" 255 "NOTEMP" /end COMPU_VTAB
/begin COMPU_METHOD DFC_OneToOne "" RAT_FUNC "%6.2" "-" COEFFS 0 1 0 0 0 1 /end COMPU_METHOD
/begin COMPU_METHOD DFES_OneToOne "" RAT_FUNC "%6.2" "-" COEFFS 0 1 0 0 0 1 /end COMPU_METHOD
/begin COMPU_METHOD DINH_ct_Compu "" RAT_FUNC "%6.0" "" COEFFS 0 -1 4096 0 0 1 /end COMPU_METHOD
/begin COMPU_METHOD EngN "" RAT_FUNC "%6.3" "rpm" COEFFS 0 2 0 0 0 1 /end COMPU_METHOD
/begin COMPU_METHOD Fact100 "" RAT_FUNC "%6.4" "-" COEFFS 0 100 0 0 0 1 /end COMPU_METHOD
/begin COMPU_METHOD HLCCcs_stApplPtcol_VERB "" TAB_VERB "%6.3" "" COMPU_TAB_REF HLCCcs_stApplPtcol_VERB /end COMPU_METHOD
/begin COMPU_VTAB HLCCcs_stApplPtcol_VERB "" TAB_VERB 3 0 "HLCCCS_APPLPTCOL_NONE" 1 "HLCCCS_APPLPTCOL_ISO" 2 "HLCCCS_APPLPTCOL_DIN" /end COMPU_VTAB
/begin COMPU_METHOD HLCCcs_stEvseDcIso_VERB "" TAB_VERB "%6.3" "" COMPU_TAB_REF HLCCcs_stEvseDcIso_VERB /end COMPU_METHOD
/begin COMPU_VTAB HLCCcs_stEvseDcIso_VERB "" TAB_VERB 6 0 "HLCCCS_EVSEDCISO_NODATA" 1 "HLCCCS_EVSEDCISO_INVLD" 2 "HLCCCS_EVSEDCISO_VLD" 3 "HLCCCS_EVSEDCISO_WARN" 4 "HLCCCS_EVSEDCISO_FLT" 5 "HLCCCS_EVSEDCISO_NODEV" /end COMPU_VTAB
/begin COMPU_METHOD HLCCcs_stFwDwnl_VERB "" TAB_VERB "%6.3" "" COMPU_TAB_REF HLCCcs_stFwDwnl_VERB /end COMPU_METHOD
/begin COMPU_VTAB HLCCcs_stFwDwnl_VERB "" TAB_VERB 4 0 "HLCCCS_FWDWNL_NONE" 1 "HLCCCS_FWDWNL_STRTD" 2 "HLCCCS_FWDWNL_SUC" 3 "HLCCCS_FWDWNL_FAILD" /end COMPU_VTAB
/begin COMPU_METHOD HLCCcs_stSlacEve_VERB "" TAB_VERB "%6.3" "" COMPU_TAB_REF HLCCcs_stSlacEve_VERB /end COMPU_METHOD
/begin COMPU_VTAB HLCCcs_stSlacEve_VERB "" TAB_VERB 28 0 "HLCCCS_SLACINFO_NOERR" 1 "HLCCCS_SLACINFO_ABORT" 2 "HLCCCS_SLACINFO_UKWNMSG" 3 "HLCCCS_SLACINFO_UNEXPTMSG" 4 "HLCCCS_SLACINFO_NEWEVSEADDED" 5 "HLCCCS_SLACINFO_WAITFORLINK" 6 "HLCCCS_SLACINFO_WAITFORLINKDOWN" 7 "HLCCCS_SLACINFO_WAITFORAMPMAP" 8 "HLCCCS_SLACINFO_LEAVESUC" 9 "HLCCCS_SLACWARN_LINKWOSLAC" 10 "HLCCCS_SLACWARN_INVLDMSG" 11 "HLCCCS_SLACWARN_TOUTMSG" 12 "HLCCCS_SLACWARN_TOOMANYEVSE" 13 "HLCCCS_SLACWARN_NUMSOUNDLIM" 14 "HLCCCS_SLACWARN_ATTENPROFGROUP" 15 "HLCCCS_SLACWARN_MPLDRCTEVSE" 16 "HLCCCS_SLACWARN_ONLYINDRCTEVSE" 17 "HLCCCS_SLACWARN_UKWNEVSE" 18 "HLCCCS_SLACWARN_REJMSG" 19 "HLCCCS_SLACWARN_DFTNMK" 20 "HLCCCS_SLACWARN_LEAVEFAILD" 21 "HLCCCS_SLACERR_PREPFAILD" 22 "HLCCCS_SLACERR_NORESP" 23 "HLCCCS_SLACERR_ATTENRNG" 24 "HLCCCS_SLACERR_NOEVSE" 25 "HLCCCS_SLACERR_NOLINK" 26 "HLCCCS_SLACERR_LOSTLINK" 27 "HLCCCS_SLACERR_PLCREBOOT" /end COMPU_VTAB
/begin COMPU_METHOD HLCCcs_stSlacRdy_VERB "" TAB_VERB "%6.3" "" COMPU_TAB_REF HLCCcs_stSlacRdy_VERB /end COMPU_METHOD
/begin COMPU_VTAB HLCCcs_stSlacRdy_VERB "" TAB_VERB 3 0 "HLCCCS_SLACRDY_INI" 1 "HLCCCS_SLACRDY_RDY" 2 "HLCCCS_SLACRDY_NOTRDY" /end COMPU_VTAB
/begin COMPU_METHOD HLCCcs_stSlacStep_VERB "" TAB_VERB "%6.3" "" COMPU_TAB_REF HLCCcs_stSlacStep_VERB /end COMPU_METHOD
/begin COMPU_VTAB HLCCcs_stSlacStep_VERB "" TAB_VERB 15 0 "HLCCCS_SLACSTEP_NONE" 1 "HLCCCS_SLACSTEP_PREP" 2 "HLCCCS_SLACSTEP_PARM" 3 "HLCCCS_SLACSTEP_STARTATTENCHAR" 4 "HLCCCS_SLACSTEP_MNBCSOUND" 5 "HLCCCS_SLACSTEP_ATTENCHAR" 6 "HLCCCS_SLACSTEP_SELEVSE" 7 "HLCCCS_SLACSTEP_VLDT1" 8 "HLCCCS_SLACSTEP_VLDT2" 9 "HLCCCS_SLACSTEP_MATCH" 10 "HLCCCS_SLACSTEP_SETKEY" 11 "HLCCCS_SLACSTEP_WAITFORLINK" 12 "HLCCCS_SLACSTEP_AMPMAP" 13 "HLCCCS_SLACSTEP_WAITFORSTABLINK" 14 "HLCCCS_SLACSTEP_CNCT" /end COMPU_VTAB
/begin COMPU_METHOD HLCCcs_stSlacVldnMod_VERB "" TAB_VERB "%6.3" "" COMPU_TAB_REF HLCCcs_stSlacVldnMod_VERB /end COMPU_METHOD
/begin COMPU_VTAB HLCCcs_stSlacVldnMod_VERB "" TAB_VERB 3 0 "HLCCCS_SLACVLDNMOD_NOVLDN" 1 "HLCCCS_SLACVLDNMOD_OPTVLDN" 2 "HLCCCS_SLACVLDNMOD_FRCDVLDN" /end COMPU_VTAB
/begin COMPU_METHOD HLCCcs_stV2GMsg_VERB "" TAB_VERB "%6.3" "" COMPU_TAB_REF HLCCcs_stV2GMsg_VERB /end COMPU_METHOD
/begin COMPU_VTAB HLCCcs_stV2GMsg_VERB "" TAB_VERB 3 0 "HLCCCS_V2GMSG_PREPREQ" 1 "HLCCCS_V2GMSG_WAITFORRESP" 2 "HLCCCS_V2GMSG_PROCNRESP" /end COMPU_VTAB
/begin COMPU_METHOD HLCCcs_stV2GTcpSock_VERB "" TAB_VERB "%6.3" "" COMPU_TAB_REF HLCCcs_stV2GTcpSock_VERB /end COMPU_METHOD
/begin COMPU_VTAB HLCCcs_stV2GTcpSock_VERB "" TAB_VERB 4 0 "HLCCCS_TCPSOCK_CLSD" 1 "HLCCCS_TCPSOCK_CNCT" 2 "HLCCCS_TCPSOCK_CNCTD" 3 "HLCCCS_TCPSOCK_DISCNCT" /end COMPU_VTAB
/begin COMPU_METHOD HvacMod_stRefgntTar_VERB "" TAB_VERB "%6.3" "" COMPU_TAB_REF HvacMod_stRefgntTar_VERB /end COMPU_METHOD
/begin COMPU_VTAB HvacMod_stRefgntTar_VERB "" TAB_VERB 5 0 "OFF" 1 "MINPWR" 2 "REDPWR" 3 "DEFOG" 4 "COOLG" /end COMPU_VTAB
/begin COMPU_METHOD HvacMod_st_VERB "" TAB_VERB "%6.3" "" COMPU_TAB_REF HvacMod_st_VERB /end COMPU_METHOD
/begin COMPU_VTAB HvacMod_st_VERB "" TAB_VERB 7 0 "Off" 1 "NormCoolg" 2 "DeratedCoolg" 3 "LoPwrCoolg" 4 "NormHeatg" 5 "DefogHeatg" 6 "LoPwrDefogHeatg" /end COMPU_VTAB
/begin COMPU_METHOD HVINTLCKOUT2_TYPAVL_SC_Compu "" TAB_VERB "%6.3" "" COMPU_TAB_REF HVINTLCKOUT2_TYPAVL_SC_Compu /end COMPU_METHOD
/begin COMPU_VTAB HVINTLCKOUT2_TYPAVL_SC_Compu "" TAB_VERB 2 0 "False" 1 "True" /end COMPU_VTAB
/begin COMPU_METHOD HVINTLCKOUT3_TYPAVL_SC_Compu "" TAB_VERB "%6.3" "" COMPU_TAB_REF HVINTLCKOUT3_TYPAVL_SC_Compu /end COMPU_METHOD
/begin COMPU_VTAB HVINTLCKOUT3_TYPAVL_SC_Compu "" TAB_VERB 2 0 "False" 1 "True" /end COMPU_VTAB
/begin COMPU_METHOD HWDPD_SC_Compu "" TAB_VERB "%6.3" "" COMPU_TAB_REF HWDPD_SC_Compu /end COMPU_METHOD
/begin COMPU_VTAB HWDPD_SC_Compu "" TAB_VERB 3 0 "HWDPD_NEUT" 1 "HWDPD_SWNOTSEL" 2 "HWDPD_SWSEL" /end COMPU_VTAB
/begin COMPU_METHOD HW_VCU_SC_Compu "" TAB_VERB "%6.3" "" COMPU_TAB_REF HW_VCU_SC_Compu /end COMPU_METHOD
/begin COMPU_VTAB HW_VCU_SC_Compu "" TAB_VERB 5 0 "NO_VCU" 12 "VC1CP012" 90 "VC1CP090" 91 "VC1CP091" 500 "VC1CP500" /end COMPU_VTAB
/begin COMPU_METHOD HYDSTORGHIPT_TYPAVL_SC_Compu "" TAB_VERB "%6.3" "" COMPU_TAB_REF HYDSTORGHIPT_TYPAVL_SC_Compu /end COMPU_METHOD
/begin COMPU_VTAB HYDSTORGHIPT_TYPAVL_SC_Compu "" TAB_VERB 2 0 "False" 1 "True" /end COMPU_VTAB
/begin COMPU_METHOD HYDSTORGLOPT_TYPAVL_SC_Compu "" TAB_VERB "%6.3" "" COMPU_TAB_REF HYDSTORGLOPT_TYPAVL_SC_Compu /end COMPU_METHOD
/begin COMPU_VTAB HYDSTORGLOPT_TYPAVL_SC_Compu "" TAB_VERB 2 0 "False" 1 "True" /end COMPU_VTAB
/begin COMPU_METHOD HYDSYSHIPTSEC_TYPAVL_SC_Compu "" TAB_VERB "%6.3" "" COMPU_TAB_REF HYDSYSHIPTSEC_TYPAVL_SC_Compu /end COMPU_METHOD
/begin COMPU_VTAB HYDSYSHIPTSEC_TYPAVL_SC_Compu "" TAB_VERB 2 0 "False" 1 "True" /end COMPU_VTAB
/begin COMPU_METHOD HYDSYSLOPT_TYPAVL_SC_Compu "" TAB_VERB "%6.3" "" COMPU_TAB_REF HYDSYSLOPT_TYPAVL_SC_Compu /end COMPU_METHOD
/begin COMPU_VTAB HYDSYSLOPT_TYPAVL_SC_Compu "" TAB_VERB 2 0 "False" 1 "True" /end COMPU_VTAB
/begin COMPU_METHOD I15031SRV9NOXBIN_SC_Compu "" TAB_VERB "%6.3" "" COMPU_TAB_REF I15031SRV9NOXBIN_SC_Compu /end COMPU_METHOD
/begin COMPU_VTAB I15031SRV9NOXBIN_SC_Compu "" TAB_VERB 2 0 "FALSE" 1 "TRUE" /end COMPU_VTAB
/begin COMPU_METHOD I15031SRV9VT_SC_Compu "" TAB_VERB "%6.3" "" COMPU_TAB_REF I15031SRV9VT_SC_Compu /end COMPU_METHOD
/begin COMPU_VTAB I15031SRV9VT_SC_Compu "" TAB_VERB 2 0 "VT_disabled" 1 "VT_enabled" /end COMPU_VTAB
/begin COMPU_METHOD I15031SRV9VT_STORGRSTBHVR_SC_Compu "" TAB_VERB "%6.3" "" COMPU_TAB_REF I15031SRV9VT_STORGRSTBHVR_SC_Compu /end COMPU_METHOD
/begin COMPU_VTAB I15031SRV9VT_STORGRSTBHVR_SC_Compu "" TAB_VERB 3 1 "ENVRAM_IUMPRReset" 2 "EEPROM_NoReset" 3 "EEPROM_CalibrationReset" /end COMPU_VTAB
/begin COMPU_METHOD I15031_CVNALG_SC_Compu "" TAB_VERB "%6.3" "" COMPU_TAB_REF I15031_CVNALG_SC_Compu /end COMPU_METHOD
/begin COMPU_VTAB I15031_CVNALG_SC_Compu "" TAB_VERB 4 1 "CVN_ALG_CRC32_DIABAS" 2 "CVN_ALG_CRC32_SECULIBS" 3 "CVN_ALG_SHA256_BCL" 4 "CVN_ALG_SHA256_HSM" /end COMPU_VTAB
/begin COMPU_METHOD I15031_EXTCVNSTORGBHVR_SC_Compu "" TAB_VERB "%6.3" "" COMPU_TAB_REF I15031_EXTCVNSTORGBHVR_SC_Compu /end COMPU_METHOD
/begin COMPU_VTAB I15031_EXTCVNSTORGBHVR_SC_Compu "" TAB_VERB 2 1 "PSTDRV" 2 "RAS1s" /end COMPU_VTAB
/begin COMPU_METHOD I15031_MODRULECUST_SC_Compu "" TAB_VERB "%6.3" "" COMPU_TAB_REF I15031_MODRULECUST_SC_Compu /end COMPU_METHOD
/begin COMPU_VTAB I15031_MODRULECUST_SC_Compu "" TAB_VERB 2 0 "False" 1 "True" /end COMPU_VTAB
/begin COMPU_METHOD I15031_OBD_CNTL_SC_Compu "" TAB_VERB "%6.3" "" COMPU_TAB_REF I15031_OBD_CNTL_SC_Compu /end COMPU_METHOD
/begin COMPU_VTAB I15031_OBD_CNTL_SC_Compu "" TAB_VERB 4 0 "I15031_ACTIVE" 1 "I15031_SRV_ADJUST" 2 "I15031_INACTIVE" 3 "I15031_NOT_EXISTING" /end COMPU_VTAB
/begin COMPU_METHOD I27145_SC_Compu "" TAB_VERB "%6.3" "" COMPU_TAB_REF I27145_SC_Compu /end COMPU_METHOD
/begin COMPU_VTAB I27145_SC_Compu "" TAB_VERB 2 0 "False" 1 "True" /end COMPU_VTAB
/begin COMPU_METHOD INJCRV_INJMASSPIIFACT_SY_Compu "" RAT_FUNC "%6.2" "" COEFFS 0 1 0 0 0 1 /end COMPU_METHOD
/begin COMPU_METHOD InjMass "" RAT_FUNC "%6.4" "mg/hub" COEFFS 0 100 0 0 0 1 /end COMPU_METHOD
/begin COMPU_METHOD InjMassCyc "" RAT_FUNC "%6.4" "mg/cyc" COEFFS 0 100 0 0 0 1 /end COMPU_METHOD
/begin COMPU_METHOD InjMassInj "" RAT_FUNC "%6.4" "mg/inj" COEFFS 0 100 0 0 0 1 /end COMPU_METHOD
/begin COMPU_METHOD InjMassPerTime "" RAT_FUNC "%6.4" "Kg/h" COEFFS 0 100 0 0 0 1 /end COMPU_METHOD
/begin COMPU_METHOD InjMassPerTimeHi "" RAT_FUNC "%7.6" "Kg/h" COEFFS 0 10000 0 0 0 1 /end COMPU_METHOD
/begin COMPU_METHOD InjMsPrTime_q0p001_COMPU "" RAT_FUNC "%6.5" "Kg/h" COEFFS 0 1000 0 0 0 1 /end COMPU_METHOD
/begin COMPU_METHOD InjMs_q0p1_COMPU "" RAT_FUNC "%6.3" "mg/hub" COEFFS 0 10 0 0 0 1 /end COMPU_METHOD
/begin COMPU_METHOD InjMs_q0p2_COMPU "" RAT_FUNC "%6.3" "mg/hub" COEFFS 0 5 0 0 0 1 /end COMPU_METHOD
/begin COMPU_METHOD InjQnt "" RAT_FUNC "%6.3" "mm^3/hub" COEFFS 0 10 0 0 0 1 /end COMPU_METHOD
/begin COMPU_METHOD InjQntInj "" RAT_FUNC "%6.4" "mm^3/inj" COEFFS 0 100 0 0 0 1 /end COMPU_METHOD
/begin COMPU_METHOD INJSYS_POI1SETPOINT_SY_Compu "" RAT_FUNC "%6.2" "" COEFFS 0 1 0 0 0 1 /end COMPU_METHOD
/begin COMPU_METHOD INJSYS_POI2SETPOINT_SY_Compu "" RAT_FUNC "%6.2" "" COEFFS 0 1 0 0 0 1 /end COMPU_METHOD
/begin COMPU_METHOD INJSYS_POI3SETPOINT_SY_Compu "" RAT_FUNC "%6.2" "" COEFFS 0 1 0 0 0 1 /end COMPU_METHOD
/begin COMPU_METHOD InjTime_us "" RAT_FUNC "%6.3" "us" COEFFS 0 2.5 0 0 0 1 /end COMPU_METHOD
/begin COMPU_METHOD InrtTrq_COMPU "" RAT_FUNC "%6.5" "kg*s^2" COEFFS 0 1024 0 0 0 1 /end COMPU_METHOD
/begin COMPU_METHOD INTKAIRT_INTKMNFLD_SC_Compu "" TAB_VERB "%6.3" "" COMPU_TAB_REF INTKAIRT_INTKMNFLD_SC_Compu /end COMPU_METHOD
/begin COMPU_VTAB INTKAIRT_INTKMNFLD_SC_Compu "" TAB_VERB 3 0 "no_signal" 1 "sensor" 2 "model" /end COMPU_VTAB
/begin COMPU_METHOD INTKAIRT_SNSR1POS_SC_Compu "" TAB_VERB "%6.3" "" COMPU_TAB_REF INTKAIRT_SNSR1POS_SC_Compu /end COMPU_METHOD
/begin COMPU_VTAB INTKAIRT_SNSR1POS_SC_Compu "" TAB_VERB 7 0 "no_sensor" 1 "IntkMnfld" 2 "MnfldIcoDs" 3 "ThrVlvUs" 4 "CmprDs" 5 "AirFltDs" 6 "Cmpr2Us" /end COMPU_VTAB
/begin COMPU_METHOD INTKAIRT_SNSR2POS_SC_Compu "" TAB_VERB "%6.3" "" COMPU_TAB_REF INTKAIRT_SNSR2POS_SC_Compu /end COMPU_METHOD
/begin COMPU_VTAB INTKAIRT_SNSR2POS_SC_Compu "" TAB_VERB 7 0 "no_sensor" 1 "IntkMnfld" 2 "MnfldIcoDs" 3 "ThrVlvUs" 4 "CmprDs" 5 "AirFltDs" 6 "Cmpr2Us" /end COMPU_VTAB
/begin COMPU_METHOD INTKAIRT_SNSR3POS_SC_Compu "" TAB_VERB "%6.3" "" COMPU_TAB_REF INTKAIRT_SNSR3POS_SC_Compu /end COMPU_METHOD
/begin COMPU_VTAB INTKAIRT_SNSR3POS_SC_Compu "" TAB_VERB 7 0 "no_sensor" 1 "IntkMnfld" 2 "MnfldIcoDs" 3 "ThrVlvUs" 4 "CmprDs" 5 "AirFltDs" 6 "Cmpr2Us" /end COMPU_VTAB
/begin COMPU_METHOD INTKAIRT_TYPAVL_SC_Compu "" TAB_VERB "%6.3" "" COMPU_TAB_REF INTKAIRT_TYPAVL_SC_Compu /end COMPU_METHOD
/begin COMPU_VTAB INTKAIRT_TYPAVL_SC_Compu "" TAB_VERB 2 0 "False" 1 "True" /end COMPU_VTAB
/begin COMPU_METHOD INTLCKCHRGPLGI_TYPAVL_SC_Compu "" TAB_VERB "%6.3" "" COMPU_TAB_REF INTLCKCHRGPLGI_TYPAVL_SC_Compu /end COMPU_METHOD
/begin COMPU_VTAB INTLCKCHRGPLGI_TYPAVL_SC_Compu "" TAB_VERB 2 0 "False" 1 "True" /end COMPU_VTAB
/begin COMPU_METHOD INTLCKCHRGPLGPOSN_TYPAVL_SC_Compu "" TAB_VERB "%6.3" "" COMPU_TAB_REF INTLCKCHRGPLGPOSN_TYPAVL_SC_Compu /end COMPU_METHOD
/begin COMPU_VTAB INTLCKCHRGPLGPOSN_TYPAVL_SC_Compu "" TAB_VERB 2 0 "False" 1 "True" /end COMPU_VTAB
/begin COMPU_METHOD INTLCKCHRGPLG_TYPAVL_SC_Compu "" TAB_VERB "%6.3" "" COMPU_TAB_REF INTLCKCHRGPLG_TYPAVL_SC_Compu /end COMPU_METHOD
/begin COMPU_VTAB INTLCKCHRGPLG_TYPAVL_SC_Compu "" TAB_VERB 2 0 "False" 1 "True" /end COMPU_VTAB
/begin COMPU_METHOD IOEXTDEV_CJ260_SC_Compu "" RAT_FUNC "%6.2" "" COEFFS 0 1 0 0 0 1 /end COMPU_METHOD
/begin COMPU_METHOD IOEXTDEV_PORTEXP_SC_Compu "" TAB_VERB "%6.3" "" COMPU_TAB_REF IOEXTDEV_PORTEXP_SC_Compu /end COMPU_METHOD
/begin COMPU_VTAB IOEXTDEV_PORTEXP_SC_Compu "" TAB_VERB 2 0 "No_Port_Expander" 1 "Port_Expander_I2C" /end COMPU_VTAB
/begin COMPU_METHOD IPDUM_SC_Compu "" TAB_VERB "%6.3" "" COMPU_TAB_REF IPDUM_SC_Compu /end COMPU_METHOD
/begin COMPU_VTAB IPDUM_SC_Compu "" TAB_VERB 2 0 "False" 1 "True" /end COMPU_VTAB
/begin COMPU_METHOD IUMPR_SY_Compu "" TAB_VERB "%6.3" "" COMPU_TAB_REF IUMPR_SY_Compu /end COMPU_METHOD
/begin COMPU_VTAB IUMPR_SY_Compu "" TAB_VERB 2 0 "NO_IUMPR_ACTIVE" 1 "IUMPR_ACTIVE" /end COMPU_VTAB
/begin COMPU_METHOD IUMPR_VERS_SY_Compu "" TAB_VERB "%6.3" "" COMPU_TAB_REF IUMPR_VERS_SY_Compu /end COMPU_METHOD
/begin COMPU_VTAB IUMPR_VERS_SY_Compu "" TAB_VERB 4 0 "IUMPR_2005" 1 "IUMPR_2007" 2 "IUMPR_2009" 3 "IUMPR_2016" /end COMPU_VTAB
/begin COMPU_METHOD IVTRTMDLTYP_SC_Compu "" TAB_VERB "%6.3" "" COMPU_TAB_REF IVTRTMDLTYP_SC_Compu /end COMPU_METHOD
/begin COMPU_VTAB IVTRTMDLTYP_SC_Compu "" TAB_VERB 4 0 "BaseMdl" 1 "ExtdCooltMdl" 2 "ExtdIvtrMdl" 3 "ExtdCooltAndIvtrMdl" /end COMPU_VTAB
/begin COMPU_METHOD J1939NM_SC_Compu "" TAB_VERB "%6.3" "" COMPU_TAB_REF J1939NM_SC_Compu /end COMPU_METHOD
/begin COMPU_VTAB J1939NM_SC_Compu "" TAB_VERB 2 0 "False" 1 "True" /end COMPU_VTAB
/begin COMPU_METHOD J1939RM_SC_Compu "" TAB_VERB "%6.3" "" COMPU_TAB_REF J1939RM_SC_Compu /end COMPU_METHOD
/begin COMPU_VTAB J1939RM_SC_Compu "" TAB_VERB 2 0 "False" 1 "True" /end COMPU_VTAB
/begin COMPU_METHOD J1939TP_SC_Compu "" TAB_VERB "%6.3" "" COMPU_TAB_REF J1939TP_SC_Compu /end COMPU_METHOD
/begin COMPU_VTAB J1939TP_SC_Compu "" TAB_VERB 2 0 "False" 1 "True" /end COMPU_VTAB
/begin COMPU_METHOD Kd "" RAT_FUNC "%7.6" "1/1" COEFFS 0 65536 0 0 0 1 /end COMPU_METHOD
/begin COMPU_METHOD Kd_1 "" RAT_FUNC "%6.4" "1/1" COEFFS 0 512 0 0 0 1 /end COMPU_METHOD
/begin COMPU_METHOD Kd_Lin_16 "" RAT_FUNC "%7.6" "1/1" COEFFS 0 32767 0 0 0 1 /end COMPU_METHOD
/begin COMPU_METHOD Kd_pRail2Q_1 "" RAT_FUNC "%7.6" "mm^3/s/hPa" COEFFS 0 40960 0 0 0 1 /end COMPU_METHOD
/begin COMPU_METHOD Kd_Prc_COMPU "" RAT_FUNC "%6.5" "%" COEFFS 0 8000 0 0 0 1 /end COMPU_METHOD
/begin COMPU_METHOD Ki "" RAT_FUNC "%6.5" "1/s" COEFFS 0 2147.483648 0 0 0 1 /end COMPU_METHOD
/begin COMPU_METHOD Ki_1 "" RAT_FUNC "%6.4" "1/s" COEFFS 0 67.108864 0 0 0 1 /end COMPU_METHOD
/begin COMPU_METHOD Length "" RAT_FUNC "%6.2" "m" COEFFS 0 1 0 0 0 1 /end COMPU_METHOD
/begin COMPU_METHOD OneToOne "" RAT_FUNC "%6.2" "-" COEFFS 0 1 0 0 0 1 /end COMPU_METHOD
/begin COMPU_METHOD Prc "" RAT_FUNC "%6.4" "%" COEFFS 0 81.92 0 0 0 1 /end COMPU_METHOD
/begin COMPU_METHOD p_q0p1_bar "" RAT_FUNC "%6.3" "bar" COEFFS 0 10 0 0 0 1 /end COMPU_METHOD
/begin COMPU_METHOD q0p1_s "" RAT_FUNC "%6.3" "s" COEFFS 0 10 0 0 0 1 /end COMPU_METHOD
/begin COMPU_METHOD q1 "" RAT_FUNC "%6.2" "-" COEFFS 0 1 0 0 0 1 /end COMPU_METHOD
/begin COMPU_METHOD q1p52588Em5_Perc_DIV_s "" RAT_FUNC "%7.6" "%/s" COEFFS 0 65536 0 0 0 1 /end COMPU_METHOD
/begin COMPU_METHOD RBPtCel_dp_1p0_3 "" RAT_FUNC "%6.2" "hPa/s" COEFFS 0 1 0 0 0 1 /end COMPU_METHOD
/begin COMPU_METHOD RBPtCel_dt_1p0_1 "" RAT_FUNC "%6.2" "K/s" COEFFS 0 1 0 0 0 1 /end COMPU_METHOD
/begin COMPU_METHOD RBPtCel_fac_0p0001_2 "" RAT_FUNC "%7.6" "-" COEFFS 0 10000 0 0 0 1 /end COMPU_METHOD
/begin COMPU_METHOD RBPtCel_fac_0p001_2 "" RAT_FUNC "%6.5" "%" COEFFS 0 1000 0 0 0 1 /end COMPU_METHOD
/begin COMPU_METHOD RBPtCel_fac_0p01_1 "" RAT_FUNC "%6.4" "-" COEFFS 0 100 0 0 0 1 /end COMPU_METHOD
/begin COMPU_METHOD RBPtCel_i_0p03125_1 "" RAT_FUNC "%6.4" "A" COEFFS 0 32 0 0 0 1 /end COMPU_METHOD
/begin COMPU_METHOD RBPtCel_nGrdt_1p0_1 "" RAT_FUNC "%6.2" "rpm/s" COEFFS 0 1 0 0 0 1 /end COMPU_METHOD
/begin COMPU_METHOD RBPtCel_n_1p0_1 "" RAT_FUNC "%6.2" "rpm" COEFFS 0 1 0 0 0 1 /end COMPU_METHOD
/begin COMPU_METHOD RBPtCel_Perc_1p0_1 "" RAT_FUNC "%6.2" "%" COEFFS 0 1 0 0 0 1 /end COMPU_METHOD
/begin COMPU_METHOD RBPtCel_pwr_10p0_1 "" RAT_FUNC "%6.1" "W" COEFFS 0 1 0 0 0 10 /end COMPU_METHOD
/begin COMPU_METHOD RBPtCel_pwr_1p0_1 "" RAT_FUNC "%6.2" "W" COEFFS 0 1 0 0 0 1 /end COMPU_METHOD
/begin COMPU_METHOD RBPtCel_pwr_25p0_1 "" RAT_FUNC "%6.1" "W" COEFFS 0 1 0 0 0 25 /end COMPU_METHOD
/begin COMPU_METHOD RBPtCel_p_1p0_1 "" RAT_FUNC "%6.2" "hPa" COEFFS 0 1 0 0 0 1 /end COMPU_METHOD
/begin COMPU_METHOD RBPtCel_q_0p125_1 "" RAT_FUNC "%6.3" "Ah" COEFFS 0 8 0 0 0 1 /end COMPU_METHOD
/begin COMPU_METHOD RBPtCel_ti_0p01_1 "" RAT_FUNC "%6.4" "s" COEFFS 0 100 0 0 0 1 /end COMPU_METHOD
/begin COMPU_METHOD RBPtCel_ti_10p0_1 "" RAT_FUNC "%6.1" "ms" COEFFS 0 1 0 0 0 10 /end COMPU_METHOD
/begin COMPU_METHOD RBPtCel_ti_1p0_2 "" RAT_FUNC "%6.2" "s" COEFFS 0 1 0 0 0 1 /end COMPU_METHOD
/begin COMPU_METHOD RBPtCel_t_0p1_1 "" RAT_FUNC "%6.3" "K" COEFFS 0 10 0 0 0 1 /end COMPU_METHOD
/begin COMPU_METHOD RBPtCel_t_1p0_3 "" RAT_FUNC "%6.2" "Deg C" COEFFS 0 1 0 0 0 1 /end COMPU_METHOD
/begin COMPU_METHOD RBPtCel_u_0p1_1 "" RAT_FUNC "%6.3" "V" COEFFS 0 10 0 0 0 1 /end COMPU_METHOD
/begin COMPU_METHOD RBPtCel_u_1p0_2 "" RAT_FUNC "%6.2" "mV" COEFFS 0 1 0 0 0 1 /end COMPU_METHOD
/begin COMPU_METHOD SigQly_COMPU_VERB "" TAB_VERB "%6.3" "" COMPU_TAB_REF SigQly_COMPU_VERB /end COMPU_METHOD
/begin COMPU_VTAB SigQly_COMPU_VERB "" TAB_VERB 16 0 "SIGQLY_NOTCALC" 1 "SIGQLY_INIT" 2 "SIGQLY_OK" 3 "SIGQLY_MODEL" 4 "SIGQLY_REPLACEMENT" 5 "SIGQLY_FROZEN" 6 "SIGQLY_INVALID" 7 "SIGQLY_RESERVED_7" 8 "SIGQLY_RESERVED_8" 9 "SIGQLY_RESERVED_9" 10 "SIGQLY_RESERVED_10" 11 "SIGQLY_RESERVED_11" 12 "SIGQLY_RESERVED_12" 13 "SIGQLY_RESERVED_13" 14 "SIGQLY_RESERVED_14" 15 "SIGQLY_RESERVED_15" /end COMPU_VTAB
/begin COMPU_METHOD Temp_Cels "" RAT_FUNC "%6.1" "deg C" COEFFS 0 10 2731.4 0 0 1 /end COMPU_METHOD
/begin COMPU_METHOD TimeDelay_s "" RAT_FUNC "%6.1" "s" COEFFS 0 0 1 0 0.00023283064365387 0 /end COMPU_METHOD
/begin COMPU_METHOD Time_ms "" RAT_FUNC "%6.1" "ms" COEFFS 0 0.1 0 0 0 1 /end COMPU_METHOD
/begin COMPU_METHOD Vel "" RAT_FUNC "%6.4" "km/h" COEFFS 0 100 0 0 0 1 /end COMPU_METHOD
/begin COMPU_METHOD Volt "" RAT_FUNC "%6.3" "mV" COEFFS 0 5 0 0 0 1 /end COMPU_METHOD
/begin COMPU_METHOD Volt_V_q0p03125_COMPU "" RAT_FUNC "%6.4" "V" COEFFS 0 32 0 0 0 1 /end COMPU_METHOD
/begin RECORD_LAYOUT Kw_Wr32 FNC_VALUES 1 FLOAT32_IEEE COLUMN_DIR DIRECT /end RECORD_LAYOUT
/begin RECORD_LAYOUT Kw_Wu8 FNC_VALUES 1 UBYTE COLUMN_DIR DIRECT /end RECORD_LAYOUT
/begin RECORD_LAYOUT RB_Curve_R32_R32_sao NO_AXIS_PTS_X 1 ULONG AXIS_PTS_X 2 FLOAT32_IEEE INDEX_INCR DIRECT FNC_VALUES 3 FLOAT32_IEEE COLUMN_DIR DIRECT STATIC_ADDRESS_OFFSETS /end RECORD_LAYOUT
/begin RECORD_LAYOUT RB_Curve_R32_S16_sao NO_AXIS_PTS_X 1 ULONG AXIS_PTS_X 2 FLOAT32_IEEE INDEX_INCR DIRECT FNC_VALUES 3 SWORD COLUMN_DIR DIRECT STATIC_ADDRESS_OFFSETS /end RECORD_LAYOUT
/begin RECORD_LAYOUT RB_Curve_S16_S32_sao NO_AXIS_PTS_X 1 SWORD AXIS_PTS_X 2 SWORD INDEX_INCR DIRECT FNC_VALUES 3 SLONG COLUMN_DIR DIRECT STATIC_ADDRESS_OFFSETS /end RECORD_LAYOUT
/begin RECORD_LAYOUT RB_Curve_S16_U8_sao NO_AXIS_PTS_X 1 SWORD AXIS_PTS_X 2 SWORD INDEX_INCR DIRECT FNC_VALUES 3 UBYTE COLUMN_DIR DIRECT STATIC_ADDRESS_OFFSETS /end RECORD_LAYOUT
/begin RECORD_LAYOUT RB_Curve_U8_S16_sao NO_AXIS_PTS_X 1 UBYTE AXIS_PTS_X 2 UBYTE INDEX_INCR DIRECT FNC_VALUES 3 SWORD COLUMN_DIR DIRECT STATIC_ADDRESS_OFFSETS /end RECORD_LAYOUT
/begin RECORD_LAYOUT RB_Map_S16S16_R32_sao NO_AXIS_PTS_X 1 SWORD NO_AXIS_PTS_Y 2 SWORD AXIS_PTS_X 3 SWORD INDEX_INCR DIRECT AXIS_PTS_Y 4 SWORD INDEX_INCR DIRECT FNC_VALUES 5 FLOAT32_IEEE COLUMN_DIR DIRECT STATIC_ADDRESS_OFFSETS /end RECORD_LAYOUT
/begin RECORD_LAYOUT RB_Map_S16S16_U8_sao NO_AXIS_PTS_X 1 SWORD NO_AXIS_PTS_Y 2 SWORD AXIS_PTS_X 3 SWORD INDEX_INCR DIRECT AXIS_PTS_Y 4 SWORD INDEX_INCR DIRECT FNC_VALUES 5 UBYTE COLUMN_DIR DIRECT STATIC_ADDRESS_OFFSETS /end RECORD_LAYOUT
/begin RECORD_LAYOUT RB_Val_Wr32 FNC_VALUES 1 FLOAT32_IEEE COLUMN_DIR DIRECT /end RECORD_LAYOUT
/begin RECORD_LAYOUT RB_Val_Ws16 FNC_VALUES 1 SWORD COLUMN_DIR DIRECT /end RECORD_LAYOUT
/begin RECORD_LAYOUT RB_Val_Ws32 FNC_VALUES 1 SLONG COLUMN_DIR DIRECT /end RECORD_LAYOUT
/begin RECORD_LAYOUT RB_Val_Ws8 FNC_VALUES 1 SBYTE COLUMN_DIR DIRECT /end RECORD_LAYOUT
/begin RECORD_LAYOUT RB_Val_Wu16 FNC_VALUES 1 UWORD COLUMN_DIR DIRECT /end RECORD_LAYOUT
/begin RECORD_LAYOUT RB_Val_Wu32 FNC_VALUES 1 ULONG COLUMN_DIR DIRECT /end RECORD_LAYOUT
/begin RECORD_LAYOUT RB_Val_Wu8 FNC_VALUES 1 UBYTE COLUMN_DIR DIRECT /end RECORD_LAYOUT
/begin RECORD_LAYOUT Val_Wr32 FNC_VALUES 1 FLOAT32_IEEE COLUMN_DIR DIRECT /end RECORD_LAYOUT
/begin RECORD_LAYOUT Val_Ws16 FNC_VALUES 1 SWORD COLUMN_DIR DIRECT /end RECORD_LAYOUT
/begin RECORD_LAYOUT Val_Ws32 FNC_VALUES 1 SLONG COLUMN_DIR DIRECT /end RECORD_LAYOUT
/begin RECORD_LAYOUT Val_Wu16 FNC_VALUES 1 UWORD COLUMN_DIR DIRECT /end RECORD_LAYOUT
/begin RECORD_LAYOUT Val_Wu32 FNC_VALUES 1 ULONG COLUMN_DIR DIRECT /end RECORD_LAYOUT
/begin RECORD_LAYOUT Val_Wu8 FNC_VALUES 1 UBYTE COLUMN_DIR DIRECT /end RECORD_LAYOUT
/end MODULE
/end PROJECT

ASAP2_VERSION 1 70
/begin PROJECT MDG1C "VC1CP091_STLA_N_D061I3"
/begin HEADER "" VERSION "VC1CP091_STLA_N_D061I3" PROJECT_NO MDG1C /end HEADER
/begin MODULE DIM ""
/begin MOD_COMMON "" BYTE_ORDER MSB_LAST ALIGNMENT_BYTE 1 ALIGNMENT_WORD 2 ALIGNMENT_LONG 4 ALIGNMENT_INT64 4 ALIGNMENT_FLOAT32_IEEE 4 ALIGNMENT_FLOAT64_IEEE 4 DATA_SIZE 32 /end MOD_COMMON
/begin CHARACTERISTIC DDRC_DurDeb.VehV_tiPhysRngHiDebOk_C "" VALUE 0x80240AC0 Val_Wu16 655350.0 DDRCTime_ms 0.00 655350.0 FORMAT "%8.1" /end CHARACTERISTIC
/begin CHARACTERISTIC DDRC_DurDeb.VehV_tiPhysRngHiDebDef_C "" VALUE 0x80240AC2 Val_Wu16 655350.0 DDRCTime_ms 0.00 655350.0 FORMAT "%8.1" /end CHARACTERISTIC
/begin CHARACTERISTIC DDRC_DurDeb.VehV_tiPhysRngLoDebOk_C "" VALUE 0x80240AC4 Val_Wu16 655350.0 DDRCTime_ms 0.00 655350.0 FORMAT "%8.1" /end CHARACTERISTIC
/begin CHARACTERISTIC DDRC_DurDeb.VehV_tiPhysRngLoDebDef_C "" VALUE 0x80240AC6 Val_Wu16 655350.0 DDRCTime_ms 0.00 655350.0 FORMAT "%8.1" /end CHARACTERISTIC
/begin CHARACTERISTIC DDRC_DurDeb.VehV_tiSigCanDebOk_C "" VALUE 0x80240AC8 Val_Wu16 655350.0 DDRCTime_ms 0.00 655350.0 FORMAT "%8.1" /end CHARACTERISTIC
/begin CHARACTERISTIC DDRC_DurDeb.VehV_tiSigCanDebDef_C "" VALUE 0x80240ACA Val_Wu16 655350.0 DDRCTime_ms 0.00 655350.0 FORMAT "%8.1" /end CHARACTERISTIC
/begin CHARACTERISTIC DDRC_DurDeb.VehV_tiSigCanSafeDebOk_C "" VALUE 0x80240ACC Val_Wu16 655350.0 DDRCTime_ms 0.00 655350.0 FORMAT "%8.1" /end CHARACTERISTIC
/begin CHARACTERISTIC DDRC_DurDeb.VehV_tiSigCanSafeDebDef_C "" VALUE 0x80240ACE Val_Wu16 655350.0 DDRCTime_ms 0.00 655350.0 FORMAT "%8.1" /end CHARACTERISTIC
/begin CHARACTERISTIC DDRC_DurDeb.VehCoorn_tiDrvrNotPrsntDebOk_C "" VALUE 0x80240DAC Val_Wu16 655350.0 DDRCTime_ms 0.00 655350.0 FORMAT "%8.1" /end CHARACTERISTIC
/begin CHARACTERISTIC DDRC_DurDeb.VehCoorn_tiDrvrNotPrsntDebDef_C "" VALUE 0x80240DAE Val_Wu16 655350.0 DDRCTime_ms 0.00 655350.0 FORMAT "%8.1" /end CHARACTERISTIC
/begin CHARACTERISTIC DDRC_RatDeb.VehV_tiPhysRngHiUDRat_C "" VALUE 0x80248AB4 Val_Wu8 3.00000000000 DDRC_Ratio 1.00000000000 4.00000000000 FORMAT "%13.11" /end CHARACTERISTIC
/begin CHARACTERISTIC DDRC_RatDeb.VehV_tiPhysRngLoUDRat_C "" VALUE 0x80248AB5 Val_Wu8 3.00000000000 DDRC_Ratio 1.00000000000 4.00000000000 FORMAT "%13.11" /end CHARACTERISTIC
/begin CHARACTERISTIC DDRC_RatDeb.VehV_tiSigCanUDRat_C "" VALUE 0x80248AB6 Val_Wu8 3.00000000000 DDRC_Ratio 1.00000000000 4.00000000000 FORMAT "%13.11" /end CHARACTERISTIC
/begin CHARACTERISTIC DDRC_RatDeb.VehV_tiSigCanSafeUDRat_C "" VALUE 0x80248AB7 Val_Wu8 3.00000000000 DDRC_Ratio 1.00000000000 4.00000000000 FORMAT "%13.11" /end CHARACTERISTIC
/begin CHARACTERISTIC DFC_CtlMsk2.DFC_VehCoornDrvrNotPrsnt_C "" VALUE 0x8024139B Val_Wu8 255.0 DFES_OneToOne 0.00 255.0 FORMAT "%5.1" /end CHARACTERISTIC
/begin CHARACTERISTIC DFC_CtlMsk2.DFC_VehVPhysRngHi_C "" VALUE 0x8024156D Val_Wu8 255.0 DFES_OneToOne 0.00 255.0 FORMAT "%5.1" /end CHARACTERISTIC
/begin CHARACTERISTIC DFC_CtlMsk2.DFC_VehVPhysRngLo_C "" VALUE 0x8024156E Val_Wu8 255.0 DFES_OneToOne 0.00 255.0 FORMAT "%5.1" /end CHARACTERISTIC
/begin CHARACTERISTIC DFC_CtlMsk2.DFC_VehVSigCan_C "" VALUE 0x8024156F Val_Wu8 255.0 DFES_OneToOne 0.00 255.0 FORMAT "%5.1" /end CHARACTERISTIC
/begin CHARACTERISTIC DFC_CtlMsk2.DFC_VehVSigCanSafe_C "" VALUE 0x80241570 Val_Wu8 255.0 DFES_OneToOne 0.00 255.0 FORMAT "%5.1" /end CHARACTERISTIC
/begin CHARACTERISTIC DFC_CtlMsk2.DFC_VehVObd_C "" VALUE 0x802416B0 Val_Wu8 255.0 DFES_OneToOne 0.00 255.0 FORMAT "%5.1" /end CHARACTERISTIC
/begin CHARACTERISTIC DFC_DisblMsk2.DFC_VehCoornDrvrNotPrsnt_C "" VALUE 0x80248C1C Val_Wu16 65535.00 DFES_OneToOne 0.00 65535.00 FORMAT "%8.2" /end CHARACTERISTIC
/begin CHARACTERISTIC DFC_DisblMsk2.DFC_VehVPhysRngHi_C "" VALUE 0x80248FC0 Val_Wu16 65535.00 DFES_OneToOne 0.00 65535.00 FORMAT "%8.2" /end CHARACTERISTIC
/begin CHARACTERISTIC DFC_DisblMsk2.DFC_VehVPhysRngLo_C "" VALUE 0x80248FC2 Val_Wu16 65535.00 DFES_OneToOne 0.00 65535.00 FORMAT "%8.2" /end CHARACTERISTIC
/begin CHARACTERISTIC DFC_DisblMsk2.DFC_VehVSigCan_C "" VALUE 0x80248FC4 Val_Wu16 65535.00 DFES_OneToOne 0.00 65535.00 FORMAT "%8.2" /end CHARACTERISTIC
/begin CHARACTERISTIC DFC_DisblMsk2.DFC_VehVSigCanSafe_C "" VALUE 0x80248FC6 Val_Wu16 65535.00 DFES_OneToOne 0.00 65535.00 FORMAT "%8.2" /end CHARACTERISTIC
/begin CHARACTERISTIC DFC_DisblMsk2.DFC_VehVObd_C "" VALUE 0x80249246 Val_Wu16 65535.00 DFES_OneToOne 0.00 65535.00 FORMAT "%8.2" /end CHARACTERISTIC
/begin CHARACTERISTIC VehCoorn_flgAllwChrgnT15Off_C "flag to enable functionality llow charging only if OFF" VALUE 0x80252618 RB_Val_Wu8 1.00000000000 B_TRUE 0.00 1.00000000000 FORMAT "%13.11" /end CHARACTERISTIC
/begin CHARACTERISTIC VehCoorn_flgDoorOpenConsdr_C "flag to enabledisable dooropen condition" VALUE 0x80252619 RB_Val_Wu8 1.00000000000 B_TRUE 0.00 1.00000000000 FORMAT "%13.11" /end CHARACTERISTIC
/begin CHARACTERISTIC VehCoorn_flgDrvModNeutChrgReq_C "Neutral charging request" VALUE 0x8025261A RB_Val_Wu8 1.00000000000 B_TRUE 0.00 1.00000000000 FORMAT "%13.11" /end CHARACTERISTIC
/begin CHARACTERISTIC VehCoorn_flgDrvModParkChrgReq_C "Calibration to enable option to request charging if drive mode is in park" VALUE 0x8025261B RB_Val_Wu8 1.00000000000 B_TRUE 0.00 1.00000000000 FORMAT "%13.11" /end CHARACTERISTIC
/begin CHARACTERISTIC VehCoorn_flgDrvModReqConsdr_C "Calibration to consider drive mode status in driving request calculation using T50" VALUE 0x8025261C RB_Val_Wu8 1.00000000000 B_TRUE 0.00 1.00000000000 FORMAT "%13.11" /end CHARACTERISTIC
/begin CHARACTERISTIC VehCoorn_flgParkBrkMask_C "Parameter to mask the park brake." VALUE 0x8025261D RB_Val_Wu8 1.00000000000 B_TRUE 0.00 1.00000000000 FORMAT "%13.11" /end CHARACTERISTIC
/begin CHARACTERISTIC VehCoorn_flgStReqSwRst_C "Calibration to enable functions after software reset in VehCoorn_StReq" VALUE 0x8025261E RB_Val_Wu8 1.00000000000 B_TRUE 0.00 1.00000000000 FORMAT "%13.11" /end CHARACTERISTIC
/begin CHARACTERISTIC VehCoorn_flgT50DrvInhbEnad_C "Calibration to enable T50 status for drive inhibit" VALUE 0x8025261F RB_Val_Wu8 1.00000000000 B_TRUE 0.00 1.00000000000 FORMAT "%13.11" /end CHARACTERISTIC
/begin CHARACTERISTIC VehCoorn_maskActSpdEm01VldySq_C "calibration mask for actual speed Em01 validity of signal quality" VALUE 0x80252620 RB_Val_Wu16 65535.00 OneToOne 0.00 65535.00 FORMAT "%8.2" /end CHARACTERISTIC
/begin CHARACTERISTIC VehCoorn_maskChrgnSpstReqSq_C "calibration mask for Charge Spst request" VALUE 0x80252622 RB_Val_Wu16 65535.00 OneToOne 0.00 65535.00 FORMAT "%8.2" /end CHARACTERISTIC
/begin CHARACTERISTIC VehCoorn_maskIgnPosnVldySq_C "Calibration mask to determine Ignition key position validity" VALUE 0x80252624 RB_Val_Wu16 65535.00 OneToOne 0.00 65535.00 FORMAT "%8.2" /end CHARACTERISTIC
/begin CHARACTERISTIC VehCoorn_maskVehVVldySq_C "Calibration mask to evaluate vehicle speed" VALUE 0x80252626 RB_Val_Wu16 65535.00 OneToOne 0.00 65535.00 FORMAT "%8.2" /end CHARACTERISTIC
/begin CHARACTERISTIC VehCoorn_nActEmThd_C "Actual threshold speed" VALUE 0x80252628 RB_Val_Ws16 65535.00 nmot_q1 -32768.00 32767.00 FORMAT "%8.2" /end CHARACTERISTIC
/begin CHARACTERISTIC VehCoorn_ratSocHvOnMinThd_C "minimum threshold for SOC" VALUE 0x8025262A RB_Val_Ws16 799.9878 Prc -400.0000 399.9878 FORMAT "%8.4" /end CHARACTERISTIC
/begin CHARACTERISTIC VehCoorn_swtBrkConsdrDrvReq_C "Switch brake depending on Drive request" VALUE 0x8025262C RB_Val_Wu8 1.00000000000 B_TRUE 0.00 1.00000000000 FORMAT "%13.11" /end CHARACTERISTIC
/begin CHARACTERISTIC VehCoorn_tiDebChrgPlgSwRst_C "Parameter to delay charge plug drive inhibition after software reset" VALUE 0x8025262E RB_Val_Ws16 655.3500 Time_s -327.6800 327.6700 FORMAT "%8.4" /end CHARACTERISTIC
/begin CHARACTERISTIC VehCoorn_tiDebChrgPlg_C "Calibration time for chargeplug" VALUE 0x80252630 RB_Val_Ws16 65535.00 Time_1s -32768.00 32767.00 FORMAT "%8.2" /end CHARACTERISTIC
/begin CHARACTERISTIC VehCoorn_tiDebDrvReq_C "Delay time for vehicle drive request" VALUE 0x80252632 RB_Val_Ws16 655.3500 Time_s -327.6800 327.6700 FORMAT "%8.4" /end CHARACTERISTIC
/begin CHARACTERISTIC VehCoorn_tiDebHvBattSoc_C "Parameter to delay Battery SOC condition" VALUE 0x80252634 RB_Val_Ws16 655.3500 Time_s -327.6800 327.6700 FORMAT "%8.4" /end CHARACTERISTIC
/begin CHARACTERISTIC VehCoorn_tiDebHvReq_C "Delay time for HV Request" VALUE 0x80252636 RB_Val_Ws16 65535.00 Time_1s -32768.00 32767.00 FORMAT "%8.2" /end CHARACTERISTIC
/begin CHARACTERISTIC VehCoorn_tiDebIgnKeySwRst_C "Parameter to delay Ignition key position condition after software reset" VALUE 0x80252638 RB_Val_Ws16 655.3500 Time_s -327.6800 327.6700 FORMAT "%8.4" /end CHARACTERISTIC
/begin CHARACTERISTIC VehCoorn_tiDebSpdSwRst_C "Parameter to delay vehicle speed condition after software reset" VALUE 0x8025263A RB_Val_Ws16 655.3500 Time_s -327.6800 327.6700 FORMAT "%8.4" /end CHARACTERISTIC
/begin CHARACTERISTIC VehCoorn_tiDebT15SwRst_C "Parameter to delay T15 after software reset" VALUE 0x8025263C RB_Val_Ws16 655.3500 Time_s -327.6800 327.6700 FORMAT "%8.4" /end CHARACTERISTIC
/begin CHARACTERISTIC VehCoorn_tiT15OnHvReqOff_C "T15On time HvReqOff" VALUE 0x8025263E RB_Val_Ws16 65535.00 Time_1s -32768.00 32767.00 FORMAT "%8.2" /end CHARACTERISTIC
/begin CHARACTERISTIC VehCoorn_tiThdNoDrvrInp_C "Time for which there is no driver input when left at standstill before hv is shutdown" VALUE 0x80252640 RB_Val_Ws32 4294967295.00 RBPtCel_ti_1p0_4 -2147483648.00 2147483647.00 FORMAT "%13.2" /end CHARACTERISTIC
/begin CHARACTERISTIC VehCoorn_vChrgMax_C "Maximum vehicle speed for charging" VALUE 0x80252644 RB_Val_Ws16 655.3500 Vel -327.6800 327.6700 FORMAT "%8.4" /end CHARACTERISTIC
/begin CHARACTERISTIC VehCoorn_vDrvInhbChrgPlgMax_C "Driving is inhibited when charge plug is plugged and vehicle speed is below this threshold" VALUE 0x80252646 RB_Val_Ws16 655.3500 Vel -327.6800 327.6700 FORMAT "%8.4" /end CHARACTERISTIC
/begin CHARACTERISTIC VehCoorn_vDrvInhbMaxDelta_C "Hysteresis delta value for maximum speed threshold for inhibiting drive mode" VALUE 0x80252648 RB_Val_Ws16 655.3500 Vel -327.6800 327.6700 FORMAT "%8.4" /end CHARACTERISTIC
/begin CHARACTERISTIC VehCoorn_vDrvInhbMax_C "Hysteresis value for maximum speed threshold for inhibiting drive mode" VALUE 0x8025264A RB_Val_Ws16 655.3500 Vel -327.6800 327.6700 FORMAT "%8.4" /end CHARACTERISTIC
/begin CHARACTERISTIC VehCoorn_vDrvReqMinDelta_C "Hysteresis delta value for minimum speed threshold to enable drive mode" VALUE 0x8025264C RB_Val_Ws16 655.3500 Vel -327.6800 327.6700 FORMAT "%8.4" /end CHARACTERISTIC
/begin CHARACTERISTIC VehCoorn_vDrvReqMin_C "Hysteresis value for minimum speed threshold to enable drive mode" VALUE 0x8025264E RB_Val_Ws16 655.3500 Vel -327.6800 327.6700 FORMAT "%8.4" /end CHARACTERISTIC
/begin CHARACTERISTIC VehCoorn_vHvMinThd_C "Minimum threshold velocity" VALUE 0x80252650 RB_Val_Ws16 655.3500 Vel -327.6800 327.6700 FORMAT "%8.4" /end CHARACTERISTIC
/begin CHARACTERISTIC VehCoorn_vHvReqMinThd_C "Vehicle speed stand still threshold for HV request calculation" VALUE 0x80252652 RB_Val_Ws16 655.3500 Vel -327.6800 327.6700 FORMAT "%8.4" /end CHARACTERISTIC
/begin CHARACTERISTIC VehCoorn_vStandStillSwRst_C "Calibration parameter to check vehicle in stanstill before software reset" VALUE 0x80252654 RB_Val_Ws16 655.3500 Vel -327.6800 327.6700 FORMAT "%8.4" /end CHARACTERISTIC
/begin CHARACTERISTIC VehDrvEv_facDsbcCtrlrGain01_CUR "Curve for gain factor for disturbence control (e-machine 1)" CURVE 0x8025265C RB_Curve_S16_S16 655.3500 TransR -327.6800 327.6700 FORMAT "%8.4"
 /begin AXIS_DESCR STD_AXIS VehDrvEv_nAct01 nmot_q1 8 0.00 32767.00 FORMAT "%8.2" EXTENDED_LIMITS -32768.00 32767.00 DEPOSIT ABSOLUTE /end AXIS_DESCR
/end CHARACTERISTIC
/begin CHARACTERISTIC VehDrvEv_flgDsbcCtrlrOff01_C "parameter to deactivate the desturbence control (e-Machine 1)" VALUE 0x8025267E RB_Val_Wboolean 1.00000000000 B_TRUE 0.00 1.00000000000 FORMAT "%13.11" /end CHARACTERISTIC
/begin CHARACTERISTIC VehDrvEv_flgStrtUpCtrlEna_C "Influence of startup governor for shut-off of the disturbance controller activated" VALUE 0x8025267F RB_Val_Wboolean 1.00000000000 B_TRUE 0.00 1.00000000000 FORMAT "%13.11" /end CHARACTERISTIC
/begin CHARACTERISTIC VehDrvEv_stCfgASDrf_C "configuration codeword for the reference filter" VALUE 0x80252680 RB_Val_Wu8 255.0 dez 0.00 255.0 FORMAT "%5.1" /end CHARACTERISTIC
/begin CHARACTERISTIC VehDrvEv_tiRefFilCrp_C "Filter time constant of the second order lowpass reference Filter in case of active driver assistance function" VALUE 0x80252658 RB_Val_Wu16 655.34999985 zk10msxs_uw_b655p36 0.01000015 655.36000000 FORMAT "%12.8" EXTENDED_LIMITS 0.010000152590 655.36000000 /end CHARACTERISTIC
/begin CHARACTERISTIC VehDrvEv_tiRefFil_C "Time constant during normal operation mode (startup governor deactivated)" VALUE 0x8025265A RB_Val_Wu16 655.34999985 zk10msxs_uw_b655p36 0.01000015 655.36000000 FORMAT "%12.8" EXTENDED_LIMITS 0.010000152590 655.36000000 /end CHARACTERISTIC
/begin CHARACTERISTIC VehDrvEv_tqDsbcCtrlrMax01_C "maximum torque for the desturbence control (e-machine 1)" VALUE 0x80252682 RB_Val_Ws16 6553.500 Trq -3276.800 3276.700 FORMAT "%8.3" /end CHARACTERISTIC
/begin CHARACTERISTIC VehDrvEv_tqGrdtMaxZrCrssCrp_M "Torque Gradient for zero crossing in case of driver assistance active" MAP 0x80252684 RB_Map_S16S16_S16 104856.0 TrqPrp -52428.80 52427.20 FORMAT "%8.2"
 /begin AXIS_DESCR STD_AXIS VehDrvEv_tqNormZrCrssFild TrqPrp 10 -52428.80 52427.20 FORMAT "%8.2" DEPOSIT ABSOLUTE /end AXIS_DESCR
 /begin AXIS_DESCR STD_AXIS VehV_v Vel 8 -327.6800 327.6700 FORMAT "%8.4" DEPOSIT ABSOLUTE /end AXIS_DESCR
/end CHARACTERISTIC
/begin CHARACTERISTIC VehDrvEv_tqGrdtMaxZrCrssEco_M "map for maximum torque gradient for zero cross filter (normalized, Eco mode)" MAP 0x8025274C RB_Map_S16S16_S16 104856.0 TrqPrp -52428.80 52427.20 FORMAT "%8.2"
 /begin AXIS_DESCR STD_AXIS VehDrvEv_tqNormZrCrssFild TrqPrp 10 -52428.80 52427.20 FORMAT "%8.2" DEPOSIT ABSOLUTE /end AXIS_DESCR
 /begin AXIS_DESCR STD_AXIS VehV_v Vel 8 -327.6800 327.6700 FORMAT "%8.4" DEPOSIT ABSOLUTE /end AXIS_DESCR
/end CHARACTERISTIC
/begin CHARACTERISTIC VehDrvEv_tqGrdtMaxZrCrssNegCrp_M "Torque negative Gradient for zero crossing in case of driver assistance active" MAP 0x80252814 RB_Map_S16S16_S16 104856.0 TrqPrp -52428.80 52427.20 FORMAT "%8.2"
 /begin AXIS_DESCR STD_AXIS VehDrvEv_tqNormZrCrssFild TrqPrp 10 -52428.80 52427.20 FORMAT "%8.2" DEPOSIT ABSOLUTE /end AXIS_DESCR
 /begin AXIS_DESCR STD_AXIS VehV_v Vel 8 -327.6800 327.6700 FORMAT "%8.4" DEPOSIT ABSOLUTE /end AXIS_DESCR
/end CHARACTERISTIC
/begin CHARACTERISTIC VehDrvEv_tqGrdtMaxZrCrssNegEco_M "map for maximum torque gradient for zero cross filter (negative slope, normalized, Eco Mode)" MAP 0x802528DC RB_Map_S16S16_S16 104856.0 TrqPrp -52428.80 52427.20 FORMAT "%8.2"
 /begin AXIS_DESCR STD_AXIS VehDrvEv_tqNormZrCrssFild TrqPrp 10 -52428.80 52427.20 FORMAT "%8.2" DEPOSIT ABSOLUTE /end AXIS_DESCR
 /begin AXIS_DESCR STD_AXIS VehV_v Vel 8 -327.6800 327.6700 FORMAT "%8.4" DEPOSIT ABSOLUTE /end AXIS_DESCR
/end CHARACTERISTIC
/begin CHARACTERISTIC VehDrvEv_tqGrdtMaxZrCrssNegSpt_M "map for maximum torque gradient for zero cross filter (negative slope, normalized, sport mode)" MAP 0x802529A4 RB_Map_S16S16_S16 104856.0 TrqPrp -52428.80 52427.20 FORMAT "%8.2"
 /begin AXIS_DESCR STD_AXIS VehDrvEv_tqNormZrCrssFild TrqPrp 10 -52428.80 52427.20 FORMAT "%8.2" DEPOSIT ABSOLUTE /end AXIS_DESCR
 /begin AXIS_DESCR STD_AXIS VehV_v Vel 8 -327.6800 327.6700 FORMAT "%8.4" DEPOSIT ABSOLUTE /end AXIS_DESCR
/end CHARACTERISTIC
/begin CHARACTERISTIC VehDrvEv_tqGrdtMaxZrCrssNeg_M "map for maximum negative ramp gradient for zero-transition" MAP 0x80252A6C RB_Map_S16S16_S16 104856.0 TrqPrp -52428.80 52427.20 FORMAT "%8.2"
 /begin AXIS_DESCR STD_AXIS VehDrvEv_tqNormZrCrssFild TrqPrp 10 -52428.80 52427.20 FORMAT "%8.2" DEPOSIT ABSOLUTE /end AXIS_DESCR
 /begin AXIS_DESCR STD_AXIS VehV_v Vel 8 -327.6800 327.6700 FORMAT "%8.4" DEPOSIT ABSOLUTE /end AXIS_DESCR
/end CHARACTERISTIC
/begin CHARACTERISTIC VehDrvEv_tqGrdtMaxZrCrssSpt_M "map for maximum torque gradient for zero cross filter (normalized, sport mode)" MAP 0x80252B34 RB_Map_S16S16_S16 104856.0 TrqPrp -52428.80 52427.20 FORMAT "%8.2"
 /begin AXIS_DESCR STD_AXIS VehDrvEv_tqNormZrCrssFild TrqPrp 10 -52428.80 52427.20 FORMAT "%8.2" DEPOSIT ABSOLUTE /end AXIS_DESCR
 /begin AXIS_DESCR STD_AXIS VehV_v Vel 8 -327.6800 327.6700 FORMAT "%8.4" DEPOSIT ABSOLUTE /end AXIS_DESCR
/end CHARACTERISTIC
/begin CHARACTERISTIC VehDrvEv_tqGrdtMaxZrCrss_M "map for maximum positive ramp gradient for zero-transition" MAP 0x80252BFC RB_Map_S16S16_S16 104856.0 TrqPrp -52428.80 52427.20 FORMAT "%8.2"
 /begin AXIS_DESCR STD_AXIS VehDrvEv_tqNormZrCrssFild TrqPrp 10 -52428.80 52427.20 FORMAT "%8.2" DEPOSIT ABSOLUTE /end AXIS_DESCR
 /begin AXIS_DESCR STD_AXIS VehV_v Vel 8 -327.6800 327.6700 FORMAT "%8.4" DEPOSIT ABSOLUTE /end AXIS_DESCR
/end CHARACTERISTIC
/begin CHARACTERISTIC VehDrvEv_tqGrdtZrCrssDeltaNegEco_T "curve for torque gradient for zero cross filter (negative slope, eco mode)" CURVE 0x80252CC4 RB_Curve_S16_S16 104856.0 TrqPrp -52428.80 52427.20 FORMAT "%8.2"
 /begin AXIS_DESCR STD_AXIS VehDrvEv_tqDeltaZrCrss TrqPrp 6 -52428.80 52427.20 FORMAT "%8.2" DEPOSIT ABSOLUTE /end AXIS_DESCR
/end CHARACTERISTIC
/begin CHARACTERISTIC VehDrvEv_tqGrdtZrCrssDeltaNegSpt_T "curve for torque gradient for zero cross filter (negative slope, sport mode)" CURVE 0x80252CDE RB_Curve_S16_S16 104856.0 TrqPrp -52428.80 52427.20 FORMAT "%8.2"
 /begin AXIS_DESCR STD_AXIS VehDrvEv_tqDeltaZrCrss TrqPrp 6 -52428.80 52427.20 FORMAT "%8.2" DEPOSIT ABSOLUTE /end AXIS_DESCR
/end CHARACTERISTIC
/begin CHARACTERISTIC VehDrvEv_tqGrdtZrCrssDeltaNeg_T "curve for torque gradient for zero cross filter (negative slope)" CURVE 0x80252CF8 RB_Curve_S16_S16 104856.0 TrqPrp -52428.80 52427.20 FORMAT "%8.2"
 /begin AXIS_DESCR STD_AXIS VehDrvEv_tqDeltaZrCrss TrqPrp 6 -52428.80 52427.20 FORMAT "%8.2" DEPOSIT ABSOLUTE /end AXIS_DESCR
/end CHARACTERISTIC
/begin CHARACTERISTIC VehDrvEv_tqGrdtZrCrssEco_T "curve for torque gradient for zero cross filter (Eco mode)" CURVE 0x80252D12 RB_Curve_S16_S16 104856.0 TrqPrp -52428.80 52427.20 FORMAT "%8.2"
 /begin AXIS_DESCR STD_AXIS VehDrvEv_tqDeltaZrCrss TrqPrp 6 -52428.80 52427.20 FORMAT "%8.2" DEPOSIT ABSOLUTE /end AXIS_DESCR
/end CHARACTERISTIC
/begin CHARACTERISTIC VehDrvEv_tqGrdtZrCrssLimEco_C "limit of the torque gradient for zero cross filter (eco mode)" VALUE 0x80252D2C RB_Val_Ws32 6553599.99847 RmpTrqPrpHigh -3276800.00000 3276799.99847 FORMAT "%13.5" /end CHARACTERISTIC
/begin CHARACTERISTIC VehDrvEv_tqGrdtZrCrssLimNegEco_C "limit of the torque gradient for zero cross filter (negative slope, Eco mode)" VALUE 0x80252D30 RB_Val_Ws32 6553599.99847 RmpTrqPrpHigh -3276800.00000 3276799.99847 FORMAT "%13.5" /end CHARACTERISTIC
/begin CHARACTERISTIC VehDrvEv_tqGrdtZrCrssLimNegSpt_C "limit of the torque gradient for zero cross filter (negative slope, sport mode)" VALUE 0x80252D34 RB_Val_Ws32 6553599.99847 RmpTrqPrpHigh -3276800.00000 3276799.99847 FORMAT "%13.5" /end CHARACTERISTIC
/begin CHARACTERISTIC VehDrvEv_tqGrdtZrCrssLimNeg_C "limit of the torque gradient for zero cross filter (negative slope)" VALUE 0x80252D38 RB_Val_Ws32 6553599.99847 RmpTrqPrpHigh -3276800.00000 3276799.99847 FORMAT "%13.5" /end CHARACTERISTIC
/begin CHARACTERISTIC VehDrvEv_tqGrdtZrCrssLimSpt_C "limit of the torque gradient for zero cross filter (sport mode)" VALUE 0x80252D3C RB_Val_Ws32 6553599.99847 RmpTrqPrpHigh -3276800.00000 3276799.99847 FORMAT "%13.5" /end CHARACTERISTIC
/begin CHARACTERISTIC VehDrvEv_tqGrdtZrCrssLim_C "limit of the torque gradient for zero cross filter" VALUE 0x80252D40 RB_Val_Ws32 6553599.99847 RmpTrqPrpHigh -3276800.00000 3276799.99847 FORMAT "%13.5" /end CHARACTERISTIC
/begin CHARACTERISTIC VehDrvEv_tqGrdtZrCrssSpt_T "curve for torque gradient for zero cross filter (Sport mode)" CURVE 0x80252D44 RB_Curve_S16_S16 104856.0 TrqPrp -52428.80 52427.20 FORMAT "%8.2"
 /begin AXIS_DESCR STD_AXIS VehDrvEv_tqDeltaZrCrss TrqPrp 6 -52428.80 52427.20 FORMAT "%8.2" DEPOSIT ABSOLUTE /end AXIS_DESCR
/end CHARACTERISTIC
/begin CHARACTERISTIC VehDrvEv_tqGrdtZrCrss_T "curve for torque gradient for zero cross filter" CURVE 0x80252D5E RB_Curve_S16_S16 104856.0 TrqPrp -52428.80 52427.20 FORMAT "%8.2"
 /begin AXIS_DESCR STD_AXIS VehDrvEv_tqDeltaZrCrss TrqPrp 6 -52428.80 52427.20 FORMAT "%8.2" DEPOSIT ABSOLUTE /end AXIS_DESCR
/end CHARACTERISTIC
/begin CHARACTERISTIC VehDrvEv_tqThresDsbcCtrlrOn01_C "Torque threshold for the desturbence control (e-machine 1)" VALUE 0x80252D78 RB_Val_Ws16 6553.500 Trq -3276.800 3276.700 FORMAT "%8.3" /end CHARACTERISTIC
/begin CHARACTERISTIC VehMot_mInrt_C "total vehicle inertia" VALUE 0x80252D7C RB_Val_Ws16 65535.00 Mass -32768.00 32767.00 FORMAT "%8.2" /end CHARACTERISTIC
/begin CHARACTERISTIC VehMot_nDifRecupTqLimPrimAxle_T "Calibration curve for difference (range) between lower and upper boundary of recuperation torque limitation window on primary axle" CURVE 0x80252D9C RB_Curve_S16_S16 32766.00 nmot_q1 1.00 32767.00 FORMAT "%8.2" EXTENDED_LIMITS -32768.00 32767.00
 /begin AXIS_DESCR STD_AXIS VehMot_dNAct01 EngNGrd 2 -16384.00 16383.50 FORMAT "%8.2" DEPOSIT ABSOLUTE /end AXIS_DESCR
/end CHARACTERISTIC
/begin CHARACTERISTIC VehMot_nLowrBndyRecupTqLimPrimAxle_T "Calibration curve for lower boundary of recuperation torque limitation window on primary axle" CURVE 0x80252DA6 RB_Curve_S16_S16 65535.00 nmot_q1 -32768.00 32767.00 FORMAT "%8.2"
 /begin AXIS_DESCR STD_AXIS VehMot_dNAct01 EngNGrd 2 -16384.00 16383.50 FORMAT "%8.2" DEPOSIT ABSOLUTE /end AXIS_DESCR
/end CHARACTERISTIC
/begin CHARACTERISTIC VehMot_tidNAct01Fil_C "Filter time constant of ElM01 engine speed gradient for recuperation torque calculation of primary axle" VALUE 0x80252DB0 RB_Val_Ws32 4294.9672940000000 TimeDelay_s 0.0000020000000 4294.9672959999998 FORMAT "%19.14" EXTENDED_LIMITS 0.000002000000001 4294.9672959999998 /end CHARACTERISTIC
/begin CHARACTERISTIC VehMot_tiNAct01RecupFilDwn_C "Asynchronous filter time constant for recuperation torque limitation in case that ElM01-engine speed is falling" VALUE 0x80252DB4 RB_Val_Ws32 4294.9672940000000 TimeDelay_s 0.0000020000000 4294.9672959999998 FORMAT "%19.14" EXTENDED_LIMITS 0.000002000000001 4294.9672959999998 /end CHARACTERISTIC
/begin CHARACTERISTIC VehMot_tiNAct01RecupFilUp_C "Asynchronous filter time constant for recuperation torque limitation in case that ElM01-engine speed is rising" VALUE 0x80252DB8 RB_Val_Ws32 4294.9672940000000 TimeDelay_s 0.0000020000000 4294.9672959999998 FORMAT "%19.14" EXTENDED_LIMITS 0.000002000000001 4294.9672959999998 /end CHARACTERISTIC
/begin CHARACTERISTIC VehMot_tiTrqDragMin_C "Minimum time constant for filtering drag esimation" VALUE 0x80252D7E RB_Val_Ws16 655.3500 Time_s -327.6800 327.6700 FORMAT "%8.4" /end CHARACTERISTIC
/begin CHARACTERISTIC VehMot_tiTrqDragPosSlop_C "Positive slope for filter time constant." VALUE 0x80252D80 RB_Val_Wu8 255.0 OneToOne 0.00 255.0 FORMAT "%5.1" /end CHARACTERISTIC
/begin CHARACTERISTIC VehMot_tiTrqDragVx_CUR "Characteristic line of time constant dependend from velocity" CURVE 0x80252D82 RB_Curve_S16_S16 655.3500 Time_s -327.6800 327.6700 FORMAT "%8.4"
 /begin AXIS_DESCR STD_AXIS VehV_v Vel 3 -327.6800 327.6700 FORMAT "%8.4" DEPOSIT ABSOLUTE /end AXIS_DESCR
/end CHARACTERISTIC
/begin CHARACTERISTIC VehMot_tiTrqPrpPT1_C "Time constant for torque filter" VALUE 0x80252D90 RB_Val_Ws32 4294.9672940000000 TimeDelay_s 0.0000020000000 4294.9672959999998 FORMAT "%19.14" EXTENDED_LIMITS 0.000002000000001 4294.9672959999998 /end CHARACTERISTIC
/begin CHARACTERISTIC VehMot_tqMinPtdPrimAxle_C "Minimum permitted amount of recuperation torque on primary axle" VALUE 0x80252DBC RB_Val_Ws32 429496729.500 TrqPrpHigh -214748364.800 214748364.700 FORMAT "%13.3" /end CHARACTERISTIC
/begin CHARACTERISTIC VehMot_trqDragMax_C "Maximum drag torque" VALUE 0x80252D94 RB_Val_Ws32 429496729.500 TrqPrpHigh -214748364.800 214748364.700 FORMAT "%13.3" /end CHARACTERISTIC
/begin CHARACTERISTIC VehMot_vMinDragEst_C "Minimum velocity for drag esimation" VALUE 0x80252D98 RB_Val_Ws16 655.3500 Vel -327.6800 327.6700 FORMAT "%8.4" /end CHARACTERISTIC
/begin CHARACTERISTIC VehV_aDft_C "Default value of the vehicle acceleration in case of a final defect" VALUE 0x80252DD0 RB_Val_Ws16 65.53500 Acc -32.76800 32.76700 FORMAT "%8.5" /end CHARACTERISTIC
/begin CHARACTERISTIC VehV_flgEmSpdBasdSignEvlnActv_C "Flag for signed based electric machine speed evaluation active" VALUE 0x80252DE4 RB_Val_Wboolean 1.00000000000 B_TRUE 0.00 1.00000000000 FORMAT "%13.11" /end CHARACTERISTIC
/begin CHARACTERISTIC VehV_flgFwdMntdMot_C "Flag for forward mounted motor" VALUE 0x80252DE5 RB_Val_Wboolean 1.00000000000 B_TRUE 0.00 1.00000000000 FORMAT "%13.11" /end CHARACTERISTIC
/begin CHARACTERISTIC VehV_flgSwtVSensAbsltEna_C "Calibration switch to select between actual and absolute value of vehicle speed." VALUE 0x80252DD2 RB_Val_Wu8 1.00000000000 B_TRUE 0.00 1.00000000000 FORMAT "%13.11" /end CHARACTERISTIC
/begin CHARACTERISTIC VehV_maskEmNActPhy01Sq_C "Calibration mask to detect the signal quality of actual speed of e-machine-01" VALUE 0x80252DC0 RB_Val_Wu16 65535.00 OneToOne 0.00 65535.00 FORMAT "%8.2" /end CHARACTERISTIC
/begin CHARACTERISTIC VehV_maskFrzValSq_C "Calibratable mask for detecting vehicle speed sensor preliminary defect" VALUE 0x80252DC4 RB_Val_Wu16 65535.00 OneToOne 0.00 65535.00 FORMAT "%8.2" /end CHARACTERISTIC
/begin CHARACTERISTIC VehV_maskObdFrzValSq_C "Calibratable mask for detecting vehicle speed preliminary defect" VALUE 0x80252DE6 RB_Val_Wu16 65535.00 OneToOne 0.00 65535.00 FORMAT "%8.2" /end CHARACTERISTIC
/begin CHARACTERISTIC VehV_maskObdReplcmtValSq_C "Calibratable mask for detecting vehicle speed final defect" VALUE 0x80252DE8 RB_Val_Wu16 65535.00 OneToOne 0.00 65535.00 FORMAT "%8.2" /end CHARACTERISTIC
/begin CHARACTERISTIC VehV_maskPhyRngSq_C "Calibratable mask for detecting vehicle speed defect for checking vehicle speed physical range" VALUE 0x80252DEA RB_Val_Wu16 65535.00 OneToOne 0.00 65535.00 FORMAT "%8.2" /end CHARACTERISTIC
/begin CHARACTERISTIC VehV_maskReplcmtValSq_C "Calibratable mask for detecting vehicle speed sensor final defect" VALUE 0x80252DC6 RB_Val_Wu16 65535.00 OneToOne 0.00 65535.00 FORMAT "%8.2" /end CHARACTERISTIC
/begin CHARACTERISTIC VehV_maskVehAFrzSq_C "Calibratable mask for detecting vehicle acceleration preliminary defect" VALUE 0x80252DD4 RB_Val_Wu16 65535.00 OneToOne 0.00 65535.00 FORMAT "%8.2" /end CHARACTERISTIC
/begin CHARACTERISTIC VehV_maskVehAReplcmtSq_C "Calibratable mask for detecting final defect. The respective bit position should be calibrated to 1 inorder to detect the final defect." VALUE 0x80252DD6 RB_Val_Wu16 65535.00 OneToOne 0.00 65535.00 FORMAT "%8.2" /end CHARACTERISTIC
/begin CHARACTERISTIC VehV_swtEmSeln_C "Calibration to select the e-machines for calculating vehicle speed" VALUE 0x80252DC2 RB_Val_Wu8 255.0 q1 0.00 255.0 FORMAT "%5.1" /end CHARACTERISTIC
/begin CHARACTERISTIC VehV_swtSigSafe_C "Switch to select vehicle speed from safe input source" VALUE 0x80252DEC RB_Val_Wu8 255.0 OneToOne 0.00 255.0 FORMAT "%5.1" /end CHARACTERISTIC
/begin CHARACTERISTIC VehV_swtSigStd_C "Switch to select vehicle speed from standard input source" VALUE 0x80252DED RB_Val_Wu8 255.0 OneToOne 0.00 255.0 FORMAT "%5.1" /end CHARACTERISTIC
/begin CHARACTERISTIC VehV_tiAPT1_C "Time constant for low pass filtering of the vehicle acceleration" VALUE 0x80252DD8 RB_Val_Ws32 4294.9672940000000 TimeDelay_s 0.0000020000000 4294.9672959999998 FORMAT "%19.14" EXTENDED_LIMITS 0.000002000000001 4294.9672959999998 /end CHARACTERISTIC
/begin CHARACTERISTIC VehV_tiVAPT1_C "Time constant for low pass filtering of the vehicle speed for acceleration calculation" VALUE 0x80252DDC RB_Val_Ws32 4294.9672940000000 TimeDelay_s 0.0000020000000 4294.9672959999998 FORMAT "%19.14" EXTENDED_LIMITS 0.000002000000001 4294.9672959999998 /end CHARACTERISTIC
/begin CHARACTERISTIC VehV_tiVPT1_C "Time constant for low pass filtering of the vehicle speed" VALUE 0x80252DC8 RB_Val_Ws32 4294.9672940000000 TimeDelay_s 0.0000020000000 4294.9672959999998 FORMAT "%19.14" EXTENDED_LIMITS 0.000002000000001 4294.9672959999998 /end CHARACTERISTIC
/begin CHARACTERISTIC VehV_vAMinThd_C "Minimum vehicle speed threshold to start derivation of the vehicle speed" VALUE 0x80252DE0 RB_Val_Ws16 655.3500 Vel -327.6800 327.6700 FORMAT "%8.4" /end CHARACTERISTIC
/begin CHARACTERISTIC VehV_vDflOBD_C "Default value for OBD relevent vehicle speed in case of permanent error" VALUE 0x80252DEE RB_Val_Ws16 655.3500 Vel -327.6800 327.6700 FORMAT "%8.4" /end CHARACTERISTIC
/begin CHARACTERISTIC VehV_vDfl_C "Default vehicle speed value in case the sensed vehicle speed crosses Min or Max limits" VALUE 0x80252DCC RB_Val_Ws16 655.3500 Vel -327.6800 327.6700 FORMAT "%8.4" /end CHARACTERISTIC
/begin CHARACTERISTIC VehV_vMin_C "min. sensed vehicle speed for calculation of outputted vehicle speed" VALUE 0x80252DCE RB_Val_Ws16 655.3500 Vel -327.6800 327.6700 FORMAT "%8.4" /end CHARACTERISTIC
/begin CHARACTERISTIC VehV_vPhysRngMax_C "Maximum value of vehicle speed above which physical range max error is reported" VALUE 0x80252DF0 RB_Val_Ws16 655.3500 Vel -327.6800 327.6700 FORMAT "%8.4" /end CHARACTERISTIC
/begin CHARACTERISTIC VehV_vPhysRngMin_C "Minimum value of vehicle speed below which physical range min error is reported" VALUE 0x80252DF2 RB_Val_Ws16 655.3500 Vel -327.6800 327.6700 FORMAT "%8.4" /end CHARACTERISTIC
/begin CHARACTERISTIC VMSIEv_dtqAbsIntvRmpNeg_C "negative torque gradient for recurperation inhibit ramp EM-01 due to ABS intervention" VALUE 0x80252130 RB_Val_Ws32 6553599.99847 RmpTrq -3276800.00000 3276799.99847 FORMAT "%13.5" /end CHARACTERISTIC
/begin CHARACTERISTIC VMSIEv_dtqAbsIntvRmpPos_C "positive torque gradient for recurperation inhibit ramp EM-01 due to ABS intervention" VALUE 0x80252134 RB_Val_Ws32 6553599.99847 RmpTrq -3276800.00000 3276799.99847 FORMAT "%13.5" /end CHARACTERISTIC
/begin CHARACTERISTIC VMSIEv_dtqDCSDesAbortRamp01_C "torque gradient for abort ramp DCS (e-machine 1)" VALUE 0x80252138 RB_Val_Ws32 6553599.99847 RmpTrqPrpHigh -3276800.00000 3276799.99847 FORMAT "%13.5" /end CHARACTERISTIC
/begin CHARACTERISTIC VMSIEv_dtqTCSDesAbortRamp01_C "torque gradient for abort ramp TCS (e-machine 1)" VALUE 0x8025213C RB_Val_Ws32 6553599.99847 RmpTrqPrpHigh -3276800.00000 3276799.99847 FORMAT "%13.5" /end CHARACTERISTIC
/begin CHARACTERISTIC WtrPmp1_mfCoolgReqMin_C "Parameter for the minimum coolant flow while the coordinator requests passive cooling" VALUE 0x80252DF4 RB_Val_Ws16 7.999878 q1p220703Em4_kg_DIV_s -4.000000 3.999878 FORMAT "%8.6" /end CHARACTERISTIC
/begin CHARACTERISTIC WtrPmp1_mfCooltFlowReq_T "Calibration curve to calculate MT coolant flow based on component request" CURVE 0x80252DF6 RB_Curve_S8_S16_sao 7.999878 q1p220703Em4_kg_DIV_s -4.000000 3.999878 FORMAT "%8.6"
 /begin AXIS_DESCR STD_AXIS ThermCfg_ratMTPmpReq RBPtCel_Perc_1p0_1 5 -128.0 127.0 FORMAT "%5.1" DEPOSIT ABSOLUTE /end AXIS_DESCR
/end CHARACTERISTIC
/begin CHARACTERISTIC WtrPmp1_mfCooltMTSp_T "Curve to calculate the coolant flow rate depending on the delta between setpoint and coolant temperature" CURVE 0x80252E06 RB_Curve_S16_S16 7.999878 q1p220703Em4_kg_DIV_s -4.000000 3.999878 FORMAT "%8.6"
 /begin AXIS_DESCR STD_AXIS ThermLvl_dTMTCooltSp RBPtCel_t_0p1_1 5 -3276.800 3276.700 FORMAT "%8.3" DEPOSIT ABSOLUTE /end AXIS_DESCR
/end CHARACTERISTIC
/begin CHARACTERISTIC WtrPmp1_mfDesMax_C "maximal desired mass flow of water pump" VALUE 0x80252E1C RB_Val_Ws16 7.999878 q1p220703Em4_kg_DIV_s -4.000000 3.999878 FORMAT "%8.6" /end CHARACTERISTIC
/begin CHARACTERISTIC WtrPmp1_pLossMedT_M "Map to calculate the pressure loss based on the MT coolant mass flow and MT circuit coolant temperature." MAP 0x80252E1E RB_Map_S16S16_S16 6553.500 RBPtCel_p_0p1_4 -3276.800 3276.700 FORMAT "%8.3"
 /begin AXIS_DESCR STD_AXIS ThermLvl_tMedTCircRadDs RBPtCel_t_0p1om273p14_1 5 -3549.940 3003.560 FORMAT "%8.3" DEPOSIT ABSOLUTE /end AXIS_DESCR
 /begin AXIS_DESCR STD_AXIS WtrPmp1_mfDesMedT q1p220703Em4_kg_DIV_s 5 -4.000000 3.999878 FORMAT "%8.6" DEPOSIT ABSOLUTE /end AXIS_DESCR
/end CHARACTERISTIC
/begin MEASUREMENT DDRC_St.DFC_VehCoornDrvrNotPrsnt "" ULONG DFC_OneToOne 1 100 0.00 536870911.000 BIT_MASK 0x1fffffff FORMAT "%13.3" ECU_ADDRESS 0x6001C468 /end MEASUREMENT
/begin MEASUREMENT DDRC_St.DFC_VehVPhysRngHi "" UWORD DFC_OneToOne 1 100 0.00 8191.000 BIT_MASK 0x1fff FORMAT "%8.3" ECU_ADDRESS 0x60021FF0 /end MEASUREMENT
/begin MEASUREMENT DDRC_St.DFC_VehVPhysRngLo "" UWORD DFC_OneToOne 1 100 0.00 8191.000 BIT_MASK 0x1fff FORMAT "%8.3" ECU_ADDRESS 0x60021FF2 /end MEASUREMENT
/begin MEASUREMENT DDRC_St.DFC_VehVSigCan "" UWORD DFC_OneToOne 1 100 0.00 8191.000 BIT_MASK 0x1fff FORMAT "%8.3" ECU_ADDRESS 0x60021FF4 /end MEASUREMENT
/begin MEASUREMENT DDRC_St.DFC_VehVSigCanSafe "" UWORD DFC_OneToOne 1 100 0.00 8191.000 BIT_MASK 0x1fff FORMAT "%8.3" ECU_ADDRESS 0x60021FF6 /end MEASUREMENT
/begin MEASUREMENT DFC_st.DFC_VehCoornDrvrNotPrsnt "" UBYTE DFC_OneToOne 1 100 0.00 255.0 FORMAT "%5.1" ECU_ADDRESS 0x60034A7D /end MEASUREMENT
/begin MEASUREMENT DFC_st.DFC_VehVPhysRngHi "" UBYTE DFC_OneToOne 1 100 0.00 255.0 FORMAT "%5.1" ECU_ADDRESS 0x60034C4F /end MEASUREMENT
/begin MEASUREMENT DFC_st.DFC_VehVPhysRngLo "" UBYTE DFC_OneToOne 1 100 0.00 255.0 FORMAT "%5.1" ECU_ADDRESS 0x60034C50 /end MEASUREMENT
/begin MEASUREMENT DFC_st.DFC_VehVSigCan "" UBYTE DFC_OneToOne 1 100 0.00 255.0 FORMAT "%5.1" ECU_ADDRESS 0x60034C51 /end MEASUREMENT
/begin MEASUREMENT DFC_st.DFC_VehVSigCanSafe "" UBYTE DFC_OneToOne 1 100 0.00 255.0 FORMAT "%5.1" ECU_ADDRESS 0x60034C52 /end MEASUREMENT
/begin MEASUREMENT DFC_st.DFC_VehVObd "" UBYTE DFC_OneToOne 1 100 0.00 255.0 FORMAT "%5.1" ECU_ADDRESS 0x60034D92 /end MEASUREMENT
/begin MEASUREMENT DINH_nrActvInhReas.FId_VMSIEvDCSRampShOff01 "" UWORD DINH_ct_Compu 1 100 -4095.000 4096.000 BIT_MASK 0x1fff FORMAT "%8.3" ECU_ADDRESS 0x60021586 /end MEASUREMENT
/begin MEASUREMENT DINH_nrActvInhReas.FId_VMSIEvDCSShOff01 "" UWORD DINH_ct_Compu 1 100 -4095.000 4096.000 BIT_MASK 0x1fff FORMAT "%8.3" ECU_ADDRESS 0x60021588 /end MEASUREMENT
/begin MEASUREMENT DINH_nrActvInhReas.FId_VMSIEvTCSRampShOff01 "" UWORD DINH_ct_Compu 1 100 -4095.000 4096.000 BIT_MASK 0x1fff FORMAT "%8.3" ECU_ADDRESS 0x6002158A /end MEASUREMENT
/begin MEASUREMENT DINH_nrActvInhReas.FId_VMSIEvTCSShOff01 "" UWORD DINH_ct_Compu 1 100 -4095.000 4096.000 BIT_MASK 0x1fff FORMAT "%8.3" ECU_ADDRESS 0x6002158C /end MEASUREMENT
/begin MEASUREMENT DINH_nrActvInhReas.FId_VMSIEvTVRampShOff01 "" UWORD DINH_ct_Compu 1 100 -4095.000 4096.000 BIT_MASK 0x1fff FORMAT "%8.3" ECU_ADDRESS 0x6002158E /end MEASUREMENT
/begin MEASUREMENT DINH_nrActvInhReas.FId_VMSIEvTVShOff01 "" UWORD DINH_ct_Compu 1 100 -4095.000 4096.000 BIT_MASK 0x1fff FORMAT "%8.3" ECU_ADDRESS 0x60021590 /end MEASUREMENT
/begin MEASUREMENT DINH_nrActvInhReas.FId_VehCoornHvReq "" UWORD DINH_ct_Compu 1 100 -4095.000 4096.000 BIT_MASK 0x1fff FORMAT "%8.3" ECU_ADDRESS 0x600215A6 /end MEASUREMENT
/begin MEASUREMENT DINH_nrActvInhReas.FId_VehCoornImobTrqInhbn "" UWORD DINH_ct_Compu 1 100 -4095.000 4096.000 BIT_MASK 0x1fff FORMAT "%8.3" ECU_ADDRESS 0x600215A8 /end MEASUREMENT
/begin MEASUREMENT DINH_nrActvInhReas.FId_VehVCANFrzVal "" UWORD DINH_ct_Compu 1 100 -4095.000 4096.000 BIT_MASK 0x1fff FORMAT "%8.3" ECU_ADDRESS 0x600215B0 /end MEASUREMENT
/begin MEASUREMENT DINH_nrActvInhReas.FId_VehVCANReplVal "" UWORD DINH_ct_Compu 1 100 -4095.000 4096.000 BIT_MASK 0x1fff FORMAT "%8.3" ECU_ADDRESS 0x600215B2 /end MEASUREMENT
/begin MEASUREMENT DINH_nrActvInhReas.FId_VehVCanSafeFrzVal "" UWORD DINH_ct_Compu 1 100 -4095.000 4096.000 BIT_MASK 0x1fff FORMAT "%8.3" ECU_ADDRESS 0x600215B4 /end MEASUREMENT
/begin MEASUREMENT DINH_nrActvInhReas.FId_VehVCanSafeReplVal "" UWORD DINH_ct_Compu 1 100 -4095.000 4096.000 BIT_MASK 0x1fff FORMAT "%8.3" ECU_ADDRESS 0x600215B6 /end MEASUREMENT
/begin MEASUREMENT DINH_nrActvInhReas.FId_VehVFrzVal "" UWORD DINH_ct_Compu 1 100 -4095.000 4096.000 BIT_MASK 0x1fff FORMAT "%8.3" ECU_ADDRESS 0x600215B8 /end MEASUREMENT
/begin MEASUREMENT DINH_nrActvInhReas.FId_VehVNActPhy01Dfct "" UWORD DINH_ct_Compu 1 100 -4095.000 4096.000 BIT_MASK 0x1fff FORMAT "%8.3" ECU_ADDRESS 0x600215BA /end MEASUREMENT
/begin MEASUREMENT DINH_nrActvInhReas.FId_VehVReplVal "" UWORD DINH_ct_Compu 1 100 -4095.000 4096.000 BIT_MASK 0x1fff FORMAT "%8.3" ECU_ADDRESS 0x600215BC /end MEASUREMENT
/begin MEASUREMENT DINH_nrActvInhReas.FId_VehVSigCan "" UWORD DINH_ct_Compu 1 100 -4095.000 4096.000 BIT_MASK 0x1fff FORMAT "%8.3" ECU_ADDRESS 0x600215BE /end MEASUREMENT
/begin MEASUREMENT DINH_nrActvInhReas.FId_VehVSigCanSafe "" UWORD DINH_ct_Compu 1 100 -4095.000 4096.000 BIT_MASK 0x1fff FORMAT "%8.3" ECU_ADDRESS 0x600215C0 /end MEASUREMENT
/begin MEASUREMENT DINH_nrActvInhReas.FId_WtrPmp1Err "" UWORD DINH_ct_Compu 1 100 -4095.000 4096.000 BIT_MASK 0x1fff FORMAT "%8.3" ECU_ADDRESS 0x600215C2 /end MEASUREMENT
/begin MEASUREMENT DINH_stFId.FId_VMSIEvDCSRampShOff01 "" UWORD DFC_OneToOne 1 100 0.00 65535.00 FORMAT "%8.2" ECU_ADDRESS 0x60021586 /end MEASUREMENT
/begin MEASUREMENT DINH_stFId.FId_VMSIEvDCSShOff01 "" UWORD DFC_OneToOne 1 100 0.00 65535.00 FORMAT "%8.2" ECU_ADDRESS 0x60021588 /end MEASUREMENT
/begin MEASUREMENT DINH_stFId.FId_VMSIEvTCSRampShOff01 "" UWORD DFC_OneToOne 1 100 0.00 65535.00 FORMAT "%8.2" ECU_ADDRESS 0x6002158A /end MEASUREMENT
/begin MEASUREMENT DINH_stFId.FId_VMSIEvTCSShOff01 "" UWORD DFC_OneToOne 1 100 0.00 65535.00 FORMAT "%8.2" ECU_ADDRESS 0x6002158C /end MEASUREMENT
/begin MEASUREMENT DINH_stFId.FId_VMSIEvTVRampShOff01 "" UWORD DFC_OneToOne 1 100 0.00 65535.00 FORMAT "%8.2" ECU_ADDRESS 0x6002158E /end MEASUREMENT
/begin MEASUREMENT DINH_stFId.FId_VMSIEvTVShOff01 "" UWORD DFC_OneToOne 1 100 0.00 65535.00 FORMAT "%8.2" ECU_ADDRESS 0x60021590 /end MEASUREMENT
/begin MEASUREMENT DINH_stFId.FId_VehCoornHvReq "" UWORD DFC_OneToOne 1 100 0.00 65535.00 FORMAT "%8.2" ECU_ADDRESS 0x600215A6 /end MEASUREMENT
/begin MEASUREMENT DINH_stFId.FId_VehCoornImobTrqInhbn "" UWORD DFC_OneToOne 1 100 0.00 65535.00 FORMAT "%8.2" ECU_ADDRESS 0x600215A8 /end MEASUREMENT
/begin MEASUREMENT DINH_stFId.FId_VehVCANFrzVal "" UWORD DFC_OneToOne 1 100 0.00 65535.00 FORMAT "%8.2" ECU_ADDRESS 0x600215B0 /end MEASUREMENT
/begin MEASUREMENT DINH_stFId.FId_VehVCANReplVal "" UWORD DFC_OneToOne 1 100 0.00 65535.00 FORMAT "%8.2" ECU_ADDRESS 0x600215B2 /end MEASUREMENT
/begin MEASUREMENT DINH_stFId.FId_VehVCanSafeFrzVal "" UWORD DFC_OneToOne 1 100 0.00 65535.00 FORMAT "%8.2" ECU_ADDRESS 0x600215B4 /end MEASUREMENT
/begin MEASUREMENT DINH_stFId.FId_VehVCanSafeReplVal "" UWORD DFC_OneToOne 1 100 0.00 65535.00 FORMAT "%8.2" ECU_ADDRESS 0x600215B6 /end MEASUREMENT
/begin MEASUREMENT DINH_stFId.FId_VehVFrzVal "" UWORD DFC_OneToOne 1 100 0.00 65535.00 FORMAT "%8.2" ECU_ADDRESS 0x600215B8 /end MEASUREMENT
/begin MEASUREMENT DINH_stFId.FId_VehVNActPhy01Dfct "" UWORD DFC_OneToOne 1 100 0.00 65535.00 FORMAT "%8.2" ECU_ADDRESS 0x600215BA /end MEASUREMENT
/begin MEASUREMENT DINH_stFId.FId_VehVReplVal "" UWORD DFC_OneToOne 1 100 0.00 65535.00 FORMAT "%8.2" ECU_ADDRESS 0x600215BC /end MEASUREMENT
/begin MEASUREMENT DINH_stFId.FId_VehVSigCan "" UWORD DFC_OneToOne 1 100 0.00 65535.00 FORMAT "%8.2" ECU_ADDRESS 0x600215BE /end MEASUREMENT
/begin MEASUREMENT DINH_stFId.FId_VehVSigCanSafe "" UWORD DFC_OneToOne 1 100 0.00 65535.00 FORMAT "%8.2" ECU_ADDRESS 0x600215C0 /end MEASUREMENT
/begin MEASUREMENT DINH_stFId.FId_WtrPmp1Err "" UWORD DFC_OneToOne 1 100 0.00 65535.00 FORMAT "%8.2" ECU_ADDRESS 0x600215C2 /end MEASUREMENT
/begin MEASUREMENT VehCoorn_flgAllwChrgnT15Off "flag to check if charge request is provided only when t15 is off" UBYTE B_TRUE 1 100 0.00 1.00000000000 BIT_MASK 0x1 FORMAT "%13.11" ECU_ADDRESS 0x700000DE
 /begin IF_DATA XCPplus 0x0102
  /begin DAQ_EVENT VARIABLE /end DAQ_EVENT
 /end IF_DATA
/end MEASUREMENT
/begin MEASUREMENT VehCoorn_flgChrgPlg "Flag for charge plug status after Delay" UBYTE B_TRUE 1 100 0.00 1.00000000000 BIT_MASK 0x1 FORMAT "%13.11" ECU_ADDRESS 0x700000DD
 /begin IF_DATA XCPplus 0x0102
  /begin DAQ_EVENT VARIABLE /end DAQ_EVENT
 /end IF_DATA
/end MEASUREMENT
/begin MEASUREMENT VehCoorn_flgChrgPlgDrvInhb "flag for drive inhibition due to charge plug" UBYTE B_TRUE 1 100 0.00 1.00000000000 BIT_MASK 0x1 FORMAT "%13.11" ECU_ADDRESS 0x700000DC
 /begin IF_DATA XCPplus 0x0102
  /begin DAQ_EVENT VARIABLE /end DAQ_EVENT
 /end IF_DATA
/end MEASUREMENT
/begin MEASUREMENT VehCoorn_flgChrgReq "Vehicle coordinator Charging request" UBYTE B_TRUE 1 100 0.00 1.00000000000 BIT_MASK 0x1 FORMAT "%13.11" ECU_ADDRESS 0x7000026D
 /begin IF_DATA XCPplus 0x0102
  /begin DAQ_EVENT VARIABLE /end DAQ_EVENT
 /end IF_DATA
/end MEASUREMENT
/begin MEASUREMENT VehCoorn_flgChrgrPlgChrgnInhb "flag for charging inhibition due to charger plug" UBYTE B_TRUE 1 100 0.00 1.00000000000 BIT_MASK 0x1 FORMAT "%13.11" ECU_ADDRESS 0x700000DB
 /begin IF_DATA XCPplus 0x0102
  /begin DAQ_EVENT VARIABLE /end DAQ_EVENT
 /end IF_DATA
/end MEASUREMENT
/begin MEASUREMENT VehCoorn_flgDrvInhb "Vehicle coordinator Inhibt Driving" UBYTE B_TRUE 1 100 0.00 1.00000000000 BIT_MASK 0x1 FORMAT "%13.11" ECU_ADDRESS 0x7000026C
 /begin IF_DATA XCPplus 0x0102
  /begin DAQ_EVENT VARIABLE /end DAQ_EVENT
 /end IF_DATA
/end MEASUREMENT
/begin MEASUREMENT VehCoorn_flgDrvReq "vehicle requests drive mode" UBYTE B_TRUE 1 100 0.00 1.00000000000 BIT_MASK 0x1 FORMAT "%13.11" ECU_ADDRESS 0x7000026A
 /begin IF_DATA XCPplus 0x0102
  /begin DAQ_EVENT VARIABLE /end DAQ_EVENT
 /end IF_DATA
/end MEASUREMENT
/begin MEASUREMENT VehCoorn_flgDrvrInp "Flag Drive input" UBYTE B_TRUE 1 100 0.00 1.00000000000 BIT_MASK 0x1 FORMAT "%13.11" ECU_ADDRESS 0x70000269
 /begin IF_DATA XCPplus 0x0102
  /begin DAQ_EVENT VARIABLE /end DAQ_EVENT
 /end IF_DATA
/end MEASUREMENT
/begin MEASUREMENT VehCoorn_flgHVReq "vehicel requests HV System" UBYTE B_TRUE 1 100 0.00 1.00000000000 BIT_MASK 0x1 FORMAT "%13.11" ECU_ADDRESS 0x70000268
 /begin IF_DATA XCPplus 0x0102
  /begin DAQ_EVENT VARIABLE /end DAQ_EVENT
 /end IF_DATA
/end MEASUREMENT
/begin MEASUREMENT VehCoorn_flgHvReqRst "HV reset request" UBYTE B_TRUE 1 100 0.00 1.00000000000 BIT_MASK 0x1 FORMAT "%13.11" ECU_ADDRESS 0x700000DA
 /begin IF_DATA XCPplus 0x0102
  /begin DAQ_EVENT VARIABLE /end DAQ_EVENT
 /end IF_DATA
/end MEASUREMENT
/begin MEASUREMENT VehCoorn_flgHvReqSet "hv set request" UBYTE B_TRUE 1 100 0.00 1.00000000000 BIT_MASK 0x1 FORMAT "%13.11" ECU_ADDRESS 0x700000D9
 /begin IF_DATA XCPplus 0x0102
  /begin DAQ_EVENT VARIABLE /end DAQ_EVENT
 /end IF_DATA
/end MEASUREMENT
/begin MEASUREMENT VehCoorn_flgIgnOnWoCrk "ignition on without crank" UBYTE B_TRUE 1 100 0.00 1.00000000000 BIT_MASK 0x1 FORMAT "%13.11" ECU_ADDRESS 0x700000D8
 /begin IF_DATA XCPplus 0x0102
  /begin DAQ_EVENT VARIABLE /end DAQ_EVENT
 /end IF_DATA
/end MEASUREMENT
/begin MEASUREMENT VehCoorn_flgIgnOnWoCrkTout "ignition on without crank time out" UBYTE B_TRUE 1 100 0.00 1.00000000000 BIT_MASK 0x1 FORMAT "%13.11" ECU_ADDRESS 0x700000D7
 /begin IF_DATA XCPplus 0x0102
  /begin DAQ_EVENT VARIABLE /end DAQ_EVENT
 /end IF_DATA
/end MEASUREMENT
/begin MEASUREMENT VehCoorn_flgNoDrvrInp "flag to enablefunctionality of hvshutdown when no driver input is present for a calibratable time" UBYTE B_TRUE 1 100 0.00 1.00000000000 BIT_MASK 0x1 FORMAT "%13.11" ECU_ADDRESS 0x700000D6
 /begin IF_DATA XCPplus 0x0102
  /begin DAQ_EVENT VARIABLE /end DAQ_EVENT
 /end IF_DATA
/end MEASUREMENT
/begin MEASUREMENT VehCoorn_flgRmtChrgReq "Flag for remote charging request" UBYTE B_TRUE 1 100 0.00 1.00000000000 BIT_MASK 0x1 FORMAT "%13.11" ECU_ADDRESS 0x70000264
 /begin IF_DATA XCPplus 0x0102
  /begin DAQ_EVENT VARIABLE /end DAQ_EVENT
 /end IF_DATA
/end MEASUREMENT
/begin MEASUREMENT VehCoorn_flgT15Off "HV request due to t15 off" UBYTE B_TRUE 1 100 0.00 1.00000000000 BIT_MASK 0x1 FORMAT "%13.11" ECU_ADDRESS 0x700000D5
 /begin IF_DATA XCPplus 0x0102
  /begin DAQ_EVENT VARIABLE /end DAQ_EVENT
 /end IF_DATA
/end MEASUREMENT
/begin MEASUREMENT VehCoorn_flgT15OnHvReqOffRst "T15On Hv request OFF reset" UBYTE B_TRUE 1 100 0.00 1.00000000000 BIT_MASK 0x1 FORMAT "%13.11" ECU_ADDRESS 0x700000D4
 /begin IF_DATA XCPplus 0x0102
  /begin DAQ_EVENT VARIABLE /end DAQ_EVENT
 /end IF_DATA
/end MEASUREMENT
/begin MEASUREMENT VehCoorn_flgT15OnHvReqOffSet "T15On Hv request OFF set" UBYTE B_TRUE 1 100 0.00 1.00000000000 BIT_MASK 0x1 FORMAT "%13.11" ECU_ADDRESS 0x700000D3
 /begin IF_DATA XCPplus 0x0102
  /begin DAQ_EVENT VARIABLE /end DAQ_EVENT
 /end IF_DATA
/end MEASUREMENT
/begin MEASUREMENT VehCoorn_flgVehDrvChrgrPlgd "charger plugged and in drive state" UBYTE B_TRUE 1 100 0.00 1.00000000000 BIT_MASK 0x1 FORMAT "%13.11" ECU_ADDRESS 0x700000D2
 /begin IF_DATA XCPplus 0x0102
  /begin DAQ_EVENT VARIABLE /end DAQ_EVENT
 /end IF_DATA
/end MEASUREMENT
/begin MEASUREMENT VehCoorn_HvReqTOffD_I.XOld "Turn Off Delay for HV Request / Old input value from last call" UBYTE B_TRUE 1 100 0.00 1.00000000000 BIT_MASK 0x1 FORMAT "%13.11" ECU_ADDRESS 0x6003476C /end MEASUREMENT
/begin MEASUREMENT VehCoorn_HvReqTOffD_I.Timer "Turn Off Delay for HV Request / Timer for internal state" FLOAT32_IEEE OneToOne 1 100 -1.00000000E+037 1.00000000E+037 FORMAT "%13.3" ECU_ADDRESS 0x60034770 /end MEASUREMENT
/begin MEASUREMENT VehCoorn_stChrgnReq "Statusof charging request" UBYTE B_TRUE 1 100 0.00 1.00000000000 BIT_MASK 0x1 FORMAT "%13.11" ECU_ADDRESS 0x700000CE
 /begin IF_DATA XCPplus 0x0102
  /begin DAQ_EVENT VARIABLE /end DAQ_EVENT
 /end IF_DATA
/end MEASUREMENT
/begin MEASUREMENT VehCoorn_stRmtNoChrgn "Status of remote no charge" UBYTE B_TRUE 1 100 0.00 1.00000000000 BIT_MASK 0x1 FORMAT "%13.11" ECU_ADDRESS 0x6003494C
 /begin IF_DATA XCPplus 0x0102
  /begin DAQ_EVENT VARIABLE /end DAQ_EVENT
 /end IF_DATA
/end MEASUREMENT
/begin MEASUREMENT VehCoorn_StrtReqTOffD_I.XOld "TOff-Delay vehicle drive request / old input value from previous call" UBYTE B_TRUE 1 100 0.00 1.00000000000 BIT_MASK 0x1 FORMAT "%13.11" ECU_ADDRESS 0x600003B0 /end MEASUREMENT
/begin MEASUREMENT VehCoorn_StrtReqTOffD_I.Timer "TOff-Delay vehicle drive request / Timer for internal state" SLONG OneToOne 1 100 -2147483648.00 2147483647.00 FORMAT "%13.2" ECU_ADDRESS 0x600003B4 /end MEASUREMENT
/begin MEASUREMENT VehCoorn_tiNoDrvrInpTout "Remaining Time for which there is no driver input when left at standstill before hv is shutdown" SLONG RBPtCel_ti_1p0_4 1 100 -2147483648.00 2147483647.00 FORMAT "%13.2" ECU_ADDRESS 0x600003BC
 /begin IF_DATA XCPplus 0x0102
  /begin DAQ_EVENT VARIABLE /end DAQ_EVENT
 /end IF_DATA
/end MEASUREMENT
/begin MEASUREMENT VehCoorn_tiThdDebHvReq "isolation monitoring request" SWORD Time_1s 1 100 -32768.00 32767.00 FORMAT "%8.2" ECU_ADDRESS 0x6001FA66
 /begin IF_DATA XCPplus 0x0102
  /begin DAQ_EVENT VARIABLE /end DAQ_EVENT
 /end IF_DATA
/end MEASUREMENT
/begin MEASUREMENT VehDrvEv_facDsbcCtrlrGain01 "Gain factor for disturbence control (e-machine 1)" SWORD TransR 1 100 -327.6800 327.6700 FORMAT "%8.4" ECU_ADDRESS 0x6001FA64
 /begin IF_DATA XCPplus 0x0102
  /begin DAQ_EVENT VARIABLE /end DAQ_EVENT
 /end IF_DATA
/end MEASUREMENT
/begin MEASUREMENT VehDrvEv_nAct01 "Absolute value of Actual engine speed, e-machine 01" SWORD nmot_q1 1 100 0.00 32767.00 FORMAT "%8.2" ECU_ADDRESS 0x6001F3BA
 /begin IF_DATA XCPplus 0x0102
  /begin DAQ_EVENT VARIABLE /end DAQ_EVENT
 /end IF_DATA
/end MEASUREMENT
/begin MEASUREMENT VehDrvEv_stDsbcCtrlr01 "Status request for disturbance controller Electrcial machine 01" UBYTE OneToOne 1 100 0.00 255.0 FORMAT "%5.1" ECU_ADDRESS 0x600234FD
 /begin IF_DATA XCPplus 0x0102
  /begin DAQ_EVENT VARIABLE /end DAQ_EVENT
 /end IF_DATA
/end MEASUREMENT
/begin MEASUREMENT VehDrvEv_tiRefFil "Time parameter for second order low pass filter" UWORD zk10msxs_uw_b655p36 1 100 0.01000015 655.36000000 FORMAT "%12.8" ECU_ADDRESS 0x6001FA16
 /begin IF_DATA XCPplus 0x0102
  /begin DAQ_EVENT VARIABLE /end DAQ_EVENT
 /end IF_DATA
/end MEASUREMENT
/begin MEASUREMENT VehDrvEv_tqCrssPerStepNeg "Negative torque per step" SLONG TrqPrpHigh 1 100 -214748364.800 214748364.700 FORMAT "%13.3" ECU_ADDRESS 0x60000F34
 /begin IF_DATA XCPplus 0x0102
  /begin DAQ_EVENT VARIABLE /end DAQ_EVENT
 /end IF_DATA
/end MEASUREMENT
/begin MEASUREMENT VehDrvEv_tqCrssPerStepPos "Positive torque per step" SLONG TrqPrpHigh 1 100 -214748364.800 214748364.700 FORMAT "%13.3" ECU_ADDRESS 0x60000F30
 /begin IF_DATA XCPplus 0x0102
  /begin DAQ_EVENT VARIABLE /end DAQ_EVENT
 /end IF_DATA
/end MEASUREMENT
/begin MEASUREMENT VehDrvEv_tqDeltaZrCrss "difference torque between output torque of the reference filter and the zero crossing filter" SWORD TrqPrp 1 100 -52428.80 52427.20 FORMAT "%8.2" ECU_ADDRESS 0x6001F3B8
 /begin IF_DATA XCPplus 0x0102
  /begin DAQ_EVENT VARIABLE /end DAQ_EVENT
 /end IF_DATA
/end MEASUREMENT
/begin MEASUREMENT VehDrvEv_tqDesLpFild "Desired low pass filtered propulsion torque" SLONG TrqPrpHigh 1 100 -214748364.800 214748364.700 FORMAT "%13.3" ECU_ADDRESS 0x60000F2C
 /begin IF_DATA XCPplus 0x0102
  /begin DAQ_EVENT VARIABLE /end DAQ_EVENT
 /end IF_DATA
/end MEASUREMENT
/begin MEASUREMENT VehDrvEv_tqDsbcCtrlrMax01 "maximum torque for the desturbence control (e-machine 1)" SWORD Trq 1 100 -3276.800 3276.700 FORMAT "%8.3" ECU_ADDRESS 0x6001FA62
 /begin IF_DATA XCPplus 0x0102
  /begin DAQ_EVENT VARIABLE /end DAQ_EVENT
 /end IF_DATA
/end MEASUREMENT
/begin MEASUREMENT VehDrvEv_tqGrdtMaxZrCrss "maximum torque gradient for zero cross filter" SLONG RmpTrqPrpHigh 1 100 -3276800.00000 3276799.99847 FORMAT "%13.5" ECU_ADDRESS 0x600003AC
 /begin IF_DATA XCPplus 0x0102
  /begin DAQ_EVENT VARIABLE /end DAQ_EVENT
 /end IF_DATA
/end MEASUREMENT
/begin MEASUREMENT VehDrvEv_tqGrdtMaxZrCrssDrvgMod "maximum positive torque gradient for zero crossing when driving modes active" SWORD TrqPrp 1 100 -52428.80 52427.20 FORMAT "%8.2" ECU_ADDRESS 0x6001F3B6
 /begin IF_DATA XCPplus 0x0102
  /begin DAQ_EVENT VARIABLE /end DAQ_EVENT
 /end IF_DATA
/end MEASUREMENT
/begin MEASUREMENT VehDrvEv_tqGrdtMaxZrCrssNeg "maximum torque gradient for zero cross filter (negative slope)" SLONG RmpTrqPrpHigh 1 100 -3276800.00000 3276799.99847 FORMAT "%13.5" ECU_ADDRESS 0x600003A8
 /begin IF_DATA XCPplus 0x0102
  /begin DAQ_EVENT VARIABLE /end DAQ_EVENT
 /end IF_DATA
/end MEASUREMENT
/begin MEASUREMENT VehDrvEv_tqGrdtMaxZrCrssNegDrvgMod "maximum negative torque gradient for zero crossing when driving modes active" SWORD TrqPrp 1 100 -52428.80 52427.20 FORMAT "%8.2" ECU_ADDRESS 0x6001F3B4
 /begin IF_DATA XCPplus 0x0102
  /begin DAQ_EVENT VARIABLE /end DAQ_EVENT
 /end IF_DATA
/end MEASUREMENT
/begin MEASUREMENT VehDrvEv_tqGrdtReaTar "positive torque gradient to shape the reaching of ther target torque" SLONG RmpTrqPrpHigh 1 100 -3276800.00000 3276799.99847 FORMAT "%13.5" ECU_ADDRESS 0x600003A4
 /begin IF_DATA XCPplus 0x0102
  /begin DAQ_EVENT VARIABLE /end DAQ_EVENT
 /end IF_DATA
/end MEASUREMENT
/begin MEASUREMENT VehDrvEv_tqGrdtReaTarNeg "negative torque gradient to shape the reaching of ther target torque" SLONG RmpTrqPrpHigh 1 100 -3276800.00000 3276799.99847 FORMAT "%13.5" ECU_ADDRESS 0x600003A0
 /begin IF_DATA XCPplus 0x0102
  /begin DAQ_EVENT VARIABLE /end DAQ_EVENT
 /end IF_DATA
/end MEASUREMENT
/begin MEASUREMENT VehDrvEv_tqGrdtZrCrss "torque gradient for zero cross filter" SLONG RmpTrqPrpHigh 1 100 -3276800.00000 3276799.99847 FORMAT "%13.5" ECU_ADDRESS 0x6000039C
 /begin IF_DATA XCPplus 0x0102
  /begin DAQ_EVENT VARIABLE /end DAQ_EVENT
 /end IF_DATA
/end MEASUREMENT
/begin MEASUREMENT VehDrvEv_tqGrdtZrCrssDeltaNeg "torque gradient for zero cross filter (negative slope)" SLONG RmpTrqPrpHigh 1 100 -3276800.00000 3276799.99847 FORMAT "%13.5" ECU_ADDRESS 0x60000398
 /begin IF_DATA XCPplus 0x0102
  /begin DAQ_EVENT VARIABLE /end DAQ_EVENT
 /end IF_DATA
/end MEASUREMENT
/begin MEASUREMENT VehDrvEv_tqGrdtZrCrssLimSlopeNeg "limit of the torque gradient for zero cross filter (negative slope)" SLONG RmpTrqPrpHigh 1 100 -3276800.00000 3276799.99847 FORMAT "%13.5" ECU_ADDRESS 0x60000394
 /begin IF_DATA XCPplus 0x0102
  /begin DAQ_EVENT VARIABLE /end DAQ_EVENT
 /end IF_DATA
/end MEASUREMENT
/begin MEASUREMENT VehDrvEv_tqGrdtZrCrssLimSlopePos "limit of the torque gradient for zero cross filter" SLONG RmpTrqPrpHigh 1 100 -3276800.00000 3276799.99847 FORMAT "%13.5" ECU_ADDRESS 0x60000390
 /begin IF_DATA XCPplus 0x0102
  /begin DAQ_EVENT VARIABLE /end DAQ_EVENT
 /end IF_DATA
/end MEASUREMENT
/begin MEASUREMENT VehDrvEv_tqGrdtZrCrssNeg "torque gradient for zero cross filter (negative slope)" SLONG RmpTrqPrpHigh 1 100 -3276800.00000 3276799.99847 FORMAT "%13.5" ECU_ADDRESS 0x6000038C
 /begin IF_DATA XCPplus 0x0102
  /begin DAQ_EVENT VARIABLE /end DAQ_EVENT
 /end IF_DATA
/end MEASUREMENT
/begin MEASUREMENT VehDrvEv_tqGrdtZrCrssPos "torque gradient for zero cross filter (positive slope)" SLONG RmpTrqPrpHigh 1 100 -3276800.00000 3276799.99847 FORMAT "%13.5" ECU_ADDRESS 0x60000388
 /begin IF_DATA XCPplus 0x0102
  /begin DAQ_EVENT VARIABLE /end DAQ_EVENT
 /end IF_DATA
/end MEASUREMENT
/begin MEASUREMENT VehDrvEv_tqNormZrCrssFild "normalized torque (e-machine torque level)" SWORD TrqPrp 1 100 -52428.80 52427.20 FORMAT "%8.2" ECU_ADDRESS 0x6001F3B2
 /begin IF_DATA XCPplus 0x0102
  /begin DAQ_EVENT VARIABLE /end DAQ_EVENT
 /end IF_DATA
/end MEASUREMENT
/begin MEASUREMENT VehDrvEv_tqThresDsbcCtrlrOn01 "Torque threshold for the desturbence control (e-machine 1)" SWORD Trq 1 100 -3276.800 3276.700 FORMAT "%8.3" ECU_ADDRESS 0x6001FA60
 /begin IF_DATA XCPplus 0x0102
  /begin DAQ_EVENT VARIABLE /end DAQ_EVENT
 /end IF_DATA
/end MEASUREMENT
/begin MEASUREMENT VehDrvEv_tqZrCrssFild "filtered total desired torque for distribution" SLONG TrqPrpHigh 1 100 -214748364.800 214748364.700 FORMAT "%13.3" ECU_ADDRESS 0x60000F24
 /begin IF_DATA XCPplus 0x0102
  /begin DAQ_EVENT VARIABLE /end DAQ_EVENT
 /end IF_DATA
/end MEASUREMENT
/begin MEASUREMENT VehDrvEv_tqZrCrssFildRamp "filtered total desired ramp torque" SLONG TrqPrpHigh 1 100 -214748364.800 214748364.700 FORMAT "%13.3" ECU_ADDRESS 0x60000384
 /begin IF_DATA XCPplus 0x0102
  /begin DAQ_EVENT VARIABLE /end DAQ_EVENT
 /end IF_DATA
/end MEASUREMENT
/begin MEASUREMENT VehMotEv_tqPrimAxleFild "filtered desired primary axle torque" SLONG TrqPrpHigh 1 100 -214748364.800 214748364.700 FORMAT "%13.3" ECU_ADDRESS 0x60000F20
 /begin IF_DATA XCPplus 0x0102
  /begin DAQ_EVENT VARIABLE /end DAQ_EVENT
 /end IF_DATA
/end MEASUREMENT
/begin MEASUREMENT VehMot_a2trq "Conversion factor acceleration to propulsion torque" SWORD MassLength 1 100 -6553.600 6553.400 FORMAT "%8.3" ECU_ADDRESS 0x6001FA5E /end MEASUREMENT
/begin MEASUREMENT VehMot_aPrpCurr "Current estimated acceleration" SWORD Acc 1 100 -32.76800 32.76700 FORMAT "%8.5" ECU_ADDRESS 0x6001FA5C
 /begin IF_DATA XCPplus 0x0102
  /begin DAQ_EVENT VARIABLE /end DAQ_EVENT
 /end IF_DATA
/end MEASUREMENT
/begin MEASUREMENT VehMot_aPrpMax "Maximum estimated acceleration at current engaged gear" SWORD Acc 1 100 -32.76800 32.76700 FORMAT "%8.5" ECU_ADDRESS 0x6001FA5A
 /begin IF_DATA XCPplus 0x0102
  /begin DAQ_EVENT VARIABLE /end DAQ_EVENT
 /end IF_DATA
/end MEASUREMENT
/begin MEASUREMENT VehMot_aPrpMin "Minimum estimated acceleration at current engaged gear" SWORD Acc 1 100 -32.76800 32.76700 FORMAT "%8.5" ECU_ADDRESS 0x6001FA58
 /begin IF_DATA XCPplus 0x0102
  /begin DAQ_EVENT VARIABLE /end DAQ_EVENT
 /end IF_DATA
/end MEASUREMENT
/begin MEASUREMENT VehMot_dNAct01 "filtered gradient of ElM01-engine speed" SWORD EngNGrd 1 100 -16384.00 16383.50 FORMAT "%8.2" ECU_ADDRESS 0x6001F3AE
 /begin IF_DATA XCPplus 0x0102
  /begin DAQ_EVENT VARIABLE /end DAQ_EVENT
 /end IF_DATA
/end MEASUREMENT
/begin MEASUREMENT VehMot_dNAct01Raw "unfiltered gradient of ElM01-engine speed" SWORD EngNGrd 1 100 -16384.00 16383.50 FORMAT "%8.2" ECU_ADDRESS 0x6001F3AC
 /begin IF_DATA XCPplus 0x0102
  /begin DAQ_EVENT VARIABLE /end DAQ_EVENT
 /end IF_DATA
/end MEASUREMENT
/begin MEASUREMENT VehMot_facRecupTqLimPrimAxle "recuperation torque factor of primary axle" SWORD Fact 1 100 -4.000000 3.999878 FORMAT "%8.6" ECU_ADDRESS 0x6001F3AA
 /begin IF_DATA XCPplus 0x0102
  /begin DAQ_EVENT VARIABLE /end DAQ_EVENT
 /end IF_DATA
/end MEASUREMENT
/begin MEASUREMENT VehMot_nAct01AbsltPrevCyc "ElM01 absolute value of engine speed from previous computation cycle, used for calculation of ElM01 engine speed gradient" SWORD nmot_q1 1 100 -32768.00 32767.00 FORMAT "%8.2" ECU_ADDRESS 0x6001F3A8
 /begin IF_DATA XCPplus 0x0102
  /begin DAQ_EVENT VARIABLE /end DAQ_EVENT
 /end IF_DATA
/end MEASUREMENT
/begin MEASUREMENT VehMot_nActFildPrimAxle "filtered abolute value of ElM01-engine speed" SWORD nmot_q1 1 100 -32768.00 32767.00 FORMAT "%8.2" ECU_ADDRESS 0x6001F3A6
 /begin IF_DATA XCPplus 0x0102
  /begin DAQ_EVENT VARIABLE /end DAQ_EVENT
 /end IF_DATA
/end MEASUREMENT
/begin MEASUREMENT VehMot_nDifRecupTqLimPrimAxle "engine speed difference (range) between lower and upper boundary of recuperation torque limitation window on primary axle" SWORD nmot_q1 1 100 1.00 32767.00 FORMAT "%8.2" ECU_ADDRESS 0x6001F3A4
 /begin IF_DATA XCPplus 0x0102
  /begin DAQ_EVENT VARIABLE /end DAQ_EVENT
 /end IF_DATA
/end MEASUREMENT
/begin MEASUREMENT VehMot_nLowrBndyRecupTqLimPrimAxle "engine speed lower boundary of recuperation torque limitation window on primary axle" SWORD nmot_q1 1 100 -32768.00 32767.00 FORMAT "%8.2" ECU_ADDRESS 0x6001F3A2
 /begin IF_DATA XCPplus 0x0102
  /begin DAQ_EVENT VARIABLE /end DAQ_EVENT
 /end IF_DATA
/end MEASUREMENT
/begin MEASUREMENT VehMot_tiTrqDragPT1 "Time constant for filtering drag esimation" SLONG Time_s 1 100 -21474836.4800 21474836.4700 FORMAT "%13.4" ECU_ADDRESS 0x60000380
 /begin IF_DATA XCPplus 0x0102
  /begin DAQ_EVENT VARIABLE /end DAQ_EVENT
 /end IF_DATA
/end MEASUREMENT
/begin MEASUREMENT VehMot_tiTrqDragVx "Time constant for filtering drag esimation" SWORD Time_s 1 100 -327.6800 327.6700 FORMAT "%8.4" ECU_ADDRESS 0x6001F3B0
 /begin IF_DATA XCPplus 0x0102
  /begin DAQ_EVENT VARIABLE /end DAQ_EVENT
 /end IF_DATA
/end MEASUREMENT
/begin MEASUREMENT VehMot_tqDragEst "Calculated driving resistance unfiltered" SLONG TrqPrpHigh 1 100 -214748364.800 214748364.700 FORMAT "%13.3" ECU_ADDRESS 0x6000037C
 /begin IF_DATA XCPplus 0x0102
  /begin DAQ_EVENT VARIABLE /end DAQ_EVENT
 /end IF_DATA
/end MEASUREMENT
/begin MEASUREMENT VehMot_tqWhlRecupLimPrimAxle "Recuperation torque limit for primary axle" SLONG TrqPrpHigh 1 100 -214748364.800 214748364.700 FORMAT "%13.3" ECU_ADDRESS 0x60000F1C
 /begin IF_DATA XCPplus 0x0102
  /begin DAQ_EVENT VARIABLE /end DAQ_EVENT
 /end IF_DATA
/end MEASUREMENT
/begin MEASUREMENT VehMot_trqDrag "calculated driving resistance" SLONG TrqPrpHigh 1 100 -214748364.800 214748364.700 FORMAT "%13.3" ECU_ADDRESS 0x60000F18
 /begin IF_DATA XCPplus 0x0102
  /begin DAQ_EVENT VARIABLE /end DAQ_EVENT
 /end IF_DATA
/end MEASUREMENT
/begin MEASUREMENT VehMot_trqDragEstWoLimn "Estimated drag torque" SLONG TrqPrpHigh 1 100 -214748364.800 214748364.700 FORMAT "%13.3" ECU_ADDRESS 0x60000378
 /begin IF_DATA XCPplus 0x0102
  /begin DAQ_EVENT VARIABLE /end DAQ_EVENT
 /end IF_DATA
/end MEASUREMENT
/begin MEASUREMENT VehMot_trqPrpFlt "Current torque, filtered" SLONG TrqPrpHigh 1 100 -214748364.800 214748364.700 FORMAT "%13.3" ECU_ADDRESS 0x60000374
 /begin IF_DATA XCPplus 0x0102
  /begin DAQ_EVENT VARIABLE /end DAQ_EVENT
 /end IF_DATA
/end MEASUREMENT
/begin MEASUREMENT VehV_a "Vehicle Acceleration" SWORD Acc 1 100 -32.76800 32.76700 FORMAT "%8.5" ECU_ADDRESS 0x6001FA56
 /begin IF_DATA XCPplus 0x0102
  /begin DAQ_EVENT VARIABLE /end DAQ_EVENT
 /end IF_DATA
/end MEASUREMENT
/begin MEASUREMENT VehV_aFild "Filtered vehicle acceleration without any error handling" SWORD Acc 1 100 -32.76800 32.76700 FORMAT "%8.5" ECU_ADDRESS 0x6001F39A
 /begin IF_DATA XCPplus 0x0102
  /begin DAQ_EVENT VARIABLE /end DAQ_EVENT
 /end IF_DATA
/end MEASUREMENT
/begin MEASUREMENT VehV_aSens "Vehicle Acceleration raw value from VehV_v sensor" SWORD Acc 1 100 -32.76800 32.76700 FORMAT "%8.5" ECU_ADDRESS 0x6001FA54
 /begin IF_DATA XCPplus 0x0102
  /begin DAQ_EVENT VARIABLE /end DAQ_EVENT
 /end IF_DATA
/end MEASUREMENT
/begin MEASUREMENT VehV_a_Sq "Vehicle acceleration signal qualifier" UBYTE SigQly_COMPU_VERB 1 100 0.00 15.0000000000 FORMAT "%13.10" ECU_ADDRESS 0x600234FB
 /begin IF_DATA XCPplus 0x0102
  /begin DAQ_EVENT VARIABLE /end DAQ_EVENT
 /end IF_DATA
/end MEASUREMENT
/begin MEASUREMENT VehV_flgEm01Actv "Vehicle speed calculated from e-machine 1 is active" UBYTE B_TRUE 1 100 0.00 1.00000000000 BIT_MASK 0x1 FORMAT "%13.11" ECU_ADDRESS 0x700000C9
 /begin IF_DATA XCPplus 0x0102
  /begin DAQ_EVENT VARIABLE /end DAQ_EVENT
 /end IF_DATA
/end MEASUREMENT
/begin MEASUREMENT VehV_flgStandStillActv "Vehicle stand still active" UBYTE B_TRUE 1 100 0.00 1.00000000000 BIT_MASK 0x1 FORMAT "%13.11" ECU_ADDRESS 0x700000C8
 /begin IF_DATA XCPplus 0x0102
  /begin DAQ_EVENT VARIABLE /end DAQ_EVENT
 /end IF_DATA
/end MEASUREMENT
/begin MEASUREMENT VehV_stQlySafe "Status of Vehicle speed from safe signal source" UBYTE OneToOne 1 100 0.00 255.0 FORMAT "%5.1" ECU_ADDRESS 0x60022F79
 /begin IF_DATA XCPplus 0x0102
  /begin DAQ_EVENT VARIABLE /end DAQ_EVENT
 /end IF_DATA
/end MEASUREMENT
/begin MEASUREMENT VehV_stQlyStd "Status of Vehicle speed from standard signal source" UBYTE OneToOne 1 100 0.00 255.0 FORMAT "%5.1" ECU_ADDRESS 0x60022F78
 /begin IF_DATA XCPplus 0x0102
  /begin DAQ_EVENT VARIABLE /end DAQ_EVENT
 /end IF_DATA
/end MEASUREMENT
/begin MEASUREMENT VehV_stSigSrc "Current active Signal Source for vehicle speed sensing" UBYTE OneToOne 1 100 0.00 255.0 FORMAT "%5.1" ECU_ADDRESS 0x600234FA
 /begin IF_DATA XCPplus 0x0102
  /begin DAQ_EVENT VARIABLE /end DAQ_EVENT
 /end IF_DATA
/end MEASUREMENT
/begin MEASUREMENT VehV_v "Vehicle speed" SWORD Vel 1 100 -327.6800 327.6700 FORMAT "%8.4" ECU_ADDRESS 0x7000151E
 /begin IF_DATA XCPplus 0x0102
  /begin DAQ_EVENT VARIABLE /end DAQ_EVENT
 /end IF_DATA
/end MEASUREMENT
/begin MEASUREMENT VehV_vAFlt "Filtered vehicle speed for vehicle acceleration calculation" SWORD Vel 1 100 -327.6800 327.6700 FORMAT "%8.4" ECU_ADDRESS 0x6001F396
 /begin IF_DATA XCPplus 0x0102
  /begin DAQ_EVENT VARIABLE /end DAQ_EVENT
 /end IF_DATA
/end MEASUREMENT
/begin MEASUREMENT VehV_vEm "Vehicle speed calculated from e-machines" SWORD Vel 1 100 -327.6800 327.6700 FORMAT "%8.4" ECU_ADDRESS 0x6001FA52
 /begin IF_DATA XCPplus 0x0102
  /begin DAQ_EVENT VARIABLE /end DAQ_EVENT
 /end IF_DATA
/end MEASUREMENT
/begin MEASUREMENT VehV_vEm01 "Vehicle speed calculated from e-machine 1" SWORD Vel 1 100 -327.6800 327.6700 FORMAT "%8.4" ECU_ADDRESS 0x6001F3A0
 /begin IF_DATA XCPplus 0x0102
  /begin DAQ_EVENT VARIABLE /end DAQ_EVENT
 /end IF_DATA
/end MEASUREMENT
/begin MEASUREMENT VehV_vEmPrimAxle "Vehicle speed calculated from e-machines connected in the primary axle" SWORD Vel 1 100 -327.6800 327.6700 FORMAT "%8.4" ECU_ADDRESS 0x6001FA50
 /begin IF_DATA XCPplus 0x0102
  /begin DAQ_EVENT VARIABLE /end DAQ_EVENT
 /end IF_DATA
/end MEASUREMENT
/begin MEASUREMENT VehV_vEmPrimAxle_Sq "Signal quality:Vehicle speed calculated from e-machines connected in the primary axle" UBYTE SigQly_COMPU_VERB 1 100 0.00 15.0000000000 FORMAT "%13.10" ECU_ADDRESS 0x600234F9
 /begin IF_DATA XCPplus 0x0102
  /begin DAQ_EVENT VARIABLE /end DAQ_EVENT
 /end IF_DATA
/end MEASUREMENT
/begin MEASUREMENT VehV_vEm_Sq "Signal quality: Vehicle speed calculated from e-machines" UBYTE SigQly_COMPU_VERB 1 100 0.00 15.0000000000 FORMAT "%13.10" ECU_ADDRESS 0x600234F8
 /begin IF_DATA XCPplus 0x0102
  /begin DAQ_EVENT VARIABLE /end DAQ_EVENT
 /end IF_DATA
/end MEASUREMENT
/begin MEASUREMENT VehV_vFlt "Filtered vehicle speed" SWORD Vel 1 100 -327.6800 327.6700 FORMAT "%8.4" ECU_ADDRESS 0x6001F39E
 /begin IF_DATA XCPplus 0x0102
  /begin DAQ_EVENT VARIABLE /end DAQ_EVENT
 /end IF_DATA
/end MEASUREMENT
/begin MEASUREMENT VehV_vSens "Sensed vehicle speed" SWORD Vel 1 100 -327.6800 327.6700 FORMAT "%8.4" ECU_ADDRESS 0x6001FA4E
 /begin IF_DATA XCPplus 0x0102
  /begin DAQ_EVENT VARIABLE /end DAQ_EVENT
 /end IF_DATA
/end MEASUREMENT
/begin MEASUREMENT VehV_vSensOBD "Sensed vehicle speed for OBD" SWORD Vel 1 100 -327.6800 327.6700 FORMAT "%8.4" ECU_ADDRESS 0x6001FA4C
 /begin IF_DATA XCPplus 0x0102
  /begin DAQ_EVENT VARIABLE /end DAQ_EVENT
 /end IF_DATA
/end MEASUREMENT
/begin MEASUREMENT VehV_vSens_Sq "Rawvehicle speed signal qualifier" UBYTE SigQly_COMPU_VERB 1 100 0.00 15.0000000000 FORMAT "%13.10" ECU_ADDRESS 0x600234F7
 /begin IF_DATA XCPplus 0x0102
  /begin DAQ_EVENT VARIABLE /end DAQ_EVENT
 /end IF_DATA
/end MEASUREMENT
/begin MEASUREMENT VehV_vSign "Vehicle speed with direction." SWORD Vel 1 100 -327.6800 327.6700 FORMAT "%8.4" ECU_ADDRESS 0x6001FA4A
 /begin IF_DATA XCPplus 0x0102
  /begin DAQ_EVENT VARIABLE /end DAQ_EVENT
 /end IF_DATA
/end MEASUREMENT
/begin MEASUREMENT VehV_vSnsrSafe "Raw standard vehicle speed" SWORD Vel 1 100 -327.6800 327.6700 FORMAT "%8.4" ECU_ADDRESS 0x6001F394
 /begin IF_DATA XCPplus 0x0102
  /begin DAQ_EVENT VARIABLE /end DAQ_EVENT
 /end IF_DATA
/end MEASUREMENT
/begin MEASUREMENT VehV_vSnsrStd "Raw safe vehicle speed" SWORD Vel 1 100 -327.6800 327.6700 FORMAT "%8.4" ECU_ADDRESS 0x6001F392
 /begin IF_DATA XCPplus 0x0102
  /begin DAQ_EVENT VARIABLE /end DAQ_EVENT
 /end IF_DATA
/end MEASUREMENT
/begin MEASUREMENT VehV_vUnFlt "Unfiltered value of vehicle velocity" SWORD Vel 1 100 -327.6800 327.6700 FORMAT "%8.4" ECU_ADDRESS 0x6001F39C
 /begin IF_DATA XCPplus 0x0102
  /begin DAQ_EVENT VARIABLE /end DAQ_EVENT
 /end IF_DATA
/end MEASUREMENT
/begin MEASUREMENT VehV_v_Sq "Vehicle speed signal qualifier" UBYTE SigQly_COMPU_VERB 1 100 0.00 15.0000000000 FORMAT "%13.10" ECU_ADDRESS 0x600234F6
 /begin IF_DATA XCPplus 0x0102
  /begin DAQ_EVENT VARIABLE /end DAQ_EVENT
 /end IF_DATA
/end MEASUREMENT
/begin MEASUREMENT VMSIEv_flgAbsIntv01RmpInin "Flag indicating initialization of ABS intervention for EM-01" UBYTE B_TRUE 1 100 0.00 1.00000000000 BIT_MASK 0x1 FORMAT "%13.11" ECU_ADDRESS 0x60022F77
 /begin IF_DATA XCPplus 0x0102
  /begin DAQ_EVENT VARIABLE /end DAQ_EVENT
 /end IF_DATA
/end MEASUREMENT
/begin MEASUREMENT VMSIEv_flgDcsIntv01 "flag for DCS intervention active status(E machine 01)" UBYTE B_TRUE 1 100 0.00 1.00000000000 BIT_MASK 0x1 FORMAT "%13.11" ECU_ADDRESS 0x60022F76
 /begin IF_DATA XCPplus 0x0102
  /begin DAQ_EVENT VARIABLE /end DAQ_EVENT
 /end IF_DATA
/end MEASUREMENT
/begin MEASUREMENT VMSIEv_flgTcsIntv01 "flag for TCS intervention active status(E machine 01)" UBYTE B_TRUE 1 100 0.00 1.00000000000 BIT_MASK 0x1 FORMAT "%13.11" ECU_ADDRESS 0x60022F75
 /begin IF_DATA XCPplus 0x0102
  /begin DAQ_EVENT VARIABLE /end DAQ_EVENT
 /end IF_DATA
/end MEASUREMENT
/begin MEASUREMENT VMSIEv_tqDcsIntv01 "DCS intervention torque (E machine 01)" SLONG TrqPrpHigh 1 100 -214748364.800 214748364.700 FORMAT "%13.3" ECU_ADDRESS 0x60000350
 /begin IF_DATA XCPplus 0x0102
  /begin DAQ_EVENT VARIABLE /end DAQ_EVENT
 /end IF_DATA
/end MEASUREMENT
/begin MEASUREMENT VMSIEv_tqDesAbsIntv01 "Desired torque due to ABS intervention for EM-01" SLONG TrqPrpHigh 1 100 -214748364.800 214748364.700 FORMAT "%13.3" ECU_ADDRESS 0x6000034C
 /begin IF_DATA XCPplus 0x0102
  /begin DAQ_EVENT VARIABLE /end DAQ_EVENT
 /end IF_DATA
/end MEASUREMENT
/begin MEASUREMENT VMSIEv_tqDesAbsIntv01Cnv "Desired ABS intervention torque of EM 01 converted from wheel level" SWORD Trq 1 100 -3276.800 3276.700 FORMAT "%8.3" ECU_ADDRESS 0x6001F390
 /begin IF_DATA XCPplus 0x0102
  /begin DAQ_EVENT VARIABLE /end DAQ_EVENT
 /end IF_DATA
/end MEASUREMENT
/begin MEASUREMENT VMSIEv_tqDesAbsIntv01Em "Desired ABS intervention torque of EM01 at EM level" SWORD Trq 1 100 -3276.800 3276.700 FORMAT "%8.3" ECU_ADDRESS 0x6001F38E
 /begin IF_DATA XCPplus 0x0102
  /begin DAQ_EVENT VARIABLE /end DAQ_EVENT
 /end IF_DATA
/end MEASUREMENT
/begin MEASUREMENT VMSIEv_tqDesDCSIntv01 "Desired torque for DCS intervention EM-01" SLONG TrqPrpHigh 1 100 -214748364.800 214748364.700 FORMAT "%13.3" ECU_ADDRESS 0x60000348
 /begin IF_DATA XCPplus 0x0102
  /begin DAQ_EVENT VARIABLE /end DAQ_EVENT
 /end IF_DATA
/end MEASUREMENT
/begin MEASUREMENT VMSIEv_tqDesMax01 "TCS intervention torque (e-machine 1)" SLONG TrqPrpHigh 1 100 -214748364.800 214748364.700 FORMAT "%13.3" ECU_ADDRESS 0x60000F44
 /begin IF_DATA XCPplus 0x0102
  /begin DAQ_EVENT VARIABLE /end DAQ_EVENT
 /end IF_DATA
/end MEASUREMENT
/begin MEASUREMENT VMSIEv_tqDesMin01 "DCS intervention torque (e-machine 1)" SLONG TrqPrpHigh 1 100 -214748364.800 214748364.700 FORMAT "%13.3" ECU_ADDRESS 0x60000F40
 /begin IF_DATA XCPplus 0x0102
  /begin DAQ_EVENT VARIABLE /end DAQ_EVENT
 /end IF_DATA
/end MEASUREMENT
/begin MEASUREMENT VMSIEv_tqDesWithAllIntv "Desired torque with all possible intervention" SLONG TrqPrpHigh 1 100 -214748364.800 214748364.700 FORMAT "%13.3" ECU_ADDRESS 0x60000344
 /begin IF_DATA XCPplus 0x0102
  /begin DAQ_EVENT VARIABLE /end DAQ_EVENT
 /end IF_DATA
/end MEASUREMENT
/begin MEASUREMENT VMSIEv_tqTcsIntv01 "TCS intervention torque (E machine 01)" SLONG TrqPrpHigh 1 100 -214748364.800 214748364.700 FORMAT "%13.3" ECU_ADDRESS 0x60000340
 /begin IF_DATA XCPplus 0x0102
  /begin DAQ_EVENT VARIABLE /end DAQ_EVENT
 /end IF_DATA
/end MEASUREMENT
/begin MEASUREMENT VMSIEv_tqTCSRampOutp01 "TCS intervention torque (E machine 01) during ShutOff Ramp" SLONG TrqPrpHigh 1 100 -214748364.800 214748364.700 FORMAT "%13.3" ECU_ADDRESS 0x6000033C
 /begin IF_DATA XCPplus 0x0102
  /begin DAQ_EVENT VARIABLE /end DAQ_EVENT
 /end IF_DATA
/end MEASUREMENT
/begin MEASUREMENT VMSIEv_tqTqVectg01 "Torque of torque vectoring of e-machine 1" SLONG TrqPrpHigh 1 100 -214748364.800 214748364.700 FORMAT "%13.3" ECU_ADDRESS 0x60000F3C /end MEASUREMENT
/begin MEASUREMENT WtrPmp1_mfCoolgReq "Coolant flow request evaluated from component request" SWORD q1p220703Em4_kg_DIV_s 1 100 -4.000000 3.999878 FORMAT "%8.6" ECU_ADDRESS 0x6001F38C
 /begin IF_DATA XCPplus 0x0102
  /begin DAQ_EVENT VARIABLE /end DAQ_EVENT
 /end IF_DATA
/end MEASUREMENT
/begin MEASUREMENT WtrPmp1_mfDesMedT "MT coolant flow correction factor" SWORD q1p220703Em4_kg_DIV_s 1 100 -4.000000 3.999878 FORMAT "%8.6" ECU_ADDRESS 0x6001F9C2
 /begin IF_DATA XCPplus 0x0102
  /begin DAQ_EVENT VARIABLE /end DAQ_EVENT
 /end IF_DATA
/end MEASUREMENT
/begin MEASUREMENT WtrPmp1_pLossMedT "MT coolant flow request" SWORD RBPtCel_p_0p1_4 1 100 -3276.800 3276.700 FORMAT "%8.3" ECU_ADDRESS 0x6001F9C0
 /begin IF_DATA XCPplus 0x0102
  /begin DAQ_EVENT VARIABLE /end DAQ_EVENT
 /end IF_DATA
/end MEASUREMENT
/begin FUNCTION VehCoorn_StReq "1400.6.0  Request Common Vehicle State Transition"
 /begin DEF_CHARACTERISTIC DDRC_DurDeb.VehCoorn_tiDrvrNotPrsntDebOk_C DDRC_DurDeb.VehCoorn_tiDrvrNotPrsntDebDef_C DFC_CtlMsk2.DFC_VehCoornDrvrNotPrsnt_C DFC_DisblMsk2.DFC_VehCoornDrvrNotPrsnt_C VehCoorn_flgAllwChrgnT15Off_C VehCoorn_flgDoorOpenConsdr_C VehCoorn_flgDrvModNeutChrgReq_C VehCoorn_flgDrvModParkChrgReq_C VehCoorn_flgDrvModReqConsdr_C VehCoorn_flgParkBrkMask_C VehCoorn_flgStReqSwRst_C VehCoorn_flgT50DrvInhbEnad_C VehCoorn_maskActSpdEm01VldySq_C VehCoorn_maskChrgnSpstReqSq_C VehCoorn_maskIgnPosnVldySq_C VehCoorn_maskVehVVldySq_C VehCoorn_nActEmThd_C VehCoorn_ratSocHvOnMinThd_C VehCoorn_swtBrkConsdrDrvReq_C VehCoorn_tiDebChrgPlgSwRst_C VehCoorn_tiDebChrgPlg_C VehCoorn_tiDebDrvReq_C VehCoorn_tiDebHvBattSoc_C VehCoorn_tiDebHvReq_C VehCoorn_tiDebIgnKeySwRst_C VehCoorn_tiDebSpdSwRst_C VehCoorn_tiDebT15SwRst_C VehCoorn_tiT15OnHvReqOff_C VehCoorn_tiThdNoDrvrInp_C VehCoorn_vChrgMax_C VehCoorn_vDrvInhbChrgPlgMax_C VehCoorn_vDrvInhbMaxDelta_C VehCoorn_vDrvInhbMax_C VehCoorn_vDrvReqMinDelta_C VehCoorn_vDrvReqMin_C VehCoorn_vHvMinThd_C VehCoorn_vHvReqMinThd_C VehCoorn_vStandStillSwRst_C /end DEF_CHARACTERISTIC
 /begin IN_MEASUREMENT APP_r Brk_st ChrgMod_stChrgn ChrgMod_stMod ChrgPlg_stPlg Com_stChrgnSpstReq Com_stChrgnSpstReq_sq Com_stIgnkeyPos Com_stIgnkeyPos_Sq Com_stPrkBrk DcmDspUDS_bDCDCOpVoltFlg DcmDspUDS_bHvbusDchaFlg DrvDoor_bFault DrvDoor_bOpn DrvMod_stPosnEnhd Emac_nAct01 Emac_nAct01_Sq HvBatt_ratSoc MoFRelsMngt_flgPtActvMsg Reset_flgECURstOcc Reset_VehV_v SWAdp_flgChrgNmComReq T15_st T50_st VehCoorn_st VehV_v VehV_v_Sq /end IN_MEASUREMENT
 /begin OUT_MEASUREMENT DDRC_St.DFC_VehCoornDrvrNotPrsnt DFC_st.DFC_VehCoornDrvrNotPrsnt DINH_nrActvInhReas.FId_VehCoornHvReq DINH_nrActvInhReas.FId_VehCoornImobTrqInhbn DINH_stFId.FId_VehCoornHvReq DINH_stFId.FId_VehCoornImobTrqInhbn VehCoorn_flgChrgReq VehCoorn_flgDrvInhb VehCoorn_flgDrvReq VehCoorn_flgHVReq VehCoorn_flgRmtChrgReq VehCoorn_tiThdDebHvReq /end OUT_MEASUREMENT
 /begin LOC_MEASUREMENT VehCoorn_flgAllwChrgnT15Off VehCoorn_flgChrgPlg VehCoorn_flgChrgPlgDrvInhb VehCoorn_flgChrgrPlgChrgnInhb VehCoorn_flgDrvrInp VehCoorn_flgHvReqRst VehCoorn_flgHvReqSet VehCoorn_flgIgnOnWoCrk VehCoorn_flgIgnOnWoCrkTout VehCoorn_flgNoDrvrInp VehCoorn_flgT15Off VehCoorn_flgT15OnHvReqOffRst VehCoorn_flgT15OnHvReqOffSet VehCoorn_flgVehDrvChrgrPlgd VehCoorn_HvReqTOffD_I.XOld VehCoorn_HvReqTOffD_I.Timer VehCoorn_stChrgnReq VehCoorn_stRmtNoChrgn VehCoorn_StrtReqTOffD_I.XOld VehCoorn_StrtReqTOffD_I.Timer VehCoorn_tiNoDrvrInpTout /end LOC_MEASUREMENT
 FUNCTION_VERSION "1400.6.0" /end FUNCTION
/begin FUNCTION VehDrvEv_FilRef "160.6.0   Reference filter for electric vehicle" /begin DEF_CHARACTERISTIC VehDrvEv_tiRefFilCrp_C VehDrvEv_tiRefFil_C /end DEF_CHARACTERISTIC
 /begin IN_MEASUREMENT CoPOM_tqWhlQstyMax CoPOM_tqWhlQstyMin CoVMD_flgDrvDmdHiPrio VMDEv_tqDes /end IN_MEASUREMENT
 /begin OUT_MEASUREMENT VehDrvEv_tiRefFil VehDrvEv_tqDesLpFild /end OUT_MEASUREMENT
 FUNCTION_VERSION "160.6.0" /end FUNCTION
/begin FUNCTION VehDrvEv_FilZrCrsng "160.5.0   Torque zero crossing former"
 /begin DEF_CHARACTERISTIC VehDrvEv_facDsbcCtrlrGain01_CUR VehDrvEv_flgDsbcCtrlrOff01_C VehDrvEv_flgStrtUpCtrlEna_C VehDrvEv_stCfgASDrf_C VehDrvEv_tqDsbcCtrlrMax01_C VehDrvEv_tqGrdtMaxZrCrssCrp_M VehDrvEv_tqGrdtMaxZrCrssEco_M VehDrvEv_tqGrdtMaxZrCrssNegCrp_M VehDrvEv_tqGrdtMaxZrCrssNegEco_M VehDrvEv_tqGrdtMaxZrCrssNegSpt_M VehDrvEv_tqGrdtMaxZrCrssNeg_M VehDrvEv_tqGrdtMaxZrCrssSpt_M VehDrvEv_tqGrdtMaxZrCrss_M VehDrvEv_tqGrdtZrCrssDeltaNegEco_T VehDrvEv_tqGrdtZrCrssDeltaNegSpt_T VehDrvEv_tqGrdtZrCrssDeltaNeg_T VehDrvEv_tqGrdtZrCrssEco_T VehDrvEv_tqGrdtZrCrssLimEco_C VehDrvEv_tqGrdtZrCrssLimNegEco_C VehDrvEv_tqGrdtZrCrssLimNegSpt_C VehDrvEv_tqGrdtZrCrssLimNeg_C VehDrvEv_tqGrdtZrCrssLimSpt_C VehDrvEv_tqGrdtZrCrssLim_C VehDrvEv_tqGrdtZrCrssSpt_T VehDrvEv_tqGrdtZrCrss_T VehDrvEv_tqThresDsbcCtrlrOn01_C /end DEF_CHARACTERISTIC
 /begin IN_MEASUREMENT CoPOM_tqWhlQstyMax CoPOM_tqWhlQstyMin CoPTEv_stTqLimd01 CoVMD_flgDrvDmdHiPrio Emac_nAct01 MoFTqPtdVeh_stDrvProgReqMsg VehDrvEv_tqDesLpFild VehV_v /end IN_MEASUREMENT
 /begin OUT_MEASUREMENT VehDrvEv_facDsbcCtrlrGain01 VehDrvEv_stDsbcCtrlr01 VehDrvEv_tqCrssPerStepNeg VehDrvEv_tqCrssPerStepPos VehDrvEv_tqDsbcCtrlrMax01 VehDrvEv_tqThresDsbcCtrlrOn01 VehDrvEv_tqZrCrssFild /end OUT_MEASUREMENT
 /begin LOC_MEASUREMENT VehDrvEv_nAct01 VehDrvEv_tqDeltaZrCrss VehDrvEv_tqGrdtMaxZrCrss VehDrvEv_tqGrdtMaxZrCrssDrvgMod VehDrvEv_tqGrdtMaxZrCrssNeg VehDrvEv_tqGrdtMaxZrCrssNegDrvgMod VehDrvEv_tqGrdtReaTar VehDrvEv_tqGrdtReaTarNeg VehDrvEv_tqGrdtZrCrss VehDrvEv_tqGrdtZrCrssDeltaNeg VehDrvEv_tqGrdtZrCrssLimSlopeNeg VehDrvEv_tqGrdtZrCrssLimSlopePos VehDrvEv_tqGrdtZrCrssNeg VehDrvEv_tqGrdtZrCrssPos VehDrvEv_tqNormZrCrssFild VehDrvEv_tqZrCrssFildRamp /end LOC_MEASUREMENT
 FUNCTION_VERSION "160.5.0" /end FUNCTION
/begin FUNCTION VehMotEv_TqDistbn "160.3.0   Torque distribution in an electric vehicle" /begin IN_MEASUREMENT VehDrvEv_tqZrCrssFild /end IN_MEASUREMENT /begin OUT_MEASUREMENT VehMotEv_tqPrimAxleFild /end OUT_MEASUREMENT FUNCTION_VERSION "160.3.0" /end FUNCTION
/begin FUNCTION VehMot_CalcTrqDrag "160.3.0   Vehicle Motion Drag Torque Calculation"
 /begin DEF_CHARACTERISTIC VehMot_mInrt_C VehMot_tiTrqDragMin_C VehMot_tiTrqDragPosSlop_C VehMot_tiTrqDragVx_CUR VehMot_tiTrqPrpPT1_C VehMot_trqDragMax_C VehMot_vMinDragEst_C /end DEF_CHARACTERISTIC
 /begin IN_MEASUREMENT Brk_st CoPOM_tqWhlQstyMax CoVMD_tqWhlMinDrvrAssc GlbDa_lWhlCirc PT_tqWhlAct VehV_a VehV_v VMDEv_tqDes /end IN_MEASUREMENT
 /begin OUT_MEASUREMENT VehMot_a2trq VehMot_aPrpCurr VehMot_aPrpMax VehMot_aPrpMin VehMot_trqDrag /end OUT_MEASUREMENT
 /begin LOC_MEASUREMENT VehMot_tiTrqDragPT1 VehMot_tiTrqDragVx VehMot_tqDragEst VehMot_trqDragEstWoLimn VehMot_trqPrpFlt /end LOC_MEASUREMENT
 FUNCTION_VERSION "160.3.0" /end FUNCTION
/begin FUNCTION VehMot_RecupTqLim "160.1.0   Calculation of Recuperation Torque Limits"
 /begin DEF_CHARACTERISTIC VehMot_nDifRecupTqLimPrimAxle_T VehMot_nLowrBndyRecupTqLimPrimAxle_T VehMot_tidNAct01Fil_C VehMot_tiNAct01RecupFilDwn_C VehMot_tiNAct01RecupFilUp_C VehMot_tqMinPtdPrimAxle_C /end DEF_CHARACTERISTIC
 /begin IN_MEASUREMENT ComEmac_nAct01 ElM_flgEnaFrbdnQdrLockgOddAxles TrsmEmac_ratTqPrimAxle /end IN_MEASUREMENT
 /begin OUT_MEASUREMENT VehMot_tqWhlRecupLimPrimAxle /end OUT_MEASUREMENT
 /begin LOC_MEASUREMENT VehMot_dNAct01 VehMot_dNAct01Raw VehMot_facRecupTqLimPrimAxle VehMot_nAct01AbsltPrevCyc VehMot_nActFildPrimAxle VehMot_nDifRecupTqLimPrimAxle VehMot_nLowrBndyRecupTqLimPrimAxle /end LOC_MEASUREMENT
 FUNCTION_VERSION "160.1.0" /end FUNCTION
/begin FUNCTION VehV_DDEm "1.2.0     Vehicle speed device driver with source as electrical machine rpm" /begin DEF_CHARACTERISTIC VehV_maskEmNActPhy01Sq_C VehV_swtEmSeln_C /end DEF_CHARACTERISTIC
 /begin IN_MEASUREMENT Emac_nActPhy01 Emac_nActPhy01_Sq GlbDa_lWhlCirc TrsmEmac_ratTqPrimAxle /end IN_MEASUREMENT
 /begin OUT_MEASUREMENT DINH_nrActvInhReas.FId_VehVNActPhy01Dfct DINH_stFId.FId_VehVNActPhy01Dfct VehV_vEm VehV_vEmPrimAxle VehV_vEmPrimAxle_Sq VehV_vEm_Sq /end OUT_MEASUREMENT
 /begin LOC_MEASUREMENT VehV_flgEm01Actv VehV_vEm01 /end LOC_MEASUREMENT
 FUNCTION_VERSION "1.2.0" /end FUNCTION
/begin FUNCTION VehV_VD "1400.0.0  Vehicle Speed - Virtual Device"
 /begin DEF_CHARACTERISTIC DFC_CtlMsk2.DFC_VehVObd_C DFC_DisblMsk2.DFC_VehVObd_C VehV_maskFrzValSq_C VehV_maskReplcmtValSq_C VehV_tiVPT1_C VehV_vDfl_C VehV_vMin_C /end DEF_CHARACTERISTIC
 /begin IN_MEASUREMENT VehV_vSens VehV_vSens_Sq /end IN_MEASUREMENT
 /begin OUT_MEASUREMENT DFC_st.DFC_VehVObd DINH_nrActvInhReas.FId_VehVFrzVal DINH_nrActvInhReas.FId_VehVReplVal DINH_stFId.FId_VehVFrzVal DINH_stFId.FId_VehVReplVal VehV_v VehV_vSign VehV_v_Sq /end OUT_MEASUREMENT
 /begin LOC_MEASUREMENT VehV_flgStandStillActv VehV_vFlt VehV_vUnFlt /end LOC_MEASUREMENT
 FUNCTION_VERSION "1400.0.0" /end FUNCTION
/begin FUNCTION VehV_VdA "1.2.0     Virtual device for vehicle speed - calculation of vehicle acceleration"
 /begin DEF_CHARACTERISTIC VehV_aDft_C VehV_flgSwtVSensAbsltEna_C VehV_maskVehAFrzSq_C VehV_maskVehAReplcmtSq_C VehV_tiAPT1_C VehV_tiVAPT1_C VehV_vAMinThd_C /end DEF_CHARACTERISTIC
 /begin IN_MEASUREMENT VehV_vSens VehV_v_Sq /end IN_MEASUREMENT
 /begin OUT_MEASUREMENT VehV_a VehV_aSens VehV_a_Sq /end OUT_MEASUREMENT
 /begin LOC_MEASUREMENT VehV_aFild VehV_vAFlt /end LOC_MEASUREMENT
 FUNCTION_VERSION "1.2.0" /end FUNCTION
/begin FUNCTION VehV_VdAcqn "1400.0.0  Vehicle speed sensor acquisition"
 /begin DEF_CHARACTERISTIC DDRC_DurDeb.VehV_tiPhysRngHiDebOk_C DDRC_DurDeb.VehV_tiPhysRngHiDebDef_C DDRC_DurDeb.VehV_tiPhysRngLoDebOk_C DDRC_DurDeb.VehV_tiPhysRngLoDebDef_C DDRC_DurDeb.VehV_tiSigCanDebOk_C DDRC_DurDeb.VehV_tiSigCanDebDef_C DDRC_DurDeb.VehV_tiSigCanSafeDebOk_C DDRC_DurDeb.VehV_tiSigCanSafeDebDef_C DDRC_RatDeb.VehV_tiPhysRngHiUDRat_C DDRC_RatDeb.VehV_tiPhysRngLoUDRat_C DDRC_RatDeb.VehV_tiSigCanUDRat_C DDRC_RatDeb.VehV_tiSigCanSafeUDRat_C DFC_CtlMsk2.DFC_VehVPhysRngHi_C DFC_CtlMsk2.DFC_VehVPhysRngLo_C DFC_CtlMsk2.DFC_VehVSigCan_C DFC_CtlMsk2.DFC_VehVSigCanSafe_C DFC_DisblMsk2.DFC_VehVPhysRngHi_C DFC_DisblMsk2.DFC_VehVPhysRngLo_C DFC_DisblMsk2.DFC_VehVSigCan_C DFC_DisblMsk2.DFC_VehVSigCanSafe_C VehV_flgEmSpdBasdSignEvlnActv_C VehV_flgFwdMntdMot_C VehV_maskObdFrzValSq_C VehV_maskObdReplcmtValSq_C VehV_maskPhyRngSq_C VehV_swtSigSafe_C VehV_swtSigStd_C VehV_vDflOBD_C VehV_vPhysRngMax_C VehV_vPhysRngMin_C /end DEF_CHARACTERISTIC
 /begin IN_MEASUREMENT Com_vVeh Emac_nActPhy01 Emac_nActPhy01_Sq VehV_vEm VehV_vEmPrimAxle VehV_vEmPrimAxle_Sq VehV_vEm_Sq /end IN_MEASUREMENT
 /begin OUT_MEASUREMENT DDRC_St.DFC_VehVPhysRngHi DDRC_St.DFC_VehVPhysRngLo DDRC_St.DFC_VehVSigCan DDRC_St.DFC_VehVSigCanSafe DFC_st.DFC_VehVPhysRngHi DFC_st.DFC_VehVPhysRngLo DFC_st.DFC_VehVSigCan DFC_st.DFC_VehVSigCanSafe DINH_nrActvInhReas.FId_VehVCANFrzVal DINH_nrActvInhReas.FId_VehVCANReplVal DINH_nrActvInhReas.FId_VehVCanSafeFrzVal DINH_nrActvInhReas.FId_VehVCanSafeReplVal DINH_nrActvInhReas.FId_VehVSigCan DINH_nrActvInhReas.FId_VehVSigCanSafe DINH_stFId.FId_VehVCANFrzVal DINH_stFId.FId_VehVCANReplVal DINH_stFId.FId_VehVCanSafeFrzVal DINH_stFId.FId_VehVCanSafeReplVal DINH_stFId.FId_VehVSigCan DINH_stFId.FId_VehVSigCanSafe VehV_stSigSrc VehV_vSens VehV_vSensOBD VehV_vSens_Sq /end OUT_MEASUREMENT
 /begin LOC_MEASUREMENT VehV_stQlySafe VehV_stQlyStd VehV_vSnsrSafe VehV_vSnsrStd /end LOC_MEASUREMENT
 FUNCTION_VERSION "1400.0.0" /end FUNCTION
/begin FUNCTION VMSIEv_PlausTqIntv "1400.0.0_1.1.0Electric vehicle motion stability intervention"
 /begin DEF_CHARACTERISTIC VMSIEv_dtqAbsIntvRmpNeg_C VMSIEv_dtqAbsIntvRmpPos_C VMSIEv_dtqDCSDesAbortRamp01_C VMSIEv_dtqTCSDesAbortRamp01_C /end DEF_CHARACTERISTIC
 /begin IN_MEASUREMENT CoPTEv_stTqLimd01 MoFEscAssc_flgEscDCSPtd01Msg MoFEscAssc_flgEscTCSPtd01Msg PT_tqDesEmac01 StabyIntv_flgAbsIntv01 StabyIntv_flgDCSIntv01 StabyIntv_flgTCSIntv01 StabyIntv_tqDCSDes01 StabyIntv_tqTCSDes01 TrsmEmac_ratTqPrimAxle TrsmEmac_tqLoss01 /end IN_MEASUREMENT
 /begin OUT_MEASUREMENT DINH_nrActvInhReas.FId_VMSIEvDCSRampShOff01 DINH_nrActvInhReas.FId_VMSIEvDCSShOff01 DINH_nrActvInhReas.FId_VMSIEvTCSRampShOff01 DINH_nrActvInhReas.FId_VMSIEvTCSShOff01 DINH_nrActvInhReas.FId_VMSIEvTVRampShOff01 DINH_nrActvInhReas.FId_VMSIEvTVShOff01 DINH_stFId.FId_VMSIEvDCSRampShOff01 DINH_stFId.FId_VMSIEvDCSShOff01 DINH_stFId.FId_VMSIEvTCSRampShOff01 DINH_stFId.FId_VMSIEvTCSShOff01 DINH_stFId.FId_VMSIEvTVRampShOff01 DINH_stFId.FId_VMSIEvTVShOff01 VMSIEv_tqDesMax01 VMSIEv_tqDesMin01 VMSIEv_tqTqVectg01 /end OUT_MEASUREMENT
 /begin LOC_MEASUREMENT VMSIEv_flgAbsIntv01RmpInin VMSIEv_flgDcsIntv01 VMSIEv_flgTcsIntv01 VMSIEv_tqDcsIntv01 VMSIEv_tqDesAbsIntv01 VMSIEv_tqDesAbsIntv01Cnv VMSIEv_tqDesAbsIntv01Em VMSIEv_tqDesDCSIntv01 VMSIEv_tqDesWithAllIntv VMSIEv_tqTcsIntv01 VMSIEv_tqTCSRampOutp01 /end LOC_MEASUREMENT
 FUNCTION_VERSION "1400.0.0_1.1.0" /end FUNCTION
/begin FUNCTION WtrPmp1_Ctrl "8.4.0     Water Pump 1"
 /begin DEF_CHARACTERISTIC WtrPmp1_mfCoolgReqMin_C WtrPmp1_mfCooltFlowReq_T WtrPmp1_mfCooltMTSp_T WtrPmp1_mfDesMax_C WtrPmp1_pLossMedT_M /end DEF_CHARACTERISTIC
 /begin IN_MEASUREMENT ThermCfg_ratMTPmpReq ThermCoorn_stCtrl ThermCoorn_stMTPmp ThermLvl_dTMTCooltSp ThermLvl_tMedTCircRadDs /end IN_MEASUREMENT
 /begin OUT_MEASUREMENT DINH_nrActvInhReas.FId_WtrPmp1Err DINH_stFId.FId_WtrPmp1Err WtrPmp1_mfDesMedT WtrPmp1_pLossMedT /end OUT_MEASUREMENT
 /begin LOC_MEASUREMENT WtrPmp1_mfCoolgReq /end LOC_MEASUREMENT
 FUNCTION_VERSION "8.4.0" /end FUNCTION
/begin FUNCTION XcpAppl "302.7.1   XCP Calibration Protocol Applikation" FUNCTION_VERSION "302.7.1" /end FUNCTION
/*********** End of merged COMPU_METHOD blocks ***********/
/begin COMPU_METHOD Acc "" RAT_FUNC "%6.5" "m/s^2" COEFFS 0 1000 0 0 0 1 /end COMPU_METHOD
/begin COMPU_METHOD B_TRUE "" TAB_VERB "%6.3" "" COMPU_TAB_REF B_TRUE /end COMPU_METHOD
/begin COMPU_VTAB B_TRUE "" TAB_VERB 2 0 "FALSE" 1 "TRUE" /end COMPU_VTAB
/begin COMPU_METHOD DDRCTime_ms "" RAT_FUNC "%6.1" "ms" COEFFS 0 1 0 0 0 10 /end COMPU_METHOD
/begin COMPU_METHOD DDRC_Ratio "" TAB_VERB "%6.3" "-" COMPU_TAB_REF DDRC_Ratio /end COMPU_METHOD
/begin COMPU_VTAB DDRC_Ratio "" TAB_VERB 4 1 "Ratio1" 2 "Ratio2" 3 "Ratio3" 4 "Ratio4" /end COMPU_VTAB
/begin COMPU_METHOD dez "" RAT_FUNC "%6.2" "" COEFFS 0 1 0 0 0 1 /end COMPU_METHOD
/begin COMPU_METHOD DFC_OneToOne "" RAT_FUNC "%6.2" "-" COEFFS 0 1 0 0 0 1 /end COMPU_METHOD
/begin COMPU_METHOD DFES_OneToOne "" RAT_FUNC "%6.2" "-" COEFFS 0 1 0 0 0 1 /end COMPU_METHOD
/begin COMPU_METHOD DINH_ct_Compu "" RAT_FUNC "%6.0" "" COEFFS 0 -1 4096 0 0 1 /end COMPU_METHOD
/begin COMPU_METHOD EngNGrd "" RAT_FUNC "%6.3" "rpm/s" COEFFS 0 2 0 0 0 1 /end COMPU_METHOD
/begin COMPU_METHOD Fact "" RAT_FUNC "%6.5" "-" COEFFS 0 8192 0 0 0 1 /end COMPU_METHOD
/begin COMPU_METHOD Mass "" RAT_FUNC "%6.2" "-" COEFFS 0 1 0 0 0 1 /end COMPU_METHOD
/begin COMPU_METHOD MassLength "" RAT_FUNC "%6.3" "" COEFFS 0 5 0 0 0 1 /end COMPU_METHOD
/begin COMPU_METHOD nmot_q1 "" RAT_FUNC "%6.2" "1/min" COEFFS 0 1 0 0 0 1 /end COMPU_METHOD
/begin COMPU_METHOD OneToOne "" RAT_FUNC "%6.2" "-" COEFFS 0 1 0 0 0 1 /end COMPU_METHOD
/begin COMPU_METHOD Prc "" RAT_FUNC "%6.4" "%" COEFFS 0 81.92 0 0 0 1 /end COMPU_METHOD
/begin COMPU_METHOD q1 "" RAT_FUNC "%6.2" "-" COEFFS 0 1 0 0 0 1 /end COMPU_METHOD
/begin COMPU_METHOD q1p220703Em4_kg_DIV_s "" RAT_FUNC "%6.5" "kg/s" COEFFS 0 10000000000000 0 0 0 1220703125 /end COMPU_METHOD
/begin COMPU_METHOD RBPtCel_Perc_1p0_1 "" RAT_FUNC "%6.2" "%" COEFFS 0 1 0 0 0 1 /end COMPU_METHOD
/begin COMPU_METHOD RBPtCel_p_0p1_4 "" RAT_FUNC "%6.3" "hPa" COEFFS 0 10 0 0 0 1 /end COMPU_METHOD
/begin COMPU_METHOD RBPtCel_ti_1p0_4 "" RAT_FUNC "%6.2" "min" COEFFS 0 1 0 0 0 1 /end COMPU_METHOD
/begin COMPU_METHOD RBPtCel_t_0p1om273p14_1 "" RAT_FUNC "%6.1" "Deg C" COEFFS 0 10 2731.4 0 0 1 /end COMPU_METHOD
/begin COMPU_METHOD RBPtCel_t_0p1_1 "" RAT_FUNC "%6.3" "K" COEFFS 0 10 0 0 0 1 /end COMPU_METHOD
/begin COMPU_METHOD RmpTrq "" RAT_FUNC "%6.4" "Nm/s" COEFFS 0 655.36 0 0 0 1 /end COMPU_METHOD
/begin COMPU_METHOD RmpTrqPrpHigh "" RAT_FUNC "%6.4" "Nm/s" COEFFS 0 655.36 0 0 0 1 /end COMPU_METHOD
/begin COMPU_METHOD SigQly_COMPU_VERB "" TAB_VERB "%6.3" "" COMPU_TAB_REF SigQly_COMPU_VERB /end COMPU_METHOD
/begin COMPU_VTAB SigQly_COMPU_VERB "" TAB_VERB 16 0 "SIGQLY_NOTCALC" 1 "SIGQLY_INIT" 2 "SIGQLY_OK" 3 "SIGQLY_MODEL" 4 "SIGQLY_REPLACEMENT" 5 "SIGQLY_FROZEN" 6 "SIGQLY_INVALID" 7 "SIGQLY_RESERVED_7" 8 "SIGQLY_RESERVED_8" 9 "SIGQLY_RESERVED_9" 10 "SIGQLY_RESERVED_10" 11 "SIGQLY_RESERVED_11" 12 "SIGQLY_RESERVED_12" 13 "SIGQLY_RESERVED_13" 14 "SIGQLY_RESERVED_14" 15 "SIGQLY_RESERVED_15" /end COMPU_VTAB
/begin COMPU_METHOD TimeDelay_s "" RAT_FUNC "%6.1" "s" COEFFS 0 0 1 0 0.00023283064365387 0 /end COMPU_METHOD
/begin COMPU_METHOD Time_1s "" RAT_FUNC "%6.2" "s" COEFFS 0 1 0 0 0 1 /end COMPU_METHOD
/begin COMPU_METHOD Time_s "" RAT_FUNC "%6.4" "s" COEFFS 0 100 0 0 0 1 /end COMPU_METHOD
/begin COMPU_METHOD TransR "" RAT_FUNC "%6.4" "-" COEFFS 0 100 0 0 0 1 /end COMPU_METHOD
/begin COMPU_METHOD Trq "" RAT_FUNC "%6.3" "Nm" COEFFS 0 10 0 0 0 1 /end COMPU_METHOD
/begin COMPU_METHOD TrqPrp "" RAT_FUNC "%6.2" "Nm" COEFFS 0 0.625 0 0 0 1 /end COMPU_METHOD
/begin COMPU_METHOD TrqPrpHigh "" RAT_FUNC "%6.3" "Nm" COEFFS 0 10 0 0 0 1 /end COMPU_METHOD
/begin COMPU_METHOD Vel "" RAT_FUNC "%6.4" "km/h" COEFFS 0 100 0 0 0 1 /end COMPU_METHOD
/begin COMPU_METHOD WHRCOOLTPDIF_TYPAVL_SC_Compu "" TAB_VERB "%6.3" "" COMPU_TAB_REF WHRCOOLTPDIF_TYPAVL_SC_Compu /end COMPU_METHOD
/begin COMPU_VTAB WHRCOOLTPDIF_TYPAVL_SC_Compu "" TAB_VERB 2 0 "False" 1 "True" /end COMPU_VTAB
/begin COMPU_METHOD wink_q0p03125_deg "" RAT_FUNC "%6.4" "deg" COEFFS 0 32 0 0 0 1 /end COMPU_METHOD
/begin COMPU_METHOD WIPRIFTYP_SC_Compu "" TAB_VERB "%6.3" "" COMPU_TAB_REF WIPRIFTYP_SC_Compu /end COMPU_METHOD
/begin COMPU_VTAB WIPRIFTYP_SC_Compu "" TAB_VERB 5 0 "WIPRIFTYP_NON" 1 "WIPRIFTYP_DIG" 2 "WIPRIFTYP_ADC" 3 "WIPRIFTYP_MISC" 4 "WIPRIFTYP_BUS" /end COMPU_VTAB
/begin COMPU_METHOD WTRCACT_TYPAVL_SC_Compu "" TAB_VERB "%6.3" "" COMPU_TAB_REF WTRCACT_TYPAVL_SC_Compu /end COMPU_METHOD
/begin COMPU_VTAB WTRCACT_TYPAVL_SC_Compu "" TAB_VERB 2 0 "False" 1 "True" /end COMPU_VTAB
/begin COMPU_METHOD WTRCOOLTP1_TYPAVL_SY_Compu "" TAB_VERB "%6.3" "" COMPU_TAB_REF WTRCOOLTP1_TYPAVL_SY_Compu /end COMPU_METHOD
/begin COMPU_VTAB WTRCOOLTP1_TYPAVL_SY_Compu "" TAB_VERB 2 0 "False" 1 "True" /end COMPU_VTAB
/begin COMPU_METHOD WTRCOOLTP_TYPAVL_SY_Compu "" TAB_VERB "%6.3" "" COMPU_TAB_REF WTRCOOLTP_TYPAVL_SY_Compu /end COMPU_METHOD
/begin COMPU_VTAB WTRCOOLTP_TYPAVL_SY_Compu "" TAB_VERB 2 0 "False" 1 "True" /end COMPU_VTAB
/begin COMPU_METHOD XCORECDD_SC_Compu "" TAB_VERB "%6.3" "" COMPU_TAB_REF XCORECDD_SC_Compu /end COMPU_METHOD
/begin COMPU_VTAB XCORECDD_SC_Compu "" TAB_VERB 2 0 "False" 1 "True" /end COMPU_VTAB
/begin COMPU_METHOD XCPVERS_SC_Compu "" TAB_VERB "%6.3" "" COMPU_TAB_REF XCPVERS_SC_Compu /end COMPU_METHOD
/begin COMPU_VTAB XCPVERS_SC_Compu "" TAB_VERB 5 1 "XCP_1_0" 2 "XCP_1_1" 3 "XCP_1_2" 4 "XCP_1_3" 5 "XCP_1_4" /end COMPU_VTAB
/begin COMPU_METHOD XCP_SY_Compu "" TAB_VERB "%6.3" "" COMPU_TAB_REF XCP_SY_Compu /end COMPU_METHOD
/begin COMPU_VTAB XCP_SY_Compu "" TAB_VERB 2 0 "No XCP" 1 "XCP" /end COMPU_VTAB
/begin COMPU_METHOD XDI_SC_Compu "" TAB_VERB "%6.3" "" COMPU_TAB_REF XDI_SC_Compu /end COMPU_METHOD
/begin COMPU_VTAB XDI_SC_Compu "" TAB_VERB 2 0 "False" 1 "True" /end COMPU_VTAB
/begin COMPU_METHOD zk10msxs_uw_b655p36 "" RAT_FUNC "%6.2" "s" COEFFS 0 0 65536 0 100 0 /end COMPU_METHOD
/begin RECORD_LAYOUT RB_Curve_S16_S16 NO_AXIS_PTS_X 1 SWORD AXIS_PTS_X 2 SWORD INDEX_INCR DIRECT FNC_VALUES 3 SWORD COLUMN_DIR DIRECT /end RECORD_LAYOUT
/begin RECORD_LAYOUT RB_Curve_S8_S16_sao NO_AXIS_PTS_X 1 SBYTE AXIS_PTS_X 2 SBYTE INDEX_INCR DIRECT FNC_VALUES 3 SWORD COLUMN_DIR DIRECT STATIC_ADDRESS_OFFSETS /end RECORD_LAYOUT
/begin RECORD_LAYOUT RB_Map_S16S16_S16 NO_AXIS_PTS_X 1 SWORD NO_AXIS_PTS_Y 2 SWORD AXIS_PTS_X 3 SWORD INDEX_INCR DIRECT AXIS_PTS_Y 4 SWORD INDEX_INCR DIRECT FNC_VALUES 5 SWORD COLUMN_DIR DIRECT /end RECORD_LAYOUT
/begin RECORD_LAYOUT RB_Val_Wboolean FNC_VALUES 1 UBYTE COLUMN_DIR DIRECT /end RECORD_LAYOUT
/begin RECORD_LAYOUT RB_Val_Ws16 FNC_VALUES 1 SWORD COLUMN_DIR DIRECT /end RECORD_LAYOUT
/begin RECORD_LAYOUT RB_Val_Ws32 FNC_VALUES 1 SLONG COLUMN_DIR DIRECT /end RECORD_LAYOUT
/begin RECORD_LAYOUT RB_Val_Wu16 FNC_VALUES 1 UWORD COLUMN_DIR DIRECT /end RECORD_LAYOUT
/begin RECORD_LAYOUT RB_Val_Wu8 FNC_VALUES 1 UBYTE COLUMN_DIR DIRECT /end RECORD_LAYOUT
/begin RECORD_LAYOUT Val_Wu16 FNC_VALUES 1 UWORD COLUMN_DIR DIRECT /end RECORD_LAYOUT
/begin RECORD_LAYOUT Val_Wu8 FNC_VALUES 1 UBYTE COLUMN_DIR DIRECT /end RECORD_LAYOUT
/begin UNIT AUTOSAR_CanIf_Units_NoUnit "No Unit" "noUnit" EXTENDED_SI SI_EXPONENTS 0 0 0 0 0 0 0 /end UNIT
/begin UNIT AUTOSAR_ComM_Units_NoUnit "No Unit" "noUnit" EXTENDED_SI SI_EXPONENTS 0 0 0 0 0 0 0 /end UNIT
/begin UNIT AUTOSAR_Fee_Units_Fee_NoUnit "Fee No Unit" "Fee_NoUnit" EXTENDED_SI SI_EXPONENTS 0 0 0 0 0 0 0 /end UNIT
/begin UNIT AUTOSAR_LinIf_Units_NoUnit "No Unit" "noUnit" EXTENDED_SI SI_EXPONENTS 0 0 0 0 0 0 0 /end UNIT
/begin UNIT AUTOSAR_PduR_Units_NoUnit "No Unit" "noUnit" EXTENDED_SI SI_EXPONENTS 0 0 0 0 0 0 0 /end UNIT
/begin UNIT Mcan_Can_Units_NoUnit "No Unit" "noUnit" EXTENDED_SI SI_EXPONENTS 0 0 0 0 0 0 0 /end UNIT
/begin UNIT RB_RBA_rba_BypDrv_Units_NoUnit "No Unit" "noUnit" EXTENDED_SI SI_EXPONENTS 0 0 0 0 0 0 0 /end UNIT
/begin UNIT RB_RBA_rba_Dme_Units_NoUnit "" "noUnit" EXTENDED_SI SI_EXPONENTS 0 0 0 0 0 0 0 /end UNIT
/begin UNIT RB_RBA_rba_Etks_Units_NoUnit "No Unit" "noUnit" EXTENDED_SI SI_EXPONENTS 0 0 0 0 0 0 0 /end UNIT
/begin UNIT RB_RBA_rba_IoExtLib_Units_NoUnit "No Unit" "noUnit" EXTENDED_SI SI_EXPONENTS 0 0 0 0 0 0 0 /end UNIT
/begin UNIT RB_RBA_rba_OsShell_Units_NoUnit "No Unit" "noUnit" EXTENDED_SI SI_EXPONENTS 0 0 0 0 0 0 0 /end UNIT
/begin UNIT RB_RBA_rba_SvbbDrv_Units_NoUnit "No Unit" "noUnit" EXTENDED_SI SI_EXPONENTS 0 0 0 0 0 0 0 /end UNIT
/end MODULE
/end PROJECT

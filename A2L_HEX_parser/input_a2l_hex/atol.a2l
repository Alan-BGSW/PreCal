ASAP2_VERSION 1 70
/begin PROJECT MDG1C "VC1CP091_STLA_N_D061I3"
/begin HEADER "" VERSION "VC1CP091_STLA_N_D061I3" PROJECT_NO MDG1C /end HEADER
/begin MODULE DIM ""
/begin MOD_COMMON "" BYTE_ORDER MSB_LAST ALIGNMENT_BYTE 1 ALIGNMENT_WORD 2 ALIGNMENT_LONG 4 ALIGNMENT_INT64 4 ALIGNMENT_FLOAT32_IEEE 4 ALIGNMENT_FLOAT64_IEEE 4 DATA_SIZE 32 /end MOD_COMMON
/begin CHARACTERISTIC DINH_FId.DFC_ACCmprFltLvlRes_CA "" VAL_BLK 0x80241AFE ValA_Wu16 1139.00000000 DINH_FIdVerb 0.00 1139.00000000 FORMAT "%13.8" MATRIX_DIM 13 /end CHARACTERISTIC
/begin CHARACTERISTIC DINH_FId.DFC_AbgHiSigFlt_CA "" VAL_BLK 0x80241B18 ValA_Wu16 1139.00000000 DINH_FIdVerb 0.00 1139.00000000 FORMAT "%13.8" MATRIX_DIM 17 /end CHARACTERISTIC
/begin CHARACTERISTIC DINH_FId.DFC_AbgIntPatFlt_CA "" VAL_BLK 0x80241B3A ValA_Wu16 1139.00000000 DINH_FIdVerb 0.00 1139.00000000 FORMAT "%13.8" MATRIX_DIM 16 /end CHARACTERISTIC
/begin CHARACTERISTIC DINH_FId.DFC_AbgLoSigFlt_CA "" VAL_BLK 0x80241B5A ValA_Wu16 1139.00000000 DINH_FIdVerb 0.00 1139.00000000 FORMAT "%13.8" MATRIX_DIM 17 /end CHARACTERISTIC
/begin CHARACTERISTIC DINH_FId.DFC_AbgUnkwnErrSigFlt_CA "" VAL_BLK 0x80241B7C ValA_Wu16 1139.00000000 DINH_FIdVerb 0.00 1139.00000000 FORMAT "%13.8" MATRIX_DIM 16 /end CHARACTERISTIC
/begin CHARACTERISTIC DINH_FId.DFC_AcExtChrgrIBattExcdd_CA "" VAL_BLK 0x80241B9C ValA_Wu16 1139.00000000 DINH_FIdVerb 0.00 1139.00000000 FORMAT "%13.8" MATRIX_DIM 13 /end CHARACTERISTIC
/begin CHARACTERISTIC DINH_FId.DFC_AcExtChrgrIInExcdd_CA "" VAL_BLK 0x80241BB6 ValA_Wu16 1139.00000000 DINH_FIdVerb 0.00 1139.00000000 FORMAT "%13.8" MATRIX_DIM 13 /end CHARACTERISTIC
/begin CHARACTERISTIC DINH_FId.DFC_AcExtChrgrIOutDe_CA "" VAL_BLK 0x80241BD0 ValA_Wu16 1139.00000000 DINH_FIdVerb 0.00 1139.00000000 FORMAT "%13.8" MATRIX_DIM 13 /end CHARACTERISTIC
/begin CHARACTERISTIC DINH_FId.DFC_AcExtChrgrIOutExcdd_CA "" VAL_BLK 0x80241BEA ValA_Wu16 1139.00000000 DINH_FIdVerb 0.00 1139.00000000 FORMAT "%13.8" MATRIX_DIM 13 /end CHARACTERISTIC
/begin CHARACTERISTIC DINH_FId.DFC_AcExtChrgrUOutDe_CA "" VAL_BLK 0x80241C04 ValA_Wu16 1139.00000000 DINH_FIdVerb 0.00 1139.00000000 FORMAT "%13.8" MATRIX_DIM 13 /end CHARACTERISTIC
/begin CHARACTERISTIC DINH_FId.DFC_AdpActvDChaFailr_CA "" VAL_BLK 0x80241C1E ValA_Wu16 1139.00000000 DINH_FIdVerb 0.00 1139.00000000 FORMAT "%13.8" MATRIX_DIM 13 /end CHARACTERISTIC
/begin CHARACTERISTIC DINH_FId.DFC_AirbcuFlt_CA "" VAL_BLK 0x80241C38 ValA_Wu16 1139.00000000 DINH_FIdVerb 0.00 1139.00000000 FORMAT "%13.8" MATRIX_DIM 13 /end CHARACTERISTIC
/begin CHARACTERISTIC DINH_FId.DFC_Airbg_CA "" VAL_BLK 0x80241C52 ValA_Wu16 1139.00000000 DINH_FIdVerb 0.00 1139.00000000 FORMAT "%13.8" MATRIX_DIM 13 /end CHARACTERISTIC
/begin CHARACTERISTIC DINH_FId.DFC_AirbgCan_CA "" VAL_BLK 0x80241C6C ValA_Wu16 1139.00000000 DINH_FIdVerb 0.00 1139.00000000 FORMAT "%13.8" MATRIX_DIM 13 /end CHARACTERISTIC
/begin CHARACTERISTIC DINH_FId.DFC_AirbgCanHWPlaus_CA "" VAL_BLK 0x80241C86 ValA_Wu16 1139.00000000 DINH_FIdVerb 0.00 1139.00000000 FORMAT "%13.8" MATRIX_DIM 13 /end CHARACTERISTIC
/begin CHARACTERISTIC DINH_FId.DFC_AirbgHWCanPlaus_CA "" VAL_BLK 0x80241CA0 ValA_Wu16 1139.00000000 DINH_FIdVerb 0.00 1139.00000000 FORMAT "%13.8" MATRIX_DIM 13 /end CHARACTERISTIC
/begin CHARACTERISTIC DINH_FId.DFC_AirbgMnr_CA "" VAL_BLK 0x80241CBA ValA_Wu16 1139.00000000 DINH_FIdVerb 0.00 1139.00000000 FORMAT "%13.8" MATRIX_DIM 13 /end CHARACTERISTIC
/begin CHARACTERISTIC DINH_FId.DFC_AirbgPerHi_CA "" VAL_BLK 0x80241CD4 ValA_Wu16 1139.00000000 DINH_FIdVerb 0.00 1139.00000000 FORMAT "%13.8" MATRIX_DIM 16 /end CHARACTERISTIC
/begin CHARACTERISTIC DINH_FId.DFC_AirbgPerdRngFlt_CA "" VAL_BLK 0x80241CF4 ValA_Wu16 1139.00000000 DINH_FIdVerb 0.00 1139.00000000 FORMAT "%13.8" MATRIX_DIM 16 /end CHARACTERISTIC
/begin CHARACTERISTIC DINH_FId.DFC_BlowrRlyErr_CA "" VAL_BLK 0x80241D14 ValA_Wu16 1139.00000000 DINH_FIdVerb 0.00 1139.00000000 FORMAT "%13.8" MATRIX_DIM 13 /end CHARACTERISTIC
/begin CHARACTERISTIC DINH_FId.DFC_BrkBstPmpActtnDfct_CA "" VAL_BLK 0x80241D2E ValA_Wu16 1139.00000000 DINH_FIdVerb 0.00 1139.00000000 FORMAT "%13.8" MATRIX_DIM 14 /end CHARACTERISTIC
/begin CHARACTERISTIC DINH_FId.DFC_BrkBstPmpDeactvnDfct_CA "" VAL_BLK 0x80241D4A ValA_Wu16 1139.00000000 DINH_FIdVerb 0.00 1139.00000000 FORMAT "%13.8" MATRIX_DIM 14 /end CHARACTERISTIC
/begin CHARACTERISTIC DINH_FId.DFC_BrkSwtFlt_CA "" VAL_BLK 0x80241D66 ValA_Wu16 1139.00000000 DINH_FIdVerb 0.00 1139.00000000 FORMAT "%13.8" MATRIX_DIM 13 /end CHARACTERISTIC
/begin CHARACTERISTIC DINH_FId.DFC_CbnHeatgHeatrHsScb_CA "" VAL_BLK 0x80241D80 ValA_Wu16 1139.00000000 DINH_FIdVerb 0.00 1139.00000000 FORMAT "%13.8" MATRIX_DIM 14 /end CHARACTERISTIC
/begin CHARACTERISTIC DINH_FId.DFC_CbnHeatgHeatrHsScg_CA "" VAL_BLK 0x80241D9C ValA_Wu16 1139.00000000 DINH_FIdVerb 0.00 1139.00000000 FORMAT "%13.8" MATRIX_DIM 14 /end CHARACTERISTIC
/begin CHARACTERISTIC DINH_FId.DFC_CbnHeatgHeatrLsOl_CA "" VAL_BLK 0x80241DB8 ValA_Wu16 1139.00000000 DINH_FIdVerb 0.00 1139.00000000 FORMAT "%13.8" MATRIX_DIM 14 /end CHARACTERISTIC
/begin CHARACTERISTIC DINH_FId.DFC_CbnHeatgHeatrLsScb_CA "" VAL_BLK 0x80241DD4 ValA_Wu16 1139.00000000 DINH_FIdVerb 0.00 1139.00000000 FORMAT "%13.8" MATRIX_DIM 14 /end CHARACTERISTIC
/begin CHARACTERISTIC DINH_FId.DFC_CbnHeatgHeatrLsScg_CA "" VAL_BLK 0x80241DF0 ValA_Wu16 1139.00000000 DINH_FIdVerb 0.00 1139.00000000 FORMAT "%13.8" MATRIX_DIM 14 /end CHARACTERISTIC
/begin CHARACTERISTIC DINH_FId.DFC_CbnHeatgHeatrUnUsed_CA "" VAL_BLK 0x80241E0C ValA_Wu16 1139.00000000 DINH_FIdVerb 0.00 1139.00000000 FORMAT "%13.8" MATRIX_DIM 13 /end CHARACTERISTIC
/begin CHARACTERISTIC DINH_FId.DFC_ChrgnCntctHsOt_CA "" VAL_BLK 0x80241E26 ValA_Wu16 1139.00000000 DINH_FIdVerb 0.00 1139.00000000 FORMAT "%13.8" MATRIX_DIM 13 /end CHARACTERISTIC
/begin CHARACTERISTIC DINH_FId.DFC_ChrgnCntctHsScb_CA "" VAL_BLK 0x80241E40 ValA_Wu16 1139.00000000 DINH_FIdVerb 0.00 1139.00000000 FORMAT "%13.8" MATRIX_DIM 13 /end CHARACTERISTIC
/begin CHARACTERISTIC DINH_FId.DFC_ChrgnCntctHsScg_CA "" VAL_BLK 0x80241E5A ValA_Wu16 1139.00000000 DINH_FIdVerb 0.00 1139.00000000 FORMAT "%13.8" MATRIX_DIM 13 /end CHARACTERISTIC
/begin CHARACTERISTIC DINH_FId.DFC_ChrgnCntctLsNegOl_CA "" VAL_BLK 0x80241E74 ValA_Wu16 1139.00000000 DINH_FIdVerb 0.00 1139.00000000 FORMAT "%13.8" MATRIX_DIM 13 /end CHARACTERISTIC
/begin CHARACTERISTIC DINH_FId.DFC_ChrgnCntctLsNegOt_CA "" VAL_BLK 0x80241E8E ValA_Wu16 1139.00000000 DINH_FIdVerb 0.00 1139.00000000 FORMAT "%13.8" MATRIX_DIM 13 /end CHARACTERISTIC
/begin CHARACTERISTIC DINH_FId.DFC_ChrgnCntctLsNegScb_CA "" VAL_BLK 0x80241EA8 ValA_Wu16 1139.00000000 DINH_FIdVerb 0.00 1139.00000000 FORMAT "%13.8" MATRIX_DIM 13 /end CHARACTERISTIC
/begin CHARACTERISTIC DINH_FId.DFC_ChrgnCntctLsNegScg_CA "" VAL_BLK 0x80241EC2 ValA_Wu16 1139.00000000 DINH_FIdVerb 0.00 1139.00000000 FORMAT "%13.8" MATRIX_DIM 13 /end CHARACTERISTIC
/begin CHARACTERISTIC DINH_FId.DFC_ChrgnCntctLsPosOl_CA "" VAL_BLK 0x80241EDC ValA_Wu16 1139.00000000 DINH_FIdVerb 0.00 1139.00000000 FORMAT "%13.8" MATRIX_DIM 13 /end CHARACTERISTIC
/begin CHARACTERISTIC DINH_FId.DFC_ChrgnCntctLsPosOt_CA "" VAL_BLK 0x80241EF6 ValA_Wu16 1139.00000000 DINH_FIdVerb 0.00 1139.00000000 FORMAT "%13.8" MATRIX_DIM 13 /end CHARACTERISTIC
/begin CHARACTERISTIC DINH_FId.DFC_ChrgnCntctLsPosScb_CA "" VAL_BLK 0x80241F10 ValA_Wu16 1139.00000000 DINH_FIdVerb 0.00 1139.00000000 FORMAT "%13.8" MATRIX_DIM 13 /end CHARACTERISTIC
/begin CHARACTERISTIC DINH_FId.DFC_ChrgnCntctLsPosScg_CA "" VAL_BLK 0x80241F2A ValA_Wu16 1139.00000000 DINH_FIdVerb 0.00 1139.00000000 FORMAT "%13.8" MATRIX_DIM 13 /end CHARACTERISTIC
/begin CHARACTERISTIC DINH_FId.DFC_ChrgnCntctUnUsed_CA "" VAL_BLK 0x80241F44 ValA_Wu16 1139.00000000 DINH_FIdVerb 0.00 1139.00000000 FORMAT "%13.8" MATRIX_DIM 13 /end CHARACTERISTIC
/begin CHARACTERISTIC DINH_FId.DFC_ComBrkMai_CA "" VAL_BLK 0x80241F5E ValA_Wu16 1139.00000000 DINH_FIdVerb 0.00 1139.00000000 FORMAT "%13.8" MATRIX_DIM 13 /end CHARACTERISTIC
/begin CHARACTERISTIC DINH_FId.DFC_ComChrgrEVCont_CA "" VAL_BLK 0x80241F78 ValA_Wu16 1139.00000000 DINH_FIdVerb 0.00 1139.00000000 FORMAT "%13.8" MATRIX_DIM 13 /end CHARACTERISTIC
/begin CHARACTERISTIC DINH_FId.DFC_ComChrgrEVtBlink_CA "" VAL_BLK 0x80241F92 ValA_Wu16 1139.00000000 DINH_FIdVerb 0.00 1139.00000000 FORMAT "%13.8" MATRIX_DIM 13 /end CHARACTERISTIC
/begin CHARACTERISTIC DINH_FId.DFC_ComChrgrMstBlink_CA "" VAL_BLK 0x80241FAC ValA_Wu16 1139.00000000 DINH_FIdVerb 0.00 1139.00000000 FORMAT "%13.8" MATRIX_DIM 13 /end CHARACTERISTIC
/begin CHARACTERISTIC DINH_FId.DFC_ComChrgrMstCont_CA "" VAL_BLK 0x80241FC6 ValA_Wu16 1139.00000000 DINH_FIdVerb 0.00 1139.00000000 FORMAT "%13.8" MATRIX_DIM 13 /end CHARACTERISTIC
/begin CHARACTERISTIC DINH_FId.DFC_ComChrgrSVSBlink_CA "" VAL_BLK 0x80241FE0 ValA_Wu16 1139.00000000 DINH_FIdVerb 0.00 1139.00000000 FORMAT "%13.8" MATRIX_DIM 13 /end CHARACTERISTIC
/begin CHARACTERISTIC DINH_FId.DFC_ComChrgrSVSCont_CA "" VAL_BLK 0x80241FFA ValA_Wu16 1139.00000000 DINH_FIdVerb 0.00 1139.00000000 FORMAT "%13.8" MATRIX_DIM 13 /end CHARACTERISTIC
/begin CHARACTERISTIC DINH_FId.DFC_ComDcdcEVBlink_CA "" VAL_BLK 0x80242014 ValA_Wu16 1139.00000000 DINH_FIdVerb 0.00 1139.00000000 FORMAT "%13.8" MATRIX_DIM 13 /end CHARACTERISTIC
/begin CHARACTERISTIC DINH_FId.DFC_ComDcdcEVCont_CA "" VAL_BLK 0x8024202E ValA_Wu16 1139.00000000 DINH_FIdVerb 0.00 1139.00000000 FORMAT "%13.8" MATRIX_DIM 13 /end CHARACTERISTIC
/begin CHARACTERISTIC DINH_FId.DFC_ComDcdcFltLvl2_CA "" VAL_BLK 0x80242048 ValA_Wu16 1139.00000000 DINH_FIdVerb 0.00 1139.00000000 FORMAT "%13.8" MATRIX_DIM 13 /end CHARACTERISTIC
/begin CHARACTERISTIC DINH_FId.DFC_ComDcdcFltLvl3_CA "" VAL_BLK 0x80242062 ValA_Wu16 1139.00000000 DINH_FIdVerb 0.00 1139.00000000 FORMAT "%13.8" MATRIX_DIM 13 /end CHARACTERISTIC
/begin CHARACTERISTIC DINH_FId.DFC_ComDcdcFltLvl4_CA "" VAL_BLK 0x8024207C ValA_Wu16 1139.00000000 DINH_FIdVerb 0.00 1139.00000000 FORMAT "%13.8" MATRIX_DIM 13 /end CHARACTERISTIC
/begin CHARACTERISTIC DINH_FId.DFC_ComDcdcFltLvl5_CA "" VAL_BLK 0x80242096 ValA_Wu16 1139.00000000 DINH_FIdVerb 0.00 1139.00000000 FORMAT "%13.8" MATRIX_DIM 13 /end CHARACTERISTIC
/begin CHARACTERISTIC DINH_FId.DFC_ComDcdcFltLvlRes_CA "" VAL_BLK 0x802420B0 ValA_Wu16 1139.00000000 DINH_FIdVerb 0.00 1139.00000000 FORMAT "%13.8" MATRIX_DIM 13 /end CHARACTERISTIC
/begin CHARACTERISTIC DINH_FId.DFC_ComDcdcMstBlink_CA "" VAL_BLK 0x802420CA ValA_Wu16 1139.00000000 DINH_FIdVerb 0.00 1139.00000000 FORMAT "%13.8" MATRIX_DIM 13 /end CHARACTERISTIC
/begin CHARACTERISTIC DINH_FId.DFC_ComDcdcMstCont_CA "" VAL_BLK 0x802420E4 ValA_Wu16 1139.00000000 DINH_FIdVerb 0.00 1139.00000000 FORMAT "%13.8" MATRIX_DIM 13 /end CHARACTERISTIC
/begin CHARACTERISTIC DINH_FId.DFC_ComDcdcSVSBlink_CA "" VAL_BLK 0x802420FE ValA_Wu16 1139.00000000 DINH_FIdVerb 0.00 1139.00000000 FORMAT "%13.8" MATRIX_DIM 13 /end CHARACTERISTIC
/begin CHARACTERISTIC DINH_FId.DFC_ComDcdcSVSCont_CA "" VAL_BLK 0x80242118 ValA_Wu16 1139.00000000 DINH_FIdVerb 0.00 1139.00000000 FORMAT "%13.8" MATRIX_DIM 13 /end CHARACTERISTIC
/begin CHARACTERISTIC DINH_FId.DFC_ComElMIIvtrFltLvl2_CA "" VAL_BLK 0x80242132 ValA_Wu16 1139.00000000 DINH_FIdVerb 0.00 1139.00000000 FORMAT "%13.8" MATRIX_DIM 13 /end CHARACTERISTIC
/begin CHARACTERISTIC DINH_FId.DFC_ComElMIIvtrFltLvl3_CA "" VAL_BLK 0x8024214C ValA_Wu16 1139.00000000 DINH_FIdVerb 0.00 1139.00000000 FORMAT "%13.8" MATRIX_DIM 15 /end CHARACTERISTIC
/begin CHARACTERISTIC DINH_FId.DFC_ComElMIIvtrFltLvl4_CA "" VAL_BLK 0x8024216A ValA_Wu16 1139.00000000 DINH_FIdVerb 0.00 1139.00000000 FORMAT "%13.8" MATRIX_DIM 13 /end CHARACTERISTIC
/begin CHARACTERISTIC DINH_FId.DFC_ComElMIIvtrFltLvl5_CA "" VAL_BLK 0x80242184 ValA_Wu16 1139.00000000 DINH_FIdVerb 0.00 1139.00000000 FORMAT "%13.8" MATRIX_DIM 13 /end CHARACTERISTIC
/begin CHARACTERISTIC DINH_FId.DFC_ComElMIIvtrFltLvlRes_CA "" VAL_BLK 0x8024219E ValA_Wu16 1139.00000000 DINH_FIdVerb 0.00 1139.00000000 FORMAT "%13.8" MATRIX_DIM 13 /end CHARACTERISTIC
/begin CHARACTERISTIC DINH_FId.DFC_ComEmacEVBlink_CA "" VAL_BLK 0x802421B8 ValA_Wu16 1139.00000000 DINH_FIdVerb 0.00 1139.00000000 FORMAT "%13.8" MATRIX_DIM 13 /end CHARACTERISTIC
/begin CHARACTERISTIC DINH_FId.DFC_ComEmacEVCont_CA "" VAL_BLK 0x802421D2 ValA_Wu16 1139.00000000 DINH_FIdVerb 0.00 1139.00000000 FORMAT "%13.8" MATRIX_DIM 13 /end CHARACTERISTIC
/begin CHARACTERISTIC DINH_FId.DFC_ComEmacMstCont_CA "" VAL_BLK 0x802421EC ValA_Wu16 1139.00000000 DINH_FIdVerb 0.00 1139.00000000 FORMAT "%13.8" MATRIX_DIM 13 /end CHARACTERISTIC
/begin CHARACTERISTIC DINH_FId.DFC_ComEmacMsttBlink_CA "" VAL_BLK 0x80242206 ValA_Wu16 1139.00000000 DINH_FIdVerb 0.00 1139.00000000 FORMAT "%13.8" MATRIX_DIM 13 /end CHARACTERISTIC
/begin CHARACTERISTIC DINH_FId.DFC_ComEmacSVSBlink_CA "" VAL_BLK 0x80242220 ValA_Wu16 1139.00000000 DINH_FIdVerb 0.00 1139.00000000 FORMAT "%13.8" MATRIX_DIM 13 /end CHARACTERISTIC
/begin CHARACTERISTIC DINH_FId.DFC_ComEmacSVSCont_CA "" VAL_BLK 0x8024223A ValA_Wu16 1139.00000000 DINH_FIdVerb 0.00 1139.00000000 FORMAT "%13.8" MATRIX_DIM 13 /end CHARACTERISTIC
/begin CHARACTERISTIC DINH_FId.DFC_ComGunCntInfoWkuReq_CA "" VAL_BLK 0x80242254 ValA_Wu16 1139.00000000 DINH_FIdVerb 0.00 1139.00000000 FORMAT "%13.8" MATRIX_DIM 13 /end CHARACTERISTIC
/begin CHARACTERISTIC DINH_FId.DFC_ComHillHldFlt_CA "" VAL_BLK 0x8024226E ValA_Wu16 1139.00000000 DINH_FIdVerb 0.00 1139.00000000 FORMAT "%13.8" MATRIX_DIM 13 /end CHARACTERISTIC
/begin CHARACTERISTIC DINH_FId.DFC_ComHvBattRchrgWkuReq_CA "" VAL_BLK 0x80242288 ValA_Wu16 1139.00000000 DINH_FIdVerb 0.00 1139.00000000 FORMAT "%13.8" MATRIX_DIM 13 /end CHARACTERISTIC
/begin CHARACTERISTIC DINH_FId.DFC_ComHvbFltLvl2_CA "" VAL_BLK 0x802422A2 ValA_Wu16 1139.00000000 DINH_FIdVerb 0.00 1139.00000000 FORMAT "%13.8" MATRIX_DIM 13 /end CHARACTERISTIC
/begin CHARACTERISTIC DINH_FId.DFC_ComHvbFltLvl3_CA "" VAL_BLK 0x802422BC ValA_Wu16 1139.00000000 DINH_FIdVerb 0.00 1139.00000000 FORMAT "%13.8" MATRIX_DIM 13 /end CHARACTERISTIC
/begin CHARACTERISTIC DINH_FId.DFC_ComHvbFltLvl4_CA "" VAL_BLK 0x802422D6 ValA_Wu16 1139.00000000 DINH_FIdVerb 0.00 1139.00000000 FORMAT "%13.8" MATRIX_DIM 13 /end CHARACTERISTIC
/begin CHARACTERISTIC DINH_FId.DFC_ComHvbFltLvl5_CA "" VAL_BLK 0x802422F0 ValA_Wu16 1139.00000000 DINH_FIdVerb 0.00 1139.00000000 FORMAT "%13.8" MATRIX_DIM 13 /end CHARACTERISTIC
/begin CHARACTERISTIC DINH_FId.DFC_ComHvbFltLvlRes_CA "" VAL_BLK 0x8024230A ValA_Wu16 1139.00000000 DINH_FIdVerb 0.00 1139.00000000 FORMAT "%13.8" MATRIX_DIM 13 /end CHARACTERISTIC
/begin CHARACTERISTIC DINH_FId.DFC_ComHvbMstBlink_CA "" VAL_BLK 0x80242324 ValA_Wu16 1139.00000000 DINH_FIdVerb 0.00 1139.00000000 FORMAT "%13.8" MATRIX_DIM 13 /end CHARACTERISTIC
/begin CHARACTERISTIC DINH_FId.DFC_ComHvbMstCont_CA "" VAL_BLK 0x8024233E ValA_Wu16 1139.00000000 DINH_FIdVerb 0.00 1139.00000000 FORMAT "%13.8" MATRIX_DIM 13 /end CHARACTERISTIC
/begin CHARACTERISTIC DINH_FId.DFC_ComImmoUnlockWkuReq_CA "" VAL_BLK 0x80242358 ValA_Wu16 1139.00000000 DINH_FIdVerb 0.00 1139.00000000 FORMAT "%13.8" MATRIX_DIM 13 /end CHARACTERISTIC
/begin CHARACTERISTIC DINH_FId.DFC_ComInfoReqPtlWkuReq_CA "" VAL_BLK 0x80242372 ValA_Wu16 1139.00000000 DINH_FIdVerb 0.00 1139.00000000 FORMAT "%13.8" MATRIX_DIM 13 /end CHARACTERISTIC
/begin CHARACTERISTIC DINH_FId.DFC_ComOBCFltLvl2_CA "" VAL_BLK 0x8024238C ValA_Wu16 1139.00000000 DINH_FIdVerb 0.00 1139.00000000 FORMAT "%13.8" MATRIX_DIM 13 /end CHARACTERISTIC
/begin CHARACTERISTIC DINH_FId.DFC_ComOBCFltLvl3_CA "" VAL_BLK 0x802423A6 ValA_Wu16 1139.00000000 DINH_FIdVerb 0.00 1139.00000000 FORMAT "%13.8" MATRIX_DIM 13 /end CHARACTERISTIC
/begin CHARACTERISTIC DINH_FId.DFC_ComOBCFltLvl4_CA "" VAL_BLK 0x802423C0 ValA_Wu16 1139.00000000 DINH_FIdVerb 0.00 1139.00000000 FORMAT "%13.8" MATRIX_DIM 13 /end CHARACTERISTIC
/begin CHARACTERISTIC DINH_FId.DFC_ComOBCFltLvl5_CA "" VAL_BLK 0x802423DA ValA_Wu16 1139.00000000 DINH_FIdVerb 0.00 1139.00000000 FORMAT "%13.8" MATRIX_DIM 13 /end CHARACTERISTIC
/begin CHARACTERISTIC DINH_FId.DFC_ComOBCFltLvlRes_CA "" VAL_BLK 0x802423F4 ValA_Wu16 1139.00000000 DINH_FIdVerb 0.00 1139.00000000 FORMAT "%13.8" MATRIX_DIM 13 /end CHARACTERISTIC
/begin CHARACTERISTIC DINH_FId.DFC_ComPostOperationWkuReq_CA "" VAL_BLK 0x8024240E ValA_Wu16 1139.00000000 DINH_FIdVerb 0.00 1139.00000000 FORMAT "%13.8" MATRIX_DIM 13 /end CHARACTERISTIC
/begin CHARACTERISTIC DINH_FId.DFC_ComPreCondElecWkuReq_CA "" VAL_BLK 0x80242428 ValA_Wu16 1139.00000000 DINH_FIdVerb 0.00 1139.00000000 FORMAT "%13.8" MATRIX_DIM 13 /end CHARACTERISTIC
/begin CHARACTERISTIC DINH_FId.DFC_ComRemUnlckWkuReq_CA "" VAL_BLK 0x80242442 ValA_Wu16 1139.00000000 DINH_FIdVerb 0.00 1139.00000000 FORMAT "%13.8" MATRIX_DIM 13 /end CHARACTERISTIC
/begin CHARACTERISTIC DINH_FId.DFC_ComStpDlyHMIWkuReq_CA "" VAL_BLK 0x8024245C ValA_Wu16 1139.00000000 DINH_FIdVerb 0.00 1139.00000000 FORMAT "%13.8" MATRIX_DIM 13 /end CHARACTERISTIC
/begin CHARACTERISTIC DINH_FId.DFC_ComflgCurMeasmtErr_CA "" VAL_BLK 0x80242476 ValA_Wu16 1139.00000000 DINH_FIdVerb 0.00 1139.00000000 FORMAT "%13.8" MATRIX_DIM 13 /end CHARACTERISTIC
/begin CHARACTERISTIC DINH_FId.DFC_ComflgCurMeasmtSysErr_CA "" VAL_BLK 0x80242490 ValA_Wu16 1139.00000000 DINH_FIdVerb 0.00 1139.00000000 FORMAT "%13.8" MATRIX_DIM 13 /end CHARACTERISTIC
/begin CHARACTERISTIC DINH_FId.DFC_ComflgCurMeasmtVld_CA "" VAL_BLK 0x802424AA ValA_Wu16 1139.00000000 DINH_FIdVerb 0.00 1139.00000000 FORMAT "%13.8" MATRIX_DIM 13 /end CHARACTERISTIC
/begin CHARACTERISTIC DINH_FId.DFC_ComflgCurRngErr_CA "" VAL_BLK 0x802424C4 ValA_Wu16 1139.00000000 DINH_FIdVerb 0.00 1139.00000000 FORMAT "%13.8" MATRIX_DIM 13 /end CHARACTERISTIC
/begin CHARACTERISTIC DINH_FId.DFC_ComflgTPcbMeasmtErr_CA "" VAL_BLK 0x802424DE ValA_Wu16 1139.00000000 DINH_FIdVerb 0.00 1139.00000000 FORMAT "%13.8" MATRIX_DIM 13 /end CHARACTERISTIC
/begin CHARACTERISTIC DINH_FId.DFC_ComflgTPcbMeasmtVld_CA "" VAL_BLK 0x802424F8 ValA_Wu16 1139.00000000 DINH_FIdVerb 0.00 1139.00000000 FORMAT "%13.8" MATRIX_DIM 13 /end CHARACTERISTIC
/begin CHARACTERISTIC DINH_FId.DFC_ComflgTPcbRngErr_CA "" VAL_BLK 0x80242512 ValA_Wu16 1139.00000000 DINH_FIdVerb 0.00 1139.00000000 FORMAT "%13.8" MATRIX_DIM 13 /end CHARACTERISTIC
/begin CHARACTERISTIC DINH_FId.DFC_ComflgTPcbSysErr_CA "" VAL_BLK 0x8024252C ValA_Wu16 1139.00000000 DINH_FIdVerb 0.00 1139.00000000 FORMAT "%13.8" MATRIX_DIM 13 /end CHARACTERISTIC
/begin CHARACTERISTIC DINH_FId.DFC_ComflgTShntMeasmtErr_CA "" VAL_BLK 0x80242546 ValA_Wu16 1139.00000000 DINH_FIdVerb 0.00 1139.00000000 FORMAT "%13.8" MATRIX_DIM 13 /end CHARACTERISTIC
/begin CHARACTERISTIC DINH_FId.DFC_ComflgTShntMeasmtVld_CA "" VAL_BLK 0x80242560 ValA_Wu16 1139.00000000 DINH_FIdVerb 0.00 1139.00000000 FORMAT "%13.8" MATRIX_DIM 13 /end CHARACTERISTIC
/begin CHARACTERISTIC DINH_FId.DFC_ComflgTShntRngErr_CA "" VAL_BLK 0x8024257A ValA_Wu16 1139.00000000 DINH_FIdVerb 0.00 1139.00000000 FORMAT "%13.8" MATRIX_DIM 13 /end CHARACTERISTIC
/begin CHARACTERISTIC DINH_FId.DFC_ComflgTShntSysErr_CA "" VAL_BLK 0x80242594 ValA_Wu16 1139.00000000 DINH_FIdVerb 0.00 1139.00000000 FORMAT "%13.8" MATRIX_DIM 13 /end CHARACTERISTIC
/begin CHARACTERISTIC DINH_FId.DFC_ComflgVoltMeasmtErr_CA "" VAL_BLK 0x802425AE ValA_Wu16 1139.00000000 DINH_FIdVerb 0.00 1139.00000000 FORMAT "%13.8" MATRIX_DIM 13 /end CHARACTERISTIC
/begin CHARACTERISTIC DINH_FId.DFC_ComflgVoltMeasmtSysErr_CA "" VAL_BLK 0x802425C8 ValA_Wu16 1139.00000000 DINH_FIdVerb 0.00 1139.00000000 FORMAT "%13.8" MATRIX_DIM 13 /end CHARACTERISTIC
/begin CHARACTERISTIC DINH_FId.DFC_ComflgVoltMeasmtVld_CA "" VAL_BLK 0x802425E2 ValA_Wu16 1139.00000000 DINH_FIdVerb 0.00 1139.00000000 FORMAT "%13.8" MATRIX_DIM 13 /end CHARACTERISTIC
/begin CHARACTERISTIC DINH_FId.DFC_ComflgVoltRngErr_CA "" VAL_BLK 0x802425FC ValA_Wu16 1139.00000000 DINH_FIdVerb 0.00 1139.00000000 FORMAT "%13.8" MATRIX_DIM 13 /end CHARACTERISTIC
/begin CHARACTERISTIC DINH_FId.DFC_CrashEveOcc_CA "" VAL_BLK 0x80242616 ValA_Wu16 1139.00000000 DINH_FIdVerb 0.00 1139.00000000 FORMAT "%13.8" MATRIX_DIM 13 /end CHARACTERISTIC
/begin CHARACTERISTIC DINH_FId.DFC_DcdcFwdModStuck_CA "" VAL_BLK 0x80242630 ValA_Wu16 1139.00000000 DINH_FIdVerb 0.00 1139.00000000 FORMAT "%13.8" MATRIX_DIM 13 /end CHARACTERISTIC
/begin CHARACTERISTIC DINH_FId.DFC_DcdcLvUDifMaxFlt_CA "" VAL_BLK 0x8024264A ValA_Wu16 1139.00000000 DINH_FIdVerb 0.00 1139.00000000 FORMAT "%13.8" MATRIX_DIM 13 /end CHARACTERISTIC
/begin CHARACTERISTIC DINH_FId.DFC_DcdcOffModStuck_CA "" VAL_BLK 0x80242664 ValA_Wu16 1139.00000000 DINH_FIdVerb 0.00 1139.00000000 FORMAT "%13.8" MATRIX_DIM 13 /end CHARACTERISTIC
/begin CHARACTERISTIC DINH_FId.DFC_DcdcOperModFailr_CA "" VAL_BLK 0x8024267E ValA_Wu16 1139.00000000 DINH_FIdVerb 0.00 1139.00000000 FORMAT "%13.8" MATRIX_DIM 15 /end CHARACTERISTIC
/begin CHARACTERISTIC DINH_FId.DFC_DcdcPrecModStuck_CA "" VAL_BLK 0x8024269C ValA_Wu16 1139.00000000 DINH_FIdVerb 0.00 1139.00000000 FORMAT "%13.8" MATRIX_DIM 13 /end CHARACTERISTIC
/begin CHARACTERISTIC DINH_FId.DFC_DrvDoorOpn_CA "" VAL_BLK 0x802426B6 ValA_Wu16 1139.00000000 DINH_FIdVerb 0.00 1139.00000000 FORMAT "%13.8" MATRIX_DIM 13 /end CHARACTERISTIC
/begin CHARACTERISTIC DINH_FId.DFC_DrvModPosnDfct_CA "" VAL_BLK 0x802426D0 ValA_Wu16 1139.00000000 DINH_FIdVerb 0.00 1139.00000000 FORMAT "%13.8" MATRIX_DIM 14 /end CHARACTERISTIC
/begin CHARACTERISTIC DINH_FId.DFC_DrvStbltOpn_CA "" VAL_BLK 0x802426EC ValA_Wu16 1139.00000000 DINH_FIdVerb 0.00 1139.00000000 FORMAT "%13.8" MATRIX_DIM 13 /end CHARACTERISTIC
/begin CHARACTERISTIC DINH_FId.DFC_ETogFailrLvl3_CA "" VAL_BLK 0x80242706 ValA_Wu16 1139.00000000 DINH_FIdVerb 0.00 1139.00000000 FORMAT "%13.8" MATRIX_DIM 13 /end CHARACTERISTIC
/begin CHARACTERISTIC DINH_FId.DFC_ETogFailrLvl4_CA "" VAL_BLK 0x80242720 ValA_Wu16 1139.00000000 DINH_FIdVerb 0.00 1139.00000000 FORMAT "%13.8" MATRIX_DIM 14 /end CHARACTERISTIC
/begin CHARACTERISTIC DINH_FId.DFC_EbsLvBattSocDiagLo_CA "" VAL_BLK 0x8024273C ValA_Wu16 1139.00000000 DINH_FIdVerb 0.00 1139.00000000 FORMAT "%13.8" MATRIX_DIM 14 /end CHARACTERISTIC
/begin CHARACTERISTIC DINH_FId.DFC_EbsLvBattUDiagDiOper_CA "" VAL_BLK 0x80242758 ValA_Wu16 1139.00000000 DINH_FIdVerb 0.00 1139.00000000 FORMAT "%13.8" MATRIX_DIM 13 /end CHARACTERISTIC
/begin CHARACTERISTIC DINH_FId.DFC_EbsLvBattUDiagFltLvl1_CA "" VAL_BLK 0x80242772 ValA_Wu16 1139.00000000 DINH_FIdVerb 0.00 1139.00000000 FORMAT "%13.8" MATRIX_DIM 13 /end CHARACTERISTIC
/begin CHARACTERISTIC DINH_FId.DFC_EbsLvBattUDiagFltLvl2_CA "" VAL_BLK 0x8024278C ValA_Wu16 1139.00000000 DINH_FIdVerb 0.00 1139.00000000 FORMAT "%13.8" MATRIX_DIM 13 /end CHARACTERISTIC
/begin CHARACTERISTIC DINH_FId.DFC_EbsLvBattUDiagLo_CA "" VAL_BLK 0x802427A6 ValA_Wu16 1139.00000000 DINH_FIdVerb 0.00 1139.00000000 FORMAT "%13.8" MATRIX_DIM 13 /end CHARACTERISTIC
/begin CHARACTERISTIC DINH_FId.DFC_EbsSnsrSt_CA "" VAL_BLK 0x802427C0 ValA_Wu16 1139.00000000 DINH_FIdVerb 0.00 1139.00000000 FORMAT "%13.8" MATRIX_DIM 13 /end CHARACTERISTIC
/begin CHARACTERISTIC DINH_FId.DFC_EbsSofASILErr_CA "" VAL_BLK 0x802427DA ValA_Wu16 1139.00000000 DINH_FIdVerb 0.00 1139.00000000 FORMAT "%13.8" MATRIX_DIM 13 /end CHARACTERISTIC
/begin CHARACTERISTIC DINH_FId.DFC_ElTSPtSysLimDrvErr_CA "" VAL_BLK 0x802427F4 ValA_Wu16 1139.00000000 DINH_FIdVerb 0.00 1139.00000000 FORMAT "%13.8" MATRIX_DIM 13 /end CHARACTERISTIC
/begin CHARACTERISTIC DINH_FId.DFC_ElTSPtSysLimRgnErr_CA "" VAL_BLK 0x8024280E ValA_Wu16 1139.00000000 DINH_FIdVerb 0.00 1139.00000000 FORMAT "%13.8" MATRIX_DIM 13 /end CHARACTERISTIC
/begin CHARACTERISTIC DINH_FId.DFC_HLCCcsFwDwnl_CA "" VAL_BLK 0x80242828 ValA_Wu16 1139.00000000 DINH_FIdVerb 0.00 1139.00000000 FORMAT "%13.8" MATRIX_DIM 13 /end CHARACTERISTIC
/begin CHARACTERISTIC DINH_FId.DFC_HvBattChrgPwrMax_CA "" VAL_BLK 0x80242842 ValA_Wu16 1139.00000000 DINH_FIdVerb 0.00 1139.00000000 FORMAT "%13.8" MATRIX_DIM 13 /end CHARACTERISTIC
/begin CHARACTERISTIC DINH_FId.DFC_HvBattCrashDetd_CA "" VAL_BLK 0x8024285C ValA_Wu16 1139.00000000 DINH_FIdVerb 0.00 1139.00000000 FORMAT "%13.8" MATRIX_DIM 14 /end CHARACTERISTIC
/begin CHARACTERISTIC DINH_FId.DFC_HvBattDchaPwrMax_CA "" VAL_BLK 0x80242878 ValA_Wu16 1139.00000000 DINH_FIdVerb 0.00 1139.00000000 FORMAT "%13.8" MATRIX_DIM 13 /end CHARACTERISTIC
/begin CHARACTERISTIC DINH_FId.DFC_HvBattEmgyOff_CA "" VAL_BLK 0x80242892 ValA_Wu16 1139.00000000 DINH_FIdVerb 0.00 1139.00000000 FORMAT "%13.8" MATRIX_DIM 14 /end CHARACTERISTIC
/begin CHARACTERISTIC DINH_FId.DFC_HvBattEmgyOffIntlck_CA "" VAL_BLK 0x802428AE ValA_Wu16 1139.00000000 DINH_FIdVerb 0.00 1139.00000000 FORMAT "%13.8" MATRIX_DIM 14 /end CHARACTERISTIC
/begin CHARACTERISTIC DINH_FId.DFC_HvBattEmgyOffReq_CA "" VAL_BLK 0x802428CA ValA_Wu16 1139.00000000 DINH_FIdVerb 0.00 1139.00000000 FORMAT "%13.8" MATRIX_DIM 17 /end CHARACTERISTIC
/begin CHARACTERISTIC DINH_FId.DFC_HvBattFltMod_CA "" VAL_BLK 0x802428EC ValA_Wu16 1139.00000000 DINH_FIdVerb 0.00 1139.00000000 FORMAT "%13.8" MATRIX_DIM 17 /end CHARACTERISTIC
/begin CHARACTERISTIC DINH_FId.DFC_HvBattIReqToChrgrErr_CA "" VAL_BLK 0x8024290E ValA_Wu16 1139.00000000 DINH_FIdVerb 0.00 1139.00000000 FORMAT "%13.8" MATRIX_DIM 14 /end CHARACTERISTIC
/begin CHARACTERISTIC DINH_FId.DFC_HvBattIReqToChrgrIni_CA "" VAL_BLK 0x8024292A ValA_Wu16 1139.00000000 DINH_FIdVerb 0.00 1139.00000000 FORMAT "%13.8" MATRIX_DIM 14 /end CHARACTERISTIC
/begin CHARACTERISTIC DINH_FId.DFC_HvBattIninTout_CA "" VAL_BLK 0x80242946 ValA_Wu16 1139.00000000 DINH_FIdVerb 0.00 1139.00000000 FORMAT "%13.8" MATRIX_DIM 13 /end CHARACTERISTIC
/begin CHARACTERISTIC DINH_FId.DFC_HvBattIntlckSt_CA "" VAL_BLK 0x80242960 ValA_Wu16 1139.00000000 DINH_FIdVerb 0.00 1139.00000000 FORMAT "%13.8" MATRIX_DIM 19 /end CHARACTERISTIC
/begin CHARACTERISTIC DINH_FId.DFC_HvBattIsoFlt_CA "" VAL_BLK 0x80242986 ValA_Wu16 1139.00000000 DINH_FIdVerb 0.00 1139.00000000 FORMAT "%13.8" MATRIX_DIM 18 /end CHARACTERISTIC
/begin CHARACTERISTIC DINH_FId.DFC_HvBattLimdPwr_CA "" VAL_BLK 0x802429AA ValA_Wu16 1139.00000000 DINH_FIdVerb 0.00 1139.00000000 FORMAT "%13.8" MATRIX_DIM 13 /end CHARACTERISTIC
/begin CHARACTERISTIC DINH_FId.DFC_HvBattMaiSwtClsngFlt_CA "" VAL_BLK 0x802429C4 ValA_Wu16 1139.00000000 DINH_FIdVerb 0.00 1139.00000000 FORMAT "%13.8" MATRIX_DIM 16 /end CHARACTERISTIC
/begin CHARACTERISTIC DINH_FId.DFC_HvBattMaiSwtFlt_CA "" VAL_BLK 0x802429E4 ValA_Wu16 1139.00000000 DINH_FIdVerb 0.00 1139.00000000 FORMAT "%13.8" MATRIX_DIM 16 /end CHARACTERISTIC
/begin CHARACTERISTIC DINH_FId.DFC_HvBattMaiSwtOpen_CA "" VAL_BLK 0x80242A04 ValA_Wu16 1139.00000000 DINH_FIdVerb 0.00 1139.00000000 FORMAT "%13.8" MATRIX_DIM 15 /end CHARACTERISTIC
/begin CHARACTERISTIC DINH_FId.DFC_HvBattMaiSwtOpngFlt_CA "" VAL_BLK 0x80242A22 ValA_Wu16 1139.00000000 DINH_FIdVerb 0.00 1139.00000000 FORMAT "%13.8" MATRIX_DIM 13 /end CHARACTERISTIC
/begin CHARACTERISTIC DINH_FId.DFC_HvBattMaiSwtWldd_CA "" VAL_BLK 0x80242A3C ValA_Wu16 1139.00000000 DINH_FIdVerb 0.00 1139.00000000 FORMAT "%13.8" MATRIX_DIM 14 /end CHARACTERISTIC
/begin CHARACTERISTIC DINH_FId.DFC_HvBattNegCntctrCntErr_CA "" VAL_BLK 0x80242A58 ValA_Wu16 1139.00000000 DINH_FIdVerb 0.00 1139.00000000 FORMAT "%13.8" MATRIX_DIM 13 /end CHARACTERISTIC
/begin CHARACTERISTIC DINH_FId.DFC_HvBattOperModChrgPlausy_CA "" VAL_BLK 0x80242A72 ValA_Wu16 1139.00000000 DINH_FIdVerb 0.00 1139.00000000 FORMAT "%13.8" MATRIX_DIM 13 /end CHARACTERISTIC
/begin CHARACTERISTIC DINH_FId.DFC_HvBattOverTDern_CA "" VAL_BLK 0x80242A8C ValA_Wu16 1139.00000000 DINH_FIdVerb 0.00 1139.00000000 FORMAT "%13.8" MATRIX_DIM 13 /end CHARACTERISTIC
/begin CHARACTERISTIC DINH_FId.DFC_HvBattPosCntctrCntErr_CA "" VAL_BLK 0x80242AA6 ValA_Wu16 1139.00000000 DINH_FIdVerb 0.00 1139.00000000 FORMAT "%13.8" MATRIX_DIM 13 /end CHARACTERISTIC
/begin CHARACTERISTIC DINH_FId.DFC_HvBattPrecCntctrCntErr_CA "" VAL_BLK 0x80242AC0 ValA_Wu16 1139.00000000 DINH_FIdVerb 0.00 1139.00000000 FORMAT "%13.8" MATRIX_DIM 13 /end CHARACTERISTIC
/begin CHARACTERISTIC DINH_FId.DFC_HvBattPwrDistbnTDern_CA "" VAL_BLK 0x80242ADA ValA_Wu16 1139.00000000 DINH_FIdVerb 0.00 1139.00000000 FORMAT "%13.8" MATRIX_DIM 13 /end CHARACTERISTIC
/begin CHARACTERISTIC DINH_FId.DFC_HvBattPwrDistbnTInhbn_CA "" VAL_BLK 0x80242AF4 ValA_Wu16 1139.00000000 DINH_FIdVerb 0.00 1139.00000000 FORMAT "%13.8" MATRIX_DIM 13 /end CHARACTERISTIC
/begin CHARACTERISTIC DINH_FId.DFC_HvBattRatRSohErr_CA "" VAL_BLK 0x80242B0E ValA_Wu16 1139.00000000 DINH_FIdVerb 0.00 1139.00000000 FORMAT "%13.8" MATRIX_DIM 13 /end CHARACTERISTIC
/begin CHARACTERISTIC DINH_FId.DFC_HvBattRatSohErr_CA "" VAL_BLK 0x80242B28 ValA_Wu16 1139.00000000 DINH_FIdVerb 0.00 1139.00000000 FORMAT "%13.8" MATRIX_DIM 13 /end CHARACTERISTIC
/begin CHARACTERISTIC DINH_FId.DFC_HvBattSngIsoWarn_CA "" VAL_BLK 0x80242B42 ValA_Wu16 1139.00000000 DINH_FIdVerb 0.00 1139.00000000 FORMAT "%13.8" MATRIX_DIM 16 /end CHARACTERISTIC
/begin CHARACTERISTIC DINH_FId.DFC_HvBattSrvPlgDiscnct_CA "" VAL_BLK 0x80242B62 ValA_Wu16 1139.00000000 DINH_FIdVerb 0.00 1139.00000000 FORMAT "%13.8" MATRIX_DIM 14 /end CHARACTERISTIC
/begin CHARACTERISTIC DINH_FId.DFC_HvBattUNomChrgnErr_CA "" VAL_BLK 0x80242B7E ValA_Wu16 1139.00000000 DINH_FIdVerb 0.00 1139.00000000 FORMAT "%13.8" MATRIX_DIM 14 /end CHARACTERISTIC
/begin CHARACTERISTIC DINH_FId.DFC_HvBattUNomChrgnIni_CA "" VAL_BLK 0x80242B9A ValA_Wu16 1139.00000000 DINH_FIdVerb 0.00 1139.00000000 FORMAT "%13.8" MATRIX_DIM 14 /end CHARACTERISTIC
/begin CHARACTERISTIC DINH_FId.DFC_HvBattUnderTDern_CA "" VAL_BLK 0x80242BB6 ValA_Wu16 1139.00000000 DINH_FIdVerb 0.00 1139.00000000 FORMAT "%13.8" MATRIX_DIM 13 /end CHARACTERISTIC
/begin CHARACTERISTIC DINH_FId.DFC_HvbEVLmpBlink_CA "" VAL_BLK 0x80242BD0 ValA_Wu16 1139.00000000 DINH_FIdVerb 0.00 1139.00000000 FORMAT "%13.8" MATRIX_DIM 13 /end CHARACTERISTIC
/begin CHARACTERISTIC DINH_FId.DFC_HvbEVLmpCont_CA "" VAL_BLK 0x80242BEA ValA_Wu16 1139.00000000 DINH_FIdVerb 0.00 1139.00000000 FORMAT "%13.8" MATRIX_DIM 13 /end CHARACTERISTIC
/begin CHARACTERISTIC DINH_FId.DFC_HvbSVSBlink_CA "" VAL_BLK 0x80242C04 ValA_Wu16 1139.00000000 DINH_FIdVerb 0.00 1139.00000000 FORMAT "%13.8" MATRIX_DIM 13 /end CHARACTERISTIC
/begin CHARACTERISTIC DINH_FId.DFC_HvbSVSCont_CA "" VAL_BLK 0x80242C1E ValA_Wu16 1139.00000000 DINH_FIdVerb 0.00 1139.00000000 FORMAT "%13.8" MATRIX_DIM 13 /end CHARACTERISTIC
/begin CHARACTERISTIC DINH_FId.DFC_InmLINBusBlk_CA "" VAL_BLK 0x80242C38 ValA_Wu16 1139.00000000 DINH_FIdVerb 0.00 1139.00000000 FORMAT "%13.8" MATRIX_DIM 13 /end CHARACTERISTIC
/begin CHARACTERISTIC DINH_FId.DFC_PDUProgmFailr_CA "" VAL_BLK 0x80242C52 ValA_Wu16 1139.00000000 DINH_FIdVerb 0.00 1139.00000000 FORMAT "%13.8" MATRIX_DIM 13 /end CHARACTERISTIC
/begin CHARACTERISTIC DINH_FId.DFC_PEnvSigRngMax_CA "" VAL_BLK 0x80242C6C ValA_Wu16 1139.00000000 DINH_FIdVerb 0.00 1139.00000000 FORMAT "%13.8" MATRIX_DIM 20 /end CHARACTERISTIC
/begin CHARACTERISTIC DINH_FId.DFC_PEnvSigRngMin_CA "" VAL_BLK 0x80242C94 ValA_Wu16 1139.00000000 DINH_FIdVerb 0.00 1139.00000000 FORMAT "%13.8" MATRIX_DIM 20 /end CHARACTERISTIC
/begin CHARACTERISTIC DINH_FId.DFC_PLnCChpDeactvnFaild_CA "" VAL_BLK 0x80242CBC ValA_Wu16 1139.00000000 DINH_FIdVerb 0.00 1139.00000000 FORMAT "%13.8" MATRIX_DIM 13 /end CHARACTERISTIC
/begin CHARACTERISTIC DINH_FId.DFC_PrkgBrkFailr_CA "" VAL_BLK 0x80242CD6 ValA_Wu16 1139.00000000 DINH_FIdVerb 0.00 1139.00000000 FORMAT "%13.8" MATRIX_DIM 13 /end CHARACTERISTIC
/begin CHARACTERISTIC DINH_FId.DFC_PtSysLimErr_CA "" VAL_BLK 0x80242CF0 ValA_Wu16 1139.00000000 DINH_FIdVerb 0.00 1139.00000000 FORMAT "%13.8" MATRIX_DIM 13 /end CHARACTERISTIC
/begin CHARACTERISTIC DINH_FId.DFC_PwrMaxDchaShoLo_CA "" VAL_BLK 0x80242D0A ValA_Wu16 1139.00000000 DINH_FIdVerb 0.00 1139.00000000 FORMAT "%13.8" MATRIX_DIM 13 /end CHARACTERISTIC
/begin CHARACTERISTIC DINH_FId.DFC_SCtPmp1FailSafeNotSuc_CA "" VAL_BLK 0x80242D24 ValA_Wu16 1139.00000000 DINH_FIdVerb 0.00 1139.00000000 FORMAT "%13.8" MATRIX_DIM 13 /end CHARACTERISTIC
/begin CHARACTERISTIC DINH_FId.DFC_SCtPmp1SCG_CA "" VAL_BLK 0x80242D3E ValA_Wu16 1139.00000000 DINH_FIdVerb 0.00 1139.00000000 FORMAT "%13.8" MATRIX_DIM 18 /end CHARACTERISTIC
/begin CHARACTERISTIC DINH_FId.DFC_VehCoornDrvrNotPrsnt_CA "" VAL_BLK 0x80242D62 ValA_Wu16 1139.00000000 DINH_FIdVerb 0.00 1139.00000000 FORMAT "%13.8" MATRIX_DIM 13 /end CHARACTERISTIC
/begin CHARACTERISTIC DINH_FId.DFC_VehVCanAvl_CA "" VAL_BLK 0x80242D7C ValA_Wu16 1139.00000000 DINH_FIdVerb 0.00 1139.00000000 FORMAT "%13.8" MATRIX_DIM 16 /end CHARACTERISTIC
/begin CHARACTERISTIC DINH_FId.DFC_VehVCanErr_CA "" VAL_BLK 0x80242D9C ValA_Wu16 1139.00000000 DINH_FIdVerb 0.00 1139.00000000 FORMAT "%13.8" MATRIX_DIM 13 /end CHARACTERISTIC
/begin CHARACTERISTIC DINH_FId.DFC_eTogFailrLvlRes_CA "" VAL_BLK 0x80242DB6 ValA_Wu16 1139.00000000 DINH_FIdVerb 0.00 1139.00000000 FORMAT "%13.8" MATRIX_DIM 13 /end CHARACTERISTIC
/begin CHARACTERISTIC DINH_FId.DFC_flgBrkMaiDiag_CA "" VAL_BLK 0x80242DD0 ValA_Wu16 1139.00000000 DINH_FIdVerb 0.00 1139.00000000 FORMAT "%13.8" MATRIX_DIM 15 /end CHARACTERISTIC
/begin CHARACTERISTIC DINH_FId.DFC_stHvbIsoMeasmtRes_CA "" VAL_BLK 0x80242DEE ValA_Wu16 1139.00000000 DINH_FIdVerb 0.00 1139.00000000 FORMAT "%13.8" MATRIX_DIM 13 /end CHARACTERISTIC
/begin CHARACTERISTIC DINH_FId.DFC_BrkBstPmpPLeakDfct_CA "" VAL_BLK 0x80242E08 ValA_Wu16 1139.00000000 DINH_FIdVerb 0.00 1139.00000000 FORMAT "%13.8" MATRIX_DIM 15 /end CHARACTERISTIC
/begin CHARACTERISTIC DINH_FId.DFC_Com082hTooShort_CA "" VAL_BLK 0x80242E26 ValA_Wu16 1139.00000000 DINH_FIdVerb 0.00 1139.00000000 FORMAT "%13.8" MATRIX_DIM 15 /end CHARACTERISTIC
/begin CHARACTERISTIC DINH_FId.DFC_Com092hTooShort_CA "" VAL_BLK 0x80242E44 ValA_Wu16 1139.00000000 DINH_FIdVerb 0.00 1139.00000000 FORMAT "%13.8" MATRIX_DIM 15 /end CHARACTERISTIC
/begin CHARACTERISTIC DINH_FId.DFC_Com205hAbsent_CA "" VAL_BLK 0x80242E62 ValA_Wu16 1139.00000000 DINH_FIdVerb 0.00 1139.00000000 FORMAT "%13.8" MATRIX_DIM 29 /end CHARACTERISTIC
/begin CHARACTERISTIC DINH_FId.DFC_Com205hChecksum_CA "" VAL_BLK 0x80242E9C ValA_Wu16 1139.00000000 DINH_FIdVerb 0.00 1139.00000000 FORMAT "%13.8" MATRIX_DIM 26 /end CHARACTERISTIC
/begin CHARACTERISTIC DINH_FId.DFC_Com205hCounter_CA "" VAL_BLK 0x80242ED0 ValA_Wu16 1139.00000000 DINH_FIdVerb 0.00 1139.00000000 FORMAT "%13.8" MATRIX_DIM 26 /end CHARACTERISTIC
/begin CHARACTERISTIC DINH_FId.DFC_Com205hTooShort_CA "" VAL_BLK 0x80242F04 ValA_Wu16 1139.00000000 DINH_FIdVerb 0.00 1139.00000000 FORMAT "%13.8" MATRIX_DIM 26 /end CHARACTERISTIC
/begin CHARACTERISTIC DINH_FId.DFC_Com217hAbsent_CA "" VAL_BLK 0x80242F38 ValA_Wu16 1139.00000000 DINH_FIdVerb 0.00 1139.00000000 FORMAT "%13.8" MATRIX_DIM 20 /end CHARACTERISTIC
/begin CHARACTERISTIC DINH_FId.DFC_Com217hChecksum_CA "" VAL_BLK 0x80242F60 ValA_Wu16 1139.00000000 DINH_FIdVerb 0.00 1139.00000000 FORMAT "%13.8" MATRIX_DIM 15 /end CHARACTERISTIC
/begin CHARACTERISTIC DINH_FId.DFC_Com217hCounter_CA "" VAL_BLK 0x80242F7E ValA_Wu16 1139.00000000 DINH_FIdVerb 0.00 1139.00000000 FORMAT "%13.8" MATRIX_DIM 15 /end CHARACTERISTIC
/begin CHARACTERISTIC DINH_FId.DFC_Com217hTooShort_CA "" VAL_BLK 0x80242F9C ValA_Wu16 1139.00000000 DINH_FIdVerb 0.00 1139.00000000 FORMAT "%13.8" MATRIX_DIM 20 /end CHARACTERISTIC
/begin CHARACTERISTIC DINH_FId.DFC_Com227hAbsent_CA "" VAL_BLK 0x80242FC4 ValA_Wu16 1139.00000000 DINH_FIdVerb 0.00 1139.00000000 FORMAT "%13.8" MATRIX_DIM 16 /end CHARACTERISTIC
/begin CHARACTERISTIC DINH_FId.DFC_Com227hTooShort_CA "" VAL_BLK 0x80242FE4 ValA_Wu16 1139.00000000 DINH_FIdVerb 0.00 1139.00000000 FORMAT "%13.8" MATRIX_DIM 16 /end CHARACTERISTIC
/begin CHARACTERISTIC DINH_FId.DFC_Com237hAbsent_CA "" VAL_BLK 0x80243004 ValA_Wu16 1139.00000000 DINH_FIdVerb 0.00 1139.00000000 FORMAT "%13.8" MATRIX_DIM 16 /end CHARACTERISTIC
/begin CHARACTERISTIC DINH_FId.DFC_Com237hChecksum_CA "" VAL_BLK 0x80243024 ValA_Wu16 1139.00000000 DINH_FIdVerb 0.00 1139.00000000 FORMAT "%13.8" MATRIX_DIM 13 /end CHARACTERISTIC
/begin CHARACTERISTIC DINH_FId.DFC_Com237hCounter_CA "" VAL_BLK 0x8024303E ValA_Wu16 1139.00000000 DINH_FIdVerb 0.00 1139.00000000 FORMAT "%13.8" MATRIX_DIM 13 /end CHARACTERISTIC
/begin CHARACTERISTIC DINH_FId.DFC_Com237hTooShort_CA "" VAL_BLK 0x80243058 ValA_Wu16 1139.00000000 DINH_FIdVerb 0.00 1139.00000000 FORMAT "%13.8" MATRIX_DIM 16 /end CHARACTERISTIC
/begin CHARACTERISTIC DINH_FId.DFC_Com259hAbsent_CA "" VAL_BLK 0x80243078 ValA_Wu16 1139.00000000 DINH_FIdVerb 0.00 1139.00000000 FORMAT "%13.8" MATRIX_DIM 15 /end CHARACTERISTIC
/begin CHARACTERISTIC DINH_FId.DFC_Com259hChecksum_CA "" VAL_BLK 0x80243096 ValA_Wu16 1139.00000000 DINH_FIdVerb 0.00 1139.00000000 FORMAT "%13.8" MATRIX_DIM 15 /end CHARACTERISTIC
/begin CHARACTERISTIC DINH_FId.DFC_Com259hCounter_CA "" VAL_BLK 0x802430B4 ValA_Wu16 1139.00000000 DINH_FIdVerb 0.00 1139.00000000 FORMAT "%13.8" MATRIX_DIM 15 /end CHARACTERISTIC
/begin CHARACTERISTIC DINH_FId.DFC_Com259hTooShort_CA "" VAL_BLK 0x802430D2 ValA_Wu16 1139.00000000 DINH_FIdVerb 0.00 1139.00000000 FORMAT "%13.8" MATRIX_DIM 15 /end CHARACTERISTIC
/begin CHARACTERISTIC DINH_FId.DFC_Com26hAbsent_CA "" VAL_BLK 0x802430F0 ValA_Wu16 1139.00000000 DINH_FIdVerb 0.00 1139.00000000 FORMAT "%13.8" MATRIX_DIM 13 /end CHARACTERISTIC
/begin CHARACTERISTIC DINH_FId.DFC_Com26hTooShort_CA "" VAL_BLK 0x8024310A ValA_Wu16 1139.00000000 DINH_FIdVerb 0.00 1139.00000000 FORMAT "%13.8" MATRIX_DIM 13 /end CHARACTERISTIC
/begin CHARACTERISTIC DINH_FId.DFC_Com273hAbsent_CA "" VAL_BLK 0x80243124 ValA_Wu16 1139.00000000 DINH_FIdVerb 0.00 1139.00000000 FORMAT "%13.8" MATRIX_DIM 15 /end CHARACTERISTIC
/begin CHARACTERISTIC DINH_FId.DFC_Com273hChecksum_CA "" VAL_BLK 0x80243142 ValA_Wu16 1139.00000000 DINH_FIdVerb 0.00 1139.00000000 FORMAT "%13.8" MATRIX_DIM 13 /end CHARACTERISTIC
/begin CHARACTERISTIC DINH_FId.DFC_Com273hCounter_CA "" VAL_BLK 0x8024315C ValA_Wu16 1139.00000000 DINH_FIdVerb 0.00 1139.00000000 FORMAT "%13.8" MATRIX_DIM 13 /end CHARACTERISTIC
/begin CHARACTERISTIC DINH_FId.DFC_Com273hTooShort_CA "" VAL_BLK 0x80243176 ValA_Wu16 1139.00000000 DINH_FIdVerb 0.00 1139.00000000 FORMAT "%13.8" MATRIX_DIM 15 /end CHARACTERISTIC
/begin CHARACTERISTIC DINH_FId.DFC_Com275hAbsent_CA "" VAL_BLK 0x80243194 ValA_Wu16 1139.00000000 DINH_FIdVerb 0.00 1139.00000000 FORMAT "%13.8" MATRIX_DIM 15 /end CHARACTERISTIC
/begin CHARACTERISTIC DINH_FId.DFC_Com275hChecksum_CA "" VAL_BLK 0x802431B2 ValA_Wu16 1139.00000000 DINH_FIdVerb 0.00 1139.00000000 FORMAT "%13.8" MATRIX_DIM 15 /end CHARACTERISTIC
/begin CHARACTERISTIC DINH_FId.DFC_Com275hCounter_CA "" VAL_BLK 0x802431D0 ValA_Wu16 1139.00000000 DINH_FIdVerb 0.00 1139.00000000 FORMAT "%13.8" MATRIX_DIM 15 /end CHARACTERISTIC
/begin CHARACTERISTIC DINH_FId.DFC_Com275hTooShort_CA "" VAL_BLK 0x802431EE ValA_Wu16 1139.00000000 DINH_FIdVerb 0.00 1139.00000000 FORMAT "%13.8" MATRIX_DIM 15 /end CHARACTERISTIC
/begin CHARACTERISTIC DINH_FId.DFC_Com283hAbsent_CA "" VAL_BLK 0x8024320C ValA_Wu16 1139.00000000 DINH_FIdVerb 0.00 1139.00000000 FORMAT "%13.8" MATRIX_DIM 16 /end CHARACTERISTIC
/begin CHARACTERISTIC DINH_FId.DFC_Com283hTooShort_CA "" VAL_BLK 0x8024322C ValA_Wu16 1139.00000000 DINH_FIdVerb 0.00 1139.00000000 FORMAT "%13.8" MATRIX_DIM 16 /end CHARACTERISTIC
/begin CHARACTERISTIC DINH_FId.DFC_Com285hAbsent_CA "" VAL_BLK 0x8024324C ValA_Wu16 1139.00000000 DINH_FIdVerb 0.00 1139.00000000 FORMAT "%13.8" MATRIX_DIM 15 /end CHARACTERISTIC
/begin CHARACTERISTIC DINH_FId.DFC_Com285hChecksum_CA "" VAL_BLK 0x8024326A ValA_Wu16 1139.00000000 DINH_FIdVerb 0.00 1139.00000000 FORMAT "%13.8" MATRIX_DIM 15 /end CHARACTERISTIC
/begin CHARACTERISTIC DINH_FId.DFC_Com285hCounter_CA "" VAL_BLK 0x80243288 ValA_Wu16 1139.00000000 DINH_FIdVerb 0.00 1139.00000000 FORMAT "%13.8" MATRIX_DIM 15 /end CHARACTERISTIC
/begin CHARACTERISTIC DINH_FId.DFC_Com285hTooShort_CA "" VAL_BLK 0x802432A6 ValA_Wu16 1139.00000000 DINH_FIdVerb 0.00 1139.00000000 FORMAT "%13.8" MATRIX_DIM 15 /end CHARACTERISTIC
/begin CHARACTERISTIC DINH_FId.DFC_Com293hAbsent_CA "" VAL_BLK 0x802432C4 ValA_Wu16 1139.00000000 DINH_FIdVerb 0.00 1139.00000000 FORMAT "%13.8" MATRIX_DIM 15 /end CHARACTERISTIC
/begin CHARACTERISTIC DINH_FId.DFC_Com293hChecksum_CA "" VAL_BLK 0x802432E2 ValA_Wu16 1139.00000000 DINH_FIdVerb 0.00 1139.00000000 FORMAT "%13.8" MATRIX_DIM 13 /end CHARACTERISTIC
/begin CHARACTERISTIC DINH_FId.DFC_Com293hCounter_CA "" VAL_BLK 0x802432FC ValA_Wu16 1139.00000000 DINH_FIdVerb 0.00 1139.00000000 FORMAT "%13.8" MATRIX_DIM 13 /end CHARACTERISTIC
/begin CHARACTERISTIC DINH_FId.DFC_Com293hTooShort_CA "" VAL_BLK 0x80243316 ValA_Wu16 1139.00000000 DINH_FIdVerb 0.00 1139.00000000 FORMAT "%13.8" MATRIX_DIM 15 /end CHARACTERISTIC
/begin CHARACTERISTIC DINH_FId.DFC_Com308hAbsent_CA "" VAL_BLK 0x80243334 ValA_Wu16 1139.00000000 DINH_FIdVerb 0.00 1139.00000000 FORMAT "%13.8" MATRIX_DIM 16 /end CHARACTERISTIC
/begin CHARACTERISTIC DINH_FId.DFC_Com308hChecksum_CA "" VAL_BLK 0x80243354 ValA_Wu16 1139.00000000 DINH_FIdVerb 0.00 1139.00000000 FORMAT "%13.8" MATRIX_DIM 16 /end CHARACTERISTIC
/begin CHARACTERISTIC DINH_FId.DFC_Com308hCounter_CA "" VAL_BLK 0x80243374 ValA_Wu16 1139.00000000 DINH_FIdVerb 0.00 1139.00000000 FORMAT "%13.8" MATRIX_DIM 16 /end CHARACTERISTIC
/begin CHARACTERISTIC DINH_FId.DFC_Com308hTooShort_CA "" VAL_BLK 0x80243394 ValA_Wu16 1139.00000000 DINH_FIdVerb 0.00 1139.00000000 FORMAT "%13.8" MATRIX_DIM 16 /end CHARACTERISTIC
/begin CHARACTERISTIC DINH_FId.DFC_Com318hAbsent_CA "" VAL_BLK 0x802433B4 ValA_Wu16 1139.00000000 DINH_FIdVerb 0.00 1139.00000000 FORMAT "%13.8" MATRIX_DIM 16 /end CHARACTERISTIC
/begin CHARACTERISTIC DINH_FId.DFC_Com318hChecksum_CA "" VAL_BLK 0x802433D4 ValA_Wu16 1139.00000000 DINH_FIdVerb 0.00 1139.00000000 FORMAT "%13.8" MATRIX_DIM 16 /end CHARACTERISTIC
/begin CHARACTERISTIC DINH_FId.DFC_Com318hCounter_CA "" VAL_BLK 0x802433F4 ValA_Wu16 1139.00000000 DINH_FIdVerb 0.00 1139.00000000 FORMAT "%13.8" MATRIX_DIM 16 /end CHARACTERISTIC
/begin CHARACTERISTIC DINH_FId.DFC_Com318hTooShort_CA "" VAL_BLK 0x80243414 ValA_Wu16 1139.00000000 DINH_FIdVerb 0.00 1139.00000000 FORMAT "%13.8" MATRIX_DIM 16 /end CHARACTERISTIC
/begin CHARACTERISTIC DINH_FId.DFC_Com325hAbsent_CA "" VAL_BLK 0x80243434 ValA_Wu16 1139.00000000 DINH_FIdVerb 0.00 1139.00000000 FORMAT "%13.8" MATRIX_DIM 19 /end CHARACTERISTIC
/begin CHARACTERISTIC DINH_FId.DFC_Com325hChecksum_CA "" VAL_BLK 0x8024345A ValA_Wu16 1139.00000000 DINH_FIdVerb 0.00 1139.00000000 FORMAT "%13.8" MATRIX_DIM 19 /end CHARACTERISTIC
/begin CHARACTERISTIC DINH_FId.DFC_Com325hCounter_CA "" VAL_BLK 0x80243480 ValA_Wu16 1139.00000000 DINH_FIdVerb 0.00 1139.00000000 FORMAT "%13.8" MATRIX_DIM 19 /end CHARACTERISTIC
/begin CHARACTERISTIC DINH_FId.DFC_Com325hTooShort_CA "" VAL_BLK 0x802434A6 ValA_Wu16 1139.00000000 DINH_FIdVerb 0.00 1139.00000000 FORMAT "%13.8" MATRIX_DIM 19 /end CHARACTERISTIC
/begin CHARACTERISTIC DINH_FId.DFC_Com335hAbsent_CA "" VAL_BLK 0x802434CC ValA_Wu16 1139.00000000 DINH_FIdVerb 0.00 1139.00000000 FORMAT "%13.8" MATRIX_DIM 20 /end CHARACTERISTIC
/begin CHARACTERISTIC DINH_FId.DFC_Com335hChecksum_CA "" VAL_BLK 0x802434F4 ValA_Wu16 1139.00000000 DINH_FIdVerb 0.00 1139.00000000 FORMAT "%13.8" MATRIX_DIM 19 /end CHARACTERISTIC
/begin CHARACTERISTIC DINH_FId.DFC_Com335hCounter_CA "" VAL_BLK 0x8024351A ValA_Wu16 1139.00000000 DINH_FIdVerb 0.00 1139.00000000 FORMAT "%13.8" MATRIX_DIM 19 /end CHARACTERISTIC
/begin CHARACTERISTIC DINH_FId.DFC_Com335hTooShort_CA "" VAL_BLK 0x80243540 ValA_Wu16 1139.00000000 DINH_FIdVerb 0.00 1139.00000000 FORMAT "%13.8" MATRIX_DIM 20 /end CHARACTERISTIC
/begin CHARACTERISTIC DINH_FId.DFC_Com351hAbsent_CA "" VAL_BLK 0x80243568 ValA_Wu16 1139.00000000 DINH_FIdVerb 0.00 1139.00000000 FORMAT "%13.8" MATRIX_DIM 16 /end CHARACTERISTIC
/begin CHARACTERISTIC DINH_FId.DFC_Com351hTooShort_CA "" VAL_BLK 0x80243588 ValA_Wu16 1139.00000000 DINH_FIdVerb 0.00 1139.00000000 FORMAT "%13.8" MATRIX_DIM 16 /end CHARACTERISTIC
/begin CHARACTERISTIC DINH_FId.DFC_Com38DhAbsent_CA "" VAL_BLK 0x802435A8 ValA_Wu16 1139.00000000 DINH_FIdVerb 0.00 1139.00000000 FORMAT "%13.8" MATRIX_DIM 22 /end CHARACTERISTIC
/begin CHARACTERISTIC DINH_FId.DFC_Com38DhChecksum_CA "" VAL_BLK 0x802435D4 ValA_Wu16 1139.00000000 DINH_FIdVerb 0.00 1139.00000000 FORMAT "%13.8" MATRIX_DIM 18 /end CHARACTERISTIC
/begin CHARACTERISTIC DINH_FId.DFC_Com38DhCounter_CA "" VAL_BLK 0x802435F8 ValA_Wu16 1139.00000000 DINH_FIdVerb 0.00 1139.00000000 FORMAT "%13.8" MATRIX_DIM 18 /end CHARACTERISTIC
/begin CHARACTERISTIC DINH_FId.DFC_Com38DhTooShort_CA "" VAL_BLK 0x8024361C ValA_Wu16 1139.00000000 DINH_FIdVerb 0.00 1139.00000000 FORMAT "%13.8" MATRIX_DIM 23 /end CHARACTERISTIC
/begin CHARACTERISTIC DINH_FId.DFC_Com412hAbsent_CA "" VAL_BLK 0x8024364A ValA_Wu16 1139.00000000 DINH_FIdVerb 0.00 1139.00000000 FORMAT "%13.8" MATRIX_DIM 20 /end CHARACTERISTIC
/begin CHARACTERISTIC DINH_FId.DFC_Com412hChecksum_CA "" VAL_BLK 0x80243672 ValA_Wu16 1139.00000000 DINH_FIdVerb 0.00 1139.00000000 FORMAT "%13.8" MATRIX_DIM 16 /end CHARACTERISTIC
/begin CHARACTERISTIC DINH_FId.DFC_Com412hCounter_CA "" VAL_BLK 0x80243692 ValA_Wu16 1139.00000000 DINH_FIdVerb 0.00 1139.00000000 FORMAT "%13.8" MATRIX_DIM 16 /end CHARACTERISTIC
/begin CHARACTERISTIC DINH_FId.DFC_Com412hTooShort_CA "" VAL_BLK 0x802436B2 ValA_Wu16 1139.00000000 DINH_FIdVerb 0.00 1139.00000000 FORMAT "%13.8" MATRIX_DIM 20 /end CHARACTERISTIC
/begin CHARACTERISTIC DINH_FId.DFC_Com427hAbsent_CA "" VAL_BLK 0x802436DA ValA_Wu16 1139.00000000 DINH_FIdVerb 0.00 1139.00000000 FORMAT "%13.8" MATRIX_DIM 20 /end CHARACTERISTIC
/begin CHARACTERISTIC DINH_FId.DFC_Com427hTooShort_CA "" VAL_BLK 0x80243702 ValA_Wu16 1139.00000000 DINH_FIdVerb 0.00 1139.00000000 FORMAT "%13.8" MATRIX_DIM 20 /end CHARACTERISTIC
/begin CHARACTERISTIC DINH_FId.DFC_Com432hAbsent_CA "" VAL_BLK 0x8024372A ValA_Wu16 1139.00000000 DINH_FIdVerb 0.00 1139.00000000 FORMAT "%13.8" MATRIX_DIM 16 /end CHARACTERISTIC
/begin CHARACTERISTIC DINH_FId.DFC_Com432hChecksum_CA "" VAL_BLK 0x8024374A ValA_Wu16 1139.00000000 DINH_FIdVerb 0.00 1139.00000000 FORMAT "%13.8" MATRIX_DIM 15 /end CHARACTERISTIC
/begin CHARACTERISTIC DINH_FId.DFC_Com432hCounter_CA "" VAL_BLK 0x80243768 ValA_Wu16 1139.00000000 DINH_FIdVerb 0.00 1139.00000000 FORMAT "%13.8" MATRIX_DIM 15 /end CHARACTERISTIC
/begin CHARACTERISTIC DINH_FId.DFC_Com432hTooShort_CA "" VAL_BLK 0x80243786 ValA_Wu16 1139.00000000 DINH_FIdVerb 0.00 1139.00000000 FORMAT "%13.8" MATRIX_DIM 15 /end CHARACTERISTIC
/begin CHARACTERISTIC DINH_FId.DFC_Com435hAbsent_CA "" VAL_BLK 0x802437A4 ValA_Wu16 1139.00000000 DINH_FIdVerb 0.00 1139.00000000 FORMAT "%13.8" MATRIX_DIM 19 /end CHARACTERISTIC
/begin CHARACTERISTIC DINH_FId.DFC_Com435hTooShort_CA "" VAL_BLK 0x802437CA ValA_Wu16 1139.00000000 DINH_FIdVerb 0.00 1139.00000000 FORMAT "%13.8" MATRIX_DIM 19 /end CHARACTERISTIC
/begin CHARACTERISTIC DINH_FId.DFC_Com442hAbsent_CA "" VAL_BLK 0x802437F0 ValA_Wu16 1139.00000000 DINH_FIdVerb 0.00 1139.00000000 FORMAT "%13.8" MATRIX_DIM 16 /end CHARACTERISTIC
/begin CHARACTERISTIC DINH_FId.DFC_Com442hTooShort_CA "" VAL_BLK 0x80243810 ValA_Wu16 1139.00000000 DINH_FIdVerb 0.00 1139.00000000 FORMAT "%13.8" MATRIX_DIM 16 /end CHARACTERISTIC
/begin CHARACTERISTIC DINH_FId.DFC_Com453hAbsent_CA "" VAL_BLK 0x80243830 ValA_Wu16 1139.00000000 DINH_FIdVerb 0.00 1139.00000000 FORMAT "%13.8" MATRIX_DIM 24 /end CHARACTERISTIC
/begin CHARACTERISTIC DINH_FId.DFC_Com453hTooShort_CA "" VAL_BLK 0x80243860 ValA_Wu16 1139.00000000 DINH_FIdVerb 0.00 1139.00000000 FORMAT "%13.8" MATRIX_DIM 24 /end CHARACTERISTIC
/begin CHARACTERISTIC DINH_FId.DFC_Com455hAbsent_CA "" VAL_BLK 0x80243890 ValA_Wu16 1139.00000000 DINH_FIdVerb 0.00 1139.00000000 FORMAT "%13.8" MATRIX_DIM 18 /end CHARACTERISTIC
/begin CHARACTERISTIC DINH_FId.DFC_Com455hTooShort_CA "" VAL_BLK 0x802438B4 ValA_Wu16 1139.00000000 DINH_FIdVerb 0.00 1139.00000000 FORMAT "%13.8" MATRIX_DIM 18 /end CHARACTERISTIC
/begin CHARACTERISTIC DINH_FId.DFC_Com463hAbsent_CA "" VAL_BLK 0x802438D8 ValA_Wu16 1139.00000000 DINH_FIdVerb 0.00 1139.00000000 FORMAT "%13.8" MATRIX_DIM 18 /end CHARACTERISTIC
/begin CHARACTERISTIC DINH_FId.DFC_Com463hTooShort_CA "" VAL_BLK 0x802438FC ValA_Wu16 1139.00000000 DINH_FIdVerb 0.00 1139.00000000 FORMAT "%13.8" MATRIX_DIM 18 /end CHARACTERISTIC
/begin CHARACTERISTIC DINH_FId.DFC_Com473hAbsent_CA "" VAL_BLK 0x80243920 ValA_Wu16 1139.00000000 DINH_FIdVerb 0.00 1139.00000000 FORMAT "%13.8" MATRIX_DIM 17 /end CHARACTERISTIC
/begin CHARACTERISTIC DINH_FId.DFC_Com473hTooShort_CA "" VAL_BLK 0x80243942 ValA_Wu16 1139.00000000 DINH_FIdVerb 0.00 1139.00000000 FORMAT "%13.8" MATRIX_DIM 17 /end CHARACTERISTIC
/begin CHARACTERISTIC DINH_FId.DFC_Com47BhAbsent_CA "" VAL_BLK 0x80243964 ValA_Wu16 1139.00000000 DINH_FIdVerb 0.00 1139.00000000 FORMAT "%13.8" MATRIX_DIM 17 /end CHARACTERISTIC
/begin CHARACTERISTIC DINH_FId.DFC_Com47BhTooShort_CA "" VAL_BLK 0x80243986 ValA_Wu16 1139.00000000 DINH_FIdVerb 0.00 1139.00000000 FORMAT "%13.8" MATRIX_DIM 17 /end CHARACTERISTIC
/begin CHARACTERISTIC DINH_FId.DFC_Com48BhAbsent_CA "" VAL_BLK 0x802439A8 ValA_Wu16 1139.00000000 DINH_FIdVerb 0.00 1139.00000000 FORMAT "%13.8" MATRIX_DIM 15 /end CHARACTERISTIC
/begin CHARACTERISTIC DINH_FId.DFC_Com48BhTooShort_CA "" VAL_BLK 0x802439C6 ValA_Wu16 1139.00000000 DINH_FIdVerb 0.00 1139.00000000 FORMAT "%13.8" MATRIX_DIM 15 /end CHARACTERISTIC
/begin CHARACTERISTIC DINH_FId.DFC_Com497hTooShort_CA "" VAL_BLK 0x802439E4 ValA_Wu16 1139.00000000 DINH_FIdVerb 0.00 1139.00000000 FORMAT "%13.8" MATRIX_DIM 15 /end CHARACTERISTIC
/begin CHARACTERISTIC DINH_FId.DFC_Com4F2hAbsent_CA "" VAL_BLK 0x80243A02 ValA_Wu16 1139.00000000 DINH_FIdVerb 0.00 1139.00000000 FORMAT "%13.8" MATRIX_DIM 15 /end CHARACTERISTIC
/begin CHARACTERISTIC DINH_FId.DFC_Com4F2hChecksum_CA "" VAL_BLK 0x80243A20 ValA_Wu16 1139.00000000 DINH_FIdVerb 0.00 1139.00000000 FORMAT "%13.8" MATRIX_DIM 15 /end CHARACTERISTIC
/begin CHARACTERISTIC DINH_FId.DFC_Com4F2hCounter_CA "" VAL_BLK 0x80243A3E ValA_Wu16 1139.00000000 DINH_FIdVerb 0.00 1139.00000000 FORMAT "%13.8" MATRIX_DIM 15 /end CHARACTERISTIC
/begin CHARACTERISTIC DINH_FId.DFC_Com4F2hTooShort_CA "" VAL_BLK 0x80243A5C ValA_Wu16 1139.00000000 DINH_FIdVerb 0.00 1139.00000000 FORMAT "%13.8" MATRIX_DIM 15 /end CHARACTERISTIC
/begin CHARACTERISTIC DINH_FId.DFC_Com50DhAbsent_CA "" VAL_BLK 0x80243A7A ValA_Wu16 1139.00000000 DINH_FIdVerb 0.00 1139.00000000 FORMAT "%13.8" MATRIX_DIM 15 /end CHARACTERISTIC
/begin CHARACTERISTIC DINH_FId.DFC_Com50DhTooShort_CA "" VAL_BLK 0x80243A98 ValA_Wu16 1139.00000000 DINH_FIdVerb 0.00 1139.00000000 FORMAT "%13.8" MATRIX_DIM 15 /end CHARACTERISTIC
/begin CHARACTERISTIC DINH_FId.DFC_Com535hAbsent_CA "" VAL_BLK 0x80243AB6 ValA_Wu16 1139.00000000 DINH_FIdVerb 0.00 1139.00000000 FORMAT "%13.8" MATRIX_DIM 22 /end CHARACTERISTIC
/begin CHARACTERISTIC DINH_FId.DFC_Com535hTooShort_CA "" VAL_BLK 0x80243AE2 ValA_Wu16 1139.00000000 DINH_FIdVerb 0.00 1139.00000000 FORMAT "%13.8" MATRIX_DIM 22 /end CHARACTERISTIC
/begin CHARACTERISTIC DINH_FId.DFC_Com543hAbsent_CA "" VAL_BLK 0x80243B0E ValA_Wu16 1139.00000000 DINH_FIdVerb 0.00 1139.00000000 FORMAT "%13.8" MATRIX_DIM 19 /end CHARACTERISTIC
/begin CHARACTERISTIC DINH_FId.DFC_Com543hTooShort_CA "" VAL_BLK 0x80243B34 ValA_Wu16 1139.00000000 DINH_FIdVerb 0.00 1139.00000000 FORMAT "%13.8" MATRIX_DIM 19 /end CHARACTERISTIC
/begin CHARACTERISTIC DINH_FId.DFC_Com552hAbsent_CA "" VAL_BLK 0x80243B5A ValA_Wu16 1139.00000000 DINH_FIdVerb 0.00 1139.00000000 FORMAT "%13.8" MATRIX_DIM 15 /end CHARACTERISTIC
/begin CHARACTERISTIC DINH_FId.DFC_Com552hTooShort_CA "" VAL_BLK 0x80243B78 ValA_Wu16 1139.00000000 DINH_FIdVerb 0.00 1139.00000000 FORMAT "%13.8" MATRIX_DIM 15 /end CHARACTERISTIC
/begin CHARACTERISTIC DINH_FId.DFC_Com583hAbsent_CA "" VAL_BLK 0x80243B96 ValA_Wu16 1139.00000000 DINH_FIdVerb 0.00 1139.00000000 FORMAT "%13.8" MATRIX_DIM 16 /end CHARACTERISTIC
/begin CHARACTERISTIC DINH_FId.DFC_Com583hTooShort_CA "" VAL_BLK 0x80243BB6 ValA_Wu16 1139.00000000 DINH_FIdVerb 0.00 1139.00000000 FORMAT "%13.8" MATRIX_DIM 16 /end CHARACTERISTIC
/begin CHARACTERISTIC DINH_FId.DFC_Com592hAbsent_CA "" VAL_BLK 0x80243BD6 ValA_Wu16 1139.00000000 DINH_FIdVerb 0.00 1139.00000000 FORMAT "%13.8" MATRIX_DIM 15 /end CHARACTERISTIC
/begin CHARACTERISTIC DINH_FId.DFC_Com592hChecksum_CA "" VAL_BLK 0x80243BF4 ValA_Wu16 1139.00000000 DINH_FIdVerb 0.00 1139.00000000 FORMAT "%13.8" MATRIX_DIM 15 /end CHARACTERISTIC
/begin CHARACTERISTIC DINH_FId.DFC_Com592hCounter_CA "" VAL_BLK 0x80243C12 ValA_Wu16 1139.00000000 DINH_FIdVerb 0.00 1139.00000000 FORMAT "%13.8" MATRIX_DIM 15 /end CHARACTERISTIC
/begin CHARACTERISTIC DINH_FId.DFC_Com592hTooShort_CA "" VAL_BLK 0x80243C30 ValA_Wu16 1139.00000000 DINH_FIdVerb 0.00 1139.00000000 FORMAT "%13.8" MATRIX_DIM 15 /end CHARACTERISTIC
/begin CHARACTERISTIC DINH_FId.DFC_Com595hAbsent_CA "" VAL_BLK 0x80243C4E ValA_Wu16 1139.00000000 DINH_FIdVerb 0.00 1139.00000000 FORMAT "%13.8" MATRIX_DIM 15 /end CHARACTERISTIC
/begin CHARACTERISTIC DINH_FId.DFC_Com595hChecksum_CA "" VAL_BLK 0x80243C6C ValA_Wu16 1139.00000000 DINH_FIdVerb 0.00 1139.00000000 FORMAT "%13.8" MATRIX_DIM 15 /end CHARACTERISTIC
/begin CHARACTERISTIC DINH_FId.DFC_Com595hCounter_CA "" VAL_BLK 0x80243C8A ValA_Wu16 1139.00000000 DINH_FIdVerb 0.00 1139.00000000 FORMAT "%13.8" MATRIX_DIM 15 /end CHARACTERISTIC
/begin CHARACTERISTIC DINH_FId.DFC_Com595hTooShort_CA "" VAL_BLK 0x80243CA8 ValA_Wu16 1139.00000000 DINH_FIdVerb 0.00 1139.00000000 FORMAT "%13.8" MATRIX_DIM 15 /end CHARACTERISTIC
/begin CHARACTERISTIC DINH_FId.DFC_Com5B2hAbsent_CA "" VAL_BLK 0x80243CC6 ValA_Wu16 1139.00000000 DINH_FIdVerb 0.00 1139.00000000 FORMAT "%13.8" MATRIX_DIM 15 /end CHARACTERISTIC
/begin CHARACTERISTIC DINH_FId.DFC_Com5B2hTooShort_CA "" VAL_BLK 0x80243CE4 ValA_Wu16 1139.00000000 DINH_FIdVerb 0.00 1139.00000000 FORMAT "%13.8" MATRIX_DIM 15 /end CHARACTERISTIC
/begin CHARACTERISTIC DINH_FId.DFC_Com5B5hAbsent_CA "" VAL_BLK 0x80243D02 ValA_Wu16 1139.00000000 DINH_FIdVerb 0.00 1139.00000000 FORMAT "%13.8" MATRIX_DIM 16 /end CHARACTERISTIC
/begin CHARACTERISTIC DINH_FId.DFC_Com5B5hChecksum_CA "" VAL_BLK 0x80243D22 ValA_Wu16 1139.00000000 DINH_FIdVerb 0.00 1139.00000000 FORMAT "%13.8" MATRIX_DIM 16 /end CHARACTERISTIC
/begin CHARACTERISTIC DINH_FId.DFC_Com5B5hCounter_CA "" VAL_BLK 0x80243D42 ValA_Wu16 1139.00000000 DINH_FIdVerb 0.00 1139.00000000 FORMAT "%13.8" MATRIX_DIM 16 /end CHARACTERISTIC
/begin CHARACTERISTIC DINH_FId.DFC_Com5B5hTooShort_CA "" VAL_BLK 0x80243D62 ValA_Wu16 1139.00000000 DINH_FIdVerb 0.00 1139.00000000 FORMAT "%13.8" MATRIX_DIM 16 /end CHARACTERISTIC
/begin CHARACTERISTIC DINH_FId.DFC_Com5C7hTooShort_CA "" VAL_BLK 0x80243D82 ValA_Wu16 1139.00000000 DINH_FIdVerb 0.00 1139.00000000 FORMAT "%13.8" MATRIX_DIM 16 /end CHARACTERISTIC
/begin CHARACTERISTIC DINH_FId.DFC_Com5E7hAbsent_CA "" VAL_BLK 0x80243DA2 ValA_Wu16 1139.00000000 DINH_FIdVerb 0.00 1139.00000000 FORMAT "%13.8" MATRIX_DIM 15 /end CHARACTERISTIC
/begin CHARACTERISTIC DINH_FId.DFC_Com5E7hTooShort_CA "" VAL_BLK 0x80243DC0 ValA_Wu16 1139.00000000 DINH_FIdVerb 0.00 1139.00000000 FORMAT "%13.8" MATRIX_DIM 15 /end CHARACTERISTIC
/begin CHARACTERISTIC DINH_FId.DFC_Com635hTooShort_CA "" VAL_BLK 0x80243DDE ValA_Wu16 1139.00000000 DINH_FIdVerb 0.00 1139.00000000 FORMAT "%13.8" MATRIX_DIM 15 /end CHARACTERISTIC
/begin CHARACTERISTIC DINH_FId.DFC_Com645hTooShort_CA "" VAL_BLK 0x80243DFC ValA_Wu16 1139.00000000 DINH_FIdVerb 0.00 1139.00000000 FORMAT "%13.8" MATRIX_DIM 15 /end CHARACTERISTIC
/begin CHARACTERISTIC DINH_FId.DFC_Com663hAbsent_CA "" VAL_BLK 0x80243E1A ValA_Wu16 1139.00000000 DINH_FIdVerb 0.00 1139.00000000 FORMAT "%13.8" MATRIX_DIM 15 /end CHARACTERISTIC
/begin CHARACTERISTIC DINH_FId.DFC_Com663hTooShort_CA "" VAL_BLK 0x80243E38 ValA_Wu16 1139.00000000 DINH_FIdVerb 0.00 1139.00000000 FORMAT "%13.8" MATRIX_DIM 15 /end CHARACTERISTIC
/begin CHARACTERISTIC DINH_FId.DFC_Com665hAbsent_CA "" VAL_BLK 0x80243E56 ValA_Wu16 1139.00000000 DINH_FIdVerb 0.00 1139.00000000 FORMAT "%13.8" MATRIX_DIM 18 /end CHARACTERISTIC
/begin CHARACTERISTIC DINH_FId.DFC_Com665hTooShort_CA "" VAL_BLK 0x80243E7A ValA_Wu16 1139.00000000 DINH_FIdVerb 0.00 1139.00000000 FORMAT "%13.8" MATRIX_DIM 18 /end CHARACTERISTIC
/begin CHARACTERISTIC DINH_FId.DFC_Com675hAbsent_CA "" VAL_BLK 0x80243E9E ValA_Wu16 1139.00000000 DINH_FIdVerb 0.00 1139.00000000 FORMAT "%13.8" MATRIX_DIM 16 /end CHARACTERISTIC
/begin CHARACTERISTIC DINH_FId.DFC_Com675hTooShort_CA "" VAL_BLK 0x80243EBE ValA_Wu16 1139.00000000 DINH_FIdVerb 0.00 1139.00000000 FORMAT "%13.8" MATRIX_DIM 16 /end CHARACTERISTIC
/begin CHARACTERISTIC DINH_FId.DFC_ComFrbd_205h_HVBAT_PACK_CURRENT_CA "" VAL_BLK 0x80243EDE ValA_Wu16 1139.00000000 DINH_FIdVerb 0.00 1139.00000000 FORMAT "%13.8" MATRIX_DIM 18 /end CHARACTERISTIC
/begin CHARACTERISTIC DINH_FId.DFC_ComFrbd_205h_HVBAT_SOC_DISPLAY_CA "" VAL_BLK 0x80243F02 ValA_Wu16 1139.00000000 DINH_FIdVerb 0.00 1139.00000000 FORMAT "%13.8" MATRIX_DIM 18 /end CHARACTERISTIC
/begin CHARACTERISTIC DINH_FId.DFC_ComFrbd_205h_HVBAT_VOLTAGE_CA "" VAL_BLK 0x80243F26 ValA_Wu16 1139.00000000 DINH_FIdVerb 0.00 1139.00000000 FORMAT "%13.8" MATRIX_DIM 19 /end CHARACTERISTIC
/begin CHARACTERISTIC DINH_FId.DFC_ComFrbd_217h_INV_DC_BUS_VOLTAGE_CA "" VAL_BLK 0x80243F4C ValA_Wu16 1139.00000000 DINH_FIdVerb 0.00 1139.00000000 FORMAT "%13.8" MATRIX_DIM 16 /end CHARACTERISTIC
/begin CHARACTERISTIC DINH_FId.DFC_ComFrbd_217h_INV_MTR_ACTUAL_TRQ_CA "" VAL_BLK 0x80243F6C ValA_Wu16 1139.00000000 DINH_FIdVerb 0.00 1139.00000000 FORMAT "%13.8" MATRIX_DIM 15 /end CHARACTERISTIC
/begin CHARACTERISTIC DINH_FId.DFC_ComFrbd_217h_INV_MTR_SPEED_CA "" VAL_BLK 0x80243F8A ValA_Wu16 1139.00000000 DINH_FIdVerb 0.00 1139.00000000 FORMAT "%13.8" MATRIX_DIM 16 /end CHARACTERISTIC
/begin CHARACTERISTIC DINH_FId.DFC_ComFrbd_217h_INV_MTR_TRQ_CA "" VAL_BLK 0x80243FAA ValA_Wu16 1139.00000000 DINH_FIdVerb 0.00 1139.00000000 FORMAT "%13.8" MATRIX_DIM 15 /end CHARACTERISTIC
/begin CHARACTERISTIC DINH_FId.DFC_ComFrbd_227h_INV_DC_CURRENT_CA "" VAL_BLK 0x80243FC8 ValA_Wu16 1139.00000000 DINH_FIdVerb 0.00 1139.00000000 FORMAT "%13.8" MATRIX_DIM 15 /end CHARACTERISTIC
/begin CHARACTERISTIC DINH_FId.DFC_ComFrbd_227h_INV_MOTORING_PEAK_TRQ_CA "" VAL_BLK 0x80243FE6 ValA_Wu16 1139.00000000 DINH_FIdVerb 0.00 1139.00000000 FORMAT "%13.8" MATRIX_DIM 17 /end CHARACTERISTIC
/begin CHARACTERISTIC DINH_FId.DFC_ComFrbd_227h_INV_MTR_INST_INPUT_POWER_CA "" VAL_BLK 0x80244008 ValA_Wu16 1139.00000000 DINH_FIdVerb 0.00 1139.00000000 FORMAT "%13.8" MATRIX_DIM 15 /end CHARACTERISTIC
/begin CHARACTERISTIC DINH_FId.DFC_ComFrbd_227h_INV_REGEN_PEAK_TRQ_CA "" VAL_BLK 0x80244026 ValA_Wu16 1139.00000000 DINH_FIdVerb 0.00 1139.00000000 FORMAT "%13.8" MATRIX_DIM 17 /end CHARACTERISTIC
/begin CHARACTERISTIC DINH_FId.DFC_ComFrbd_237h_INV_ACTIVE_DISCHARGE_STATUS_CA "" VAL_BLK 0x80244048 ValA_Wu16 1139.00000000 DINH_FIdVerb 0.00 1139.00000000 FORMAT "%13.8" MATRIX_DIM 15 /end CHARACTERISTIC
/begin CHARACTERISTIC DINH_FId.DFC_ComFrbd_237h_INV_CTRL_MODE_ACK_CA "" VAL_BLK 0x80244066 ValA_Wu16 1139.00000000 DINH_FIdVerb 0.00 1139.00000000 FORMAT "%13.8" MATRIX_DIM 15 /end CHARACTERISTIC
/begin CHARACTERISTIC DINH_FId.DFC_ComFrbd_237h_INV_EV_WARNING_CA "" VAL_BLK 0x80244084 ValA_Wu16 1139.00000000 DINH_FIdVerb 0.00 1139.00000000 FORMAT "%13.8" MATRIX_DIM 15 /end CHARACTERISTIC
/begin CHARACTERISTIC DINH_FId.DFC_ComFrbd_237h_INV_FAULT_LEVEL_CA "" VAL_BLK 0x802440A2 ValA_Wu16 1139.00000000 DINH_FIdVerb 0.00 1139.00000000 FORMAT "%13.8" MATRIX_DIM 15 /end CHARACTERISTIC
/begin CHARACTERISTIC DINH_FId.DFC_ComFrbd_237h_INV_MASTER_STOP_CA "" VAL_BLK 0x802440C0 ValA_Wu16 1139.00000000 DINH_FIdVerb 0.00 1139.00000000 FORMAT "%13.8" MATRIX_DIM 15 /end CHARACTERISTIC
/begin CHARACTERISTIC DINH_FId.DFC_ComFrbd_237h_INV_SERVICE_DUE_CA "" VAL_BLK 0x802440DE ValA_Wu16 1139.00000000 DINH_FIdVerb 0.00 1139.00000000 FORMAT "%13.8" MATRIX_DIM 15 /end CHARACTERISTIC
/begin CHARACTERISTIC DINH_FId.DFC_ComFrbd_237h_INV_STAB_MIN_TRQ_CA "" VAL_BLK 0x802440FC ValA_Wu16 1139.00000000 DINH_FIdVerb 0.00 1139.00000000 FORMAT "%13.8" MATRIX_DIM 15 /end CHARACTERISTIC
/begin CHARACTERISTIC DINH_FId.DFC_ComFrbd_259h_TGLM_FAILURE_STATE_CA "" VAL_BLK 0x8024411A ValA_Wu16 1139.00000000 DINH_FIdVerb 0.00 1139.00000000 FORMAT "%13.8" MATRIX_DIM 15 /end CHARACTERISTIC
/begin CHARACTERISTIC DINH_FId.DFC_ComFrbd_259h_TGLM_MODE_PUSH_CA "" VAL_BLK 0x80244138 ValA_Wu16 1139.00000000 DINH_FIdVerb 0.00 1139.00000000 FORMAT "%13.8" MATRIX_DIM 15 /end CHARACTERISTIC
/begin CHARACTERISTIC DINH_FId.DFC_ComFrbd_259h_TOGGLE_MONOSTABLE_POS_CA "" VAL_BLK 0x80244156 ValA_Wu16 1139.00000000 DINH_FIdVerb 0.00 1139.00000000 FORMAT "%13.8" MATRIX_DIM 15 /end CHARACTERISTIC
/begin CHARACTERISTIC DINH_FId.DFC_ComFrbd_273h_OBC_outputpower_capability_CA "" VAL_BLK 0x80244174 ValA_Wu16 1139.00000000 DINH_FIdVerb 0.00 1139.00000000 FORMAT "%13.8" MATRIX_DIM 15 /end CHARACTERISTIC
/begin CHARACTERISTIC DINH_FId.DFC_ComFrbd_275h_HVBAT_DISCHARGE_30S_AVAILABLE_CURRENT_CA "" VAL_BLK 0x80244192 ValA_Wu16 1139.00000000 DINH_FIdVerb 0.00 1139.00000000 FORMAT "%13.8" MATRIX_DIM 15 /end CHARACTERISTIC
/begin CHARACTERISTIC DINH_FId.DFC_ComFrbd_275h_HVBAT_DISCHARGE_30S_AVAILABLE_POWER_CA "" VAL_BLK 0x802441B0 ValA_Wu16 1139.00000000 DINH_FIdVerb 0.00 1139.00000000 FORMAT "%13.8" MATRIX_DIM 15 /end CHARACTERISTIC
/begin CHARACTERISTIC DINH_FId.DFC_ComFrbd_283h_DCDC_IN_CURRENT_CA "" VAL_BLK 0x802441CE ValA_Wu16 1139.00000000 DINH_FIdVerb 0.00 1139.00000000 FORMAT "%13.8" MATRIX_DIM 15 /end CHARACTERISTIC
/begin CHARACTERISTIC DINH_FId.DFC_ComFrbd_283h_DCDC_IN_VOLTAGE_CA "" VAL_BLK 0x802441EC ValA_Wu16 1139.00000000 DINH_FIdVerb 0.00 1139.00000000 FORMAT "%13.8" MATRIX_DIM 15 /end CHARACTERISTIC
/begin CHARACTERISTIC DINH_FId.DFC_ComFrbd_283h_DCDC_OUT_CURRENT_CA "" VAL_BLK 0x8024420A ValA_Wu16 1139.00000000 DINH_FIdVerb 0.00 1139.00000000 FORMAT "%13.8" MATRIX_DIM 15 /end CHARACTERISTIC
/begin CHARACTERISTIC DINH_FId.DFC_ComFrbd_283h_DCDC_OUT_VOLTAGE_CA "" VAL_BLK 0x80244228 ValA_Wu16 1139.00000000 DINH_FIdVerb 0.00 1139.00000000 FORMAT "%13.8" MATRIX_DIM 15 /end CHARACTERISTIC
/begin CHARACTERISTIC DINH_FId.DFC_ComFrbd_285h_HVBAT_REGEN_CHG_30S_CURRENT_LIMIT_CA "" VAL_BLK 0x80244246 ValA_Wu16 1139.00000000 DINH_FIdVerb 0.00 1139.00000000 FORMAT "%13.8" MATRIX_DIM 15 /end CHARACTERISTIC
/begin CHARACTERISTIC DINH_FId.DFC_ComFrbd_285h_HVBAT_REGEN_CHRG_30S_POWER_LIMIT_CA "" VAL_BLK 0x80244264 ValA_Wu16 1139.00000000 DINH_FIdVerb 0.00 1139.00000000 FORMAT "%13.8" MATRIX_DIM 15 /end CHARACTERISTIC
/begin CHARACTERISTIC DINH_FId.DFC_ComFrbd_293h_DCDC_outputpower_capability_CA "" VAL_BLK 0x80244282 ValA_Wu16 1139.00000000 DINH_FIdVerb 0.00 1139.00000000 FORMAT "%13.8" MATRIX_DIM 15 /end CHARACTERISTIC
/begin CHARACTERISTIC DINH_FId.DFC_ComFrbd_325h_HVBAT_INSULATION_RESISTANCE_CA "" VAL_BLK 0x802442A0 ValA_Wu16 1139.00000000 DINH_FIdVerb 0.00 1139.00000000 FORMAT "%13.8" MATRIX_DIM 15 /end CHARACTERISTIC
/begin CHARACTERISTIC DINH_FId.DFC_ComFrbd_325h_HVBAT_TEMPERATURE_CA "" VAL_BLK 0x802442BE ValA_Wu16 1139.00000000 DINH_FIdVerb 0.00 1139.00000000 FORMAT "%13.8" MATRIX_DIM 15 /end CHARACTERISTIC
/begin CHARACTERISTIC DINH_FId.DFC_ComFrbd_335h_HVBAT_CHRG_CONTINUOUS_CURR_MAX_CA "" VAL_BLK 0x802442DC ValA_Wu16 1139.00000000 DINH_FIdVerb 0.00 1139.00000000 FORMAT "%13.8" MATRIX_DIM 15 /end CHARACTERISTIC
/begin CHARACTERISTIC DINH_FId.DFC_ComFrbd_335h_HVBAT_CHRG_COTINUOUS_CURR_REQ_CA "" VAL_BLK 0x802442FA ValA_Wu16 1139.00000000 DINH_FIdVerb 0.00 1139.00000000 FORMAT "%13.8" MATRIX_DIM 18 /end CHARACTERISTIC
/begin CHARACTERISTIC DINH_FId.DFC_ComFrbd_335h_HVBAT_CHRG_MAX_VOLT_CA "" VAL_BLK 0x8024431E ValA_Wu16 1139.00000000 DINH_FIdVerb 0.00 1139.00000000 FORMAT "%13.8" MATRIX_DIM 18 /end CHARACTERISTIC
/begin CHARACTERISTIC DINH_FId.DFC_ComFrbd_335h_HVBAT_DC_BUS_VOLTAGE_CA "" VAL_BLK 0x80244342 ValA_Wu16 1139.00000000 DINH_FIdVerb 0.00 1139.00000000 FORMAT "%13.8" MATRIX_DIM 16 /end CHARACTERISTIC
/begin CHARACTERISTIC DINH_FId.DFC_ComFrbd_427h_INV_OP_MODE_CA "" VAL_BLK 0x80244362 ValA_Wu16 1139.00000000 DINH_FIdVerb 0.00 1139.00000000 FORMAT "%13.8" MATRIX_DIM 15 /end CHARACTERISTIC
/begin CHARACTERISTIC DINH_FId.DFC_ComFrbd_427h_INV_PERMISIBLE_TORQUE_CA "" VAL_BLK 0x80244380 ValA_Wu16 1139.00000000 DINH_FIdVerb 0.00 1139.00000000 FORMAT "%13.8" MATRIX_DIM 15 /end CHARACTERISTIC
/begin CHARACTERISTIC DINH_FId.DFC_ComFrbd_435h_HVBAT_MAX_CELL_VOLT_CA "" VAL_BLK 0x8024439E ValA_Wu16 1139.00000000 DINH_FIdVerb 0.00 1139.00000000 FORMAT "%13.8" MATRIX_DIM 15 /end CHARACTERISTIC
/begin CHARACTERISTIC DINH_FId.DFC_ComFrbd_435h_HVBAT_MAX_CELL_VOLT_NUM_CA "" VAL_BLK 0x802443BC ValA_Wu16 1139.00000000 DINH_FIdVerb 0.00 1139.00000000 FORMAT "%13.8" MATRIX_DIM 15 /end CHARACTERISTIC
/begin CHARACTERISTIC DINH_FId.DFC_ComFrbd_435h_HVBAT_MAX_SENSOR_TEMP_CA "" VAL_BLK 0x802443DA ValA_Wu16 1139.00000000 DINH_FIdVerb 0.00 1139.00000000 FORMAT "%13.8" MATRIX_DIM 15 /end CHARACTERISTIC
/begin CHARACTERISTIC DINH_FId.DFC_ComFrbd_435h_HVBAT_MIN_CELL_VOLT_CA "" VAL_BLK 0x802443F8 ValA_Wu16 1139.00000000 DINH_FIdVerb 0.00 1139.00000000 FORMAT "%13.8" MATRIX_DIM 15 /end CHARACTERISTIC
/begin CHARACTERISTIC DINH_FId.DFC_ComFrbd_435h_HVBAT_MIN_CELL_VOLT_NUM_CA "" VAL_BLK 0x80244416 ValA_Wu16 1139.00000000 DINH_FIdVerb 0.00 1139.00000000 FORMAT "%13.8" MATRIX_DIM 15 /end CHARACTERISTIC
/begin CHARACTERISTIC DINH_FId.DFC_ComFrbd_453h_OBC_IN_CURRENT_CA "" VAL_BLK 0x80244434 ValA_Wu16 1139.00000000 DINH_FIdVerb 0.00 1139.00000000 FORMAT "%13.8" MATRIX_DIM 16 /end CHARACTERISTIC
/begin CHARACTERISTIC DINH_FId.DFC_ComFrbd_453h_OBC_IN_VOLTAGE_CA "" VAL_BLK 0x80244454 ValA_Wu16 1139.00000000 DINH_FIdVerb 0.00 1139.00000000 FORMAT "%13.8" MATRIX_DIM 15 /end CHARACTERISTIC
/begin CHARACTERISTIC DINH_FId.DFC_ComFrbd_453h_OBC_IP_POWER_CA "" VAL_BLK 0x80244472 ValA_Wu16 1139.00000000 DINH_FIdVerb 0.00 1139.00000000 FORMAT "%13.8" MATRIX_DIM 15 /end CHARACTERISTIC
/begin CHARACTERISTIC DINH_FId.DFC_ComFrbd_455h_HVBAT_NOMINAL_VOLTAGE_CA "" VAL_BLK 0x80244490 ValA_Wu16 1139.00000000 DINH_FIdVerb 0.00 1139.00000000 FORMAT "%13.8" MATRIX_DIM 18 /end CHARACTERISTIC
/begin CHARACTERISTIC DINH_FId.DFC_ComFrbd_463h_OBC_OUT_CURRENT_CA "" VAL_BLK 0x802444B4 ValA_Wu16 1139.00000000 DINH_FIdVerb 0.00 1139.00000000 FORMAT "%13.8" MATRIX_DIM 16 /end CHARACTERISTIC
/begin CHARACTERISTIC DINH_FId.DFC_ComFrbd_463h_OBC_OUT_VOLTAGE_CA "" VAL_BLK 0x802444D4 ValA_Wu16 1139.00000000 DINH_FIdVerb 0.00 1139.00000000 FORMAT "%13.8" MATRIX_DIM 16 /end CHARACTERISTIC
/begin CHARACTERISTIC DINH_FId.DFC_ComFrbd_463h_OBC_TEMPERATURE_CA "" VAL_BLK 0x802444F4 ValA_Wu16 1139.00000000 DINH_FIdVerb 0.00 1139.00000000 FORMAT "%13.8" MATRIX_DIM 16 /end CHARACTERISTIC
/begin CHARACTERISTIC DINH_FId.DFC_ComFrbd_473h_DCDC_Coolant_Temperature_CA "" VAL_BLK 0x80244514 ValA_Wu16 1139.00000000 DINH_FIdVerb 0.00 1139.00000000 FORMAT "%13.8" MATRIX_DIM 15 /end CHARACTERISTIC
/begin CHARACTERISTIC DINH_FId.DFC_ComFrbd_473h_DCDC_TEMPERATURE_CA "" VAL_BLK 0x80244532 ValA_Wu16 1139.00000000 DINH_FIdVerb 0.00 1139.00000000 FORMAT "%13.8" MATRIX_DIM 17 /end CHARACTERISTIC
/begin CHARACTERISTIC DINH_FId.DFC_ComFrbd_47Bh_eCOMP_BusBarCurrent_CA "" VAL_BLK 0x80244554 ValA_Wu16 1139.00000000 DINH_FIdVerb 0.00 1139.00000000 FORMAT "%13.8" MATRIX_DIM 15 /end CHARACTERISTIC
/begin CHARACTERISTIC DINH_FId.DFC_ComFrbd_47Bh_eCOMP_BusBarVoltage_CA "" VAL_BLK 0x80244572 ValA_Wu16 1139.00000000 DINH_FIdVerb 0.00 1139.00000000 FORMAT "%13.8" MATRIX_DIM 15 /end CHARACTERISTIC
/begin CHARACTERISTIC DINH_FId.DFC_ComFrbd_47Bh_eCOMP_CompressorSpeed_CA "" VAL_BLK 0x80244590 ValA_Wu16 1139.00000000 DINH_FIdVerb 0.00 1139.00000000 FORMAT "%13.8" MATRIX_DIM 15 /end CHARACTERISTIC
/begin CHARACTERISTIC DINH_FId.DFC_ComFrbd_47Bh_eCOMP_IGBT_Temp_CA "" VAL_BLK 0x802445AE ValA_Wu16 1139.00000000 DINH_FIdVerb 0.00 1139.00000000 FORMAT "%13.8" MATRIX_DIM 15 /end CHARACTERISTIC
/begin CHARACTERISTIC DINH_FId.DFC_ComFrbd_47Bh_eCOMP_PeakPhaCurrent_CA "" VAL_BLK 0x802445CC ValA_Wu16 1139.00000000 DINH_FIdVerb 0.00 1139.00000000 FORMAT "%13.8" MATRIX_DIM 15 /end CHARACTERISTIC
/begin CHARACTERISTIC DINH_FId.DFC_ComFrbd_47Bh_eCOMP_Power_consumption_CA "" VAL_BLK 0x802445EA ValA_Wu16 1139.00000000 DINH_FIdVerb 0.00 1139.00000000 FORMAT "%13.8" MATRIX_DIM 15 /end CHARACTERISTIC
/begin CHARACTERISTIC DINH_FId.DFC_ComFrbd_48Bh_eCOMP_Fault_Level_CA "" VAL_BLK 0x80244608 ValA_Wu16 1139.00000000 DINH_FIdVerb 0.00 1139.00000000 FORMAT "%13.8" MATRIX_DIM 15 /end CHARACTERISTIC
/begin CHARACTERISTIC DINH_FId.DFC_ComFrbd_4F2h_VALEUR_SOC_ETENDUE_CA "" VAL_BLK 0x80244626 ValA_Wu16 1139.00000000 DINH_FIdVerb 0.00 1139.00000000 FORMAT "%13.8" MATRIX_DIM 15 /end CHARACTERISTIC
/begin CHARACTERISTIC DINH_FId.DFC_ComFrbd_535h_HV_BATT_TEMP_AVG_CA "" VAL_BLK 0x80244644 ValA_Wu16 1139.00000000 DINH_FIdVerb 0.00 1139.00000000 FORMAT "%13.8" MATRIX_DIM 15 /end CHARACTERISTIC
/begin CHARACTERISTIC DINH_FId.DFC_ComFrbd_543h_HVBAT_RESTBATTENERGY_CA "" VAL_BLK 0x80244662 ValA_Wu16 1139.00000000 DINH_FIdVerb 0.00 1139.00000000 FORMAT "%13.8" MATRIX_DIM 15 /end CHARACTERISTIC
/begin CHARACTERISTIC DINH_FId.DFC_ComFrbd_543h_HVBAT_SOH_CA "" VAL_BLK 0x80244680 ValA_Wu16 1139.00000000 DINH_FIdVerb 0.00 1139.00000000 FORMAT "%13.8" MATRIX_DIM 15 /end CHARACTERISTIC
/begin CHARACTERISTIC DINH_FId.DFC_ComFrbd_543h_HV_BATT_SOH_RES_CA "" VAL_BLK 0x8024469E ValA_Wu16 1139.00000000 DINH_FIdVerb 0.00 1139.00000000 FORMAT "%13.8" MATRIX_DIM 15 /end CHARACTERISTIC
/begin CHARACTERISTIC DINH_FId.DFC_ComFrbd_592h_IBATT_1_CA "" VAL_BLK 0x802446BC ValA_Wu16 1139.00000000 DINH_FIdVerb 0.00 1139.00000000 FORMAT "%13.8" MATRIX_DIM 15 /end CHARACTERISTIC
/begin CHARACTERISTIC DINH_FId.DFC_ComFrbd_592h_IBATT_2_CA "" VAL_BLK 0x802446DA ValA_Wu16 1139.00000000 DINH_FIdVerb 0.00 1139.00000000 FORMAT "%13.8" MATRIX_DIM 15 /end CHARACTERISTIC
/begin CHARACTERISTIC DINH_FId.DFC_ComFrbd_592h_IBATT_3_CA "" VAL_BLK 0x802446F8 ValA_Wu16 1139.00000000 DINH_FIdVerb 0.00 1139.00000000 FORMAT "%13.8" MATRIX_DIM 15 /end CHARACTERISTIC
/begin CHARACTERISTIC DINH_FId.DFC_ComFrbd_592h_TEMP_BATT_CA "" VAL_BLK 0x80244716 ValA_Wu16 1139.00000000 DINH_FIdVerb 0.00 1139.00000000 FORMAT "%13.8" MATRIX_DIM 15 /end CHARACTERISTIC
/begin CHARACTERISTIC DINH_FId.DFC_ComFrbd_592h_U_BATT_BECB_CA "" VAL_BLK 0x80244734 ValA_Wu16 1139.00000000 DINH_FIdVerb 0.00 1139.00000000 FORMAT "%13.8" MATRIX_DIM 15 /end CHARACTERISTIC
/begin CHARACTERISTIC DINH_FId.DFC_ComFrbd_595h_HVBAT_TIME_TO_CHRG_80_CA "" VAL_BLK 0x80244752 ValA_Wu16 1139.00000000 DINH_FIdVerb 0.00 1139.00000000 FORMAT "%13.8" MATRIX_DIM 15 /end CHARACTERISTIC
/begin CHARACTERISTIC DINH_FId.DFC_ComFrbd_5B2h_TEMP_AIR_EXT_CA "" VAL_BLK 0x80244770 ValA_Wu16 1139.00000000 DINH_FIdVerb 0.00 1139.00000000 FORMAT "%13.8" MATRIX_DIM 15 /end CHARACTERISTIC
/begin CHARACTERISTIC DINH_FId.DFC_ComFrbd_635h_HVBAT_NEG_CONT_COUNT_SEG1_CA "" VAL_BLK 0x8024478E ValA_Wu16 1139.00000000 DINH_FIdVerb 0.00 1139.00000000 FORMAT "%13.8" MATRIX_DIM 15 /end CHARACTERISTIC
/begin CHARACTERISTIC DINH_FId.DFC_ComFrbd_635h_HVBAT_NEG_CONT_COUNT_SEG3_CA "" VAL_BLK 0x802447AC ValA_Wu16 1139.00000000 DINH_FIdVerb 0.00 1139.00000000 FORMAT "%13.8" MATRIX_DIM 15 /end CHARACTERISTIC
/begin CHARACTERISTIC DINH_FId.DFC_ComFrbd_635h_HVBAT_NEG_CONT_COUNT_SEG4_CA "" VAL_BLK 0x802447CA ValA_Wu16 1139.00000000 DINH_FIdVerb 0.00 1139.00000000 FORMAT "%13.8" MATRIX_DIM 15 /end CHARACTERISTIC
/begin CHARACTERISTIC DINH_FId.DFC_ComFrbd_635h_HVBAT_PST_CONT_COUNT_SEG1_CA "" VAL_BLK 0x802447E8 ValA_Wu16 1139.00000000 DINH_FIdVerb 0.00 1139.00000000 FORMAT "%13.8" MATRIX_DIM 15 /end CHARACTERISTIC
/begin CHARACTERISTIC DINH_FId.DFC_ComFrbd_635h_HVBAT_PST_CONT_COUNT_SEG3_CA "" VAL_BLK 0x80244806 ValA_Wu16 1139.00000000 DINH_FIdVerb 0.00 1139.00000000 FORMAT "%13.8" MATRIX_DIM 15 /end CHARACTERISTIC
/begin CHARACTERISTIC DINH_FId.DFC_ComFrbd_635h_HVBAT_PST_CONT_COUNT_SEG4_CA "" VAL_BLK 0x80244824 ValA_Wu16 1139.00000000 DINH_FIdVerb 0.00 1139.00000000 FORMAT "%13.8" MATRIX_DIM 15 /end CHARACTERISTIC
/begin CHARACTERISTIC DINH_FId.DFC_ComFrbd_645h_HVBAT_PRECHRGE_CONT_COUNT_SEG1_CA "" VAL_BLK 0x80244842 ValA_Wu16 1139.00000000 DINH_FIdVerb 0.00 1139.00000000 FORMAT "%13.8" MATRIX_DIM 15 /end CHARACTERISTIC
/begin CHARACTERISTIC DINH_FId.DFC_ComFrbd_645h_HVBAT_PRECHRGE_CONT_COUNT_SEG2_CA "" VAL_BLK 0x80244860 ValA_Wu16 1139.00000000 DINH_FIdVerb 0.00 1139.00000000 FORMAT "%13.8" MATRIX_DIM 15 /end CHARACTERISTIC
/begin CHARACTERISTIC DINH_FId.DFC_ComFrbd_675h_HVBAT_REMAININGBATTCAPACITY_CA "" VAL_BLK 0x8024487E ValA_Wu16 1139.00000000 DINH_FIdVerb 0.00 1139.00000000 FORMAT "%13.8" MATRIX_DIM 15 /end CHARACTERISTIC
/begin CHARACTERISTIC DINH_FId.DFC_ComInvld_205h_HVBAT_CHARGING_STATUS_CA "" VAL_BLK 0x8024489C ValA_Wu16 1139.00000000 DINH_FIdVerb 0.00 1139.00000000 FORMAT "%13.8" MATRIX_DIM 15 /end CHARACTERISTIC
/begin CHARACTERISTIC DINH_FId.DFC_ComInvld_205h_HVBAT_PACK_CURRENT_CA "" VAL_BLK 0x802448BA ValA_Wu16 1139.00000000 DINH_FIdVerb 0.00 1139.00000000 FORMAT "%13.8" MATRIX_DIM 18 /end CHARACTERISTIC
/begin CHARACTERISTIC DINH_FId.DFC_ComInvld_205h_HVBAT_SOC_DISPLAY_CA "" VAL_BLK 0x802448DE ValA_Wu16 1139.00000000 DINH_FIdVerb 0.00 1139.00000000 FORMAT "%13.8" MATRIX_DIM 18 /end CHARACTERISTIC
/begin CHARACTERISTIC DINH_FId.DFC_ComInvld_205h_HVBAT_VOLTAGE_CA "" VAL_BLK 0x80244902 ValA_Wu16 1139.00000000 DINH_FIdVerb 0.00 1139.00000000 FORMAT "%13.8" MATRIX_DIM 19 /end CHARACTERISTIC
/begin CHARACTERISTIC DINH_FId.DFC_ComInvld_217h_INV_DC_BUS_VOLTAGE_CA "" VAL_BLK 0x80244928 ValA_Wu16 1139.00000000 DINH_FIdVerb 0.00 1139.00000000 FORMAT "%13.8" MATRIX_DIM 16 /end CHARACTERISTIC
/begin CHARACTERISTIC DINH_FId.DFC_ComInvld_217h_INV_MTR_ACTUAL_TRQ_CA "" VAL_BLK 0x80244948 ValA_Wu16 1139.00000000 DINH_FIdVerb 0.00 1139.00000000 FORMAT "%13.8" MATRIX_DIM 16 /end CHARACTERISTIC
/begin CHARACTERISTIC DINH_FId.DFC_ComInvld_217h_INV_MTR_SPEED_CA "" VAL_BLK 0x80244968 ValA_Wu16 1139.00000000 DINH_FIdVerb 0.00 1139.00000000 FORMAT "%13.8" MATRIX_DIM 16 /end CHARACTERISTIC
/begin CHARACTERISTIC DINH_FId.DFC_ComInvld_217h_INV_MTR_TRQ_CA "" VAL_BLK 0x80244988 ValA_Wu16 1139.00000000 DINH_FIdVerb 0.00 1139.00000000 FORMAT "%13.8" MATRIX_DIM 15 /end CHARACTERISTIC
/begin CHARACTERISTIC DINH_FId.DFC_ComInvld_227h_INV_DC_CURRENT_CA "" VAL_BLK 0x802449A6 ValA_Wu16 1139.00000000 DINH_FIdVerb 0.00 1139.00000000 FORMAT "%13.8" MATRIX_DIM 15 /end CHARACTERISTIC
/begin CHARACTERISTIC DINH_FId.DFC_ComInvld_227h_INV_MOTORING_PEAK_TRQ_CA "" VAL_BLK 0x802449C4 ValA_Wu16 1139.00000000 DINH_FIdVerb 0.00 1139.00000000 FORMAT "%13.8" MATRIX_DIM 17 /end CHARACTERISTIC
/begin CHARACTERISTIC DINH_FId.DFC_ComInvld_227h_INV_MTR_INST_INPUT_POWER_CA "" VAL_BLK 0x802449E6 ValA_Wu16 1139.00000000 DINH_FIdVerb 0.00 1139.00000000 FORMAT "%13.8" MATRIX_DIM 15 /end CHARACTERISTIC
/begin CHARACTERISTIC DINH_FId.DFC_ComInvld_227h_INV_REGEN_PEAK_TRQ_CA "" VAL_BLK 0x80244A04 ValA_Wu16 1139.00000000 DINH_FIdVerb 0.00 1139.00000000 FORMAT "%13.8" MATRIX_DIM 17 /end CHARACTERISTIC
/begin CHARACTERISTIC DINH_FId.DFC_ComInvld_237h_INV_ACTIVE_DISCHARGE_STATUS_CA "" VAL_BLK 0x80244A26 ValA_Wu16 1139.00000000 DINH_FIdVerb 0.00 1139.00000000 FORMAT "%13.8" MATRIX_DIM 15 /end CHARACTERISTIC
/begin CHARACTERISTIC DINH_FId.DFC_ComInvld_237h_INV_FAULT_LEVEL_CA "" VAL_BLK 0x80244A44 ValA_Wu16 1139.00000000 DINH_FIdVerb 0.00 1139.00000000 FORMAT "%13.8" MATRIX_DIM 15 /end CHARACTERISTIC
/begin CHARACTERISTIC DINH_FId.DFC_ComInvld_237h_INV_STAB_MIN_TRQ_CA "" VAL_BLK 0x80244A62 ValA_Wu16 1139.00000000 DINH_FIdVerb 0.00 1139.00000000 FORMAT "%13.8" MATRIX_DIM 15 /end CHARACTERISTIC
/begin CHARACTERISTIC DINH_FId.DFC_ComInvld_259h_TGLM_MODE_PUSH_CA "" VAL_BLK 0x80244A80 ValA_Wu16 1139.00000000 DINH_FIdVerb 0.00 1139.00000000 FORMAT "%13.8" MATRIX_DIM 15 /end CHARACTERISTIC
/begin CHARACTERISTIC DINH_FId.DFC_ComInvld_259h_TOGGLE_MONOSTABLE_POS_CA "" VAL_BLK 0x80244A9E ValA_Wu16 1139.00000000 DINH_FIdVerb 0.00 1139.00000000 FORMAT "%13.8" MATRIX_DIM 15 /end CHARACTERISTIC
/begin CHARACTERISTIC DINH_FId.DFC_ComInvld_26h_AC_SWITCH_REQ_CA "" VAL_BLK 0x80244ABC ValA_Wu16 1139.00000000 DINH_FIdVerb 0.00 1139.00000000 FORMAT "%13.8" MATRIX_DIM 15 /end CHARACTERISTIC
/begin CHARACTERISTIC DINH_FId.DFC_ComInvld_26h_BLOWER_POSITION_CA "" VAL_BLK 0x80244ADA ValA_Wu16 1139.00000000 DINH_FIdVerb 0.00 1139.00000000 FORMAT "%13.8" MATRIX_DIM 15 /end CHARACTERISTIC
/begin CHARACTERISTIC DINH_FId.DFC_ComInvld_26h_EVAP_SENSOR_FAULT_CA "" VAL_BLK 0x80244AF8 ValA_Wu16 1139.00000000 DINH_FIdVerb 0.00 1139.00000000 FORMAT "%13.8" MATRIX_DIM 15 /end CHARACTERISTIC
/begin CHARACTERISTIC DINH_FId.DFC_ComInvld_26h_EVAP_SENSOR_VALUE_CA "" VAL_BLK 0x80244B16 ValA_Wu16 1139.00000000 DINH_FIdVerb 0.00 1139.00000000 FORMAT "%13.8" MATRIX_DIM 15 /end CHARACTERISTIC
/begin CHARACTERISTIC DINH_FId.DFC_ComInvld_26h_POTENTIOMETER_FAULT_CA "" VAL_BLK 0x80244B34 ValA_Wu16 1139.00000000 DINH_FIdVerb 0.00 1139.00000000 FORMAT "%13.8" MATRIX_DIM 15 /end CHARACTERISTIC
/begin CHARACTERISTIC DINH_FId.DFC_ComInvld_26h_REAR_DEFOG_REQ_CA "" VAL_BLK 0x80244B52 ValA_Wu16 1139.00000000 DINH_FIdVerb 0.00 1139.00000000 FORMAT "%13.8" MATRIX_DIM 15 /end CHARACTERISTIC
/begin CHARACTERISTIC DINH_FId.DFC_ComInvld_26h_TEMP_POSITION_CA "" VAL_BLK 0x80244B70 ValA_Wu16 1139.00000000 DINH_FIdVerb 0.00 1139.00000000 FORMAT "%13.8" MATRIX_DIM 15 /end CHARACTERISTIC
/begin CHARACTERISTIC DINH_FId.DFC_ComInvld_273h_OBC_FAULT_LEVEL_CA "" VAL_BLK 0x80244B8E ValA_Wu16 1139.00000000 DINH_FIdVerb 0.00 1139.00000000 FORMAT "%13.8" MATRIX_DIM 15 /end CHARACTERISTIC
/begin CHARACTERISTIC DINH_FId.DFC_ComInvld_273h_OBC_outputpower_capability_CA "" VAL_BLK 0x80244BAC ValA_Wu16 1139.00000000 DINH_FIdVerb 0.00 1139.00000000 FORMAT "%13.8" MATRIX_DIM 15 /end CHARACTERISTIC
/begin CHARACTERISTIC DINH_FId.DFC_ComInvld_275h_HVBAT_DISCHARGE_30S_AVAILABLE_CURRENT_CA "" VAL_BLK 0x80244BCA ValA_Wu16 1139.00000000 DINH_FIdVerb 0.00 1139.00000000 FORMAT "%13.8" MATRIX_DIM 15 /end CHARACTERISTIC
/begin CHARACTERISTIC DINH_FId.DFC_ComInvld_275h_HVBAT_DISCHARGE_30S_AVAILABLE_POWER_CA "" VAL_BLK 0x80244BE8 ValA_Wu16 1139.00000000 DINH_FIdVerb 0.00 1139.00000000 FORMAT "%13.8" MATRIX_DIM 15 /end CHARACTERISTIC
/begin CHARACTERISTIC DINH_FId.DFC_ComInvld_283h_DCDC_IN_CURRENT_CA "" VAL_BLK 0x80244C06 ValA_Wu16 1139.00000000 DINH_FIdVerb 0.00 1139.00000000 FORMAT "%13.8" MATRIX_DIM 15 /end CHARACTERISTIC
/begin CHARACTERISTIC DINH_FId.DFC_ComInvld_283h_DCDC_IN_VOLTAGE_CA "" VAL_BLK 0x80244C24 ValA_Wu16 1139.00000000 DINH_FIdVerb 0.00 1139.00000000 FORMAT "%13.8" MATRIX_DIM 15 /end CHARACTERISTIC
/begin CHARACTERISTIC DINH_FId.DFC_ComInvld_283h_DCDC_OUT_CURRENT_CA "" VAL_BLK 0x80244C42 ValA_Wu16 1139.00000000 DINH_FIdVerb 0.00 1139.00000000 FORMAT "%13.8" MATRIX_DIM 15 /end CHARACTERISTIC
/begin CHARACTERISTIC DINH_FId.DFC_ComInvld_283h_DCDC_OUT_VOLTAGE_CA "" VAL_BLK 0x80244C60 ValA_Wu16 1139.00000000 DINH_FIdVerb 0.00 1139.00000000 FORMAT "%13.8" MATRIX_DIM 15 /end CHARACTERISTIC
/begin CHARACTERISTIC DINH_FId.DFC_ComInvld_285h_HVBAT_REGEN_CHG_30S_CURRENT_LIMIT_CA "" VAL_BLK 0x80244C7E ValA_Wu16 1139.00000000 DINH_FIdVerb 0.00 1139.00000000 FORMAT "%13.8" MATRIX_DIM 15 /end CHARACTERISTIC
/begin CHARACTERISTIC DINH_FId.DFC_ComInvld_285h_HVBAT_REGEN_CHRG_30S_POWER_LIMIT_CA "" VAL_BLK 0x80244C9C ValA_Wu16 1139.00000000 DINH_FIdVerb 0.00 1139.00000000 FORMAT "%13.8" MATRIX_DIM 15 /end CHARACTERISTIC
/begin CHARACTERISTIC DINH_FId.DFC_ComInvld_293h_DCDC_FAULT_LEVEL_CA "" VAL_BLK 0x80244CBA ValA_Wu16 1139.00000000 DINH_FIdVerb 0.00 1139.00000000 FORMAT "%13.8" MATRIX_DIM 15 /end CHARACTERISTIC
/begin CHARACTERISTIC DINH_FId.DFC_ComInvld_293h_DCDC_outputpower_capability_CA "" VAL_BLK 0x80244CD8 ValA_Wu16 1139.00000000 DINH_FIdVerb 0.00 1139.00000000 FORMAT "%13.8" MATRIX_DIM 15 /end CHARACTERISTIC
/begin CHARACTERISTIC DINH_FId.DFC_ComInvld_325h_HVBAT_EPLUG_STATUS_CA "" VAL_BLK 0x80244CF6 ValA_Wu16 1139.00000000 DINH_FIdVerb 0.00 1139.00000000 FORMAT "%13.8" MATRIX_DIM 15 /end CHARACTERISTIC
/begin CHARACTERISTIC DINH_FId.DFC_ComInvld_325h_HVBAT_HVIL_STS_CA "" VAL_BLK 0x80244D14 ValA_Wu16 1139.00000000 DINH_FIdVerb 0.00 1139.00000000 FORMAT "%13.8" MATRIX_DIM 15 /end CHARACTERISTIC
/begin CHARACTERISTIC DINH_FId.DFC_ComInvld_325h_HVBAT_INSULATION_FAULT_CA "" VAL_BLK 0x80244D32 ValA_Wu16 1139.00000000 DINH_FIdVerb 0.00 1139.00000000 FORMAT "%13.8" MATRIX_DIM 15 /end CHARACTERISTIC
/begin CHARACTERISTIC DINH_FId.DFC_ComInvld_325h_HVBAT_INSULATION_RESISTANCE_CA "" VAL_BLK 0x80244D50 ValA_Wu16 1139.00000000 DINH_FIdVerb 0.00 1139.00000000 FORMAT "%13.8" MATRIX_DIM 15 /end CHARACTERISTIC
/begin CHARACTERISTIC DINH_FId.DFC_ComInvld_325h_HVBAT_TEMPERATURE_CA "" VAL_BLK 0x80244D6E ValA_Wu16 1139.00000000 DINH_FIdVerb 0.00 1139.00000000 FORMAT "%13.8" MATRIX_DIM 15 /end CHARACTERISTIC
/begin CHARACTERISTIC DINH_FId.DFC_ComInvld_335h_HVBAT_CHRG_CONTINUOUS_CURR_MAX_CA "" VAL_BLK 0x80244D8C ValA_Wu16 1139.00000000 DINH_FIdVerb 0.00 1139.00000000 FORMAT "%13.8" MATRIX_DIM 15 /end CHARACTERISTIC
/begin CHARACTERISTIC DINH_FId.DFC_ComInvld_335h_HVBAT_CHRG_COTINUOUS_CURR_REQ_CA "" VAL_BLK 0x80244DAA ValA_Wu16 1139.00000000 DINH_FIdVerb 0.00 1139.00000000 FORMAT "%13.8" MATRIX_DIM 18 /end CHARACTERISTIC
/begin CHARACTERISTIC DINH_FId.DFC_ComInvld_335h_HVBAT_CHRG_MAX_VOLT_CA "" VAL_BLK 0x80244DCE ValA_Wu16 1139.00000000 DINH_FIdVerb 0.00 1139.00000000 FORMAT "%13.8" MATRIX_DIM 18 /end CHARACTERISTIC
/begin CHARACTERISTIC DINH_FId.DFC_ComInvld_335h_HVBAT_DC_BUS_VOLTAGE_CA "" VAL_BLK 0x80244DF2 ValA_Wu16 1139.00000000 DINH_FIdVerb 0.00 1139.00000000 FORMAT "%13.8" MATRIX_DIM 16 /end CHARACTERISTIC
/begin CHARACTERISTIC DINH_FId.DFC_ComInvld_38Dh_VITESSE_VEHICULE_ROUES_CA "" VAL_BLK 0x80244E12 ValA_Wu16 1139.00000000 DINH_FIdVerb 0.00 1139.00000000 FORMAT "%13.8" MATRIX_DIM 16 /end CHARACTERISTIC
/begin CHARACTERISTIC DINH_FId.DFC_ComInvld_38Dh_VVH_INDISP_CA "" VAL_BLK 0x80244E32 ValA_Wu16 1139.00000000 DINH_FIdVerb 0.00 1139.00000000 FORMAT "%13.8" MATRIX_DIM 18 /end CHARACTERISTIC
/begin CHARACTERISTIC DINH_FId.DFC_ComInvld_427h_INV_COOLANT_TEMP_CA "" VAL_BLK 0x80244E56 ValA_Wu16 1139.00000000 DINH_FIdVerb 0.00 1139.00000000 FORMAT "%13.8" MATRIX_DIM 16 /end CHARACTERISTIC
/begin CHARACTERISTIC DINH_FId.DFC_ComInvld_427h_INV_MOTOR_TEMP_CA "" VAL_BLK 0x80244E76 ValA_Wu16 1139.00000000 DINH_FIdVerb 0.00 1139.00000000 FORMAT "%13.8" MATRIX_DIM 16 /end CHARACTERISTIC
/begin CHARACTERISTIC DINH_FId.DFC_ComInvld_427h_INV_OP_MODE_CA "" VAL_BLK 0x80244E96 ValA_Wu16 1139.00000000 DINH_FIdVerb 0.00 1139.00000000 FORMAT "%13.8" MATRIX_DIM 15 /end CHARACTERISTIC
/begin CHARACTERISTIC DINH_FId.DFC_ComInvld_427h_INV_PERMISIBLE_TORQUE_CA "" VAL_BLK 0x80244EB4 ValA_Wu16 1139.00000000 DINH_FIdVerb 0.00 1139.00000000 FORMAT "%13.8" MATRIX_DIM 15 /end CHARACTERISTIC
/begin CHARACTERISTIC DINH_FId.DFC_ComInvld_427h_INV_TEMP_CA "" VAL_BLK 0x80244ED2 ValA_Wu16 1139.00000000 DINH_FIdVerb 0.00 1139.00000000 FORMAT "%13.8" MATRIX_DIM 16 /end CHARACTERISTIC
/begin CHARACTERISTIC DINH_FId.DFC_ComInvld_432h_REVEIL_PRINCIPAL_CA "" VAL_BLK 0x80244EF2 ValA_Wu16 1139.00000000 DINH_FIdVerb 0.00 1139.00000000 FORMAT "%13.8" MATRIX_DIM 17 /end CHARACTERISTIC
/begin CHARACTERISTIC DINH_FId.DFC_ComInvld_435h_HVBAT_MAX_CELL_VOLT_CA "" VAL_BLK 0x80244F14 ValA_Wu16 1139.00000000 DINH_FIdVerb 0.00 1139.00000000 FORMAT "%13.8" MATRIX_DIM 15 /end CHARACTERISTIC
/begin CHARACTERISTIC DINH_FId.DFC_ComInvld_435h_HVBAT_MAX_CELL_VOLT_NUM_CA "" VAL_BLK 0x80244F32 ValA_Wu16 1139.00000000 DINH_FIdVerb 0.00 1139.00000000 FORMAT "%13.8" MATRIX_DIM 15 /end CHARACTERISTIC
/begin CHARACTERISTIC DINH_FId.DFC_ComInvld_435h_HVBAT_MAX_SENSOR_TEMP_CA "" VAL_BLK 0x80244F50 ValA_Wu16 1139.00000000 DINH_FIdVerb 0.00 1139.00000000 FORMAT "%13.8" MATRIX_DIM 15 /end CHARACTERISTIC
/begin CHARACTERISTIC DINH_FId.DFC_ComInvld_435h_HVBAT_MIN_CELL_VOLT_CA "" VAL_BLK 0x80244F6E ValA_Wu16 1139.00000000 DINH_FIdVerb 0.00 1139.00000000 FORMAT "%13.8" MATRIX_DIM 15 /end CHARACTERISTIC
/begin CHARACTERISTIC DINH_FId.DFC_ComInvld_435h_HVBAT_MIN_CELL_VOLT_NUM_CA "" VAL_BLK 0x80244F8C ValA_Wu16 1139.00000000 DINH_FIdVerb 0.00 1139.00000000 FORMAT "%13.8" MATRIX_DIM 15 /end CHARACTERISTIC
/begin CHARACTERISTIC DINH_FId.DFC_ComInvld_442h_BCCM_BLOWER_RELAY_STS_CA "" VAL_BLK 0x80244FAA ValA_Wu16 1139.00000000 DINH_FIdVerb 0.00 1139.00000000 FORMAT "%13.8" MATRIX_DIM 15 /end CHARACTERISTIC
/begin CHARACTERISTIC DINH_FId.DFC_ComInvld_453h_OBC_IN_CURRENT_CA "" VAL_BLK 0x80244FC8 ValA_Wu16 1139.00000000 DINH_FIdVerb 0.00 1139.00000000 FORMAT "%13.8" MATRIX_DIM 16 /end CHARACTERISTIC
/begin CHARACTERISTIC DINH_FId.DFC_ComInvld_453h_OBC_IN_VOLTAGE_CA "" VAL_BLK 0x80244FE8 ValA_Wu16 1139.00000000 DINH_FIdVerb 0.00 1139.00000000 FORMAT "%13.8" MATRIX_DIM 15 /end CHARACTERISTIC
/begin CHARACTERISTIC DINH_FId.DFC_ComInvld_453h_OBC_IP_POWER_CA "" VAL_BLK 0x80245006 ValA_Wu16 1139.00000000 DINH_FIdVerb 0.00 1139.00000000 FORMAT "%13.8" MATRIX_DIM 15 /end CHARACTERISTIC
/begin CHARACTERISTIC DINH_FId.DFC_ComInvld_455h_HVBAT_NOMINAL_VOLTAGE_CA "" VAL_BLK 0x80245024 ValA_Wu16 1139.00000000 DINH_FIdVerb 0.00 1139.00000000 FORMAT "%13.8" MATRIX_DIM 18 /end CHARACTERISTIC
/begin CHARACTERISTIC DINH_FId.DFC_ComInvld_463h_OBC_OUT_CURRENT_CA "" VAL_BLK 0x80245048 ValA_Wu16 1139.00000000 DINH_FIdVerb 0.00 1139.00000000 FORMAT "%13.8" MATRIX_DIM 16 /end CHARACTERISTIC
/begin CHARACTERISTIC DINH_FId.DFC_ComInvld_463h_OBC_OUT_VOLTAGE_CA "" VAL_BLK 0x80245068 ValA_Wu16 1139.00000000 DINH_FIdVerb 0.00 1139.00000000 FORMAT "%13.8" MATRIX_DIM 16 /end CHARACTERISTIC
/begin CHARACTERISTIC DINH_FId.DFC_ComInvld_463h_OBC_TEMPERATURE_CA "" VAL_BLK 0x80245088 ValA_Wu16 1139.00000000 DINH_FIdVerb 0.00 1139.00000000 FORMAT "%13.8" MATRIX_DIM 16 /end CHARACTERISTIC
/begin CHARACTERISTIC DINH_FId.DFC_ComInvld_473h_DCDC_Coolant_Temperature_CA "" VAL_BLK 0x802450A8 ValA_Wu16 1139.00000000 DINH_FIdVerb 0.00 1139.00000000 FORMAT "%13.8" MATRIX_DIM 15 /end CHARACTERISTIC
/begin CHARACTERISTIC DINH_FId.DFC_ComInvld_473h_DCDC_TEMPERATURE_CA "" VAL_BLK 0x802450C6 ValA_Wu16 1139.00000000 DINH_FIdVerb 0.00 1139.00000000 FORMAT "%13.8" MATRIX_DIM 17 /end CHARACTERISTIC
/begin CHARACTERISTIC DINH_FId.DFC_ComInvld_47Bh_eCOMP_BusBarCurrent_CA "" VAL_BLK 0x802450E8 ValA_Wu16 1139.00000000 DINH_FIdVerb 0.00 1139.00000000 FORMAT "%13.8" MATRIX_DIM 16 /end CHARACTERISTIC
/begin CHARACTERISTIC DINH_FId.DFC_ComInvld_47Bh_eCOMP_BusBarVoltage_CA "" VAL_BLK 0x80245108 ValA_Wu16 1139.00000000 DINH_FIdVerb 0.00 1139.00000000 FORMAT "%13.8" MATRIX_DIM 15 /end CHARACTERISTIC
/begin CHARACTERISTIC DINH_FId.DFC_ComInvld_47Bh_eCOMP_CompressorSpeed_CA "" VAL_BLK 0x80245126 ValA_Wu16 1139.00000000 DINH_FIdVerb 0.00 1139.00000000 FORMAT "%13.8" MATRIX_DIM 15 /end CHARACTERISTIC
/begin CHARACTERISTIC DINH_FId.DFC_ComInvld_47Bh_eCOMP_IGBT_Temp_CA "" VAL_BLK 0x80245144 ValA_Wu16 1139.00000000 DINH_FIdVerb 0.00 1139.00000000 FORMAT "%13.8" MATRIX_DIM 15 /end CHARACTERISTIC
/begin CHARACTERISTIC DINH_FId.DFC_ComInvld_47Bh_eCOMP_PeakPhaCurrent_CA "" VAL_BLK 0x80245162 ValA_Wu16 1139.00000000 DINH_FIdVerb 0.00 1139.00000000 FORMAT "%13.8" MATRIX_DIM 15 /end CHARACTERISTIC
/begin CHARACTERISTIC DINH_FId.DFC_ComInvld_47Bh_eCOMP_Power_consumption_CA "" VAL_BLK 0x80245180 ValA_Wu16 1139.00000000 DINH_FIdVerb 0.00 1139.00000000 FORMAT "%13.8" MATRIX_DIM 15 /end CHARACTERISTIC
/begin CHARACTERISTIC DINH_FId.DFC_ComInvld_4F2h_STATUS_SOC_CA "" VAL_BLK 0x8024519E ValA_Wu16 1139.00000000 DINH_FIdVerb 0.00 1139.00000000 FORMAT "%13.8" MATRIX_DIM 15 /end CHARACTERISTIC
/begin CHARACTERISTIC DINH_FId.DFC_ComInvld_4F2h_TEMP_BATT_STATUS_CA "" VAL_BLK 0x802451BC ValA_Wu16 1139.00000000 DINH_FIdVerb 0.00 1139.00000000 FORMAT "%13.8" MATRIX_DIM 15 /end CHARACTERISTIC
/begin CHARACTERISTIC DINH_FId.DFC_ComInvld_4F2h_VALEUR_SOC_ETENDUE_CA "" VAL_BLK 0x802451DA ValA_Wu16 1139.00000000 DINH_FIdVerb 0.00 1139.00000000 FORMAT "%13.8" MATRIX_DIM 15 /end CHARACTERISTIC
/begin CHARACTERISTIC DINH_FId.DFC_ComInvld_535h_HV_BATT_TEMP_AVG_CA "" VAL_BLK 0x802451F8 ValA_Wu16 1139.00000000 DINH_FIdVerb 0.00 1139.00000000 FORMAT "%13.8" MATRIX_DIM 17 /end CHARACTERISTIC
/begin CHARACTERISTIC DINH_FId.DFC_ComInvld_543h_HVBAT_RESTBATTENERGY_CA "" VAL_BLK 0x8024521A ValA_Wu16 1139.00000000 DINH_FIdVerb 0.00 1139.00000000 FORMAT "%13.8" MATRIX_DIM 16 /end CHARACTERISTIC
/begin CHARACTERISTIC DINH_FId.DFC_ComInvld_543h_HVBAT_SOH_CA "" VAL_BLK 0x8024523A ValA_Wu16 1139.00000000 DINH_FIdVerb 0.00 1139.00000000 FORMAT "%13.8" MATRIX_DIM 15 /end CHARACTERISTIC
/begin CHARACTERISTIC DINH_FId.DFC_ComInvld_543h_HV_BATT_SOH_RES_CA "" VAL_BLK 0x80245258 ValA_Wu16 1139.00000000 DINH_FIdVerb 0.00 1139.00000000 FORMAT "%13.8" MATRIX_DIM 16 /end CHARACTERISTIC
/begin CHARACTERISTIC DINH_FId.DFC_ComInvld_552h_CPT_TEMPOREL_CA "" VAL_BLK 0x80245278 ValA_Wu16 1139.00000000 DINH_FIdVerb 0.00 1139.00000000 FORMAT "%13.8" MATRIX_DIM 15 /end CHARACTERISTIC
/begin CHARACTERISTIC DINH_FId.DFC_ComInvld_552h_KILOMETRAGE_CA "" VAL_BLK 0x80245296 ValA_Wu16 1139.00000000 DINH_FIdVerb 0.00 1139.00000000 FORMAT "%13.8" MATRIX_DIM 17 /end CHARACTERISTIC
/begin CHARACTERISTIC DINH_FId.DFC_ComInvld_583h_HV_BATT_DISCONT_CSE_OPEN_CA "" VAL_BLK 0x802452B8 ValA_Wu16 1139.00000000 DINH_FIdVerb 0.00 1139.00000000 FORMAT "%13.8" MATRIX_DIM 15 /end CHARACTERISTIC
/begin CHARACTERISTIC DINH_FId.DFC_ComInvld_592h_CALIBRE_IBATT_CA "" VAL_BLK 0x802452D6 ValA_Wu16 1139.00000000 DINH_FIdVerb 0.00 1139.00000000 FORMAT "%13.8" MATRIX_DIM 15 /end CHARACTERISTIC
/begin CHARACTERISTIC DINH_FId.DFC_ComInvld_592h_IBATT_1_CA "" VAL_BLK 0x802452F4 ValA_Wu16 1139.00000000 DINH_FIdVerb 0.00 1139.00000000 FORMAT "%13.8" MATRIX_DIM 15 /end CHARACTERISTIC
/begin CHARACTERISTIC DINH_FId.DFC_ComInvld_592h_IBATT_2_CA "" VAL_BLK 0x80245312 ValA_Wu16 1139.00000000 DINH_FIdVerb 0.00 1139.00000000 FORMAT "%13.8" MATRIX_DIM 15 /end CHARACTERISTIC
/begin CHARACTERISTIC DINH_FId.DFC_ComInvld_592h_IBATT_3_CA "" VAL_BLK 0x80245330 ValA_Wu16 1139.00000000 DINH_FIdVerb 0.00 1139.00000000 FORMAT "%13.8" MATRIX_DIM 15 /end CHARACTERISTIC
/begin CHARACTERISTIC DINH_FId.DFC_ComInvld_592h_TEMP_BATT_CA "" VAL_BLK 0x8024534E ValA_Wu16 1139.00000000 DINH_FIdVerb 0.00 1139.00000000 FORMAT "%13.8" MATRIX_DIM 15 /end CHARACTERISTIC
/begin CHARACTERISTIC DINH_FId.DFC_ComInvld_592h_U_BATT_BECB_CA "" VAL_BLK 0x8024536C ValA_Wu16 1139.00000000 DINH_FIdVerb 0.00 1139.00000000 FORMAT "%13.8" MATRIX_DIM 15 /end CHARACTERISTIC
/begin CHARACTERISTIC DINH_FId.DFC_ComInvld_595h_HVBAT_TIME_TO_CHRG_80_CA "" VAL_BLK 0x8024538A ValA_Wu16 1139.00000000 DINH_FIdVerb 0.00 1139.00000000 FORMAT "%13.8" MATRIX_DIM 15 /end CHARACTERISTIC
/begin CHARACTERISTIC DINH_FId.DFC_ComInvld_5B2h_TEMP_AIR_EXT_CA "" VAL_BLK 0x802453A8 ValA_Wu16 1139.00000000 DINH_FIdVerb 0.00 1139.00000000 FORMAT "%13.8" MATRIX_DIM 15 /end CHARACTERISTIC
/begin CHARACTERISTIC DINH_FId.DFC_ComInvld_5B5h_HVBAT_THERMAL_RUNAWAY_CA "" VAL_BLK 0x802453C6 ValA_Wu16 1139.00000000 DINH_FIdVerb 0.00 1139.00000000 FORMAT "%13.8" MATRIX_DIM 15 /end CHARACTERISTIC
/begin CHARACTERISTIC DINH_FId.DFC_ComInvld_635h_HVBAT_NEG_CONT_COUNT_SEG1_CA "" VAL_BLK 0x802453E4 ValA_Wu16 1139.00000000 DINH_FIdVerb 0.00 1139.00000000 FORMAT "%13.8" MATRIX_DIM 15 /end CHARACTERISTIC
/begin CHARACTERISTIC DINH_FId.DFC_ComInvld_635h_HVBAT_NEG_CONT_COUNT_SEG3_CA "" VAL_BLK 0x80245402 ValA_Wu16 1139.00000000 DINH_FIdVerb 0.00 1139.00000000 FORMAT "%13.8" MATRIX_DIM 15 /end CHARACTERISTIC
/begin CHARACTERISTIC DINH_FId.DFC_ComInvld_635h_HVBAT_NEG_CONT_COUNT_SEG4_CA "" VAL_BLK 0x80245420 ValA_Wu16 1139.00000000 DINH_FIdVerb 0.00 1139.00000000 FORMAT "%13.8" MATRIX_DIM 15 /end CHARACTERISTIC
/begin CHARACTERISTIC DINH_FId.DFC_ComInvld_635h_HVBAT_PST_CONT_COUNT_SEG1_CA "" VAL_BLK 0x8024543E ValA_Wu16 1139.00000000 DINH_FIdVerb 0.00 1139.00000000 FORMAT "%13.8" MATRIX_DIM 15 /end CHARACTERISTIC
/begin CHARACTERISTIC DINH_FId.DFC_ComInvld_635h_HVBAT_PST_CONT_COUNT_SEG3_CA "" VAL_BLK 0x8024545C ValA_Wu16 1139.00000000 DINH_FIdVerb 0.00 1139.00000000 FORMAT "%13.8" MATRIX_DIM 15 /end CHARACTERISTIC
/begin CHARACTERISTIC DINH_FId.DFC_ComInvld_635h_HVBAT_PST_CONT_COUNT_SEG4_CA "" VAL_BLK 0x8024547A ValA_Wu16 1139.00000000 DINH_FIdVerb 0.00 1139.00000000 FORMAT "%13.8" MATRIX_DIM 15 /end CHARACTERISTIC
/begin CHARACTERISTIC DINH_FId.DFC_ComInvld_645h_HVBAT_PRECHRGE_CONT_COUNT_SEG1_CA "" VAL_BLK 0x80245498 ValA_Wu16 1139.00000000 DINH_FIdVerb 0.00 1139.00000000 FORMAT "%13.8" MATRIX_DIM 15 /end CHARACTERISTIC
/begin CHARACTERISTIC DINH_FId.DFC_ComInvld_645h_HVBAT_PRECHRGE_CONT_COUNT_SEG2_CA "" VAL_BLK 0x802454B6 ValA_Wu16 1139.00000000 DINH_FIdVerb 0.00 1139.00000000 FORMAT "%13.8" MATRIX_DIM 15 /end CHARACTERISTIC
/begin CHARACTERISTIC DINH_FId.DFC_ComInvld_675h_HVBAT_REMAININGBATTCAPACITY_CA "" VAL_BLK 0x802454D4 ValA_Wu16 1139.00000000 DINH_FIdVerb 0.00 1139.00000000 FORMAT "%13.8" MATRIX_DIM 15 /end CHARACTERISTIC
/begin CHARACTERISTIC DINH_FId.DFC_ACCmprFltLvl1_CA "" VAL_BLK 0x802454F2 ValA_Wu16 1139.00000000 DINH_FIdVerb 0.00 1139.00000000 FORMAT "%13.8" MATRIX_DIM 14 /end CHARACTERISTIC
/begin CHARACTERISTIC DINH_FId.DFC_ACCmprFltLvl2_CA "" VAL_BLK 0x8024550E ValA_Wu16 1139.00000000 DINH_FIdVerb 0.00 1139.00000000 FORMAT "%13.8" MATRIX_DIM 14 /end CHARACTERISTIC
/begin CHARACTERISTIC DINH_FId.DFC_ACCmprFltLvl3_CA "" VAL_BLK 0x8024552A ValA_Wu16 1139.00000000 DINH_FIdVerb 0.00 1139.00000000 FORMAT "%13.8" MATRIX_DIM 14 /end CHARACTERISTIC
/begin CHARACTERISTIC DINH_FId.DFC_ACCmprFltLvl4_CA "" VAL_BLK 0x80245546 ValA_Wu16 1139.00000000 DINH_FIdVerb 0.00 1139.00000000 FORMAT "%13.8" MATRIX_DIM 14 /end CHARACTERISTIC
/begin CHARACTERISTIC DINH_FId.DFC_ACCmprHiPFlt_CA "" VAL_BLK 0x80245562 ValA_Wu16 1139.00000000 DINH_FIdVerb 0.00 1139.00000000 FORMAT "%13.8" MATRIX_DIM 14 /end CHARACTERISTIC
/begin CHARACTERISTIC DINH_FId.DFC_ACCmprInvldCmprSt_CA "" VAL_BLK 0x8024557E ValA_Wu16 1139.00000000 DINH_FIdVerb 0.00 1139.00000000 FORMAT "%13.8" MATRIX_DIM 14 /end CHARACTERISTIC
/begin CHARACTERISTIC DINH_FId.DFC_ACCmprInvldElecActPwr_CA "" VAL_BLK 0x8024559A ValA_Wu16 1139.00000000 DINH_FIdVerb 0.00 1139.00000000 FORMAT "%13.8" MATRIX_DIM 14 /end CHARACTERISTIC
/begin CHARACTERISTIC DINH_FId.DFC_ACCmprLoPFlt_CA "" VAL_BLK 0x802455B6 ValA_Wu16 1139.00000000 DINH_FIdVerb 0.00 1139.00000000 FORMAT "%13.8" MATRIX_DIM 14 /end CHARACTERISTIC
/begin CHARACTERISTIC DINH_FId.DFC_AcChrgrIntkTSRCMin_CA "" VAL_BLK 0x802455D2 ValA_Wu16 1139.00000000 DINH_FIdVerb 0.00 1139.00000000 FORMAT "%13.8" MATRIX_DIM 17 /end CHARACTERISTIC
/begin CHARACTERISTIC DINH_FId.DFC_BattUBMaxBatt_CA "" VAL_BLK 0x802455F4 ValA_Wu16 1139.00000000 DINH_FIdVerb 0.00 1139.00000000 FORMAT "%13.8" MATRIX_DIM 13 /end CHARACTERISTIC
/begin CHARACTERISTIC DINH_FId.DFC_BattUBMaxNoBatt_CA "" VAL_BLK 0x8024560E ValA_Wu16 1139.00000000 DINH_FIdVerb 0.00 1139.00000000 FORMAT "%13.8" MATRIX_DIM 13 /end CHARACTERISTIC
/begin CHARACTERISTIC DINH_FId.DFC_BattUBMinBatt_CA "" VAL_BLK 0x80245628 ValA_Wu16 1139.00000000 DINH_FIdVerb 0.00 1139.00000000 FORMAT "%13.8" MATRIX_DIM 14 /end CHARACTERISTIC
/begin CHARACTERISTIC DINH_FId.DFC_BattUBMinNoBatt_CA "" VAL_BLK 0x80245644 ValA_Wu16 1139.00000000 DINH_FIdVerb 0.00 1139.00000000 FORMAT "%13.8" MATRIX_DIM 13 /end CHARACTERISTIC
/begin CHARACTERISTIC DINH_FId.DFC_BattUSRCMax_CA "" VAL_BLK 0x8024565E ValA_Wu16 1139.00000000 DINH_FIdVerb 0.00 1139.00000000 FORMAT "%13.8" MATRIX_DIM 15 /end CHARACTERISTIC
/begin CHARACTERISTIC DINH_FId.DFC_BattUSRCMin_CA "" VAL_BLK 0x8024567C ValA_Wu16 1139.00000000 DINH_FIdVerb 0.00 1139.00000000 FORMAT "%13.8" MATRIX_DIM 15 /end CHARACTERISTIC
/begin CHARACTERISTIC DINH_FId.DFC_BrkBstPHiCautionDfct_CA "" VAL_BLK 0x8024569A ValA_Wu16 1139.00000000 DINH_FIdVerb 0.00 1139.00000000 FORMAT "%13.8" MATRIX_DIM 14 /end CHARACTERISTIC
/begin CHARACTERISTIC DINH_FId.DFC_BrkBstPHiWarnDfct_CA "" VAL_BLK 0x802456B6 ValA_Wu16 1139.00000000 DINH_FIdVerb 0.00 1139.00000000 FORMAT "%13.8" MATRIX_DIM 14 /end CHARACTERISTIC
/begin CHARACTERISTIC DINH_FId.DFC_BrkBstPSnsr12PlausDfct_CA "" VAL_BLK 0x802456D2 ValA_Wu16 1139.00000000 DINH_FIdVerb 0.00 1139.00000000 FORMAT "%13.8" MATRIX_DIM 17 /end CHARACTERISTIC
/begin CHARACTERISTIC DINH_FId.DFC_BrkBstPSnsr1Scb_CA "" VAL_BLK 0x802456F4 ValA_Wu16 1139.00000000 DINH_FIdVerb 0.00 1139.00000000 FORMAT "%13.8" MATRIX_DIM 17 /end CHARACTERISTIC
/begin CHARACTERISTIC DINH_FId.DFC_BrkBstPSnsr1Scg_CA "" VAL_BLK 0x80245716 ValA_Wu16 1139.00000000 DINH_FIdVerb 0.00 1139.00000000 FORMAT "%13.8" MATRIX_DIM 17 /end CHARACTERISTIC
/begin CHARACTERISTIC DINH_FId.DFC_BrkBstPSnsr2Scb_CA "" VAL_BLK 0x80245738 ValA_Wu16 1139.00000000 DINH_FIdVerb 0.00 1139.00000000 FORMAT "%13.8" MATRIX_DIM 17 /end CHARACTERISTIC
/begin CHARACTERISTIC DINH_FId.DFC_BrkBstPSnsr2Scg_CA "" VAL_BLK 0x8024575A ValA_Wu16 1139.00000000 DINH_FIdVerb 0.00 1139.00000000 FORMAT "%13.8" MATRIX_DIM 17 /end CHARACTERISTIC
/begin CHARACTERISTIC DINH_FId.DFC_BrkBstPSnsrMax_CA "" VAL_BLK 0x8024577C ValA_Wu16 1139.00000000 DINH_FIdVerb 0.00 1139.00000000 FORMAT "%13.8" MATRIX_DIM 14 /end CHARACTERISTIC
/begin CHARACTERISTIC DINH_FId.DFC_BrkBstPSnsrMin_CA "" VAL_BLK 0x80245798 ValA_Wu16 1139.00000000 DINH_FIdVerb 0.00 1139.00000000 FORMAT "%13.8" MATRIX_DIM 15 /end CHARACTERISTIC
/begin CHARACTERISTIC DINH_FId.DFC_BrkBstPhyRngChkMax_CA "" VAL_BLK 0x802457B6 ValA_Wu16 1139.00000000 DINH_FIdVerb 0.00 1139.00000000 FORMAT "%13.8" MATRIX_DIM 15 /end CHARACTERISTIC
/begin CHARACTERISTIC DINH_FId.DFC_BrkBstPhyRngChkMin_CA "" VAL_BLK 0x802457D4 ValA_Wu16 1139.00000000 DINH_FIdVerb 0.00 1139.00000000 FORMAT "%13.8" MATRIX_DIM 15 /end CHARACTERISTIC
/begin CHARACTERISTIC DINH_FId.DFC_BrkBstPmpHsScb_CA "" VAL_BLK 0x802457F2 ValA_Wu16 1139.00000000 DINH_FIdVerb 0.00 1139.00000000 FORMAT "%13.8" MATRIX_DIM 17 /end CHARACTERISTIC
/begin CHARACTERISTIC DINH_FId.DFC_BrkBstPmpHsScg_CA "" VAL_BLK 0x80245814 ValA_Wu16 1139.00000000 DINH_FIdVerb 0.00 1139.00000000 FORMAT "%13.8" MATRIX_DIM 19 /end CHARACTERISTIC
/begin CHARACTERISTIC DINH_FId.DFC_BrkBstPmpLsOl_CA "" VAL_BLK 0x8024583A ValA_Wu16 1139.00000000 DINH_FIdVerb 0.00 1139.00000000 FORMAT "%13.8" MATRIX_DIM 17 /end CHARACTERISTIC
/begin CHARACTERISTIC DINH_FId.DFC_BrkBstPmpLsScb_CA "" VAL_BLK 0x8024585C ValA_Wu16 1139.00000000 DINH_FIdVerb 0.00 1139.00000000 FORMAT "%13.8" MATRIX_DIM 19 /end CHARACTERISTIC
/begin CHARACTERISTIC DINH_FId.DFC_BrkBstPmpLsScg_CA "" VAL_BLK 0x80245882 ValA_Wu16 1139.00000000 DINH_FIdVerb 0.00 1139.00000000 FORMAT "%13.8" MATRIX_DIM 18 /end CHARACTERISTIC
/begin CHARACTERISTIC DINH_FId.DFC_CbnHeatgHeatrRlyOpend_CA "" VAL_BLK 0x802458A6 ValA_Wu16 1139.00000000 DINH_FIdVerb 0.00 1139.00000000 FORMAT "%13.8" MATRIX_DIM 14 /end CHARACTERISTIC
/begin CHARACTERISTIC DINH_FId.DFC_CbnHeatgHeatrRlyWldd_CA "" VAL_BLK 0x802458C2 ValA_Wu16 1139.00000000 DINH_FIdVerb 0.00 1139.00000000 FORMAT "%13.8" MATRIX_DIM 14 /end CHARACTERISTIC
/begin CHARACTERISTIC DINH_FId.DFC_CcsDcIBattExcdd_CA "" VAL_BLK 0x802458DE ValA_Wu16 1139.00000000 DINH_FIdVerb 0.00 1139.00000000 FORMAT "%13.8" MATRIX_DIM 14 /end CHARACTERISTIC
/begin CHARACTERISTIC DINH_FId.DFC_CcsDcIEvseOutDe_CA "" VAL_BLK 0x802458FA ValA_Wu16 1139.00000000 DINH_FIdVerb 0.00 1139.00000000 FORMAT "%13.8" MATRIX_DIM 13 /end CHARACTERISTIC
/begin CHARACTERISTIC DINH_FId.DFC_CcsDcIOutDe_CA "" VAL_BLK 0x80245914 ValA_Wu16 1139.00000000 DINH_FIdVerb 0.00 1139.00000000 FORMAT "%13.8" MATRIX_DIM 15 /end CHARACTERISTIC
/begin CHARACTERISTIC DINH_FId.DFC_CcsDcIOutExcdd_CA "" VAL_BLK 0x80245932 ValA_Wu16 1139.00000000 DINH_FIdVerb 0.00 1139.00000000 FORMAT "%13.8" MATRIX_DIM 15 /end CHARACTERISTIC
/begin CHARACTERISTIC DINH_FId.DFC_CcsDcUOutDe_CA "" VAL_BLK 0x80245950 ValA_Wu16 1139.00000000 DINH_FIdVerb 0.00 1139.00000000 FORMAT "%13.8" MATRIX_DIM 14 /end CHARACTERISTIC
/begin CHARACTERISTIC DINH_FId.DFC_CcsDcUOutExcdd_CA "" VAL_BLK 0x8024596C ValA_Wu16 1139.00000000 DINH_FIdVerb 0.00 1139.00000000 FORMAT "%13.8" MATRIX_DIM 14 /end CHARACTERISTIC
/begin CHARACTERISTIC DINH_FId.DFC_CcsPwrLineChpRstOL_CA "" VAL_BLK 0x80245988 ValA_Wu16 1139.00000000 DINH_FIdVerb 0.00 1139.00000000 FORMAT "%13.8" MATRIX_DIM 15 /end CHARACTERISTIC
/begin CHARACTERISTIC DINH_FId.DFC_CcsPwrLineChpRstOvrTemp_CA "" VAL_BLK 0x802459A6 ValA_Wu16 1139.00000000 DINH_FIdVerb 0.00 1139.00000000 FORMAT "%13.8" MATRIX_DIM 15 /end CHARACTERISTIC
/begin CHARACTERISTIC DINH_FId.DFC_CcsPwrLineChpRstSCB_CA "" VAL_BLK 0x802459C4 ValA_Wu16 1139.00000000 DINH_FIdVerb 0.00 1139.00000000 FORMAT "%13.8" MATRIX_DIM 15 /end CHARACTERISTIC
/begin CHARACTERISTIC DINH_FId.DFC_CcsPwrLineChpRstSCG_CA "" VAL_BLK 0x802459E2 ValA_Wu16 1139.00000000 DINH_FIdVerb 0.00 1139.00000000 FORMAT "%13.8" MATRIX_DIM 15 /end CHARACTERISTIC
/begin CHARACTERISTIC DINH_FId.DFC_CcsPwrLineChpVccEnaOL_CA "" VAL_BLK 0x80245A00 ValA_Wu16 1139.00000000 DINH_FIdVerb 0.00 1139.00000000 FORMAT "%13.8" MATRIX_DIM 15 /end CHARACTERISTIC
/begin CHARACTERISTIC DINH_FId.DFC_CcsPwrLineChpVccEnaOvrTemp_CA "" VAL_BLK 0x80245A1E ValA_Wu16 1139.00000000 DINH_FIdVerb 0.00 1139.00000000 FORMAT "%13.8" MATRIX_DIM 15 /end CHARACTERISTIC
/begin CHARACTERISTIC DINH_FId.DFC_CcsPwrLineChpVccEnaSCB_CA "" VAL_BLK 0x80245A3C ValA_Wu16 1139.00000000 DINH_FIdVerb 0.00 1139.00000000 FORMAT "%13.8" MATRIX_DIM 15 /end CHARACTERISTIC
/begin CHARACTERISTIC DINH_FId.DFC_CcsPwrLineChpVccEnaSCG_CA "" VAL_BLK 0x80245A5A ValA_Wu16 1139.00000000 DINH_FIdVerb 0.00 1139.00000000 FORMAT "%13.8" MATRIX_DIM 15 /end CHARACTERISTIC
/begin CHARACTERISTIC DINH_FId.DFC_CcsPwrLineChpVccSRCMin_CA "" VAL_BLK 0x80245A78 ValA_Wu16 1139.00000000 DINH_FIdVerb 0.00 1139.00000000 FORMAT "%13.8" MATRIX_DIM 17 /end CHARACTERISTIC
/begin CHARACTERISTIC DINH_FId.DFC_CcsPwrLineComChpTSRCMin_CA "" VAL_BLK 0x80245A9A ValA_Wu16 1139.00000000 DINH_FIdVerb 0.00 1139.00000000 FORMAT "%13.8" MATRIX_DIM 18 /end CHARACTERISTIC
/begin CHARACTERISTIC DINH_FId.DFC_CtPSwtActrOL_CA "" VAL_BLK 0x80245ABE ValA_Wu16 1139.00000000 DINH_FIdVerb 0.00 1139.00000000 FORMAT "%13.8" MATRIX_DIM 15 /end CHARACTERISTIC
/begin CHARACTERISTIC DINH_FId.DFC_CtPSwtActrOvrTemp_CA "" VAL_BLK 0x80245ADC ValA_Wu16 1139.00000000 DINH_FIdVerb 0.00 1139.00000000 FORMAT "%13.8" MATRIX_DIM 15 /end CHARACTERISTIC
/begin CHARACTERISTIC DINH_FId.DFC_CtPSwtActrSCB_CA "" VAL_BLK 0x80245AFA ValA_Wu16 1139.00000000 DINH_FIdVerb 0.00 1139.00000000 FORMAT "%13.8" MATRIX_DIM 15 /end CHARACTERISTIC
/begin CHARACTERISTIC DINH_FId.DFC_CtPSwtActrSCG_CA "" VAL_BLK 0x80245B18 ValA_Wu16 1139.00000000 DINH_FIdVerb 0.00 1139.00000000 FORMAT "%13.8" MATRIX_DIM 15 /end CHARACTERISTIC
/begin CHARACTERISTIC DINH_FId.DFC_CtPSwtDiagSRCMin_CA "" VAL_BLK 0x80245B36 ValA_Wu16 1139.00000000 DINH_FIdVerb 0.00 1139.00000000 FORMAT "%13.8" MATRIX_DIM 17 /end CHARACTERISTIC
/begin CHARACTERISTIC DINH_FId.DFC_CtpCarrFrqSRCMin_CA "" VAL_BLK 0x80245B58 ValA_Wu16 1139.00000000 DINH_FIdVerb 0.00 1139.00000000 FORMAT "%13.8" MATRIX_DIM 17 /end CHARACTERISTIC
/begin CHARACTERISTIC DINH_FId.DFC_DcChrgrIntkT2SRCMin_CA "" VAL_BLK 0x80245B7A ValA_Wu16 1139.00000000 DINH_FIdVerb 0.00 1139.00000000 FORMAT "%13.8" MATRIX_DIM 18 /end CHARACTERISTIC
/begin CHARACTERISTIC DINH_FId.DFC_DcChrgrIntkTSRCMin_CA "" VAL_BLK 0x80245B9E ValA_Wu16 1139.00000000 DINH_FIdVerb 0.00 1139.00000000 FORMAT "%13.8" MATRIX_DIM 18 /end CHARACTERISTIC
/begin CHARACTERISTIC DINH_FId.DFC_DevLibBattUHi_CA "" VAL_BLK 0x80245BC2 ValA_Wu16 1139.00000000 DINH_FIdVerb 0.00 1139.00000000 FORMAT "%13.8" MATRIX_DIM 13 /end CHARACTERISTIC
/begin CHARACTERISTIC DINH_FId.DFC_DevLibBattULo_CA "" VAL_BLK 0x80245BDC ValA_Wu16 1139.00000000 DINH_FIdVerb 0.00 1139.00000000 FORMAT "%13.8" MATRIX_DIM 13 /end CHARACTERISTIC
/begin CHARACTERISTIC DINH_FId.DFC_EmWakeupSigOL_CA "" VAL_BLK 0x80245BF6 ValA_Wu16 1139.00000000 DINH_FIdVerb 0.00 1139.00000000 FORMAT "%13.8" MATRIX_DIM 15 /end CHARACTERISTIC
/begin CHARACTERISTIC DINH_FId.DFC_EmWakeupSigOvrTemp_CA "" VAL_BLK 0x80245C14 ValA_Wu16 1139.00000000 DINH_FIdVerb 0.00 1139.00000000 FORMAT "%13.8" MATRIX_DIM 15 /end CHARACTERISTIC
/begin CHARACTERISTIC DINH_FId.DFC_EmWakeupSigSCB_CA "" VAL_BLK 0x80245C32 ValA_Wu16 1139.00000000 DINH_FIdVerb 0.00 1139.00000000 FORMAT "%13.8" MATRIX_DIM 15 /end CHARACTERISTIC
/begin CHARACTERISTIC DINH_FId.DFC_EmWakeupSigSCG_CA "" VAL_BLK 0x80245C50 ValA_Wu16 1139.00000000 DINH_FIdVerb 0.00 1139.00000000 FORMAT "%13.8" MATRIX_DIM 15 /end CHARACTERISTIC
/begin CHARACTERISTIC DINH_FId.DFC_Fan1OL_CA "" VAL_BLK 0x80245C6E ValA_Wu16 1139.00000000 DINH_FIdVerb 0.00 1139.00000000 FORMAT "%13.8" MATRIX_DIM 17 /end CHARACTERISTIC
/begin CHARACTERISTIC DINH_FId.DFC_Fan1OvrTemp_CA "" VAL_BLK 0x80245C90 ValA_Wu16 1139.00000000 DINH_FIdVerb 0.00 1139.00000000 FORMAT "%13.8" MATRIX_DIM 16 /end CHARACTERISTIC
/begin CHARACTERISTIC DINH_FId.DFC_Fan1SCB_CA "" VAL_BLK 0x80245CB0 ValA_Wu16 1139.00000000 DINH_FIdVerb 0.00 1139.00000000 FORMAT "%13.8" MATRIX_DIM 17 /end CHARACTERISTIC
/begin CHARACTERISTIC DINH_FId.DFC_FanRlySCB_CA "" VAL_BLK 0x80245CD2 ValA_Wu16 1139.00000000 DINH_FIdVerb 0.00 1139.00000000 FORMAT "%13.8" MATRIX_DIM 13 /end CHARACTERISTIC
/begin CHARACTERISTIC DINH_FId.DFC_FanRlySCG_CA "" VAL_BLK 0x80245CEC ValA_Wu16 1139.00000000 DINH_FIdVerb 0.00 1139.00000000 FORMAT "%13.8" MATRIX_DIM 13 /end CHARACTERISTIC
/begin CHARACTERISTIC DINH_FId.DFC_FanSpdSRCMin_CA "" VAL_BLK 0x80245D06 ValA_Wu16 1139.00000000 DINH_FIdVerb 0.00 1139.00000000 FORMAT "%13.8" MATRIX_DIM 17 /end CHARACTERISTIC
/begin CHARACTERISTIC DINH_FId.DFC_FreonPSRCMin_CA "" VAL_BLK 0x80245D28 ValA_Wu16 1139.00000000 DINH_FIdVerb 0.00 1139.00000000 FORMAT "%13.8" MATRIX_DIM 19 /end CHARACTERISTIC
/begin CHARACTERISTIC DINH_FId.DFC_HLCCcsPLnCChipTHi_CA "" VAL_BLK 0x80245D4E ValA_Wu16 1139.00000000 DINH_FIdVerb 0.00 1139.00000000 FORMAT "%13.8" MATRIX_DIM 14 /end CHARACTERISTIC
/begin CHARACTERISTIC DINH_FId.DFC_HeatrCoreTSRCMin_CA "" VAL_BLK 0x80245D6A ValA_Wu16 1139.00000000 DINH_FIdVerb 0.00 1139.00000000 FORMAT "%13.8" MATRIX_DIM 17 /end CHARACTERISTIC
/begin CHARACTERISTIC DINH_FId.DFC_PwmCtPSRCMin_CA "" VAL_BLK 0x80245D8C ValA_Wu16 1139.00000000 DINH_FIdVerb 0.00 1139.00000000 FORMAT "%13.8" MATRIX_DIM 17 /end CHARACTERISTIC
/begin CHARACTERISTIC DINH_FId.DFC_PwrDistbnUnitTSRCMin_CA "" VAL_BLK 0x80245DAE ValA_Wu16 1139.00000000 DINH_FIdVerb 0.00 1139.00000000 FORMAT "%13.8" MATRIX_DIM 21 /end CHARACTERISTIC
/begin CHARACTERISTIC DINH_FId.DFC_SCtPmp1OL_CA "" VAL_BLK 0x80245DD8 ValA_Wu16 1139.00000000 DINH_FIdVerb 0.00 1139.00000000 FORMAT "%13.8" MATRIX_DIM 20 /end CHARACTERISTIC
/begin CHARACTERISTIC DINH_FId.DFC_SCtPmp1OvrTemp_CA "" VAL_BLK 0x80245E00 ValA_Wu16 1139.00000000 DINH_FIdVerb 0.00 1139.00000000 FORMAT "%13.8" MATRIX_DIM 18 /end CHARACTERISTIC
/begin CHARACTERISTIC DINH_FId.DFC_SCtPmp1SCB_CA "" VAL_BLK 0x80245E24 ValA_Wu16 1139.00000000 DINH_FIdVerb 0.00 1139.00000000 FORMAT "%13.8" MATRIX_DIM 20 /end CHARACTERISTIC
/begin CHARACTERISTIC DINH_FId.DFC_SCtPmpRlyOL_CA "" VAL_BLK 0x80245E4C ValA_Wu16 1139.00000000 DINH_FIdVerb 0.00 1139.00000000 FORMAT "%13.8" MATRIX_DIM 15 /end CHARACTERISTIC
/begin CHARACTERISTIC DINH_FId.DFC_SCtPmpRlyOvrTemp_CA "" VAL_BLK 0x80245E6A ValA_Wu16 1139.00000000 DINH_FIdVerb 0.00 1139.00000000 FORMAT "%13.8" MATRIX_DIM 14 /end CHARACTERISTIC
/begin CHARACTERISTIC DINH_FId.DFC_SCtPmpRlySCB_CA "" VAL_BLK 0x80245E86 ValA_Wu16 1139.00000000 DINH_FIdVerb 0.00 1139.00000000 FORMAT "%13.8" MATRIX_DIM 15 /end CHARACTERISTIC
/begin CHARACTERISTIC DINH_FId.DFC_SpplCooltPmpRlyOL_CA "" VAL_BLK 0x80245EA4 ValA_Wu16 1139.00000000 DINH_FIdVerb 0.00 1139.00000000 FORMAT "%13.8" MATRIX_DIM 15 /end CHARACTERISTIC
/begin CHARACTERISTIC DINH_FId.DFC_SpplCooltPmpRlyOvrTemp_CA "" VAL_BLK 0x80245EC2 ValA_Wu16 1139.00000000 DINH_FIdVerb 0.00 1139.00000000 FORMAT "%13.8" MATRIX_DIM 14 /end CHARACTERISTIC
/begin CHARACTERISTIC DINH_FId.DFC_SpplCooltPmpRlySCB_CA "" VAL_BLK 0x80245EDE ValA_Wu16 1139.00000000 DINH_FIdVerb 0.00 1139.00000000 FORMAT "%13.8" MATRIX_DIM 15 /end CHARACTERISTIC
/begin CHARACTERISTIC DINH_FId.DFC_UCtPSRCMin_CA "" VAL_BLK 0x80245EFC ValA_Wu16 1139.00000000 DINH_FIdVerb 0.00 1139.00000000 FORMAT "%13.8" MATRIX_DIM 17 /end CHARACTERISTIC
/begin CHARACTERISTIC DINH_FId.DFC_UPxP1SRCMin_CA "" VAL_BLK 0x80245F1E ValA_Wu16 1139.00000000 DINH_FIdVerb 0.00 1139.00000000 FORMAT "%13.8" MATRIX_DIM 17 /end CHARACTERISTIC
/begin CHARACTERISTIC DINH_FId.DFC_ComHSN1CANMute_CA "" VAL_BLK 0x80245F40 ValA_Wu16 1139.00000000 DINH_FIdVerb 0.00 1139.00000000 FORMAT "%13.8" MATRIX_DIM 13 /end CHARACTERISTIC
/begin CHARACTERISTIC DINH_FId.DFC_ComHSN3CANMute_CA "" VAL_BLK 0x80245F5A ValA_Wu16 1139.00000000 DINH_FIdVerb 0.00 1139.00000000 FORMAT "%13.8" MATRIX_DIM 13 /end CHARACTERISTIC
/begin CHARACTERISTIC DINH_FId.DFC_AcChrgrIntkTPhysRngHi_CA "" VAL_BLK 0x80245F74 ValA_Wu16 1139.00000000 DINH_FIdVerb 0.00 1139.00000000 FORMAT "%13.8" MATRIX_DIM 15 /end CHARACTERISTIC
/begin CHARACTERISTIC DINH_FId.DFC_AcChrgrIntkTPhysRngLo_CA "" VAL_BLK 0x80245F92 ValA_Wu16 1139.00000000 DINH_FIdVerb 0.00 1139.00000000 FORMAT "%13.8" MATRIX_DIM 15 /end CHARACTERISTIC
/begin CHARACTERISTIC DINH_FId.DFC_AcChrgrIntkTSRCOpn_CA "" VAL_BLK 0x80245FB0 ValA_Wu16 1139.00000000 DINH_FIdVerb 0.00 1139.00000000 FORMAT "%13.8" MATRIX_DIM 13 /end CHARACTERISTIC
/begin CHARACTERISTIC DINH_FId.DFC_CcsPwrLineChpVccPhysRngHi_CA "" VAL_BLK 0x80245FCA ValA_Wu16 1139.00000000 DINH_FIdVerb 0.00 1139.00000000 FORMAT "%13.8" MATRIX_DIM 15 /end CHARACTERISTIC
/begin CHARACTERISTIC DINH_FId.DFC_CcsPwrLineChpVccPhysRngLo_CA "" VAL_BLK 0x80245FE8 ValA_Wu16 1139.00000000 DINH_FIdVerb 0.00 1139.00000000 FORMAT "%13.8" MATRIX_DIM 15 /end CHARACTERISTIC
/begin CHARACTERISTIC DINH_FId.DFC_CcsPwrLineChpVccSRCOpn_CA "" VAL_BLK 0x80246006 ValA_Wu16 1139.00000000 DINH_FIdVerb 0.00 1139.00000000 FORMAT "%13.8" MATRIX_DIM 13 /end CHARACTERISTIC
/begin CHARACTERISTIC DINH_FId.DFC_CcsPwrLineComChpTPhysRngHi_CA "" VAL_BLK 0x80246020 ValA_Wu16 1139.00000000 DINH_FIdVerb 0.00 1139.00000000 FORMAT "%13.8" MATRIX_DIM 15 /end CHARACTERISTIC
/begin CHARACTERISTIC DINH_FId.DFC_CcsPwrLineComChpTPhysRngLo_CA "" VAL_BLK 0x8024603E ValA_Wu16 1139.00000000 DINH_FIdVerb 0.00 1139.00000000 FORMAT "%13.8" MATRIX_DIM 15 /end CHARACTERISTIC
/begin CHARACTERISTIC DINH_FId.DFC_CcsPwrLineComChpTSRCOpn_CA "" VAL_BLK 0x8024605C ValA_Wu16 1139.00000000 DINH_FIdVerb 0.00 1139.00000000 FORMAT "%13.8" MATRIX_DIM 14 /end CHARACTERISTIC
/begin CHARACTERISTIC DINH_FId.DFC_CtPSwtDiagPhysRngHi_CA "" VAL_BLK 0x80246078 ValA_Wu16 1139.00000000 DINH_FIdVerb 0.00 1139.00000000 FORMAT "%13.8" MATRIX_DIM 15 /end CHARACTERISTIC
/begin CHARACTERISTIC DINH_FId.DFC_CtPSwtDiagPhysRngLo_CA "" VAL_BLK 0x80246096 ValA_Wu16 1139.00000000 DINH_FIdVerb 0.00 1139.00000000 FORMAT "%13.8" MATRIX_DIM 15 /end CHARACTERISTIC
/begin CHARACTERISTIC DINH_FId.DFC_CtPSwtDiagSRCOpn_CA "" VAL_BLK 0x802460B4 ValA_Wu16 1139.00000000 DINH_FIdVerb 0.00 1139.00000000 FORMAT "%13.8" MATRIX_DIM 13 /end CHARACTERISTIC
/begin CHARACTERISTIC DINH_FId.DFC_CtpCarrFrqPhysRngHi_CA "" VAL_BLK 0x802460CE ValA_Wu16 1139.00000000 DINH_FIdVerb 0.00 1139.00000000 FORMAT "%13.8" MATRIX_DIM 15 /end CHARACTERISTIC
/begin CHARACTERISTIC DINH_FId.DFC_CtpCarrFrqPhysRngLo_CA "" VAL_BLK 0x802460EC ValA_Wu16 1139.00000000 DINH_FIdVerb 0.00 1139.00000000 FORMAT "%13.8" MATRIX_DIM 15 /end CHARACTERISTIC
/begin CHARACTERISTIC DINH_FId.DFC_CtpCarrFrqSRCMax_CA "" VAL_BLK 0x8024610A ValA_Wu16 1139.00000000 DINH_FIdVerb 0.00 1139.00000000 FORMAT "%13.8" MATRIX_DIM 17 /end CHARACTERISTIC
/begin CHARACTERISTIC DINH_FId.DFC_DcChrgrIntkT2PhysRngHi_CA "" VAL_BLK 0x8024612C ValA_Wu16 1139.00000000 DINH_FIdVerb 0.00 1139.00000000 FORMAT "%13.8" MATRIX_DIM 15 /end CHARACTERISTIC
/begin CHARACTERISTIC DINH_FId.DFC_DcChrgrIntkT2PhysRngLo_CA "" VAL_BLK 0x8024614A ValA_Wu16 1139.00000000 DINH_FIdVerb 0.00 1139.00000000 FORMAT "%13.8" MATRIX_DIM 15 /end CHARACTERISTIC
/begin CHARACTERISTIC DINH_FId.DFC_DcChrgrIntkT2SRCOpn_CA "" VAL_BLK 0x80246168 ValA_Wu16 1139.00000000 DINH_FIdVerb 0.00 1139.00000000 FORMAT "%13.8" MATRIX_DIM 13 /end CHARACTERISTIC
/begin CHARACTERISTIC DINH_FId.DFC_DcChrgrIntkTPhysRngHi_CA "" VAL_BLK 0x80246182 ValA_Wu16 1139.00000000 DINH_FIdVerb 0.00 1139.00000000 FORMAT "%13.8" MATRIX_DIM 15 /end CHARACTERISTIC
/begin CHARACTERISTIC DINH_FId.DFC_DcChrgrIntkTPhysRngLo_CA "" VAL_BLK 0x802461A0 ValA_Wu16 1139.00000000 DINH_FIdVerb 0.00 1139.00000000 FORMAT "%13.8" MATRIX_DIM 15 /end CHARACTERISTIC
/begin CHARACTERISTIC DINH_FId.DFC_DcChrgrIntkTSRCOpn_CA "" VAL_BLK 0x802461BE ValA_Wu16 1139.00000000 DINH_FIdVerb 0.00 1139.00000000 FORMAT "%13.8" MATRIX_DIM 13 /end CHARACTERISTIC
/begin CHARACTERISTIC DINH_FId.DFC_Fan1SCG_CA "" VAL_BLK 0x802461D8 ValA_Wu16 1139.00000000 DINH_FIdVerb 0.00 1139.00000000 FORMAT "%13.8" MATRIX_DIM 17 /end CHARACTERISTIC
/begin CHARACTERISTIC DINH_FId.DFC_FanSpdPhysRngHi_CA "" VAL_BLK 0x802461FA ValA_Wu16 1139.00000000 DINH_FIdVerb 0.00 1139.00000000 FORMAT "%13.8" MATRIX_DIM 15 /end CHARACTERISTIC
/begin CHARACTERISTIC DINH_FId.DFC_FanSpdPhysRngLo_CA "" VAL_BLK 0x80246218 ValA_Wu16 1139.00000000 DINH_FIdVerb 0.00 1139.00000000 FORMAT "%13.8" MATRIX_DIM 15 /end CHARACTERISTIC
/begin CHARACTERISTIC DINH_FId.DFC_FanSpdSRCOpn_CA "" VAL_BLK 0x80246236 ValA_Wu16 1139.00000000 DINH_FIdVerb 0.00 1139.00000000 FORMAT "%13.8" MATRIX_DIM 13 /end CHARACTERISTIC
/begin CHARACTERISTIC DINH_FId.DFC_FreonPPhysRngHi_CA "" VAL_BLK 0x80246250 ValA_Wu16 1139.00000000 DINH_FIdVerb 0.00 1139.00000000 FORMAT "%13.8" MATRIX_DIM 16 /end CHARACTERISTIC
/begin CHARACTERISTIC DINH_FId.DFC_FreonPPhysRngLo_CA "" VAL_BLK 0x80246270 ValA_Wu16 1139.00000000 DINH_FIdVerb 0.00 1139.00000000 FORMAT "%13.8" MATRIX_DIM 16 /end CHARACTERISTIC
/begin CHARACTERISTIC DINH_FId.DFC_FreonPSRCOpn_CA "" VAL_BLK 0x80246290 ValA_Wu16 1139.00000000 DINH_FIdVerb 0.00 1139.00000000 FORMAT "%13.8" MATRIX_DIM 15 /end CHARACTERISTIC
/begin CHARACTERISTIC DINH_FId.DFC_HeatrCoreTPhysRngHi_CA "" VAL_BLK 0x802462AE ValA_Wu16 1139.00000000 DINH_FIdVerb 0.00 1139.00000000 FORMAT "%13.8" MATRIX_DIM 15 /end CHARACTERISTIC
/begin CHARACTERISTIC DINH_FId.DFC_HeatrCoreTPhysRngLo_CA "" VAL_BLK 0x802462CC ValA_Wu16 1139.00000000 DINH_FIdVerb 0.00 1139.00000000 FORMAT "%13.8" MATRIX_DIM 15 /end CHARACTERISTIC
/begin CHARACTERISTIC DINH_FId.DFC_HeatrCoreTSRCOpn_CA "" VAL_BLK 0x802462EA ValA_Wu16 1139.00000000 DINH_FIdVerb 0.00 1139.00000000 FORMAT "%13.8" MATRIX_DIM 13 /end CHARACTERISTIC
/begin CHARACTERISTIC DINH_FId.DFC_HvGridUMaxSftyLim_CA "" VAL_BLK 0x80246304 ValA_Wu16 1139.00000000 DINH_FIdVerb 0.00 1139.00000000 FORMAT "%13.8" MATRIX_DIM 14 /end CHARACTERISTIC
/begin CHARACTERISTIC DINH_FId.DFC_HvGridUMinSftyLim_CA "" VAL_BLK 0x80246320 ValA_Wu16 1139.00000000 DINH_FIdVerb 0.00 1139.00000000 FORMAT "%13.8" MATRIX_DIM 14 /end CHARACTERISTIC
/begin CHARACTERISTIC DINH_FId.DFC_HvGridUPlausy_CA "" VAL_BLK 0x8024633C ValA_Wu16 1139.00000000 DINH_FIdVerb 0.00 1139.00000000 FORMAT "%13.8" MATRIX_DIM 16 /end CHARACTERISTIC
/begin CHARACTERISTIC DINH_FId.DFC_IntlckChrgPlgHBrgOpnLd_CA "" VAL_BLK 0x8024635C ValA_Wu16 1139.00000000 DINH_FIdVerb 0.00 1139.00000000 FORMAT "%13.8" MATRIX_DIM 15 /end CHARACTERISTIC
/begin CHARACTERISTIC DINH_FId.DFC_IntlckChrgPlgHBrgOvrCurr_CA "" VAL_BLK 0x8024637A ValA_Wu16 1139.00000000 DINH_FIdVerb 0.00 1139.00000000 FORMAT "%13.8" MATRIX_DIM 14 /end CHARACTERISTIC
/begin CHARACTERISTIC DINH_FId.DFC_IntlckChrgPlgHBrgOvrTemp_CA "" VAL_BLK 0x80246396 ValA_Wu16 1139.00000000 DINH_FIdVerb 0.00 1139.00000000 FORMAT "%13.8" MATRIX_DIM 14 /end CHARACTERISTIC
/begin CHARACTERISTIC DINH_FId.DFC_IntlckChrgPlgHBrgShCirBatt1_CA "" VAL_BLK 0x802463B2 ValA_Wu16 1139.00000000 DINH_FIdVerb 0.00 1139.00000000 FORMAT "%13.8" MATRIX_DIM 15 /end CHARACTERISTIC
/begin CHARACTERISTIC DINH_FId.DFC_IntlckChrgPlgHBrgShCirBatt2_CA "" VAL_BLK 0x802463D0 ValA_Wu16 1139.00000000 DINH_FIdVerb 0.00 1139.00000000 FORMAT "%13.8" MATRIX_DIM 15 /end CHARACTERISTIC
/begin CHARACTERISTIC DINH_FId.DFC_IntlckChrgPlgHBrgShCirGnd1_CA "" VAL_BLK 0x802463EE ValA_Wu16 1139.00000000 DINH_FIdVerb 0.00 1139.00000000 FORMAT "%13.8" MATRIX_DIM 15 /end CHARACTERISTIC
/begin CHARACTERISTIC DINH_FId.DFC_IntlckChrgPlgHBrgShCirGnd2_CA "" VAL_BLK 0x8024640C ValA_Wu16 1139.00000000 DINH_FIdVerb 0.00 1139.00000000 FORMAT "%13.8" MATRIX_DIM 15 /end CHARACTERISTIC
/begin CHARACTERISTIC DINH_FId.DFC_IntlckChrgPlgHBrgShCirOvrLd_CA "" VAL_BLK 0x8024642A ValA_Wu16 1139.00000000 DINH_FIdVerb 0.00 1139.00000000 FORMAT "%13.8" MATRIX_DIM 15 /end CHARACTERISTIC
/begin CHARACTERISTIC DINH_FId.DFC_IntlckChrgPlgHBrgTempOvrCurr_CA "" VAL_BLK 0x80246448 ValA_Wu16 1139.00000000 DINH_FIdVerb 0.00 1139.00000000 FORMAT "%13.8" MATRIX_DIM 14 /end CHARACTERISTIC
/begin CHARACTERISTIC DINH_FId.DFC_IntlckChrgPlgHBrgUndrVltg_CA "" VAL_BLK 0x80246464 ValA_Wu16 1139.00000000 DINH_FIdVerb 0.00 1139.00000000 FORMAT "%13.8" MATRIX_DIM 14 /end CHARACTERISTIC
/begin CHARACTERISTIC DINH_FId.DFC_IntlckChrgPlgPosnRngFlt_CA "" VAL_BLK 0x80246480 ValA_Wu16 1139.00000000 DINH_FIdVerb 0.00 1139.00000000 FORMAT "%13.8" MATRIX_DIM 13 /end CHARACTERISTIC
/begin CHARACTERISTIC DINH_FId.DFC_IntlckChrgPlgPosnSrcMax_CA "" VAL_BLK 0x8024649A ValA_Wu16 1139.00000000 DINH_FIdVerb 0.00 1139.00000000 FORMAT "%13.8" MATRIX_DIM 14 /end CHARACTERISTIC
/begin CHARACTERISTIC DINH_FId.DFC_IntlckChrgPlgPosnSrcMin_CA "" VAL_BLK 0x802464B6 ValA_Wu16 1139.00000000 DINH_FIdVerb 0.00 1139.00000000 FORMAT "%13.8" MATRIX_DIM 14 /end CHARACTERISTIC
/begin CHARACTERISTIC DINH_FId.DFC_PwmCtPPhysRngHi_CA "" VAL_BLK 0x802464D2 ValA_Wu16 1139.00000000 DINH_FIdVerb 0.00 1139.00000000 FORMAT "%13.8" MATRIX_DIM 15 /end CHARACTERISTIC
/begin CHARACTERISTIC DINH_FId.DFC_PwmCtPPhysRngLo_CA "" VAL_BLK 0x802464F0 ValA_Wu16 1139.00000000 DINH_FIdVerb 0.00 1139.00000000 FORMAT "%13.8" MATRIX_DIM 15 /end CHARACTERISTIC
/begin CHARACTERISTIC DINH_FId.DFC_PwmCtPSRCMax_CA "" VAL_BLK 0x8024650E ValA_Wu16 1139.00000000 DINH_FIdVerb 0.00 1139.00000000 FORMAT "%13.8" MATRIX_DIM 17 /end CHARACTERISTIC
/begin CHARACTERISTIC DINH_FId.DFC_PwrDistbnUnitTPhysRngHi_CA "" VAL_BLK 0x80246530 ValA_Wu16 1139.00000000 DINH_FIdVerb 0.00 1139.00000000 FORMAT "%13.8" MATRIX_DIM 15 /end CHARACTERISTIC
/begin CHARACTERISTIC DINH_FId.DFC_PwrDistbnUnitTPhysRngLo_CA "" VAL_BLK 0x8024654E ValA_Wu16 1139.00000000 DINH_FIdVerb 0.00 1139.00000000 FORMAT "%13.8" MATRIX_DIM 15 /end CHARACTERISTIC
/begin CHARACTERISTIC DINH_FId.DFC_PwrDistbnUnitTSRCOpn_CA "" VAL_BLK 0x8024656C ValA_Wu16 1139.00000000 DINH_FIdVerb 0.00 1139.00000000 FORMAT "%13.8" MATRIX_DIM 17 /end CHARACTERISTIC
/begin CHARACTERISTIC DINH_FId.DFC_SCtPmpRlySCG_CA "" VAL_BLK 0x8024658E ValA_Wu16 1139.00000000 DINH_FIdVerb 0.00 1139.00000000 FORMAT "%13.8" MATRIX_DIM 15 /end CHARACTERISTIC
/begin CHARACTERISTIC DINH_FId.DFC_SpplCooltPmpRlySCG_CA "" VAL_BLK 0x802465AC ValA_Wu16 1139.00000000 DINH_FIdVerb 0.00 1139.00000000 FORMAT "%13.8" MATRIX_DIM 15 /end CHARACTERISTIC
/begin CHARACTERISTIC DINH_FId.DFC_UCtPPhysRngHi_CA "" VAL_BLK 0x802465CA ValA_Wu16 1139.00000000 DINH_FIdVerb 0.00 1139.00000000 FORMAT "%13.8" MATRIX_DIM 15 /end CHARACTERISTIC
/begin CHARACTERISTIC DINH_FId.DFC_UCtPPhysRngLo_CA "" VAL_BLK 0x802465E8 ValA_Wu16 1139.00000000 DINH_FIdVerb 0.00 1139.00000000 FORMAT "%13.8" MATRIX_DIM 15 /end CHARACTERISTIC
/begin CHARACTERISTIC DINH_FId.DFC_UCtPSRCOpn_CA "" VAL_BLK 0x80246606 ValA_Wu16 1139.00000000 DINH_FIdVerb 0.00 1139.00000000 FORMAT "%13.8" MATRIX_DIM 13 /end CHARACTERISTIC
/begin CHARACTERISTIC DINH_FId.DFC_UPxP1PhysRngHi_CA "" VAL_BLK 0x80246620 ValA_Wu16 1139.00000000 DINH_FIdVerb 0.00 1139.00000000 FORMAT "%13.8" MATRIX_DIM 15 /end CHARACTERISTIC
/begin CHARACTERISTIC DINH_FId.DFC_UPxP1PhysRngLo_CA "" VAL_BLK 0x8024663E ValA_Wu16 1139.00000000 DINH_FIdVerb 0.00 1139.00000000 FORMAT "%13.8" MATRIX_DIM 15 /end CHARACTERISTIC
/begin CHARACTERISTIC DINH_FId.DFC_UPxP1SRCOpn_CA "" VAL_BLK 0x8024665C ValA_Wu16 1139.00000000 DINH_FIdVerb 0.00 1139.00000000 FORMAT "%13.8" MATRIX_DIM 13 /end CHARACTERISTIC
/begin CHARACTERISTIC DINH_FId.DFC_VehVPhysRngHi_CA "" VAL_BLK 0x80246676 ValA_Wu16 1139.00000000 DINH_FIdVerb 0.00 1139.00000000 FORMAT "%13.8" MATRIX_DIM 15 /end CHARACTERISTIC
/begin CHARACTERISTIC DINH_FId.DFC_VehVPhysRngLo_CA "" VAL_BLK 0x80246694 ValA_Wu16 1139.00000000 DINH_FIdVerb 0.00 1139.00000000 FORMAT "%13.8" MATRIX_DIM 15 /end CHARACTERISTIC
/begin CHARACTERISTIC DINH_FId.DFC_VehVSigCan_CA "" VAL_BLK 0x802466B2 ValA_Wu16 1139.00000000 DINH_FIdVerb 0.00 1139.00000000 FORMAT "%13.8" MATRIX_DIM 15 /end CHARACTERISTIC
/begin CHARACTERISTIC DINH_FId.DFC_VehVSigCanSafe_CA "" VAL_BLK 0x802466D0 ValA_Wu16 1139.00000000 DINH_FIdVerb 0.00 1139.00000000 FORMAT "%13.8" MATRIX_DIM 15 /end CHARACTERISTIC
/begin CHARACTERISTIC DINH_FId.DFC_SCtPmp1DiagGrdKey1_CA "" VAL_BLK 0x802466EE ValA_Wu16 1139.00000000 DINH_FIdVerb 0.00 1139.00000000 FORMAT "%13.8" MATRIX_DIM 14 /end CHARACTERISTIC
/begin CHARACTERISTIC DINH_FId.DFC_SCtPmp1DiagGrdKey2_CA "" VAL_BLK 0x8024670A ValA_Wu16 1139.00000000 DINH_FIdVerb 0.00 1139.00000000 FORMAT "%13.8" MATRIX_DIM 14 /end CHARACTERISTIC
/begin CHARACTERISTIC DINH_FId.DFC_SCtPmp1DiagGrdKey3_CA "" VAL_BLK 0x80246726 ValA_Wu16 1139.00000000 DINH_FIdVerb 0.00 1139.00000000 FORMAT "%13.8" MATRIX_DIM 14 /end CHARACTERISTIC
/begin CHARACTERISTIC DINH_FId.DFC_SCtPmp1DiagGrdKey4_CA "" VAL_BLK 0x80246742 ValA_Wu16 1139.00000000 DINH_FIdVerb 0.00 1139.00000000 FORMAT "%13.8" MATRIX_DIM 14 /end CHARACTERISTIC
/begin CHARACTERISTIC DINH_FId.DFC_SCtPmp1DiagGrdKey5_CA "" VAL_BLK 0x8024675E ValA_Wu16 1139.00000000 DINH_FIdVerb 0.00 1139.00000000 FORMAT "%13.8" MATRIX_DIM 14 /end CHARACTERISTIC
/begin CHARACTERISTIC DINH_FId.DFC_ChrgPlgLiveCntctHzrdCcs_CA "" VAL_BLK 0x8024677A ValA_Wu16 1139.00000000 DINH_FIdVerb 0.00 1139.00000000 FORMAT "%13.8" MATRIX_DIM 13 /end CHARACTERISTIC
/begin CHARACTERISTIC DINH_FId.DFC_ChrgPlgProxPltImps_CA "" VAL_BLK 0x80246794 ValA_Wu16 1139.00000000 DINH_FIdVerb 0.00 1139.00000000 FORMAT "%13.8" MATRIX_DIM 13 /end CHARACTERISTIC
/begin CHARACTERISTIC DINH_FId.DFC_ChrgPlgTHiCcsDc_CA "" VAL_BLK 0x802467AE ValA_Wu16 1139.00000000 DINH_FIdVerb 0.00 1139.00000000 FORMAT "%13.8" MATRIX_DIM 14 /end CHARACTERISTIC
/begin CHARACTERISTIC DINH_FId.DFC_ElMActvDchaFailr_CA "" VAL_BLK 0x802467CA ValA_Wu16 1139.00000000 DINH_FIdVerb 0.00 1139.00000000 FORMAT "%13.8" MATRIX_DIM 13 /end CHARACTERISTIC
/begin CHARACTERISTIC DINH_FId.DFC_ElMActvDchaFlt_CA "" VAL_BLK 0x802467E4 ValA_Wu16 1139.00000000 DINH_FIdVerb 0.00 1139.00000000 FORMAT "%13.8" MATRIX_DIM 13 /end CHARACTERISTIC
/begin CHARACTERISTIC DINH_FId.DFC_ElMFbdnIvtrModDrv01_CA "" VAL_BLK 0x802467FE ValA_Wu16 1139.00000000 DINH_FIdVerb 0.00 1139.00000000 FORMAT "%13.8" MATRIX_DIM 13 /end CHARACTERISTIC
/begin CHARACTERISTIC DINH_FId.DFC_ElMImobAuthent_CA "" VAL_BLK 0x80246818 ValA_Wu16 1139.00000000 DINH_FIdVerb 0.00 1139.00000000 FORMAT "%13.8" MATRIX_DIM 13 /end CHARACTERISTIC
/begin CHARACTERISTIC DINH_FId.DFC_ElMIsoMonFlt_CA "" VAL_BLK 0x80246832 ValA_Wu16 1139.00000000 DINH_FIdVerb 0.00 1139.00000000 FORMAT "%13.8" MATRIX_DIM 13 /end CHARACTERISTIC
/begin CHARACTERISTIC DINH_FId.DFC_ElMIsoMonPlausyFlt_CA "" VAL_BLK 0x8024684C ValA_Wu16 1139.00000000 DINH_FIdVerb 0.00 1139.00000000 FORMAT "%13.8" MATRIX_DIM 13 /end CHARACTERISTIC
/begin CHARACTERISTIC DINH_FId.DFC_ElMIvtrCooltT01_CA "" VAL_BLK 0x80246866 ValA_Wu16 1139.00000000 DINH_FIdVerb 0.00 1139.00000000 FORMAT "%13.8" MATRIX_DIM 13 /end CHARACTERISTIC
/begin CHARACTERISTIC DINH_FId.DFC_ElMIvtrEmgyShtDwn01_CA "" VAL_BLK 0x80246880 ValA_Wu16 1139.00000000 DINH_FIdVerb 0.00 1139.00000000 FORMAT "%13.8" MATRIX_DIM 15 /end CHARACTERISTIC
/begin CHARACTERISTIC DINH_FId.DFC_ElMIvtrFailr01_CA "" VAL_BLK 0x8024689E ValA_Wu16 1139.00000000 DINH_FIdVerb 0.00 1139.00000000 FORMAT "%13.8" MATRIX_DIM 15 /end CHARACTERISTIC
/begin CHARACTERISTIC DINH_FId.DFC_ElMIvtrIntlck01_CA "" VAL_BLK 0x802468BC ValA_Wu16 1139.00000000 DINH_FIdVerb 0.00 1139.00000000 FORMAT "%13.8" MATRIX_DIM 16 /end CHARACTERISTIC
/begin CHARACTERISTIC DINH_FId.DFC_ElMIvtrTErr01_CA "" VAL_BLK 0x802468DC ValA_Wu16 1139.00000000 DINH_FIdVerb 0.00 1139.00000000 FORMAT "%13.8" MATRIX_DIM 13 /end CHARACTERISTIC
/begin CHARACTERISTIC DINH_FId.DFC_ElMOverSpdNeg01_CA "" VAL_BLK 0x802468F6 ValA_Wu16 1139.00000000 DINH_FIdVerb 0.00 1139.00000000 FORMAT "%13.8" MATRIX_DIM 13 /end CHARACTERISTIC
/begin CHARACTERISTIC DINH_FId.DFC_ElMOverSpdPos01_CA "" VAL_BLK 0x80246910 ValA_Wu16 1139.00000000 DINH_FIdVerb 0.00 1139.00000000 FORMAT "%13.8" MATRIX_DIM 13 /end CHARACTERISTIC
/begin CHARACTERISTIC DINH_FId.DFC_ElMOverTqNeg01_CA "" VAL_BLK 0x8024692A ValA_Wu16 1139.00000000 DINH_FIdVerb 0.00 1139.00000000 FORMAT "%13.8" MATRIX_DIM 13 /end CHARACTERISTIC
/begin CHARACTERISTIC DINH_FId.DFC_ElMOverTqPos01_CA "" VAL_BLK 0x80246944 ValA_Wu16 1139.00000000 DINH_FIdVerb 0.00 1139.00000000 FORMAT "%13.8" MATRIX_DIM 13 /end CHARACTERISTIC
/begin CHARACTERISTIC DINH_FId.DFC_ElMPwrAuthn_CA "" VAL_BLK 0x8024695E ValA_Wu16 1139.00000000 DINH_FIdVerb 0.00 1139.00000000 FORMAT "%13.8" MATRIX_DIM 13 /end CHARACTERISTIC
/begin CHARACTERISTIC DINH_FId.DFC_ElMSpdErr01_CA "" VAL_BLK 0x80246978 ValA_Wu16 1139.00000000 DINH_FIdVerb 0.00 1139.00000000 FORMAT "%13.8" MATRIX_DIM 13 /end CHARACTERISTIC
/begin CHARACTERISTIC DINH_FId.DFC_ElMSvs01_CA "" VAL_BLK 0x80246992 ValA_Wu16 1139.00000000 DINH_FIdVerb 0.00 1139.00000000 FORMAT "%13.8" MATRIX_DIM 13 /end CHARACTERISTIC
/begin CHARACTERISTIC DINH_FId.DFC_PEnvCcMax_CA "" VAL_BLK 0x802469AC ValA_Wu16 1139.00000000 DINH_FIdVerb 0.00 1139.00000000 FORMAT "%13.8" MATRIX_DIM 16 /end CHARACTERISTIC
/begin CHARACTERISTIC DINH_FId.DFC_PEnvCcMin_CA "" VAL_BLK 0x802469CC ValA_Wu16 1139.00000000 DINH_FIdVerb 0.00 1139.00000000 FORMAT "%13.8" MATRIX_DIM 16 /end CHARACTERISTIC
/begin CHARACTERISTIC DINH_FId.DFC_PEnvRngChkMax_CA "" VAL_BLK 0x802469EC ValA_Wu16 1139.00000000 DINH_FIdVerb 0.00 1139.00000000 FORMAT "%13.8" MATRIX_DIM 17 /end CHARACTERISTIC
/begin CHARACTERISTIC DINH_FId.DFC_PEnvRngChkMin_CA "" VAL_BLK 0x80246A0E ValA_Wu16 1139.00000000 DINH_FIdVerb 0.00 1139.00000000 FORMAT "%13.8" MATRIX_DIM 17 /end CHARACTERISTIC
/begin CHARACTERISTIC DINH_FId.DFC_PEnvSnsrPlaus_CA "" VAL_BLK 0x80246A30 ValA_Wu16 1139.00000000 DINH_FIdVerb 0.00 1139.00000000 FORMAT "%13.8" MATRIX_DIM 18 /end CHARACTERISTIC
/begin CHARACTERISTIC DINH_FId.DFC_BrkBstPmpPlausGenn_CA "" VAL_BLK 0x80246A54 ValA_Wu16 1139.00000000 DINH_FIdVerb 0.00 1139.00000000 FORMAT "%13.8" MATRIX_DIM 14 /end CHARACTERISTIC
/begin CHARACTERISTIC DINH_FId.DFC_CbnHeatrRlyLfLoWarn_CA "" VAL_BLK 0x80246A70 ValA_Wu16 1139.00000000 DINH_FIdVerb 0.00 1139.00000000 FORMAT "%13.8" MATRIX_DIM 13 /end CHARACTERISTIC
/begin CHARACTERISTIC DINH_FId.DFC_ChgrPlugLockPinByndClsd_CA "" VAL_BLK 0x80246A8A ValA_Wu16 1139.00000000 DINH_FIdVerb 0.00 1139.00000000 FORMAT "%13.8" MATRIX_DIM 13 /end CHARACTERISTIC
/begin CHARACTERISTIC DINH_FId.DFC_ChgrPlugLockPinMoveWoCmd_CA "" VAL_BLK 0x80246AA4 ValA_Wu16 1139.00000000 DINH_FIdVerb 0.00 1139.00000000 FORMAT "%13.8" MATRIX_DIM 13 /end CHARACTERISTIC
/begin CHARACTERISTIC DINH_FId.DFC_ChgrPlugLockPinStuckInClsd_CA "" VAL_BLK 0x80246ABE ValA_Wu16 1139.00000000 DINH_FIdVerb 0.00 1139.00000000 FORMAT "%13.8" MATRIX_DIM 13 /end CHARACTERISTIC
/begin CHARACTERISTIC DINH_FId.DFC_ChgrPlugLockPinStuckInOpen_CA "" VAL_BLK 0x80246AD8 ValA_Wu16 1139.00000000 DINH_FIdVerb 0.00 1139.00000000 FORMAT "%13.8" MATRIX_DIM 13 /end CHARACTERISTIC
/begin CHARACTERISTIC DINH_FId.DFC_ChrgrStErr_CA "" VAL_BLK 0x80246AF2 ValA_Wu16 1139.00000000 DINH_FIdVerb 0.00 1139.00000000 FORMAT "%13.8" MATRIX_DIM 13 /end CHARACTERISTIC
/begin CHARACTERISTIC DINH_FId.DFC_ComHSN1BusOff_CA "" VAL_BLK 0x80246B0C ValA_Wu16 1139.00000000 DINH_FIdVerb 0.00 1139.00000000 FORMAT "%13.8" MATRIX_DIM 13 /end CHARACTERISTIC
/begin CHARACTERISTIC DINH_FId.DFC_ComHSN3BusOff_CA "" VAL_BLK 0x80246B26 ValA_Wu16 1139.00000000 DINH_FIdVerb 0.00 1139.00000000 FORMAT "%13.8" MATRIX_DIM 13 /end CHARACTERISTIC
/begin CHARACTERISTIC DINH_FId.DFC_ComVCInval_CA "" VAL_BLK 0x80246B40 ValA_Wu16 1139.00000000 DINH_FIdVerb 0.00 1139.00000000 FORMAT "%13.8" MATRIX_DIM 13 /end CHARACTERISTIC
/begin CHARACTERISTIC DINH_FId.DFC_EemDcdcPrecSpdInhb_CA "" VAL_BLK 0x80246B5A ValA_Wu16 1139.00000000 DINH_FIdVerb 0.00 1139.00000000 FORMAT "%13.8" MATRIX_DIM 13 /end CHARACTERISTIC
/begin CHARACTERISTIC DINH_FId.DFC_ExpPwrLatch_CA "" VAL_BLK 0x80246B74 ValA_Wu16 1139.00000000 DINH_FIdVerb 0.00 1139.00000000 FORMAT "%13.8" MATRIX_DIM 14 /end CHARACTERISTIC
/begin CHARACTERISTIC DINH_FId.DFC_FanMaxOvrd_CA "" VAL_BLK 0x80246B90 ValA_Wu16 1139.00000000 DINH_FIdVerb 0.00 1139.00000000 FORMAT "%13.8" MATRIX_DIM 13 /end CHARACTERISTIC
/begin CHARACTERISTIC DINH_FId.DFC_HLCCcsGnrlComErr_CA "" VAL_BLK 0x80246BAA ValA_Wu16 1139.00000000 DINH_FIdVerb 0.00 1139.00000000 FORMAT "%13.8" MATRIX_DIM 13 /end CHARACTERISTIC
/begin CHARACTERISTIC DINH_FId.DFC_InmLINNodeHVACPanelAbsnt_CA "" VAL_BLK 0x80246BC4 ValA_Wu16 1139.00000000 DINH_FIdVerb 0.00 1139.00000000 FORMAT "%13.8" MATRIX_DIM 15 /end CHARACTERISTIC
/begin CHARACTERISTIC DINH_FId.DFC_ResetRcvNotAllwd_CA "" VAL_BLK 0x80246BE2 ValA_Wu16 1139.00000000 DINH_FIdVerb 0.00 1139.00000000 FORMAT "%13.8" MATRIX_DIM 13 /end CHARACTERISTIC
/begin CHARACTERISTIC DINH_FId.DFC_TelltlCooltPlaus_CA "" VAL_BLK 0x80246BFC ValA_Wu16 1139.00000000 DINH_FIdVerb 0.00 1139.00000000 FORMAT "%13.8" MATRIX_DIM 13 /end CHARACTERISTIC
/begin CHARACTERISTIC DINH_FId.DFC_MRlyOL_CA "" VAL_BLK 0x80246C16 ValA_Wu16 1139.00000000 DINH_FIdVerb 0.00 1139.00000000 FORMAT "%13.8" MATRIX_DIM 13 /end CHARACTERISTIC
/begin CHARACTERISTIC DINH_FId.DFC_MRlySCB_CA "" VAL_BLK 0x80246C30 ValA_Wu16 1139.00000000 DINH_FIdVerb 0.00 1139.00000000 FORMAT "%13.8" MATRIX_DIM 13 /end CHARACTERISTIC
/begin CHARACTERISTIC DINH_FId.DFC_MRlySCG_CA "" VAL_BLK 0x80246C4A ValA_Wu16 1139.00000000 DINH_FIdVerb 0.00 1139.00000000 FORMAT "%13.8" MATRIX_DIM 14 /end CHARACTERISTIC
/begin CHARACTERISTIC DINH_FId.DFC_SSpMon1_CA "" VAL_BLK 0x80246C66 ValA_Wu16 1139.00000000 DINH_FIdVerb 0.00 1139.00000000 FORMAT "%13.8" MATRIX_DIM 45 /end CHARACTERISTIC
/begin CHARACTERISTIC DINH_FId.DFC_SSpMon1OV_CA "" VAL_BLK 0x80246CC0 ValA_Wu16 1139.00000000 DINH_FIdVerb 0.00 1139.00000000 FORMAT "%13.8" MATRIX_DIM 17 /end CHARACTERISTIC
/begin CHARACTERISTIC DINH_FId.DFC_SSpMon1SCG_CA "" VAL_BLK 0x80246CE2 ValA_Wu16 1139.00000000 DINH_FIdVerb 0.00 1139.00000000 FORMAT "%13.8" MATRIX_DIM 17 /end CHARACTERISTIC
/begin CHARACTERISTIC DINH_FId.DFC_SSpMon1UV_CA "" VAL_BLK 0x80246D04 ValA_Wu16 1139.00000000 DINH_FIdVerb 0.00 1139.00000000 FORMAT "%13.8" MATRIX_DIM 17 /end CHARACTERISTIC
/begin CHARACTERISTIC DINH_FId.DFC_SSpMon2_CA "" VAL_BLK 0x80246D26 ValA_Wu16 1139.00000000 DINH_FIdVerb 0.00 1139.00000000 FORMAT "%13.8" MATRIX_DIM 42 /end CHARACTERISTIC
/begin CHARACTERISTIC DINH_FId.DFC_SSpMon2OV_CA "" VAL_BLK 0x80246D7A ValA_Wu16 1139.00000000 DINH_FIdVerb 0.00 1139.00000000 FORMAT "%13.8" MATRIX_DIM 14 /end CHARACTERISTIC
/begin CHARACTERISTIC DINH_FId.DFC_SSpMon2SCG_CA "" VAL_BLK 0x80246D96 ValA_Wu16 1139.00000000 DINH_FIdVerb 0.00 1139.00000000 FORMAT "%13.8" MATRIX_DIM 14 /end CHARACTERISTIC
/begin CHARACTERISTIC DINH_FId.DFC_SSpMon2UV_CA "" VAL_BLK 0x80246DB2 ValA_Wu16 1139.00000000 DINH_FIdVerb 0.00 1139.00000000 FORMAT "%13.8" MATRIX_DIM 14 /end CHARACTERISTIC
/begin CHARACTERISTIC DINH_FId.DFC_SSpMon3_CA "" VAL_BLK 0x80246DCE ValA_Wu16 1139.00000000 DINH_FIdVerb 0.00 1139.00000000 FORMAT "%13.8" MATRIX_DIM 45 /end CHARACTERISTIC
/begin CHARACTERISTIC DINH_FId.DFC_SSpMon3OV_CA "" VAL_BLK 0x80246E28 ValA_Wu16 1139.00000000 DINH_FIdVerb 0.00 1139.00000000 FORMAT "%13.8" MATRIX_DIM 16 /end CHARACTERISTIC
/begin CHARACTERISTIC DINH_FId.DFC_SSpMon3SCG_CA "" VAL_BLK 0x80246E48 ValA_Wu16 1139.00000000 DINH_FIdVerb 0.00 1139.00000000 FORMAT "%13.8" MATRIX_DIM 16 /end CHARACTERISTIC
/begin CHARACTERISTIC DINH_FId.DFC_SSpMon3UV_CA "" VAL_BLK 0x80246E68 ValA_Wu16 1139.00000000 DINH_FIdVerb 0.00 1139.00000000 FORMAT "%13.8" MATRIX_DIM 16 /end CHARACTERISTIC
/begin CHARACTERISTIC DINH_FId.DFC_CANSM_E_BUS_OFF_NETWORK_HSN1_CAN_CA "" VAL_BLK 0x80246E88 ValA_Wu16 1139.00000000 DINH_FIdVerb 0.00 1139.00000000 FORMAT "%13.8" MATRIX_DIM 13 /end CHARACTERISTIC
/begin CHARACTERISTIC DINH_FId.DFC_CANSM_E_BUS_OFF_NETWORK_HSN3_CAN_CA "" VAL_BLK 0x80246EA2 ValA_Wu16 1139.00000000 DINH_FIdVerb 0.00 1139.00000000 FORMAT "%13.8" MATRIX_DIM 13 /end CHARACTERISTIC
/begin CHARACTERISTIC DINH_FId.DFC_CANSM_E_BUS_OFF_NETWORK_HSN4_CAN_CA "" VAL_BLK 0x80246EBC ValA_Wu16 1139.00000000 DINH_FIdVerb 0.00 1139.00000000 FORMAT "%13.8" MATRIX_DIM 13 /end CHARACTERISTIC
/begin FUNCTION DINH "30000.25.0Diagnostic Inhibit Handler"
 /begin DEF_CHARACTERISTIC DINH_FId.DFC_ACCmprFltLvlRes_CA DINH_FId.DFC_AbgHiSigFlt_CA DINH_FId.DFC_AbgIntPatFlt_CA DINH_FId.DFC_AbgLoSigFlt_CA DINH_FId.DFC_AbgUnkwnErrSigFlt_CA DINH_FId.DFC_AcExtChrgrIBattExcdd_CA DINH_FId.DFC_AcExtChrgrIInExcdd_CA DINH_FId.DFC_AcExtChrgrIOutDe_CA DINH_FId.DFC_AcExtChrgrIOutExcdd_CA DINH_FId.DFC_AcExtChrgrUOutDe_CA DINH_FId.DFC_AdpActvDChaFailr_CA DINH_FId.DFC_AirbcuFlt_CA DINH_FId.DFC_Airbg_CA DINH_FId.DFC_AirbgCan_CA DINH_FId.DFC_AirbgCanHWPlaus_CA DINH_FId.DFC_AirbgHWCanPlaus_CA DINH_FId.DFC_AirbgMnr_CA DINH_FId.DFC_AirbgPerHi_CA DINH_FId.DFC_AirbgPerdRngFlt_CA DINH_FId.DFC_BlowrRlyErr_CA DINH_FId.DFC_BrkBstPmpActtnDfct_CA DINH_FId.DFC_BrkBstPmpDeactvnDfct_CA DINH_FId.DFC_BrkSwtFlt_CA DINH_FId.DFC_CbnHeatgHeatrHsScb_CA DINH_FId.DFC_CbnHeatgHeatrHsScg_CA DINH_FId.DFC_CbnHeatgHeatrLsOl_CA DINH_FId.DFC_CbnHeatgHeatrLsScb_CA DINH_FId.DFC_CbnHeatgHeatrLsScg_CA DINH_FId.DFC_CbnHeatgHeatrUnUsed_CA DINH_FId.DFC_ChrgnCntctHsOt_CA DINH_FId.DFC_ChrgnCntctHsScb_CA DINH_FId.DFC_ChrgnCntctHsScg_CA DINH_FId.DFC_ChrgnCntctLsNegOl_CA DINH_FId.DFC_ChrgnCntctLsNegOt_CA DINH_FId.DFC_ChrgnCntctLsNegScb_CA DINH_FId.DFC_ChrgnCntctLsNegScg_CA DINH_FId.DFC_ChrgnCntctLsPosOl_CA DINH_FId.DFC_ChrgnCntctLsPosOt_CA DINH_FId.DFC_ChrgnCntctLsPosScb_CA DINH_FId.DFC_ChrgnCntctLsPosScg_CA DINH_FId.DFC_ChrgnCntctUnUsed_CA DINH_FId.DFC_ComBrkMai_CA DINH_FId.DFC_ComChrgrEVCont_CA DINH_FId.DFC_ComChrgrEVtBlink_CA DINH_FId.DFC_ComChrgrMstBlink_CA DINH_FId.DFC_ComChrgrMstCont_CA DINH_FId.DFC_ComChrgrSVSBlink_CA DINH_FId.DFC_ComChrgrSVSCont_CA DINH_FId.DFC_ComDcdcEVBlink_CA DINH_FId.DFC_ComDcdcEVCont_CA DINH_FId.DFC_ComDcdcFltLvl2_CA DINH_FId.DFC_ComDcdcFltLvl3_CA DINH_FId.DFC_ComDcdcFltLvl4_CA DINH_FId.DFC_ComDcdcFltLvl5_CA DINH_FId.DFC_ComDcdcFltLvlRes_CA DINH_FId.DFC_ComDcdcMstBlink_CA DINH_FId.DFC_ComDcdcMstCont_CA DINH_FId.DFC_ComDcdcSVSBlink_CA DINH_FId.DFC_ComDcdcSVSCont_CA DINH_FId.DFC_ComElMIIvtrFltLvl2_CA DINH_FId.DFC_ComElMIIvtrFltLvl3_CA DINH_FId.DFC_ComElMIIvtrFltLvl4_CA DINH_FId.DFC_ComElMIIvtrFltLvl5_CA DINH_FId.DFC_ComElMIIvtrFltLvlRes_CA DINH_FId.DFC_ComEmacEVBlink_CA DINH_FId.DFC_ComEmacEVCont_CA DINH_FId.DFC_ComEmacMstCont_CA DINH_FId.DFC_ComEmacMsttBlink_CA DINH_FId.DFC_ComEmacSVSBlink_CA DINH_FId.DFC_ComEmacSVSCont_CA DINH_FId.DFC_ComGunCntInfoWkuReq_CA DINH_FId.DFC_ComHillHldFlt_CA DINH_FId.DFC_ComHvBattRchrgWkuReq_CA DINH_FId.DFC_ComHvbFltLvl2_CA DINH_FId.DFC_ComHvbFltLvl3_CA DINH_FId.DFC_ComHvbFltLvl4_CA DINH_FId.DFC_ComHvbFltLvl5_CA DINH_FId.DFC_ComHvbFltLvlRes_CA DINH_FId.DFC_ComHvbMstBlink_CA DINH_FId.DFC_ComHvbMstCont_CA DINH_FId.DFC_ComImmoUnlockWkuReq_CA DINH_FId.DFC_ComInfoReqPtlWkuReq_CA DINH_FId.DFC_ComOBCFltLvl2_CA DINH_FId.DFC_ComOBCFltLvl3_CA DINH_FId.DFC_ComOBCFltLvl4_CA DINH_FId.DFC_ComOBCFltLvl5_CA DINH_FId.DFC_ComOBCFltLvlRes_CA DINH_FId.DFC_ComPostOperationWkuReq_CA DINH_FId.DFC_ComPreCondElecWkuReq_CA DINH_FId.DFC_ComRemUnlckWkuReq_CA DINH_FId.DFC_ComStpDlyHMIWkuReq_CA DINH_FId.DFC_ComflgCurMeasmtErr_CA DINH_FId.DFC_ComflgCurMeasmtSysErr_CA DINH_FId.DFC_ComflgCurMeasmtVld_CA DINH_FId.DFC_ComflgCurRngErr_CA DINH_FId.DFC_ComflgTPcbMeasmtErr_CA DINH_FId.DFC_ComflgTPcbMeasmtVld_CA DINH_FId.DFC_ComflgTPcbRngErr_CA DINH_FId.DFC_ComflgTPcbSysErr_CA DINH_FId.DFC_ComflgTShntMeasmtErr_CA DINH_FId.DFC_ComflgTShntMeasmtVld_CA DINH_FId.DFC_ComflgTShntRngErr_CA DINH_FId.DFC_ComflgTShntSysErr_CA DINH_FId.DFC_ComflgVoltMeasmtErr_CA DINH_FId.DFC_ComflgVoltMeasmtSysErr_CA DINH_FId.DFC_ComflgVoltMeasmtVld_CA DINH_FId.DFC_ComflgVoltRngErr_CA DINH_FId.DFC_CrashEveOcc_CA DINH_FId.DFC_DcdcFwdModStuck_CA DINH_FId.DFC_DcdcLvUDifMaxFlt_CA DINH_FId.DFC_DcdcOffModStuck_CA DINH_FId.DFC_DcdcOperModFailr_CA DINH_FId.DFC_DcdcPrecModStuck_CA DINH_FId.DFC_DrvDoorOpn_CA DINH_FId.DFC_DrvModPosnDfct_CA DINH_FId.DFC_DrvStbltOpn_CA DINH_FId.DFC_ETogFailrLvl3_CA DINH_FId.DFC_ETogFailrLvl4_CA DINH_FId.DFC_EbsLvBattSocDiagLo_CA DINH_FId.DFC_EbsLvBattUDiagDiOper_CA DINH_FId.DFC_EbsLvBattUDiagFltLvl1_CA DINH_FId.DFC_EbsLvBattUDiagFltLvl2_CA DINH_FId.DFC_EbsLvBattUDiagLo_CA DINH_FId.DFC_EbsSnsrSt_CA DINH_FId.DFC_EbsSofASILErr_CA DINH_FId.DFC_ElTSPtSysLimDrvErr_CA DINH_FId.DFC_ElTSPtSysLimRgnErr_CA DINH_FId.DFC_HLCCcsFwDwnl_CA DINH_FId.DFC_HvBattChrgPwrMax_CA DINH_FId.DFC_HvBattCrashDetd_CA DINH_FId.DFC_HvBattDchaPwrMax_CA DINH_FId.DFC_HvBattEmgyOff_CA DINH_FId.DFC_HvBattEmgyOffIntlck_CA DINH_FId.DFC_HvBattEmgyOffReq_CA DINH_FId.DFC_HvBattFltMod_CA DINH_FId.DFC_HvBattIReqToChrgrErr_CA DINH_FId.DFC_HvBattIReqToChrgrIni_CA DINH_FId.DFC_HvBattIninTout_CA DINH_FId.DFC_HvBattIntlckSt_CA DINH_FId.DFC_HvBattIsoFlt_CA DINH_FId.DFC_HvBattLimdPwr_CA DINH_FId.DFC_HvBattMaiSwtClsngFlt_CA DINH_FId.DFC_HvBattMaiSwtFlt_CA DINH_FId.DFC_HvBattMaiSwtOpen_CA DINH_FId.DFC_HvBattMaiSwtOpngFlt_CA DINH_FId.DFC_HvBattMaiSwtWldd_CA DINH_FId.DFC_HvBattNegCntctrCntErr_CA DINH_FId.DFC_HvBattOperModChrgPlausy_CA DINH_FId.DFC_HvBattOverTDern_CA DINH_FId.DFC_HvBattPosCntctrCntErr_CA DINH_FId.DFC_HvBattPrecCntctrCntErr_CA DINH_FId.DFC_HvBattPwrDistbnTDern_CA DINH_FId.DFC_HvBattPwrDistbnTInhbn_CA DINH_FId.DFC_HvBattRatRSohErr_CA DINH_FId.DFC_HvBattRatSohErr_CA DINH_FId.DFC_HvBattSngIsoWarn_CA DINH_FId.DFC_HvBattSrvPlgDiscnct_CA DINH_FId.DFC_HvBattUNomChrgnErr_CA DINH_FId.DFC_HvBattUNomChrgnIni_CA DINH_FId.DFC_HvBattUnderTDern_CA DINH_FId.DFC_HvbEVLmpBlink_CA DINH_FId.DFC_HvbEVLmpCont_CA DINH_FId.DFC_HvbSVSBlink_CA DINH_FId.DFC_HvbSVSCont_CA DINH_FId.DFC_InmLINBusBlk_CA DINH_FId.DFC_PDUProgmFailr_CA DINH_FId.DFC_PEnvSigRngMax_CA DINH_FId.DFC_PEnvSigRngMin_CA DINH_FId.DFC_PLnCChpDeactvnFaild_CA DINH_FId.DFC_PrkgBrkFailr_CA DINH_FId.DFC_PtSysLimErr_CA DINH_FId.DFC_PwrMaxDchaShoLo_CA DINH_FId.DFC_SCtPmp1FailSafeNotSuc_CA DINH_FId.DFC_SCtPmp1SCG_CA DINH_FId.DFC_VehCoornDrvrNotPrsnt_CA DINH_FId.DFC_VehVCanAvl_CA DINH_FId.DFC_VehVCanErr_CA DINH_FId.DFC_eTogFailrLvlRes_CA DINH_FId.DFC_flgBrkMaiDiag_CA DINH_FId.DFC_stHvbIsoMeasmtRes_CA DINH_FId.DFC_BrkBstPmpPLeakDfct_CA DINH_FId.DFC_Com082hTooShort_CA DINH_FId.DFC_Com092hTooShort_CA DINH_FId.DFC_Com205hAbsent_CA DINH_FId.DFC_Com205hChecksum_CA DINH_FId.DFC_Com205hCounter_CA DINH_FId.DFC_Com205hTooShort_CA DINH_FId.DFC_Com217hAbsent_CA DINH_FId.DFC_Com217hChecksum_CA DINH_FId.DFC_Com217hCounter_CA DINH_FId.DFC_Com217hTooShort_CA DINH_FId.DFC_Com227hAbsent_CA DINH_FId.DFC_Com227hTooShort_CA DINH_FId.DFC_Com237hAbsent_CA DINH_FId.DFC_Com237hChecksum_CA DINH_FId.DFC_Com237hCounter_CA DINH_FId.DFC_Com237hTooShort_CA DINH_FId.DFC_Com259hAbsent_CA DINH_FId.DFC_Com259hChecksum_CA DINH_FId.DFC_Com259hCounter_CA DINH_FId.DFC_Com259hTooShort_CA DINH_FId.DFC_Com26hAbsent_CA DINH_FId.DFC_Com26hTooShort_CA DINH_FId.DFC_Com273hAbsent_CA DINH_FId.DFC_Com273hChecksum_CA DINH_FId.DFC_Com273hCounter_CA DINH_FId.DFC_Com273hTooShort_CA DINH_FId.DFC_Com275hAbsent_CA DINH_FId.DFC_Com275hChecksum_CA DINH_FId.DFC_Com275hCounter_CA DINH_FId.DFC_Com275hTooShort_CA DINH_FId.DFC_Com283hAbsent_CA DINH_FId.DFC_Com283hTooShort_CA DINH_FId.DFC_Com285hAbsent_CA DINH_FId.DFC_Com285hChecksum_CA DINH_FId.DFC_Com285hCounter_CA DINH_FId.DFC_Com285hTooShort_CA DINH_FId.DFC_Com293hAbsent_CA DINH_FId.DFC_Com293hChecksum_CA DINH_FId.DFC_Com293hCounter_CA DINH_FId.DFC_Com293hTooShort_CA DINH_FId.DFC_Com308hAbsent_CA DINH_FId.DFC_Com308hChecksum_CA DINH_FId.DFC_Com308hCounter_CA DINH_FId.DFC_Com308hTooShort_CA DINH_FId.DFC_Com318hAbsent_CA DINH_FId.DFC_Com318hChecksum_CA DINH_FId.DFC_Com318hCounter_CA DINH_FId.DFC_Com318hTooShort_CA DINH_FId.DFC_Com325hAbsent_CA DINH_FId.DFC_Com325hChecksum_CA DINH_FId.DFC_Com325hCounter_CA DINH_FId.DFC_Com325hTooShort_CA DINH_FId.DFC_Com335hAbsent_CA DINH_FId.DFC_Com335hChecksum_CA DINH_FId.DFC_Com335hCounter_CA DINH_FId.DFC_Com335hTooShort_CA DINH_FId.DFC_Com351hAbsent_CA DINH_FId.DFC_Com351hTooShort_CA DINH_FId.DFC_Com38DhAbsent_CA DINH_FId.DFC_Com38DhChecksum_CA DINH_FId.DFC_Com38DhCounter_CA DINH_FId.DFC_Com38DhTooShort_CA DINH_FId.DFC_Com412hAbsent_CA DINH_FId.DFC_Com412hChecksum_CA DINH_FId.DFC_Com412hCounter_CA DINH_FId.DFC_Com412hTooShort_CA DINH_FId.DFC_Com427hAbsent_CA DINH_FId.DFC_Com427hTooShort_CA DINH_FId.DFC_Com432hAbsent_CA DINH_FId.DFC_Com432hChecksum_CA DINH_FId.DFC_Com432hCounter_CA DINH_FId.DFC_Com432hTooShort_CA DINH_FId.DFC_Com435hAbsent_CA DINH_FId.DFC_Com435hTooShort_CA DINH_FId.DFC_Com442hAbsent_CA DINH_FId.DFC_Com442hTooShort_CA DINH_FId.DFC_Com453hAbsent_CA DINH_FId.DFC_Com453hTooShort_CA DINH_FId.DFC_Com455hAbsent_CA DINH_FId.DFC_Com455hTooShort_CA DINH_FId.DFC_Com463hAbsent_CA DINH_FId.DFC_Com463hTooShort_CA DINH_FId.DFC_Com473hAbsent_CA DINH_FId.DFC_Com473hTooShort_CA DINH_FId.DFC_Com47BhAbsent_CA DINH_FId.DFC_Com47BhTooShort_CA DINH_FId.DFC_Com48BhAbsent_CA DINH_FId.DFC_Com48BhTooShort_CA DINH_FId.DFC_Com497hTooShort_CA DINH_FId.DFC_Com4F2hAbsent_CA DINH_FId.DFC_Com4F2hChecksum_CA DINH_FId.DFC_Com4F2hCounter_CA DINH_FId.DFC_Com4F2hTooShort_CA DINH_FId.DFC_Com50DhAbsent_CA DINH_FId.DFC_Com50DhTooShort_CA DINH_FId.DFC_Com535hAbsent_CA DINH_FId.DFC_Com535hTooShort_CA DINH_FId.DFC_Com543hAbsent_CA DINH_FId.DFC_Com543hTooShort_CA DINH_FId.DFC_Com552hAbsent_CA DINH_FId.DFC_Com552hTooShort_CA DINH_FId.DFC_Com583hAbsent_CA DINH_FId.DFC_Com583hTooShort_CA DINH_FId.DFC_Com592hAbsent_CA DINH_FId.DFC_Com592hChecksum_CA DINH_FId.DFC_Com592hCounter_CA DINH_FId.DFC_Com592hTooShort_CA DINH_FId.DFC_Com595hAbsent_CA DINH_FId.DFC_Com595hChecksum_CA DINH_FId.DFC_Com595hCounter_CA DINH_FId.DFC_Com595hTooShort_CA DINH_FId.DFC_Com5B2hAbsent_CA DINH_FId.DFC_Com5B2hTooShort_CA DINH_FId.DFC_Com5B5hAbsent_CA DINH_FId.DFC_Com5B5hChecksum_CA DINH_FId.DFC_Com5B5hCounter_CA DINH_FId.DFC_Com5B5hTooShort_CA DINH_FId.DFC_Com5C7hTooShort_CA DINH_FId.DFC_Com5E7hAbsent_CA DINH_FId.DFC_Com5E7hTooShort_CA DINH_FId.DFC_Com635hTooShort_CA DINH_FId.DFC_Com645hTooShort_CA DINH_FId.DFC_Com663hAbsent_CA DINH_FId.DFC_Com663hTooShort_CA DINH_FId.DFC_Com665hAbsent_CA DINH_FId.DFC_Com665hTooShort_CA DINH_FId.DFC_Com675hAbsent_CA DINH_FId.DFC_Com675hTooShort_CA DINH_FId.DFC_ComFrbd_205h_HVBAT_PACK_CURRENT_CA DINH_FId.DFC_ComFrbd_205h_HVBAT_SOC_DISPLAY_CA DINH_FId.DFC_ComFrbd_205h_HVBAT_VOLTAGE_CA DINH_FId.DFC_ComFrbd_217h_INV_DC_BUS_VOLTAGE_CA DINH_FId.DFC_ComFrbd_217h_INV_MTR_ACTUAL_TRQ_CA DINH_FId.DFC_ComFrbd_217h_INV_MTR_SPEED_CA DINH_FId.DFC_ComFrbd_217h_INV_MTR_TRQ_CA DINH_FId.DFC_ComFrbd_227h_INV_DC_CURRENT_CA DINH_FId.DFC_ComFrbd_227h_INV_MOTORING_PEAK_TRQ_CA DINH_FId.DFC_ComFrbd_227h_INV_MTR_INST_INPUT_POWER_CA DINH_FId.DFC_ComFrbd_227h_INV_REGEN_PEAK_TRQ_CA DINH_FId.DFC_ComFrbd_237h_INV_ACTIVE_DISCHARGE_STATUS_CA DINH_FId.DFC_ComFrbd_237h_INV_CTRL_MODE_ACK_CA DINH_FId.DFC_ComFrbd_237h_INV_EV_WARNING_CA DINH_FId.DFC_ComFrbd_237h_INV_FAULT_LEVEL_CA DINH_FId.DFC_ComFrbd_237h_INV_MASTER_STOP_CA DINH_FId.DFC_ComFrbd_237h_INV_SERVICE_DUE_CA DINH_FId.DFC_ComFrbd_237h_INV_STAB_MIN_TRQ_CA DINH_FId.DFC_ComFrbd_259h_TGLM_FAILURE_STATE_CA DINH_FId.DFC_ComFrbd_259h_TGLM_MODE_PUSH_CA DINH_FId.DFC_ComFrbd_259h_TOGGLE_MONOSTABLE_POS_CA DINH_FId.DFC_ComFrbd_273h_OBC_outputpower_capability_CA DINH_FId.DFC_ComFrbd_275h_HVBAT_DISCHARGE_30S_AVAILABLE_CURRENT_CA DINH_FId.DFC_ComFrbd_275h_HVBAT_DISCHARGE_30S_AVAILABLE_POWER_CA DINH_FId.DFC_ComFrbd_283h_DCDC_IN_CURRENT_CA DINH_FId.DFC_ComFrbd_283h_DCDC_IN_VOLTAGE_CA DINH_FId.DFC_ComFrbd_283h_DCDC_OUT_CURRENT_CA DINH_FId.DFC_ComFrbd_283h_DCDC_OUT_VOLTAGE_CA DINH_FId.DFC_ComFrbd_285h_HVBAT_REGEN_CHG_30S_CURRENT_LIMIT_CA DINH_FId.DFC_ComFrbd_285h_HVBAT_REGEN_CHRG_30S_POWER_LIMIT_CA DINH_FId.DFC_ComFrbd_293h_DCDC_outputpower_capability_CA DINH_FId.DFC_ComFrbd_325h_HVBAT_INSULATION_RESISTANCE_CA DINH_FId.DFC_ComFrbd_325h_HVBAT_TEMPERATURE_CA DINH_FId.DFC_ComFrbd_335h_HVBAT_CHRG_CONTINUOUS_CURR_MAX_CA DINH_FId.DFC_ComFrbd_335h_HVBAT_CHRG_COTINUOUS_CURR_REQ_CA DINH_FId.DFC_ComFrbd_335h_HVBAT_CHRG_MAX_VOLT_CA DINH_FId.DFC_ComFrbd_335h_HVBAT_DC_BUS_VOLTAGE_CA DINH_FId.DFC_ComFrbd_427h_INV_OP_MODE_CA DINH_FId.DFC_ComFrbd_427h_INV_PERMISIBLE_TORQUE_CA DINH_FId.DFC_ComFrbd_435h_HVBAT_MAX_CELL_VOLT_CA DINH_FId.DFC_ComFrbd_435h_HVBAT_MAX_CELL_VOLT_NUM_CA DINH_FId.DFC_ComFrbd_435h_HVBAT_MAX_SENSOR_TEMP_CA DINH_FId.DFC_ComFrbd_435h_HVBAT_MIN_CELL_VOLT_CA DINH_FId.DFC_ComFrbd_435h_HVBAT_MIN_CELL_VOLT_NUM_CA DINH_FId.DFC_ComFrbd_453h_OBC_IN_CURRENT_CA DINH_FId.DFC_ComFrbd_453h_OBC_IN_VOLTAGE_CA DINH_FId.DFC_ComFrbd_453h_OBC_IP_POWER_CA DINH_FId.DFC_ComFrbd_455h_HVBAT_NOMINAL_VOLTAGE_CA DINH_FId.DFC_ComFrbd_463h_OBC_OUT_CURRENT_CA DINH_FId.DFC_ComFrbd_463h_OBC_OUT_VOLTAGE_CA DINH_FId.DFC_ComFrbd_463h_OBC_TEMPERATURE_CA DINH_FId.DFC_ComFrbd_473h_DCDC_Coolant_Temperature_CA DINH_FId.DFC_ComFrbd_473h_DCDC_TEMPERATURE_CA DINH_FId.DFC_ComFrbd_47Bh_eCOMP_BusBarCurrent_CA DINH_FId.DFC_ComFrbd_47Bh_eCOMP_BusBarVoltage_CA DINH_FId.DFC_ComFrbd_47Bh_eCOMP_CompressorSpeed_CA DINH_FId.DFC_ComFrbd_47Bh_eCOMP_IGBT_Temp_CA DINH_FId.DFC_ComFrbd_47Bh_eCOMP_PeakPhaCurrent_CA DINH_FId.DFC_ComFrbd_47Bh_eCOMP_Power_consumption_CA DINH_FId.DFC_ComFrbd_48Bh_eCOMP_Fault_Level_CA DINH_FId.DFC_ComFrbd_4F2h_VALEUR_SOC_ETENDUE_CA DINH_FId.DFC_ComFrbd_535h_HV_BATT_TEMP_AVG_CA DINH_FId.DFC_ComFrbd_543h_HVBAT_RESTBATTENERGY_CA DINH_FId.DFC_ComFrbd_543h_HVBAT_SOH_CA DINH_FId.DFC_ComFrbd_543h_HV_BATT_SOH_RES_CA DINH_FId.DFC_ComFrbd_592h_IBATT_1_CA DINH_FId.DFC_ComFrbd_592h_IBATT_2_CA DINH_FId.DFC_ComFrbd_592h_IBATT_3_CA DINH_FId.DFC_ComFrbd_592h_TEMP_BATT_CA DINH_FId.DFC_ComFrbd_592h_U_BATT_BECB_CA DINH_FId.DFC_ComFrbd_595h_HVBAT_TIME_TO_CHRG_80_CA DINH_FId.DFC_ComFrbd_5B2h_TEMP_AIR_EXT_CA DINH_FId.DFC_ComFrbd_635h_HVBAT_NEG_CONT_COUNT_SEG1_CA DINH_FId.DFC_ComFrbd_635h_HVBAT_NEG_CONT_COUNT_SEG3_CA DINH_FId.DFC_ComFrbd_635h_HVBAT_NEG_CONT_COUNT_SEG4_CA DINH_FId.DFC_ComFrbd_635h_HVBAT_PST_CONT_COUNT_SEG1_CA DINH_FId.DFC_ComFrbd_635h_HVBAT_PST_CONT_COUNT_SEG3_CA DINH_FId.DFC_ComFrbd_635h_HVBAT_PST_CONT_COUNT_SEG4_CA DINH_FId.DFC_ComFrbd_645h_HVBAT_PRECHRGE_CONT_COUNT_SEG1_CA DINH_FId.DFC_ComFrbd_645h_HVBAT_PRECHRGE_CONT_COUNT_SEG2_CA DINH_FId.DFC_ComFrbd_675h_HVBAT_REMAININGBATTCAPACITY_CA DINH_FId.DFC_ComInvld_205h_HVBAT_CHARGING_STATUS_CA DINH_FId.DFC_ComInvld_205h_HVBAT_PACK_CURRENT_CA DINH_FId.DFC_ComInvld_205h_HVBAT_SOC_DISPLAY_CA DINH_FId.DFC_ComInvld_205h_HVBAT_VOLTAGE_CA DINH_FId.DFC_ComInvld_217h_INV_DC_BUS_VOLTAGE_CA DINH_FId.DFC_ComInvld_217h_INV_MTR_ACTUAL_TRQ_CA DINH_FId.DFC_ComInvld_217h_INV_MTR_SPEED_CA DINH_FId.DFC_ComInvld_217h_INV_MTR_TRQ_CA DINH_FId.DFC_ComInvld_227h_INV_DC_CURRENT_CA DINH_FId.DFC_ComInvld_227h_INV_MOTORING_PEAK_TRQ_CA DINH_FId.DFC_ComInvld_227h_INV_MTR_INST_INPUT_POWER_CA DINH_FId.DFC_ComInvld_227h_INV_REGEN_PEAK_TRQ_CA DINH_FId.DFC_ComInvld_237h_INV_ACTIVE_DISCHARGE_STATUS_CA DINH_FId.DFC_ComInvld_237h_INV_FAULT_LEVEL_CA DINH_FId.DFC_ComInvld_237h_INV_STAB_MIN_TRQ_CA DINH_FId.DFC_ComInvld_259h_TGLM_MODE_PUSH_CA DINH_FId.DFC_ComInvld_259h_TOGGLE_MONOSTABLE_POS_CA DINH_FId.DFC_ComInvld_26h_AC_SWITCH_REQ_CA DINH_FId.DFC_ComInvld_26h_BLOWER_POSITION_CA DINH_FId.DFC_ComInvld_26h_EVAP_SENSOR_FAULT_CA DINH_FId.DFC_ComInvld_26h_EVAP_SENSOR_VALUE_CA DINH_FId.DFC_ComInvld_26h_POTENTIOMETER_FAULT_CA DINH_FId.DFC_ComInvld_26h_REAR_DEFOG_REQ_CA DINH_FId.DFC_ComInvld_26h_TEMP_POSITION_CA DINH_FId.DFC_ComInvld_273h_OBC_FAULT_LEVEL_CA DINH_FId.DFC_ComInvld_273h_OBC_outputpower_capability_CA DINH_FId.DFC_ComInvld_275h_HVBAT_DISCHARGE_30S_AVAILABLE_CURRENT_CA DINH_FId.DFC_ComInvld_275h_HVBAT_DISCHARGE_30S_AVAILABLE_POWER_CA DINH_FId.DFC_ComInvld_283h_DCDC_IN_CURRENT_CA DINH_FId.DFC_ComInvld_283h_DCDC_IN_VOLTAGE_CA DINH_FId.DFC_ComInvld_283h_DCDC_OUT_CURRENT_CA DINH_FId.DFC_ComInvld_283h_DCDC_OUT_VOLTAGE_CA DINH_FId.DFC_ComInvld_285h_HVBAT_REGEN_CHG_30S_CURRENT_LIMIT_CA DINH_FId.DFC_ComInvld_285h_HVBAT_REGEN_CHRG_30S_POWER_LIMIT_CA DINH_FId.DFC_ComInvld_293h_DCDC_FAULT_LEVEL_CA DINH_FId.DFC_ComInvld_293h_DCDC_outputpower_capability_CA DINH_FId.DFC_ComInvld_325h_HVBAT_EPLUG_STATUS_CA DINH_FId.DFC_ComInvld_325h_HVBAT_HVIL_STS_CA DINH_FId.DFC_ComInvld_325h_HVBAT_INSULATION_FAULT_CA DINH_FId.DFC_ComInvld_325h_HVBAT_INSULATION_RESISTANCE_CA DINH_FId.DFC_ComInvld_325h_HVBAT_TEMPERATURE_CA DINH_FId.DFC_ComInvld_335h_HVBAT_CHRG_CONTINUOUS_CURR_MAX_CA DINH_FId.DFC_ComInvld_335h_HVBAT_CHRG_COTINUOUS_CURR_REQ_CA DINH_FId.DFC_ComInvld_335h_HVBAT_CHRG_MAX_VOLT_CA DINH_FId.DFC_ComInvld_335h_HVBAT_DC_BUS_VOLTAGE_CA DINH_FId.DFC_ComInvld_38Dh_VITESSE_VEHICULE_ROUES_CA DINH_FId.DFC_ComInvld_38Dh_VVH_INDISP_CA DINH_FId.DFC_ComInvld_427h_INV_COOLANT_TEMP_CA DINH_FId.DFC_ComInvld_427h_INV_MOTOR_TEMP_CA DINH_FId.DFC_ComInvld_427h_INV_OP_MODE_CA DINH_FId.DFC_ComInvld_427h_INV_PERMISIBLE_TORQUE_CA DINH_FId.DFC_ComInvld_427h_INV_TEMP_CA DINH_FId.DFC_ComInvld_432h_REVEIL_PRINCIPAL_CA DINH_FId.DFC_ComInvld_435h_HVBAT_MAX_CELL_VOLT_CA DINH_FId.DFC_ComInvld_435h_HVBAT_MAX_CELL_VOLT_NUM_CA DINH_FId.DFC_ComInvld_435h_HVBAT_MAX_SENSOR_TEMP_CA DINH_FId.DFC_ComInvld_435h_HVBAT_MIN_CELL_VOLT_CA DINH_FId.DFC_ComInvld_435h_HVBAT_MIN_CELL_VOLT_NUM_CA DINH_FId.DFC_ComInvld_442h_BCCM_BLOWER_RELAY_STS_CA DINH_FId.DFC_ComInvld_453h_OBC_IN_CURRENT_CA DINH_FId.DFC_ComInvld_453h_OBC_IN_VOLTAGE_CA DINH_FId.DFC_ComInvld_453h_OBC_IP_POWER_CA DINH_FId.DFC_ComInvld_455h_HVBAT_NOMINAL_VOLTAGE_CA DINH_FId.DFC_ComInvld_463h_OBC_OUT_CURRENT_CA DINH_FId.DFC_ComInvld_463h_OBC_OUT_VOLTAGE_CA DINH_FId.DFC_ComInvld_463h_OBC_TEMPERATURE_CA DINH_FId.DFC_ComInvld_473h_DCDC_Coolant_Temperature_CA DINH_FId.DFC_ComInvld_473h_DCDC_TEMPERATURE_CA DINH_FId.DFC_ComInvld_47Bh_eCOMP_BusBarCurrent_CA DINH_FId.DFC_ComInvld_47Bh_eCOMP_BusBarVoltage_CA DINH_FId.DFC_ComInvld_47Bh_eCOMP_CompressorSpeed_CA DINH_FId.DFC_ComInvld_47Bh_eCOMP_IGBT_Temp_CA DINH_FId.DFC_ComInvld_47Bh_eCOMP_PeakPhaCurrent_CA DINH_FId.DFC_ComInvld_47Bh_eCOMP_Power_consumption_CA DINH_FId.DFC_ComInvld_4F2h_STATUS_SOC_CA DINH_FId.DFC_ComInvld_4F2h_TEMP_BATT_STATUS_CA DINH_FId.DFC_ComInvld_4F2h_VALEUR_SOC_ETENDUE_CA DINH_FId.DFC_ComInvld_535h_HV_BATT_TEMP_AVG_CA DINH_FId.DFC_ComInvld_543h_HVBAT_RESTBATTENERGY_CA DINH_FId.DFC_ComInvld_543h_HVBAT_SOH_CA DINH_FId.DFC_ComInvld_543h_HV_BATT_SOH_RES_CA DINH_FId.DFC_ComInvld_552h_CPT_TEMPOREL_CA DINH_FId.DFC_ComInvld_552h_KILOMETRAGE_CA DINH_FId.DFC_ComInvld_583h_HV_BATT_DISCONT_CSE_OPEN_CA DINH_FId.DFC_ComInvld_592h_CALIBRE_IBATT_CA DINH_FId.DFC_ComInvld_592h_IBATT_1_CA DINH_FId.DFC_ComInvld_592h_IBATT_2_CA DINH_FId.DFC_ComInvld_592h_IBATT_3_CA DINH_FId.DFC_ComInvld_592h_TEMP_BATT_CA DINH_FId.DFC_ComInvld_592h_U_BATT_BECB_CA DINH_FId.DFC_ComInvld_595h_HVBAT_TIME_TO_CHRG_80_CA DINH_FId.DFC_ComInvld_5B2h_TEMP_AIR_EXT_CA DINH_FId.DFC_ComInvld_5B5h_HVBAT_THERMAL_RUNAWAY_CA DINH_FId.DFC_ComInvld_635h_HVBAT_NEG_CONT_COUNT_SEG1_CA DINH_FId.DFC_ComInvld_635h_HVBAT_NEG_CONT_COUNT_SEG3_CA DINH_FId.DFC_ComInvld_635h_HVBAT_NEG_CONT_COUNT_SEG4_CA DINH_FId.DFC_ComInvld_635h_HVBAT_PST_CONT_COUNT_SEG1_CA DINH_FId.DFC_ComInvld_635h_HVBAT_PST_CONT_COUNT_SEG3_CA DINH_FId.DFC_ComInvld_635h_HVBAT_PST_CONT_COUNT_SEG4_CA DINH_FId.DFC_ComInvld_645h_HVBAT_PRECHRGE_CONT_COUNT_SEG1_CA DINH_FId.DFC_ComInvld_645h_HVBAT_PRECHRGE_CONT_COUNT_SEG2_CA DINH_FId.DFC_ComInvld_675h_HVBAT_REMAININGBATTCAPACITY_CA DINH_FId.DFC_ACCmprFltLvl1_CA DINH_FId.DFC_ACCmprFltLvl2_CA DINH_FId.DFC_ACCmprFltLvl3_CA DINH_FId.DFC_ACCmprFltLvl4_CA DINH_FId.DFC_ACCmprHiPFlt_CA DINH_FId.DFC_ACCmprInvldCmprSt_CA DINH_FId.DFC_ACCmprInvldElecActPwr_CA DINH_FId.DFC_ACCmprLoPFlt_CA DINH_FId.DFC_AcChrgrIntkTSRCMin_CA DINH_FId.DFC_BattUBMaxBatt_CA DINH_FId.DFC_BattUBMaxNoBatt_CA DINH_FId.DFC_BattUBMinBatt_CA DINH_FId.DFC_BattUBMinNoBatt_CA DINH_FId.DFC_BattUSRCMax_CA DINH_FId.DFC_BattUSRCMin_CA DINH_FId.DFC_BrkBstPHiCautionDfct_CA DINH_FId.DFC_BrkBstPHiWarnDfct_CA DINH_FId.DFC_BrkBstPSnsr12PlausDfct_CA DINH_FId.DFC_BrkBstPSnsr1Scb_CA DINH_FId.DFC_BrkBstPSnsr1Scg_CA DINH_FId.DFC_BrkBstPSnsr2Scb_CA DINH_FId.DFC_BrkBstPSnsr2Scg_CA DINH_FId.DFC_BrkBstPSnsrMax_CA DINH_FId.DFC_BrkBstPSnsrMin_CA DINH_FId.DFC_BrkBstPhyRngChkMax_CA DINH_FId.DFC_BrkBstPhyRngChkMin_CA DINH_FId.DFC_BrkBstPmpHsScb_CA DINH_FId.DFC_BrkBstPmpHsScg_CA DINH_FId.DFC_BrkBstPmpLsOl_CA DINH_FId.DFC_BrkBstPmpLsScb_CA DINH_FId.DFC_BrkBstPmpLsScg_CA DINH_FId.DFC_CbnHeatgHeatrRlyOpend_CA DINH_FId.DFC_CbnHeatgHeatrRlyWldd_CA DINH_FId.DFC_CcsDcIBattExcdd_CA DINH_FId.DFC_CcsDcIEvseOutDe_CA DINH_FId.DFC_CcsDcIOutDe_CA DINH_FId.DFC_CcsDcIOutExcdd_CA DINH_FId.DFC_CcsDcUOutDe_CA DINH_FId.DFC_CcsDcUOutExcdd_CA DINH_FId.DFC_CcsPwrLineChpRstOL_CA DINH_FId.DFC_CcsPwrLineChpRstOvrTemp_CA DINH_FId.DFC_CcsPwrLineChpRstSCB_CA DINH_FId.DFC_CcsPwrLineChpRstSCG_CA DINH_FId.DFC_CcsPwrLineChpVccEnaOL_CA DINH_FId.DFC_CcsPwrLineChpVccEnaOvrTemp_CA DINH_FId.DFC_CcsPwrLineChpVccEnaSCB_CA DINH_FId.DFC_CcsPwrLineChpVccEnaSCG_CA DINH_FId.DFC_CcsPwrLineChpVccSRCMin_CA DINH_FId.DFC_CcsPwrLineComChpTSRCMin_CA DINH_FId.DFC_CtPSwtActrOL_CA DINH_FId.DFC_CtPSwtActrOvrTemp_CA DINH_FId.DFC_CtPSwtActrSCB_CA DINH_FId.DFC_CtPSwtActrSCG_CA DINH_FId.DFC_CtPSwtDiagSRCMin_CA DINH_FId.DFC_CtpCarrFrqSRCMin_CA DINH_FId.DFC_DcChrgrIntkT2SRCMin_CA DINH_FId.DFC_DcChrgrIntkTSRCMin_CA DINH_FId.DFC_DevLibBattUHi_CA DINH_FId.DFC_DevLibBattULo_CA DINH_FId.DFC_EmWakeupSigOL_CA DINH_FId.DFC_EmWakeupSigOvrTemp_CA DINH_FId.DFC_EmWakeupSigSCB_CA DINH_FId.DFC_EmWakeupSigSCG_CA DINH_FId.DFC_Fan1OL_CA DINH_FId.DFC_Fan1OvrTemp_CA DINH_FId.DFC_Fan1SCB_CA DINH_FId.DFC_FanRlySCB_CA DINH_FId.DFC_FanRlySCG_CA DINH_FId.DFC_FanSpdSRCMin_CA DINH_FId.DFC_FreonPSRCMin_CA DINH_FId.DFC_HLCCcsPLnCChipTHi_CA DINH_FId.DFC_HeatrCoreTSRCMin_CA DINH_FId.DFC_PwmCtPSRCMin_CA DINH_FId.DFC_PwrDistbnUnitTSRCMin_CA DINH_FId.DFC_SCtPmp1OL_CA DINH_FId.DFC_SCtPmp1OvrTemp_CA DINH_FId.DFC_SCtPmp1SCB_CA DINH_FId.DFC_SCtPmpRlyOL_CA DINH_FId.DFC_SCtPmpRlyOvrTemp_CA DINH_FId.DFC_SCtPmpRlySCB_CA DINH_FId.DFC_SpplCooltPmpRlyOL_CA DINH_FId.DFC_SpplCooltPmpRlyOvrTemp_CA DINH_FId.DFC_SpplCooltPmpRlySCB_CA DINH_FId.DFC_UCtPSRCMin_CA DINH_FId.DFC_UPxP1SRCMin_CA DINH_FId.DFC_ComHSN1CANMute_CA DINH_FId.DFC_ComHSN3CANMute_CA DINH_FId.DFC_AcChrgrIntkTPhysRngHi_CA DINH_FId.DFC_AcChrgrIntkTPhysRngLo_CA DINH_FId.DFC_AcChrgrIntkTSRCOpn_CA DINH_FId.DFC_CcsPwrLineChpVccPhysRngHi_CA DINH_FId.DFC_CcsPwrLineChpVccPhysRngLo_CA DINH_FId.DFC_CcsPwrLineChpVccSRCOpn_CA DINH_FId.DFC_CcsPwrLineComChpTPhysRngHi_CA DINH_FId.DFC_CcsPwrLineComChpTPhysRngLo_CA DINH_FId.DFC_CcsPwrLineComChpTSRCOpn_CA DINH_FId.DFC_CtPSwtDiagPhysRngHi_CA DINH_FId.DFC_CtPSwtDiagPhysRngLo_CA DINH_FId.DFC_CtPSwtDiagSRCOpn_CA DINH_FId.DFC_CtpCarrFrqPhysRngHi_CA DINH_FId.DFC_CtpCarrFrqPhysRngLo_CA DINH_FId.DFC_CtpCarrFrqSRCMax_CA DINH_FId.DFC_DcChrgrIntkT2PhysRngHi_CA DINH_FId.DFC_DcChrgrIntkT2PhysRngLo_CA DINH_FId.DFC_DcChrgrIntkT2SRCOpn_CA DINH_FId.DFC_DcChrgrIntkTPhysRngHi_CA DINH_FId.DFC_DcChrgrIntkTPhysRngLo_CA DINH_FId.DFC_DcChrgrIntkTSRCOpn_CA DINH_FId.DFC_Fan1SCG_CA DINH_FId.DFC_FanSpdPhysRngHi_CA DINH_FId.DFC_FanSpdPhysRngLo_CA DINH_FId.DFC_FanSpdSRCOpn_CA DINH_FId.DFC_FreonPPhysRngHi_CA DINH_FId.DFC_FreonPPhysRngLo_CA DINH_FId.DFC_FreonPSRCOpn_CA DINH_FId.DFC_HeatrCoreTPhysRngHi_CA DINH_FId.DFC_HeatrCoreTPhysRngLo_CA DINH_FId.DFC_HeatrCoreTSRCOpn_CA DINH_FId.DFC_HvGridUMaxSftyLim_CA DINH_FId.DFC_HvGridUMinSftyLim_CA DINH_FId.DFC_HvGridUPlausy_CA DINH_FId.DFC_IntlckChrgPlgHBrgOpnLd_CA DINH_FId.DFC_IntlckChrgPlgHBrgOvrCurr_CA DINH_FId.DFC_IntlckChrgPlgHBrgOvrTemp_CA DINH_FId.DFC_IntlckChrgPlgHBrgShCirBatt1_CA DINH_FId.DFC_IntlckChrgPlgHBrgShCirBatt2_CA DINH_FId.DFC_IntlckChrgPlgHBrgShCirGnd1_CA DINH_FId.DFC_IntlckChrgPlgHBrgShCirGnd2_CA DINH_FId.DFC_IntlckChrgPlgHBrgShCirOvrLd_CA DINH_FId.DFC_IntlckChrgPlgHBrgTempOvrCurr_CA DINH_FId.DFC_IntlckChrgPlgHBrgUndrVltg_CA DINH_FId.DFC_IntlckChrgPlgPosnRngFlt_CA DINH_FId.DFC_IntlckChrgPlgPosnSrcMax_CA DINH_FId.DFC_IntlckChrgPlgPosnSrcMin_CA DINH_FId.DFC_PwmCtPPhysRngHi_CA DINH_FId.DFC_PwmCtPPhysRngLo_CA DINH_FId.DFC_PwmCtPSRCMax_CA DINH_FId.DFC_PwrDistbnUnitTPhysRngHi_CA DINH_FId.DFC_PwrDistbnUnitTPhysRngLo_CA DINH_FId.DFC_PwrDistbnUnitTSRCOpn_CA DINH_FId.DFC_SCtPmpRlySCG_CA DINH_FId.DFC_SpplCooltPmpRlySCG_CA DINH_FId.DFC_UCtPPhysRngHi_CA DINH_FId.DFC_UCtPPhysRngLo_CA DINH_FId.DFC_UCtPSRCOpn_CA DINH_FId.DFC_UPxP1PhysRngHi_CA DINH_FId.DFC_UPxP1PhysRngLo_CA DINH_FId.DFC_UPxP1SRCOpn_CA DINH_FId.DFC_VehVPhysRngHi_CA DINH_FId.DFC_VehVPhysRngLo_CA DINH_FId.DFC_VehVSigCan_CA DINH_FId.DFC_VehVSigCanSafe_CA DINH_FId.DFC_SCtPmp1DiagGrdKey1_CA DINH_FId.DFC_SCtPmp1DiagGrdKey2_CA DINH_FId.DFC_SCtPmp1DiagGrdKey3_CA DINH_FId.DFC_SCtPmp1DiagGrdKey4_CA DINH_FId.DFC_SCtPmp1DiagGrdKey5_CA DINH_FId.DFC_ChrgPlgLiveCntctHzrdCcs_CA DINH_FId.DFC_ChrgPlgProxPltImps_CA DINH_FId.DFC_ChrgPlgTHiCcsDc_CA DINH_FId.DFC_ElMActvDchaFailr_CA DINH_FId.DFC_ElMActvDchaFlt_CA DINH_FId.DFC_ElMFbdnIvtrModDrv01_CA DINH_FId.DFC_ElMImobAuthent_CA DINH_FId.DFC_ElMIsoMonFlt_CA DINH_FId.DFC_ElMIsoMonPlausyFlt_CA DINH_FId.DFC_ElMIvtrCooltT01_CA DINH_FId.DFC_ElMIvtrEmgyShtDwn01_CA DINH_FId.DFC_ElMIvtrFailr01_CA DINH_FId.DFC_ElMIvtrIntlck01_CA DINH_FId.DFC_ElMIvtrTErr01_CA DINH_FId.DFC_ElMOverSpdNeg01_CA DINH_FId.DFC_ElMOverSpdPos01_CA DINH_FId.DFC_ElMOverTqNeg01_CA DINH_FId.DFC_ElMOverTqPos01_CA DINH_FId.DFC_ElMPwrAuthn_CA DINH_FId.DFC_ElMSpdErr01_CA DINH_FId.DFC_ElMSvs01_CA DINH_FId.DFC_PEnvCcMax_CA DINH_FId.DFC_PEnvCcMin_CA DINH_FId.DFC_PEnvRngChkMax_CA DINH_FId.DFC_PEnvRngChkMin_CA DINH_FId.DFC_PEnvSnsrPlaus_CA DINH_FId.DFC_BrkBstPmpPlausGenn_CA DINH_FId.DFC_CbnHeatrRlyLfLoWarn_CA DINH_FId.DFC_ChgrPlugLockPinByndClsd_CA DINH_FId.DFC_ChgrPlugLockPinMoveWoCmd_CA DINH_FId.DFC_ChgrPlugLockPinStuckInClsd_CA DINH_FId.DFC_ChgrPlugLockPinStuckInOpen_CA DINH_FId.DFC_ChrgrStErr_CA DINH_FId.DFC_ComHSN1BusOff_CA DINH_FId.DFC_ComHSN3BusOff_CA DINH_FId.DFC_ComVCInval_CA DINH_FId.DFC_EemDcdcPrecSpdInhb_CA DINH_FId.DFC_ExpPwrLatch_CA DINH_FId.DFC_FanMaxOvrd_CA DINH_FId.DFC_HLCCcsGnrlComErr_CA DINH_FId.DFC_InmLINNodeHVACPanelAbsnt_CA DINH_FId.DFC_ResetRcvNotAllwd_CA DINH_FId.DFC_TelltlCooltPlaus_CA DINH_FId.DFC_MRlyOL_CA DINH_FId.DFC_MRlySCB_CA DINH_FId.DFC_MRlySCG_CA DINH_FId.DFC_SSpMon1_CA DINH_FId.DFC_SSpMon1OV_CA DINH_FId.DFC_SSpMon1SCG_CA DINH_FId.DFC_SSpMon1UV_CA DINH_FId.DFC_SSpMon2_CA DINH_FId.DFC_SSpMon2OV_CA DINH_FId.DFC_SSpMon2SCG_CA DINH_FId.DFC_SSpMon2UV_CA DINH_FId.DFC_SSpMon3_CA DINH_FId.DFC_SSpMon3OV_CA DINH_FId.DFC_SSpMon3SCG_CA DINH_FId.DFC_SSpMon3UV_CA DINH_FId.DFC_CANSM_E_BUS_OFF_NETWORK_HSN1_CAN_CA DINH_FId.DFC_CANSM_E_BUS_OFF_NETWORK_HSN3_CAN_CA DINH_FId.DFC_CANSM_E_BUS_OFF_NETWORK_HSN4_CAN_CA /end DEF_CHARACTERISTIC
 FUNCTION_VERSION "30000.25.0" /end FUNCTION
/begin COMPU_METHOD DINH_FIdVerb "" TAB_VERB "%6.3" "-" COMPU_TAB_REF DINH_FIdVerb /end COMPU_METHOD
/begin COMPU_VTAB DINH_FIdVerb "" TAB_VERB 1140 0 "FId_Unused" 1 "FID_ElTSPwrChrgnOutErr" 2 "FID_ElTSPwrInActErr" 3 "FId_ACCmprFltPDiagEnad" 4 "FId_ACCmprInpErr" 5 "FId_ACpAC" 6 "FId_APP1SigPath" 7 "FId_APP2SigPath" 8 "FId_APPBrkErr" 9 "FId_APPVehVErr" 10 "FId_AcChrgrIntkTEnhdSRCMax" 11 "FId_AcChrgrIntkTFrzVal" 12 "FId_AcChrgrIntkTPhysRng" 13 "FId_AcChrgrIntkTRplVal" 14 "FId_AcChrgrIntkTSSpMon" 15 "FId_AcChrgrIntkTTmpErrCnt" 16 "FId_AcExtChrgrChrgn" 17 "FId_Airbg2MED" 18 "FId_AirbgAVSstCrash" 19 "FId_AirbgCan" 20 "FId_AirbgHw" 21 "FId_AirbgInpSigErr" 22 "FId_AirbgPWMErr" 23 "FId_AirbgPwmSrcErr" 24 "FId_BattUDiagEna" 25 "FId_BattUInvalid" 26 "FId_BattUReplcmt" 27 "FId_BattUVehVVld" 28 "FId_BlwrComErr" 29 "FId_BrkBstBrkSt" 30 "FId_BrkBstP" 31 "FId_BrkBstPEnaPrc" 32 "FId_BrkBstPFrzVal" 33 "FId_BrkBstPPlaus12FrznDfct" 34 "FId_BrkBstPPlaus12ReplcmtDfct" 35 "FId_BrkBstPReplVal" 36 "FId_BrkBstPSnsr1FrzDfct" 37 "FId_BrkBstPSnsr1ReplcmtDfct" 38 "FId_BrkBstPSnsr1SplyDfct" 39 "FId_BrkBstPSnsr2FrzDfct" 40 "FId_BrkBstPSnsr2ReplcmtDfct" 41 "FId_BrkBstPSnsr2SplyDfct" 42 "FId_BrkBstPmpActtnDiagEnad" 43 "FId_BrkBstPmpDeactvnDiagEnad" 44 "FId_BrkBstPmpLeakDiagEnad" 45 "FId_BrkBstPmpM1Err" 46 "FId_BrkBstPmpM2Err" 47 "FId_BrkBstPmpScgLsErr" 48 "FId_BrkBstPmpVacChkEna" 49 "FId_BrkBstTst" 50 "FId_BrkPlaus1Ena" 51 "FId_BrkPresAlrt" 52 "FId_BrkSigMaiCanFrzVal" 53 "FId_BrkSigMaiCanReplVal" 54 "FId_BrkStMnFinalDfct" 55 "FId_BrkStMnPrelDfct" 56 "FId_BrkStRdntFinalDfct" 57 "FId_BrkStRdntPrelDfct" 58 "FId_CanEifVehSpdVld" 59 "FId_CbnHeatgHeatrPsFlt" 60 "FId_CbnHeatgHeatrRlyDiagEnad" 61 "FId_CbnHeatgSwtFrzVal" 62 "FId_CbnHeatgSwtRplVal" 63 "FId_CbnHeatgSwtTmpErrCnt" 64 "FId_CcsDcStopChrgn" 65 "FId_CcsDcStopChrgnIDftl" 66 "FId_CcsPwrLineChpRstMonOff" 67 "FId_CcsPwrLineChpRstOff" 68 "FId_CcsPwrLineChpRstPsOff" 69 "FId_CcsPwrLineChpRstSnsr" 70 "FId_CcsPwrLineChpVccEnaMonOff" 71 "FId_CcsPwrLineChpVccEnaOff" 72 "FId_CcsPwrLineChpVccEnaPsOff" 73 "FId_CcsPwrLineChpVccEnaSnsr" 74 "FId_CcsPwrLineChpVccEnhdSRCMax" 75 "FId_CcsPwrLineChpVccFrzVal" 76 "FId_CcsPwrLineChpVccPhysRng" 77 "FId_CcsPwrLineChpVccRplVal" 78 "FId_CcsPwrLineChpVccSSpMon" 79 "FId_CcsPwrLineChpVccTmpErrCnt" 80 "FId_CcsPwrLineComChpTEnhdSRCMax" 81 "FId_CcsPwrLineComChpTFrzVal" 82 "FId_CcsPwrLineComChpTPhysRng" 83 "FId_CcsPwrLineComChpTRplVal" 84 "FId_CcsPwrLineComChpTSSpMon" 85 "FId_CcsPwrLineComChpTTmpErrCnt" 86 "FId_ChgrPlugCtpSwtSnsrActrErr" 87 "FId_ChgrPlugLockActrErr" 88 "FId_ChgrPlugLockSnsrErr" 89 "FId_ChgrPlugPxp1InhbDiagSrc" 90 "FId_ChgrPlugTPinDcErr" 91 "FId_ChrgPlgChrgrRlyWlddCcs" 92 "FId_ChrgPlugCtpDetnErr" 93 "FId_ChrgnCntctPsFlt" 94 "FId_ChrgnLmpChrgnFlt" 95 "FId_ChrgnLmpNoChrgn" 96 "FId_ChrgnUnplRqrd" 97 "FId_ChrgrRlyDcActNegErr" 98 "FId_ChrgrRlyDcActPosErr" 99 "FId_CmbdChrgnSysCntctErr" 100 "FId_CoElMDSQCanEMS01" 101 "FId_CoElMErr01" 102 "FId_CoPOMLimdPrpnHmi" 103 "FId_CoPOMMaxLimFltDetnPrim" 104 "FId_CoPOMMinLimFltDetnPrim" 105 "FId_CoPOMNoPrpnHmi" 106 "FId_CoPOMRecupPwrRednHmi" 107 "FId_CoPOMRgnInhbnPrim" 108 "FId_CoVMEvSysCptMaxErrPrim01" 109 "FId_CoVMEvSysCptMaxErrPrim02" 110 "FId_CoVMEvSysCptMaxErrPrim03" 111 "FId_CoVMEvSysCptMaxErrPrim04" 112 "FId_CoVMEvSysCptMaxErrPrim05" 113 "FId_CoVMEvSysCptMinErrPrim01" 114 "FId_CoVMEvSysCptMinErrPrim02" 115 "FId_CoVMEvSysCptMinErrPrim03" 116 "FId_CoVMEvVehVVld" 117 "FId_ComHillHldFrmErr" 118 "FId_Com_stMainWkuInvld" 119 "FId_CtPSwtActrMonOff" 120 "FId_CtPSwtActrOff" 121 "FId_CtPSwtActrPsOff" 122 "FId_CtPSwtActrSnsr" 123 "FId_CtPSwtDiagEnhdSRCMax" 124 "FId_CtPSwtDiagFrzVal" 125 "FId_CtPSwtDiagPhysRng" 126 "FId_CtPSwtDiagRplVal" 127 "FId_CtPSwtDiagSSpMon" 128 "FId_CtPSwtDiagTmpErrCnt" 129 "FId_CtpCarrFrqFrzVal" 130 "FId_CtpCarrFrqPhysRng" 131 "FId_CtpCarrFrqRplVal" 132 "FId_CtpCarrFrqSSpMon" 133 "FId_CtpCarrFrqTmpErrCnt" 134 "FId_DELibAcChrgrIntkT" 135 "FId_DELibDcChrgrIntkT" 136 "FId_DELibEnvP" 137 "FId_DELibEnvT" 138 "FId_DELibHeatrCoreT" 139 "FId_DSMAUXWucVrnt5" 140 "FId_DcChrgnCtrlChrgPrmExch" 141 "FId_DcChrgrIntkT2EnhdSRCMax" 142 "FId_DcChrgrIntkT2FrzVal" 143 "FId_DcChrgrIntkT2PhysRng" 144 "FId_DcChrgrIntkT2RplVal" 145 "FId_DcChrgrIntkT2SSpMon" 146 "FId_DcChrgrIntkT2TmpErrCnt" 147 "FId_DcChrgrIntkTEnhdSRCMax" 148 "FId_DcChrgrIntkTFrzVal" 149 "FId_DcChrgrIntkTPhysRng" 150 "FId_DcChrgrIntkTRplVal" 151 "FId_DcChrgrIntkTSSpMon" 152 "FId_DcChrgrIntkTTmpErrCnt" 153 "FId_DcdcDesOperModFwd" 154 "FId_DcdcPwrLoadMngtMaxPred" 155 "FId_DcdcUDesLvGrid" 156 "FId_DcmDspUDSStPwrLatch" 157 "FId_DrvDoorCANSigFault" 158 "FId_DrvInfoEgyAvlErr" 159 "FId_DrvModPosnApp" 160 "FId_DrvPrgSwtEna" 161 "FId_DrvStbltCANSigFault" 162 "FId_EBDLmpSig" 163 "FId_EVLmpBlnkIllmn" 164 "FId_EVLmpContIllmn" 165 "FId_EbsLinErr" 166 "FId_EemDcdcPrecErr" 167 "FId_EemDcdcUHVAct" 168 "FId_EemFltHvDcha" 169 "FId_EemFstHvShdwn" 170 "FId_EemHvBattMod" 171 "FId_EemHvOffTout" 172 "FId_EemHvShdwn" 173 "FId_EemNoHvStrtup" 174 "FId_ElMNoPrp01" 175 "FId_ElMnLim01" 176 "FId_ElMtrqLim01" 177 "FId_ElSSACCmprUFlt" 178 "FId_ElSSCabAirHtUFlt" 179 "FId_ElSSHvReqEna" 180 "FId_ElSSUHvDcBus" 181 "FId_ElTSHvIntlck" 182 "FId_EmWakeupSigMonOff" 183 "FId_EmWakeupSigOff" 184 "FId_EmWakeupSigPsOff" 185 "FId_EmWakeupSigSnsr" 186 "FId_EmacUDcLnk01" 187 "FId_EvThermLTClgDmdErr" 188 "FId_EvThermMTClgDmdErr" 189 "FId_Fan1ActrOff" 190 "FId_Fan1Mon" 191 "FId_Fan1Off" 192 "FId_Fan1PsSwtOff" 193 "FId_Fan1PwrStg" 194 "FId_FanCtlFan1Err" 195 "FId_FanRlyDiagEnad" 196 "FId_FanSpdEnhdSRCMax" 197 "FId_FanSpdFrzVal" 198 "FId_FanSpdPhysRng" 199 "FId_FanSpdRplVal" 200 "FId_FanSpdSSpMon" 201 "FId_FanSpdTmpErrCnt" 202 "FId_FansFacCor" 203 "FId_FiMFID_rba_MRly_Diag_Stk" 204 "FId_FiMFID_test" 205 "FId_FreonPEnhdSRCMax" 206 "FId_FreonPFrzVal" 207 "FId_FreonPPhysRng" 208 "FId_FreonPRplVal" 209 "FId_FreonPSSpMon" 210 "FId_FreonPTmpErrCnt" 211 "FId_GlbDaLSumvXPtd" 212 "FId_HLCCcs_CoornPLnCChipTHi" 213 "FId_HLCCcs_CoornPLnCChpT" 214 "FId_HeatrCoreTEnhdSRCMax" 215 "FId_HeatrCoreTFrzVal" 216 "FId_HeatrCoreTPhysRng" 217 "FId_HeatrCoreTRplVal" 218 "FId_HeatrCoreTSSpMon" 219 "FId_HeatrCoreTTmpErrCnt" 220 "FId_HvBattChrgLvl3DernFlt" 221 "FId_HvBattDchaLvl3DernFlt" 222 "FId_HvBattDesChrgIDern" 223 "FId_HvBattMaiSwtDiagEna" 224 "FId_HvBattMaxPwrBusTDern" 225 "FId_HvBattNegCntctrCnt" 226 "FId_HvBattPosCntctrCnt" 227 "FId_HvBattPrecCntctrCnt" 228 "FId_HvBattPwrDistbnTDern" 229 "FId_HvBattPwrDistbnTInhbn" 230 "FId_HvBattRatRSoh" 231 "FId_HvBattRatSoh" 232 "FId_HvGridAuxPwr01" 233 "FId_HvGridAuxPwr02" 234 "FId_HvGridAuxPwr03" 235 "FId_HvGridAuxPwr04" 236 "FId_HvGridDcdcPwr" 237 "FId_HvGridDcdcUSftyErr" 238 "FId_HvGridElM01USftyErr" 239 "FId_HvGridHvBattSftyLimErr" 240 "FId_HvGridMaiSwtErr" 241 "FId_HvGridPwrMaxChrgContnsErr" 242 "FId_HvGridPwrMaxChrgShoErr" 243 "FId_HvGridPwrMaxDchaContnsErr" 244 "FId_HvGridPwrMaxDchaShoErr" 245 "FId_HvacHmiFlt" 246 "FId_HvacModCoolgFlt" 247 "FId_HvacModHeatgFlt" 248 "FId_HvacPtcHeatrErr" 249 "FId_InhibitAlways" 250 "FId_InhibitNever" 251 "FId_IntlckChrgPlgActrOff" 252 "FId_IntlckChrgPlgHbrdgNotTstd" 253 "FId_IntlckChrgPlgHbrgOLErr" 254 "FId_IntlckChrgPlgMon" 255 "FId_IntlckChrgPlgPosnAdcInvld" 256 "FId_IntlckChrgPlgPsSwtOff" 257 "FId_IntlckChrgPlgPwrStg" 258 "FId_IntlckChrgPlg_VehvErr" 259 "FId_LvGridSocErr" 260 "FId_LvGridTErr" 261 "FId_LvGridTestPlsReq" 262 "FId_LvGridUErr" 263 "FId_MedTPmpFlt" 264 "FId_MedTPmpPwrCtrlRly" 265 "FId_MstWrnLmpBlink" 266 "FId_MstWrnLmpChime" 267 "FId_MstWrnLmpContIllmn" 268 "FId_PEnvCc" 269 "FId_PEnvEnaBndMdl" 270 "FId_PEnvMeasVld" 271 "FId_PEnvPlaus" 272 "FId_PEnvPrc" 273 "FId_PEnvRefSnsr" 274 "FId_PEnvSigRngVld" 275 "FId_PEnvSnsrPlaus" 276 "FId_PerfLimnActvLmpBlink" 277 "FId_PerfLimnActvLmpCont" 278 "FId_PerfLimnActvLmpContNoChime" 279 "FId_PwmCtPFrzVal" 280 "FId_PwmCtPPhysRng" 281 "FId_PwmCtPRplVal" 282 "FId_PwmCtPSSpMon" 283 "FId_PwmCtPTmpErrCnt" 284 "FId_PwrDistbnUnitTEnhdSRCMax" 285 "FId_PwrDistbnUnitTFrzVal" 286 "FId_PwrDistbnUnitTPhysRng" 287 "FId_PwrDistbnUnitTRplVal" 288 "FId_PwrDistbnUnitTSSpMon" 289 "FId_PwrDistbnUnitTTmpErrCnt" 290 "FId_SCtPmp1ActrOff" 291 "FId_SCtPmp1CircErr" 292 "FId_SCtPmp1Mon" 293 "FId_SCtPmp1Off" 294 "FId_SCtPmp1PsErr" 295 "FId_SCtPmp1PsSwtOff" 296 "FId_SCtPmp1PwrStg" 297 "FId_SCtPmp1QlySensFrzn" 298 "FId_SCtPmp1QlySensRplVal" 299 "FId_SCtPmp1_VehvErr" 300 "FId_SCtPmpRlyActrOff" 301 "FId_SCtPmpRlyMon" 302 "FId_SCtPmpRlyOff" 303 "FId_SCtPmpRlyPsSwtOff" 304 "FId_SCtPmpRlyPwrStg" 305 "FId_SVSWrnLmpBlnkIllmn" 306 "FId_SVSWrnLmpContIllmn" 307 "FId_SpplCooltPmpRlyActrOff" 308 "FId_SpplCooltPmpRlyMon" 309 "FId_SpplCooltPmpRlyOff" 310 "FId_SpplCooltPmpRlyPsSwtOff" 311 "FId_SpplCooltPmpRlyPwrStg" 312 "FId_StrtUpEvDrvAwy" 313 "FId_TelltlCooltTErr" 314 "FId_TelltlCooltTMon" 315 "FId_ThermHvacPreCdngFlt" 316 "FId_ThermModCritErr" 317 "FId_UCtPEnhdSRCMax" 318 "FId_UCtPFrzVal" 319 "FId_UCtPPhysRng" 320 "FId_UCtPRplVal" 321 "FId_UCtPSSpMon" 322 "FId_UCtPTmpErrCnt" 323 "FId_UPxP1EnhdSRCMax" 324 "FId_UPxP1FrzVal" 325 "FId_UPxP1PhysRng" 326 "FId_UPxP1RplVal" 327 "FId_UPxP1SSpMon" 328 "FId_UPxP1TmpErrCnt" 329 "FId_VMSIEvBrkFlt" 330 "FId_VMSIEvDCSRampShOff01" 331 "FId_VMSIEvDCSShOff01" 332 "FId_VMSIEvTCSRampShOff01" 333 "FId_VMSIEvTCSShOff01" 334 "FId_VMSIEvTVRampShOff01" 335 "FId_VMSIEvTVShOff01" 336 "FId_VacPmpErr" 337 "FId_VehCoornAuxAvrgEnvT" 338 "FId_VehCoornAuxAvrgPwr" 339 "FId_VehCoornAuxAvrgT" 340 "FId_VehCoornAuxAvrgVehV" 341 "FId_VehCoornDstRngPrdcDispDft" 342 "FId_VehCoornEgyRmn" 343 "FId_VehCoornErrExclChrg" 344 "FId_VehCoornErrExclDrv" 345 "FId_VehCoornHVErr" 346 "FId_VehCoornHvReq" 347 "FId_VehCoornImobTrqInhbn" 348 "FId_VehCoornPrpAvrg" 349 "FId_VehCoornRngPrdcAuxPwr" 350 "FId_VehCoornSigQualVehV" 351 "FId_VehVCANFrzVal" 352 "FId_VehVCANReplVal" 353 "FId_VehVCanSafeFrzVal" 354 "FId_VehVCanSafeReplVal" 355 "FId_VehVFrzVal" 356 "FId_VehVNActPhy01Dfct" 357 "FId_VehVReplVal" 358 "FId_VehVSigCan" 359 "FId_VehVSigCanSafe" 360 "FId_WtrPmp1Err" 361 "FId_bInhCanEif_HVBAT_NGTV_CONTACTOR_STS" 362 "FId_bInhCanEif_HVBAT_PRECHRG_CONTACTOR_STS" 363 "FId_bInhCanEif_HVBAT_PSTV_CONTACTOR_STS" 364 "FId_bInhCanEif_VCU_eBCCM_432h" 365 "FId_bInhCdtSpdVehImmo" 366 "FId_bInhComGw_Com_BMS_REMAININGBATTCAPACITY" 367 "FId_bInhComGw_Com_CONTACT_FREIN_PRK" 368 "FId_bInhComGw_Com_DCDC_IP_POWER" 369 "FId_bInhComGw_Com_HVBAT_ALERT_LOW_BATT_ENERGY" 370 "FId_bInhComGw_Com_HVBAT_CHARGING_STATUS" 371 "FId_bInhComGw_Com_HVBAT_SOC" 372 "FId_bInhComGw_Com_HVBAT_TEMPERATURE" 373 "FId_bInhComGw_Com_HVBAT_THERMAL_RUNAWAY" 374 "FId_bInhComGw_Com_HV_BATT_CELL_VOLT_MAX" 375 "FId_bInhComGw_Com_HV_BATT_CELL_VOLT_MIN" 376 "FId_bInhComGw_Com_HV_BATT_INSULATION_RESISTANCE" 377 "FId_bInhComGw_Com_HV_BATT_INSUL_FAILURE" 378 "FId_bInhComGw_Com_HV_BATT_INTERLOCK_LINE" 379 "FId_bInhComGw_Com_HV_BATT_MIN_VOLT_WARN" 380 "FId_bInhComGw_Com_HV_BATT_NB_CELL_VOLT_MAX" 381 "FId_bInhComGw_Com_HV_BATT_NB_CELL_VOLT_MIN" 382 "FId_bInhComGw_Com_HV_BATT_SOC" 383 "FId_bInhComGw_Com_HV_BATT_SOC_5C3" 384 "FId_bInhComGw_Com_HV_BATT_SOH_CAPA" 385 "FId_bInhComGw_Com_HV_BATT_SOH_RES" 386 "FId_bInhComGw_Com_HV_BATT_TEMP_AVG" 387 "FId_bInhComGw_Com_INV_MTR_INST_INPUT_POWER" 388 "FId_bInhComGw_Com_PEM_ENGINE_RPM" 389 "FId_bInhComGw_Com_PEM_ESTIM_TRQ" 390 "FId_bInhComGw_Com_PEM_INVERTER_TEMP" 391 "FId_bInhComGw_Com_PEM_INVERTOR_ALERT_TEMP" 392 "FId_bInhComGw_Com_PEM_OVERTEMP_FAILURE" 393 "FId_bInhComGw_Com_PEM_STATOR_TEMP" 394 "FId_bInhComGw_Com_VITESSE_VEHICULE_ROUES" 395 "FId_bInhComGw_Com_VVH_INDISP" 396 "FId_bInhComGw_Com_eCOMP_Power_consumption" 397 "FId_bInhComGw_MAIN_RELAY_ACTUATION_COUNTER" 398 "FId_bInhComGw_TIME_HV_BATT_OVER_TEMPERATURE" 399 "FId_bInhComGw_TOTAL_HV_BATT_POS_QTY_CURR" 400 "FId_bInhDiag_CLUSTER_5E7" 401 "FId_bInhDiag_CONTEXTE_1_5B2" 402 "FId_bInhDiag_DAT3_BSI_4F2h" 403 "FId_bInhDiag_DCDC_283h" 404 "FId_bInhDiag_DCDC_293h" 405 "FId_bInhDiag_DCDC_473h" 406 "FId_bInhDiag_DCDC_663h" 407 "FId_bInhDiag_HS3_AUTO_GEARBOX_SWITCH_STATUS" 408 "FId_bInhDiag_HVAC_PANEL_26h" 409 "FId_bInhDiag_HVBAT_205h" 410 "FId_bInhDiag_HVBAT_275h" 411 "FId_bInhDiag_HVBAT_285h" 412 "FId_bInhDiag_HVBAT_325h" 413 "FId_bInhDiag_HVBAT_335h" 414 "FId_bInhDiag_HVBAT_455h" 415 "FId_bInhDiag_HVBAT_535" 416 "FId_bInhDiag_HVBAT_595h" 417 "FId_bInhDiag_HVBAT_635h" 418 "FId_bInhDiag_HVBAT_645h" 419 "FId_bInhDiag_HVBAT_665h" 420 "FId_bInhDiag_HVBAT_675h" 421 "FId_bInhDiag_HVBAT_THERMAL_5B5" 422 "FId_bInhDiag_HVBAT_VCU_435h" 423 "FId_bInhDiag_HVBAT_VCU_543" 424 "FId_bInhDiag_HVBAT_VCU_583" 425 "FId_bInhDiag_INV_217h" 426 "FId_bInhDiag_INV_227h" 427 "FId_bInhDiag_INV_237" 428 "FId_bInhDiag_INV_427h" 429 "FId_bInhDiag_INV_497h" 430 "FId_bInhDiag_INV_IMMO_5C7" 431 "FId_bInhDiag_IS_DAT6_BSI_592h" 432 "FId_bInhDiag_IS_DAT_ABR_50Dh" 433 "FId_bInhDiag_IS_DAT_BSI_412h" 434 "FId_bInhDiag_IS_DYN_ABR_38Dh" 435 "FId_bInhDiag_IS_INTE_ELECTRON_BSI_092h" 436 "FId_bInhDiag_OBC_273h" 437 "FId_bInhDiag_OBC_453h" 438 "FId_bInhDiag_OBC_463h" 439 "FId_bInhDiag_PDU_BusVoltages_308" 440 "FId_bInhDiag_PDU_Current_318" 441 "FId_bInhDiag_SC_INFO_BCCM_442h" 442 "FId_bInhDiag_VCU_AIRBAG_351h" 443 "FId_bInhDiag_VCU_eBCCM_432h" 444 "FId_bInhDiag_VCU_eBCCM_552h" 445 "FId_bInhDiag_eBCCM_082h" 446 "FId_bInhDiag_eCOMP_Information_47B" 447 "FId_bInhDiag_eCOMP_Information_48B" 448 "FId_bInhFrbd_ComChrgr_iAcMax" 449 "FId_bInhFrbd_ComChrgr_iDcHvAct" 450 "FId_bInhFrbd_ComChrgr_pwrInAct" 451 "FId_bInhFrbd_ComChrgr_pwrOutpCpby" 452 "FId_bInhFrbd_ComChrgr_tChrgrMaxAct" 453 "FId_bInhFrbd_ComChrgr_uAcActL1" 454 "FId_bInhFrbd_ComChrgr_uDcHvAct" 455 "FId_bInhFrbd_ComEmac_iDcLnk01" 456 "FId_bInhFrbd_ComEmac_nAct01" 457 "FId_bInhFrbd_ComEmac_pwrInstnsInpRx" 458 "FId_bInhFrbd_ComEmac_stActvDcha" 459 "FId_bInhFrbd_ComEmac_stEVLmp" 460 "FId_bInhFrbd_ComEmac_stIvtrOpMod01" 461 "FId_bInhFrbd_ComEmac_stMod01Rx" 462 "FId_bInhFrbd_ComEmac_stMstWrnLmp" 463 "FId_bInhFrbd_ComEmac_stSVSLmp" 464 "FId_bInhFrbd_ComEmac_tqAbsltMax01" 465 "FId_bInhFrbd_ComEmac_tqAbsltMaxRx01" 466 "FId_bInhFrbd_ComEmac_tqAbsltMin01" 467 "FId_bInhFrbd_ComEmac_tqAbsltMinRx01" 468 "FId_bInhFrbd_ComEmac_tqAckd01" 469 "FId_bInhFrbd_ComEmac_tqAct01" 470 "FId_bInhFrbd_ComEmac_tqPtd01" 471 "FId_bInhFrbd_ComEmac_tqStabnMin" 472 "FId_bInhFrbd_ComEmac_uDcLnk01" 473 "FId_bInhFrbd_Com_HvbMaxSnsrTempRx" 474 "FId_bInhFrbd_Com_ctHvbNegCntctrSeg1" 475 "FId_bInhFrbd_Com_ctHvbNegCntctrSeg3" 476 "FId_bInhFrbd_Com_ctHvbNegCntctrSeg4" 477 "FId_bInhFrbd_Com_ctHvbPosCntctrSeg1" 478 "FId_bInhFrbd_Com_ctHvbPosCntctrSeg3" 479 "FId_bInhFrbd_Com_ctHvbPosCntctrSeg4" 480 "FId_bInhFrbd_Com_ctHvbPrecCntctrSeg1" 481 "FId_bInhFrbd_Com_ctHvbPrecCntctrSeg2" 482 "FId_bInhFrbd_Com_egyHvbAvl_fRx" 483 "FId_bInhFrbd_Com_flgEcoNormReqRx" 484 "FId_bInhFrbd_Com_iBattEBS1Rx" 485 "FId_bInhFrbd_Com_iBattEBS2Rx" 486 "FId_bInhFrbd_Com_iBattEBS3Rx" 487 "FId_bInhFrbd_Com_iDcdcHvActRvsn1" 488 "FId_bInhFrbd_Com_iDcdcLvActRvsn1" 489 "FId_bInhFrbd_Com_iElCmprHvAct" 490 "FId_bInhFrbd_Com_iElCmprPeakPha" 491 "FId_bInhFrbd_Com_iHvbActRx" 492 "FId_bInhFrbd_Com_iHvbChrgMaxSho" 493 "FId_bInhFrbd_Com_iHvbDchaMaxSho" 494 "FId_bInhFrbd_Com_iHvbDes" 495 "FId_bInhFrbd_Com_iHvbNomChrgn" 496 "FId_bInhFrbd_Com_nElCmprActl" 497 "FId_bInhFrbd_Com_nrSerMaxCell" 498 "FId_bInhFrbd_Com_nrSerMinCell" 499 "FId_bInhFrbd_Com_pwrDcdcOutpCpby" 500 "FId_bInhFrbd_Com_pwrElCmprActl" 501 "FId_bInhFrbd_Com_pwrMaxChrgSho" 502 "FId_bInhFrbd_Com_pwrMaxDchaSho" 503 "FId_bInhFrbd_Com_qHvbTotCpRx" 504 "FId_bInhFrbd_Com_rHvbIsoMeasmt" 505 "FId_bInhFrbd_Com_ratHvbSoc" 506 "FId_bInhFrbd_Com_ratHvbSoh" 507 "FId_bInhFrbd_Com_ratRHvbSoh" 508 "FId_bInhFrbd_Com_ratSocLvBatt" 509 "FId_bInhFrbd_Com_stElCmprFltLvl" 510 "FId_bInhFrbd_Com_stGearLvrPos" 511 "FId_bInhFrbd_Com_stIIvtrFltLvl01" 512 "FId_bInhFrbd_Com_steTogFailrLvl" 513 "FId_bInhFrbd_Com_tDcdcAct" 514 "FId_bInhFrbd_Com_tDcdcInltCoolt" 515 "FId_bInhFrbd_Com_tElCmprActl" 516 "FId_bInhFrbd_Com_tEnvT" 517 "FId_bInhFrbd_Com_tHvbAct" 518 "FId_bInhFrbd_Com_tHvbMax" 519 "FId_bInhFrbd_Com_tLvBatt" 520 "FId_bInhFrbd_Com_tiHvbChrgnHalfRx" 521 "FId_bInhFrbd_Com_uBattEBSRx" 522 "FId_bInhFrbd_Com_uDcdcHvAct" 523 "FId_bInhFrbd_Com_uDcdcLvAct" 524 "FId_bInhFrbd_Com_uElCmprHvAct" 525 "FId_bInhFrbd_Com_uHvbAct" 526 "FId_bInhFrbd_Com_uHvbDcBus" 527 "FId_bInhFrbd_Com_uHvbLimHi" 528 "FId_bInhFrbd_Com_uHvbMaxCell" 529 "FId_bInhFrbd_Com_uHvbMinCell" 530 "FId_bInhFrbd_Com_uHvbNomChrgn" 531 "FId_bInhInvld_ComChrgr_flgChrgrErrLvl" 532 "FId_bInhInvld_ComChrgr_iAcMax" 533 "FId_bInhInvld_ComChrgr_iDcHvAct" 534 "FId_bInhInvld_ComChrgr_pwrInAct" 535 "FId_bInhInvld_ComChrgr_pwrOutpCpby" 536 "FId_bInhInvld_ComChrgr_tChrgrMaxAct" 537 "FId_bInhInvld_ComChrgr_uAcActL1" 538 "FId_bInhInvld_ComChrgr_uDcHvAct" 539 "FId_bInhInvld_ComEmac_iDcLnk01" 540 "FId_bInhInvld_ComEmac_nAct01" 541 "FId_bInhInvld_ComEmac_pwrInstnsInpRx" 542 "FId_bInhInvld_ComEmac_stActvDcha" 543 "FId_bInhInvld_ComEmac_stIvtrOpMod01" 544 "FId_bInhInvld_ComEmac_tInvr01" 545 "FId_bInhInvld_ComEmac_tIvtrCooltIn01" 546 "FId_bInhInvld_ComEmac_tMac01" 547 "FId_bInhInvld_ComEmac_tqAbsltMax01" 548 "FId_bInhInvld_ComEmac_tqAbsltMaxRx01" 549 "FId_bInhInvld_ComEmac_tqAbsltMin01" 550 "FId_bInhInvld_ComEmac_tqAbsltMinRx01" 551 "FId_bInhInvld_ComEmac_tqAckd01" 552 "FId_bInhInvld_ComEmac_tqAct01" 553 "FId_bInhInvld_ComEmac_tqPtd01" 554 "FId_bInhInvld_ComEmac_tqStabnMin" 555 "FId_bInhInvld_ComEmac_uDcLnk01" 556 "FId_bInhInvld_Com_HvbMaxSnsrTempRx" 557 "FId_bInhInvld_Com_ctHvbNegCntctrSeg1" 558 "FId_bInhInvld_Com_ctHvbNegCntctrSeg3" 559 "FId_bInhInvld_Com_ctHvbNegCntctrSeg4" 560 "FId_bInhInvld_Com_ctHvbPosCntctrSeg1" 561 "FId_bInhInvld_Com_ctHvbPosCntctrSeg3" 562 "FId_bInhInvld_Com_ctHvbPosCntctrSeg4" 563 "FId_bInhInvld_Com_ctHvbPrecCntctrSeg1" 564 "FId_bInhInvld_Com_ctHvbPrecCntctrSeg2" 565 "FId_bInhInvld_Com_egyHvbAvl_fRx" 566 "FId_bInhInvld_Com_flgEcoNormReqRx" 567 "FId_bInhInvld_Com_flgVehSpdAvl" 568 "FId_bInhInvld_Com_iBattEBS1Rx" 569 "FId_bInhInvld_Com_iBattEBS2Rx" 570 "FId_bInhInvld_Com_iBattEBS3Rx" 571 "FId_bInhInvld_Com_iDcdcHvActRvsn1" 572 "FId_bInhInvld_Com_iDcdcLvActRvsn1" 573 "FId_bInhInvld_Com_iElCmprHvAct" 574 "FId_bInhInvld_Com_iElCmprPeakPha" 575 "FId_bInhInvld_Com_iHvbActRx" 576 "FId_bInhInvld_Com_iHvbChrgMaxSho" 577 "FId_bInhInvld_Com_iHvbDchaMaxSho" 578 "FId_bInhInvld_Com_iHvbDes" 579 "FId_bInhInvld_Com_iHvbNomChrgn" 580 "FId_bInhInvld_Com_lDstGlbDa" 581 "FId_bInhInvld_Com_lTotOdometer" 582 "FId_bInhInvld_Com_nElCmprActl" 583 "FId_bInhInvld_Com_nrSerMaxCell" 584 "FId_bInhInvld_Com_nrSerMinCell" 585 "FId_bInhInvld_Com_pwrDcdcOutpCpby" 586 "FId_bInhInvld_Com_pwrElCmprActl" 587 "FId_bInhInvld_Com_pwrMaxChrgSho" 588 "FId_bInhInvld_Com_pwrMaxDchaSho" 589 "FId_bInhInvld_Com_qHvbTotCpRx" 590 "FId_bInhInvld_Com_rHvbIsoMeasmt" 591 "FId_bInhInvld_Com_ratHvbSoc" 592 "FId_bInhInvld_Com_ratHvbSoh" 593 "FId_bInhInvld_Com_ratRHvbSoh" 594 "FId_bInhInvld_Com_ratSocLvBatt" 595 "FId_bInhInvld_Com_stAC" 596 "FId_bInhInvld_Com_stAlrtThermRunAwy" 597 "FId_bInhInvld_Com_stBlowrRly" 598 "FId_bInhInvld_Com_stDcdcFltLvl" 599 "FId_bInhInvld_Com_stEvapTFlt" 600 "FId_bInhInvld_Com_stGearLvrPos" 601 "FId_bInhInvld_Com_stHvacBlwrFront" 602 "FId_bInhInvld_Com_stHvacKnobPosn" 603 "FId_bInhInvld_Com_stHvacPanPotiFlt" 604 "FId_bInhInvld_Com_stHvbChrgn" 605 "FId_bInhInvld_Com_stHvbDiscnctReas" 606 "FId_bInhInvld_Com_stHvbIntlckRx" 607 "FId_bInhInvld_Com_stHvbIsoFltRx" 608 "FId_bInhInvld_Com_stHvbSrvPlgRx" 609 "FId_bInhInvld_Com_stIBattEBS" 610 "FId_bInhInvld_Com_stIIvtrFltLvl01" 611 "FId_bInhInvld_Com_stMainWkuReq" 612 "FId_bInhInvld_Com_stReFogReq" 613 "FId_bInhInvld_Com_stSocRx" 614 "FId_bInhInvld_Com_stT" 615 "FId_bInhInvld_Com_tDcdcAct" 616 "FId_bInhInvld_Com_tDcdcInltCoolt" 617 "FId_bInhInvld_Com_tElCmprActl" 618 "FId_bInhInvld_Com_tEnvT" 619 "FId_bInhInvld_Com_tEvapT" 620 "FId_bInhInvld_Com_tHvbAct" 621 "FId_bInhInvld_Com_tHvbMax" 622 "FId_bInhInvld_Com_tLvBatt" 623 "FId_bInhInvld_Com_tiCurVehTmr" 624 "FId_bInhInvld_Com_tiHvbChrgnHalfRx" 625 "FId_bInhInvld_Com_uBattEBSRx" 626 "FId_bInhInvld_Com_uDcdcHvAct" 627 "FId_bInhInvld_Com_uDcdcLvAct" 628 "FId_bInhInvld_Com_uElCmprHvAct" 629 "FId_bInhInvld_Com_uHvbAct" 630 "FId_bInhInvld_Com_uHvbDcBus" 631 "FId_bInhInvld_Com_uHvbLimHi" 632 "FId_bInhInvld_Com_uHvbMaxCell" 633 "FId_bInhInvld_Com_uHvbMinCell" 634 "FId_bInhInvld_Com_uHvbNomChrgn" 635 "FId_bInhInvld_Com_vVeh" 636 "FId_bInh_ACCmpr_pwrLimMax" 637 "FId_bInh_ACCtl_flgCmprEna" 638 "FId_bInh_ACCtl_nCmprSpdReq" 639 "FId_bInh_APP_rInp" 640 "FId_bInh_BattId_numOrganNature1" 641 "FId_bInh_BattId_numOrganNature2" 642 "FId_bInh_BattId_numOrganRef1" 643 "FId_bInh_BattId_numOrganRef2" 644 "FId_bInh_BattId_numOrganRef3" 645 "FId_bInh_BattId_numOrganRef4" 646 "FId_bInh_BattId_numSerl1" 647 "FId_bInh_BattId_numSerl2" 648 "FId_bInh_BattId_numSerl3" 649 "FId_bInh_BattId_numSerl4" 650 "FId_bInh_BattId_numSerl5" 651 "FId_bInh_BattId_numSerl6" 652 "FId_bInh_BattId_numSerl7" 653 "FId_bInh_Brk_stRed" 654 "FId_bInh_CbnHeatgHeatr_cntrRlyLf" 655 "FId_bInh_ChgrPlug_stPlgLockTx" 656 "FId_bInh_ChrgCntct_nrNegCntctElpdOper" 657 "FId_bInh_ChrgCntct_nrPosCntctElpdOper" 658 "FId_bInh_ChrgrRly_stRlyDes" 659 "FId_bInh_ChrgrVal_iChrgrDes" 660 "FId_bInh_ChrgrVal_iGridLimMax" 661 "FId_bInh_ChrgrVal_uHvMax" 662 "FId_bInh_CoDrvPITh_stEPSModeReq" 663 "FId_bInh_CoPtFH_stPwt" 664 "FId_bInh_ComChrg_stMod" 665 "FId_bInh_ComChrgn_iDcRly_Sq_Frz" 666 "FId_bInh_ComChrgn_uDcRly_Sq_Frz" 667 "FId_bInh_ComChrgr_flgChrgrErr_Sq_Frz" 668 "FId_bInh_ComChrgr_iAcMax_Sq_Frz" 669 "FId_bInh_ComChrgr_iDcHvAct_Sq_Frz" 670 "FId_bInh_ComChrgr_pwrInAct_Sq_Frz" 671 "FId_bInh_ComChrgr_stChrgnEna" 672 "FId_bInh_ComChrgr_stChrgr_Sq_Frz" 673 "FId_bInh_ComChrgr_tChrgrMaxAct_Sq_Frz" 674 "FId_bInh_ComChrgr_uAcActL1_Sq_Frz" 675 "FId_bInh_ComChrgr_uDcHvAct_Sq_Frz" 676 "FId_bInh_ComEmac_flgSvsReq01_Sq_Frz" 677 "FId_bInh_ComEmac_tIvtrCoolt01_Sq_Frz" 678 "FId_bInh_Com_25h_B1b0" 679 "FId_bInh_Com_25h_B1b2" 680 "FId_bInh_Com_25h_B1b4" 681 "FId_bInh_Com_25h_B1b6" 682 "FId_bInh_Com_HvbMaxSnsrTempTx" 683 "FId_bInh_Com_TogLedDrv" 684 "FId_bInh_Com_TogLedMod" 685 "FId_bInh_Com_TogLedNeut" 686 "FId_bInh_Com_TogLedRvs" 687 "FId_bInh_Com_bAcLedReq" 688 "FId_bInh_Com_bDiagMuxCAN" 689 "FId_bInh_Com_bGunCntInfoWkuReq" 690 "FId_bInh_Com_bHvBattRchrgWkuReq" 691 "FId_bInh_Com_bPostOperationWkuReq" 692 "FId_bInh_Com_bReFogRlySt" 693 "FId_bInh_Com_flgBlowrAuthn" 694 "FId_bInh_Com_flgBlowrRlyCtrl" 695 "FId_bInh_Com_flgBrkAlrt" 696 "FId_bInh_Com_flgDrvAwy" 697 "FId_bInh_Com_flgVehSpdQly" 698 "FId_bInh_Com_iDcdcHvActRvsn1_Sq_Frz" 699 "FId_bInh_Com_iDcdcLvActRvsn1_Sq_Frz" 700 "FId_bInh_Com_iElCmprHvAct_Sq_Frz" 701 "FId_bInh_Com_iHvbActTx" 702 "FId_bInh_Com_nElCmprActlTx" 703 "FId_bInh_Com_nIvtrMotAct01" 704 "FId_bInh_Com_noEditCal" 705 "FId_bInh_Com_noEditSw" 706 "FId_bInh_Com_noVerSysDay" 707 "FId_bInh_Com_noVersAdp" 708 "FId_bInh_Com_noVersSw" 709 "FId_bInh_Com_noVersSys" 710 "FId_bInh_Com_noVersSysMnth" 711 "FId_bInh_Com_noVersSysYr" 712 "FId_bInh_Com_ratHvbSoh_Sq_Frz" 713 "FId_bInh_Com_stACTx" 714 "FId_bInh_Com_stBrk" 715 "FId_bInh_Com_stBrkBstPFlt" 716 "FId_bInh_Com_stBrkCntctIndcn" 717 "FId_bInh_Com_stChrgPlg" 718 "FId_bInh_Com_stChrgPlgChrgn" 719 "FId_bInh_Com_stClstrStopIndcn" 720 "FId_bInh_Com_stCmdHvBattCntctr" 721 "FId_bInh_Com_stCmdOffsEM01" 722 "FId_bInh_Com_stDcdcOperModAct_Sq_Frz" 723 "FId_bInh_Com_stDrvAwyDi" 724 "FId_bInh_Com_stDrvModPosn" 725 "FId_bInh_Com_stEVLmp" 726 "FId_bInh_Com_stElCmprStatTx" 727 "FId_bInh_Com_stElMDesEem" 728 "FId_bInh_Com_stHvBattOperModDes" 729 "FId_bInh_Com_stHvacBlwrFront_CAN" 730 "FId_bInh_Com_stHvacKnobPosn_CAN" 731 "FId_bInh_Com_stMstWrnLmp" 732 "FId_bInh_Com_stNwCmdLIN" 733 "FId_bInh_Com_stPwrLimnLmp" 734 "FId_bInh_Com_stReFogReq_CAN" 735 "FId_bInh_Com_stSrvLmp" 736 "FId_bInh_Com_stVehCoorn" 737 "FId_bInh_Com_tDcdcAct_Sq_Frz" 738 "FId_bInh_Com_tDcdcInltCoolt_Sq" 739 "FId_bInh_Com_tqMotLimMax" 740 "FId_bInh_Com_uDcdcHvAct_Sq_Frz" 741 "FId_bInh_Com_uDcdcLvAct_Sq_Frz" 742 "FId_bInh_Com_uHvbActTx" 743 "FId_bInh_Com_valEepOffsEM01" 744 "FId_bInh_DcChrgnRly_ctMaxOperCyc" 745 "FId_bInh_Dcdc_flgDesLvGridULim" 746 "FId_bInh_Dcdc_iLimLvGrid" 747 "FId_bInh_Dcdc_stDesDcdc" 748 "FId_bInh_Dcdc_uDesLvGrid" 749 "FId_bInh_DrvInfo_wTotTripEgy" 750 "FId_bInh_EChrDv_cntPlin" 751 "FId_bInh_Eem_flgFstHvShdwn" 752 "FId_bInh_ElM_stDesEem01" 753 "FId_bInh_ElTS_egyTotChrgCyc" 754 "FId_bInh_ElTS_ratEmPowChrgn" 755 "FId_bInh_ElTS_ratEmPowDcha" 756 "FId_bInh_ElTS_stChrgCyc" 757 "FId_bInh_Emac_stIsoMonSwtReq" 758 "FId_bInh_Emac_tqDesCom01" 759 "FId_bInh_Ext_bSyncGPC" 760 "FId_bInh_HvBatt_flgIsoMeasmtDiReq" 761 "FId_bInh_HvBatt_ratSoc" 762 "FId_bInh_HvGrid_pwrMaxDcdc" 763 "FId_bInh_HvacPtc_stElHeatr" 764 "FId_bInh_Pdu_CLUSTER_5E7_Frz" 765 "FId_bInh_Pdu_CLUSTER_5E7_Rcf" 766 "FId_bInh_Pdu_CONTEXTE_1_5B2_Frz" 767 "FId_bInh_Pdu_CONTEXTE_1_5B2_Rcf" 768 "FId_bInh_Pdu_Com_pwrMaxChrgSho_Sq_Frz" 769 "FId_bInh_Pdu_Com_pwrMaxDchaSho_Sq_Frz" 770 "FId_bInh_Pdu_DAT3_BSI_4F2h_Frz" 771 "FId_bInh_Pdu_DAT3_BSI_4F2h_Rcf" 772 "FId_bInh_Pdu_DCDC_283h_Frz" 773 "FId_bInh_Pdu_DCDC_283h_Rcf" 774 "FId_bInh_Pdu_DCDC_293h_Frz" 775 "FId_bInh_Pdu_DCDC_293h_Rcf" 776 "FId_bInh_Pdu_DCDC_473h_Frz" 777 "FId_bInh_Pdu_DCDC_473h_Rcf" 778 "FId_bInh_Pdu_DCDC_663h_Frz" 779 "FId_bInh_Pdu_DCDC_663h_Rcf" 780 "FId_bInh_Pdu_HS3_AUTO_GEARBOX_SWITCH_STATUS_Frz" 781 "FId_bInh_Pdu_HS3_AUTO_GEARBOX_SWITCH_STATUS_Rcf" 782 "FId_bInh_Pdu_HVAC_PANEL_26h_Frz" 783 "FId_bInh_Pdu_HVAC_PANEL_26h_Rcf" 784 "FId_bInh_Pdu_HVBAT_205h_Frz" 785 "FId_bInh_Pdu_HVBAT_205h_Rcf" 786 "FId_bInh_Pdu_HVBAT_275h_Frz" 787 "FId_bInh_Pdu_HVBAT_275h_Rcf" 788 "FId_bInh_Pdu_HVBAT_285h_Frz" 789 "FId_bInh_Pdu_HVBAT_285h_Rcf" 790 "FId_bInh_Pdu_HVBAT_325h_Frz" 791 "FId_bInh_Pdu_HVBAT_325h_Rcf" 792 "FId_bInh_Pdu_HVBAT_335h_Frz" 793 "FId_bInh_Pdu_HVBAT_335h_Rcf" 794 "FId_bInh_Pdu_HVBAT_455h_Frz" 795 "FId_bInh_Pdu_HVBAT_455h_Rcf" 796 "FId_bInh_Pdu_HVBAT_535_Frz" 797 "FId_bInh_Pdu_HVBAT_535_Rcf" 798 "FId_bInh_Pdu_HVBAT_595h_Frz" 799 "FId_bInh_Pdu_HVBAT_595h_Rcf" 800 "FId_bInh_Pdu_HVBAT_635h_Frz" 801 "FId_bInh_Pdu_HVBAT_635h_Rcf" 802 "FId_bInh_Pdu_HVBAT_645h_Frz" 803 "FId_bInh_Pdu_HVBAT_645h_Rcf" 804 "FId_bInh_Pdu_HVBAT_665h_Frz" 805 "FId_bInh_Pdu_HVBAT_665h_Rcf" 806 "FId_bInh_Pdu_HVBAT_675h_Frz" 807 "FId_bInh_Pdu_HVBAT_675h_Rcf" 808 "FId_bInh_Pdu_HVBAT_THERMAL_5B5_Frz" 809 "FId_bInh_Pdu_HVBAT_THERMAL_5B5_Rcf" 810 "FId_bInh_Pdu_HVBAT_VCU_435h_Frz" 811 "FId_bInh_Pdu_HVBAT_VCU_435h_Rcf" 812 "FId_bInh_Pdu_HVBAT_VCU_543_Frz" 813 "FId_bInh_Pdu_HVBAT_VCU_543_Rcf" 814 "FId_bInh_Pdu_HVBAT_VCU_583_Frz" 815 "FId_bInh_Pdu_HVBAT_VCU_583_Rcf" 816 "FId_bInh_Pdu_INV_217h_Frz" 817 "FId_bInh_Pdu_INV_217h_Rcf" 818 "FId_bInh_Pdu_INV_227h_Frz" 819 "FId_bInh_Pdu_INV_227h_Rcf" 820 "FId_bInh_Pdu_INV_237_Frz" 821 "FId_bInh_Pdu_INV_237_Rcf" 822 "FId_bInh_Pdu_INV_427h_Frz" 823 "FId_bInh_Pdu_INV_427h_Rcf" 824 "FId_bInh_Pdu_INV_497h_Frz" 825 "FId_bInh_Pdu_INV_497h_Rcf" 826 "FId_bInh_Pdu_INV_IMMO_5C7_Frz" 827 "FId_bInh_Pdu_INV_IMMO_5C7_Rcf" 828 "FId_bInh_Pdu_IS_DAT6_BSI_592h_Frz" 829 "FId_bInh_Pdu_IS_DAT6_BSI_592h_Rcf" 830 "FId_bInh_Pdu_IS_DAT_ABR_50Dh_Frz" 831 "FId_bInh_Pdu_IS_DAT_ABR_50Dh_Rcf" 832 "FId_bInh_Pdu_IS_DAT_BSI_412h_Frz" 833 "FId_bInh_Pdu_IS_DAT_BSI_412h_Rcf" 834 "FId_bInh_Pdu_IS_DYN_ABR_38Dh_Frz" 835 "FId_bInh_Pdu_IS_DYN_ABR_38Dh_Rcf" 836 "FId_bInh_Pdu_IS_INTE_ELECTRON_BSI_092h_Frz" 837 "FId_bInh_Pdu_IS_INTE_ELECTRON_BSI_092h_Rcf" 838 "FId_bInh_Pdu_OBC_273h_Frz" 839 "FId_bInh_Pdu_OBC_273h_Rcf" 840 "FId_bInh_Pdu_OBC_453h_Frz" 841 "FId_bInh_Pdu_OBC_453h_Rcf" 842 "FId_bInh_Pdu_OBC_463h_Frz" 843 "FId_bInh_Pdu_OBC_463h_Rcf" 844 "FId_bInh_Pdu_PDU_BusVoltages_308_Frz" 845 "FId_bInh_Pdu_PDU_BusVoltages_308_Rcf" 846 "FId_bInh_Pdu_PDU_Current_318_Frz" 847 "FId_bInh_Pdu_PDU_Current_318_Rcf" 848 "FId_bInh_Pdu_SC_INFO_BCCM_442h_Frz" 849 "FId_bInh_Pdu_SC_INFO_BCCM_442h_Rcf" 850 "FId_bInh_Pdu_VCU_AIRBAG_351h_Frz" 851 "FId_bInh_Pdu_VCU_AIRBAG_351h_Rcf" 852 "FId_bInh_Pdu_VCU_AIRBAG_fault_Frz" 853 "FId_bInh_Pdu_VCU_eBCCM_432h_Frz" 854 "FId_bInh_Pdu_VCU_eBCCM_432h_Rcf" 855 "FId_bInh_Pdu_VCU_eBCCM_552h_Frz" 856 "FId_bInh_Pdu_VCU_eBCCM_552h_Rcf" 857 "FId_bInh_Pdu_eBCCM_082h_Frz" 858 "FId_bInh_Pdu_eBCCM_082h_Rcf" 859 "FId_bInh_Pdu_eCOMP_Information_47B_Frz" 860 "FId_bInh_Pdu_eCOMP_Information_47B_Rcf" 861 "FId_bInh_Pdu_eCOMP_Information_48B_Frz" 862 "FId_bInh_Pdu_eCOMP_Information_48B_Rcf" 863 "FId_bInh_Sig205h_Com_iHvbActRx_Frz" 864 "FId_bInh_Sig205h_Com_iHvbActRx_Rcf" 865 "FId_bInh_Sig205h_Com_ratHvbSoc_Frz" 866 "FId_bInh_Sig205h_Com_ratHvbSoc_Rcf" 867 "FId_bInh_Sig205h_Com_stHvbChrgn_Frz" 868 "FId_bInh_Sig205h_Com_stHvbChrgn_Rcf" 869 "FId_bInh_Sig205h_Com_uHvbAct_Frz" 870 "FId_bInh_Sig205h_Com_uHvbAct_Rcf" 871 "FId_bInh_Sig217h_ComEmac_nAct01_Frz" 872 "FId_bInh_Sig217h_ComEmac_nAct01_Rcf" 873 "FId_bInh_Sig217h_ComEmac_tqAckd01_Frz" 874 "FId_bInh_Sig217h_ComEmac_tqAckd01_Rcf" 875 "FId_bInh_Sig217h_ComEmac_tqAct01_Frz" 876 "FId_bInh_Sig217h_ComEmac_tqAct01_Rcf" 877 "FId_bInh_Sig217h_ComEmac_uDcLnk01_Frz" 878 "FId_bInh_Sig217h_ComEmac_uDcLnk01_Rcf" 879 "FId_bInh_Sig227h_ComEmac_iDcLnk01_Frz" 880 "FId_bInh_Sig227h_ComEmac_iDcLnk01_Rcf" 881 "FId_bInh_Sig227h_ComEmac_pwrInstnsInpRx_Frz" 882 "FId_bInh_Sig227h_ComEmac_pwrInstnsInpRx_Rcf" 883 "FId_bInh_Sig227h_ComEmac_tqAbsltMax01_Frz" 884 "FId_bInh_Sig227h_ComEmac_tqAbsltMax01_Rcf" 885 "FId_bInh_Sig227h_ComEmac_tqAbsltMaxRx01_Frz" 886 "FId_bInh_Sig227h_ComEmac_tqAbsltMaxRx01_Rcf" 887 "FId_bInh_Sig227h_ComEmac_tqAbsltMin01_Frz" 888 "FId_bInh_Sig227h_ComEmac_tqAbsltMin01_Rcf" 889 "FId_bInh_Sig227h_ComEmac_tqAbsltMinRx01_Frz" 890 "FId_bInh_Sig227h_ComEmac_tqAbsltMinRx01_Rcf" 891 "FId_bInh_Sig237h_ComEmac_stActvDcha_Frz" 892 "FId_bInh_Sig237h_ComEmac_stActvDcha_Rcf" 893 "FId_bInh_Sig237h_ComEmac_stEVLmp_Frz" 894 "FId_bInh_Sig237h_ComEmac_stEVLmp_Rcf" 895 "FId_bInh_Sig237h_ComEmac_stMod01Rx_Frz" 896 "FId_bInh_Sig237h_ComEmac_stMod01Rx_Rcf" 897 "FId_bInh_Sig237h_ComEmac_stMstWrnLmp_Frz" 898 "FId_bInh_Sig237h_ComEmac_stMstWrnLmp_Rcf" 899 "FId_bInh_Sig237h_ComEmac_stSVSLmp_Frz" 900 "FId_bInh_Sig237h_ComEmac_stSVSLmp_Rcf" 901 "FId_bInh_Sig237h_ComEmac_tqStabnMin_Frz" 902 "FId_bInh_Sig237h_ComEmac_tqStabnMin_Rcf" 903 "FId_bInh_Sig237h_Com_stIIvtrFltLvl01_Frz" 904 "FId_bInh_Sig237h_Com_stIIvtrFltLvl01_Rcf" 905 "FId_bInh_Sig259hFlt" 906 "FId_bInh_Sig259h_Com_flgEcoNormReqRx_Frz" 907 "FId_bInh_Sig259h_Com_flgEcoNormReqRx_Rcf" 908 "FId_bInh_Sig259h_Com_stGearLvrPos_Frz" 909 "FId_bInh_Sig259h_Com_stGearLvrPos_Rcf" 910 "FId_bInh_Sig259h_Com_steTogFailrLvl_Frz" 911 "FId_bInh_Sig259h_Com_steTogFailrLvl_Rcf" 912 "FId_bInh_Sig26h_Com_stAC_Frz" 913 "FId_bInh_Sig26h_Com_stAC_Rcf" 914 "FId_bInh_Sig26h_Com_stEvapTFlt_Frz" 915 "FId_bInh_Sig26h_Com_stEvapTFlt_Rcf" 916 "FId_bInh_Sig26h_Com_stHvacBlwrFront_Frz" 917 "FId_bInh_Sig26h_Com_stHvacBlwrFront_Rcf" 918 "FId_bInh_Sig26h_Com_stHvacKnobPosn_Frz" 919 "FId_bInh_Sig26h_Com_stHvacKnobPosn_Rcf" 920 "FId_bInh_Sig26h_Com_stHvacPanPotiFlt_Frz" 921 "FId_bInh_Sig26h_Com_stHvacPanPotiFlt_Rcf" 922 "FId_bInh_Sig26h_Com_stReFogReq_Frz" 923 "FId_bInh_Sig26h_Com_stReFogReq_Rcf" 924 "FId_bInh_Sig26h_Com_tEvapT_Frz" 925 "FId_bInh_Sig26h_Com_tEvapT_Rcf" 926 "FId_bInh_Sig273h_ComChrgr_flgChrgrErrLvl_Frz" 927 "FId_bInh_Sig273h_ComChrgr_flgChrgrErrLvl_Rcf" 928 "FId_bInh_Sig273h_ComChrgr_pwrOutpCpby_Frz" 929 "FId_bInh_Sig273h_ComChrgr_pwrOutpCpby_Rcf" 930 "FId_bInh_Sig275h_Com_iHvbDchaMaxSho_Frz" 931 "FId_bInh_Sig275h_Com_iHvbDchaMaxSho_Rcf" 932 "FId_bInh_Sig275h_Com_pwrMaxDchaSho_Frz" 933 "FId_bInh_Sig275h_Com_pwrMaxDchaSho_Rcf" 934 "FId_bInh_Sig283h_Com_iDcdcHvActRvsn1_Frz" 935 "FId_bInh_Sig283h_Com_iDcdcHvActRvsn1_Rcf" 936 "FId_bInh_Sig283h_Com_iDcdcLvActRvsn1_Frz" 937 "FId_bInh_Sig283h_Com_iDcdcLvActRvsn1_Rcf" 938 "FId_bInh_Sig283h_Com_uDcdcHvAct_Frz" 939 "FId_bInh_Sig283h_Com_uDcdcHvAct_Rcf" 940 "FId_bInh_Sig283h_Com_uDcdcLvAct_Frz" 941 "FId_bInh_Sig283h_Com_uDcdcLvAct_Rcf" 942 "FId_bInh_Sig285h_Com_iHvbChrgMaxSho_Frz" 943 "FId_bInh_Sig285h_Com_iHvbChrgMaxSho_Rcf" 944 "FId_bInh_Sig285h_Com_pwrMaxChrgSho_Frz" 945 "FId_bInh_Sig285h_Com_pwrMaxChrgSho_Rcf" 946 "FId_bInh_Sig293h_Com_pwrDcdcOutpCpby_Frz" 947 "FId_bInh_Sig293h_Com_pwrDcdcOutpCpby_Rcf" 948 "FId_bInh_Sig293h_Com_stDcdcFltLvl_Frz" 949 "FId_bInh_Sig293h_Com_stDcdcFltLvl_Rcf" 950 "FId_bInh_Sig325h_Com_rHvbIsoMeasmt_Frz" 951 "FId_bInh_Sig325h_Com_rHvbIsoMeasmt_Rcf" 952 "FId_bInh_Sig325h_Com_stHvbIntlckRx_Frz" 953 "FId_bInh_Sig325h_Com_stHvbIntlckRx_Rcf" 954 "FId_bInh_Sig325h_Com_stHvbIsoFltRx_Frz" 955 "FId_bInh_Sig325h_Com_stHvbIsoFltRx_Rcf" 956 "FId_bInh_Sig325h_Com_stHvbSrvPlgRx_Frz" 957 "FId_bInh_Sig325h_Com_stHvbSrvPlgRx_Rcf" 958 "FId_bInh_Sig325h_Com_tHvbMax_Frz" 959 "FId_bInh_Sig325h_Com_tHvbMax_Rcf" 960 "FId_bInh_Sig335h_Com_iHvbDes_Frz" 961 "FId_bInh_Sig335h_Com_iHvbDes_Rcf" 962 "FId_bInh_Sig335h_Com_iHvbNomChrgn_Frz" 963 "FId_bInh_Sig335h_Com_iHvbNomChrgn_Rcf" 964 "FId_bInh_Sig335h_Com_uHvbDcBus_Frz" 965 "FId_bInh_Sig335h_Com_uHvbDcBus_Rcf" 966 "FId_bInh_Sig335h_Com_uHvbLimHi_Frz" 967 "FId_bInh_Sig335h_Com_uHvbLimHi_Rcf" 968 "FId_bInh_Sig38Dh_Com_flgVehSpdAvl_Frz" 969 "FId_bInh_Sig38Dh_Com_flgVehSpdAvl_Rcf" 970 "FId_bInh_Sig38Dh_Com_vVeh_Frz" 971 "FId_bInh_Sig38Dh_Com_vVeh_Rcf" 972 "FId_bInh_Sig427h_ComEmac_stIvtrOpMod01_Frz" 973 "FId_bInh_Sig427h_ComEmac_stIvtrOpMod01_Rcf" 974 "FId_bInh_Sig427h_ComEmac_tInvr01_Frz" 975 "FId_bInh_Sig427h_ComEmac_tInvr01_Rcf" 976 "FId_bInh_Sig427h_ComEmac_tIvtrCooltIn01_Frz" 977 "FId_bInh_Sig427h_ComEmac_tIvtrCooltIn01_Rcf" 978 "FId_bInh_Sig427h_ComEmac_tMac01_Frz" 979 "FId_bInh_Sig427h_ComEmac_tMac01_Rcf" 980 "FId_bInh_Sig427h_ComEmac_tqPtd01_Frz" 981 "FId_bInh_Sig427h_ComEmac_tqPtd01_Rcf" 982 "FId_bInh_Sig432h_Com_stMainWkuReq_Frz" 983 "FId_bInh_Sig432h_Com_stMainWkuReq_Rcf" 984 "FId_bInh_Sig435h_Com_HvbMaxSnsrTempRx_Frz" 985 "FId_bInh_Sig435h_Com_HvbMaxSnsrTempRx_Rcf" 986 "FId_bInh_Sig435h_Com_nrSerMaxCell_Frz" 987 "FId_bInh_Sig435h_Com_nrSerMaxCell_Rcf" 988 "FId_bInh_Sig435h_Com_nrSerMinCell_Frz" 989 "FId_bInh_Sig435h_Com_nrSerMinCell_Rcf" 990 "FId_bInh_Sig435h_Com_uHvbMaxCell_Frz" 991 "FId_bInh_Sig435h_Com_uHvbMaxCell_Rcf" 992 "FId_bInh_Sig435h_Com_uHvbMinCell_Frz" 993 "FId_bInh_Sig435h_Com_uHvbMinCell_Rcf" 994 "FId_bInh_Sig442h_Com_stBlowrRly_Frz" 995 "FId_bInh_Sig442h_Com_stBlowrRly_Rcf" 996 "FId_bInh_Sig453h_ComChrgr_iAcMax_Frz" 997 "FId_bInh_Sig453h_ComChrgr_iAcMax_Rcf" 998 "FId_bInh_Sig453h_ComChrgr_pwrInAct_Frz" 999 "FId_bInh_Sig453h_ComChrgr_pwrInAct_Rcf" 1000 "FId_bInh_Sig453h_ComChrgr_uAcActL1_Frz" 1001 "FId_bInh_Sig453h_ComChrgr_uAcActL1_Rcf" 1002 "FId_bInh_Sig455h_Com_uHvbNomChrgn_Frz" 1003 "FId_bInh_Sig455h_Com_uHvbNomChrgn_Rcf" 1004 "FId_bInh_Sig463h_ComChrgr_iDcHvAct_Frz" 1005 "FId_bInh_Sig463h_ComChrgr_iDcHvAct_Rcf" 1006 "FId_bInh_Sig463h_ComChrgr_tChrgrMaxAct_Frz" 1007 "FId_bInh_Sig463h_ComChrgr_tChrgrMaxAct_Rcf" 1008 "FId_bInh_Sig463h_ComChrgr_uDcHvAct_Frz" 1009 "FId_bInh_Sig463h_ComChrgr_uDcHvAct_Rcf" 1010 "FId_bInh_Sig473h_Com_tDcdcAct_Frz" 1011 "FId_bInh_Sig473h_Com_tDcdcAct_Rcf" 1012 "FId_bInh_Sig473h_Com_tDcdcInltCoolt_Frz" 1013 "FId_bInh_Sig473h_Com_tDcdcInltCoolt_Rcf" 1014 "FId_bInh_Sig47Bh_Com_iElCmprHvAct_Frz" 1015 "FId_bInh_Sig47Bh_Com_iElCmprHvAct_Rcf" 1016 "FId_bInh_Sig47Bh_Com_iElCmprPeakPha_Frz" 1017 "FId_bInh_Sig47Bh_Com_iElCmprPeakPha_Rcf" 1018 "FId_bInh_Sig47Bh_Com_nElCmprActl_Frz" 1019 "FId_bInh_Sig47Bh_Com_nElCmprActl_Rcf" 1020 "FId_bInh_Sig47Bh_Com_pwrElCmprActl_Frz" 1021 "FId_bInh_Sig47Bh_Com_pwrElCmprActl_Rcf" 1022 "FId_bInh_Sig47Bh_Com_tElCmprActl_Frz" 1023 "FId_bInh_Sig47Bh_Com_tElCmprActl_Rcf" 1024 "FId_bInh_Sig47Bh_Com_uElCmprHvAct_Frz" 1025 "FId_bInh_Sig47Bh_Com_uElCmprHvAct_Rcf" 1026 "FId_bInh_Sig48Bh_Com_stElCmprFltLvl_Frz" 1027 "FId_bInh_Sig48Bh_Com_stElCmprFltLvl_Rcf" 1028 "FId_bInh_Sig4F2h_Com_ratSocLvBatt_Frz" 1029 "FId_bInh_Sig4F2h_Com_ratSocLvBatt_Rcf" 1030 "FId_bInh_Sig4F2h_Com_stSocRx_Frz" 1031 "FId_bInh_Sig4F2h_Com_stSocRx_Rcf" 1032 "FId_bInh_Sig4F2h_Com_stT_Frz" 1033 "FId_bInh_Sig4F2h_Com_stT_Rcf" 1034 "FId_bInh_Sig535h_Com_tHvbAct_Frz" 1035 "FId_bInh_Sig535h_Com_tHvbAct_Rcf" 1036 "FId_bInh_Sig543h_Com_egyHvbAvl_fRx_Frz" 1037 "FId_bInh_Sig543h_Com_egyHvbAvl_fRx_Rcf" 1038 "FId_bInh_Sig543h_Com_ratHvbSoh_Frz" 1039 "FId_bInh_Sig543h_Com_ratHvbSoh_Rcf" 1040 "FId_bInh_Sig543h_Com_ratRHvbSoh_Frz" 1041 "FId_bInh_Sig543h_Com_ratRHvbSoh_Rcf" 1042 "FId_bInh_Sig552h_Com_lDstGlbDa_Frz" 1043 "FId_bInh_Sig552h_Com_lDstGlbDa_Rcf" 1044 "FId_bInh_Sig552h_Com_lTotOdometer_Frz" 1045 "FId_bInh_Sig552h_Com_lTotOdometer_Rcf" 1046 "FId_bInh_Sig552h_Com_tiCurVehTmr_Frz" 1047 "FId_bInh_Sig552h_Com_tiCurVehTmr_Rcf" 1048 "FId_bInh_Sig583h_Com_stHvbDiscnctReas_Frz" 1049 "FId_bInh_Sig583h_Com_stHvbDiscnctReas_Rcf" 1050 "FId_bInh_Sig592h_Com_iBattEBS1Rx_Frz" 1051 "FId_bInh_Sig592h_Com_iBattEBS1Rx_Rcf" 1052 "FId_bInh_Sig592h_Com_iBattEBS2Rx_Frz" 1053 "FId_bInh_Sig592h_Com_iBattEBS2Rx_Rcf" 1054 "FId_bInh_Sig592h_Com_iBattEBS3Rx_Frz" 1055 "FId_bInh_Sig592h_Com_iBattEBS3Rx_Rcf" 1056 "FId_bInh_Sig592h_Com_stIBattEBS_Frz" 1057 "FId_bInh_Sig592h_Com_stIBattEBS_Rcf" 1058 "FId_bInh_Sig592h_Com_tLvBatt_Frz" 1059 "FId_bInh_Sig592h_Com_tLvBatt_Rcf" 1060 "FId_bInh_Sig592h_Com_uBattEBSRx_Frz" 1061 "FId_bInh_Sig592h_Com_uBattEBSRx_Rcf" 1062 "FId_bInh_Sig595h_Com_tiHvbChrgnHalfRx_Frz" 1063 "FId_bInh_Sig595h_Com_tiHvbChrgnHalfRx_Rcf" 1064 "FId_bInh_Sig5B2h_Com_tEnvT_Frz" 1065 "FId_bInh_Sig5B2h_Com_tEnvT_Rcf" 1066 "FId_bInh_Sig5B5h_Com_stAlrtThermRunAwy_Frz" 1067 "FId_bInh_Sig5B5h_Com_stAlrtThermRunAwy_Rcf" 1068 "FId_bInh_Sig635h_Com_ctHvbNegCntctrSeg1_Frz" 1069 "FId_bInh_Sig635h_Com_ctHvbNegCntctrSeg1_Rcf" 1070 "FId_bInh_Sig635h_Com_ctHvbNegCntctrSeg3_Frz" 1071 "FId_bInh_Sig635h_Com_ctHvbNegCntctrSeg3_Rcf" 1072 "FId_bInh_Sig635h_Com_ctHvbNegCntctrSeg4_Frz" 1073 "FId_bInh_Sig635h_Com_ctHvbNegCntctrSeg4_Rcf" 1074 "FId_bInh_Sig635h_Com_ctHvbPosCntctrSeg1_Frz" 1075 "FId_bInh_Sig635h_Com_ctHvbPosCntctrSeg1_Rcf" 1076 "FId_bInh_Sig635h_Com_ctHvbPosCntctrSeg3_Frz" 1077 "FId_bInh_Sig635h_Com_ctHvbPosCntctrSeg3_Rcf" 1078 "FId_bInh_Sig635h_Com_ctHvbPosCntctrSeg4_Frz" 1079 "FId_bInh_Sig635h_Com_ctHvbPosCntctrSeg4_Rcf" 1080 "FId_bInh_Sig645h_Com_ctHvbPrecCntctrSeg1_Frz" 1081 "FId_bInh_Sig645h_Com_ctHvbPrecCntctrSeg1_Rcf" 1082 "FId_bInh_Sig645h_Com_ctHvbPrecCntctrSeg2_Frz" 1083 "FId_bInh_Sig645h_Com_ctHvbPrecCntctrSeg2_Rcf" 1084 "FId_bInh_Sig675h_Com_qHvbTotCpRx_Frz" 1085 "FId_bInh_Sig675h_Com_qHvbTotCpRx_Rcf" 1086 "FId_bInh_Sig_ComEmac_flgImobAuthent_Sq_Frz" 1087 "FId_bInh_Sig_ComEmac_stIsoMonSwtAck_Sq_Frz" 1088 "FId_bInh_Sig_ComEmac_stPwrAuthn_Sq_Frz" 1089 "FId_bInh_Sig_Com_flgEcoNormReq_Frz" 1090 "FId_bInh_Sig_Com_pwrMaxChrgSho_Sq_Frz" 1091 "FId_bInh_Sig_Com_pwrMaxDchaSho_Sq_Frz" 1092 "FId_bInh_Sig_Com_stDcdcULimReq_Sq_Frz" 1093 "FId_bInh_Sig_Com_stGearLvrPos_Frz" 1094 "FId_bInh_Sig_Com_stIgnkeyPos_Sq_Frz" 1095 "FId_bInh_ThermHvac_stRemPrecndn" 1096 "FId_bInh_VehCoorn_dstRngPrdcDispTx" 1097 "FId_bInh_VehCoorn_wCnsTotWghtAvrgEffTripA" 1098 "FId_bInh_VehCoorn_wCnsTotWghtAvrgEffTripB" 1099 "FId_bInh_VehCoorn_wCnsTotWghtAvrgEffTx" 1100 "FId_bInh_VehCoorn_wCnsTotWghtTripAvrgEffTx" 1101 "FId_bInh_VehCoorn_wCnsWghtAvrgEffTripA" 1102 "FId_bInh_VehCoorn_wCnsWghtAvrgEffTripB" 1103 "FId_binnh_Sig_ComEmac_flgEmgyShtDwnReq01_Sq_Frz" 1104 "FId_binnh_Sig_ComEmac_flgImobAuthent_Sq_Frz" 1105 "FId_binnh_Sig_ComEmac_iDcLnk01_Sq_Frz" 1106 "FId_binnh_Sig_ComEmac_nAct01_Sq_Frz" 1107 "FId_binnh_Sig_ComEmac_stActvDcha_Sq_Frz" 1108 "FId_binnh_Sig_ComEmac_stIsoMonSwtAck_Sq_Frz" 1109 "FId_binnh_Sig_ComEmac_stMod01_Sq_Frz" 1110 "FId_binnh_Sig_ComEmac_stPwrAuthn_Sq_Frz" 1111 "FId_binnh_Sig_ComEmac_tInvr01_Sq_Frz" 1112 "FId_binnh_Sig_ComEmac_tMac01_Sq_Frz" 1113 "FId_binnh_Sig_ComEmac_tqAbsltMax01_Sq_Frz" 1114 "FId_binnh_Sig_ComEmac_tqAbsltMin01_Sq_Frz" 1115 "FId_binnh_Sig_ComEmac_tqAct01_Sq_Frz" 1116 "FId_binnh_Sig_ComEmac_uDcLnk01_sq_Frz" 1117 "FId_binnh_Sig_Com_egyHvbAvl_Sq_Frz" 1118 "FId_binnh_Sig_Com_iHvbAct_Sq_Frz" 1119 "FId_binnh_Sig_Com_iHvbChrgMaxSho_Sq_Frz" 1120 "FId_binnh_Sig_Com_iHvbDchaMaxSho_Sq_Frz" 1121 "FId_binnh_Sig_Com_iHvbDes_Sq_Frz" 1122 "FId_binnh_Sig_Com_pwrDcdcOutpCpby_Sq_Frz" 1123 "FId_binnh_Sig_Com_rHvbIsoMeasmt_Sq_Frz" 1124 "FId_binnh_Sig_Com_ratHvbSoc_Sq_Frz" 1125 "FId_binnh_Sig_Com_stDcdcULimReq_Sq_Frz" 1126 "FId_binnh_Sig_Com_stHvbCntct_Sq_Frz" 1127 "FId_binnh_Sig_Com_stHvbDernMaxT_Sq_Frz" 1128 "FId_binnh_Sig_Com_stHvbDernMinT_Sq_Frz" 1129 "FId_binnh_Sig_Com_stHvbFlt_Sq_Frz" 1130 "FId_binnh_Sig_Com_stHvbIntlck_Sq_Frz" 1131 "FId_binnh_Sig_Com_stHvbIsoFlt_Sq_Frz" 1132 "FId_binnh_Sig_Com_stHvbMod_Sq_Frz" 1133 "FId_binnh_Sig_Com_stHvbSrvPlg_Sq_Frz" 1134 "FId_binnh_Sig_Com_tHvbAct_Sq_Frz" 1135 "FId_binnh_Sig_Com_uElCmprHvAct_Sq_Frz" 1136 "FId_binnh_Sig_Com_uHvbAct_Sq_Frz" 1137 "FId_binnh_Sig_Com_uHvbDcBus_Sq_Frz" 1138 "FId_binnh_Sig_Com_uHvbLimHi_Sq_Frz" 1139 "FId_binnh_Sig_Com_uHvbNomChrgn_Sq_Frz" DEFAULT_VALUE "---" /end COMPU_VTAB
/begin RECORD_LAYOUT ValA_Wu16 FNC_VALUES 1 UWORD COLUMN_DIR DIRECT /end RECORD_LAYOUT
/end MODULE
/end PROJECT

ASAP2_VERSION 1 70
/begin PROJECT MDG1C "VC1CP091_STLA_N_D061I3"
/begin HEADER "" VERSION "VC1CP091_STLA_N_D061I3" PROJECT_NO MDG1C /end HEADER
/begin MODULE DIM ""
/begin MOD_COMMON "" BYTE_ORDER MSB_LAST ALIGNMENT_BYTE 1 ALIGNMENT_WORD 2 ALIGNMENT_LONG 4 ALIGNMENT_INT64 4 ALIGNMENT_FLOAT32_IEEE 4 ALIGNMENT_FLOAT64_IEEE 4 DATA_SIZE 32 /end MOD_COMMON
/begin CHARACTERISTIC DFC_CtlMsk2.DFC_MoFTqPtdVeh_C "" VALUE 0x80241678 Val_Wu8 255.0 DFES_OneToOne 0.00 255.0 FORMAT "%5.1" /end CHARACTERISTIC
/begin CHARACTERISTIC DFC_CtlMsk2.DFC_MoFVarPostBldSel_C "" VALUE 0x80241679 Val_Wu8 255.0 DFES_OneToOne 0.00 255.0 FORMAT "%5.1" /end CHARACTERISTIC
/begin CHARACTERISTIC DFC_DisblMsk2.DFC_MoFTqPtdVeh_C "" VALUE 0x802491D6 Val_Wu16 65535.00 DFES_OneToOne 0.00 65535.00 FORMAT "%8.2" /end CHARACTERISTIC
/begin CHARACTERISTIC DFC_DisblMsk2.DFC_MoFVarPostBldSel_C "" VALUE 0x802491D8 Val_Wu16 65535.00 DFES_OneToOne 0.00 65535.00 FORMAT "%8.2" /end CHARACTERISTIC
/begin CHARACTERISTIC MoFTqPtdVeh_aRecupDrvOnePedlDrvg_M "Recuperation map for drive mode in function monitoring" MAP 0x8026E6D0 Map_Xs16Ys16Ws16 65.53500 acc_q0p001 -32.76800 32.76700 FORMAT "%8.5"
 /begin AXIS_DESCR STD_AXIS MoFBas_vVehSignd Vel 16 -327.6800 327.6700 FORMAT "%8.4" DEPOSIT ABSOLUTE /end AXIS_DESCR
 /begin AXIS_DESCR STD_AXIS MoFTqPtdVeh_stDrvProgPrev OneToOne 3 -32768.00 32767.00 FORMAT "%8.2" DEPOSIT ABSOLUTE /end AXIS_DESCR
/end CHARACTERISTIC
/begin CHARACTERISTIC MoFTqPtdVeh_aRecupRvsOnePedlDrvg_M "Recuperation map for reverse mode in function monitoring" MAP 0x8026E75A Map_Xs16Ys16Ws16 65.53500 acc_q0p001 -32.76800 32.76700 FORMAT "%8.5"
 /begin AXIS_DESCR STD_AXIS MoFTqPtdVeh_vVehSigndRvs Vel 16 -327.6800 327.6700 FORMAT "%8.4" DEPOSIT ABSOLUTE /end AXIS_DESCR
 /begin AXIS_DESCR STD_AXIS MoFTqPtdVeh_stDrvProgReqRecupLoc OneToOne 3 -32768.00 32767.00 FORMAT "%8.2" DEPOSIT ABSOLUTE /end AXIS_DESCR
/end CHARACTERISTIC
/begin CHARACTERISTIC MoFTqPtdVeh_cntrDebCrpDsblRst_C "Disable creep control reset delay limit to function monitoring" VALUE 0x8026CF40 Val_Wu8 255.0 OneToOne 0.00 255.0 FORMAT "%5.1" /end CHARACTERISTIC
/begin CHARACTERISTIC MoFTqPtdVeh_cntrDebReqDiCrp_C "disable creep control request delay limit to functional level" VALUE 0x8026CF41 Val_Wu8 255.0 OneToOne 0.00 255.0 FORMAT "%5.1" /end CHARACTERISTIC
/begin CHARACTERISTIC MoFTqPtdVeh_cntrDebSetDiCrpCtrl_C "allowed vehicle speed deviation delay limit for creep control" VALUE 0x8026E54A Val_Wu16 65535.00 OneToOne 0.00 65535.00 FORMAT "%8.2" /end CHARACTERISTIC
/begin CHARACTERISTIC MoFTqPtdVeh_cntrSwtDrvProgDly_C "Debounce threshold for delay of transition of driver prrogram" VALUE 0x8026CF44 Val_Wu8 255.0 OneToOne 0.00 255.0 FORMAT "%5.1" /end CHARACTERISTIC
/begin CHARACTERISTIC MoFTqPtdVeh_cntrTestComp_C "Diagnosis test counter threshold to heal DFC_MoFTqPtdVeh" VALUE 0x80270622 Val_Wu8 255.0 OneToOne 0.00 255.0 FORMAT "%5.1" /end CHARACTERISTIC
/begin CHARACTERISTIC MoFTqPtdVeh_cntrTqCompMax_C "Error threshold in torque comparison on vehicle level in function monitoring" VALUE 0x8026CF3E Val_Wu8 255.0 OneToOne 0.00 255.0 FORMAT "%5.1" /end CHARACTERISTIC
/begin CHARACTERISTIC MoFTqPtdVeh_deAppGrdtLvlRst_C "Calibratable resistance value of the deviation from the accelerator pedal" VALUE 0x8026FC1A Val_Ws16 39999.39 PrcPerSec -20000.00 19999.39 FORMAT "%8.2" /end CHARACTERISTIC
/begin CHARACTERISTIC MoFTqPtdVeh_dTqDrvAwyGrdt_C "Drive away torque gradient" VALUE 0x8026D1F4 Val_Ws32 429496729.500 TrqPrpHigh -214748364.800 214748364.700 FORMAT "%13.3" /end CHARACTERISTIC
/begin CHARACTERISTIC MoFTqPtdVeh_enaOthTrqCompErr_C "e-machine or axle level torque comparison error consider in torque comparison at vehicle level" VALUE 0x8026CF3F Val_Wu8 255.0 OneToOne 0.00 255.0 FORMAT "%5.1" /end CHARACTERISTIC
/begin CHARACTERISTIC MoFTqPtdVeh_facAPPGrdtLvl_T "Table of factor from gradient of deviation on accelerator pedal position" CURVE 0x8026FC1C Mo_DataCurveSstS16WS16 2.550000 fak_q0p01 0.00 2.550000 FORMAT "%8.6" EXTENDED_LIMITS -327.6800 327.6700
 /begin AXIS_DESCR STD_AXIS MoFTqPtdVeh_deAPPOld PrcPerSec 4 -20000.00 19999.39 FORMAT "%8.2" DEPOSIT ABSOLUTE /end AXIS_DESCR
/end CHARACTERISTIC
/begin CHARACTERISTIC MoFTqPtdVeh_facDifModPerStep_T "Muliplication factor step per calculation step dependent from torque difference between the two modes" CURVE 0x8026E7E4 Mo_DataCurveSstS16WS16 65.53500 Fact1000 -32.76800 32.76700 FORMAT "%8.5"
 /begin AXIS_DESCR STD_AXIS MoFTqPtdVeh_tqDifMod TrqPrp 5 -52428.80 52427.20 FORMAT "%8.2" DEPOSIT ABSOLUTE /end AXIS_DESCR
/end CHARACTERISTIC
/begin CHARACTERISTIC MoFTqPtdVeh_facRecupAppGrdtPerStepDec_C "Decrement step size calibration for ramping down during falling edge of ACC active flag" VALUE 0x8026CF4A Val_Wu8 2.550 fak_q0p01 0.00 2.550 FORMAT "%5.3" /end CHARACTERISTIC
/begin CHARACTERISTIC MoFTqPtdVeh_facRecupModStepMax_T "Curve for maximal Step per slope limitation of recuperation lever" CURVE 0x8026FC2E Mo_DataCurveSstS16WS16 2.550000 fak_q0p01 0.00 2.550000 FORMAT "%8.6" EXTENDED_LIMITS -327.6800 327.6700
 /begin AXIS_DESCR STD_AXIS MoFBas_vVehSignd Vel 10 -327.6800 327.6700 FORMAT "%8.4" DEPOSIT ABSOLUTE /end AXIS_DESCR
/end CHARACTERISTIC
/begin CHARACTERISTIC MoFTqPtdVeh_facRecupMod_CA "Array recuperation factor in function monitoring" VAL_BLK 0x8026CF4B ValA_Wu8 2.550 fak_q0p01 0.00 2.550 FORMAT "%5.3" MATRIX_DIM 8 /end CHARACTERISTIC
/begin CHARACTERISTIC MoFTqPtdVeh_flgActvnRecupSwt_C "Calibration switch to enable or disable lever based recuperation calculation in final factor for one pedal recuperation" VALUE 0x8026CF53 Val_Wu8 1.00000000000 B_TRUE 0.00 1.00000000000 FORMAT "%13.11" /end CHARACTERISTIC
/begin CHARACTERISTIC MoFTqPtdVeh_flgCnvnFacSwt_C "Switch for selection of acceleration to torque factor" VALUE 0x8026CF45 Val_Wu8 1.00000000000 B_TRUE 0.00 1.00000000000 FORMAT "%13.11" /end CHARACTERISTIC
/begin CHARACTERISTIC MoFTqPtdVeh_flgEM02Prsnt_C "Flag indicating EM02 present status" VALUE 0x8026CF48 Val_Wu8 1.00000000000 B_TRUE 0.00 1.00000000000 FORMAT "%13.11" /end CHARACTERISTIC
/begin CHARACTERISTIC MoFTqPtdVeh_flgOnePedlDrvgExtReq_C "Switch for selection of external acceleration request" VALUE 0x8026CF46 Val_Wu8 1.00000000000 B_TRUE 0.00 1.00000000000 FORMAT "%13.11" /end CHARACTERISTIC
/begin CHARACTERISTIC MoFTqPtdVeh_flgVirtZrPntSwtExt_C "Calibration flag for external virtual zero point" VALUE 0x8026CF54 Val_Wu8 1.00000000000 B_TRUE 0.00 1.00000000000 FORMAT "%13.11" /end CHARACTERISTIC
/begin CHARACTERISTIC MoFTqPtdVeh_lenWhlCircum_C "Wheel circumference" VALUE 0x8026E7FA Val_Ws16 65.53500 Length_fine -32.76800 32.76700 FORMAT "%8.5" /end CHARACTERISTIC
/begin CHARACTERISTIC MoFTqPtdVeh_mTotVeh_C "Total vehicle mass" VALUE 0x8026E7FC Val_Ws16 65535.00 Mass -32768.00 32767.00 FORMAT "%8.2" /end CHARACTERISTIC
/begin CHARACTERISTIC MoFTqPtdVeh_rAPPActv_C "Minimum accped press ratio for enabling the creep control" VALUE 0x8026E54C Val_Ws16 799.9878 Prc -400.0000 399.9878 FORMAT "%8.4" /end CHARACTERISTIC
/begin CHARACTERISTIC MoFTqPtdVeh_rAppCrsCtrlOvrL_C "calibratable parameter for low threshold of hysteres for coordination" VALUE 0x8026E518 Val_Ws16 799.9878 Prc -400.0000 399.9878 FORMAT "%8.4" /end CHARACTERISTIC
/begin CHARACTERISTIC MoFTqPtdVeh_rAppCrsCtrlOvrR_C "calibratable parameter for high threshold of hysteres for coordination" VALUE 0x8026E51A Val_Ws16 799.9878 Prc -400.0000 399.9878 FORMAT "%8.4" /end CHARACTERISTIC
/begin CHARACTERISTIC MoFTqPtdVeh_ratCoastGapOnePedlDrvg_M "Map of coasting gap of one pedal driving" MAP 0x8026FC58 Map_Xs16Ys16Ws16 799.9878 Prc -400.0000 399.9878 FORMAT "%8.4"
 /begin AXIS_DESCR STD_AXIS MoFBas_vVehSignd Vel 10 -327.6800 327.6700 FORMAT "%8.4" DEPOSIT ABSOLUTE /end AXIS_DESCR
 /begin AXIS_DESCR STD_AXIS MoFTqPtdVeh_stDrvProgReqLoc OneToOne 4 -32768.00 32767.00 FORMAT "%8.2" DEPOSIT ABSOLUTE /end AXIS_DESCR
/end CHARACTERISTIC
/begin CHARACTERISTIC MoFTqPtdVeh_ratCoastGapPerStepMax_T "Curve for maximal Step per slope limitation of coasting gap" CURVE 0x8026FCC8 Mo_DataCurveSstS16WS16 799.9878 Prc -400.0000 399.9878 FORMAT "%8.4"
 /begin AXIS_DESCR STD_AXIS MoFBas_vVehSignd Vel 10 -327.6800 327.6700 FORMAT "%8.4" DEPOSIT ABSOLUTE /end AXIS_DESCR
/end CHARACTERISTIC
/begin CHARACTERISTIC MoFTqPtdVeh_ratCoastGapRvsOnePedlDrvg_M "Map of coasting gap for reverse gear of one pedal driving" MAP 0x8026FCF2 Map_Xs16Ys16Ws16 799.9878 Prc -400.0000 399.9878 FORMAT "%8.4"
 /begin AXIS_DESCR STD_AXIS MoFTqPtdVeh_vSignCnvn Vel 10 -327.6800 327.6700 FORMAT "%8.4" DEPOSIT ABSOLUTE /end AXIS_DESCR
 /begin AXIS_DESCR STD_AXIS MoFTqPtdVeh_stDrvProgReqLoc OneToOne 4 -32768.00 32767.00 FORMAT "%8.2" DEPOSIT ABSOLUTE /end AXIS_DESCR
/end CHARACTERISTIC
/begin CHARACTERISTIC MoFTqPtdVeh_ratTqDifVehWght_T "Factor of error wheigh in torque comparison on vehicle level" CURVE 0x8026E3AE Mo_DataCurveSstS16WS16 655.3500 fak_q0p01 -327.6800 327.6700 FORMAT "%8.4"
 /begin AXIS_DESCR STD_AXIS MoFTqPtdVeh_tqWhlCoordLoResl TrqPrp 8 -52428.80 52427.20 FORMAT "%8.2" DEPOSIT ABSOLUTE /end AXIS_DESCR
/end CHARACTERISTIC
/begin CHARACTERISTIC MoFTqPtdVeh_ratVirtZrPntLim_C "Calibration to limit virtual zero point" VALUE 0x8026FD62 Val_Ws16 799.9878 Prc -400.0000 399.9878 FORMAT "%8.4" /end CHARACTERISTIC
/begin CHARACTERISTIC MoFTqPtdVeh_ratVirtZrPntOffs_C "Virtual zero point offset calibration" VALUE 0x8026FD64 Val_Ws16 799.9878 Prc -400.0000 399.9878 FORMAT "%8.4" /end CHARACTERISTIC
/begin CHARACTERISTIC MoFTqPtdVeh_ratVirtZrPntOnePedlDrvg_M "Map of virtual zero point for one pedal driving" MAP 0x8026FD66 Map_Xs16Ys16Ws16 799.9878 Prc -400.0000 399.9878 FORMAT "%8.4"
 /begin AXIS_DESCR STD_AXIS MoFBas_vVehSignd Vel 10 -327.6800 327.6700 FORMAT "%8.4" DEPOSIT ABSOLUTE /end AXIS_DESCR
 /begin AXIS_DESCR STD_AXIS MoFTqPtdVeh_stDrvProgReqLoc OneToOne 4 -32768.00 32767.00 FORMAT "%8.2" DEPOSIT ABSOLUTE /end AXIS_DESCR
/end CHARACTERISTIC
/begin CHARACTERISTIC MoFTqPtdVeh_ratVirtZrPntPerStepDec_T "Curve for per step decrement of virtual zero point" CURVE 0x8026FDD6 Mo_DataCurveSstS16WS16 799.9878 Prc -400.0000 399.9878 FORMAT "%8.4"
 /begin AXIS_DESCR STD_AXIS MoFBas_vVehSignd Vel 10 -327.6800 327.6700 FORMAT "%8.4" DEPOSIT ABSOLUTE /end AXIS_DESCR
/end CHARACTERISTIC
/begin CHARACTERISTIC MoFTqPtdVeh_ratVirtZrPntPerStepInct_T "Curve for per step increment of virtual zero point" CURVE 0x8026FE00 Mo_DataCurveSstS16WS16 799.9878 Prc -400.0000 399.9878 FORMAT "%8.4"
 /begin AXIS_DESCR STD_AXIS MoFBas_vVehSignd Vel 10 -327.6800 327.6700 FORMAT "%8.4" DEPOSIT ABSOLUTE /end AXIS_DESCR
/end CHARACTERISTIC
/begin CHARACTERISTIC MoFTqPtdVeh_ratVirtZrPntRvsOnePedlDrvg_M "Map of virtual zero point for reverse gear of one pedal driving" MAP 0x8026FE2A Map_Xs16Ys16Ws16 799.9878 Prc -400.0000 399.9878 FORMAT "%8.4"
 /begin AXIS_DESCR STD_AXIS MoFTqPtdVeh_vSignCnvn Vel 10 -327.6800 327.6700 FORMAT "%8.4" DEPOSIT ABSOLUTE /end AXIS_DESCR
 /begin AXIS_DESCR STD_AXIS MoFTqPtdVeh_stDrvProgReqLoc OneToOne 4 -32768.00 32767.00 FORMAT "%8.2" DEPOSIT ABSOLUTE /end AXIS_DESCR
/end CHARACTERISTIC
/begin CHARACTERISTIC MoFTqPtdVeh_ratZrPntOnePedlThd_C "Threshold for virtual zero point of one pedal driving to avoid division through zero" VALUE 0x8026FE9A Val_Ws16 799.9878 Prc -400.0000 399.9878 FORMAT "%8.4" /end CHARACTERISTIC
/begin CHARACTERISTIC MoFTqPtdVeh_rMinGapThd_C "Minium threshold gap, to avoid wrong calculated coasting gap" VALUE 0x8026FE9C Val_Ws16 799.9878 Prc -400.0000 399.9878 FORMAT "%8.4" /end CHARACTERISTIC
/begin CHARACTERISTIC MoFTqPtdVeh_RstVehV_C "Calibration for Veh_v for freeze frame" VALUE 0x8026E7FE Val_Ws16 655.3500 Vel -327.6800 327.6700 FORMAT "%8.4" /end CHARACTERISTIC
/begin CHARACTERISTIC MoFTqPtdveh_stCfgASDrf_C "Calibration Parameter to select different torque gradient" VALUE 0x8026F166 Val_Wu16 65535.00 OneToOne 0.00 65535.00 FORMAT "%8.2" /end CHARACTERISTIC
/begin CHARACTERISTIC MoFTqPtdVeh_stDrvProgEco_C "ECO Mode active in function monitoring" VALUE 0x8026E6CA Val_Wu16 65535.00 OneToOne 0.00 65535.00 FORMAT "%8.2" /end CHARACTERISTIC
/begin CHARACTERISTIC MoFTqPtdVeh_stDrvProgNorm_C "Normal Mode active in function monitoring" VALUE 0x8026E6CC Val_Wu16 65535.00 OneToOne 0.00 65535.00 FORMAT "%8.2" /end CHARACTERISTIC
/begin CHARACTERISTIC MoFTqPtdVeh_stDrvProgSpt_C "Sport Mode active in function monitoring" VALUE 0x8026E6CE Val_Wu16 65535.00 OneToOne 0.00 65535.00 FORMAT "%8.2" /end CHARACTERISTIC
/begin CHARACTERISTIC MoFTqPtdVeh_stRecupMod_C "Status of recuperation mode" VALUE 0x8026CF55 Val_Wu8 7.000 OneToOne 0.00 7.000 FORMAT "%5.3" EXTENDED_LIMITS 0.00 255.0 /end CHARACTERISTIC
/begin CHARACTERISTIC MoFTqPtdVeh_swtBrkSeln_C "Brake selection switch" VALUE 0x8026CF42 Val_Wu8 255.0 OneToOne 0.00 255.0 FORMAT "%5.1" /end CHARACTERISTIC
/begin CHARACTERISTIC MoFTqPtdVeh_swtCfgDisblCrp_C "creep control swt swich for temp deactivation conditions" VALUE 0x8026CF43 Val_Wu8 255.0 OneToOne 0.00 255.0 FORMAT "%5.1" /end CHARACTERISTIC
/begin CHARACTERISTIC MoFTqPtdVeh_tiBrkgToZrRefFil_C "Filter time constant of reference filter when braking to zeroflag is activated" VALUE 0x8026E51C Val_Wu16 655.34999985 zk10msxs_uw_b655p36 0.01000015 655.36000000 FORMAT "%12.8" EXTENDED_LIMITS 0.010000152590 655.36000000 /end CHARACTERISTIC
/begin CHARACTERISTIC MoFTqPtdVeh_tiPrpDrvrAsscRefFil_C "Filter time constant of the second order lowpass reference Filter in case of DrvrAssc or ADAS function is active" VALUE 0x8026E51E Val_Wu16 655.34999985 zk10msxs_uw_b655p36 0.01000015 655.36000000 FORMAT "%12.8" EXTENDED_LIMITS 0.010000152590 655.36000000 /end CHARACTERISTIC
/begin CHARACTERISTIC MoFTqPtdVeh_tiRefFilDas_C "Filter time constant of the reference Filter in case of active driver assistance function." VALUE 0x8026E520 Val_Wu16 655.34999985 zk10msxs_uw_b655p36 0.01000015 655.36000000 FORMAT "%12.8" EXTENDED_LIMITS 0.010000152590 655.36000000 /end CHARACTERISTIC
/begin CHARACTERISTIC MoFTqPtdVeh_tiRefFil_C "Time constant during normal operation mode (startup governor deactivated)" VALUE 0x8026E522 Val_Wu16 655.34999985 zk10msxs_uw_b655p36 0.01000015 655.36000000 FORMAT "%12.8" EXTENDED_LIMITS 0.010000152590 655.36000000 /end CHARACTERISTIC
/begin CHARACTERISTIC MoFTqPtdVeh_tqDrvAwayDes_C "Desire Drive away torque calibration" VALUE 0x8026D1F8 Val_Ws32 429496729.500 TrqPrpHigh -214748364.800 214748364.700 FORMAT "%13.3" /end CHARACTERISTIC
/begin CHARACTERISTIC MoFTqPtdVeh_tqDrvAwyEcoDrv_T "ECO Mode curve for Drive" CURVE 0x8026E54E Mo_DataCurveSstS16WS16 104856.0 TrqPrp -52428.80 52427.20 FORMAT "%8.2"
 /begin AXIS_DESCR STD_AXIS MoFBas_vVehSignd Vel 15 -327.6800 327.6700 FORMAT "%8.4" DEPOSIT ABSOLUTE /end AXIS_DESCR
/end CHARACTERISTIC
/begin CHARACTERISTIC MoFTqPtdVeh_tqDrvAwyEcoRe_T "ECO Mode curve for Reverse" CURVE 0x8026E58C Mo_DataCurveSstS16WS16 104856.0 TrqPrp -52428.80 52427.20 FORMAT "%8.2"
 /begin AXIS_DESCR STD_AXIS MoFBas_vVehSignd Vel 15 -327.6800 327.6700 FORMAT "%8.4" DEPOSIT ABSOLUTE /end AXIS_DESCR
/end CHARACTERISTIC
/begin CHARACTERISTIC MoFTqPtdVeh_tqDrvAwyNormDrv_T "Normal Mode curve for Drive" CURVE 0x8026E5CA Mo_DataCurveSstS16WS16 104856.0 TrqPrp -52428.80 52427.20 FORMAT "%8.2"
 /begin AXIS_DESCR STD_AXIS MoFBas_vVehSignd Vel 15 -327.6800 327.6700 FORMAT "%8.4" DEPOSIT ABSOLUTE /end AXIS_DESCR
/end CHARACTERISTIC
/begin CHARACTERISTIC MoFTqPtdVeh_tqDrvAwyNormRe_T "Normal mode for Reverse" CURVE 0x8026E608 Mo_DataCurveSstS16WS16 104856.0 TrqPrp -52428.80 52427.20 FORMAT "%8.2"
 /begin AXIS_DESCR STD_AXIS MoFBas_vVehSignd Vel 15 -327.6800 327.6700 FORMAT "%8.4" DEPOSIT ABSOLUTE /end AXIS_DESCR
/end CHARACTERISTIC
/begin CHARACTERISTIC MoFTqPtdVeh_tqDrvAwySptDrv_T "Sport mode curve for Drive" CURVE 0x8026E646 Mo_DataCurveSstS16WS16 104856.0 TrqPrp -52428.80 52427.20 FORMAT "%8.2"
 /begin AXIS_DESCR STD_AXIS MoFBas_vVehSignd Vel 15 -327.6800 327.6700 FORMAT "%8.4" DEPOSIT ABSOLUTE /end AXIS_DESCR
/end CHARACTERISTIC
/begin CHARACTERISTIC MoFTqPtdVeh_tqDrvAwySptRe_T "Sport mode curve for Reverse" CURVE 0x8026E684 Mo_DataCurveSstS16WS16 104856.0 TrqPrp -52428.80 52427.20 FORMAT "%8.2"
 /begin AXIS_DESCR STD_AXIS MoFBas_vVehSignd Vel 15 -327.6800 327.6700 FORMAT "%8.4" DEPOSIT ABSOLUTE /end AXIS_DESCR
/end CHARACTERISTIC
/begin CHARACTERISTIC MoFTqPtdVeh_tqDrvrOvrdHi_C "Calibration parameter for higher threshold of hysteresis to determine APP override status" VALUE 0x8026D1C0 Val_Ws32 429496729.500 TrqPrpHigh -214748364.800 214748364.700 FORMAT "%13.3" /end CHARACTERISTIC
/begin CHARACTERISTIC MoFTqPtdVeh_tqDrvrOvrdLo_C "Calibration parameter for lower threshold of hysteresis to determine APP override status" VALUE 0x8026D1C4 Val_Ws32 429496729.500 TrqPrpHigh -214748364.800 214748364.700 FORMAT "%13.3" /end CHARACTERISTIC
/begin CHARACTERISTIC MoFTqPtdVeh_tqGrdtMaxZrCrssBrkgZrNeg_M "Map for maximum neagtive torque gradient for zerocross filter when the Braking to Zero is activated." MAP 0x8026F168 Map_Xs16Ys16Ws16 104856.0 TrqPrp -52428.80 52427.20 FORMAT "%8.2"
 /begin AXIS_DESCR STD_AXIS MoFTqPtdVeh_tqNrm TrqPrp 10 -52428.80 52427.20 FORMAT "%8.2" DEPOSIT ABSOLUTE /end AXIS_DESCR
 /begin AXIS_DESCR STD_AXIS MoFBas_vVeh Vel 8 -327.6800 327.6700 FORMAT "%8.4" DEPOSIT ABSOLUTE /end AXIS_DESCR
/end CHARACTERISTIC
/begin CHARACTERISTIC MoFTqPtdVeh_tqGrdtMaxZrCrssBrkgZrPos_M "Map for maximum positive torque gradient for zerocross filter when the Braking to Zero is activated." MAP 0x8026F230 Map_Xs16Ys16Ws16 104856.0 TrqPrp -52428.80 52427.20 FORMAT "%8.2"
 /begin AXIS_DESCR STD_AXIS MoFTqPtdVeh_tqNrm TrqPrp 10 -52428.80 52427.20 FORMAT "%8.2" DEPOSIT ABSOLUTE /end AXIS_DESCR
 /begin AXIS_DESCR STD_AXIS MoFBas_vVeh Vel 8 -327.6800 327.6700 FORMAT "%8.4" DEPOSIT ABSOLUTE /end AXIS_DESCR
/end CHARACTERISTIC
/begin CHARACTERISTIC MoFTqPtdVeh_tqGrdtMaxZrCrssEco_M "Map for maximum positive torque gradient for zero cross filter when drive program is in ECO mode." MAP 0x8026F2F8 Map_Xs16Ys16Ws16 104856.0 TrqPrp -52428.80 52427.20 FORMAT "%8.2"
 /begin AXIS_DESCR STD_AXIS MoFTqPtdVeh_tqNrm TrqPrp 10 -52428.80 52427.20 FORMAT "%8.2" DEPOSIT ABSOLUTE /end AXIS_DESCR
 /begin AXIS_DESCR STD_AXIS MoFBas_vVeh Vel 8 -327.6800 327.6700 FORMAT "%8.4" DEPOSIT ABSOLUTE /end AXIS_DESCR
/end CHARACTERISTIC
/begin CHARACTERISTIC MoFTqPtdVeh_tqGrdtMaxZrCrssNegDas_M "Map for maximum negative gradient in the zero crossing area if driver demand does not have priority" MAP 0x8026F3C0 Map_Xs16Ys16Ws16 104856.0 TrqPrp -52428.80 52427.20 FORMAT "%8.2"
 /begin AXIS_DESCR STD_AXIS MoFTqPtdVeh_tqNrm TrqPrp 10 -52428.80 52427.20 FORMAT "%8.2" DEPOSIT ABSOLUTE /end AXIS_DESCR
 /begin AXIS_DESCR STD_AXIS MoFBas_vVeh Vel 8 -327.6800 327.6700 FORMAT "%8.4" DEPOSIT ABSOLUTE /end AXIS_DESCR
/end CHARACTERISTIC
/begin CHARACTERISTIC MoFTqPtdVeh_tqGrdtMaxZrCrssNegEco_M "Map for maximum negative torque gradient for zero cross filter when drive program is in ECO mode." MAP 0x8026F488 Map_Xs16Ys16Ws16 104856.0 TrqPrp -52428.80 52427.20 FORMAT "%8.2"
 /begin AXIS_DESCR STD_AXIS MoFTqPtdVeh_tqNrm TrqPrp 10 -52428.80 52427.20 FORMAT "%8.2" DEPOSIT ABSOLUTE /end AXIS_DESCR
 /begin AXIS_DESCR STD_AXIS MoFBas_vVeh Vel 8 -327.6800 327.6700 FORMAT "%8.4" DEPOSIT ABSOLUTE /end AXIS_DESCR
/end CHARACTERISTIC
/begin CHARACTERISTIC MoFTqPtdVeh_tqGrdtMaxZrCrssNegPrpDrvrAssc_M "Maximal gradient (negative slope) for forming the demand torque of the electric motor when driver assistance function is active for Normal mode" MAP 0x8026F550 Map_Xs16Ys16Ws16 104856.0 TrqPrp -52428.80 52427.20 FORMAT "%8.2"
 /begin AXIS_DESCR STD_AXIS MoFTqPtdVeh_tqNrm TrqPrp 10 -52428.80 52427.20 FORMAT "%8.2" DEPOSIT ABSOLUTE /end AXIS_DESCR
 /begin AXIS_DESCR STD_AXIS MoFBas_vVeh Vel 8 -327.6800 327.6700 FORMAT "%8.4" DEPOSIT ABSOLUTE /end AXIS_DESCR
/end CHARACTERISTIC
/begin CHARACTERISTIC MoFTqPtdVeh_tqGrdtMaxZrCrssNegSpt_M "Map for maximum negative torque gradient for zero cross filter when drive program is in Sport mode." MAP 0x8026F618 Map_Xs16Ys16Ws16 104856.0 TrqPrp -52428.80 52427.20 FORMAT "%8.2"
 /begin AXIS_DESCR STD_AXIS MoFTqPtdVeh_tqNrm TrqPrp 10 -52428.80 52427.20 FORMAT "%8.2" DEPOSIT ABSOLUTE /end AXIS_DESCR
 /begin AXIS_DESCR STD_AXIS MoFBas_vVeh Vel 8 -327.6800 327.6700 FORMAT "%8.4" DEPOSIT ABSOLUTE /end AXIS_DESCR
/end CHARACTERISTIC
/begin CHARACTERISTIC MoFTqPtdVeh_tqGrdtMaxZrCrssNeg_M "Torque gradient maximum zero crossing negative map" MAP 0x8026F6E0 Map_Xs16Ys16Ws16 104856.0 TrqPrp -52428.80 52427.20 FORMAT "%8.2"
 /begin AXIS_DESCR STD_AXIS MoFTqPtdVeh_tqNrm TrqPrp 10 -52428.80 52427.20 FORMAT "%8.2" DEPOSIT ABSOLUTE /end AXIS_DESCR
 /begin AXIS_DESCR STD_AXIS MoFBas_vVeh Vel 8 -327.6800 327.6700 FORMAT "%8.4" DEPOSIT ABSOLUTE /end AXIS_DESCR
/end CHARACTERISTIC
/begin CHARACTERISTIC MoFTqPtdVeh_tqGrdtMaxZrCrssPosDas_M "map for maximum positive gradient in the zero crossing area if driver demand does not have priority" MAP 0x8026F7A8 Map_Xs16Ys16Ws16 104856.0 TrqPrp -52428.80 52427.20 FORMAT "%8.2"
 /begin AXIS_DESCR STD_AXIS MoFTqPtdVeh_tqNrm TrqPrp 10 -52428.80 52427.20 FORMAT "%8.2" DEPOSIT ABSOLUTE /end AXIS_DESCR
 /begin AXIS_DESCR STD_AXIS MoFBas_vVeh Vel 8 -327.6800 327.6700 FORMAT "%8.4" DEPOSIT ABSOLUTE /end AXIS_DESCR
/end CHARACTERISTIC
/begin CHARACTERISTIC MoFTqPtdVeh_tqGrdtMaxZrCrssPosPrpDrvrAssc_M "Maximal gradient (positive slope) for forming the demand torque of the electric motor when driver assistance function is active for Normal mode" MAP 0x8026F870 Map_Xs16Ys16Ws16 104856.0 TrqPrp -52428.80 52427.20 FORMAT "%8.2"
 /begin AXIS_DESCR STD_AXIS MoFTqPtdVeh_tqNrm TrqPrp 10 -52428.80 52427.20 FORMAT "%8.2" DEPOSIT ABSOLUTE /end AXIS_DESCR
 /begin AXIS_DESCR STD_AXIS MoFBas_vVeh Vel 8 -327.6800 327.6700 FORMAT "%8.4" DEPOSIT ABSOLUTE /end AXIS_DESCR
/end CHARACTERISTIC
/begin CHARACTERISTIC MoFTqPtdVeh_tqGrdtMaxZrCrssPos_M "Torque gradient maximum zero crossing positive map" MAP 0x8026F938 Map_Xs16Ys16Ws16 104856.0 TrqPrp -52428.80 52427.20 FORMAT "%8.2"
 /begin AXIS_DESCR STD_AXIS MoFTqPtdVeh_tqNrm TrqPrp 10 -52428.80 52427.20 FORMAT "%8.2" DEPOSIT ABSOLUTE /end AXIS_DESCR
 /begin AXIS_DESCR STD_AXIS MoFBas_vVeh Vel 8 -327.6800 327.6700 FORMAT "%8.4" DEPOSIT ABSOLUTE /end AXIS_DESCR
/end CHARACTERISTIC
/begin CHARACTERISTIC MoFTqPtdVeh_tqGrdtMaxZrCrssSpt_M "Map for maximum positive torque gradient for zero cross filter when drive program is in Sport mode." MAP 0x8026FA00 Map_Xs16Ys16Ws16 104856.0 TrqPrp -52428.80 52427.20 FORMAT "%8.2"
 /begin AXIS_DESCR STD_AXIS MoFTqPtdVeh_tqNrm TrqPrp 10 -52428.80 52427.20 FORMAT "%8.2" DEPOSIT ABSOLUTE /end AXIS_DESCR
 /begin AXIS_DESCR STD_AXIS MoFBas_vVeh Vel 8 -327.6800 327.6700 FORMAT "%8.4" DEPOSIT ABSOLUTE /end AXIS_DESCR
/end CHARACTERISTIC
/begin CHARACTERISTIC MoFTqPtdVeh_tqGrdtReaTarBrkgZrNeg_T "Curve for maximum negative torque gradient for zerocross filter when the Braking to Zero is activated." CURVE 0x8026FAC8 Mo_DataCurveSstS16WS16 104856.0 TrqPrp -52428.80 52427.20 FORMAT "%8.2"
 /begin AXIS_DESCR STD_AXIS MoFTqPtdVeh_tqDeltaZrCrss TrqPrp 6 -52428.80 52427.20 FORMAT "%8.2" DEPOSIT ABSOLUTE /end AXIS_DESCR
/end CHARACTERISTIC
/begin CHARACTERISTIC MoFTqPtdVeh_tqGrdtReaTarBrkgZrPos_T "Curve for maximum positive torque gradient for zerocross filter when the Braking to Zero is activated." CURVE 0x8026FAE2 Mo_DataCurveSstS16WS16 104856.0 TrqPrp -52428.80 52427.20 FORMAT "%8.2"
 /begin AXIS_DESCR STD_AXIS MoFTqPtdVeh_tqDeltaZrCrss TrqPrp 6 -52428.80 52427.20 FORMAT "%8.2" DEPOSIT ABSOLUTE /end AXIS_DESCR
/end CHARACTERISTIC
/begin CHARACTERISTIC MoFTqPtdVeh_tqGrdtReaTarEco_T "Curve for maximum positive torque gradient for zero cross filter when drive program is in ECO mode." CURVE 0x8026FAFC Mo_DataCurveSstS16WS16 104856.0 TrqPrp -52428.80 52427.20 FORMAT "%8.2"
 /begin AXIS_DESCR STD_AXIS MoFTqPtdVeh_tqDeltaZrCrss TrqPrp 6 -52428.80 52427.20 FORMAT "%8.2" DEPOSIT ABSOLUTE /end AXIS_DESCR
/end CHARACTERISTIC
/begin CHARACTERISTIC MoFTqPtdVeh_tqGrdtReaTarNegEco_T "Curve for maximum negative torque gradient for zero cross filter when drive program is in ECO mode." CURVE 0x8026FB16 Mo_DataCurveSstS16WS16 104856.0 TrqPrp -52428.80 52427.20 FORMAT "%8.2"
 /begin AXIS_DESCR STD_AXIS MoFTqPtdVeh_tqDeltaZrCrss TrqPrp 6 -52428.80 52427.20 FORMAT "%8.2" DEPOSIT ABSOLUTE /end AXIS_DESCR
/end CHARACTERISTIC
/begin CHARACTERISTIC MoFTqPtdVeh_tqGrdtReaTarNegSpt_T "Curve for maximum negative torque gradient for zero cross filter when drive program is in Sport mode." CURVE 0x8026FB30 Mo_DataCurveSstS16WS16 104856.0 TrqPrp -52428.80 52427.20 FORMAT "%8.2"
 /begin AXIS_DESCR STD_AXIS MoFTqPtdVeh_tqDeltaZrCrss TrqPrp 6 -52428.80 52427.20 FORMAT "%8.2" DEPOSIT ABSOLUTE /end AXIS_DESCR
/end CHARACTERISTIC
/begin CHARACTERISTIC MoFTqPtdVeh_tqGrdtReaTarNeg_T "Torque gradient reached target negative Table" CURVE 0x8026FB4A Mo_DataCurveSstS16WS16 104856.0 TrqPrp -52428.80 52427.20 FORMAT "%8.2"
 /begin AXIS_DESCR STD_AXIS MoFTqPtdVeh_tqDeltaZrCrss TrqPrp 6 -52428.80 52427.20 FORMAT "%8.2" DEPOSIT ABSOLUTE /end AXIS_DESCR
/end CHARACTERISTIC
/begin CHARACTERISTIC MoFTqPtdVeh_tqGrdtReaTarPos_T "Torque gradient reached target positve Table" CURVE 0x8026FB64 Mo_DataCurveSstS16WS16 104856.0 TrqPrp -52428.80 52427.20 FORMAT "%8.2"
 /begin AXIS_DESCR STD_AXIS MoFTqPtdVeh_tqDeltaZrCrss TrqPrp 6 -52428.80 52427.20 FORMAT "%8.2" DEPOSIT ABSOLUTE /end AXIS_DESCR
/end CHARACTERISTIC
/begin CHARACTERISTIC MoFTqPtdVeh_tqGrdtReaTarPrpDrvrAsscNeg_T "Negative torque gradient reached target value curve when propulsive driver assistance is active" CURVE 0x8026FB7E Mo_DataCurveSstS16WS16 104856.0 TrqPrp -52428.80 52427.20 FORMAT "%8.2"
 /begin AXIS_DESCR STD_AXIS MoFTqPtdVeh_tqDeltaZrCrss TrqPrp 6 -52428.80 52427.20 FORMAT "%8.2" DEPOSIT ABSOLUTE /end AXIS_DESCR
/end CHARACTERISTIC
/begin CHARACTERISTIC MoFTqPtdVeh_tqGrdtReaTarPrpDrvrAsscPos_T "Positive torque gradient reached target value curve when propulsive driver assistance is active" CURVE 0x8026FB98 Mo_DataCurveSstS16WS16 104856.0 TrqPrp -52428.80 52427.20 FORMAT "%8.2"
 /begin AXIS_DESCR STD_AXIS MoFTqPtdVeh_tqDeltaZrCrss TrqPrp 6 -52428.80 52427.20 FORMAT "%8.2" DEPOSIT ABSOLUTE /end AXIS_DESCR
/end CHARACTERISTIC
/begin CHARACTERISTIC MoFTqPtdVeh_tqGrdtReaTarSpt_T "Curve for maximum positive torque gradient for zero cross filter when drive program is in Sport mode." CURVE 0x8026FBB2 Mo_DataCurveSstS16WS16 104856.0 TrqPrp -52428.80 52427.20 FORMAT "%8.2"
 /begin AXIS_DESCR STD_AXIS MoFTqPtdVeh_tqDeltaZrCrss TrqPrp 6 -52428.80 52427.20 FORMAT "%8.2" DEPOSIT ABSOLUTE /end AXIS_DESCR
/end CHARACTERISTIC
/begin CHARACTERISTIC MoFTqPtdVeh_tqGrdtZrCrssLimBrkgToZrNeg_C "Negative torque gradient for zero crossing filter when braking to zero is activated" VALUE 0x8026D1FC Val_Ws32 6871947672.00 TrqPrp -3435973836.80 3435973835.20 FORMAT "%13.2" /end CHARACTERISTIC
/begin CHARACTERISTIC MoFTqPtdVeh_tqGrdtZrCrssLimBrkgToZrPos_C "Positive torque gradient for zero crossing filter when braking to zero is activated" VALUE 0x8026D200 Val_Ws32 6871947672.00 TrqPrp -3435973836.80 3435973835.20 FORMAT "%13.2" /end CHARACTERISTIC
/begin CHARACTERISTIC MoFTqPtdVeh_tqGrdtZrCrssLimNegEco_C "Calibration for maximum negative ramp gradient when drive program is in ECO mode" VALUE 0x8026D204 Val_Ws32 6871947672.00 TrqPrp -3435973836.80 3435973835.20 FORMAT "%13.2" /end CHARACTERISTIC
/begin CHARACTERISTIC MoFTqPtdVeh_tqGrdtZrCrssLimNegSpt_C "Calibration for maximum negative ramp gradient when drive program is in Sport mode" VALUE 0x8026D208 Val_Ws32 6871947672.00 TrqPrp -3435973836.80 3435973835.20 FORMAT "%13.2" /end CHARACTERISTIC
/begin CHARACTERISTIC MoFTqPtdVeh_tqGrdtZrCrssLimNeg_C "Calibration for maximum negative ramp gradient when the target value is almost reached" VALUE 0x8026D20C Val_Ws32 6871947672.00 TrqPrp -3435973836.80 3435973835.20 FORMAT "%13.2" /end CHARACTERISTIC
/begin CHARACTERISTIC MoFTqPtdVeh_tqGrdtZrCrssLimPosEco_C "Calibration for maximum positive ramp gradient when drive program is in ECO mode" VALUE 0x8026D210 Val_Ws32 6871947672.00 TrqPrp -3435973836.80 3435973835.20 FORMAT "%13.2" /end CHARACTERISTIC
/begin CHARACTERISTIC MoFTqPtdVeh_tqGrdtZrCrssLimPosSpt_C "Calibration for maximum positive ramp gradient when drive program is in Sport mode" VALUE 0x8026D214 Val_Ws32 6871947672.00 TrqPrp -3435973836.80 3435973835.20 FORMAT "%13.2" /end CHARACTERISTIC
/begin CHARACTERISTIC MoFTqPtdVeh_tqGrdtZrCrssLimPos_C "Calibration for maximum positive ramp gradient when the target value is almost reached" VALUE 0x8026D218 Val_Ws32 6871947672.00 TrqPrp -3435973836.80 3435973835.20 FORMAT "%13.2" /end CHARACTERISTIC
/begin CHARACTERISTIC MoFTqPtdVeh_tqGrdtZrCrssLimPrpDrvrAsscNeg_C "Calibration for maximum negative ramp gradient when propulsive driver assistance is active" VALUE 0x8026D21C Val_Ws32 6871947672.00 TrqPrp -3435973836.80 3435973835.20 FORMAT "%13.2" /end CHARACTERISTIC
/begin CHARACTERISTIC MoFTqPtdVeh_tqGrdtZrCrssLimPrpDrvrAsscPos_C "Calibration for maximum positive ramp gradient when propulsive driver assistance is active" VALUE 0x8026D220 Val_Ws32 6871947672.00 TrqPrp -3435973836.80 3435973835.20 FORMAT "%13.2" /end CHARACTERISTIC
/begin CHARACTERISTIC MoFTqPtdVeh_tqHillHldRampMax_C "Hillhold ramp max calibration parameter" VALUE 0x8026D1C8 Val_Ws32 429496729.500 TrqPrpHigh -214748364.800 214748364.700 FORMAT "%13.3" /end CHARACTERISTIC
/begin CHARACTERISTIC MoFTqPtdVeh_tqHillHldRampMin_C "Hillhold ramp minimum caibration parameter" VALUE 0x8026D1CC Val_Ws32 429496729.500 TrqPrpHigh -214748364.800 214748364.700 FORMAT "%13.3" /end CHARACTERISTIC
/begin CHARACTERISTIC MoFTqPtdVeh_tqMaxStepDwnRamp_C "calibration parameter for maximal allowed step down for ramping functionality in coordination" VALUE 0x8026D1D0 Val_Ws32 429496729.500 TrqPrpHigh -214748364.800 214748364.700 FORMAT "%13.3" /end CHARACTERISTIC
/begin CHARACTERISTIC MoFTqPtdVeh_tqMaxStepUpRamp_C "calibration parameter for maximal allowed step up for ramping functionality in coordination" VALUE 0x8026D1D4 Val_Ws32 429496729.500 TrqPrpHigh -214748364.800 214748364.700 FORMAT "%13.3" /end CHARACTERISTIC
/begin CHARACTERISTIC MoFTqPtdVeh_tqMinStepDwnRamp_C "calibration parameter for minimal allowed step down for ramping functionality in coordination" VALUE 0x8026D1D8 Val_Ws32 429496729.500 TrqPrpHigh -214748364.800 214748364.700 FORMAT "%13.3" /end CHARACTERISTIC
/begin CHARACTERISTIC MoFTqPtdVeh_tqMinStepUpRamp_C "calibration parameter for minimal allowed step up for ramping functionality in coordination" VALUE 0x8026D1DC Val_Ws32 429496729.500 TrqPrpHigh -214748364.800 214748364.700 FORMAT "%13.3" /end CHARACTERISTIC
/begin CHARACTERISTIC MoFTqPtdVeh_tqNegPtdOffs_M "Permitted negative offset for torque limits on vehicle level" MAP 0x8026E3D0 Map_Xs16Ys16Ws16 52428.80 TrqPrp -52428.80 0.00 FORMAT "%8.2" EXTENDED_LIMITS -52428.80 52427.20
 /begin AXIS_DESCR STD_AXIS MoFTqPtdVeh_tqWhlCoordLoResl TrqPrp 8 -52428.80 52427.20 FORMAT "%8.2" DEPOSIT ABSOLUTE /end AXIS_DESCR
 /begin AXIS_DESCR STD_AXIS MoFBas_vVeh Vel 8 -327.6800 327.6700 FORMAT "%8.4" DEPOSIT ABSOLUTE /end AXIS_DESCR
/end CHARACTERISTIC
/begin CHARACTERISTIC MoFTqPtdVeh_tqNegSlop_C "Parameter for the Negative slope of the Ramp." VALUE 0x8026D1E0 Val_Ws32 429496729.500 mdt_q0p1_Nm_DIV_s -214748364.800 214748364.700 FORMAT "%13.3" /end CHARACTERISTIC
/begin CHARACTERISTIC MoFTqPtdVeh_tqNegStaty_C "Permitted negative stationary torque on vehicle level" VALUE 0x8026D1AC Val_Ws32 429496729.500 TrqPrpHigh -214748364.800 214748364.700 FORMAT "%13.3" /end CHARACTERISTIC
/begin CHARACTERISTIC MoFTqPtdVeh_tqPosPtdOffs_M "Permitted positive offset for torque limits on vehicle level" MAP 0x8026E474 Map_Xs16Ys16Ws16 52427.20 TrqPrp 0.00 52427.20 FORMAT "%8.2" EXTENDED_LIMITS -52428.80 52427.20
 /begin AXIS_DESCR STD_AXIS MoFTqPtdVeh_tqWhlCoordLoResl TrqPrp 8 -52428.80 52427.20 FORMAT "%8.2" DEPOSIT ABSOLUTE /end AXIS_DESCR
 /begin AXIS_DESCR STD_AXIS MoFBas_vVeh Vel 8 -327.6800 327.6700 FORMAT "%8.4" DEPOSIT ABSOLUTE /end AXIS_DESCR
/end CHARACTERISTIC
/begin CHARACTERISTIC MoFTqPtdVeh_tqPosSlop_C "Parameter for the Positive slope of the Ramp." VALUE 0x8026D1E4 Val_Ws32 429496729.500 mdt_q0p1_Nm_DIV_s -214748364.800 214748364.700 FORMAT "%13.3" /end CHARACTERISTIC
/begin CHARACTERISTIC MoFTqPtdVeh_tqPosStaty_C "Permitted positive stationary torque on vehicle level" VALUE 0x8026D1B0 Val_Ws32 429496729.500 TrqPrpHigh -214748364.800 214748364.700 FORMAT "%13.3" /end CHARACTERISTIC
/begin CHARACTERISTIC MoFTqPtdVeh_tqRampLowrOffs_C "Torque Ramp Lower Offset Calibration" VALUE 0x8026D1E8 Val_Ws32 429496729.500 TrqPrpHigh -214748364.800 214748364.700 FORMAT "%13.3" /end CHARACTERISTIC
/begin CHARACTERISTIC MoFTqPtdVeh_tqRampUpprOffs_C "Torque Ramp Upper Offset Calibration" VALUE 0x8026D1EC Val_Ws32 429496729.500 TrqPrpHigh -214748364.800 214748364.700 FORMAT "%13.3" /end CHARACTERISTIC
/begin CHARACTERISTIC MoFTqPtdVeh_tqRecupOnePedlDrvgLim_C "Maximum possible deceleration torque" VALUE 0x8026E800 Val_Ws16 104856.0 TrqPrp -52428.80 52427.20 FORMAT "%8.2" /end CHARACTERISTIC
/begin CHARACTERISTIC MoFTqPtdVeh_tqRecupOnePedlDrvgPerStepMax_T "Recuperation step torque per raster" CURVE 0x8026E802 Mo_DataCurveSstS16WS16 104856.0 TrqPrp -52428.80 52427.20 FORMAT "%8.2"
 /begin AXIS_DESCR STD_AXIS MoFBas_vVehSignd Vel 10 -327.6800 327.6700 FORMAT "%8.4" DEPOSIT ABSOLUTE /end AXIS_DESCR
/end CHARACTERISTIC
/begin CHARACTERISTIC MoFTqPtdVeh_tqRecupOnePedlDrvgPerStepMin_T "Minimum Recuperation step torque per raster" CURVE 0x8026E82C Mo_DataCurveSstS16WS16 104856.0 TrqPrp -52428.80 52427.20 FORMAT "%8.2"
 /begin AXIS_DESCR STD_AXIS MoFBas_vVehSignd Vel 10 -327.6800 327.6700 FORMAT "%8.4" DEPOSIT ABSOLUTE /end AXIS_DESCR
/end CHARACTERISTIC
/begin CHARACTERISTIC MoFTqPtdVeh_tqSpdLimMin_T "Minimal permitted torque from speed limiter based on velocity difference to maximum velocity" CURVE 0x8026E524 Mo_DataCurveSstS16WS16 104856.0 TrqPrp -52428.80 52427.20 FORMAT "%8.2"
 /begin AXIS_DESCR STD_AXIS MoFTqPtdVeh_vVehDifMax Vel 7 -327.6800 327.6700 FORMAT "%8.4" DEPOSIT ABSOLUTE /end AXIS_DESCR
/end CHARACTERISTIC
/begin CHARACTERISTIC MoFTqPtdVeh_tqSpdLimPosStep_C "Maximum increase of speed limiter minimal permitted torque per calculation period" VALUE 0x8026D1F0 Val_Ws32 214748364.700 TrqPrpHigh 0.00 214748364.700 FORMAT "%13.3" EXTENDED_LIMITS -214748364.800 214748364.700 /end CHARACTERISTIC
/begin CHARACTERISTIC MoFTqPtdVeh_tqTiIntegDec_C "Constant for reduction of torque integral on freedom from defects" VALUE 0x8026D1B4 Val_Ws32 2147483.64700 mdt_q0p001_Nm_s 0.00 2147483.64700 FORMAT "%13.5" EXTENDED_LIMITS -2147483.64800 2147483.64700 /end CHARACTERISTIC
/begin CHARACTERISTIC MoFTqPtdVeh_tqTiIntegErr_C "Threshold of error detection in torque integral check" VALUE 0x8026D1B8 Val_Ws32 2147483.64700 mdt_q0p001_Nm_s 0.00 2147483.64700 FORMAT "%13.5" EXTENDED_LIMITS -2147483.64800 2147483.64700 /end CHARACTERISTIC
/begin CHARACTERISTIC MoFTqPtdVeh_tqTiIntegMax_C "Maximum filling level of torque integral check" VALUE 0x8026D1BC Val_Ws32 2147483.64700 mdt_q0p001_Nm_s 0.00 2147483.64700 FORMAT "%13.5" EXTENDED_LIMITS -2147483.64800 2147483.64700 /end CHARACTERISTIC
/begin CHARACTERISTIC MoFTqPtdVeh_tqWhlCoordRampFilOffs_T "Offset Curve to plausibilise between level1 and Level2 torque Ramp torques" CURVE 0x8026FBCC Mo_DataCurveSstS16WS16 6553.500 TrqPrpHigh -3276.800 3276.700 FORMAT "%8.3"
 /begin AXIS_DESCR STD_AXIS MoFBas_vVeh Vel 6 -327.6800 327.6700 FORMAT "%8.4" DEPOSIT ABSOLUTE /end AXIS_DESCR
/end CHARACTERISTIC
/begin CHARACTERISTIC MoFTqPtdVeh_tqWhlCoordUnfildOffs_T "Offset Curve to plausibilise between level1 and Level2 unfiltered desired torques" CURVE 0x8026FBE6 Mo_DataCurveSstS16WS16 6553.500 TrqPrpHigh -3276.800 3276.700 FORMAT "%8.3"
 /begin AXIS_DESCR STD_AXIS MoFBas_vVeh Vel 6 -327.6800 327.6700 FORMAT "%8.4" DEPOSIT ABSOLUTE /end AXIS_DESCR
/end CHARACTERISTIC
/begin CHARACTERISTIC MoFTqPtdVeh_tqWhlDesNoFil_T "Offset Curve to plausibilise between level1 and Level2 unfiltered desired torques, if EM02 is present." CURVE 0x8026FC00 Mo_DataCurveSstS16WS16 6553.500 TrqPrpHigh -3276.800 3276.700 FORMAT "%8.3"
 /begin AXIS_DESCR STD_AXIS MoFBas_vVeh Vel 6 -327.6800 327.6700 FORMAT "%8.4" DEPOSIT ABSOLUTE /end AXIS_DESCR
/end CHARACTERISTIC
/begin CHARACTERISTIC MoFTqPtdVeh_tqWhlEco_M "Pedal map Eco in function monitoring" MAP 0x8026E856 Map_Xs16Ys16Ws16 104856.0 TrqPrp -52428.80 52427.20 FORMAT "%8.2"
 /begin AXIS_DESCR STD_AXIS MoFTqPtdVeh_ratPrpOnePedlDrvg Prc 16 -400.0000 399.9878 FORMAT "%8.4" DEPOSIT ABSOLUTE /end AXIS_DESCR
 /begin AXIS_DESCR STD_AXIS MoFBas_vVehSignd Vel 16 -327.6800 327.6700 FORMAT "%8.4" DEPOSIT ABSOLUTE /end AXIS_DESCR
/end CHARACTERISTIC
/begin CHARACTERISTIC MoFTqPtdVeh_tqWhlNorm_M "Pedal map Normal in function monitoring" MAP 0x8026EA9A Map_Xs16Ys16Ws16 104856.0 TrqPrp -52428.80 52427.20 FORMAT "%8.2"
 /begin AXIS_DESCR STD_AXIS MoFTqPtdVeh_ratPrpOnePedlDrvg Prc 16 -400.0000 399.9878 FORMAT "%8.4" DEPOSIT ABSOLUTE /end AXIS_DESCR
 /begin AXIS_DESCR STD_AXIS MoFBas_vVehSignd Vel 16 -327.6800 327.6700 FORMAT "%8.4" DEPOSIT ABSOLUTE /end AXIS_DESCR
/end CHARACTERISTIC
/begin CHARACTERISTIC MoFTqPtdVeh_tqWhlRvs_M "Pedal map Reverse in function monitoring" MAP 0x8026ECDE Map_Xs16Ys16Ws16 104856.0 TrqPrp -52428.80 52427.20 FORMAT "%8.2"
 /begin AXIS_DESCR STD_AXIS MoFTqPtdVeh_ratPrpOnePedlDrvg Prc 16 -400.0000 399.9878 FORMAT "%8.4" DEPOSIT ABSOLUTE /end AXIS_DESCR
 /begin AXIS_DESCR STD_AXIS MoFTqPtdVeh_vVehSigndRvs Vel 16 -327.6800 327.6700 FORMAT "%8.4" DEPOSIT ABSOLUTE /end AXIS_DESCR
/end CHARACTERISTIC
/begin CHARACTERISTIC MoFTqPtdVeh_tqWhlSpt_M "Pedal map Sport in function monitoring" MAP 0x8026EF22 Map_Xs16Ys16Ws16 104856.0 TrqPrp -52428.80 52427.20 FORMAT "%8.2"
 /begin AXIS_DESCR STD_AXIS MoFTqPtdVeh_ratPrpOnePedlDrvg Prc 16 -400.0000 399.9878 FORMAT "%8.4" DEPOSIT ABSOLUTE /end AXIS_DESCR
 /begin AXIS_DESCR STD_AXIS MoFBas_vVehSignd Vel 16 -327.6800 327.6700 FORMAT "%8.4" DEPOSIT ABSOLUTE /end AXIS_DESCR
/end CHARACTERISTIC
/begin CHARACTERISTIC MoFTqPtdVeh_vCrpOPDDeactvn_C "one pedal driving permanent creep contorl deactivaiton limit" VALUE 0x8026E6C2 Val_Ws16 655.3500 Vel -327.6800 327.6700 FORMAT "%8.4" /end CHARACTERISTIC
/begin CHARACTERISTIC MoFTqPtdVeh_vCrpRels_C "creep contorl release speed" VALUE 0x8026E6C4 Val_Ws16 655.3500 Vel -327.6800 327.6700 FORMAT "%8.4" /end CHARACTERISTIC
/begin CHARACTERISTIC MoFTqPtdVeh_vCrpTmpDeactvn_C "temp creep contorl deactivation speed" VALUE 0x8026E6C6 Val_Ws16 655.3500 Vel -327.6800 327.6700 FORMAT "%8.4" /end CHARACTERISTIC
/begin CHARACTERISTIC MoFTqPtdVeh_vLimVehCrp_C "permanent vehicle speed deactivaion limit for creep contorl" VALUE 0x8026E6C8 Val_Ws16 655.3500 Vel -327.6800 327.6700 FORMAT "%8.4" /end CHARACTERISTIC
/begin CHARACTERISTIC MoFTqPtdVeh_vMaxFixdEco_C "Highest permitted velocity in eco mode" VALUE 0x8026E542 Val_Ws16 655.3500 Vel -327.6800 327.6700 FORMAT "%8.4" /end CHARACTERISTIC
/begin CHARACTERISTIC MoFTqPtdVeh_vMaxFixdNorm_C "Highest permitted velocity in normal mode" VALUE 0x8026E544 Val_Ws16 655.3500 Vel -327.6800 327.6700 FORMAT "%8.4" /end CHARACTERISTIC
/begin CHARACTERISTIC MoFTqPtdVeh_vMaxFixdRvs_C "Highest permitted velocity in reverse gear" VALUE 0x8026E546 Val_Ws16 655.3500 Vel -327.6800 327.6700 FORMAT "%8.4" /end CHARACTERISTIC
/begin CHARACTERISTIC MoFTqPtdVeh_vMaxFixdSpt_C "Highest permitted velocity in sport mode" VALUE 0x8026E548 Val_Ws16 655.3500 Vel -327.6800 327.6700 FORMAT "%8.4" /end CHARACTERISTIC
/begin CHARACTERISTIC MoFTrqPtd_cntrActvPostBldCfg_C "Number of debounce steps of error debounce due to an error in return of the active post-build configuration" VALUE 0x8026CF62 Val_Wu8 255.0 OneToOne 0.00 255.0 FORMAT "%5.1" /end CHARACTERISTIC
/begin CHARACTERISTIC MoFTrqPtd_cntrNegChkPostBldCfg_C "Number of debounce steps of error debounce due to an error in the negative check of the post-build configuration" VALUE 0x8026CF63 Val_Wu8 255.0 OneToOne 0.00 255.0 FORMAT "%5.1" /end CHARACTERISTIC
/begin CHARACTERISTIC MoFTrqPtd_cntrPosChkPostBldCfg_C "Number of debounce steps of error debounce due to an error in the positive check of the post-build configuration" VALUE 0x8026CF64 Val_Wu8 255.0 OneToOne 0.00 255.0 FORMAT "%5.1" /end CHARACTERISTIC
/begin CHARACTERISTIC MoFTrqPtd_cntrRstPostBldSel_C "Number of software resets from MoFVar_PostBldSel before request of an error reaction" VALUE 0x8026CF65 Val_Wu8 255.0 OneToOne 0.00 255.0 FORMAT "%5.1" /end CHARACTERISTIC
/begin CHARACTERISTIC MoFTrqPtd_cntrStabyChkPostBldCfg_C "Number of debounce steps of error debounce due to changed post-build configuration during driving cycle" VALUE 0x8026CF66 Val_Wu8 255.0 OneToOne 0.00 255.0 FORMAT "%5.1" /end CHARACTERISTIC
/begin CHARACTERISTIC MoFTrqPtd_cntrTestPostBldSel_C "Debounce steps for setting the testflag in post-build selectable diagnosis in function monitoring" VALUE 0x80270623 Val_Wu8 255.0 OneToOne 0.00 255.0 FORMAT "%5.1" /end CHARACTERISTIC
/begin CHARACTERISTIC MoFTrqPtd_stSwtPbsChk_C "Switch for activation of the post-build selectable monitoring in the function monitoring" VALUE 0x8026CF67 Val_Wu8 255.0 OneToOne 0.00 255.0 FORMAT "%5.1" /end CHARACTERISTIC
/begin CHARACTERISTIC MoFTrsmAssc_cntrDebGearReqRst_C "Counter threshold limit to reset the requested gear state" VALUE 0x8026CF56 Val_Wu8 255.0 OneToOne 0.00 255.0 FORMAT "%5.1" /end CHARACTERISTIC
/begin CHARACTERISTIC MoFTrsmAssc_cntrDrvRst_C "Counter threshold limit to reset the permitted status of DRIVE" VALUE 0x8026CF57 Val_Wu8 255.0 OneToOne 0.00 255.0 FORMAT "%5.1" /end CHARACTERISTIC
/begin CHARACTERISTIC MoFTrsmAssc_cntrModReqChgCfm_C "Low to high debounce calibration for counter" VALUE 0x8026CF58 Val_Wu8 255.0 OneToOne 0.00 255.0 FORMAT "%5.1" /end CHARACTERISTIC
/begin CHARACTERISTIC MoFTrsmAssc_cntrModReqChgHeal_C "High to low debounce calibration for counter" VALUE 0x8026CF59 Val_Wu8 255.0 OneToOne 0.00 255.0 FORMAT "%5.1" /end CHARACTERISTIC
/begin CHARACTERISTIC MoFTrsmAssc_cntrRvsRst_C "Counter threshold limit to reset the permitted status of REVERSE" VALUE 0x8026CF5A Val_Wu8 255.0 OneToOne 0.00 255.0 FORMAT "%5.1" /end CHARACTERISTIC
/begin CHARACTERISTIC MoFTrsmAssc_ctRst_C "Calibration for Reset Recovery counter check" VALUE 0x8026CF5B Val_Wu8 255.0 OneToOne 0.00 255.0 FORMAT "%5.1" /end CHARACTERISTIC
/begin CHARACTERISTIC MoFTrsmAssc_stLvl1ModeDrv_C "Parameter to evaluate gear status from level1 for DRIVE" VALUE 0x8026CF5C Val_Wu8 255.0 OneToOne 0.00 255.0 FORMAT "%5.1" /end CHARACTERISTIC
/begin CHARACTERISTIC MoFTrsmAssc_stLvl1ModeNeut_C "Parameter to evaluate gear status from level1 for NEUTRAL" VALUE 0x8026CF5D Val_Wu8 255.0 OneToOne 0.00 255.0 FORMAT "%5.1" /end CHARACTERISTIC
/begin CHARACTERISTIC MoFTrsmAssc_stLvl1ModePark_C "Parameter to evaluate gear status from level1 for PARK" VALUE 0x8026CF5E Val_Wu8 255.0 OneToOne 0.00 255.0 FORMAT "%5.1" /end CHARACTERISTIC
/begin CHARACTERISTIC MoFTrsmAssc_stLvl1ModeRvs_C "Parameter to evaluate gear status from level1 for reverse" VALUE 0x8026CF5F Val_Wu8 255.0 OneToOne 0.00 255.0 FORMAT "%5.1" /end CHARACTERISTIC
/begin CHARACTERISTIC MoFTrsmAssc_stSwtBrkSnsrSigSeln_C "Switch to select the evaluation logic of brake pressed without error" VALUE 0x8026CF60 Val_Wu8 255.0 OneToOne 0.00 255.0 FORMAT "%5.1" /end CHARACTERISTIC
/begin CHARACTERISTIC MoFTrsmAssc_vDrvRstThd_C "Vehicle speed threshold limit beyond which permitted gear state DRIVE is not safe" VALUE 0x8026FE9E Val_Ws16 655.3500 Vel -327.6800 327.6700 FORMAT "%8.4" /end CHARACTERISTIC
/begin CHARACTERISTIC MoFTrsmAssc_vDrvSwRstThd_C "Software threshold limit for safe vehicle speed range for Drive" VALUE 0x8026FEA0 Val_Ws16 655.3500 Vel -327.6800 327.6700 FORMAT "%8.4" /end CHARACTERISTIC
/begin CHARACTERISTIC MoFTrsmAssc_vDrvThd_C "Vehicle speed threshold limit to allow gear state transition to DRIVE" VALUE 0x8026FEA2 Val_Ws16 655.3500 Vel -327.6800 327.6700 FORMAT "%8.4" /end CHARACTERISTIC
/begin CHARACTERISTIC MoFTrsmAssc_vNeutThd_C "Vehicle speed threshold limit to allow gear state transition to NEUTRAL" VALUE 0x8026FEA4 Val_Ws16 655.3500 Vel -327.6800 327.6700 FORMAT "%8.4" /end CHARACTERISTIC
/begin CHARACTERISTIC MoFTrsmAssc_vRvsRstThd_C "Vehicle speed threshold limit beyond which permitted gear state REVERSE is not safe" VALUE 0x8026FEA6 Val_Ws16 655.3500 Vel -327.6800 327.6700 FORMAT "%8.4" /end CHARACTERISTIC
/begin CHARACTERISTIC MoFTrsmAssc_vRvsSwRstThd_C "Software threshold limit for safe vehicle speed range for Reverse" VALUE 0x8026FEA8 Val_Ws16 655.3500 Vel -327.6800 327.6700 FORMAT "%8.4" /end CHARACTERISTIC
/begin CHARACTERISTIC MoFTrsmAssc_vRvsThd_C "Vehicle speed threshold limit to allow gear state transition to REVERSE" VALUE 0x8026FEAA Val_Ws16 655.3500 Vel -327.6800 327.6700 FORMAT "%8.4" /end CHARACTERISTIC
/begin MEASUREMENT DFC_st.DFC_MoFTqPtdVeh "" UBYTE DFC_OneToOne 1 100 0.00 255.0 FORMAT "%5.1" ECU_ADDRESS 0x60034D5A /end MEASUREMENT
/begin MEASUREMENT DFC_st.DFC_MoFVarPostBldSel "" UBYTE DFC_OneToOne 1 100 0.00 255.0 FORMAT "%5.1" ECU_ADDRESS 0x60034D5B /end MEASUREMENT
/begin MEASUREMENT MoFTqPtdVehComp_bbLoc1Cpl "RAM data redundancy for MoFTqPtdVehComp_bbLoc1" UBYTE OneToOne 1 100 0.00 255.0 FORMAT "%5.1" ECU_ADDRESS 0x6002BB5F
 /begin IF_DATA XCPplus 0x0102
  /begin DAQ_EVENT VARIABLE /end DAQ_EVENT
 /end IF_DATA
/end MEASUREMENT
/begin MEASUREMENT MoFTqPtdVehComp_bbLoc2Cpl "RAM data redundancy for MoFTqPtdVehComp_bbLoc2" UBYTE OneToOne 1 100 0.00 255.0 FORMAT "%5.1" ECU_ADDRESS 0x6002BB5E
 /begin IF_DATA XCPplus 0x0102
  /begin DAQ_EVENT VARIABLE /end DAQ_EVENT
 /end IF_DATA
/end MEASUREMENT
/begin MEASUREMENT MoFTqPtdVehCoorn_bbLoc1Cpl "RAM data redundancy for MoFTqPtdVehCoorn_bbLoc1" UBYTE OneToOne 1 100 0.00 255.0 FORMAT "%5.1" ECU_ADDRESS 0x6002BB42
 /begin IF_DATA XCPplus 0x0102
  /begin DAQ_EVENT VARIABLE /end DAQ_EVENT
 /end IF_DATA
/end MEASUREMENT
/begin MEASUREMENT MoFTqPtdVehCoorn_bbOutCpl "complement variable" UBYTE OneToOne 1 100 0.00 255.0 FORMAT "%5.1" ECU_ADDRESS 0x6002BB41
 /begin IF_DATA XCPplus 0x0102
  /begin DAQ_EVENT VARIABLE /end DAQ_EVENT
 /end IF_DATA
/end MEASUREMENT
/begin MEASUREMENT MoFTqPtdVehDrvAwy_bbLoc1Cpl "Ram data redundancy for MoFTqPtdVehDrvAwy_bbloc1" UBYTE OneToOne 1 100 0.00 255.0 FORMAT "%5.1" ECU_ADDRESS 0x6002BAE8
 /begin IF_DATA XCPplus 0x0102
  /begin DAQ_EVENT VARIABLE /end DAQ_EVENT
 /end IF_DATA
/end MEASUREMENT
/begin MEASUREMENT MoFTqPtdVehDrvAwy_bbLoc2Cpl "Ram data redundancy for MoFTqPtdVehDrvAwy_bbloc2" UBYTE OneToOne 1 100 0.00 255.0 FORMAT "%5.1" ECU_ADDRESS 0x6002BAE7
 /begin IF_DATA XCPplus 0x0102
  /begin DAQ_EVENT VARIABLE /end DAQ_EVENT
 /end IF_DATA
/end MEASUREMENT
/begin MEASUREMENT MoFTqPtdVehDrvrDmd_bbLocCpl "RAM data redundancy for MoFTqPtdVehDrvrDmd_bbLoc" UBYTE OneToOne 1 100 0.00 255.0 FORMAT "%5.1" ECU_ADDRESS 0x6002BAC2
 /begin IF_DATA XCPplus 0x0102
  /begin DAQ_EVENT VARIABLE /end DAQ_EVENT
 /end IF_DATA
/end MEASUREMENT
/begin MEASUREMENT MoFTqPtdVehDrvrDmd_bbOutCpl "Complement of MoFTqPtdVehDrvrDmd_bbOut" UBYTE OneToOne 1 100 0.00 255.0 FORMAT "%5.1" ECU_ADDRESS 0x6002BAC1
 /begin IF_DATA XCPplus 0x0102
  /begin DAQ_EVENT VARIABLE /end DAQ_EVENT
 /end IF_DATA
/end MEASUREMENT
/begin MEASUREMENT MoFTqPtdVeh_aRecupOnePedlDrvg "Deceleration for reverse and drive mode" SWORD acc_q0p001 1 100 -32.76800 32.76700 FORMAT "%8.5" ECU_ADDRESS 0x6002C4CE
 /begin IF_DATA XCPplus 0x0102
  /begin DAQ_EVENT VARIABLE /end DAQ_EVENT
 /end IF_DATA
/end MEASUREMENT
/begin MEASUREMENT MoFTqPtdVeh_aRecupOnePedlDrvgCpl "RAM data redundancy for MoFTqPtdVeh_aRecupOnePedlDrvg" UWORD OneToOne 1 100 0.00 65535.00 FORMAT "%8.2" ECU_ADDRESS 0x6002BAB2
 /begin IF_DATA XCPplus 0x0102
  /begin DAQ_EVENT VARIABLE /end DAQ_EVENT
 /end IF_DATA
/end MEASUREMENT
/begin MEASUREMENT MoFTqPtdVeh_bbLoc1Cpl "RAM data redundancy for MoFTqPtdVeh_bbLoc1" UBYTE OneToOne 1 100 0.00 255.0 FORMAT "%5.1" ECU_ADDRESS 0x6002BA11
 /begin IF_DATA XCPplus 0x0102
  /begin DAQ_EVENT VARIABLE /end DAQ_EVENT
 /end IF_DATA
/end MEASUREMENT
/begin MEASUREMENT MoFTqPtdVeh_cntrDebCrpDsblRst "Disable creep control reset delay counter to function monitoring" UBYTE OneToOne 1 100 0.00 255.0 FORMAT "%5.1" ECU_ADDRESS 0x6002C502
 /begin IF_DATA XCPplus 0x0102
  /begin DAQ_EVENT VARIABLE /end DAQ_EVENT
 /end IF_DATA
/end MEASUREMENT
/begin MEASUREMENT MoFTqPtdVeh_cntrDebCrpDsblRstCpl "RAM data redundancy" UBYTE OneToOne 1 100 0.00 255.0 FORMAT "%5.1" ECU_ADDRESS 0x6002BAE6
 /begin IF_DATA XCPplus 0x0102
  /begin DAQ_EVENT VARIABLE /end DAQ_EVENT
 /end IF_DATA
/end MEASUREMENT
/begin MEASUREMENT MoFTqPtdVeh_cntrDebReqDiCrp "disable creep control request delay counter to functional level" UBYTE OneToOne 1 100 0.00 255.0 FORMAT "%5.1" ECU_ADDRESS 0x6002C501
 /begin IF_DATA XCPplus 0x0102
  /begin DAQ_EVENT VARIABLE /end DAQ_EVENT
 /end IF_DATA
/end MEASUREMENT
/begin MEASUREMENT MoFTqPtdVeh_cntrDebReqDiCrpCpl "RAM data redundancy" UBYTE OneToOne 1 100 0.00 255.0 FORMAT "%5.1" ECU_ADDRESS 0x6002BAE5
 /begin IF_DATA XCPplus 0x0102
  /begin DAQ_EVENT VARIABLE /end DAQ_EVENT
 /end IF_DATA
/end MEASUREMENT
/begin MEASUREMENT MoFTqPtdVeh_cntrDebSetDiCrpCtrl "allowed vehicle speed deviation delay counter for creep control" UWORD OneToOne 1 100 0.00 65535.00 FORMAT "%8.2" ECU_ADDRESS 0x6002C4E4
 /begin IF_DATA XCPplus 0x0102
  /begin DAQ_EVENT VARIABLE /end DAQ_EVENT
 /end IF_DATA
/end MEASUREMENT
/begin MEASUREMENT MoFTqPtdVeh_cntrDebSetDiCrpCtrlCpl "RAM data redundancy" UWORD OneToOne 1 100 0.00 65535.00 FORMAT "%8.2" ECU_ADDRESS 0x6002BAC8
 /begin IF_DATA XCPplus 0x0102
  /begin DAQ_EVENT VARIABLE /end DAQ_EVENT
 /end IF_DATA
/end MEASUREMENT
/begin MEASUREMENT MoFTqPtdVeh_cntrSwtDrvProgDly "Debounce counter for delay of transition of driver prrogram" UBYTE OneToOne 1 100 0.00 255.0 FORMAT "%5.1" ECU_ADDRESS 0x6002C4DD
 /begin IF_DATA XCPplus 0x0102
  /begin DAQ_EVENT VARIABLE /end DAQ_EVENT
 /end IF_DATA
/end MEASUREMENT
/begin MEASUREMENT MoFTqPtdVeh_cntrSwtDrvProgDlyCpl "RAM data redundancy for MoFTqPtdVeh_cntrSwtDrvProgDly" UBYTE OneToOne 1 100 0.00 255.0 FORMAT "%5.1" ECU_ADDRESS 0x6002BAC0
 /begin IF_DATA XCPplus 0x0102
  /begin DAQ_EVENT VARIABLE /end DAQ_EVENT
 /end IF_DATA
/end MEASUREMENT
/begin MEASUREMENT MoFTqPtdVeh_cntrTestComp "Diagnosis test counter to heal DFC_MoFTqPtdVeh" UBYTE OneToOne 1 100 0.00 255.0 FORMAT "%5.1" ECU_ADDRESS 0x600230F0
 /begin IF_DATA XCPplus 0x0102
  /begin DAQ_EVENT VARIABLE /end DAQ_EVENT
 /end IF_DATA
/end MEASUREMENT
/begin MEASUREMENT MoFTqPtdVeh_cntrTqComp "Debounce counter for torque comparison error on vehicle level" UBYTE OneToOne 1 100 0.00 255.0 FORMAT "%5.1" ECU_ADDRESS 0x6002C579
 /begin IF_DATA XCPplus 0x0102
  /begin DAQ_EVENT VARIABLE /end DAQ_EVENT
 /end IF_DATA
/end MEASUREMENT
/begin MEASUREMENT MoFTqPtdVeh_cntrTqCompCpl "RAM data redundancy for MoFTqPtdVeh_cntrTqComp" UBYTE OneToOne 1 100 0.00 255.0 FORMAT "%5.1" ECU_ADDRESS 0x6002BB5D
 /begin IF_DATA XCPplus 0x0102
  /begin DAQ_EVENT VARIABLE /end DAQ_EVENT
 /end IF_DATA
/end MEASUREMENT
/begin MEASUREMENT MoFTqPtdVeh_deAPPOld "Previous value of deviation of accelerator pedal position" SWORD PrcPerSec 1 100 -20000.00 19999.39 FORMAT "%8.2" ECU_ADDRESS 0x6002C424
 /begin IF_DATA XCPplus 0x0102
  /begin DAQ_EVENT VARIABLE /end DAQ_EVENT
 /end IF_DATA
/end MEASUREMENT
/begin MEASUREMENT MoFTqPtdVeh_deAPPOldCpl "Complement for previous value of deviation of accelerator pedal position" UWORD OneToOne 1 100 0.00 65535.00 FORMAT "%8.2" ECU_ADDRESS 0x6002BA08
 /begin IF_DATA XCPplus 0x0102
  /begin DAQ_EVENT VARIABLE /end DAQ_EVENT
 /end IF_DATA
/end MEASUREMENT
/begin MEASUREMENT MoFTqPtdVeh_deAPPRaw "Deviation of accelerator pedal position" SWORD PrcPerSec 1 100 -20000.00 19999.39 FORMAT "%8.2" ECU_ADDRESS 0x6002C422
 /begin IF_DATA XCPplus 0x0102
  /begin DAQ_EVENT VARIABLE /end DAQ_EVENT
 /end IF_DATA
/end MEASUREMENT
/begin MEASUREMENT MoFTqPtdVeh_deAPPRawCpl "Complement for deviation of accelerator pedal position" UWORD OneToOne 1 100 0.00 65535.00 FORMAT "%8.2" ECU_ADDRESS 0x6002BA06
 /begin IF_DATA XCPplus 0x0102
  /begin DAQ_EVENT VARIABLE /end DAQ_EVENT
 /end IF_DATA
/end MEASUREMENT
/begin MEASUREMENT MoFTqPtdVeh_dirRamp "Variable to indicate direction of ramp" SWORD OneToOne 1 100 -32768.00 32767.00 FORMAT "%8.2" ECU_ADDRESS 0x6002C514
 /begin IF_DATA XCPplus 0x0102
  /begin DAQ_EVENT VARIABLE /end DAQ_EVENT
 /end IF_DATA
/end MEASUREMENT
/begin MEASUREMENT MoFTqPtdVeh_dirRampCpl "Complement of Variable to indicate direction of ramp" UWORD OneToOne 1 100 0.00 65535.00 FORMAT "%8.2" ECU_ADDRESS 0x6002BAF8
 /begin IF_DATA XCPplus 0x0102
  /begin DAQ_EVENT VARIABLE /end DAQ_EVENT
 /end IF_DATA
/end MEASUREMENT
/begin MEASUREMENT MoFTqPtdVeh_facAppGrdt "Calculated factor value based on APP gradient" UBYTE fak_q0p01 1 100 0.00 2.550 FORMAT "%5.3" ECU_ADDRESS 0x6002C42C
 /begin IF_DATA XCPplus 0x0102
  /begin DAQ_EVENT VARIABLE /end DAQ_EVENT
 /end IF_DATA
/end MEASUREMENT
/begin MEASUREMENT MoFTqPtdVeh_facAppGrdtCpl "Complement of Calculated factor value based on APP gradient" UBYTE OneToOne 1 100 0.00 255.0 FORMAT "%5.1" ECU_ADDRESS 0x6002BA10
 /begin IF_DATA XCPplus 0x0102
  /begin DAQ_EVENT VARIABLE /end DAQ_EVENT
 /end IF_DATA
/end MEASUREMENT
/begin MEASUREMENT MoFTqPtdVeh_facDif "Muliplication factor step per calculation step" SWORD Fact1000 1 100 -32.76800 32.76700 FORMAT "%8.5" ECU_ADDRESS 0x6002C4CC
 /begin IF_DATA XCPplus 0x0102
  /begin DAQ_EVENT VARIABLE /end DAQ_EVENT
 /end IF_DATA
/end MEASUREMENT
/begin MEASUREMENT MoFTqPtdVeh_facDifCpl "RAM data redundancy for MoFTqPtdVeh_facDif" UWORD OneToOne 1 100 0.00 65535.00 FORMAT "%8.2" ECU_ADDRESS 0x6002BAB0
 /begin IF_DATA XCPplus 0x0102
  /begin DAQ_EVENT VARIABLE /end DAQ_EVENT
 /end IF_DATA
/end MEASUREMENT
/begin MEASUREMENT MoFTqPtdVeh_facRecupAppGrdt "Factor of recuperation from the gradient of deviation on accelerator pedal position" UBYTE fak_q0p01 1 100 0.00 2.550 FORMAT "%5.3" ECU_ADDRESS 0x6002C42B
 /begin IF_DATA XCPplus 0x0102
  /begin DAQ_EVENT VARIABLE /end DAQ_EVENT
 /end IF_DATA
/end MEASUREMENT
/begin MEASUREMENT MoFTqPtdVeh_facRecupAppGrdtCpl "complement for Factor of recuperation from the gradient of deviation on accelerator pedal position" UBYTE OneToOne 1 100 0.00 255.0 FORMAT "%5.1" ECU_ADDRESS 0x6002BA0F
 /begin IF_DATA XCPplus 0x0102
  /begin DAQ_EVENT VARIABLE /end DAQ_EVENT
 /end IF_DATA
/end MEASUREMENT
/begin MEASUREMENT MoFTqPtdVeh_facRecupAppGrdtRamp "Ramped down value of recuperation factor" UBYTE fak_q0p01 1 100 0.00 2.550 FORMAT "%5.3" ECU_ADDRESS 0x6002C42A
 /begin IF_DATA XCPplus 0x0102
  /begin DAQ_EVENT VARIABLE /end DAQ_EVENT
 /end IF_DATA
/end MEASUREMENT
/begin MEASUREMENT MoFTqPtdVeh_facRecupAppGrdtRampCpl "Complement of Ramped down value of recuperation factor" UBYTE OneToOne 1 100 0.00 255.0 FORMAT "%5.1" ECU_ADDRESS 0x6002BA0E
 /begin IF_DATA XCPplus 0x0102
  /begin DAQ_EVENT VARIABLE /end DAQ_EVENT
 /end IF_DATA
/end MEASUREMENT
/begin MEASUREMENT MoFTqPtdVeh_facRecupMod "Demanded recuperation factor depending on recuperation mode" UBYTE fak_q0p01 1 100 0.00 2.550 FORMAT "%5.3" ECU_ADDRESS 0x6002C429
 /begin IF_DATA XCPplus 0x0102
  /begin DAQ_EVENT VARIABLE /end DAQ_EVENT
 /end IF_DATA
/end MEASUREMENT
/begin MEASUREMENT MoFTqPtdVeh_facRecupModCpl "RAM data redundancy for MoFTqPtdVeh_facRecupMod" UBYTE OneToOne 1 100 0.00 255.0 FORMAT "%5.1" ECU_ADDRESS 0x6002BA0D
 /begin IF_DATA XCPplus 0x0102
  /begin DAQ_EVENT VARIABLE /end DAQ_EVENT
 /end IF_DATA
/end MEASUREMENT
/begin MEASUREMENT MoFTqPtdVeh_facRecupModLimd "Limited factor of recuperation lever" UBYTE fak_q0p01 1 100 0.00 2.550 FORMAT "%5.3" ECU_ADDRESS 0x6002C428
 /begin IF_DATA XCPplus 0x0102
  /begin DAQ_EVENT VARIABLE /end DAQ_EVENT
 /end IF_DATA
/end MEASUREMENT
/begin MEASUREMENT MoFTqPtdVeh_facRecupModLimdCpl "Complement for Limited factor of recuperation lever" UBYTE OneToOne 1 100 0.00 255.0 FORMAT "%5.1" ECU_ADDRESS 0x6002BA0C
 /begin IF_DATA XCPplus 0x0102
  /begin DAQ_EVENT VARIABLE /end DAQ_EVENT
 /end IF_DATA
/end MEASUREMENT
/begin MEASUREMENT MoFTqPtdVeh_facRecupOnePedlDrvg "Factor of recuperation on one pedal driving" UBYTE fak_q0p01 1 100 0.00 2.550 FORMAT "%5.3" ECU_ADDRESS 0x6002C426
 /begin IF_DATA XCPplus 0x0102
  /begin DAQ_EVENT VARIABLE /end DAQ_EVENT
 /end IF_DATA
/end MEASUREMENT
/begin MEASUREMENT MoFTqPtdVeh_facRecupOnePedlDrvgBas "Base value of recuperation factor" UBYTE fak_q0p01 1 100 0.00 2.550 FORMAT "%5.3" ECU_ADDRESS 0x6002C427
 /begin IF_DATA XCPplus 0x0102
  /begin DAQ_EVENT VARIABLE /end DAQ_EVENT
 /end IF_DATA
/end MEASUREMENT
/begin MEASUREMENT MoFTqPtdVeh_facRecupOnePedlDrvgBasCpl "Complement for Base value of recuperation factor" UBYTE OneToOne 1 100 0.00 255.0 FORMAT "%5.1" ECU_ADDRESS 0x6002BA0B
 /begin IF_DATA XCPplus 0x0102
  /begin DAQ_EVENT VARIABLE /end DAQ_EVENT
 /end IF_DATA
/end MEASUREMENT
/begin MEASUREMENT MoFTqPtdVeh_facRecupOnePedlDrvgCpl "Complement for Factor of recuperation on one pedal driving" UBYTE OneToOne 1 100 0.00 255.0 FORMAT "%5.1" ECU_ADDRESS 0x6002BA0A
 /begin IF_DATA XCPplus 0x0102
  /begin DAQ_EVENT VARIABLE /end DAQ_EVENT
 /end IF_DATA
/end MEASUREMENT
/begin MEASUREMENT MoFTqPtdVeh_facTranMap "Blendingfactor between the acceleration pedal maps at mode change" SWORD Fact1000 1 100 -32.76800 32.76700 FORMAT "%8.5" ECU_ADDRESS 0x6002C4CA
 /begin IF_DATA XCPplus 0x0102
  /begin DAQ_EVENT VARIABLE /end DAQ_EVENT
 /end IF_DATA
/end MEASUREMENT
/begin MEASUREMENT MoFTqPtdVeh_facTranMapCpl "RAM data redundancy for MoFTqPtdVeh_facTranMap" UWORD OneToOne 1 100 0.00 65535.00 FORMAT "%8.2" ECU_ADDRESS 0x6002BAAE
 /begin IF_DATA XCPplus 0x0102
  /begin DAQ_EVENT VARIABLE /end DAQ_EVENT
 /end IF_DATA
/end MEASUREMENT
/begin MEASUREMENT MoFTqPtdVeh_flgAccRampRqrd "Flag indicating whether ramping is required or not for Recuperation Factor" UBYTE B_TRUE 1 100 0.00 1.00000000000 BIT_MASK 0x1 FORMAT "%13.11" ECU_ADDRESS 0x6002C42D
 /begin IF_DATA XCPplus 0x0102
  /begin DAQ_EVENT VARIABLE /end DAQ_EVENT
 /end IF_DATA
/end MEASUREMENT
/begin MEASUREMENT MoFTqPtdVeh_flgAccrPsd "flag indicating acceleration pedal pressed in coordination" UBYTE B_TRUE 1 100 0.00 1.00000000000 BIT_MASK 0x1 FORMAT "%13.11" ECU_ADDRESS 0x6002C55E
 /begin IF_DATA XCPplus 0x0102
  /begin DAQ_EVENT VARIABLE /end DAQ_EVENT
 /end IF_DATA
/end MEASUREMENT
/begin MEASUREMENT MoFTqPtdVeh_flgAPPOvrd "Flag to indicate App override is status" UBYTE B_TRUE 1 100 0.00 1.00000000000 BIT_MASK 0x80 FORMAT "%13.11" ECU_ADDRESS 0x6002C55E
 /begin IF_DATA XCPplus 0x0102
  /begin DAQ_EVENT VARIABLE /end DAQ_EVENT
 /end IF_DATA
/end MEASUREMENT
/begin MEASUREMENT MoFTqPtdVeh_flgBrkgToZrActvdOld "Flag to indicate old value of braking to zero activated" UBYTE B_TRUE 1 100 0.00 1.00000000000 BIT_MASK 0x20 FORMAT "%13.11" ECU_ADDRESS 0x6002C55E
 /begin IF_DATA XCPplus 0x0102
  /begin DAQ_EVENT VARIABLE /end DAQ_EVENT
 /end IF_DATA
/end MEASUREMENT
/begin MEASUREMENT MoFTqPtdVeh_flgBrkgToZrEdgeFall "Flag to indicate falling edge of braking to zero activated" UBYTE B_TRUE 1 100 0.00 1.00000000000 BIT_MASK 0x40 FORMAT "%13.11" ECU_ADDRESS 0x6002C55E
 /begin IF_DATA XCPplus 0x0102
  /begin DAQ_EVENT VARIABLE /end DAQ_EVENT
 /end IF_DATA
/end MEASUREMENT
/begin MEASUREMENT MoFTqPtdVeh_flgBrkPsdOld "creep control delayed brake pressed condition" UBYTE B_TRUE 1 100 0.00 1.00000000000 BIT_MASK 0x80 FORMAT "%13.11" ECU_ADDRESS 0x6002C504
 /begin IF_DATA XCPplus 0x0102
  /begin DAQ_EVENT VARIABLE /end DAQ_EVENT
 /end IF_DATA
/end MEASUREMENT
/begin MEASUREMENT MoFTqPtdVeh_flgBrkSeln "Brake selection" UBYTE B_TRUE 1 100 0.00 1.00000000000 BIT_MASK 0x4 FORMAT "%13.11" ECU_ADDRESS 0x6002C503
 /begin IF_DATA XCPplus 0x0102
  /begin DAQ_EVENT VARIABLE /end DAQ_EVENT
 /end IF_DATA
/end MEASUREMENT
/begin MEASUREMENT MoFTqPtdVeh_flgClr "Condition clear FCM in function MoFTqPtdVeh_Comp" UBYTE B_TRUE 1 100 0.00 1.00000000000 BIT_MASK 0x1 FORMAT "%13.11" ECU_ADDRESS 0x70000117
 /begin IF_DATA XCPplus 0x0102
  /begin DAQ_EVENT VARIABLE /end DAQ_EVENT
 /end IF_DATA
/end MEASUREMENT
/begin MEASUREMENT MoFTqPtdVeh_flgDiCreepMsg "Flag indicating if creep control is inhibited by L2" UBYTE B_TRUE 1 100 0.00 1.00000000000 BIT_MASK 0x1 FORMAT "%13.11" ECU_ADDRESS 0x7000022A
 /begin IF_DATA XCPplus 0x0102
  /begin DAQ_EVENT VARIABLE /end DAQ_EVENT
 /end IF_DATA
/end MEASUREMENT
/begin MEASUREMENT MoFTqPtdVeh_flgDiCrp "creep contorl disable condition" UBYTE B_TRUE 1 100 0.00 1.00000000000 BIT_MASK 0x4 FORMAT "%13.11" ECU_ADDRESS 0x6002C504
 /begin IF_DATA XCPplus 0x0102
  /begin DAQ_EVENT VARIABLE /end DAQ_EVENT
 /end IF_DATA
/end MEASUREMENT
/begin MEASUREMENT MoFTqPtdVeh_flgDiCrpTmp "temporary creep control disable condition" UBYTE B_TRUE 1 100 0.00 1.00000000000 BIT_MASK 0x1 FORMAT "%13.11" ECU_ADDRESS 0x6002C503
 /begin IF_DATA XCPplus 0x0102
  /begin DAQ_EVENT VARIABLE /end DAQ_EVENT
 /end IF_DATA
/end MEASUREMENT
/begin MEASUREMENT MoFTqPtdVeh_flgDrvAwyGearLvrNeutOld "Old neutral gear position" UBYTE B_TRUE 1 100 0.00 1.00000000000 BIT_MASK 0x8 FORMAT "%13.11" ECU_ADDRESS 0x6002C503
 /begin IF_DATA XCPplus 0x0102
  /begin DAQ_EVENT VARIABLE /end DAQ_EVENT
 /end IF_DATA
/end MEASUREMENT
/begin MEASUREMENT MoFTqPtdVeh_flgDrvDmdHiPrio "Flag Drv Demand High Prio" UBYTE B_TRUE 1 100 0.00 1.00000000000 BIT_MASK 0x1 FORMAT "%13.11" ECU_ADDRESS 0x6002C55C
 /begin IF_DATA XCPplus 0x0102
  /begin DAQ_EVENT VARIABLE /end DAQ_EVENT
 /end IF_DATA
/end MEASUREMENT
/begin MEASUREMENT MoFTqPtdVeh_flgDrvProgActvOld "State: Gear lever in drive in previous cycle" UBYTE B_TRUE 1 100 0.00 1.00000000000 BIT_MASK 0x2 FORMAT "%13.11" ECU_ADDRESS 0x6002C4DE
 /begin IF_DATA XCPplus 0x0102
  /begin DAQ_EVENT VARIABLE /end DAQ_EVENT
 /end IF_DATA
/end MEASUREMENT
/begin MEASUREMENT MoFTqPtdVeh_flgDrvProgChgOld "State: Driver program changed in previous cycle" UBYTE B_TRUE 1 100 0.00 1.00000000000 BIT_MASK 0x4 FORMAT "%13.11" ECU_ADDRESS 0x6002C4DE
 /begin IF_DATA XCPplus 0x0102
  /begin DAQ_EVENT VARIABLE /end DAQ_EVENT
 /end IF_DATA
/end MEASUREMENT
/begin MEASUREMENT MoFTqPtdVeh_flgDrvrAsscisTar "Flag to indicate driver assistance is target for coordination" UBYTE B_TRUE 1 100 0.00 1.00000000000 BIT_MASK 0x2 FORMAT "%13.11" ECU_ADDRESS 0x6002C55E
 /begin IF_DATA XCPplus 0x0102
  /begin DAQ_EVENT VARIABLE /end DAQ_EVENT
 /end IF_DATA
/end MEASUREMENT
/begin MEASUREMENT MoFTqPtdVeh_flgDrvrAsscisTarOld "Old value of driver assistance is target status" UBYTE B_TRUE 1 100 0.00 1.00000000000 BIT_MASK 0x4 FORMAT "%13.11" ECU_ADDRESS 0x6002C55E
 /begin IF_DATA XCPplus 0x0102
  /begin DAQ_EVENT VARIABLE /end DAQ_EVENT
 /end IF_DATA
/end MEASUREMENT
/begin MEASUREMENT MoFTqPtdVeh_flgGearLvrDrvOld "creep control delayed gear lever drive condition" UBYTE B_TRUE 1 100 0.00 1.00000000000 BIT_MASK 0x8 FORMAT "%13.11" ECU_ADDRESS 0x6002C504
 /begin IF_DATA XCPplus 0x0102
  /begin DAQ_EVENT VARIABLE /end DAQ_EVENT
 /end IF_DATA
/end MEASUREMENT
/begin MEASUREMENT MoFTqPtdVeh_flgGearLvrRvsOld "creep control delayed gear lever reverse condition" UBYTE B_TRUE 1 100 0.00 1.00000000000 BIT_MASK 0x20 FORMAT "%13.11" ECU_ADDRESS 0x6002C504
 /begin IF_DATA XCPplus 0x0102
  /begin DAQ_EVENT VARIABLE /end DAQ_EVENT
 /end IF_DATA
/end MEASUREMENT
/begin MEASUREMENT MoFTqPtdVeh_flgHMICrpDisad "creep contorl human machine interface disable condition" UBYTE B_TRUE 1 100 0.00 1.00000000000 BIT_MASK 0x40 FORMAT "%13.11" ECU_ADDRESS 0x6002C504
 /begin IF_DATA XCPplus 0x0102
  /begin DAQ_EVENT VARIABLE /end DAQ_EVENT
 /end IF_DATA
/end MEASUREMENT
/begin MEASUREMENT MoFTqPtdVeh_flgIrrvErrMsg "Irreversible error status for torque error on vehicle level" UBYTE B_TRUE 1 100 0.00 1.00000000000 BIT_MASK 0x1 FORMAT "%13.11" ECU_ADDRESS 0x70000229
 /begin IF_DATA XCPplus 0x0102
  /begin DAQ_EVENT VARIABLE /end DAQ_EVENT
 /end IF_DATA
/end MEASUREMENT
/begin MEASUREMENT MoFTqPtdVeh_flgLwrLimExcd "Error flag: Undercut of permitted lower torque limit" UBYTE B_TRUE 1 100 0.00 1.00000000000 BIT_MASK 0x1 FORMAT "%13.11" ECU_ADDRESS 0x6002C57B
 /begin IF_DATA XCPplus 0x0102
  /begin DAQ_EVENT VARIABLE /end DAQ_EVENT
 /end IF_DATA
/end MEASUREMENT
/begin MEASUREMENT MoFTqPtdVeh_flgOnePedlDrvgNeutRampActv "OPD Neutral Gear Ramp status" UBYTE B_TRUE 1 100 0.00 1.00000000000 BIT_MASK 0x1 FORMAT "%13.11" ECU_ADDRESS 0x6002C4DC
 /begin IF_DATA XCPplus 0x0102
  /begin DAQ_EVENT VARIABLE /end DAQ_EVENT
 /end IF_DATA
/end MEASUREMENT
/begin MEASUREMENT MoFTqPtdVeh_flgOthTrqCompErr "Error flag for torque comparison errors of e-machine and axle level which considered at vehicle level" UBYTE B_TRUE 1 100 0.00 1.00000000000 BIT_MASK 0x1 FORMAT "%13.11" ECU_ADDRESS 0x6002C57A
 /begin IF_DATA XCPplus 0x0102
  /begin DAQ_EVENT VARIABLE /end DAQ_EVENT
 /end IF_DATA
/end MEASUREMENT
/begin MEASUREMENT MoFTqPtdVeh_flgPrpDrvrAsscActv "Propulsion Driver Assistance Active Flag" UBYTE B_TRUE 1 100 0.00 1.00000000000 BIT_MASK 0x2 FORMAT "%13.11" ECU_ADDRESS 0x6002C55C
 /begin IF_DATA XCPplus 0x0102
  /begin DAQ_EVENT VARIABLE /end DAQ_EVENT
 /end IF_DATA
/end MEASUREMENT
/begin MEASUREMENT MoFTqPtdVeh_flgReqDiCrp "creep contorl request condition" UBYTE B_TRUE 1 100 0.00 1.00000000000 BIT_MASK 0x10 FORMAT "%13.11" ECU_ADDRESS 0x6002C504
 /begin IF_DATA XCPplus 0x0102
  /begin DAQ_EVENT VARIABLE /end DAQ_EVENT
 /end IF_DATA
/end MEASUREMENT
/begin MEASUREMENT MoFTqPtdVeh_flgRstDiCrp "Creep control reactivation condition before delay" UBYTE B_TRUE 1 100 0.00 1.00000000000 BIT_MASK 0x2 FORMAT "%13.11" ECU_ADDRESS 0x6002C503
 /begin IF_DATA XCPplus 0x0102
  /begin DAQ_EVENT VARIABLE /end DAQ_EVENT
 /end IF_DATA
/end MEASUREMENT
/begin MEASUREMENT MoFTqPtdVeh_flgRstDiCrpCtrl "creep contorl reactivation condition" UBYTE B_TRUE 1 100 0.00 1.00000000000 BIT_MASK 0x1 FORMAT "%13.11" ECU_ADDRESS 0x6002C504
 /begin IF_DATA XCPplus 0x0102
  /begin DAQ_EVENT VARIABLE /end DAQ_EVENT
 /end IF_DATA
/end MEASUREMENT
/begin MEASUREMENT MoFTqPtdVeh_flgSetDiCrpCtrl "creep contorl deactivation condition" UBYTE B_TRUE 1 100 0.00 1.00000000000 BIT_MASK 0x2 FORMAT "%13.11" ECU_ADDRESS 0x6002C504
 /begin IF_DATA XCPplus 0x0102
  /begin DAQ_EVENT VARIABLE /end DAQ_EVENT
 /end IF_DATA
/end MEASUREMENT
/begin MEASUREMENT MoFTqPtdVeh_flgSwitch "flag indicating a switch of target torque for coordination" UBYTE B_TRUE 1 100 0.00 1.00000000000 BIT_MASK 0x8 FORMAT "%13.11" ECU_ADDRESS 0x6002C55E
 /begin IF_DATA XCPplus 0x0102
  /begin DAQ_EVENT VARIABLE /end DAQ_EVENT
 /end IF_DATA
/end MEASUREMENT
/begin MEASUREMENT MoFTqptdVeh_flgSwtDrvProgDly "State: delay of driver program switch" UBYTE B_TRUE 1 100 0.00 1.00000000000 BIT_MASK 0x1 FORMAT "%13.11" ECU_ADDRESS 0x6002C4DE
 /begin IF_DATA XCPplus 0x0102
  /begin DAQ_EVENT VARIABLE /end DAQ_EVENT
 /end IF_DATA
/end MEASUREMENT
/begin MEASUREMENT MoFTqPtdVeh_flgTarBlwCurrTq "flag indicating target torque for coordination is below last value of coordinated torque" UBYTE B_TRUE 1 100 0.00 1.00000000000 BIT_MASK 0x10 FORMAT "%13.11" ECU_ADDRESS 0x6002C55E
 /begin IF_DATA XCPplus 0x0102
  /begin DAQ_EVENT VARIABLE /end DAQ_EVENT
 /end IF_DATA
/end MEASUREMENT
/begin MEASUREMENT MoFTqPtdVeh_flgTestMsg "Bit test conditions for diagnosis of fault path DFC_MoFTqPtdVeh" UBYTE B_TRUE 1 100 0.00 1.00000000000 BIT_MASK 0x1 FORMAT "%13.11" ECU_ADDRESS 0x70000228
 /begin IF_DATA XCPplus 0x0102
  /begin DAQ_EVENT VARIABLE /end DAQ_EVENT
 /end IF_DATA
/end MEASUREMENT
/begin MEASUREMENT MoFTqPtdVeh_flgTqCompDeb "State: error debouncing in torque comparison on vehicle level active" UBYTE B_TRUE 1 100 0.00 1.00000000000 BIT_MASK 0x2 FORMAT "%13.11" ECU_ADDRESS 0x6002C57B
 /begin IF_DATA XCPplus 0x0102
  /begin DAQ_EVENT VARIABLE /end DAQ_EVENT
 /end IF_DATA
/end MEASUREMENT
/begin MEASUREMENT MoFTqPtdVeh_flgTqCompErr "Error flag: Error in torque comparison on vehicle level" UBYTE B_TRUE 1 100 0.00 1.00000000000 BIT_MASK 0x4 FORMAT "%13.11" ECU_ADDRESS 0x6002C57B
 /begin IF_DATA XCPplus 0x0102
  /begin DAQ_EVENT VARIABLE /end DAQ_EVENT
 /end IF_DATA
/end MEASUREMENT
/begin MEASUREMENT MoFTqPtdVeh_flgTqIntegDeb "State: error debouncing in torque integral check on vehicle level active" UBYTE B_TRUE 1 100 0.00 1.00000000000 BIT_MASK 0x8 FORMAT "%13.11" ECU_ADDRESS 0x6002C57B
 /begin IF_DATA XCPplus 0x0102
  /begin DAQ_EVENT VARIABLE /end DAQ_EVENT
 /end IF_DATA
/end MEASUREMENT
/begin MEASUREMENT MoFTqPtdVeh_flgTqIntegErr "Error flag: Error in torque integral check on vehicle level" UBYTE B_TRUE 1 100 0.00 1.00000000000 BIT_MASK 0x10 FORMAT "%13.11" ECU_ADDRESS 0x6002C57B
 /begin IF_DATA XCPplus 0x0102
  /begin DAQ_EVENT VARIABLE /end DAQ_EVENT
 /end IF_DATA
/end MEASUREMENT
/begin MEASUREMENT MoFTqPtdVeh_flgTqLimChkErr "Error flag: xceedance of permitted torque limit on vehicle level" UBYTE B_TRUE 1 100 0.00 1.00000000000 BIT_MASK 0x20 FORMAT "%13.11" ECU_ADDRESS 0x6002C57B
 /begin IF_DATA XCPplus 0x0102
  /begin DAQ_EVENT VARIABLE /end DAQ_EVENT
 /end IF_DATA
/end MEASUREMENT
/begin MEASUREMENT MoFTqPtdVeh_flgTqVehNeg "State: coordinated vehicle torque is negative" UBYTE B_TRUE 1 100 0.00 1.00000000000 BIT_MASK 0x40 FORMAT "%13.11" ECU_ADDRESS 0x6002C57B
 /begin IF_DATA XCPplus 0x0102
  /begin DAQ_EVENT VARIABLE /end DAQ_EVENT
 /end IF_DATA
/end MEASUREMENT
/begin MEASUREMENT MoFTqPtdVeh_flgUpLimExcd "Error flag: Exceedance of permitted upper torque limit" UBYTE B_TRUE 1 100 0.00 1.00000000000 BIT_MASK 0x80 FORMAT "%13.11" ECU_ADDRESS 0x6002C57B
 /begin IF_DATA XCPplus 0x0102
  /begin DAQ_EVENT VARIABLE /end DAQ_EVENT
 /end IF_DATA
/end MEASUREMENT
/begin MEASUREMENT MoFTqPtdVeh_FltLoFil1 "First PT1 Filter Low Part" UWORD OneToOne 1 100 0.00 65535.00 FORMAT "%8.2" ECU_ADDRESS 0x6002C512
 /begin IF_DATA XCPplus 0x0102
  /begin DAQ_EVENT VARIABLE /end DAQ_EVENT
 /end IF_DATA
/end MEASUREMENT
/begin MEASUREMENT MoFTqPtdVeh_FltLoFil1Cpl "RAM Data redundancy for MoFTqPtdVeh_FltLoFil1" UWORD OneToOne 1 100 0.00 65535.00 FORMAT "%8.2" ECU_ADDRESS 0x6002BAF6
 /begin IF_DATA XCPplus 0x0102
  /begin DAQ_EVENT VARIABLE /end DAQ_EVENT
 /end IF_DATA
/end MEASUREMENT
/begin MEASUREMENT MoFTqPtdVeh_FltLoFil2 "Second PT1 Filter Low Part" UWORD OneToOne 1 100 0.00 65535.00 FORMAT "%8.2" ECU_ADDRESS 0x6002C510
 /begin IF_DATA XCPplus 0x0102
  /begin DAQ_EVENT VARIABLE /end DAQ_EVENT
 /end IF_DATA
/end MEASUREMENT
/begin MEASUREMENT MoFTqPtdVeh_FltLoFil2Cpl "RAM Data redundancy for MoFTqPtdVeh_FltLoFil2" UWORD OneToOne 1 100 0.00 65535.00 FORMAT "%8.2" ECU_ADDRESS 0x6002BAF4
 /begin IF_DATA XCPplus 0x0102
  /begin DAQ_EVENT VARIABLE /end DAQ_EVENT
 /end IF_DATA
/end MEASUREMENT
/begin MEASUREMENT MoFTqPtdVeh_ratAccrOld "previous value of accelerator pedal position for gradient claculation" SWORD Prc 1 100 -400.0000 399.9878 FORMAT "%8.4" ECU_ADDRESS 0x6002C420
 /begin IF_DATA XCPplus 0x0102
  /begin DAQ_EVENT VARIABLE /end DAQ_EVENT
 /end IF_DATA
/end MEASUREMENT
/begin MEASUREMENT MoFTqPtdVeh_ratAccrOldCpl "Complement for previous value of accelerator pedal position for gradient claculation" UWORD OneToOne 1 100 0.00 65535.00 FORMAT "%8.2" ECU_ADDRESS 0x6002BA04
 /begin IF_DATA XCPplus 0x0102
  /begin DAQ_EVENT VARIABLE /end DAQ_EVENT
 /end IF_DATA
/end MEASUREMENT
/begin MEASUREMENT MoFTqPtdVeh_ratCoastGap "Applicable coasting gap" SWORD Prc 1 100 -400.0000 399.9878 FORMAT "%8.4" ECU_ADDRESS 0x6002C408
 /begin IF_DATA XCPplus 0x0102
  /begin DAQ_EVENT VARIABLE /end DAQ_EVENT
 /end IF_DATA
/end MEASUREMENT
/begin MEASUREMENT MoFTqPtdVeh_ratCoastGapCpl "Complement for Applicable coasting gap" UWORD OneToOne 1 100 0.00 65535.00 FORMAT "%8.2" ECU_ADDRESS 0x6002BA02
 /begin IF_DATA XCPplus 0x0102
  /begin DAQ_EVENT VARIABLE /end DAQ_EVENT
 /end IF_DATA
/end MEASUREMENT
/begin MEASUREMENT MoFTqPtdVeh_ratCoastGapLim "Limited coasting gap" SWORD Prc 1 100 -400.0000 399.9878 FORMAT "%8.4" ECU_ADDRESS 0x6002C41E
 /begin IF_DATA XCPplus 0x0102
  /begin DAQ_EVENT VARIABLE /end DAQ_EVENT
 /end IF_DATA
/end MEASUREMENT
/begin MEASUREMENT MoFTqPtdVeh_ratCoastGapLimCpl "Complement for limited coasting gap" UWORD OneToOne 1 100 0.00 65535.00 FORMAT "%8.2" ECU_ADDRESS 0x6002BA00
 /begin IF_DATA XCPplus 0x0102
  /begin DAQ_EVENT VARIABLE /end DAQ_EVENT
 /end IF_DATA
/end MEASUREMENT
/begin MEASUREMENT MoFTqPtdVeh_ratCoastGapPerStepMax "Maximal per step change in coasting gap" SWORD Prc 1 100 -400.0000 399.9878 FORMAT "%8.4" ECU_ADDRESS 0x6002C41C
 /begin IF_DATA XCPplus 0x0102
  /begin DAQ_EVENT VARIABLE /end DAQ_EVENT
 /end IF_DATA
/end MEASUREMENT
/begin MEASUREMENT MoFTqPtdVeh_ratCoastGapPerStepMaxCpl "Complement for maximal per step change in coasting gap" UWORD OneToOne 1 100 0.00 65535.00 FORMAT "%8.2" ECU_ADDRESS 0x6002B9FE
 /begin IF_DATA XCPplus 0x0102
  /begin DAQ_EVENT VARIABLE /end DAQ_EVENT
 /end IF_DATA
/end MEASUREMENT
/begin MEASUREMENT MoFTqPtdVeh_ratCoastGapUnlim "Coasting gap before limitation" SWORD Prc 1 100 -400.0000 399.9878 FORMAT "%8.4" ECU_ADDRESS 0x6002C41A
 /begin IF_DATA XCPplus 0x0102
  /begin DAQ_EVENT VARIABLE /end DAQ_EVENT
 /end IF_DATA
/end MEASUREMENT
/begin MEASUREMENT MoFTqPtdVeh_ratCoastGapUnlimCpl "Complement for Coasting gap before limitation" UWORD OneToOne 1 100 0.00 65535.00 FORMAT "%8.2" ECU_ADDRESS 0x6002B9FC
 /begin IF_DATA XCPplus 0x0102
  /begin DAQ_EVENT VARIABLE /end DAQ_EVENT
 /end IF_DATA
/end MEASUREMENT
/begin MEASUREMENT MoFTqPtdVeh_ratPrpOnePedlDrvg "Ratio of the propulsion on one pedal driving" SWORD Prc 1 100 -400.0000 399.9878 FORMAT "%8.4" ECU_ADDRESS 0x6002C406
 /begin IF_DATA XCPplus 0x0102
  /begin DAQ_EVENT VARIABLE /end DAQ_EVENT
 /end IF_DATA
/end MEASUREMENT
/begin MEASUREMENT MoFTqPtdVeh_ratPrpOnePedlDrvgCpl "Complement for Ratio of the propulsion on one pedal driving" UWORD OneToOne 1 100 0.00 65535.00 FORMAT "%8.2" ECU_ADDRESS 0x6002B9FA
 /begin IF_DATA XCPplus 0x0102
  /begin DAQ_EVENT VARIABLE /end DAQ_EVENT
 /end IF_DATA
/end MEASUREMENT
/begin MEASUREMENT MoFTqPtdVeh_ratPrpOnePedlDrvgLoc "Ratio of accelerator pedal" SWORD Prc 1 100 -400.0000 399.9878 FORMAT "%8.4" ECU_ADDRESS 0x6002C418
 /begin IF_DATA XCPplus 0x0102
  /begin DAQ_EVENT VARIABLE /end DAQ_EVENT
 /end IF_DATA
/end MEASUREMENT
/begin MEASUREMENT MoFTqPtdVeh_ratPrpOnePedlDrvgLocCpl "Complement of ratio of accelerator pedal position" UWORD OneToOne 1 100 0.00 65535.00 FORMAT "%8.2" ECU_ADDRESS 0x6002B9F8
 /begin IF_DATA XCPplus 0x0102
  /begin DAQ_EVENT VARIABLE /end DAQ_EVENT
 /end IF_DATA
/end MEASUREMENT
/begin MEASUREMENT MoFTqPtdVeh_ratRecupOnePedlDrvgStrt "Starting point of recuperation on one pedal driving" SWORD Prc 1 100 -400.0000 399.9878 FORMAT "%8.4" ECU_ADDRESS 0x6002C416
 /begin IF_DATA XCPplus 0x0102
  /begin DAQ_EVENT VARIABLE /end DAQ_EVENT
 /end IF_DATA
/end MEASUREMENT
/begin MEASUREMENT MoFTqPtdVeh_ratRecupOnePedlDrvgStrtCpl "Complement for Starting point of recuperation on one pedal driving" UWORD OneToOne 1 100 0.00 65535.00 FORMAT "%8.2" ECU_ADDRESS 0x6002B9F6
 /begin IF_DATA XCPplus 0x0102
  /begin DAQ_EVENT VARIABLE /end DAQ_EVENT
 /end IF_DATA
/end MEASUREMENT
/begin MEASUREMENT MoFTqPtdVeh_ratVirtZrPnt "Ratio of the virtual zero point" SWORD Prc 1 100 -400.0000 399.9878 FORMAT "%8.4" ECU_ADDRESS 0x6002C404
 /begin IF_DATA XCPplus 0x0102
  /begin DAQ_EVENT VARIABLE /end DAQ_EVENT
 /end IF_DATA
/end MEASUREMENT
/begin MEASUREMENT MoFTqPtdVeh_ratVirtZrPntCpl "Complement for Ratio of the virtual zero point" UWORD OneToOne 1 100 0.00 65535.00 FORMAT "%8.2" ECU_ADDRESS 0x6002B9F4
 /begin IF_DATA XCPplus 0x0102
  /begin DAQ_EVENT VARIABLE /end DAQ_EVENT
 /end IF_DATA
/end MEASUREMENT
/begin MEASUREMENT MoFTqPtdVeh_ratVirtZrPntLim "Limited virtual zero point" SWORD Prc 1 100 -400.0000 399.9878 FORMAT "%8.4" ECU_ADDRESS 0x6002C414
 /begin IF_DATA XCPplus 0x0102
  /begin DAQ_EVENT VARIABLE /end DAQ_EVENT
 /end IF_DATA
/end MEASUREMENT
/begin MEASUREMENT MoFTqPtdVeh_ratVirtZrPntLimCpl "Complement of limited virtual zero point" UWORD OneToOne 1 100 0.00 65535.00 FORMAT "%8.2" ECU_ADDRESS 0x6002B9F2
 /begin IF_DATA XCPplus 0x0102
  /begin DAQ_EVENT VARIABLE /end DAQ_EVENT
 /end IF_DATA
/end MEASUREMENT
/begin MEASUREMENT MoFTqPtdVeh_ratVirtZrPntPerStepDec "Per step decrement of virtual zero point" SWORD Prc 1 100 -400.0000 399.9878 FORMAT "%8.4" ECU_ADDRESS 0x6002C412
 /begin IF_DATA XCPplus 0x0102
  /begin DAQ_EVENT VARIABLE /end DAQ_EVENT
 /end IF_DATA
/end MEASUREMENT
/begin MEASUREMENT MoFTqPtdVeh_ratVirtZrPntPerStepDecCpl "Complement of per step decrement of virtual zero point" UWORD OneToOne 1 100 0.00 65535.00 FORMAT "%8.2" ECU_ADDRESS 0x6002B9F0
 /begin IF_DATA XCPplus 0x0102
  /begin DAQ_EVENT VARIABLE /end DAQ_EVENT
 /end IF_DATA
/end MEASUREMENT
/begin MEASUREMENT MoFTqPtdVeh_ratVirtZrPntPerStepInct "Per step increment of virtual zero point" SWORD Prc 1 100 -400.0000 399.9878 FORMAT "%8.4" ECU_ADDRESS 0x6002C410
 /begin IF_DATA XCPplus 0x0102
  /begin DAQ_EVENT VARIABLE /end DAQ_EVENT
 /end IF_DATA
/end MEASUREMENT
/begin MEASUREMENT MoFTqPtdVeh_ratVirtZrPntPerStepInctCpl "Complement of per step increment of virtual zero point" UWORD OneToOne 1 100 0.00 65535.00 FORMAT "%8.2" ECU_ADDRESS 0x6002B9EE
 /begin IF_DATA XCPplus 0x0102
  /begin DAQ_EVENT VARIABLE /end DAQ_EVENT
 /end IF_DATA
/end MEASUREMENT
/begin MEASUREMENT MoFTqPtdVeh_ratVirtZrPntUnlim "Virtual zero point ratio befor limitation" SWORD Prc 1 100 -400.0000 399.9878 FORMAT "%8.4" ECU_ADDRESS 0x6002C40E
 /begin IF_DATA XCPplus 0x0102
  /begin DAQ_EVENT VARIABLE /end DAQ_EVENT
 /end IF_DATA
/end MEASUREMENT
/begin MEASUREMENT MoFTqPtdVeh_ratVirtZrPntUnlimCpl "Complement for Virtual zero point ratio befor limitation" UWORD OneToOne 1 100 0.00 65535.00 FORMAT "%8.2" ECU_ADDRESS 0x6002B9EC
 /begin IF_DATA XCPplus 0x0102
  /begin DAQ_EVENT VARIABLE /end DAQ_EVENT
 /end IF_DATA
/end MEASUREMENT
/begin MEASUREMENT MoFTqPtdVeh_stDiCrp "creep contorl deactivation status" UBYTE OneToOne 1 100 0.00 255.0 FORMAT "%5.1" ECU_ADDRESS 0x6002C500
 /begin IF_DATA XCPplus 0x0102
  /begin DAQ_EVENT VARIABLE /end DAQ_EVENT
 /end IF_DATA
/end MEASUREMENT
/begin MEASUREMENT MoFTqPtdVeh_stDiCrpCpl "RAM data redundancy" UBYTE OneToOne 1 100 0.00 255.0 FORMAT "%5.1" ECU_ADDRESS 0x6002BAE4
 /begin IF_DATA XCPplus 0x0102
  /begin DAQ_EVENT VARIABLE /end DAQ_EVENT
 /end IF_DATA
/end MEASUREMENT
/begin MEASUREMENT MoFTqPtdVeh_stDrvProgDly "Current acitve driver program after delay" UWORD OneToOne 1 100 0.00 65535.00 FORMAT "%8.2" ECU_ADDRESS 0x6002C4C8
 /begin IF_DATA XCPplus 0x0102
  /begin DAQ_EVENT VARIABLE /end DAQ_EVENT
 /end IF_DATA
/end MEASUREMENT
/begin MEASUREMENT MoFTqPtdVeh_stDrvProgDlyCpl "RAM data redundancy for MoFTqPtdVeh_stDrvProgDly" UWORD OneToOne 1 100 0.00 65535.00 FORMAT "%8.2" ECU_ADDRESS 0x6002BAAC
 /begin IF_DATA XCPplus 0x0102
  /begin DAQ_EVENT VARIABLE /end DAQ_EVENT
 /end IF_DATA
/end MEASUREMENT
/begin MEASUREMENT MoFTqPtdVeh_stDrvProgDlyProtd "Drive Mode Previous request in ProtRAM" UWORD OneToOne 1 100 0.00 65535.00 FORMAT "%8.2" ECU_ADDRESS 0x600347C4
 /begin IF_DATA XCPplus 0x0102
  /begin DAQ_EVENT VARIABLE /end DAQ_EVENT
 /end IF_DATA
/end MEASUREMENT
/begin MEASUREMENT MoFTqPtdVeh_stDrvProgDlyProtdCpl "Compliment" UWORD OneToOne 1 100 0.00 65535.00 FORMAT "%8.2" ECU_ADDRESS 0x600347C2
 /begin IF_DATA XCPplus 0x0102
  /begin DAQ_EVENT VARIABLE /end DAQ_EVENT
 /end IF_DATA
/end MEASUREMENT
/begin MEASUREMENT MoFTqPtdVeh_stDrvProgPrev "Active driver program on previous cycle" UWORD OneToOne 1 100 0.00 65535.00 FORMAT "%8.2" ECU_ADDRESS 0x6002C4C6
 /begin IF_DATA XCPplus 0x0102
  /begin DAQ_EVENT VARIABLE /end DAQ_EVENT
 /end IF_DATA
/end MEASUREMENT
/begin MEASUREMENT MoFTqPtdVeh_stDrvProgPrevCpl "RAM data redundancy for MoFTqPtdVeh_stDrvProgPrev" UWORD OneToOne 1 100 0.00 65535.00 FORMAT "%8.2" ECU_ADDRESS 0x6002BAAA
 /begin IF_DATA XCPplus 0x0102
  /begin DAQ_EVENT VARIABLE /end DAQ_EVENT
 /end IF_DATA
/end MEASUREMENT
/begin MEASUREMENT MoFTqPtdVeh_stDrvProgReq "Drive program switch request status in function monitoring" UWORD OneToOne 1 100 0.00 65535.00 FORMAT "%8.2" ECU_ADDRESS 0x6002C4E0
 /begin IF_DATA XCPplus 0x0102
  /begin DAQ_EVENT VARIABLE /end DAQ_EVENT
 /end IF_DATA
/end MEASUREMENT
/begin MEASUREMENT MoFTqPtdVeh_stDrvProgReqCpl "RAM data redundancy for MoFTqPtdVeh_stDrvProgReq" UWORD OneToOne 1 100 0.00 65535.00 FORMAT "%8.2" ECU_ADDRESS 0x6002BAC4
 /begin IF_DATA XCPplus 0x0102
  /begin DAQ_EVENT VARIABLE /end DAQ_EVENT
 /end IF_DATA
/end MEASUREMENT
/begin MEASUREMENT MoFTqPtdVeh_stDrvProgReqLoc "Drive program mode" SWORD OneToOne 1 100 -32768.00 32767.00 FORMAT "%8.2" ECU_ADDRESS 0x6002C40C
 /begin IF_DATA XCPplus 0x0102
  /begin DAQ_EVENT VARIABLE /end DAQ_EVENT
 /end IF_DATA
/end MEASUREMENT
/begin MEASUREMENT MoFTqPtdVeh_stDrvProgReqLocCpl "Complement for drive program mode" UWORD OneToOne 1 100 0.00 65535.00 FORMAT "%8.2" ECU_ADDRESS 0x6002B9EA
 /begin IF_DATA XCPplus 0x0102
  /begin DAQ_EVENT VARIABLE /end DAQ_EVENT
 /end IF_DATA
/end MEASUREMENT
/begin MEASUREMENT MoFTqPtdVeh_stDrvProgReqMsg "Message to L1 - Drive Program Request status" UWORD OneToOne 1 100 0.00 65535.00 FORMAT "%8.2" ECU_ADDRESS 0x6001FA22
 /begin IF_DATA XCPplus 0x0102
  /begin DAQ_EVENT VARIABLE /end DAQ_EVENT
 /end IF_DATA
/end MEASUREMENT
/begin MEASUREMENT MoFTqPtdVeh_stDrvProgReqRecupLoc "Drive program mode during recuperation" SWORD OneToOne 1 100 -32768.00 32767.00 FORMAT "%8.2" ECU_ADDRESS 0x6002C4C4
 /begin IF_DATA XCPplus 0x0102
  /begin DAQ_EVENT VARIABLE /end DAQ_EVENT
 /end IF_DATA
/end MEASUREMENT
/begin MEASUREMENT MoFTqPtdVeh_stDrvProgReqRecupLocCpl "Complement of drive program mode during recuperation" UWORD OneToOne 1 100 0.00 65535.00 FORMAT "%8.2" ECU_ADDRESS 0x6002BAA8
 /begin IF_DATA XCPplus 0x0102
  /begin DAQ_EVENT VARIABLE /end DAQ_EVENT
 /end IF_DATA
/end MEASUREMENT
/begin MEASUREMENT MoFTqPtdVeh_stDrvProgTar "Target driver program after transition" UWORD OneToOne 1 100 0.00 65535.00 FORMAT "%8.2" ECU_ADDRESS 0x6002C4C2
 /begin IF_DATA XCPplus 0x0102
  /begin DAQ_EVENT VARIABLE /end DAQ_EVENT
 /end IF_DATA
/end MEASUREMENT
/begin MEASUREMENT MoFTqPtdVeh_stDrvProgTarCpl "RAM data redundancy for MoFTqPtdVeh_stDrvProgTar" UWORD OneToOne 1 100 0.00 65535.00 FORMAT "%8.2" ECU_ADDRESS 0x6002BAA6
 /begin IF_DATA XCPplus 0x0102
  /begin DAQ_EVENT VARIABLE /end DAQ_EVENT
 /end IF_DATA
/end MEASUREMENT
/begin MEASUREMENT MoFTqPtdVeh_stErrTqComp "error state of torque comparison on vehicle level" UBYTE OneToOne 1 100 0.00 255.0 FORMAT "%5.1" ECU_ADDRESS 0x6002C578
 /begin IF_DATA XCPplus 0x0102
  /begin DAQ_EVENT VARIABLE /end DAQ_EVENT
 /end IF_DATA
/end MEASUREMENT
/begin MEASUREMENT MoFTqPtdVeh_stErrTqCompCpl "RAM data redundancy for MoFTqPtdVeh_stErrTqComp" UBYTE OneToOne 1 100 0.00 255.0 FORMAT "%5.1" ECU_ADDRESS 0x6002BB5C
 /begin IF_DATA XCPplus 0x0102
  /begin DAQ_EVENT VARIABLE /end DAQ_EVENT
 /end IF_DATA
/end MEASUREMENT
/begin MEASUREMENT MoFTqPtdVeh_stRcptMsg "Message to L1 - status driver requested recuperation factor" UBYTE OneToOne 1 100 0.00 255.0 FORMAT "%5.1" ECU_ADDRESS 0x60023529
 /begin IF_DATA XCPplus 0x0102
  /begin DAQ_EVENT VARIABLE /end DAQ_EVENT
 /end IF_DATA
/end MEASUREMENT
/begin MEASUREMENT MoFTqPtdVeh_stRecupMod "Status of recuperation mode" UBYTE OneToOne 1 100 0.00 255.0 FORMAT "%5.1" ECU_ADDRESS 0x6002C4E2
 /begin IF_DATA XCPplus 0x0102
  /begin DAQ_EVENT VARIABLE /end DAQ_EVENT
 /end IF_DATA
/end MEASUREMENT
/begin MEASUREMENT MoFTqPtdVeh_stRecupModCpl "RAM data redundancy for MoFTqPtdVeh_stRecupMod" UBYTE OneToOne 1 100 0.00 255.0 FORMAT "%5.1" ECU_ADDRESS 0x6002BAC6
 /begin IF_DATA XCPplus 0x0102
  /begin DAQ_EVENT VARIABLE /end DAQ_EVENT
 /end IF_DATA
/end MEASUREMENT
/begin MEASUREMENT MoFTqPtdVeh_stRmpOn "status indicating ramping functionality is on in coordination" UBYTE OneToOne 1 100 0.00 255.0 FORMAT "%5.1" ECU_ADDRESS 0x6002C55D
 /begin IF_DATA XCPplus 0x0102
  /begin DAQ_EVENT VARIABLE /end DAQ_EVENT
 /end IF_DATA
/end MEASUREMENT
/begin MEASUREMENT MoFTqPtdVeh_stRmpOnCpl "complement of status indicating ramping functionality is on in coordination" UBYTE OneToOne 1 100 0.00 255.0 FORMAT "%5.1" ECU_ADDRESS 0x6002BB40
 /begin IF_DATA XCPplus 0x0102
  /begin DAQ_EVENT VARIABLE /end DAQ_EVENT
 /end IF_DATA
/end MEASUREMENT
/begin MEASUREMENT MoFTqPtdVeh_tiLpFil "time contant for low pass filter" UWORD zk10msxs_uw_b655p36 1 100 0.01000015 655.36000000 FORMAT "%12.8" ECU_ADDRESS 0x6002C50E
 /begin IF_DATA XCPplus 0x0102
  /begin DAQ_EVENT VARIABLE /end DAQ_EVENT
 /end IF_DATA
/end MEASUREMENT
/begin MEASUREMENT MoFTqPtdVeh_tiLpFilCpl "RAM Data redundancy for MoFTqPtdVeh_tiLpFil" UWORD OneToOne 1 100 0.00 65535.00 FORMAT "%8.2" ECU_ADDRESS 0x6002BAF2
 /begin IF_DATA XCPplus 0x0102
  /begin DAQ_EVENT VARIABLE /end DAQ_EVENT
 /end IF_DATA
/end MEASUREMENT
/begin MEASUREMENT MoFTqPtdVeh_tqAccrPedWhlDes "Driver desired torque in function monitoring" SLONG TrqPrpHigh 1 100 -214748364.800 214748364.700 FORMAT "%13.3" ECU_ADDRESS 0x6002C4D4
 /begin IF_DATA XCPplus 0x0102
  /begin DAQ_EVENT VARIABLE /end DAQ_EVENT
 /end IF_DATA
/end MEASUREMENT
/begin MEASUREMENT MoFTqPtdVeh_tqAccrPedWhlDesCpl "RAM data redundancy for MoFTqPtdVeh_tqAccrPedWhlDes" ULONG OneToOne 1 100 0.00 4294967295.00 FORMAT "%13.2" ECU_ADDRESS 0x6002BABC
 /begin IF_DATA XCPplus 0x0102
  /begin DAQ_EVENT VARIABLE /end DAQ_EVENT
 /end IF_DATA
/end MEASUREMENT
/begin MEASUREMENT MoFTqPtdVeh_tqCoordSeldWithRampTq "Selected torque by coordination including ramping functionality" SLONG TrqPrpHigh 1 100 -214748364.800 214748364.700 FORMAT "%13.3" ECU_ADDRESS 0x6002C558
 /begin IF_DATA XCPplus 0x0102
  /begin DAQ_EVENT VARIABLE /end DAQ_EVENT
 /end IF_DATA
/end MEASUREMENT
/begin MEASUREMENT MoFTqPtdVeh_tqCoordSeldWithRampTqCpl "Complement of selected Torque by coordination including ramping functionality" ULONG OneToOne 1 100 0.00 4294967295.00 FORMAT "%13.2" ECU_ADDRESS 0x6002BB3C
 /begin IF_DATA XCPplus 0x0102
  /begin DAQ_EVENT VARIABLE /end DAQ_EVENT
 /end IF_DATA
/end MEASUREMENT
/begin MEASUREMENT MoFTqPtdVeh_tqCoordSeldWithRampTqOld "Last value of torque coordination of driver assistance on vehicle level" SLONG TrqPrpHigh 1 100 -214748364.800 214748364.700 FORMAT "%13.3" ECU_ADDRESS 0x6002C554
 /begin IF_DATA XCPplus 0x0102
  /begin DAQ_EVENT VARIABLE /end DAQ_EVENT
 /end IF_DATA
/end MEASUREMENT
/begin MEASUREMENT MoFTqPtdVeh_tqCoordSeldWithRampTqOldCpl "Complement of last value of torque coordination of driver assistance on vehicle level" ULONG OneToOne 1 100 0.00 4294967295.00 FORMAT "%13.2" ECU_ADDRESS 0x6002BB38
 /begin IF_DATA XCPplus 0x0102
  /begin DAQ_EVENT VARIABLE /end DAQ_EVENT
 /end IF_DATA
/end MEASUREMENT
/begin MEASUREMENT MoFTqPtdVeh_tqCoordUnfildRamp "Unfiltered coordinated ramp torque" SLONG TrqPrpHigh 1 100 -214748364.800 214748364.700 FORMAT "%13.3" ECU_ADDRESS 0x6002C550
 /begin IF_DATA XCPplus 0x0102
  /begin DAQ_EVENT VARIABLE /end DAQ_EVENT
 /end IF_DATA
/end MEASUREMENT
/begin MEASUREMENT MoFTqPtdVeh_tqCoordUnfildRampCpl "Complement of unfiltered coordinated ramp torque" ULONG OneToOne 1 100 0.00 4294967295.00 FORMAT "%13.2" ECU_ADDRESS 0x6002BB34
 /begin IF_DATA XCPplus 0x0102
  /begin DAQ_EVENT VARIABLE /end DAQ_EVENT
 /end IF_DATA
/end MEASUREMENT
/begin MEASUREMENT MoFTqPtdVeh_tqDeltaZrCrss "Torque delta zero crossing" SWORD TrqPrp 1 100 -52428.80 52427.20 FORMAT "%8.2" ECU_ADDRESS 0x6002C430
 /begin IF_DATA XCPplus 0x0102
  /begin DAQ_EVENT VARIABLE /end DAQ_EVENT
 /end IF_DATA
/end MEASUREMENT
/begin MEASUREMENT MoFTqPtdVeh_tqDeltaZrCrssCpl "Complement of torque delta zero crossing" UWORD OneToOne 1 100 0.00 65535.00 FORMAT "%8.2" ECU_ADDRESS 0x6002BA14
 /begin IF_DATA XCPplus 0x0102
  /begin DAQ_EVENT VARIABLE /end DAQ_EVENT
 /end IF_DATA
/end MEASUREMENT
/begin MEASUREMENT MoFTqPtdVeh_tqDes "Desired unfiltered torque" SLONG TrqPrpHigh 1 100 -214748364.800 214748364.700 FORMAT "%13.3" ECU_ADDRESS 0x6002C51C
 /begin IF_DATA XCPplus 0x0102
  /begin DAQ_EVENT VARIABLE /end DAQ_EVENT
 /end IF_DATA
/end MEASUREMENT
/begin MEASUREMENT MoFTqPtdVeh_tqDesCpl "complement of Desired unfiltered torque" ULONG OneToOne 1 100 0.00 4294967295.00 FORMAT "%13.2" ECU_ADDRESS 0x6002BB30
 /begin IF_DATA XCPplus 0x0102
  /begin DAQ_EVENT VARIABLE /end DAQ_EVENT
 /end IF_DATA
/end MEASUREMENT
/begin MEASUREMENT MoFTqPtdVeh_tqDesLvl1NotPT2Fild "Non PT2 filttered limited Level 1 torque" SLONG TrqPrpHigh 1 100 -214748364.800 214748364.700 FORMAT "%13.3" ECU_ADDRESS 0x6002C4B0
 /begin IF_DATA XCPplus 0x0102
  /begin DAQ_EVENT VARIABLE /end DAQ_EVENT
 /end IF_DATA
/end MEASUREMENT
/begin MEASUREMENT MoFTqPtdVeh_tqDesLvl1NotPT2FildCpl "Complement of Non PT2 filttered limited Level 1 torque" ULONG OneToOne 1 100 0.00 4294967295.00 FORMAT "%13.2" ECU_ADDRESS 0x6002BA94
 /begin IF_DATA XCPplus 0x0102
  /begin DAQ_EVENT VARIABLE /end DAQ_EVENT
 /end IF_DATA
/end MEASUREMENT
/begin MEASUREMENT MoFTqPtdVeh_tqDesLvl2NotPT2Fild "Non PT2 filttered limited Level 2 torque" SLONG TrqPrpHigh 1 100 -214748364.800 214748364.700 FORMAT "%13.3" ECU_ADDRESS 0x6002C4AC
 /begin IF_DATA XCPplus 0x0102
  /begin DAQ_EVENT VARIABLE /end DAQ_EVENT
 /end IF_DATA
/end MEASUREMENT
/begin MEASUREMENT MoFTqPtdVeh_tqDesLvl2NotPT2FildCpl "Complement of Non PT2 filttered limited Level 2 torque" ULONG OneToOne 1 100 0.00 4294967295.00 FORMAT "%13.2" ECU_ADDRESS 0x6002BA90
 /begin IF_DATA XCPplus 0x0102
  /begin DAQ_EVENT VARIABLE /end DAQ_EVENT
 /end IF_DATA
/end MEASUREMENT
/begin MEASUREMENT MoFTqPtdVeh_tqDifMod "Torque difference between the requested and actual driver mode" SWORD TrqPrp 1 100 -52428.80 52427.20 FORMAT "%8.2" ECU_ADDRESS 0x6002C4C0
 /begin IF_DATA XCPplus 0x0102
  /begin DAQ_EVENT VARIABLE /end DAQ_EVENT
 /end IF_DATA
/end MEASUREMENT
/begin MEASUREMENT MoFTqPtdVeh_tqDifModCpl "RAM data redundancy for MoFTqPtdVeh_tqDifMod" UWORD OneToOne 1 100 0.00 65535.00 FORMAT "%8.2" ECU_ADDRESS 0x6002BAA4
 /begin IF_DATA XCPplus 0x0102
  /begin DAQ_EVENT VARIABLE /end DAQ_EVENT
 /end IF_DATA
/end MEASUREMENT
/begin MEASUREMENT MoFTqPtdVeh_tqDifVeh "Differnce between desired and permitted torque" SLONG TrqPrpHigh 1 100 -214748364.800 214748364.700 FORMAT "%13.3" ECU_ADDRESS 0x6002C574
 /begin IF_DATA XCPplus 0x0102
  /begin DAQ_EVENT VARIABLE /end DAQ_EVENT
 /end IF_DATA
/end MEASUREMENT
/begin MEASUREMENT MoFTqPtdVeh_tqDifVehCpl "RAM data redundancy for MoFTqPtdVeh_tqDifVeh" ULONG OneToOne 1 100 0.00 4294967295.00 FORMAT "%13.2" ECU_ADDRESS 0x6002BB58
 /begin IF_DATA XCPplus 0x0102
  /begin DAQ_EVENT VARIABLE /end DAQ_EVENT
 /end IF_DATA
/end MEASUREMENT
/begin MEASUREMENT MoFTqPtdVeh_tqDrvAwy "Drive away torque" SLONG TrqPrpHigh 1 100 -214748364.800 214748364.700 FORMAT "%13.3" ECU_ADDRESS 0x6002C4FC
 /begin IF_DATA XCPplus 0x0102
  /begin DAQ_EVENT VARIABLE /end DAQ_EVENT
 /end IF_DATA
/end MEASUREMENT
/begin MEASUREMENT MoFTqPtdVeh_tqDrvAwyCpl "Complement of Drive away torque" ULONG OneToOne 1 100 0.00 4294967295.00 FORMAT "%13.2" ECU_ADDRESS 0x6002BAE0
 /begin IF_DATA XCPplus 0x0102
  /begin DAQ_EVENT VARIABLE /end DAQ_EVENT
 /end IF_DATA
/end MEASUREMENT
/begin MEASUREMENT MoFTqPtdVeh_tqDrvAwyDes "Torque Drive Away in Monitoring" SLONG TrqPrpHigh 1 100 -214748364.800 214748364.700 FORMAT "%13.3" ECU_ADDRESS 0x6002C4E8
 /begin IF_DATA XCPplus 0x0102
  /begin DAQ_EVENT VARIABLE /end DAQ_EVENT
 /end IF_DATA
/end MEASUREMENT
/begin MEASUREMENT MoFTqPtdVeh_tqDrvAwyDesCpl "RAM data redundancy for MoFTqPtdVeh_tqDrvAwyDes" ULONG OneToOne 1 100 0.00 4294967295.00 FORMAT "%13.2" ECU_ADDRESS 0x6002BADC
 /begin IF_DATA XCPplus 0x0102
  /begin DAQ_EVENT VARIABLE /end DAQ_EVENT
 /end IF_DATA
/end MEASUREMENT
/begin MEASUREMENT MoFTqPtdVeh_tqDrvAwyDesOld "Old value of desired drive away torque" SLONG TrqPrpHigh 1 100 -214748364.800 214748364.700 FORMAT "%13.3" ECU_ADDRESS 0x6002C4F8
 /begin IF_DATA XCPplus 0x0102
  /begin DAQ_EVENT VARIABLE /end DAQ_EVENT
 /end IF_DATA
/end MEASUREMENT
/begin MEASUREMENT MoFTqPtdVeh_tqDrvAwyDesOldCpl "Complement of Old value of desired drive away torque" ULONG OneToOne 1 100 0.00 4294967295.00 FORMAT "%13.2" ECU_ADDRESS 0x6002BAD8
 /begin IF_DATA XCPplus 0x0102
  /begin DAQ_EVENT VARIABLE /end DAQ_EVENT
 /end IF_DATA
/end MEASUREMENT
/begin MEASUREMENT MoFTqPtdVeh_tqDrvAwyMax "Maximum permitted drive away torque" SLONG TrqPrpHigh 1 100 -214748364.800 214748364.700 FORMAT "%13.3" ECU_ADDRESS 0x6002C4F4
 /begin IF_DATA XCPplus 0x0102
  /begin DAQ_EVENT VARIABLE /end DAQ_EVENT
 /end IF_DATA
/end MEASUREMENT
/begin MEASUREMENT MoFTqPtdVeh_tqDrvAwyMaxCpl "RAM data redundancy for MoFTqPtdVeh_tqDrvAwyMax" ULONG OneToOne 1 100 0.00 4294967295.00 FORMAT "%13.2" ECU_ADDRESS 0x6002BAD4
 /begin IF_DATA XCPplus 0x0102
  /begin DAQ_EVENT VARIABLE /end DAQ_EVENT
 /end IF_DATA
/end MEASUREMENT
/begin MEASUREMENT MoFTqPtdVeh_tqDrvAwyRampd "Ramped Drive Away Torque" SLONG TrqPrpHigh 1 100 -214748364.800 214748364.700 FORMAT "%13.3" ECU_ADDRESS 0x6002C4F0
 /begin IF_DATA XCPplus 0x0102
  /begin DAQ_EVENT VARIABLE /end DAQ_EVENT
 /end IF_DATA
/end MEASUREMENT
/begin MEASUREMENT MoFTqPtdVeh_tqDrvAwyRampdCpl "Compliment" ULONG OneToOne 1 100 0.00 4294967295.00 FORMAT "%13.2" ECU_ADDRESS 0x6002BAD0
 /begin IF_DATA XCPplus 0x0102
  /begin DAQ_EVENT VARIABLE /end DAQ_EVENT
 /end IF_DATA
/end MEASUREMENT
/begin MEASUREMENT MoFTqPtdVeh_tqDrvAwyRampDwn "Drive way creep ramp down torque" SLONG TrqPrpHigh 1 100 -214748364.800 214748364.700 FORMAT "%13.3" ECU_ADDRESS 0x6002C4EC
 /begin IF_DATA XCPplus 0x0102
  /begin DAQ_EVENT VARIABLE /end DAQ_EVENT
 /end IF_DATA
/end MEASUREMENT
/begin MEASUREMENT MoFTqPtdVeh_tqDrvAwyRampDwnCpl "Compliment" ULONG OneToOne 1 100 0.00 4294967295.00 FORMAT "%13.2" ECU_ADDRESS 0x6002BACC
 /begin IF_DATA XCPplus 0x0102
  /begin DAQ_EVENT VARIABLE /end DAQ_EVENT
 /end IF_DATA
/end MEASUREMENT
/begin MEASUREMENT MoFTqPtdVeh_tqFilIn "Low resolution Vehicle desired torque before filtering." SWORD TrqPrp 1 100 -52428.80 52427.20 FORMAT "%8.2" ECU_ADDRESS 0x6002C50C
 /begin IF_DATA XCPplus 0x0102
  /begin DAQ_EVENT VARIABLE /end DAQ_EVENT
 /end IF_DATA
/end MEASUREMENT
/begin MEASUREMENT MoFTqPtdVeh_tqFilInCpl "RAM Data redundancy for MoFTqPtdVeh_tqFilIn" UWORD OneToOne 1 100 0.00 65535.00 FORMAT "%8.2" ECU_ADDRESS 0x6002BAF0
 /begin IF_DATA XCPplus 0x0102
  /begin DAQ_EVENT VARIABLE /end DAQ_EVENT
 /end IF_DATA
/end MEASUREMENT
/begin MEASUREMENT MoFTqPtdVeh_tqFltHiFil1 "Desired torque at vehicle level after passing through 1 low pass filter" SWORD TrqPrp 1 100 -52428.80 52427.20 FORMAT "%8.2" ECU_ADDRESS 0x6002C50A
 /begin IF_DATA XCPplus 0x0102
  /begin DAQ_EVENT VARIABLE /end DAQ_EVENT
 /end IF_DATA
/end MEASUREMENT
/begin MEASUREMENT MoFTqPtdVeh_tqFltHiFil1Cpl "RAM Data redundancy for MoFTqPtdVeh_tqFltHiFil1" UWORD OneToOne 1 100 0.00 65535.00 FORMAT "%8.2" ECU_ADDRESS 0x6002BAEE
 /begin IF_DATA XCPplus 0x0102
  /begin DAQ_EVENT VARIABLE /end DAQ_EVENT
 /end IF_DATA
/end MEASUREMENT
/begin MEASUREMENT MoFTqPtdVeh_tqFltHiFil2 "Desired torque at vehicle level after complete filtering" SWORD TrqPrp 1 100 -52428.80 52427.20 FORMAT "%8.2" ECU_ADDRESS 0x6002C508
 /begin IF_DATA XCPplus 0x0102
  /begin DAQ_EVENT VARIABLE /end DAQ_EVENT
 /end IF_DATA
/end MEASUREMENT
/begin MEASUREMENT MoFTqPtdVeh_tqFltHiFil2Cpl "RAM Data redundancy for MoFTqPtdVeh_tqFltHiFil2" UWORD OneToOne 1 100 0.00 65535.00 FORMAT "%8.2" ECU_ADDRESS 0x6002BAEC
 /begin IF_DATA XCPplus 0x0102
  /begin DAQ_EVENT VARIABLE /end DAQ_EVENT
 /end IF_DATA
/end MEASUREMENT
/begin MEASUREMENT MoFTqPtdVeh_tqGrdtLimSlopeNeg "maximum negative ramp gradient" SLONG TrqPrp 1 100 -3435973836.80 3435973835.20 FORMAT "%13.2" ECU_ADDRESS 0x6002C4A8
 /begin IF_DATA XCPplus 0x0102
  /begin DAQ_EVENT VARIABLE /end DAQ_EVENT
 /end IF_DATA
/end MEASUREMENT
/begin MEASUREMENT MoFTqPtdVeh_tqGrdtLimSlopeNegCpl "Complement of maximum negative ramp gradient" ULONG OneToOne 1 100 0.00 4294967295.00 FORMAT "%13.2" ECU_ADDRESS 0x6002BA8C
 /begin IF_DATA XCPplus 0x0102
  /begin DAQ_EVENT VARIABLE /end DAQ_EVENT
 /end IF_DATA
/end MEASUREMENT
/begin MEASUREMENT MoFTqPtdVeh_tqGrdtLimSlopePos "maximum positive ramp gradient" SLONG TrqPrp 1 100 -3435973836.80 3435973835.20 FORMAT "%13.2" ECU_ADDRESS 0x6002C4A4
 /begin IF_DATA XCPplus 0x0102
  /begin DAQ_EVENT VARIABLE /end DAQ_EVENT
 /end IF_DATA
/end MEASUREMENT
/begin MEASUREMENT MoFTqPtdVeh_tqGrdtLimSlopePosCpl "Complement of maximum positive ramp gradient" ULONG OneToOne 1 100 0.00 4294967295.00 FORMAT "%13.2" ECU_ADDRESS 0x6002BA88
 /begin IF_DATA XCPplus 0x0102
  /begin DAQ_EVENT VARIABLE /end DAQ_EVENT
 /end IF_DATA
/end MEASUREMENT
/begin MEASUREMENT MoFTqPtdVeh_tqGrdtMaxZrCrssBrkgZrNeg "maximum negative torque gradient for zero cross filter when braking to zero is activated." SLONG TrqPrp 1 100 -3435973836.80 3435973835.20 FORMAT "%13.2" ECU_ADDRESS 0x6002C4A0
 /begin IF_DATA XCPplus 0x0102
  /begin DAQ_EVENT VARIABLE /end DAQ_EVENT
 /end IF_DATA
/end MEASUREMENT
/begin MEASUREMENT MoFTqPtdVeh_tqGrdtMaxZrCrssBrkgZrNegCpl "complement of maximum negative torque gradient for zero cross filter when braking to zero is activated" ULONG OneToOne 1 100 0.00 4294967295.00 FORMAT "%13.2" ECU_ADDRESS 0x6002BA84
 /begin IF_DATA XCPplus 0x0102
  /begin DAQ_EVENT VARIABLE /end DAQ_EVENT
 /end IF_DATA
/end MEASUREMENT
/begin MEASUREMENT MoFTqPtdVeh_tqGrdtMaxZrCrssBrkgZrPos "maximum positive torque gradient for zero cross filter when braking to zero is activated" SLONG TrqPrp 1 100 -3435973836.80 3435973835.20 FORMAT "%13.2" ECU_ADDRESS 0x6002C49C
 /begin IF_DATA XCPplus 0x0102
  /begin DAQ_EVENT VARIABLE /end DAQ_EVENT
 /end IF_DATA
/end MEASUREMENT
/begin MEASUREMENT MoFTqPtdVeh_tqGrdtMaxZrCrssBrkgZrPosCpl "complement of maximum positive torque gradient for zero cross filter when braking to zero is activated" ULONG OneToOne 1 100 0.00 4294967295.00 FORMAT "%13.2" ECU_ADDRESS 0x6002BA80
 /begin IF_DATA XCPplus 0x0102
  /begin DAQ_EVENT VARIABLE /end DAQ_EVENT
 /end IF_DATA
/end MEASUREMENT
/begin MEASUREMENT MoFTqPtdVeh_tqGrdtMaxZrCrssNeg "maximum negative torque gradient for zero cross filter" SLONG TrqPrp 1 100 -3435973836.80 3435973835.20 FORMAT "%13.2" ECU_ADDRESS 0x6002C498
 /begin IF_DATA XCPplus 0x0102
  /begin DAQ_EVENT VARIABLE /end DAQ_EVENT
 /end IF_DATA
/end MEASUREMENT
/begin MEASUREMENT MoFTqPtdVeh_tqGrdtMaxZrCrssNegCpl "Complement of maximum negative torque gradient for zero cross filter" ULONG OneToOne 1 100 0.00 4294967295.00 FORMAT "%13.2" ECU_ADDRESS 0x6002BA7C
 /begin IF_DATA XCPplus 0x0102
  /begin DAQ_EVENT VARIABLE /end DAQ_EVENT
 /end IF_DATA
/end MEASUREMENT
/begin MEASUREMENT MoFTqPtdVeh_tqGrdtMaxZrCrssNegPrpDrvrAssc "Maximum negative torque gradient for zero cross filter when propulsive driver assistance is active" SLONG TrqPrp 1 100 -3435973836.80 3435973835.20 FORMAT "%13.2" ECU_ADDRESS 0x6002C494
 /begin IF_DATA XCPplus 0x0102
  /begin DAQ_EVENT VARIABLE /end DAQ_EVENT
 /end IF_DATA
/end MEASUREMENT
/begin MEASUREMENT MoFTqPtdVeh_tqGrdtMaxZrCrssNegPrpDrvrAsscCpl "Complement of Maximum negative torque gradient for zero cross filter when propulsive driver assistance is active" ULONG OneToOne 1 100 0.00 4294967295.00 FORMAT "%13.2" ECU_ADDRESS 0x6002BA78
 /begin IF_DATA XCPplus 0x0102
  /begin DAQ_EVENT VARIABLE /end DAQ_EVENT
 /end IF_DATA
/end MEASUREMENT
/begin MEASUREMENT MoFTqPtdVeh_tqGrdtMaxZrCrssPos "maximum positive torque gradient for zero cross filter" SLONG TrqPrp 1 100 -3435973836.80 3435973835.20 FORMAT "%13.2" ECU_ADDRESS 0x6002C490
 /begin IF_DATA XCPplus 0x0102
  /begin DAQ_EVENT VARIABLE /end DAQ_EVENT
 /end IF_DATA
/end MEASUREMENT
/begin MEASUREMENT MoFTqPtdVeh_tqGrdtMaxZrCrssPosCpl "Complement of maximum positive torque gradient for zero cross filter" ULONG OneToOne 1 100 0.00 4294967295.00 FORMAT "%13.2" ECU_ADDRESS 0x6002BA74
 /begin IF_DATA XCPplus 0x0102
  /begin DAQ_EVENT VARIABLE /end DAQ_EVENT
 /end IF_DATA
/end MEASUREMENT
/begin MEASUREMENT MoFTqPtdVeh_tqGrdtMaxZrCrssPosPrpDrvrAssc "Maximum positive torque gradient for zero cross filter when propulsive driver assistance is active" SLONG TrqPrp 1 100 -3435973836.80 3435973835.20 FORMAT "%13.2" ECU_ADDRESS 0x6002C48C
 /begin IF_DATA XCPplus 0x0102
  /begin DAQ_EVENT VARIABLE /end DAQ_EVENT
 /end IF_DATA
/end MEASUREMENT
/begin MEASUREMENT MoFTqPtdVeh_tqGrdtMaxZrCrssPosPrpDrvrAsscCpl "Complement of Maximum positive torque gradient for zero cross filter when propulsive driver assistance is active" ULONG OneToOne 1 100 0.00 4294967295.00 FORMAT "%13.2" ECU_ADDRESS 0x6002BA70
 /begin IF_DATA XCPplus 0x0102
  /begin DAQ_EVENT VARIABLE /end DAQ_EVENT
 /end IF_DATA
/end MEASUREMENT
/begin MEASUREMENT MoFTqPtdVeh_tqGrdtNeg "maximum negative gradient of torque ramp" SLONG RmpTrqPrpHigh 1 100 -3276800.00000 3276799.99847 FORMAT "%13.5" ECU_ADDRESS 0x6002C488
 /begin IF_DATA XCPplus 0x0102
  /begin DAQ_EVENT VARIABLE /end DAQ_EVENT
 /end IF_DATA
/end MEASUREMENT
/begin MEASUREMENT MoFTqPtdVeh_tqGrdtNegCpl "Ram redundancy data for MoFTqPtdVeh_tqGrdtNeg" ULONG OneToOne 1 100 0.00 4294967295.00 FORMAT "%13.2" ECU_ADDRESS 0x6002BA6C
 /begin IF_DATA XCPplus 0x0102
  /begin DAQ_EVENT VARIABLE /end DAQ_EVENT
 /end IF_DATA
/end MEASUREMENT
/begin MEASUREMENT MoFTqPtdVeh_tqGrdtNegMin "Minimum of Maximum Negative Torque gradient calculated from map and curve" SLONG TrqPrp 1 100 -3435973836.80 3435973835.20 FORMAT "%13.2" ECU_ADDRESS 0x6002C484
 /begin IF_DATA XCPplus 0x0102
  /begin DAQ_EVENT VARIABLE /end DAQ_EVENT
 /end IF_DATA
/end MEASUREMENT
/begin MEASUREMENT MoFTqPtdVeh_tqGrdtNegMinCpl "Complement of Minimum of Maximum Negative Torque gradient calculated from map and curve" ULONG OneToOne 1 100 0.00 4294967295.00 FORMAT "%13.2" ECU_ADDRESS 0x6002BA68
 /begin IF_DATA XCPplus 0x0102
  /begin DAQ_EVENT VARIABLE /end DAQ_EVENT
 /end IF_DATA
/end MEASUREMENT
/begin MEASUREMENT MoFTqPtdVeh_tqGrdtPos "maximum positive gradient of torque ramp" SLONG RmpTrqPrpHigh 1 100 -3276800.00000 3276799.99847 FORMAT "%13.5" ECU_ADDRESS 0x6002C480
 /begin IF_DATA XCPplus 0x0102
  /begin DAQ_EVENT VARIABLE /end DAQ_EVENT
 /end IF_DATA
/end MEASUREMENT
/begin MEASUREMENT MoFTqPtdVeh_tqGrdtPosCpl "Ram redundancy data for MoFTqPtdVeh_tqGrdtPos" ULONG OneToOne 1 100 0.00 4294967295.00 FORMAT "%13.2" ECU_ADDRESS 0x6002BA64
 /begin IF_DATA XCPplus 0x0102
  /begin DAQ_EVENT VARIABLE /end DAQ_EVENT
 /end IF_DATA
/end MEASUREMENT
/begin MEASUREMENT MoFTqPtdVeh_tqGrdtPosMin "Minimum of Maximum Positive Torque gradient calculated from map and curve" SLONG TrqPrp 1 100 -3435973836.80 3435973835.20 FORMAT "%13.2" ECU_ADDRESS 0x6002C47C
 /begin IF_DATA XCPplus 0x0102
  /begin DAQ_EVENT VARIABLE /end DAQ_EVENT
 /end IF_DATA
/end MEASUREMENT
/begin MEASUREMENT MoFTqPtdVeh_tqGrdtPosMinCpl "Complement of Minimum of Maximum Positive Torque gradient calculated from map and curve" ULONG OneToOne 1 100 0.00 4294967295.00 FORMAT "%13.2" ECU_ADDRESS 0x6002BA60
 /begin IF_DATA XCPplus 0x0102
  /begin DAQ_EVENT VARIABLE /end DAQ_EVENT
 /end IF_DATA
/end MEASUREMENT
/begin MEASUREMENT MoFTqPtdVeh_tqGrdtReaTar "Maximum positive torque gradient for zero cross filter selected from the curve." SLONG TrqPrp 1 100 -3435973836.80 3435973835.20 FORMAT "%13.2" ECU_ADDRESS 0x6002C478
 /begin IF_DATA XCPplus 0x0102
  /begin DAQ_EVENT VARIABLE /end DAQ_EVENT
 /end IF_DATA
/end MEASUREMENT
/begin MEASUREMENT MoFTqPtdVeh_tqGrdtReaTarBrkgZrNeg "maximum negative torque gradient for approximation to target value when braking to zero is activated." SLONG TrqPrp 1 100 -3435973836.80 3435973835.20 FORMAT "%13.2" ECU_ADDRESS 0x6002C474
 /begin IF_DATA XCPplus 0x0102
  /begin DAQ_EVENT VARIABLE /end DAQ_EVENT
 /end IF_DATA
/end MEASUREMENT
/begin MEASUREMENT MoFTqPtdVeh_tqGrdtReaTarBrkgZrNegCpl "complement of maximum negative torque gradient for approximation to target value when braking to zero is activated." ULONG OneToOne 1 100 0.00 4294967295.00 FORMAT "%13.2" ECU_ADDRESS 0x6002BA5C
 /begin IF_DATA XCPplus 0x0102
  /begin DAQ_EVENT VARIABLE /end DAQ_EVENT
 /end IF_DATA
/end MEASUREMENT
/begin MEASUREMENT MoFTqPtdVeh_tqGrdtReaTarBrkgZrPos "maximum positive torque gradient for approximation to target value when braking to zero is activated." SLONG TrqPrp 1 100 -3435973836.80 3435973835.20 FORMAT "%13.2" ECU_ADDRESS 0x6002C470
 /begin IF_DATA XCPplus 0x0102
  /begin DAQ_EVENT VARIABLE /end DAQ_EVENT
 /end IF_DATA
/end MEASUREMENT
/begin MEASUREMENT MoFTqPtdVeh_tqGrdtReaTarBrkgZrPosCpl "complement of maximum posititve torque gradient for approximation to target value when braking to zero is activated." ULONG OneToOne 1 100 0.00 4294967295.00 FORMAT "%13.2" ECU_ADDRESS 0x6002BA58
 /begin IF_DATA XCPplus 0x0102
  /begin DAQ_EVENT VARIABLE /end DAQ_EVENT
 /end IF_DATA
/end MEASUREMENT
/begin MEASUREMENT MoFTqPtdVeh_tqGrdtReaTarCpl "Complement of Maximum positive torque gradient for zero cross filter selected from the curve." ULONG OneToOne 1 100 0.00 4294967295.00 FORMAT "%13.2" ECU_ADDRESS 0x6002BA54
 /begin IF_DATA XCPplus 0x0102
  /begin DAQ_EVENT VARIABLE /end DAQ_EVENT
 /end IF_DATA
/end MEASUREMENT
/begin MEASUREMENT MoFTqPtdVeh_tqGrdtReaTarNeg "Maximum negative torque gradient for zero cross filter selected from curve." SLONG TrqPrp 1 100 -3435973836.80 3435973835.20 FORMAT "%13.2" ECU_ADDRESS 0x6002C46C
 /begin IF_DATA XCPplus 0x0102
  /begin DAQ_EVENT VARIABLE /end DAQ_EVENT
 /end IF_DATA
/end MEASUREMENT
/begin MEASUREMENT MoFTqPtdVeh_tqGrdtReaTarNegCpl "Complement of Maximum negative torque gradient for zero cross filter selected from curve." ULONG OneToOne 1 100 0.00 4294967295.00 FORMAT "%13.2" ECU_ADDRESS 0x6002BA50
 /begin IF_DATA XCPplus 0x0102
  /begin DAQ_EVENT VARIABLE /end DAQ_EVENT
 /end IF_DATA
/end MEASUREMENT
/begin MEASUREMENT MoFTqPtdVeh_tqGrdtReaTarPrpDrvrAsscNeg "Negative torque gradient reached target value when propulsive driver assistance is active" SLONG TrqPrp 1 100 -3435973836.80 3435973835.20 FORMAT "%13.2" ECU_ADDRESS 0x6002C468
 /begin IF_DATA XCPplus 0x0102
  /begin DAQ_EVENT VARIABLE /end DAQ_EVENT
 /end IF_DATA
/end MEASUREMENT
/begin MEASUREMENT MoFTqPtdVeh_tqGrdtReaTarPrpDrvrAsscNegCpl "Complement of Negative torque gradient reached target value when propulsive driver assistance is active" ULONG OneToOne 1 100 0.00 4294967295.00 FORMAT "%13.2" ECU_ADDRESS 0x6002BA4C
 /begin IF_DATA XCPplus 0x0102
  /begin DAQ_EVENT VARIABLE /end DAQ_EVENT
 /end IF_DATA
/end MEASUREMENT
/begin MEASUREMENT MoFTqPtdVeh_tqGrdtReaTarPrpDrvrAsscPos "Positive torque gradient reached target value when propulsive driver assistance is active" SLONG TrqPrp 1 100 -3435973836.80 3435973835.20 FORMAT "%13.2" ECU_ADDRESS 0x6002C464
 /begin IF_DATA XCPplus 0x0102
  /begin DAQ_EVENT VARIABLE /end DAQ_EVENT
 /end IF_DATA
/end MEASUREMENT
/begin MEASUREMENT MoFTqPtdVeh_tqGrdtReaTarPrpDrvrAsscPosCpl "Complement of Positive torque gradient reached target value when propulsive driver assistance is active" ULONG OneToOne 1 100 0.00 4294967295.00 FORMAT "%13.2" ECU_ADDRESS 0x6002BA48
 /begin IF_DATA XCPplus 0x0102
  /begin DAQ_EVENT VARIABLE /end DAQ_EVENT
 /end IF_DATA
/end MEASUREMENT
/begin MEASUREMENT MoFTqPtdVeh_tqHillHldRamp "Braking to zero hill hold ramp torque" SLONG TrqPrpHigh 1 100 -214748364.800 214748364.700 FORMAT "%13.3" ECU_ADDRESS 0x6002C54C
 /begin IF_DATA XCPplus 0x0102
  /begin DAQ_EVENT VARIABLE /end DAQ_EVENT
 /end IF_DATA
/end MEASUREMENT
/begin MEASUREMENT MoFTqPtdVeh_tqHillHldRampCpl "Complement of Braking to zero hill hold ramp torque" ULONG OneToOne 1 100 0.00 4294967295.00 FORMAT "%13.2" ECU_ADDRESS 0x6002BB2C
 /begin IF_DATA XCPplus 0x0102
  /begin DAQ_EVENT VARIABLE /end DAQ_EVENT
 /end IF_DATA
/end MEASUREMENT
/begin MEASUREMENT MoFTqPtdVeh_tqHillHldRampLvl1 "E-braking to zero Hill hold ramp level1" SLONG TrqPrpHigh 1 100 -214748364.800 214748364.700 FORMAT "%13.3" ECU_ADDRESS 0x6002C548
 /begin IF_DATA XCPplus 0x0102
  /begin DAQ_EVENT VARIABLE /end DAQ_EVENT
 /end IF_DATA
/end MEASUREMENT
/begin MEASUREMENT MoFTqPtdVeh_tqHillHldRampLvl1Cpl "Complement of E-braking to zero Hill hold ramp level1" ULONG OneToOne 1 100 0.00 4294967295.00 FORMAT "%13.2" ECU_ADDRESS 0x6002BB28
 /begin IF_DATA XCPplus 0x0102
  /begin DAQ_EVENT VARIABLE /end DAQ_EVENT
 /end IF_DATA
/end MEASUREMENT
/begin MEASUREMENT MoFTqPtdVeh_tqHillHldRampLvl1Lmtd "Limited hillhold ramp torque" SLONG TrqPrpHigh 1 100 -214748364.800 214748364.700 FORMAT "%13.3" ECU_ADDRESS 0x6002C544
 /begin IF_DATA XCPplus 0x0102
  /begin DAQ_EVENT VARIABLE /end DAQ_EVENT
 /end IF_DATA
/end MEASUREMENT
/begin MEASUREMENT MoFTqPtdVeh_tqHillHldRampLvl1LmtdCpl "Complement of Limited hillhold ramp torque" ULONG OneToOne 1 100 0.00 4294967295.00 FORMAT "%13.2" ECU_ADDRESS 0x6002BB24
 /begin IF_DATA XCPplus 0x0102
  /begin DAQ_EVENT VARIABLE /end DAQ_EVENT
 /end IF_DATA
/end MEASUREMENT
/begin MEASUREMENT MoFTqPtdVeh_tqHiResRampOut "output of the ramp that switches to 0 in case of regeneration prohibition" SLONG TrqPrpHigh 1 100 -214748364.800 214748364.700 FORMAT "%13.3" ECU_ADDRESS 0x6002C460
 /begin IF_DATA XCPplus 0x0102
  /begin DAQ_EVENT VARIABLE /end DAQ_EVENT
 /end IF_DATA
/end MEASUREMENT
/begin MEASUREMENT MoFTqPtdVeh_tqHiResRampOutCpl "complement: output of the ramp that switches to 0 in case of regeneration prohibition" ULONG OneToOne 1 100 0.00 4294967295.00 FORMAT "%13.2" ECU_ADDRESS 0x6002BA44
 /begin IF_DATA XCPplus 0x0102
  /begin DAQ_EVENT VARIABLE /end DAQ_EVENT
 /end IF_DATA
/end MEASUREMENT
/begin MEASUREMENT MoFTqPtdVeh_tqLowrLim "Lower limit of permitted torque on vehicle level in function monitoring" SLONG TrqPrpHigh 1 100 -214748364.800 214748364.700 FORMAT "%13.3" ECU_ADDRESS 0x6002C570
 /begin IF_DATA XCPplus 0x0102
  /begin DAQ_EVENT VARIABLE /end DAQ_EVENT
 /end IF_DATA
/end MEASUREMENT
/begin MEASUREMENT MoFTqPtdVeh_tqLowrLimCpl "RAM data redundancy for MoFTqPtdVeh_tqLowrLim" ULONG OneToOne 1 100 0.00 4294967295.00 FORMAT "%13.2" ECU_ADDRESS 0x6002BB54
 /begin IF_DATA XCPplus 0x0102
  /begin DAQ_EVENT VARIABLE /end DAQ_EVENT
 /end IF_DATA
/end MEASUREMENT
/begin MEASUREMENT MoFTqPtdVeh_tqLvl1ZrCrssFild "One raster delayed signal of VehDrvEv_tqZrCrssFild" SLONG TrqPrpHigh 1 100 -214748364.800 214748364.700 FORMAT "%13.3" ECU_ADDRESS 0x6002C45C
 /begin IF_DATA XCPplus 0x0102
  /begin DAQ_EVENT VARIABLE /end DAQ_EVENT
 /end IF_DATA
/end MEASUREMENT
/begin MEASUREMENT MoFTqPtdVeh_tqLvl1ZrCrssFildCpl "Complement of one raster delayed signal of VehDrvEv_tqZrCrssFild" ULONG OneToOne 1 100 0.00 4294967295.00 FORMAT "%13.2" ECU_ADDRESS 0x6002BA40
 /begin IF_DATA XCPplus 0x0102
  /begin DAQ_EVENT VARIABLE /end DAQ_EVENT
 /end IF_DATA
/end MEASUREMENT
/begin MEASUREMENT MoFTqPtdVeh_tqMaxRecupOnePedlDrvg "Maximum recuperation torque for one pedal driving" SWORD TrqPrp 1 100 -52428.80 52427.20 FORMAT "%8.2" ECU_ADDRESS 0x6002C4BE
 /begin IF_DATA XCPplus 0x0102
  /begin DAQ_EVENT VARIABLE /end DAQ_EVENT
 /end IF_DATA
/end MEASUREMENT
/begin MEASUREMENT MoFTqPtdVeh_tqMaxRecupOnePedlDrvgCpl "Complement of MoFTqPtdVeh_tqMaxRecupOnePedlDrvg" UWORD OneToOne 1 100 0.00 65535.00 FORMAT "%8.2" ECU_ADDRESS 0x6002BAA2
 /begin IF_DATA XCPplus 0x0102
  /begin DAQ_EVENT VARIABLE /end DAQ_EVENT
 /end IF_DATA
/end MEASUREMENT
/begin MEASUREMENT MoFTqPtdVeh_tqNrm "Normalised torque" SWORD TrqPrp 1 100 -52428.80 52427.20 FORMAT "%8.2" ECU_ADDRESS 0x6002C42E
 /begin IF_DATA XCPplus 0x0102
  /begin DAQ_EVENT VARIABLE /end DAQ_EVENT
 /end IF_DATA
/end MEASUREMENT
/begin MEASUREMENT MoFTqPtdVeh_tqNrmCpl "Complement of Normalised torque" UWORD OneToOne 1 100 0.00 65535.00 FORMAT "%8.2" ECU_ADDRESS 0x6002BA12
 /begin IF_DATA XCPplus 0x0102
  /begin DAQ_EVENT VARIABLE /end DAQ_EVENT
 /end IF_DATA
/end MEASUREMENT
/begin MEASUREMENT MoFTqPtdVeh_tqPrp "Actual propulsion torque" SWORD TrqPrp 1 100 -52428.80 52427.20 FORMAT "%8.2" ECU_ADDRESS 0x6002C4BC
 /begin IF_DATA XCPplus 0x0102
  /begin DAQ_EVENT VARIABLE /end DAQ_EVENT
 /end IF_DATA
/end MEASUREMENT
/begin MEASUREMENT MoFTqPtdVeh_tqPrpCpl "RAM data redundancy for MoFTqPtdVeh_tqPrp" UWORD OneToOne 1 100 0.00 65535.00 FORMAT "%8.2" ECU_ADDRESS 0x6002BAA0
 /begin IF_DATA XCPplus 0x0102
  /begin DAQ_EVENT VARIABLE /end DAQ_EVENT
 /end IF_DATA
/end MEASUREMENT
/begin MEASUREMENT MoFTqPtdVeh_tqPrpPrevMod "Propulsion torque of previous mode during mode switch" SWORD TrqPrp 1 100 -52428.80 52427.20 FORMAT "%8.2" ECU_ADDRESS 0x6002C4BA
 /begin IF_DATA XCPplus 0x0102
  /begin DAQ_EVENT VARIABLE /end DAQ_EVENT
 /end IF_DATA
/end MEASUREMENT
/begin MEASUREMENT MoFTqPtdVeh_tqPrpPrevModCpl "RAM data redundancy for MoFTqPtdVeh_tqPrpPrevMod" UWORD OneToOne 1 100 0.00 65535.00 FORMAT "%8.2" ECU_ADDRESS 0x6002BA9E
 /begin IF_DATA XCPplus 0x0102
  /begin DAQ_EVENT VARIABLE /end DAQ_EVENT
 /end IF_DATA
/end MEASUREMENT
/begin MEASUREMENT MoFTqPtdVeh_tqRampCrsCtrlLowrLim "lower limit for ramping functionality in coordination" SLONG TrqPrpHigh 1 100 -214748364.800 214748364.700 FORMAT "%13.3" ECU_ADDRESS 0x6002C540
 /begin IF_DATA XCPplus 0x0102
  /begin DAQ_EVENT VARIABLE /end DAQ_EVENT
 /end IF_DATA
/end MEASUREMENT
/begin MEASUREMENT MoFTqPtdVeh_tqRampCrsCtrlLowrLimCpl "complement of lower limit for ramping functionality in coordination" ULONG OneToOne 1 100 0.00 4294967295.00 FORMAT "%13.2" ECU_ADDRESS 0x6002BB20
 /begin IF_DATA XCPplus 0x0102
  /begin DAQ_EVENT VARIABLE /end DAQ_EVENT
 /end IF_DATA
/end MEASUREMENT
/begin MEASUREMENT MoFTqPtdVeh_tqRampCrsCtrlUpLim "upper limit for ramping functionality in coordination" SLONG TrqPrpHigh 1 100 -214748364.800 214748364.700 FORMAT "%13.3" ECU_ADDRESS 0x6002C53C
 /begin IF_DATA XCPplus 0x0102
  /begin DAQ_EVENT VARIABLE /end DAQ_EVENT
 /end IF_DATA
/end MEASUREMENT
/begin MEASUREMENT MoFTqPtdVeh_tqRampCrsCtrlUpLimCpl "complement of upper limit for ramping functionality in coordination" ULONG OneToOne 1 100 0.00 4294967295.00 FORMAT "%13.2" ECU_ADDRESS 0x6002BB1C
 /begin IF_DATA XCPplus 0x0102
  /begin DAQ_EVENT VARIABLE /end DAQ_EVENT
 /end IF_DATA
/end MEASUREMENT
/begin MEASUREMENT MoFTqPtdVeh_tqRecup "Recuperation torque" SLONG TrqPrp 1 100 -3435973836.80 3435973835.20 FORMAT "%13.2" ECU_ADDRESS 0x6002C4D8
 /begin IF_DATA XCPplus 0x0102
  /begin DAQ_EVENT VARIABLE /end DAQ_EVENT
 /end IF_DATA
/end MEASUREMENT
/begin MEASUREMENT MoFTqPtdVeh_tqRecupCpl "Complement of recuperation torque" ULONG OneToOne 1 100 0.00 4294967295.00 FORMAT "%13.2" ECU_ADDRESS 0x6002BAB8
 /begin IF_DATA XCPplus 0x0102
  /begin DAQ_EVENT VARIABLE /end DAQ_EVENT
 /end IF_DATA
/end MEASUREMENT
/begin MEASUREMENT MoFTqPtdVeh_tqRecupOnePedlDrvg "Actual recuperation torque" SWORD TrqPrp 1 100 -52428.80 52427.20 FORMAT "%8.2" ECU_ADDRESS 0x6002C4B8
 /begin IF_DATA XCPplus 0x0102
  /begin DAQ_EVENT VARIABLE /end DAQ_EVENT
 /end IF_DATA
/end MEASUREMENT
/begin MEASUREMENT MoFTqPtdVeh_tqRecupOnePedlDrvgCpl "RAM data redundancy for MoFTqPtdVeh_tqRecupOnePedlDrvg" UWORD OneToOne 1 100 0.00 65535.00 FORMAT "%8.2" ECU_ADDRESS 0x6002BA9C
 /begin IF_DATA XCPplus 0x0102
  /begin DAQ_EVENT VARIABLE /end DAQ_EVENT
 /end IF_DATA
/end MEASUREMENT
/begin MEASUREMENT MoFTqPtdVeh_tqRecupOnePedlDrvgLim "Recuperation torque limit" SWORD TrqPrp 1 100 -52428.80 52427.20 FORMAT "%8.2" ECU_ADDRESS 0x6002C4B6
 /begin IF_DATA XCPplus 0x0102
  /begin DAQ_EVENT VARIABLE /end DAQ_EVENT
 /end IF_DATA
/end MEASUREMENT
/begin MEASUREMENT MoFTqPtdVeh_tqRecupOnePedlDrvgLimCpl "RAM data redundancy for MoFTqPtdVeh_tqRecupOnePedlDrvgLim" UWORD OneToOne 1 100 0.00 65535.00 FORMAT "%8.2" ECU_ADDRESS 0x6002BA9A
 /begin IF_DATA XCPplus 0x0102
  /begin DAQ_EVENT VARIABLE /end DAQ_EVENT
 /end IF_DATA
/end MEASUREMENT
/begin MEASUREMENT MoFTqPtdVeh_tqRecupOnePedlDrvgMin "Vehicle minimum allowed recuperation torque Sfty" SLONG TrqPrpHigh 1 100 -214748364.800 214748364.700 FORMAT "%13.3" ECU_ADDRESS 0x6002C4D0
 /begin IF_DATA XCPplus 0x0102
  /begin DAQ_EVENT VARIABLE /end DAQ_EVENT
 /end IF_DATA
/end MEASUREMENT
/begin MEASUREMENT MoFTqPtdVeh_tqRecupOnePedlDrvgMinCpl "Complement variable for MoFTqPtdVeh_tqRecupOnePedlDrvgMin" ULONG OneToOne 1 100 0.00 4294967295.00 FORMAT "%13.2" ECU_ADDRESS 0x6002BAB4
 /begin IF_DATA XCPplus 0x0102
  /begin DAQ_EVENT VARIABLE /end DAQ_EVENT
 /end IF_DATA
/end MEASUREMENT
/begin MEASUREMENT MoFTqPtdVeh_tqRecupOnePedlDrvgMinMsg "Vehicle minimum allowed recuperation torque Sfty Message" SLONG TrqPrpHigh 1 100 -214748364.800 214748364.700 FORMAT "%13.3" ECU_ADDRESS 0x60000F58
 /begin IF_DATA XCPplus 0x0102
  /begin DAQ_EVENT VARIABLE /end DAQ_EVENT
 /end IF_DATA
/end MEASUREMENT
/begin MEASUREMENT MoFTqPtdVeh_tqSpdLimDes "Speed Limiter Torque in function monitoring" SLONG TrqPrpHigh 1 100 -214748364.800 214748364.700 FORMAT "%13.3" ECU_ADDRESS 0x6002C538
 /begin IF_DATA XCPplus 0x0102
  /begin DAQ_EVENT VARIABLE /end DAQ_EVENT
 /end IF_DATA
/end MEASUREMENT
/begin MEASUREMENT MoFTqPtdVeh_tqSpdLimDesCpl "RAM data redundancy for MoFTqPtdVeh_tqSpdLimDes" ULONG OneToOne 1 100 0.00 4294967295.00 FORMAT "%13.2" ECU_ADDRESS 0x6002BB18
 /begin IF_DATA XCPplus 0x0102
  /begin DAQ_EVENT VARIABLE /end DAQ_EVENT
 /end IF_DATA
/end MEASUREMENT
/begin MEASUREMENT MoFTqPtdVeh_tqSpdLimMin "Minimal permitted torque from speed limiter" SLONG TrqPrpHigh 1 100 -214748364.800 214748364.700 FORMAT "%13.3" ECU_ADDRESS 0x6002C534
 /begin IF_DATA XCPplus 0x0102
  /begin DAQ_EVENT VARIABLE /end DAQ_EVENT
 /end IF_DATA
/end MEASUREMENT
/begin MEASUREMENT MoFTqPtdVeh_tqSpdLimMinCpl "RAM data redundancy for MoFTqPtdVeh_tqSpdLimMin" ULONG OneToOne 1 100 0.00 4294967295.00 FORMAT "%13.2" ECU_ADDRESS 0x6002BB14
 /begin IF_DATA XCPplus 0x0102
  /begin DAQ_EVENT VARIABLE /end DAQ_EVENT
 /end IF_DATA
/end MEASUREMENT
/begin MEASUREMENT MoFTqPtdVeh_tqTarCoord "target torque for coordination" SLONG TrqPrpHigh 1 100 -214748364.800 214748364.700 FORMAT "%13.3" ECU_ADDRESS 0x6002C530
 /begin IF_DATA XCPplus 0x0102
  /begin DAQ_EVENT VARIABLE /end DAQ_EVENT
 /end IF_DATA
/end MEASUREMENT
/begin MEASUREMENT MoFTqPtdVeh_tqTarCoordCpl "complement of target torque for coordination" ULONG OneToOne 1 100 0.00 4294967295.00 FORMAT "%13.2" ECU_ADDRESS 0x6002BB10
 /begin IF_DATA XCPplus 0x0102
  /begin DAQ_EVENT VARIABLE /end DAQ_EVENT
 /end IF_DATA
/end MEASUREMENT
/begin MEASUREMENT MoFTqPtdVeh_tqTiInteg "Integral value of torque comparison on vehicle level" SLONG mdt_q0p001_Nm_s 1 100 -2147483.64800 2147483.64700 FORMAT "%13.5" ECU_ADDRESS 0x6002C56C
 /begin IF_DATA XCPplus 0x0102
  /begin DAQ_EVENT VARIABLE /end DAQ_EVENT
 /end IF_DATA
/end MEASUREMENT
/begin MEASUREMENT MoFTqPtdVeh_tqTiIntegCpl "RAM data redundancy for MoFTqPtdVeh_tqTiInteg" ULONG OneToOne 1 100 0.00 4294967295.00 FORMAT "%13.2" ECU_ADDRESS 0x6002BB50
 /begin IF_DATA XCPplus 0x0102
  /begin DAQ_EVENT VARIABLE /end DAQ_EVENT
 /end IF_DATA
/end MEASUREMENT
/begin MEASUREMENT MoFTqPtdVeh_tqUpLim "Upper limit of permitted torque on vehicle level in function monitoring" SLONG TrqPrpHigh 1 100 -214748364.800 214748364.700 FORMAT "%13.3" ECU_ADDRESS 0x6002C568
 /begin IF_DATA XCPplus 0x0102
  /begin DAQ_EVENT VARIABLE /end DAQ_EVENT
 /end IF_DATA
/end MEASUREMENT
/begin MEASUREMENT MoFTqPtdVeh_tqUpLimCpl "RAM data redundancy for MoFTqPtdVeh_tqUpLim" ULONG OneToOne 1 100 0.00 4294967295.00 FORMAT "%13.2" ECU_ADDRESS 0x6002BB4C
 /begin IF_DATA XCPplus 0x0102
  /begin DAQ_EVENT VARIABLE /end DAQ_EVENT
 /end IF_DATA
/end MEASUREMENT
/begin MEASUREMENT MoFTqPtdVeh_tqWhlCoord "Coordinated desired torque on vehicle level in function monitoring" SLONG TrqPrpHigh 1 100 -214748364.800 214748364.700 FORMAT "%13.3" ECU_ADDRESS 0x6002C434
 /begin IF_DATA XCPplus 0x0102
  /begin DAQ_EVENT VARIABLE /end DAQ_EVENT
 /end IF_DATA
/end MEASUREMENT
/begin MEASUREMENT MoFTqPtdVeh_tqWhlCoordCpl "RAM data redundancy for MoFTqPtdVeh_tqWhlCoord" ULONG OneToOne 1 100 0.00 4294967295.00 FORMAT "%13.2" ECU_ADDRESS 0x6002BA3C
 /begin IF_DATA XCPplus 0x0102
  /begin DAQ_EVENT VARIABLE /end DAQ_EVENT
 /end IF_DATA
/end MEASUREMENT
/begin MEASUREMENT MoFTqPtdVeh_tqWhlCoordLoResl "Coordinated desired torque on vehicle level in low resolution" SWORD TrqPrp 1 100 -52428.80 52427.20 FORMAT "%8.2" ECU_ADDRESS 0x6002C560
 /begin IF_DATA XCPplus 0x0102
  /begin DAQ_EVENT VARIABLE /end DAQ_EVENT
 /end IF_DATA
/end MEASUREMENT
/begin MEASUREMENT MoFTqPtdVeh_tqWhlCoordLoReslCpl "Complement of coordinated desired torque on vehicle level in low resolution" UWORD OneToOne 1 100 0.00 65535.00 FORMAT "%8.2" ECU_ADDRESS 0x6002BB44
 /begin IF_DATA XCPplus 0x0102
  /begin DAQ_EVENT VARIABLE /end DAQ_EVENT
 /end IF_DATA
/end MEASUREMENT
/begin MEASUREMENT MoFTqPtdVeh_tqWhlCoordNoFil "Unfiltered by speed limiter limited coordinated torque" SLONG TrqPrpHigh 1 100 -214748364.800 214748364.700 FORMAT "%13.3" ECU_ADDRESS 0x6002C52C
 /begin IF_DATA XCPplus 0x0102
  /begin DAQ_EVENT VARIABLE /end DAQ_EVENT
 /end IF_DATA
/end MEASUREMENT
/begin MEASUREMENT MoFTqPtdVeh_tqWhlCoordNoFilCpl "complement of unfiltered by speed limiter limited coordinated torque" ULONG OneToOne 1 100 0.00 4294967295.00 FORMAT "%13.2" ECU_ADDRESS 0x6002BB0C
 /begin IF_DATA XCPplus 0x0102
  /begin DAQ_EVENT VARIABLE /end DAQ_EVENT
 /end IF_DATA
/end MEASUREMENT
/begin MEASUREMENT MoFTqPtdVeh_tqWhlCoordNoFilLimd "Limited unfiltered coordinated torque" SLONG TrqPrpHigh 1 100 -214748364.800 214748364.700 FORMAT "%13.3" ECU_ADDRESS 0x6002C528
 /begin IF_DATA XCPplus 0x0102
  /begin DAQ_EVENT VARIABLE /end DAQ_EVENT
 /end IF_DATA
/end MEASUREMENT
/begin MEASUREMENT MoFTqPtdVeh_tqWhlCoordNoFilLimdCpl "Complement of limited unfiltered coordinated torque" ULONG OneToOne 1 100 0.00 4294967295.00 FORMAT "%13.2" ECU_ADDRESS 0x6002BB08
 /begin IF_DATA XCPplus 0x0102
  /begin DAQ_EVENT VARIABLE /end DAQ_EVENT
 /end IF_DATA
/end MEASUREMENT
/begin MEASUREMENT MoFTqPtdVeh_tqWhlCoordNotFilMax "Unfiltered coordinated maximum torque" SLONG TrqPrpHigh 1 100 -214748364.800 214748364.700 FORMAT "%13.3" ECU_ADDRESS 0x6002C458
 /begin IF_DATA XCPplus 0x0102
  /begin DAQ_EVENT VARIABLE /end DAQ_EVENT
 /end IF_DATA
/end MEASUREMENT
/begin MEASUREMENT MoFTqPtdVeh_tqWhlCoordNotFilMaxCpl "Complement of Unfiltered coordinated maximum torque" ULONG OneToOne 1 100 0.00 4294967295.00 FORMAT "%13.2" ECU_ADDRESS 0x6002BA38
 /begin IF_DATA XCPplus 0x0102
  /begin DAQ_EVENT VARIABLE /end DAQ_EVENT
 /end IF_DATA
/end MEASUREMENT
/begin MEASUREMENT MoFTqPtdVeh_tqWhlCoordOld "Old value of MoFTqPtdVeh_tqWhlCoord" SLONG TrqPrpHigh 1 100 -214748364.800 214748364.700 FORMAT "%13.3" ECU_ADDRESS 0x6002C454
 /begin IF_DATA XCPplus 0x0102
  /begin DAQ_EVENT VARIABLE /end DAQ_EVENT
 /end IF_DATA
/end MEASUREMENT
/begin MEASUREMENT MoFTqPtdVeh_tqWhlCoordOldCpl "Complement of Old value of MoFTqPtdVeh_tqWhlCoord" ULONG OneToOne 1 100 0.00 4294967295.00 FORMAT "%13.2" ECU_ADDRESS 0x6002BA34
 /begin IF_DATA XCPplus 0x0102
  /begin DAQ_EVENT VARIABLE /end DAQ_EVENT
 /end IF_DATA
/end MEASUREMENT
/begin MEASUREMENT MoFTqPtdVeh_tqWhlCoordRampFilMax "Robustness plausibilised Maximum Ramp torque in Level2" SLONG TrqPrpHigh 1 100 -214748364.800 214748364.700 FORMAT "%13.3" ECU_ADDRESS 0x6002C450
 /begin IF_DATA XCPplus 0x0102
  /begin DAQ_EVENT VARIABLE /end DAQ_EVENT
 /end IF_DATA
/end MEASUREMENT
/begin MEASUREMENT MoFTqPtdVeh_tqWhlCoordRampFilMaxCpl "Complement of Robustness plausibilised Maximum Ramp torque in Level2" ULONG OneToOne 1 100 0.00 4294967295.00 FORMAT "%13.2" ECU_ADDRESS 0x6002BA30
 /begin IF_DATA XCPplus 0x0102
  /begin DAQ_EVENT VARIABLE /end DAQ_EVENT
 /end IF_DATA
/end MEASUREMENT
/begin MEASUREMENT MoFTqPtdVeh_tqWhlCoordUnfild "Lowpass filtered coordinated desired torque at vehicle level" SLONG TrqPrpHigh 1 100 -214748364.800 214748364.700 FORMAT "%13.3" ECU_ADDRESS 0x6002C518
 /begin IF_DATA XCPplus 0x0102
  /begin DAQ_EVENT VARIABLE /end DAQ_EVENT
 /end IF_DATA
/end MEASUREMENT
/begin MEASUREMENT MoFTqPtdVeh_tqWhlCoordUnfildCpl "Complement of Unfiltered coordinated desired torque at vehicle level" ULONG OneToOne 1 100 0.00 4294967295.00 FORMAT "%13.2" ECU_ADDRESS 0x6002BB04
 /begin IF_DATA XCPplus 0x0102
  /begin DAQ_EVENT VARIABLE /end DAQ_EVENT
 /end IF_DATA
/end MEASUREMENT
/begin MEASUREMENT MoFTqPtdVeh_tqWhlCoordUnfildRamp "Unfiltered coordinated ramp torque at vehicle level" SLONG TrqPrpHigh 1 100 -214748364.800 214748364.700 FORMAT "%13.3" ECU_ADDRESS 0x6002C524
 /begin IF_DATA XCPplus 0x0102
  /begin DAQ_EVENT VARIABLE /end DAQ_EVENT
 /end IF_DATA
/end MEASUREMENT
/begin MEASUREMENT MoFTqPtdVeh_tqWhlCoordUnfildRampCpl "Complement of unfiltered coordinated ramp torque at vehicale level" ULONG OneToOne 1 100 0.00 4294967295.00 FORMAT "%13.2" ECU_ADDRESS 0x6002BB00
 /begin IF_DATA XCPplus 0x0102
  /begin DAQ_EVENT VARIABLE /end DAQ_EVENT
 /end IF_DATA
/end MEASUREMENT
/begin MEASUREMENT MoFTqPtdVeh_tqWhlDes "Desired torque on vehicle level in function monitoring" SLONG TrqPrpHigh 1 100 -214748364.800 214748364.700 FORMAT "%13.3" ECU_ADDRESS 0x6002C564
 /begin IF_DATA XCPplus 0x0102
  /begin DAQ_EVENT VARIABLE /end DAQ_EVENT
 /end IF_DATA
/end MEASUREMENT
/begin MEASUREMENT MoFTqPtdVeh_tqWhlDesCpl "RAM data redundancy for MoFTqPtdVeh_tqWhlDes" ULONG OneToOne 1 100 0.00 4294967295.00 FORMAT "%13.2" ECU_ADDRESS 0x6002BB48
 /begin IF_DATA XCPplus 0x0102
  /begin DAQ_EVENT VARIABLE /end DAQ_EVENT
 /end IF_DATA
/end MEASUREMENT
/begin MEASUREMENT MoFTqPtdVeh_tqWhlDesNotPT2Fil "Desired coordinated non PT2 filter torque" SLONG TrqPrpHigh 1 100 -214748364.800 214748364.700 FORMAT "%13.3" ECU_ADDRESS 0x6002C44C
 /begin IF_DATA XCPplus 0x0102
  /begin DAQ_EVENT VARIABLE /end DAQ_EVENT
 /end IF_DATA
/end MEASUREMENT
/begin MEASUREMENT MoFTqPtdVeh_tqWhlDesNotPT2FilCpl "Complement of Desired coordinated non PT2 filter torque" ULONG OneToOne 1 100 0.00 4294967295.00 FORMAT "%13.2" ECU_ADDRESS 0x6002BA2C
 /begin IF_DATA XCPplus 0x0102
  /begin DAQ_EVENT VARIABLE /end DAQ_EVENT
 /end IF_DATA
/end MEASUREMENT
/begin MEASUREMENT MoFTqPtdVeh_tqWhlDesWithDrvAwyDes "torque request from driver including crawling request" SLONG TrqPrpHigh 1 100 -214748364.800 214748364.700 FORMAT "%13.3" ECU_ADDRESS 0x6002C520
 /begin IF_DATA XCPplus 0x0102
  /begin DAQ_EVENT VARIABLE /end DAQ_EVENT
 /end IF_DATA
/end MEASUREMENT
/begin MEASUREMENT MoFTqPtdVeh_tqWhlDesWithDrvAwyDesCpl "complement of torque request from driver including crawling request" ULONG OneToOne 1 100 0.00 4294967295.00 FORMAT "%13.2" ECU_ADDRESS 0x6002BAFC
 /begin IF_DATA XCPplus 0x0102
  /begin DAQ_EVENT VARIABLE /end DAQ_EVENT
 /end IF_DATA
/end MEASUREMENT
/begin MEASUREMENT MoFTqPtdVeh_tqWhlQstyMaxLvl1 "Copy of CoPOM_tqWhlQstyMax" SLONG TrqPrpHigh 1 100 -214748364.800 214748364.700 FORMAT "%13.3" ECU_ADDRESS 0x6002C448
 /begin IF_DATA XCPplus 0x0102
  /begin DAQ_EVENT VARIABLE /end DAQ_EVENT
 /end IF_DATA
/end MEASUREMENT
/begin MEASUREMENT MoFTqPtdVeh_tqWhlQstyMaxLvl1Cpl "Complement of MoFTqPtdVeh_tqWhlQstyMaxLvl1" ULONG OneToOne 1 100 0.00 4294967295.00 FORMAT "%13.2" ECU_ADDRESS 0x6002BA28
 /begin IF_DATA XCPplus 0x0102
  /begin DAQ_EVENT VARIABLE /end DAQ_EVENT
 /end IF_DATA
/end MEASUREMENT
/begin MEASUREMENT MoFTqPtdVeh_tqWhlQstyMaxWoDistbnLvl1 "Copy of CoPOM_tqWhlQstyMaxWoDistbn" SLONG TrqPrpHigh 1 100 -214748364.800 214748364.700 FORMAT "%13.3" ECU_ADDRESS 0x6002C444
 /begin IF_DATA XCPplus 0x0102
  /begin DAQ_EVENT VARIABLE /end DAQ_EVENT
 /end IF_DATA
/end MEASUREMENT
/begin MEASUREMENT MoFTqPtdVeh_tqWhlQstyMaxWoDistbnLvl1Cpl "Complement of MoFTqPtdVeh_tqWhlQstyMaxWoDistbnLvl1" ULONG OneToOne 1 100 0.00 4294967295.00 FORMAT "%13.2" ECU_ADDRESS 0x6002BA24
 /begin IF_DATA XCPplus 0x0102
  /begin DAQ_EVENT VARIABLE /end DAQ_EVENT
 /end IF_DATA
/end MEASUREMENT
/begin MEASUREMENT MoFTqPtdVeh_tqWhlQstyMinLvl1 "Copy of CoPOM_tqWhlQstyMin" SLONG TrqPrpHigh 1 100 -214748364.800 214748364.700 FORMAT "%13.3" ECU_ADDRESS 0x6002C440
 /begin IF_DATA XCPplus 0x0102
  /begin DAQ_EVENT VARIABLE /end DAQ_EVENT
 /end IF_DATA
/end MEASUREMENT
/begin MEASUREMENT MoFTqPtdVeh_tqWhlQstyMinLvl1Cpl "Complement of MoFTqPtdVeh_tqWhlQstyMaxLvl1" ULONG OneToOne 1 100 0.00 4294967295.00 FORMAT "%13.2" ECU_ADDRESS 0x6002BA20
 /begin IF_DATA XCPplus 0x0102
  /begin DAQ_EVENT VARIABLE /end DAQ_EVENT
 /end IF_DATA
/end MEASUREMENT
/begin MEASUREMENT MoFTqPtdVeh_tqZrCrssDrvgMod "Maximum positive torque gradient for zero cross filter selected from map." SLONG TrqPrp 1 100 -3435973836.80 3435973835.20 FORMAT "%13.2" ECU_ADDRESS 0x6002C43C
 /begin IF_DATA XCPplus 0x0102
  /begin DAQ_EVENT VARIABLE /end DAQ_EVENT
 /end IF_DATA
/end MEASUREMENT
/begin MEASUREMENT MoFTqPtdVeh_tqZrCrssDrvgModCpl "Complement of Maximum positive torque gradient for zero cross filter selected from map." ULONG OneToOne 1 100 0.00 4294967295.00 FORMAT "%13.2" ECU_ADDRESS 0x6002BA1C
 /begin IF_DATA XCPplus 0x0102
  /begin DAQ_EVENT VARIABLE /end DAQ_EVENT
 /end IF_DATA
/end MEASUREMENT
/begin MEASUREMENT MoFTqPtdVeh_tqZrCrssNegDrvgMod "Maximum negative torque gradient for zero cross filter selected from map." SLONG TrqPrp 1 100 -3435973836.80 3435973835.20 FORMAT "%13.2" ECU_ADDRESS 0x6002C438
 /begin IF_DATA XCPplus 0x0102
  /begin DAQ_EVENT VARIABLE /end DAQ_EVENT
 /end IF_DATA
/end MEASUREMENT
/begin MEASUREMENT MoFTqPtdVeh_tqZrCrssNegDrvgModCpl "Complement of Maximum negative torque gradient for zero cross filter selected from map." ULONG OneToOne 1 100 0.00 4294967295.00 FORMAT "%13.2" ECU_ADDRESS 0x6002BA18
 /begin IF_DATA XCPplus 0x0102
  /begin DAQ_EVENT VARIABLE /end DAQ_EVENT
 /end IF_DATA
/end MEASUREMENT
/begin MEASUREMENT MoFTqPtdVeh_vSignCnvn "Sign conversion of signed vehicle speed" SWORD Vel 1 100 -327.6800 327.6700 FORMAT "%8.4" ECU_ADDRESS 0x6002C40A
 /begin IF_DATA XCPplus 0x0102
  /begin DAQ_EVENT VARIABLE /end DAQ_EVENT
 /end IF_DATA
/end MEASUREMENT
/begin MEASUREMENT MoFTqPtdVeh_vSignCnvnCpl "Complement for Sign conversion of signed vehicle speed" UWORD OneToOne 1 100 0.00 65535.00 FORMAT "%8.2" ECU_ADDRESS 0x6002B9E8
 /begin IF_DATA XCPplus 0x0102
  /begin DAQ_EVENT VARIABLE /end DAQ_EVENT
 /end IF_DATA
/end MEASUREMENT
/begin MEASUREMENT MoFTqPtdVeh_vVehDifMax "Difference of actual and maximum vehicle speed" SWORD Vel 1 100 -327.6800 327.6700 FORMAT "%8.4" ECU_ADDRESS 0x6002C506
 /begin IF_DATA XCPplus 0x0102
  /begin DAQ_EVENT VARIABLE /end DAQ_EVENT
 /end IF_DATA
/end MEASUREMENT
/begin MEASUREMENT MoFTqPtdVeh_vVehDifMaxCpl "RAM Data redundancy for MoFTqPtdVeh_vVehDifMax" UWORD OneToOne 1 100 0.00 65535.00 FORMAT "%8.2" ECU_ADDRESS 0x6002BAEA
 /begin IF_DATA XCPplus 0x0102
  /begin DAQ_EVENT VARIABLE /end DAQ_EVENT
 /end IF_DATA
/end MEASUREMENT
/begin MEASUREMENT MoFTqPtdVeh_vVehSigndRvs "Reversed signed vehicle velocity in function monitoring" SWORD Vel 1 100 -327.6800 327.6700 FORMAT "%8.4" ECU_ADDRESS 0x6002C4B4
 /begin IF_DATA XCPplus 0x0102
  /begin DAQ_EVENT VARIABLE /end DAQ_EVENT
 /end IF_DATA
/end MEASUREMENT
/begin MEASUREMENT MoFTqPtdVeh_vVehSigndRvsCpl "RAM Data redundancy for MoFTqPtdVeh_vVehSigndRvs" UWORD OneToOne 1 100 0.00 65535.00 FORMAT "%8.2" ECU_ADDRESS 0x6002BA98
 /begin IF_DATA XCPplus 0x0102
  /begin DAQ_EVENT VARIABLE /end DAQ_EVENT
 /end IF_DATA
/end MEASUREMENT
/begin MEASUREMENT MoFTrqPtd_cntrActvPostBldCfg "Counter for error debounce due to an error in return of the active post-build configuration" UBYTE OneToOne 1 100 0.00 255.0 FORMAT "%5.1" ECU_ADDRESS 0x6002C3DD
 /begin IF_DATA XCPplus 0x0102
  /begin DAQ_EVENT VARIABLE /end DAQ_EVENT
 /end IF_DATA
/end MEASUREMENT
/begin MEASUREMENT MoFTrqPtd_cntrActvPostBldCfgCpl "RAM data redundancy of MoFTrqPtd_cntrActvPostBldCfg" UBYTE OneToOne 1 100 0.00 255.0 FORMAT "%5.1" ECU_ADDRESS 0x6002B9C1
 /begin IF_DATA XCPplus 0x0102
  /begin DAQ_EVENT VARIABLE /end DAQ_EVENT
 /end IF_DATA
/end MEASUREMENT
/begin MEASUREMENT MoFTrqPtd_cntrNegChkPostBldCfg "Counter for error debounce due to an error in the negative check of the post-build configuration" UBYTE OneToOne 1 100 0.00 255.0 FORMAT "%5.1" ECU_ADDRESS 0x6002C3DC
 /begin IF_DATA XCPplus 0x0102
  /begin DAQ_EVENT VARIABLE /end DAQ_EVENT
 /end IF_DATA
/end MEASUREMENT
/begin MEASUREMENT MoFTrqPtd_cntrNegChkPostBldCfgCpl "RAM data redundancy of MoFTrqPtd_cntrNegChkPostBldCfg" UBYTE OneToOne 1 100 0.00 255.0 FORMAT "%5.1" ECU_ADDRESS 0x6002B9C0
 /begin IF_DATA XCPplus 0x0102
  /begin DAQ_EVENT VARIABLE /end DAQ_EVENT
 /end IF_DATA
/end MEASUREMENT
/begin MEASUREMENT MoFTrqPtd_cntrPosChkPostBldCfg "Counter for error debounce due to an error in the positive check of the post-build configuration" UBYTE OneToOne 1 100 0.00 255.0 FORMAT "%5.1" ECU_ADDRESS 0x6002C3DB
 /begin IF_DATA XCPplus 0x0102
  /begin DAQ_EVENT VARIABLE /end DAQ_EVENT
 /end IF_DATA
/end MEASUREMENT
/begin MEASUREMENT MoFTrqPtd_cntrPosChkPostBldCfgCpl "RAM data redundancy of MoFTrqPtd_cntrPosChkPostBldCfg" UBYTE OneToOne 1 100 0.00 255.0 FORMAT "%5.1" ECU_ADDRESS 0x6002B9BF
 /begin IF_DATA XCPplus 0x0102
  /begin DAQ_EVENT VARIABLE /end DAQ_EVENT
 /end IF_DATA
/end MEASUREMENT
/begin MEASUREMENT MoFTrqPtd_cntrStabyChkPostBldCfg "Counter for the error debounce due to changed post-build configuration during driving cycle" UBYTE OneToOne 1 100 0.00 255.0 FORMAT "%5.1" ECU_ADDRESS 0x6002C3DA
 /begin IF_DATA XCPplus 0x0102
  /begin DAQ_EVENT VARIABLE /end DAQ_EVENT
 /end IF_DATA
/end MEASUREMENT
/begin MEASUREMENT MoFTrqPtd_cntrStabyChkPostBldCfgCpl "RAM data redundancy of MoFTrqPtd_cntrStabyChkPostBldCfg" UBYTE OneToOne 1 100 0.00 255.0 FORMAT "%5.1" ECU_ADDRESS 0x6002B9BE
 /begin IF_DATA XCPplus 0x0102
  /begin DAQ_EVENT VARIABLE /end DAQ_EVENT
 /end IF_DATA
/end MEASUREMENT
/begin MEASUREMENT MoFTrqPtd_cntrTestPostBldSel "Counter for setting the testflag in diagnosis of post-build selectable in function monitoring" UBYTE OneToOne 1 100 0.00 255.0 FORMAT "%5.1" ECU_ADDRESS 0x600230EF
 /begin IF_DATA XCPplus 0x0102
  /begin DAQ_EVENT VARIABLE /end DAQ_EVENT
 /end IF_DATA
/end MEASUREMENT
/begin MEASUREMENT MoFTrqPtd_flgAlt "Alternating flag in post-build selectable monitoring" UBYTE B_TRUE 1 100 0.00 1.00000000000 BIT_MASK 0x8 FORMAT "%13.11" ECU_ADDRESS 0x6002C3D4
 /begin IF_DATA XCPplus 0x0102
  /begin DAQ_EVENT VARIABLE /end DAQ_EVENT
 /end IF_DATA
/end MEASUREMENT
/begin MEASUREMENT MoFTrqPtd_flgClrPostBldSel "Condition DSM clearing in MoFVar_PostBldSel in function monitoring" UBYTE B_TRUE 1 100 0.00 1.00000000000 BIT_MASK 0x1 FORMAT "%13.11" ECU_ADDRESS 0x70000116
 /begin IF_DATA XCPplus 0x0102
  /begin DAQ_EVENT VARIABLE /end DAQ_EVENT
 /end IF_DATA
/end MEASUREMENT
/begin MEASUREMENT MoFTrqPtd_flgErrActvPostBldCfg "Error during request of post-build index of BSW" UBYTE B_TRUE 1 100 0.00 1.00000000000 BIT_MASK 0x10 FORMAT "%13.11" ECU_ADDRESS 0x6002C3D4
 /begin IF_DATA XCPplus 0x0102
  /begin DAQ_EVENT VARIABLE /end DAQ_EVENT
 /end IF_DATA
/end MEASUREMENT
/begin MEASUREMENT MoFTrqPtd_flgErrDcycStabyChk "Error of monitoring of the post-build variant on stability check over driving cycle" UBYTE B_TRUE 1 100 0.00 1.00000000000 BIT_MASK 0x20 FORMAT "%13.11" ECU_ADDRESS 0x6002C3D4
 /begin IF_DATA XCPplus 0x0102
  /begin DAQ_EVENT VARIABLE /end DAQ_EVENT
 /end IF_DATA
/end MEASUREMENT
/begin MEASUREMENT MoFTrqPtd_flgErrIvsChkPostBld "Error in inverse check of post-build configuration" UBYTE B_TRUE 1 100 0.00 1.00000000000 BIT_MASK 0x80 FORMAT "%13.11" ECU_ADDRESS 0x6002C3D4
 /begin IF_DATA XCPplus 0x0102
  /begin DAQ_EVENT VARIABLE /end DAQ_EVENT
 /end IF_DATA
/end MEASUREMENT
/begin MEASUREMENT MoFTrqPtd_flgErrPosChk "Wrong return value in positive check of post-build selectable monitoring received" UBYTE B_TRUE 1 100 0.00 1.00000000000 BIT_MASK 0x2 FORMAT "%13.11" ECU_ADDRESS 0x6002C3D4
 /begin IF_DATA XCPplus 0x0102
  /begin DAQ_EVENT VARIABLE /end DAQ_EVENT
 /end IF_DATA
/end MEASUREMENT
/begin MEASUREMENT MoFTrqPtd_flgErrPosChk2 "Wrong return value in positive check of post-build selectable monitoring received" UBYTE B_TRUE 1 100 0.00 1.00000000000 BIT_MASK 0x4 FORMAT "%13.11" ECU_ADDRESS 0x6002C3D4
 /begin IF_DATA XCPplus 0x0102
  /begin DAQ_EVENT VARIABLE /end DAQ_EVENT
 /end IF_DATA
/end MEASUREMENT
/begin MEASUREMENT MoFTrqPtd_flgErrPosChkPostBld "Error in positive check of post-build configuration" UBYTE B_TRUE 1 100 0.00 1.00000000000 BIT_MASK 0x40 FORMAT "%13.11" ECU_ADDRESS 0x6002C3D4
 /begin IF_DATA XCPplus 0x0102
  /begin DAQ_EVENT VARIABLE /end DAQ_EVENT
 /end IF_DATA
/end MEASUREMENT
/begin MEASUREMENT MoFTrqPtd_flgIrrvErrPostBldSel "Irreversible error flag from post-build selectable function monitoring" UBYTE B_TRUE 1 100 0.00 1.00000000000 BIT_MASK 0x1 FORMAT "%13.11" ECU_ADDRESS 0x6002C3D3
 /begin IF_DATA XCPplus 0x0102
  /begin DAQ_EVENT VARIABLE /end DAQ_EVENT
 /end IF_DATA
/end MEASUREMENT
/begin MEASUREMENT MoFTrqPtd_flgIrrvErrPostBldSelMsg "Irreversible error flag from post-build selectable function monitoring to level 1" UBYTE B_TRUE 1 100 0.00 1.00000000000 BIT_MASK 0x1 FORMAT "%13.11" ECU_ADDRESS 0x70000227
 /begin IF_DATA XCPplus 0x0102
  /begin DAQ_EVENT VARIABLE /end DAQ_EVENT
 /end IF_DATA
/end MEASUREMENT
/begin MEASUREMENT MoFTrqPtd_flgPostBldCfgRxd "Post-build configuration from BSW overtaken to level 2 variable" UBYTE B_TRUE 1 100 0.00 1.00000000000 BIT_MASK 0x1 FORMAT "%13.11" ECU_ADDRESS 0x6002C3D4
 /begin IF_DATA XCPplus 0x0102
  /begin DAQ_EVENT VARIABLE /end DAQ_EVENT
 /end IF_DATA
/end MEASUREMENT
/begin MEASUREMENT MoFTrqPtd_idxPostBldCfg "Active post-build configuration from BSW" UBYTE OneToOne 1 100 0.00 255.0 FORMAT "%5.1" ECU_ADDRESS 0x6002C3D9
 /begin IF_DATA XCPplus 0x0102
  /begin DAQ_EVENT VARIABLE /end DAQ_EVENT
 /end IF_DATA
/end MEASUREMENT
/begin MEASUREMENT MoFTrqPtd_idxPostBldCfgCpl "RAM data redundancy of MoFTrqPtd_idxPostBldCfg" UBYTE OneToOne 1 100 0.00 255.0 FORMAT "%5.1" ECU_ADDRESS 0x6002B9BD
 /begin IF_DATA XCPplus 0x0102
  /begin DAQ_EVENT VARIABLE /end DAQ_EVENT
 /end IF_DATA
/end MEASUREMENT
/begin MEASUREMENT MoFTrqPtd_idxPostBldCfgIni "After initialization in level 2 stored post-build configuration" UBYTE OneToOne 1 100 0.00 255.0 FORMAT "%5.1" ECU_ADDRESS 0x6002C3D8
 /begin IF_DATA XCPplus 0x0102
  /begin DAQ_EVENT VARIABLE /end DAQ_EVENT
 /end IF_DATA
/end MEASUREMENT
/begin MEASUREMENT MoFTrqPtd_idxPostBldCfgIniCpl "RAM data redundancy of MoFTrqPtd_idxPostBldCfgIni" UBYTE OneToOne 1 100 0.00 255.0 FORMAT "%5.1" ECU_ADDRESS 0x6002B9BC
 /begin IF_DATA XCPplus 0x0102
  /begin DAQ_EVENT VARIABLE /end DAQ_EVENT
 /end IF_DATA
/end MEASUREMENT
/begin MEASUREMENT MoFTrqPtd_stActvPostBldVrntIdx "Return value of the callback function EcuM_RbMoGetActivePostBuildVariantIndex" UBYTE OneToOne 1 100 0.00 255.0 FORMAT "%5.1" ECU_ADDRESS 0x6002C3D7
 /begin IF_DATA XCPplus 0x0102
  /begin DAQ_EVENT VARIABLE /end DAQ_EVENT
 /end IF_DATA
/end MEASUREMENT
/begin MEASUREMENT MoFTrqPtd_stActvPostBldVrntIdxCpl "Complement of the return value of the callback function EcuM_RbMoGetActivePostBuildVariantIndex" UBYTE OneToOne 1 100 0.00 255.0 FORMAT "%5.1" ECU_ADDRESS 0x6002B9BB
 /begin IF_DATA XCPplus 0x0102
  /begin DAQ_EVENT VARIABLE /end DAQ_EVENT
 /end IF_DATA
/end MEASUREMENT
/begin MEASUREMENT MoFTrqPtd_stMonIninChk "Return value of the callback function EcuM_RbMoInitCheck" UBYTE OneToOne 1 100 0.00 255.0 FORMAT "%5.1" ECU_ADDRESS 0x6002C3D6
 /begin IF_DATA XCPplus 0x0102
  /begin DAQ_EVENT VARIABLE /end DAQ_EVENT
 /end IF_DATA
/end MEASUREMENT
/begin MEASUREMENT MoFTrqPtd_stMonIninChkCpl "Complement of the return value of the callback function EcuM_RbMoInitCheck" UBYTE OneToOne 1 100 0.00 255.0 FORMAT "%5.1" ECU_ADDRESS 0x6002B9BA
 /begin IF_DATA XCPplus 0x0102
  /begin DAQ_EVENT VARIABLE /end DAQ_EVENT
 /end IF_DATA
/end MEASUREMENT
/begin MEASUREMENT MoFTrqPtd_stMonIninChkIvs "Return value of the callback function EcuM_RbMoInitCheckInverse" UBYTE OneToOne 1 100 0.00 255.0 FORMAT "%5.1" ECU_ADDRESS 0x6002C3D5
 /begin IF_DATA XCPplus 0x0102
  /begin DAQ_EVENT VARIABLE /end DAQ_EVENT
 /end IF_DATA
/end MEASUREMENT
/begin MEASUREMENT MoFTrqPtd_stMonIninChkIvsCpl "Complement of the return value of the callback function EcuM_RbMoInitCheckInverse" UBYTE OneToOne 1 100 0.00 255.0 FORMAT "%5.1" ECU_ADDRESS 0x6002B9B9
 /begin IF_DATA XCPplus 0x0102
  /begin DAQ_EVENT VARIABLE /end DAQ_EVENT
 /end IF_DATA
/end MEASUREMENT
/begin MEASUREMENT MoFTrsmAsscGearLvrCoorr_bbLoc1Cpl "Complement variable for MoFTrsmAsscGearLvrCoorr_bbLoc1" UBYTE OneToOne 1 100 0.00 255.0 FORMAT "%5.1" ECU_ADDRESS 0x6002B9E6
 /begin IF_DATA XCPplus 0x0102
  /begin DAQ_EVENT VARIABLE /end DAQ_EVENT
 /end IF_DATA
/end MEASUREMENT
/begin MEASUREMENT MoFTrsmAsscGearLvrCoorr_bbLoc2Cpl "Complement variable for MoFTrsmAsscGearLvrCoorr_bbOut2" UBYTE OneToOne 1 100 0.00 255.0 FORMAT "%5.1" ECU_ADDRESS 0x6002B9E5
 /begin IF_DATA XCPplus 0x0102
  /begin DAQ_EVENT VARIABLE /end DAQ_EVENT
 /end IF_DATA
/end MEASUREMENT
/begin MEASUREMENT MoFTrsmAsscGearLvrCoorr_bbOut1Cpl "Complement variable for MoFTrsmAsscGearLvrCoorr_bbOut1" UBYTE OneToOne 1 100 0.00 255.0 FORMAT "%5.1" ECU_ADDRESS 0x6002B9E4
 /begin IF_DATA XCPplus 0x0102
  /begin DAQ_EVENT VARIABLE /end DAQ_EVENT
 /end IF_DATA
/end MEASUREMENT
/begin MEASUREMENT MoFTrsmAssc_cntrDebGearReqRst "Debounce counter to reset requested gear state" UBYTE OneToOne 1 100 0.00 255.0 FORMAT "%5.1" ECU_ADDRESS 0x6002C400
 /begin IF_DATA XCPplus 0x0102
  /begin DAQ_EVENT VARIABLE /end DAQ_EVENT
 /end IF_DATA
/end MEASUREMENT
/begin MEASUREMENT MoFTrsmAssc_cntrDebGearReqRstCpl "Complement for MoFTrsmAssc_cntrDebGearReqRst" UBYTE OneToOne 1 100 0.00 255.0 FORMAT "%5.1" ECU_ADDRESS 0x6002B9E3
 /begin IF_DATA XCPplus 0x0102
  /begin DAQ_EVENT VARIABLE /end DAQ_EVENT
 /end IF_DATA
/end MEASUREMENT
/begin MEASUREMENT MoFTrsmAssc_cntrDrvRst "Debounce counter to reset the permitted status of DRIVE" UBYTE OneToOne 1 100 0.00 255.0 FORMAT "%5.1" ECU_ADDRESS 0x6002C3FF
 /begin IF_DATA XCPplus 0x0102
  /begin DAQ_EVENT VARIABLE /end DAQ_EVENT
 /end IF_DATA
/end MEASUREMENT
/begin MEASUREMENT MoFTrsmAssc_cntrDrvRstCpl "compleemnt for MoFTrsmAssc_cntrDrvRst" UBYTE OneToOne 1 100 0.00 255.0 FORMAT "%5.1" ECU_ADDRESS 0x6002B9E2
 /begin IF_DATA XCPplus 0x0102
  /begin DAQ_EVENT VARIABLE /end DAQ_EVENT
 /end IF_DATA
/end MEASUREMENT
/begin MEASUREMENT MoFTrsmAssc_cntrModChgReqChg "Counter Debounce whenever Gear change request happens" UBYTE OneToOne 1 100 0.00 255.0 FORMAT "%5.1" ECU_ADDRESS 0x6002C3FE
 /begin IF_DATA XCPplus 0x0102
  /begin DAQ_EVENT VARIABLE /end DAQ_EVENT
 /end IF_DATA
/end MEASUREMENT
/begin MEASUREMENT MoFTrsmAssc_cntrModChgReqChgCpl "Compliment" UBYTE OneToOne 1 100 0.00 255.0 FORMAT "%5.1" ECU_ADDRESS 0x6002B9E1
 /begin IF_DATA XCPplus 0x0102
  /begin DAQ_EVENT VARIABLE /end DAQ_EVENT
 /end IF_DATA
/end MEASUREMENT
/begin MEASUREMENT MoFTrsmAssc_cntrRvsRst "Debounce counter to reset the permitted status of REVERSE" UBYTE OneToOne 1 100 0.00 255.0 FORMAT "%5.1" ECU_ADDRESS 0x6002C3FD
 /begin IF_DATA XCPplus 0x0102
  /begin DAQ_EVENT VARIABLE /end DAQ_EVENT
 /end IF_DATA
/end MEASUREMENT
/begin MEASUREMENT MoFTrsmAssc_cntrRvsRstCpl "Complement for MoFTrsmAssc_cntrRvsRst" UBYTE OneToOne 1 100 0.00 255.0 FORMAT "%5.1" ECU_ADDRESS 0x6002B9E0
 /begin IF_DATA XCPplus 0x0102
  /begin DAQ_EVENT VARIABLE /end DAQ_EVENT
 /end IF_DATA
/end MEASUREMENT
/begin MEASUREMENT MoFTrsmAssc_flgBrkPsd "Flag to indicate brake pedal is pressed without error" UBYTE B_TRUE 1 100 0.00 1.00000000000 BIT_MASK 0x1 FORMAT "%13.11" ECU_ADDRESS 0x6002C402
 /begin IF_DATA XCPplus 0x0102
  /begin DAQ_EVENT VARIABLE /end DAQ_EVENT
 /end IF_DATA
/end MEASUREMENT
/begin MEASUREMENT MoFTrsmAssc_flgDrvModReqChg "Driver Mode change request" UBYTE B_TRUE 1 100 0.00 1.00000000000 BIT_MASK 0x40 FORMAT "%13.11" ECU_ADDRESS 0x6002C402
 /begin IF_DATA XCPplus 0x0102
  /begin DAQ_EVENT VARIABLE /end DAQ_EVENT
 /end IF_DATA
/end MEASUREMENT
/begin MEASUREMENT MoFTrsmAssc_flgDrvModReqChgCfm "Confirm Drive Mode Request flag" UBYTE B_TRUE 1 100 0.00 1.00000000000 BIT_MASK 0x4 FORMAT "%13.11" ECU_ADDRESS 0x6002C401
 /begin IF_DATA XCPplus 0x0102
  /begin DAQ_EVENT VARIABLE /end DAQ_EVENT
 /end IF_DATA
/end MEASUREMENT
/begin MEASUREMENT MoFTrsmAssc_flgDrvReq "Drive Request" UBYTE B_TRUE 1 100 0.00 1.00000000000 BIT_MASK 0x80 FORMAT "%13.11" ECU_ADDRESS 0x6002C402
 /begin IF_DATA XCPplus 0x0102
  /begin DAQ_EVENT VARIABLE /end DAQ_EVENT
 /end IF_DATA
/end MEASUREMENT
/begin MEASUREMENT MoFTrsmAssc_flgDrvRst "Flag to indicate the permitted status of DRIVE is reset" UBYTE B_TRUE 1 100 0.00 1.00000000000 BIT_MASK 0x2 FORMAT "%13.11" ECU_ADDRESS 0x6002C402
 /begin IF_DATA XCPplus 0x0102
  /begin DAQ_EVENT VARIABLE /end DAQ_EVENT
 /end IF_DATA
/end MEASUREMENT
/begin MEASUREMENT MoFTrsmAssc_flgGearLvrDrv "Flag indicating gear lever is in Drive" UBYTE B_TRUE 1 100 0.00 1.00000000000 BIT_MASK 0x1 FORMAT "%13.11" ECU_ADDRESS 0x6002C3F1
 /begin IF_DATA XCPplus 0x0102
  /begin DAQ_EVENT VARIABLE /end DAQ_EVENT
 /end IF_DATA
/end MEASUREMENT
/begin MEASUREMENT MoFTrsmAssc_flgGearLvrNeut "Flag indicating gear lever is in Neutral" UBYTE B_TRUE 1 100 0.00 1.00000000000 BIT_MASK 0x2 FORMAT "%13.11" ECU_ADDRESS 0x6002C3F1
 /begin IF_DATA XCPplus 0x0102
  /begin DAQ_EVENT VARIABLE /end DAQ_EVENT
 /end IF_DATA
/end MEASUREMENT
/begin MEASUREMENT MoFTrsmAssc_flgGearLvrPark "Flag indicating gear lever is in Park" UBYTE B_TRUE 1 100 0.00 1.00000000000 BIT_MASK 0x4 FORMAT "%13.11" ECU_ADDRESS 0x6002C3F1
 /begin IF_DATA XCPplus 0x0102
  /begin DAQ_EVENT VARIABLE /end DAQ_EVENT
 /end IF_DATA
/end MEASUREMENT
/begin MEASUREMENT MoFTrsmAssc_flgGearLvrRe "Flag indicating gear lever is in Reverse" UBYTE B_TRUE 1 100 0.00 1.00000000000 BIT_MASK 0x8 FORMAT "%13.11" ECU_ADDRESS 0x6002C3F1
 /begin IF_DATA XCPplus 0x0102
  /begin DAQ_EVENT VARIABLE /end DAQ_EVENT
 /end IF_DATA
/end MEASUREMENT
/begin MEASUREMENT MoFTrsmAssc_flgGearNumQlfr_tmp "Qualifier error flag" UBYTE B_TRUE 1 100 0.00 1.00000000000 BIT_MASK 0x4 FORMAT "%13.11" ECU_ADDRESS 0x6002C402
 /begin IF_DATA XCPplus 0x0102
  /begin DAQ_EVENT VARIABLE /end DAQ_EVENT
 /end IF_DATA
/end MEASUREMENT
/begin MEASUREMENT MoFTrsmAssc_flgGearReqRst "Flag to indicate the requested gear state is reset" UBYTE B_TRUE 1 100 0.00 1.00000000000 BIT_MASK 0x8 FORMAT "%13.11" ECU_ADDRESS 0x6002C402
 /begin IF_DATA XCPplus 0x0102
  /begin DAQ_EVENT VARIABLE /end DAQ_EVENT
 /end IF_DATA
/end MEASUREMENT
/begin MEASUREMENT MoFTrsmAssc_flgNeutReq "Neutral Request" UBYTE B_TRUE 1 100 0.00 1.00000000000 BIT_MASK 0x1 FORMAT "%13.11" ECU_ADDRESS 0x6002C401
 /begin IF_DATA XCPplus 0x0102
  /begin DAQ_EVENT VARIABLE /end DAQ_EVENT
 /end IF_DATA
/end MEASUREMENT
/begin MEASUREMENT MoFTrsmAssc_flgRvsReq "Reverse Request" UBYTE B_TRUE 1 100 0.00 1.00000000000 BIT_MASK 0x2 FORMAT "%13.11" ECU_ADDRESS 0x6002C401
 /begin IF_DATA XCPplus 0x0102
  /begin DAQ_EVENT VARIABLE /end DAQ_EVENT
 /end IF_DATA
/end MEASUREMENT
/begin MEASUREMENT MoFTrsmAssc_flgRvsRst "Flag to indicate the permitted status of REVERSE is reset" UBYTE B_TRUE 1 100 0.00 1.00000000000 BIT_MASK 0x10 FORMAT "%13.11" ECU_ADDRESS 0x6002C402
 /begin IF_DATA XCPplus 0x0102
  /begin DAQ_EVENT VARIABLE /end DAQ_EVENT
 /end IF_DATA
/end MEASUREMENT
/begin MEASUREMENT MoFTrsmAssc_flgSafeVehSpd "Flag to indicate the vehicle speed is within the Drive and reverse reset threshold limits" UBYTE B_TRUE 1 100 0.00 1.00000000000 BIT_MASK 0x20 FORMAT "%13.11" ECU_ADDRESS 0x6002C402
 /begin IF_DATA XCPplus 0x0102
  /begin DAQ_EVENT VARIABLE /end DAQ_EVENT
 /end IF_DATA
/end MEASUREMENT
/begin MEASUREMENT MoFTrsmAssc_flgTrsmMaxPtdMsg "Message to level1: Increasing transmission intervention permitted in function monitoring" UBYTE B_TRUE 1 100 0.00 1.00000000000 BIT_MASK 0x1 FORMAT "%13.11" ECU_ADDRESS 0x70000226
 /begin IF_DATA XCPplus 0x0102
  /begin DAQ_EVENT VARIABLE /end DAQ_EVENT
 /end IF_DATA
/end MEASUREMENT
/begin MEASUREMENT MoFTrsmAssc_flgTrsmMinPtdMsg "Message to level1: Decreasing transmission intervention permitted in function monitoring" UBYTE B_TRUE 1 100 0.00 1.00000000000 BIT_MASK 0x1 FORMAT "%13.11" ECU_ADDRESS 0x70000225
 /begin IF_DATA XCPplus 0x0102
  /begin DAQ_EVENT VARIABLE /end DAQ_EVENT
 /end IF_DATA
/end MEASUREMENT
/begin MEASUREMENT MoFTrsmAssc_stGearNr "Requested gear status in function safety" UBYTE OneToOne 1 100 0.00 255.0 FORMAT "%5.1" ECU_ADDRESS 0x6002C3FC
 /begin IF_DATA XCPplus 0x0102
  /begin DAQ_EVENT VARIABLE /end DAQ_EVENT
 /end IF_DATA
/end MEASUREMENT
/begin MEASUREMENT MoFTrsmAssc_stGearNrCpl "Complement for MoFTrsmAssc_stGearNr" UBYTE OneToOne 1 100 0.00 255.0 FORMAT "%5.1" ECU_ADDRESS 0x6002B9DF
 /begin IF_DATA XCPplus 0x0102
  /begin DAQ_EVENT VARIABLE /end DAQ_EVENT
 /end IF_DATA
/end MEASUREMENT
/begin MEASUREMENT MoFTrsmAssc_stGearNrLvl1 "Status of requested gear in level1 mapped to function safety" UBYTE OneToOne 1 100 0.00 255.0 FORMAT "%5.1" ECU_ADDRESS 0x6002C3FB
 /begin IF_DATA XCPplus 0x0102
  /begin DAQ_EVENT VARIABLE /end DAQ_EVENT
 /end IF_DATA
/end MEASUREMENT
/begin MEASUREMENT MoFTrsmAssc_stGearNrLvl1Cpl "Complement for MoFTrsmAssc_stGearNrLvl1" UBYTE OneToOne 1 100 0.00 255.0 FORMAT "%5.1" ECU_ADDRESS 0x6002B9DE
 /begin IF_DATA XCPplus 0x0102
  /begin DAQ_EVENT VARIABLE /end DAQ_EVENT
 /end IF_DATA
/end MEASUREMENT
/begin MEASUREMENT MoFTrsmAssc_stGearNrOld "Requested gear status previous value" UBYTE OneToOne 1 100 0.00 255.0 FORMAT "%5.1" ECU_ADDRESS 0x6002C3FA
 /begin IF_DATA XCPplus 0x0102
  /begin DAQ_EVENT VARIABLE /end DAQ_EVENT
 /end IF_DATA
/end MEASUREMENT
/begin MEASUREMENT MoFTrsmAssc_stGearNrOldCpl "complement for MoFTrsmAssc_stGearNrOld" UBYTE OneToOne 1 100 0.00 255.0 FORMAT "%5.1" ECU_ADDRESS 0x6002B9DD
 /begin IF_DATA XCPplus 0x0102
  /begin DAQ_EVENT VARIABLE /end DAQ_EVENT
 /end IF_DATA
/end MEASUREMENT
/begin MEASUREMENT MoFTrsmAssc_stGearNrProtd "L2 Final Gear value stored in ProtRAM" UBYTE OneToOne 1 100 0.00 255.0 FORMAT "%5.1" ECU_ADDRESS 0x600347C0
 /begin IF_DATA XCPplus 0x0102
  /begin DAQ_EVENT VARIABLE /end DAQ_EVENT
 /end IF_DATA
/end MEASUREMENT
/begin MEASUREMENT MoFTrsmAssc_stGearNrProtdCpl "Cpompliment" UBYTE OneToOne 1 100 0.00 255.0 FORMAT "%5.1" ECU_ADDRESS 0x600347BF
 /begin IF_DATA XCPplus 0x0102
  /begin DAQ_EVENT VARIABLE /end DAQ_EVENT
 /end IF_DATA
/end MEASUREMENT
/begin MEASUREMENT MoFTrsmAssc_stGearNrPtd "Permitted status for gear state" UBYTE OneToOne 1 100 0.00 255.0 FORMAT "%5.1" ECU_ADDRESS 0x6002C3F9
 /begin IF_DATA XCPplus 0x0102
  /begin DAQ_EVENT VARIABLE /end DAQ_EVENT
 /end IF_DATA
/end MEASUREMENT
/begin MEASUREMENT MoFTrsmAssc_stGearNrPtdCpl "Complement for MoFTrsmAssc_stGearNrPtd" UBYTE OneToOne 1 100 0.00 255.0 FORMAT "%5.1" ECU_ADDRESS 0x6002B9DC
 /begin IF_DATA XCPplus 0x0102
  /begin DAQ_EVENT VARIABLE /end DAQ_EVENT
 /end IF_DATA
/end MEASUREMENT
/begin MEASUREMENT MoFTrsmAssc_stGearNrReq "Requested gear state in function safety without error" UBYTE OneToOne 1 100 0.00 255.0 FORMAT "%5.1" ECU_ADDRESS 0x6002C3F8
 /begin IF_DATA XCPplus 0x0102
  /begin DAQ_EVENT VARIABLE /end DAQ_EVENT
 /end IF_DATA
/end MEASUREMENT
/begin MEASUREMENT MoFTrsmAssc_stGearNrReqCpl "Complement for MoFTrsmAssc_stGearNrReq" UBYTE OneToOne 1 100 0.00 255.0 FORMAT "%5.1" ECU_ADDRESS 0x6002B9DB
 /begin IF_DATA XCPplus 0x0102
  /begin DAQ_EVENT VARIABLE /end DAQ_EVENT
 /end IF_DATA
/end MEASUREMENT
/begin MEASUREMENT MoFTrsmAssc_stGearNumProtd "Com gear value in L2 stored in ProtRAM" UBYTE OneToOne 1 100 0.00 255.0 FORMAT "%5.1" ECU_ADDRESS 0x600347BE
 /begin IF_DATA XCPplus 0x0102
  /begin DAQ_EVENT VARIABLE /end DAQ_EVENT
 /end IF_DATA
/end MEASUREMENT
/begin MEASUREMENT MoFTrsmAssc_stGearNumProtdCpl "Compliment" UBYTE OneToOne 1 100 0.00 255.0 FORMAT "%5.1" ECU_ADDRESS 0x600347BD
 /begin IF_DATA XCPplus 0x0102
  /begin DAQ_EVENT VARIABLE /end DAQ_EVENT
 /end IF_DATA
/end MEASUREMENT
/begin MEASUREMENT MoFTrsmAssc_stGearNumTran "Gear Transmision state" UBYTE OneToOne 1 100 0.00 255.0 FORMAT "%5.1" ECU_ADDRESS 0x6002C3F7
 /begin IF_DATA XCPplus 0x0102
  /begin DAQ_EVENT VARIABLE /end DAQ_EVENT
 /end IF_DATA
/end MEASUREMENT
/begin MEASUREMENT MoFTrsmAssc_stGearNumTranCpl "MoFTrsmAssc_stGearNumTran Cpl" UBYTE OneToOne 1 100 0.00 255.0 FORMAT "%5.1" ECU_ADDRESS 0x6002B9DA
 /begin IF_DATA XCPplus 0x0102
  /begin DAQ_EVENT VARIABLE /end DAQ_EVENT
 /end IF_DATA
/end MEASUREMENT
/begin MEASUREMENT MoFTrsmAssc_stGearNumTranProtd "L2 Gear Transition value stored in ProtRAM" UBYTE OneToOne 1 100 0.00 255.0 FORMAT "%5.1" ECU_ADDRESS 0x600347BC
 /begin IF_DATA XCPplus 0x0102
  /begin DAQ_EVENT VARIABLE /end DAQ_EVENT
 /end IF_DATA
/end MEASUREMENT
/begin MEASUREMENT MoFTrsmAssc_stGearNumTranProtdCpl "Compliment" UBYTE OneToOne 1 100 0.00 255.0 FORMAT "%5.1" ECU_ADDRESS 0x600347BB
 /begin IF_DATA XCPplus 0x0102
  /begin DAQ_EVENT VARIABLE /end DAQ_EVENT
 /end IF_DATA
/end MEASUREMENT
/begin MEASUREMENT MoFTrsmAssc_stGearNumTran_prev "Previous state of Gear Transmision" UBYTE OneToOne 1 100 0.00 255.0 FORMAT "%5.1" ECU_ADDRESS 0x6002C3F6
 /begin IF_DATA XCPplus 0x0102
  /begin DAQ_EVENT VARIABLE /end DAQ_EVENT
 /end IF_DATA
/end MEASUREMENT
/begin MEASUREMENT MoFTrsmAssc_stGearNumTran_prevCpl "MoFTrsmAssc_stGearNumTran_prev Cpl" UBYTE OneToOne 1 100 0.00 255.0 FORMAT "%5.1" ECU_ADDRESS 0x6002B9D9
 /begin IF_DATA XCPplus 0x0102
  /begin DAQ_EVENT VARIABLE /end DAQ_EVENT
 /end IF_DATA
/end MEASUREMENT
/begin MEASUREMENT MoFTrsmAssc_stGearNum_prev "Previous Gear state from COM" UBYTE OneToOne 1 100 0.00 255.0 FORMAT "%5.1" ECU_ADDRESS 0x6002C3F5
 /begin IF_DATA XCPplus 0x0102
  /begin DAQ_EVENT VARIABLE /end DAQ_EVENT
 /end IF_DATA
/end MEASUREMENT
/begin MEASUREMENT MoFTrsmAssc_stGearNum_prevCpl "MoFTrsmAssc_stGearNum_prev Cpl" UBYTE OneToOne 1 100 0.00 255.0 FORMAT "%5.1" ECU_ADDRESS 0x6002B9D8
 /begin IF_DATA XCPplus 0x0102
  /begin DAQ_EVENT VARIABLE /end DAQ_EVENT
 /end IF_DATA
/end MEASUREMENT
/begin MEASUREMENT MoFTrsmAssc_stGearNum_tmp "Gear state from COM" UBYTE OneToOne 1 100 0.00 255.0 FORMAT "%5.1" ECU_ADDRESS 0x6002C3F4
 /begin IF_DATA XCPplus 0x0102
  /begin DAQ_EVENT VARIABLE /end DAQ_EVENT
 /end IF_DATA
/end MEASUREMENT
/begin MEASUREMENT MoFTrsmAssc_stGearNum_tmpCpl "MoFTrsmAssc_stGearNum_tmp Cpl" UBYTE OneToOne 1 100 0.00 255.0 FORMAT "%5.1" ECU_ADDRESS 0x6002B9D7
 /begin IF_DATA XCPplus 0x0102
  /begin DAQ_EVENT VARIABLE /end DAQ_EVENT
 /end IF_DATA
/end MEASUREMENT
/begin MEASUREMENT MoFTrsmAssc_stGearNum_vld "Valid Gear Change state" UBYTE OneToOne 1 100 0.00 255.0 FORMAT "%5.1" ECU_ADDRESS 0x6002C3F3
 /begin IF_DATA XCPplus 0x0102
  /begin DAQ_EVENT VARIABLE /end DAQ_EVENT
 /end IF_DATA
/end MEASUREMENT
/begin MEASUREMENT MoFTrsmAssc_stGearNum_vldCpl "Compliment" UBYTE OneToOne 1 100 0.00 255.0 FORMAT "%5.1" ECU_ADDRESS 0x6002B9D6
 /begin IF_DATA XCPplus 0x0102
  /begin DAQ_EVENT VARIABLE /end DAQ_EVENT
 /end IF_DATA
/end MEASUREMENT
/begin MEASUREMENT MoFTrsmAssc_stModChgReqChg "Mode Change Request debounce state" UBYTE OneToOne 1 100 0.00 255.0 FORMAT "%5.1" ECU_ADDRESS 0x6002C3F2
 /begin IF_DATA XCPplus 0x0102
  /begin DAQ_EVENT VARIABLE /end DAQ_EVENT
 /end IF_DATA
/end MEASUREMENT
/begin MEASUREMENT MoFTrsmAssc_stModChgReqChgCpl "Compliment" UBYTE OneToOne 1 100 0.00 255.0 FORMAT "%5.1" ECU_ADDRESS 0x6002B9D5
 /begin IF_DATA XCPplus 0x0102
  /begin DAQ_EVENT VARIABLE /end DAQ_EVENT
 /end IF_DATA
/end MEASUREMENT
/begin MEASUREMENT MoFTrsmAssc_tqTrsmDecIntv01 "Decreasing torque intervention" SWORD Trq 1 100 -3276.800 3276.700 FORMAT "%8.3" ECU_ADDRESS 0x6002C3EC
 /begin IF_DATA XCPplus 0x0102
  /begin DAQ_EVENT VARIABLE /end DAQ_EVENT
 /end IF_DATA
/end MEASUREMENT
/begin MEASUREMENT MoFTrsmAssc_tqTrsmDecIntv01Cpl "RAM data redundancy of MoFTrsmAssc_tqTrsmDecIntv01" UWORD OneToOne 1 100 0.00 65535.00 FORMAT "%8.2" ECU_ADDRESS 0x6002B9D0
 /begin IF_DATA XCPplus 0x0102
  /begin DAQ_EVENT VARIABLE /end DAQ_EVENT
 /end IF_DATA
/end MEASUREMENT
/begin MEASUREMENT MoFTrsmAssc_tqTrsmDecIntv02 "Decreasing torque intervention from transmission for EM02 in function monitoring" SWORD Trq 1 100 -3276.800 3276.700 FORMAT "%8.3" ECU_ADDRESS 0x6002C3EA
 /begin IF_DATA XCPplus 0x0102
  /begin DAQ_EVENT VARIABLE /end DAQ_EVENT
 /end IF_DATA
/end MEASUREMENT
/begin MEASUREMENT MoFTrsmAssc_tqTrsmDecIntv02Cpl "RAM data redundancy of MoFTrsmAssc_tqTrsmDecIntv02" UWORD OneToOne 1 100 0.00 65535.00 FORMAT "%8.2" ECU_ADDRESS 0x6002B9CE
 /begin IF_DATA XCPplus 0x0102
  /begin DAQ_EVENT VARIABLE /end DAQ_EVENT
 /end IF_DATA
/end MEASUREMENT
/begin MEASUREMENT MoFTrsmAssc_tqTrsmDecIntv03 "Decreasing torque intervention from transmission for EM03 in function monitoring" SWORD Trq 1 100 -3276.800 3276.700 FORMAT "%8.3" ECU_ADDRESS 0x6002C3E8
 /begin IF_DATA XCPplus 0x0102
  /begin DAQ_EVENT VARIABLE /end DAQ_EVENT
 /end IF_DATA
/end MEASUREMENT
/begin MEASUREMENT MoFTrsmAssc_tqTrsmDecIntv03Cpl "RAM data redundancy of MoFTrsmAssc_tqTrsmDecIntv03" UWORD OneToOne 1 100 0.00 65535.00 FORMAT "%8.2" ECU_ADDRESS 0x6002B9CC
 /begin IF_DATA XCPplus 0x0102
  /begin DAQ_EVENT VARIABLE /end DAQ_EVENT
 /end IF_DATA
/end MEASUREMENT
/begin MEASUREMENT MoFTrsmAssc_tqTrsmDecIntv04 "Decreasing torque intervention from transmission for EM04 in function monitoring" SWORD Trq 1 100 -3276.800 3276.700 FORMAT "%8.3" ECU_ADDRESS 0x6002C3E6
 /begin IF_DATA XCPplus 0x0102
  /begin DAQ_EVENT VARIABLE /end DAQ_EVENT
 /end IF_DATA
/end MEASUREMENT
/begin MEASUREMENT MoFTrsmAssc_tqTrsmDecIntv04Cpl "RAM data redundancy of MoFTrsmAssc_tqTrsmDecIntv04" UWORD OneToOne 1 100 0.00 65535.00 FORMAT "%8.2" ECU_ADDRESS 0x6002B9CA
 /begin IF_DATA XCPplus 0x0102
  /begin DAQ_EVENT VARIABLE /end DAQ_EVENT
 /end IF_DATA
/end MEASUREMENT
/begin MEASUREMENT MoFTrsmAssc_tqTrsmIncIntv01 "Increasing torque intervention" SWORD Trq 1 100 -3276.800 3276.700 FORMAT "%8.3" ECU_ADDRESS 0x6002C3E4
 /begin IF_DATA XCPplus 0x0102
  /begin DAQ_EVENT VARIABLE /end DAQ_EVENT
 /end IF_DATA
/end MEASUREMENT
/begin MEASUREMENT MoFTrsmAssc_tqTrsmIncIntv01Cpl "RAM data redundancy of MoFTrsmAssc_tqTrsmIncIntv01" UWORD OneToOne 1 100 0.00 65535.00 FORMAT "%8.2" ECU_ADDRESS 0x6002B9C8
 /begin IF_DATA XCPplus 0x0102
  /begin DAQ_EVENT VARIABLE /end DAQ_EVENT
 /end IF_DATA
/end MEASUREMENT
/begin MEASUREMENT MoFTrsmAssc_tqTrsmIncIntv02 "Increasing torque intervention from transmission for EM02 in function monitoring" SWORD Trq 1 100 -3276.800 3276.700 FORMAT "%8.3" ECU_ADDRESS 0x6002C3E2
 /begin IF_DATA XCPplus 0x0102
  /begin DAQ_EVENT VARIABLE /end DAQ_EVENT
 /end IF_DATA
/end MEASUREMENT
/begin MEASUREMENT MoFTrsmAssc_tqTrsmIncIntv02Cpl "RAM data redundancy of MoFTrsmAssc_tqTrsmIncIntv02" UWORD OneToOne 1 100 0.00 65535.00 FORMAT "%8.2" ECU_ADDRESS 0x6002B9C6
 /begin IF_DATA XCPplus 0x0102
  /begin DAQ_EVENT VARIABLE /end DAQ_EVENT
 /end IF_DATA
/end MEASUREMENT
/begin MEASUREMENT MoFTrsmAssc_tqTrsmIncIntv03 "Increasing torque intervention from transmission for EM03 in function monitoring" SWORD Trq 1 100 -3276.800 3276.700 FORMAT "%8.3" ECU_ADDRESS 0x6002C3E0
 /begin IF_DATA XCPplus 0x0102
  /begin DAQ_EVENT VARIABLE /end DAQ_EVENT
 /end IF_DATA
/end MEASUREMENT
/begin MEASUREMENT MoFTrsmAssc_tqTrsmIncIntv03Cpl "RAM data redundancy of MoFTrsmAssc_tqTrsmIncIntv03" UWORD OneToOne 1 100 0.00 65535.00 FORMAT "%8.2" ECU_ADDRESS 0x6002B9C4
 /begin IF_DATA XCPplus 0x0102
  /begin DAQ_EVENT VARIABLE /end DAQ_EVENT
 /end IF_DATA
/end MEASUREMENT
/begin MEASUREMENT MoFTrsmAssc_tqTrsmIncIntv04 "Increasing torque intervention from transmission for EM04 in function monitoring" SWORD Trq 1 100 -3276.800 3276.700 FORMAT "%8.3" ECU_ADDRESS 0x6002C3DE
 /begin IF_DATA XCPplus 0x0102
  /begin DAQ_EVENT VARIABLE /end DAQ_EVENT
 /end IF_DATA
/end MEASUREMENT
/begin MEASUREMENT MoFTrsmAssc_tqTrsmIncIntv04Cpl "RAM data redundancy of MoFTrsmAssc_tqTrsmIncIntv04" UWORD OneToOne 1 100 0.00 65535.00 FORMAT "%8.2" ECU_ADDRESS 0x6002B9C2
 /begin IF_DATA XCPplus 0x0102
  /begin DAQ_EVENT VARIABLE /end DAQ_EVENT
 /end IF_DATA
/end MEASUREMENT
/begin MEASUREMENT MoFVarPostBldSel_bbLoc1Cpl "RAM data redundancy of MoFVarPostBldSel_bbLoc1" UBYTE OneToOne 1 100 0.00 255.0 FORMAT "%5.1" ECU_ADDRESS 0x6002B9B8
 /begin IF_DATA XCPplus 0x0102
  /begin DAQ_EVENT VARIABLE /end DAQ_EVENT
 /end IF_DATA
/end MEASUREMENT
/begin MEASUREMENT MoFVarPostBldSel_bbOut1Cpl "RAM data redundancy of MoFVarPostBldSel_bbOut1" UBYTE OneToOne 1 100 0.00 255.0 FORMAT "%5.1" ECU_ADDRESS 0x6002B9B7
 /begin IF_DATA XCPplus 0x0102
  /begin DAQ_EVENT VARIABLE /end DAQ_EVENT
 /end IF_DATA
/end MEASUREMENT
/begin MEASUREMENT MonGbx_stGearLvr "Gearbox Status Gear Lever" UBYTE MonGbx_stGearLvr_VERB 1 100 0.00 255.000000000 FORMAT "%13.9" ECU_ADDRESS 0x6002C3F0
 /begin IF_DATA XCPplus 0x0102
  /begin DAQ_EVENT VARIABLE /end DAQ_EVENT
 /end IF_DATA
/end MEASUREMENT
/begin MEASUREMENT MonGbx_stGearLvrCpl "MonGbx_stGearLvr Cpl" UBYTE OneToOne 1 100 0.00 255.0 FORMAT "%5.1" ECU_ADDRESS 0x6002B9D4
 /begin IF_DATA XCPplus 0x0102
  /begin DAQ_EVENT VARIABLE /end DAQ_EVENT
 /end IF_DATA
/end MEASUREMENT
/begin MEASUREMENT MonGbx_stGearLvrQlfr "Gearbox Status Gear Lever Qualifier" UWORD OneToOne 1 100 0.00 65535.00 FORMAT "%8.2" ECU_ADDRESS 0x6002C3EE
 /begin IF_DATA XCPplus 0x0102
  /begin DAQ_EVENT VARIABLE /end DAQ_EVENT
 /end IF_DATA
/end MEASUREMENT
/begin MEASUREMENT MonGbx_stGearLvrQlfrCpl "MonGbx_stGearLvrQlfr Cpl" UWORD OneToOne 1 100 0.00 65535.00 FORMAT "%8.2" ECU_ADDRESS 0x6002B9D2
 /begin IF_DATA XCPplus 0x0102
  /begin DAQ_EVENT VARIABLE /end DAQ_EVENT
 /end IF_DATA
/end MEASUREMENT
/begin FUNCTION MoFTqPtdVeh_Comp "5.3.0     Function monitoring Torque comparison vehicle level"
 /begin DEF_CHARACTERISTIC DFC_CtlMsk2.DFC_MoFTqPtdVeh_C DFC_DisblMsk2.DFC_MoFTqPtdVeh_C MoFTqPtdVeh_cntrTestComp_C MoFTqPtdVeh_cntrTqCompMax_C MoFTqPtdVeh_enaOthTrqCompErr_C MoFTqPtdVeh_ratTqDifVehWght_T MoFTqPtdVeh_tqNegPtdOffs_M MoFTqPtdVeh_tqNegStaty_C MoFTqPtdVeh_tqPosPtdOffs_M MoFTqPtdVeh_tqPosStaty_C MoFTqPtdVeh_tqTiIntegDec_C MoFTqPtdVeh_tqTiIntegErr_C MoFTqPtdVeh_tqTiIntegMax_C /end DEF_CHARACTERISTIC
 /begin IN_MEASUREMENT MoFBas_vVeh MoFTqPtdAxleSec_stErrTqComp MoFTqPtdAxle_stErrTqComp MoFTqPtdEmSec_stErrTqComp MoFTqPtdEm_stErrTqComp MoFTqPtdVeh_tqWhlCoord Mo_stCplChk Mo_stMoC Mo_stMoCCpl VehDrvEv_tqZrCrssFild /end IN_MEASUREMENT
 /begin OUT_MEASUREMENT DFC_st.DFC_MoFTqPtdVeh MoFTqPtdVeh_flgIrrvErrMsg MoFTqPtdVeh_flgTestMsg MoFTqPtdVeh_stErrTqComp MoFTqPtdVeh_tqWhlDes /end OUT_MEASUREMENT
 /begin LOC_MEASUREMENT MoFTqPtdVehComp_bbLoc1Cpl MoFTqPtdVehComp_bbLoc2Cpl MoFTqPtdVeh_cntrTestComp MoFTqPtdVeh_cntrTqComp MoFTqPtdVeh_cntrTqCompCpl MoFTqPtdVeh_flgClr MoFTqPtdVeh_flgLwrLimExcd MoFTqPtdVeh_flgOthTrqCompErr MoFTqPtdVeh_flgTqCompDeb MoFTqPtdVeh_flgTqCompErr MoFTqPtdVeh_flgTqIntegDeb MoFTqPtdVeh_flgTqIntegErr MoFTqPtdVeh_flgTqLimChkErr MoFTqPtdVeh_flgTqVehNeg MoFTqPtdVeh_flgUpLimExcd MoFTqPtdVeh_stErrTqCompCpl MoFTqPtdVeh_tqDifVeh MoFTqPtdVeh_tqDifVehCpl MoFTqPtdVeh_tqLowrLim MoFTqPtdVeh_tqLowrLimCpl MoFTqPtdVeh_tqTiInteg MoFTqPtdVeh_tqTiIntegCpl MoFTqPtdVeh_tqUpLim MoFTqPtdVeh_tqUpLimCpl MoFTqPtdVeh_tqWhlCoordLoResl MoFTqPtdVeh_tqWhlCoordLoReslCpl MoFTqPtdVeh_tqWhlDesCpl /end LOC_MEASUREMENT
 FUNCTION_VERSION "5.3.0" /end FUNCTION
/begin FUNCTION MoFTqPtdVeh_Coorn "22.0.0    Function monitoring Coordination permitted torque vehicle level"
 /begin DEF_CHARACTERISTIC MoFTqPtdVeh_rAppCrsCtrlOvrL_C MoFTqPtdVeh_rAppCrsCtrlOvrR_C MoFTqPtdVeh_tiBrkgToZrRefFil_C MoFTqPtdVeh_tiPrpDrvrAsscRefFil_C MoFTqPtdVeh_tiRefFilDas_C MoFTqPtdVeh_tiRefFil_C MoFTqPtdVeh_tqDrvrOvrdHi_C MoFTqPtdVeh_tqDrvrOvrdLo_C MoFTqPtdVeh_tqHillHldRampMax_C MoFTqPtdVeh_tqHillHldRampMin_C MoFTqPtdVeh_tqMaxStepDwnRamp_C MoFTqPtdVeh_tqMaxStepUpRamp_C MoFTqPtdVeh_tqMinStepDwnRamp_C MoFTqPtdVeh_tqMinStepUpRamp_C MoFTqPtdVeh_tqNegSlop_C MoFTqPtdVeh_tqPosSlop_C MoFTqPtdVeh_tqRampLowrOffs_C MoFTqPtdVeh_tqRampUpprOffs_C MoFTqPtdVeh_tqSpdLimMin_T MoFTqPtdVeh_tqSpdLimPosStep_C MoFTqPtdVeh_vMaxFixdEco_C MoFTqPtdVeh_vMaxFixdNorm_C MoFTqPtdVeh_vMaxFixdRvs_C MoFTqPtdVeh_vMaxFixdSpt_C /end DEF_CHARACTERISTIC
 /begin REF_CHARACTERISTIC MoFTqPtdVeh_stDrvProgEco_C MoFTqPtdVeh_stDrvProgSpt_C /end REF_CHARACTERISTIC
 /begin IN_MEASUREMENT BrkgToZr_tqHillHldRamp CoPOM_tqWhlQstyMax CoPOM_tqWhlQstyMin CoVMDEv_tqDrvrDmd CoVMDEv_tqWithStrtUp CoVMD_tqAdas CoVMD_trqLLim MoFAccr_ratAccr MoFBas_vVeh MoFDrvrAssc_flgDrvrAsscActv MoFDrvrAssc_stAdasOvrd MoFDrvrAssc_tqDrvrAssc MoFEvMngt_flgBrkgToZrActvd MoFTqPtdVeh_stDrvProgReq MoFTqPtdVeh_tqAccrPedWhlDes MoFTqPtdVeh_tqDrvAwyDes MoFTrsmAssc_flgGearLvrRe Mo_stCplChk Mo_stMoC Mo_stMoCCpl /end IN_MEASUREMENT
 /begin OUT_MEASUREMENT MoFTqPtdVeh_flgDrvDmdHiPrio MoFTqPtdVeh_flgPrpDrvrAsscActv MoFTqPtdVeh_tqDes MoFTqPtdVeh_tqWhlCoordUnfild /end OUT_MEASUREMENT
 /begin LOC_MEASUREMENT MoFTqPtdVehCoorn_bbLoc1Cpl MoFTqPtdVehCoorn_bbOutCpl MoFTqPtdVeh_dirRamp MoFTqPtdVeh_dirRampCpl MoFTqPtdVeh_flgAccrPsd MoFTqPtdVeh_flgAPPOvrd MoFTqPtdVeh_flgBrkgToZrActvdOld MoFTqPtdVeh_flgBrkgToZrEdgeFall MoFTqPtdVeh_flgDrvrAsscisTar MoFTqPtdVeh_flgDrvrAsscisTarOld MoFTqPtdVeh_flgSwitch MoFTqPtdVeh_flgTarBlwCurrTq MoFTqPtdVeh_FltLoFil1 MoFTqPtdVeh_FltLoFil1Cpl MoFTqPtdVeh_FltLoFil2 MoFTqPtdVeh_FltLoFil2Cpl MoFTqPtdVeh_stRmpOn MoFTqPtdVeh_stRmpOnCpl MoFTqPtdVeh_tiLpFil MoFTqPtdVeh_tiLpFilCpl MoFTqPtdVeh_tqCoordSeldWithRampTq MoFTqPtdVeh_tqCoordSeldWithRampTqCpl MoFTqPtdVeh_tqCoordSeldWithRampTqOld MoFTqPtdVeh_tqCoordSeldWithRampTqOldCpl MoFTqPtdVeh_tqCoordUnfildRamp MoFTqPtdVeh_tqCoordUnfildRampCpl MoFTqPtdVeh_tqDesCpl MoFTqPtdVeh_tqFilIn MoFTqPtdVeh_tqFilInCpl MoFTqPtdVeh_tqFltHiFil1 MoFTqPtdVeh_tqFltHiFil1Cpl MoFTqPtdVeh_tqFltHiFil2 MoFTqPtdVeh_tqFltHiFil2Cpl MoFTqPtdVeh_tqHillHldRamp MoFTqPtdVeh_tqHillHldRampCpl MoFTqPtdVeh_tqHillHldRampLvl1 MoFTqPtdVeh_tqHillHldRampLvl1Cpl MoFTqPtdVeh_tqHillHldRampLvl1Lmtd MoFTqPtdVeh_tqHillHldRampLvl1LmtdCpl MoFTqPtdVeh_tqRampCrsCtrlLowrLim MoFTqPtdVeh_tqRampCrsCtrlLowrLimCpl MoFTqPtdVeh_tqRampCrsCtrlUpLim MoFTqPtdVeh_tqRampCrsCtrlUpLimCpl MoFTqPtdVeh_tqSpdLimDes MoFTqPtdVeh_tqSpdLimDesCpl MoFTqPtdVeh_tqSpdLimMin MoFTqPtdVeh_tqSpdLimMinCpl MoFTqPtdVeh_tqTarCoord MoFTqPtdVeh_tqTarCoordCpl MoFTqPtdVeh_tqWhlCoordNoFil MoFTqPtdVeh_tqWhlCoordNoFilCpl MoFTqPtdVeh_tqWhlCoordNoFilLimd MoFTqPtdVeh_tqWhlCoordNoFilLimdCpl MoFTqPtdVeh_tqWhlCoordUnfildCpl MoFTqPtdVeh_tqWhlCoordUnfildRamp MoFTqPtdVeh_tqWhlCoordUnfildRampCpl MoFTqPtdVeh_tqWhlDesWithDrvAwyDes MoFTqPtdVeh_tqWhlDesWithDrvAwyDesCpl MoFTqPtdVeh_vVehDifMax MoFTqPtdVeh_vVehDifMaxCpl /end LOC_MEASUREMENT
 FUNCTION_VERSION "22.0.0" /end FUNCTION
/begin FUNCTION MoFTqPtdVeh_DrvAwy "10.2.0    Function monitoring Drive off assistance"
 /begin DEF_CHARACTERISTIC MoFTqPtdVeh_cntrDebCrpDsblRst_C MoFTqPtdVeh_cntrDebReqDiCrp_C MoFTqPtdVeh_cntrDebSetDiCrpCtrl_C MoFTqPtdVeh_dTqDrvAwyGrdt_C MoFTqPtdVeh_rAPPActv_C MoFTqPtdVeh_swtBrkSeln_C MoFTqPtdVeh_swtCfgDisblCrp_C MoFTqPtdVeh_tqDrvAwayDes_C MoFTqPtdVeh_tqDrvAwyEcoDrv_T MoFTqPtdVeh_tqDrvAwyEcoRe_T MoFTqPtdVeh_tqDrvAwyNormDrv_T MoFTqPtdVeh_tqDrvAwyNormRe_T MoFTqPtdVeh_tqDrvAwySptDrv_T MoFTqPtdVeh_tqDrvAwySptRe_T MoFTqPtdVeh_vCrpOPDDeactvn_C MoFTqPtdVeh_vCrpRels_C MoFTqPtdVeh_vCrpTmpDeactvn_C MoFTqPtdVeh_vLimVehCrp_C /end DEF_CHARACTERISTIC
 /begin IN_MEASUREMENT MoFAccr_ratAccr MoFBas_vVehSignd MoFBrk_flgBrkErr MoFBrk_flgBrkMai MoFBrk_flgBrkRdnt MoFDrvrAssc_flgAtnmsDrvActv MoFFrm_flgDrvrDoorOpen MoFFrm_flgHMICrpDi MoFFrm_flgVehHldActv MoFFrm_stDrvrSeatBlt MoFFrm_stPrkgBrkSwt MoFRelsMngt_flgPtActv MoFTqPtdVeh_stDrvProgReqMsg MoFTrsmAssc_flgGearLvrDrv MoFTrsmAssc_flgGearLvrNeut MoFTrsmAssc_flgGearLvrPark MoFTrsmAssc_flgGearLvrRe Mo_stCplChk Mo_stMoC Mo_stMoCCpl StrtUpEv_flgPrmntDeactvd StrtUpEv_flgTmpDeactvd StrtUpEv_tqDes /end IN_MEASUREMENT
 /begin OUT_MEASUREMENT MoFTqPtdVeh_flgDiCreepMsg MoFTqPtdVeh_tqDrvAwyDes /end OUT_MEASUREMENT
 /begin LOC_MEASUREMENT MoFTqPtdVehDrvAwy_bbLoc1Cpl MoFTqPtdVehDrvAwy_bbLoc2Cpl MoFTqPtdVeh_cntrDebCrpDsblRst MoFTqPtdVeh_cntrDebCrpDsblRstCpl MoFTqPtdVeh_cntrDebReqDiCrp MoFTqPtdVeh_cntrDebReqDiCrpCpl MoFTqPtdVeh_cntrDebSetDiCrpCtrl MoFTqPtdVeh_cntrDebSetDiCrpCtrlCpl MoFTqPtdVeh_flgBrkPsdOld MoFTqPtdVeh_flgBrkSeln MoFTqPtdVeh_flgDiCrp MoFTqPtdVeh_flgDiCrpTmp MoFTqPtdVeh_flgDrvAwyGearLvrNeutOld MoFTqPtdVeh_flgGearLvrDrvOld MoFTqPtdVeh_flgGearLvrRvsOld MoFTqPtdVeh_flgHMICrpDisad MoFTqPtdVeh_flgReqDiCrp MoFTqPtdVeh_flgRstDiCrp MoFTqPtdVeh_flgRstDiCrpCtrl MoFTqPtdVeh_flgSetDiCrpCtrl MoFTqPtdVeh_stDiCrp MoFTqPtdVeh_stDiCrpCpl MoFTqPtdVeh_tqDrvAwy MoFTqPtdVeh_tqDrvAwyCpl MoFTqPtdVeh_tqDrvAwyDesCpl MoFTqPtdVeh_tqDrvAwyDesOld MoFTqPtdVeh_tqDrvAwyDesOldCpl MoFTqPtdVeh_tqDrvAwyMax MoFTqPtdVeh_tqDrvAwyMaxCpl MoFTqPtdVeh_tqDrvAwyRampd MoFTqPtdVeh_tqDrvAwyRampdCpl MoFTqPtdVeh_tqDrvAwyRampDwn MoFTqPtdVeh_tqDrvAwyRampDwnCpl /end LOC_MEASUREMENT
 FUNCTION_VERSION "10.2.0" /end FUNCTION
/begin FUNCTION MoFTqPtdVeh_DrvProg "1.1.0     Function monitoring Drive program"
 /begin DEF_CHARACTERISTIC MoFTqPtdVeh_stDrvProgEco_C MoFTqPtdVeh_stDrvProgNorm_C MoFTqPtdVeh_stDrvProgSpt_C /end DEF_CHARACTERISTIC
 /begin IN_MEASUREMENT DrvPrgSwt_stRcpt DrvPrgSwt_stReq Mo_stCplChk Mo_stMoC Mo_stMoCCpl /end IN_MEASUREMENT
 /begin OUT_MEASUREMENT MoFTqPtdVeh_stDrvProgReq MoFTqPtdVeh_stDrvProgReqMsg MoFTqPtdVeh_stRcptMsg MoFTqPtdVeh_stRecupMod /end OUT_MEASUREMENT
 /begin LOC_MEASUREMENT MoFTqPtdVeh_stDrvProgReqCpl MoFTqPtdVeh_stRecupModCpl /end LOC_MEASUREMENT
 FUNCTION_VERSION "1.1.0" /end FUNCTION
/begin FUNCTION MoFTqPtdVeh_DrvrDmd "19.2.0    Function monitoring Driver torque demand"
 /begin DEF_CHARACTERISTIC MoFTqPtdVeh_aRecupDrvOnePedlDrvg_M MoFTqPtdVeh_aRecupRvsOnePedlDrvg_M MoFTqPtdVeh_cntrSwtDrvProgDly_C MoFTqPtdVeh_facDifModPerStep_T MoFTqPtdVeh_flgCnvnFacSwt_C MoFTqPtdVeh_flgOnePedlDrvgExtReq_C MoFTqPtdVeh_lenWhlCircum_C MoFTqPtdVeh_mTotVeh_C MoFTqPtdVeh_RstVehV_C MoFTqPtdVeh_tqRecupOnePedlDrvgLim_C MoFTqPtdVeh_tqRecupOnePedlDrvgPerStepMax_T MoFTqPtdVeh_tqRecupOnePedlDrvgPerStepMin_T MoFTqPtdVeh_tqWhlEco_M MoFTqPtdVeh_tqWhlNorm_M MoFTqPtdVeh_tqWhlRvs_M MoFTqPtdVeh_tqWhlSpt_M /end DEF_CHARACTERISTIC
 /begin REF_CHARACTERISTIC MoFTqPtdVeh_stDrvProgEco_C MoFTqPtdVeh_stDrvProgNorm_C MoFTqPtdVeh_stDrvProgSpt_C MoFTrsmAssc_ctRst_C /end REF_CHARACTERISTIC
 /begin IN_MEASUREMENT AccPedEv_tqPrp AccPedEv_tqRecupFacOnePedlLim CoPOM_tqWhlQstyMin MoFBas_vVehSignd MoFFrm_aRecupDrvOnePedlDrvg MoFFrm_aRecupRvsOnePedlDrvg MoFTqPtdVeh_facRecupOnePedlDrvg MoFTqPtdVeh_ratPrpOnePedlDrvg MoFTqPtdVeh_stDrvProgReq MoFTrsmAssc_flgGearLvrDrv MoFTrsmAssc_flgGearLvrNeut MoFTrsmAssc_flgGearLvrRe Mo_stCplChk Mo_stMoC Mo_stMoCCpl Reset_Env_ctRst Reset_VehV_v VehMot_a2trq /end IN_MEASUREMENT
 /begin OUT_MEASUREMENT MoFTqPtdVeh_flgOnePedlDrvgNeutRampActv MoFTqPtdVeh_tqAccrPedWhlDes MoFTqPtdVeh_tqRecupOnePedlDrvgMin MoFTqPtdVeh_tqRecupOnePedlDrvgMinMsg /end OUT_MEASUREMENT
 /begin LOC_MEASUREMENT MoFTqPtdVehDrvrDmd_bbLocCpl MoFTqPtdVehDrvrDmd_bbOutCpl MoFTqPtdVeh_aRecupOnePedlDrvg MoFTqPtdVeh_aRecupOnePedlDrvgCpl MoFTqPtdVeh_cntrSwtDrvProgDly MoFTqPtdVeh_cntrSwtDrvProgDlyCpl MoFTqPtdVeh_facDif MoFTqPtdVeh_facDifCpl MoFTqPtdVeh_facTranMap MoFTqPtdVeh_facTranMapCpl MoFTqPtdVeh_flgDrvProgActvOld MoFTqPtdVeh_flgDrvProgChgOld MoFTqptdVeh_flgSwtDrvProgDly MoFTqPtdVeh_stDrvProgDly MoFTqPtdVeh_stDrvProgDlyCpl MoFTqPtdVeh_stDrvProgDlyProtd MoFTqPtdVeh_stDrvProgDlyProtdCpl MoFTqPtdVeh_stDrvProgPrev MoFTqPtdVeh_stDrvProgPrevCpl MoFTqPtdVeh_stDrvProgReqRecupLoc MoFTqPtdVeh_stDrvProgReqRecupLocCpl MoFTqPtdVeh_stDrvProgTar MoFTqPtdVeh_stDrvProgTarCpl MoFTqPtdVeh_tqAccrPedWhlDesCpl MoFTqPtdVeh_tqDifMod MoFTqPtdVeh_tqDifModCpl MoFTqPtdVeh_tqMaxRecupOnePedlDrvg MoFTqPtdVeh_tqMaxRecupOnePedlDrvgCpl MoFTqPtdVeh_tqPrp MoFTqPtdVeh_tqPrpCpl MoFTqPtdVeh_tqPrpPrevMod MoFTqPtdVeh_tqPrpPrevModCpl MoFTqPtdVeh_tqRecup MoFTqPtdVeh_tqRecupCpl MoFTqPtdVeh_tqRecupOnePedlDrvg MoFTqPtdVeh_tqRecupOnePedlDrvgCpl MoFTqPtdVeh_tqRecupOnePedlDrvgLim MoFTqPtdVeh_tqRecupOnePedlDrvgLimCpl MoFTqPtdVeh_tqRecupOnePedlDrvgMinCpl MoFTqPtdVeh_vVehSigndRvs MoFTqPtdVeh_vVehSigndRvsCpl /end LOC_MEASUREMENT
 FUNCTION_VERSION "19.2.0" /end FUNCTION
/begin FUNCTION MoFTqPtdVeh_Fil "2.4.2     Function monitoring Permitted vehicle torque filter"
 /begin DEF_CHARACTERISTIC MoFTqPtdVeh_flgEM02Prsnt_C MoFTqPtdveh_stCfgASDrf_C MoFTqPtdVeh_tqGrdtMaxZrCrssBrkgZrNeg_M MoFTqPtdVeh_tqGrdtMaxZrCrssBrkgZrPos_M MoFTqPtdVeh_tqGrdtMaxZrCrssEco_M MoFTqPtdVeh_tqGrdtMaxZrCrssNegDas_M MoFTqPtdVeh_tqGrdtMaxZrCrssNegEco_M MoFTqPtdVeh_tqGrdtMaxZrCrssNegPrpDrvrAssc_M MoFTqPtdVeh_tqGrdtMaxZrCrssNegSpt_M MoFTqPtdVeh_tqGrdtMaxZrCrssNeg_M MoFTqPtdVeh_tqGrdtMaxZrCrssPosDas_M MoFTqPtdVeh_tqGrdtMaxZrCrssPosPrpDrvrAssc_M MoFTqPtdVeh_tqGrdtMaxZrCrssPos_M MoFTqPtdVeh_tqGrdtMaxZrCrssSpt_M MoFTqPtdVeh_tqGrdtReaTarBrkgZrNeg_T MoFTqPtdVeh_tqGrdtReaTarBrkgZrPos_T MoFTqPtdVeh_tqGrdtReaTarEco_T MoFTqPtdVeh_tqGrdtReaTarNegEco_T MoFTqPtdVeh_tqGrdtReaTarNegSpt_T MoFTqPtdVeh_tqGrdtReaTarNeg_T MoFTqPtdVeh_tqGrdtReaTarPos_T MoFTqPtdVeh_tqGrdtReaTarPrpDrvrAsscNeg_T MoFTqPtdVeh_tqGrdtReaTarPrpDrvrAsscPos_T MoFTqPtdVeh_tqGrdtReaTarSpt_T MoFTqPtdVeh_tqGrdtZrCrssLimBrkgToZrNeg_C MoFTqPtdVeh_tqGrdtZrCrssLimBrkgToZrPos_C MoFTqPtdVeh_tqGrdtZrCrssLimNegEco_C MoFTqPtdVeh_tqGrdtZrCrssLimNegSpt_C MoFTqPtdVeh_tqGrdtZrCrssLimNeg_C MoFTqPtdVeh_tqGrdtZrCrssLimPosEco_C MoFTqPtdVeh_tqGrdtZrCrssLimPosSpt_C MoFTqPtdVeh_tqGrdtZrCrssLimPos_C MoFTqPtdVeh_tqGrdtZrCrssLimPrpDrvrAsscNeg_C MoFTqPtdVeh_tqGrdtZrCrssLimPrpDrvrAsscPos_C MoFTqPtdVeh_tqWhlCoordRampFilOffs_T MoFTqPtdVeh_tqWhlCoordUnfildOffs_T MoFTqPtdVeh_tqWhlDesNoFil_T /end DEF_CHARACTERISTIC
 /begin REF_CHARACTERISTIC MoFTqPtdVeh_stDrvProgEco_C MoFTqPtdVeh_stDrvProgSpt_C /end REF_CHARACTERISTIC
 /begin IN_MEASUREMENT CoPOM_tqWhlQstyMax CoPOM_tqWhlQstyMaxWoDistbn CoPOM_tqWhlQstyMin MoFBas_vVeh MoFEvMngt_flgBrkgToZrActvd MoFTqPtdVeh_flgDrvDmdHiPrio MoFTqPtdVeh_flgPrpDrvrAsscActv MoFTqPtdVeh_stDrvProgReq MoFTqPtdVeh_tqDes MoFTqPtdVeh_tqWhlCoordUnfild Mo_stCplChk Mo_stMoC Mo_stMoCCpl VehDrvEv_tqDesLpFild VehDrvEv_tqZrCrssFild VMDEv_tqDes /end IN_MEASUREMENT
 /begin OUT_MEASUREMENT MoFTqPtdVeh_tqWhlCoord /end OUT_MEASUREMENT
 /begin LOC_MEASUREMENT MoFTqPtdVeh_tqDeltaZrCrss MoFTqPtdVeh_tqDeltaZrCrssCpl MoFTqPtdVeh_tqDesLvl1NotPT2Fild MoFTqPtdVeh_tqDesLvl1NotPT2FildCpl MoFTqPtdVeh_tqDesLvl2NotPT2Fild MoFTqPtdVeh_tqDesLvl2NotPT2FildCpl MoFTqPtdVeh_tqGrdtLimSlopeNeg MoFTqPtdVeh_tqGrdtLimSlopeNegCpl MoFTqPtdVeh_tqGrdtLimSlopePos MoFTqPtdVeh_tqGrdtLimSlopePosCpl MoFTqPtdVeh_tqGrdtMaxZrCrssBrkgZrNeg MoFTqPtdVeh_tqGrdtMaxZrCrssBrkgZrNegCpl MoFTqPtdVeh_tqGrdtMaxZrCrssBrkgZrPos MoFTqPtdVeh_tqGrdtMaxZrCrssBrkgZrPosCpl MoFTqPtdVeh_tqGrdtMaxZrCrssNeg MoFTqPtdVeh_tqGrdtMaxZrCrssNegCpl MoFTqPtdVeh_tqGrdtMaxZrCrssNegPrpDrvrAssc MoFTqPtdVeh_tqGrdtMaxZrCrssNegPrpDrvrAsscCpl MoFTqPtdVeh_tqGrdtMaxZrCrssPos MoFTqPtdVeh_tqGrdtMaxZrCrssPosCpl MoFTqPtdVeh_tqGrdtMaxZrCrssPosPrpDrvrAssc MoFTqPtdVeh_tqGrdtMaxZrCrssPosPrpDrvrAsscCpl MoFTqPtdVeh_tqGrdtNeg MoFTqPtdVeh_tqGrdtNegCpl MoFTqPtdVeh_tqGrdtNegMin MoFTqPtdVeh_tqGrdtNegMinCpl MoFTqPtdVeh_tqGrdtPos MoFTqPtdVeh_tqGrdtPosCpl MoFTqPtdVeh_tqGrdtPosMin MoFTqPtdVeh_tqGrdtPosMinCpl MoFTqPtdVeh_tqGrdtReaTar MoFTqPtdVeh_tqGrdtReaTarBrkgZrNeg MoFTqPtdVeh_tqGrdtReaTarBrkgZrNegCpl MoFTqPtdVeh_tqGrdtReaTarBrkgZrPos MoFTqPtdVeh_tqGrdtReaTarBrkgZrPosCpl MoFTqPtdVeh_tqGrdtReaTarCpl MoFTqPtdVeh_tqGrdtReaTarNeg MoFTqPtdVeh_tqGrdtReaTarNegCpl MoFTqPtdVeh_tqGrdtReaTarPrpDrvrAsscNeg MoFTqPtdVeh_tqGrdtReaTarPrpDrvrAsscNegCpl MoFTqPtdVeh_tqGrdtReaTarPrpDrvrAsscPos MoFTqPtdVeh_tqGrdtReaTarPrpDrvrAsscPosCpl MoFTqPtdVeh_tqHiResRampOut MoFTqPtdVeh_tqHiResRampOutCpl MoFTqPtdVeh_tqLvl1ZrCrssFild MoFTqPtdVeh_tqLvl1ZrCrssFildCpl MoFTqPtdVeh_tqNrm MoFTqPtdVeh_tqNrmCpl MoFTqPtdVeh_tqWhlCoordCpl MoFTqPtdVeh_tqWhlCoordNotFilMax MoFTqPtdVeh_tqWhlCoordNotFilMaxCpl MoFTqPtdVeh_tqWhlCoordOld MoFTqPtdVeh_tqWhlCoordOldCpl MoFTqPtdVeh_tqWhlCoordRampFilMax MoFTqPtdVeh_tqWhlCoordRampFilMaxCpl MoFTqPtdVeh_tqWhlDesNotPT2Fil MoFTqPtdVeh_tqWhlDesNotPT2FilCpl MoFTqPtdVeh_tqWhlQstyMaxLvl1 MoFTqPtdVeh_tqWhlQstyMaxLvl1Cpl MoFTqPtdVeh_tqWhlQstyMaxWoDistbnLvl1 MoFTqPtdVeh_tqWhlQstyMaxWoDistbnLvl1Cpl MoFTqPtdVeh_tqWhlQstyMinLvl1 MoFTqPtdVeh_tqWhlQstyMinLvl1Cpl MoFTqPtdVeh_tqZrCrssDrvgMod MoFTqPtdVeh_tqZrCrssDrvgModCpl MoFTqPtdVeh_tqZrCrssNegDrvgMod MoFTqPtdVeh_tqZrCrssNegDrvgModCpl /end LOC_MEASUREMENT
 FUNCTION_VERSION "2.4.2" /end FUNCTION
/begin FUNCTION MoFTqPtdVeh_OnePedlDrvg "1.1.1     Functional Safety one pedal driving"
 /begin DEF_CHARACTERISTIC MoFTqPtdVeh_deAppGrdtLvlRst_C MoFTqPtdVeh_facAPPGrdtLvl_T MoFTqPtdVeh_facRecupAppGrdtPerStepDec_C MoFTqPtdVeh_facRecupModStepMax_T MoFTqPtdVeh_facRecupMod_CA MoFTqPtdVeh_flgActvnRecupSwt_C MoFTqPtdVeh_flgVirtZrPntSwtExt_C MoFTqPtdVeh_ratCoastGapOnePedlDrvg_M MoFTqPtdVeh_ratCoastGapPerStepMax_T MoFTqPtdVeh_ratCoastGapRvsOnePedlDrvg_M MoFTqPtdVeh_ratVirtZrPntLim_C MoFTqPtdVeh_ratVirtZrPntOffs_C MoFTqPtdVeh_ratVirtZrPntOnePedlDrvg_M MoFTqPtdVeh_ratVirtZrPntPerStepDec_T MoFTqPtdVeh_ratVirtZrPntPerStepInct_T MoFTqPtdVeh_ratVirtZrPntRvsOnePedlDrvg_M MoFTqPtdVeh_ratZrPntOnePedlThd_C MoFTqPtdVeh_rMinGapThd_C MoFTqPtdVeh_stRecupMod_C /end DEF_CHARACTERISTIC
 /begin IN_MEASUREMENT AccPed_facRecupAppGrdt AccPed_facRecupBas AccPed_facRecupLvrLimd AccPed_rCoastGap AccPed_rPrpOnePedlDrvg AccPed_rRecupOnePedlDrvgStrt AccPed_rVirtZrPnt MoFAccr_ratAccr MoFBas_vVehSignd MoFDrvrAssc_flgAccActv MoFFrm_ratVirtZrPnt MoFTqPtdVeh_stDrvProgReq MoFTqPtdVeh_stRecupMod MoFTrsmAssc_flgGearLvrDrv MoFTrsmAssc_flgGearLvrRe Mo_stCplChk Mo_stMoC Mo_stMoCCpl /end IN_MEASUREMENT
 /begin OUT_MEASUREMENT MoFTqPtdVeh_facRecupOnePedlDrvg MoFTqPtdVeh_ratCoastGap MoFTqPtdVeh_ratPrpOnePedlDrvg MoFTqPtdVeh_ratVirtZrPnt /end OUT_MEASUREMENT
 /begin LOC_MEASUREMENT MoFTqPtdVeh_bbLoc1Cpl MoFTqPtdVeh_deAPPOld MoFTqPtdVeh_deAPPOldCpl MoFTqPtdVeh_deAPPRaw MoFTqPtdVeh_deAPPRawCpl MoFTqPtdVeh_facAppGrdt MoFTqPtdVeh_facAppGrdtCpl MoFTqPtdVeh_facRecupAppGrdt MoFTqPtdVeh_facRecupAppGrdtCpl MoFTqPtdVeh_facRecupAppGrdtRamp MoFTqPtdVeh_facRecupAppGrdtRampCpl MoFTqPtdVeh_facRecupMod MoFTqPtdVeh_facRecupModCpl MoFTqPtdVeh_facRecupModLimd MoFTqPtdVeh_facRecupModLimdCpl MoFTqPtdVeh_facRecupOnePedlDrvgBas MoFTqPtdVeh_facRecupOnePedlDrvgBasCpl MoFTqPtdVeh_facRecupOnePedlDrvgCpl MoFTqPtdVeh_flgAccRampRqrd MoFTqPtdVeh_ratAccrOld MoFTqPtdVeh_ratAccrOldCpl MoFTqPtdVeh_ratCoastGapCpl MoFTqPtdVeh_ratCoastGapLim MoFTqPtdVeh_ratCoastGapLimCpl MoFTqPtdVeh_ratCoastGapPerStepMax MoFTqPtdVeh_ratCoastGapPerStepMaxCpl MoFTqPtdVeh_ratCoastGapUnlim MoFTqPtdVeh_ratCoastGapUnlimCpl MoFTqPtdVeh_ratPrpOnePedlDrvgCpl MoFTqPtdVeh_ratPrpOnePedlDrvgLoc MoFTqPtdVeh_ratPrpOnePedlDrvgLocCpl MoFTqPtdVeh_ratRecupOnePedlDrvgStrt MoFTqPtdVeh_ratRecupOnePedlDrvgStrtCpl MoFTqPtdVeh_ratVirtZrPntCpl MoFTqPtdVeh_ratVirtZrPntLim MoFTqPtdVeh_ratVirtZrPntLimCpl MoFTqPtdVeh_ratVirtZrPntPerStepDec MoFTqPtdVeh_ratVirtZrPntPerStepDecCpl MoFTqPtdVeh_ratVirtZrPntPerStepInct MoFTqPtdVeh_ratVirtZrPntPerStepInctCpl MoFTqPtdVeh_ratVirtZrPntUnlim MoFTqPtdVeh_ratVirtZrPntUnlimCpl MoFTqPtdVeh_stDrvProgReqLoc MoFTqPtdVeh_stDrvProgReqLocCpl MoFTqPtdVeh_vSignCnvn MoFTqPtdVeh_vSignCnvnCpl /end LOC_MEASUREMENT
 FUNCTION_VERSION "1.1.1" /end FUNCTION
/begin FUNCTION MoFTrsmAssc_GearLvrCoorr "7.1.0     Function monitoring : Gear lever coordinator"
 /begin DEF_CHARACTERISTIC MoFTrsmAssc_cntrDebGearReqRst_C MoFTrsmAssc_cntrDrvRst_C MoFTrsmAssc_cntrModReqChgCfm_C MoFTrsmAssc_cntrModReqChgHeal_C MoFTrsmAssc_cntrRvsRst_C MoFTrsmAssc_ctRst_C MoFTrsmAssc_stLvl1ModeDrv_C MoFTrsmAssc_stLvl1ModeNeut_C MoFTrsmAssc_stLvl1ModePark_C MoFTrsmAssc_stLvl1ModeRvs_C MoFTrsmAssc_stSwtBrkSnsrSigSeln_C MoFTrsmAssc_vDrvRstThd_C MoFTrsmAssc_vDrvSwRstThd_C MoFTrsmAssc_vDrvThd_C MoFTrsmAssc_vNeutThd_C MoFTrsmAssc_vRvsRstThd_C MoFTrsmAssc_vRvsSwRstThd_C MoFTrsmAssc_vRvsThd_C /end DEF_CHARACTERISTIC
 /begin IN_MEASUREMENT DrvMod_stPosn MoFBas_flgErrVSig MoFBas_vVehSignd MoFBrk_flgBrkErr MoFBrk_flgBrkMai MoFBrk_flgBrkRdnt MoFFrm_stGearNum MoFFrm_stGearNumQlfr Mo_stCplChk Mo_stMoC Mo_stMoCCpl Reset_Env_ctRst /end IN_MEASUREMENT
 /begin OUT_MEASUREMENT MoFTrsmAssc_flgGearLvrDrv MoFTrsmAssc_flgGearLvrNeut MoFTrsmAssc_flgGearLvrPark MoFTrsmAssc_flgGearLvrRe MonGbx_stGearLvr MonGbx_stGearLvrQlfr /end OUT_MEASUREMENT
 /begin LOC_MEASUREMENT MoFTrsmAsscGearLvrCoorr_bbLoc1Cpl MoFTrsmAsscGearLvrCoorr_bbLoc2Cpl MoFTrsmAsscGearLvrCoorr_bbOut1Cpl MoFTrsmAssc_cntrDebGearReqRst MoFTrsmAssc_cntrDebGearReqRstCpl MoFTrsmAssc_cntrDrvRst MoFTrsmAssc_cntrDrvRstCpl MoFTrsmAssc_cntrModChgReqChg MoFTrsmAssc_cntrModChgReqChgCpl MoFTrsmAssc_cntrRvsRst MoFTrsmAssc_cntrRvsRstCpl MoFTrsmAssc_flgBrkPsd MoFTrsmAssc_flgDrvModReqChg MoFTrsmAssc_flgDrvModReqChgCfm MoFTrsmAssc_flgDrvReq MoFTrsmAssc_flgDrvRst MoFTrsmAssc_flgGearNumQlfr_tmp MoFTrsmAssc_flgGearReqRst MoFTrsmAssc_flgNeutReq MoFTrsmAssc_flgRvsReq MoFTrsmAssc_flgRvsRst MoFTrsmAssc_flgSafeVehSpd MoFTrsmAssc_stGearNr MoFTrsmAssc_stGearNrCpl MoFTrsmAssc_stGearNrLvl1 MoFTrsmAssc_stGearNrLvl1Cpl MoFTrsmAssc_stGearNrOld MoFTrsmAssc_stGearNrOldCpl MoFTrsmAssc_stGearNrProtd MoFTrsmAssc_stGearNrProtdCpl MoFTrsmAssc_stGearNrPtd MoFTrsmAssc_stGearNrPtdCpl MoFTrsmAssc_stGearNrReq MoFTrsmAssc_stGearNrReqCpl MoFTrsmAssc_stGearNumProtd MoFTrsmAssc_stGearNumProtdCpl MoFTrsmAssc_stGearNumTran MoFTrsmAssc_stGearNumTranCpl MoFTrsmAssc_stGearNumTranProtd MoFTrsmAssc_stGearNumTranProtdCpl MoFTrsmAssc_stGearNumTran_prev MoFTrsmAssc_stGearNumTran_prevCpl MoFTrsmAssc_stGearNum_prev MoFTrsmAssc_stGearNum_prevCpl MoFTrsmAssc_stGearNum_tmp MoFTrsmAssc_stGearNum_tmpCpl MoFTrsmAssc_stGearNum_vld MoFTrsmAssc_stGearNum_vldCpl MoFTrsmAssc_stModChgReqChg MoFTrsmAssc_stModChgReqChgCpl MonGbx_stGearLvrCpl MonGbx_stGearLvrQlfrCpl /end LOC_MEASUREMENT
 FUNCTION_VERSION "7.1.0" /end FUNCTION
/begin FUNCTION MoFTrsmAssc_Trsm "2.0.0     Function monitoring Transmission information" /begin IN_MEASUREMENT Mo_stCplChk Mo_stMoC Mo_stMoCCpl /end IN_MEASUREMENT
 /begin OUT_MEASUREMENT MoFTrsmAssc_flgTrsmMaxPtdMsg MoFTrsmAssc_flgTrsmMinPtdMsg MoFTrsmAssc_tqTrsmDecIntv01 MoFTrsmAssc_tqTrsmDecIntv02 MoFTrsmAssc_tqTrsmDecIntv03 MoFTrsmAssc_tqTrsmDecIntv04 MoFTrsmAssc_tqTrsmIncIntv01 MoFTrsmAssc_tqTrsmIncIntv02 MoFTrsmAssc_tqTrsmIncIntv03 MoFTrsmAssc_tqTrsmIncIntv04 /end OUT_MEASUREMENT
 /begin LOC_MEASUREMENT MoFTrsmAssc_tqTrsmDecIntv01Cpl MoFTrsmAssc_tqTrsmDecIntv02Cpl MoFTrsmAssc_tqTrsmDecIntv03Cpl MoFTrsmAssc_tqTrsmDecIntv04Cpl MoFTrsmAssc_tqTrsmIncIntv01Cpl MoFTrsmAssc_tqTrsmIncIntv02Cpl MoFTrsmAssc_tqTrsmIncIntv03Cpl MoFTrsmAssc_tqTrsmIncIntv04Cpl /end LOC_MEASUREMENT
 FUNCTION_VERSION "2.0.0" /end FUNCTION
/begin FUNCTION MoFVar_PostBldSel "2.2.0     Function Monitoring: Post-Build Selectable"
 /begin DEF_CHARACTERISTIC DFC_CtlMsk2.DFC_MoFVarPostBldSel_C DFC_DisblMsk2.DFC_MoFVarPostBldSel_C MoFTrqPtd_cntrActvPostBldCfg_C MoFTrqPtd_cntrNegChkPostBldCfg_C MoFTrqPtd_cntrPosChkPostBldCfg_C MoFTrqPtd_cntrRstPostBldSel_C MoFTrqPtd_cntrStabyChkPostBldCfg_C MoFTrqPtd_cntrTestPostBldSel_C MoFTrqPtd_stSwtPbsChk_C /end DEF_CHARACTERISTIC
 /begin IN_MEASUREMENT Mo_ctRst Mo_ctRstCpl Mo_stCplChk Mo_stMoC Mo_stMoCCpl Mo_stMoF Mo_stMoFCpl /end IN_MEASUREMENT
 /begin OUT_MEASUREMENT DFC_st.DFC_MoFVarPostBldSel MoFTrqPtd_flgIrrvErrPostBldSel MoFTrqPtd_flgIrrvErrPostBldSelMsg /end OUT_MEASUREMENT
 /begin LOC_MEASUREMENT MoFTrqPtd_cntrActvPostBldCfg MoFTrqPtd_cntrActvPostBldCfgCpl MoFTrqPtd_cntrNegChkPostBldCfg MoFTrqPtd_cntrNegChkPostBldCfgCpl MoFTrqPtd_cntrPosChkPostBldCfg MoFTrqPtd_cntrPosChkPostBldCfgCpl MoFTrqPtd_cntrStabyChkPostBldCfg MoFTrqPtd_cntrStabyChkPostBldCfgCpl MoFTrqPtd_cntrTestPostBldSel MoFTrqPtd_flgAlt MoFTrqPtd_flgClrPostBldSel MoFTrqPtd_flgErrActvPostBldCfg MoFTrqPtd_flgErrDcycStabyChk MoFTrqPtd_flgErrIvsChkPostBld MoFTrqPtd_flgErrPosChk MoFTrqPtd_flgErrPosChk2 MoFTrqPtd_flgErrPosChkPostBld MoFTrqPtd_flgPostBldCfgRxd MoFTrqPtd_idxPostBldCfg MoFTrqPtd_idxPostBldCfgCpl MoFTrqPtd_idxPostBldCfgIni MoFTrqPtd_idxPostBldCfgIniCpl MoFTrqPtd_stActvPostBldVrntIdx MoFTrqPtd_stActvPostBldVrntIdxCpl MoFTrqPtd_stMonIninChk MoFTrqPtd_stMonIninChkCpl MoFTrqPtd_stMonIninChkIvs MoFTrqPtd_stMonIninChkIvsCpl MoFVarPostBldSel_bbLoc1Cpl MoFVarPostBldSel_bbOut1Cpl /end LOC_MEASUREMENT
 FUNCTION_VERSION "2.2.0" /end FUNCTION
/begin FUNCTION MoFWDA_Co "16.0.0    Function Monitoring: Fault reaction from function monitoring via WDA" /begin IN_MEASUREMENT Mo_stMoF /end IN_MEASUREMENT FUNCTION_VERSION "16.0.0" /end FUNCTION
/begin COMPU_METHOD acc_q0p001 "" RAT_FUNC "%6.5" "m/(s^2)" COEFFS 0 1000 0 0 0 1 /end COMPU_METHOD
/begin COMPU_METHOD B_TRUE "" TAB_VERB "%6.3" "" COMPU_TAB_REF B_TRUE /end COMPU_METHOD
/begin COMPU_VTAB B_TRUE "" TAB_VERB 2 0 "FALSE" 1 "TRUE" /end COMPU_VTAB
/begin COMPU_METHOD DFC_OneToOne "" RAT_FUNC "%6.2" "-" COEFFS 0 1 0 0 0 1 /end COMPU_METHOD
/begin COMPU_METHOD DFES_OneToOne "" RAT_FUNC "%6.2" "-" COEFFS 0 1 0 0 0 1 /end COMPU_METHOD
/begin COMPU_METHOD Fact1000 "" RAT_FUNC "%6.5" "-" COEFFS 0 1000 0 0 0 1 /end COMPU_METHOD
/begin COMPU_METHOD fak_q0p01 "" RAT_FUNC "%6.4" "" COEFFS 0 100 0 0 0 1 /end COMPU_METHOD
/begin COMPU_METHOD Length_fine "" RAT_FUNC "%6.5" "m" COEFFS 0 1000 0 0 0 1 /end COMPU_METHOD
/begin COMPU_METHOD Mass "" RAT_FUNC "%6.2" "-" COEFFS 0 1 0 0 0 1 /end COMPU_METHOD
/begin COMPU_METHOD mdt_q0p001_Nm_s "" RAT_FUNC "%6.5" "Nm*s" COEFFS 0 1000 0 0 0 1 /end COMPU_METHOD
/begin COMPU_METHOD mdt_q0p1_Nm_DIV_s "" RAT_FUNC "%6.3" "Nm/s" COEFFS 0 10 0 0 0 1 /end COMPU_METHOD
/begin COMPU_METHOD MonGbx_stGearLvr_VERB "" TAB_VERB "%6.3" "" COMPU_TAB_REF MonGbx_stGearLvr_VERB /end COMPU_METHOD
/begin COMPU_VTAB MonGbx_stGearLvr_VERB "" TAB_VERB 6 0 "GEARLVR_UNDEF" 3 "GEARLVR_DRV" 6 "GEARLVR_NEUT" 9 "GEARLVR_RVS" 255 "GEARLVR_ERR" 12 "GEARLVR_PARK" /end COMPU_VTAB
/begin COMPU_METHOD OneToOne "" RAT_FUNC "%6.2" "-" COEFFS 0 1 0 0 0 1 /end COMPU_METHOD
/begin COMPU_METHOD Prc "" RAT_FUNC "%6.4" "%" COEFFS 0 81.92 0 0 0 1 /end COMPU_METHOD
/begin COMPU_METHOD PrcPerSec "" RAT_FUNC "%6.3" "%/s" COEFFS 0 1.6384 0 0 0 1 /end COMPU_METHOD
/begin COMPU_METHOD RatAirMassPerTime_COMPU "" RAT_FUNC "%6.3" "1/s" COEFFS 0 10 0 0 0 1 /end COMPU_METHOD
/begin COMPU_METHOD RatAirPres_COMPU "" RAT_FUNC "%6.5" "-" COEFFS 0 1000 0 0 0 1 /end COMPU_METHOD
/begin COMPU_METHOD RatAshMass "" RAT_FUNC "%8.7" "-" COEFFS 0 100000 0 0 0 1 /end COMPU_METHOD
/begin COMPU_METHOD RatCOMass "" RAT_FUNC "%9.8" "-" COEFFS 0 1000000 0 0 0 1 /end COMPU_METHOD
/begin COMPU_METHOD RatFuelMass "" RAT_FUNC "%6.4" "-" COEFFS 0 100 0 0 0 1 /end COMPU_METHOD
/begin COMPU_METHOD RatFuelMassHi "" RAT_FUNC "%8.7" "-" COEFFS 0 100000 0 0 0 1 /end COMPU_METHOD
/begin COMPU_METHOD RatHiRes_COMPU "" RAT_FUNC "%6.5" "-" COEFFS 0 1000 0 0 0 1 /end COMPU_METHOD
/begin COMPU_METHOD RatHiRes_CPP_COMPU "" RAT_FUNC "%7.6" "-" COEFFS 0 10000 0 0 0 1 /end COMPU_METHOD
/begin COMPU_METHOD RatNOxMass "" RAT_FUNC "%10.9" "-" COEFFS 0 10000000 0 0 0 1 /end COMPU_METHOD
/begin COMPU_METHOD RatSotMass "" RAT_FUNC "%8.7" "-" COEFFS 0 100000 0 0 0 1 /end COMPU_METHOD
/begin COMPU_METHOD RatSotSot "" RAT_FUNC "%6.5" "-" COEFFS 0 4000 0 0 0 1 /end COMPU_METHOD
/begin COMPU_METHOD RatSOxMass "" RAT_FUNC "%11.10" "-" COEFFS 0 100000000 0 0 0 1 /end COMPU_METHOD
/begin COMPU_METHOD RBANDSTYPE_SC_Compu "" TAB_VERB "%6.3" "" COMPU_TAB_REF RBANDSTYPE_SC_Compu /end COMPU_METHOD
/begin COMPU_VTAB RBANDSTYPE_SC_Compu "" TAB_VERB 4 0 "NO_RBANDS" 1 "ONLY_RBANDS" 2 "MIXED_RBANDS" 3 "MSR_RBANDS" /end COMPU_VTAB
/begin COMPU_METHOD RBA_SWTRACEENA_SC_Compu "" TAB_VERB "%6.3" "" COMPU_TAB_REF RBA_SWTRACEENA_SC_Compu /end COMPU_METHOD
/begin COMPU_VTAB RBA_SWTRACEENA_SC_Compu "" TAB_VERB 2 0 "False" 1 "True" /end COMPU_VTAB
/begin COMPU_METHOD RBPtCel_a_1p0_1 "" RAT_FUNC "%6.2" "m/s^2" COEFFS 0 1 0 0 0 1 /end COMPU_METHOD
/begin COMPU_METHOD RBPtCel_fPerp_1p0_1 "" RAT_FUNC "%6.2" "N/Bar" COEFFS 0 1 0 0 0 1 /end COMPU_METHOD
/begin COMPU_METHOD RBPtCel_fti_1p0_1 "" RAT_FUNC "%6.2" "Ns" COEFFS 0 1 0 0 0 1 /end COMPU_METHOD
/begin COMPU_METHOD RBPtCel_f_1p0_1 "" RAT_FUNC "%6.2" "N" COEFFS 0 1 0 0 0 1 /end COMPU_METHOD
/begin COMPU_METHOD RmpTrqPrpHigh "" RAT_FUNC "%6.4" "Nm/s" COEFFS 0 655.36 0 0 0 1 /end COMPU_METHOD
/begin COMPU_METHOD Trq "" RAT_FUNC "%6.3" "Nm" COEFFS 0 10 0 0 0 1 /end COMPU_METHOD
/begin COMPU_METHOD TrqPrp "" RAT_FUNC "%6.2" "Nm" COEFFS 0 0.625 0 0 0 1 /end COMPU_METHOD
/begin COMPU_METHOD TrqPrpHigh "" RAT_FUNC "%6.3" "Nm" COEFFS 0 10 0 0 0 1 /end COMPU_METHOD
/begin COMPU_METHOD Vel "" RAT_FUNC "%6.4" "km/h" COEFFS 0 100 0 0 0 1 /end COMPU_METHOD
/begin COMPU_METHOD zk10msxs_uw_b655p36 "" RAT_FUNC "%6.2" "s" COEFFS 0 0 65536 0 100 0 /end COMPU_METHOD
/begin RECORD_LAYOUT Map_Xs16Ys16Ws16 NO_AXIS_PTS_X 1 SWORD NO_AXIS_PTS_Y 2 SWORD AXIS_PTS_X 3 SWORD INDEX_INCR DIRECT AXIS_PTS_Y 4 SWORD INDEX_INCR DIRECT FNC_VALUES 5 SWORD COLUMN_DIR DIRECT /end RECORD_LAYOUT
/begin RECORD_LAYOUT Mo_DataCurveSstS16WS16 NO_AXIS_PTS_X 1 SWORD AXIS_PTS_X 2 SWORD INDEX_INCR DIRECT FNC_VALUES 3 SWORD COLUMN_DIR DIRECT /end RECORD_LAYOUT
/begin RECORD_LAYOUT ValA_Wu8 FNC_VALUES 1 UBYTE COLUMN_DIR DIRECT /end RECORD_LAYOUT
/begin RECORD_LAYOUT Val_Ws16 FNC_VALUES 1 SWORD COLUMN_DIR DIRECT /end RECORD_LAYOUT
/begin RECORD_LAYOUT Val_Ws32 FNC_VALUES 1 SLONG COLUMN_DIR DIRECT /end RECORD_LAYOUT
/begin RECORD_LAYOUT Val_Wu16 FNC_VALUES 1 UWORD COLUMN_DIR DIRECT /end RECORD_LAYOUT
/begin RECORD_LAYOUT Val_Wu8 FNC_VALUES 1 UBYTE COLUMN_DIR DIRECT /end RECORD_LAYOUT
/end MODULE
/end PROJECT

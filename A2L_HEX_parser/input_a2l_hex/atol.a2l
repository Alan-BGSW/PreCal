ASAP2_VERSION 1 70
/begin PROJECT MDG1C "VC1CP091_STLA_N_D061I3"
/begin HEADER "" VERSION "VC1CP091_STLA_N_D061I3" PROJECT_NO MDG1C /end HEADER
/begin MODULE DIM ""
/begin MOD_COMMON "" BYTE_ORDER MSB_LAST ALIGNMENT_BYTE 1 ALIGNMENT_WORD 2 ALIGNMENT_LONG 4 ALIGNMENT_INT64 4 ALIGNMENT_FLOAT32_IEEE 4 ALIGNMENT_FLOAT64_IEEE 4 DATA_SIZE 32 /end MOD_COMMON
/begin CHARACTERISTIC DDRC_DurDeb.DevLib_tiBattUHiDebOk_C "" VALUE 0x80240960 Val_Wu16 655350.0 DDRCTime_ms 0.00 655350.0 FORMAT "%8.1" /end CHARACTERISTIC
/begin CHARACTERISTIC DDRC_DurDeb.DevLib_tiBattUHiDebDef_C "" VALUE 0x80240962 Val_Wu16 655350.0 DDRCTime_ms 0.00 655350.0 FORMAT "%8.1" /end CHARACTERISTIC
/begin CHARACTERISTIC DDRC_DurDeb.DevLib_tiBattULoDebOk_C "" VALUE 0x80240964 Val_Wu16 655350.0 DDRCTime_ms 0.00 655350.0 FORMAT "%8.1" /end CHARACTERISTIC
/begin CHARACTERISTIC DDRC_DurDeb.DevLib_tiBattULoDebDef_C "" VALUE 0x80240966 Val_Wu16 655350.0 DDRCTime_ms 0.00 655350.0 FORMAT "%8.1" /end CHARACTERISTIC
/begin CHARACTERISTIC DDRC_RatDeb.DevLib_tiBattUHiUDRat_C "" VALUE 0x80248A5C Val_Wu8 3.00000000000 DDRC_Ratio 1.00000000000 4.00000000000 FORMAT "%13.11" /end CHARACTERISTIC
/begin CHARACTERISTIC DDRC_RatDeb.DevLib_tiBattULoUDRat_C "" VALUE 0x80248A5D Val_Wu8 3.00000000000 DDRC_Ratio 1.00000000000 4.00000000000 FORMAT "%13.11" /end CHARACTERISTIC
/begin CHARACTERISTIC Devlib_PsDisbl.facLowHysLo_C "Structure containing hysterisis limits for battery voltage correction factor / Lower hysterisis limit for battery correction factor LOW." VALUE 0x8025EE30 Kw_Ws16 1.000000 Fact 0.00 1.000000 FORMAT "%8.6" EXTENDED_LIMITS -4.000000 3.999878 /end CHARACTERISTIC
/begin CHARACTERISTIC Devlib_PsDisbl.facLowHysHi_C "Structure containing hysterisis limits for battery voltage correction factor / Higher hysterisis limit for battery correction factor LOW." VALUE 0x8025EE32 Kw_Ws16 1.000000 Fact 0.00 1.000000 FORMAT "%8.6" EXTENDED_LIMITS -4.000000 3.999878 /end CHARACTERISTIC
/begin CHARACTERISTIC Devlib_PsDisbl.facHighHysLo_C "Structure containing hysterisis limits for battery voltage correction factor / Lower hysterisis limit for battery correction factor HIGH." VALUE 0x8025EE34 Kw_Ws16 2.000000 Fact 1.000000 3.000000 FORMAT "%8.6" EXTENDED_LIMITS -4.000000 3.999878 /end CHARACTERISTIC
/begin CHARACTERISTIC Devlib_PsDisbl.facHighHysHi_C "Structure containing hysterisis limits for battery voltage correction factor / Higher hysterisis limit for battery correction factor HIGH." VALUE 0x8025EE36 Kw_Ws16 2.000000 Fact 1.000000 3.000000 FORMAT "%8.6" EXTENDED_LIMITS -4.000000 3.999878 /end CHARACTERISTIC
/begin CHARACTERISTIC Devlib_PwrStg.BattLoHysLo_C "Structure containing hysterisis check for battery voltage LOW/HIGH / Lower limit for battery voltage LOW hysterisis check." VALUE 0x8025EE38 Kw_Ws16 9000.000 Volt_Batt 3000.00 12000.00 FORMAT "%8.2" EXTENDED_LIMITS -655360.0 655340.0 /end CHARACTERISTIC
/begin CHARACTERISTIC Devlib_PwrStg.BattLoHysHi_C "Structure containing hysterisis check for battery voltage LOW/HIGH / Higher limit for battery voltage LOW hysterisis check" VALUE 0x8025EE3A Kw_Ws16 9000.000 Volt_Batt 3000.00 12000.00 FORMAT "%8.2" EXTENDED_LIMITS -655360.0 655340.0 /end CHARACTERISTIC
/begin CHARACTERISTIC Devlib_PwrStg.BattHiHysLo_C "Structure containing hysterisis check for battery voltage LOW/HIGH / Lower limit for battery voltage HIGH hysterisis check" VALUE 0x8025EE3C Kw_Ws16 24000.00 Volt_Batt 12000.00 36000.00 FORMAT "%8.2" EXTENDED_LIMITS -655360.0 655340.0 /end CHARACTERISTIC
/begin CHARACTERISTIC Devlib_PwrStg.BattHiHysHi_C "Structure containing hysterisis check for battery voltage LOW/HIGH / Upper limit for battery voltage HIGH hysterisis check" VALUE 0x8025EE3E Kw_Ws16 24000.00 Volt_Batt 12000.00 36000.00 FORMAT "%8.2" EXTENDED_LIMITS -655360.0 655340.0 /end CHARACTERISTIC
/begin CHARACTERISTIC DFC_CtlMsk2.DFC_DevLibBattUHi_C "" VALUE 0x80241512 Val_Wu8 255.0 DFES_OneToOne 0.00 255.0 FORMAT "%5.1" /end CHARACTERISTIC
/begin CHARACTERISTIC DFC_CtlMsk2.DFC_DevLibBattULo_C "" VALUE 0x80241513 Val_Wu8 255.0 DFES_OneToOne 0.00 255.0 FORMAT "%5.1" /end CHARACTERISTIC
/begin CHARACTERISTIC DFC_DisblMsk2.DFC_DevLibBattUHi_C "" VALUE 0x80248F0A Val_Wu16 65535.00 DFES_OneToOne 0.00 65535.00 FORMAT "%8.2" /end CHARACTERISTIC
/begin CHARACTERISTIC DFC_DisblMsk2.DFC_DevLibBattULo_C "" VALUE 0x80248F0C Val_Wu16 65535.00 DFES_OneToOne 0.00 65535.00 FORMAT "%8.2" /end CHARACTERISTIC
/begin MEASUREMENT DDRC_St.DFC_DevLibBattUHi "" ULONG DFC_OneToOne 1 100 0.00 536870911.000 BIT_MASK 0x1fffffff FORMAT "%13.3" ECU_ADDRESS 0x6001CA44 /end MEASUREMENT
/begin MEASUREMENT DDRC_St.DFC_DevLibBattULo "" ULONG DFC_OneToOne 1 100 0.00 536870911.000 BIT_MASK 0x1fffffff FORMAT "%13.3" ECU_ADDRESS 0x6001CA48 /end MEASUREMENT
/begin MEASUREMENT DevLib_stPwrStgEnaCond "Device Library - state of powerstage enabling conditions" UWORD OneToOne 1 100 0.00 65535.00 FORMAT "%8.2" ECU_ADDRESS 0x6001FC9C
 /begin IF_DATA XCPplus 0x0102
  /begin DAQ_EVENT VARIABLE /end DAQ_EVENT
 /end IF_DATA
/end MEASUREMENT
/begin MEASUREMENT DFC_b.TST_ACCmprFltLvlRes "" UBYTE DFC_OneToOne 1 100 0.00 1.000 BIT_MASK 0x8 FORMAT "%5.3" ECU_ADDRESS 0x600349CF /end MEASUREMENT
/begin MEASUREMENT DFC_b.TST_AbgHiSigFlt "" UBYTE DFC_OneToOne 1 100 0.00 1.000 BIT_MASK 0x8 FORMAT "%5.3" ECU_ADDRESS 0x600349D0 /end MEASUREMENT
/begin MEASUREMENT DFC_b.TST_AbgIntPatFlt "" UBYTE DFC_OneToOne 1 100 0.00 1.000 BIT_MASK 0x8 FORMAT "%5.3" ECU_ADDRESS 0x600349D1 /end MEASUREMENT
/begin MEASUREMENT DFC_b.TST_AbgLoSigFlt "" UBYTE DFC_OneToOne 1 100 0.00 1.000 BIT_MASK 0x8 FORMAT "%5.3" ECU_ADDRESS 0x600349D2 /end MEASUREMENT
/begin MEASUREMENT DFC_b.TST_AbgUnkwnErrSigFlt "" UBYTE DFC_OneToOne 1 100 0.00 1.000 BIT_MASK 0x8 FORMAT "%5.3" ECU_ADDRESS 0x600349D3 /end MEASUREMENT
/begin MEASUREMENT DFC_b.TST_AcExtChrgrIBattExcdd "" UBYTE DFC_OneToOne 1 100 0.00 1.000 BIT_MASK 0x8 FORMAT "%5.3" ECU_ADDRESS 0x600349D4 /end MEASUREMENT
/begin MEASUREMENT DFC_b.TST_AcExtChrgrIInExcdd "" UBYTE DFC_OneToOne 1 100 0.00 1.000 BIT_MASK 0x8 FORMAT "%5.3" ECU_ADDRESS 0x600349D5 /end MEASUREMENT
/begin MEASUREMENT DFC_b.TST_AcExtChrgrIOutDe "" UBYTE DFC_OneToOne 1 100 0.00 1.000 BIT_MASK 0x8 FORMAT "%5.3" ECU_ADDRESS 0x600349D6 /end MEASUREMENT
/begin MEASUREMENT DFC_b.TST_AcExtChrgrIOutExcdd "" UBYTE DFC_OneToOne 1 100 0.00 1.000 BIT_MASK 0x8 FORMAT "%5.3" ECU_ADDRESS 0x600349D7 /end MEASUREMENT
/begin MEASUREMENT DFC_b.TST_AcExtChrgrUOutDe "" UBYTE DFC_OneToOne 1 100 0.00 1.000 BIT_MASK 0x8 FORMAT "%5.3" ECU_ADDRESS 0x600349D8 /end MEASUREMENT
/begin MEASUREMENT DFC_b.TST_AdpActvDChaFailr "" UBYTE DFC_OneToOne 1 100 0.00 1.000 BIT_MASK 0x8 FORMAT "%5.3" ECU_ADDRESS 0x600349D9 /end MEASUREMENT
/begin MEASUREMENT DFC_b.TST_AirbcuFlt "" UBYTE DFC_OneToOne 1 100 0.00 1.000 BIT_MASK 0x8 FORMAT "%5.3" ECU_ADDRESS 0x600349DA /end MEASUREMENT
/begin MEASUREMENT DFC_b.TST_Airbg "" UBYTE DFC_OneToOne 1 100 0.00 1.000 BIT_MASK 0x8 FORMAT "%5.3" ECU_ADDRESS 0x600349DB /end MEASUREMENT
/begin MEASUREMENT DFC_b.TST_AirbgCan "" UBYTE DFC_OneToOne 1 100 0.00 1.000 BIT_MASK 0x8 FORMAT "%5.3" ECU_ADDRESS 0x600349DC /end MEASUREMENT
/begin MEASUREMENT DFC_b.TST_AirbgCanHWPlaus "" UBYTE DFC_OneToOne 1 100 0.00 1.000 BIT_MASK 0x8 FORMAT "%5.3" ECU_ADDRESS 0x600349DD /end MEASUREMENT
/begin MEASUREMENT DFC_b.TST_AirbgHWCanPlaus "" UBYTE DFC_OneToOne 1 100 0.00 1.000 BIT_MASK 0x8 FORMAT "%5.3" ECU_ADDRESS 0x600349DE /end MEASUREMENT
/begin MEASUREMENT DFC_b.TST_AirbgMnr "" UBYTE DFC_OneToOne 1 100 0.00 1.000 BIT_MASK 0x8 FORMAT "%5.3" ECU_ADDRESS 0x600349DF /end MEASUREMENT
/begin MEASUREMENT DFC_b.TST_AirbgPerHi "" UBYTE DFC_OneToOne 1 100 0.00 1.000 BIT_MASK 0x8 FORMAT "%5.3" ECU_ADDRESS 0x600349E0 /end MEASUREMENT
/begin MEASUREMENT DFC_b.TST_AirbgPerdRngFlt "" UBYTE DFC_OneToOne 1 100 0.00 1.000 BIT_MASK 0x8 FORMAT "%5.3" ECU_ADDRESS 0x600349E1 /end MEASUREMENT
/begin MEASUREMENT DFC_b.TST_BlowrRlyErr "" UBYTE DFC_OneToOne 1 100 0.00 1.000 BIT_MASK 0x8 FORMAT "%5.3" ECU_ADDRESS 0x600349E2 /end MEASUREMENT
/begin MEASUREMENT DFC_b.TST_BrkBstPmpActtnDfct "" UBYTE DFC_OneToOne 1 100 0.00 1.000 BIT_MASK 0x8 FORMAT "%5.3" ECU_ADDRESS 0x600349E3 /end MEASUREMENT
/begin MEASUREMENT DFC_b.TST_BrkBstPmpDeactvnDfct "" UBYTE DFC_OneToOne 1 100 0.00 1.000 BIT_MASK 0x8 FORMAT "%5.3" ECU_ADDRESS 0x600349E4 /end MEASUREMENT
/begin MEASUREMENT DFC_b.TST_BrkSwtFlt "" UBYTE DFC_OneToOne 1 100 0.00 1.000 BIT_MASK 0x8 FORMAT "%5.3" ECU_ADDRESS 0x600349E5 /end MEASUREMENT
/begin MEASUREMENT DFC_b.TST_CbnHeatgHeatrHsScb "" UBYTE DFC_OneToOne 1 100 0.00 1.000 BIT_MASK 0x8 FORMAT "%5.3" ECU_ADDRESS 0x600349E6 /end MEASUREMENT
/begin MEASUREMENT DFC_b.TST_CbnHeatgHeatrHsScg "" UBYTE DFC_OneToOne 1 100 0.00 1.000 BIT_MASK 0x8 FORMAT "%5.3" ECU_ADDRESS 0x600349E7 /end MEASUREMENT
/begin MEASUREMENT DFC_b.TST_CbnHeatgHeatrLsOl "" UBYTE DFC_OneToOne 1 100 0.00 1.000 BIT_MASK 0x8 FORMAT "%5.3" ECU_ADDRESS 0x600349E8 /end MEASUREMENT
/begin MEASUREMENT DFC_b.TST_CbnHeatgHeatrLsScb "" UBYTE DFC_OneToOne 1 100 0.00 1.000 BIT_MASK 0x8 FORMAT "%5.3" ECU_ADDRESS 0x600349E9 /end MEASUREMENT
/begin MEASUREMENT DFC_b.TST_CbnHeatgHeatrLsScg "" UBYTE DFC_OneToOne 1 100 0.00 1.000 BIT_MASK 0x8 FORMAT "%5.3" ECU_ADDRESS 0x600349EA /end MEASUREMENT
/begin MEASUREMENT DFC_b.TST_CbnHeatgHeatrUnUsed "" UBYTE DFC_OneToOne 1 100 0.00 1.000 BIT_MASK 0x8 FORMAT "%5.3" ECU_ADDRESS 0x600349EB /end MEASUREMENT
/begin MEASUREMENT DFC_b.TST_ChrgnCntctHsOt "" UBYTE DFC_OneToOne 1 100 0.00 1.000 BIT_MASK 0x8 FORMAT "%5.3" ECU_ADDRESS 0x600349EC /end MEASUREMENT
/begin MEASUREMENT DFC_b.TST_ChrgnCntctHsScb "" UBYTE DFC_OneToOne 1 100 0.00 1.000 BIT_MASK 0x8 FORMAT "%5.3" ECU_ADDRESS 0x600349ED /end MEASUREMENT
/begin MEASUREMENT DFC_b.TST_ChrgnCntctHsScg "" UBYTE DFC_OneToOne 1 100 0.00 1.000 BIT_MASK 0x8 FORMAT "%5.3" ECU_ADDRESS 0x600349EE /end MEASUREMENT
/begin MEASUREMENT DFC_b.TST_ChrgnCntctLsNegOl "" UBYTE DFC_OneToOne 1 100 0.00 1.000 BIT_MASK 0x8 FORMAT "%5.3" ECU_ADDRESS 0x600349EF /end MEASUREMENT
/begin MEASUREMENT DFC_b.TST_ChrgnCntctLsNegOt "" UBYTE DFC_OneToOne 1 100 0.00 1.000 BIT_MASK 0x8 FORMAT "%5.3" ECU_ADDRESS 0x600349F0 /end MEASUREMENT
/begin MEASUREMENT DFC_b.TST_ChrgnCntctLsNegScb "" UBYTE DFC_OneToOne 1 100 0.00 1.000 BIT_MASK 0x8 FORMAT "%5.3" ECU_ADDRESS 0x600349F1 /end MEASUREMENT
/begin MEASUREMENT DFC_b.TST_ChrgnCntctLsNegScg "" UBYTE DFC_OneToOne 1 100 0.00 1.000 BIT_MASK 0x8 FORMAT "%5.3" ECU_ADDRESS 0x600349F2 /end MEASUREMENT
/begin MEASUREMENT DFC_b.TST_ChrgnCntctLsPosOl "" UBYTE DFC_OneToOne 1 100 0.00 1.000 BIT_MASK 0x8 FORMAT "%5.3" ECU_ADDRESS 0x600349F3 /end MEASUREMENT
/begin MEASUREMENT DFC_b.TST_ChrgnCntctLsPosOt "" UBYTE DFC_OneToOne 1 100 0.00 1.000 BIT_MASK 0x8 FORMAT "%5.3" ECU_ADDRESS 0x600349F4 /end MEASUREMENT
/begin MEASUREMENT DFC_b.TST_ChrgnCntctLsPosScb "" UBYTE DFC_OneToOne 1 100 0.00 1.000 BIT_MASK 0x8 FORMAT "%5.3" ECU_ADDRESS 0x600349F5 /end MEASUREMENT
/begin MEASUREMENT DFC_b.TST_ChrgnCntctLsPosScg "" UBYTE DFC_OneToOne 1 100 0.00 1.000 BIT_MASK 0x8 FORMAT "%5.3" ECU_ADDRESS 0x600349F6 /end MEASUREMENT
/begin MEASUREMENT DFC_b.TST_ChrgnCntctUnUsed "" UBYTE DFC_OneToOne 1 100 0.00 1.000 BIT_MASK 0x8 FORMAT "%5.3" ECU_ADDRESS 0x600349F7 /end MEASUREMENT
/begin MEASUREMENT DFC_b.TST_ComBrkMai "" UBYTE DFC_OneToOne 1 100 0.00 1.000 BIT_MASK 0x8 FORMAT "%5.3" ECU_ADDRESS 0x600349F8 /end MEASUREMENT
/begin MEASUREMENT DFC_b.TST_ComChrgrEVCont "" UBYTE DFC_OneToOne 1 100 0.00 1.000 BIT_MASK 0x8 FORMAT "%5.3" ECU_ADDRESS 0x600349F9 /end MEASUREMENT
/begin MEASUREMENT DFC_b.TST_ComChrgrEVtBlink "" UBYTE DFC_OneToOne 1 100 0.00 1.000 BIT_MASK 0x8 FORMAT "%5.3" ECU_ADDRESS 0x600349FA /end MEASUREMENT
/begin MEASUREMENT DFC_b.TST_ComChrgrMstBlink "" UBYTE DFC_OneToOne 1 100 0.00 1.000 BIT_MASK 0x8 FORMAT "%5.3" ECU_ADDRESS 0x600349FB /end MEASUREMENT
/begin MEASUREMENT DFC_b.TST_ComChrgrMstCont "" UBYTE DFC_OneToOne 1 100 0.00 1.000 BIT_MASK 0x8 FORMAT "%5.3" ECU_ADDRESS 0x600349FC /end MEASUREMENT
/begin MEASUREMENT DFC_b.TST_ComChrgrSVSBlink "" UBYTE DFC_OneToOne 1 100 0.00 1.000 BIT_MASK 0x8 FORMAT "%5.3" ECU_ADDRESS 0x600349FD /end MEASUREMENT
/begin MEASUREMENT DFC_b.TST_ComChrgrSVSCont "" UBYTE DFC_OneToOne 1 100 0.00 1.000 BIT_MASK 0x8 FORMAT "%5.3" ECU_ADDRESS 0x600349FE /end MEASUREMENT
/begin MEASUREMENT DFC_b.TST_ComDcdcEVBlink "" UBYTE DFC_OneToOne 1 100 0.00 1.000 BIT_MASK 0x8 FORMAT "%5.3" ECU_ADDRESS 0x600349FF /end MEASUREMENT
/begin MEASUREMENT DFC_b.TST_ComDcdcEVCont "" UBYTE DFC_OneToOne 1 100 0.00 1.000 BIT_MASK 0x8 FORMAT "%5.3" ECU_ADDRESS 0x60034A00 /end MEASUREMENT
/begin MEASUREMENT DFC_b.TST_ComDcdcFltLvl2 "" UBYTE DFC_OneToOne 1 100 0.00 1.000 BIT_MASK 0x8 FORMAT "%5.3" ECU_ADDRESS 0x60034A01 /end MEASUREMENT
/begin MEASUREMENT DFC_b.TST_ComDcdcFltLvl3 "" UBYTE DFC_OneToOne 1 100 0.00 1.000 BIT_MASK 0x8 FORMAT "%5.3" ECU_ADDRESS 0x60034A02 /end MEASUREMENT
/begin MEASUREMENT DFC_b.TST_ComDcdcFltLvl4 "" UBYTE DFC_OneToOne 1 100 0.00 1.000 BIT_MASK 0x8 FORMAT "%5.3" ECU_ADDRESS 0x60034A03 /end MEASUREMENT
/begin MEASUREMENT DFC_b.TST_ComDcdcFltLvl5 "" UBYTE DFC_OneToOne 1 100 0.00 1.000 BIT_MASK 0x8 FORMAT "%5.3" ECU_ADDRESS 0x60034A04 /end MEASUREMENT
/begin MEASUREMENT DFC_b.TST_ComDcdcFltLvlRes "" UBYTE DFC_OneToOne 1 100 0.00 1.000 BIT_MASK 0x8 FORMAT "%5.3" ECU_ADDRESS 0x60034A05 /end MEASUREMENT
/begin MEASUREMENT DFC_b.TST_ComDcdcMstBlink "" UBYTE DFC_OneToOne 1 100 0.00 1.000 BIT_MASK 0x8 FORMAT "%5.3" ECU_ADDRESS 0x60034A06 /end MEASUREMENT
/begin MEASUREMENT DFC_b.TST_ComDcdcMstCont "" UBYTE DFC_OneToOne 1 100 0.00 1.000 BIT_MASK 0x8 FORMAT "%5.3" ECU_ADDRESS 0x60034A07 /end MEASUREMENT
/begin MEASUREMENT DFC_b.TST_ComDcdcSVSBlink "" UBYTE DFC_OneToOne 1 100 0.00 1.000 BIT_MASK 0x8 FORMAT "%5.3" ECU_ADDRESS 0x60034A08 /end MEASUREMENT
/begin MEASUREMENT DFC_b.TST_ComDcdcSVSCont "" UBYTE DFC_OneToOne 1 100 0.00 1.000 BIT_MASK 0x8 FORMAT "%5.3" ECU_ADDRESS 0x60034A09 /end MEASUREMENT
/begin MEASUREMENT DFC_b.TST_ComElMIIvtrFltLvl2 "" UBYTE DFC_OneToOne 1 100 0.00 1.000 BIT_MASK 0x8 FORMAT "%5.3" ECU_ADDRESS 0x60034A0A /end MEASUREMENT
/begin MEASUREMENT DFC_b.TST_ComElMIIvtrFltLvl3 "" UBYTE DFC_OneToOne 1 100 0.00 1.000 BIT_MASK 0x8 FORMAT "%5.3" ECU_ADDRESS 0x60034A0B /end MEASUREMENT
/begin MEASUREMENT DFC_b.TST_ComElMIIvtrFltLvl4 "" UBYTE DFC_OneToOne 1 100 0.00 1.000 BIT_MASK 0x8 FORMAT "%5.3" ECU_ADDRESS 0x60034A0C /end MEASUREMENT
/begin MEASUREMENT DFC_b.TST_ComElMIIvtrFltLvl5 "" UBYTE DFC_OneToOne 1 100 0.00 1.000 BIT_MASK 0x8 FORMAT "%5.3" ECU_ADDRESS 0x60034A0D /end MEASUREMENT
/begin MEASUREMENT DFC_b.TST_ComElMIIvtrFltLvlRes "" UBYTE DFC_OneToOne 1 100 0.00 1.000 BIT_MASK 0x8 FORMAT "%5.3" ECU_ADDRESS 0x60034A0E /end MEASUREMENT
/begin MEASUREMENT DFC_b.TST_ComEmacEVBlink "" UBYTE DFC_OneToOne 1 100 0.00 1.000 BIT_MASK 0x8 FORMAT "%5.3" ECU_ADDRESS 0x60034A0F /end MEASUREMENT
/begin MEASUREMENT DFC_b.TST_ComEmacEVCont "" UBYTE DFC_OneToOne 1 100 0.00 1.000 BIT_MASK 0x8 FORMAT "%5.3" ECU_ADDRESS 0x60034A10 /end MEASUREMENT
/begin MEASUREMENT DFC_b.TST_ComEmacMstCont "" UBYTE DFC_OneToOne 1 100 0.00 1.000 BIT_MASK 0x8 FORMAT "%5.3" ECU_ADDRESS 0x60034A11 /end MEASUREMENT
/begin MEASUREMENT DFC_b.TST_ComEmacMsttBlink "" UBYTE DFC_OneToOne 1 100 0.00 1.000 BIT_MASK 0x8 FORMAT "%5.3" ECU_ADDRESS 0x60034A12 /end MEASUREMENT
/begin MEASUREMENT DFC_b.TST_ComEmacSVSBlink "" UBYTE DFC_OneToOne 1 100 0.00 1.000 BIT_MASK 0x8 FORMAT "%5.3" ECU_ADDRESS 0x60034A13 /end MEASUREMENT
/begin MEASUREMENT DFC_b.TST_ComEmacSVSCont "" UBYTE DFC_OneToOne 1 100 0.00 1.000 BIT_MASK 0x8 FORMAT "%5.3" ECU_ADDRESS 0x60034A14 /end MEASUREMENT
/begin MEASUREMENT DFC_b.TST_ComGunCntInfoWkuReq "" UBYTE DFC_OneToOne 1 100 0.00 1.000 BIT_MASK 0x8 FORMAT "%5.3" ECU_ADDRESS 0x60034A15 /end MEASUREMENT
/begin MEASUREMENT DFC_b.TST_ComHillHldFlt "" UBYTE DFC_OneToOne 1 100 0.00 1.000 BIT_MASK 0x8 FORMAT "%5.3" ECU_ADDRESS 0x60034A16 /end MEASUREMENT
/begin MEASUREMENT DFC_b.TST_ComHvBattRchrgWkuReq "" UBYTE DFC_OneToOne 1 100 0.00 1.000 BIT_MASK 0x8 FORMAT "%5.3" ECU_ADDRESS 0x60034A17 /end MEASUREMENT
/begin MEASUREMENT DFC_b.TST_ComHvbFltLvl2 "" UBYTE DFC_OneToOne 1 100 0.00 1.000 BIT_MASK 0x8 FORMAT "%5.3" ECU_ADDRESS 0x60034A18 /end MEASUREMENT
/begin MEASUREMENT DFC_b.TST_ComHvbFltLvl3 "" UBYTE DFC_OneToOne 1 100 0.00 1.000 BIT_MASK 0x8 FORMAT "%5.3" ECU_ADDRESS 0x60034A19 /end MEASUREMENT
/begin MEASUREMENT DFC_b.TST_ComHvbFltLvl4 "" UBYTE DFC_OneToOne 1 100 0.00 1.000 BIT_MASK 0x8 FORMAT "%5.3" ECU_ADDRESS 0x60034A1A /end MEASUREMENT
/begin MEASUREMENT DFC_b.TST_ComHvbFltLvl5 "" UBYTE DFC_OneToOne 1 100 0.00 1.000 BIT_MASK 0x8 FORMAT "%5.3" ECU_ADDRESS 0x60034A1B /end MEASUREMENT
/begin MEASUREMENT DFC_b.TST_ComHvbFltLvlRes "" UBYTE DFC_OneToOne 1 100 0.00 1.000 BIT_MASK 0x8 FORMAT "%5.3" ECU_ADDRESS 0x60034A1C /end MEASUREMENT
/begin MEASUREMENT DFC_b.TST_ComHvbMstBlink "" UBYTE DFC_OneToOne 1 100 0.00 1.000 BIT_MASK 0x8 FORMAT "%5.3" ECU_ADDRESS 0x60034A1D /end MEASUREMENT
/begin MEASUREMENT DFC_b.TST_ComHvbMstCont "" UBYTE DFC_OneToOne 1 100 0.00 1.000 BIT_MASK 0x8 FORMAT "%5.3" ECU_ADDRESS 0x60034A1E /end MEASUREMENT
/begin MEASUREMENT DFC_b.TST_ComImmoUnlockWkuReq "" UBYTE DFC_OneToOne 1 100 0.00 1.000 BIT_MASK 0x8 FORMAT "%5.3" ECU_ADDRESS 0x60034A1F /end MEASUREMENT
/begin MEASUREMENT DFC_b.TST_ComInfoReqPtlWkuReq "" UBYTE DFC_OneToOne 1 100 0.00 1.000 BIT_MASK 0x8 FORMAT "%5.3" ECU_ADDRESS 0x60034A20 /end MEASUREMENT
/begin MEASUREMENT DFC_b.TST_ComOBCFltLvl2 "" UBYTE DFC_OneToOne 1 100 0.00 1.000 BIT_MASK 0x8 FORMAT "%5.3" ECU_ADDRESS 0x60034A21 /end MEASUREMENT
/begin MEASUREMENT DFC_b.TST_ComOBCFltLvl3 "" UBYTE DFC_OneToOne 1 100 0.00 1.000 BIT_MASK 0x8 FORMAT "%5.3" ECU_ADDRESS 0x60034A22 /end MEASUREMENT
/begin MEASUREMENT DFC_b.TST_ComOBCFltLvl4 "" UBYTE DFC_OneToOne 1 100 0.00 1.000 BIT_MASK 0x8 FORMAT "%5.3" ECU_ADDRESS 0x60034A23 /end MEASUREMENT
/begin MEASUREMENT DFC_b.TST_ComOBCFltLvl5 "" UBYTE DFC_OneToOne 1 100 0.00 1.000 BIT_MASK 0x8 FORMAT "%5.3" ECU_ADDRESS 0x60034A24 /end MEASUREMENT
/begin MEASUREMENT DFC_b.TST_ComOBCFltLvlRes "" UBYTE DFC_OneToOne 1 100 0.00 1.000 BIT_MASK 0x8 FORMAT "%5.3" ECU_ADDRESS 0x60034A25 /end MEASUREMENT
/begin MEASUREMENT DFC_b.TST_ComPostOperationWkuReq "" UBYTE DFC_OneToOne 1 100 0.00 1.000 BIT_MASK 0x8 FORMAT "%5.3" ECU_ADDRESS 0x60034A26 /end MEASUREMENT
/begin MEASUREMENT DFC_b.TST_ComPreCondElecWkuReq "" UBYTE DFC_OneToOne 1 100 0.00 1.000 BIT_MASK 0x8 FORMAT "%5.3" ECU_ADDRESS 0x60034A27 /end MEASUREMENT
/begin MEASUREMENT DFC_b.TST_ComRemUnlckWkuReq "" UBYTE DFC_OneToOne 1 100 0.00 1.000 BIT_MASK 0x8 FORMAT "%5.3" ECU_ADDRESS 0x60034A28 /end MEASUREMENT
/begin MEASUREMENT DFC_b.TST_ComStpDlyHMIWkuReq "" UBYTE DFC_OneToOne 1 100 0.00 1.000 BIT_MASK 0x8 FORMAT "%5.3" ECU_ADDRESS 0x60034A29 /end MEASUREMENT
/begin MEASUREMENT DFC_b.TST_ComflgCurMeasmtErr "" UBYTE DFC_OneToOne 1 100 0.00 1.000 BIT_MASK 0x8 FORMAT "%5.3" ECU_ADDRESS 0x60034A2A /end MEASUREMENT
/begin MEASUREMENT DFC_b.TST_ComflgCurMeasmtSysErr "" UBYTE DFC_OneToOne 1 100 0.00 1.000 BIT_MASK 0x8 FORMAT "%5.3" ECU_ADDRESS 0x60034A2B /end MEASUREMENT
/begin MEASUREMENT DFC_b.TST_ComflgCurMeasmtVld "" UBYTE DFC_OneToOne 1 100 0.00 1.000 BIT_MASK 0x8 FORMAT "%5.3" ECU_ADDRESS 0x60034A2C /end MEASUREMENT
/begin MEASUREMENT DFC_b.TST_ComflgCurRngErr "" UBYTE DFC_OneToOne 1 100 0.00 1.000 BIT_MASK 0x8 FORMAT "%5.3" ECU_ADDRESS 0x60034A2D /end MEASUREMENT
/begin MEASUREMENT DFC_b.TST_ComflgTPcbMeasmtErr "" UBYTE DFC_OneToOne 1 100 0.00 1.000 BIT_MASK 0x8 FORMAT "%5.3" ECU_ADDRESS 0x60034A2E /end MEASUREMENT
/begin MEASUREMENT DFC_b.TST_ComflgTPcbMeasmtVld "" UBYTE DFC_OneToOne 1 100 0.00 1.000 BIT_MASK 0x8 FORMAT "%5.3" ECU_ADDRESS 0x60034A2F /end MEASUREMENT
/begin MEASUREMENT DFC_b.TST_ComflgTPcbRngErr "" UBYTE DFC_OneToOne 1 100 0.00 1.000 BIT_MASK 0x8 FORMAT "%5.3" ECU_ADDRESS 0x60034A30 /end MEASUREMENT
/begin MEASUREMENT DFC_b.TST_ComflgTPcbSysErr "" UBYTE DFC_OneToOne 1 100 0.00 1.000 BIT_MASK 0x8 FORMAT "%5.3" ECU_ADDRESS 0x60034A31 /end MEASUREMENT
/begin MEASUREMENT DFC_b.TST_ComflgTShntMeasmtErr "" UBYTE DFC_OneToOne 1 100 0.00 1.000 BIT_MASK 0x8 FORMAT "%5.3" ECU_ADDRESS 0x60034A32 /end MEASUREMENT
/begin MEASUREMENT DFC_b.TST_ComflgTShntMeasmtVld "" UBYTE DFC_OneToOne 1 100 0.00 1.000 BIT_MASK 0x8 FORMAT "%5.3" ECU_ADDRESS 0x60034A33 /end MEASUREMENT
/begin MEASUREMENT DFC_b.TST_ComflgTShntRngErr "" UBYTE DFC_OneToOne 1 100 0.00 1.000 BIT_MASK 0x8 FORMAT "%5.3" ECU_ADDRESS 0x60034A34 /end MEASUREMENT
/begin MEASUREMENT DFC_b.TST_ComflgTShntSysErr "" UBYTE DFC_OneToOne 1 100 0.00 1.000 BIT_MASK 0x8 FORMAT "%5.3" ECU_ADDRESS 0x60034A35 /end MEASUREMENT
/begin MEASUREMENT DFC_b.TST_ComflgVoltMeasmtErr "" UBYTE DFC_OneToOne 1 100 0.00 1.000 BIT_MASK 0x8 FORMAT "%5.3" ECU_ADDRESS 0x60034A36 /end MEASUREMENT
/begin MEASUREMENT DFC_b.TST_ComflgVoltMeasmtSysErr "" UBYTE DFC_OneToOne 1 100 0.00 1.000 BIT_MASK 0x8 FORMAT "%5.3" ECU_ADDRESS 0x60034A37 /end MEASUREMENT
/begin MEASUREMENT DFC_b.TST_ComflgVoltMeasmtVld "" UBYTE DFC_OneToOne 1 100 0.00 1.000 BIT_MASK 0x8 FORMAT "%5.3" ECU_ADDRESS 0x60034A38 /end MEASUREMENT
/begin MEASUREMENT DFC_b.TST_ComflgVoltRngErr "" UBYTE DFC_OneToOne 1 100 0.00 1.000 BIT_MASK 0x8 FORMAT "%5.3" ECU_ADDRESS 0x60034A39 /end MEASUREMENT
/begin MEASUREMENT DFC_b.TST_CrashEveOcc "" UBYTE DFC_OneToOne 1 100 0.00 1.000 BIT_MASK 0x8 FORMAT "%5.3" ECU_ADDRESS 0x60034A3A /end MEASUREMENT
/begin MEASUREMENT DFC_b.TST_DcdcFwdModStuck "" UBYTE DFC_OneToOne 1 100 0.00 1.000 BIT_MASK 0x8 FORMAT "%5.3" ECU_ADDRESS 0x60034A3B /end MEASUREMENT
/begin MEASUREMENT DFC_b.TST_DcdcLvUDifMaxFlt "" UBYTE DFC_OneToOne 1 100 0.00 1.000 BIT_MASK 0x8 FORMAT "%5.3" ECU_ADDRESS 0x60034A3C /end MEASUREMENT
/begin MEASUREMENT DFC_b.TST_DcdcOffModStuck "" UBYTE DFC_OneToOne 1 100 0.00 1.000 BIT_MASK 0x8 FORMAT "%5.3" ECU_ADDRESS 0x60034A3D /end MEASUREMENT
/begin MEASUREMENT DFC_b.TST_DcdcOperModFailr "" UBYTE DFC_OneToOne 1 100 0.00 1.000 BIT_MASK 0x8 FORMAT "%5.3" ECU_ADDRESS 0x60034A3E /end MEASUREMENT
/begin MEASUREMENT DFC_b.TST_DcdcPrecModStuck "" UBYTE DFC_OneToOne 1 100 0.00 1.000 BIT_MASK 0x8 FORMAT "%5.3" ECU_ADDRESS 0x60034A3F /end MEASUREMENT
/begin MEASUREMENT DFC_b.TST_DrvDoorOpn "" UBYTE DFC_OneToOne 1 100 0.00 1.000 BIT_MASK 0x8 FORMAT "%5.3" ECU_ADDRESS 0x60034A40 /end MEASUREMENT
/begin MEASUREMENT DFC_b.TST_DrvModPosnDfct "" UBYTE DFC_OneToOne 1 100 0.00 1.000 BIT_MASK 0x8 FORMAT "%5.3" ECU_ADDRESS 0x60034A41 /end MEASUREMENT
/begin MEASUREMENT DFC_b.TST_DrvStbltOpn "" UBYTE DFC_OneToOne 1 100 0.00 1.000 BIT_MASK 0x8 FORMAT "%5.3" ECU_ADDRESS 0x60034A42 /end MEASUREMENT
/begin MEASUREMENT DFC_b.TST_ETogFailrLvl3 "" UBYTE DFC_OneToOne 1 100 0.00 1.000 BIT_MASK 0x8 FORMAT "%5.3" ECU_ADDRESS 0x60034A43 /end MEASUREMENT
/begin MEASUREMENT DFC_b.TST_ETogFailrLvl4 "" UBYTE DFC_OneToOne 1 100 0.00 1.000 BIT_MASK 0x8 FORMAT "%5.3" ECU_ADDRESS 0x60034A44 /end MEASUREMENT
/begin MEASUREMENT DFC_b.TST_EbsLvBattSocDiagLo "" UBYTE DFC_OneToOne 1 100 0.00 1.000 BIT_MASK 0x8 FORMAT "%5.3" ECU_ADDRESS 0x60034A45 /end MEASUREMENT
/begin MEASUREMENT DFC_b.TST_EbsLvBattUDiagDiOper "" UBYTE DFC_OneToOne 1 100 0.00 1.000 BIT_MASK 0x8 FORMAT "%5.3" ECU_ADDRESS 0x60034A46 /end MEASUREMENT
/begin MEASUREMENT DFC_b.TST_EbsLvBattUDiagFltLvl1 "" UBYTE DFC_OneToOne 1 100 0.00 1.000 BIT_MASK 0x8 FORMAT "%5.3" ECU_ADDRESS 0x60034A47 /end MEASUREMENT
/begin MEASUREMENT DFC_b.TST_EbsLvBattUDiagFltLvl2 "" UBYTE DFC_OneToOne 1 100 0.00 1.000 BIT_MASK 0x8 FORMAT "%5.3" ECU_ADDRESS 0x60034A48 /end MEASUREMENT
/begin MEASUREMENT DFC_b.TST_EbsLvBattUDiagLo "" UBYTE DFC_OneToOne 1 100 0.00 1.000 BIT_MASK 0x8 FORMAT "%5.3" ECU_ADDRESS 0x60034A49 /end MEASUREMENT
/begin MEASUREMENT DFC_b.TST_EbsSnsrSt "" UBYTE DFC_OneToOne 1 100 0.00 1.000 BIT_MASK 0x8 FORMAT "%5.3" ECU_ADDRESS 0x60034A4A /end MEASUREMENT
/begin MEASUREMENT DFC_b.TST_EbsSofASILErr "" UBYTE DFC_OneToOne 1 100 0.00 1.000 BIT_MASK 0x8 FORMAT "%5.3" ECU_ADDRESS 0x60034A4B /end MEASUREMENT
/begin MEASUREMENT DFC_b.TST_ElTSPtSysLimDrvErr "" UBYTE DFC_OneToOne 1 100 0.00 1.000 BIT_MASK 0x8 FORMAT "%5.3" ECU_ADDRESS 0x60034A4C /end MEASUREMENT
/begin MEASUREMENT DFC_b.TST_ElTSPtSysLimRgnErr "" UBYTE DFC_OneToOne 1 100 0.00 1.000 BIT_MASK 0x8 FORMAT "%5.3" ECU_ADDRESS 0x60034A4D /end MEASUREMENT
/begin MEASUREMENT DFC_b.TST_HLCCcsFwDwnl "" UBYTE DFC_OneToOne 1 100 0.00 1.000 BIT_MASK 0x8 FORMAT "%5.3" ECU_ADDRESS 0x60034A4E /end MEASUREMENT
/begin MEASUREMENT DFC_b.TST_HvBattChrgPwrMax "" UBYTE DFC_OneToOne 1 100 0.00 1.000 BIT_MASK 0x8 FORMAT "%5.3" ECU_ADDRESS 0x60034A4F /end MEASUREMENT
/begin MEASUREMENT DFC_b.TST_HvBattCrashDetd "" UBYTE DFC_OneToOne 1 100 0.00 1.000 BIT_MASK 0x8 FORMAT "%5.3" ECU_ADDRESS 0x60034A50 /end MEASUREMENT
/begin MEASUREMENT DFC_b.TST_HvBattDchaPwrMax "" UBYTE DFC_OneToOne 1 100 0.00 1.000 BIT_MASK 0x8 FORMAT "%5.3" ECU_ADDRESS 0x60034A51 /end MEASUREMENT
/begin MEASUREMENT DFC_b.TST_HvBattEmgyOff "" UBYTE DFC_OneToOne 1 100 0.00 1.000 BIT_MASK 0x8 FORMAT "%5.3" ECU_ADDRESS 0x60034A52 /end MEASUREMENT
/begin MEASUREMENT DFC_b.TST_HvBattEmgyOffIntlck "" UBYTE DFC_OneToOne 1 100 0.00 1.000 BIT_MASK 0x8 FORMAT "%5.3" ECU_ADDRESS 0x60034A53 /end MEASUREMENT
/begin MEASUREMENT DFC_b.TST_HvBattEmgyOffReq "" UBYTE DFC_OneToOne 1 100 0.00 1.000 BIT_MASK 0x8 FORMAT "%5.3" ECU_ADDRESS 0x60034A54 /end MEASUREMENT
/begin MEASUREMENT DFC_b.TST_HvBattFltMod "" UBYTE DFC_OneToOne 1 100 0.00 1.000 BIT_MASK 0x8 FORMAT "%5.3" ECU_ADDRESS 0x60034A55 /end MEASUREMENT
/begin MEASUREMENT DFC_b.TST_HvBattIReqToChrgrErr "" UBYTE DFC_OneToOne 1 100 0.00 1.000 BIT_MASK 0x8 FORMAT "%5.3" ECU_ADDRESS 0x60034A56 /end MEASUREMENT
/begin MEASUREMENT DFC_b.TST_HvBattIReqToChrgrIni "" UBYTE DFC_OneToOne 1 100 0.00 1.000 BIT_MASK 0x8 FORMAT "%5.3" ECU_ADDRESS 0x60034A57 /end MEASUREMENT
/begin MEASUREMENT DFC_b.TST_HvBattIninTout "" UBYTE DFC_OneToOne 1 100 0.00 1.000 BIT_MASK 0x8 FORMAT "%5.3" ECU_ADDRESS 0x60034A58 /end MEASUREMENT
/begin MEASUREMENT DFC_b.TST_HvBattIntlckSt "" UBYTE DFC_OneToOne 1 100 0.00 1.000 BIT_MASK 0x8 FORMAT "%5.3" ECU_ADDRESS 0x60034A59 /end MEASUREMENT
/begin MEASUREMENT DFC_b.TST_HvBattIsoFlt "" UBYTE DFC_OneToOne 1 100 0.00 1.000 BIT_MASK 0x8 FORMAT "%5.3" ECU_ADDRESS 0x60034A5A /end MEASUREMENT
/begin MEASUREMENT DFC_b.TST_HvBattLimdPwr "" UBYTE DFC_OneToOne 1 100 0.00 1.000 BIT_MASK 0x8 FORMAT "%5.3" ECU_ADDRESS 0x60034A5B /end MEASUREMENT
/begin MEASUREMENT DFC_b.TST_HvBattMaiSwtClsngFlt "" UBYTE DFC_OneToOne 1 100 0.00 1.000 BIT_MASK 0x8 FORMAT "%5.3" ECU_ADDRESS 0x60034A5C /end MEASUREMENT
/begin MEASUREMENT DFC_b.TST_HvBattMaiSwtFlt "" UBYTE DFC_OneToOne 1 100 0.00 1.000 BIT_MASK 0x8 FORMAT "%5.3" ECU_ADDRESS 0x60034A5D /end MEASUREMENT
/begin MEASUREMENT DFC_b.TST_HvBattMaiSwtOpen "" UBYTE DFC_OneToOne 1 100 0.00 1.000 BIT_MASK 0x8 FORMAT "%5.3" ECU_ADDRESS 0x60034A5E /end MEASUREMENT
/begin MEASUREMENT DFC_b.TST_HvBattMaiSwtOpngFlt "" UBYTE DFC_OneToOne 1 100 0.00 1.000 BIT_MASK 0x8 FORMAT "%5.3" ECU_ADDRESS 0x60034A5F /end MEASUREMENT
/begin MEASUREMENT DFC_b.TST_HvBattMaiSwtWldd "" UBYTE DFC_OneToOne 1 100 0.00 1.000 BIT_MASK 0x8 FORMAT "%5.3" ECU_ADDRESS 0x60034A60 /end MEASUREMENT
/begin MEASUREMENT DFC_b.TST_HvBattNegCntctrCntErr "" UBYTE DFC_OneToOne 1 100 0.00 1.000 BIT_MASK 0x8 FORMAT "%5.3" ECU_ADDRESS 0x60034A61 /end MEASUREMENT
/begin MEASUREMENT DFC_b.TST_HvBattOperModChrgPlausy "" UBYTE DFC_OneToOne 1 100 0.00 1.000 BIT_MASK 0x8 FORMAT "%5.3" ECU_ADDRESS 0x60034A62 /end MEASUREMENT
/begin MEASUREMENT DFC_b.TST_HvBattOverTDern "" UBYTE DFC_OneToOne 1 100 0.00 1.000 BIT_MASK 0x8 FORMAT "%5.3" ECU_ADDRESS 0x60034A63 /end MEASUREMENT
/begin MEASUREMENT DFC_b.TST_HvBattPosCntctrCntErr "" UBYTE DFC_OneToOne 1 100 0.00 1.000 BIT_MASK 0x8 FORMAT "%5.3" ECU_ADDRESS 0x60034A64 /end MEASUREMENT
/begin MEASUREMENT DFC_b.TST_HvBattPrecCntctrCntErr "" UBYTE DFC_OneToOne 1 100 0.00 1.000 BIT_MASK 0x8 FORMAT "%5.3" ECU_ADDRESS 0x60034A65 /end MEASUREMENT
/begin MEASUREMENT DFC_b.TST_HvBattPwrDistbnTDern "" UBYTE DFC_OneToOne 1 100 0.00 1.000 BIT_MASK 0x8 FORMAT "%5.3" ECU_ADDRESS 0x60034A66 /end MEASUREMENT
/begin MEASUREMENT DFC_b.TST_HvBattPwrDistbnTInhbn "" UBYTE DFC_OneToOne 1 100 0.00 1.000 BIT_MASK 0x8 FORMAT "%5.3" ECU_ADDRESS 0x60034A67 /end MEASUREMENT
/begin MEASUREMENT DFC_b.TST_HvBattRatRSohErr "" UBYTE DFC_OneToOne 1 100 0.00 1.000 BIT_MASK 0x8 FORMAT "%5.3" ECU_ADDRESS 0x60034A68 /end MEASUREMENT
/begin MEASUREMENT DFC_b.TST_HvBattRatSohErr "" UBYTE DFC_OneToOne 1 100 0.00 1.000 BIT_MASK 0x8 FORMAT "%5.3" ECU_ADDRESS 0x60034A69 /end MEASUREMENT
/begin MEASUREMENT DFC_b.TST_HvBattSngIsoWarn "" UBYTE DFC_OneToOne 1 100 0.00 1.000 BIT_MASK 0x8 FORMAT "%5.3" ECU_ADDRESS 0x60034A6A /end MEASUREMENT
/begin MEASUREMENT DFC_b.TST_HvBattSrvPlgDiscnct "" UBYTE DFC_OneToOne 1 100 0.00 1.000 BIT_MASK 0x8 FORMAT "%5.3" ECU_ADDRESS 0x60034A6B /end MEASUREMENT
/begin MEASUREMENT DFC_b.TST_HvBattUNomChrgnErr "" UBYTE DFC_OneToOne 1 100 0.00 1.000 BIT_MASK 0x8 FORMAT "%5.3" ECU_ADDRESS 0x60034A6C /end MEASUREMENT
/begin MEASUREMENT DFC_b.TST_HvBattUNomChrgnIni "" UBYTE DFC_OneToOne 1 100 0.00 1.000 BIT_MASK 0x8 FORMAT "%5.3" ECU_ADDRESS 0x60034A6D /end MEASUREMENT
/begin MEASUREMENT DFC_b.TST_HvBattUnderTDern "" UBYTE DFC_OneToOne 1 100 0.00 1.000 BIT_MASK 0x8 FORMAT "%5.3" ECU_ADDRESS 0x60034A6E /end MEASUREMENT
/begin MEASUREMENT DFC_b.TST_HvbEVLmpBlink "" UBYTE DFC_OneToOne 1 100 0.00 1.000 BIT_MASK 0x8 FORMAT "%5.3" ECU_ADDRESS 0x60034A6F /end MEASUREMENT
/begin MEASUREMENT DFC_b.TST_HvbEVLmpCont "" UBYTE DFC_OneToOne 1 100 0.00 1.000 BIT_MASK 0x8 FORMAT "%5.3" ECU_ADDRESS 0x60034A70 /end MEASUREMENT
/begin MEASUREMENT DFC_b.TST_HvbSVSBlink "" UBYTE DFC_OneToOne 1 100 0.00 1.000 BIT_MASK 0x8 FORMAT "%5.3" ECU_ADDRESS 0x60034A71 /end MEASUREMENT
/begin MEASUREMENT DFC_b.TST_HvbSVSCont "" UBYTE DFC_OneToOne 1 100 0.00 1.000 BIT_MASK 0x8 FORMAT "%5.3" ECU_ADDRESS 0x60034A72 /end MEASUREMENT
/begin MEASUREMENT DFC_b.TST_InmLINBusBlk "" UBYTE DFC_OneToOne 1 100 0.00 1.000 BIT_MASK 0x8 FORMAT "%5.3" ECU_ADDRESS 0x60034A73 /end MEASUREMENT
/begin MEASUREMENT DFC_b.TST_PDUProgmFailr "" UBYTE DFC_OneToOne 1 100 0.00 1.000 BIT_MASK 0x8 FORMAT "%5.3" ECU_ADDRESS 0x60034A74 /end MEASUREMENT
/begin MEASUREMENT DFC_b.TST_PEnvSigRngMax "" UBYTE DFC_OneToOne 1 100 0.00 1.000 BIT_MASK 0x8 FORMAT "%5.3" ECU_ADDRESS 0x60034A75 /end MEASUREMENT
/begin MEASUREMENT DFC_b.TST_PEnvSigRngMin "" UBYTE DFC_OneToOne 1 100 0.00 1.000 BIT_MASK 0x8 FORMAT "%5.3" ECU_ADDRESS 0x60034A76 /end MEASUREMENT
/begin MEASUREMENT DFC_b.TST_PLnCChpDeactvnFaild "" UBYTE DFC_OneToOne 1 100 0.00 1.000 BIT_MASK 0x8 FORMAT "%5.3" ECU_ADDRESS 0x60034A77 /end MEASUREMENT
/begin MEASUREMENT DFC_b.TST_PrkgBrkFailr "" UBYTE DFC_OneToOne 1 100 0.00 1.000 BIT_MASK 0x8 FORMAT "%5.3" ECU_ADDRESS 0x60034A78 /end MEASUREMENT
/begin MEASUREMENT DFC_b.TST_PtSysLimErr "" UBYTE DFC_OneToOne 1 100 0.00 1.000 BIT_MASK 0x8 FORMAT "%5.3" ECU_ADDRESS 0x60034A79 /end MEASUREMENT
/begin MEASUREMENT DFC_b.TST_PwrMaxDchaShoLo "" UBYTE DFC_OneToOne 1 100 0.00 1.000 BIT_MASK 0x8 FORMAT "%5.3" ECU_ADDRESS 0x60034A7A /end MEASUREMENT
/begin MEASUREMENT DFC_b.TST_SCtPmp1FailSafeNotSuc "" UBYTE DFC_OneToOne 1 100 0.00 1.000 BIT_MASK 0x8 FORMAT "%5.3" ECU_ADDRESS 0x60034A7B /end MEASUREMENT
/begin MEASUREMENT DFC_b.TST_SCtPmp1SCG "" UBYTE DFC_OneToOne 1 100 0.00 1.000 BIT_MASK 0x8 FORMAT "%5.3" ECU_ADDRESS 0x60034A7C /end MEASUREMENT
/begin MEASUREMENT DFC_b.TST_VehCoornDrvrNotPrsnt "" UBYTE DFC_OneToOne 1 100 0.00 1.000 BIT_MASK 0x8 FORMAT "%5.3" ECU_ADDRESS 0x60034A7D /end MEASUREMENT
/begin MEASUREMENT DFC_b.TST_VehVCanAvl "" UBYTE DFC_OneToOne 1 100 0.00 1.000 BIT_MASK 0x8 FORMAT "%5.3" ECU_ADDRESS 0x60034A7E /end MEASUREMENT
/begin MEASUREMENT DFC_b.TST_VehVCanErr "" UBYTE DFC_OneToOne 1 100 0.00 1.000 BIT_MASK 0x8 FORMAT "%5.3" ECU_ADDRESS 0x60034A7F /end MEASUREMENT
/begin MEASUREMENT DFC_b.TST_eTogFailrLvlRes "" UBYTE DFC_OneToOne 1 100 0.00 1.000 BIT_MASK 0x8 FORMAT "%5.3" ECU_ADDRESS 0x60034A80 /end MEASUREMENT
/begin MEASUREMENT DFC_b.TST_flgBrkMaiDiag "" UBYTE DFC_OneToOne 1 100 0.00 1.000 BIT_MASK 0x8 FORMAT "%5.3" ECU_ADDRESS 0x60034A81 /end MEASUREMENT
/begin MEASUREMENT DFC_b.TST_stHvbIsoMeasmtRes "" UBYTE DFC_OneToOne 1 100 0.00 1.000 BIT_MASK 0x8 FORMAT "%5.3" ECU_ADDRESS 0x60034A82 /end MEASUREMENT
/begin MEASUREMENT DFC_b.TST_BrkBstPmpPLeakDfct "" UBYTE DFC_OneToOne 1 100 0.00 1.000 BIT_MASK 0x8 FORMAT "%5.3" ECU_ADDRESS 0x60034A83 /end MEASUREMENT
/begin MEASUREMENT DFC_b.TST_Com082hTooShort "" UBYTE DFC_OneToOne 1 100 0.00 1.000 BIT_MASK 0x8 FORMAT "%5.3" ECU_ADDRESS 0x60034A84 /end MEASUREMENT
/begin MEASUREMENT DFC_b.TST_Com092hTooShort "" UBYTE DFC_OneToOne 1 100 0.00 1.000 BIT_MASK 0x8 FORMAT "%5.3" ECU_ADDRESS 0x60034A85 /end MEASUREMENT
/begin MEASUREMENT DFC_b.TST_Com205hAbsent "" UBYTE DFC_OneToOne 1 100 0.00 1.000 BIT_MASK 0x8 FORMAT "%5.3" ECU_ADDRESS 0x60034A86 /end MEASUREMENT
/begin MEASUREMENT DFC_b.TST_Com205hChecksum "" UBYTE DFC_OneToOne 1 100 0.00 1.000 BIT_MASK 0x8 FORMAT "%5.3" ECU_ADDRESS 0x60034A87 /end MEASUREMENT
/begin MEASUREMENT DFC_b.TST_Com205hCounter "" UBYTE DFC_OneToOne 1 100 0.00 1.000 BIT_MASK 0x8 FORMAT "%5.3" ECU_ADDRESS 0x60034A88 /end MEASUREMENT
/begin MEASUREMENT DFC_b.TST_Com205hTooShort "" UBYTE DFC_OneToOne 1 100 0.00 1.000 BIT_MASK 0x8 FORMAT "%5.3" ECU_ADDRESS 0x60034A89 /end MEASUREMENT
/begin MEASUREMENT DFC_b.TST_Com217hAbsent "" UBYTE DFC_OneToOne 1 100 0.00 1.000 BIT_MASK 0x8 FORMAT "%5.3" ECU_ADDRESS 0x60034A8A /end MEASUREMENT
/begin MEASUREMENT DFC_b.TST_Com217hChecksum "" UBYTE DFC_OneToOne 1 100 0.00 1.000 BIT_MASK 0x8 FORMAT "%5.3" ECU_ADDRESS 0x60034A8B /end MEASUREMENT
/begin MEASUREMENT DFC_b.TST_Com217hCounter "" UBYTE DFC_OneToOne 1 100 0.00 1.000 BIT_MASK 0x8 FORMAT "%5.3" ECU_ADDRESS 0x60034A8C /end MEASUREMENT
/begin MEASUREMENT DFC_b.TST_Com217hTooShort "" UBYTE DFC_OneToOne 1 100 0.00 1.000 BIT_MASK 0x8 FORMAT "%5.3" ECU_ADDRESS 0x60034A8D /end MEASUREMENT
/begin MEASUREMENT DFC_b.TST_Com227hAbsent "" UBYTE DFC_OneToOne 1 100 0.00 1.000 BIT_MASK 0x8 FORMAT "%5.3" ECU_ADDRESS 0x60034A8E /end MEASUREMENT
/begin MEASUREMENT DFC_b.TST_Com227hTooShort "" UBYTE DFC_OneToOne 1 100 0.00 1.000 BIT_MASK 0x8 FORMAT "%5.3" ECU_ADDRESS 0x60034A8F /end MEASUREMENT
/begin MEASUREMENT DFC_b.TST_Com237hAbsent "" UBYTE DFC_OneToOne 1 100 0.00 1.000 BIT_MASK 0x8 FORMAT "%5.3" ECU_ADDRESS 0x60034A90 /end MEASUREMENT
/begin MEASUREMENT DFC_b.TST_Com237hChecksum "" UBYTE DFC_OneToOne 1 100 0.00 1.000 BIT_MASK 0x8 FORMAT "%5.3" ECU_ADDRESS 0x60034A91 /end MEASUREMENT
/begin MEASUREMENT DFC_b.TST_Com237hCounter "" UBYTE DFC_OneToOne 1 100 0.00 1.000 BIT_MASK 0x8 FORMAT "%5.3" ECU_ADDRESS 0x60034A92 /end MEASUREMENT
/begin MEASUREMENT DFC_b.TST_Com237hTooShort "" UBYTE DFC_OneToOne 1 100 0.00 1.000 BIT_MASK 0x8 FORMAT "%5.3" ECU_ADDRESS 0x60034A93 /end MEASUREMENT
/begin MEASUREMENT DFC_b.TST_Com259hAbsent "" UBYTE DFC_OneToOne 1 100 0.00 1.000 BIT_MASK 0x8 FORMAT "%5.3" ECU_ADDRESS 0x60034A94 /end MEASUREMENT
/begin MEASUREMENT DFC_b.TST_Com259hChecksum "" UBYTE DFC_OneToOne 1 100 0.00 1.000 BIT_MASK 0x8 FORMAT "%5.3" ECU_ADDRESS 0x60034A95 /end MEASUREMENT
/begin MEASUREMENT DFC_b.TST_Com259hCounter "" UBYTE DFC_OneToOne 1 100 0.00 1.000 BIT_MASK 0x8 FORMAT "%5.3" ECU_ADDRESS 0x60034A96 /end MEASUREMENT
/begin MEASUREMENT DFC_b.TST_Com259hTooShort "" UBYTE DFC_OneToOne 1 100 0.00 1.000 BIT_MASK 0x8 FORMAT "%5.3" ECU_ADDRESS 0x60034A97 /end MEASUREMENT
/begin MEASUREMENT DFC_b.TST_Com26hAbsent "" UBYTE DFC_OneToOne 1 100 0.00 1.000 BIT_MASK 0x8 FORMAT "%5.3" ECU_ADDRESS 0x60034A98 /end MEASUREMENT
/begin MEASUREMENT DFC_b.TST_Com26hTooShort "" UBYTE DFC_OneToOne 1 100 0.00 1.000 BIT_MASK 0x8 FORMAT "%5.3" ECU_ADDRESS 0x60034A99 /end MEASUREMENT
/begin MEASUREMENT DFC_b.TST_Com273hAbsent "" UBYTE DFC_OneToOne 1 100 0.00 1.000 BIT_MASK 0x8 FORMAT "%5.3" ECU_ADDRESS 0x60034A9A /end MEASUREMENT
/begin MEASUREMENT DFC_b.TST_Com273hChecksum "" UBYTE DFC_OneToOne 1 100 0.00 1.000 BIT_MASK 0x8 FORMAT "%5.3" ECU_ADDRESS 0x60034A9B /end MEASUREMENT
/begin MEASUREMENT DFC_b.TST_Com273hCounter "" UBYTE DFC_OneToOne 1 100 0.00 1.000 BIT_MASK 0x8 FORMAT "%5.3" ECU_ADDRESS 0x60034A9C /end MEASUREMENT
/begin MEASUREMENT DFC_b.TST_Com273hTooShort "" UBYTE DFC_OneToOne 1 100 0.00 1.000 BIT_MASK 0x8 FORMAT "%5.3" ECU_ADDRESS 0x60034A9D /end MEASUREMENT
/begin MEASUREMENT DFC_b.TST_Com275hAbsent "" UBYTE DFC_OneToOne 1 100 0.00 1.000 BIT_MASK 0x8 FORMAT "%5.3" ECU_ADDRESS 0x60034A9E /end MEASUREMENT
/begin MEASUREMENT DFC_b.TST_Com275hChecksum "" UBYTE DFC_OneToOne 1 100 0.00 1.000 BIT_MASK 0x8 FORMAT "%5.3" ECU_ADDRESS 0x60034A9F /end MEASUREMENT
/begin MEASUREMENT DFC_b.TST_Com275hCounter "" UBYTE DFC_OneToOne 1 100 0.00 1.000 BIT_MASK 0x8 FORMAT "%5.3" ECU_ADDRESS 0x60034AA0 /end MEASUREMENT
/begin MEASUREMENT DFC_b.TST_Com275hTooShort "" UBYTE DFC_OneToOne 1 100 0.00 1.000 BIT_MASK 0x8 FORMAT "%5.3" ECU_ADDRESS 0x60034AA1 /end MEASUREMENT
/begin MEASUREMENT DFC_b.TST_Com283hAbsent "" UBYTE DFC_OneToOne 1 100 0.00 1.000 BIT_MASK 0x8 FORMAT "%5.3" ECU_ADDRESS 0x60034AA2 /end MEASUREMENT
/begin MEASUREMENT DFC_b.TST_Com283hTooShort "" UBYTE DFC_OneToOne 1 100 0.00 1.000 BIT_MASK 0x8 FORMAT "%5.3" ECU_ADDRESS 0x60034AA3 /end MEASUREMENT
/begin MEASUREMENT DFC_b.TST_Com285hAbsent "" UBYTE DFC_OneToOne 1 100 0.00 1.000 BIT_MASK 0x8 FORMAT "%5.3" ECU_ADDRESS 0x60034AA4 /end MEASUREMENT
/begin MEASUREMENT DFC_b.TST_Com285hChecksum "" UBYTE DFC_OneToOne 1 100 0.00 1.000 BIT_MASK 0x8 FORMAT "%5.3" ECU_ADDRESS 0x60034AA5 /end MEASUREMENT
/begin MEASUREMENT DFC_b.TST_Com285hCounter "" UBYTE DFC_OneToOne 1 100 0.00 1.000 BIT_MASK 0x8 FORMAT "%5.3" ECU_ADDRESS 0x60034AA6 /end MEASUREMENT
/begin MEASUREMENT DFC_b.TST_Com285hTooShort "" UBYTE DFC_OneToOne 1 100 0.00 1.000 BIT_MASK 0x8 FORMAT "%5.3" ECU_ADDRESS 0x60034AA7 /end MEASUREMENT
/begin MEASUREMENT DFC_b.TST_Com293hAbsent "" UBYTE DFC_OneToOne 1 100 0.00 1.000 BIT_MASK 0x8 FORMAT "%5.3" ECU_ADDRESS 0x60034AA8 /end MEASUREMENT
/begin MEASUREMENT DFC_b.TST_Com293hChecksum "" UBYTE DFC_OneToOne 1 100 0.00 1.000 BIT_MASK 0x8 FORMAT "%5.3" ECU_ADDRESS 0x60034AA9 /end MEASUREMENT
/begin MEASUREMENT DFC_b.TST_Com293hCounter "" UBYTE DFC_OneToOne 1 100 0.00 1.000 BIT_MASK 0x8 FORMAT "%5.3" ECU_ADDRESS 0x60034AAA /end MEASUREMENT
/begin MEASUREMENT DFC_b.TST_Com293hTooShort "" UBYTE DFC_OneToOne 1 100 0.00 1.000 BIT_MASK 0x8 FORMAT "%5.3" ECU_ADDRESS 0x60034AAB /end MEASUREMENT
/begin MEASUREMENT DFC_b.TST_Com308hAbsent "" UBYTE DFC_OneToOne 1 100 0.00 1.000 BIT_MASK 0x8 FORMAT "%5.3" ECU_ADDRESS 0x60034AAC /end MEASUREMENT
/begin MEASUREMENT DFC_b.TST_Com308hChecksum "" UBYTE DFC_OneToOne 1 100 0.00 1.000 BIT_MASK 0x8 FORMAT "%5.3" ECU_ADDRESS 0x60034AAD /end MEASUREMENT
/begin MEASUREMENT DFC_b.TST_Com308hCounter "" UBYTE DFC_OneToOne 1 100 0.00 1.000 BIT_MASK 0x8 FORMAT "%5.3" ECU_ADDRESS 0x60034AAE /end MEASUREMENT
/begin MEASUREMENT DFC_b.TST_Com308hTooShort "" UBYTE DFC_OneToOne 1 100 0.00 1.000 BIT_MASK 0x8 FORMAT "%5.3" ECU_ADDRESS 0x60034AAF /end MEASUREMENT
/begin MEASUREMENT DFC_b.TST_Com318hAbsent "" UBYTE DFC_OneToOne 1 100 0.00 1.000 BIT_MASK 0x8 FORMAT "%5.3" ECU_ADDRESS 0x60034AB0 /end MEASUREMENT
/begin MEASUREMENT DFC_b.TST_Com318hChecksum "" UBYTE DFC_OneToOne 1 100 0.00 1.000 BIT_MASK 0x8 FORMAT "%5.3" ECU_ADDRESS 0x60034AB1 /end MEASUREMENT
/begin MEASUREMENT DFC_b.TST_Com318hCounter "" UBYTE DFC_OneToOne 1 100 0.00 1.000 BIT_MASK 0x8 FORMAT "%5.3" ECU_ADDRESS 0x60034AB2 /end MEASUREMENT
/begin MEASUREMENT DFC_b.TST_Com318hTooShort "" UBYTE DFC_OneToOne 1 100 0.00 1.000 BIT_MASK 0x8 FORMAT "%5.3" ECU_ADDRESS 0x60034AB3 /end MEASUREMENT
/begin MEASUREMENT DFC_b.TST_Com325hAbsent "" UBYTE DFC_OneToOne 1 100 0.00 1.000 BIT_MASK 0x8 FORMAT "%5.3" ECU_ADDRESS 0x60034AB4 /end MEASUREMENT
/begin MEASUREMENT DFC_b.TST_Com325hChecksum "" UBYTE DFC_OneToOne 1 100 0.00 1.000 BIT_MASK 0x8 FORMAT "%5.3" ECU_ADDRESS 0x60034AB5 /end MEASUREMENT
/begin MEASUREMENT DFC_b.TST_Com325hCounter "" UBYTE DFC_OneToOne 1 100 0.00 1.000 BIT_MASK 0x8 FORMAT "%5.3" ECU_ADDRESS 0x60034AB6 /end MEASUREMENT
/begin MEASUREMENT DFC_b.TST_Com325hTooShort "" UBYTE DFC_OneToOne 1 100 0.00 1.000 BIT_MASK 0x8 FORMAT "%5.3" ECU_ADDRESS 0x60034AB7 /end MEASUREMENT
/begin MEASUREMENT DFC_b.TST_Com335hAbsent "" UBYTE DFC_OneToOne 1 100 0.00 1.000 BIT_MASK 0x8 FORMAT "%5.3" ECU_ADDRESS 0x60034AB8 /end MEASUREMENT
/begin MEASUREMENT DFC_b.TST_Com335hChecksum "" UBYTE DFC_OneToOne 1 100 0.00 1.000 BIT_MASK 0x8 FORMAT "%5.3" ECU_ADDRESS 0x60034AB9 /end MEASUREMENT
/begin MEASUREMENT DFC_b.TST_Com335hCounter "" UBYTE DFC_OneToOne 1 100 0.00 1.000 BIT_MASK 0x8 FORMAT "%5.3" ECU_ADDRESS 0x60034ABA /end MEASUREMENT
/begin MEASUREMENT DFC_b.TST_Com335hTooShort "" UBYTE DFC_OneToOne 1 100 0.00 1.000 BIT_MASK 0x8 FORMAT "%5.3" ECU_ADDRESS 0x60034ABB /end MEASUREMENT
/begin MEASUREMENT DFC_b.TST_Com351hAbsent "" UBYTE DFC_OneToOne 1 100 0.00 1.000 BIT_MASK 0x8 FORMAT "%5.3" ECU_ADDRESS 0x60034ABC /end MEASUREMENT
/begin MEASUREMENT DFC_b.TST_Com351hTooShort "" UBYTE DFC_OneToOne 1 100 0.00 1.000 BIT_MASK 0x8 FORMAT "%5.3" ECU_ADDRESS 0x60034ABD /end MEASUREMENT
/begin MEASUREMENT DFC_b.TST_Com38DhAbsent "" UBYTE DFC_OneToOne 1 100 0.00 1.000 BIT_MASK 0x8 FORMAT "%5.3" ECU_ADDRESS 0x60034ABE /end MEASUREMENT
/begin MEASUREMENT DFC_b.TST_Com38DhChecksum "" UBYTE DFC_OneToOne 1 100 0.00 1.000 BIT_MASK 0x8 FORMAT "%5.3" ECU_ADDRESS 0x60034ABF /end MEASUREMENT
/begin MEASUREMENT DFC_b.TST_Com38DhCounter "" UBYTE DFC_OneToOne 1 100 0.00 1.000 BIT_MASK 0x8 FORMAT "%5.3" ECU_ADDRESS 0x60034AC0 /end MEASUREMENT
/begin MEASUREMENT DFC_b.TST_Com38DhTooShort "" UBYTE DFC_OneToOne 1 100 0.00 1.000 BIT_MASK 0x8 FORMAT "%5.3" ECU_ADDRESS 0x60034AC1 /end MEASUREMENT
/begin MEASUREMENT DFC_b.TST_Com412hAbsent "" UBYTE DFC_OneToOne 1 100 0.00 1.000 BIT_MASK 0x8 FORMAT "%5.3" ECU_ADDRESS 0x60034AC2 /end MEASUREMENT
/begin MEASUREMENT DFC_b.TST_Com412hChecksum "" UBYTE DFC_OneToOne 1 100 0.00 1.000 BIT_MASK 0x8 FORMAT "%5.3" ECU_ADDRESS 0x60034AC3 /end MEASUREMENT
/begin MEASUREMENT DFC_b.TST_Com412hCounter "" UBYTE DFC_OneToOne 1 100 0.00 1.000 BIT_MASK 0x8 FORMAT "%5.3" ECU_ADDRESS 0x60034AC4 /end MEASUREMENT
/begin MEASUREMENT DFC_b.TST_Com412hTooShort "" UBYTE DFC_OneToOne 1 100 0.00 1.000 BIT_MASK 0x8 FORMAT "%5.3" ECU_ADDRESS 0x60034AC5 /end MEASUREMENT
/begin MEASUREMENT DFC_b.TST_Com427hAbsent "" UBYTE DFC_OneToOne 1 100 0.00 1.000 BIT_MASK 0x8 FORMAT "%5.3" ECU_ADDRESS 0x60034AC6 /end MEASUREMENT
/begin MEASUREMENT DFC_b.TST_Com427hTooShort "" UBYTE DFC_OneToOne 1 100 0.00 1.000 BIT_MASK 0x8 FORMAT "%5.3" ECU_ADDRESS 0x60034AC7 /end MEASUREMENT
/begin MEASUREMENT DFC_b.TST_Com432hAbsent "" UBYTE DFC_OneToOne 1 100 0.00 1.000 BIT_MASK 0x8 FORMAT "%5.3" ECU_ADDRESS 0x60034AC8 /end MEASUREMENT
/begin MEASUREMENT DFC_b.TST_Com432hChecksum "" UBYTE DFC_OneToOne 1 100 0.00 1.000 BIT_MASK 0x8 FORMAT "%5.3" ECU_ADDRESS 0x60034AC9 /end MEASUREMENT
/begin MEASUREMENT DFC_b.TST_Com432hCounter "" UBYTE DFC_OneToOne 1 100 0.00 1.000 BIT_MASK 0x8 FORMAT "%5.3" ECU_ADDRESS 0x60034ACA /end MEASUREMENT
/begin MEASUREMENT DFC_b.TST_Com432hTooShort "" UBYTE DFC_OneToOne 1 100 0.00 1.000 BIT_MASK 0x8 FORMAT "%5.3" ECU_ADDRESS 0x60034ACB /end MEASUREMENT
/begin MEASUREMENT DFC_b.TST_Com435hAbsent "" UBYTE DFC_OneToOne 1 100 0.00 1.000 BIT_MASK 0x8 FORMAT "%5.3" ECU_ADDRESS 0x60034ACC /end MEASUREMENT
/begin MEASUREMENT DFC_b.TST_Com435hTooShort "" UBYTE DFC_OneToOne 1 100 0.00 1.000 BIT_MASK 0x8 FORMAT "%5.3" ECU_ADDRESS 0x60034ACD /end MEASUREMENT
/begin MEASUREMENT DFC_b.TST_Com442hAbsent "" UBYTE DFC_OneToOne 1 100 0.00 1.000 BIT_MASK 0x8 FORMAT "%5.3" ECU_ADDRESS 0x60034ACE /end MEASUREMENT
/begin MEASUREMENT DFC_b.TST_Com442hTooShort "" UBYTE DFC_OneToOne 1 100 0.00 1.000 BIT_MASK 0x8 FORMAT "%5.3" ECU_ADDRESS 0x60034ACF /end MEASUREMENT
/begin MEASUREMENT DFC_b.TST_Com453hAbsent "" UBYTE DFC_OneToOne 1 100 0.00 1.000 BIT_MASK 0x8 FORMAT "%5.3" ECU_ADDRESS 0x60034AD0 /end MEASUREMENT
/begin MEASUREMENT DFC_b.TST_Com453hTooShort "" UBYTE DFC_OneToOne 1 100 0.00 1.000 BIT_MASK 0x8 FORMAT "%5.3" ECU_ADDRESS 0x60034AD1 /end MEASUREMENT
/begin MEASUREMENT DFC_b.TST_Com455hAbsent "" UBYTE DFC_OneToOne 1 100 0.00 1.000 BIT_MASK 0x8 FORMAT "%5.3" ECU_ADDRESS 0x60034AD2 /end MEASUREMENT
/begin MEASUREMENT DFC_b.TST_Com455hTooShort "" UBYTE DFC_OneToOne 1 100 0.00 1.000 BIT_MASK 0x8 FORMAT "%5.3" ECU_ADDRESS 0x60034AD3 /end MEASUREMENT
/begin MEASUREMENT DFC_b.TST_Com463hAbsent "" UBYTE DFC_OneToOne 1 100 0.00 1.000 BIT_MASK 0x8 FORMAT "%5.3" ECU_ADDRESS 0x60034AD4 /end MEASUREMENT
/begin MEASUREMENT DFC_b.TST_Com463hTooShort "" UBYTE DFC_OneToOne 1 100 0.00 1.000 BIT_MASK 0x8 FORMAT "%5.3" ECU_ADDRESS 0x60034AD5 /end MEASUREMENT
/begin MEASUREMENT DFC_b.TST_Com473hAbsent "" UBYTE DFC_OneToOne 1 100 0.00 1.000 BIT_MASK 0x8 FORMAT "%5.3" ECU_ADDRESS 0x60034AD6 /end MEASUREMENT
/begin MEASUREMENT DFC_b.TST_Com473hTooShort "" UBYTE DFC_OneToOne 1 100 0.00 1.000 BIT_MASK 0x8 FORMAT "%5.3" ECU_ADDRESS 0x60034AD7 /end MEASUREMENT
/begin MEASUREMENT DFC_b.TST_Com47BhAbsent "" UBYTE DFC_OneToOne 1 100 0.00 1.000 BIT_MASK 0x8 FORMAT "%5.3" ECU_ADDRESS 0x60034AD8 /end MEASUREMENT
/begin MEASUREMENT DFC_b.TST_Com47BhTooShort "" UBYTE DFC_OneToOne 1 100 0.00 1.000 BIT_MASK 0x8 FORMAT "%5.3" ECU_ADDRESS 0x60034AD9 /end MEASUREMENT
/begin MEASUREMENT DFC_b.TST_Com48BhAbsent "" UBYTE DFC_OneToOne 1 100 0.00 1.000 BIT_MASK 0x8 FORMAT "%5.3" ECU_ADDRESS 0x60034ADA /end MEASUREMENT
/begin MEASUREMENT DFC_b.TST_Com48BhTooShort "" UBYTE DFC_OneToOne 1 100 0.00 1.000 BIT_MASK 0x8 FORMAT "%5.3" ECU_ADDRESS 0x60034ADB /end MEASUREMENT
/begin MEASUREMENT DFC_b.TST_Com497hTooShort "" UBYTE DFC_OneToOne 1 100 0.00 1.000 BIT_MASK 0x8 FORMAT "%5.3" ECU_ADDRESS 0x60034ADC /end MEASUREMENT
/begin MEASUREMENT DFC_b.TST_Com4F2hAbsent "" UBYTE DFC_OneToOne 1 100 0.00 1.000 BIT_MASK 0x8 FORMAT "%5.3" ECU_ADDRESS 0x60034ADD /end MEASUREMENT
/begin MEASUREMENT DFC_b.TST_Com4F2hChecksum "" UBYTE DFC_OneToOne 1 100 0.00 1.000 BIT_MASK 0x8 FORMAT "%5.3" ECU_ADDRESS 0x60034ADE /end MEASUREMENT
/begin MEASUREMENT DFC_b.TST_Com4F2hCounter "" UBYTE DFC_OneToOne 1 100 0.00 1.000 BIT_MASK 0x8 FORMAT "%5.3" ECU_ADDRESS 0x60034ADF /end MEASUREMENT
/begin MEASUREMENT DFC_b.TST_Com4F2hTooShort "" UBYTE DFC_OneToOne 1 100 0.00 1.000 BIT_MASK 0x8 FORMAT "%5.3" ECU_ADDRESS 0x60034AE0 /end MEASUREMENT
/begin MEASUREMENT DFC_b.TST_Com50DhAbsent "" UBYTE DFC_OneToOne 1 100 0.00 1.000 BIT_MASK 0x8 FORMAT "%5.3" ECU_ADDRESS 0x60034AE1 /end MEASUREMENT
/begin MEASUREMENT DFC_b.TST_Com50DhTooShort "" UBYTE DFC_OneToOne 1 100 0.00 1.000 BIT_MASK 0x8 FORMAT "%5.3" ECU_ADDRESS 0x60034AE2 /end MEASUREMENT
/begin MEASUREMENT DFC_b.TST_Com535hAbsent "" UBYTE DFC_OneToOne 1 100 0.00 1.000 BIT_MASK 0x8 FORMAT "%5.3" ECU_ADDRESS 0x60034AE3 /end MEASUREMENT
/begin MEASUREMENT DFC_b.TST_Com535hTooShort "" UBYTE DFC_OneToOne 1 100 0.00 1.000 BIT_MASK 0x8 FORMAT "%5.3" ECU_ADDRESS 0x60034AE4 /end MEASUREMENT
/begin MEASUREMENT DFC_b.TST_Com543hAbsent "" UBYTE DFC_OneToOne 1 100 0.00 1.000 BIT_MASK 0x8 FORMAT "%5.3" ECU_ADDRESS 0x60034AE5 /end MEASUREMENT
/begin MEASUREMENT DFC_b.TST_Com543hTooShort "" UBYTE DFC_OneToOne 1 100 0.00 1.000 BIT_MASK 0x8 FORMAT "%5.3" ECU_ADDRESS 0x60034AE6 /end MEASUREMENT
/begin MEASUREMENT DFC_b.TST_Com552hAbsent "" UBYTE DFC_OneToOne 1 100 0.00 1.000 BIT_MASK 0x8 FORMAT "%5.3" ECU_ADDRESS 0x60034AE7 /end MEASUREMENT
/begin MEASUREMENT DFC_b.TST_Com552hTooShort "" UBYTE DFC_OneToOne 1 100 0.00 1.000 BIT_MASK 0x8 FORMAT "%5.3" ECU_ADDRESS 0x60034AE8 /end MEASUREMENT
/begin MEASUREMENT DFC_b.TST_Com583hAbsent "" UBYTE DFC_OneToOne 1 100 0.00 1.000 BIT_MASK 0x8 FORMAT "%5.3" ECU_ADDRESS 0x60034AE9 /end MEASUREMENT
/begin MEASUREMENT DFC_b.TST_Com583hTooShort "" UBYTE DFC_OneToOne 1 100 0.00 1.000 BIT_MASK 0x8 FORMAT "%5.3" ECU_ADDRESS 0x60034AEA /end MEASUREMENT
/begin MEASUREMENT DFC_b.TST_Com592hAbsent "" UBYTE DFC_OneToOne 1 100 0.00 1.000 BIT_MASK 0x8 FORMAT "%5.3" ECU_ADDRESS 0x60034AEB /end MEASUREMENT
/begin MEASUREMENT DFC_b.TST_Com592hChecksum "" UBYTE DFC_OneToOne 1 100 0.00 1.000 BIT_MASK 0x8 FORMAT "%5.3" ECU_ADDRESS 0x60034AEC /end MEASUREMENT
/begin MEASUREMENT DFC_b.TST_Com592hCounter "" UBYTE DFC_OneToOne 1 100 0.00 1.000 BIT_MASK 0x8 FORMAT "%5.3" ECU_ADDRESS 0x60034AED /end MEASUREMENT
/begin MEASUREMENT DFC_b.TST_Com592hTooShort "" UBYTE DFC_OneToOne 1 100 0.00 1.000 BIT_MASK 0x8 FORMAT "%5.3" ECU_ADDRESS 0x60034AEE /end MEASUREMENT
/begin MEASUREMENT DFC_b.TST_Com595hAbsent "" UBYTE DFC_OneToOne 1 100 0.00 1.000 BIT_MASK 0x8 FORMAT "%5.3" ECU_ADDRESS 0x60034AEF /end MEASUREMENT
/begin MEASUREMENT DFC_b.TST_Com595hChecksum "" UBYTE DFC_OneToOne 1 100 0.00 1.000 BIT_MASK 0x8 FORMAT "%5.3" ECU_ADDRESS 0x60034AF0 /end MEASUREMENT
/begin MEASUREMENT DFC_b.TST_Com595hCounter "" UBYTE DFC_OneToOne 1 100 0.00 1.000 BIT_MASK 0x8 FORMAT "%5.3" ECU_ADDRESS 0x60034AF1 /end MEASUREMENT
/begin MEASUREMENT DFC_b.TST_Com595hTooShort "" UBYTE DFC_OneToOne 1 100 0.00 1.000 BIT_MASK 0x8 FORMAT "%5.3" ECU_ADDRESS 0x60034AF2 /end MEASUREMENT
/begin MEASUREMENT DFC_b.TST_Com5B2hAbsent "" UBYTE DFC_OneToOne 1 100 0.00 1.000 BIT_MASK 0x8 FORMAT "%5.3" ECU_ADDRESS 0x60034AF3 /end MEASUREMENT
/begin MEASUREMENT DFC_b.TST_Com5B2hTooShort "" UBYTE DFC_OneToOne 1 100 0.00 1.000 BIT_MASK 0x8 FORMAT "%5.3" ECU_ADDRESS 0x60034AF4 /end MEASUREMENT
/begin MEASUREMENT DFC_b.TST_Com5B5hAbsent "" UBYTE DFC_OneToOne 1 100 0.00 1.000 BIT_MASK 0x8 FORMAT "%5.3" ECU_ADDRESS 0x60034AF5 /end MEASUREMENT
/begin MEASUREMENT DFC_b.TST_Com5B5hChecksum "" UBYTE DFC_OneToOne 1 100 0.00 1.000 BIT_MASK 0x8 FORMAT "%5.3" ECU_ADDRESS 0x60034AF6 /end MEASUREMENT
/begin MEASUREMENT DFC_b.TST_Com5B5hCounter "" UBYTE DFC_OneToOne 1 100 0.00 1.000 BIT_MASK 0x8 FORMAT "%5.3" ECU_ADDRESS 0x60034AF7 /end MEASUREMENT
/begin MEASUREMENT DFC_b.TST_Com5B5hTooShort "" UBYTE DFC_OneToOne 1 100 0.00 1.000 BIT_MASK 0x8 FORMAT "%5.3" ECU_ADDRESS 0x60034AF8 /end MEASUREMENT
/begin MEASUREMENT DFC_b.TST_Com5C7hTooShort "" UBYTE DFC_OneToOne 1 100 0.00 1.000 BIT_MASK 0x8 FORMAT "%5.3" ECU_ADDRESS 0x60034AF9 /end MEASUREMENT
/begin MEASUREMENT DFC_b.TST_Com5E7hAbsent "" UBYTE DFC_OneToOne 1 100 0.00 1.000 BIT_MASK 0x8 FORMAT "%5.3" ECU_ADDRESS 0x60034AFA /end MEASUREMENT
/begin MEASUREMENT DFC_b.TST_Com5E7hTooShort "" UBYTE DFC_OneToOne 1 100 0.00 1.000 BIT_MASK 0x8 FORMAT "%5.3" ECU_ADDRESS 0x60034AFB /end MEASUREMENT
/begin MEASUREMENT DFC_b.TST_Com635hTooShort "" UBYTE DFC_OneToOne 1 100 0.00 1.000 BIT_MASK 0x8 FORMAT "%5.3" ECU_ADDRESS 0x60034AFC /end MEASUREMENT
/begin MEASUREMENT DFC_b.TST_Com645hTooShort "" UBYTE DFC_OneToOne 1 100 0.00 1.000 BIT_MASK 0x8 FORMAT "%5.3" ECU_ADDRESS 0x60034AFD /end MEASUREMENT
/begin MEASUREMENT DFC_b.TST_Com663hAbsent "" UBYTE DFC_OneToOne 1 100 0.00 1.000 BIT_MASK 0x8 FORMAT "%5.3" ECU_ADDRESS 0x60034AFE /end MEASUREMENT
/begin MEASUREMENT DFC_b.TST_Com663hTooShort "" UBYTE DFC_OneToOne 1 100 0.00 1.000 BIT_MASK 0x8 FORMAT "%5.3" ECU_ADDRESS 0x60034AFF /end MEASUREMENT
/begin MEASUREMENT DFC_b.TST_Com665hAbsent "" UBYTE DFC_OneToOne 1 100 0.00 1.000 BIT_MASK 0x8 FORMAT "%5.3" ECU_ADDRESS 0x60034B00 /end MEASUREMENT
/begin MEASUREMENT DFC_b.TST_Com665hTooShort "" UBYTE DFC_OneToOne 1 100 0.00 1.000 BIT_MASK 0x8 FORMAT "%5.3" ECU_ADDRESS 0x60034B01 /end MEASUREMENT
/begin MEASUREMENT DFC_b.TST_Com675hAbsent "" UBYTE DFC_OneToOne 1 100 0.00 1.000 BIT_MASK 0x8 FORMAT "%5.3" ECU_ADDRESS 0x60034B02 /end MEASUREMENT
/begin MEASUREMENT DFC_b.TST_Com675hTooShort "" UBYTE DFC_OneToOne 1 100 0.00 1.000 BIT_MASK 0x8 FORMAT "%5.3" ECU_ADDRESS 0x60034B03 /end MEASUREMENT
/begin MEASUREMENT DFC_b.TST_ComFrbd_205h_HVBAT_PACK_CURRENT "" UBYTE DFC_OneToOne 1 100 0.00 1.000 BIT_MASK 0x8 FORMAT "%5.3" ECU_ADDRESS 0x60034B04 /end MEASUREMENT
/begin MEASUREMENT DFC_b.TST_ComFrbd_205h_HVBAT_SOC_DISPLAY "" UBYTE DFC_OneToOne 1 100 0.00 1.000 BIT_MASK 0x8 FORMAT "%5.3" ECU_ADDRESS 0x60034B05 /end MEASUREMENT
/begin MEASUREMENT DFC_b.TST_ComFrbd_205h_HVBAT_VOLTAGE "" UBYTE DFC_OneToOne 1 100 0.00 1.000 BIT_MASK 0x8 FORMAT "%5.3" ECU_ADDRESS 0x60034B06 /end MEASUREMENT
/begin MEASUREMENT DFC_b.TST_ComFrbd_217h_INV_DC_BUS_VOLTAGE "" UBYTE DFC_OneToOne 1 100 0.00 1.000 BIT_MASK 0x8 FORMAT "%5.3" ECU_ADDRESS 0x60034B07 /end MEASUREMENT
/begin MEASUREMENT DFC_b.TST_ComFrbd_217h_INV_MTR_ACTUAL_TRQ "" UBYTE DFC_OneToOne 1 100 0.00 1.000 BIT_MASK 0x8 FORMAT "%5.3" ECU_ADDRESS 0x60034B08 /end MEASUREMENT
/begin MEASUREMENT DFC_b.TST_ComFrbd_217h_INV_MTR_SPEED "" UBYTE DFC_OneToOne 1 100 0.00 1.000 BIT_MASK 0x8 FORMAT "%5.3" ECU_ADDRESS 0x60034B09 /end MEASUREMENT
/begin MEASUREMENT DFC_b.TST_ComFrbd_217h_INV_MTR_TRQ "" UBYTE DFC_OneToOne 1 100 0.00 1.000 BIT_MASK 0x8 FORMAT "%5.3" ECU_ADDRESS 0x60034B0A /end MEASUREMENT
/begin MEASUREMENT DFC_b.TST_ComFrbd_227h_INV_DC_CURRENT "" UBYTE DFC_OneToOne 1 100 0.00 1.000 BIT_MASK 0x8 FORMAT "%5.3" ECU_ADDRESS 0x60034B0B /end MEASUREMENT
/begin MEASUREMENT DFC_b.TST_ComFrbd_227h_INV_MOTORING_PEAK_TRQ "" UBYTE DFC_OneToOne 1 100 0.00 1.000 BIT_MASK 0x8 FORMAT "%5.3" ECU_ADDRESS 0x60034B0C /end MEASUREMENT
/begin MEASUREMENT DFC_b.TST_ComFrbd_227h_INV_MTR_INST_INPUT_POWER "" UBYTE DFC_OneToOne 1 100 0.00 1.000 BIT_MASK 0x8 FORMAT "%5.3" ECU_ADDRESS 0x60034B0D /end MEASUREMENT
/begin MEASUREMENT DFC_b.TST_ComFrbd_227h_INV_REGEN_PEAK_TRQ "" UBYTE DFC_OneToOne 1 100 0.00 1.000 BIT_MASK 0x8 FORMAT "%5.3" ECU_ADDRESS 0x60034B0E /end MEASUREMENT
/begin MEASUREMENT DFC_b.TST_ComFrbd_237h_INV_ACTIVE_DISCHARGE_STATUS "" UBYTE DFC_OneToOne 1 100 0.00 1.000 BIT_MASK 0x8 FORMAT "%5.3" ECU_ADDRESS 0x60034B0F /end MEASUREMENT
/begin MEASUREMENT DFC_b.TST_ComFrbd_237h_INV_CTRL_MODE_ACK "" UBYTE DFC_OneToOne 1 100 0.00 1.000 BIT_MASK 0x8 FORMAT "%5.3" ECU_ADDRESS 0x60034B10 /end MEASUREMENT
/begin MEASUREMENT DFC_b.TST_ComFrbd_237h_INV_EV_WARNING "" UBYTE DFC_OneToOne 1 100 0.00 1.000 BIT_MASK 0x8 FORMAT "%5.3" ECU_ADDRESS 0x60034B11 /end MEASUREMENT
/begin MEASUREMENT DFC_b.TST_ComFrbd_237h_INV_FAULT_LEVEL "" UBYTE DFC_OneToOne 1 100 0.00 1.000 BIT_MASK 0x8 FORMAT "%5.3" ECU_ADDRESS 0x60034B12 /end MEASUREMENT
/begin MEASUREMENT DFC_b.TST_ComFrbd_237h_INV_MASTER_STOP "" UBYTE DFC_OneToOne 1 100 0.00 1.000 BIT_MASK 0x8 FORMAT "%5.3" ECU_ADDRESS 0x60034B13 /end MEASUREMENT
/begin MEASUREMENT DFC_b.TST_ComFrbd_237h_INV_SERVICE_DUE "" UBYTE DFC_OneToOne 1 100 0.00 1.000 BIT_MASK 0x8 FORMAT "%5.3" ECU_ADDRESS 0x60034B14 /end MEASUREMENT
/begin MEASUREMENT DFC_b.TST_ComFrbd_237h_INV_STAB_MIN_TRQ "" UBYTE DFC_OneToOne 1 100 0.00 1.000 BIT_MASK 0x8 FORMAT "%5.3" ECU_ADDRESS 0x60034B15 /end MEASUREMENT
/begin MEASUREMENT DFC_b.TST_ComFrbd_259h_TGLM_FAILURE_STATE "" UBYTE DFC_OneToOne 1 100 0.00 1.000 BIT_MASK 0x8 FORMAT "%5.3" ECU_ADDRESS 0x60034B16 /end MEASUREMENT
/begin MEASUREMENT DFC_b.TST_ComFrbd_259h_TGLM_MODE_PUSH "" UBYTE DFC_OneToOne 1 100 0.00 1.000 BIT_MASK 0x8 FORMAT "%5.3" ECU_ADDRESS 0x60034B17 /end MEASUREMENT
/begin MEASUREMENT DFC_b.TST_ComFrbd_259h_TOGGLE_MONOSTABLE_POS "" UBYTE DFC_OneToOne 1 100 0.00 1.000 BIT_MASK 0x8 FORMAT "%5.3" ECU_ADDRESS 0x60034B18 /end MEASUREMENT
/begin MEASUREMENT DFC_b.TST_ComFrbd_273h_OBC_outputpower_capability "" UBYTE DFC_OneToOne 1 100 0.00 1.000 BIT_MASK 0x8 FORMAT "%5.3" ECU_ADDRESS 0x60034B19 /end MEASUREMENT
/begin MEASUREMENT DFC_b.TST_ComFrbd_275h_HVBAT_DISCHARGE_30S_AVAILABLE_CURRENT "" UBYTE DFC_OneToOne 1 100 0.00 1.000 BIT_MASK 0x8 FORMAT "%5.3" ECU_ADDRESS 0x60034B1A /end MEASUREMENT
/begin MEASUREMENT DFC_b.TST_ComFrbd_275h_HVBAT_DISCHARGE_30S_AVAILABLE_POWER "" UBYTE DFC_OneToOne 1 100 0.00 1.000 BIT_MASK 0x8 FORMAT "%5.3" ECU_ADDRESS 0x60034B1B /end MEASUREMENT
/begin MEASUREMENT DFC_b.TST_ComFrbd_283h_DCDC_IN_CURRENT "" UBYTE DFC_OneToOne 1 100 0.00 1.000 BIT_MASK 0x8 FORMAT "%5.3" ECU_ADDRESS 0x60034B1C /end MEASUREMENT
/begin MEASUREMENT DFC_b.TST_ComFrbd_283h_DCDC_IN_VOLTAGE "" UBYTE DFC_OneToOne 1 100 0.00 1.000 BIT_MASK 0x8 FORMAT "%5.3" ECU_ADDRESS 0x60034B1D /end MEASUREMENT
/begin MEASUREMENT DFC_b.TST_ComFrbd_283h_DCDC_OUT_CURRENT "" UBYTE DFC_OneToOne 1 100 0.00 1.000 BIT_MASK 0x8 FORMAT "%5.3" ECU_ADDRESS 0x60034B1E /end MEASUREMENT
/begin MEASUREMENT DFC_b.TST_ComFrbd_283h_DCDC_OUT_VOLTAGE "" UBYTE DFC_OneToOne 1 100 0.00 1.000 BIT_MASK 0x8 FORMAT "%5.3" ECU_ADDRESS 0x60034B1F /end MEASUREMENT
/begin MEASUREMENT DFC_b.TST_ComFrbd_285h_HVBAT_REGEN_CHG_30S_CURRENT_LIMIT "" UBYTE DFC_OneToOne 1 100 0.00 1.000 BIT_MASK 0x8 FORMAT "%5.3" ECU_ADDRESS 0x60034B20 /end MEASUREMENT
/begin MEASUREMENT DFC_b.TST_ComFrbd_285h_HVBAT_REGEN_CHRG_30S_POWER_LIMIT "" UBYTE DFC_OneToOne 1 100 0.00 1.000 BIT_MASK 0x8 FORMAT "%5.3" ECU_ADDRESS 0x60034B21 /end MEASUREMENT
/begin MEASUREMENT DFC_b.TST_ComFrbd_293h_DCDC_outputpower_capability "" UBYTE DFC_OneToOne 1 100 0.00 1.000 BIT_MASK 0x8 FORMAT "%5.3" ECU_ADDRESS 0x60034B22 /end MEASUREMENT
/begin MEASUREMENT DFC_b.TST_ComFrbd_325h_HVBAT_INSULATION_RESISTANCE "" UBYTE DFC_OneToOne 1 100 0.00 1.000 BIT_MASK 0x8 FORMAT "%5.3" ECU_ADDRESS 0x60034B23 /end MEASUREMENT
/begin MEASUREMENT DFC_b.TST_ComFrbd_325h_HVBAT_TEMPERATURE "" UBYTE DFC_OneToOne 1 100 0.00 1.000 BIT_MASK 0x8 FORMAT "%5.3" ECU_ADDRESS 0x60034B24 /end MEASUREMENT
/begin MEASUREMENT DFC_b.TST_ComFrbd_335h_HVBAT_CHRG_CONTINUOUS_CURR_MAX "" UBYTE DFC_OneToOne 1 100 0.00 1.000 BIT_MASK 0x8 FORMAT "%5.3" ECU_ADDRESS 0x60034B25 /end MEASUREMENT
/begin MEASUREMENT DFC_b.TST_ComFrbd_335h_HVBAT_CHRG_COTINUOUS_CURR_REQ "" UBYTE DFC_OneToOne 1 100 0.00 1.000 BIT_MASK 0x8 FORMAT "%5.3" ECU_ADDRESS 0x60034B26 /end MEASUREMENT
/begin MEASUREMENT DFC_b.TST_ComFrbd_335h_HVBAT_CHRG_MAX_VOLT "" UBYTE DFC_OneToOne 1 100 0.00 1.000 BIT_MASK 0x8 FORMAT "%5.3" ECU_ADDRESS 0x60034B27 /end MEASUREMENT
/begin MEASUREMENT DFC_b.TST_ComFrbd_335h_HVBAT_DC_BUS_VOLTAGE "" UBYTE DFC_OneToOne 1 100 0.00 1.000 BIT_MASK 0x8 FORMAT "%5.3" ECU_ADDRESS 0x60034B28 /end MEASUREMENT
/begin MEASUREMENT DFC_b.TST_ComFrbd_427h_INV_OP_MODE "" UBYTE DFC_OneToOne 1 100 0.00 1.000 BIT_MASK 0x8 FORMAT "%5.3" ECU_ADDRESS 0x60034B29 /end MEASUREMENT
/begin MEASUREMENT DFC_b.TST_ComFrbd_427h_INV_PERMISIBLE_TORQUE "" UBYTE DFC_OneToOne 1 100 0.00 1.000 BIT_MASK 0x8 FORMAT "%5.3" ECU_ADDRESS 0x60034B2A /end MEASUREMENT
/begin MEASUREMENT DFC_b.TST_ComFrbd_435h_HVBAT_MAX_CELL_VOLT "" UBYTE DFC_OneToOne 1 100 0.00 1.000 BIT_MASK 0x8 FORMAT "%5.3" ECU_ADDRESS 0x60034B2B /end MEASUREMENT
/begin MEASUREMENT DFC_b.TST_ComFrbd_435h_HVBAT_MAX_CELL_VOLT_NUM "" UBYTE DFC_OneToOne 1 100 0.00 1.000 BIT_MASK 0x8 FORMAT "%5.3" ECU_ADDRESS 0x60034B2C /end MEASUREMENT
/begin MEASUREMENT DFC_b.TST_ComFrbd_435h_HVBAT_MAX_SENSOR_TEMP "" UBYTE DFC_OneToOne 1 100 0.00 1.000 BIT_MASK 0x8 FORMAT "%5.3" ECU_ADDRESS 0x60034B2D /end MEASUREMENT
/begin MEASUREMENT DFC_b.TST_ComFrbd_435h_HVBAT_MIN_CELL_VOLT "" UBYTE DFC_OneToOne 1 100 0.00 1.000 BIT_MASK 0x8 FORMAT "%5.3" ECU_ADDRESS 0x60034B2E /end MEASUREMENT
/begin MEASUREMENT DFC_b.TST_ComFrbd_435h_HVBAT_MIN_CELL_VOLT_NUM "" UBYTE DFC_OneToOne 1 100 0.00 1.000 BIT_MASK 0x8 FORMAT "%5.3" ECU_ADDRESS 0x60034B2F /end MEASUREMENT
/begin MEASUREMENT DFC_b.TST_ComFrbd_453h_OBC_IN_CURRENT "" UBYTE DFC_OneToOne 1 100 0.00 1.000 BIT_MASK 0x8 FORMAT "%5.3" ECU_ADDRESS 0x60034B30 /end MEASUREMENT
/begin MEASUREMENT DFC_b.TST_ComFrbd_453h_OBC_IN_VOLTAGE "" UBYTE DFC_OneToOne 1 100 0.00 1.000 BIT_MASK 0x8 FORMAT "%5.3" ECU_ADDRESS 0x60034B31 /end MEASUREMENT
/begin MEASUREMENT DFC_b.TST_ComFrbd_453h_OBC_IP_POWER "" UBYTE DFC_OneToOne 1 100 0.00 1.000 BIT_MASK 0x8 FORMAT "%5.3" ECU_ADDRESS 0x60034B32 /end MEASUREMENT
/begin MEASUREMENT DFC_b.TST_ComFrbd_455h_HVBAT_NOMINAL_VOLTAGE "" UBYTE DFC_OneToOne 1 100 0.00 1.000 BIT_MASK 0x8 FORMAT "%5.3" ECU_ADDRESS 0x60034B33 /end MEASUREMENT
/begin MEASUREMENT DFC_b.TST_ComFrbd_463h_OBC_OUT_CURRENT "" UBYTE DFC_OneToOne 1 100 0.00 1.000 BIT_MASK 0x8 FORMAT "%5.3" ECU_ADDRESS 0x60034B34 /end MEASUREMENT
/begin MEASUREMENT DFC_b.TST_ComFrbd_463h_OBC_OUT_VOLTAGE "" UBYTE DFC_OneToOne 1 100 0.00 1.000 BIT_MASK 0x8 FORMAT "%5.3" ECU_ADDRESS 0x60034B35 /end MEASUREMENT
/begin MEASUREMENT DFC_b.TST_ComFrbd_463h_OBC_TEMPERATURE "" UBYTE DFC_OneToOne 1 100 0.00 1.000 BIT_MASK 0x8 FORMAT "%5.3" ECU_ADDRESS 0x60034B36 /end MEASUREMENT
/begin MEASUREMENT DFC_b.TST_ComFrbd_473h_DCDC_Coolant_Temperature "" UBYTE DFC_OneToOne 1 100 0.00 1.000 BIT_MASK 0x8 FORMAT "%5.3" ECU_ADDRESS 0x60034B37 /end MEASUREMENT
/begin MEASUREMENT DFC_b.TST_ComFrbd_473h_DCDC_TEMPERATURE "" UBYTE DFC_OneToOne 1 100 0.00 1.000 BIT_MASK 0x8 FORMAT "%5.3" ECU_ADDRESS 0x60034B38 /end MEASUREMENT
/begin MEASUREMENT DFC_b.TST_ComFrbd_47Bh_eCOMP_BusBarCurrent "" UBYTE DFC_OneToOne 1 100 0.00 1.000 BIT_MASK 0x8 FORMAT "%5.3" ECU_ADDRESS 0x60034B39 /end MEASUREMENT
/begin MEASUREMENT DFC_b.TST_ComFrbd_47Bh_eCOMP_BusBarVoltage "" UBYTE DFC_OneToOne 1 100 0.00 1.000 BIT_MASK 0x8 FORMAT "%5.3" ECU_ADDRESS 0x60034B3A /end MEASUREMENT
/begin MEASUREMENT DFC_b.TST_ComFrbd_47Bh_eCOMP_CompressorSpeed "" UBYTE DFC_OneToOne 1 100 0.00 1.000 BIT_MASK 0x8 FORMAT "%5.3" ECU_ADDRESS 0x60034B3B /end MEASUREMENT
/begin MEASUREMENT DFC_b.TST_ComFrbd_47Bh_eCOMP_IGBT_Temp "" UBYTE DFC_OneToOne 1 100 0.00 1.000 BIT_MASK 0x8 FORMAT "%5.3" ECU_ADDRESS 0x60034B3C /end MEASUREMENT
/begin MEASUREMENT DFC_b.TST_ComFrbd_47Bh_eCOMP_PeakPhaCurrent "" UBYTE DFC_OneToOne 1 100 0.00 1.000 BIT_MASK 0x8 FORMAT "%5.3" ECU_ADDRESS 0x60034B3D /end MEASUREMENT
/begin MEASUREMENT DFC_b.TST_ComFrbd_47Bh_eCOMP_Power_consumption "" UBYTE DFC_OneToOne 1 100 0.00 1.000 BIT_MASK 0x8 FORMAT "%5.3" ECU_ADDRESS 0x60034B3E /end MEASUREMENT
/begin MEASUREMENT DFC_b.TST_ComFrbd_48Bh_eCOMP_Fault_Level "" UBYTE DFC_OneToOne 1 100 0.00 1.000 BIT_MASK 0x8 FORMAT "%5.3" ECU_ADDRESS 0x60034B3F /end MEASUREMENT
/begin MEASUREMENT DFC_b.TST_ComFrbd_4F2h_VALEUR_SOC_ETENDUE "" UBYTE DFC_OneToOne 1 100 0.00 1.000 BIT_MASK 0x8 FORMAT "%5.3" ECU_ADDRESS 0x60034B40 /end MEASUREMENT
/begin MEASUREMENT DFC_b.TST_ComFrbd_535h_HV_BATT_TEMP_AVG "" UBYTE DFC_OneToOne 1 100 0.00 1.000 BIT_MASK 0x8 FORMAT "%5.3" ECU_ADDRESS 0x60034B41 /end MEASUREMENT
/begin MEASUREMENT DFC_b.TST_ComFrbd_543h_HVBAT_RESTBATTENERGY "" UBYTE DFC_OneToOne 1 100 0.00 1.000 BIT_MASK 0x8 FORMAT "%5.3" ECU_ADDRESS 0x60034B42 /end MEASUREMENT
/begin MEASUREMENT DFC_b.TST_ComFrbd_543h_HVBAT_SOH "" UBYTE DFC_OneToOne 1 100 0.00 1.000 BIT_MASK 0x8 FORMAT "%5.3" ECU_ADDRESS 0x60034B43 /end MEASUREMENT
/begin MEASUREMENT DFC_b.TST_ComFrbd_543h_HV_BATT_SOH_RES "" UBYTE DFC_OneToOne 1 100 0.00 1.000 BIT_MASK 0x8 FORMAT "%5.3" ECU_ADDRESS 0x60034B44 /end MEASUREMENT
/begin MEASUREMENT DFC_b.TST_ComFrbd_592h_IBATT_1 "" UBYTE DFC_OneToOne 1 100 0.00 1.000 BIT_MASK 0x8 FORMAT "%5.3" ECU_ADDRESS 0x60034B45 /end MEASUREMENT
/begin MEASUREMENT DFC_b.TST_ComFrbd_592h_IBATT_2 "" UBYTE DFC_OneToOne 1 100 0.00 1.000 BIT_MASK 0x8 FORMAT "%5.3" ECU_ADDRESS 0x60034B46 /end MEASUREMENT
/begin MEASUREMENT DFC_b.TST_ComFrbd_592h_IBATT_3 "" UBYTE DFC_OneToOne 1 100 0.00 1.000 BIT_MASK 0x8 FORMAT "%5.3" ECU_ADDRESS 0x60034B47 /end MEASUREMENT
/begin MEASUREMENT DFC_b.TST_ComFrbd_592h_TEMP_BATT "" UBYTE DFC_OneToOne 1 100 0.00 1.000 BIT_MASK 0x8 FORMAT "%5.3" ECU_ADDRESS 0x60034B48 /end MEASUREMENT
/begin MEASUREMENT DFC_b.TST_ComFrbd_592h_U_BATT_BECB "" UBYTE DFC_OneToOne 1 100 0.00 1.000 BIT_MASK 0x8 FORMAT "%5.3" ECU_ADDRESS 0x60034B49 /end MEASUREMENT
/begin MEASUREMENT DFC_b.TST_ComFrbd_595h_HVBAT_TIME_TO_CHRG_80 "" UBYTE DFC_OneToOne 1 100 0.00 1.000 BIT_MASK 0x8 FORMAT "%5.3" ECU_ADDRESS 0x60034B4A /end MEASUREMENT
/begin MEASUREMENT DFC_b.TST_ComFrbd_5B2h_TEMP_AIR_EXT "" UBYTE DFC_OneToOne 1 100 0.00 1.000 BIT_MASK 0x8 FORMAT "%5.3" ECU_ADDRESS 0x60034B4B /end MEASUREMENT
/begin MEASUREMENT DFC_b.TST_ComFrbd_635h_HVBAT_NEG_CONT_COUNT_SEG1 "" UBYTE DFC_OneToOne 1 100 0.00 1.000 BIT_MASK 0x8 FORMAT "%5.3" ECU_ADDRESS 0x60034B4C /end MEASUREMENT
/begin MEASUREMENT DFC_b.TST_ComFrbd_635h_HVBAT_NEG_CONT_COUNT_SEG3 "" UBYTE DFC_OneToOne 1 100 0.00 1.000 BIT_MASK 0x8 FORMAT "%5.3" ECU_ADDRESS 0x60034B4D /end MEASUREMENT
/begin MEASUREMENT DFC_b.TST_ComFrbd_635h_HVBAT_NEG_CONT_COUNT_SEG4 "" UBYTE DFC_OneToOne 1 100 0.00 1.000 BIT_MASK 0x8 FORMAT "%5.3" ECU_ADDRESS 0x60034B4E /end MEASUREMENT
/begin MEASUREMENT DFC_b.TST_ComFrbd_635h_HVBAT_PST_CONT_COUNT_SEG1 "" UBYTE DFC_OneToOne 1 100 0.00 1.000 BIT_MASK 0x8 FORMAT "%5.3" ECU_ADDRESS 0x60034B4F /end MEASUREMENT
/begin MEASUREMENT DFC_b.TST_ComFrbd_635h_HVBAT_PST_CONT_COUNT_SEG3 "" UBYTE DFC_OneToOne 1 100 0.00 1.000 BIT_MASK 0x8 FORMAT "%5.3" ECU_ADDRESS 0x60034B50 /end MEASUREMENT
/begin MEASUREMENT DFC_b.TST_ComFrbd_635h_HVBAT_PST_CONT_COUNT_SEG4 "" UBYTE DFC_OneToOne 1 100 0.00 1.000 BIT_MASK 0x8 FORMAT "%5.3" ECU_ADDRESS 0x60034B51 /end MEASUREMENT
/begin MEASUREMENT DFC_b.TST_ComFrbd_645h_HVBAT_PRECHRGE_CONT_COUNT_SEG1 "" UBYTE DFC_OneToOne 1 100 0.00 1.000 BIT_MASK 0x8 FORMAT "%5.3" ECU_ADDRESS 0x60034B52 /end MEASUREMENT
/begin MEASUREMENT DFC_b.TST_ComFrbd_645h_HVBAT_PRECHRGE_CONT_COUNT_SEG2 "" UBYTE DFC_OneToOne 1 100 0.00 1.000 BIT_MASK 0x8 FORMAT "%5.3" ECU_ADDRESS 0x60034B53 /end MEASUREMENT
/begin MEASUREMENT DFC_b.TST_ComFrbd_675h_HVBAT_REMAININGBATTCAPACITY "" UBYTE DFC_OneToOne 1 100 0.00 1.000 BIT_MASK 0x8 FORMAT "%5.3" ECU_ADDRESS 0x60034B54 /end MEASUREMENT
/begin MEASUREMENT DFC_b.TST_ComInvld_205h_HVBAT_CHARGING_STATUS "" UBYTE DFC_OneToOne 1 100 0.00 1.000 BIT_MASK 0x8 FORMAT "%5.3" ECU_ADDRESS 0x60034B55 /end MEASUREMENT
/begin MEASUREMENT DFC_b.TST_ComInvld_205h_HVBAT_PACK_CURRENT "" UBYTE DFC_OneToOne 1 100 0.00 1.000 BIT_MASK 0x8 FORMAT "%5.3" ECU_ADDRESS 0x60034B56 /end MEASUREMENT
/begin MEASUREMENT DFC_b.TST_ComInvld_205h_HVBAT_SOC_DISPLAY "" UBYTE DFC_OneToOne 1 100 0.00 1.000 BIT_MASK 0x8 FORMAT "%5.3" ECU_ADDRESS 0x60034B57 /end MEASUREMENT
/begin MEASUREMENT DFC_b.TST_ComInvld_205h_HVBAT_VOLTAGE "" UBYTE DFC_OneToOne 1 100 0.00 1.000 BIT_MASK 0x8 FORMAT "%5.3" ECU_ADDRESS 0x60034B58 /end MEASUREMENT
/begin MEASUREMENT DFC_b.TST_ComInvld_217h_INV_DC_BUS_VOLTAGE "" UBYTE DFC_OneToOne 1 100 0.00 1.000 BIT_MASK 0x8 FORMAT "%5.3" ECU_ADDRESS 0x60034B59 /end MEASUREMENT
/begin MEASUREMENT DFC_b.TST_ComInvld_217h_INV_MTR_ACTUAL_TRQ "" UBYTE DFC_OneToOne 1 100 0.00 1.000 BIT_MASK 0x8 FORMAT "%5.3" ECU_ADDRESS 0x60034B5A /end MEASUREMENT
/begin MEASUREMENT DFC_b.TST_ComInvld_217h_INV_MTR_SPEED "" UBYTE DFC_OneToOne 1 100 0.00 1.000 BIT_MASK 0x8 FORMAT "%5.3" ECU_ADDRESS 0x60034B5B /end MEASUREMENT
/begin MEASUREMENT DFC_b.TST_ComInvld_217h_INV_MTR_TRQ "" UBYTE DFC_OneToOne 1 100 0.00 1.000 BIT_MASK 0x8 FORMAT "%5.3" ECU_ADDRESS 0x60034B5C /end MEASUREMENT
/begin MEASUREMENT DFC_b.TST_ComInvld_227h_INV_DC_CURRENT "" UBYTE DFC_OneToOne 1 100 0.00 1.000 BIT_MASK 0x8 FORMAT "%5.3" ECU_ADDRESS 0x60034B5D /end MEASUREMENT
/begin MEASUREMENT DFC_b.TST_ComInvld_227h_INV_MOTORING_PEAK_TRQ "" UBYTE DFC_OneToOne 1 100 0.00 1.000 BIT_MASK 0x8 FORMAT "%5.3" ECU_ADDRESS 0x60034B5E /end MEASUREMENT
/begin MEASUREMENT DFC_b.TST_ComInvld_227h_INV_MTR_INST_INPUT_POWER "" UBYTE DFC_OneToOne 1 100 0.00 1.000 BIT_MASK 0x8 FORMAT "%5.3" ECU_ADDRESS 0x60034B5F /end MEASUREMENT
/begin MEASUREMENT DFC_b.TST_ComInvld_227h_INV_REGEN_PEAK_TRQ "" UBYTE DFC_OneToOne 1 100 0.00 1.000 BIT_MASK 0x8 FORMAT "%5.3" ECU_ADDRESS 0x60034B60 /end MEASUREMENT
/begin MEASUREMENT DFC_b.TST_ComInvld_237h_INV_ACTIVE_DISCHARGE_STATUS "" UBYTE DFC_OneToOne 1 100 0.00 1.000 BIT_MASK 0x8 FORMAT "%5.3" ECU_ADDRESS 0x60034B61 /end MEASUREMENT
/begin MEASUREMENT DFC_b.TST_ComInvld_237h_INV_FAULT_LEVEL "" UBYTE DFC_OneToOne 1 100 0.00 1.000 BIT_MASK 0x8 FORMAT "%5.3" ECU_ADDRESS 0x60034B62 /end MEASUREMENT
/begin MEASUREMENT DFC_b.TST_ComInvld_237h_INV_STAB_MIN_TRQ "" UBYTE DFC_OneToOne 1 100 0.00 1.000 BIT_MASK 0x8 FORMAT "%5.3" ECU_ADDRESS 0x60034B63 /end MEASUREMENT
/begin MEASUREMENT DFC_b.TST_ComInvld_259h_TGLM_MODE_PUSH "" UBYTE DFC_OneToOne 1 100 0.00 1.000 BIT_MASK 0x8 FORMAT "%5.3" ECU_ADDRESS 0x60034B64 /end MEASUREMENT
/begin MEASUREMENT DFC_b.TST_ComInvld_259h_TOGGLE_MONOSTABLE_POS "" UBYTE DFC_OneToOne 1 100 0.00 1.000 BIT_MASK 0x8 FORMAT "%5.3" ECU_ADDRESS 0x60034B65 /end MEASUREMENT
/begin MEASUREMENT DFC_b.TST_ComInvld_26h_AC_SWITCH_REQ "" UBYTE DFC_OneToOne 1 100 0.00 1.000 BIT_MASK 0x8 FORMAT "%5.3" ECU_ADDRESS 0x60034B66 /end MEASUREMENT
/begin MEASUREMENT DFC_b.TST_ComInvld_26h_BLOWER_POSITION "" UBYTE DFC_OneToOne 1 100 0.00 1.000 BIT_MASK 0x8 FORMAT "%5.3" ECU_ADDRESS 0x60034B67 /end MEASUREMENT
/begin MEASUREMENT DFC_b.TST_ComInvld_26h_EVAP_SENSOR_FAULT "" UBYTE DFC_OneToOne 1 100 0.00 1.000 BIT_MASK 0x8 FORMAT "%5.3" ECU_ADDRESS 0x60034B68 /end MEASUREMENT
/begin MEASUREMENT DFC_b.TST_ComInvld_26h_EVAP_SENSOR_VALUE "" UBYTE DFC_OneToOne 1 100 0.00 1.000 BIT_MASK 0x8 FORMAT "%5.3" ECU_ADDRESS 0x60034B69 /end MEASUREMENT
/begin MEASUREMENT DFC_b.TST_ComInvld_26h_POTENTIOMETER_FAULT "" UBYTE DFC_OneToOne 1 100 0.00 1.000 BIT_MASK 0x8 FORMAT "%5.3" ECU_ADDRESS 0x60034B6A /end MEASUREMENT
/begin MEASUREMENT DFC_b.TST_ComInvld_26h_REAR_DEFOG_REQ "" UBYTE DFC_OneToOne 1 100 0.00 1.000 BIT_MASK 0x8 FORMAT "%5.3" ECU_ADDRESS 0x60034B6B /end MEASUREMENT
/begin MEASUREMENT DFC_b.TST_ComInvld_26h_TEMP_POSITION "" UBYTE DFC_OneToOne 1 100 0.00 1.000 BIT_MASK 0x8 FORMAT "%5.3" ECU_ADDRESS 0x60034B6C /end MEASUREMENT
/begin MEASUREMENT DFC_b.TST_ComInvld_273h_OBC_FAULT_LEVEL "" UBYTE DFC_OneToOne 1 100 0.00 1.000 BIT_MASK 0x8 FORMAT "%5.3" ECU_ADDRESS 0x60034B6D /end MEASUREMENT
/begin MEASUREMENT DFC_b.TST_ComInvld_273h_OBC_outputpower_capability "" UBYTE DFC_OneToOne 1 100 0.00 1.000 BIT_MASK 0x8 FORMAT "%5.3" ECU_ADDRESS 0x60034B6E /end MEASUREMENT
/begin MEASUREMENT DFC_b.TST_ComInvld_275h_HVBAT_DISCHARGE_30S_AVAILABLE_CURRENT "" UBYTE DFC_OneToOne 1 100 0.00 1.000 BIT_MASK 0x8 FORMAT "%5.3" ECU_ADDRESS 0x60034B6F /end MEASUREMENT
/begin MEASUREMENT DFC_b.TST_ComInvld_275h_HVBAT_DISCHARGE_30S_AVAILABLE_POWER "" UBYTE DFC_OneToOne 1 100 0.00 1.000 BIT_MASK 0x8 FORMAT "%5.3" ECU_ADDRESS 0x60034B70 /end MEASUREMENT
/begin MEASUREMENT DFC_b.TST_ComInvld_283h_DCDC_IN_CURRENT "" UBYTE DFC_OneToOne 1 100 0.00 1.000 BIT_MASK 0x8 FORMAT "%5.3" ECU_ADDRESS 0x60034B71 /end MEASUREMENT
/begin MEASUREMENT DFC_b.TST_ComInvld_283h_DCDC_IN_VOLTAGE "" UBYTE DFC_OneToOne 1 100 0.00 1.000 BIT_MASK 0x8 FORMAT "%5.3" ECU_ADDRESS 0x60034B72 /end MEASUREMENT
/begin MEASUREMENT DFC_b.TST_ComInvld_283h_DCDC_OUT_CURRENT "" UBYTE DFC_OneToOne 1 100 0.00 1.000 BIT_MASK 0x8 FORMAT "%5.3" ECU_ADDRESS 0x60034B73 /end MEASUREMENT
/begin MEASUREMENT DFC_b.TST_ComInvld_283h_DCDC_OUT_VOLTAGE "" UBYTE DFC_OneToOne 1 100 0.00 1.000 BIT_MASK 0x8 FORMAT "%5.3" ECU_ADDRESS 0x60034B74 /end MEASUREMENT
/begin MEASUREMENT DFC_b.TST_ComInvld_285h_HVBAT_REGEN_CHG_30S_CURRENT_LIMIT "" UBYTE DFC_OneToOne 1 100 0.00 1.000 BIT_MASK 0x8 FORMAT "%5.3" ECU_ADDRESS 0x60034B75 /end MEASUREMENT
/begin MEASUREMENT DFC_b.TST_ComInvld_285h_HVBAT_REGEN_CHRG_30S_POWER_LIMIT "" UBYTE DFC_OneToOne 1 100 0.00 1.000 BIT_MASK 0x8 FORMAT "%5.3" ECU_ADDRESS 0x60034B76 /end MEASUREMENT
/begin MEASUREMENT DFC_b.TST_ComInvld_293h_DCDC_FAULT_LEVEL "" UBYTE DFC_OneToOne 1 100 0.00 1.000 BIT_MASK 0x8 FORMAT "%5.3" ECU_ADDRESS 0x60034B77 /end MEASUREMENT
/begin MEASUREMENT DFC_b.TST_ComInvld_293h_DCDC_outputpower_capability "" UBYTE DFC_OneToOne 1 100 0.00 1.000 BIT_MASK 0x8 FORMAT "%5.3" ECU_ADDRESS 0x60034B78 /end MEASUREMENT
/begin MEASUREMENT DFC_b.TST_ComInvld_325h_HVBAT_EPLUG_STATUS "" UBYTE DFC_OneToOne 1 100 0.00 1.000 BIT_MASK 0x8 FORMAT "%5.3" ECU_ADDRESS 0x60034B79 /end MEASUREMENT
/begin MEASUREMENT DFC_b.TST_ComInvld_325h_HVBAT_HVIL_STS "" UBYTE DFC_OneToOne 1 100 0.00 1.000 BIT_MASK 0x8 FORMAT "%5.3" ECU_ADDRESS 0x60034B7A /end MEASUREMENT
/begin MEASUREMENT DFC_b.TST_ComInvld_325h_HVBAT_INSULATION_FAULT "" UBYTE DFC_OneToOne 1 100 0.00 1.000 BIT_MASK 0x8 FORMAT "%5.3" ECU_ADDRESS 0x60034B7B /end MEASUREMENT
/begin MEASUREMENT DFC_b.TST_ComInvld_325h_HVBAT_INSULATION_RESISTANCE "" UBYTE DFC_OneToOne 1 100 0.00 1.000 BIT_MASK 0x8 FORMAT "%5.3" ECU_ADDRESS 0x60034B7C /end MEASUREMENT
/begin MEASUREMENT DFC_b.TST_ComInvld_325h_HVBAT_TEMPERATURE "" UBYTE DFC_OneToOne 1 100 0.00 1.000 BIT_MASK 0x8 FORMAT "%5.3" ECU_ADDRESS 0x60034B7D /end MEASUREMENT
/begin MEASUREMENT DFC_b.TST_ComInvld_335h_HVBAT_CHRG_CONTINUOUS_CURR_MAX "" UBYTE DFC_OneToOne 1 100 0.00 1.000 BIT_MASK 0x8 FORMAT "%5.3" ECU_ADDRESS 0x60034B7E /end MEASUREMENT
/begin MEASUREMENT DFC_b.TST_ComInvld_335h_HVBAT_CHRG_COTINUOUS_CURR_REQ "" UBYTE DFC_OneToOne 1 100 0.00 1.000 BIT_MASK 0x8 FORMAT "%5.3" ECU_ADDRESS 0x60034B7F /end MEASUREMENT
/begin MEASUREMENT DFC_b.TST_ComInvld_335h_HVBAT_CHRG_MAX_VOLT "" UBYTE DFC_OneToOne 1 100 0.00 1.000 BIT_MASK 0x8 FORMAT "%5.3" ECU_ADDRESS 0x60034B80 /end MEASUREMENT
/begin MEASUREMENT DFC_b.TST_ComInvld_335h_HVBAT_DC_BUS_VOLTAGE "" UBYTE DFC_OneToOne 1 100 0.00 1.000 BIT_MASK 0x8 FORMAT "%5.3" ECU_ADDRESS 0x60034B81 /end MEASUREMENT
/begin MEASUREMENT DFC_b.TST_ComInvld_38Dh_VITESSE_VEHICULE_ROUES "" UBYTE DFC_OneToOne 1 100 0.00 1.000 BIT_MASK 0x8 FORMAT "%5.3" ECU_ADDRESS 0x60034B82 /end MEASUREMENT
/begin MEASUREMENT DFC_b.TST_ComInvld_38Dh_VVH_INDISP "" UBYTE DFC_OneToOne 1 100 0.00 1.000 BIT_MASK 0x8 FORMAT "%5.3" ECU_ADDRESS 0x60034B83 /end MEASUREMENT
/begin MEASUREMENT DFC_b.TST_ComInvld_427h_INV_COOLANT_TEMP "" UBYTE DFC_OneToOne 1 100 0.00 1.000 BIT_MASK 0x8 FORMAT "%5.3" ECU_ADDRESS 0x60034B84 /end MEASUREMENT
/begin MEASUREMENT DFC_b.TST_ComInvld_427h_INV_MOTOR_TEMP "" UBYTE DFC_OneToOne 1 100 0.00 1.000 BIT_MASK 0x8 FORMAT "%5.3" ECU_ADDRESS 0x60034B85 /end MEASUREMENT
/begin MEASUREMENT DFC_b.TST_ComInvld_427h_INV_OP_MODE "" UBYTE DFC_OneToOne 1 100 0.00 1.000 BIT_MASK 0x8 FORMAT "%5.3" ECU_ADDRESS 0x60034B86 /end MEASUREMENT
/begin MEASUREMENT DFC_b.TST_ComInvld_427h_INV_PERMISIBLE_TORQUE "" UBYTE DFC_OneToOne 1 100 0.00 1.000 BIT_MASK 0x8 FORMAT "%5.3" ECU_ADDRESS 0x60034B87 /end MEASUREMENT
/begin MEASUREMENT DFC_b.TST_ComInvld_427h_INV_TEMP "" UBYTE DFC_OneToOne 1 100 0.00 1.000 BIT_MASK 0x8 FORMAT "%5.3" ECU_ADDRESS 0x60034B88 /end MEASUREMENT
/begin MEASUREMENT DFC_b.TST_ComInvld_432h_REVEIL_PRINCIPAL "" UBYTE DFC_OneToOne 1 100 0.00 1.000 BIT_MASK 0x8 FORMAT "%5.3" ECU_ADDRESS 0x60034B89 /end MEASUREMENT
/begin MEASUREMENT DFC_b.TST_ComInvld_435h_HVBAT_MAX_CELL_VOLT "" UBYTE DFC_OneToOne 1 100 0.00 1.000 BIT_MASK 0x8 FORMAT "%5.3" ECU_ADDRESS 0x60034B8A /end MEASUREMENT
/begin MEASUREMENT DFC_b.TST_ComInvld_435h_HVBAT_MAX_CELL_VOLT_NUM "" UBYTE DFC_OneToOne 1 100 0.00 1.000 BIT_MASK 0x8 FORMAT "%5.3" ECU_ADDRESS 0x60034B8B /end MEASUREMENT
/begin MEASUREMENT DFC_b.TST_ComInvld_435h_HVBAT_MAX_SENSOR_TEMP "" UBYTE DFC_OneToOne 1 100 0.00 1.000 BIT_MASK 0x8 FORMAT "%5.3" ECU_ADDRESS 0x60034B8C /end MEASUREMENT
/begin MEASUREMENT DFC_b.TST_ComInvld_435h_HVBAT_MIN_CELL_VOLT "" UBYTE DFC_OneToOne 1 100 0.00 1.000 BIT_MASK 0x8 FORMAT "%5.3" ECU_ADDRESS 0x60034B8D /end MEASUREMENT
/begin MEASUREMENT DFC_b.TST_ComInvld_435h_HVBAT_MIN_CELL_VOLT_NUM "" UBYTE DFC_OneToOne 1 100 0.00 1.000 BIT_MASK 0x8 FORMAT "%5.3" ECU_ADDRESS 0x60034B8E /end MEASUREMENT
/begin MEASUREMENT DFC_b.TST_ComInvld_442h_BCCM_BLOWER_RELAY_STS "" UBYTE DFC_OneToOne 1 100 0.00 1.000 BIT_MASK 0x8 FORMAT "%5.3" ECU_ADDRESS 0x60034B8F /end MEASUREMENT
/begin MEASUREMENT DFC_b.TST_ComInvld_453h_OBC_IN_CURRENT "" UBYTE DFC_OneToOne 1 100 0.00 1.000 BIT_MASK 0x8 FORMAT "%5.3" ECU_ADDRESS 0x60034B90 /end MEASUREMENT
/begin MEASUREMENT DFC_b.TST_ComInvld_453h_OBC_IN_VOLTAGE "" UBYTE DFC_OneToOne 1 100 0.00 1.000 BIT_MASK 0x8 FORMAT "%5.3" ECU_ADDRESS 0x60034B91 /end MEASUREMENT
/begin MEASUREMENT DFC_b.TST_ComInvld_453h_OBC_IP_POWER "" UBYTE DFC_OneToOne 1 100 0.00 1.000 BIT_MASK 0x8 FORMAT "%5.3" ECU_ADDRESS 0x60034B92 /end MEASUREMENT
/begin MEASUREMENT DFC_b.TST_ComInvld_455h_HVBAT_NOMINAL_VOLTAGE "" UBYTE DFC_OneToOne 1 100 0.00 1.000 BIT_MASK 0x8 FORMAT "%5.3" ECU_ADDRESS 0x60034B93 /end MEASUREMENT
/begin MEASUREMENT DFC_b.TST_ComInvld_463h_OBC_OUT_CURRENT "" UBYTE DFC_OneToOne 1 100 0.00 1.000 BIT_MASK 0x8 FORMAT "%5.3" ECU_ADDRESS 0x60034B94 /end MEASUREMENT
/begin MEASUREMENT DFC_b.TST_ComInvld_463h_OBC_OUT_VOLTAGE "" UBYTE DFC_OneToOne 1 100 0.00 1.000 BIT_MASK 0x8 FORMAT "%5.3" ECU_ADDRESS 0x60034B95 /end MEASUREMENT
/begin MEASUREMENT DFC_b.TST_ComInvld_463h_OBC_TEMPERATURE "" UBYTE DFC_OneToOne 1 100 0.00 1.000 BIT_MASK 0x8 FORMAT "%5.3" ECU_ADDRESS 0x60034B96 /end MEASUREMENT
/begin MEASUREMENT DFC_st.DFC_DevLibBattUHi "" UBYTE DFC_OneToOne 1 100 0.00 255.0 FORMAT "%5.1" ECU_ADDRESS 0x60034BF4 /end MEASUREMENT
/begin MEASUREMENT DFC_st.DFC_DevLibBattULo "" UBYTE DFC_OneToOne 1 100 0.00 255.0 FORMAT "%5.1" ECU_ADDRESS 0x60034BF5 /end MEASUREMENT
/begin FUNCTION DevLib_PwrStgState "100.7.0   Power Stage State"
 /begin DEF_CHARACTERISTIC DDRC_DurDeb.DevLib_tiBattUHiDebOk_C DDRC_DurDeb.DevLib_tiBattUHiDebDef_C DDRC_DurDeb.DevLib_tiBattULoDebOk_C DDRC_DurDeb.DevLib_tiBattULoDebDef_C DDRC_RatDeb.DevLib_tiBattUHiUDRat_C DDRC_RatDeb.DevLib_tiBattULoUDRat_C Devlib_PsDisbl.facLowHysLo_C Devlib_PsDisbl.facLowHysHi_C Devlib_PsDisbl.facHighHysLo_C Devlib_PsDisbl.facHighHysHi_C Devlib_PwrStg.BattLoHysLo_C Devlib_PwrStg.BattLoHysHi_C Devlib_PwrStg.BattHiHysLo_C Devlib_PwrStg.BattHiHysHi_C DFC_CtlMsk2.DFC_DevLibBattUHi_C DFC_CtlMsk2.DFC_DevLibBattULo_C DFC_DisblMsk2.DFC_DevLibBattUHi_C DFC_DisblMsk2.DFC_DevLibBattULo_C /end DEF_CHARACTERISTIC
 /begin IN_MEASUREMENT BattU_facCor BattU_u DSM_TripChgFinshd MoCSOP_stRdy MoCSOP_stRdyMsg SyC_stSub /end IN_MEASUREMENT
 /begin OUT_MEASUREMENT DDRC_St.DFC_DevLibBattUHi DDRC_St.DFC_DevLibBattULo DevLib_stPwrStgEnaCond DFC_st.DFC_DevLibBattUHi DFC_st.DFC_DevLibBattULo /end OUT_MEASUREMENT
 FUNCTION_VERSION "100.7.0" /end FUNCTION
/begin FUNCTION DevLib_SRC "1.145.0   Device Library electrical Signal Range Check" FUNCTION_VERSION "1.145.0" /end FUNCTION
/begin FUNCTION DevLib_TransStage "1.149.0   Device Library Transition Stage for sensor replacement values" FUNCTION_VERSION "1.149.0" /end FUNCTION
/begin FUNCTION DFC "30000.32.0Diagnostic Fault Check"
 /begin REF_CHARACTERISTIC DFC_CtlMsk2.DFC_ACCmprFltLvlRes_C DFC_CtlMsk2.DFC_AbgHiSigFlt_C DFC_CtlMsk2.DFC_AbgIntPatFlt_C DFC_CtlMsk2.DFC_AbgLoSigFlt_C DFC_CtlMsk2.DFC_AbgUnkwnErrSigFlt_C DFC_CtlMsk2.DFC_AcExtChrgrIBattExcdd_C DFC_CtlMsk2.DFC_AcExtChrgrIInExcdd_C DFC_CtlMsk2.DFC_AcExtChrgrIOutDe_C DFC_CtlMsk2.DFC_AcExtChrgrIOutExcdd_C DFC_CtlMsk2.DFC_AcExtChrgrUOutDe_C DFC_CtlMsk2.DFC_AdpActvDChaFailr_C DFC_CtlMsk2.DFC_AirbcuFlt_C DFC_CtlMsk2.DFC_Airbg_C DFC_CtlMsk2.DFC_AirbgCan_C DFC_CtlMsk2.DFC_AirbgCanHWPlaus_C DFC_CtlMsk2.DFC_AirbgHWCanPlaus_C DFC_CtlMsk2.DFC_AirbgMnr_C DFC_CtlMsk2.DFC_AirbgPerHi_C DFC_CtlMsk2.DFC_AirbgPerdRngFlt_C DFC_CtlMsk2.DFC_BlowrRlyErr_C DFC_CtlMsk2.DFC_BrkBstPmpActtnDfct_C DFC_CtlMsk2.DFC_BrkBstPmpDeactvnDfct_C DFC_CtlMsk2.DFC_BrkSwtFlt_C DFC_CtlMsk2.DFC_CbnHeatgHeatrHsScb_C DFC_CtlMsk2.DFC_CbnHeatgHeatrHsScg_C DFC_CtlMsk2.DFC_CbnHeatgHeatrLsOl_C DFC_CtlMsk2.DFC_CbnHeatgHeatrLsScb_C DFC_CtlMsk2.DFC_CbnHeatgHeatrLsScg_C DFC_CtlMsk2.DFC_CbnHeatgHeatrUnUsed_C DFC_CtlMsk2.DFC_ChrgnCntctHsOt_C DFC_CtlMsk2.DFC_ChrgnCntctHsScb_C DFC_CtlMsk2.DFC_ChrgnCntctHsScg_C DFC_CtlMsk2.DFC_ChrgnCntctLsNegOl_C DFC_CtlMsk2.DFC_ChrgnCntctLsNegOt_C DFC_CtlMsk2.DFC_ChrgnCntctLsNegScb_C DFC_CtlMsk2.DFC_ChrgnCntctLsNegScg_C DFC_CtlMsk2.DFC_ChrgnCntctLsPosOl_C DFC_CtlMsk2.DFC_ChrgnCntctLsPosOt_C DFC_CtlMsk2.DFC_ChrgnCntctLsPosScb_C DFC_CtlMsk2.DFC_ChrgnCntctLsPosScg_C DFC_CtlMsk2.DFC_ChrgnCntctUnUsed_C DFC_CtlMsk2.DFC_ComBrkMai_C DFC_CtlMsk2.DFC_ComChrgrEVCont_C DFC_CtlMsk2.DFC_ComChrgrEVtBlink_C DFC_CtlMsk2.DFC_ComChrgrMstBlink_C DFC_CtlMsk2.DFC_ComChrgrMstCont_C DFC_CtlMsk2.DFC_ComChrgrSVSBlink_C DFC_CtlMsk2.DFC_ComChrgrSVSCont_C DFC_CtlMsk2.DFC_ComDcdcEVBlink_C DFC_CtlMsk2.DFC_ComDcdcEVCont_C DFC_CtlMsk2.DFC_ComDcdcFltLvl2_C DFC_CtlMsk2.DFC_ComDcdcFltLvl3_C DFC_CtlMsk2.DFC_ComDcdcFltLvl4_C DFC_CtlMsk2.DFC_ComDcdcFltLvl5_C DFC_CtlMsk2.DFC_ComDcdcFltLvlRes_C DFC_CtlMsk2.DFC_ComDcdcMstBlink_C DFC_CtlMsk2.DFC_ComDcdcMstCont_C DFC_CtlMsk2.DFC_ComDcdcSVSBlink_C DFC_CtlMsk2.DFC_ComDcdcSVSCont_C DFC_CtlMsk2.DFC_ComElMIIvtrFltLvl2_C DFC_CtlMsk2.DFC_ComElMIIvtrFltLvl3_C DFC_CtlMsk2.DFC_ComElMIIvtrFltLvl4_C DFC_CtlMsk2.DFC_ComElMIIvtrFltLvl5_C DFC_CtlMsk2.DFC_ComElMIIvtrFltLvlRes_C DFC_CtlMsk2.DFC_ComEmacEVBlink_C DFC_CtlMsk2.DFC_ComEmacEVCont_C DFC_CtlMsk2.DFC_ComEmacMstCont_C DFC_CtlMsk2.DFC_ComEmacMsttBlink_C DFC_CtlMsk2.DFC_ComEmacSVSBlink_C DFC_CtlMsk2.DFC_ComEmacSVSCont_C DFC_CtlMsk2.DFC_ComGunCntInfoWkuReq_C DFC_CtlMsk2.DFC_ComHillHldFlt_C DFC_CtlMsk2.DFC_ComHvBattRchrgWkuReq_C DFC_CtlMsk2.DFC_ComHvbFltLvl2_C DFC_CtlMsk2.DFC_ComHvbFltLvl3_C DFC_CtlMsk2.DFC_ComHvbFltLvl4_C DFC_CtlMsk2.DFC_ComHvbFltLvl5_C DFC_CtlMsk2.DFC_ComHvbFltLvlRes_C DFC_CtlMsk2.DFC_ComHvbMstBlink_C DFC_CtlMsk2.DFC_ComHvbMstCont_C DFC_CtlMsk2.DFC_ComImmoUnlockWkuReq_C DFC_CtlMsk2.DFC_ComInfoReqPtlWkuReq_C DFC_CtlMsk2.DFC_ComOBCFltLvl2_C DFC_CtlMsk2.DFC_ComOBCFltLvl3_C DFC_CtlMsk2.DFC_ComOBCFltLvl4_C DFC_CtlMsk2.DFC_ComOBCFltLvl5_C DFC_CtlMsk2.DFC_ComOBCFltLvlRes_C DFC_CtlMsk2.DFC_ComPostOperationWkuReq_C DFC_CtlMsk2.DFC_ComPreCondElecWkuReq_C DFC_CtlMsk2.DFC_ComRemUnlckWkuReq_C DFC_CtlMsk2.DFC_ComStpDlyHMIWkuReq_C DFC_CtlMsk2.DFC_ComflgCurMeasmtErr_C DFC_CtlMsk2.DFC_ComflgCurMeasmtSysErr_C DFC_CtlMsk2.DFC_ComflgCurMeasmtVld_C DFC_CtlMsk2.DFC_ComflgCurRngErr_C DFC_CtlMsk2.DFC_ComflgTPcbMeasmtErr_C DFC_CtlMsk2.DFC_ComflgTPcbMeasmtVld_C DFC_CtlMsk2.DFC_ComflgTPcbRngErr_C DFC_CtlMsk2.DFC_ComflgTPcbSysErr_C DFC_CtlMsk2.DFC_ComflgTShntMeasmtErr_C DFC_CtlMsk2.DFC_ComflgTShntMeasmtVld_C DFC_CtlMsk2.DFC_ComflgTShntRngErr_C DFC_CtlMsk2.DFC_ComflgTShntSysErr_C DFC_CtlMsk2.DFC_ComflgVoltMeasmtErr_C DFC_CtlMsk2.DFC_ComflgVoltMeasmtSysErr_C DFC_CtlMsk2.DFC_ComflgVoltMeasmtVld_C DFC_CtlMsk2.DFC_ComflgVoltRngErr_C DFC_CtlMsk2.DFC_CrashEveOcc_C DFC_CtlMsk2.DFC_DcdcFwdModStuck_C DFC_CtlMsk2.DFC_DcdcLvUDifMaxFlt_C DFC_CtlMsk2.DFC_DcdcOffModStuck_C DFC_CtlMsk2.DFC_DcdcOperModFailr_C DFC_CtlMsk2.DFC_DcdcPrecModStuck_C DFC_CtlMsk2.DFC_DrvDoorOpn_C DFC_CtlMsk2.DFC_DrvModPosnDfct_C DFC_CtlMsk2.DFC_DrvStbltOpn_C DFC_CtlMsk2.DFC_ETogFailrLvl3_C DFC_CtlMsk2.DFC_ETogFailrLvl4_C DFC_CtlMsk2.DFC_EbsLvBattSocDiagLo_C DFC_CtlMsk2.DFC_EbsLvBattUDiagDiOper_C DFC_CtlMsk2.DFC_EbsLvBattUDiagFltLvl1_C DFC_CtlMsk2.DFC_EbsLvBattUDiagFltLvl2_C DFC_CtlMsk2.DFC_EbsLvBattUDiagLo_C DFC_CtlMsk2.DFC_EbsSnsrSt_C DFC_CtlMsk2.DFC_EbsSofASILErr_C DFC_CtlMsk2.DFC_ElTSPtSysLimDrvErr_C DFC_CtlMsk2.DFC_ElTSPtSysLimRgnErr_C DFC_CtlMsk2.DFC_HLCCcsFwDwnl_C DFC_CtlMsk2.DFC_HvBattChrgPwrMax_C DFC_CtlMsk2.DFC_HvBattCrashDetd_C DFC_CtlMsk2.DFC_HvBattDchaPwrMax_C DFC_CtlMsk2.DFC_HvBattEmgyOff_C DFC_CtlMsk2.DFC_HvBattEmgyOffIntlck_C DFC_CtlMsk2.DFC_HvBattEmgyOffReq_C DFC_CtlMsk2.DFC_HvBattFltMod_C DFC_CtlMsk2.DFC_HvBattIReqToChrgrErr_C DFC_CtlMsk2.DFC_HvBattIReqToChrgrIni_C DFC_CtlMsk2.DFC_HvBattIninTout_C DFC_CtlMsk2.DFC_HvBattIntlckSt_C DFC_CtlMsk2.DFC_HvBattIsoFlt_C DFC_CtlMsk2.DFC_HvBattLimdPwr_C DFC_CtlMsk2.DFC_HvBattMaiSwtClsngFlt_C DFC_CtlMsk2.DFC_HvBattMaiSwtFlt_C DFC_CtlMsk2.DFC_HvBattMaiSwtOpen_C DFC_CtlMsk2.DFC_HvBattMaiSwtOpngFlt_C DFC_CtlMsk2.DFC_HvBattMaiSwtWldd_C DFC_CtlMsk2.DFC_HvBattNegCntctrCntErr_C DFC_CtlMsk2.DFC_HvBattOperModChrgPlausy_C DFC_CtlMsk2.DFC_HvBattOverTDern_C DFC_CtlMsk2.DFC_HvBattPosCntctrCntErr_C DFC_CtlMsk2.DFC_HvBattPrecCntctrCntErr_C DFC_CtlMsk2.DFC_HvBattPwrDistbnTDern_C DFC_CtlMsk2.DFC_HvBattPwrDistbnTInhbn_C DFC_CtlMsk2.DFC_HvBattRatRSohErr_C DFC_CtlMsk2.DFC_HvBattRatSohErr_C DFC_CtlMsk2.DFC_HvBattSngIsoWarn_C DFC_CtlMsk2.DFC_HvBattSrvPlgDiscnct_C DFC_CtlMsk2.DFC_HvBattUNomChrgnErr_C DFC_CtlMsk2.DFC_HvBattUNomChrgnIni_C DFC_CtlMsk2.DFC_HvBattUnderTDern_C DFC_CtlMsk2.DFC_HvbEVLmpBlink_C DFC_CtlMsk2.DFC_HvbEVLmpCont_C DFC_CtlMsk2.DFC_HvbSVSBlink_C DFC_CtlMsk2.DFC_HvbSVSCont_C DFC_CtlMsk2.DFC_InmLINBusBlk_C DFC_CtlMsk2.DFC_PDUProgmFailr_C DFC_CtlMsk2.DFC_PEnvSigRngMax_C DFC_CtlMsk2.DFC_PEnvSigRngMin_C DFC_CtlMsk2.DFC_PLnCChpDeactvnFaild_C DFC_CtlMsk2.DFC_PrkgBrkFailr_C DFC_CtlMsk2.DFC_PtSysLimErr_C DFC_CtlMsk2.DFC_PwrMaxDchaShoLo_C DFC_CtlMsk2.DFC_SCtPmp1FailSafeNotSuc_C DFC_CtlMsk2.DFC_SCtPmp1SCG_C DFC_CtlMsk2.DFC_VehCoornDrvrNotPrsnt_C DFC_CtlMsk2.DFC_VehVCanAvl_C DFC_CtlMsk2.DFC_VehVCanErr_C DFC_CtlMsk2.DFC_eTogFailrLvlRes_C DFC_CtlMsk2.DFC_flgBrkMaiDiag_C DFC_CtlMsk2.DFC_stHvbIsoMeasmtRes_C DFC_CtlMsk2.DFC_BrkBstPmpPLeakDfct_C DFC_CtlMsk2.DFC_Com082hTooShort_C DFC_CtlMsk2.DFC_Com092hTooShort_C DFC_CtlMsk2.DFC_Com205hAbsent_C DFC_CtlMsk2.DFC_Com205hChecksum_C DFC_CtlMsk2.DFC_Com205hCounter_C DFC_CtlMsk2.DFC_Com205hTooShort_C DFC_CtlMsk2.DFC_Com217hAbsent_C DFC_CtlMsk2.DFC_Com217hChecksum_C DFC_CtlMsk2.DFC_Com217hCounter_C DFC_CtlMsk2.DFC_Com217hTooShort_C DFC_CtlMsk2.DFC_Com227hAbsent_C DFC_CtlMsk2.DFC_Com227hTooShort_C DFC_CtlMsk2.DFC_Com237hAbsent_C DFC_CtlMsk2.DFC_Com237hChecksum_C DFC_CtlMsk2.DFC_Com237hCounter_C DFC_CtlMsk2.DFC_Com237hTooShort_C DFC_CtlMsk2.DFC_Com259hAbsent_C DFC_CtlMsk2.DFC_Com259hChecksum_C DFC_CtlMsk2.DFC_Com259hCounter_C DFC_CtlMsk2.DFC_Com259hTooShort_C DFC_CtlMsk2.DFC_Com26hAbsent_C DFC_CtlMsk2.DFC_Com26hTooShort_C DFC_CtlMsk2.DFC_Com273hAbsent_C DFC_CtlMsk2.DFC_Com273hChecksum_C DFC_CtlMsk2.DFC_Com273hCounter_C DFC_CtlMsk2.DFC_Com273hTooShort_C DFC_CtlMsk2.DFC_Com275hAbsent_C DFC_CtlMsk2.DFC_Com275hChecksum_C DFC_CtlMsk2.DFC_Com275hCounter_C DFC_CtlMsk2.DFC_Com275hTooShort_C DFC_CtlMsk2.DFC_Com283hAbsent_C DFC_CtlMsk2.DFC_Com283hTooShort_C DFC_CtlMsk2.DFC_Com285hAbsent_C DFC_CtlMsk2.DFC_Com285hChecksum_C DFC_CtlMsk2.DFC_Com285hCounter_C DFC_CtlMsk2.DFC_Com285hTooShort_C DFC_CtlMsk2.DFC_Com293hAbsent_C DFC_CtlMsk2.DFC_Com293hChecksum_C DFC_CtlMsk2.DFC_Com293hCounter_C DFC_CtlMsk2.DFC_Com293hTooShort_C DFC_CtlMsk2.DFC_Com308hAbsent_C DFC_CtlMsk2.DFC_Com308hChecksum_C DFC_CtlMsk2.DFC_Com308hCounter_C DFC_CtlMsk2.DFC_Com308hTooShort_C DFC_CtlMsk2.DFC_Com318hAbsent_C DFC_CtlMsk2.DFC_Com318hChecksum_C DFC_CtlMsk2.DFC_Com318hCounter_C DFC_CtlMsk2.DFC_Com318hTooShort_C DFC_CtlMsk2.DFC_Com325hAbsent_C DFC_CtlMsk2.DFC_Com325hChecksum_C DFC_CtlMsk2.DFC_Com325hCounter_C DFC_CtlMsk2.DFC_Com325hTooShort_C DFC_CtlMsk2.DFC_Com335hAbsent_C DFC_CtlMsk2.DFC_Com335hChecksum_C DFC_CtlMsk2.DFC_Com335hCounter_C DFC_CtlMsk2.DFC_Com335hTooShort_C DFC_CtlMsk2.DFC_Com351hAbsent_C DFC_CtlMsk2.DFC_Com351hTooShort_C DFC_CtlMsk2.DFC_Com38DhAbsent_C DFC_CtlMsk2.DFC_Com38DhChecksum_C DFC_CtlMsk2.DFC_Com38DhCounter_C DFC_CtlMsk2.DFC_Com38DhTooShort_C DFC_CtlMsk2.DFC_Com412hAbsent_C DFC_CtlMsk2.DFC_Com412hChecksum_C DFC_CtlMsk2.DFC_Com412hCounter_C DFC_CtlMsk2.DFC_Com412hTooShort_C DFC_CtlMsk2.DFC_Com427hAbsent_C DFC_CtlMsk2.DFC_Com427hTooShort_C DFC_CtlMsk2.DFC_Com432hAbsent_C DFC_CtlMsk2.DFC_Com432hChecksum_C DFC_CtlMsk2.DFC_Com432hCounter_C DFC_CtlMsk2.DFC_Com432hTooShort_C DFC_CtlMsk2.DFC_Com435hAbsent_C DFC_CtlMsk2.DFC_Com435hTooShort_C DFC_CtlMsk2.DFC_Com442hAbsent_C DFC_CtlMsk2.DFC_Com442hTooShort_C DFC_CtlMsk2.DFC_Com453hAbsent_C DFC_CtlMsk2.DFC_Com453hTooShort_C DFC_CtlMsk2.DFC_Com455hAbsent_C DFC_CtlMsk2.DFC_Com455hTooShort_C DFC_CtlMsk2.DFC_Com463hAbsent_C DFC_CtlMsk2.DFC_Com463hTooShort_C DFC_CtlMsk2.DFC_Com473hAbsent_C DFC_CtlMsk2.DFC_Com473hTooShort_C DFC_CtlMsk2.DFC_Com47BhAbsent_C DFC_CtlMsk2.DFC_Com47BhTooShort_C DFC_CtlMsk2.DFC_Com48BhAbsent_C DFC_CtlMsk2.DFC_Com48BhTooShort_C DFC_CtlMsk2.DFC_Com497hTooShort_C DFC_CtlMsk2.DFC_Com4F2hAbsent_C DFC_CtlMsk2.DFC_Com4F2hChecksum_C DFC_CtlMsk2.DFC_Com4F2hCounter_C DFC_CtlMsk2.DFC_Com4F2hTooShort_C DFC_CtlMsk2.DFC_Com50DhAbsent_C DFC_CtlMsk2.DFC_Com50DhTooShort_C DFC_CtlMsk2.DFC_Com535hAbsent_C DFC_CtlMsk2.DFC_Com535hTooShort_C DFC_CtlMsk2.DFC_Com543hAbsent_C DFC_CtlMsk2.DFC_Com543hTooShort_C DFC_CtlMsk2.DFC_Com552hAbsent_C DFC_CtlMsk2.DFC_Com552hTooShort_C DFC_CtlMsk2.DFC_Com583hAbsent_C DFC_CtlMsk2.DFC_Com583hTooShort_C DFC_CtlMsk2.DFC_Com592hAbsent_C DFC_CtlMsk2.DFC_Com592hChecksum_C DFC_CtlMsk2.DFC_Com592hCounter_C DFC_CtlMsk2.DFC_Com592hTooShort_C DFC_CtlMsk2.DFC_Com595hAbsent_C DFC_CtlMsk2.DFC_Com595hChecksum_C DFC_CtlMsk2.DFC_Com595hCounter_C DFC_CtlMsk2.DFC_Com595hTooShort_C DFC_CtlMsk2.DFC_Com5B2hAbsent_C DFC_CtlMsk2.DFC_Com5B2hTooShort_C DFC_CtlMsk2.DFC_Com5B5hAbsent_C DFC_CtlMsk2.DFC_Com5B5hChecksum_C DFC_CtlMsk2.DFC_Com5B5hCounter_C DFC_CtlMsk2.DFC_Com5B5hTooShort_C DFC_CtlMsk2.DFC_Com5C7hTooShort_C DFC_CtlMsk2.DFC_Com5E7hAbsent_C DFC_CtlMsk2.DFC_Com5E7hTooShort_C DFC_CtlMsk2.DFC_Com635hTooShort_C DFC_CtlMsk2.DFC_Com645hTooShort_C DFC_CtlMsk2.DFC_Com663hAbsent_C DFC_CtlMsk2.DFC_Com663hTooShort_C DFC_CtlMsk2.DFC_Com665hAbsent_C DFC_CtlMsk2.DFC_Com665hTooShort_C DFC_CtlMsk2.DFC_Com675hAbsent_C DFC_CtlMsk2.DFC_Com675hTooShort_C DFC_CtlMsk2.DFC_ComFrbd_205h_HVBAT_PACK_CURRENT_C DFC_CtlMsk2.DFC_ComFrbd_205h_HVBAT_SOC_DISPLAY_C DFC_CtlMsk2.DFC_ComFrbd_205h_HVBAT_VOLTAGE_C DFC_CtlMsk2.DFC_ComFrbd_217h_INV_DC_BUS_VOLTAGE_C DFC_CtlMsk2.DFC_ComFrbd_217h_INV_MTR_ACTUAL_TRQ_C DFC_CtlMsk2.DFC_ComFrbd_217h_INV_MTR_SPEED_C DFC_CtlMsk2.DFC_ComFrbd_217h_INV_MTR_TRQ_C DFC_CtlMsk2.DFC_ComFrbd_227h_INV_DC_CURRENT_C DFC_CtlMsk2.DFC_ComFrbd_227h_INV_MOTORING_PEAK_TRQ_C DFC_CtlMsk2.DFC_ComFrbd_227h_INV_MTR_INST_INPUT_POWER_C DFC_CtlMsk2.DFC_ComFrbd_227h_INV_REGEN_PEAK_TRQ_C DFC_CtlMsk2.DFC_ComFrbd_237h_INV_ACTIVE_DISCHARGE_STATUS_C DFC_CtlMsk2.DFC_ComFrbd_237h_INV_CTRL_MODE_ACK_C DFC_CtlMsk2.DFC_ComFrbd_237h_INV_EV_WARNING_C DFC_CtlMsk2.DFC_ComFrbd_237h_INV_FAULT_LEVEL_C DFC_CtlMsk2.DFC_ComFrbd_237h_INV_MASTER_STOP_C DFC_CtlMsk2.DFC_ComFrbd_237h_INV_SERVICE_DUE_C DFC_CtlMsk2.DFC_ComFrbd_237h_INV_STAB_MIN_TRQ_C DFC_CtlMsk2.DFC_ComFrbd_259h_TGLM_FAILURE_STATE_C DFC_CtlMsk2.DFC_ComFrbd_259h_TGLM_MODE_PUSH_C DFC_CtlMsk2.DFC_ComFrbd_259h_TOGGLE_MONOSTABLE_POS_C DFC_CtlMsk2.DFC_ComFrbd_273h_OBC_outputpower_capability_C DFC_CtlMsk2.DFC_ComFrbd_275h_HVBAT_DISCHARGE_30S_AVAILABLE_CURRENT_C DFC_CtlMsk2.DFC_ComFrbd_275h_HVBAT_DISCHARGE_30S_AVAILABLE_POWER_C DFC_CtlMsk2.DFC_ComFrbd_283h_DCDC_IN_CURRENT_C DFC_CtlMsk2.DFC_ComFrbd_283h_DCDC_IN_VOLTAGE_C DFC_CtlMsk2.DFC_ComFrbd_283h_DCDC_OUT_CURRENT_C DFC_CtlMsk2.DFC_ComFrbd_283h_DCDC_OUT_VOLTAGE_C DFC_CtlMsk2.DFC_ComFrbd_285h_HVBAT_REGEN_CHG_30S_CURRENT_LIMIT_C DFC_CtlMsk2.DFC_ComFrbd_285h_HVBAT_REGEN_CHRG_30S_POWER_LIMIT_C DFC_CtlMsk2.DFC_ComFrbd_293h_DCDC_outputpower_capability_C DFC_CtlMsk2.DFC_ComFrbd_325h_HVBAT_INSULATION_RESISTANCE_C DFC_CtlMsk2.DFC_ComFrbd_325h_HVBAT_TEMPERATURE_C DFC_CtlMsk2.DFC_ComFrbd_335h_HVBAT_CHRG_CONTINUOUS_CURR_MAX_C DFC_CtlMsk2.DFC_ComFrbd_335h_HVBAT_CHRG_COTINUOUS_CURR_REQ_C DFC_CtlMsk2.DFC_ComFrbd_335h_HVBAT_CHRG_MAX_VOLT_C DFC_CtlMsk2.DFC_ComFrbd_335h_HVBAT_DC_BUS_VOLTAGE_C DFC_CtlMsk2.DFC_ComFrbd_427h_INV_OP_MODE_C DFC_CtlMsk2.DFC_ComFrbd_427h_INV_PERMISIBLE_TORQUE_C DFC_CtlMsk2.DFC_ComFrbd_435h_HVBAT_MAX_CELL_VOLT_C DFC_CtlMsk2.DFC_ComFrbd_435h_HVBAT_MAX_CELL_VOLT_NUM_C DFC_CtlMsk2.DFC_ComFrbd_435h_HVBAT_MAX_SENSOR_TEMP_C DFC_CtlMsk2.DFC_ComFrbd_435h_HVBAT_MIN_CELL_VOLT_C DFC_CtlMsk2.DFC_ComFrbd_435h_HVBAT_MIN_CELL_VOLT_NUM_C DFC_CtlMsk2.DFC_ComFrbd_453h_OBC_IN_CURRENT_C DFC_CtlMsk2.DFC_ComFrbd_453h_OBC_IN_VOLTAGE_C DFC_CtlMsk2.DFC_ComFrbd_453h_OBC_IP_POWER_C DFC_CtlMsk2.DFC_ComFrbd_455h_HVBAT_NOMINAL_VOLTAGE_C DFC_CtlMsk2.DFC_ComFrbd_463h_OBC_OUT_CURRENT_C DFC_CtlMsk2.DFC_ComFrbd_463h_OBC_OUT_VOLTAGE_C DFC_CtlMsk2.DFC_ComFrbd_463h_OBC_TEMPERATURE_C DFC_CtlMsk2.DFC_ComFrbd_473h_DCDC_Coolant_Temperature_C DFC_CtlMsk2.DFC_ComFrbd_473h_DCDC_TEMPERATURE_C DFC_CtlMsk2.DFC_ComFrbd_47Bh_eCOMP_BusBarCurrent_C DFC_CtlMsk2.DFC_ComFrbd_47Bh_eCOMP_BusBarVoltage_C DFC_CtlMsk2.DFC_ComFrbd_47Bh_eCOMP_CompressorSpeed_C DFC_CtlMsk2.DFC_ComFrbd_47Bh_eCOMP_IGBT_Temp_C DFC_CtlMsk2.DFC_ComFrbd_47Bh_eCOMP_PeakPhaCurrent_C DFC_CtlMsk2.DFC_ComFrbd_47Bh_eCOMP_Power_consumption_C DFC_CtlMsk2.DFC_ComFrbd_48Bh_eCOMP_Fault_Level_C DFC_CtlMsk2.DFC_ComFrbd_4F2h_VALEUR_SOC_ETENDUE_C DFC_CtlMsk2.DFC_ComFrbd_535h_HV_BATT_TEMP_AVG_C DFC_CtlMsk2.DFC_ComFrbd_543h_HVBAT_RESTBATTENERGY_C DFC_CtlMsk2.DFC_ComFrbd_543h_HVBAT_SOH_C DFC_CtlMsk2.DFC_ComFrbd_543h_HV_BATT_SOH_RES_C DFC_CtlMsk2.DFC_ComFrbd_592h_IBATT_1_C DFC_CtlMsk2.DFC_ComFrbd_592h_IBATT_2_C DFC_CtlMsk2.DFC_ComFrbd_592h_IBATT_3_C DFC_CtlMsk2.DFC_ComFrbd_592h_TEMP_BATT_C DFC_CtlMsk2.DFC_ComFrbd_592h_U_BATT_BECB_C DFC_CtlMsk2.DFC_ComFrbd_595h_HVBAT_TIME_TO_CHRG_80_C DFC_CtlMsk2.DFC_ComFrbd_5B2h_TEMP_AIR_EXT_C DFC_CtlMsk2.DFC_ComFrbd_635h_HVBAT_NEG_CONT_COUNT_SEG1_C DFC_CtlMsk2.DFC_ComFrbd_635h_HVBAT_NEG_CONT_COUNT_SEG3_C DFC_CtlMsk2.DFC_ComFrbd_635h_HVBAT_NEG_CONT_COUNT_SEG4_C DFC_CtlMsk2.DFC_ComFrbd_635h_HVBAT_PST_CONT_COUNT_SEG1_C DFC_CtlMsk2.DFC_ComFrbd_635h_HVBAT_PST_CONT_COUNT_SEG3_C DFC_CtlMsk2.DFC_ComFrbd_635h_HVBAT_PST_CONT_COUNT_SEG4_C DFC_CtlMsk2.DFC_ComFrbd_645h_HVBAT_PRECHRGE_CONT_COUNT_SEG1_C DFC_CtlMsk2.DFC_ComFrbd_645h_HVBAT_PRECHRGE_CONT_COUNT_SEG2_C DFC_CtlMsk2.DFC_ComFrbd_675h_HVBAT_REMAININGBATTCAPACITY_C DFC_CtlMsk2.DFC_ComInvld_205h_HVBAT_CHARGING_STATUS_C DFC_CtlMsk2.DFC_ComInvld_205h_HVBAT_PACK_CURRENT_C DFC_CtlMsk2.DFC_ComInvld_205h_HVBAT_SOC_DISPLAY_C DFC_CtlMsk2.DFC_ComInvld_205h_HVBAT_VOLTAGE_C DFC_CtlMsk2.DFC_ComInvld_217h_INV_DC_BUS_VOLTAGE_C DFC_CtlMsk2.DFC_ComInvld_217h_INV_MTR_ACTUAL_TRQ_C DFC_CtlMsk2.DFC_ComInvld_217h_INV_MTR_SPEED_C DFC_CtlMsk2.DFC_ComInvld_217h_INV_MTR_TRQ_C DFC_CtlMsk2.DFC_ComInvld_227h_INV_DC_CURRENT_C DFC_CtlMsk2.DFC_ComInvld_227h_INV_MOTORING_PEAK_TRQ_C DFC_CtlMsk2.DFC_ComInvld_227h_INV_MTR_INST_INPUT_POWER_C DFC_CtlMsk2.DFC_ComInvld_227h_INV_REGEN_PEAK_TRQ_C DFC_CtlMsk2.DFC_ComInvld_237h_INV_ACTIVE_DISCHARGE_STATUS_C DFC_CtlMsk2.DFC_ComInvld_237h_INV_FAULT_LEVEL_C DFC_CtlMsk2.DFC_ComInvld_237h_INV_STAB_MIN_TRQ_C DFC_CtlMsk2.DFC_ComInvld_259h_TGLM_MODE_PUSH_C DFC_CtlMsk2.DFC_ComInvld_259h_TOGGLE_MONOSTABLE_POS_C DFC_CtlMsk2.DFC_ComInvld_26h_AC_SWITCH_REQ_C DFC_CtlMsk2.DFC_ComInvld_26h_BLOWER_POSITION_C DFC_CtlMsk2.DFC_ComInvld_26h_EVAP_SENSOR_FAULT_C DFC_CtlMsk2.DFC_ComInvld_26h_EVAP_SENSOR_VALUE_C DFC_CtlMsk2.DFC_ComInvld_26h_POTENTIOMETER_FAULT_C DFC_CtlMsk2.DFC_ComInvld_26h_REAR_DEFOG_REQ_C DFC_CtlMsk2.DFC_ComInvld_26h_TEMP_POSITION_C DFC_CtlMsk2.DFC_ComInvld_273h_OBC_FAULT_LEVEL_C DFC_CtlMsk2.DFC_ComInvld_273h_OBC_outputpower_capability_C DFC_CtlMsk2.DFC_ComInvld_275h_HVBAT_DISCHARGE_30S_AVAILABLE_CURRENT_C DFC_CtlMsk2.DFC_ComInvld_275h_HVBAT_DISCHARGE_30S_AVAILABLE_POWER_C DFC_CtlMsk2.DFC_ComInvld_283h_DCDC_IN_CURRENT_C DFC_CtlMsk2.DFC_ComInvld_283h_DCDC_IN_VOLTAGE_C DFC_CtlMsk2.DFC_ComInvld_283h_DCDC_OUT_CURRENT_C DFC_CtlMsk2.DFC_ComInvld_283h_DCDC_OUT_VOLTAGE_C DFC_CtlMsk2.DFC_ComInvld_285h_HVBAT_REGEN_CHG_30S_CURRENT_LIMIT_C DFC_CtlMsk2.DFC_ComInvld_285h_HVBAT_REGEN_CHRG_30S_POWER_LIMIT_C DFC_CtlMsk2.DFC_ComInvld_293h_DCDC_FAULT_LEVEL_C DFC_CtlMsk2.DFC_ComInvld_293h_DCDC_outputpower_capability_C DFC_CtlMsk2.DFC_ComInvld_325h_HVBAT_EPLUG_STATUS_C DFC_CtlMsk2.DFC_ComInvld_325h_HVBAT_HVIL_STS_C DFC_CtlMsk2.DFC_ComInvld_325h_HVBAT_INSULATION_FAULT_C DFC_CtlMsk2.DFC_ComInvld_325h_HVBAT_INSULATION_RESISTANCE_C DFC_CtlMsk2.DFC_ComInvld_325h_HVBAT_TEMPERATURE_C DFC_CtlMsk2.DFC_ComInvld_335h_HVBAT_CHRG_CONTINUOUS_CURR_MAX_C DFC_CtlMsk2.DFC_ComInvld_335h_HVBAT_CHRG_COTINUOUS_CURR_REQ_C DFC_CtlMsk2.DFC_ComInvld_335h_HVBAT_CHRG_MAX_VOLT_C DFC_CtlMsk2.DFC_ComInvld_335h_HVBAT_DC_BUS_VOLTAGE_C DFC_CtlMsk2.DFC_ComInvld_38Dh_VITESSE_VEHICULE_ROUES_C DFC_CtlMsk2.DFC_ComInvld_38Dh_VVH_INDISP_C DFC_CtlMsk2.DFC_ComInvld_427h_INV_COOLANT_TEMP_C DFC_CtlMsk2.DFC_ComInvld_427h_INV_MOTOR_TEMP_C DFC_CtlMsk2.DFC_ComInvld_427h_INV_OP_MODE_C DFC_CtlMsk2.DFC_ComInvld_427h_INV_PERMISIBLE_TORQUE_C DFC_CtlMsk2.DFC_ComInvld_427h_INV_TEMP_C DFC_CtlMsk2.DFC_ComInvld_432h_REVEIL_PRINCIPAL_C DFC_CtlMsk2.DFC_ComInvld_435h_HVBAT_MAX_CELL_VOLT_C DFC_CtlMsk2.DFC_ComInvld_435h_HVBAT_MAX_CELL_VOLT_NUM_C DFC_CtlMsk2.DFC_ComInvld_435h_HVBAT_MAX_SENSOR_TEMP_C DFC_CtlMsk2.DFC_ComInvld_435h_HVBAT_MIN_CELL_VOLT_C DFC_CtlMsk2.DFC_ComInvld_435h_HVBAT_MIN_CELL_VOLT_NUM_C DFC_CtlMsk2.DFC_ComInvld_442h_BCCM_BLOWER_RELAY_STS_C DFC_CtlMsk2.DFC_ComInvld_453h_OBC_IN_CURRENT_C DFC_CtlMsk2.DFC_ComInvld_453h_OBC_IN_VOLTAGE_C DFC_CtlMsk2.DFC_ComInvld_453h_OBC_IP_POWER_C DFC_CtlMsk2.DFC_ComInvld_455h_HVBAT_NOMINAL_VOLTAGE_C DFC_CtlMsk2.DFC_ComInvld_463h_OBC_OUT_CURRENT_C DFC_CtlMsk2.DFC_ComInvld_463h_OBC_OUT_VOLTAGE_C DFC_CtlMsk2.DFC_ComInvld_463h_OBC_TEMPERATURE_C DFC_CtlMsk2.DFC_ComInvld_473h_DCDC_Coolant_Temperature_C DFC_CtlMsk2.DFC_ComInvld_473h_DCDC_TEMPERATURE_C DFC_CtlMsk2.DFC_ComInvld_47Bh_eCOMP_BusBarCurrent_C DFC_CtlMsk2.DFC_ComInvld_47Bh_eCOMP_BusBarVoltage_C DFC_CtlMsk2.DFC_ComInvld_47Bh_eCOMP_CompressorSpeed_C DFC_CtlMsk2.DFC_ComInvld_47Bh_eCOMP_IGBT_Temp_C DFC_CtlMsk2.DFC_ComInvld_47Bh_eCOMP_PeakPhaCurrent_C DFC_CtlMsk2.DFC_ComInvld_47Bh_eCOMP_Power_consumption_C DFC_CtlMsk2.DFC_ComInvld_4F2h_STATUS_SOC_C DFC_CtlMsk2.DFC_ComInvld_4F2h_TEMP_BATT_STATUS_C DFC_CtlMsk2.DFC_ComInvld_4F2h_VALEUR_SOC_ETENDUE_C DFC_CtlMsk2.DFC_ComInvld_535h_HV_BATT_TEMP_AVG_C DFC_CtlMsk2.DFC_ComInvld_543h_HVBAT_RESTBATTENERGY_C DFC_CtlMsk2.DFC_ComInvld_543h_HVBAT_SOH_C DFC_CtlMsk2.DFC_ComInvld_543h_HV_BATT_SOH_RES_C DFC_CtlMsk2.DFC_ComInvld_552h_CPT_TEMPOREL_C DFC_CtlMsk2.DFC_ComInvld_552h_KILOMETRAGE_C DFC_CtlMsk2.DFC_ComInvld_583h_HV_BATT_DISCONT_CSE_OPEN_C DFC_CtlMsk2.DFC_ComInvld_592h_CALIBRE_IBATT_C DFC_CtlMsk2.DFC_ComInvld_592h_IBATT_1_C DFC_CtlMsk2.DFC_ComInvld_592h_IBATT_2_C DFC_CtlMsk2.DFC_ComInvld_592h_IBATT_3_C DFC_CtlMsk2.DFC_ComInvld_592h_TEMP_BATT_C DFC_CtlMsk2.DFC_ComInvld_592h_U_BATT_BECB_C DFC_CtlMsk2.DFC_ComInvld_595h_HVBAT_TIME_TO_CHRG_80_C DFC_CtlMsk2.DFC_ComInvld_5B2h_TEMP_AIR_EXT_C DFC_CtlMsk2.DFC_ComInvld_5B5h_HVBAT_THERMAL_RUNAWAY_C DFC_CtlMsk2.DFC_ComInvld_635h_HVBAT_NEG_CONT_COUNT_SEG1_C DFC_CtlMsk2.DFC_ComInvld_635h_HVBAT_NEG_CONT_COUNT_SEG3_C DFC_CtlMsk2.DFC_ComInvld_635h_HVBAT_NEG_CONT_COUNT_SEG4_C DFC_CtlMsk2.DFC_ComInvld_635h_HVBAT_PST_CONT_COUNT_SEG1_C DFC_CtlMsk2.DFC_ComInvld_635h_HVBAT_PST_CONT_COUNT_SEG3_C DFC_CtlMsk2.DFC_ComInvld_635h_HVBAT_PST_CONT_COUNT_SEG4_C DFC_CtlMsk2.DFC_ComInvld_645h_HVBAT_PRECHRGE_CONT_COUNT_SEG1_C DFC_CtlMsk2.DFC_ComInvld_645h_HVBAT_PRECHRGE_CONT_COUNT_SEG2_C DFC_CtlMsk2.DFC_ComInvld_675h_HVBAT_REMAININGBATTCAPACITY_C DFC_CtlMsk2.DFC_ACCmprFltLvl1_C DFC_CtlMsk2.DFC_ACCmprFltLvl2_C DFC_CtlMsk2.DFC_ACCmprFltLvl3_C DFC_CtlMsk2.DFC_ACCmprFltLvl4_C DFC_CtlMsk2.DFC_ACCmprHiPFlt_C DFC_CtlMsk2.DFC_ACCmprInvldCmprSt_C DFC_CtlMsk2.DFC_ACCmprInvldElecActPwr_C DFC_CtlMsk2.DFC_ACCmprLoPFlt_C DFC_CtlMsk2.DFC_AcChrgrIntkTSRCMin_C DFC_CtlMsk2.DFC_BattUBMaxBatt_C DFC_CtlMsk2.DFC_BattUBMaxNoBatt_C DFC_CtlMsk2.DFC_BattUBMinBatt_C DFC_CtlMsk2.DFC_BattUBMinNoBatt_C DFC_CtlMsk2.DFC_BattUSRCMax_C DFC_CtlMsk2.DFC_BattUSRCMin_C DFC_CtlMsk2.DFC_BrkBstPHiCautionDfct_C DFC_CtlMsk2.DFC_BrkBstPHiWarnDfct_C DFC_CtlMsk2.DFC_BrkBstPSnsr12PlausDfct_C DFC_CtlMsk2.DFC_BrkBstPSnsr1Scb_C DFC_CtlMsk2.DFC_BrkBstPSnsr1Scg_C DFC_CtlMsk2.DFC_BrkBstPSnsr2Scb_C DFC_CtlMsk2.DFC_BrkBstPSnsr2Scg_C DFC_CtlMsk2.DFC_BrkBstPSnsrMax_C DFC_CtlMsk2.DFC_BrkBstPSnsrMin_C DFC_CtlMsk2.DFC_BrkBstPhyRngChkMax_C DFC_CtlMsk2.DFC_BrkBstPhyRngChkMin_C DFC_CtlMsk2.DFC_BrkBstPmpHsScb_C DFC_CtlMsk2.DFC_BrkBstPmpHsScg_C DFC_CtlMsk2.DFC_BrkBstPmpLsOl_C DFC_CtlMsk2.DFC_BrkBstPmpLsScb_C DFC_CtlMsk2.DFC_BrkBstPmpLsScg_C DFC_CtlMsk2.DFC_CbnHeatgHeatrRlyOpend_C DFC_CtlMsk2.DFC_CbnHeatgHeatrRlyWldd_C DFC_CtlMsk2.DFC_CcsDcIBattExcdd_C DFC_CtlMsk2.DFC_CcsDcIEvseOutDe_C DFC_CtlMsk2.DFC_CcsDcIOutDe_C DFC_CtlMsk2.DFC_CcsDcIOutExcdd_C DFC_CtlMsk2.DFC_CcsDcUOutDe_C DFC_CtlMsk2.DFC_CcsDcUOutExcdd_C DFC_CtlMsk2.DFC_CcsPwrLineChpRstOL_C DFC_CtlMsk2.DFC_CcsPwrLineChpRstOvrTemp_C DFC_CtlMsk2.DFC_CcsPwrLineChpRstSCB_C DFC_CtlMsk2.DFC_CcsPwrLineChpRstSCG_C DFC_CtlMsk2.DFC_CcsPwrLineChpVccEnaOL_C DFC_CtlMsk2.DFC_CcsPwrLineChpVccEnaOvrTemp_C DFC_CtlMsk2.DFC_CcsPwrLineChpVccEnaSCB_C DFC_CtlMsk2.DFC_CcsPwrLineChpVccEnaSCG_C DFC_CtlMsk2.DFC_CcsPwrLineChpVccSRCMin_C DFC_CtlMsk2.DFC_CcsPwrLineComChpTSRCMin_C DFC_CtlMsk2.DFC_CtPSwtActrOL_C DFC_CtlMsk2.DFC_CtPSwtActrOvrTemp_C DFC_CtlMsk2.DFC_CtPSwtActrSCB_C DFC_CtlMsk2.DFC_CtPSwtActrSCG_C DFC_CtlMsk2.DFC_CtPSwtDiagSRCMin_C DFC_CtlMsk2.DFC_CtpCarrFrqSRCMin_C DFC_CtlMsk2.DFC_DcChrgrIntkT2SRCMin_C DFC_CtlMsk2.DFC_DcChrgrIntkTSRCMin_C DFC_CtlMsk2.DFC_DevLibBattUHi_C DFC_CtlMsk2.DFC_DevLibBattULo_C DFC_CtlMsk2.DFC_EmWakeupSigOL_C DFC_CtlMsk2.DFC_EmWakeupSigOvrTemp_C DFC_CtlMsk2.DFC_EmWakeupSigSCB_C DFC_CtlMsk2.DFC_EmWakeupSigSCG_C DFC_CtlMsk2.DFC_Fan1OL_C DFC_CtlMsk2.DFC_Fan1OvrTemp_C DFC_CtlMsk2.DFC_Fan1SCB_C DFC_CtlMsk2.DFC_FanRlySCB_C DFC_CtlMsk2.DFC_FanRlySCG_C DFC_CtlMsk2.DFC_FanSpdSRCMin_C DFC_CtlMsk2.DFC_FreonPSRCMin_C DFC_CtlMsk2.DFC_HLCCcsPLnCChipTHi_C DFC_CtlMsk2.DFC_HeatrCoreTSRCMin_C DFC_CtlMsk2.DFC_PwmCtPSRCMin_C DFC_CtlMsk2.DFC_PwrDistbnUnitTSRCMin_C DFC_CtlMsk2.DFC_SCtPmp1OL_C DFC_CtlMsk2.DFC_SCtPmp1OvrTemp_C DFC_CtlMsk2.DFC_SCtPmp1SCB_C DFC_CtlMsk2.DFC_SCtPmpRlyOL_C DFC_CtlMsk2.DFC_SCtPmpRlyOvrTemp_C DFC_CtlMsk2.DFC_SCtPmpRlySCB_C DFC_CtlMsk2.DFC_SpplCooltPmpRlyOL_C DFC_CtlMsk2.DFC_SpplCooltPmpRlyOvrTemp_C DFC_CtlMsk2.DFC_SpplCooltPmpRlySCB_C DFC_CtlMsk2.DFC_UCtPSRCMin_C DFC_CtlMsk2.DFC_UPxP1SRCMin_C DFC_CtlMsk2.DFC_ComHSN1CANMute_C DFC_CtlMsk2.DFC_ComHSN3CANMute_C DFC_CtlMsk2.DFC_AcChrgrIntkTPhysRngHi_C DFC_CtlMsk2.DFC_AcChrgrIntkTPhysRngLo_C DFC_CtlMsk2.DFC_AcChrgrIntkTSRCOpn_C DFC_CtlMsk2.DFC_CcsPwrLineChpVccPhysRngHi_C DFC_CtlMsk2.DFC_CcsPwrLineChpVccPhysRngLo_C DFC_CtlMsk2.DFC_CcsPwrLineChpVccSRCOpn_C DFC_CtlMsk2.DFC_CcsPwrLineComChpTPhysRngHi_C DFC_CtlMsk2.DFC_CcsPwrLineComChpTPhysRngLo_C DFC_CtlMsk2.DFC_CcsPwrLineComChpTSRCOpn_C DFC_CtlMsk2.DFC_CtPSwtDiagPhysRngHi_C DFC_CtlMsk2.DFC_CtPSwtDiagPhysRngLo_C DFC_CtlMsk2.DFC_CtPSwtDiagSRCOpn_C DFC_CtlMsk2.DFC_CtpCarrFrqPhysRngHi_C DFC_CtlMsk2.DFC_CtpCarrFrqPhysRngLo_C DFC_CtlMsk2.DFC_CtpCarrFrqSRCMax_C DFC_CtlMsk2.DFC_DcChrgrIntkT2PhysRngHi_C DFC_CtlMsk2.DFC_DcChrgrIntkT2PhysRngLo_C DFC_CtlMsk2.DFC_DcChrgrIntkT2SRCOpn_C DFC_CtlMsk2.DFC_DcChrgrIntkTPhysRngHi_C DFC_CtlMsk2.DFC_DcChrgrIntkTPhysRngLo_C DFC_CtlMsk2.DFC_DcChrgrIntkTSRCOpn_C DFC_CtlMsk2.DFC_Fan1SCG_C DFC_CtlMsk2.DFC_FanSpdPhysRngHi_C DFC_CtlMsk2.DFC_FanSpdPhysRngLo_C DFC_CtlMsk2.DFC_FanSpdSRCOpn_C DFC_CtlMsk2.DFC_FreonPPhysRngHi_C DFC_CtlMsk2.DFC_FreonPPhysRngLo_C DFC_CtlMsk2.DFC_FreonPSRCOpn_C DFC_CtlMsk2.DFC_HeatrCoreTPhysRngHi_C DFC_CtlMsk2.DFC_HeatrCoreTPhysRngLo_C DFC_CtlMsk2.DFC_HeatrCoreTSRCOpn_C DFC_CtlMsk2.DFC_HvGridUMaxSftyLim_C DFC_CtlMsk2.DFC_HvGridUMinSftyLim_C DFC_CtlMsk2.DFC_HvGridUPlausy_C DFC_CtlMsk2.DFC_IntlckChrgPlgHBrgOpnLd_C DFC_CtlMsk2.DFC_IntlckChrgPlgHBrgOvrCurr_C DFC_CtlMsk2.DFC_IntlckChrgPlgHBrgOvrTemp_C DFC_CtlMsk2.DFC_IntlckChrgPlgHBrgShCirBatt1_C DFC_CtlMsk2.DFC_IntlckChrgPlgHBrgShCirBatt2_C DFC_CtlMsk2.DFC_IntlckChrgPlgHBrgShCirGnd1_C DFC_CtlMsk2.DFC_IntlckChrgPlgHBrgShCirGnd2_C DFC_CtlMsk2.DFC_IntlckChrgPlgHBrgShCirOvrLd_C DFC_CtlMsk2.DFC_IntlckChrgPlgHBrgTempOvrCurr_C DFC_CtlMsk2.DFC_IntlckChrgPlgHBrgUndrVltg_C DFC_CtlMsk2.DFC_IntlckChrgPlgPosnRngFlt_C DFC_CtlMsk2.DFC_IntlckChrgPlgPosnSrcMax_C DFC_CtlMsk2.DFC_IntlckChrgPlgPosnSrcMin_C DFC_CtlMsk2.DFC_PwmCtPPhysRngHi_C DFC_CtlMsk2.DFC_PwmCtPPhysRngLo_C DFC_CtlMsk2.DFC_PwmCtPSRCMax_C DFC_CtlMsk2.DFC_PwrDistbnUnitTPhysRngHi_C DFC_CtlMsk2.DFC_PwrDistbnUnitTPhysRngLo_C DFC_CtlMsk2.DFC_PwrDistbnUnitTSRCOpn_C DFC_CtlMsk2.DFC_SCtPmpRlySCG_C DFC_CtlMsk2.DFC_SpplCooltPmpRlySCG_C DFC_CtlMsk2.DFC_UCtPPhysRngHi_C DFC_CtlMsk2.DFC_UCtPPhysRngLo_C DFC_CtlMsk2.DFC_UCtPSRCOpn_C DFC_CtlMsk2.DFC_UPxP1PhysRngHi_C DFC_CtlMsk2.DFC_UPxP1PhysRngLo_C DFC_CtlMsk2.DFC_UPxP1SRCOpn_C DFC_CtlMsk2.DFC_VehVPhysRngHi_C DFC_CtlMsk2.DFC_VehVPhysRngLo_C DFC_CtlMsk2.DFC_VehVSigCan_C DFC_CtlMsk2.DFC_VehVSigCanSafe_C DFC_CtlMsk2.DFC_SCtPmp1DiagGrdKey1_C DFC_CtlMsk2.DFC_SCtPmp1DiagGrdKey2_C DFC_CtlMsk2.DFC_SCtPmp1DiagGrdKey3_C DFC_CtlMsk2.DFC_SCtPmp1DiagGrdKey4_C DFC_CtlMsk2.DFC_SCtPmp1DiagGrdKey5_C DFC_CtlMsk2.DFC_ChrgPlgLiveCntctHzrdCcs_C DFC_CtlMsk2.DFC_ChrgPlgProxPltImps_C DFC_CtlMsk2.DFC_ChrgPlgTHiCcsDc_C DFC_CtlMsk2.DFC_ElMActvDchaFailr_C DFC_CtlMsk2.DFC_ElMActvDchaFlt_C DFC_CtlMsk2.DFC_ElMFbdnIvtrModDrv01_C DFC_CtlMsk2.DFC_ElMImobAuthent_C DFC_CtlMsk2.DFC_ElMIsoMonFlt_C DFC_CtlMsk2.DFC_ElMIsoMonPlausyFlt_C DFC_CtlMsk2.DFC_ElMIvtrCooltT01_C DFC_CtlMsk2.DFC_ElMIvtrEmgyShtDwn01_C DFC_CtlMsk2.DFC_ElMIvtrFailr01_C DFC_CtlMsk2.DFC_ElMIvtrIntlck01_C DFC_CtlMsk2.DFC_ElMIvtrTErr01_C DFC_CtlMsk2.DFC_ElMOverSpdNeg01_C DFC_CtlMsk2.DFC_ElMOverSpdPos01_C DFC_CtlMsk2.DFC_ElMOverTqNeg01_C DFC_CtlMsk2.DFC_ElMOverTqPos01_C DFC_CtlMsk2.DFC_ElMPwrAuthn_C DFC_CtlMsk2.DFC_ElMSpdErr01_C DFC_CtlMsk2.DFC_ElMSvs01_C DFC_CtlMsk2.DFC_PEnvCcMax_C DFC_CtlMsk2.DFC_PEnvCcMin_C DFC_CtlMsk2.DFC_PEnvRngChkMax_C DFC_CtlMsk2.DFC_PEnvRngChkMin_C DFC_CtlMsk2.DFC_PEnvSnsrPlaus_C DFC_CtlMsk2.DFC_BrkBstPmpPlausGenn_C DFC_CtlMsk2.DFC_CbnHeatrRlyLfLoWarn_C DFC_CtlMsk2.DFC_ChgrPlugLockPinByndClsd_C DFC_CtlMsk2.DFC_ChgrPlugLockPinMoveWoCmd_C DFC_CtlMsk2.DFC_ChgrPlugLockPinStuckInClsd_C DFC_CtlMsk2.DFC_ChgrPlugLockPinStuckInOpen_C DFC_CtlMsk2.DFC_ChrgrStErr_C DFC_CtlMsk2.DFC_ComHSN1BusOff_C DFC_CtlMsk2.DFC_ComHSN3BusOff_C DFC_CtlMsk2.DFC_ComVCInval_C DFC_CtlMsk2.DFC_EemDcdcPrecSpdInhb_C DFC_CtlMsk2.DFC_ExpPwrLatch_C DFC_CtlMsk2.DFC_FanMaxOvrd_C DFC_CtlMsk2.DFC_HLCCcsGnrlComErr_C DFC_CtlMsk2.DFC_InmLINNodeHVACPanelAbsnt_C DFC_CtlMsk2.DFC_ResetRcvNotAllwd_C DFC_CtlMsk2.DFC_TelltlCooltPlaus_C DFC_CtlMsk2.DFC_MRlyOL_C DFC_CtlMsk2.DFC_MRlySCB_C DFC_CtlMsk2.DFC_MRlySCG_C DFC_CtlMsk2.DFC_SSpMon1_C DFC_CtlMsk2.DFC_SSpMon1OV_C DFC_CtlMsk2.DFC_SSpMon1SCG_C DFC_CtlMsk2.DFC_SSpMon1UV_C DFC_CtlMsk2.DFC_SSpMon2_C DFC_CtlMsk2.DFC_SSpMon2OV_C DFC_CtlMsk2.DFC_SSpMon2SCG_C DFC_CtlMsk2.DFC_SSpMon2UV_C DFC_CtlMsk2.DFC_SSpMon3_C DFC_CtlMsk2.DFC_SSpMon3OV_C DFC_CtlMsk2.DFC_SSpMon3SCG_C DFC_CtlMsk2.DFC_SSpMon3UV_C DFC_CtlMsk2.DFC_CANTRCV_E_NO_TRCV_CONTROL_0_C DFC_CtlMsk2.DFC_CAN_E_TIMEOUT_C DFC_CtlMsk2.DFC_COMM_E_NET_START_IND_CHANNEL_3_C DFC_CtlMsk2.DFC_COMM_E_NET_START_IND_CHANNEL_4_C DFC_CtlMsk2.DFC_COMM_E_NET_START_IND_CHANNEL_5_C DFC_CtlMsk2.DFC_rba_EcuCtrl_TOMaxProlg_C DFC_CtlMsk2.DFC_rba_EcuCtrl_TOMaxShutDwn_C DFC_CtlMsk2.DFC_rba_MultiStackTrace_Threshold_C DFC_CtlMsk2.DFC_RBA_IOEXTLIB_KEEPALIVE_DRV_C DFC_CtlMsk2.DFC_RBA_IOEXTLIB_KEEPALIVE_INI_C DFC_CtlMsk2.DFC_rba_IoSigRtc_StopCounter_C DFC_CtlMsk2.DFC_rba_MRly_Diag_Stk_Event_C DFC_CtlMsk2.DFC_rba_MemDiag_MemReadErr_C DFC_CtlMsk2.DFC_rba_MemDiag_MemWrErr_C DFC_CtlMsk2.DFC_rba_SyC_IrrSwOffTrigEngRun_Event_C DFC_CtlMsk2.DFC_AcChrgrIntkTSRCMax_C DFC_CtlMsk2.DFC_AcChrgrIntkTTmpErr_C DFC_CtlMsk2.DFC_AcFlt_C DFC_CtlMsk2.DFC_AppAllSnsrDfct_C DFC_CtlMsk2.DFC_BattUPwrFail_C DFC_CtlMsk2.DFC_BrkBstBkupOvrn_C DFC_CtlMsk2.DFC_BrkBstPmpOvld_C DFC_CtlMsk2.DFC_BrkPlausChk_C DFC_CtlMsk2.DFC_CbnHeatgSwtTmpErr_C DFC_CtlMsk2.DFC_CcsPwrLineChpVccSRCMax_C DFC_CtlMsk2.DFC_CcsPwrLineChpVccTmpErr_C DFC_CtlMsk2.DFC_CcsPwrLineComChpTSRCMax_C DFC_CtlMsk2.DFC_CcsPwrLineComChpTTmpErr_C DFC_CtlMsk2.DFC_ChgrPlugCtpCarrFrqErr_C DFC_CtlMsk2.DFC_ChgrPlugCtpSwtStuckClsd_C DFC_CtlMsk2.DFC_ChgrPlugCtpSwtStuckOpen_C DFC_CtlMsk2.DFC_ChgrPlugCtpUErrHi_C DFC_CtlMsk2.DFC_ChgrPlugPxp1SrcErr_C DFC_CtlMsk2.DFC_ChrgCntctAllWldd_C DFC_CtlMsk2.DFC_ChrgCntctNegOperErr_C DFC_CtlMsk2.DFC_ChrgCntctNegOperWarn_C DFC_CtlMsk2.DFC_ChrgCntctNegWldd_C DFC_CtlMsk2.DFC_ChrgCntctPosOperErr_C DFC_CtlMsk2.DFC_ChrgCntctPosOperWarn_C DFC_CtlMsk2.DFC_ChrgCntctPosWldd_C DFC_CtlMsk2.DFC_ChrgCntctStuckOpen_C DFC_CtlMsk2.DFC_ChrgPlgIntlckFaild_C DFC_CtlMsk2.DFC_ChrgnUnplRqrd_C DFC_CtlMsk2.DFC_CoElMOffsCalibActv01_C DFC_CtlMsk2.DFC_CtPSwtDiagSRCMax_C DFC_CtlMsk2.DFC_CtPSwtDiagTmpErr_C DFC_CtlMsk2.DFC_CtpCarrFrqTmpErr_C DFC_CtlMsk2.DFC_DcChrgrIntkT2SRCMax_C DFC_CtlMsk2.DFC_DcChrgrIntkT2TmpErr_C DFC_CtlMsk2.DFC_DcChrgrIntkTSRCMax_C DFC_CtlMsk2.DFC_DcChrgrIntkTTmpErr_C DFC_CtlMsk2.DFC_EChrDvPlinCntrThdExcdd_C DFC_CtlMsk2.DFC_EemDiagCtctrClsTout_C DFC_CtlMsk2.DFC_EemDiagDcdcOffTOut_C DFC_CtlMsk2.DFC_EemDiagHvCnsrOffTOut_C DFC_CtlMsk2.DFC_EemDiagHvbOffTOut_C DFC_CtlMsk2.DFC_FanSpdSRCMax_C DFC_CtlMsk2.DFC_FanSpdTmpErr_C DFC_CtlMsk2.DFC_FreonPSRCMax_C DFC_CtlMsk2.DFC_FreonPTmpErr_C DFC_CtlMsk2.DFC_HeatrCoreTSRCMax_C DFC_CtlMsk2.DFC_HeatrCoreTTmpErr_C DFC_CtlMsk2.DFC_HvGridSocMinLim_C DFC_CtlMsk2.DFC_HvacBlwrFrntFlt_C DFC_CtlMsk2.DFC_HvacEvapElecFlt_C DFC_CtlMsk2.DFC_HvacEvapElecFltGnd_C DFC_CtlMsk2.DFC_HvacKnobPosnFlt_C DFC_CtlMsk2.DFC_InvBinID_C DFC_CtlMsk2.DFC_InvCalID_C DFC_CtlMsk2.DFC_InvErotan_C DFC_CtlMsk2.DFC_InvVinID_C DFC_CtlMsk2.DFC_MOXEMM_SMU_ALM0_0_C DFC_CtlMsk2.DFC_MOXEMM_SMU_ALM0_1_C DFC_CtlMsk2.DFC_MOXEMM_SMU_ALM0_10_C DFC_CtlMsk2.DFC_MOXEMM_SMU_ALM0_11_C DFC_CtlMsk2.DFC_MOXEMM_SMU_ALM0_13_C DFC_CtlMsk2.DFC_MOXEMM_SMU_ALM0_14_C DFC_CtlMsk2.DFC_MOXEMM_SMU_ALM0_2_C DFC_CtlMsk2.DFC_MOXEMM_SMU_ALM0_22_C DFC_CtlMsk2.DFC_MOXEMM_SMU_ALM0_23_C DFC_CtlMsk2.DFC_MOXEMM_SMU_ALM0_4_C DFC_CtlMsk2.DFC_MOXEMM_SMU_ALM0_5_C DFC_CtlMsk2.DFC_MOXEMM_SMU_ALM0_7_C DFC_CtlMsk2.DFC_MOXEMM_SMU_ALM0_8_C DFC_CtlMsk2.DFC_MOXEMM_SMU_ALM10_16_C DFC_CtlMsk2.DFC_MOXEMM_SMU_ALM10_17_C DFC_CtlMsk2.DFC_MOXEMM_SMU_ALM10_21_C DFC_CtlMsk2.DFC_MOXEMM_SMU_ALM11_0_C DFC_CtlMsk2.DFC_MOXEMM_SMU_ALM11_1_C DFC_CtlMsk2.DFC_MOXEMM_SMU_ALM11_2_C DFC_CtlMsk2.DFC_MOXEMM_SMU_ALM11_3_C DFC_CtlMsk2.DFC_MOXEMM_SMU_ALM11_4_C DFC_CtlMsk2.DFC_MOXEMM_SMU_ALM11_5_C DFC_CtlMsk2.DFC_MOXEMM_SMU_ALM11_8_C DFC_CtlMsk2.DFC_MOXEMM_SMU_ALM11_9_C DFC_CtlMsk2.DFC_MOXEMM_SMU_ALM1_0_C DFC_CtlMsk2.DFC_MOXEMM_SMU_ALM1_1_C DFC_CtlMsk2.DFC_MOXEMM_SMU_ALM1_10_C DFC_CtlMsk2.DFC_MOXEMM_SMU_ALM1_11_C DFC_CtlMsk2.DFC_MOXEMM_SMU_ALM1_13_C DFC_CtlMsk2.DFC_MOXEMM_SMU_ALM1_14_C DFC_CtlMsk2.DFC_MOXEMM_SMU_ALM1_2_C DFC_CtlMsk2.DFC_MOXEMM_SMU_ALM1_22_C DFC_CtlMsk2.DFC_MOXEMM_SMU_ALM1_23_C DFC_CtlMsk2.DFC_MOXEMM_SMU_ALM1_4_C DFC_CtlMsk2.DFC_MOXEMM_SMU_ALM1_5_C DFC_CtlMsk2.DFC_MOXEMM_SMU_ALM1_7_C DFC_CtlMsk2.DFC_MOXEMM_SMU_ALM1_8_C DFC_CtlMsk2.DFC_MOXEMM_SMU_ALM21_0_C DFC_CtlMsk2.DFC_MOXEMM_SMU_ALM21_16_C DFC_CtlMsk2.DFC_MOXEMM_SMU_ALM21_3_C DFC_CtlMsk2.DFC_MOXEMM_SMU_ALM2_1_C DFC_CtlMsk2.DFC_MOXEMM_SMU_ALM2_10_C DFC_CtlMsk2.DFC_MOXEMM_SMU_ALM2_11_C DFC_CtlMsk2.DFC_MOXEMM_SMU_ALM2_13_C DFC_CtlMsk2.DFC_MOXEMM_SMU_ALM2_14_C DFC_CtlMsk2.DFC_MOXEMM_SMU_ALM2_22_C DFC_CtlMsk2.DFC_MOXEMM_SMU_ALM2_23_C DFC_CtlMsk2.DFC_MOXEMM_SMU_ALM2_4_C DFC_CtlMsk2.DFC_MOXEMM_SMU_ALM2_5_C DFC_CtlMsk2.DFC_MOXEMM_SMU_ALM2_7_C DFC_CtlMsk2.DFC_MOXEMM_SMU_ALM2_8_C DFC_CtlMsk2.DFC_MOXEMM_SMU_ALM6_0_C DFC_CtlMsk2.DFC_MOXEMM_SMU_ALM6_11_C DFC_CtlMsk2.DFC_MOXEMM_SMU_ALM6_12_C DFC_CtlMsk2.DFC_MOXEMM_SMU_ALM6_14_C DFC_CtlMsk2.DFC_MOXEMM_SMU_ALM6_15_C DFC_CtlMsk2.DFC_MOXEMM_SMU_ALM6_17_C DFC_CtlMsk2.DFC_MOXEMM_SMU_ALM6_18_C DFC_CtlMsk2.DFC_MOXEMM_SMU_ALM6_20_C DFC_CtlMsk2.DFC_MOXEMM_SMU_ALM6_21_C DFC_CtlMsk2.DFC_MOXEMM_SMU_ALM6_25_C DFC_CtlMsk2.DFC_MOXEMM_SMU_ALM6_4_C DFC_CtlMsk2.DFC_MOXEMM_SMU_ALM6_5_C DFC_CtlMsk2.DFC_MOXEMM_SMU_ALM6_7_C DFC_CtlMsk2.DFC_MOXEMM_SMU_ALM6_8_C DFC_CtlMsk2.DFC_MOXEMM_SMU_ALM7_1_C DFC_CtlMsk2.DFC_MOXEMM_SMU_ALM7_12_C DFC_CtlMsk2.DFC_MOXEMM_SMU_ALM7_13_C DFC_CtlMsk2.DFC_MOXEMM_SMU_ALM7_14_C DFC_CtlMsk2.DFC_MOXEMM_SMU_ALM7_15_C DFC_CtlMsk2.DFC_MOXEMM_SMU_ALM7_16_C DFC_CtlMsk2.DFC_MOXEMM_SMU_ALM7_17_C DFC_CtlMsk2.DFC_MOXEMM_SMU_ALM7_2_C DFC_CtlMsk2.DFC_MOXEMM_SMU_ALM7_20_C DFC_CtlMsk2.DFC_MOXEMM_SMU_ALM7_25_C DFC_CtlMsk2.DFC_MOXEMM_SMU_ALM7_26_C DFC_CtlMsk2.DFC_MOXEMM_SMU_ALM7_28_C DFC_CtlMsk2.DFC_MOXEMM_SMU_ALM7_29_C DFC_CtlMsk2.DFC_MOXEMM_SMU_ALM7_30_C DFC_CtlMsk2.DFC_MOXEMM_SMU_ALM7_31_C DFC_CtlMsk2.DFC_MOXEMM_SMU_ALM8_0_C DFC_CtlMsk2.DFC_MOXEMM_SMU_ALM8_1_C DFC_CtlMsk2.DFC_MOXEMM_SMU_ALM8_10_C DFC_CtlMsk2.DFC_MOXEMM_SMU_ALM8_11_C DFC_CtlMsk2.DFC_MOXEMM_SMU_ALM8_12_C DFC_CtlMsk2.DFC_MOXEMM_SMU_ALM8_16_C DFC_CtlMsk2.DFC_MOXEMM_SMU_ALM8_18_C DFC_CtlMsk2.DFC_MOXEMM_SMU_ALM8_2_C DFC_CtlMsk2.DFC_MOXEMM_SMU_ALM8_3_C DFC_CtlMsk2.DFC_MOXEMM_SMU_ALM8_31_C DFC_CtlMsk2.DFC_MOXEMM_SMU_ALM8_4_C DFC_CtlMsk2.DFC_MOXEMM_SMU_ALM9_0_C DFC_CtlMsk2.DFC_MOXEMM_SMU_ALM9_15_C DFC_CtlMsk2.DFC_MOXEMM_SMU_ALM9_3_C DFC_CtlMsk2.DFC_MoCADCNTPBnk1_C DFC_CtlMsk2.DFC_MoCADCTestVoltBnk1_C DFC_CtlMsk2.DFC_MoCSOPICO_C DFC_CtlMsk2.DFC_MoFAccr_C DFC_CtlMsk2.DFC_MoFCbnPreCdngOvrheat_C DFC_CtlMsk2.DFC_MoFCbnPreCdngTmrExpi_C DFC_CtlMsk2.DFC_MoFEvMngtBms_C DFC_CtlMsk2.DFC_MoFEvMngtDcdc_C DFC_CtlMsk2.DFC_MoFEvMngtEm01_C DFC_CtlMsk2.DFC_MoFEvMngtEm01BrkgToZr_C DFC_CtlMsk2.DFC_MoFEvMngtEm01EngSpd_C DFC_CtlMsk2.DFC_MoFEvMngtEm02EngSpd_C DFC_CtlMsk2.DFC_MoFEvMngtEm02Lvl1_C DFC_CtlMsk2.DFC_MoFEvMngtEm02Lvl2_C DFC_CtlMsk2.DFC_MoFExtCptAuxCpt_C DFC_CtlMsk2.DFC_MoFExtCptVacPmpErr_C DFC_CtlMsk2.DFC_MoFTqPtdAxle_C DFC_CtlMsk2.DFC_MoFTqPtdAxleSec_C DFC_CtlMsk2.DFC_MoFTqPtdEmPtRels_C DFC_CtlMsk2.DFC_MoFTqPtdEmPtRelsSec_C DFC_CtlMsk2.DFC_MoFTqPtdEmSign_C DFC_CtlMsk2.DFC_MoFTqPtdEmSignSec_C DFC_CtlMsk2.DFC_MoFTqPtdEmTq_C DFC_CtlMsk2.DFC_MoFTqPtdEmTqSec_C DFC_CtlMsk2.DFC_MoFTqPtdVeh_C DFC_CtlMsk2.DFC_MoFVarPostBldSel_C DFC_CtlMsk2.DFC_MoSysCtrlReIni_C DFC_CtlMsk2.DFC_MoXEMMHwLTMCUFW_C DFC_CtlMsk2.DFC_MoXEMMHwLTMonBIST_C DFC_CtlMsk2.DFC_MoXEMMHwLTRegMonTest_C DFC_CtlMsk2.DFC_MoXEMMHwLTStbySMUAlvTest_C DFC_CtlMsk2.DFC_MoXEMMHwLTTempSens_C DFC_CtlMsk2.DFC_MoXEMMHwLTUCBCfg_C DFC_CtlMsk2.DFC_MonEgyChrgnCoorr_AcChrgnWoMofRels_C DFC_CtlMsk2.DFC_MonEgyChrgnCoorr_ChrgnAbortIgr_C DFC_CtlMsk2.DFC_MonEgyChrgnCoorr_DcCntctFailr_C DFC_CtlMsk2.DFC_MonEgyChrgnCoorr_ExtChrgnShtOffReq_C DFC_CtlMsk2.DFC_MonEgyChrgnCoorr_ImpsChrgnMod_C DFC_CtlMsk2.DFC_MonEgyChrgnCoorr_ImpsChrgnPrms_C DFC_CtlMsk2.DFC_MonEgyChrgnCoorr_ImpsUDcIntk_C DFC_CtlMsk2.DFC_MonEgyChrgnCoorr_PlgLockMovmt_C DFC_CtlMsk2.DFC_MonEgyChrgnCoorr_VehCrashDetn_C DFC_CtlMsk2.DFC_MonEgyChrgnErrReactn_SftySwt_C DFC_CtlMsk2.DFC_MonEgyChrgnInlet_CcsPlgCtp_C DFC_CtlMsk2.DFC_MonEgyChrgnInlet_CcsPlgCtpPwm_C DFC_CtlMsk2.DFC_MonEgyChrgnInlet_CcsPlgLockCtrlImpsAtmpt_C DFC_CtlMsk2.DFC_MonEgyChrgnInlet_CcsPlgLockSnsrSigRngChk_C DFC_CtlMsk2.DFC_MonEgyChrgnInlet_CcsPlgLockStImps_C DFC_CtlMsk2.DFC_MonEgyChrgnInlet_CcsPlgPxp_C DFC_CtlMsk2.DFC_MonEgyChrgnT_Snsr1GrdtChk_C DFC_CtlMsk2.DFC_MonEgyChrgnT_Snsr1SigRngChk_C DFC_CtlMsk2.DFC_MonEgyChrgnT_Snsr2GrdtChk_C DFC_CtlMsk2.DFC_MonEgyChrgnT_Snsr2SigRngChk_C DFC_CtlMsk2.DFC_MonEgyChrgnT_SnsrDif_C DFC_CtlMsk2.DFC_OCWDAABEActv_C DFC_CtlMsk2.DFC_OCWDACom_C DFC_CtlMsk2.DFC_OCWDAErrPin_C DFC_CtlMsk2.DFC_OCWDAOvrVltg_C DFC_CtlMsk2.DFC_PUmax_C DFC_CtlMsk2.DFC_PwmCtPTmpErr_C DFC_CtlMsk2.DFC_PwrDistbnUnitTSRCMax_C DFC_CtlMsk2.DFC_PwrDistbnUnitTTmpErr_C DFC_CtlMsk2.DFC_SCtPmp1DiagGrdKeyErr_C DFC_CtlMsk2.DFC_SRCHighAPP1_C DFC_CtlMsk2.DFC_SRCHighAPP2_C DFC_CtlMsk2.DFC_SRCLowAPP1_C DFC_CtlMsk2.DFC_SRCLowAPP2_C DFC_CtlMsk2.DFC_SWReset_0_C DFC_CtlMsk2.DFC_SWReset_1_C DFC_CtlMsk2.DFC_SWReset_2_C DFC_CtlMsk2.DFC_Sia_InvldCode_C DFC_CtlMsk2.DFC_Sia_InvldKey_C DFC_CtlMsk2.DFC_Sia_NoRespUCx_C DFC_CtlMsk2.DFC_Sia_TprotRttp_C DFC_CtlMsk2.DFC_StrtUpEvStandStillDeactvn_C DFC_CtlMsk2.DFC_SyncAPP_C DFC_CtlMsk2.DFC_UCtPSRCMax_C DFC_CtlMsk2.DFC_UCtPTmpErr_C DFC_CtlMsk2.DFC_UPxP1SRCMax_C DFC_CtlMsk2.DFC_UPxP1TmpErr_C DFC_CtlMsk2.DFC_VehVObd_C DFC_DisblMsk2.DFC_ACCmprFltLvlRes_C DFC_DisblMsk2.DFC_AbgHiSigFlt_C DFC_DisblMsk2.DFC_AbgIntPatFlt_C DFC_DisblMsk2.DFC_AbgLoSigFlt_C DFC_DisblMsk2.DFC_AbgUnkwnErrSigFlt_C DFC_DisblMsk2.DFC_AcExtChrgrIBattExcdd_C DFC_DisblMsk2.DFC_AcExtChrgrIInExcdd_C DFC_DisblMsk2.DFC_AcExtChrgrIOutDe_C DFC_DisblMsk2.DFC_AcExtChrgrIOutExcdd_C DFC_DisblMsk2.DFC_AcExtChrgrUOutDe_C DFC_DisblMsk2.DFC_AdpActvDChaFailr_C DFC_DisblMsk2.DFC_AirbcuFlt_C DFC_DisblMsk2.DFC_Airbg_C DFC_DisblMsk2.DFC_AirbgCan_C DFC_DisblMsk2.DFC_AirbgCanHWPlaus_C DFC_DisblMsk2.DFC_AirbgHWCanPlaus_C DFC_DisblMsk2.DFC_AirbgMnr_C DFC_DisblMsk2.DFC_AirbgPerHi_C DFC_DisblMsk2.DFC_AirbgPerdRngFlt_C DFC_DisblMsk2.DFC_BlowrRlyErr_C DFC_DisblMsk2.DFC_BrkBstPmpActtnDfct_C DFC_DisblMsk2.DFC_BrkBstPmpDeactvnDfct_C DFC_DisblMsk2.DFC_BrkSwtFlt_C DFC_DisblMsk2.DFC_CbnHeatgHeatrHsScb_C DFC_DisblMsk2.DFC_CbnHeatgHeatrHsScg_C DFC_DisblMsk2.DFC_CbnHeatgHeatrLsOl_C DFC_DisblMsk2.DFC_CbnHeatgHeatrLsScb_C DFC_DisblMsk2.DFC_CbnHeatgHeatrLsScg_C DFC_DisblMsk2.DFC_CbnHeatgHeatrUnUsed_C DFC_DisblMsk2.DFC_ChrgnCntctHsOt_C DFC_DisblMsk2.DFC_ChrgnCntctHsScb_C DFC_DisblMsk2.DFC_ChrgnCntctHsScg_C DFC_DisblMsk2.DFC_ChrgnCntctLsNegOl_C DFC_DisblMsk2.DFC_ChrgnCntctLsNegOt_C DFC_DisblMsk2.DFC_ChrgnCntctLsNegScb_C DFC_DisblMsk2.DFC_ChrgnCntctLsNegScg_C DFC_DisblMsk2.DFC_ChrgnCntctLsPosOl_C DFC_DisblMsk2.DFC_ChrgnCntctLsPosOt_C DFC_DisblMsk2.DFC_ChrgnCntctLsPosScb_C DFC_DisblMsk2.DFC_ChrgnCntctLsPosScg_C DFC_DisblMsk2.DFC_ChrgnCntctUnUsed_C DFC_DisblMsk2.DFC_ComBrkMai_C DFC_DisblMsk2.DFC_ComChrgrEVCont_C DFC_DisblMsk2.DFC_ComChrgrEVtBlink_C DFC_DisblMsk2.DFC_ComChrgrMstBlink_C DFC_DisblMsk2.DFC_ComChrgrMstCont_C DFC_DisblMsk2.DFC_ComChrgrSVSBlink_C DFC_DisblMsk2.DFC_ComChrgrSVSCont_C DFC_DisblMsk2.DFC_ComDcdcEVBlink_C DFC_DisblMsk2.DFC_ComDcdcEVCont_C DFC_DisblMsk2.DFC_ComDcdcFltLvl2_C DFC_DisblMsk2.DFC_ComDcdcFltLvl3_C DFC_DisblMsk2.DFC_ComDcdcFltLvl4_C DFC_DisblMsk2.DFC_ComDcdcFltLvl5_C DFC_DisblMsk2.DFC_ComDcdcFltLvlRes_C DFC_DisblMsk2.DFC_ComDcdcMstBlink_C DFC_DisblMsk2.DFC_ComDcdcMstCont_C DFC_DisblMsk2.DFC_ComDcdcSVSBlink_C DFC_DisblMsk2.DFC_ComDcdcSVSCont_C DFC_DisblMsk2.DFC_ComElMIIvtrFltLvl2_C DFC_DisblMsk2.DFC_ComElMIIvtrFltLvl3_C DFC_DisblMsk2.DFC_ComElMIIvtrFltLvl4_C DFC_DisblMsk2.DFC_ComElMIIvtrFltLvl5_C DFC_DisblMsk2.DFC_ComElMIIvtrFltLvlRes_C DFC_DisblMsk2.DFC_ComEmacEVBlink_C DFC_DisblMsk2.DFC_ComEmacEVCont_C DFC_DisblMsk2.DFC_ComEmacMstCont_C DFC_DisblMsk2.DFC_ComEmacMsttBlink_C DFC_DisblMsk2.DFC_ComEmacSVSBlink_C DFC_DisblMsk2.DFC_ComEmacSVSCont_C DFC_DisblMsk2.DFC_ComGunCntInfoWkuReq_C DFC_DisblMsk2.DFC_ComHillHldFlt_C DFC_DisblMsk2.DFC_ComHvBattRchrgWkuReq_C DFC_DisblMsk2.DFC_ComHvbFltLvl2_C DFC_DisblMsk2.DFC_ComHvbFltLvl3_C DFC_DisblMsk2.DFC_ComHvbFltLvl4_C DFC_DisblMsk2.DFC_ComHvbFltLvl5_C DFC_DisblMsk2.DFC_ComHvbFltLvlRes_C DFC_DisblMsk2.DFC_ComHvbMstBlink_C DFC_DisblMsk2.DFC_ComHvbMstCont_C DFC_DisblMsk2.DFC_ComImmoUnlockWkuReq_C DFC_DisblMsk2.DFC_ComInfoReqPtlWkuReq_C DFC_DisblMsk2.DFC_ComOBCFltLvl2_C DFC_DisblMsk2.DFC_ComOBCFltLvl3_C DFC_DisblMsk2.DFC_ComOBCFltLvl4_C DFC_DisblMsk2.DFC_ComOBCFltLvl5_C DFC_DisblMsk2.DFC_ComOBCFltLvlRes_C DFC_DisblMsk2.DFC_ComPostOperationWkuReq_C DFC_DisblMsk2.DFC_ComPreCondElecWkuReq_C DFC_DisblMsk2.DFC_ComRemUnlckWkuReq_C DFC_DisblMsk2.DFC_ComStpDlyHMIWkuReq_C DFC_DisblMsk2.DFC_ComflgCurMeasmtErr_C DFC_DisblMsk2.DFC_ComflgCurMeasmtSysErr_C DFC_DisblMsk2.DFC_ComflgCurMeasmtVld_C DFC_DisblMsk2.DFC_ComflgCurRngErr_C DFC_DisblMsk2.DFC_ComflgTPcbMeasmtErr_C DFC_DisblMsk2.DFC_ComflgTPcbMeasmtVld_C DFC_DisblMsk2.DFC_ComflgTPcbRngErr_C DFC_DisblMsk2.DFC_ComflgTPcbSysErr_C DFC_DisblMsk2.DFC_ComflgTShntMeasmtErr_C DFC_DisblMsk2.DFC_ComflgTShntMeasmtVld_C DFC_DisblMsk2.DFC_ComflgTShntRngErr_C DFC_DisblMsk2.DFC_ComflgTShntSysErr_C DFC_DisblMsk2.DFC_ComflgVoltMeasmtErr_C DFC_DisblMsk2.DFC_ComflgVoltMeasmtSysErr_C DFC_DisblMsk2.DFC_ComflgVoltMeasmtVld_C DFC_DisblMsk2.DFC_ComflgVoltRngErr_C DFC_DisblMsk2.DFC_CrashEveOcc_C DFC_DisblMsk2.DFC_DcdcFwdModStuck_C DFC_DisblMsk2.DFC_DcdcLvUDifMaxFlt_C DFC_DisblMsk2.DFC_DcdcOffModStuck_C DFC_DisblMsk2.DFC_DcdcOperModFailr_C DFC_DisblMsk2.DFC_DcdcPrecModStuck_C DFC_DisblMsk2.DFC_DrvDoorOpn_C DFC_DisblMsk2.DFC_DrvModPosnDfct_C DFC_DisblMsk2.DFC_DrvStbltOpn_C DFC_DisblMsk2.DFC_ETogFailrLvl3_C DFC_DisblMsk2.DFC_ETogFailrLvl4_C DFC_DisblMsk2.DFC_EbsLvBattSocDiagLo_C DFC_DisblMsk2.DFC_EbsLvBattUDiagDiOper_C DFC_DisblMsk2.DFC_EbsLvBattUDiagFltLvl1_C DFC_DisblMsk2.DFC_EbsLvBattUDiagFltLvl2_C DFC_DisblMsk2.DFC_EbsLvBattUDiagLo_C DFC_DisblMsk2.DFC_EbsSnsrSt_C DFC_DisblMsk2.DFC_EbsSofASILErr_C DFC_DisblMsk2.DFC_ElTSPtSysLimDrvErr_C DFC_DisblMsk2.DFC_ElTSPtSysLimRgnErr_C DFC_DisblMsk2.DFC_HLCCcsFwDwnl_C DFC_DisblMsk2.DFC_HvBattChrgPwrMax_C DFC_DisblMsk2.DFC_HvBattCrashDetd_C DFC_DisblMsk2.DFC_HvBattDchaPwrMax_C DFC_DisblMsk2.DFC_HvBattEmgyOff_C DFC_DisblMsk2.DFC_HvBattEmgyOffIntlck_C DFC_DisblMsk2.DFC_HvBattEmgyOffReq_C DFC_DisblMsk2.DFC_HvBattFltMod_C DFC_DisblMsk2.DFC_HvBattIReqToChrgrErr_C DFC_DisblMsk2.DFC_HvBattIReqToChrgrIni_C DFC_DisblMsk2.DFC_HvBattIninTout_C DFC_DisblMsk2.DFC_HvBattIntlckSt_C DFC_DisblMsk2.DFC_HvBattIsoFlt_C DFC_DisblMsk2.DFC_HvBattLimdPwr_C DFC_DisblMsk2.DFC_HvBattMaiSwtClsngFlt_C DFC_DisblMsk2.DFC_HvBattMaiSwtFlt_C DFC_DisblMsk2.DFC_HvBattMaiSwtOpen_C DFC_DisblMsk2.DFC_HvBattMaiSwtOpngFlt_C DFC_DisblMsk2.DFC_HvBattMaiSwtWldd_C DFC_DisblMsk2.DFC_HvBattNegCntctrCntErr_C DFC_DisblMsk2.DFC_HvBattOperModChrgPlausy_C DFC_DisblMsk2.DFC_HvBattOverTDern_C DFC_DisblMsk2.DFC_HvBattPosCntctrCntErr_C DFC_DisblMsk2.DFC_HvBattPrecCntctrCntErr_C DFC_DisblMsk2.DFC_HvBattPwrDistbnTDern_C DFC_DisblMsk2.DFC_HvBattPwrDistbnTInhbn_C DFC_DisblMsk2.DFC_HvBattRatRSohErr_C DFC_DisblMsk2.DFC_HvBattRatSohErr_C DFC_DisblMsk2.DFC_HvBattSngIsoWarn_C DFC_DisblMsk2.DFC_HvBattSrvPlgDiscnct_C DFC_DisblMsk2.DFC_HvBattUNomChrgnErr_C DFC_DisblMsk2.DFC_HvBattUNomChrgnIni_C DFC_DisblMsk2.DFC_HvBattUnderTDern_C DFC_DisblMsk2.DFC_HvbEVLmpBlink_C DFC_DisblMsk2.DFC_HvbEVLmpCont_C DFC_DisblMsk2.DFC_HvbSVSBlink_C DFC_DisblMsk2.DFC_HvbSVSCont_C DFC_DisblMsk2.DFC_InmLINBusBlk_C DFC_DisblMsk2.DFC_PDUProgmFailr_C DFC_DisblMsk2.DFC_PEnvSigRngMax_C DFC_DisblMsk2.DFC_PEnvSigRngMin_C DFC_DisblMsk2.DFC_PLnCChpDeactvnFaild_C DFC_DisblMsk2.DFC_PrkgBrkFailr_C DFC_DisblMsk2.DFC_PtSysLimErr_C DFC_DisblMsk2.DFC_PwrMaxDchaShoLo_C DFC_DisblMsk2.DFC_SCtPmp1FailSafeNotSuc_C DFC_DisblMsk2.DFC_SCtPmp1SCG_C DFC_DisblMsk2.DFC_VehCoornDrvrNotPrsnt_C DFC_DisblMsk2.DFC_VehVCanAvl_C DFC_DisblMsk2.DFC_VehVCanErr_C DFC_DisblMsk2.DFC_eTogFailrLvlRes_C DFC_DisblMsk2.DFC_flgBrkMaiDiag_C DFC_DisblMsk2.DFC_stHvbIsoMeasmtRes_C DFC_DisblMsk2.DFC_BrkBstPmpPLeakDfct_C DFC_DisblMsk2.DFC_Com082hTooShort_C DFC_DisblMsk2.DFC_Com092hTooShort_C DFC_DisblMsk2.DFC_Com205hAbsent_C DFC_DisblMsk2.DFC_Com205hChecksum_C DFC_DisblMsk2.DFC_Com205hCounter_C DFC_DisblMsk2.DFC_Com205hTooShort_C DFC_DisblMsk2.DFC_Com217hAbsent_C DFC_DisblMsk2.DFC_Com217hChecksum_C DFC_DisblMsk2.DFC_Com217hCounter_C DFC_DisblMsk2.DFC_Com217hTooShort_C DFC_DisblMsk2.DFC_Com227hAbsent_C DFC_DisblMsk2.DFC_Com227hTooShort_C DFC_DisblMsk2.DFC_Com237hAbsent_C DFC_DisblMsk2.DFC_Com237hChecksum_C DFC_DisblMsk2.DFC_Com237hCounter_C DFC_DisblMsk2.DFC_Com237hTooShort_C DFC_DisblMsk2.DFC_Com259hAbsent_C DFC_DisblMsk2.DFC_Com259hChecksum_C DFC_DisblMsk2.DFC_Com259hCounter_C DFC_DisblMsk2.DFC_Com259hTooShort_C DFC_DisblMsk2.DFC_Com26hAbsent_C DFC_DisblMsk2.DFC_Com26hTooShort_C DFC_DisblMsk2.DFC_Com273hAbsent_C DFC_DisblMsk2.DFC_Com273hChecksum_C DFC_DisblMsk2.DFC_Com273hCounter_C DFC_DisblMsk2.DFC_Com273hTooShort_C DFC_DisblMsk2.DFC_Com275hAbsent_C DFC_DisblMsk2.DFC_Com275hChecksum_C DFC_DisblMsk2.DFC_Com275hCounter_C DFC_DisblMsk2.DFC_Com275hTooShort_C DFC_DisblMsk2.DFC_Com283hAbsent_C DFC_DisblMsk2.DFC_Com283hTooShort_C DFC_DisblMsk2.DFC_Com285hAbsent_C DFC_DisblMsk2.DFC_Com285hChecksum_C DFC_DisblMsk2.DFC_Com285hCounter_C DFC_DisblMsk2.DFC_Com285hTooShort_C DFC_DisblMsk2.DFC_Com293hAbsent_C DFC_DisblMsk2.DFC_Com293hChecksum_C DFC_DisblMsk2.DFC_Com293hCounter_C DFC_DisblMsk2.DFC_Com293hTooShort_C DFC_DisblMsk2.DFC_Com308hAbsent_C DFC_DisblMsk2.DFC_Com308hChecksum_C DFC_DisblMsk2.DFC_Com308hCounter_C DFC_DisblMsk2.DFC_Com308hTooShort_C DFC_DisblMsk2.DFC_Com318hAbsent_C DFC_DisblMsk2.DFC_Com318hChecksum_C DFC_DisblMsk2.DFC_Com318hCounter_C DFC_DisblMsk2.DFC_Com318hTooShort_C DFC_DisblMsk2.DFC_Com325hAbsent_C DFC_DisblMsk2.DFC_Com325hChecksum_C DFC_DisblMsk2.DFC_Com325hCounter_C DFC_DisblMsk2.DFC_Com325hTooShort_C DFC_DisblMsk2.DFC_Com335hAbsent_C DFC_DisblMsk2.DFC_Com335hChecksum_C DFC_DisblMsk2.DFC_Com335hCounter_C DFC_DisblMsk2.DFC_Com335hTooShort_C DFC_DisblMsk2.DFC_Com351hAbsent_C DFC_DisblMsk2.DFC_Com351hTooShort_C DFC_DisblMsk2.DFC_Com38DhAbsent_C DFC_DisblMsk2.DFC_Com38DhChecksum_C DFC_DisblMsk2.DFC_Com38DhCounter_C DFC_DisblMsk2.DFC_Com38DhTooShort_C DFC_DisblMsk2.DFC_Com412hAbsent_C DFC_DisblMsk2.DFC_Com412hChecksum_C DFC_DisblMsk2.DFC_Com412hCounter_C DFC_DisblMsk2.DFC_Com412hTooShort_C DFC_DisblMsk2.DFC_Com427hAbsent_C DFC_DisblMsk2.DFC_Com427hTooShort_C DFC_DisblMsk2.DFC_Com432hAbsent_C DFC_DisblMsk2.DFC_Com432hChecksum_C DFC_DisblMsk2.DFC_Com432hCounter_C DFC_DisblMsk2.DFC_Com432hTooShort_C DFC_DisblMsk2.DFC_Com435hAbsent_C DFC_DisblMsk2.DFC_Com435hTooShort_C DFC_DisblMsk2.DFC_Com442hAbsent_C DFC_DisblMsk2.DFC_Com442hTooShort_C DFC_DisblMsk2.DFC_Com453hAbsent_C DFC_DisblMsk2.DFC_Com453hTooShort_C DFC_DisblMsk2.DFC_Com455hAbsent_C DFC_DisblMsk2.DFC_Com455hTooShort_C DFC_DisblMsk2.DFC_Com463hAbsent_C DFC_DisblMsk2.DFC_Com463hTooShort_C DFC_DisblMsk2.DFC_Com473hAbsent_C DFC_DisblMsk2.DFC_Com473hTooShort_C DFC_DisblMsk2.DFC_Com47BhAbsent_C DFC_DisblMsk2.DFC_Com47BhTooShort_C DFC_DisblMsk2.DFC_Com48BhAbsent_C DFC_DisblMsk2.DFC_Com48BhTooShort_C DFC_DisblMsk2.DFC_Com497hTooShort_C DFC_DisblMsk2.DFC_Com4F2hAbsent_C DFC_DisblMsk2.DFC_Com4F2hChecksum_C DFC_DisblMsk2.DFC_Com4F2hCounter_C DFC_DisblMsk2.DFC_Com4F2hTooShort_C DFC_DisblMsk2.DFC_Com50DhAbsent_C DFC_DisblMsk2.DFC_Com50DhTooShort_C DFC_DisblMsk2.DFC_Com535hAbsent_C DFC_DisblMsk2.DFC_Com535hTooShort_C DFC_DisblMsk2.DFC_Com543hAbsent_C DFC_DisblMsk2.DFC_Com543hTooShort_C DFC_DisblMsk2.DFC_Com552hAbsent_C DFC_DisblMsk2.DFC_Com552hTooShort_C DFC_DisblMsk2.DFC_Com583hAbsent_C DFC_DisblMsk2.DFC_Com583hTooShort_C DFC_DisblMsk2.DFC_Com592hAbsent_C DFC_DisblMsk2.DFC_Com592hChecksum_C DFC_DisblMsk2.DFC_Com592hCounter_C DFC_DisblMsk2.DFC_Com592hTooShort_C DFC_DisblMsk2.DFC_Com595hAbsent_C DFC_DisblMsk2.DFC_Com595hChecksum_C DFC_DisblMsk2.DFC_Com595hCounter_C DFC_DisblMsk2.DFC_Com595hTooShort_C DFC_DisblMsk2.DFC_Com5B2hAbsent_C DFC_DisblMsk2.DFC_Com5B2hTooShort_C DFC_DisblMsk2.DFC_Com5B5hAbsent_C DFC_DisblMsk2.DFC_Com5B5hChecksum_C DFC_DisblMsk2.DFC_Com5B5hCounter_C DFC_DisblMsk2.DFC_Com5B5hTooShort_C DFC_DisblMsk2.DFC_Com5C7hTooShort_C DFC_DisblMsk2.DFC_Com5E7hAbsent_C DFC_DisblMsk2.DFC_Com5E7hTooShort_C DFC_DisblMsk2.DFC_Com635hTooShort_C DFC_DisblMsk2.DFC_Com645hTooShort_C DFC_DisblMsk2.DFC_Com663hAbsent_C DFC_DisblMsk2.DFC_Com663hTooShort_C DFC_DisblMsk2.DFC_Com665hAbsent_C DFC_DisblMsk2.DFC_Com665hTooShort_C DFC_DisblMsk2.DFC_Com675hAbsent_C DFC_DisblMsk2.DFC_Com675hTooShort_C DFC_DisblMsk2.DFC_ComFrbd_205h_HVBAT_PACK_CURRENT_C DFC_DisblMsk2.DFC_ComFrbd_205h_HVBAT_SOC_DISPLAY_C DFC_DisblMsk2.DFC_ComFrbd_205h_HVBAT_VOLTAGE_C DFC_DisblMsk2.DFC_ComFrbd_217h_INV_DC_BUS_VOLTAGE_C DFC_DisblMsk2.DFC_ComFrbd_217h_INV_MTR_ACTUAL_TRQ_C DFC_DisblMsk2.DFC_ComFrbd_217h_INV_MTR_SPEED_C DFC_DisblMsk2.DFC_ComFrbd_217h_INV_MTR_TRQ_C DFC_DisblMsk2.DFC_ComFrbd_227h_INV_DC_CURRENT_C DFC_DisblMsk2.DFC_ComFrbd_227h_INV_MOTORING_PEAK_TRQ_C DFC_DisblMsk2.DFC_ComFrbd_227h_INV_MTR_INST_INPUT_POWER_C DFC_DisblMsk2.DFC_ComFrbd_227h_INV_REGEN_PEAK_TRQ_C DFC_DisblMsk2.DFC_ComFrbd_237h_INV_ACTIVE_DISCHARGE_STATUS_C DFC_DisblMsk2.DFC_ComFrbd_237h_INV_CTRL_MODE_ACK_C DFC_DisblMsk2.DFC_ComFrbd_237h_INV_EV_WARNING_C DFC_DisblMsk2.DFC_ComFrbd_237h_INV_FAULT_LEVEL_C DFC_DisblMsk2.DFC_ComFrbd_237h_INV_MASTER_STOP_C DFC_DisblMsk2.DFC_ComFrbd_237h_INV_SERVICE_DUE_C DFC_DisblMsk2.DFC_ComFrbd_237h_INV_STAB_MIN_TRQ_C DFC_DisblMsk2.DFC_ComFrbd_259h_TGLM_FAILURE_STATE_C DFC_DisblMsk2.DFC_ComFrbd_259h_TGLM_MODE_PUSH_C DFC_DisblMsk2.DFC_ComFrbd_259h_TOGGLE_MONOSTABLE_POS_C DFC_DisblMsk2.DFC_ComFrbd_273h_OBC_outputpower_capability_C DFC_DisblMsk2.DFC_ComFrbd_275h_HVBAT_DISCHARGE_30S_AVAILABLE_CURRENT_C DFC_DisblMsk2.DFC_ComFrbd_275h_HVBAT_DISCHARGE_30S_AVAILABLE_POWER_C DFC_DisblMsk2.DFC_ComFrbd_283h_DCDC_IN_CURRENT_C DFC_DisblMsk2.DFC_ComFrbd_283h_DCDC_IN_VOLTAGE_C DFC_DisblMsk2.DFC_ComFrbd_283h_DCDC_OUT_CURRENT_C DFC_DisblMsk2.DFC_ComFrbd_283h_DCDC_OUT_VOLTAGE_C DFC_DisblMsk2.DFC_ComFrbd_285h_HVBAT_REGEN_CHG_30S_CURRENT_LIMIT_C DFC_DisblMsk2.DFC_ComFrbd_285h_HVBAT_REGEN_CHRG_30S_POWER_LIMIT_C DFC_DisblMsk2.DFC_ComFrbd_293h_DCDC_outputpower_capability_C DFC_DisblMsk2.DFC_ComFrbd_325h_HVBAT_INSULATION_RESISTANCE_C DFC_DisblMsk2.DFC_ComFrbd_325h_HVBAT_TEMPERATURE_C DFC_DisblMsk2.DFC_ComFrbd_335h_HVBAT_CHRG_CONTINUOUS_CURR_MAX_C DFC_DisblMsk2.DFC_ComFrbd_335h_HVBAT_CHRG_COTINUOUS_CURR_REQ_C DFC_DisblMsk2.DFC_ComFrbd_335h_HVBAT_CHRG_MAX_VOLT_C DFC_DisblMsk2.DFC_ComFrbd_335h_HVBAT_DC_BUS_VOLTAGE_C DFC_DisblMsk2.DFC_ComFrbd_427h_INV_OP_MODE_C DFC_DisblMsk2.DFC_ComFrbd_427h_INV_PERMISIBLE_TORQUE_C DFC_DisblMsk2.DFC_ComFrbd_435h_HVBAT_MAX_CELL_VOLT_C DFC_DisblMsk2.DFC_ComFrbd_435h_HVBAT_MAX_CELL_VOLT_NUM_C DFC_DisblMsk2.DFC_ComFrbd_435h_HVBAT_MAX_SENSOR_TEMP_C DFC_DisblMsk2.DFC_ComFrbd_435h_HVBAT_MIN_CELL_VOLT_C DFC_DisblMsk2.DFC_ComFrbd_435h_HVBAT_MIN_CELL_VOLT_NUM_C DFC_DisblMsk2.DFC_ComFrbd_453h_OBC_IN_CURRENT_C DFC_DisblMsk2.DFC_ComFrbd_453h_OBC_IN_VOLTAGE_C DFC_DisblMsk2.DFC_ComFrbd_453h_OBC_IP_POWER_C DFC_DisblMsk2.DFC_ComFrbd_455h_HVBAT_NOMINAL_VOLTAGE_C DFC_DisblMsk2.DFC_ComFrbd_463h_OBC_OUT_CURRENT_C DFC_DisblMsk2.DFC_ComFrbd_463h_OBC_OUT_VOLTAGE_C DFC_DisblMsk2.DFC_ComFrbd_463h_OBC_TEMPERATURE_C DFC_DisblMsk2.DFC_ComFrbd_473h_DCDC_Coolant_Temperature_C DFC_DisblMsk2.DFC_ComFrbd_473h_DCDC_TEMPERATURE_C DFC_DisblMsk2.DFC_ComFrbd_47Bh_eCOMP_BusBarCurrent_C DFC_DisblMsk2.DFC_ComFrbd_47Bh_eCOMP_BusBarVoltage_C DFC_DisblMsk2.DFC_ComFrbd_47Bh_eCOMP_CompressorSpeed_C DFC_DisblMsk2.DFC_ComFrbd_47Bh_eCOMP_IGBT_Temp_C DFC_DisblMsk2.DFC_ComFrbd_47Bh_eCOMP_PeakPhaCurrent_C DFC_DisblMsk2.DFC_ComFrbd_47Bh_eCOMP_Power_consumption_C DFC_DisblMsk2.DFC_ComFrbd_48Bh_eCOMP_Fault_Level_C DFC_DisblMsk2.DFC_ComFrbd_4F2h_VALEUR_SOC_ETENDUE_C DFC_DisblMsk2.DFC_ComFrbd_535h_HV_BATT_TEMP_AVG_C DFC_DisblMsk2.DFC_ComFrbd_543h_HVBAT_RESTBATTENERGY_C DFC_DisblMsk2.DFC_ComFrbd_543h_HVBAT_SOH_C DFC_DisblMsk2.DFC_ComFrbd_543h_HV_BATT_SOH_RES_C DFC_DisblMsk2.DFC_ComFrbd_592h_IBATT_1_C DFC_DisblMsk2.DFC_ComFrbd_592h_IBATT_2_C DFC_DisblMsk2.DFC_ComFrbd_592h_IBATT_3_C DFC_DisblMsk2.DFC_ComFrbd_592h_TEMP_BATT_C DFC_DisblMsk2.DFC_ComFrbd_592h_U_BATT_BECB_C DFC_DisblMsk2.DFC_ComFrbd_595h_HVBAT_TIME_TO_CHRG_80_C DFC_DisblMsk2.DFC_ComFrbd_5B2h_TEMP_AIR_EXT_C DFC_DisblMsk2.DFC_ComFrbd_635h_HVBAT_NEG_CONT_COUNT_SEG1_C DFC_DisblMsk2.DFC_ComFrbd_635h_HVBAT_NEG_CONT_COUNT_SEG3_C DFC_DisblMsk2.DFC_ComFrbd_635h_HVBAT_NEG_CONT_COUNT_SEG4_C DFC_DisblMsk2.DFC_ComFrbd_635h_HVBAT_PST_CONT_COUNT_SEG1_C DFC_DisblMsk2.DFC_ComFrbd_635h_HVBAT_PST_CONT_COUNT_SEG3_C DFC_DisblMsk2.DFC_ComFrbd_635h_HVBAT_PST_CONT_COUNT_SEG4_C DFC_DisblMsk2.DFC_ComFrbd_645h_HVBAT_PRECHRGE_CONT_COUNT_SEG1_C DFC_DisblMsk2.DFC_ComFrbd_645h_HVBAT_PRECHRGE_CONT_COUNT_SEG2_C DFC_DisblMsk2.DFC_ComFrbd_675h_HVBAT_REMAININGBATTCAPACITY_C DFC_DisblMsk2.DFC_ComInvld_205h_HVBAT_CHARGING_STATUS_C DFC_DisblMsk2.DFC_ComInvld_205h_HVBAT_PACK_CURRENT_C DFC_DisblMsk2.DFC_ComInvld_205h_HVBAT_SOC_DISPLAY_C DFC_DisblMsk2.DFC_ComInvld_205h_HVBAT_VOLTAGE_C DFC_DisblMsk2.DFC_ComInvld_217h_INV_DC_BUS_VOLTAGE_C DFC_DisblMsk2.DFC_ComInvld_217h_INV_MTR_ACTUAL_TRQ_C DFC_DisblMsk2.DFC_ComInvld_217h_INV_MTR_SPEED_C DFC_DisblMsk2.DFC_ComInvld_217h_INV_MTR_TRQ_C DFC_DisblMsk2.DFC_ComInvld_227h_INV_DC_CURRENT_C DFC_DisblMsk2.DFC_ComInvld_227h_INV_MOTORING_PEAK_TRQ_C DFC_DisblMsk2.DFC_ComInvld_227h_INV_MTR_INST_INPUT_POWER_C DFC_DisblMsk2.DFC_ComInvld_227h_INV_REGEN_PEAK_TRQ_C DFC_DisblMsk2.DFC_ComInvld_237h_INV_ACTIVE_DISCHARGE_STATUS_C DFC_DisblMsk2.DFC_ComInvld_237h_INV_FAULT_LEVEL_C DFC_DisblMsk2.DFC_ComInvld_237h_INV_STAB_MIN_TRQ_C DFC_DisblMsk2.DFC_ComInvld_259h_TGLM_MODE_PUSH_C DFC_DisblMsk2.DFC_ComInvld_259h_TOGGLE_MONOSTABLE_POS_C DFC_DisblMsk2.DFC_ComInvld_26h_AC_SWITCH_REQ_C DFC_DisblMsk2.DFC_ComInvld_26h_BLOWER_POSITION_C DFC_DisblMsk2.DFC_ComInvld_26h_EVAP_SENSOR_FAULT_C DFC_DisblMsk2.DFC_ComInvld_26h_EVAP_SENSOR_VALUE_C DFC_DisblMsk2.DFC_ComInvld_26h_POTENTIOMETER_FAULT_C DFC_DisblMsk2.DFC_ComInvld_26h_REAR_DEFOG_REQ_C DFC_DisblMsk2.DFC_ComInvld_26h_TEMP_POSITION_C DFC_DisblMsk2.DFC_ComInvld_273h_OBC_FAULT_LEVEL_C DFC_DisblMsk2.DFC_ComInvld_273h_OBC_outputpower_capability_C DFC_DisblMsk2.DFC_ComInvld_275h_HVBAT_DISCHARGE_30S_AVAILABLE_CURRENT_C DFC_DisblMsk2.DFC_ComInvld_275h_HVBAT_DISCHARGE_30S_AVAILABLE_POWER_C DFC_DisblMsk2.DFC_ComInvld_283h_DCDC_IN_CURRENT_C DFC_DisblMsk2.DFC_ComInvld_283h_DCDC_IN_VOLTAGE_C DFC_DisblMsk2.DFC_ComInvld_283h_DCDC_OUT_CURRENT_C DFC_DisblMsk2.DFC_ComInvld_283h_DCDC_OUT_VOLTAGE_C DFC_DisblMsk2.DFC_ComInvld_285h_HVBAT_REGEN_CHG_30S_CURRENT_LIMIT_C DFC_DisblMsk2.DFC_ComInvld_285h_HVBAT_REGEN_CHRG_30S_POWER_LIMIT_C DFC_DisblMsk2.DFC_ComInvld_293h_DCDC_FAULT_LEVEL_C DFC_DisblMsk2.DFC_ComInvld_293h_DCDC_outputpower_capability_C DFC_DisblMsk2.DFC_ComInvld_325h_HVBAT_EPLUG_STATUS_C DFC_DisblMsk2.DFC_ComInvld_325h_HVBAT_HVIL_STS_C DFC_DisblMsk2.DFC_ComInvld_325h_HVBAT_INSULATION_FAULT_C DFC_DisblMsk2.DFC_ComInvld_325h_HVBAT_INSULATION_RESISTANCE_C DFC_DisblMsk2.DFC_ComInvld_325h_HVBAT_TEMPERATURE_C DFC_DisblMsk2.DFC_ComInvld_335h_HVBAT_CHRG_CONTINUOUS_CURR_MAX_C DFC_DisblMsk2.DFC_ComInvld_335h_HVBAT_CHRG_COTINUOUS_CURR_REQ_C DFC_DisblMsk2.DFC_ComInvld_335h_HVBAT_CHRG_MAX_VOLT_C DFC_DisblMsk2.DFC_ComInvld_335h_HVBAT_DC_BUS_VOLTAGE_C DFC_DisblMsk2.DFC_ComInvld_38Dh_VITESSE_VEHICULE_ROUES_C DFC_DisblMsk2.DFC_ComInvld_38Dh_VVH_INDISP_C DFC_DisblMsk2.DFC_ComInvld_427h_INV_COOLANT_TEMP_C DFC_DisblMsk2.DFC_ComInvld_427h_INV_MOTOR_TEMP_C DFC_DisblMsk2.DFC_ComInvld_427h_INV_OP_MODE_C DFC_DisblMsk2.DFC_ComInvld_427h_INV_PERMISIBLE_TORQUE_C DFC_DisblMsk2.DFC_ComInvld_427h_INV_TEMP_C DFC_DisblMsk2.DFC_ComInvld_432h_REVEIL_PRINCIPAL_C DFC_DisblMsk2.DFC_ComInvld_435h_HVBAT_MAX_CELL_VOLT_C DFC_DisblMsk2.DFC_ComInvld_435h_HVBAT_MAX_CELL_VOLT_NUM_C DFC_DisblMsk2.DFC_ComInvld_435h_HVBAT_MAX_SENSOR_TEMP_C DFC_DisblMsk2.DFC_ComInvld_435h_HVBAT_MIN_CELL_VOLT_C DFC_DisblMsk2.DFC_ComInvld_435h_HVBAT_MIN_CELL_VOLT_NUM_C DFC_DisblMsk2.DFC_ComInvld_442h_BCCM_BLOWER_RELAY_STS_C DFC_DisblMsk2.DFC_ComInvld_453h_OBC_IN_CURRENT_C DFC_DisblMsk2.DFC_ComInvld_453h_OBC_IN_VOLTAGE_C DFC_DisblMsk2.DFC_ComInvld_453h_OBC_IP_POWER_C DFC_DisblMsk2.DFC_ComInvld_455h_HVBAT_NOMINAL_VOLTAGE_C DFC_DisblMsk2.DFC_ComInvld_463h_OBC_OUT_CURRENT_C DFC_DisblMsk2.DFC_ComInvld_463h_OBC_OUT_VOLTAGE_C DFC_DisblMsk2.DFC_ComInvld_463h_OBC_TEMPERATURE_C DFC_DisblMsk2.DFC_ComInvld_473h_DCDC_Coolant_Temperature_C DFC_DisblMsk2.DFC_ComInvld_473h_DCDC_TEMPERATURE_C DFC_DisblMsk2.DFC_ComInvld_47Bh_eCOMP_BusBarCurrent_C DFC_DisblMsk2.DFC_ComInvld_47Bh_eCOMP_BusBarVoltage_C DFC_DisblMsk2.DFC_ComInvld_47Bh_eCOMP_CompressorSpeed_C DFC_DisblMsk2.DFC_ComInvld_47Bh_eCOMP_IGBT_Temp_C DFC_DisblMsk2.DFC_ComInvld_47Bh_eCOMP_PeakPhaCurrent_C DFC_DisblMsk2.DFC_ComInvld_47Bh_eCOMP_Power_consumption_C DFC_DisblMsk2.DFC_ComInvld_4F2h_STATUS_SOC_C DFC_DisblMsk2.DFC_ComInvld_4F2h_TEMP_BATT_STATUS_C DFC_DisblMsk2.DFC_ComInvld_4F2h_VALEUR_SOC_ETENDUE_C DFC_DisblMsk2.DFC_ComInvld_535h_HV_BATT_TEMP_AVG_C DFC_DisblMsk2.DFC_ComInvld_543h_HVBAT_RESTBATTENERGY_C DFC_DisblMsk2.DFC_ComInvld_543h_HVBAT_SOH_C DFC_DisblMsk2.DFC_ComInvld_543h_HV_BATT_SOH_RES_C DFC_DisblMsk2.DFC_ComInvld_552h_CPT_TEMPOREL_C DFC_DisblMsk2.DFC_ComInvld_552h_KILOMETRAGE_C DFC_DisblMsk2.DFC_ComInvld_583h_HV_BATT_DISCONT_CSE_OPEN_C DFC_DisblMsk2.DFC_ComInvld_592h_CALIBRE_IBATT_C DFC_DisblMsk2.DFC_ComInvld_592h_IBATT_1_C DFC_DisblMsk2.DFC_ComInvld_592h_IBATT_2_C DFC_DisblMsk2.DFC_ComInvld_592h_IBATT_3_C DFC_DisblMsk2.DFC_ComInvld_592h_TEMP_BATT_C DFC_DisblMsk2.DFC_ComInvld_592h_U_BATT_BECB_C DFC_DisblMsk2.DFC_ComInvld_595h_HVBAT_TIME_TO_CHRG_80_C DFC_DisblMsk2.DFC_ComInvld_5B2h_TEMP_AIR_EXT_C DFC_DisblMsk2.DFC_ComInvld_5B5h_HVBAT_THERMAL_RUNAWAY_C DFC_DisblMsk2.DFC_ComInvld_635h_HVBAT_NEG_CONT_COUNT_SEG1_C DFC_DisblMsk2.DFC_ComInvld_635h_HVBAT_NEG_CONT_COUNT_SEG3_C DFC_DisblMsk2.DFC_ComInvld_635h_HVBAT_NEG_CONT_COUNT_SEG4_C DFC_DisblMsk2.DFC_ComInvld_635h_HVBAT_PST_CONT_COUNT_SEG1_C DFC_DisblMsk2.DFC_ComInvld_635h_HVBAT_PST_CONT_COUNT_SEG3_C DFC_DisblMsk2.DFC_ComInvld_635h_HVBAT_PST_CONT_COUNT_SEG4_C DFC_DisblMsk2.DFC_ComInvld_645h_HVBAT_PRECHRGE_CONT_COUNT_SEG1_C DFC_DisblMsk2.DFC_ComInvld_645h_HVBAT_PRECHRGE_CONT_COUNT_SEG2_C DFC_DisblMsk2.DFC_ComInvld_675h_HVBAT_REMAININGBATTCAPACITY_C DFC_DisblMsk2.DFC_ACCmprFltLvl1_C DFC_DisblMsk2.DFC_ACCmprFltLvl2_C DFC_DisblMsk2.DFC_ACCmprFltLvl3_C DFC_DisblMsk2.DFC_ACCmprFltLvl4_C DFC_DisblMsk2.DFC_ACCmprHiPFlt_C DFC_DisblMsk2.DFC_ACCmprInvldCmprSt_C DFC_DisblMsk2.DFC_ACCmprInvldElecActPwr_C DFC_DisblMsk2.DFC_ACCmprLoPFlt_C DFC_DisblMsk2.DFC_AcChrgrIntkTSRCMin_C DFC_DisblMsk2.DFC_BattUBMaxBatt_C DFC_DisblMsk2.DFC_BattUBMaxNoBatt_C DFC_DisblMsk2.DFC_BattUBMinBatt_C DFC_DisblMsk2.DFC_BattUBMinNoBatt_C DFC_DisblMsk2.DFC_BattUSRCMax_C DFC_DisblMsk2.DFC_BattUSRCMin_C DFC_DisblMsk2.DFC_BrkBstPHiCautionDfct_C DFC_DisblMsk2.DFC_BrkBstPHiWarnDfct_C DFC_DisblMsk2.DFC_BrkBstPSnsr12PlausDfct_C DFC_DisblMsk2.DFC_BrkBstPSnsr1Scb_C DFC_DisblMsk2.DFC_BrkBstPSnsr1Scg_C DFC_DisblMsk2.DFC_BrkBstPSnsr2Scb_C DFC_DisblMsk2.DFC_BrkBstPSnsr2Scg_C DFC_DisblMsk2.DFC_BrkBstPSnsrMax_C DFC_DisblMsk2.DFC_BrkBstPSnsrMin_C DFC_DisblMsk2.DFC_BrkBstPhyRngChkMax_C DFC_DisblMsk2.DFC_BrkBstPhyRngChkMin_C DFC_DisblMsk2.DFC_BrkBstPmpHsScb_C DFC_DisblMsk2.DFC_BrkBstPmpHsScg_C DFC_DisblMsk2.DFC_BrkBstPmpLsOl_C DFC_DisblMsk2.DFC_BrkBstPmpLsScb_C DFC_DisblMsk2.DFC_BrkBstPmpLsScg_C DFC_DisblMsk2.DFC_CbnHeatgHeatrRlyOpend_C DFC_DisblMsk2.DFC_CbnHeatgHeatrRlyWldd_C DFC_DisblMsk2.DFC_CcsDcIBattExcdd_C DFC_DisblMsk2.DFC_CcsDcIEvseOutDe_C DFC_DisblMsk2.DFC_CcsDcIOutDe_C DFC_DisblMsk2.DFC_CcsDcIOutExcdd_C DFC_DisblMsk2.DFC_CcsDcUOutDe_C DFC_DisblMsk2.DFC_CcsDcUOutExcdd_C DFC_DisblMsk2.DFC_CcsPwrLineChpRstOL_C DFC_DisblMsk2.DFC_CcsPwrLineChpRstOvrTemp_C DFC_DisblMsk2.DFC_CcsPwrLineChpRstSCB_C DFC_DisblMsk2.DFC_CcsPwrLineChpRstSCG_C DFC_DisblMsk2.DFC_CcsPwrLineChpVccEnaOL_C DFC_DisblMsk2.DFC_CcsPwrLineChpVccEnaOvrTemp_C DFC_DisblMsk2.DFC_CcsPwrLineChpVccEnaSCB_C DFC_DisblMsk2.DFC_CcsPwrLineChpVccEnaSCG_C DFC_DisblMsk2.DFC_CcsPwrLineChpVccSRCMin_C DFC_DisblMsk2.DFC_CcsPwrLineComChpTSRCMin_C DFC_DisblMsk2.DFC_CtPSwtActrOL_C DFC_DisblMsk2.DFC_CtPSwtActrOvrTemp_C DFC_DisblMsk2.DFC_CtPSwtActrSCB_C DFC_DisblMsk2.DFC_CtPSwtActrSCG_C DFC_DisblMsk2.DFC_CtPSwtDiagSRCMin_C DFC_DisblMsk2.DFC_CtpCarrFrqSRCMin_C DFC_DisblMsk2.DFC_DcChrgrIntkT2SRCMin_C DFC_DisblMsk2.DFC_DcChrgrIntkTSRCMin_C DFC_DisblMsk2.DFC_DevLibBattUHi_C DFC_DisblMsk2.DFC_DevLibBattULo_C DFC_DisblMsk2.DFC_EmWakeupSigOL_C DFC_DisblMsk2.DFC_EmWakeupSigOvrTemp_C DFC_DisblMsk2.DFC_EmWakeupSigSCB_C DFC_DisblMsk2.DFC_EmWakeupSigSCG_C DFC_DisblMsk2.DFC_Fan1OL_C DFC_DisblMsk2.DFC_Fan1OvrTemp_C DFC_DisblMsk2.DFC_Fan1SCB_C DFC_DisblMsk2.DFC_FanRlySCB_C DFC_DisblMsk2.DFC_FanRlySCG_C DFC_DisblMsk2.DFC_FanSpdSRCMin_C DFC_DisblMsk2.DFC_FreonPSRCMin_C DFC_DisblMsk2.DFC_HLCCcsPLnCChipTHi_C DFC_DisblMsk2.DFC_HeatrCoreTSRCMin_C DFC_DisblMsk2.DFC_PwmCtPSRCMin_C DFC_DisblMsk2.DFC_PwrDistbnUnitTSRCMin_C DFC_DisblMsk2.DFC_SCtPmp1OL_C DFC_DisblMsk2.DFC_SCtPmp1OvrTemp_C DFC_DisblMsk2.DFC_SCtPmp1SCB_C DFC_DisblMsk2.DFC_SCtPmpRlyOL_C DFC_DisblMsk2.DFC_SCtPmpRlyOvrTemp_C DFC_DisblMsk2.DFC_SCtPmpRlySCB_C DFC_DisblMsk2.DFC_SpplCooltPmpRlyOL_C DFC_DisblMsk2.DFC_SpplCooltPmpRlyOvrTemp_C DFC_DisblMsk2.DFC_SpplCooltPmpRlySCB_C DFC_DisblMsk2.DFC_UCtPSRCMin_C DFC_DisblMsk2.DFC_UPxP1SRCMin_C DFC_DisblMsk2.DFC_ComHSN1CANMute_C DFC_DisblMsk2.DFC_ComHSN3CANMute_C DFC_DisblMsk2.DFC_AcChrgrIntkTPhysRngHi_C DFC_DisblMsk2.DFC_AcChrgrIntkTPhysRngLo_C DFC_DisblMsk2.DFC_AcChrgrIntkTSRCOpn_C DFC_DisblMsk2.DFC_CcsPwrLineChpVccPhysRngHi_C DFC_DisblMsk2.DFC_CcsPwrLineChpVccPhysRngLo_C DFC_DisblMsk2.DFC_CcsPwrLineChpVccSRCOpn_C DFC_DisblMsk2.DFC_CcsPwrLineComChpTPhysRngHi_C DFC_DisblMsk2.DFC_CcsPwrLineComChpTPhysRngLo_C DFC_DisblMsk2.DFC_CcsPwrLineComChpTSRCOpn_C DFC_DisblMsk2.DFC_CtPSwtDiagPhysRngHi_C DFC_DisblMsk2.DFC_CtPSwtDiagPhysRngLo_C DFC_DisblMsk2.DFC_CtPSwtDiagSRCOpn_C DFC_DisblMsk2.DFC_CtpCarrFrqPhysRngHi_C DFC_DisblMsk2.DFC_CtpCarrFrqPhysRngLo_C DFC_DisblMsk2.DFC_CtpCarrFrqSRCMax_C DFC_DisblMsk2.DFC_DcChrgrIntkT2PhysRngHi_C DFC_DisblMsk2.DFC_DcChrgrIntkT2PhysRngLo_C DFC_DisblMsk2.DFC_DcChrgrIntkT2SRCOpn_C DFC_DisblMsk2.DFC_DcChrgrIntkTPhysRngHi_C DFC_DisblMsk2.DFC_DcChrgrIntkTPhysRngLo_C DFC_DisblMsk2.DFC_DcChrgrIntkTSRCOpn_C DFC_DisblMsk2.DFC_Fan1SCG_C DFC_DisblMsk2.DFC_FanSpdPhysRngHi_C DFC_DisblMsk2.DFC_FanSpdPhysRngLo_C DFC_DisblMsk2.DFC_FanSpdSRCOpn_C DFC_DisblMsk2.DFC_FreonPPhysRngHi_C DFC_DisblMsk2.DFC_FreonPPhysRngLo_C DFC_DisblMsk2.DFC_FreonPSRCOpn_C DFC_DisblMsk2.DFC_HeatrCoreTPhysRngHi_C DFC_DisblMsk2.DFC_HeatrCoreTPhysRngLo_C DFC_DisblMsk2.DFC_HeatrCoreTSRCOpn_C DFC_DisblMsk2.DFC_HvGridUMaxSftyLim_C DFC_DisblMsk2.DFC_HvGridUMinSftyLim_C DFC_DisblMsk2.DFC_HvGridUPlausy_C DFC_DisblMsk2.DFC_IntlckChrgPlgHBrgOpnLd_C DFC_DisblMsk2.DFC_IntlckChrgPlgHBrgOvrCurr_C DFC_DisblMsk2.DFC_IntlckChrgPlgHBrgOvrTemp_C DFC_DisblMsk2.DFC_IntlckChrgPlgHBrgShCirBatt1_C DFC_DisblMsk2.DFC_IntlckChrgPlgHBrgShCirBatt2_C DFC_DisblMsk2.DFC_IntlckChrgPlgHBrgShCirGnd1_C DFC_DisblMsk2.DFC_IntlckChrgPlgHBrgShCirGnd2_C DFC_DisblMsk2.DFC_IntlckChrgPlgHBrgShCirOvrLd_C DFC_DisblMsk2.DFC_IntlckChrgPlgHBrgTempOvrCurr_C DFC_DisblMsk2.DFC_IntlckChrgPlgHBrgUndrVltg_C DFC_DisblMsk2.DFC_IntlckChrgPlgPosnRngFlt_C DFC_DisblMsk2.DFC_IntlckChrgPlgPosnSrcMax_C DFC_DisblMsk2.DFC_IntlckChrgPlgPosnSrcMin_C DFC_DisblMsk2.DFC_PwmCtPPhysRngHi_C DFC_DisblMsk2.DFC_PwmCtPPhysRngLo_C DFC_DisblMsk2.DFC_PwmCtPSRCMax_C DFC_DisblMsk2.DFC_PwrDistbnUnitTPhysRngHi_C DFC_DisblMsk2.DFC_PwrDistbnUnitTPhysRngLo_C DFC_DisblMsk2.DFC_PwrDistbnUnitTSRCOpn_C DFC_DisblMsk2.DFC_SCtPmpRlySCG_C DFC_DisblMsk2.DFC_SpplCooltPmpRlySCG_C DFC_DisblMsk2.DFC_UCtPPhysRngHi_C DFC_DisblMsk2.DFC_UCtPPhysRngLo_C DFC_DisblMsk2.DFC_UCtPSRCOpn_C DFC_DisblMsk2.DFC_UPxP1PhysRngHi_C DFC_DisblMsk2.DFC_UPxP1PhysRngLo_C DFC_DisblMsk2.DFC_UPxP1SRCOpn_C DFC_DisblMsk2.DFC_VehVPhysRngHi_C DFC_DisblMsk2.DFC_VehVPhysRngLo_C DFC_DisblMsk2.DFC_VehVSigCan_C DFC_DisblMsk2.DFC_VehVSigCanSafe_C DFC_DisblMsk2.DFC_SCtPmp1DiagGrdKey1_C DFC_DisblMsk2.DFC_SCtPmp1DiagGrdKey2_C DFC_DisblMsk2.DFC_SCtPmp1DiagGrdKey3_C DFC_DisblMsk2.DFC_SCtPmp1DiagGrdKey4_C DFC_DisblMsk2.DFC_SCtPmp1DiagGrdKey5_C DFC_DisblMsk2.DFC_ChrgPlgLiveCntctHzrdCcs_C DFC_DisblMsk2.DFC_ChrgPlgProxPltImps_C DFC_DisblMsk2.DFC_ChrgPlgTHiCcsDc_C DFC_DisblMsk2.DFC_ElMActvDchaFailr_C DFC_DisblMsk2.DFC_ElMActvDchaFlt_C DFC_DisblMsk2.DFC_ElMFbdnIvtrModDrv01_C DFC_DisblMsk2.DFC_ElMImobAuthent_C DFC_DisblMsk2.DFC_ElMIsoMonFlt_C DFC_DisblMsk2.DFC_ElMIsoMonPlausyFlt_C DFC_DisblMsk2.DFC_ElMIvtrCooltT01_C DFC_DisblMsk2.DFC_ElMIvtrEmgyShtDwn01_C DFC_DisblMsk2.DFC_ElMIvtrFailr01_C DFC_DisblMsk2.DFC_ElMIvtrIntlck01_C DFC_DisblMsk2.DFC_ElMIvtrTErr01_C DFC_DisblMsk2.DFC_ElMOverSpdNeg01_C DFC_DisblMsk2.DFC_ElMOverSpdPos01_C DFC_DisblMsk2.DFC_ElMOverTqNeg01_C DFC_DisblMsk2.DFC_ElMOverTqPos01_C DFC_DisblMsk2.DFC_ElMPwrAuthn_C DFC_DisblMsk2.DFC_ElMSpdErr01_C DFC_DisblMsk2.DFC_ElMSvs01_C DFC_DisblMsk2.DFC_PEnvCcMax_C DFC_DisblMsk2.DFC_PEnvCcMin_C DFC_DisblMsk2.DFC_PEnvRngChkMax_C DFC_DisblMsk2.DFC_PEnvRngChkMin_C DFC_DisblMsk2.DFC_PEnvSnsrPlaus_C DFC_DisblMsk2.DFC_BrkBstPmpPlausGenn_C DFC_DisblMsk2.DFC_CbnHeatrRlyLfLoWarn_C DFC_DisblMsk2.DFC_ChgrPlugLockPinByndClsd_C DFC_DisblMsk2.DFC_ChgrPlugLockPinMoveWoCmd_C DFC_DisblMsk2.DFC_ChgrPlugLockPinStuckInClsd_C DFC_DisblMsk2.DFC_ChgrPlugLockPinStuckInOpen_C DFC_DisblMsk2.DFC_ChrgrStErr_C DFC_DisblMsk2.DFC_ComHSN1BusOff_C DFC_DisblMsk2.DFC_ComHSN3BusOff_C DFC_DisblMsk2.DFC_ComVCInval_C DFC_DisblMsk2.DFC_EemDcdcPrecSpdInhb_C DFC_DisblMsk2.DFC_ExpPwrLatch_C DFC_DisblMsk2.DFC_FanMaxOvrd_C DFC_DisblMsk2.DFC_HLCCcsGnrlComErr_C DFC_DisblMsk2.DFC_InmLINNodeHVACPanelAbsnt_C DFC_DisblMsk2.DFC_ResetRcvNotAllwd_C DFC_DisblMsk2.DFC_TelltlCooltPlaus_C DFC_DisblMsk2.DFC_MRlyOL_C DFC_DisblMsk2.DFC_MRlySCB_C DFC_DisblMsk2.DFC_MRlySCG_C DFC_DisblMsk2.DFC_SSpMon1_C DFC_DisblMsk2.DFC_SSpMon1OV_C DFC_DisblMsk2.DFC_SSpMon1SCG_C DFC_DisblMsk2.DFC_SSpMon1UV_C DFC_DisblMsk2.DFC_SSpMon2_C DFC_DisblMsk2.DFC_SSpMon2OV_C DFC_DisblMsk2.DFC_SSpMon2SCG_C DFC_DisblMsk2.DFC_SSpMon2UV_C DFC_DisblMsk2.DFC_SSpMon3_C DFC_DisblMsk2.DFC_SSpMon3OV_C DFC_DisblMsk2.DFC_SSpMon3SCG_C DFC_DisblMsk2.DFC_SSpMon3UV_C DFC_DisblMsk2.DFC_CANTRCV_E_NO_TRCV_CONTROL_0_C DFC_DisblMsk2.DFC_CAN_E_TIMEOUT_C DFC_DisblMsk2.DFC_COMM_E_NET_START_IND_CHANNEL_3_C DFC_DisblMsk2.DFC_COMM_E_NET_START_IND_CHANNEL_4_C DFC_DisblMsk2.DFC_COMM_E_NET_START_IND_CHANNEL_5_C DFC_DisblMsk2.DFC_rba_EcuCtrl_TOMaxProlg_C DFC_DisblMsk2.DFC_rba_EcuCtrl_TOMaxShutDwn_C DFC_DisblMsk2.DFC_rba_MultiStackTrace_Threshold_C DFC_DisblMsk2.DFC_RBA_IOEXTLIB_KEEPALIVE_DRV_C DFC_DisblMsk2.DFC_RBA_IOEXTLIB_KEEPALIVE_INI_C DFC_DisblMsk2.DFC_rba_IoSigRtc_StopCounter_C DFC_DisblMsk2.DFC_rba_MRly_Diag_Stk_Event_C DFC_DisblMsk2.DFC_rba_MemDiag_MemReadErr_C DFC_DisblMsk2.DFC_rba_MemDiag_MemWrErr_C DFC_DisblMsk2.DFC_rba_SyC_IrrSwOffTrigEngRun_Event_C DFC_DisblMsk2.DFC_AcChrgrIntkTSRCMax_C DFC_DisblMsk2.DFC_AcChrgrIntkTTmpErr_C DFC_DisblMsk2.DFC_AcFlt_C DFC_DisblMsk2.DFC_AppAllSnsrDfct_C DFC_DisblMsk2.DFC_BattUPwrFail_C DFC_DisblMsk2.DFC_BrkBstBkupOvrn_C DFC_DisblMsk2.DFC_BrkBstPmpOvld_C DFC_DisblMsk2.DFC_BrkPlausChk_C DFC_DisblMsk2.DFC_CbnHeatgSwtTmpErr_C DFC_DisblMsk2.DFC_CcsPwrLineChpVccSRCMax_C DFC_DisblMsk2.DFC_CcsPwrLineChpVccTmpErr_C DFC_DisblMsk2.DFC_CcsPwrLineComChpTSRCMax_C DFC_DisblMsk2.DFC_CcsPwrLineComChpTTmpErr_C DFC_DisblMsk2.DFC_ChgrPlugCtpCarrFrqErr_C DFC_DisblMsk2.DFC_ChgrPlugCtpSwtStuckClsd_C DFC_DisblMsk2.DFC_ChgrPlugCtpSwtStuckOpen_C DFC_DisblMsk2.DFC_ChgrPlugCtpUErrHi_C DFC_DisblMsk2.DFC_ChgrPlugPxp1SrcErr_C DFC_DisblMsk2.DFC_ChrgCntctAllWldd_C DFC_DisblMsk2.DFC_ChrgCntctNegOperErr_C DFC_DisblMsk2.DFC_ChrgCntctNegOperWarn_C DFC_DisblMsk2.DFC_ChrgCntctNegWldd_C DFC_DisblMsk2.DFC_ChrgCntctPosOperErr_C DFC_DisblMsk2.DFC_ChrgCntctPosOperWarn_C DFC_DisblMsk2.DFC_ChrgCntctPosWldd_C DFC_DisblMsk2.DFC_ChrgCntctStuckOpen_C DFC_DisblMsk2.DFC_ChrgPlgIntlckFaild_C DFC_DisblMsk2.DFC_ChrgnUnplRqrd_C DFC_DisblMsk2.DFC_CoElMOffsCalibActv01_C DFC_DisblMsk2.DFC_CtPSwtDiagSRCMax_C DFC_DisblMsk2.DFC_CtPSwtDiagTmpErr_C DFC_DisblMsk2.DFC_CtpCarrFrqTmpErr_C DFC_DisblMsk2.DFC_DcChrgrIntkT2SRCMax_C DFC_DisblMsk2.DFC_DcChrgrIntkT2TmpErr_C DFC_DisblMsk2.DFC_DcChrgrIntkTSRCMax_C DFC_DisblMsk2.DFC_DcChrgrIntkTTmpErr_C DFC_DisblMsk2.DFC_EChrDvPlinCntrThdExcdd_C DFC_DisblMsk2.DFC_EemDiagCtctrClsTout_C DFC_DisblMsk2.DFC_EemDiagDcdcOffTOut_C DFC_DisblMsk2.DFC_EemDiagHvCnsrOffTOut_C DFC_DisblMsk2.DFC_EemDiagHvbOffTOut_C DFC_DisblMsk2.DFC_FanSpdSRCMax_C DFC_DisblMsk2.DFC_FanSpdTmpErr_C DFC_DisblMsk2.DFC_FreonPSRCMax_C DFC_DisblMsk2.DFC_FreonPTmpErr_C DFC_DisblMsk2.DFC_HeatrCoreTSRCMax_C DFC_DisblMsk2.DFC_HeatrCoreTTmpErr_C DFC_DisblMsk2.DFC_HvGridSocMinLim_C DFC_DisblMsk2.DFC_HvacBlwrFrntFlt_C DFC_DisblMsk2.DFC_HvacEvapElecFlt_C DFC_DisblMsk2.DFC_HvacEvapElecFltGnd_C DFC_DisblMsk2.DFC_HvacKnobPosnFlt_C DFC_DisblMsk2.DFC_InvBinID_C DFC_DisblMsk2.DFC_InvCalID_C DFC_DisblMsk2.DFC_InvErotan_C DFC_DisblMsk2.DFC_InvVinID_C DFC_DisblMsk2.DFC_MOXEMM_SMU_ALM0_0_C DFC_DisblMsk2.DFC_MOXEMM_SMU_ALM0_1_C DFC_DisblMsk2.DFC_MOXEMM_SMU_ALM0_10_C DFC_DisblMsk2.DFC_MOXEMM_SMU_ALM0_11_C DFC_DisblMsk2.DFC_MOXEMM_SMU_ALM0_13_C DFC_DisblMsk2.DFC_MOXEMM_SMU_ALM0_14_C DFC_DisblMsk2.DFC_MOXEMM_SMU_ALM0_2_C DFC_DisblMsk2.DFC_MOXEMM_SMU_ALM0_22_C DFC_DisblMsk2.DFC_MOXEMM_SMU_ALM0_23_C DFC_DisblMsk2.DFC_MOXEMM_SMU_ALM0_4_C DFC_DisblMsk2.DFC_MOXEMM_SMU_ALM0_5_C DFC_DisblMsk2.DFC_MOXEMM_SMU_ALM0_7_C DFC_DisblMsk2.DFC_MOXEMM_SMU_ALM0_8_C DFC_DisblMsk2.DFC_MOXEMM_SMU_ALM10_16_C DFC_DisblMsk2.DFC_MOXEMM_SMU_ALM10_17_C DFC_DisblMsk2.DFC_MOXEMM_SMU_ALM10_21_C DFC_DisblMsk2.DFC_MOXEMM_SMU_ALM11_0_C DFC_DisblMsk2.DFC_MOXEMM_SMU_ALM11_1_C DFC_DisblMsk2.DFC_MOXEMM_SMU_ALM11_2_C DFC_DisblMsk2.DFC_MOXEMM_SMU_ALM11_3_C DFC_DisblMsk2.DFC_MOXEMM_SMU_ALM11_4_C DFC_DisblMsk2.DFC_MOXEMM_SMU_ALM11_5_C DFC_DisblMsk2.DFC_MOXEMM_SMU_ALM11_8_C DFC_DisblMsk2.DFC_MOXEMM_SMU_ALM11_9_C DFC_DisblMsk2.DFC_MOXEMM_SMU_ALM1_0_C DFC_DisblMsk2.DFC_MOXEMM_SMU_ALM1_1_C DFC_DisblMsk2.DFC_MOXEMM_SMU_ALM1_10_C DFC_DisblMsk2.DFC_MOXEMM_SMU_ALM1_11_C DFC_DisblMsk2.DFC_MOXEMM_SMU_ALM1_13_C DFC_DisblMsk2.DFC_MOXEMM_SMU_ALM1_14_C DFC_DisblMsk2.DFC_MOXEMM_SMU_ALM1_2_C DFC_DisblMsk2.DFC_MOXEMM_SMU_ALM1_22_C DFC_DisblMsk2.DFC_MOXEMM_SMU_ALM1_23_C DFC_DisblMsk2.DFC_MOXEMM_SMU_ALM1_4_C DFC_DisblMsk2.DFC_MOXEMM_SMU_ALM1_5_C DFC_DisblMsk2.DFC_MOXEMM_SMU_ALM1_7_C DFC_DisblMsk2.DFC_MOXEMM_SMU_ALM1_8_C DFC_DisblMsk2.DFC_MOXEMM_SMU_ALM21_0_C DFC_DisblMsk2.DFC_MOXEMM_SMU_ALM21_16_C DFC_DisblMsk2.DFC_MOXEMM_SMU_ALM21_3_C DFC_DisblMsk2.DFC_MOXEMM_SMU_ALM2_1_C DFC_DisblMsk2.DFC_MOXEMM_SMU_ALM2_10_C DFC_DisblMsk2.DFC_MOXEMM_SMU_ALM2_11_C DFC_DisblMsk2.DFC_MOXEMM_SMU_ALM2_13_C DFC_DisblMsk2.DFC_MOXEMM_SMU_ALM2_14_C DFC_DisblMsk2.DFC_MOXEMM_SMU_ALM2_22_C DFC_DisblMsk2.DFC_MOXEMM_SMU_ALM2_23_C DFC_DisblMsk2.DFC_MOXEMM_SMU_ALM2_4_C DFC_DisblMsk2.DFC_MOXEMM_SMU_ALM2_5_C DFC_DisblMsk2.DFC_MOXEMM_SMU_ALM2_7_C DFC_DisblMsk2.DFC_MOXEMM_SMU_ALM2_8_C DFC_DisblMsk2.DFC_MOXEMM_SMU_ALM6_0_C DFC_DisblMsk2.DFC_MOXEMM_SMU_ALM6_11_C DFC_DisblMsk2.DFC_MOXEMM_SMU_ALM6_12_C DFC_DisblMsk2.DFC_MOXEMM_SMU_ALM6_14_C DFC_DisblMsk2.DFC_MOXEMM_SMU_ALM6_15_C DFC_DisblMsk2.DFC_MOXEMM_SMU_ALM6_17_C DFC_DisblMsk2.DFC_MOXEMM_SMU_ALM6_18_C DFC_DisblMsk2.DFC_MOXEMM_SMU_ALM6_20_C DFC_DisblMsk2.DFC_MOXEMM_SMU_ALM6_21_C DFC_DisblMsk2.DFC_MOXEMM_SMU_ALM6_25_C DFC_DisblMsk2.DFC_MOXEMM_SMU_ALM6_4_C DFC_DisblMsk2.DFC_MOXEMM_SMU_ALM6_5_C DFC_DisblMsk2.DFC_MOXEMM_SMU_ALM6_7_C DFC_DisblMsk2.DFC_MOXEMM_SMU_ALM6_8_C DFC_DisblMsk2.DFC_MOXEMM_SMU_ALM7_1_C DFC_DisblMsk2.DFC_MOXEMM_SMU_ALM7_12_C DFC_DisblMsk2.DFC_MOXEMM_SMU_ALM7_13_C DFC_DisblMsk2.DFC_MOXEMM_SMU_ALM7_14_C DFC_DisblMsk2.DFC_MOXEMM_SMU_ALM7_15_C DFC_DisblMsk2.DFC_MOXEMM_SMU_ALM7_16_C DFC_DisblMsk2.DFC_MOXEMM_SMU_ALM7_17_C DFC_DisblMsk2.DFC_MOXEMM_SMU_ALM7_2_C DFC_DisblMsk2.DFC_MOXEMM_SMU_ALM7_20_C DFC_DisblMsk2.DFC_MOXEMM_SMU_ALM7_25_C DFC_DisblMsk2.DFC_MOXEMM_SMU_ALM7_26_C DFC_DisblMsk2.DFC_MOXEMM_SMU_ALM7_28_C DFC_DisblMsk2.DFC_MOXEMM_SMU_ALM7_29_C DFC_DisblMsk2.DFC_MOXEMM_SMU_ALM7_30_C DFC_DisblMsk2.DFC_MOXEMM_SMU_ALM7_31_C DFC_DisblMsk2.DFC_MOXEMM_SMU_ALM8_0_C DFC_DisblMsk2.DFC_MOXEMM_SMU_ALM8_1_C DFC_DisblMsk2.DFC_MOXEMM_SMU_ALM8_10_C DFC_DisblMsk2.DFC_MOXEMM_SMU_ALM8_11_C DFC_DisblMsk2.DFC_MOXEMM_SMU_ALM8_12_C DFC_DisblMsk2.DFC_MOXEMM_SMU_ALM8_16_C DFC_DisblMsk2.DFC_MOXEMM_SMU_ALM8_18_C DFC_DisblMsk2.DFC_MOXEMM_SMU_ALM8_2_C DFC_DisblMsk2.DFC_MOXEMM_SMU_ALM8_3_C DFC_DisblMsk2.DFC_MOXEMM_SMU_ALM8_31_C DFC_DisblMsk2.DFC_MOXEMM_SMU_ALM8_4_C DFC_DisblMsk2.DFC_MOXEMM_SMU_ALM9_0_C DFC_DisblMsk2.DFC_MOXEMM_SMU_ALM9_15_C DFC_DisblMsk2.DFC_MOXEMM_SMU_ALM9_3_C DFC_DisblMsk2.DFC_MoCADCNTPBnk1_C DFC_DisblMsk2.DFC_MoCADCTestVoltBnk1_C DFC_DisblMsk2.DFC_MoCSOPICO_C DFC_DisblMsk2.DFC_MoFAccr_C DFC_DisblMsk2.DFC_MoFCbnPreCdngOvrheat_C DFC_DisblMsk2.DFC_MoFCbnPreCdngTmrExpi_C DFC_DisblMsk2.DFC_MoFEvMngtBms_C DFC_DisblMsk2.DFC_MoFEvMngtDcdc_C DFC_DisblMsk2.DFC_MoFEvMngtEm01_C DFC_DisblMsk2.DFC_MoFEvMngtEm01BrkgToZr_C DFC_DisblMsk2.DFC_MoFEvMngtEm01EngSpd_C DFC_DisblMsk2.DFC_MoFEvMngtEm02EngSpd_C DFC_DisblMsk2.DFC_MoFEvMngtEm02Lvl1_C DFC_DisblMsk2.DFC_MoFEvMngtEm02Lvl2_C DFC_DisblMsk2.DFC_MoFExtCptAuxCpt_C DFC_DisblMsk2.DFC_MoFExtCptVacPmpErr_C DFC_DisblMsk2.DFC_MoFTqPtdAxle_C DFC_DisblMsk2.DFC_MoFTqPtdAxleSec_C DFC_DisblMsk2.DFC_MoFTqPtdEmPtRels_C DFC_DisblMsk2.DFC_MoFTqPtdEmPtRelsSec_C DFC_DisblMsk2.DFC_MoFTqPtdEmSign_C DFC_DisblMsk2.DFC_MoFTqPtdEmSignSec_C DFC_DisblMsk2.DFC_MoFTqPtdEmTq_C DFC_DisblMsk2.DFC_MoFTqPtdEmTqSec_C DFC_DisblMsk2.DFC_MoFTqPtdVeh_C DFC_DisblMsk2.DFC_MoFVarPostBldSel_C DFC_DisblMsk2.DFC_MoSysCtrlReIni_C DFC_DisblMsk2.DFC_MoXEMMHwLTMCUFW_C DFC_DisblMsk2.DFC_MoXEMMHwLTMonBIST_C DFC_DisblMsk2.DFC_MoXEMMHwLTRegMonTest_C DFC_DisblMsk2.DFC_MoXEMMHwLTStbySMUAlvTest_C DFC_DisblMsk2.DFC_MoXEMMHwLTTempSens_C DFC_DisblMsk2.DFC_MoXEMMHwLTUCBCfg_C DFC_DisblMsk2.DFC_MonEgyChrgnCoorr_AcChrgnWoMofRels_C DFC_DisblMsk2.DFC_MonEgyChrgnCoorr_ChrgnAbortIgr_C DFC_DisblMsk2.DFC_MonEgyChrgnCoorr_DcCntctFailr_C DFC_DisblMsk2.DFC_MonEgyChrgnCoorr_ExtChrgnShtOffReq_C DFC_DisblMsk2.DFC_MonEgyChrgnCoorr_ImpsChrgnMod_C DFC_DisblMsk2.DFC_MonEgyChrgnCoorr_ImpsChrgnPrms_C DFC_DisblMsk2.DFC_MonEgyChrgnCoorr_ImpsUDcIntk_C DFC_DisblMsk2.DFC_MonEgyChrgnCoorr_PlgLockMovmt_C DFC_DisblMsk2.DFC_MonEgyChrgnCoorr_VehCrashDetn_C DFC_DisblMsk2.DFC_MonEgyChrgnErrReactn_SftySwt_C DFC_DisblMsk2.DFC_MonEgyChrgnInlet_CcsPlgCtp_C DFC_DisblMsk2.DFC_MonEgyChrgnInlet_CcsPlgCtpPwm_C DFC_DisblMsk2.DFC_MonEgyChrgnInlet_CcsPlgLockCtrlImpsAtmpt_C DFC_DisblMsk2.DFC_MonEgyChrgnInlet_CcsPlgLockSnsrSigRngChk_C DFC_DisblMsk2.DFC_MonEgyChrgnInlet_CcsPlgLockStImps_C DFC_DisblMsk2.DFC_MonEgyChrgnInlet_CcsPlgPxp_C DFC_DisblMsk2.DFC_MonEgyChrgnT_Snsr1GrdtChk_C DFC_DisblMsk2.DFC_MonEgyChrgnT_Snsr1SigRngChk_C DFC_DisblMsk2.DFC_MonEgyChrgnT_Snsr2GrdtChk_C DFC_DisblMsk2.DFC_MonEgyChrgnT_Snsr2SigRngChk_C DFC_DisblMsk2.DFC_MonEgyChrgnT_SnsrDif_C DFC_DisblMsk2.DFC_OCWDAABEActv_C DFC_DisblMsk2.DFC_OCWDACom_C DFC_DisblMsk2.DFC_OCWDAErrPin_C DFC_DisblMsk2.DFC_OCWDAOvrVltg_C DFC_DisblMsk2.DFC_PUmax_C DFC_DisblMsk2.DFC_PwmCtPTmpErr_C DFC_DisblMsk2.DFC_PwrDistbnUnitTSRCMax_C DFC_DisblMsk2.DFC_PwrDistbnUnitTTmpErr_C DFC_DisblMsk2.DFC_SCtPmp1DiagGrdKeyErr_C DFC_DisblMsk2.DFC_SRCHighAPP1_C DFC_DisblMsk2.DFC_SRCHighAPP2_C DFC_DisblMsk2.DFC_SRCLowAPP1_C DFC_DisblMsk2.DFC_SRCLowAPP2_C DFC_DisblMsk2.DFC_SWReset_0_C DFC_DisblMsk2.DFC_SWReset_1_C DFC_DisblMsk2.DFC_SWReset_2_C DFC_DisblMsk2.DFC_Sia_InvldCode_C DFC_DisblMsk2.DFC_Sia_InvldKey_C DFC_DisblMsk2.DFC_Sia_NoRespUCx_C DFC_DisblMsk2.DFC_Sia_TprotRttp_C DFC_DisblMsk2.DFC_StrtUpEvStandStillDeactvn_C DFC_DisblMsk2.DFC_SyncAPP_C DFC_DisblMsk2.DFC_UCtPSRCMax_C DFC_DisblMsk2.DFC_UCtPTmpErr_C DFC_DisblMsk2.DFC_UPxP1SRCMax_C DFC_DisblMsk2.DFC_UPxP1TmpErr_C DFC_DisblMsk2.DFC_VehVObd_C /end REF_CHARACTERISTIC
 /begin IN_MEASUREMENT DFC_st.DFC_ACCmprFltLvlRes DFC_st.DFC_AbgHiSigFlt DFC_st.DFC_AbgIntPatFlt DFC_st.DFC_AbgLoSigFlt DFC_st.DFC_AbgUnkwnErrSigFlt DFC_st.DFC_AcExtChrgrIBattExcdd DFC_st.DFC_AcExtChrgrIInExcdd DFC_st.DFC_AcExtChrgrIOutDe DFC_st.DFC_AcExtChrgrIOutExcdd DFC_st.DFC_AcExtChrgrUOutDe DFC_st.DFC_AdpActvDChaFailr DFC_st.DFC_AirbcuFlt DFC_st.DFC_Airbg DFC_st.DFC_AirbgCan DFC_st.DFC_AirbgCanHWPlaus DFC_st.DFC_AirbgHWCanPlaus DFC_st.DFC_AirbgMnr DFC_st.DFC_AirbgPerHi DFC_st.DFC_AirbgPerdRngFlt DFC_st.DFC_BlowrRlyErr DFC_st.DFC_BrkBstPmpActtnDfct DFC_st.DFC_BrkBstPmpDeactvnDfct DFC_st.DFC_BrkSwtFlt DFC_st.DFC_CbnHeatgHeatrHsScb DFC_st.DFC_CbnHeatgHeatrHsScg DFC_st.DFC_CbnHeatgHeatrLsOl DFC_st.DFC_CbnHeatgHeatrLsScb DFC_st.DFC_CbnHeatgHeatrLsScg DFC_st.DFC_CbnHeatgHeatrUnUsed DFC_st.DFC_ChrgnCntctHsOt DFC_st.DFC_ChrgnCntctHsScb DFC_st.DFC_ChrgnCntctHsScg DFC_st.DFC_ChrgnCntctLsNegOl DFC_st.DFC_ChrgnCntctLsNegOt DFC_st.DFC_ChrgnCntctLsNegScb DFC_st.DFC_ChrgnCntctLsNegScg DFC_st.DFC_ChrgnCntctLsPosOl DFC_st.DFC_ChrgnCntctLsPosOt DFC_st.DFC_ChrgnCntctLsPosScb DFC_st.DFC_ChrgnCntctLsPosScg DFC_st.DFC_ChrgnCntctUnUsed DFC_st.DFC_ComBrkMai DFC_st.DFC_ComChrgrEVCont DFC_st.DFC_ComChrgrEVtBlink DFC_st.DFC_ComChrgrMstBlink DFC_st.DFC_ComChrgrMstCont DFC_st.DFC_ComChrgrSVSBlink DFC_st.DFC_ComChrgrSVSCont DFC_st.DFC_ComDcdcEVBlink DFC_st.DFC_ComDcdcEVCont DFC_st.DFC_ComDcdcFltLvl2 DFC_st.DFC_ComDcdcFltLvl3 DFC_st.DFC_ComDcdcFltLvl4 DFC_st.DFC_ComDcdcFltLvl5 DFC_st.DFC_ComDcdcFltLvlRes DFC_st.DFC_ComDcdcMstBlink DFC_st.DFC_ComDcdcMstCont DFC_st.DFC_ComDcdcSVSBlink DFC_st.DFC_ComDcdcSVSCont DFC_st.DFC_ComElMIIvtrFltLvl2 DFC_st.DFC_ComElMIIvtrFltLvl3 DFC_st.DFC_ComElMIIvtrFltLvl4 DFC_st.DFC_ComElMIIvtrFltLvl5 DFC_st.DFC_ComElMIIvtrFltLvlRes DFC_st.DFC_ComEmacEVBlink DFC_st.DFC_ComEmacEVCont DFC_st.DFC_ComEmacMstCont DFC_st.DFC_ComEmacMsttBlink DFC_st.DFC_ComEmacSVSBlink DFC_st.DFC_ComEmacSVSCont DFC_st.DFC_ComGunCntInfoWkuReq DFC_st.DFC_ComHillHldFlt DFC_st.DFC_ComHvBattRchrgWkuReq DFC_st.DFC_ComHvbFltLvl2 DFC_st.DFC_ComHvbFltLvl3 DFC_st.DFC_ComHvbFltLvl4 DFC_st.DFC_ComHvbFltLvl5 DFC_st.DFC_ComHvbFltLvlRes DFC_st.DFC_ComHvbMstBlink DFC_st.DFC_ComHvbMstCont DFC_st.DFC_ComImmoUnlockWkuReq DFC_st.DFC_ComInfoReqPtlWkuReq DFC_st.DFC_ComOBCFltLvl2 DFC_st.DFC_ComOBCFltLvl3 DFC_st.DFC_ComOBCFltLvl4 DFC_st.DFC_ComOBCFltLvl5 DFC_st.DFC_ComOBCFltLvlRes DFC_st.DFC_ComPostOperationWkuReq DFC_st.DFC_ComPreCondElecWkuReq DFC_st.DFC_ComRemUnlckWkuReq DFC_st.DFC_ComStpDlyHMIWkuReq DFC_st.DFC_ComflgCurMeasmtErr DFC_st.DFC_ComflgCurMeasmtSysErr DFC_st.DFC_ComflgCurMeasmtVld DFC_st.DFC_ComflgCurRngErr DFC_st.DFC_ComflgTPcbMeasmtErr DFC_st.DFC_ComflgTPcbMeasmtVld DFC_st.DFC_ComflgTPcbRngErr DFC_st.DFC_ComflgTPcbSysErr DFC_st.DFC_ComflgTShntMeasmtErr DFC_st.DFC_ComflgTShntMeasmtVld DFC_st.DFC_ComflgTShntRngErr DFC_st.DFC_ComflgTShntSysErr DFC_st.DFC_ComflgVoltMeasmtErr DFC_st.DFC_ComflgVoltMeasmtSysErr DFC_st.DFC_ComflgVoltMeasmtVld DFC_st.DFC_ComflgVoltRngErr DFC_st.DFC_CrashEveOcc DFC_st.DFC_DcdcFwdModStuck DFC_st.DFC_DcdcLvUDifMaxFlt DFC_st.DFC_DcdcOffModStuck DFC_st.DFC_DcdcOperModFailr DFC_st.DFC_DcdcPrecModStuck DFC_st.DFC_DrvDoorOpn DFC_st.DFC_DrvModPosnDfct DFC_st.DFC_DrvStbltOpn DFC_st.DFC_ETogFailrLvl3 DFC_st.DFC_ETogFailrLvl4 DFC_st.DFC_EbsLvBattSocDiagLo DFC_st.DFC_EbsLvBattUDiagDiOper DFC_st.DFC_EbsLvBattUDiagFltLvl1 DFC_st.DFC_EbsLvBattUDiagFltLvl2 DFC_st.DFC_EbsLvBattUDiagLo DFC_st.DFC_EbsSnsrSt DFC_st.DFC_EbsSofASILErr DFC_st.DFC_ElTSPtSysLimDrvErr DFC_st.DFC_ElTSPtSysLimRgnErr DFC_st.DFC_HLCCcsFwDwnl DFC_st.DFC_HvBattChrgPwrMax DFC_st.DFC_HvBattCrashDetd DFC_st.DFC_HvBattDchaPwrMax DFC_st.DFC_HvBattEmgyOff DFC_st.DFC_HvBattEmgyOffIntlck DFC_st.DFC_HvBattEmgyOffReq DFC_st.DFC_HvBattFltMod DFC_st.DFC_HvBattIReqToChrgrErr DFC_st.DFC_HvBattIReqToChrgrIni DFC_st.DFC_HvBattIninTout DFC_st.DFC_HvBattIntlckSt DFC_st.DFC_HvBattIsoFlt DFC_st.DFC_HvBattLimdPwr DFC_st.DFC_HvBattMaiSwtClsngFlt DFC_st.DFC_HvBattMaiSwtFlt DFC_st.DFC_HvBattMaiSwtOpen DFC_st.DFC_HvBattMaiSwtOpngFlt DFC_st.DFC_HvBattMaiSwtWldd DFC_st.DFC_HvBattNegCntctrCntErr DFC_st.DFC_HvBattOperModChrgPlausy DFC_st.DFC_HvBattOverTDern DFC_st.DFC_HvBattPosCntctrCntErr DFC_st.DFC_HvBattPrecCntctrCntErr DFC_st.DFC_HvBattPwrDistbnTDern DFC_st.DFC_HvBattPwrDistbnTInhbn DFC_st.DFC_HvBattRatRSohErr DFC_st.DFC_HvBattRatSohErr DFC_st.DFC_HvBattSngIsoWarn DFC_st.DFC_HvBattSrvPlgDiscnct DFC_st.DFC_HvBattUNomChrgnErr DFC_st.DFC_HvBattUNomChrgnIni DFC_st.DFC_HvBattUnderTDern DFC_st.DFC_HvbEVLmpBlink DFC_st.DFC_HvbEVLmpCont DFC_st.DFC_HvbSVSBlink DFC_st.DFC_HvbSVSCont DFC_st.DFC_InmLINBusBlk DFC_st.DFC_PDUProgmFailr DFC_st.DFC_PEnvSigRngMax DFC_st.DFC_PEnvSigRngMin DFC_st.DFC_PLnCChpDeactvnFaild DFC_st.DFC_PrkgBrkFailr DFC_st.DFC_PtSysLimErr DFC_st.DFC_PwrMaxDchaShoLo DFC_st.DFC_SCtPmp1FailSafeNotSuc DFC_st.DFC_SCtPmp1SCG DFC_st.DFC_VehCoornDrvrNotPrsnt DFC_st.DFC_VehVCanAvl DFC_st.DFC_VehVCanErr DFC_st.DFC_eTogFailrLvlRes DFC_st.DFC_flgBrkMaiDiag DFC_st.DFC_stHvbIsoMeasmtRes DFC_st.DFC_BrkBstPmpPLeakDfct DFC_st.DFC_Com082hTooShort DFC_st.DFC_Com092hTooShort DFC_st.DFC_Com205hAbsent DFC_st.DFC_Com205hChecksum DFC_st.DFC_Com205hCounter DFC_st.DFC_Com205hTooShort DFC_st.DFC_Com217hAbsent DFC_st.DFC_Com217hChecksum DFC_st.DFC_Com217hCounter DFC_st.DFC_Com217hTooShort DFC_st.DFC_Com227hAbsent DFC_st.DFC_Com227hTooShort DFC_st.DFC_Com237hAbsent DFC_st.DFC_Com237hChecksum DFC_st.DFC_Com237hCounter DFC_st.DFC_Com237hTooShort DFC_st.DFC_Com259hAbsent DFC_st.DFC_Com259hChecksum DFC_st.DFC_Com259hCounter DFC_st.DFC_Com259hTooShort DFC_st.DFC_Com26hAbsent DFC_st.DFC_Com26hTooShort DFC_st.DFC_Com273hAbsent DFC_st.DFC_Com273hChecksum DFC_st.DFC_Com273hCounter DFC_st.DFC_Com273hTooShort DFC_st.DFC_Com275hAbsent DFC_st.DFC_Com275hChecksum DFC_st.DFC_Com275hCounter DFC_st.DFC_Com275hTooShort DFC_st.DFC_Com283hAbsent DFC_st.DFC_Com283hTooShort DFC_st.DFC_Com285hAbsent DFC_st.DFC_Com285hChecksum DFC_st.DFC_Com285hCounter DFC_st.DFC_Com285hTooShort DFC_st.DFC_Com293hAbsent DFC_st.DFC_Com293hChecksum DFC_st.DFC_Com293hCounter DFC_st.DFC_Com293hTooShort DFC_st.DFC_Com308hAbsent DFC_st.DFC_Com308hChecksum DFC_st.DFC_Com308hCounter DFC_st.DFC_Com308hTooShort DFC_st.DFC_Com318hAbsent DFC_st.DFC_Com318hChecksum DFC_st.DFC_Com318hCounter DFC_st.DFC_Com318hTooShort DFC_st.DFC_Com325hAbsent DFC_st.DFC_Com325hChecksum DFC_st.DFC_Com325hCounter DFC_st.DFC_Com325hTooShort DFC_st.DFC_Com335hAbsent DFC_st.DFC_Com335hChecksum DFC_st.DFC_Com335hCounter DFC_st.DFC_Com335hTooShort DFC_st.DFC_Com351hAbsent DFC_st.DFC_Com351hTooShort DFC_st.DFC_Com38DhAbsent DFC_st.DFC_Com38DhChecksum DFC_st.DFC_Com38DhCounter DFC_st.DFC_Com38DhTooShort DFC_st.DFC_Com412hAbsent DFC_st.DFC_Com412hChecksum DFC_st.DFC_Com412hCounter DFC_st.DFC_Com412hTooShort DFC_st.DFC_Com427hAbsent DFC_st.DFC_Com427hTooShort DFC_st.DFC_Com432hAbsent DFC_st.DFC_Com432hChecksum DFC_st.DFC_Com432hCounter DFC_st.DFC_Com432hTooShort DFC_st.DFC_Com435hAbsent DFC_st.DFC_Com435hTooShort DFC_st.DFC_Com442hAbsent DFC_st.DFC_Com442hTooShort DFC_st.DFC_Com453hAbsent DFC_st.DFC_Com453hTooShort DFC_st.DFC_Com455hAbsent DFC_st.DFC_Com455hTooShort DFC_st.DFC_Com463hAbsent DFC_st.DFC_Com463hTooShort DFC_st.DFC_Com473hAbsent DFC_st.DFC_Com473hTooShort DFC_st.DFC_Com47BhAbsent DFC_st.DFC_Com47BhTooShort DFC_st.DFC_Com48BhAbsent DFC_st.DFC_Com48BhTooShort DFC_st.DFC_Com497hTooShort DFC_st.DFC_Com4F2hAbsent DFC_st.DFC_Com4F2hChecksum DFC_st.DFC_Com4F2hCounter DFC_st.DFC_Com4F2hTooShort DFC_st.DFC_Com50DhAbsent DFC_st.DFC_Com50DhTooShort DFC_st.DFC_Com535hAbsent DFC_st.DFC_Com535hTooShort DFC_st.DFC_Com543hAbsent DFC_st.DFC_Com543hTooShort DFC_st.DFC_Com552hAbsent DFC_st.DFC_Com552hTooShort DFC_st.DFC_Com583hAbsent DFC_st.DFC_Com583hTooShort DFC_st.DFC_Com592hAbsent DFC_st.DFC_Com592hChecksum DFC_st.DFC_Com592hCounter DFC_st.DFC_Com592hTooShort DFC_st.DFC_Com595hAbsent DFC_st.DFC_Com595hChecksum DFC_st.DFC_Com595hCounter DFC_st.DFC_Com595hTooShort DFC_st.DFC_Com5B2hAbsent DFC_st.DFC_Com5B2hTooShort DFC_st.DFC_Com5B5hAbsent DFC_st.DFC_Com5B5hChecksum DFC_st.DFC_Com5B5hCounter DFC_st.DFC_Com5B5hTooShort DFC_st.DFC_Com5C7hTooShort DFC_st.DFC_Com5E7hAbsent DFC_st.DFC_Com5E7hTooShort DFC_st.DFC_Com635hTooShort DFC_st.DFC_Com645hTooShort DFC_st.DFC_Com663hAbsent DFC_st.DFC_Com663hTooShort DFC_st.DFC_Com665hAbsent DFC_st.DFC_Com665hTooShort DFC_st.DFC_Com675hAbsent DFC_st.DFC_Com675hTooShort DFC_st.DFC_ComFrbd_205h_HVBAT_PACK_CURRENT DFC_st.DFC_ComFrbd_205h_HVBAT_SOC_DISPLAY DFC_st.DFC_ComFrbd_205h_HVBAT_VOLTAGE DFC_st.DFC_ComFrbd_217h_INV_DC_BUS_VOLTAGE DFC_st.DFC_ComFrbd_217h_INV_MTR_ACTUAL_TRQ DFC_st.DFC_ComFrbd_217h_INV_MTR_SPEED DFC_st.DFC_ComFrbd_217h_INV_MTR_TRQ DFC_st.DFC_ComFrbd_227h_INV_DC_CURRENT DFC_st.DFC_ComFrbd_227h_INV_MOTORING_PEAK_TRQ DFC_st.DFC_ComFrbd_227h_INV_MTR_INST_INPUT_POWER DFC_st.DFC_ComFrbd_227h_INV_REGEN_PEAK_TRQ DFC_st.DFC_ComFrbd_237h_INV_ACTIVE_DISCHARGE_STATUS DFC_st.DFC_ComFrbd_237h_INV_CTRL_MODE_ACK DFC_st.DFC_ComFrbd_237h_INV_EV_WARNING DFC_st.DFC_ComFrbd_237h_INV_FAULT_LEVEL DFC_st.DFC_ComFrbd_237h_INV_MASTER_STOP DFC_st.DFC_ComFrbd_237h_INV_SERVICE_DUE DFC_st.DFC_ComFrbd_237h_INV_STAB_MIN_TRQ DFC_st.DFC_ComFrbd_259h_TGLM_FAILURE_STATE DFC_st.DFC_ComFrbd_259h_TGLM_MODE_PUSH DFC_st.DFC_ComFrbd_259h_TOGGLE_MONOSTABLE_POS DFC_st.DFC_ComFrbd_273h_OBC_outputpower_capability DFC_st.DFC_ComFrbd_275h_HVBAT_DISCHARGE_30S_AVAILABLE_CURRENT DFC_st.DFC_ComFrbd_275h_HVBAT_DISCHARGE_30S_AVAILABLE_POWER DFC_st.DFC_ComFrbd_283h_DCDC_IN_CURRENT DFC_st.DFC_ComFrbd_283h_DCDC_IN_VOLTAGE DFC_st.DFC_ComFrbd_283h_DCDC_OUT_CURRENT DFC_st.DFC_ComFrbd_283h_DCDC_OUT_VOLTAGE DFC_st.DFC_ComFrbd_285h_HVBAT_REGEN_CHG_30S_CURRENT_LIMIT DFC_st.DFC_ComFrbd_285h_HVBAT_REGEN_CHRG_30S_POWER_LIMIT DFC_st.DFC_ComFrbd_293h_DCDC_outputpower_capability DFC_st.DFC_ComFrbd_325h_HVBAT_INSULATION_RESISTANCE DFC_st.DFC_ComFrbd_325h_HVBAT_TEMPERATURE DFC_st.DFC_ComFrbd_335h_HVBAT_CHRG_CONTINUOUS_CURR_MAX DFC_st.DFC_ComFrbd_335h_HVBAT_CHRG_COTINUOUS_CURR_REQ DFC_st.DFC_ComFrbd_335h_HVBAT_CHRG_MAX_VOLT DFC_st.DFC_ComFrbd_335h_HVBAT_DC_BUS_VOLTAGE DFC_st.DFC_ComFrbd_427h_INV_OP_MODE DFC_st.DFC_ComFrbd_427h_INV_PERMISIBLE_TORQUE DFC_st.DFC_ComFrbd_435h_HVBAT_MAX_CELL_VOLT DFC_st.DFC_ComFrbd_435h_HVBAT_MAX_CELL_VOLT_NUM DFC_st.DFC_ComFrbd_435h_HVBAT_MAX_SENSOR_TEMP DFC_st.DFC_ComFrbd_435h_HVBAT_MIN_CELL_VOLT DFC_st.DFC_ComFrbd_435h_HVBAT_MIN_CELL_VOLT_NUM DFC_st.DFC_ComFrbd_453h_OBC_IN_CURRENT DFC_st.DFC_ComFrbd_453h_OBC_IN_VOLTAGE DFC_st.DFC_ComFrbd_453h_OBC_IP_POWER DFC_st.DFC_ComFrbd_455h_HVBAT_NOMINAL_VOLTAGE DFC_st.DFC_ComFrbd_463h_OBC_OUT_CURRENT DFC_st.DFC_ComFrbd_463h_OBC_OUT_VOLTAGE DFC_st.DFC_ComFrbd_463h_OBC_TEMPERATURE DFC_st.DFC_ComFrbd_473h_DCDC_Coolant_Temperature DFC_st.DFC_ComFrbd_473h_DCDC_TEMPERATURE DFC_st.DFC_ComFrbd_47Bh_eCOMP_BusBarCurrent DFC_st.DFC_ComFrbd_47Bh_eCOMP_BusBarVoltage DFC_st.DFC_ComFrbd_47Bh_eCOMP_CompressorSpeed DFC_st.DFC_ComFrbd_47Bh_eCOMP_IGBT_Temp DFC_st.DFC_ComFrbd_47Bh_eCOMP_PeakPhaCurrent DFC_st.DFC_ComFrbd_47Bh_eCOMP_Power_consumption DFC_st.DFC_ComFrbd_48Bh_eCOMP_Fault_Level DFC_st.DFC_ComFrbd_4F2h_VALEUR_SOC_ETENDUE DFC_st.DFC_ComFrbd_535h_HV_BATT_TEMP_AVG DFC_st.DFC_ComFrbd_543h_HVBAT_RESTBATTENERGY DFC_st.DFC_ComFrbd_543h_HVBAT_SOH DFC_st.DFC_ComFrbd_543h_HV_BATT_SOH_RES DFC_st.DFC_ComFrbd_592h_IBATT_1 DFC_st.DFC_ComFrbd_592h_IBATT_2 DFC_st.DFC_ComFrbd_592h_IBATT_3 DFC_st.DFC_ComFrbd_592h_TEMP_BATT DFC_st.DFC_ComFrbd_592h_U_BATT_BECB DFC_st.DFC_ComFrbd_595h_HVBAT_TIME_TO_CHRG_80 DFC_st.DFC_ComFrbd_5B2h_TEMP_AIR_EXT DFC_st.DFC_ComFrbd_635h_HVBAT_NEG_CONT_COUNT_SEG1 DFC_st.DFC_ComFrbd_635h_HVBAT_NEG_CONT_COUNT_SEG3 DFC_st.DFC_ComFrbd_635h_HVBAT_NEG_CONT_COUNT_SEG4 DFC_st.DFC_ComFrbd_635h_HVBAT_PST_CONT_COUNT_SEG1 DFC_st.DFC_ComFrbd_635h_HVBAT_PST_CONT_COUNT_SEG3 DFC_st.DFC_ComFrbd_635h_HVBAT_PST_CONT_COUNT_SEG4 DFC_st.DFC_ComFrbd_645h_HVBAT_PRECHRGE_CONT_COUNT_SEG1 DFC_st.DFC_ComFrbd_645h_HVBAT_PRECHRGE_CONT_COUNT_SEG2 DFC_st.DFC_ComFrbd_675h_HVBAT_REMAININGBATTCAPACITY DFC_st.DFC_ComInvld_205h_HVBAT_CHARGING_STATUS DFC_st.DFC_ComInvld_205h_HVBAT_PACK_CURRENT DFC_st.DFC_ComInvld_205h_HVBAT_SOC_DISPLAY DFC_st.DFC_ComInvld_205h_HVBAT_VOLTAGE DFC_st.DFC_ComInvld_217h_INV_DC_BUS_VOLTAGE DFC_st.DFC_ComInvld_217h_INV_MTR_ACTUAL_TRQ DFC_st.DFC_ComInvld_217h_INV_MTR_SPEED DFC_st.DFC_ComInvld_217h_INV_MTR_TRQ DFC_st.DFC_ComInvld_227h_INV_DC_CURRENT DFC_st.DFC_ComInvld_227h_INV_MOTORING_PEAK_TRQ DFC_st.DFC_ComInvld_227h_INV_MTR_INST_INPUT_POWER DFC_st.DFC_ComInvld_227h_INV_REGEN_PEAK_TRQ DFC_st.DFC_ComInvld_237h_INV_ACTIVE_DISCHARGE_STATUS DFC_st.DFC_ComInvld_237h_INV_FAULT_LEVEL DFC_st.DFC_ComInvld_237h_INV_STAB_MIN_TRQ DFC_st.DFC_ComInvld_259h_TGLM_MODE_PUSH DFC_st.DFC_ComInvld_259h_TOGGLE_MONOSTABLE_POS DFC_st.DFC_ComInvld_26h_AC_SWITCH_REQ DFC_st.DFC_ComInvld_26h_BLOWER_POSITION DFC_st.DFC_ComInvld_26h_EVAP_SENSOR_FAULT DFC_st.DFC_ComInvld_26h_EVAP_SENSOR_VALUE DFC_st.DFC_ComInvld_26h_POTENTIOMETER_FAULT DFC_st.DFC_ComInvld_26h_REAR_DEFOG_REQ DFC_st.DFC_ComInvld_26h_TEMP_POSITION DFC_st.DFC_ComInvld_273h_OBC_FAULT_LEVEL DFC_st.DFC_ComInvld_273h_OBC_outputpower_capability DFC_st.DFC_ComInvld_275h_HVBAT_DISCHARGE_30S_AVAILABLE_CURRENT DFC_st.DFC_ComInvld_275h_HVBAT_DISCHARGE_30S_AVAILABLE_POWER DFC_st.DFC_ComInvld_283h_DCDC_IN_CURRENT DFC_st.DFC_ComInvld_283h_DCDC_IN_VOLTAGE DFC_st.DFC_ComInvld_283h_DCDC_OUT_CURRENT DFC_st.DFC_ComInvld_283h_DCDC_OUT_VOLTAGE DFC_st.DFC_ComInvld_285h_HVBAT_REGEN_CHG_30S_CURRENT_LIMIT DFC_st.DFC_ComInvld_285h_HVBAT_REGEN_CHRG_30S_POWER_LIMIT DFC_st.DFC_ComInvld_293h_DCDC_FAULT_LEVEL DFC_st.DFC_ComInvld_293h_DCDC_outputpower_capability DFC_st.DFC_ComInvld_325h_HVBAT_EPLUG_STATUS DFC_st.DFC_ComInvld_325h_HVBAT_HVIL_STS DFC_st.DFC_ComInvld_325h_HVBAT_INSULATION_FAULT DFC_st.DFC_ComInvld_325h_HVBAT_INSULATION_RESISTANCE DFC_st.DFC_ComInvld_325h_HVBAT_TEMPERATURE DFC_st.DFC_ComInvld_335h_HVBAT_CHRG_CONTINUOUS_CURR_MAX DFC_st.DFC_ComInvld_335h_HVBAT_CHRG_COTINUOUS_CURR_REQ DFC_st.DFC_ComInvld_335h_HVBAT_CHRG_MAX_VOLT DFC_st.DFC_ComInvld_335h_HVBAT_DC_BUS_VOLTAGE DFC_st.DFC_ComInvld_38Dh_VITESSE_VEHICULE_ROUES DFC_st.DFC_ComInvld_38Dh_VVH_INDISP DFC_st.DFC_ComInvld_427h_INV_COOLANT_TEMP DFC_st.DFC_ComInvld_427h_INV_MOTOR_TEMP DFC_st.DFC_ComInvld_427h_INV_OP_MODE DFC_st.DFC_ComInvld_427h_INV_PERMISIBLE_TORQUE DFC_st.DFC_ComInvld_427h_INV_TEMP DFC_st.DFC_ComInvld_432h_REVEIL_PRINCIPAL DFC_st.DFC_ComInvld_435h_HVBAT_MAX_CELL_VOLT DFC_st.DFC_ComInvld_435h_HVBAT_MAX_CELL_VOLT_NUM DFC_st.DFC_ComInvld_435h_HVBAT_MAX_SENSOR_TEMP DFC_st.DFC_ComInvld_435h_HVBAT_MIN_CELL_VOLT DFC_st.DFC_ComInvld_435h_HVBAT_MIN_CELL_VOLT_NUM DFC_st.DFC_ComInvld_442h_BCCM_BLOWER_RELAY_STS DFC_st.DFC_ComInvld_453h_OBC_IN_CURRENT DFC_st.DFC_ComInvld_453h_OBC_IN_VOLTAGE DFC_st.DFC_ComInvld_453h_OBC_IP_POWER DFC_st.DFC_ComInvld_455h_HVBAT_NOMINAL_VOLTAGE DFC_st.DFC_ComInvld_463h_OBC_OUT_CURRENT DFC_st.DFC_ComInvld_463h_OBC_OUT_VOLTAGE DFC_st.DFC_ComInvld_463h_OBC_TEMPERATURE DFC_st.DFC_ComInvld_473h_DCDC_Coolant_Temperature DFC_st.DFC_ComInvld_473h_DCDC_TEMPERATURE DFC_st.DFC_ComInvld_47Bh_eCOMP_BusBarCurrent DFC_st.DFC_ComInvld_47Bh_eCOMP_BusBarVoltage DFC_st.DFC_ComInvld_47Bh_eCOMP_CompressorSpeed DFC_st.DFC_ComInvld_47Bh_eCOMP_IGBT_Temp DFC_st.DFC_ComInvld_47Bh_eCOMP_PeakPhaCurrent DFC_st.DFC_ComInvld_47Bh_eCOMP_Power_consumption DFC_st.DFC_ComInvld_4F2h_STATUS_SOC DFC_st.DFC_ComInvld_4F2h_TEMP_BATT_STATUS DFC_st.DFC_ComInvld_4F2h_VALEUR_SOC_ETENDUE DFC_st.DFC_ComInvld_535h_HV_BATT_TEMP_AVG DFC_st.DFC_ComInvld_543h_HVBAT_RESTBATTENERGY DFC_st.DFC_ComInvld_543h_HVBAT_SOH DFC_st.DFC_ComInvld_543h_HV_BATT_SOH_RES DFC_st.DFC_ComInvld_552h_CPT_TEMPOREL DFC_st.DFC_ComInvld_552h_KILOMETRAGE DFC_st.DFC_ComInvld_583h_HV_BATT_DISCONT_CSE_OPEN DFC_st.DFC_ComInvld_592h_CALIBRE_IBATT DFC_st.DFC_ComInvld_592h_IBATT_1 DFC_st.DFC_ComInvld_592h_IBATT_2 DFC_st.DFC_ComInvld_592h_IBATT_3 DFC_st.DFC_ComInvld_592h_TEMP_BATT DFC_st.DFC_ComInvld_592h_U_BATT_BECB DFC_st.DFC_ComInvld_595h_HVBAT_TIME_TO_CHRG_80 DFC_st.DFC_ComInvld_5B2h_TEMP_AIR_EXT DFC_st.DFC_ComInvld_5B5h_HVBAT_THERMAL_RUNAWAY DFC_st.DFC_ComInvld_635h_HVBAT_NEG_CONT_COUNT_SEG1 DFC_st.DFC_ComInvld_635h_HVBAT_NEG_CONT_COUNT_SEG3 DFC_st.DFC_ComInvld_635h_HVBAT_NEG_CONT_COUNT_SEG4 DFC_st.DFC_ComInvld_635h_HVBAT_PST_CONT_COUNT_SEG1 DFC_st.DFC_ComInvld_635h_HVBAT_PST_CONT_COUNT_SEG3 DFC_st.DFC_ComInvld_635h_HVBAT_PST_CONT_COUNT_SEG4 DFC_st.DFC_ComInvld_645h_HVBAT_PRECHRGE_CONT_COUNT_SEG1 DFC_st.DFC_ComInvld_645h_HVBAT_PRECHRGE_CONT_COUNT_SEG2 DFC_st.DFC_ComInvld_675h_HVBAT_REMAININGBATTCAPACITY DFC_st.DFC_ACCmprFltLvl1 DFC_st.DFC_ACCmprFltLvl2 DFC_st.DFC_ACCmprFltLvl3 DFC_st.DFC_ACCmprFltLvl4 DFC_st.DFC_ACCmprHiPFlt DFC_st.DFC_ACCmprInvldCmprSt DFC_st.DFC_ACCmprInvldElecActPwr DFC_st.DFC_ACCmprLoPFlt DFC_st.DFC_AcChrgrIntkTSRCMin DFC_st.DFC_BattUBMaxBatt DFC_st.DFC_BattUBMaxNoBatt DFC_st.DFC_BattUBMinBatt DFC_st.DFC_BattUBMinNoBatt DFC_st.DFC_BattUSRCMax DFC_st.DFC_BattUSRCMin DFC_st.DFC_BrkBstPHiCautionDfct DFC_st.DFC_BrkBstPHiWarnDfct DFC_st.DFC_BrkBstPSnsr12PlausDfct DFC_st.DFC_BrkBstPSnsr1Scb DFC_st.DFC_BrkBstPSnsr1Scg DFC_st.DFC_BrkBstPSnsr2Scb DFC_st.DFC_BrkBstPSnsr2Scg DFC_st.DFC_BrkBstPSnsrMax DFC_st.DFC_BrkBstPSnsrMin DFC_st.DFC_BrkBstPhyRngChkMax DFC_st.DFC_BrkBstPhyRngChkMin DFC_st.DFC_BrkBstPmpHsScb DFC_st.DFC_BrkBstPmpHsScg DFC_st.DFC_BrkBstPmpLsOl DFC_st.DFC_BrkBstPmpLsScb DFC_st.DFC_BrkBstPmpLsScg DFC_st.DFC_CbnHeatgHeatrRlyOpend DFC_st.DFC_CbnHeatgHeatrRlyWldd DFC_st.DFC_CcsDcIBattExcdd DFC_st.DFC_CcsDcIEvseOutDe DFC_st.DFC_CcsDcIOutDe DFC_st.DFC_CcsDcIOutExcdd DFC_st.DFC_CcsDcUOutDe DFC_st.DFC_CcsDcUOutExcdd DFC_st.DFC_CcsPwrLineChpRstOL DFC_st.DFC_CcsPwrLineChpRstOvrTemp DFC_st.DFC_CcsPwrLineChpRstSCB DFC_st.DFC_CcsPwrLineChpRstSCG DFC_st.DFC_CcsPwrLineChpVccEnaOL DFC_st.DFC_CcsPwrLineChpVccEnaOvrTemp DFC_st.DFC_CcsPwrLineChpVccEnaSCB DFC_st.DFC_CcsPwrLineChpVccEnaSCG DFC_st.DFC_CcsPwrLineChpVccSRCMin DFC_st.DFC_CcsPwrLineComChpTSRCMin DFC_st.DFC_CtPSwtActrOL DFC_st.DFC_CtPSwtActrOvrTemp DFC_st.DFC_CtPSwtActrSCB DFC_st.DFC_CtPSwtActrSCG DFC_st.DFC_CtPSwtDiagSRCMin DFC_st.DFC_CtpCarrFrqSRCMin DFC_st.DFC_DcChrgrIntkT2SRCMin DFC_st.DFC_DcChrgrIntkTSRCMin DFC_st.DFC_DevLibBattUHi DFC_st.DFC_DevLibBattULo DFC_st.DFC_EmWakeupSigOL DFC_st.DFC_EmWakeupSigOvrTemp DFC_st.DFC_EmWakeupSigSCB DFC_st.DFC_EmWakeupSigSCG DFC_st.DFC_Fan1OL DFC_st.DFC_Fan1OvrTemp DFC_st.DFC_Fan1SCB DFC_st.DFC_FanRlySCB DFC_st.DFC_FanRlySCG DFC_st.DFC_FanSpdSRCMin DFC_st.DFC_FreonPSRCMin DFC_st.DFC_HLCCcsPLnCChipTHi DFC_st.DFC_HeatrCoreTSRCMin DFC_st.DFC_PwmCtPSRCMin DFC_st.DFC_PwrDistbnUnitTSRCMin DFC_st.DFC_SCtPmp1OL DFC_st.DFC_SCtPmp1OvrTemp DFC_st.DFC_SCtPmp1SCB DFC_st.DFC_SCtPmpRlyOL DFC_st.DFC_SCtPmpRlyOvrTemp DFC_st.DFC_SCtPmpRlySCB DFC_st.DFC_SpplCooltPmpRlyOL DFC_st.DFC_SpplCooltPmpRlyOvrTemp DFC_st.DFC_SpplCooltPmpRlySCB DFC_st.DFC_UCtPSRCMin DFC_st.DFC_UPxP1SRCMin DFC_st.DFC_ComHSN1CANMute DFC_st.DFC_ComHSN3CANMute DFC_st.DFC_AcChrgrIntkTPhysRngHi DFC_st.DFC_AcChrgrIntkTPhysRngLo DFC_st.DFC_AcChrgrIntkTSRCOpn DFC_st.DFC_CcsPwrLineChpVccPhysRngHi DFC_st.DFC_CcsPwrLineChpVccPhysRngLo DFC_st.DFC_CcsPwrLineChpVccSRCOpn DFC_st.DFC_CcsPwrLineComChpTPhysRngHi DFC_st.DFC_CcsPwrLineComChpTPhysRngLo DFC_st.DFC_CcsPwrLineComChpTSRCOpn DFC_st.DFC_CtPSwtDiagPhysRngHi DFC_st.DFC_CtPSwtDiagPhysRngLo DFC_st.DFC_CtPSwtDiagSRCOpn DFC_st.DFC_CtpCarrFrqPhysRngHi DFC_st.DFC_CtpCarrFrqPhysRngLo DFC_st.DFC_CtpCarrFrqSRCMax DFC_st.DFC_DcChrgrIntkT2PhysRngHi DFC_st.DFC_DcChrgrIntkT2PhysRngLo DFC_st.DFC_DcChrgrIntkT2SRCOpn DFC_st.DFC_DcChrgrIntkTPhysRngHi DFC_st.DFC_DcChrgrIntkTPhysRngLo DFC_st.DFC_DcChrgrIntkTSRCOpn DFC_st.DFC_Fan1SCG DFC_st.DFC_FanSpdPhysRngHi DFC_st.DFC_FanSpdPhysRngLo DFC_st.DFC_FanSpdSRCOpn DFC_st.DFC_FreonPPhysRngHi DFC_st.DFC_FreonPPhysRngLo DFC_st.DFC_FreonPSRCOpn DFC_st.DFC_HeatrCoreTPhysRngHi DFC_st.DFC_HeatrCoreTPhysRngLo DFC_st.DFC_HeatrCoreTSRCOpn DFC_st.DFC_HvGridUMaxSftyLim DFC_st.DFC_HvGridUMinSftyLim DFC_st.DFC_HvGridUPlausy DFC_st.DFC_IntlckChrgPlgHBrgOpnLd DFC_st.DFC_IntlckChrgPlgHBrgOvrCurr DFC_st.DFC_IntlckChrgPlgHBrgOvrTemp DFC_st.DFC_IntlckChrgPlgHBrgShCirBatt1 DFC_st.DFC_IntlckChrgPlgHBrgShCirBatt2 DFC_st.DFC_IntlckChrgPlgHBrgShCirGnd1 DFC_st.DFC_IntlckChrgPlgHBrgShCirGnd2 DFC_st.DFC_IntlckChrgPlgHBrgShCirOvrLd DFC_st.DFC_IntlckChrgPlgHBrgTempOvrCurr DFC_st.DFC_IntlckChrgPlgHBrgUndrVltg DFC_st.DFC_IntlckChrgPlgPosnRngFlt DFC_st.DFC_IntlckChrgPlgPosnSrcMax DFC_st.DFC_IntlckChrgPlgPosnSrcMin DFC_st.DFC_PwmCtPPhysRngHi DFC_st.DFC_PwmCtPPhysRngLo DFC_st.DFC_PwmCtPSRCMax DFC_st.DFC_PwrDistbnUnitTPhysRngHi DFC_st.DFC_PwrDistbnUnitTPhysRngLo DFC_st.DFC_PwrDistbnUnitTSRCOpn DFC_st.DFC_SCtPmpRlySCG DFC_st.DFC_SpplCooltPmpRlySCG DFC_st.DFC_UCtPPhysRngHi DFC_st.DFC_UCtPPhysRngLo DFC_st.DFC_UCtPSRCOpn DFC_st.DFC_UPxP1PhysRngHi DFC_st.DFC_UPxP1PhysRngLo DFC_st.DFC_UPxP1SRCOpn DFC_st.DFC_VehVPhysRngHi DFC_st.DFC_VehVPhysRngLo DFC_st.DFC_VehVSigCan DFC_st.DFC_VehVSigCanSafe DFC_st.DFC_SCtPmp1DiagGrdKey1 DFC_st.DFC_SCtPmp1DiagGrdKey2 DFC_st.DFC_SCtPmp1DiagGrdKey3 DFC_st.DFC_SCtPmp1DiagGrdKey4 DFC_st.DFC_SCtPmp1DiagGrdKey5 DFC_st.DFC_ChrgPlgLiveCntctHzrdCcs DFC_st.DFC_ChrgPlgProxPltImps DFC_st.DFC_ChrgPlgTHiCcsDc DFC_st.DFC_ElMActvDchaFailr DFC_st.DFC_ElMActvDchaFlt DFC_st.DFC_ElMFbdnIvtrModDrv01 DFC_st.DFC_ElMImobAuthent DFC_st.DFC_ElMIsoMonFlt DFC_st.DFC_ElMIsoMonPlausyFlt DFC_st.DFC_ElMIvtrCooltT01 DFC_st.DFC_ElMIvtrEmgyShtDwn01 DFC_st.DFC_ElMIvtrFailr01 DFC_st.DFC_ElMIvtrIntlck01 DFC_st.DFC_ElMIvtrTErr01 DFC_st.DFC_ElMOverSpdNeg01 DFC_st.DFC_ElMOverSpdPos01 DFC_st.DFC_ElMOverTqNeg01 DFC_st.DFC_ElMOverTqPos01 DFC_st.DFC_ElMPwrAuthn DFC_st.DFC_ElMSpdErr01 DFC_st.DFC_ElMSvs01 DFC_st.DFC_PEnvCcMax DFC_st.DFC_PEnvCcMin DFC_st.DFC_PEnvRngChkMax DFC_st.DFC_PEnvRngChkMin DFC_st.DFC_PEnvSnsrPlaus DFC_st.DFC_BrkBstPmpPlausGenn DFC_st.DFC_CbnHeatrRlyLfLoWarn DFC_st.DFC_ChgrPlugLockPinByndClsd DFC_st.DFC_ChgrPlugLockPinMoveWoCmd DFC_st.DFC_ChgrPlugLockPinStuckInClsd DFC_st.DFC_ChgrPlugLockPinStuckInOpen DFC_st.DFC_ChrgrStErr DFC_st.DFC_ComHSN1BusOff DFC_st.DFC_ComHSN3BusOff DFC_st.DFC_ComVCInval DFC_st.DFC_EemDcdcPrecSpdInhb DFC_st.DFC_ExpPwrLatch DFC_st.DFC_FanMaxOvrd DFC_st.DFC_HLCCcsGnrlComErr DFC_st.DFC_InmLINNodeHVACPanelAbsnt DFC_st.DFC_ResetRcvNotAllwd DFC_st.DFC_TelltlCooltPlaus DFC_st.DFC_MRlyOL DFC_st.DFC_MRlySCB DFC_st.DFC_MRlySCG DFC_st.DFC_SSpMon1 DFC_st.DFC_SSpMon1OV DFC_st.DFC_SSpMon1SCG DFC_st.DFC_SSpMon1UV DFC_st.DFC_SSpMon2 DFC_st.DFC_SSpMon2OV DFC_st.DFC_SSpMon2SCG DFC_st.DFC_SSpMon2UV DFC_st.DFC_SSpMon3 DFC_st.DFC_SSpMon3OV DFC_st.DFC_SSpMon3SCG DFC_st.DFC_SSpMon3UV DFC_st.DFC_CANTRCV_E_NO_TRCV_CONTROL_0 DFC_st.DFC_CAN_E_TIMEOUT DFC_st.DFC_COMM_E_NET_START_IND_CHANNEL_3 DFC_st.DFC_COMM_E_NET_START_IND_CHANNEL_4 DFC_st.DFC_COMM_E_NET_START_IND_CHANNEL_5 DFC_st.DFC_rba_EcuCtrl_TOMaxProlg DFC_st.DFC_rba_EcuCtrl_TOMaxShutDwn DFC_st.DFC_rba_MultiStackTrace_Threshold DFC_st.DFC_RBA_IOEXTLIB_KEEPALIVE_DRV DFC_st.DFC_RBA_IOEXTLIB_KEEPALIVE_INI DFC_st.DFC_rba_IoSigRtc_StopCounter DFC_st.DFC_rba_MRly_Diag_Stk_Event DFC_st.DFC_rba_MemDiag_MemReadErr DFC_st.DFC_rba_MemDiag_MemWrErr DFC_st.DFC_rba_SyC_IrrSwOffTrigEngRun_Event DFC_st.DFC_AcChrgrIntkTSRCMax DFC_st.DFC_AcChrgrIntkTTmpErr DFC_st.DFC_AcFlt DFC_st.DFC_AppAllSnsrDfct DFC_st.DFC_BattUPwrFail DFC_st.DFC_BrkBstBkupOvrn DFC_st.DFC_BrkBstPmpOvld DFC_st.DFC_BrkPlausChk DFC_st.DFC_CbnHeatgSwtTmpErr DFC_st.DFC_CcsPwrLineChpVccSRCMax DFC_st.DFC_CcsPwrLineChpVccTmpErr DFC_st.DFC_CcsPwrLineComChpTSRCMax DFC_st.DFC_CcsPwrLineComChpTTmpErr DFC_st.DFC_ChgrPlugCtpCarrFrqErr DFC_st.DFC_ChgrPlugCtpSwtStuckClsd DFC_st.DFC_ChgrPlugCtpSwtStuckOpen DFC_st.DFC_ChgrPlugCtpUErrHi DFC_st.DFC_ChgrPlugPxp1SrcErr DFC_st.DFC_ChrgCntctAllWldd DFC_st.DFC_ChrgCntctNegOperErr DFC_st.DFC_ChrgCntctNegOperWarn DFC_st.DFC_ChrgCntctNegWldd DFC_st.DFC_ChrgCntctPosOperErr DFC_st.DFC_ChrgCntctPosOperWarn DFC_st.DFC_ChrgCntctPosWldd DFC_st.DFC_ChrgCntctStuckOpen DFC_st.DFC_ChrgPlgIntlckFaild DFC_st.DFC_ChrgnUnplRqrd DFC_st.DFC_CoElMOffsCalibActv01 DFC_st.DFC_CtPSwtDiagSRCMax DFC_st.DFC_CtPSwtDiagTmpErr DFC_st.DFC_CtpCarrFrqTmpErr DFC_st.DFC_DcChrgrIntkT2SRCMax DFC_st.DFC_DcChrgrIntkT2TmpErr DFC_st.DFC_DcChrgrIntkTSRCMax DFC_st.DFC_DcChrgrIntkTTmpErr DFC_st.DFC_EChrDvPlinCntrThdExcdd DFC_st.DFC_EemDiagCtctrClsTout DFC_st.DFC_EemDiagDcdcOffTOut DFC_st.DFC_EemDiagHvCnsrOffTOut DFC_st.DFC_EemDiagHvbOffTOut DFC_st.DFC_FanSpdSRCMax DFC_st.DFC_FanSpdTmpErr DFC_st.DFC_FreonPSRCMax DFC_st.DFC_FreonPTmpErr DFC_st.DFC_HeatrCoreTSRCMax DFC_st.DFC_HeatrCoreTTmpErr DFC_st.DFC_HvGridSocMinLim DFC_st.DFC_HvacBlwrFrntFlt DFC_st.DFC_HvacEvapElecFlt DFC_st.DFC_HvacEvapElecFltGnd DFC_st.DFC_HvacKnobPosnFlt DFC_st.DFC_InvBinID DFC_st.DFC_InvCalID DFC_st.DFC_InvErotan DFC_st.DFC_InvVinID DFC_st.DFC_MOXEMM_SMU_ALM0_0 DFC_st.DFC_MOXEMM_SMU_ALM0_1 DFC_st.DFC_MOXEMM_SMU_ALM0_10 DFC_st.DFC_MOXEMM_SMU_ALM0_11 DFC_st.DFC_MOXEMM_SMU_ALM0_13 DFC_st.DFC_MOXEMM_SMU_ALM0_14 DFC_st.DFC_MOXEMM_SMU_ALM0_2 DFC_st.DFC_MOXEMM_SMU_ALM0_22 DFC_st.DFC_MOXEMM_SMU_ALM0_23 DFC_st.DFC_MOXEMM_SMU_ALM0_4 DFC_st.DFC_MOXEMM_SMU_ALM0_5 DFC_st.DFC_MOXEMM_SMU_ALM0_7 DFC_st.DFC_MOXEMM_SMU_ALM0_8 DFC_st.DFC_MOXEMM_SMU_ALM10_16 DFC_st.DFC_MOXEMM_SMU_ALM10_17 DFC_st.DFC_MOXEMM_SMU_ALM10_21 DFC_st.DFC_MOXEMM_SMU_ALM11_0 DFC_st.DFC_MOXEMM_SMU_ALM11_1 DFC_st.DFC_MOXEMM_SMU_ALM11_2 DFC_st.DFC_MOXEMM_SMU_ALM11_3 DFC_st.DFC_MOXEMM_SMU_ALM11_4 DFC_st.DFC_MOXEMM_SMU_ALM11_5 DFC_st.DFC_MOXEMM_SMU_ALM11_8 DFC_st.DFC_MOXEMM_SMU_ALM11_9 DFC_st.DFC_MOXEMM_SMU_ALM1_0 DFC_st.DFC_MOXEMM_SMU_ALM1_1 DFC_st.DFC_MOXEMM_SMU_ALM1_10 DFC_st.DFC_MOXEMM_SMU_ALM1_11 DFC_st.DFC_MOXEMM_SMU_ALM1_13 DFC_st.DFC_MOXEMM_SMU_ALM1_14 DFC_st.DFC_MOXEMM_SMU_ALM1_2 DFC_st.DFC_MOXEMM_SMU_ALM1_22 DFC_st.DFC_MOXEMM_SMU_ALM1_23 DFC_st.DFC_MOXEMM_SMU_ALM1_4 DFC_st.DFC_MOXEMM_SMU_ALM1_5 DFC_st.DFC_MOXEMM_SMU_ALM1_7 DFC_st.DFC_MOXEMM_SMU_ALM1_8 DFC_st.DFC_MOXEMM_SMU_ALM21_0 DFC_st.DFC_MOXEMM_SMU_ALM21_16 DFC_st.DFC_MOXEMM_SMU_ALM21_3 DFC_st.DFC_MOXEMM_SMU_ALM2_1 DFC_st.DFC_MOXEMM_SMU_ALM2_10 DFC_st.DFC_MOXEMM_SMU_ALM2_11 DFC_st.DFC_MOXEMM_SMU_ALM2_13 DFC_st.DFC_MOXEMM_SMU_ALM2_14 DFC_st.DFC_MOXEMM_SMU_ALM2_22 DFC_st.DFC_MOXEMM_SMU_ALM2_23 DFC_st.DFC_MOXEMM_SMU_ALM2_4 DFC_st.DFC_MOXEMM_SMU_ALM2_5 DFC_st.DFC_MOXEMM_SMU_ALM2_7 DFC_st.DFC_MOXEMM_SMU_ALM2_8 DFC_st.DFC_MOXEMM_SMU_ALM6_0 DFC_st.DFC_MOXEMM_SMU_ALM6_11 DFC_st.DFC_MOXEMM_SMU_ALM6_12 DFC_st.DFC_MOXEMM_SMU_ALM6_14 DFC_st.DFC_MOXEMM_SMU_ALM6_15 DFC_st.DFC_MOXEMM_SMU_ALM6_17 DFC_st.DFC_MOXEMM_SMU_ALM6_18 DFC_st.DFC_MOXEMM_SMU_ALM6_20 DFC_st.DFC_MOXEMM_SMU_ALM6_21 DFC_st.DFC_MOXEMM_SMU_ALM6_25 DFC_st.DFC_MOXEMM_SMU_ALM6_4 DFC_st.DFC_MOXEMM_SMU_ALM6_5 DFC_st.DFC_MOXEMM_SMU_ALM6_7 DFC_st.DFC_MOXEMM_SMU_ALM6_8 DFC_st.DFC_MOXEMM_SMU_ALM7_1 DFC_st.DFC_MOXEMM_SMU_ALM7_12 DFC_st.DFC_MOXEMM_SMU_ALM7_13 DFC_st.DFC_MOXEMM_SMU_ALM7_14 DFC_st.DFC_MOXEMM_SMU_ALM7_15 DFC_st.DFC_MOXEMM_SMU_ALM7_16 DFC_st.DFC_MOXEMM_SMU_ALM7_17 DFC_st.DFC_MOXEMM_SMU_ALM7_2 DFC_st.DFC_MOXEMM_SMU_ALM7_20 DFC_st.DFC_MOXEMM_SMU_ALM7_25 DFC_st.DFC_MOXEMM_SMU_ALM7_26 DFC_st.DFC_MOXEMM_SMU_ALM7_28 DFC_st.DFC_MOXEMM_SMU_ALM7_29 DFC_st.DFC_MOXEMM_SMU_ALM7_30 DFC_st.DFC_MOXEMM_SMU_ALM7_31 DFC_st.DFC_MOXEMM_SMU_ALM8_0 DFC_st.DFC_MOXEMM_SMU_ALM8_1 DFC_st.DFC_MOXEMM_SMU_ALM8_10 DFC_st.DFC_MOXEMM_SMU_ALM8_11 DFC_st.DFC_MOXEMM_SMU_ALM8_12 DFC_st.DFC_MOXEMM_SMU_ALM8_16 DFC_st.DFC_MOXEMM_SMU_ALM8_18 DFC_st.DFC_MOXEMM_SMU_ALM8_2 DFC_st.DFC_MOXEMM_SMU_ALM8_3 DFC_st.DFC_MOXEMM_SMU_ALM8_31 DFC_st.DFC_MOXEMM_SMU_ALM8_4 DFC_st.DFC_MOXEMM_SMU_ALM9_0 DFC_st.DFC_MOXEMM_SMU_ALM9_15 DFC_st.DFC_MOXEMM_SMU_ALM9_3 DFC_st.DFC_MoCADCNTPBnk1 DFC_st.DFC_MoCADCTestVoltBnk1 DFC_st.DFC_MoCSOPICO DFC_st.DFC_MoFAccr DFC_st.DFC_MoFCbnPreCdngOvrheat DFC_st.DFC_MoFCbnPreCdngTmrExpi DFC_st.DFC_MoFEvMngtBms DFC_st.DFC_MoFEvMngtDcdc DFC_st.DFC_MoFEvMngtEm01 DFC_st.DFC_MoFEvMngtEm01BrkgToZr DFC_st.DFC_MoFEvMngtEm01EngSpd DFC_st.DFC_MoFEvMngtEm02EngSpd DFC_st.DFC_MoFEvMngtEm02Lvl1 DFC_st.DFC_MoFEvMngtEm02Lvl2 DFC_st.DFC_MoFExtCptAuxCpt DFC_st.DFC_MoFExtCptVacPmpErr DFC_st.DFC_MoFTqPtdAxle DFC_st.DFC_MoFTqPtdAxleSec DFC_st.DFC_MoFTqPtdEmPtRels DFC_st.DFC_MoFTqPtdEmPtRelsSec DFC_st.DFC_MoFTqPtdEmSign DFC_st.DFC_MoFTqPtdEmSignSec DFC_st.DFC_MoFTqPtdEmTq DFC_st.DFC_MoFTqPtdEmTqSec DFC_st.DFC_MoFTqPtdVeh DFC_st.DFC_MoFVarPostBldSel DFC_st.DFC_MoSysCtrlReIni DFC_st.DFC_MoXEMMHwLTMCUFW DFC_st.DFC_MoXEMMHwLTMonBIST DFC_st.DFC_MoXEMMHwLTRegMonTest DFC_st.DFC_MoXEMMHwLTStbySMUAlvTest DFC_st.DFC_MoXEMMHwLTTempSens DFC_st.DFC_MoXEMMHwLTUCBCfg DFC_st.DFC_MonEgyChrgnCoorr_AcChrgnWoMofRels DFC_st.DFC_MonEgyChrgnCoorr_ChrgnAbortIgr DFC_st.DFC_MonEgyChrgnCoorr_DcCntctFailr DFC_st.DFC_MonEgyChrgnCoorr_ExtChrgnShtOffReq DFC_st.DFC_MonEgyChrgnCoorr_ImpsChrgnMod DFC_st.DFC_MonEgyChrgnCoorr_ImpsChrgnPrms DFC_st.DFC_MonEgyChrgnCoorr_ImpsUDcIntk DFC_st.DFC_MonEgyChrgnCoorr_PlgLockMovmt DFC_st.DFC_MonEgyChrgnCoorr_VehCrashDetn DFC_st.DFC_MonEgyChrgnErrReactn_SftySwt DFC_st.DFC_MonEgyChrgnInlet_CcsPlgCtp DFC_st.DFC_MonEgyChrgnInlet_CcsPlgCtpPwm DFC_st.DFC_MonEgyChrgnInlet_CcsPlgLockCtrlImpsAtmpt DFC_st.DFC_MonEgyChrgnInlet_CcsPlgLockSnsrSigRngChk DFC_st.DFC_MonEgyChrgnInlet_CcsPlgLockStImps DFC_st.DFC_MonEgyChrgnInlet_CcsPlgPxp DFC_st.DFC_MonEgyChrgnT_Snsr1GrdtChk DFC_st.DFC_MonEgyChrgnT_Snsr1SigRngChk DFC_st.DFC_MonEgyChrgnT_Snsr2GrdtChk DFC_st.DFC_MonEgyChrgnT_Snsr2SigRngChk DFC_st.DFC_MonEgyChrgnT_SnsrDif DFC_st.DFC_OCWDAABEActv DFC_st.DFC_OCWDACom DFC_st.DFC_OCWDAErrPin DFC_st.DFC_OCWDAOvrVltg DFC_st.DFC_PUmax DFC_st.DFC_PwmCtPTmpErr DFC_st.DFC_PwrDistbnUnitTSRCMax DFC_st.DFC_PwrDistbnUnitTTmpErr DFC_st.DFC_SCtPmp1DiagGrdKeyErr DFC_st.DFC_SRCHighAPP1 DFC_st.DFC_SRCHighAPP2 DFC_st.DFC_SRCLowAPP1 DFC_st.DFC_SRCLowAPP2 DFC_st.DFC_SWReset_0 DFC_st.DFC_SWReset_1 DFC_st.DFC_SWReset_2 DFC_st.DFC_Sia_InvldCode DFC_st.DFC_Sia_InvldKey DFC_st.DFC_Sia_NoRespUCx DFC_st.DFC_Sia_TprotRttp DFC_st.DFC_StrtUpEvStandStillDeactvn DFC_st.DFC_SyncAPP DFC_st.DFC_UCtPSRCMax DFC_st.DFC_UCtPTmpErr DFC_st.DFC_UPxP1SRCMax DFC_st.DFC_UPxP1TmpErr DFC_st.DFC_VehVObd DSQ_st.DSQ_ACCmprPwrConsol DSQ_st.DSQ_ACCmprUConsol DSQ_st.DSQ_BattU DSQ_st.DSQ_T15TurnOfDly /end IN_MEASUREMENT
 /begin OUT_MEASUREMENT DFC_b.TST_ACCmprFltLvlRes DFC_b.TST_AbgHiSigFlt DFC_b.TST_AbgIntPatFlt DFC_b.TST_AbgLoSigFlt DFC_b.TST_AbgUnkwnErrSigFlt DFC_b.TST_AcExtChrgrIBattExcdd DFC_b.TST_AcExtChrgrIInExcdd DFC_b.TST_AcExtChrgrIOutDe DFC_b.TST_AcExtChrgrIOutExcdd DFC_b.TST_AcExtChrgrUOutDe DFC_b.TST_AdpActvDChaFailr DFC_b.TST_AirbcuFlt DFC_b.TST_Airbg DFC_b.TST_AirbgCan DFC_b.TST_AirbgCanHWPlaus DFC_b.TST_AirbgHWCanPlaus DFC_b.TST_AirbgMnr DFC_b.TST_AirbgPerHi DFC_b.TST_AirbgPerdRngFlt DFC_b.TST_BlowrRlyErr DFC_b.TST_BrkBstPmpActtnDfct DFC_b.TST_BrkBstPmpDeactvnDfct DFC_b.TST_BrkSwtFlt DFC_b.TST_CbnHeatgHeatrHsScb DFC_b.TST_CbnHeatgHeatrHsScg DFC_b.TST_CbnHeatgHeatrLsOl DFC_b.TST_CbnHeatgHeatrLsScb DFC_b.TST_CbnHeatgHeatrLsScg DFC_b.TST_CbnHeatgHeatrUnUsed DFC_b.TST_ChrgnCntctHsOt DFC_b.TST_ChrgnCntctHsScb DFC_b.TST_ChrgnCntctHsScg DFC_b.TST_ChrgnCntctLsNegOl DFC_b.TST_ChrgnCntctLsNegOt DFC_b.TST_ChrgnCntctLsNegScb DFC_b.TST_ChrgnCntctLsNegScg DFC_b.TST_ChrgnCntctLsPosOl DFC_b.TST_ChrgnCntctLsPosOt DFC_b.TST_ChrgnCntctLsPosScb DFC_b.TST_ChrgnCntctLsPosScg DFC_b.TST_ChrgnCntctUnUsed DFC_b.TST_ComBrkMai DFC_b.TST_ComChrgrEVCont DFC_b.TST_ComChrgrEVtBlink DFC_b.TST_ComChrgrMstBlink DFC_b.TST_ComChrgrMstCont DFC_b.TST_ComChrgrSVSBlink DFC_b.TST_ComChrgrSVSCont DFC_b.TST_ComDcdcEVBlink DFC_b.TST_ComDcdcEVCont DFC_b.TST_ComDcdcFltLvl2 DFC_b.TST_ComDcdcFltLvl3 DFC_b.TST_ComDcdcFltLvl4 DFC_b.TST_ComDcdcFltLvl5 DFC_b.TST_ComDcdcFltLvlRes DFC_b.TST_ComDcdcMstBlink DFC_b.TST_ComDcdcMstCont DFC_b.TST_ComDcdcSVSBlink DFC_b.TST_ComDcdcSVSCont DFC_b.TST_ComElMIIvtrFltLvl2 DFC_b.TST_ComElMIIvtrFltLvl3 DFC_b.TST_ComElMIIvtrFltLvl4 DFC_b.TST_ComElMIIvtrFltLvl5 DFC_b.TST_ComElMIIvtrFltLvlRes DFC_b.TST_ComEmacEVBlink DFC_b.TST_ComEmacEVCont DFC_b.TST_ComEmacMstCont DFC_b.TST_ComEmacMsttBlink DFC_b.TST_ComEmacSVSBlink DFC_b.TST_ComEmacSVSCont DFC_b.TST_ComGunCntInfoWkuReq DFC_b.TST_ComHillHldFlt DFC_b.TST_ComHvBattRchrgWkuReq DFC_b.TST_ComHvbFltLvl2 DFC_b.TST_ComHvbFltLvl3 DFC_b.TST_ComHvbFltLvl4 DFC_b.TST_ComHvbFltLvl5 DFC_b.TST_ComHvbFltLvlRes DFC_b.TST_ComHvbMstBlink DFC_b.TST_ComHvbMstCont DFC_b.TST_ComImmoUnlockWkuReq DFC_b.TST_ComInfoReqPtlWkuReq DFC_b.TST_ComOBCFltLvl2 DFC_b.TST_ComOBCFltLvl3 DFC_b.TST_ComOBCFltLvl4 DFC_b.TST_ComOBCFltLvl5 DFC_b.TST_ComOBCFltLvlRes DFC_b.TST_ComPostOperationWkuReq DFC_b.TST_ComPreCondElecWkuReq DFC_b.TST_ComRemUnlckWkuReq DFC_b.TST_ComStpDlyHMIWkuReq DFC_b.TST_ComflgCurMeasmtErr DFC_b.TST_ComflgCurMeasmtSysErr DFC_b.TST_ComflgCurMeasmtVld DFC_b.TST_ComflgCurRngErr DFC_b.TST_ComflgTPcbMeasmtErr DFC_b.TST_ComflgTPcbMeasmtVld DFC_b.TST_ComflgTPcbRngErr DFC_b.TST_ComflgTPcbSysErr DFC_b.TST_ComflgTShntMeasmtErr DFC_b.TST_ComflgTShntMeasmtVld DFC_b.TST_ComflgTShntRngErr DFC_b.TST_ComflgTShntSysErr DFC_b.TST_ComflgVoltMeasmtErr DFC_b.TST_ComflgVoltMeasmtSysErr DFC_b.TST_ComflgVoltMeasmtVld DFC_b.TST_ComflgVoltRngErr DFC_b.TST_CrashEveOcc DFC_b.TST_DcdcFwdModStuck DFC_b.TST_DcdcLvUDifMaxFlt DFC_b.TST_DcdcOffModStuck DFC_b.TST_DcdcOperModFailr DFC_b.TST_DcdcPrecModStuck DFC_b.TST_DrvDoorOpn DFC_b.TST_DrvModPosnDfct DFC_b.TST_DrvStbltOpn DFC_b.TST_ETogFailrLvl3 DFC_b.TST_ETogFailrLvl4 DFC_b.TST_EbsLvBattSocDiagLo DFC_b.TST_EbsLvBattUDiagDiOper DFC_b.TST_EbsLvBattUDiagFltLvl1 DFC_b.TST_EbsLvBattUDiagFltLvl2 DFC_b.TST_EbsLvBattUDiagLo DFC_b.TST_EbsSnsrSt DFC_b.TST_EbsSofASILErr DFC_b.TST_ElTSPtSysLimDrvErr DFC_b.TST_ElTSPtSysLimRgnErr DFC_b.TST_HLCCcsFwDwnl DFC_b.TST_HvBattChrgPwrMax DFC_b.TST_HvBattCrashDetd DFC_b.TST_HvBattDchaPwrMax DFC_b.TST_HvBattEmgyOff DFC_b.TST_HvBattEmgyOffIntlck DFC_b.TST_HvBattEmgyOffReq DFC_b.TST_HvBattFltMod DFC_b.TST_HvBattIReqToChrgrErr DFC_b.TST_HvBattIReqToChrgrIni DFC_b.TST_HvBattIninTout DFC_b.TST_HvBattIntlckSt DFC_b.TST_HvBattIsoFlt DFC_b.TST_HvBattLimdPwr DFC_b.TST_HvBattMaiSwtClsngFlt DFC_b.TST_HvBattMaiSwtFlt DFC_b.TST_HvBattMaiSwtOpen DFC_b.TST_HvBattMaiSwtOpngFlt DFC_b.TST_HvBattMaiSwtWldd DFC_b.TST_HvBattNegCntctrCntErr DFC_b.TST_HvBattOperModChrgPlausy DFC_b.TST_HvBattOverTDern DFC_b.TST_HvBattPosCntctrCntErr DFC_b.TST_HvBattPrecCntctrCntErr DFC_b.TST_HvBattPwrDistbnTDern DFC_b.TST_HvBattPwrDistbnTInhbn DFC_b.TST_HvBattRatRSohErr DFC_b.TST_HvBattRatSohErr DFC_b.TST_HvBattSngIsoWarn DFC_b.TST_HvBattSrvPlgDiscnct DFC_b.TST_HvBattUNomChrgnErr DFC_b.TST_HvBattUNomChrgnIni DFC_b.TST_HvBattUnderTDern DFC_b.TST_HvbEVLmpBlink DFC_b.TST_HvbEVLmpCont DFC_b.TST_HvbSVSBlink DFC_b.TST_HvbSVSCont DFC_b.TST_InmLINBusBlk DFC_b.TST_PDUProgmFailr DFC_b.TST_PEnvSigRngMax DFC_b.TST_PEnvSigRngMin DFC_b.TST_PLnCChpDeactvnFaild DFC_b.TST_PrkgBrkFailr DFC_b.TST_PtSysLimErr DFC_b.TST_PwrMaxDchaShoLo DFC_b.TST_SCtPmp1FailSafeNotSuc DFC_b.TST_SCtPmp1SCG DFC_b.TST_VehCoornDrvrNotPrsnt DFC_b.TST_VehVCanAvl DFC_b.TST_VehVCanErr DFC_b.TST_eTogFailrLvlRes DFC_b.TST_flgBrkMaiDiag DFC_b.TST_stHvbIsoMeasmtRes DFC_b.TST_BrkBstPmpPLeakDfct DFC_b.TST_Com082hTooShort DFC_b.TST_Com092hTooShort DFC_b.TST_Com205hAbsent DFC_b.TST_Com205hChecksum DFC_b.TST_Com205hCounter DFC_b.TST_Com205hTooShort DFC_b.TST_Com217hAbsent DFC_b.TST_Com217hChecksum DFC_b.TST_Com217hCounter DFC_b.TST_Com217hTooShort DFC_b.TST_Com227hAbsent DFC_b.TST_Com227hTooShort DFC_b.TST_Com237hAbsent DFC_b.TST_Com237hChecksum DFC_b.TST_Com237hCounter DFC_b.TST_Com237hTooShort DFC_b.TST_Com259hAbsent DFC_b.TST_Com259hChecksum DFC_b.TST_Com259hCounter DFC_b.TST_Com259hTooShort DFC_b.TST_Com26hAbsent DFC_b.TST_Com26hTooShort DFC_b.TST_Com273hAbsent DFC_b.TST_Com273hChecksum DFC_b.TST_Com273hCounter DFC_b.TST_Com273hTooShort DFC_b.TST_Com275hAbsent DFC_b.TST_Com275hChecksum DFC_b.TST_Com275hCounter DFC_b.TST_Com275hTooShort DFC_b.TST_Com283hAbsent DFC_b.TST_Com283hTooShort DFC_b.TST_Com285hAbsent DFC_b.TST_Com285hChecksum DFC_b.TST_Com285hCounter DFC_b.TST_Com285hTooShort DFC_b.TST_Com293hAbsent DFC_b.TST_Com293hChecksum DFC_b.TST_Com293hCounter DFC_b.TST_Com293hTooShort DFC_b.TST_Com308hAbsent DFC_b.TST_Com308hChecksum DFC_b.TST_Com308hCounter DFC_b.TST_Com308hTooShort DFC_b.TST_Com318hAbsent DFC_b.TST_Com318hChecksum DFC_b.TST_Com318hCounter DFC_b.TST_Com318hTooShort DFC_b.TST_Com325hAbsent DFC_b.TST_Com325hChecksum DFC_b.TST_Com325hCounter DFC_b.TST_Com325hTooShort DFC_b.TST_Com335hAbsent DFC_b.TST_Com335hChecksum DFC_b.TST_Com335hCounter DFC_b.TST_Com335hTooShort DFC_b.TST_Com351hAbsent DFC_b.TST_Com351hTooShort DFC_b.TST_Com38DhAbsent DFC_b.TST_Com38DhChecksum DFC_b.TST_Com38DhCounter DFC_b.TST_Com38DhTooShort DFC_b.TST_Com412hAbsent DFC_b.TST_Com412hChecksum DFC_b.TST_Com412hCounter DFC_b.TST_Com412hTooShort DFC_b.TST_Com427hAbsent DFC_b.TST_Com427hTooShort DFC_b.TST_Com432hAbsent DFC_b.TST_Com432hChecksum DFC_b.TST_Com432hCounter DFC_b.TST_Com432hTooShort DFC_b.TST_Com435hAbsent DFC_b.TST_Com435hTooShort DFC_b.TST_Com442hAbsent DFC_b.TST_Com442hTooShort DFC_b.TST_Com453hAbsent DFC_b.TST_Com453hTooShort DFC_b.TST_Com455hAbsent DFC_b.TST_Com455hTooShort DFC_b.TST_Com463hAbsent DFC_b.TST_Com463hTooShort DFC_b.TST_Com473hAbsent DFC_b.TST_Com473hTooShort DFC_b.TST_Com47BhAbsent DFC_b.TST_Com47BhTooShort DFC_b.TST_Com48BhAbsent DFC_b.TST_Com48BhTooShort DFC_b.TST_Com497hTooShort DFC_b.TST_Com4F2hAbsent DFC_b.TST_Com4F2hChecksum DFC_b.TST_Com4F2hCounter DFC_b.TST_Com4F2hTooShort DFC_b.TST_Com50DhAbsent DFC_b.TST_Com50DhTooShort DFC_b.TST_Com535hAbsent DFC_b.TST_Com535hTooShort DFC_b.TST_Com543hAbsent DFC_b.TST_Com543hTooShort DFC_b.TST_Com552hAbsent DFC_b.TST_Com552hTooShort DFC_b.TST_Com583hAbsent DFC_b.TST_Com583hTooShort DFC_b.TST_Com592hAbsent DFC_b.TST_Com592hChecksum DFC_b.TST_Com592hCounter DFC_b.TST_Com592hTooShort DFC_b.TST_Com595hAbsent DFC_b.TST_Com595hChecksum DFC_b.TST_Com595hCounter DFC_b.TST_Com595hTooShort DFC_b.TST_Com5B2hAbsent DFC_b.TST_Com5B2hTooShort DFC_b.TST_Com5B5hAbsent DFC_b.TST_Com5B5hChecksum DFC_b.TST_Com5B5hCounter DFC_b.TST_Com5B5hTooShort DFC_b.TST_Com5C7hTooShort DFC_b.TST_Com5E7hAbsent DFC_b.TST_Com5E7hTooShort DFC_b.TST_Com635hTooShort DFC_b.TST_Com645hTooShort DFC_b.TST_Com663hAbsent DFC_b.TST_Com663hTooShort DFC_b.TST_Com665hAbsent DFC_b.TST_Com665hTooShort DFC_b.TST_Com675hAbsent DFC_b.TST_Com675hTooShort DFC_b.TST_ComFrbd_205h_HVBAT_PACK_CURRENT DFC_b.TST_ComFrbd_205h_HVBAT_SOC_DISPLAY DFC_b.TST_ComFrbd_205h_HVBAT_VOLTAGE DFC_b.TST_ComFrbd_217h_INV_DC_BUS_VOLTAGE DFC_b.TST_ComFrbd_217h_INV_MTR_ACTUAL_TRQ DFC_b.TST_ComFrbd_217h_INV_MTR_SPEED DFC_b.TST_ComFrbd_217h_INV_MTR_TRQ DFC_b.TST_ComFrbd_227h_INV_DC_CURRENT DFC_b.TST_ComFrbd_227h_INV_MOTORING_PEAK_TRQ DFC_b.TST_ComFrbd_227h_INV_MTR_INST_INPUT_POWER DFC_b.TST_ComFrbd_227h_INV_REGEN_PEAK_TRQ DFC_b.TST_ComFrbd_237h_INV_ACTIVE_DISCHARGE_STATUS DFC_b.TST_ComFrbd_237h_INV_CTRL_MODE_ACK DFC_b.TST_ComFrbd_237h_INV_EV_WARNING DFC_b.TST_ComFrbd_237h_INV_FAULT_LEVEL DFC_b.TST_ComFrbd_237h_INV_MASTER_STOP DFC_b.TST_ComFrbd_237h_INV_SERVICE_DUE DFC_b.TST_ComFrbd_237h_INV_STAB_MIN_TRQ DFC_b.TST_ComFrbd_259h_TGLM_FAILURE_STATE DFC_b.TST_ComFrbd_259h_TGLM_MODE_PUSH DFC_b.TST_ComFrbd_259h_TOGGLE_MONOSTABLE_POS DFC_b.TST_ComFrbd_273h_OBC_outputpower_capability DFC_b.TST_ComFrbd_275h_HVBAT_DISCHARGE_30S_AVAILABLE_CURRENT DFC_b.TST_ComFrbd_275h_HVBAT_DISCHARGE_30S_AVAILABLE_POWER DFC_b.TST_ComFrbd_283h_DCDC_IN_CURRENT DFC_b.TST_ComFrbd_283h_DCDC_IN_VOLTAGE DFC_b.TST_ComFrbd_283h_DCDC_OUT_CURRENT DFC_b.TST_ComFrbd_283h_DCDC_OUT_VOLTAGE DFC_b.TST_ComFrbd_285h_HVBAT_REGEN_CHG_30S_CURRENT_LIMIT DFC_b.TST_ComFrbd_285h_HVBAT_REGEN_CHRG_30S_POWER_LIMIT DFC_b.TST_ComFrbd_293h_DCDC_outputpower_capability DFC_b.TST_ComFrbd_325h_HVBAT_INSULATION_RESISTANCE DFC_b.TST_ComFrbd_325h_HVBAT_TEMPERATURE DFC_b.TST_ComFrbd_335h_HVBAT_CHRG_CONTINUOUS_CURR_MAX DFC_b.TST_ComFrbd_335h_HVBAT_CHRG_COTINUOUS_CURR_REQ DFC_b.TST_ComFrbd_335h_HVBAT_CHRG_MAX_VOLT DFC_b.TST_ComFrbd_335h_HVBAT_DC_BUS_VOLTAGE DFC_b.TST_ComFrbd_427h_INV_OP_MODE DFC_b.TST_ComFrbd_427h_INV_PERMISIBLE_TORQUE DFC_b.TST_ComFrbd_435h_HVBAT_MAX_CELL_VOLT DFC_b.TST_ComFrbd_435h_HVBAT_MAX_CELL_VOLT_NUM DFC_b.TST_ComFrbd_435h_HVBAT_MAX_SENSOR_TEMP DFC_b.TST_ComFrbd_435h_HVBAT_MIN_CELL_VOLT DFC_b.TST_ComFrbd_435h_HVBAT_MIN_CELL_VOLT_NUM DFC_b.TST_ComFrbd_453h_OBC_IN_CURRENT DFC_b.TST_ComFrbd_453h_OBC_IN_VOLTAGE DFC_b.TST_ComFrbd_453h_OBC_IP_POWER DFC_b.TST_ComFrbd_455h_HVBAT_NOMINAL_VOLTAGE DFC_b.TST_ComFrbd_463h_OBC_OUT_CURRENT DFC_b.TST_ComFrbd_463h_OBC_OUT_VOLTAGE DFC_b.TST_ComFrbd_463h_OBC_TEMPERATURE DFC_b.TST_ComFrbd_473h_DCDC_Coolant_Temperature DFC_b.TST_ComFrbd_473h_DCDC_TEMPERATURE DFC_b.TST_ComFrbd_47Bh_eCOMP_BusBarCurrent DFC_b.TST_ComFrbd_47Bh_eCOMP_BusBarVoltage DFC_b.TST_ComFrbd_47Bh_eCOMP_CompressorSpeed DFC_b.TST_ComFrbd_47Bh_eCOMP_IGBT_Temp DFC_b.TST_ComFrbd_47Bh_eCOMP_PeakPhaCurrent DFC_b.TST_ComFrbd_47Bh_eCOMP_Power_consumption DFC_b.TST_ComFrbd_48Bh_eCOMP_Fault_Level DFC_b.TST_ComFrbd_4F2h_VALEUR_SOC_ETENDUE DFC_b.TST_ComFrbd_535h_HV_BATT_TEMP_AVG DFC_b.TST_ComFrbd_543h_HVBAT_RESTBATTENERGY DFC_b.TST_ComFrbd_543h_HVBAT_SOH DFC_b.TST_ComFrbd_543h_HV_BATT_SOH_RES DFC_b.TST_ComFrbd_592h_IBATT_1 DFC_b.TST_ComFrbd_592h_IBATT_2 DFC_b.TST_ComFrbd_592h_IBATT_3 DFC_b.TST_ComFrbd_592h_TEMP_BATT DFC_b.TST_ComFrbd_592h_U_BATT_BECB DFC_b.TST_ComFrbd_595h_HVBAT_TIME_TO_CHRG_80 DFC_b.TST_ComFrbd_5B2h_TEMP_AIR_EXT DFC_b.TST_ComFrbd_635h_HVBAT_NEG_CONT_COUNT_SEG1 DFC_b.TST_ComFrbd_635h_HVBAT_NEG_CONT_COUNT_SEG3 DFC_b.TST_ComFrbd_635h_HVBAT_NEG_CONT_COUNT_SEG4 DFC_b.TST_ComFrbd_635h_HVBAT_PST_CONT_COUNT_SEG1 DFC_b.TST_ComFrbd_635h_HVBAT_PST_CONT_COUNT_SEG3 DFC_b.TST_ComFrbd_635h_HVBAT_PST_CONT_COUNT_SEG4 DFC_b.TST_ComFrbd_645h_HVBAT_PRECHRGE_CONT_COUNT_SEG1 DFC_b.TST_ComFrbd_645h_HVBAT_PRECHRGE_CONT_COUNT_SEG2 DFC_b.TST_ComFrbd_675h_HVBAT_REMAININGBATTCAPACITY DFC_b.TST_ComInvld_205h_HVBAT_CHARGING_STATUS DFC_b.TST_ComInvld_205h_HVBAT_PACK_CURRENT DFC_b.TST_ComInvld_205h_HVBAT_SOC_DISPLAY DFC_b.TST_ComInvld_205h_HVBAT_VOLTAGE DFC_b.TST_ComInvld_217h_INV_DC_BUS_VOLTAGE DFC_b.TST_ComInvld_217h_INV_MTR_ACTUAL_TRQ DFC_b.TST_ComInvld_217h_INV_MTR_SPEED DFC_b.TST_ComInvld_217h_INV_MTR_TRQ DFC_b.TST_ComInvld_227h_INV_DC_CURRENT DFC_b.TST_ComInvld_227h_INV_MOTORING_PEAK_TRQ DFC_b.TST_ComInvld_227h_INV_MTR_INST_INPUT_POWER DFC_b.TST_ComInvld_227h_INV_REGEN_PEAK_TRQ DFC_b.TST_ComInvld_237h_INV_ACTIVE_DISCHARGE_STATUS DFC_b.TST_ComInvld_237h_INV_FAULT_LEVEL DFC_b.TST_ComInvld_237h_INV_STAB_MIN_TRQ DFC_b.TST_ComInvld_259h_TGLM_MODE_PUSH DFC_b.TST_ComInvld_259h_TOGGLE_MONOSTABLE_POS DFC_b.TST_ComInvld_26h_AC_SWITCH_REQ DFC_b.TST_ComInvld_26h_BLOWER_POSITION DFC_b.TST_ComInvld_26h_EVAP_SENSOR_FAULT DFC_b.TST_ComInvld_26h_EVAP_SENSOR_VALUE DFC_b.TST_ComInvld_26h_POTENTIOMETER_FAULT DFC_b.TST_ComInvld_26h_REAR_DEFOG_REQ DFC_b.TST_ComInvld_26h_TEMP_POSITION DFC_b.TST_ComInvld_273h_OBC_FAULT_LEVEL DFC_b.TST_ComInvld_273h_OBC_outputpower_capability DFC_b.TST_ComInvld_275h_HVBAT_DISCHARGE_30S_AVAILABLE_CURRENT DFC_b.TST_ComInvld_275h_HVBAT_DISCHARGE_30S_AVAILABLE_POWER DFC_b.TST_ComInvld_283h_DCDC_IN_CURRENT DFC_b.TST_ComInvld_283h_DCDC_IN_VOLTAGE DFC_b.TST_ComInvld_283h_DCDC_OUT_CURRENT DFC_b.TST_ComInvld_283h_DCDC_OUT_VOLTAGE DFC_b.TST_ComInvld_285h_HVBAT_REGEN_CHG_30S_CURRENT_LIMIT DFC_b.TST_ComInvld_285h_HVBAT_REGEN_CHRG_30S_POWER_LIMIT DFC_b.TST_ComInvld_293h_DCDC_FAULT_LEVEL DFC_b.TST_ComInvld_293h_DCDC_outputpower_capability DFC_b.TST_ComInvld_325h_HVBAT_EPLUG_STATUS DFC_b.TST_ComInvld_325h_HVBAT_HVIL_STS DFC_b.TST_ComInvld_325h_HVBAT_INSULATION_FAULT DFC_b.TST_ComInvld_325h_HVBAT_INSULATION_RESISTANCE DFC_b.TST_ComInvld_325h_HVBAT_TEMPERATURE DFC_b.TST_ComInvld_335h_HVBAT_CHRG_CONTINUOUS_CURR_MAX DFC_b.TST_ComInvld_335h_HVBAT_CHRG_COTINUOUS_CURR_REQ DFC_b.TST_ComInvld_335h_HVBAT_CHRG_MAX_VOLT DFC_b.TST_ComInvld_335h_HVBAT_DC_BUS_VOLTAGE DFC_b.TST_ComInvld_38Dh_VITESSE_VEHICULE_ROUES DFC_b.TST_ComInvld_38Dh_VVH_INDISP DFC_b.TST_ComInvld_427h_INV_COOLANT_TEMP DFC_b.TST_ComInvld_427h_INV_MOTOR_TEMP DFC_b.TST_ComInvld_427h_INV_OP_MODE DFC_b.TST_ComInvld_427h_INV_PERMISIBLE_TORQUE DFC_b.TST_ComInvld_427h_INV_TEMP DFC_b.TST_ComInvld_432h_REVEIL_PRINCIPAL DFC_b.TST_ComInvld_435h_HVBAT_MAX_CELL_VOLT DFC_b.TST_ComInvld_435h_HVBAT_MAX_CELL_VOLT_NUM DFC_b.TST_ComInvld_435h_HVBAT_MAX_SENSOR_TEMP DFC_b.TST_ComInvld_435h_HVBAT_MIN_CELL_VOLT DFC_b.TST_ComInvld_435h_HVBAT_MIN_CELL_VOLT_NUM DFC_b.TST_ComInvld_442h_BCCM_BLOWER_RELAY_STS DFC_b.TST_ComInvld_453h_OBC_IN_CURRENT DFC_b.TST_ComInvld_453h_OBC_IN_VOLTAGE DFC_b.TST_ComInvld_453h_OBC_IP_POWER DFC_b.TST_ComInvld_455h_HVBAT_NOMINAL_VOLTAGE DFC_b.TST_ComInvld_463h_OBC_OUT_CURRENT DFC_b.TST_ComInvld_463h_OBC_OUT_VOLTAGE DFC_b.TST_ComInvld_463h_OBC_TEMPERATURE /end OUT_MEASUREMENT
 FUNCTION_VERSION "30000.32.0" /end FUNCTION
/begin COMPU_METHOD DDRCTime_ms "" RAT_FUNC "%6.1" "ms" COEFFS 0 1 0 0 0 10 /end COMPU_METHOD
/begin COMPU_METHOD DDRC_Ratio "" TAB_VERB "%6.3" "-" COMPU_TAB_REF DDRC_Ratio /end COMPU_METHOD
/begin COMPU_VTAB DDRC_Ratio "" TAB_VERB 4 1 "Ratio1" 2 "Ratio2" 3 "Ratio3" 4 "Ratio4" /end COMPU_VTAB
/begin COMPU_METHOD DFC_OneToOne "" RAT_FUNC "%6.2" "-" COEFFS 0 1 0 0 0 1 /end COMPU_METHOD
/begin COMPU_METHOD DFES_OneToOne "" RAT_FUNC "%6.2" "-" COEFFS 0 1 0 0 0 1 /end COMPU_METHOD
/begin COMPU_METHOD Eta "" RAT_FUNC "%6.4" "Nm/(mg/cyc)" COEFFS 0 128 0 0 0 1 /end COMPU_METHOD
/begin COMPU_METHOD Eta1 "" RAT_FUNC "%6.4" "-" COEFFS 0 128 0 0 0 1 /end COMPU_METHOD
/begin COMPU_METHOD Eta2 "" RAT_FUNC "%6.4" "" COEFFS 0 128 0 0 0 1 /end COMPU_METHOD
/begin COMPU_METHOD ETCtlGovKd_fac "" RAT_FUNC "%7.6" "-" COEFFS 0 12800 0 0 0 1 /end COMPU_METHOD
/begin COMPU_METHOD ETCtlGovKi_fac "" RAT_FUNC "%8.7" "-" COEFFS 0 429496.7296 0 0 0 1 /end COMPU_METHOD
/begin COMPU_METHOD Fact "" RAT_FUNC "%6.5" "-" COEFFS 0 8192 0 0 0 1 /end COMPU_METHOD
/begin COMPU_METHOD OneToOne "" RAT_FUNC "%6.2" "-" COEFFS 0 1 0 0 0 1 /end COMPU_METHOD
/begin COMPU_METHOD Volt_Batt "" RAT_FUNC "%6.1" "mV" COEFFS 0 0.05 0 0 0 1 /end COMPU_METHOD
/begin RECORD_LAYOUT Kw_Ws16 FNC_VALUES 1 SWORD COLUMN_DIR DIRECT /end RECORD_LAYOUT
/begin RECORD_LAYOUT Val_Wu16 FNC_VALUES 1 UWORD COLUMN_DIR DIRECT /end RECORD_LAYOUT
/begin RECORD_LAYOUT Val_Wu8 FNC_VALUES 1 UBYTE COLUMN_DIR DIRECT /end RECORD_LAYOUT
/end MODULE
/end PROJECT

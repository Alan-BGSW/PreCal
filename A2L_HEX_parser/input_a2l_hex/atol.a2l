ASAP2_VERSION 1 70
/begin PROJECT MDG1C "VC1CP091_STLA_N_D061I3"
/begin HEADER "" VERSION "VC1CP091_STLA_N_D061I3" PROJECT_NO MDG1C /end HEADER
/begin MODULE DIM ""
/begin MOD_COMMON "" BYTE_ORDER MSB_LAST ALIGNMENT_BYTE 1 ALIGNMENT_WORD 2 ALIGNMENT_LONG 4 ALIGNMENT_INT64 4 ALIGNMENT_FLOAT32_IEEE 4 ALIGNMENT_FLOAT64_IEEE 4 DATA_SIZE 32 /end MOD_COMMON
/begin CHARACTERISTIC CbnHeatgHeatr_ATS_ATS.LimitTypeMsk_C "" VALUE 0x80252EA0 Val_Wu8 255.0 OneToOne 0.00 255.0 FORMAT "%5.1" /end CHARACTERISTIC
/begin CHARACTERISTIC CbnHeatgHeatr_ATS_ATS.CnvNorm_C "" VALUE 0x80252EA1 Val_Wu8 255.0 OneToOne 0.00 255.0 FORMAT "%5.1" /end CHARACTERISTIC
/begin CHARACTERISTIC CbnHeatgHeatr_ATS_ATS.LowLim_C "" VALUE 0x80252EA2 Val_Ws16 65535.00 OneToOne -32768.00 32767.00 FORMAT "%8.2" /end CHARACTERISTIC
/begin CHARACTERISTIC CbnHeatgHeatr_ATS_ATS.UpLim_C "" VALUE 0x80252EA4 Val_Ws16 65535.00 OneToOne -32768.00 32767.00 FORMAT "%8.2" /end CHARACTERISTIC
/begin CHARACTERISTIC CbnHeatgHeatr_ATS_ATS.CnvFac_C "" VALUE 0x80252EA8 Val_Ws32 4294967295.00 OneToOne -2147483648.00 2147483647.00 FORMAT "%13.2" /end CHARACTERISTIC
/begin CHARACTERISTIC CbnHeatgHeatr_ATS_ATS.CnvOfs_C "" VALUE 0x80252EAC Val_Ws16 65535.00 OneToOne -32768.00 32767.00 FORMAT "%8.2" /end CHARACTERISTIC
/begin CHARACTERISTIC CbnHeatgHeatr_ATS_ATS.DfltVal_C "" VALUE 0x80252EAE Val_Ws16 65535.00 OneToOne -32768.00 32767.00 FORMAT "%8.2" /end CHARACTERISTIC
/begin CHARACTERISTIC CbnHeatgHeatr_cntrOperReplcmtVal_C "Replacement value for heater operation counter" VALUE 0x8024F988 RB_Val_Ws32 4294967295.0000 OneToOne -2147483648.0000 2147483647.0000 FORMAT "%10.4" /end CHARACTERISTIC
/begin CHARACTERISTIC CbnHeatgHeatr_cntrReplcmtVal_C "Replacement value of relay update if fail to read via tester" VALUE 0x8024F98C RB_Val_Ws32 2147483.6475 q5Em4 -1073741.8240 1073741.8235 FORMAT "%10.4" /end CHARACTERISTIC
/begin CHARACTERISTIC CbnHeatgHeatr_cntrRlyThd_C "calibratable relay count value" VALUE 0x8024F990 RB_Val_Ws32 2147483.647500 q5Em4 -1073741.824000 1073741.823500 FORMAT "%10.6" /end CHARACTERISTIC
/begin CHARACTERISTIC CbnHeatgHeatr_cntrValBreak_T "PTC relay breaking reduction count value" CURVE 0x8024F994 RB_Curve_S16_S32_sao 2147483.64750 q5Em4 -1073741.82400 1073741.82350 FORMAT "%13.5"
 /begin AXIS_DESCR STD_AXIS CabAirHt_iConsolOld RBPtCel_i_0p25_1 3 -8192.000 8191.750 FORMAT "%8.3" DEPOSIT ABSOLUTE /end AXIS_DESCR
/end CHARACTERISTIC
/begin CHARACTERISTIC CbnHeatgHeatr_cntrValMak_T "PTC relay making reduction count value" CURVE 0x8024F9A8 RB_Curve_S16_S32_sao 2147483.64750 q5Em4 -1073741.82400 1073741.82350 FORMAT "%13.5"
 /begin AXIS_DESCR STD_AXIS CabAirHt_iConsol RBPtCel_i_0p25_1 3 -8192.000 8191.750 FORMAT "%8.3" DEPOSIT ABSOLUTE /end AXIS_DESCR
/end CHARACTERISTIC
/begin CHARACTERISTIC CbnHeatgHeatr_iMax_C "calibratable maximum current for cabin heater power" VALUE 0x8024F9BC RB_Val_Wr32 2.0000E+037 RBPtCel_i_1p0_2 -1.0000E+037 1.0000E+037 FORMAT "%10.4" EXTENDED_LIMITS -3.4028E+038 3.4028E+038 /end CHARACTERISTIC
/begin CHARACTERISTIC CbnHeatgHeatr_maskHvBattUActSq_C "Mask for Hv battery voltage signal quality" VALUE 0x8024F9C0 RB_Val_Wu16 65535.00 OneToOne 0.00 65535.00 FORMAT "%8.2" /end CHARACTERISTIC
/begin CHARACTERISTIC CbnHeatgHeatr_nrMaxManTestImp_C "Maximum test impluse limit" VALUE 0x8024F9C2 RB_Val_Wu8 255.0 OneToOne 0.00 255.0 FORMAT "%5.1" /end CHARACTERISTIC
/begin CHARACTERISTIC CbnHeatgHeatr_nrTestMaxHs_C "Maximum number of tests for HS diagnosis" VALUE 0x8024F9C4 RB_Val_Wu16 65535.00 OneToOne 0.00 65535.00 FORMAT "%8.2" /end CHARACTERISTIC
/begin CHARACTERISTIC CbnHeatgHeatr_nrTestMaxLs_C "Maximum number of tests for LS diagnosis" VALUE 0x8024F9C6 RB_Val_Wu16 65535.00 OneToOne 0.00 65535.00 FORMAT "%8.2" /end CHARACTERISTIC
/begin CHARACTERISTIC CbnHeatgHeatr_pwrHeatrOnHi_C "Calibratable high Heater power threshold for turning on relay." VALUE 0x8024F9C8 RB_Val_Ws16 65535.00 RBPtCel_pwr_1p0_1 -32768.00 32767.00 FORMAT "%8.2" /end CHARACTERISTIC
/begin CHARACTERISTIC CbnHeatgHeatr_pwrHeatrOnLo_C "Calibratable low Heater power threshold for turning on relay." VALUE 0x8024F9CA RB_Val_Ws16 65535.00 RBPtCel_pwr_1p0_1 -32768.00 32767.00 FORMAT "%8.2" /end CHARACTERISTIC
/begin CHARACTERISTIC CbnHeatgHeatr_pwrHeatrOn_C "Minimum power required for heater" VALUE 0x8024F9CC RB_Val_Ws16 1638375. RBPtCel_pwr_25p0_1 -819200.0 819175.0 FORMAT "%8.1" /end CHARACTERISTIC
/begin CHARACTERISTIC CbnHeatgHeatr_rMeasdConsol_C "Calibratable resistance present in cabin air heate" VALUE 0x8024F9D0 RB_Val_Wr32 2.000E+037 RBPtCel_r_1p0_1 -1.000E+037 1.000E+037 FORMAT "%8.3" EXTENDED_LIMITS -3.403E+038 3.403E+038 /end CHARACTERISTIC
/begin CHARACTERISTIC CbnHeatgHeatr_stPsDiagDi_C "Powerstage diagnosis disable mask" VALUE 0x8024F9D4 RB_Val_Wu16 65535.00 OneToOne 0.00 65535.00 FORMAT "%8.2" /end CHARACTERISTIC
/begin CHARACTERISTIC CbnHeatgHeatr_stPsDi_C "Powerstage disable mask" VALUE 0x8024F9D6 RB_Val_Wu16 65535.00 OneToOne 0.00 65535.00 FORMAT "%8.2" /end CHARACTERISTIC
/begin CHARACTERISTIC CbnHeatgHeatr_tiBtwTestImp_C "Time between successive test pulsed" VALUE 0x8024F9D8 RB_Val_Wu8 25.50 RBPtCel_ti_0p1_1 0.00 25.50 FORMAT "%5.2" /end CHARACTERISTIC
/begin CHARACTERISTIC CbnHeatgHeatr_tiBtwTestOtHs_C "Time between successive OT tests on HS" VALUE 0x8024F9DA RB_Val_Ws16 655350.0 Time_ms -327680.0 327670.0 FORMAT "%8.1" /end CHARACTERISTIC
/begin CHARACTERISTIC CbnHeatgHeatr_tiBtwTestOtLs_C "Time between successive OT tests on LS" VALUE 0x8024F9DC RB_Val_Ws16 655350.0 Time_ms -327680.0 327670.0 FORMAT "%8.1" /end CHARACTERISTIC
/begin CHARACTERISTIC CbnHeatgHeatr_tiBtwTestScbHs_C "Time between successive SCB tests on HS" VALUE 0x8024F9DE RB_Val_Ws16 655350.0 Time_ms -327680.0 327670.0 FORMAT "%8.1" /end CHARACTERISTIC
/begin CHARACTERISTIC CbnHeatgHeatr_tiBtwTestScbLs_C "Time between successive SCB tests on LS" VALUE 0x8024F9E0 RB_Val_Ws16 655350.0 Time_ms -327680.0 327670.0 FORMAT "%8.1" /end CHARACTERISTIC
/begin CHARACTERISTIC CbnHeatgHeatr_tiWaitMinOffDly_C "Minimum delay between HS and LS relay deactivations during turn OFF" VALUE 0x8024F9E2 RB_Val_Ws16 655.3500 RBPtCel_ti_0p01_1 -327.6800 327.6700 FORMAT "%8.4" /end CHARACTERISTIC
/begin CHARACTERISTIC CbnHeatgHeatr_tiWaitMinOnDly_C "Minimum delay between HS and LS relay activations during turn ON" VALUE 0x8024F9E4 RB_Val_Ws16 655.3500 RBPtCel_ti_0p01_1 -327.6800 327.6700 FORMAT "%8.4" /end CHARACTERISTIC
/begin CHARACTERISTIC CbnHeatgHeatr_uHvBattUActRepl_C "Battery voltage replacement value" VALUE 0x8024F9E6 RB_Val_Ws16 2047.969 Volt_V_q0p03125_COMPU -1024.000 1023.969 FORMAT "%8.3" /end CHARACTERISTIC
/begin CHARACTERISTIC CbnHeatgSwt_DigSensCal.tiDebPos_C " / debounce time of rising edge" VALUE 0x802549BC Val_Ws16 655350.0 Time_ms -327680.0 327670.0 FORMAT "%8.1" /end CHARACTERISTIC
/begin CHARACTERISTIC CbnHeatgSwt_DigSensCal.tiDebNeg_C " / debounce time of falling edge" VALUE 0x802549BE Val_Ws16 655350.0 Time_ms -327680.0 327670.0 FORMAT "%8.1" /end CHARACTERISTIC
/begin CHARACTERISTIC CbnHeatgSwt_dstActGradLim_f_C "" VALUE 0x802549C0 Val_Wr32 2.00000000E+037 OneToOne -1.00000000E+037 1.00000000E+037 FORMAT "%13.3" EXTENDED_LIMITS -3.40282347E+038 3.40282347E+038 /end CHARACTERISTIC
/begin CHARACTERISTIC CbnHeatgSwt_numStdSens_C "" VALUE 0x802549E4 Val_Wu32 4294967295.00 OneToOne 0.00 4294967295.00 FORMAT "%13.2" /end CHARACTERISTIC
/begin CHARACTERISTIC CbnHeatgSwt_numTempErrDef_C "" VALUE 0x802549E8 Val_Wu8 255.0 OneToOne 0.00 255.0 FORMAT "%5.1" /end CHARACTERISTIC
/begin CHARACTERISTIC CbnHeatgSwt_RmpSlp_f.Pos_C " / Positive ramp slope dy/dt" VALUE 0x802549C4 Kw_Wr32 2.00000000E+038 OneToOne -1.00000000E+038 1.00000000E+038 FORMAT "%13.3" EXTENDED_LIMITS -3.40282347E+038 3.40282347E+038 /end CHARACTERISTIC
/begin CHARACTERISTIC CbnHeatgSwt_RmpSlp_f.Neg_C " / Negative ramp slope dy/dt" VALUE 0x802549C8 Kw_Wr32 2.00000000E+038 OneToOne -1.00000000E+038 1.00000000E+038 FORMAT "%13.3" EXTENDED_LIMITS -3.40282347E+038 3.40282347E+038 /end CHARACTERISTIC
/begin CHARACTERISTIC CbnHeatgSwt_stActDflVal_f_C "" VALUE 0x802549CC Val_Wr32 2.00000000E+037 OneToOne -1.00000000E+037 1.00000000E+037 FORMAT "%13.3" EXTENDED_LIMITS -3.40282347E+038 3.40282347E+038 /end CHARACTERISTIC
/begin CHARACTERISTIC CbnHeatgSwt_stActHiLimit_f_C "" VALUE 0x802549D0 Val_Wr32 2.00000000E+037 OneToOne -1.00000000E+037 1.00000000E+037 FORMAT "%13.3" EXTENDED_LIMITS -3.40282347E+038 3.40282347E+038 /end CHARACTERISTIC
/begin CHARACTERISTIC CbnHeatgSwt_stActLoLimit_f_C "" VALUE 0x802549D4 Val_Wr32 2.00000000E+037 OneToOne -1.00000000E+037 1.00000000E+037 FORMAT "%13.3" EXTENDED_LIMITS -3.40282347E+038 3.40282347E+038 /end CHARACTERISTIC
/begin CHARACTERISTIC CbnHeatgSwt_swtConfStdSens2_C "" VALUE 0x802549A8 Val_Wu32 4294967295.00 OneToOne 0.00 4294967295.00 FORMAT "%13.2" /end CHARACTERISTIC
/begin CHARACTERISTIC CbnHeatgSwt_swtConfStdSensSwVers162_C "" VALUE 0x802549AC Val_Wu32 4294967295.00 OneToOne 0.00 4294967295.00 FORMAT "%13.2" /end CHARACTERISTIC
/begin CHARACTERISTIC CbnHeatgSwt_swtConfStdSens_C "" VALUE 0x802549B0 Val_Wu32 4294967295.00 OneToOne 0.00 4294967295.00 FORMAT "%13.2" /end CHARACTERISTIC
/begin CHARACTERISTIC CbnHeatgSwt_tiPT1_f_C "" VALUE 0x802549D8 Val_Wr32 2.00000000E+037 RBPtCel_ti_1p0_2 -1.00000000E+037 1.00000000E+037 FORMAT "%13.3" EXTENDED_LIMITS -3.40282347E+038 3.40282347E+038 /end CHARACTERISTIC
/begin CHARACTERISTIC CbnHeatgSwt_tiTempErrOk_C "" VALUE 0x802549EA Val_Ws16 655350.0 Time_ms -327680.0 327670.0 FORMAT "%8.1" /end CHARACTERISTIC
/begin CHARACTERISTIC CbnHeatgSwt_TransStg_f.Dfl_r32_C " / This is SW-CALPRM-PROTOTYPE" VALUE 0x802549DC Kw_Wr32 2.00000000E+037 OneToOne -1.00000000E+037 1.00000000E+037 FORMAT "%13.3" EXTENDED_LIMITS -3.40282347E+038 3.40282347E+038 /end CHARACTERISTIC
/begin CHARACTERISTIC CbnHeatgSwt_TransStg_f.stSensId_C " / This is SW-CALPRM-PROTOTYPE" VALUE 0x802549E0 Kw_Wu8 255.0 OneToOne 0.00 255.0 FORMAT "%5.1" /end CHARACTERISTIC
/begin CHARACTERISTIC CcsPwrLineChpRst_psDiagDigOut.nrTstPls_C " / Maximum number of test impulses possible in one driving cycle." VALUE 0x802549EC Kw_Wu32 4294967295.00 OneToOne 0.00 4294967295.00 FORMAT "%13.2" /end CHARACTERISTIC
/begin CHARACTERISTIC CcsPwrLineChpRst_psDiagDigOut.tiBtwElecFlt_C " / Time between test in case a short circuit or open load is detected." VALUE 0x802549F0 Kw_Ws16 655350.0 Time_ms -327680.0 327670.0 FORMAT "%8.1" /end CHARACTERISTIC
/begin CHARACTERISTIC CcsPwrLineChpRst_psDiagDigOut.tiBtwOTFlt_C " / Time between test when an over temperature error is detected." VALUE 0x802549F2 Kw_Ws16 655.3500 Time_s -327.6800 327.6700 FORMAT "%8.4" /end CHARACTERISTIC
/begin CHARACTERISTIC CcsPwrLineChpRst_rCnv_CUR "" CURVE 0x8024F9EC RB_Curve_S16_S16 799.9878 Prc -400.0000 399.9878 FORMAT "%8.4"
 /begin AXIS_DESCR STD_AXIS CcsPwrLineChpRst_rActr Prc 25 -400.0000 399.9878 FORMAT "%8.4" DEPOSIT ABSOLUTE /end AXIS_DESCR
/end CHARACTERISTIC
/begin CHARACTERISTIC CcsPwrLineChpRst_stActrDis_C "" VALUE 0x8024F9E8 RB_Val_Wu16 65535.00 OneToOne 0.00 65535.00 FORMAT "%8.2" /end CHARACTERISTIC
/begin CHARACTERISTIC CcsPwrLineChpRst_stPwrStgDiaDis_C "" VALUE 0x8024FA56 RB_Val_Wu16 65535.00 OneToOne 0.00 65535.00 FORMAT "%8.2" /end CHARACTERISTIC
/begin CHARACTERISTIC CcsPwrLineChpRst_stPwrStgDis_C "" VALUE 0x8024FA52 RB_Val_Wu16 65535.00 OneToOne 0.00 65535.00 FORMAT "%8.2" /end CHARACTERISTIC
/begin CHARACTERISTIC CcsPwrLineChpRst_swtConfActrCoorrSimple_C "" VALUE 0x8024F9EA RB_Val_Wu8 255.0 OneToOne 0.00 255.0 FORMAT "%5.1" /end CHARACTERISTIC
/begin CHARACTERISTIC CcsPwrLineChpRst_swtConfActrElecDrvrSimple_C "" VALUE 0x8024FA54 RB_Val_Wu8 255.0 OneToOne 0.00 255.0 FORMAT "%5.1" /end CHARACTERISTIC
/begin CHARACTERISTIC CcsPwrLineChpRst_swtConfActrElecMonSimple_C "" VALUE 0x8024FA58 RB_Val_Wu8 255.0 OneToOne 0.00 255.0 FORMAT "%5.1" /end CHARACTERISTIC
/begin CHARACTERISTIC CcsPwrLineChpRst_swtConfActrPsDrvrSimple_C "" VALUE 0x8024FA5A RB_Val_Wu8 255.0 OneToOne 0.00 255.0 FORMAT "%5.1" /end CHARACTERISTIC
/begin CHARACTERISTIC CcsPwrLineChpRst_tiPt1Mdl_C "" VALUE 0x8024FA5C RB_Val_Ws32 4294.9672940000000 TimeDelay_s 0.0000020000000 4294.9672959999998 FORMAT "%19.14" EXTENDED_LIMITS 0.000002000000001 4294.9672959999998 /end CHARACTERISTIC
/begin CHARACTERISTIC CcsPwrLineChpVccEna_psDiagDigOut.nrTstPls_C " / Maximum number of test impulses possible in one driving cycle." VALUE 0x802549F4 Kw_Wu32 4294967295.00 OneToOne 0.00 4294967295.00 FORMAT "%13.2" /end CHARACTERISTIC
/begin CHARACTERISTIC CcsPwrLineChpVccEna_psDiagDigOut.tiBtwElecFlt_C " / Time between test in case a short circuit or open load is detected." VALUE 0x802549F8 Kw_Ws16 655350.0 Time_ms -327680.0 327670.0 FORMAT "%8.1" /end CHARACTERISTIC
/begin CHARACTERISTIC CcsPwrLineChpVccEna_psDiagDigOut.tiBtwOTFlt_C " / Time between test when an over temperature error is detected." VALUE 0x802549FA Kw_Ws16 655.3500 Time_s -327.6800 327.6700 FORMAT "%8.4" /end CHARACTERISTIC
/begin CHARACTERISTIC CcsPwrLineChpVccEna_rCnv_CUR "" CURVE 0x8024FA64 RB_Curve_S16_S16 799.9878 Prc -400.0000 399.9878 FORMAT "%8.4"
 /begin AXIS_DESCR STD_AXIS CcsPwrLineChpVccEna_rActr Prc 25 -400.0000 399.9878 FORMAT "%8.4" DEPOSIT ABSOLUTE /end AXIS_DESCR
/end CHARACTERISTIC
/begin CHARACTERISTIC CcsPwrLineChpVccEna_stActrDis_C "" VALUE 0x8024FA60 RB_Val_Wu16 65535.00 OneToOne 0.00 65535.00 FORMAT "%8.2" /end CHARACTERISTIC
/begin CHARACTERISTIC CcsPwrLineChpVccEna_stPwrStgDiaDis_C "" VALUE 0x8024FACE RB_Val_Wu16 65535.00 OneToOne 0.00 65535.00 FORMAT "%8.2" /end CHARACTERISTIC
/begin CHARACTERISTIC CcsPwrLineChpVccEna_stPwrStgDis_C "" VALUE 0x8024FACA RB_Val_Wu16 65535.00 OneToOne 0.00 65535.00 FORMAT "%8.2" /end CHARACTERISTIC
/begin CHARACTERISTIC CcsPwrLineChpVccEna_swtConfActrCoorrSimple_C "" VALUE 0x8024FA62 RB_Val_Wu8 255.0 OneToOne 0.00 255.0 FORMAT "%5.1" /end CHARACTERISTIC
/begin CHARACTERISTIC CcsPwrLineChpVccEna_swtConfActrElecDrvrSimple_C "" VALUE 0x8024FACC RB_Val_Wu8 255.0 OneToOne 0.00 255.0 FORMAT "%5.1" /end CHARACTERISTIC
/begin CHARACTERISTIC CcsPwrLineChpVccEna_swtConfActrElecMonSimple_C "" VALUE 0x8024FAD0 RB_Val_Wu8 255.0 OneToOne 0.00 255.0 FORMAT "%5.1" /end CHARACTERISTIC
/begin CHARACTERISTIC CcsPwrLineChpVccEna_swtConfActrPsDrvrSimple_C "" VALUE 0x8024FAD2 RB_Val_Wu8 255.0 OneToOne 0.00 255.0 FORMAT "%5.1" /end CHARACTERISTIC
/begin CHARACTERISTIC CcsPwrLineChpVccEna_tiPt1Mdl_C "" VALUE 0x8024FAD4 RB_Val_Ws32 4294.9672940000000 TimeDelay_s 0.0000020000000 4294.9672959999998 FORMAT "%19.14" EXTENDED_LIMITS 0.000002000000001 4294.9672959999998 /end CHARACTERISTIC
/begin CHARACTERISTIC CcsPwrLineChpVcc_ADCCal.numSRCTempSel_C "Calibration structure for ADC and SENT / Selection of temperature for signal range check" VALUE 0x8024FAD8 RB_Val_Wu8 255.000000000 DELIB_ALLTEMP_VERB_COMPU 0.00 255.000000000 FORMAT "%13.9" /end CHARACTERISTIC
/begin CHARACTERISTIC CcsPwrLineChpVcc_ADCCal.tiSRCMaxDebOK_C "Calibration structure for ADC and SENT / Error healing deounce time" VALUE 0x8024FADC RB_Val_Ws32 42949672950.0 Time_ms -21474836480.0 21474836470.0 FORMAT "%13.1" /end CHARACTERISTIC
/begin CHARACTERISTIC CcsPwrLineChpVcc_ADCCal.uSRCMax_C "Calibration structure for ADC and SENT / Maximum threshold voltage for SRC" VALUE 0x8024FAE0 RB_Val_Ws16 13107.00 Volt -6553.600 6553.400 FORMAT "%8.3" /end CHARACTERISTIC
/begin CHARACTERISTIC CcsPwrLineChpVcc_ADCCal.uSRCMin_C "Calibration structure for ADC and SENT / Minimum threshold voltage for SRC" VALUE 0x8024FAE2 RB_Val_Ws16 13107.00 Volt -6553.600 6553.400 FORMAT "%8.3" /end CHARACTERISTIC
/begin CHARACTERISTIC CcsPwrLineChpVcc_ADCCal.uSRCOpn_C "Calibration structure for ADC and SENT / Maximum threshold for open SRC connection error." VALUE 0x8024FAE4 RB_Val_Ws16 13107.00 Volt -6553.600 6553.400 FORMAT "%8.3" /end CHARACTERISTIC
/begin CHARACTERISTIC CcsPwrLineChpVcc_ADCSensTransf_f_CUR "" CURVE 0x802549FC RB_Curve_R32_R32_sao 2.00000000E+037 RBPtCel_u_1p0_1 -1.00000000E+037 1.00000000E+037 FORMAT "%13.3" EXTENDED_LIMITS -3.40282347E+038 3.40282347E+038
 /begin AXIS_DESCR STD_AXIS CcsPwrLineChpVcc_uRaw_f RBPtCel_u_1p0_2 25 -1.00000000E+037 1.00000000E+037 FORMAT "%13.3" EXTENDED_LIMITS -3.40282347E+038 3.40282347E+038 DEPOSIT ABSOLUTE /end AXIS_DESCR
/end CHARACTERISTIC
/begin CHARACTERISTIC CcsPwrLineChpVcc_DigSensCal.tiDebPos_C " / debounce time of rising edge" VALUE 0x80254B80 Val_Ws16 655350.0 Time_ms -327680.0 327670.0 FORMAT "%8.1" /end CHARACTERISTIC
/begin CHARACTERISTIC CcsPwrLineChpVcc_DigSensCal.tiDebNeg_C " / debounce time of falling edge" VALUE 0x80254B82 Val_Ws16 655350.0 Time_ms -327680.0 327670.0 FORMAT "%8.1" /end CHARACTERISTIC
/begin CHARACTERISTIC CcsPwrLineChpVcc_duGradLim_f_C "" VALUE 0x80254B84 Val_Wr32 2.00000000E+037 RBPtCel_du_1p0_1 -1.00000000E+037 1.00000000E+037 FORMAT "%13.3" EXTENDED_LIMITS -3.40282347E+038 3.40282347E+038 /end CHARACTERISTIC
/begin CHARACTERISTIC CcsPwrLineChpVcc_numStdSens_C "" VALUE 0x80254BA8 Val_Wu32 4294967295.00 OneToOne 0.00 4294967295.00 FORMAT "%13.2" /end CHARACTERISTIC
/begin CHARACTERISTIC CcsPwrLineChpVcc_numTempErrDef_C "" VALUE 0x80254BAC Val_Wu8 255.0 OneToOne 0.00 255.0 FORMAT "%5.1" /end CHARACTERISTIC
/begin CHARACTERISTIC CcsPwrLineChpVcc_numtSel_C "" VALUE 0x80254BAE Val_Wu16 255.000000000 DELIB_ALLTEMP_VERB_COMPU 0.00 255.000000000 FORMAT "%13.9" /end CHARACTERISTIC
/begin CHARACTERISTIC CcsPwrLineChpVcc_RmpSlp_f.Pos_C " / Positive ramp slope dy/dt" VALUE 0x80254B88 Kw_Wr32 2.00000000E+038 RBPtCel_du_1p0_1 -1.00000000E+038 1.00000000E+038 FORMAT "%13.3" EXTENDED_LIMITS -3.40282347E+038 3.40282347E+038 /end CHARACTERISTIC
/begin CHARACTERISTIC CcsPwrLineChpVcc_RmpSlp_f.Neg_C " / Negative ramp slope dy/dt" VALUE 0x80254B8C Kw_Wr32 2.00000000E+038 RBPtCel_du_1p0_1 -1.00000000E+038 1.00000000E+038 FORMAT "%13.3" EXTENDED_LIMITS -3.40282347E+038 3.40282347E+038 /end CHARACTERISTIC
/begin CHARACTERISTIC CcsPwrLineChpVcc_stEnhPhysSRCRls_MAP "" MAP 0x80254BB0 RB_Map_S16S16_U8_sao 255.0 OneToOne 0.00 255.0 FORMAT "%5.1"
 /begin AXIS_DESCR STD_AXIS Epm_nEng EngN 25 -16384.00 16383.50 FORMAT "%8.2" DEPOSIT ABSOLUTE /end AXIS_DESCR
 /begin AXIS_DESCR STD_AXIS InjCtl_qSetUnBal InjMass 25 -327.6800 327.6700 FORMAT "%8.4" DEPOSIT ABSOLUTE /end AXIS_DESCR
/end CHARACTERISTIC
/begin CHARACTERISTIC CcsPwrLineChpVcc_swtConfStdSens2_C "" VALUE 0x80254B6C Val_Wu32 4294967295.00 OneToOne 0.00 4294967295.00 FORMAT "%13.2" /end CHARACTERISTIC
/begin CHARACTERISTIC CcsPwrLineChpVcc_swtConfStdSensSwVers162_C "" VALUE 0x80254B70 Val_Wu32 4294967295.00 OneToOne 0.00 4294967295.00 FORMAT "%13.2" /end CHARACTERISTIC
/begin CHARACTERISTIC CcsPwrLineChpVcc_swtConfStdSens_C "" VALUE 0x80254B74 Val_Wu32 4294967295.00 OneToOne 0.00 4294967295.00 FORMAT "%13.2" /end CHARACTERISTIC
/begin CHARACTERISTIC CcsPwrLineChpVcc_tiEngOnMin_C "" VALUE 0x80254E8C Val_Wu32 42949672950.0 Time_ms 0.00 42949672950.0 FORMAT "%13.1" /end CHARACTERISTIC
/begin CHARACTERISTIC CcsPwrLineChpVcc_tiPT1Fil_C "" VALUE 0x80254B60 Val_Ws32 4294.9672940000000 TimeDelay_s 0.0000020000000 4294.9672959999998 FORMAT "%19.14" EXTENDED_LIMITS 0.000002000000001 4294.9672959999998 /end CHARACTERISTIC
/begin CHARACTERISTIC CcsPwrLineChpVcc_tiPT1_f_C "" VALUE 0x80254B90 Val_Wr32 2.00000000E+037 RBPtCel_ti_1p0_2 -1.00000000E+037 1.00000000E+037 FORMAT "%13.3" EXTENDED_LIMITS -3.40282347E+038 3.40282347E+038 /end CHARACTERISTIC
/begin CHARACTERISTIC CcsPwrLineChpVcc_tiSRCMaxDefDeb_CUR "" CURVE 0x80254AC8 RB_Curve_S16_S32_sao 42949672950.0 Time_ms -21474836480.0 21474836470.0 FORMAT "%13.1"
 /begin AXIS_DESCR STD_AXIS CcsPwrLineChpVcc_tRefSnsr_mp Temp_Cels 25 -3549.940 3003.560 FORMAT "%8.3" DEPOSIT ABSOLUTE /end AXIS_DESCR
/end CHARACTERISTIC
/begin CHARACTERISTIC CcsPwrLineChpVcc_tiTempErrOk_C "" VALUE 0x80254E90 Val_Ws16 655350.0 Time_ms -327680.0 327670.0 FORMAT "%8.1" /end CHARACTERISTIC
/begin CHARACTERISTIC CcsPwrLineChpVcc_TransStg_f.Dfl_r32_C " / This is SW-CALPRM-PROTOTYPE" VALUE 0x80254B94 Kw_Wr32 2.00000000E+037 RBPtCel_u_1p0_1 -1.00000000E+037 1.00000000E+037 FORMAT "%13.3" EXTENDED_LIMITS -3.40282347E+038 3.40282347E+038 /end CHARACTERISTIC
/begin CHARACTERISTIC CcsPwrLineChpVcc_TransStg_f.stSensId_C " / This is SW-CALPRM-PROTOTYPE" VALUE 0x80254B98 Kw_Wu8 255.0 OneToOne 0.00 255.0 FORMAT "%5.1" /end CHARACTERISTIC
/begin CHARACTERISTIC CcsPwrLineChpVcc_tSnsrMax_f_C "" VALUE 0x80254E94 Val_Wr32 2.00000000E+037 RBPtCel_t_1p0_3 -1.00000000E+037 1.00000000E+037 FORMAT "%13.3" EXTENDED_LIMITS -3.40282347E+038 3.40282347E+038 /end CHARACTERISTIC
/begin CHARACTERISTIC CcsPwrLineChpVcc_tSnsrMin_f_C "" VALUE 0x80254E98 Val_Wr32 2.00000000E+037 RBPtCel_t_1p0_3 -1.00000000E+037 1.00000000E+037 FORMAT "%13.3" EXTENDED_LIMITS -3.40282347E+038 3.40282347E+038 /end CHARACTERISTIC
/begin CHARACTERISTIC CcsPwrLineChpVcc_uDflVal_f_C "" VALUE 0x80254B9C Val_Wr32 2.00000000E+037 RBPtCel_u_1p0_1 -1.00000000E+037 1.00000000E+037 FORMAT "%13.3" EXTENDED_LIMITS -3.40282347E+038 3.40282347E+038 /end CHARACTERISTIC
/begin CHARACTERISTIC CcsPwrLineChpVcc_uEnhPhysSRCMax_f_MAP "" MAP 0x80254E9C RB_Map_S16S16_R32_sao 2.00000000E+037 RBPtCel_u_1p0_1 -1.00000000E+037 1.00000000E+037 FORMAT "%13.3" EXTENDED_LIMITS -3.40282347E+038 3.40282347E+038
 /begin AXIS_DESCR STD_AXIS Epm_nEng EngN 25 -16384.00 16383.50 FORMAT "%8.2" DEPOSIT ABSOLUTE /end AXIS_DESCR
 /begin AXIS_DESCR STD_AXIS InjCtl_qSetUnBal InjMass 25 -327.6800 327.6700 FORMAT "%8.4" DEPOSIT ABSOLUTE /end AXIS_DESCR
/end CHARACTERISTIC
/begin CHARACTERISTIC CcsPwrLineChpVcc_uEnhPhysSRCMin_f_MAP "" MAP 0x802558C8 RB_Map_S16S16_R32_sao 2.00000000E+037 RBPtCel_u_1p0_1 -1.00000000E+037 1.00000000E+037 FORMAT "%13.3" EXTENDED_LIMITS -3.40282347E+038 3.40282347E+038
 /begin AXIS_DESCR STD_AXIS Epm_nEng EngN 25 -16384.00 16383.50 FORMAT "%8.2" DEPOSIT ABSOLUTE /end AXIS_DESCR
 /begin AXIS_DESCR STD_AXIS InjCtl_qSetUnBal InjMass 25 -327.6800 327.6700 FORMAT "%8.4" DEPOSIT ABSOLUTE /end AXIS_DESCR
/end CHARACTERISTIC
/begin CHARACTERISTIC CcsPwrLineChpVcc_uHiLimit_f_C "" VALUE 0x80254BA0 Val_Wr32 2.00000000E+037 RBPtCel_u_1p0_1 -1.00000000E+037 1.00000000E+037 FORMAT "%13.3" EXTENDED_LIMITS -3.40282347E+038 3.40282347E+038 /end CHARACTERISTIC
/begin CHARACTERISTIC CcsPwrLineChpVcc_uLoLimit_f_C "" VALUE 0x80254BA4 Val_Wr32 2.00000000E+037 RBPtCel_u_1p0_1 -1.00000000E+037 1.00000000E+037 FORMAT "%13.3" EXTENDED_LIMITS -3.40282347E+038 3.40282347E+038 /end CHARACTERISTIC
/begin CHARACTERISTIC CcsPwrLineComChpT_ADCCal.numSRCTempSel_C "Calibration structure for ADC and SENT / Selection of temperature for signal range check" VALUE 0x8024FAE8 RB_Val_Wu8 255.000000000 DELIB_ALLTEMP_VERB_COMPU 0.00 255.000000000 FORMAT "%13.9" /end CHARACTERISTIC
/begin CHARACTERISTIC CcsPwrLineComChpT_ADCCal.tiSRCMaxDebOK_C "Calibration structure for ADC and SENT / Error healing deounce time" VALUE 0x8024FAEC RB_Val_Ws32 42949672950.0 Time_ms -21474836480.0 21474836470.0 FORMAT "%13.1" /end CHARACTERISTIC
/begin CHARACTERISTIC CcsPwrLineComChpT_ADCCal.uSRCMax_C "Calibration structure for ADC and SENT / Maximum threshold voltage for SRC" VALUE 0x8024FAF0 RB_Val_Ws16 13107.00 Volt -6553.600 6553.400 FORMAT "%8.3" /end CHARACTERISTIC
/begin CHARACTERISTIC CcsPwrLineComChpT_ADCCal.uSRCMin_C "Calibration structure for ADC and SENT / Minimum threshold voltage for SRC" VALUE 0x8024FAF2 RB_Val_Ws16 13107.00 Volt -6553.600 6553.400 FORMAT "%8.3" /end CHARACTERISTIC
/begin CHARACTERISTIC CcsPwrLineComChpT_ADCCal.uSRCOpn_C "Calibration structure for ADC and SENT / Maximum threshold for open SRC connection error." VALUE 0x8024FAF4 RB_Val_Ws16 13107.00 Volt -6553.600 6553.400 FORMAT "%8.3" /end CHARACTERISTIC
/begin CHARACTERISTIC CcsPwrLineComChpT_ADCSensTransf_f_CUR "" CURVE 0x802562F4 RB_Curve_R32_R32_sao 2.00000000E+037 RBPtCel_t_1p0_3 -1.00000000E+037 1.00000000E+037 FORMAT "%13.3" EXTENDED_LIMITS -3.40282347E+038 3.40282347E+038
 /begin AXIS_DESCR STD_AXIS CcsPwrLineComChpT_uRaw_f RBPtCel_u_1p0_2 25 -1.00000000E+037 1.00000000E+037 FORMAT "%13.3" EXTENDED_LIMITS -3.40282347E+038 3.40282347E+038 DEPOSIT ABSOLUTE /end AXIS_DESCR
/end CHARACTERISTIC
/begin CHARACTERISTIC CcsPwrLineComChpT_DigSensCal.tiDebPos_C " / debounce time of rising edge" VALUE 0x80256478 Val_Ws16 655350.0 Time_ms -327680.0 327670.0 FORMAT "%8.1" /end CHARACTERISTIC
/begin CHARACTERISTIC CcsPwrLineComChpT_DigSensCal.tiDebNeg_C " / debounce time of falling edge" VALUE 0x8025647A Val_Ws16 655350.0 Time_ms -327680.0 327670.0 FORMAT "%8.1" /end CHARACTERISTIC
/begin CHARACTERISTIC CcsPwrLineComChpT_dtGradLim_f_C "" VALUE 0x8025647C Val_Wr32 2.00000000E+037 RBPtCel_dt_1p0_1 -1.00000000E+037 1.00000000E+037 FORMAT "%13.3" EXTENDED_LIMITS -3.40282347E+038 3.40282347E+038 /end CHARACTERISTIC
/begin CHARACTERISTIC CcsPwrLineComChpT_numStdSens_C "" VALUE 0x802564A0 Val_Wu32 4294967295.00 OneToOne 0.00 4294967295.00 FORMAT "%13.2" /end CHARACTERISTIC
/begin CHARACTERISTIC CcsPwrLineComChpT_numTempErrDef_C "" VALUE 0x802564A4 Val_Wu8 255.0 OneToOne 0.00 255.0 FORMAT "%5.1" /end CHARACTERISTIC
/begin CHARACTERISTIC CcsPwrLineComChpT_numtSel_C "" VALUE 0x802564A6 Val_Wu16 255.000000000 DELIB_ALLTEMP_VERB_COMPU 0.00 255.000000000 FORMAT "%13.9" /end CHARACTERISTIC
/begin CHARACTERISTIC CcsPwrLineComChpT_RmpSlp_f.Pos_C " / Positive ramp slope dy/dt" VALUE 0x80256480 Kw_Wr32 2.00000000E+038 RBPtCel_dt_1p0_1 -1.00000000E+038 1.00000000E+038 FORMAT "%13.3" EXTENDED_LIMITS -3.40282347E+038 3.40282347E+038 /end CHARACTERISTIC
/begin CHARACTERISTIC CcsPwrLineComChpT_RmpSlp_f.Neg_C " / Negative ramp slope dy/dt" VALUE 0x80256484 Kw_Wr32 2.00000000E+038 RBPtCel_dt_1p0_1 -1.00000000E+038 1.00000000E+038 FORMAT "%13.3" EXTENDED_LIMITS -3.40282347E+038 3.40282347E+038 /end CHARACTERISTIC
/begin CHARACTERISTIC CcsPwrLineComChpT_stEnhPhysSRCRls_MAP "" MAP 0x802564A8 RB_Map_S16S16_U8_sao 255.0 OneToOne 0.00 255.0 FORMAT "%5.1"
 /begin AXIS_DESCR STD_AXIS Epm_nEng EngN 25 -16384.00 16383.50 FORMAT "%8.2" DEPOSIT ABSOLUTE /end AXIS_DESCR
 /begin AXIS_DESCR STD_AXIS InjCtl_qSetUnBal InjMass 25 -327.6800 327.6700 FORMAT "%8.4" DEPOSIT ABSOLUTE /end AXIS_DESCR
/end CHARACTERISTIC
/begin CHARACTERISTIC CcsPwrLineComChpT_swtConfStdSens2_C "" VALUE 0x80256464 Val_Wu32 4294967295.00 OneToOne 0.00 4294967295.00 FORMAT "%13.2" /end CHARACTERISTIC
/begin CHARACTERISTIC CcsPwrLineComChpT_swtConfStdSensSwVers162_C "" VALUE 0x80256468 Val_Wu32 4294967295.00 OneToOne 0.00 4294967295.00 FORMAT "%13.2" /end CHARACTERISTIC
/begin CHARACTERISTIC CcsPwrLineComChpT_swtConfStdSens_C "" VALUE 0x8025646C Val_Wu32 4294967295.00 OneToOne 0.00 4294967295.00 FORMAT "%13.2" /end CHARACTERISTIC
/begin CHARACTERISTIC CcsPwrLineComChpT_tDflVal_f_C "" VALUE 0x80256488 Val_Wr32 2.00000000E+037 RBPtCel_t_1p0_3 -1.00000000E+037 1.00000000E+037 FORMAT "%13.3" EXTENDED_LIMITS -3.40282347E+038 3.40282347E+038 /end CHARACTERISTIC
/begin CHARACTERISTIC CcsPwrLineComChpT_tEnhPhysSRCMax_f_MAP "" MAP 0x80256784 RB_Map_S16S16_R32_sao 2.00000000E+037 RBPtCel_t_1p0_3 -1.00000000E+037 1.00000000E+037 FORMAT "%13.3" EXTENDED_LIMITS -3.40282347E+038 3.40282347E+038
 /begin AXIS_DESCR STD_AXIS Epm_nEng EngN 25 -16384.00 16383.50 FORMAT "%8.2" DEPOSIT ABSOLUTE /end AXIS_DESCR
 /begin AXIS_DESCR STD_AXIS InjCtl_qSetUnBal InjMass 25 -327.6800 327.6700 FORMAT "%8.4" DEPOSIT ABSOLUTE /end AXIS_DESCR
/end CHARACTERISTIC
/begin CHARACTERISTIC CcsPwrLineComChpT_tEnhPhysSRCMin_f_MAP "" MAP 0x802571B0 RB_Map_S16S16_R32_sao 2.00000000E+037 RBPtCel_t_1p0_3 -1.00000000E+037 1.00000000E+037 FORMAT "%13.3" EXTENDED_LIMITS -3.40282347E+038 3.40282347E+038
 /begin AXIS_DESCR STD_AXIS Epm_nEng EngN 25 -16384.00 16383.50 FORMAT "%8.2" DEPOSIT ABSOLUTE /end AXIS_DESCR
 /begin AXIS_DESCR STD_AXIS InjCtl_qSetUnBal InjMass 25 -327.6800 327.6700 FORMAT "%8.4" DEPOSIT ABSOLUTE /end AXIS_DESCR
/end CHARACTERISTIC
/begin CHARACTERISTIC CcsPwrLineComChpT_tHiLimit_f_C "" VALUE 0x8025648C Val_Wr32 2.00000000E+037 RBPtCel_t_1p0_3 -1.00000000E+037 1.00000000E+037 FORMAT "%13.3" EXTENDED_LIMITS -3.40282347E+038 3.40282347E+038 /end CHARACTERISTIC
/begin CHARACTERISTIC CcsPwrLineComChpT_tiEngOnMin_C "" VALUE 0x80257BDC Val_Wu32 42949672950.0 Time_ms 0.00 42949672950.0 FORMAT "%13.1" /end CHARACTERISTIC
/begin CHARACTERISTIC CcsPwrLineComChpT_tiPT1Fil_C "" VALUE 0x80256458 Val_Ws32 4294.9672940000000 TimeDelay_s 0.0000020000000 4294.9672959999998 FORMAT "%19.14" EXTENDED_LIMITS 0.000002000000001 4294.9672959999998 /end CHARACTERISTIC
/begin CHARACTERISTIC CcsPwrLineComChpT_tiPT1_f_C "" VALUE 0x80256490 Val_Wr32 2.00000000E+037 RBPtCel_ti_1p0_2 -1.00000000E+037 1.00000000E+037 FORMAT "%13.3" EXTENDED_LIMITS -3.40282347E+038 3.40282347E+038 /end CHARACTERISTIC
/begin CHARACTERISTIC CcsPwrLineComChpT_tiSRCMaxDefDeb_CUR "" CURVE 0x802563C0 RB_Curve_S16_S32_sao 42949672950.0 Time_ms -21474836480.0 21474836470.0 FORMAT "%13.1"
 /begin AXIS_DESCR STD_AXIS CcsPwrLineComChpT_tRefSnsr_mp Temp_Cels 25 -3549.940 3003.560 FORMAT "%8.3" DEPOSIT ABSOLUTE /end AXIS_DESCR
/end CHARACTERISTIC
/begin CHARACTERISTIC CcsPwrLineComChpT_tiTempErrOk_C "" VALUE 0x80257BE0 Val_Ws16 655350.0 Time_ms -327680.0 327670.0 FORMAT "%8.1" /end CHARACTERISTIC
/begin CHARACTERISTIC CcsPwrLineComChpT_tLoLimit_f_C "" VALUE 0x80256494 Val_Wr32 2.00000000E+037 RBPtCel_t_1p0_3 -1.00000000E+037 1.00000000E+037 FORMAT "%13.3" EXTENDED_LIMITS -3.40282347E+038 3.40282347E+038 /end CHARACTERISTIC
/begin CHARACTERISTIC CcsPwrLineComChpT_TransStg_f.Dfl_r32_C " / This is SW-CALPRM-PROTOTYPE" VALUE 0x80256498 Kw_Wr32 2.00000000E+037 RBPtCel_t_1p0_3 -1.00000000E+037 1.00000000E+037 FORMAT "%13.3" EXTENDED_LIMITS -3.40282347E+038 3.40282347E+038 /end CHARACTERISTIC
/begin CHARACTERISTIC CcsPwrLineComChpT_TransStg_f.stSensId_C " / This is SW-CALPRM-PROTOTYPE" VALUE 0x8025649C Kw_Wu8 255.0 OneToOne 0.00 255.0 FORMAT "%5.1" /end CHARACTERISTIC
/begin CHARACTERISTIC CcsPwrLineComChpT_tSnsrMax_f_C "" VALUE 0x80257BE4 Val_Wr32 2.00000000E+037 RBPtCel_t_1p0_3 -1.00000000E+037 1.00000000E+037 FORMAT "%13.3" EXTENDED_LIMITS -3.40282347E+038 3.40282347E+038 /end CHARACTERISTIC
/begin CHARACTERISTIC CcsPwrLineComChpT_tSnsrMin_f_C "" VALUE 0x80257BE8 Val_Wr32 2.00000000E+037 RBPtCel_t_1p0_3 -1.00000000E+037 1.00000000E+037 FORMAT "%13.3" EXTENDED_LIMITS -3.40282347E+038 3.40282347E+038 /end CHARACTERISTIC
/begin CHARACTERISTIC ChrgCntct_iEmgyOpnReplcmt_C "Replacement value in case of faulty signal quality" VALUE 0x8024FAF8 RB_Val_Wu16 2047.969 RBPtCel_i_0p03125_1 0.00 2047.969 FORMAT "%8.3" /end CHARACTERISTIC
/begin CHARACTERISTIC ChrgCntct_maskIActMeasdSq_C "Healthy mask for signal quality" VALUE 0x8024FAFA RB_Val_Wu16 65535.00 OneToOne 0.00 65535.00 FORMAT "%8.2" /end CHARACTERISTIC
/begin CHARACTERISTIC ChrgCntct_nrElpdOperMaxErr_C "Maximum limit for elapsed operations of contactors (error)" VALUE 0x8024FAFC RB_Val_Wu32 4294967295.00 OneToOne 0.00 4294967295.00 FORMAT "%13.2" /end CHARACTERISTIC
/begin CHARACTERISTIC ChrgCntct_nrElpdOperMaxWarn_C "Maximum limit for elapsed operations of contactors (warning)" VALUE 0x8024FB00 RB_Val_Wu32 4294967295.00 OneToOne 0.00 4294967295.00 FORMAT "%13.2" /end CHARACTERISTIC
/begin CHARACTERISTIC ChrgCntct_Prm.tiCntctEmgyOffDly_C "Charging contactors parameters / Charging contactors - emergency open time delay between contactors" VALUE 0x8024FB04 RB_Val_Wu16 655.3500 RBPtCel_ti_0p01_1 0.00 655.3500 FORMAT "%8.4" /end CHARACTERISTIC
/begin CHARACTERISTIC ChrgCntct_Prm.tiCntctOffDurn_C "Charging contactors parameters / Charging contactors - delay after contactors opening" VALUE 0x8024FB06 RB_Val_Wu16 655.3500 RBPtCel_ti_0p01_1 0.00 655.3500 FORMAT "%8.4" /end CHARACTERISTIC
/begin CHARACTERISTIC ChrgCntct_Prm.tiCntctOnDurn_C "Charging contactors parameters / Charging contactors - delay after contactors closing" VALUE 0x8024FB08 RB_Val_Wu16 655.3500 RBPtCel_ti_0p01_1 0.00 655.3500 FORMAT "%8.4" /end CHARACTERISTIC
/begin CHARACTERISTIC ChrgCntct_Prm.tiDebVldtCntctOff_C "Charging contactors parameters / Charging contactors - opened state validation time" VALUE 0x8024FB0A RB_Val_Wu16 655.3500 RBPtCel_ti_0p01_1 0.00 655.3500 FORMAT "%8.4" /end CHARACTERISTIC
/begin CHARACTERISTIC ChrgCntct_Prm.tiDebVldtCntctOn_C "Charging contactors parameters / Charging contactors - closed state validation time" VALUE 0x8024FB0C RB_Val_Wu16 655.3500 RBPtCel_ti_0p01_1 0.00 655.3500 FORMAT "%8.4" /end CHARACTERISTIC
/begin CHARACTERISTIC ChrgCntct_Prm.tiDwellDurn_C "Charging contactors parameters / Charging contactors - dwell time" VALUE 0x8024FB0E RB_Val_Wu16 655.3500 RBPtCel_ti_0p01_1 0.00 655.3500 FORMAT "%8.4" /end CHARACTERISTIC
/begin CHARACTERISTIC ChrgCntct_Prm.tiInitDly_C "Charging contactors parameters / Charging contactors - default delay after init and finish" VALUE 0x8024FB10 RB_Val_Wu8 2.550 RBPtCel_ti_0p01_1 0.00 2.550 FORMAT "%5.3" /end CHARACTERISTIC
/begin CHARACTERISTIC ChrgCntct_Prm.tiWaitMaxCntctOff_C "Charging contactors parameters / Charging contactors - maximum time to open the contactor" VALUE 0x8024FB12 RB_Val_Wu16 655.3500 RBPtCel_ti_0p01_1 0.00 655.3500 FORMAT "%8.4" /end CHARACTERISTIC
/begin CHARACTERISTIC ChrgCntct_Prm.tiWaitMaxCntctOn_C "Charging contactors parameters / Charging contactors - maximum time to close the contactor" VALUE 0x8024FB14 RB_Val_Wu16 655.3500 RBPtCel_ti_0p01_1 0.00 655.3500 FORMAT "%8.4" /end CHARACTERISTIC
/begin CHARACTERISTIC ChrgCntct_StMacCntct.ChrgCntct_facMulTbl_C "Charging contactors state machine state / Charging contactors - factor for table output multiplication" VALUE 0x8024FB16 RB_Val_Wu8 255.0 OneToOne 0.00 255.0 FORMAT "%5.1" /end CHARACTERISTIC
/begin CHARACTERISTIC ChrgCntct_StMacCntct.ChrgCntct_facOperIHi_T "Charging contactors state machine state / Charging contactors - table number of elapsed operations based on emergency open current (low currents)" CURVE 0x8024FB18 RB_Curve_U16_U16 65535.00 OneToOne 0.00 65535.00 FORMAT "%8.2"
 /begin AXIS_DESCR STD_AXIS NO_INPUT_QUANTITY RBPtCel_i_0p03125_1 5 0.00 2047.969 FORMAT "%8.3" DEPOSIT ABSOLUTE /end AXIS_DESCR
/end CHARACTERISTIC
/begin CHARACTERISTIC ChrgCntct_StMacCntct.ChrgCntct_facOperILo_T "Charging contactors state machine state / Charging contactors - table number of elapsed operations based on emergency open current (high currents)" CURVE 0x8024FB2E RB_Curve_U16_U16 65535.00 OneToOne 0.00 65535.00 FORMAT "%8.2"
 /begin AXIS_DESCR STD_AXIS NO_INPUT_QUANTITY RBPtCel_i_0p03125_1 5 0.00 2047.969 FORMAT "%8.3" DEPOSIT ABSOLUTE /end AXIS_DESCR
/end CHARACTERISTIC
/begin CHARACTERISTIC ChrgCntct_StMacCntct.ChrgCntct_iThdSwtTbl_C "Charging contactors state machine state / Charging contactors - current threshold to switch between Lo and Hi tables" VALUE 0x8024FB44 RB_Val_Wu16 2047.969 RBPtCel_i_0p03125_1 0.00 2047.969 FORMAT "%8.3" /end CHARACTERISTIC
/begin CHARACTERISTIC ChrgCom_tiComIniAcExt_C "Communication initialization timeout AC" VALUE 0x8024FB48 RB_Val_Wu16 655.3500 RBPtCel_ti_0p01_1 0.00 655.3500 FORMAT "%8.4" /end CHARACTERISTIC
/begin CHARACTERISTIC ChrgCom_tiComIniCcsDc_C "Communication initialization timeout CCS DC" VALUE 0x8024FB4A RB_Val_Wu16 655.3500 RBPtCel_ti_0p01_1 0.00 655.3500 FORMAT "%8.4" /end CHARACTERISTIC
/begin CHARACTERISTIC ChrgCom_tiComSetUpAcExt_C "Max. time trying to establish communication for CCS AC without HLC or China AC" VALUE 0x8024FB4C RB_Val_Wu16 655.3500 RBPtCel_ti_0p01_1 0.00 655.3500 FORMAT "%8.4" /end CHARACTERISTIC
/begin CHARACTERISTIC ChrgCom_tiComSetUpCcsDc_C "Max. time trying to establish communication for CCS DC" VALUE 0x8024FB4E RB_Val_Wu16 655.3500 RBPtCel_ti_0p01_1 0.00 655.3500 FORMAT "%8.4" /end CHARACTERISTIC
/begin CHARACTERISTIC ChrgFlow_flgTogIniEna_C "Activation of initial toggle" VALUE 0x8024FB50 RB_Val_Wu8 1.00000000000 B_TRUE 0.00 1.00000000000 FORMAT "%13.11" /end CHARACTERISTIC
/begin CHARACTERISTIC ChrgFlow_tiDlyTogIni_C "Delay of initial CP S2 toggle" VALUE 0x8024FB52 RB_Val_Wu16 655.3500 RBPtCel_ti_0p01_1 0.00 655.3500 FORMAT "%8.4" /end CHARACTERISTIC
/begin CHARACTERISTIC ChrgFlow_tiTogRst_C "Max. time till reset of toggle request" VALUE 0x8024FB54 RB_Val_Wu16 655.3500 RBPtCel_ti_0p01_1 0.00 655.3500 FORMAT "%8.4" /end CHARACTERISTIC
/begin CHARACTERISTIC ChrgMod_tiHldBackFinsh_C "Max. time till charging state FINSH will be provided" VALUE 0x8024FB56 RB_Val_Wu16 655.3500 RBPtCel_ti_0p01_1 0.00 655.3500 FORMAT "%8.4" /end CHARACTERISTIC
/begin CHARACTERISTIC DDRC_DurDeb.CbnHeatgHeatr_tiRlyOpendDebOk_C "" VALUE 0x8024091C Val_Wu16 655350.0 DDRCTime_ms 0.00 655350.0 FORMAT "%8.1" /end CHARACTERISTIC
/begin CHARACTERISTIC DDRC_DurDeb.CbnHeatgHeatr_tiRlyOpendDebDef_C "" VALUE 0x8024091E Val_Wu16 655350.0 DDRCTime_ms 0.00 655350.0 FORMAT "%8.1" /end CHARACTERISTIC
/begin CHARACTERISTIC DDRC_DurDeb.CbnHeatgHeatr_tiRlyWlddDebOk_C "" VALUE 0x80240920 Val_Wu16 655350.0 DDRCTime_ms 0.00 655350.0 FORMAT "%8.1" /end CHARACTERISTIC
/begin CHARACTERISTIC DDRC_DurDeb.CbnHeatgHeatr_tiRlyWlddDebDef_C "" VALUE 0x80240922 Val_Wu16 655350.0 DDRCTime_ms 0.00 655350.0 FORMAT "%8.1" /end CHARACTERISTIC
/begin CHARACTERISTIC DDRC_DurDeb.CcsPwrLineChpRst_tiMonDFCDebOk_C "" VALUE 0x80240924 Val_Wu16 655350.0 DDRCTime_ms 0.00 655350.0 FORMAT "%8.1" /end CHARACTERISTIC
/begin CHARACTERISTIC DDRC_DurDeb.CcsPwrLineChpRst_tiMonDFCDebDef_C "" VALUE 0x80240926 Val_Wu16 655350.0 DDRCTime_ms 0.00 655350.0 FORMAT "%8.1" /end CHARACTERISTIC
/begin CHARACTERISTIC DDRC_DurDeb.CcsPwrLineChpVccEna_tiMonDFCDebOk_C "" VALUE 0x80240928 Val_Wu16 655350.0 DDRCTime_ms 0.00 655350.0 FORMAT "%8.1" /end CHARACTERISTIC
/begin CHARACTERISTIC DDRC_DurDeb.CcsPwrLineChpVccEna_tiMonDFCDebDef_C "" VALUE 0x8024092A Val_Wu16 655350.0 DDRCTime_ms 0.00 655350.0 FORMAT "%8.1" /end CHARACTERISTIC
/begin CHARACTERISTIC DDRC_DurDeb.CcsPwrLineChpVcc_tiSRCMinDebOk_C "" VALUE 0x8024092C Val_Wu16 655350.0 DDRCTime_ms 0.00 655350.0 FORMAT "%8.1" /end CHARACTERISTIC
/begin CHARACTERISTIC DDRC_DurDeb.CcsPwrLineChpVcc_tiSRCMinDebDef_C "" VALUE 0x8024092E Val_Wu16 655350.0 DDRCTime_ms 0.00 655350.0 FORMAT "%8.1" /end CHARACTERISTIC
/begin CHARACTERISTIC DDRC_DurDeb.CcsPwrLineComChpT_tiSRCMinDebOk_C "" VALUE 0x80240930 Val_Wu16 655350.0 DDRCTime_ms 0.00 655350.0 FORMAT "%8.1" /end CHARACTERISTIC
/begin CHARACTERISTIC DDRC_DurDeb.CcsPwrLineComChpT_tiSRCMinDebDef_C "" VALUE 0x80240932 Val_Wu16 655350.0 DDRCTime_ms 0.00 655350.0 FORMAT "%8.1" /end CHARACTERISTIC
/begin CHARACTERISTIC DDRC_DurDeb.CcsPwrLineChpVcc_tiPhysRngHiDebOk_C "" VALUE 0x802409D8 Val_Wu16 655350.0 DDRCTime_ms 0.00 655350.0 FORMAT "%8.1" /end CHARACTERISTIC
/begin CHARACTERISTIC DDRC_DurDeb.CcsPwrLineChpVcc_tiPhysRngHiDebDef_C "" VALUE 0x802409DA Val_Wu16 655350.0 DDRCTime_ms 0.00 655350.0 FORMAT "%8.1" /end CHARACTERISTIC
/begin CHARACTERISTIC DDRC_DurDeb.CcsPwrLineChpVcc_tiPhysRngLoDebOk_C "" VALUE 0x802409DC Val_Wu16 655350.0 DDRCTime_ms 0.00 655350.0 FORMAT "%8.1" /end CHARACTERISTIC
/begin CHARACTERISTIC DDRC_DurDeb.CcsPwrLineChpVcc_tiPhysRngLoDebDef_C "" VALUE 0x802409DE Val_Wu16 655350.0 DDRCTime_ms 0.00 655350.0 FORMAT "%8.1" /end CHARACTERISTIC
/begin CHARACTERISTIC DDRC_DurDeb.CcsPwrLineChpVcc_tiSRCOpnDebOk_C "" VALUE 0x802409E0 Val_Wu16 655350.0 DDRCTime_ms 0.00 655350.0 FORMAT "%8.1" /end CHARACTERISTIC
/begin CHARACTERISTIC DDRC_DurDeb.CcsPwrLineChpVcc_tiSRCOpnDebDef_C "" VALUE 0x802409E2 Val_Wu16 655350.0 DDRCTime_ms 0.00 655350.0 FORMAT "%8.1" /end CHARACTERISTIC
/begin CHARACTERISTIC DDRC_DurDeb.CcsPwrLineComChpT_tiPhysRngHiDebOk_C "" VALUE 0x802409E4 Val_Wu16 655350.0 DDRCTime_ms 0.00 655350.0 FORMAT "%8.1" /end CHARACTERISTIC
/begin CHARACTERISTIC DDRC_DurDeb.CcsPwrLineComChpT_tiPhysRngHiDebDef_C "" VALUE 0x802409E6 Val_Wu16 655350.0 DDRCTime_ms 0.00 655350.0 FORMAT "%8.1" /end CHARACTERISTIC
/begin CHARACTERISTIC DDRC_DurDeb.CcsPwrLineComChpT_tiPhysRngLoDebOk_C "" VALUE 0x802409E8 Val_Wu16 655350.0 DDRCTime_ms 0.00 655350.0 FORMAT "%8.1" /end CHARACTERISTIC
/begin CHARACTERISTIC DDRC_DurDeb.CcsPwrLineComChpT_tiPhysRngLoDebDef_C "" VALUE 0x802409EA Val_Wu16 655350.0 DDRCTime_ms 0.00 655350.0 FORMAT "%8.1" /end CHARACTERISTIC
/begin CHARACTERISTIC DDRC_DurDeb.CcsPwrLineComChpT_tiSRCOpnDebOk_C "" VALUE 0x802409EC Val_Wu16 655350.0 DDRCTime_ms 0.00 655350.0 FORMAT "%8.1" /end CHARACTERISTIC
/begin CHARACTERISTIC DDRC_DurDeb.CcsPwrLineComChpT_tiSRCOpnDebDef_C "" VALUE 0x802409EE Val_Wu16 655350.0 DDRCTime_ms 0.00 655350.0 FORMAT "%8.1" /end CHARACTERISTIC
/begin CHARACTERISTIC DDRC_DurDeb.CbnHeatgHeatr_tiHsScbDebOk_C "" VALUE 0x80240B2C Val_Wu16 655350.0 DDRCTime_ms 0.00 655350.0 FORMAT "%8.1" /end CHARACTERISTIC
/begin CHARACTERISTIC DDRC_DurDeb.CbnHeatgHeatr_tiHsScbDebDef_C "" VALUE 0x80240B2E Val_Wu16 655350.0 DDRCTime_ms 0.00 655350.0 FORMAT "%8.1" /end CHARACTERISTIC
/begin CHARACTERISTIC DDRC_DurDeb.CbnHeatgHeatr_tiHsScgDebOk_C "" VALUE 0x80240B30 Val_Wu16 655350.0 DDRCTime_ms 0.00 655350.0 FORMAT "%8.1" /end CHARACTERISTIC
/begin CHARACTERISTIC DDRC_DurDeb.CbnHeatgHeatr_tiHsScgDebDef_C "" VALUE 0x80240B32 Val_Wu16 655350.0 DDRCTime_ms 0.00 655350.0 FORMAT "%8.1" /end CHARACTERISTIC
/begin CHARACTERISTIC DDRC_DurDeb.CbnHeatgHeatr_tiLsOlDebOk_C "" VALUE 0x80240B34 Val_Wu16 655350.0 DDRCTime_ms 0.00 655350.0 FORMAT "%8.1" /end CHARACTERISTIC
/begin CHARACTERISTIC DDRC_DurDeb.CbnHeatgHeatr_tiLsOlDebDef_C "" VALUE 0x80240B36 Val_Wu16 655350.0 DDRCTime_ms 0.00 655350.0 FORMAT "%8.1" /end CHARACTERISTIC
/begin CHARACTERISTIC DDRC_DurDeb.CbnHeatgHeatr_tiLsScbDebOk_C "" VALUE 0x80240B38 Val_Wu16 655350.0 DDRCTime_ms 0.00 655350.0 FORMAT "%8.1" /end CHARACTERISTIC
/begin CHARACTERISTIC DDRC_DurDeb.CbnHeatgHeatr_tiLsScbDebDef_C "" VALUE 0x80240B3A Val_Wu16 655350.0 DDRCTime_ms 0.00 655350.0 FORMAT "%8.1" /end CHARACTERISTIC
/begin CHARACTERISTIC DDRC_DurDeb.CbnHeatgHeatr_tiLsScgDebOk_C "" VALUE 0x80240B3C Val_Wu16 655350.0 DDRCTime_ms 0.00 655350.0 FORMAT "%8.1" /end CHARACTERISTIC
/begin CHARACTERISTIC DDRC_DurDeb.CbnHeatgHeatr_tiLsScgDebDef_C "" VALUE 0x80240B3E Val_Wu16 655350.0 DDRCTime_ms 0.00 655350.0 FORMAT "%8.1" /end CHARACTERISTIC
/begin CHARACTERISTIC DDRC_DurDeb.CbnHeatgHeatr_tiUnUsedDebOk_C "" VALUE 0x80240B40 Val_Wu16 655350.0 DDRCTime_ms 0.00 655350.0 FORMAT "%8.1" /end CHARACTERISTIC
/begin CHARACTERISTIC DDRC_DurDeb.CbnHeatgHeatr_tiUnUsedDebDef_C "" VALUE 0x80240B42 Val_Wu16 655350.0 DDRCTime_ms 0.00 655350.0 FORMAT "%8.1" /end CHARACTERISTIC
/begin CHARACTERISTIC DDRC_RatDeb.CbnHeatgHeatr_tiRlyOpendUDRat_C "" VALUE 0x80248A4B Val_Wu8 3.00000000000 DDRC_Ratio 1.00000000000 4.00000000000 FORMAT "%13.11" /end CHARACTERISTIC
/begin CHARACTERISTIC DDRC_RatDeb.CbnHeatgHeatr_tiRlyWlddUDRat_C "" VALUE 0x80248A4C Val_Wu8 3.00000000000 DDRC_Ratio 1.00000000000 4.00000000000 FORMAT "%13.11" /end CHARACTERISTIC
/begin CHARACTERISTIC DDRC_RatDeb.CcsPwrLineChpRst_tiMonDFCUDRat_C "" VALUE 0x80248A4D Val_Wu8 3.00000000000 DDRC_Ratio 1.00000000000 4.00000000000 FORMAT "%13.11" /end CHARACTERISTIC
/begin CHARACTERISTIC DDRC_RatDeb.CcsPwrLineChpVccEna_tiMonDFCUDRat_C "" VALUE 0x80248A4E Val_Wu8 3.00000000000 DDRC_Ratio 1.00000000000 4.00000000000 FORMAT "%13.11" /end CHARACTERISTIC
/begin CHARACTERISTIC DDRC_RatDeb.CcsPwrLineChpVcc_tiSRCMinUDRat_C "" VALUE 0x80248A4F Val_Wu8 3.00000000000 DDRC_Ratio 1.00000000000 4.00000000000 FORMAT "%13.11" /end CHARACTERISTIC
/begin CHARACTERISTIC DDRC_RatDeb.CcsPwrLineComChpT_tiSRCMinUDRat_C "" VALUE 0x80248A50 Val_Wu8 3.00000000000 DDRC_Ratio 1.00000000000 4.00000000000 FORMAT "%13.11" /end CHARACTERISTIC
/begin CHARACTERISTIC DDRC_RatDeb.CcsPwrLineChpVcc_tiPhysRngHiUDRat_C "" VALUE 0x80248A7A Val_Wu8 3.00000000000 DDRC_Ratio 1.00000000000 4.00000000000 FORMAT "%13.11" /end CHARACTERISTIC
/begin CHARACTERISTIC DDRC_RatDeb.CcsPwrLineChpVcc_tiPhysRngLoUDRat_C "" VALUE 0x80248A7B Val_Wu8 3.00000000000 DDRC_Ratio 1.00000000000 4.00000000000 FORMAT "%13.11" /end CHARACTERISTIC
/begin CHARACTERISTIC DDRC_RatDeb.CcsPwrLineChpVcc_tiSRCOpnUDRat_C "" VALUE 0x80248A7C Val_Wu8 3.00000000000 DDRC_Ratio 1.00000000000 4.00000000000 FORMAT "%13.11" /end CHARACTERISTIC
/begin CHARACTERISTIC DDRC_RatDeb.CcsPwrLineComChpT_tiPhysRngHiUDRat_C "" VALUE 0x80248A7D Val_Wu8 3.00000000000 DDRC_Ratio 1.00000000000 4.00000000000 FORMAT "%13.11" /end CHARACTERISTIC
/begin CHARACTERISTIC DDRC_RatDeb.CcsPwrLineComChpT_tiPhysRngLoUDRat_C "" VALUE 0x80248A7E Val_Wu8 3.00000000000 DDRC_Ratio 1.00000000000 4.00000000000 FORMAT "%13.11" /end CHARACTERISTIC
/begin CHARACTERISTIC DDRC_RatDeb.CcsPwrLineComChpT_tiSRCOpnUDRat_C "" VALUE 0x80248A7F Val_Wu8 3.00000000000 DDRC_Ratio 1.00000000000 4.00000000000 FORMAT "%13.11" /end CHARACTERISTIC
/begin CHARACTERISTIC DFC_CtlMsk2.DFC_CbnHeatgHeatrHsScb_C "" VALUE 0x80241304 Val_Wu8 255.0 DFES_OneToOne 0.00 255.0 FORMAT "%5.1" /end CHARACTERISTIC
/begin CHARACTERISTIC DFC_CtlMsk2.DFC_CbnHeatgHeatrHsScg_C "" VALUE 0x80241305 Val_Wu8 255.0 DFES_OneToOne 0.00 255.0 FORMAT "%5.1" /end CHARACTERISTIC
/begin CHARACTERISTIC DFC_CtlMsk2.DFC_CbnHeatgHeatrLsOl_C "" VALUE 0x80241306 Val_Wu8 255.0 DFES_OneToOne 0.00 255.0 FORMAT "%5.1" /end CHARACTERISTIC
/begin CHARACTERISTIC DFC_CtlMsk2.DFC_CbnHeatgHeatrLsScb_C "" VALUE 0x80241307 Val_Wu8 255.0 DFES_OneToOne 0.00 255.0 FORMAT "%5.1" /end CHARACTERISTIC
/begin CHARACTERISTIC DFC_CtlMsk2.DFC_CbnHeatgHeatrLsScg_C "" VALUE 0x80241308 Val_Wu8 255.0 DFES_OneToOne 0.00 255.0 FORMAT "%5.1" /end CHARACTERISTIC
/begin CHARACTERISTIC DFC_CtlMsk2.DFC_CbnHeatgHeatrUnUsed_C "" VALUE 0x80241309 Val_Wu8 255.0 DFES_OneToOne 0.00 255.0 FORMAT "%5.1" /end CHARACTERISTIC
/begin CHARACTERISTIC DFC_CtlMsk2.DFC_CbnHeatgHeatrRlyOpend_C "" VALUE 0x802414F8 Val_Wu8 255.0 DFES_OneToOne 0.00 255.0 FORMAT "%5.1" /end CHARACTERISTIC
/begin CHARACTERISTIC DFC_CtlMsk2.DFC_CbnHeatgHeatrRlyWldd_C "" VALUE 0x802414F9 Val_Wu8 255.0 DFES_OneToOne 0.00 255.0 FORMAT "%5.1" /end CHARACTERISTIC
/begin CHARACTERISTIC DFC_CtlMsk2.DFC_CcsPwrLineChpRstOL_C "" VALUE 0x80241500 Val_Wu8 255.0 DFES_OneToOne 0.00 255.0 FORMAT "%5.1" /end CHARACTERISTIC
/begin CHARACTERISTIC DFC_CtlMsk2.DFC_CcsPwrLineChpRstOvrTemp_C "" VALUE 0x80241501 Val_Wu8 255.0 DFES_OneToOne 0.00 255.0 FORMAT "%5.1" /end CHARACTERISTIC
/begin CHARACTERISTIC DFC_CtlMsk2.DFC_CcsPwrLineChpRstSCB_C "" VALUE 0x80241502 Val_Wu8 255.0 DFES_OneToOne 0.00 255.0 FORMAT "%5.1" /end CHARACTERISTIC
/begin CHARACTERISTIC DFC_CtlMsk2.DFC_CcsPwrLineChpRstSCG_C "" VALUE 0x80241503 Val_Wu8 255.0 DFES_OneToOne 0.00 255.0 FORMAT "%5.1" /end CHARACTERISTIC
/begin CHARACTERISTIC DFC_CtlMsk2.DFC_CcsPwrLineChpVccEnaOL_C "" VALUE 0x80241504 Val_Wu8 255.0 DFES_OneToOne 0.00 255.0 FORMAT "%5.1" /end CHARACTERISTIC
/begin CHARACTERISTIC DFC_CtlMsk2.DFC_CcsPwrLineChpVccEnaOvrTemp_C "" VALUE 0x80241505 Val_Wu8 255.0 DFES_OneToOne 0.00 255.0 FORMAT "%5.1" /end CHARACTERISTIC
/begin CHARACTERISTIC DFC_CtlMsk2.DFC_CcsPwrLineChpVccEnaSCB_C "" VALUE 0x80241506 Val_Wu8 255.0 DFES_OneToOne 0.00 255.0 FORMAT "%5.1" /end CHARACTERISTIC
/begin CHARACTERISTIC DFC_CtlMsk2.DFC_CcsPwrLineChpVccEnaSCG_C "" VALUE 0x80241507 Val_Wu8 255.0 DFES_OneToOne 0.00 255.0 FORMAT "%5.1" /end CHARACTERISTIC
/begin CHARACTERISTIC DFC_CtlMsk2.DFC_CcsPwrLineChpVccSRCMin_C "" VALUE 0x80241508 Val_Wu8 255.0 DFES_OneToOne 0.00 255.0 FORMAT "%5.1" /end CHARACTERISTIC
/begin CHARACTERISTIC DFC_CtlMsk2.DFC_CcsPwrLineComChpTSRCMin_C "" VALUE 0x80241509 Val_Wu8 255.0 DFES_OneToOne 0.00 255.0 FORMAT "%5.1" /end CHARACTERISTIC
/begin CHARACTERISTIC DFC_CtlMsk2.DFC_CcsPwrLineChpVccPhysRngHi_C "" VALUE 0x80241533 Val_Wu8 255.0 DFES_OneToOne 0.00 255.0 FORMAT "%5.1" /end CHARACTERISTIC
/begin CHARACTERISTIC DFC_CtlMsk2.DFC_CcsPwrLineChpVccPhysRngLo_C "" VALUE 0x80241534 Val_Wu8 255.0 DFES_OneToOne 0.00 255.0 FORMAT "%5.1" /end CHARACTERISTIC
/begin CHARACTERISTIC DFC_CtlMsk2.DFC_CcsPwrLineChpVccSRCOpn_C "" VALUE 0x80241535 Val_Wu8 255.0 DFES_OneToOne 0.00 255.0 FORMAT "%5.1" /end CHARACTERISTIC
/begin CHARACTERISTIC DFC_CtlMsk2.DFC_CcsPwrLineComChpTPhysRngHi_C "" VALUE 0x80241536 Val_Wu8 255.0 DFES_OneToOne 0.00 255.0 FORMAT "%5.1" /end CHARACTERISTIC
/begin CHARACTERISTIC DFC_CtlMsk2.DFC_CcsPwrLineComChpTPhysRngLo_C "" VALUE 0x80241537 Val_Wu8 255.0 DFES_OneToOne 0.00 255.0 FORMAT "%5.1" /end CHARACTERISTIC
/begin CHARACTERISTIC DFC_CtlMsk2.DFC_CcsPwrLineComChpTSRCOpn_C "" VALUE 0x80241538 Val_Wu8 255.0 DFES_OneToOne 0.00 255.0 FORMAT "%5.1" /end CHARACTERISTIC
/begin CHARACTERISTIC DFC_CtlMsk2.DFC_CbnHeatrRlyLfLoWarn_C "" VALUE 0x80241591 Val_Wu8 255.0 DFES_OneToOne 0.00 255.0 FORMAT "%5.1" /end CHARACTERISTIC
/begin CHARACTERISTIC DFC_CtlMsk2.DFC_CbnHeatgSwtTmpErr_C "" VALUE 0x802415D2 Val_Wu8 255.0 DFES_OneToOne 0.00 255.0 FORMAT "%5.1" /end CHARACTERISTIC
/begin CHARACTERISTIC DFC_CtlMsk2.DFC_CcsPwrLineChpVccSRCMax_C "" VALUE 0x802415D3 Val_Wu8 255.0 DFES_OneToOne 0.00 255.0 FORMAT "%5.1" /end CHARACTERISTIC
/begin CHARACTERISTIC DFC_CtlMsk2.DFC_CcsPwrLineChpVccTmpErr_C "" VALUE 0x802415D4 Val_Wu8 255.0 DFES_OneToOne 0.00 255.0 FORMAT "%5.1" /end CHARACTERISTIC
/begin CHARACTERISTIC DFC_CtlMsk2.DFC_CcsPwrLineComChpTSRCMax_C "" VALUE 0x802415D5 Val_Wu8 255.0 DFES_OneToOne 0.00 255.0 FORMAT "%5.1" /end CHARACTERISTIC
/begin CHARACTERISTIC DFC_CtlMsk2.DFC_CcsPwrLineComChpTTmpErr_C "" VALUE 0x802415D6 Val_Wu8 255.0 DFES_OneToOne 0.00 255.0 FORMAT "%5.1" /end CHARACTERISTIC
/begin CHARACTERISTIC DFC_CtlMsk2.DFC_ChrgCntctAllWldd_C "" VALUE 0x802415DC Val_Wu8 255.0 DFES_OneToOne 0.00 255.0 FORMAT "%5.1" /end CHARACTERISTIC
/begin CHARACTERISTIC DFC_CtlMsk2.DFC_ChrgCntctNegOperErr_C "" VALUE 0x802415DD Val_Wu8 255.0 DFES_OneToOne 0.00 255.0 FORMAT "%5.1" /end CHARACTERISTIC
/begin CHARACTERISTIC DFC_CtlMsk2.DFC_ChrgCntctNegOperWarn_C "" VALUE 0x802415DE Val_Wu8 255.0 DFES_OneToOne 0.00 255.0 FORMAT "%5.1" /end CHARACTERISTIC
/begin CHARACTERISTIC DFC_CtlMsk2.DFC_ChrgCntctNegWldd_C "" VALUE 0x802415DF Val_Wu8 255.0 DFES_OneToOne 0.00 255.0 FORMAT "%5.1" /end CHARACTERISTIC
/begin CHARACTERISTIC DFC_CtlMsk2.DFC_ChrgCntctPosOperErr_C "" VALUE 0x802415E0 Val_Wu8 255.0 DFES_OneToOne 0.00 255.0 FORMAT "%5.1" /end CHARACTERISTIC
/begin CHARACTERISTIC DFC_CtlMsk2.DFC_ChrgCntctPosOperWarn_C "" VALUE 0x802415E1 Val_Wu8 255.0 DFES_OneToOne 0.00 255.0 FORMAT "%5.1" /end CHARACTERISTIC
/begin CHARACTERISTIC DFC_CtlMsk2.DFC_ChrgCntctPosWldd_C "" VALUE 0x802415E2 Val_Wu8 255.0 DFES_OneToOne 0.00 255.0 FORMAT "%5.1" /end CHARACTERISTIC
/begin CHARACTERISTIC DFC_CtlMsk2.DFC_ChrgCntctStuckOpen_C "" VALUE 0x802415E3 Val_Wu8 255.0 DFES_OneToOne 0.00 255.0 FORMAT "%5.1" /end CHARACTERISTIC
/begin CHARACTERISTIC DFC_CtlMsk2.DFC_ChrgnUnplRqrd_C "" VALUE 0x802415E5 Val_Wu8 255.0 DFES_OneToOne 0.00 255.0 FORMAT "%5.1" /end CHARACTERISTIC
/begin CHARACTERISTIC DFC_DisblMsk2.DFC_CbnHeatgHeatrHsScb_C "" VALUE 0x80248AEE Val_Wu16 65535.00 DFES_OneToOne 0.00 65535.00 FORMAT "%8.2" /end CHARACTERISTIC
/begin CHARACTERISTIC DFC_DisblMsk2.DFC_CbnHeatgHeatrHsScg_C "" VALUE 0x80248AF0 Val_Wu16 65535.00 DFES_OneToOne 0.00 65535.00 FORMAT "%8.2" /end CHARACTERISTIC
/begin CHARACTERISTIC DFC_DisblMsk2.DFC_CbnHeatgHeatrLsOl_C "" VALUE 0x80248AF2 Val_Wu16 65535.00 DFES_OneToOne 0.00 65535.00 FORMAT "%8.2" /end CHARACTERISTIC
/begin CHARACTERISTIC DFC_DisblMsk2.DFC_CbnHeatgHeatrLsScb_C "" VALUE 0x80248AF4 Val_Wu16 65535.00 DFES_OneToOne 0.00 65535.00 FORMAT "%8.2" /end CHARACTERISTIC
/begin CHARACTERISTIC DFC_DisblMsk2.DFC_CbnHeatgHeatrLsScg_C "" VALUE 0x80248AF6 Val_Wu16 65535.00 DFES_OneToOne 0.00 65535.00 FORMAT "%8.2" /end CHARACTERISTIC
/begin CHARACTERISTIC DFC_DisblMsk2.DFC_CbnHeatgHeatrUnUsed_C "" VALUE 0x80248AF8 Val_Wu16 65535.00 DFES_OneToOne 0.00 65535.00 FORMAT "%8.2" /end CHARACTERISTIC
/begin CHARACTERISTIC DFC_DisblMsk2.DFC_CbnHeatgHeatrRlyOpend_C "" VALUE 0x80248ED6 Val_Wu16 65535.00 DFES_OneToOne 0.00 65535.00 FORMAT "%8.2" /end CHARACTERISTIC
/begin CHARACTERISTIC DFC_DisblMsk2.DFC_CbnHeatgHeatrRlyWldd_C "" VALUE 0x80248ED8 Val_Wu16 65535.00 DFES_OneToOne 0.00 65535.00 FORMAT "%8.2" /end CHARACTERISTIC
/begin CHARACTERISTIC DFC_DisblMsk2.DFC_CcsPwrLineChpRstOL_C "" VALUE 0x80248EE6 Val_Wu16 65535.00 DFES_OneToOne 0.00 65535.00 FORMAT "%8.2" /end CHARACTERISTIC
/begin CHARACTERISTIC DFC_DisblMsk2.DFC_CcsPwrLineChpRstOvrTemp_C "" VALUE 0x80248EE8 Val_Wu16 65535.00 DFES_OneToOne 0.00 65535.00 FORMAT "%8.2" /end CHARACTERISTIC
/begin CHARACTERISTIC DFC_DisblMsk2.DFC_CcsPwrLineChpRstSCB_C "" VALUE 0x80248EEA Val_Wu16 65535.00 DFES_OneToOne 0.00 65535.00 FORMAT "%8.2" /end CHARACTERISTIC
/begin CHARACTERISTIC DFC_DisblMsk2.DFC_CcsPwrLineChpRstSCG_C "" VALUE 0x80248EEC Val_Wu16 65535.00 DFES_OneToOne 0.00 65535.00 FORMAT "%8.2" /end CHARACTERISTIC
/begin CHARACTERISTIC DFC_DisblMsk2.DFC_CcsPwrLineChpVccEnaOL_C "" VALUE 0x80248EEE Val_Wu16 65535.00 DFES_OneToOne 0.00 65535.00 FORMAT "%8.2" /end CHARACTERISTIC
/begin CHARACTERISTIC DFC_DisblMsk2.DFC_CcsPwrLineChpVccEnaOvrTemp_C "" VALUE 0x80248EF0 Val_Wu16 65535.00 DFES_OneToOne 0.00 65535.00 FORMAT "%8.2" /end CHARACTERISTIC
/begin CHARACTERISTIC DFC_DisblMsk2.DFC_CcsPwrLineChpVccEnaSCB_C "" VALUE 0x80248EF2 Val_Wu16 65535.00 DFES_OneToOne 0.00 65535.00 FORMAT "%8.2" /end CHARACTERISTIC
/begin CHARACTERISTIC DFC_DisblMsk2.DFC_CcsPwrLineChpVccEnaSCG_C "" VALUE 0x80248EF4 Val_Wu16 65535.00 DFES_OneToOne 0.00 65535.00 FORMAT "%8.2" /end CHARACTERISTIC
/begin CHARACTERISTIC DFC_DisblMsk2.DFC_CcsPwrLineChpVccSRCMin_C "" VALUE 0x80248EF6 Val_Wu16 65535.00 DFES_OneToOne 0.00 65535.00 FORMAT "%8.2" /end CHARACTERISTIC
/begin CHARACTERISTIC DFC_DisblMsk2.DFC_CcsPwrLineComChpTSRCMin_C "" VALUE 0x80248EF8 Val_Wu16 65535.00 DFES_OneToOne 0.00 65535.00 FORMAT "%8.2" /end CHARACTERISTIC
/begin CHARACTERISTIC DFC_DisblMsk2.DFC_CcsPwrLineChpVccPhysRngHi_C "" VALUE 0x80248F4C Val_Wu16 65535.00 DFES_OneToOne 0.00 65535.00 FORMAT "%8.2" /end CHARACTERISTIC
/begin CHARACTERISTIC DFC_DisblMsk2.DFC_CcsPwrLineChpVccPhysRngLo_C "" VALUE 0x80248F4E Val_Wu16 65535.00 DFES_OneToOne 0.00 65535.00 FORMAT "%8.2" /end CHARACTERISTIC
/begin CHARACTERISTIC DFC_DisblMsk2.DFC_CcsPwrLineChpVccSRCOpn_C "" VALUE 0x80248F50 Val_Wu16 65535.00 DFES_OneToOne 0.00 65535.00 FORMAT "%8.2" /end CHARACTERISTIC
/begin CHARACTERISTIC DFC_DisblMsk2.DFC_CcsPwrLineComChpTPhysRngHi_C "" VALUE 0x80248F52 Val_Wu16 65535.00 DFES_OneToOne 0.00 65535.00 FORMAT "%8.2" /end CHARACTERISTIC
/begin CHARACTERISTIC DFC_DisblMsk2.DFC_CcsPwrLineComChpTPhysRngLo_C "" VALUE 0x80248F54 Val_Wu16 65535.00 DFES_OneToOne 0.00 65535.00 FORMAT "%8.2" /end CHARACTERISTIC
/begin CHARACTERISTIC DFC_DisblMsk2.DFC_CcsPwrLineComChpTSRCOpn_C "" VALUE 0x80248F56 Val_Wu16 65535.00 DFES_OneToOne 0.00 65535.00 FORMAT "%8.2" /end CHARACTERISTIC
/begin CHARACTERISTIC DFC_DisblMsk2.DFC_CbnHeatrRlyLfLoWarn_C "" VALUE 0x80249008 Val_Wu16 65535.00 DFES_OneToOne 0.00 65535.00 FORMAT "%8.2" /end CHARACTERISTIC
/begin CHARACTERISTIC DFC_DisblMsk2.DFC_CbnHeatgSwtTmpErr_C "" VALUE 0x8024908A Val_Wu16 65535.00 DFES_OneToOne 0.00 65535.00 FORMAT "%8.2" /end CHARACTERISTIC
/begin CHARACTERISTIC DFC_DisblMsk2.DFC_CcsPwrLineChpVccSRCMax_C "" VALUE 0x8024908C Val_Wu16 65535.00 DFES_OneToOne 0.00 65535.00 FORMAT "%8.2" /end CHARACTERISTIC
/begin CHARACTERISTIC DFC_DisblMsk2.DFC_CcsPwrLineChpVccTmpErr_C "" VALUE 0x8024908E Val_Wu16 65535.00 DFES_OneToOne 0.00 65535.00 FORMAT "%8.2" /end CHARACTERISTIC
/begin CHARACTERISTIC DFC_DisblMsk2.DFC_CcsPwrLineComChpTSRCMax_C "" VALUE 0x80249090 Val_Wu16 65535.00 DFES_OneToOne 0.00 65535.00 FORMAT "%8.2" /end CHARACTERISTIC
/begin CHARACTERISTIC DFC_DisblMsk2.DFC_CcsPwrLineComChpTTmpErr_C "" VALUE 0x80249092 Val_Wu16 65535.00 DFES_OneToOne 0.00 65535.00 FORMAT "%8.2" /end CHARACTERISTIC
/begin CHARACTERISTIC DFC_DisblMsk2.DFC_ChrgCntctAllWldd_C "" VALUE 0x8024909E Val_Wu16 65535.00 DFES_OneToOne 0.00 65535.00 FORMAT "%8.2" /end CHARACTERISTIC
/begin CHARACTERISTIC DFC_DisblMsk2.DFC_ChrgCntctNegOperErr_C "" VALUE 0x802490A0 Val_Wu16 65535.00 DFES_OneToOne 0.00 65535.00 FORMAT "%8.2" /end CHARACTERISTIC
/begin CHARACTERISTIC DFC_DisblMsk2.DFC_ChrgCntctNegOperWarn_C "" VALUE 0x802490A2 Val_Wu16 65535.00 DFES_OneToOne 0.00 65535.00 FORMAT "%8.2" /end CHARACTERISTIC
/begin CHARACTERISTIC DFC_DisblMsk2.DFC_ChrgCntctNegWldd_C "" VALUE 0x802490A4 Val_Wu16 65535.00 DFES_OneToOne 0.00 65535.00 FORMAT "%8.2" /end CHARACTERISTIC
/begin CHARACTERISTIC DFC_DisblMsk2.DFC_ChrgCntctPosOperErr_C "" VALUE 0x802490A6 Val_Wu16 65535.00 DFES_OneToOne 0.00 65535.00 FORMAT "%8.2" /end CHARACTERISTIC
/begin CHARACTERISTIC DFC_DisblMsk2.DFC_ChrgCntctPosOperWarn_C "" VALUE 0x802490A8 Val_Wu16 65535.00 DFES_OneToOne 0.00 65535.00 FORMAT "%8.2" /end CHARACTERISTIC
/begin CHARACTERISTIC DFC_DisblMsk2.DFC_ChrgCntctPosWldd_C "" VALUE 0x802490AA Val_Wu16 65535.00 DFES_OneToOne 0.00 65535.00 FORMAT "%8.2" /end CHARACTERISTIC
/begin CHARACTERISTIC DFC_DisblMsk2.DFC_ChrgCntctStuckOpen_C "" VALUE 0x802490AC Val_Wu16 65535.00 DFES_OneToOne 0.00 65535.00 FORMAT "%8.2" /end CHARACTERISTIC
/begin CHARACTERISTIC DFC_DisblMsk2.DFC_ChrgnUnplRqrd_C "" VALUE 0x802490B0 Val_Wu16 65535.00 DFES_OneToOne 0.00 65535.00 FORMAT "%8.2" /end CHARACTERISTIC
/begin CHARACTERISTIC medc_datasetid "Text with the dataset identification" ASCII 0x80254938 ValA_Wu8 255.0 defaultAscii 0.00 255.0 MATRIX_DIM 99 /end CHARACTERISTIC
/begin MEASUREMENT CabAirHt_iConsol "cabin air heater current" SWORD RBPtCel_i_0p25_1 1 100 -8192.000 8191.750 FORMAT "%8.3" ECU_ADDRESS 0x6001FA0A
 /begin IF_DATA XCPplus 0x0102
  /begin DAQ_EVENT VARIABLE /end DAQ_EVENT
 /end IF_DATA
/end MEASUREMENT
/begin MEASUREMENT CabAirHt_iConsolOld "old value of PTC current" SWORD RBPtCel_i_0p25_1 1 100 -8192.000 8191.750 FORMAT "%8.3" ECU_ADDRESS 0x6001F5C8
 /begin IF_DATA XCPplus 0x0102
  /begin DAQ_EVENT VARIABLE /end DAQ_EVENT
 /end IF_DATA
/end MEASUREMENT
/begin MEASUREMENT CabAirHt_pwrConsol "cabin air heater power" SWORD RBPtCel_pwr_25p0_1 1 100 -819200.0 819175.0 FORMAT "%8.1" ECU_ADDRESS 0x6001FA08
 /begin IF_DATA XCPplus 0x0102
  /begin DAQ_EVENT VARIABLE /end DAQ_EVENT
 /end IF_DATA
/end MEASUREMENT
/begin MEASUREMENT CabAirHt_pwrLoadMngtMaxPred "Maximum power load management predition of cabin heater" SWORD RBPtCel_pwr_25p0_1 1 100 -819200.0 819175.0 FORMAT "%8.1" ECU_ADDRESS 0x6001FA06
 /begin IF_DATA XCPplus 0x0102
  /begin DAQ_EVENT VARIABLE /end DAQ_EVENT
 /end IF_DATA
/end MEASUREMENT
/begin MEASUREMENT CabAirHt_stEem "cabin air heater eem state" UBYTE OneToOne 1 100 0.00 255.0 FORMAT "%5.1" ECU_ADDRESS 0x6002346B
 /begin IF_DATA XCPplus 0x0102
  /begin DAQ_EVENT VARIABLE /end DAQ_EVENT
 /end IF_DATA
/end MEASUREMENT
/begin MEASUREMENT CabAirHt_uConsol "cabin air heater voltage" SWORD Volt_V_q0p03125_COMPU 1 100 -1024.000 1023.969 FORMAT "%8.3" ECU_ADDRESS 0x6001FA04
 /begin IF_DATA XCPplus 0x0102
  /begin DAQ_EVENT VARIABLE /end DAQ_EVENT
 /end IF_DATA
/end MEASUREMENT
/begin MEASUREMENT CbnHeatgHeatr_cntCntrRstTrig "AVS reset routine trigger indication" UWORD OneToOne 1 100 0.00 65535.00 FORMAT "%8.2" ECU_ADDRESS 0x7000151A /end MEASUREMENT
/begin MEASUREMENT CbnHeatgHeatr_cntrCntctOper "Count for heater contactor operation" SLONG OneToOne 1 100 -2147483648.00 2147483647.00 FORMAT "%13.2" ECU_ADDRESS 0x60000E10
 /begin IF_DATA XCPplus 0x0102
  /begin DAQ_EVENT VARIABLE /end DAQ_EVENT
 /end IF_DATA
/end MEASUREMENT
/begin MEASUREMENT CbnHeatgHeatr_cntrRlyLf "actual PTC relay counter life" SLONG OneToOne 1 100 -2147483648.00 2147483647.00 FORMAT "%13.2" ECU_ADDRESS 0x60000E0C
 /begin IF_DATA XCPplus 0x0102
  /begin DAQ_EVENT VARIABLE /end DAQ_EVENT
 /end IF_DATA
/end MEASUREMENT
/begin MEASUREMENT CbnHeatgHeatr_cntrRlyLfHiResl "PTC heater life counter" SLONG q5Em4 1 100 -1073741.82400 1073741.82350 FORMAT "%13.5" ECU_ADDRESS 0x60000BC4
 /begin IF_DATA XCPplus 0x0102
  /begin DAQ_EVENT VARIABLE /end DAQ_EVENT
 /end IF_DATA
/end MEASUREMENT
/begin MEASUREMENT CbnHeatgHeatr_DigOutPrmStructHs.tiBtwTstSCB_C "Prameter structure for HS diagnosis / Structure containing parameters for Digital output power stage error handling" SWORD OneToOne 1 100 -32768.00 32767.00 FORMAT "%8.2" ECU_ADDRESS 0x6001F5BE /end MEASUREMENT
/begin MEASUREMENT CbnHeatgHeatr_DigOutPrmStructHs.tiBtwTstOT_C "Prameter structure for HS diagnosis / Time between tests for OT error" SWORD OneToOne 1 100 -32768.00 32767.00 FORMAT "%8.2" ECU_ADDRESS 0x6001F5C0 /end MEASUREMENT
/begin MEASUREMENT CbnHeatgHeatr_DigOutPrmStructHs.numTstMax_C "Prameter structure for HS diagnosis / Maximum number of tests allowed on permanent defect" UWORD OneToOne 1 100 0.00 65535.00 FORMAT "%8.2" ECU_ADDRESS 0x6001F5C2 /end MEASUREMENT
/begin MEASUREMENT CbnHeatgHeatr_DigOutPrmStructLs.tiBtwTstSCB_C "Prameter structure for LS diagnosis / Structure containing parameters for Digital output power stage error handling" SWORD OneToOne 1 100 -32768.00 32767.00 FORMAT "%8.2" ECU_ADDRESS 0x6001F5B8 /end MEASUREMENT
/begin MEASUREMENT CbnHeatgHeatr_DigOutPrmStructLs.tiBtwTstOT_C "Prameter structure for LS diagnosis / Time between tests for OT error" SWORD OneToOne 1 100 -32768.00 32767.00 FORMAT "%8.2" ECU_ADDRESS 0x6001F5BA /end MEASUREMENT
/begin MEASUREMENT CbnHeatgHeatr_DigOutPrmStructLs.numTstMax_C "Prameter structure for LS diagnosis / Maximum number of tests allowed on permanent defect" UWORD OneToOne 1 100 0.00 65535.00 FORMAT "%8.2" ECU_ADDRESS 0x6001F5BC /end MEASUREMENT
/begin MEASUREMENT CbnHeatgHeatr_DigOutStatStructHs.tmrTBtwTst "Status structure for HS diagnosis / Timer to save the time between tests" SWORD SrvB_SWTmrS16 1 100 -32768.00 32767.00 FORMAT "%8.2" ECU_ADDRESS 0x6001F5B2 /end MEASUREMENT
/begin MEASUREMENT CbnHeatgHeatr_DigOutStatStructHs.ctTstDne "Status structure for HS diagnosis / Static counter to save the test impulse in permanent error" UWORD OneToOne 1 100 0.00 65535.00 FORMAT "%8.2" ECU_ADDRESS 0x6001F5B4 /end MEASUREMENT
/begin MEASUREMENT CbnHeatgHeatr_DigOutStatStructHs.stPrevTstRslt "Status structure for HS diagnosis / Test Status of Power Stage Diagnosis" UWORD OneToOne 1 100 0.00 65535.00 FORMAT "%8.2" ECU_ADDRESS 0x6001F5B6 /end MEASUREMENT
/begin MEASUREMENT CbnHeatgHeatr_DigOutStatStructLs.tmrTBtwTst "Status structure for LS diagnosis / Timer to save the time between tests" SWORD SrvB_SWTmrS16 1 100 -32768.00 32767.00 FORMAT "%8.2" ECU_ADDRESS 0x6001F5AC /end MEASUREMENT
/begin MEASUREMENT CbnHeatgHeatr_DigOutStatStructLs.ctTstDne "Status structure for LS diagnosis / Static counter to save the test impulse in permanent error" UWORD OneToOne 1 100 0.00 65535.00 FORMAT "%8.2" ECU_ADDRESS 0x6001F5AE /end MEASUREMENT
/begin MEASUREMENT CbnHeatgHeatr_DigOutStatStructLs.stPrevTstRslt "Status structure for LS diagnosis / Test Status of Power Stage Diagnosis" UWORD OneToOne 1 100 0.00 65535.00 FORMAT "%8.2" ECU_ADDRESS 0x6001F5B0 /end MEASUREMENT
/begin MEASUREMENT CbnHeatgHeatr_flgAvsRstDone "Flag indicating AVS reset routine trigger" UBYTE B_TRUE 1 100 0.00 1.00000000000 BIT_MASK 0x1 FORMAT "%13.11" ECU_ADDRESS 0x700001C4
 /begin IF_DATA XCPplus 0x0102
  /begin DAQ_EVENT VARIABLE /end DAQ_EVENT
 /end IF_DATA
/end MEASUREMENT
/begin MEASUREMENT CbnHeatgHeatr_flgDiagOnTranRls "Flag for diagnosis release during transition state" UBYTE B_TRUE 1 100 0.00 1.00000000000 BIT_MASK 0x1 FORMAT "%13.11" ECU_ADDRESS 0x700001C3
 /begin IF_DATA XCPplus 0x0102
  /begin DAQ_EVENT VARIABLE /end DAQ_EVENT
 /end IF_DATA
/end MEASUREMENT
/begin MEASUREMENT CbnHeatgHeatr_flgHeatrOn "flag indicates heater on" UBYTE B_TRUE 1 100 0.00 1.00000000000 BIT_MASK 0x1 FORMAT "%13.11" ECU_ADDRESS 0x700001C2
 /begin IF_DATA XCPplus 0x0102
  /begin DAQ_EVENT VARIABLE /end DAQ_EVENT
 /end IF_DATA
/end MEASUREMENT
/begin MEASUREMENT CbnHeatgHeatr_flgHsActr "Heater HS activation request" UBYTE B_TRUE 1 100 0.00 1.00000000000 BIT_MASK 0x1 FORMAT "%13.11" ECU_ADDRESS 0x70000290
 /begin IF_DATA XCPplus 0x0102
  /begin DAQ_EVENT VARIABLE /end DAQ_EVENT
 /end IF_DATA
/end MEASUREMENT
/begin MEASUREMENT CbnHeatgHeatr_flgLsActr "Heater LS activation request" UBYTE B_TRUE 1 100 0.00 1.00000000000 BIT_MASK 0x1 FORMAT "%13.11" ECU_ADDRESS 0x7000028F
 /begin IF_DATA XCPplus 0x0102
  /begin DAQ_EVENT VARIABLE /end DAQ_EVENT
 /end IF_DATA
/end MEASUREMENT
/begin MEASUREMENT CbnHeatgHeatr_flgPsActvnDisad "Powerstage activation disable condition" UBYTE B_TRUE 1 100 0.00 1.00000000000 BIT_MASK 0x1 FORMAT "%13.11" ECU_ADDRESS 0x700001C1
 /begin IF_DATA XCPplus 0x0102
  /begin DAQ_EVENT VARIABLE /end DAQ_EVENT
 /end IF_DATA
/end MEASUREMENT
/begin MEASUREMENT CbnHeatgHeatr_flgPsDiagDisad "Powerstage diagnosis disable condition" UBYTE B_TRUE 1 100 0.00 1.00000000000 BIT_MASK 0x1 FORMAT "%13.11" ECU_ADDRESS 0x700001C0
 /begin IF_DATA XCPplus 0x0102
  /begin DAQ_EVENT VARIABLE /end DAQ_EVENT
 /end IF_DATA
/end MEASUREMENT
/begin MEASUREMENT CbnHeatgHeatr_flgPsDisad "Powerstage disable condiiton" UBYTE B_TRUE 1 100 0.00 1.00000000000 BIT_MASK 0x1 FORMAT "%13.11" ECU_ADDRESS 0x700001BF
 /begin IF_DATA XCPplus 0x0102
  /begin DAQ_EVENT VARIABLE /end DAQ_EVENT
 /end IF_DATA
/end MEASUREMENT
/begin MEASUREMENT CbnHeatgHeatr_flgRlyLfLoWarn "flag provide a warning related to PTC relay life count is low" UBYTE B_TRUE 1 100 0.00 1.00000000000 BIT_MASK 0x1 FORMAT "%13.11" ECU_ADDRESS 0x700001BE
 /begin IF_DATA XCPplus 0x0102
  /begin DAQ_EVENT VARIABLE /end DAQ_EVENT
 /end IF_DATA
/end MEASUREMENT
/begin MEASUREMENT CbnHeatgHeatr_flgScbLocnActv "Scb identification active" UBYTE B_TRUE 1 100 0.00 1.00000000000 BIT_MASK 0x1 FORMAT "%13.11" ECU_ADDRESS 0x700001BD
 /begin IF_DATA XCPplus 0x0102
  /begin DAQ_EVENT VARIABLE /end DAQ_EVENT
 /end IF_DATA
/end MEASUREMENT
/begin MEASUREMENT CbnHeatgHeatr_flgScgErr "SCG error flag" UBYTE B_TRUE 1 100 0.00 1.00000000000 BIT_MASK 0x1 FORMAT "%13.11" ECU_ADDRESS 0x700001BC
 /begin IF_DATA XCPplus 0x0102
  /begin DAQ_EVENT VARIABLE /end DAQ_EVENT
 /end IF_DATA
/end MEASUREMENT
/begin MEASUREMENT CbnHeatgHeatr_flgScgLocnActv "Scg identification active" UBYTE B_TRUE 1 100 0.00 1.00000000000 BIT_MASK 0x1 FORMAT "%13.11" ECU_ADDRESS 0x700001BB
 /begin IF_DATA XCPplus 0x0102
  /begin DAQ_EVENT VARIABLE /end DAQ_EVENT
 /end IF_DATA
/end MEASUREMENT
/begin MEASUREMENT CbnHeatgHeatr_flgTestImpLsScb "LS test impulse trigger for Scb detection" UBYTE B_TRUE 1 100 0.00 1.00000000000 BIT_MASK 0x1 FORMAT "%13.11" ECU_ADDRESS 0x700001BA
 /begin IF_DATA XCPplus 0x0102
  /begin DAQ_EVENT VARIABLE /end DAQ_EVENT
 /end IF_DATA
/end MEASUREMENT
/begin MEASUREMENT CbnHeatgHeatr_stErr "Bit coded error status" UWORD OneToOne 1 100 0.00 65535.00 FORMAT "%8.2" ECU_ADDRESS 0x6001F5C4
 /begin IF_DATA XCPplus 0x0102
  /begin DAQ_EVENT VARIABLE /end DAQ_EVENT
 /end IF_DATA
/end MEASUREMENT
/begin MEASUREMENT CbnHeatgHeatr_stHeatrDes "Heater operation desired from ASW or ATS" UBYTE OneToOne 1 100 0.00 255.0 FORMAT "%5.1" ECU_ADDRESS 0x600231DD
 /begin IF_DATA XCPplus 0x0102
  /begin DAQ_EVENT VARIABLE /end DAQ_EVENT
 /end IF_DATA
/end MEASUREMENT
/begin MEASUREMENT CbnHeatgHeatr_stHsErrInfo "Bit coded error registry flags for HS" ULONG OneToOne 1 100 0.00 4294967295.00 FORMAT "%13.2" ECU_ADDRESS 0x60000BBC
 /begin IF_DATA XCPplus 0x0102
  /begin DAQ_EVENT VARIABLE /end DAQ_EVENT
 /end IF_DATA
/end MEASUREMENT
/begin MEASUREMENT CbnHeatgHeatr_stLsErrInfo "Bit coded error registry flags for LS" ULONG OneToOne 1 100 0.00 4294967295.00 FORMAT "%13.2" ECU_ADDRESS 0x60000BB8
 /begin IF_DATA XCPplus 0x0102
  /begin DAQ_EVENT VARIABLE /end DAQ_EVENT
 /end IF_DATA
/end MEASUREMENT
/begin MEASUREMENT CbnHeatgHeatr_stReq "heater requested sequence state" UBYTE q1 1 100 0.00 255.0 FORMAT "%5.1" ECU_ADDRESS 0x600231DC
 /begin IF_DATA XCPplus 0x0102
  /begin DAQ_EVENT VARIABLE /end DAQ_EVENT
 /end IF_DATA
/end MEASUREMENT
/begin MEASUREMENT CbnHeatgHeatr_tiStTmr "state timer" SLONG RBPtCel_ti_0p01_1 1 100 -21474836.4800 21474836.4700 FORMAT "%13.4" ECU_ADDRESS 0x60000BB4
 /begin IF_DATA XCPplus 0x0102
  /begin DAQ_EVENT VARIABLE /end DAQ_EVENT
 /end IF_DATA
/end MEASUREMENT
/begin MEASUREMENT CbnHeatgSwt_DDstSnsrState_mp "" UBYTE OneToOne 1 100 0.00 255.0 FORMAT "%5.1" ECU_ADDRESS 0x70006C28 /end MEASUREMENT
/begin MEASUREMENT CbnHeatgSwt_FirCalc.cntrAvrgZr " / Counter for 0-division in FIR (indicates failure)" UBYTE OneToOne 1 100 0.00 255.0 FORMAT "%5.1" ECU_ADDRESS 0x6001F5A6 /end MEASUREMENT
/begin MEASUREMENT CbnHeatgSwt_FirCalc.flgRdDne " / FIR: reading from uRaw-sum done" UBYTE OneToOne 1 100 0.00 1.000 BIT_MASK 0x1 FORMAT "%5.3" ECU_ADDRESS 0x6001F5A7 /end MEASUREMENT
/begin MEASUREMENT CbnHeatgSwt_FirCalc.uRawAvrg " / FIR: simple average calculated uRaw" SWORD Volt 1 100 -6553.600 6553.400 FORMAT "%8.3" ECU_ADDRESS 0x6001F5A8 /end MEASUREMENT
/begin MEASUREMENT CbnHeatgSwt_FirCalc.uRawFir " / FIR: Calculated uRaw" SWORD Volt 1 100 -6553.600 6553.400 FORMAT "%8.3" ECU_ADDRESS 0x6001F5AA /end MEASUREMENT
/begin MEASUREMENT CbnHeatgSwt_stAct "Actual physical value" SWORD OneToOne 1 100 -32768.00 32767.00 FORMAT "%8.2" ECU_ADDRESS 0x6001FEAA
 /begin IF_DATA XCPplus 0x0102
  /begin DAQ_EVENT VARIABLE /end DAQ_EVENT
 /end IF_DATA
/end MEASUREMENT
/begin MEASUREMENT CbnHeatgSwt_stActSens "" SWORD OneToOne 1 100 -32768.00 32767.00 FORMAT "%8.2" ECU_ADDRESS 0x6001FEA8
 /begin IF_DATA XCPplus 0x0102
  /begin DAQ_EVENT VARIABLE /end DAQ_EVENT
 /end IF_DATA
/end MEASUREMENT
/begin MEASUREMENT CbnHeatgSwt_stActSensCpl "" SWORD OneToOne 1 100 -32768.00 32767.00 FORMAT "%8.2" ECU_ADDRESS 0x6001FEA6
 /begin IF_DATA XCPplus 0x0102
  /begin DAQ_EVENT VARIABLE /end DAQ_EVENT
 /end IF_DATA
/end MEASUREMENT
/begin MEASUREMENT CbnHeatgSwt_stActSensGradLim_f_mp "" FLOAT32_IEEE OneToOne 1 100 -1.00000000E+037 1.00000000E+037 FORMAT "%13.3" ECU_ADDRESS 0x70006928
 /begin IF_DATA XCPplus 0x0102
  /begin DAQ_EVENT VARIABLE /end DAQ_EVENT
 /end IF_DATA
/end MEASUREMENT
/begin MEASUREMENT CbnHeatgSwt_stActSensUnFltd "" SWORD OneToOne 1 100 -32768.00 32767.00 FORMAT "%8.2" ECU_ADDRESS 0x6001FEA4
 /begin IF_DATA XCPplus 0x0102
  /begin DAQ_EVENT VARIABLE /end DAQ_EVENT
 /end IF_DATA
/end MEASUREMENT
/begin MEASUREMENT CbnHeatgSwt_stActSens_f "" FLOAT32_IEEE OneToOne 1 100 -1.00000000E+037 1.00000000E+037 FORMAT "%13.3" ECU_ADDRESS 0x600012A0
 /begin IF_DATA XCPplus 0x0102
  /begin DAQ_EVENT VARIABLE /end DAQ_EVENT
 /end IF_DATA
/end MEASUREMENT
/begin MEASUREMENT CbnHeatgSwt_stActUnFlt_f "" FLOAT32_IEEE OneToOne 1 100 -1.00000000E+037 1.00000000E+037 FORMAT "%13.3" ECU_ADDRESS 0x6000129C
 /begin IF_DATA XCPplus 0x0102
  /begin DAQ_EVENT VARIABLE /end DAQ_EVENT
 /end IF_DATA
/end MEASUREMENT
/begin MEASUREMENT CbnHeatgSwt_stAct_f "" FLOAT32_IEEE OneToOne 1 100 -1.00000000E+037 1.00000000E+037 FORMAT "%13.3" ECU_ADDRESS 0x60001298
 /begin IF_DATA XCPplus 0x0102
  /begin DAQ_EVENT VARIABLE /end DAQ_EVENT
 /end IF_DATA
/end MEASUREMENT
/begin MEASUREMENT CbnHeatgSwt_stAct_f_Sq "" UBYTE SigQly_COMPU_VERB 1 100 0.00 15.0000000000 FORMAT "%13.10" ECU_ADDRESS 0x60023876
 /begin IF_DATA XCPplus 0x0102
  /begin DAQ_EVENT VARIABLE /end DAQ_EVENT
 /end IF_DATA
/end MEASUREMENT
/begin MEASUREMENT CbnHeatgSwt_stMonStdSens "" ULONG OneToOne 1 100 0.00 4294967295.00 FORMAT "%13.2" ECU_ADDRESS 0x60001090
 /begin IF_DATA XCPplus 0x0102
  /begin DAQ_EVENT VARIABLE /end DAQ_EVENT
 /end IF_DATA
/end MEASUREMENT
/begin MEASUREMENT CbnHeatgSwt_stRaw "Digital input signal from sensor" UBYTE OneToOne 1 100 0.00 255.0 FORMAT "%5.1" ECU_ADDRESS 0x60023875
 /begin IF_DATA XCPplus 0x0102
  /begin DAQ_EVENT VARIABLE /end DAQ_EVENT
 /end IF_DATA
/end MEASUREMENT
/begin MEASUREMENT CbnHeatgSwt_stSnsrActv "" UBYTE OneToOne 1 100 0.00 255.0 BIT_MASK 0x1 FORMAT "%5.1" ECU_ADDRESS 0x60023747
 /begin IF_DATA XCPplus 0x0102
  /begin DAQ_EVENT VARIABLE /end DAQ_EVENT
 /end IF_DATA
/end MEASUREMENT
/begin MEASUREMENT CbnHeatgSwt_stSnsrDdCalc "" UBYTE OneToOne 1 100 0.00 255.0 BIT_MASK 0x1 FORMAT "%5.1" ECU_ADDRESS 0x60023746
 /begin IF_DATA XCPplus 0x0102
  /begin DAQ_EVENT VARIABLE /end DAQ_EVENT
 /end IF_DATA
/end MEASUREMENT
/begin MEASUREMENT CbnHeatgSwt_swtConfStdSens2C "" ULONG OneToOne 1 100 0.00 4294967295.00 FORMAT "%13.2" ECU_ADDRESS 0x60000BAC /end MEASUREMENT
/begin MEASUREMENT CbnHeatgSwt_swtConfStdSensC "" ULONG OneToOne 1 100 0.00 4294967295.00 FORMAT "%13.2" ECU_ADDRESS 0x60000BA8 /end MEASUREMENT
/begin MEASUREMENT CbnHeatgSwt_swtConfStdSensSwVersC "" ULONG OneToOne 1 100 0.00 4294967295.00 FORMAT "%13.2" ECU_ADDRESS 0x60000BA4 /end MEASUREMENT
/begin MEASUREMENT CbnHeatgSwt_swtSensMode "" UBYTE OneToOne 1 100 0.00 255.0 FORMAT "%5.1" ECU_ADDRESS 0x60023874 /end MEASUREMENT
/begin MEASUREMENT CbnHeatgSwt_swtSensPres "" UBYTE OneToOne 1 100 0.00 255.0 FORMAT "%5.1" ECU_ADDRESS 0x60023873
 /begin IF_DATA XCPplus 0x0102
  /begin DAQ_EVENT VARIABLE /end DAQ_EVENT
 /end IF_DATA
/end MEASUREMENT
/begin MEASUREMENT CcsPwrLineChpRst_r "Reset signal for PLC chip of CCS of CCS charging standard" SWORD Prc 1 100 -400.0000 399.9878 FORMAT "%8.4" ECU_ADDRESS 0x6001FC1E
 /begin IF_DATA XCPplus 0x0102
  /begin DAQ_EVENT VARIABLE /end DAQ_EVENT
 /end IF_DATA
/end MEASUREMENT
/begin MEASUREMENT CcsPwrLineChpRst_rAct "" SWORD Prc 1 100 -400.0000 399.9878 FORMAT "%8.4" ECU_ADDRESS 0x6001FC1C
 /begin IF_DATA XCPplus 0x0102
  /begin DAQ_EVENT VARIABLE /end DAQ_EVENT
 /end IF_DATA
/end MEASUREMENT
/begin MEASUREMENT CcsPwrLineChpRst_rActr "" SWORD Prc 1 100 -400.0000 399.9878 FORMAT "%8.4" ECU_ADDRESS 0x6001FC1A
 /begin IF_DATA XCPplus 0x0102
  /begin DAQ_EVENT VARIABLE /end DAQ_EVENT
 /end IF_DATA
/end MEASUREMENT
/begin MEASUREMENT CcsPwrLineChpRst_rAct_Sq "" UBYTE SigQly_COMPU_VERB 1 100 0.00 15.0000000000 FORMAT "%13.10" ECU_ADDRESS 0x60023674
 /begin IF_DATA XCPplus 0x0102
  /begin DAQ_EVENT VARIABLE /end DAQ_EVENT
 /end IF_DATA
/end MEASUREMENT
/begin MEASUREMENT CcsPwrLineChpRst_rDesVal "" SWORD Prc 1 100 -400.0000 399.9878 FORMAT "%8.4" ECU_ADDRESS 0x6001FC18
 /begin IF_DATA XCPplus 0x0102
  /begin DAQ_EVENT VARIABLE /end DAQ_EVENT
 /end IF_DATA
/end MEASUREMENT
/begin MEASUREMENT CcsPwrLineChpRst_rDtyCyc "" SWORD Prc 1 100 -400.0000 399.9878 FORMAT "%8.4" ECU_ADDRESS 0x6001FC16
 /begin IF_DATA XCPplus 0x0102
  /begin DAQ_EVENT VARIABLE /end DAQ_EVENT
 /end IF_DATA
/end MEASUREMENT
/begin MEASUREMENT CcsPwrLineChpRst_rPs "" SWORD DtyCyc 1 100 -327.6800 327.6700 FORMAT "%8.4" ECU_ADDRESS 0x6001FC14
 /begin IF_DATA XCPplus 0x0102
  /begin DAQ_EVENT VARIABLE /end DAQ_EVENT
 /end IF_DATA
/end MEASUREMENT
/begin MEASUREMENT CcsPwrLineChpRst_stMonActrCoorrSimple "" UBYTE OneToOne 1 100 0.00 255.0 FORMAT "%5.1" ECU_ADDRESS 0x60023673
 /begin IF_DATA XCPplus 0x0102
  /begin DAQ_EVENT VARIABLE /end DAQ_EVENT
 /end IF_DATA
/end MEASUREMENT
/begin MEASUREMENT CcsPwrLineChpRst_stMonActrElecDrvrSimple "" UBYTE OneToOne 1 100 0.00 255.0 FORMAT "%5.1" ECU_ADDRESS 0x60023672
 /begin IF_DATA XCPplus 0x0102
  /begin DAQ_EVENT VARIABLE /end DAQ_EVENT
 /end IF_DATA
/end MEASUREMENT
/begin MEASUREMENT CcsPwrLineChpRst_swtConfActrCoorrSimpleC "" UBYTE OneToOne 1 100 0.00 255.0 FORMAT "%5.1" ECU_ADDRESS 0x60023671 /end MEASUREMENT
/begin MEASUREMENT CcsPwrLineChpRst_swtConfActrElecDrvrSimpleC "" UBYTE OneToOne 1 100 0.00 255.0 FORMAT "%5.1" ECU_ADDRESS 0x60023670 /end MEASUREMENT
/begin MEASUREMENT CcsPwrLineChpRst_swtConfActrElecMonSimpleC "" UBYTE OneToOne 1 100 0.00 255.0 FORMAT "%5.1" ECU_ADDRESS 0x6002366F /end MEASUREMENT
/begin MEASUREMENT CcsPwrLineChpRst_swtConfActrPsDrvrSimpleC "" UBYTE OneToOne 1 100 0.00 255.0 FORMAT "%5.1" ECU_ADDRESS 0x6002366E /end MEASUREMENT
/begin MEASUREMENT CcsPwrLineChpVccEna_r "Supply voltage for powerline communication chip of CCS" SWORD Prc 1 100 -400.0000 399.9878 FORMAT "%8.4" ECU_ADDRESS 0x6001FC12
 /begin IF_DATA XCPplus 0x0102
  /begin DAQ_EVENT VARIABLE /end DAQ_EVENT
 /end IF_DATA
/end MEASUREMENT
/begin MEASUREMENT CcsPwrLineChpVccEna_rAct "" SWORD Prc 1 100 -400.0000 399.9878 FORMAT "%8.4" ECU_ADDRESS 0x6001FC10
 /begin IF_DATA XCPplus 0x0102
  /begin DAQ_EVENT VARIABLE /end DAQ_EVENT
 /end IF_DATA
/end MEASUREMENT
/begin MEASUREMENT CcsPwrLineChpVccEna_rActr "" SWORD Prc 1 100 -400.0000 399.9878 FORMAT "%8.4" ECU_ADDRESS 0x6001FC0E
 /begin IF_DATA XCPplus 0x0102
  /begin DAQ_EVENT VARIABLE /end DAQ_EVENT
 /end IF_DATA
/end MEASUREMENT
/begin MEASUREMENT CcsPwrLineChpVccEna_rAct_Sq "" UBYTE SigQly_COMPU_VERB 1 100 0.00 15.0000000000 FORMAT "%13.10" ECU_ADDRESS 0x6002366D
 /begin IF_DATA XCPplus 0x0102
  /begin DAQ_EVENT VARIABLE /end DAQ_EVENT
 /end IF_DATA
/end MEASUREMENT
/begin MEASUREMENT CcsPwrLineChpVccEna_rDesVal "" SWORD Prc 1 100 -400.0000 399.9878 FORMAT "%8.4" ECU_ADDRESS 0x6001FC0C
 /begin IF_DATA XCPplus 0x0102
  /begin DAQ_EVENT VARIABLE /end DAQ_EVENT
 /end IF_DATA
/end MEASUREMENT
/begin MEASUREMENT CcsPwrLineChpVccEna_rDtyCyc "" SWORD Prc 1 100 -400.0000 399.9878 FORMAT "%8.4" ECU_ADDRESS 0x6001FC0A
 /begin IF_DATA XCPplus 0x0102
  /begin DAQ_EVENT VARIABLE /end DAQ_EVENT
 /end IF_DATA
/end MEASUREMENT
/begin MEASUREMENT CcsPwrLineChpVccEna_rPs "" SWORD DtyCyc 1 100 -327.6800 327.6700 FORMAT "%8.4" ECU_ADDRESS 0x6001FC08
 /begin IF_DATA XCPplus 0x0102
  /begin DAQ_EVENT VARIABLE /end DAQ_EVENT
 /end IF_DATA
/end MEASUREMENT
/begin MEASUREMENT CcsPwrLineChpVccEna_stMonActrCoorrSimple "" UBYTE OneToOne 1 100 0.00 255.0 FORMAT "%5.1" ECU_ADDRESS 0x6002366C
 /begin IF_DATA XCPplus 0x0102
  /begin DAQ_EVENT VARIABLE /end DAQ_EVENT
 /end IF_DATA
/end MEASUREMENT
/begin MEASUREMENT CcsPwrLineChpVccEna_stMonActrElecDrvrSimple "" UBYTE OneToOne 1 100 0.00 255.0 FORMAT "%5.1" ECU_ADDRESS 0x6002366B
 /begin IF_DATA XCPplus 0x0102
  /begin DAQ_EVENT VARIABLE /end DAQ_EVENT
 /end IF_DATA
/end MEASUREMENT
/begin MEASUREMENT CcsPwrLineChpVccEna_swtConfActrCoorrSimpleC "" UBYTE OneToOne 1 100 0.00 255.0 FORMAT "%5.1" ECU_ADDRESS 0x6002366A /end MEASUREMENT
/begin MEASUREMENT CcsPwrLineChpVccEna_swtConfActrElecDrvrSimpleC "" UBYTE OneToOne 1 100 0.00 255.0 FORMAT "%5.1" ECU_ADDRESS 0x60023669 /end MEASUREMENT
/begin MEASUREMENT CcsPwrLineChpVccEna_swtConfActrElecMonSimpleC "" UBYTE OneToOne 1 100 0.00 255.0 FORMAT "%5.1" ECU_ADDRESS 0x60023668 /end MEASUREMENT
/begin MEASUREMENT CcsPwrLineChpVccEna_swtConfActrPsDrvrSimpleC "" UBYTE OneToOne 1 100 0.00 255.0 FORMAT "%5.1" ECU_ADDRESS 0x60023667 /end MEASUREMENT
/begin MEASUREMENT CcsPwrLineChpVcc_DDstSnsrState_mp "" UBYTE OneToOne 1 100 0.00 255.0 FORMAT "%5.1" ECU_ADDRESS 0x70006C27 /end MEASUREMENT
/begin MEASUREMENT CcsPwrLineChpVcc_FirCalc.cntrAvrgZr " / Counter for 0-division in FIR (indicates failure)" UBYTE OneToOne 1 100 0.00 255.0 FORMAT "%5.1" ECU_ADDRESS 0x6001F5A0 /end MEASUREMENT
/begin MEASUREMENT CcsPwrLineChpVcc_FirCalc.flgRdDne " / FIR: reading from uRaw-sum done" UBYTE OneToOne 1 100 0.00 1.000 BIT_MASK 0x1 FORMAT "%5.3" ECU_ADDRESS 0x6001F5A1 /end MEASUREMENT
/begin MEASUREMENT CcsPwrLineChpVcc_FirCalc.uRawAvrg " / FIR: simple average calculated uRaw" SWORD Volt 1 100 -6553.600 6553.400 FORMAT "%8.3" ECU_ADDRESS 0x6001F5A2 /end MEASUREMENT
/begin MEASUREMENT CcsPwrLineChpVcc_FirCalc.uRawFir " / FIR: Calculated uRaw" SWORD Volt 1 100 -6553.600 6553.400 FORMAT "%8.3" ECU_ADDRESS 0x6001F5A4 /end MEASUREMENT
/begin MEASUREMENT CcsPwrLineChpVcc_FirRead.cntr " / Counter for simple average FIR" UBYTE OneToOne 1 100 0.00 255.0 FORMAT "%5.1" ECU_ADDRESS 0x60000B98 /end MEASUREMENT
/begin MEASUREMENT CcsPwrLineChpVcc_FirRead.flgFirstRun " / FIR: 1st run after init" UBYTE OneToOne 1 100 0.00 1.000 BIT_MASK 0x1 FORMAT "%5.3" ECU_ADDRESS 0x60000B99 /end MEASUREMENT
/begin MEASUREMENT CcsPwrLineChpVcc_FirRead.idxArr " / FIR ringbuffer: actual index" UBYTE OneToOne 1 100 0.00 255.0 FORMAT "%5.1" ECU_ADDRESS 0x60000B9A /end MEASUREMENT
/begin MEASUREMENT CcsPwrLineChpVcc_FirRead.uSum " / Simple average FIR: sum of uRaws" SLONG Volt 1 100 -429496729.600 429496729.400 FORMAT "%13.3" ECU_ADDRESS 0x60000B9C /end MEASUREMENT
/begin MEASUREMENT CcsPwrLineChpVcc_stMonStdSens "" ULONG OneToOne 1 100 0.00 4294967295.00 FORMAT "%13.2" ECU_ADDRESS 0x6000108C
 /begin IF_DATA XCPplus 0x0102
  /begin DAQ_EVENT VARIABLE /end DAQ_EVENT
 /end IF_DATA
/end MEASUREMENT
/begin MEASUREMENT CcsPwrLineChpVcc_stSnsrActv "" UBYTE OneToOne 1 100 0.00 255.0 BIT_MASK 0x1 FORMAT "%5.1" ECU_ADDRESS 0x60023745
 /begin IF_DATA XCPplus 0x0102
  /begin DAQ_EVENT VARIABLE /end DAQ_EVENT
 /end IF_DATA
/end MEASUREMENT
/begin MEASUREMENT CcsPwrLineChpVcc_stSnsrDdCalc "" UBYTE OneToOne 1 100 0.00 255.0 BIT_MASK 0x1 FORMAT "%5.1" ECU_ADDRESS 0x60023744
 /begin IF_DATA XCPplus 0x0102
  /begin DAQ_EVENT VARIABLE /end DAQ_EVENT
 /end IF_DATA
/end MEASUREMENT
/begin MEASUREMENT CcsPwrLineChpVcc_stSnsrDdReadCalc "" UBYTE OneToOne 1 100 0.00 255.0 BIT_MASK 0x1 FORMAT "%5.1" ECU_ADDRESS 0x60023743
 /begin IF_DATA XCPplus 0x0102
  /begin DAQ_EVENT VARIABLE /end DAQ_EVENT
 /end IF_DATA
/end MEASUREMENT
/begin MEASUREMENT CcsPwrLineChpVcc_swtConfStdSens2C "" ULONG OneToOne 1 100 0.00 4294967295.00 FORMAT "%13.2" ECU_ADDRESS 0x60000B94 /end MEASUREMENT
/begin MEASUREMENT CcsPwrLineChpVcc_swtConfStdSensC "" ULONG OneToOne 1 100 0.00 4294967295.00 FORMAT "%13.2" ECU_ADDRESS 0x60000B90 /end MEASUREMENT
/begin MEASUREMENT CcsPwrLineChpVcc_swtConfStdSensSwVersC "" ULONG OneToOne 1 100 0.00 4294967295.00 FORMAT "%13.2" ECU_ADDRESS 0x60000B8C /end MEASUREMENT
/begin MEASUREMENT CcsPwrLineChpVcc_swtSensMode "" UBYTE OneToOne 1 100 0.00 255.0 FORMAT "%5.1" ECU_ADDRESS 0x60023872 /end MEASUREMENT
/begin MEASUREMENT CcsPwrLineChpVcc_swtSensPres "" UBYTE OneToOne 1 100 0.00 255.0 FORMAT "%5.1" ECU_ADDRESS 0x60023871
 /begin IF_DATA XCPplus 0x0102
  /begin DAQ_EVENT VARIABLE /end DAQ_EVENT
 /end IF_DATA
/end MEASUREMENT
/begin MEASUREMENT CcsPwrLineChpVcc_tiSRCMaxDefDeb "" SLONG Time_ms 1 100 -21474836480.0 21474836470.0 FORMAT "%13.1" ECU_ADDRESS 0x600010C4
 /begin IF_DATA XCPplus 0x0102
  /begin DAQ_EVENT VARIABLE /end DAQ_EVENT
 /end IF_DATA
/end MEASUREMENT
/begin MEASUREMENT CcsPwrLineChpVcc_tRefSnsr_mp "" SWORD Temp_Cels 1 100 -3549.940 3003.560 FORMAT "%8.3" ECU_ADDRESS 0x70006B4C /end MEASUREMENT
/begin MEASUREMENT CcsPwrLineChpVcc_tSensPT1Fltd_mp "" SWORD RBPtCel_u_1p0_1 1 100 -32768.00 32767.00 FORMAT "%8.2" ECU_ADDRESS 0x70006B4A /end MEASUREMENT
/begin MEASUREMENT CcsPwrLineChpVcc_uDynThresPhysRngHi_f_mp "" FLOAT32_IEEE RBPtCel_u_1p0_1 1 100 -1.00000000E+037 1.00000000E+037 FORMAT "%13.3" ECU_ADDRESS 0x70006920 /end MEASUREMENT
/begin MEASUREMENT CcsPwrLineChpVcc_uDynThresPhysRngLo_f_mp "" FLOAT32_IEEE RBPtCel_u_1p0_1 1 100 -1.00000000E+037 1.00000000E+037 FORMAT "%13.3" ECU_ADDRESS 0x7000691C /end MEASUREMENT
/begin MEASUREMENT CcsPwrLineChpVcc_uRaw "" SWORD Volt 1 100 -6553.600 6553.400 FORMAT "%8.3" ECU_ADDRESS 0x6001FEA0
 /begin IF_DATA XCPplus 0x0102
  /begin DAQ_EVENT VARIABLE /end DAQ_EVENT
 /end IF_DATA
/end MEASUREMENT
/begin MEASUREMENT CcsPwrLineChpVcc_uRawPT1Fltd "" SWORD Volt 1 100 -6553.600 6553.400 FORMAT "%8.3" ECU_ADDRESS 0x6001FE9E
 /begin IF_DATA XCPplus 0x0102
  /begin DAQ_EVENT VARIABLE /end DAQ_EVENT
 /end IF_DATA
/end MEASUREMENT
/begin MEASUREMENT CcsPwrLineChpVcc_uRawPT1FltdSens "" SWORD Volt 1 100 -6553.600 6553.400 FORMAT "%8.3" ECU_ADDRESS 0x6001FE9C
 /begin IF_DATA XCPplus 0x0102
  /begin DAQ_EVENT VARIABLE /end DAQ_EVENT
 /end IF_DATA
/end MEASUREMENT
/begin MEASUREMENT CcsPwrLineChpVcc_uRawUnFltd "" SWORD Volt 1 100 -6553.600 6553.400 FORMAT "%8.3" ECU_ADDRESS 0x6001FE9A
 /begin IF_DATA XCPplus 0x0102
  /begin DAQ_EVENT VARIABLE /end DAQ_EVENT
 /end IF_DATA
/end MEASUREMENT
/begin MEASUREMENT CcsPwrLineChpVcc_uRaw_f "" FLOAT32_IEEE RBPtCel_u_1p0_2 1 100 -1.00000000E+037 1.00000000E+037 FORMAT "%13.3" ECU_ADDRESS 0x60001294
 /begin IF_DATA XCPplus 0x0102
  /begin DAQ_EVENT VARIABLE /end DAQ_EVENT
 /end IF_DATA
/end MEASUREMENT
/begin MEASUREMENT CcsPwrLineChpVcc_uSensCpl "" SWORD OneToOne 1 100 -32768.00 32767.00 FORMAT "%8.2" ECU_ADDRESS 0x6001FE98
 /begin IF_DATA XCPplus 0x0102
  /begin DAQ_EVENT VARIABLE /end DAQ_EVENT
 /end IF_DATA
/end MEASUREMENT
/begin MEASUREMENT CcsPwrLineChpVcc_uSensGradLim_f_mp "" FLOAT32_IEEE RBPtCel_u_1p0_1 1 100 -1.00000000E+037 1.00000000E+037 FORMAT "%13.3" ECU_ADDRESS 0x70006924
 /begin IF_DATA XCPplus 0x0102
  /begin DAQ_EVENT VARIABLE /end DAQ_EVENT
 /end IF_DATA
/end MEASUREMENT
/begin MEASUREMENT CcsPwrLineChpVcc_uSensOffsCorrd_f "" FLOAT32_IEEE RBPtCel_u_1p0_1 1 100 -1.00000000E+037 1.00000000E+037 FORMAT "%13.3" ECU_ADDRESS 0x60001290
 /begin IF_DATA XCPplus 0x0102
  /begin DAQ_EVENT VARIABLE /end DAQ_EVENT
 /end IF_DATA
/end MEASUREMENT
/begin MEASUREMENT CcsPwrLineChpVcc_uSensUnFltd "" SWORD RBPtCel_u_1p0_1 1 100 -32768.00 32767.00 FORMAT "%8.2" ECU_ADDRESS 0x6001FE96
 /begin IF_DATA XCPplus 0x0102
  /begin DAQ_EVENT VARIABLE /end DAQ_EVENT
 /end IF_DATA
/end MEASUREMENT
/begin MEASUREMENT CcsPwrLineChpVcc_uSens_f "" FLOAT32_IEEE RBPtCel_u_1p0_1 1 100 -1.00000000E+037 1.00000000E+037 FORMAT "%13.3" ECU_ADDRESS 0x6000128C
 /begin IF_DATA XCPplus 0x0102
  /begin DAQ_EVENT VARIABLE /end DAQ_EVENT
 /end IF_DATA
/end MEASUREMENT
/begin MEASUREMENT CcsPwrLineChpVcc_uUnFlt_f "" FLOAT32_IEEE RBPtCel_u_1p0_1 1 100 -1.00000000E+037 1.00000000E+037 FORMAT "%13.3" ECU_ADDRESS 0x60001288
 /begin IF_DATA XCPplus 0x0102
  /begin DAQ_EVENT VARIABLE /end DAQ_EVENT
 /end IF_DATA
/end MEASUREMENT
/begin MEASUREMENT CcsPwrLineChpVcc_u_f "Supply voltage for powerline communication chip of CCS" FLOAT32_IEEE RBPtCel_u_1p0_1 1 100 -1.00000000E+037 1.00000000E+037 FORMAT "%13.3" ECU_ADDRESS 0x60001284
 /begin IF_DATA XCPplus 0x0102
  /begin DAQ_EVENT VARIABLE /end DAQ_EVENT
 /end IF_DATA
/end MEASUREMENT
/begin MEASUREMENT CcsPwrLineChpVcc_u_f_Sq "" UBYTE SigQly_COMPU_VERB 1 100 0.00 15.0000000000 FORMAT "%13.10" ECU_ADDRESS 0x60023870
 /begin IF_DATA XCPplus 0x0102
  /begin DAQ_EVENT VARIABLE /end DAQ_EVENT
 /end IF_DATA
/end MEASUREMENT
/begin MEASUREMENT CcsPwrLineComChpT_DDstSnsrState_mp "" UBYTE OneToOne 1 100 0.00 255.0 FORMAT "%5.1" ECU_ADDRESS 0x70006C26 /end MEASUREMENT
/begin MEASUREMENT CcsPwrLineComChpT_FirCalc.cntrAvrgZr " / Counter for 0-division in FIR (indicates failure)" UBYTE OneToOne 1 100 0.00 255.0 FORMAT "%5.1" ECU_ADDRESS 0x6001F59A /end MEASUREMENT
/begin MEASUREMENT CcsPwrLineComChpT_FirCalc.flgRdDne " / FIR: reading from uRaw-sum done" UBYTE OneToOne 1 100 0.00 1.000 BIT_MASK 0x1 FORMAT "%5.3" ECU_ADDRESS 0x6001F59B /end MEASUREMENT
/begin MEASUREMENT CcsPwrLineComChpT_FirCalc.uRawAvrg " / FIR: simple average calculated uRaw" SWORD Volt 1 100 -6553.600 6553.400 FORMAT "%8.3" ECU_ADDRESS 0x6001F59C /end MEASUREMENT
/begin MEASUREMENT CcsPwrLineComChpT_FirCalc.uRawFir " / FIR: Calculated uRaw" SWORD Volt 1 100 -6553.600 6553.400 FORMAT "%8.3" ECU_ADDRESS 0x6001F59E /end MEASUREMENT
/begin MEASUREMENT CcsPwrLineComChpT_FirRead.cntr " / Counter for simple average FIR" UBYTE OneToOne 1 100 0.00 255.0 FORMAT "%5.1" ECU_ADDRESS 0x60000B80 /end MEASUREMENT
/begin MEASUREMENT CcsPwrLineComChpT_FirRead.flgFirstRun " / FIR: 1st run after init" UBYTE OneToOne 1 100 0.00 1.000 BIT_MASK 0x1 FORMAT "%5.3" ECU_ADDRESS 0x60000B81 /end MEASUREMENT
/begin MEASUREMENT CcsPwrLineComChpT_FirRead.idxArr " / FIR ringbuffer: actual index" UBYTE OneToOne 1 100 0.00 255.0 FORMAT "%5.1" ECU_ADDRESS 0x60000B82 /end MEASUREMENT
/begin MEASUREMENT CcsPwrLineComChpT_FirRead.uSum " / Simple average FIR: sum of uRaws" SLONG Volt 1 100 -429496729.600 429496729.400 FORMAT "%13.3" ECU_ADDRESS 0x60000B84 /end MEASUREMENT
/begin MEASUREMENT CcsPwrLineComChpT_stMonStdSens "" ULONG OneToOne 1 100 0.00 4294967295.00 FORMAT "%13.2" ECU_ADDRESS 0x60001088
 /begin IF_DATA XCPplus 0x0102
  /begin DAQ_EVENT VARIABLE /end DAQ_EVENT
 /end IF_DATA
/end MEASUREMENT
/begin MEASUREMENT CcsPwrLineComChpT_stSnsrActv "" UBYTE OneToOne 1 100 0.00 255.0 BIT_MASK 0x1 FORMAT "%5.1" ECU_ADDRESS 0x60023742
 /begin IF_DATA XCPplus 0x0102
  /begin DAQ_EVENT VARIABLE /end DAQ_EVENT
 /end IF_DATA
/end MEASUREMENT
/begin MEASUREMENT CcsPwrLineComChpT_stSnsrDdCalc "" UBYTE OneToOne 1 100 0.00 255.0 BIT_MASK 0x1 FORMAT "%5.1" ECU_ADDRESS 0x60023741
 /begin IF_DATA XCPplus 0x0102
  /begin DAQ_EVENT VARIABLE /end DAQ_EVENT
 /end IF_DATA
/end MEASUREMENT
/begin MEASUREMENT CcsPwrLineComChpT_stSnsrDdReadCalc "" UBYTE OneToOne 1 100 0.00 255.0 BIT_MASK 0x1 FORMAT "%5.1" ECU_ADDRESS 0x60023740
 /begin IF_DATA XCPplus 0x0102
  /begin DAQ_EVENT VARIABLE /end DAQ_EVENT
 /end IF_DATA
/end MEASUREMENT
/begin MEASUREMENT CcsPwrLineComChpT_swtConfStdSens2C "" ULONG OneToOne 1 100 0.00 4294967295.00 FORMAT "%13.2" ECU_ADDRESS 0x60000B7C /end MEASUREMENT
/begin MEASUREMENT CcsPwrLineComChpT_swtConfStdSensC "" ULONG OneToOne 1 100 0.00 4294967295.00 FORMAT "%13.2" ECU_ADDRESS 0x60000B78 /end MEASUREMENT
/begin MEASUREMENT CcsPwrLineComChpT_swtConfStdSensSwVersC "" ULONG OneToOne 1 100 0.00 4294967295.00 FORMAT "%13.2" ECU_ADDRESS 0x60000B74 /end MEASUREMENT
/begin MEASUREMENT CcsPwrLineComChpT_swtSensMode "" UBYTE OneToOne 1 100 0.00 255.0 FORMAT "%5.1" ECU_ADDRESS 0x6002386F /end MEASUREMENT
/begin MEASUREMENT CcsPwrLineComChpT_swtSensPres "" UBYTE OneToOne 1 100 0.00 255.0 FORMAT "%5.1" ECU_ADDRESS 0x6002386E
 /begin IF_DATA XCPplus 0x0102
  /begin DAQ_EVENT VARIABLE /end DAQ_EVENT
 /end IF_DATA
/end MEASUREMENT
/begin MEASUREMENT CcsPwrLineComChpT_tDynThresPhysRngHi_f_mp "" FLOAT32_IEEE RBPtCel_t_1p0_3 1 100 -1.00000000E+037 1.00000000E+037 FORMAT "%13.3" ECU_ADDRESS 0x70006914 /end MEASUREMENT
/begin MEASUREMENT CcsPwrLineComChpT_tDynThresPhysRngLo_f_mp "" FLOAT32_IEEE RBPtCel_t_1p0_3 1 100 -1.00000000E+037 1.00000000E+037 FORMAT "%13.3" ECU_ADDRESS 0x70006910 /end MEASUREMENT
/begin MEASUREMENT CcsPwrLineComChpT_tiSRCMaxDefDeb "" SLONG Time_ms 1 100 -21474836480.0 21474836470.0 FORMAT "%13.1" ECU_ADDRESS 0x600010C0
 /begin IF_DATA XCPplus 0x0102
  /begin DAQ_EVENT VARIABLE /end DAQ_EVENT
 /end IF_DATA
/end MEASUREMENT
/begin MEASUREMENT CcsPwrLineComChpT_tRefSnsr_mp "" SWORD Temp_Cels 1 100 -3549.940 3003.560 FORMAT "%8.3" ECU_ADDRESS 0x70006B48 /end MEASUREMENT
/begin MEASUREMENT CcsPwrLineComChpT_tSensCpl "" SWORD OneToOne 1 100 -32768.00 32767.00 FORMAT "%8.2" ECU_ADDRESS 0x6001FE94
 /begin IF_DATA XCPplus 0x0102
  /begin DAQ_EVENT VARIABLE /end DAQ_EVENT
 /end IF_DATA
/end MEASUREMENT
/begin MEASUREMENT CcsPwrLineComChpT_tSensGradLim_f_mp "" FLOAT32_IEEE RBPtCel_t_1p0_3 1 100 -1.00000000E+037 1.00000000E+037 FORMAT "%13.3" ECU_ADDRESS 0x70006918
 /begin IF_DATA XCPplus 0x0102
  /begin DAQ_EVENT VARIABLE /end DAQ_EVENT
 /end IF_DATA
/end MEASUREMENT
/begin MEASUREMENT CcsPwrLineComChpT_tSensOffsCorrd_f "" FLOAT32_IEEE RBPtCel_t_1p0_3 1 100 -1.00000000E+037 1.00000000E+037 FORMAT "%13.3" ECU_ADDRESS 0x60001280
 /begin IF_DATA XCPplus 0x0102
  /begin DAQ_EVENT VARIABLE /end DAQ_EVENT
 /end IF_DATA
/end MEASUREMENT
/begin MEASUREMENT CcsPwrLineComChpT_tSensPT1Fltd_mp "" SWORD RBPtCel_t_1p0_3 1 100 -32768.00 32767.00 FORMAT "%8.2" ECU_ADDRESS 0x70006B46 /end MEASUREMENT
/begin MEASUREMENT CcsPwrLineComChpT_tSensUnFltd "" SWORD RBPtCel_t_1p0_3 1 100 -32768.00 32767.00 FORMAT "%8.2" ECU_ADDRESS 0x6001FE90
 /begin IF_DATA XCPplus 0x0102
  /begin DAQ_EVENT VARIABLE /end DAQ_EVENT
 /end IF_DATA
/end MEASUREMENT
/begin MEASUREMENT CcsPwrLineComChpT_tSens_f "" FLOAT32_IEEE RBPtCel_t_1p0_3 1 100 -1.00000000E+037 1.00000000E+037 FORMAT "%13.3" ECU_ADDRESS 0x6000127C
 /begin IF_DATA XCPplus 0x0102
  /begin DAQ_EVENT VARIABLE /end DAQ_EVENT
 /end IF_DATA
/end MEASUREMENT
/begin MEASUREMENT CcsPwrLineComChpT_tUnFlt_f "" FLOAT32_IEEE RBPtCel_t_1p0_3 1 100 -1.00000000E+037 1.00000000E+037 FORMAT "%13.3" ECU_ADDRESS 0x60001278
 /begin IF_DATA XCPplus 0x0102
  /begin DAQ_EVENT VARIABLE /end DAQ_EVENT
 /end IF_DATA
/end MEASUREMENT
/begin MEASUREMENT CcsPwrLineComChpT_t_f "Power line communication chip temperature" FLOAT32_IEEE RBPtCel_t_1p0_3 1 100 -1.00000000E+037 1.00000000E+037 FORMAT "%13.3" ECU_ADDRESS 0x60001274
 /begin IF_DATA XCPplus 0x0102
  /begin DAQ_EVENT VARIABLE /end DAQ_EVENT
 /end IF_DATA
/end MEASUREMENT
/begin MEASUREMENT CcsPwrLineComChpT_t_f_Sq "" UBYTE SigQly_COMPU_VERB 1 100 0.00 15.0000000000 FORMAT "%13.10" ECU_ADDRESS 0x6002386D
 /begin IF_DATA XCPplus 0x0102
  /begin DAQ_EVENT VARIABLE /end DAQ_EVENT
 /end IF_DATA
/end MEASUREMENT
/begin MEASUREMENT CcsPwrLineComChpT_uRaw "" SWORD Volt 1 100 -6553.600 6553.400 FORMAT "%8.3" ECU_ADDRESS 0x6001FE8E
 /begin IF_DATA XCPplus 0x0102
  /begin DAQ_EVENT VARIABLE /end DAQ_EVENT
 /end IF_DATA
/end MEASUREMENT
/begin MEASUREMENT CcsPwrLineComChpT_uRawPT1Fltd "" SWORD Volt 1 100 -6553.600 6553.400 FORMAT "%8.3" ECU_ADDRESS 0x6001FE8C
 /begin IF_DATA XCPplus 0x0102
  /begin DAQ_EVENT VARIABLE /end DAQ_EVENT
 /end IF_DATA
/end MEASUREMENT
/begin MEASUREMENT CcsPwrLineComChpT_uRawPT1FltdSens "" SWORD Volt 1 100 -6553.600 6553.400 FORMAT "%8.3" ECU_ADDRESS 0x6001FE8A
 /begin IF_DATA XCPplus 0x0102
  /begin DAQ_EVENT VARIABLE /end DAQ_EVENT
 /end IF_DATA
/end MEASUREMENT
/begin MEASUREMENT CcsPwrLineComChpT_uRawUnFltd "" SWORD Volt 1 100 -6553.600 6553.400 FORMAT "%8.3" ECU_ADDRESS 0x6001FE88
 /begin IF_DATA XCPplus 0x0102
  /begin DAQ_EVENT VARIABLE /end DAQ_EVENT
 /end IF_DATA
/end MEASUREMENT
/begin MEASUREMENT CcsPwrLineComChpT_uRaw_f "" FLOAT32_IEEE RBPtCel_u_1p0_2 1 100 -1.00000000E+037 1.00000000E+037 FORMAT "%13.3" ECU_ADDRESS 0x60001270
 /begin IF_DATA XCPplus 0x0102
  /begin DAQ_EVENT VARIABLE /end DAQ_EVENT
 /end IF_DATA
/end MEASUREMENT
/begin MEASUREMENT ChrgCIL_stHmiReq "normalized user demand provided by electric vehicle to stop charging and unlock or lock charge plug" UBYTE ChrgIf_stHmiReq_VERB 1 100 0.00 4.00000000000 FORMAT "%13.11" ECU_ADDRESS 0x60023660
 /begin IF_DATA XCPplus 0x0102
  /begin DAQ_EVENT VARIABLE /end DAQ_EVENT
 /end IF_DATA
/end MEASUREMENT
/begin MEASUREMENT ChrgCntct_flgAllCntctClsd "Both charging contactors closed" UBYTE B_TRUE 1 100 0.00 1.00000000000 BIT_MASK 0x1 FORMAT "%13.11" ECU_ADDRESS 0x600231D9
 /begin IF_DATA XCPplus 0x0102
  /begin DAQ_EVENT VARIABLE /end DAQ_EVENT
 /end IF_DATA
/end MEASUREMENT
/begin MEASUREMENT ChrgCntct_flgCntctNeg "Negative charging contactor position" UBYTE B_TRUE 1 100 0.00 1.00000000000 BIT_MASK 0x1 FORMAT "%13.11" ECU_ADDRESS 0x600234DB
 /begin IF_DATA XCPplus 0x0102
  /begin DAQ_EVENT VARIABLE /end DAQ_EVENT
 /end IF_DATA
/end MEASUREMENT
/begin MEASUREMENT ChrgCntct_flgCntctPos "Positive charging contactor position" UBYTE B_TRUE 1 100 0.00 1.00000000000 BIT_MASK 0x1 FORMAT "%13.11" ECU_ADDRESS 0x600234DA
 /begin IF_DATA XCPplus 0x0102
  /begin DAQ_EVENT VARIABLE /end DAQ_EVENT
 /end IF_DATA
/end MEASUREMENT
/begin MEASUREMENT ChrgCntct_flgNegCntctClsd "Negative contactor feedback closed" UBYTE B_TRUE 1 100 0.00 1.00000000000 BIT_MASK 0x1 FORMAT "%13.11" ECU_ADDRESS 0x600231D8
 /begin IF_DATA XCPplus 0x0102
  /begin DAQ_EVENT VARIABLE /end DAQ_EVENT
 /end IF_DATA
/end MEASUREMENT
/begin MEASUREMENT ChrgCntct_flgPosCntctClsd "Positive contactor feedback closed" UBYTE B_TRUE 1 100 0.00 1.00000000000 BIT_MASK 0x1 FORMAT "%13.11" ECU_ADDRESS 0x600231D7
 /begin IF_DATA XCPplus 0x0102
  /begin DAQ_EVENT VARIABLE /end DAQ_EVENT
 /end IF_DATA
/end MEASUREMENT
/begin MEASUREMENT ChrgCntct_flgSnsrErr "Charging contactors sensor error" UBYTE B_TRUE 1 100 0.00 1.00000000000 BIT_MASK 0x1 FORMAT "%13.11" ECU_ADDRESS 0x600231D6
 /begin IF_DATA XCPplus 0x0102
  /begin DAQ_EVENT VARIABLE /end DAQ_EVENT
 /end IF_DATA
/end MEASUREMENT
/begin MEASUREMENT ChrgCntct_flgTrigNegCnt "Trigger negative contactor counting" UBYTE B_TRUE 1 100 0.00 1.00000000000 BIT_MASK 0x1 FORMAT "%13.11" ECU_ADDRESS 0x600231D5
 /begin IF_DATA XCPplus 0x0102
  /begin DAQ_EVENT VARIABLE /end DAQ_EVENT
 /end IF_DATA
/end MEASUREMENT
/begin MEASUREMENT ChrgCntct_flgTrigPosCnt "Trigger positive contactor counting" UBYTE B_TRUE 1 100 0.00 1.00000000000 BIT_MASK 0x1 FORMAT "%13.11" ECU_ADDRESS 0x600231D4
 /begin IF_DATA XCPplus 0x0102
  /begin DAQ_EVENT VARIABLE /end DAQ_EVENT
 /end IF_DATA
/end MEASUREMENT
/begin MEASUREMENT ChrgCntct_iActMeasd "Contactors actual current local" UWORD RBPtCel_i_0p03125_1 1 100 0.00 2047.969 FORMAT "%8.3" ECU_ADDRESS 0x6001F598
 /begin IF_DATA XCPplus 0x0102
  /begin DAQ_EVENT VARIABLE /end DAQ_EVENT
 /end IF_DATA
/end MEASUREMENT
/begin MEASUREMENT ChrgCntct_nrNegCntctElpdOper "Negative contactor lifetime elapsed operations" ULONG OneToOne 1 100 0.00 4294967295.00 FORMAT "%13.2" ECU_ADDRESS 0x60000F10
 /begin IF_DATA XCPplus 0x0102
  /begin DAQ_EVENT VARIABLE /end DAQ_EVENT
 /end IF_DATA
/end MEASUREMENT
/begin MEASUREMENT ChrgCntct_nrNegCntctOper "Negative contactor number of operations" ULONG OneToOne 1 100 0.00 4294967295.00 FORMAT "%13.2" ECU_ADDRESS 0x60000F08
 /begin IF_DATA XCPplus 0x0102
  /begin DAQ_EVENT VARIABLE /end DAQ_EVENT
 /end IF_DATA
/end MEASUREMENT
/begin MEASUREMENT ChrgCntct_NrOper_I.nrNegCntctElpdOper "Contactor control number of operations class / Negative elapsed lifetime" ULONG OneToOne 1 100 0.00 4294967295.00 FORMAT "%13.2" ECU_ADDRESS 0x60035FF0
 /begin IF_DATA XCPplus 0x0102
  /begin DAQ_EVENT VARIABLE /end DAQ_EVENT
 /end IF_DATA
/end MEASUREMENT
/begin MEASUREMENT ChrgCntct_NrOper_I.nrNegCntctOper "Contactor control number of operations class / Negative operations" ULONG OneToOne 1 100 0.00 4294967295.00 FORMAT "%13.2" ECU_ADDRESS 0x60035FF4
 /begin IF_DATA XCPplus 0x0102
  /begin DAQ_EVENT VARIABLE /end DAQ_EVENT
 /end IF_DATA
/end MEASUREMENT
/begin MEASUREMENT ChrgCntct_NrOper_I.nrPosCntctElpdOper "Contactor control number of operations class / Positive elapsed lifetime" ULONG OneToOne 1 100 0.00 4294967295.00 FORMAT "%13.2" ECU_ADDRESS 0x60035FF8
 /begin IF_DATA XCPplus 0x0102
  /begin DAQ_EVENT VARIABLE /end DAQ_EVENT
 /end IF_DATA
/end MEASUREMENT
/begin MEASUREMENT ChrgCntct_NrOper_I.nrPosCntctOper "Contactor control number of operations class / Positive operations" ULONG OneToOne 1 100 0.00 4294967295.00 FORMAT "%13.2" ECU_ADDRESS 0x60035FFC
 /begin IF_DATA XCPplus 0x0102
  /begin DAQ_EVENT VARIABLE /end DAQ_EVENT
 /end IF_DATA
/end MEASUREMENT
/begin MEASUREMENT ChrgCntct_nrPosCntctElpdOper "Positive contactor lifetime elapsed operations" ULONG OneToOne 1 100 0.00 4294967295.00 FORMAT "%13.2" ECU_ADDRESS 0x60000F04
 /begin IF_DATA XCPplus 0x0102
  /begin DAQ_EVENT VARIABLE /end DAQ_EVENT
 /end IF_DATA
/end MEASUREMENT
/begin MEASUREMENT ChrgCntct_nrPosCntctOper "Positive contactor number of operations" ULONG OneToOne 1 100 0.00 4294967295.00 FORMAT "%13.2" ECU_ADDRESS 0x60000EFC
 /begin IF_DATA XCPplus 0x0102
  /begin DAQ_EVENT VARIABLE /end DAQ_EVENT
 /end IF_DATA
/end MEASUREMENT
/begin MEASUREMENT ChrgCntct_st "Charging contactors state" UBYTE ChrgCntct_st_VERB 1 100 0.00 6.00000000000 FORMAT "%13.11" ECU_ADDRESS 0x6002365F
 /begin IF_DATA XCPplus 0x0102
  /begin DAQ_EVENT VARIABLE /end DAQ_EVENT
 /end IF_DATA
/end MEASUREMENT
/begin MEASUREMENT ChrgCntct_StMacCntct.ChrgCntct_facNegLfTiCnt "Charging contactors state machine state / Negative contactor - lifetime counter factor" ULONG OneToOne 1 100 0.00 4294967295.00 FORMAT "%13.2" ECU_ADDRESS 0x60000B44
 /begin IF_DATA XCPplus 0x0102
  /begin DAQ_EVENT VARIABLE /end DAQ_EVENT
 /end IF_DATA
/end MEASUREMENT
/begin MEASUREMENT ChrgCntct_StMacCntct.ChrgCntct_facPosLfTiCnt "Charging contactors state machine state / Positive contactor - lifetime counter factor" ULONG OneToOne 1 100 0.00 4294967295.00 FORMAT "%13.2" ECU_ADDRESS 0x60000B48
 /begin IF_DATA XCPplus 0x0102
  /begin DAQ_EVENT VARIABLE /end DAQ_EVENT
 /end IF_DATA
/end MEASUREMENT
/begin MEASUREMENT ChrgCntct_StMacCntct.facNegOperIHiLoc "Charging contactors state machine state / Negative contactors - number of operations at Hi table output" UWORD OneToOne 1 100 0.00 65535.00 FORMAT "%8.2" ECU_ADDRESS 0x60000B50
 /begin IF_DATA XCPplus 0x0102
  /begin DAQ_EVENT VARIABLE /end DAQ_EVENT
 /end IF_DATA
/end MEASUREMENT
/begin MEASUREMENT ChrgCntct_StMacCntct.facNegOperILoLoc "Charging contactors state machine state / Negative contactors - number of operations at Lo table output" UWORD OneToOne 1 100 0.00 65535.00 FORMAT "%8.2" ECU_ADDRESS 0x60000B52
 /begin IF_DATA XCPplus 0x0102
  /begin DAQ_EVENT VARIABLE /end DAQ_EVENT
 /end IF_DATA
/end MEASUREMENT
/begin MEASUREMENT ChrgCntct_StMacCntct.facPosOperIHiLoc "Charging contactors state machine state / Positive contactors - number of operations at Hi table output" UWORD OneToOne 1 100 0.00 65535.00 FORMAT "%8.2" ECU_ADDRESS 0x60000B58
 /begin IF_DATA XCPplus 0x0102
  /begin DAQ_EVENT VARIABLE /end DAQ_EVENT
 /end IF_DATA
/end MEASUREMENT
/begin MEASUREMENT ChrgCntct_StMacCntct.facPosOperILoLoc "Charging contactors state machine state / Positive contactors - number of operations at Lo table output" UWORD OneToOne 1 100 0.00 65535.00 FORMAT "%8.2" ECU_ADDRESS 0x60000B5A
 /begin IF_DATA XCPplus 0x0102
  /begin DAQ_EVENT VARIABLE /end DAQ_EVENT
 /end IF_DATA
/end MEASUREMENT
/begin MEASUREMENT ChrgCntct_StMacCntct.flgOnlyPosCntctClsd "Charging contactors state machine state / Charging contactors - Only positive contactor was closed" UBYTE B_TRUE 1 100 0.00 1.00000000000 BIT_MASK 0x1 FORMAT "%13.11" ECU_ADDRESS 0x60000B60
 /begin IF_DATA XCPplus 0x0102
  /begin DAQ_EVENT VARIABLE /end DAQ_EVENT
 /end IF_DATA
/end MEASUREMENT
/begin MEASUREMENT ChrgCntct_StMacCntct.iEmgyOpngINeg "Charging contactors state machine state / Charging contactors - emergency open current for negative contactor" UWORD RBPtCel_i_0p03125_1 1 100 0.00 2047.969 FORMAT "%8.3" ECU_ADDRESS 0x60000B66
 /begin IF_DATA XCPplus 0x0102
  /begin DAQ_EVENT VARIABLE /end DAQ_EVENT
 /end IF_DATA
/end MEASUREMENT
/begin MEASUREMENT ChrgCntct_StMacCntct.iEmgyOpngIPos "Charging contactors state machine state / Charging contactors - emergency open current for positive contactor" UWORD RBPtCel_i_0p03125_1 1 100 0.00 2047.969 FORMAT "%8.3" ECU_ADDRESS 0x60000B68
 /begin IF_DATA XCPplus 0x0102
  /begin DAQ_EVENT VARIABLE /end DAQ_EVENT
 /end IF_DATA
/end MEASUREMENT
/begin MEASUREMENT ChrgCntct_StMacCntct.sm "Charging contactors state machine state / Charging contactors - state machine state" UBYTE ChrgCntct_Ctrl_StCntctMac_sm_VERB 1 100 0.00 16.0000000000 FORMAT "%13.10" ECU_ADDRESS 0x60000B6A
 /begin IF_DATA XCPplus 0x0102
  /begin DAQ_EVENT VARIABLE /end DAQ_EVENT
 /end IF_DATA
/end MEASUREMENT
/begin MEASUREMENT ChrgCntct_StMacCntct.stResWldChk "Charging contactors state machine state / Charging contactors - weld check result internal" UBYTE OneToOne 1 100 0.00 255.0 FORMAT "%5.1" ECU_ADDRESS 0x60000B6C
 /begin IF_DATA XCPplus 0x0102
  /begin DAQ_EVENT VARIABLE /end DAQ_EVENT
 /end IF_DATA
/end MEASUREMENT
/begin MEASUREMENT ChrgCntct_StMacCntct.tiDeb "Charging contactors state machine state / Charging contactors - debounce timer" UWORD RBPtCel_ti_0p01_1 1 100 0.00 655.3500 FORMAT "%8.4" ECU_ADDRESS 0x60000B6E
 /begin IF_DATA XCPplus 0x0102
  /begin DAQ_EVENT VARIABLE /end DAQ_EVENT
 /end IF_DATA
/end MEASUREMENT
/begin MEASUREMENT ChrgCntct_StMacCntct.tiTmr "Charging contactors state machine state / Charging contactors - general purpose timer" UWORD RBPtCel_ti_0p01_1 1 100 0.00 655.3500 FORMAT "%8.4" ECU_ADDRESS 0x60000B70
 /begin IF_DATA XCPplus 0x0102
  /begin DAQ_EVENT VARIABLE /end DAQ_EVENT
 /end IF_DATA
/end MEASUREMENT
/begin MEASUREMENT ChrgCntct_stVldnChk "Charging contactors validation state" UBYTE OneToOne 1 100 0.00 255.0 FORMAT "%5.1" ECU_ADDRESS 0x600231D3
 /begin IF_DATA XCPplus 0x0102
  /begin DAQ_EVENT VARIABLE /end DAQ_EVENT
 /end IF_DATA
/end MEASUREMENT
/begin MEASUREMENT ChrgCom_stAcExt "Communication status of charging mode CCS AC with BS or China AC" UBYTE ChrgIf_stCom_VERB 1 100 0.00 3.00000000000 FORMAT "%13.11" ECU_ADDRESS 0x6002365E
 /begin IF_DATA XCPplus 0x0102
  /begin DAQ_EVENT VARIABLE /end DAQ_EVENT
 /end IF_DATA
/end MEASUREMENT
/begin MEASUREMENT ChrgCom_stCcsDc "Communication status of charging mode CCS DC" UBYTE ChrgIf_stCom_VERB 1 100 0.00 3.00000000000 FORMAT "%13.11" ECU_ADDRESS 0x6002365D
 /begin IF_DATA XCPplus 0x0102
  /begin DAQ_EVENT VARIABLE /end DAQ_EVENT
 /end IF_DATA
/end MEASUREMENT
/begin MEASUREMENT ChrgCom_tiComSetUpAcExt "Elapsed time trying to establish communication for CCS AC without HLC or China AC" UWORD RBPtCel_ti_0p01_1 1 100 0.00 655.3500 FORMAT "%8.4" ECU_ADDRESS 0x6001F596
 /begin IF_DATA XCPplus 0x0102
  /begin DAQ_EVENT VARIABLE /end DAQ_EVENT
 /end IF_DATA
/end MEASUREMENT
/begin MEASUREMENT ChrgCom_tiComSetUpCcsDc "Elapsed time trying to establish communication for CCS DC" UWORD RBPtCel_ti_0p01_1 1 100 0.00 655.3500 FORMAT "%8.4" ECU_ADDRESS 0x6001F594
 /begin IF_DATA XCPplus 0x0102
  /begin DAQ_EVENT VARIABLE /end DAQ_EVENT
 /end IF_DATA
/end MEASUREMENT
/begin MEASUREMENT ChrgFlow_flgCtrlPltSwtReq "CP S2 switch request" UBYTE B_TRUE 1 100 0.00 1.00000000000 BIT_MASK 0x1 FORMAT "%13.11" ECU_ADDRESS 0x600234D9
 /begin IF_DATA XCPplus 0x0102
  /begin DAQ_EVENT VARIABLE /end DAQ_EVENT
 /end IF_DATA
/end MEASUREMENT
/begin MEASUREMENT ChrgFlow_flgCtrlPltSwtTogIni "Initial CP S2 toggle" UBYTE B_TRUE 1 100 0.00 1.00000000000 BIT_MASK 0x1 FORMAT "%13.11" ECU_ADDRESS 0x600231D2
 /begin IF_DATA XCPplus 0x0102
  /begin DAQ_EVENT VARIABLE /end DAQ_EVENT
 /end IF_DATA
/end MEASUREMENT
/begin MEASUREMENT ChrgFlow_flgTogReq "Local BCB toggle request by HLC" UBYTE B_TRUE 1 100 0.00 1.00000000000 BIT_MASK 0x1 FORMAT "%13.11" ECU_ADDRESS 0x600231D1
 /begin IF_DATA XCPplus 0x0102
  /begin DAQ_EVENT VARIABLE /end DAQ_EVENT
 /end IF_DATA
/end MEASUREMENT
/begin MEASUREMENT ChrgFlow_nrTogCtrlPltSwtReq "CP S2 toggle request" UBYTE OneToOne 1 100 0.00 255.0 FORMAT "%5.1" ECU_ADDRESS 0x6002365C
 /begin IF_DATA XCPplus 0x0102
  /begin DAQ_EVENT VARIABLE /end DAQ_EVENT
 /end IF_DATA
/end MEASUREMENT
/begin MEASUREMENT ChrgFlow_nrTogReq "Number of requested BCB toggles" UBYTE OneToOne 1 100 0.00 255.0 FORMAT "%5.1" ECU_ADDRESS 0x600231D0
 /begin IF_DATA XCPplus 0x0102
  /begin DAQ_EVENT VARIABLE /end DAQ_EVENT
 /end IF_DATA
/end MEASUREMENT
/begin MEASUREMENT ChrgFlow_stCtrlPltOld "Previous CP S2 state" UBYTE RBPtEChrDv_stCtP_VERB 1 100 0.00 9.00000000000 FORMAT "%13.11" ECU_ADDRESS 0x600231CF
 /begin IF_DATA XCPplus 0x0102
  /begin DAQ_EVENT VARIABLE /end DAQ_EVENT
 /end IF_DATA
/end MEASUREMENT
/begin MEASUREMENT ChrgMod_flgChrgnRdy "Charging readiness of EV" UBYTE B_TRUE 1 100 0.00 1.00000000000 BIT_MASK 0x1 FORMAT "%13.11" ECU_ADDRESS 0x600234D8
 /begin IF_DATA XCPplus 0x0102
  /begin DAQ_EVENT VARIABLE /end DAQ_EVENT
 /end IF_DATA
/end MEASUREMENT
/begin MEASUREMENT ChrgMod_flgChrgnRetry "New charging try" UBYTE B_TRUE 1 100 0.00 1.00000000000 BIT_MASK 0x1 FORMAT "%13.11" ECU_ADDRESS 0x600234D7
 /begin IF_DATA XCPplus 0x0102
  /begin DAQ_EVENT VARIABLE /end DAQ_EVENT
 /end IF_DATA
/end MEASUREMENT
/begin MEASUREMENT ChrgMod_flgIsoMeasmtDiReq "Insulation measurement disable request" UBYTE B_TRUE 1 100 0.00 1.00000000000 BIT_MASK 0x1 FORMAT "%13.11" ECU_ADDRESS 0x600234D6
 /begin IF_DATA XCPplus 0x0102
  /begin DAQ_EVENT VARIABLE /end DAQ_EVENT
 /end IF_DATA
/end MEASUREMENT
/begin MEASUREMENT ChrgMod_flgNoChrgnIni "No charging mode selected because no plug is detected" UBYTE B_TRUE 1 100 0.00 1.00000000000 BIT_MASK 0x1 FORMAT "%13.11" ECU_ADDRESS 0x600231CD
 /begin IF_DATA XCPplus 0x0102
  /begin DAQ_EVENT VARIABLE /end DAQ_EVENT
 /end IF_DATA
/end MEASUREMENT
/begin MEASUREMENT ChrgMod_flgNoChrgnPnd "No charging mode selected yet because communication establishing is ongoing" UBYTE B_TRUE 1 100 0.00 1.00000000000 BIT_MASK 0x1 FORMAT "%13.11" ECU_ADDRESS 0x600231CC
 /begin IF_DATA XCPplus 0x0102
  /begin DAQ_EVENT VARIABLE /end DAQ_EVENT
 /end IF_DATA
/end MEASUREMENT
/begin MEASUREMENT ChrgMod_flgUnplRqrd "previously detected error requires unplug of charging equipment to release new charging mode" UBYTE B_TRUE 1 100 0.00 1.00000000000 BIT_MASK 0x1 FORMAT "%13.11" ECU_ADDRESS 0x600234D5
 /begin IF_DATA XCPplus 0x0102
  /begin DAQ_EVENT VARIABLE /end DAQ_EVENT
 /end IF_DATA
/end MEASUREMENT
/begin MEASUREMENT ChrgMod_iChrgnMaxAvl "Max. available charging current of the charging station" SWORD RBPtCel_i_0p03125_1 1 100 -1024.000 1023.969 FORMAT "%8.3" ECU_ADDRESS 0x6001FC00
 /begin IF_DATA XCPplus 0x0102
  /begin DAQ_EVENT VARIABLE /end DAQ_EVENT
 /end IF_DATA
/end MEASUREMENT
/begin MEASUREMENT ChrgMod_iChrgnReq "Requested charging current" SWORD RBPtCel_i_0p03125_1 1 100 -1024.000 1023.969 FORMAT "%8.3" ECU_ADDRESS 0x6001FBFE
 /begin IF_DATA XCPplus 0x0102
  /begin DAQ_EVENT VARIABLE /end DAQ_EVENT
 /end IF_DATA
/end MEASUREMENT
/begin MEASUREMENT ChrgMod_pwrChrgnOut "Actual charging power" SWORD RBPtCel_pwr_25p0_1 1 100 -819200.0 819175.0 FORMAT "%8.1" ECU_ADDRESS 0x6001FBFC
 /begin IF_DATA XCPplus 0x0102
  /begin DAQ_EVENT VARIABLE /end DAQ_EVENT
 /end IF_DATA
/end MEASUREMENT
/begin MEASUREMENT ChrgMod_ratSocChrgnStop "Target charging SOC" SWORD Prc 1 100 -400.0000 399.9878 FORMAT "%8.4" ECU_ADDRESS 0x6001FBFA
 /begin IF_DATA XCPplus 0x0102
  /begin DAQ_EVENT VARIABLE /end DAQ_EVENT
 /end IF_DATA
/end MEASUREMENT
/begin MEASUREMENT ChrgMod_stChrgn "Charge control state" UBYTE ChrgCtrl_stChrgn_VERB 1 100 0.00 6.00000000000 FORMAT "%13.11" ECU_ADDRESS 0x6002365B
 /begin IF_DATA XCPplus 0x0102
  /begin DAQ_EVENT VARIABLE /end DAQ_EVENT
 /end IF_DATA
/end MEASUREMENT
/begin MEASUREMENT ChrgMod_stChrgnCntctReq "Charging contactors request" UBYTE ChrgCtrl_stChrgnCntctReq_VERB 1 100 0.00 2.00000000000 FORMAT "%13.11" ECU_ADDRESS 0x6002365A
 /begin IF_DATA XCPplus 0x0102
  /begin DAQ_EVENT VARIABLE /end DAQ_EVENT
 /end IF_DATA
/end MEASUREMENT
/begin MEASUREMENT ChrgMod_stChrgnLoc "Local charge control state" UBYTE ChrgCtrl_stChrgn_VERB 1 100 0.00 6.00000000000 FORMAT "%13.11" ECU_ADDRESS 0x600231CE
 /begin IF_DATA XCPplus 0x0102
  /begin DAQ_EVENT VARIABLE /end DAQ_EVENT
 /end IF_DATA
/end MEASUREMENT
/begin MEASUREMENT ChrgMod_stChrgnReq "Current charging request of active charge control" UBYTE ChrgCtrl_stChrgn_VERB 1 100 0.00 6.00000000000 FORMAT "%13.11" ECU_ADDRESS 0x60023659
 /begin IF_DATA XCPplus 0x0102
  /begin DAQ_EVENT VARIABLE /end DAQ_EVENT
 /end IF_DATA
/end MEASUREMENT
/begin MEASUREMENT ChrgMod_stMod "Active charging mode" UBYTE ChrgCtrl_stMod_VERB 1 100 0.00 9.00000000000 FORMAT "%13.11" ECU_ADDRESS 0x60023658
 /begin IF_DATA XCPplus 0x0102
  /begin DAQ_EVENT VARIABLE /end DAQ_EVENT
 /end IF_DATA
/end MEASUREMENT
/begin MEASUREMENT ChrgMod_stModSeld "Selected charging mode" UBYTE ChrgCtrl_stMod_VERB 1 100 0.00 9.00000000000 FORMAT "%13.11" ECU_ADDRESS 0x600231CB
 /begin IF_DATA XCPplus 0x0102
  /begin DAQ_EVENT VARIABLE /end DAQ_EVENT
 /end IF_DATA
/end MEASUREMENT
/begin MEASUREMENT ChrgMod_tiHldBackFinsh "Elapsed time till charging state FINSH will be provided" UWORD RBPtCel_ti_0p01_1 1 100 0.00 655.3500 FORMAT "%8.4" ECU_ADDRESS 0x6001F592
 /begin IF_DATA XCPplus 0x0102
  /begin DAQ_EVENT VARIABLE /end DAQ_EVENT
 /end IF_DATA
/end MEASUREMENT
/begin MEASUREMENT ChrgMod_uChrgnReq "Requested charging voltage" SWORD RBPtCel_u_0p1_1 1 100 -3276.800 3276.700 FORMAT "%8.3" ECU_ADDRESS 0x6001FBF8
 /begin IF_DATA XCPplus 0x0102
  /begin DAQ_EVENT VARIABLE /end DAQ_EVENT
 /end IF_DATA
/end MEASUREMENT
/begin MEASUREMENT DDRC_St.DFC_CbnHeatgHeatrHsScb "" ULONG DFC_OneToOne 1 100 0.00 536870911.000 BIT_MASK 0x1fffffff FORMAT "%13.3" ECU_ADDRESS 0x6001C20C /end MEASUREMENT
/begin MEASUREMENT DDRC_St.DFC_CbnHeatgHeatrHsScg "" ULONG DFC_OneToOne 1 100 0.00 536870911.000 BIT_MASK 0x1fffffff FORMAT "%13.3" ECU_ADDRESS 0x6001C210 /end MEASUREMENT
/begin MEASUREMENT DDRC_St.DFC_CbnHeatgHeatrLsOl "" ULONG DFC_OneToOne 1 100 0.00 536870911.000 BIT_MASK 0x1fffffff FORMAT "%13.3" ECU_ADDRESS 0x6001C214 /end MEASUREMENT
/begin MEASUREMENT DDRC_St.DFC_CbnHeatgHeatrLsScb "" ULONG DFC_OneToOne 1 100 0.00 536870911.000 BIT_MASK 0x1fffffff FORMAT "%13.3" ECU_ADDRESS 0x6001C218 /end MEASUREMENT
/begin MEASUREMENT DDRC_St.DFC_CbnHeatgHeatrLsScg "" ULONG DFC_OneToOne 1 100 0.00 536870911.000 BIT_MASK 0x1fffffff FORMAT "%13.3" ECU_ADDRESS 0x6001C21C /end MEASUREMENT
/begin MEASUREMENT DDRC_St.DFC_CbnHeatgHeatrUnUsed "" ULONG DFC_OneToOne 1 100 0.00 536870911.000 BIT_MASK 0x1fffffff FORMAT "%13.3" ECU_ADDRESS 0x6001C220 /end MEASUREMENT
/begin MEASUREMENT DDRC_St.DFC_CbnHeatgHeatrRlyOpend "" ULONG DFC_OneToOne 1 100 0.00 536870911.000 BIT_MASK 0x1fffffff FORMAT "%13.3" ECU_ADDRESS 0x6001C9DC /end MEASUREMENT
/begin MEASUREMENT DDRC_St.DFC_CbnHeatgHeatrRlyWldd "" ULONG DFC_OneToOne 1 100 0.00 536870911.000 BIT_MASK 0x1fffffff FORMAT "%13.3" ECU_ADDRESS 0x6001C9E0 /end MEASUREMENT
/begin MEASUREMENT DDRC_St.DFC_CcsPwrLineChpRstOL "" ULONG DFC_OneToOne 1 100 0.00 536870911.000 BIT_MASK 0x1fffffff FORMAT "%13.3" ECU_ADDRESS 0x6001C9FC /end MEASUREMENT
/begin MEASUREMENT DDRC_St.DFC_CcsPwrLineChpRstOvrTemp "" ULONG DFC_OneToOne 1 100 0.00 536870911.000 BIT_MASK 0x1fffffff FORMAT "%13.3" ECU_ADDRESS 0x6001CA00 /end MEASUREMENT
/begin MEASUREMENT DDRC_St.DFC_CcsPwrLineChpRstSCB "" ULONG DFC_OneToOne 1 100 0.00 536870911.000 BIT_MASK 0x1fffffff FORMAT "%13.3" ECU_ADDRESS 0x6001CA04 /end MEASUREMENT
/begin MEASUREMENT DDRC_St.DFC_CcsPwrLineChpRstSCG "" ULONG DFC_OneToOne 1 100 0.00 536870911.000 BIT_MASK 0x1fffffff FORMAT "%13.3" ECU_ADDRESS 0x6001CA08 /end MEASUREMENT
/begin MEASUREMENT DDRC_St.DFC_CcsPwrLineChpVccEnaOL "" ULONG DFC_OneToOne 1 100 0.00 536870911.000 BIT_MASK 0x1fffffff FORMAT "%13.3" ECU_ADDRESS 0x6001CA0C /end MEASUREMENT
/begin MEASUREMENT DDRC_St.DFC_CcsPwrLineChpVccEnaOvrTemp "" ULONG DFC_OneToOne 1 100 0.00 536870911.000 BIT_MASK 0x1fffffff FORMAT "%13.3" ECU_ADDRESS 0x6001CA10 /end MEASUREMENT
/begin MEASUREMENT DDRC_St.DFC_CcsPwrLineChpVccEnaSCB "" ULONG DFC_OneToOne 1 100 0.00 536870911.000 BIT_MASK 0x1fffffff FORMAT "%13.3" ECU_ADDRESS 0x6001CA14 /end MEASUREMENT
/begin MEASUREMENT DDRC_St.DFC_CcsPwrLineChpVccEnaSCG "" ULONG DFC_OneToOne 1 100 0.00 536870911.000 BIT_MASK 0x1fffffff FORMAT "%13.3" ECU_ADDRESS 0x6001CA18 /end MEASUREMENT
/begin MEASUREMENT DDRC_St.DFC_CcsPwrLineChpVccSRCMin "" ULONG DFC_OneToOne 1 100 0.00 536870911.000 BIT_MASK 0x1fffffff FORMAT "%13.3" ECU_ADDRESS 0x6001CA1C /end MEASUREMENT
/begin MEASUREMENT DDRC_St.DFC_CcsPwrLineComChpTSRCMin "" ULONG DFC_OneToOne 1 100 0.00 536870911.000 BIT_MASK 0x1fffffff FORMAT "%13.3" ECU_ADDRESS 0x6001CA20 /end MEASUREMENT
/begin MEASUREMENT DDRC_St.DFC_CcsPwrLineChpVccPhysRngHi "" UWORD DFC_OneToOne 1 100 0.00 8191.000 BIT_MASK 0x1fff FORMAT "%8.3" ECU_ADDRESS 0x60021F7C /end MEASUREMENT
/begin MEASUREMENT DDRC_St.DFC_CcsPwrLineChpVccPhysRngLo "" UWORD DFC_OneToOne 1 100 0.00 8191.000 BIT_MASK 0x1fff FORMAT "%8.3" ECU_ADDRESS 0x60021F7E /end MEASUREMENT
/begin MEASUREMENT DDRC_St.DFC_CcsPwrLineChpVccSRCOpn "" UWORD DFC_OneToOne 1 100 0.00 8191.000 BIT_MASK 0x1fff FORMAT "%8.3" ECU_ADDRESS 0x60021F80 /end MEASUREMENT
/begin MEASUREMENT DDRC_St.DFC_CcsPwrLineComChpTPhysRngHi "" UWORD DFC_OneToOne 1 100 0.00 8191.000 BIT_MASK 0x1fff FORMAT "%8.3" ECU_ADDRESS 0x60021F82 /end MEASUREMENT
/begin MEASUREMENT DDRC_St.DFC_CcsPwrLineComChpTPhysRngLo "" UWORD DFC_OneToOne 1 100 0.00 8191.000 BIT_MASK 0x1fff FORMAT "%8.3" ECU_ADDRESS 0x60021F84 /end MEASUREMENT
/begin MEASUREMENT DDRC_St.DFC_CcsPwrLineComChpTSRCOpn "" UWORD DFC_OneToOne 1 100 0.00 8191.000 BIT_MASK 0x1fff FORMAT "%8.3" ECU_ADDRESS 0x60021F86 /end MEASUREMENT
/begin MEASUREMENT DFC_st.DFC_CbnHeatgHeatrHsScb "" UBYTE DFC_OneToOne 1 100 0.00 255.0 FORMAT "%5.1" ECU_ADDRESS 0x600349E6 /end MEASUREMENT
/begin MEASUREMENT DFC_st.DFC_CbnHeatgHeatrHsScg "" UBYTE DFC_OneToOne 1 100 0.00 255.0 FORMAT "%5.1" ECU_ADDRESS 0x600349E7 /end MEASUREMENT
/begin MEASUREMENT DFC_st.DFC_CbnHeatgHeatrLsOl "" UBYTE DFC_OneToOne 1 100 0.00 255.0 FORMAT "%5.1" ECU_ADDRESS 0x600349E8 /end MEASUREMENT
/begin MEASUREMENT DFC_st.DFC_CbnHeatgHeatrLsScb "" UBYTE DFC_OneToOne 1 100 0.00 255.0 FORMAT "%5.1" ECU_ADDRESS 0x600349E9 /end MEASUREMENT
/begin MEASUREMENT DFC_st.DFC_CbnHeatgHeatrLsScg "" UBYTE DFC_OneToOne 1 100 0.00 255.0 FORMAT "%5.1" ECU_ADDRESS 0x600349EA /end MEASUREMENT
/begin MEASUREMENT DFC_st.DFC_CbnHeatgHeatrUnUsed "" UBYTE DFC_OneToOne 1 100 0.00 255.0 FORMAT "%5.1" ECU_ADDRESS 0x600349EB /end MEASUREMENT
/begin MEASUREMENT DFC_st.DFC_CbnHeatgHeatrRlyOpend "" UBYTE DFC_OneToOne 1 100 0.00 255.0 FORMAT "%5.1" ECU_ADDRESS 0x60034BDA /end MEASUREMENT
/begin MEASUREMENT DFC_st.DFC_CbnHeatgHeatrRlyWldd "" UBYTE DFC_OneToOne 1 100 0.00 255.0 FORMAT "%5.1" ECU_ADDRESS 0x60034BDB /end MEASUREMENT
/begin MEASUREMENT DFC_st.DFC_CcsPwrLineChpRstOL "" UBYTE DFC_OneToOne 1 100 0.00 255.0 FORMAT "%5.1" ECU_ADDRESS 0x60034BE2 /end MEASUREMENT
/begin MEASUREMENT DFC_st.DFC_CcsPwrLineChpRstOvrTemp "" UBYTE DFC_OneToOne 1 100 0.00 255.0 FORMAT "%5.1" ECU_ADDRESS 0x60034BE3 /end MEASUREMENT
/begin MEASUREMENT DFC_st.DFC_CcsPwrLineChpRstSCB "" UBYTE DFC_OneToOne 1 100 0.00 255.0 FORMAT "%5.1" ECU_ADDRESS 0x60034BE4 /end MEASUREMENT
/begin MEASUREMENT DFC_st.DFC_CcsPwrLineChpRstSCG "" UBYTE DFC_OneToOne 1 100 0.00 255.0 FORMAT "%5.1" ECU_ADDRESS 0x60034BE5 /end MEASUREMENT
/begin MEASUREMENT DFC_st.DFC_CcsPwrLineChpVccEnaOL "" UBYTE DFC_OneToOne 1 100 0.00 255.0 FORMAT "%5.1" ECU_ADDRESS 0x60034BE6 /end MEASUREMENT
/begin MEASUREMENT DFC_st.DFC_CcsPwrLineChpVccEnaOvrTemp "" UBYTE DFC_OneToOne 1 100 0.00 255.0 FORMAT "%5.1" ECU_ADDRESS 0x60034BE7 /end MEASUREMENT
/begin MEASUREMENT DFC_st.DFC_CcsPwrLineChpVccEnaSCB "" UBYTE DFC_OneToOne 1 100 0.00 255.0 FORMAT "%5.1" ECU_ADDRESS 0x60034BE8 /end MEASUREMENT
/begin MEASUREMENT DFC_st.DFC_CcsPwrLineChpVccEnaSCG "" UBYTE DFC_OneToOne 1 100 0.00 255.0 FORMAT "%5.1" ECU_ADDRESS 0x60034BE9 /end MEASUREMENT
/begin MEASUREMENT DFC_st.DFC_CcsPwrLineChpVccSRCMin "" UBYTE DFC_OneToOne 1 100 0.00 255.0 FORMAT "%5.1" ECU_ADDRESS 0x60034BEA /end MEASUREMENT
/begin MEASUREMENT DFC_st.DFC_CcsPwrLineComChpTSRCMin "" UBYTE DFC_OneToOne 1 100 0.00 255.0 FORMAT "%5.1" ECU_ADDRESS 0x60034BEB /end MEASUREMENT
/begin MEASUREMENT DFC_st.DFC_CcsPwrLineChpVccPhysRngHi "" UBYTE DFC_OneToOne 1 100 0.00 255.0 FORMAT "%5.1" ECU_ADDRESS 0x60034C15 /end MEASUREMENT
/begin MEASUREMENT DFC_st.DFC_CcsPwrLineChpVccPhysRngLo "" UBYTE DFC_OneToOne 1 100 0.00 255.0 FORMAT "%5.1" ECU_ADDRESS 0x60034C16 /end MEASUREMENT
/begin MEASUREMENT DFC_st.DFC_CcsPwrLineChpVccSRCOpn "" UBYTE DFC_OneToOne 1 100 0.00 255.0 FORMAT "%5.1" ECU_ADDRESS 0x60034C17 /end MEASUREMENT
/begin MEASUREMENT DFC_st.DFC_CcsPwrLineComChpTPhysRngHi "" UBYTE DFC_OneToOne 1 100 0.00 255.0 FORMAT "%5.1" ECU_ADDRESS 0x60034C18 /end MEASUREMENT
/begin MEASUREMENT DFC_st.DFC_CcsPwrLineComChpTPhysRngLo "" UBYTE DFC_OneToOne 1 100 0.00 255.0 FORMAT "%5.1" ECU_ADDRESS 0x60034C19 /end MEASUREMENT
/begin MEASUREMENT DFC_st.DFC_CcsPwrLineComChpTSRCOpn "" UBYTE DFC_OneToOne 1 100 0.00 255.0 FORMAT "%5.1" ECU_ADDRESS 0x60034C1A /end MEASUREMENT
/begin MEASUREMENT DFC_st.DFC_CbnHeatrRlyLfLoWarn "" UBYTE DFC_OneToOne 1 100 0.00 255.0 FORMAT "%5.1" ECU_ADDRESS 0x60034C73 /end MEASUREMENT
/begin MEASUREMENT DFC_st.DFC_CbnHeatgSwtTmpErr "" UBYTE DFC_OneToOne 1 100 0.00 255.0 FORMAT "%5.1" ECU_ADDRESS 0x60034CB4 /end MEASUREMENT
/begin MEASUREMENT DFC_st.DFC_CcsPwrLineChpVccSRCMax "" UBYTE DFC_OneToOne 1 100 0.00 255.0 FORMAT "%5.1" ECU_ADDRESS 0x60034CB5 /end MEASUREMENT
/begin MEASUREMENT DFC_st.DFC_CcsPwrLineChpVccTmpErr "" UBYTE DFC_OneToOne 1 100 0.00 255.0 FORMAT "%5.1" ECU_ADDRESS 0x60034CB6 /end MEASUREMENT
/begin MEASUREMENT DFC_st.DFC_CcsPwrLineComChpTSRCMax "" UBYTE DFC_OneToOne 1 100 0.00 255.0 FORMAT "%5.1" ECU_ADDRESS 0x60034CB7 /end MEASUREMENT
/begin MEASUREMENT DFC_st.DFC_CcsPwrLineComChpTTmpErr "" UBYTE DFC_OneToOne 1 100 0.00 255.0 FORMAT "%5.1" ECU_ADDRESS 0x60034CB8 /end MEASUREMENT
/begin MEASUREMENT DFC_st.DFC_ChrgCntctAllWldd "" UBYTE DFC_OneToOne 1 100 0.00 255.0 FORMAT "%5.1" ECU_ADDRESS 0x60034CBE /end MEASUREMENT
/begin MEASUREMENT DFC_st.DFC_ChrgCntctNegOperErr "" UBYTE DFC_OneToOne 1 100 0.00 255.0 FORMAT "%5.1" ECU_ADDRESS 0x60034CBF /end MEASUREMENT
/begin MEASUREMENT DFC_st.DFC_ChrgCntctNegOperWarn "" UBYTE DFC_OneToOne 1 100 0.00 255.0 FORMAT "%5.1" ECU_ADDRESS 0x60034CC0 /end MEASUREMENT
/begin MEASUREMENT DFC_st.DFC_ChrgCntctNegWldd "" UBYTE DFC_OneToOne 1 100 0.00 255.0 FORMAT "%5.1" ECU_ADDRESS 0x60034CC1 /end MEASUREMENT
/begin MEASUREMENT DFC_st.DFC_ChrgCntctPosOperErr "" UBYTE DFC_OneToOne 1 100 0.00 255.0 FORMAT "%5.1" ECU_ADDRESS 0x60034CC2 /end MEASUREMENT
/begin MEASUREMENT DFC_st.DFC_ChrgCntctPosOperWarn "" UBYTE DFC_OneToOne 1 100 0.00 255.0 FORMAT "%5.1" ECU_ADDRESS 0x60034CC3 /end MEASUREMENT
/begin MEASUREMENT DFC_st.DFC_ChrgCntctPosWldd "" UBYTE DFC_OneToOne 1 100 0.00 255.0 FORMAT "%5.1" ECU_ADDRESS 0x60034CC4 /end MEASUREMENT
/begin MEASUREMENT DFC_st.DFC_ChrgCntctStuckOpen "" UBYTE DFC_OneToOne 1 100 0.00 255.0 FORMAT "%5.1" ECU_ADDRESS 0x60034CC5 /end MEASUREMENT
/begin MEASUREMENT DFC_st.DFC_ChrgnUnplRqrd "" UBYTE DFC_OneToOne 1 100 0.00 255.0 FORMAT "%5.1" ECU_ADDRESS 0x60034CC7 /end MEASUREMENT
/begin MEASUREMENT DINH_nrActvInhReas.FId_CbnHeatgHeatrPsFlt "" UWORD DINH_ct_Compu 1 100 -4095.000 4096.000 BIT_MASK 0x1fff FORMAT "%8.3" ECU_ADDRESS 0x60021368 /end MEASUREMENT
/begin MEASUREMENT DINH_nrActvInhReas.FId_CbnHeatgHeatrRlyDiagEnad "" UWORD DINH_ct_Compu 1 100 -4095.000 4096.000 BIT_MASK 0x1fff FORMAT "%8.3" ECU_ADDRESS 0x6002136A /end MEASUREMENT
/begin MEASUREMENT DINH_nrActvInhReas.FId_CbnHeatgSwtFrzVal "" UWORD DINH_ct_Compu 1 100 -4095.000 4096.000 BIT_MASK 0x1fff FORMAT "%8.3" ECU_ADDRESS 0x6002136C /end MEASUREMENT
/begin MEASUREMENT DINH_nrActvInhReas.FId_CbnHeatgSwtRplVal "" UWORD DINH_ct_Compu 1 100 -4095.000 4096.000 BIT_MASK 0x1fff FORMAT "%8.3" ECU_ADDRESS 0x6002136E /end MEASUREMENT
/begin MEASUREMENT DINH_nrActvInhReas.FId_CbnHeatgSwtTmpErrCnt "" UWORD DINH_ct_Compu 1 100 -4095.000 4096.000 BIT_MASK 0x1fff FORMAT "%8.3" ECU_ADDRESS 0x60021370 /end MEASUREMENT
/begin MEASUREMENT DINH_nrActvInhReas.FId_CcsPwrLineChpRstMonOff "" UWORD DINH_ct_Compu 1 100 -4095.000 4096.000 BIT_MASK 0x1fff FORMAT "%8.3" ECU_ADDRESS 0x60021376 /end MEASUREMENT
/begin MEASUREMENT DINH_nrActvInhReas.FId_CcsPwrLineChpRstOff "" UWORD DINH_ct_Compu 1 100 -4095.000 4096.000 BIT_MASK 0x1fff FORMAT "%8.3" ECU_ADDRESS 0x60021378 /end MEASUREMENT
/begin MEASUREMENT DINH_nrActvInhReas.FId_CcsPwrLineChpRstPsOff "" UWORD DINH_ct_Compu 1 100 -4095.000 4096.000 BIT_MASK 0x1fff FORMAT "%8.3" ECU_ADDRESS 0x6002137A /end MEASUREMENT
/begin MEASUREMENT DINH_nrActvInhReas.FId_CcsPwrLineChpRstSnsr "" UWORD DINH_ct_Compu 1 100 -4095.000 4096.000 BIT_MASK 0x1fff FORMAT "%8.3" ECU_ADDRESS 0x6002137C /end MEASUREMENT
/begin MEASUREMENT DINH_nrActvInhReas.FId_CcsPwrLineChpVccEnaMonOff "" UWORD DINH_ct_Compu 1 100 -4095.000 4096.000 BIT_MASK 0x1fff FORMAT "%8.3" ECU_ADDRESS 0x6002137E /end MEASUREMENT
/begin MEASUREMENT DINH_nrActvInhReas.FId_CcsPwrLineChpVccEnaOff "" UWORD DINH_ct_Compu 1 100 -4095.000 4096.000 BIT_MASK 0x1fff FORMAT "%8.3" ECU_ADDRESS 0x60021380 /end MEASUREMENT
/begin MEASUREMENT DINH_nrActvInhReas.FId_CcsPwrLineChpVccEnaPsOff "" UWORD DINH_ct_Compu 1 100 -4095.000 4096.000 BIT_MASK 0x1fff FORMAT "%8.3" ECU_ADDRESS 0x60021382 /end MEASUREMENT
/begin MEASUREMENT DINH_nrActvInhReas.FId_CcsPwrLineChpVccEnaSnsr "" UWORD DINH_ct_Compu 1 100 -4095.000 4096.000 BIT_MASK 0x1fff FORMAT "%8.3" ECU_ADDRESS 0x60021384 /end MEASUREMENT
/begin MEASUREMENT DINH_nrActvInhReas.FId_CcsPwrLineChpVccEnhdSRCMax "" UWORD DINH_ct_Compu 1 100 -4095.000 4096.000 BIT_MASK 0x1fff FORMAT "%8.3" ECU_ADDRESS 0x60021386 /end MEASUREMENT
/begin MEASUREMENT DINH_nrActvInhReas.FId_CcsPwrLineChpVccFrzVal "" UWORD DINH_ct_Compu 1 100 -4095.000 4096.000 BIT_MASK 0x1fff FORMAT "%8.3" ECU_ADDRESS 0x60021388 /end MEASUREMENT
/begin MEASUREMENT DINH_nrActvInhReas.FId_CcsPwrLineChpVccPhysRng "" UWORD DINH_ct_Compu 1 100 -4095.000 4096.000 BIT_MASK 0x1fff FORMAT "%8.3" ECU_ADDRESS 0x6002138A /end MEASUREMENT
/begin MEASUREMENT DINH_nrActvInhReas.FId_CcsPwrLineChpVccRplVal "" UWORD DINH_ct_Compu 1 100 -4095.000 4096.000 BIT_MASK 0x1fff FORMAT "%8.3" ECU_ADDRESS 0x6002138C /end MEASUREMENT
/begin MEASUREMENT DINH_nrActvInhReas.FId_CcsPwrLineChpVccSSpMon "" UWORD DINH_ct_Compu 1 100 -4095.000 4096.000 BIT_MASK 0x1fff FORMAT "%8.3" ECU_ADDRESS 0x6002138E /end MEASUREMENT
/begin MEASUREMENT DINH_nrActvInhReas.FId_CcsPwrLineChpVccTmpErrCnt "" UWORD DINH_ct_Compu 1 100 -4095.000 4096.000 BIT_MASK 0x1fff FORMAT "%8.3" ECU_ADDRESS 0x60021390 /end MEASUREMENT
/begin MEASUREMENT DINH_nrActvInhReas.FId_CcsPwrLineComChpTEnhdSRCMax "" UWORD DINH_ct_Compu 1 100 -4095.000 4096.000 BIT_MASK 0x1fff FORMAT "%8.3" ECU_ADDRESS 0x60021392 /end MEASUREMENT
/begin MEASUREMENT DINH_nrActvInhReas.FId_CcsPwrLineComChpTFrzVal "" UWORD DINH_ct_Compu 1 100 -4095.000 4096.000 BIT_MASK 0x1fff FORMAT "%8.3" ECU_ADDRESS 0x60021394 /end MEASUREMENT
/begin MEASUREMENT DINH_nrActvInhReas.FId_CcsPwrLineComChpTPhysRng "" UWORD DINH_ct_Compu 1 100 -4095.000 4096.000 BIT_MASK 0x1fff FORMAT "%8.3" ECU_ADDRESS 0x60021396 /end MEASUREMENT
/begin MEASUREMENT DINH_nrActvInhReas.FId_CcsPwrLineComChpTRplVal "" UWORD DINH_ct_Compu 1 100 -4095.000 4096.000 BIT_MASK 0x1fff FORMAT "%8.3" ECU_ADDRESS 0x60021398 /end MEASUREMENT
/begin MEASUREMENT DINH_nrActvInhReas.FId_CcsPwrLineComChpTSSpMon "" UWORD DINH_ct_Compu 1 100 -4095.000 4096.000 BIT_MASK 0x1fff FORMAT "%8.3" ECU_ADDRESS 0x6002139A /end MEASUREMENT
/begin MEASUREMENT DINH_nrActvInhReas.FId_CcsPwrLineComChpTTmpErrCnt "" UWORD DINH_ct_Compu 1 100 -4095.000 4096.000 BIT_MASK 0x1fff FORMAT "%8.3" ECU_ADDRESS 0x6002139C /end MEASUREMENT
/begin MEASUREMENT DINH_nrActvInhReas.FId_ChrgnUnplRqrd "" UWORD DINH_ct_Compu 1 100 -4095.000 4096.000 BIT_MASK 0x1fff FORMAT "%8.3" ECU_ADDRESS 0x600213B2 /end MEASUREMENT
/begin MEASUREMENT DINH_stFId.FId_CbnHeatgHeatrPsFlt "" UWORD DFC_OneToOne 1 100 0.00 65535.00 FORMAT "%8.2" ECU_ADDRESS 0x60021368 /end MEASUREMENT
/begin MEASUREMENT DINH_stFId.FId_CbnHeatgHeatrRlyDiagEnad "" UWORD DFC_OneToOne 1 100 0.00 65535.00 FORMAT "%8.2" ECU_ADDRESS 0x6002136A /end MEASUREMENT
/begin MEASUREMENT DINH_stFId.FId_CbnHeatgSwtFrzVal "" UWORD DFC_OneToOne 1 100 0.00 65535.00 FORMAT "%8.2" ECU_ADDRESS 0x6002136C /end MEASUREMENT
/begin MEASUREMENT DINH_stFId.FId_CbnHeatgSwtRplVal "" UWORD DFC_OneToOne 1 100 0.00 65535.00 FORMAT "%8.2" ECU_ADDRESS 0x6002136E /end MEASUREMENT
/begin MEASUREMENT DINH_stFId.FId_CbnHeatgSwtTmpErrCnt "" UWORD DFC_OneToOne 1 100 0.00 65535.00 FORMAT "%8.2" ECU_ADDRESS 0x60021370 /end MEASUREMENT
/begin MEASUREMENT DINH_stFId.FId_CcsPwrLineChpRstMonOff "" UWORD DFC_OneToOne 1 100 0.00 65535.00 FORMAT "%8.2" ECU_ADDRESS 0x60021376 /end MEASUREMENT
/begin MEASUREMENT DINH_stFId.FId_CcsPwrLineChpRstOff "" UWORD DFC_OneToOne 1 100 0.00 65535.00 FORMAT "%8.2" ECU_ADDRESS 0x60021378 /end MEASUREMENT
/begin MEASUREMENT DINH_stFId.FId_CcsPwrLineChpRstPsOff "" UWORD DFC_OneToOne 1 100 0.00 65535.00 FORMAT "%8.2" ECU_ADDRESS 0x6002137A /end MEASUREMENT
/begin MEASUREMENT DINH_stFId.FId_CcsPwrLineChpRstSnsr "" UWORD DFC_OneToOne 1 100 0.00 65535.00 FORMAT "%8.2" ECU_ADDRESS 0x6002137C /end MEASUREMENT
/begin MEASUREMENT DINH_stFId.FId_CcsPwrLineChpVccEnaMonOff "" UWORD DFC_OneToOne 1 100 0.00 65535.00 FORMAT "%8.2" ECU_ADDRESS 0x6002137E /end MEASUREMENT
/begin MEASUREMENT DINH_stFId.FId_CcsPwrLineChpVccEnaOff "" UWORD DFC_OneToOne 1 100 0.00 65535.00 FORMAT "%8.2" ECU_ADDRESS 0x60021380 /end MEASUREMENT
/begin MEASUREMENT DINH_stFId.FId_CcsPwrLineChpVccEnaPsOff "" UWORD DFC_OneToOne 1 100 0.00 65535.00 FORMAT "%8.2" ECU_ADDRESS 0x60021382 /end MEASUREMENT
/begin MEASUREMENT DINH_stFId.FId_CcsPwrLineChpVccEnaSnsr "" UWORD DFC_OneToOne 1 100 0.00 65535.00 FORMAT "%8.2" ECU_ADDRESS 0x60021384 /end MEASUREMENT
/begin MEASUREMENT DINH_stFId.FId_CcsPwrLineChpVccEnhdSRCMax "" UWORD DFC_OneToOne 1 100 0.00 65535.00 FORMAT "%8.2" ECU_ADDRESS 0x60021386 /end MEASUREMENT
/begin MEASUREMENT DINH_stFId.FId_CcsPwrLineChpVccFrzVal "" UWORD DFC_OneToOne 1 100 0.00 65535.00 FORMAT "%8.2" ECU_ADDRESS 0x60021388 /end MEASUREMENT
/begin MEASUREMENT DINH_stFId.FId_CcsPwrLineChpVccPhysRng "" UWORD DFC_OneToOne 1 100 0.00 65535.00 FORMAT "%8.2" ECU_ADDRESS 0x6002138A /end MEASUREMENT
/begin MEASUREMENT DINH_stFId.FId_CcsPwrLineChpVccRplVal "" UWORD DFC_OneToOne 1 100 0.00 65535.00 FORMAT "%8.2" ECU_ADDRESS 0x6002138C /end MEASUREMENT
/begin MEASUREMENT DINH_stFId.FId_CcsPwrLineChpVccSSpMon "" UWORD DFC_OneToOne 1 100 0.00 65535.00 FORMAT "%8.2" ECU_ADDRESS 0x6002138E /end MEASUREMENT
/begin MEASUREMENT DINH_stFId.FId_CcsPwrLineChpVccTmpErrCnt "" UWORD DFC_OneToOne 1 100 0.00 65535.00 FORMAT "%8.2" ECU_ADDRESS 0x60021390 /end MEASUREMENT
/begin MEASUREMENT DINH_stFId.FId_CcsPwrLineComChpTEnhdSRCMax "" UWORD DFC_OneToOne 1 100 0.00 65535.00 FORMAT "%8.2" ECU_ADDRESS 0x60021392 /end MEASUREMENT
/begin MEASUREMENT DINH_stFId.FId_CcsPwrLineComChpTFrzVal "" UWORD DFC_OneToOne 1 100 0.00 65535.00 FORMAT "%8.2" ECU_ADDRESS 0x60021394 /end MEASUREMENT
/begin MEASUREMENT DINH_stFId.FId_CcsPwrLineComChpTPhysRng "" UWORD DFC_OneToOne 1 100 0.00 65535.00 FORMAT "%8.2" ECU_ADDRESS 0x60021396 /end MEASUREMENT
/begin MEASUREMENT DINH_stFId.FId_CcsPwrLineComChpTRplVal "" UWORD DFC_OneToOne 1 100 0.00 65535.00 FORMAT "%8.2" ECU_ADDRESS 0x60021398 /end MEASUREMENT
/begin MEASUREMENT DINH_stFId.FId_CcsPwrLineComChpTSSpMon "" UWORD DFC_OneToOne 1 100 0.00 65535.00 FORMAT "%8.2" ECU_ADDRESS 0x6002139A /end MEASUREMENT
/begin MEASUREMENT DINH_stFId.FId_CcsPwrLineComChpTTmpErrCnt "" UWORD DFC_OneToOne 1 100 0.00 65535.00 FORMAT "%8.2" ECU_ADDRESS 0x6002139C /end MEASUREMENT
/begin MEASUREMENT DINH_stFId.FId_ChrgnUnplRqrd "" UWORD DFC_OneToOne 1 100 0.00 65535.00 FORMAT "%8.2" ECU_ADDRESS 0x600213B2 /end MEASUREMENT
/begin FUNCTION CbnHeatgHeatr_Vd "2.6.0     Virtual driver for heater in cabin heating circuit"
 /begin DEF_CHARACTERISTIC CbnHeatgHeatr_ATS_ATS.LimitTypeMsk_C CbnHeatgHeatr_ATS_ATS.CnvNorm_C CbnHeatgHeatr_ATS_ATS.LowLim_C CbnHeatgHeatr_ATS_ATS.UpLim_C CbnHeatgHeatr_ATS_ATS.CnvFac_C CbnHeatgHeatr_ATS_ATS.CnvOfs_C CbnHeatgHeatr_ATS_ATS.DfltVal_C CbnHeatgHeatr_cntrOperReplcmtVal_C CbnHeatgHeatr_cntrReplcmtVal_C CbnHeatgHeatr_cntrRlyThd_C CbnHeatgHeatr_cntrValBreak_T CbnHeatgHeatr_cntrValMak_T CbnHeatgHeatr_iMax_C CbnHeatgHeatr_maskHvBattUActSq_C CbnHeatgHeatr_nrMaxManTestImp_C CbnHeatgHeatr_nrTestMaxHs_C CbnHeatgHeatr_nrTestMaxLs_C CbnHeatgHeatr_pwrHeatrOnHi_C CbnHeatgHeatr_pwrHeatrOnLo_C CbnHeatgHeatr_pwrHeatrOn_C CbnHeatgHeatr_rMeasdConsol_C CbnHeatgHeatr_stPsDiagDi_C CbnHeatgHeatr_stPsDi_C CbnHeatgHeatr_tiBtwTestImp_C CbnHeatgHeatr_tiBtwTestOtHs_C CbnHeatgHeatr_tiBtwTestOtLs_C CbnHeatgHeatr_tiBtwTestScbHs_C CbnHeatgHeatr_tiBtwTestScbLs_C CbnHeatgHeatr_tiWaitMinOffDly_C CbnHeatgHeatr_tiWaitMinOnDly_C CbnHeatgHeatr_uHvBattUActRepl_C DDRC_DurDeb.CbnHeatgHeatr_tiRlyOpendDebOk_C DDRC_DurDeb.CbnHeatgHeatr_tiRlyOpendDebDef_C DDRC_DurDeb.CbnHeatgHeatr_tiRlyWlddDebOk_C DDRC_DurDeb.CbnHeatgHeatr_tiRlyWlddDebDef_C DDRC_DurDeb.CbnHeatgHeatr_tiHsScbDebOk_C DDRC_DurDeb.CbnHeatgHeatr_tiHsScbDebDef_C DDRC_DurDeb.CbnHeatgHeatr_tiHsScgDebOk_C DDRC_DurDeb.CbnHeatgHeatr_tiHsScgDebDef_C DDRC_DurDeb.CbnHeatgHeatr_tiLsOlDebOk_C DDRC_DurDeb.CbnHeatgHeatr_tiLsOlDebDef_C DDRC_DurDeb.CbnHeatgHeatr_tiLsScbDebOk_C DDRC_DurDeb.CbnHeatgHeatr_tiLsScbDebDef_C DDRC_DurDeb.CbnHeatgHeatr_tiLsScgDebOk_C DDRC_DurDeb.CbnHeatgHeatr_tiLsScgDebDef_C DDRC_DurDeb.CbnHeatgHeatr_tiUnUsedDebOk_C DDRC_DurDeb.CbnHeatgHeatr_tiUnUsedDebDef_C DDRC_RatDeb.CbnHeatgHeatr_tiRlyOpendUDRat_C DDRC_RatDeb.CbnHeatgHeatr_tiRlyWlddUDRat_C DFC_CtlMsk2.DFC_CbnHeatgHeatrHsScb_C DFC_CtlMsk2.DFC_CbnHeatgHeatrHsScg_C DFC_CtlMsk2.DFC_CbnHeatgHeatrLsOl_C DFC_CtlMsk2.DFC_CbnHeatgHeatrLsScb_C DFC_CtlMsk2.DFC_CbnHeatgHeatrLsScg_C DFC_CtlMsk2.DFC_CbnHeatgHeatrUnUsed_C DFC_CtlMsk2.DFC_CbnHeatgHeatrRlyOpend_C DFC_CtlMsk2.DFC_CbnHeatgHeatrRlyWldd_C DFC_CtlMsk2.DFC_CbnHeatrRlyLfLoWarn_C DFC_DisblMsk2.DFC_CbnHeatgHeatrHsScb_C DFC_DisblMsk2.DFC_CbnHeatgHeatrHsScg_C DFC_DisblMsk2.DFC_CbnHeatgHeatrLsOl_C DFC_DisblMsk2.DFC_CbnHeatgHeatrLsScb_C DFC_DisblMsk2.DFC_CbnHeatgHeatrLsScg_C DFC_DisblMsk2.DFC_CbnHeatgHeatrUnUsed_C DFC_DisblMsk2.DFC_CbnHeatgHeatrRlyOpend_C DFC_DisblMsk2.DFC_CbnHeatgHeatrRlyWldd_C DFC_DisblMsk2.DFC_CbnHeatrRlyLfLoWarn_C /end DEF_CHARACTERISTIC
 /begin IN_MEASUREMENT DevLib_stPwrStgEnaCond HeatrRly1_st HvacPtc_pwrDes HvBatt_uActMeasd HvBatt_uActMeasd_Sq HvGrid_pwrMaxPtc VehCoorn_st /end IN_MEASUREMENT
 /begin OUT_MEASUREMENT CabAirHt_iConsol CabAirHt_pwrConsol CabAirHt_pwrLoadMngtMaxPred CabAirHt_stEem CabAirHt_uConsol CbnHeatgHeatr_cntrCntctOper CbnHeatgHeatr_cntrRlyLf CbnHeatgHeatr_flgHsActr CbnHeatgHeatr_flgLsActr DDRC_St.DFC_CbnHeatgHeatrHsScb DDRC_St.DFC_CbnHeatgHeatrHsScg DDRC_St.DFC_CbnHeatgHeatrLsOl DDRC_St.DFC_CbnHeatgHeatrLsScb DDRC_St.DFC_CbnHeatgHeatrLsScg DDRC_St.DFC_CbnHeatgHeatrUnUsed DDRC_St.DFC_CbnHeatgHeatrRlyOpend DDRC_St.DFC_CbnHeatgHeatrRlyWldd DFC_st.DFC_CbnHeatgHeatrHsScb DFC_st.DFC_CbnHeatgHeatrHsScg DFC_st.DFC_CbnHeatgHeatrLsOl DFC_st.DFC_CbnHeatgHeatrLsScb DFC_st.DFC_CbnHeatgHeatrLsScg DFC_st.DFC_CbnHeatgHeatrUnUsed DFC_st.DFC_CbnHeatgHeatrRlyOpend DFC_st.DFC_CbnHeatgHeatrRlyWldd DFC_st.DFC_CbnHeatrRlyLfLoWarn DINH_nrActvInhReas.FId_CbnHeatgHeatrPsFlt DINH_nrActvInhReas.FId_CbnHeatgHeatrRlyDiagEnad DINH_stFId.FId_CbnHeatgHeatrPsFlt DINH_stFId.FId_CbnHeatgHeatrRlyDiagEnad /end OUT_MEASUREMENT
 /begin LOC_MEASUREMENT CabAirHt_iConsolOld CbnHeatgHeatr_cntCntrRstTrig CbnHeatgHeatr_cntrRlyLfHiResl CbnHeatgHeatr_DigOutPrmStructHs.tiBtwTstSCB_C CbnHeatgHeatr_DigOutPrmStructHs.tiBtwTstOT_C CbnHeatgHeatr_DigOutPrmStructHs.numTstMax_C CbnHeatgHeatr_DigOutPrmStructLs.tiBtwTstSCB_C CbnHeatgHeatr_DigOutPrmStructLs.tiBtwTstOT_C CbnHeatgHeatr_DigOutPrmStructLs.numTstMax_C CbnHeatgHeatr_DigOutStatStructHs.tmrTBtwTst CbnHeatgHeatr_DigOutStatStructHs.ctTstDne CbnHeatgHeatr_DigOutStatStructHs.stPrevTstRslt CbnHeatgHeatr_DigOutStatStructLs.tmrTBtwTst CbnHeatgHeatr_DigOutStatStructLs.ctTstDne CbnHeatgHeatr_DigOutStatStructLs.stPrevTstRslt CbnHeatgHeatr_flgAvsRstDone CbnHeatgHeatr_flgDiagOnTranRls CbnHeatgHeatr_flgHeatrOn CbnHeatgHeatr_flgPsActvnDisad CbnHeatgHeatr_flgPsDiagDisad CbnHeatgHeatr_flgPsDisad CbnHeatgHeatr_flgRlyLfLoWarn CbnHeatgHeatr_flgScbLocnActv CbnHeatgHeatr_flgScgErr CbnHeatgHeatr_flgScgLocnActv CbnHeatgHeatr_flgTestImpLsScb CbnHeatgHeatr_stErr CbnHeatgHeatr_stHeatrDes CbnHeatgHeatr_stHsErrInfo CbnHeatgHeatr_stLsErrInfo CbnHeatgHeatr_stReq CbnHeatgHeatr_tiStTmr /end LOC_MEASUREMENT
 FUNCTION_VERSION "2.6.0" /end FUNCTION
/begin FUNCTION CbnHeatgSwt_DELib_GlbAdprOutp "1.1.0" /begin IN_MEASUREMENT CbnHeatgSwt_stActSens_f CbnHeatgSwt_stAct_f /end IN_MEASUREMENT /begin OUT_MEASUREMENT CbnHeatgSwt_stAct CbnHeatgSwt_stActSens /end OUT_MEASUREMENT FUNCTION_VERSION "1.1.0" /end FUNCTION
/begin FUNCTION CbnHeatgSwt_DELib_StdSensDd "10.2.0"
 /begin REF_CHARACTERISTIC CbnHeatgSwt_DigSensCal.tiDebPos_C CbnHeatgSwt_DigSensCal.tiDebNeg_C /end REF_CHARACTERISTIC
 /begin IN_MEASUREMENT CbnHeatgSwt_stRaw CbnHeatgSwt_swtConfStdSens2C CbnHeatgSwt_swtConfStdSensC CbnHeatgSwt_swtConfStdSensSwVersC DELib_idxArrSnsr DELib_xArrSnsr /end IN_MEASUREMENT
 /begin OUT_MEASUREMENT CbnHeatgSwt_FirCalc.cntrAvrgZr CbnHeatgSwt_FirCalc.flgRdDne CbnHeatgSwt_FirCalc.uRawAvrg CbnHeatgSwt_FirCalc.uRawFir CbnHeatgSwt_stActSensCpl CbnHeatgSwt_stActSensUnFltd CbnHeatgSwt_stActSens_f CbnHeatgSwt_stSnsrDdCalc CbnHeatgSwt_swtSensPres /end OUT_MEASUREMENT
 /begin LOC_MEASUREMENT CbnHeatgSwt_DDstSnsrState_mp /end LOC_MEASUREMENT
 FUNCTION_VERSION "10.2.0" /end FUNCTION
/begin FUNCTION CbnHeatgSwt_DELib_StdSensDdRead "10.4.0"
 /begin IN_MEASUREMENT CbnHeatgSwt_FirCalc.cntrAvrgZr CbnHeatgSwt_FirCalc.flgRdDne CbnHeatgSwt_FirCalc.uRawAvrg CbnHeatgSwt_FirCalc.uRawFir CbnHeatgSwt_swtConfStdSens2C CbnHeatgSwt_swtConfStdSensC /end IN_MEASUREMENT
 FUNCTION_VERSION "10.4.0" /end FUNCTION
/begin FUNCTION CbnHeatgSwt_DELib_StdSensDdSENTSlowRead "3.2.0"
 /begin IN_MEASUREMENT CbnHeatgSwt_swtConfStdSens2C CbnHeatgSwt_swtConfStdSensC CbnHeatgSwt_swtConfStdSensSwVersC /end IN_MEASUREMENT
 FUNCTION_VERSION "3.2.0" /end FUNCTION
/begin FUNCTION CbnHeatgSwt_DELib_StdSensExtDiag "8.1.0"
 /begin IN_MEASUREMENT CbnHeatgSwt_swtConfStdSensC CbnHeatgSwt_swtConfStdSensSwVersC DELib_idxArrSnsr DELib_xArrSnsr DSM_TripChgFinshd SyC_stSub /end IN_MEASUREMENT
 FUNCTION_VERSION "8.1.0" /end FUNCTION
/begin FUNCTION CbnHeatgSwt_DELib_StdSensInin "8.2.0"
 /begin DEF_CHARACTERISTIC CbnHeatgSwt_swtConfStdSens2_C CbnHeatgSwt_swtConfStdSensSwVers162_C CbnHeatgSwt_swtConfStdSens_C /end DEF_CHARACTERISTIC
 /begin OUT_MEASUREMENT CbnHeatgSwt_swtConfStdSens2C CbnHeatgSwt_swtConfStdSensC CbnHeatgSwt_swtConfStdSensSwVersC CbnHeatgSwt_swtSensMode /end OUT_MEASUREMENT
 FUNCTION_VERSION "8.2.0" /end FUNCTION
/begin FUNCTION CbnHeatgSwt_DELib_StdSensVd "11.0.0"
 /begin DEF_CHARACTERISTIC CbnHeatgSwt_DigSensCal.tiDebPos_C CbnHeatgSwt_DigSensCal.tiDebNeg_C CbnHeatgSwt_dstActGradLim_f_C CbnHeatgSwt_RmpSlp_f.Pos_C CbnHeatgSwt_RmpSlp_f.Neg_C CbnHeatgSwt_stActDflVal_f_C CbnHeatgSwt_stActHiLimit_f_C CbnHeatgSwt_stActLoLimit_f_C CbnHeatgSwt_tiPT1_f_C CbnHeatgSwt_TransStg_f.Dfl_r32_C CbnHeatgSwt_TransStg_f.stSensId_C /end DEF_CHARACTERISTIC
 /begin IN_MEASUREMENT CbnHeatgSwt_stActSens_f CbnHeatgSwt_stSnsrDdCalc CbnHeatgSwt_swtConfStdSensC CbnHeatgSwt_swtConfStdSensSwVersC /end IN_MEASUREMENT
 /begin OUT_MEASUREMENT CbnHeatgSwt_stActUnFlt_f CbnHeatgSwt_stAct_f CbnHeatgSwt_stAct_f_Sq CbnHeatgSwt_stRaw DINH_nrActvInhReas.FId_CbnHeatgSwtFrzVal DINH_nrActvInhReas.FId_CbnHeatgSwtRplVal DINH_stFId.FId_CbnHeatgSwtFrzVal DINH_stFId.FId_CbnHeatgSwtRplVal /end OUT_MEASUREMENT
 /begin LOC_MEASUREMENT CbnHeatgSwt_stActSensGradLim_f_mp /end LOC_MEASUREMENT
 FUNCTION_VERSION "11.0.0" /end FUNCTION
/begin FUNCTION CbnHeatgSwt_DELib_StdSensVdMon "9.2.0"
 /begin DEF_CHARACTERISTIC CbnHeatgSwt_numStdSens_C CbnHeatgSwt_numTempErrDef_C CbnHeatgSwt_tiTempErrOk_C DFC_CtlMsk2.DFC_CbnHeatgSwtTmpErr_C DFC_DisblMsk2.DFC_CbnHeatgSwtTmpErr_C /end DEF_CHARACTERISTIC
 /begin IN_MEASUREMENT CbnHeatgSwt_stSnsrDdCalc CbnHeatgSwt_swtConfStdSensC CbnHeatgSwt_swtConfStdSensSwVersC DELib_idxArrSnsr DELib_xArrSnsr DSM_TripChgFinshd /end IN_MEASUREMENT
 /begin OUT_MEASUREMENT CbnHeatgSwt_stSnsrActv DFC_st.DFC_CbnHeatgSwtTmpErr DINH_nrActvInhReas.FId_CbnHeatgSwtTmpErrCnt DINH_stFId.FId_CbnHeatgSwtTmpErrCnt /end OUT_MEASUREMENT
 /begin LOC_MEASUREMENT CbnHeatgSwt_stMonStdSens /end LOC_MEASUREMENT
 FUNCTION_VERSION "9.2.0" /end FUNCTION
/begin FUNCTION CcsPwrLineChpRst_DELib_ActrCoorrSimple "1.3.0"
 /begin DEF_CHARACTERISTIC CcsPwrLineChpRst_stActrDis_C CcsPwrLineChpRst_swtConfActrCoorrSimple_C /end DEF_CHARACTERISTIC
 /begin IN_MEASUREMENT CcsPwrLineChpRst_rDesVal CcsPwrLineChpRst_stMonActrElecDrvrSimple DevLib_stPwrStgEnaCond /end IN_MEASUREMENT
 /begin OUT_MEASUREMENT CcsPwrLineChpRst_r CcsPwrLineChpRst_stMonActrCoorrSimple DINH_nrActvInhReas.FId_CcsPwrLineChpRstOff DINH_stFId.FId_CcsPwrLineChpRstOff /end OUT_MEASUREMENT
 /begin LOC_MEASUREMENT CcsPwrLineChpRst_swtConfActrCoorrSimpleC /end LOC_MEASUREMENT
 FUNCTION_VERSION "1.3.0" /end FUNCTION
/begin FUNCTION CcsPwrLineChpRst_DELib_ActrDevDrvrSimple "1.1.0" /begin IN_MEASUREMENT CcsPwrLineChpRst_rActr /end IN_MEASUREMENT /begin OUT_MEASUREMENT CcsPwrLineChpRst_rDesVal /end OUT_MEASUREMENT FUNCTION_VERSION "1.1.0" /end FUNCTION
/begin FUNCTION CcsPwrLineChpRst_DELib_ActrElecDrvrSimple "1.4.0"
 /begin DEF_CHARACTERISTIC CcsPwrLineChpRst_rCnv_CUR CcsPwrLineChpRst_stPwrStgDis_C CcsPwrLineChpRst_swtConfActrElecDrvrSimple_C /end DEF_CHARACTERISTIC
 /begin IN_MEASUREMENT CcsPwrLineChpRst_rDtyCyc CcsPwrLineChpRst_stMonActrCoorrSimple DevLib_stPwrStgEnaCond /end IN_MEASUREMENT
 /begin OUT_MEASUREMENT CcsPwrLineChpRst_rActr CcsPwrLineChpRst_stMonActrElecDrvrSimple DINH_nrActvInhReas.FId_CcsPwrLineChpRstPsOff DINH_stFId.FId_CcsPwrLineChpRstPsOff /end OUT_MEASUREMENT
 /begin LOC_MEASUREMENT CcsPwrLineChpRst_swtConfActrElecDrvrSimpleC /end LOC_MEASUREMENT
 FUNCTION_VERSION "1.4.0" /end FUNCTION
/begin FUNCTION CcsPwrLineChpRst_DELib_ActrElecMonSimple "1.4.0"
 /begin DEF_CHARACTERISTIC CcsPwrLineChpRst_psDiagDigOut.nrTstPls_C CcsPwrLineChpRst_psDiagDigOut.tiBtwElecFlt_C CcsPwrLineChpRst_psDiagDigOut.tiBtwOTFlt_C CcsPwrLineChpRst_stPwrStgDiaDis_C CcsPwrLineChpRst_swtConfActrElecMonSimple_C DDRC_DurDeb.CcsPwrLineChpRst_tiMonDFCDebOk_C DDRC_DurDeb.CcsPwrLineChpRst_tiMonDFCDebDef_C DDRC_RatDeb.CcsPwrLineChpRst_tiMonDFCUDRat_C DFC_CtlMsk2.DFC_CcsPwrLineChpRstOL_C DFC_CtlMsk2.DFC_CcsPwrLineChpRstOvrTemp_C DFC_CtlMsk2.DFC_CcsPwrLineChpRstSCB_C DFC_CtlMsk2.DFC_CcsPwrLineChpRstSCG_C DFC_DisblMsk2.DFC_CcsPwrLineChpRstOL_C DFC_DisblMsk2.DFC_CcsPwrLineChpRstOvrTemp_C DFC_DisblMsk2.DFC_CcsPwrLineChpRstSCB_C DFC_DisblMsk2.DFC_CcsPwrLineChpRstSCG_C /end DEF_CHARACTERISTIC
 /begin IN_MEASUREMENT CcsPwrLineChpRst_stMonActrCoorrSimple DevLib_stPwrStgEnaCond /end IN_MEASUREMENT
 /begin OUT_MEASUREMENT DDRC_St.DFC_CcsPwrLineChpRstOL DDRC_St.DFC_CcsPwrLineChpRstOvrTemp DDRC_St.DFC_CcsPwrLineChpRstSCB DDRC_St.DFC_CcsPwrLineChpRstSCG DFC_st.DFC_CcsPwrLineChpRstOL DFC_st.DFC_CcsPwrLineChpRstOvrTemp DFC_st.DFC_CcsPwrLineChpRstSCB DFC_st.DFC_CcsPwrLineChpRstSCG DINH_nrActvInhReas.FId_CcsPwrLineChpRstMonOff DINH_stFId.FId_CcsPwrLineChpRstMonOff /end OUT_MEASUREMENT
 /begin LOC_MEASUREMENT CcsPwrLineChpRst_swtConfActrElecMonSimpleC /end LOC_MEASUREMENT
 FUNCTION_VERSION "1.4.0" /end FUNCTION
/begin FUNCTION CcsPwrLineChpRst_DELib_ActrHldILimnSimple "1.3.0" FUNCTION_VERSION "1.3.0" /end FUNCTION
/begin FUNCTION CcsPwrLineChpRst_DELib_ActrPsDrvrSimple "1.5.0" /begin DEF_CHARACTERISTIC CcsPwrLineChpRst_swtConfActrPsDrvrSimple_C /end DEF_CHARACTERISTIC /begin IN_MEASUREMENT CcsPwrLineChpRst_stMonActrElecDrvrSimple /end IN_MEASUREMENT /begin OUT_MEASUREMENT CcsPwrLineChpRst_rDtyCyc CcsPwrLineChpRst_rPs /end OUT_MEASUREMENT /begin LOC_MEASUREMENT CcsPwrLineChpRst_swtConfActrPsDrvrSimpleC /end LOC_MEASUREMENT FUNCTION_VERSION "1.5.0" /end FUNCTION
/begin FUNCTION CcsPwrLineChpRst_DELib_ActrSnsrSimple "1.4.0" /begin DEF_CHARACTERISTIC CcsPwrLineChpRst_tiPt1Mdl_C /end DEF_CHARACTERISTIC
 /begin IN_MEASUREMENT CcsPwrLineChpRst_rDesVal CcsPwrLineChpRst_stMonActrElecDrvrSimple /end IN_MEASUREMENT
 /begin OUT_MEASUREMENT CcsPwrLineChpRst_rAct CcsPwrLineChpRst_rAct_Sq DINH_nrActvInhReas.FId_CcsPwrLineChpRstSnsr DINH_stFId.FId_CcsPwrLineChpRstSnsr /end OUT_MEASUREMENT
 FUNCTION_VERSION "1.4.0" /end FUNCTION
/begin FUNCTION CcsPwrLineChpRst_DELib_SimpleActr "5.8.0" FUNCTION_VERSION "5.8.0" /end FUNCTION
/begin FUNCTION CcsPwrLineChpRst_DELib_VrntCodSimple "1.3.0" FUNCTION_VERSION "1.3.0" /end FUNCTION
/begin FUNCTION CcsPwrLineChpVccEna_DELib_ActrCoorrSimple "1.3.0"
 /begin DEF_CHARACTERISTIC CcsPwrLineChpVccEna_stActrDis_C CcsPwrLineChpVccEna_swtConfActrCoorrSimple_C /end DEF_CHARACTERISTIC
 /begin IN_MEASUREMENT CcsPwrLineChpVccEna_rDesVal CcsPwrLineChpVccEna_stMonActrElecDrvrSimple DevLib_stPwrStgEnaCond /end IN_MEASUREMENT
 /begin OUT_MEASUREMENT CcsPwrLineChpVccEna_r CcsPwrLineChpVccEna_stMonActrCoorrSimple DINH_nrActvInhReas.FId_CcsPwrLineChpVccEnaOff DINH_stFId.FId_CcsPwrLineChpVccEnaOff /end OUT_MEASUREMENT
 /begin LOC_MEASUREMENT CcsPwrLineChpVccEna_swtConfActrCoorrSimpleC /end LOC_MEASUREMENT
 FUNCTION_VERSION "1.3.0" /end FUNCTION
/begin FUNCTION CcsPwrLineChpVccEna_DELib_ActrDevDrvrSimple "1.1.0" /begin IN_MEASUREMENT CcsPwrLineChpVccEna_rActr /end IN_MEASUREMENT /begin OUT_MEASUREMENT CcsPwrLineChpVccEna_rDesVal /end OUT_MEASUREMENT FUNCTION_VERSION "1.1.0" /end FUNCTION
/begin FUNCTION CcsPwrLineChpVccEna_DELib_ActrElecDrvrSimple "1.4.0"
 /begin DEF_CHARACTERISTIC CcsPwrLineChpVccEna_rCnv_CUR CcsPwrLineChpVccEna_stPwrStgDis_C CcsPwrLineChpVccEna_swtConfActrElecDrvrSimple_C /end DEF_CHARACTERISTIC
 /begin IN_MEASUREMENT CcsPwrLineChpVccEna_rDtyCyc CcsPwrLineChpVccEna_stMonActrCoorrSimple DevLib_stPwrStgEnaCond /end IN_MEASUREMENT
 /begin OUT_MEASUREMENT CcsPwrLineChpVccEna_rActr CcsPwrLineChpVccEna_stMonActrElecDrvrSimple DINH_nrActvInhReas.FId_CcsPwrLineChpVccEnaPsOff DINH_stFId.FId_CcsPwrLineChpVccEnaPsOff /end OUT_MEASUREMENT
 /begin LOC_MEASUREMENT CcsPwrLineChpVccEna_swtConfActrElecDrvrSimpleC /end LOC_MEASUREMENT
 FUNCTION_VERSION "1.4.0" /end FUNCTION
/begin FUNCTION CcsPwrLineChpVccEna_DELib_ActrElecMonSimple "1.4.0"
 /begin DEF_CHARACTERISTIC CcsPwrLineChpVccEna_psDiagDigOut.nrTstPls_C CcsPwrLineChpVccEna_psDiagDigOut.tiBtwElecFlt_C CcsPwrLineChpVccEna_psDiagDigOut.tiBtwOTFlt_C CcsPwrLineChpVccEna_stPwrStgDiaDis_C CcsPwrLineChpVccEna_swtConfActrElecMonSimple_C DDRC_DurDeb.CcsPwrLineChpVccEna_tiMonDFCDebOk_C DDRC_DurDeb.CcsPwrLineChpVccEna_tiMonDFCDebDef_C DDRC_RatDeb.CcsPwrLineChpVccEna_tiMonDFCUDRat_C DFC_CtlMsk2.DFC_CcsPwrLineChpVccEnaOL_C DFC_CtlMsk2.DFC_CcsPwrLineChpVccEnaOvrTemp_C DFC_CtlMsk2.DFC_CcsPwrLineChpVccEnaSCB_C DFC_CtlMsk2.DFC_CcsPwrLineChpVccEnaSCG_C DFC_DisblMsk2.DFC_CcsPwrLineChpVccEnaOL_C DFC_DisblMsk2.DFC_CcsPwrLineChpVccEnaOvrTemp_C DFC_DisblMsk2.DFC_CcsPwrLineChpVccEnaSCB_C DFC_DisblMsk2.DFC_CcsPwrLineChpVccEnaSCG_C /end DEF_CHARACTERISTIC
 /begin IN_MEASUREMENT CcsPwrLineChpVccEna_stMonActrCoorrSimple DevLib_stPwrStgEnaCond /end IN_MEASUREMENT
 /begin OUT_MEASUREMENT DDRC_St.DFC_CcsPwrLineChpVccEnaOL DDRC_St.DFC_CcsPwrLineChpVccEnaOvrTemp DDRC_St.DFC_CcsPwrLineChpVccEnaSCB DDRC_St.DFC_CcsPwrLineChpVccEnaSCG DFC_st.DFC_CcsPwrLineChpVccEnaOL DFC_st.DFC_CcsPwrLineChpVccEnaOvrTemp DFC_st.DFC_CcsPwrLineChpVccEnaSCB DFC_st.DFC_CcsPwrLineChpVccEnaSCG DINH_nrActvInhReas.FId_CcsPwrLineChpVccEnaMonOff DINH_stFId.FId_CcsPwrLineChpVccEnaMonOff /end OUT_MEASUREMENT
 /begin LOC_MEASUREMENT CcsPwrLineChpVccEna_swtConfActrElecMonSimpleC /end LOC_MEASUREMENT
 FUNCTION_VERSION "1.4.0" /end FUNCTION
/begin FUNCTION CcsPwrLineChpVccEna_DELib_ActrHldILimnSimple "1.3.0" FUNCTION_VERSION "1.3.0" /end FUNCTION
/begin FUNCTION CcsPwrLineChpVccEna_DELib_ActrPsDrvrSimple "1.5.0" /begin DEF_CHARACTERISTIC CcsPwrLineChpVccEna_swtConfActrPsDrvrSimple_C /end DEF_CHARACTERISTIC /begin IN_MEASUREMENT CcsPwrLineChpVccEna_stMonActrElecDrvrSimple /end IN_MEASUREMENT /begin OUT_MEASUREMENT CcsPwrLineChpVccEna_rDtyCyc CcsPwrLineChpVccEna_rPs /end OUT_MEASUREMENT /begin LOC_MEASUREMENT CcsPwrLineChpVccEna_swtConfActrPsDrvrSimpleC /end LOC_MEASUREMENT FUNCTION_VERSION "1.5.0" /end FUNCTION
/begin FUNCTION CcsPwrLineChpVccEna_DELib_ActrSnsrSimple "1.4.0" /begin DEF_CHARACTERISTIC CcsPwrLineChpVccEna_tiPt1Mdl_C /end DEF_CHARACTERISTIC
 /begin IN_MEASUREMENT CcsPwrLineChpVccEna_rDesVal CcsPwrLineChpVccEna_stMonActrElecDrvrSimple /end IN_MEASUREMENT
 /begin OUT_MEASUREMENT CcsPwrLineChpVccEna_rAct CcsPwrLineChpVccEna_rAct_Sq DINH_nrActvInhReas.FId_CcsPwrLineChpVccEnaSnsr DINH_stFId.FId_CcsPwrLineChpVccEnaSnsr /end OUT_MEASUREMENT
 FUNCTION_VERSION "1.4.0" /end FUNCTION
/begin FUNCTION CcsPwrLineChpVccEna_DELib_SimpleActr "5.8.0" FUNCTION_VERSION "5.8.0" /end FUNCTION
/begin FUNCTION CcsPwrLineChpVccEna_DELib_VrntCodSimple "1.3.0" FUNCTION_VERSION "1.3.0" /end FUNCTION
/begin FUNCTION CcsPwrLineChpVcc_DELib_StdSensDd "10.2.0"
 /begin DEF_CHARACTERISTIC CcsPwrLineChpVcc_ADCCal.numSRCTempSel_C CcsPwrLineChpVcc_ADCCal.tiSRCMaxDebOK_C CcsPwrLineChpVcc_ADCCal.uSRCMax_C CcsPwrLineChpVcc_ADCCal.uSRCMin_C CcsPwrLineChpVcc_ADCCal.uSRCOpn_C CcsPwrLineChpVcc_ADCSensTransf_f_CUR CcsPwrLineChpVcc_tiSRCMaxDefDeb_CUR DDRC_DurDeb.CcsPwrLineChpVcc_tiSRCMinDebOk_C DDRC_DurDeb.CcsPwrLineChpVcc_tiSRCMinDebDef_C DDRC_DurDeb.CcsPwrLineChpVcc_tiSRCOpnDebOk_C DDRC_DurDeb.CcsPwrLineChpVcc_tiSRCOpnDebDef_C DDRC_RatDeb.CcsPwrLineChpVcc_tiSRCMinUDRat_C DDRC_RatDeb.CcsPwrLineChpVcc_tiSRCOpnUDRat_C DFC_CtlMsk2.DFC_CcsPwrLineChpVccSRCMin_C DFC_CtlMsk2.DFC_CcsPwrLineChpVccSRCOpn_C DFC_CtlMsk2.DFC_CcsPwrLineChpVccSRCMax_C DFC_DisblMsk2.DFC_CcsPwrLineChpVccSRCMin_C DFC_DisblMsk2.DFC_CcsPwrLineChpVccSRCOpn_C DFC_DisblMsk2.DFC_CcsPwrLineChpVccSRCMax_C /end DEF_CHARACTERISTIC
 /begin REF_CHARACTERISTIC CcsPwrLineChpVcc_tiPT1Fil_C CcsPwrLineChpVcc_TransStg_f.Dfl_r32_C CcsPwrLineChpVcc_TransStg_f.stSensId_C /end REF_CHARACTERISTIC
 /begin IN_MEASUREMENT CcsPwrLineChpVcc_FirRead.cntr CcsPwrLineChpVcc_FirRead.flgFirstRun CcsPwrLineChpVcc_FirRead.idxArr CcsPwrLineChpVcc_FirRead.uSum CcsPwrLineChpVcc_stSnsrDdReadCalc CcsPwrLineChpVcc_swtConfStdSens2C CcsPwrLineChpVcc_swtConfStdSensC CcsPwrLineChpVcc_swtConfStdSensSwVersC CcsPwrLineChpVcc_uRawPT1FltdSens CcsPwrLineChpVcc_uRawUnFltd DELib_idxArrSnsr DELib_xArrSnsr /end IN_MEASUREMENT
 /begin OUT_MEASUREMENT CcsPwrLineChpVcc_FirCalc.cntrAvrgZr CcsPwrLineChpVcc_FirCalc.flgRdDne CcsPwrLineChpVcc_FirCalc.uRawAvrg CcsPwrLineChpVcc_FirCalc.uRawFir CcsPwrLineChpVcc_stSnsrDdCalc CcsPwrLineChpVcc_swtSensPres CcsPwrLineChpVcc_tiSRCMaxDefDeb CcsPwrLineChpVcc_uRaw CcsPwrLineChpVcc_uRaw_f CcsPwrLineChpVcc_uSensCpl CcsPwrLineChpVcc_uSensUnFltd CcsPwrLineChpVcc_uSens_f DDRC_St.DFC_CcsPwrLineChpVccSRCMin DDRC_St.DFC_CcsPwrLineChpVccSRCOpn DFC_st.DFC_CcsPwrLineChpVccSRCMin DFC_st.DFC_CcsPwrLineChpVccSRCOpn DFC_st.DFC_CcsPwrLineChpVccSRCMax DINH_nrActvInhReas.FId_CcsPwrLineChpVccEnhdSRCMax DINH_nrActvInhReas.FId_CcsPwrLineChpVccSSpMon DINH_stFId.FId_CcsPwrLineChpVccEnhdSRCMax DINH_stFId.FId_CcsPwrLineChpVccSSpMon /end OUT_MEASUREMENT
 /begin LOC_MEASUREMENT CcsPwrLineChpVcc_DDstSnsrState_mp CcsPwrLineChpVcc_tRefSnsr_mp CcsPwrLineChpVcc_tSensPT1Fltd_mp /end LOC_MEASUREMENT
 FUNCTION_VERSION "10.2.0" /end FUNCTION
/begin FUNCTION CcsPwrLineChpVcc_DELib_StdSensDdRead "10.4.0" /begin DEF_CHARACTERISTIC CcsPwrLineChpVcc_tiPT1Fil_C /end DEF_CHARACTERISTIC
 /begin IN_MEASUREMENT CcsPwrLineChpVcc_FirCalc.cntrAvrgZr CcsPwrLineChpVcc_FirCalc.flgRdDne CcsPwrLineChpVcc_FirCalc.uRawAvrg CcsPwrLineChpVcc_FirCalc.uRawFir CcsPwrLineChpVcc_swtConfStdSens2C CcsPwrLineChpVcc_swtConfStdSensC /end IN_MEASUREMENT
 /begin OUT_MEASUREMENT CcsPwrLineChpVcc_FirRead.cntr CcsPwrLineChpVcc_FirRead.flgFirstRun CcsPwrLineChpVcc_FirRead.idxArr CcsPwrLineChpVcc_FirRead.uSum CcsPwrLineChpVcc_stSnsrDdReadCalc CcsPwrLineChpVcc_uRawPT1Fltd CcsPwrLineChpVcc_uRawPT1FltdSens CcsPwrLineChpVcc_uRawUnFltd /end OUT_MEASUREMENT
 FUNCTION_VERSION "10.4.0" /end FUNCTION
/begin FUNCTION CcsPwrLineChpVcc_DELib_StdSensDdSENTSlowRead "3.2.0"
 /begin IN_MEASUREMENT CcsPwrLineChpVcc_swtConfStdSens2C CcsPwrLineChpVcc_swtConfStdSensC CcsPwrLineChpVcc_swtConfStdSensSwVersC /end IN_MEASUREMENT
 FUNCTION_VERSION "3.2.0" /end FUNCTION
/begin FUNCTION CcsPwrLineChpVcc_DELib_StdSensExtDiag "8.1.0"
 /begin IN_MEASUREMENT CcsPwrLineChpVcc_swtConfStdSensC CcsPwrLineChpVcc_swtConfStdSensSwVersC DELib_idxArrSnsr DELib_xArrSnsr DSM_TripChgFinshd SyC_stSub /end IN_MEASUREMENT
 FUNCTION_VERSION "8.1.0" /end FUNCTION
/begin FUNCTION CcsPwrLineChpVcc_DELib_StdSensInin "8.2.0"
 /begin DEF_CHARACTERISTIC CcsPwrLineChpVcc_swtConfStdSens2_C CcsPwrLineChpVcc_swtConfStdSensSwVers162_C CcsPwrLineChpVcc_swtConfStdSens_C /end DEF_CHARACTERISTIC
 /begin REF_CHARACTERISTIC CcsPwrLineChpVcc_tiPT1Fil_C /end REF_CHARACTERISTIC
 /begin OUT_MEASUREMENT CcsPwrLineChpVcc_swtConfStdSens2C CcsPwrLineChpVcc_swtConfStdSensC CcsPwrLineChpVcc_swtConfStdSensSwVersC CcsPwrLineChpVcc_swtSensMode /end OUT_MEASUREMENT
 FUNCTION_VERSION "8.2.0" /end FUNCTION
/begin FUNCTION CcsPwrLineChpVcc_DELib_StdSensVd "11.0.0"
 /begin DEF_CHARACTERISTIC CcsPwrLineChpVcc_DigSensCal.tiDebPos_C CcsPwrLineChpVcc_DigSensCal.tiDebNeg_C CcsPwrLineChpVcc_duGradLim_f_C CcsPwrLineChpVcc_RmpSlp_f.Pos_C CcsPwrLineChpVcc_RmpSlp_f.Neg_C CcsPwrLineChpVcc_tiPT1_f_C CcsPwrLineChpVcc_TransStg_f.Dfl_r32_C CcsPwrLineChpVcc_TransStg_f.stSensId_C CcsPwrLineChpVcc_uDflVal_f_C CcsPwrLineChpVcc_uHiLimit_f_C CcsPwrLineChpVcc_uLoLimit_f_C /end DEF_CHARACTERISTIC
 /begin IN_MEASUREMENT CcsPwrLineChpVcc_stSnsrDdCalc CcsPwrLineChpVcc_swtConfStdSensC CcsPwrLineChpVcc_swtConfStdSensSwVersC CcsPwrLineChpVcc_uSens_f /end IN_MEASUREMENT
 /begin OUT_MEASUREMENT CcsPwrLineChpVcc_uSensOffsCorrd_f CcsPwrLineChpVcc_uUnFlt_f CcsPwrLineChpVcc_u_f CcsPwrLineChpVcc_u_f_Sq DINH_nrActvInhReas.FId_CcsPwrLineChpVccFrzVal DINH_nrActvInhReas.FId_CcsPwrLineChpVccRplVal DINH_stFId.FId_CcsPwrLineChpVccFrzVal DINH_stFId.FId_CcsPwrLineChpVccRplVal /end OUT_MEASUREMENT
 /begin LOC_MEASUREMENT CcsPwrLineChpVcc_uSensGradLim_f_mp /end LOC_MEASUREMENT
 FUNCTION_VERSION "11.0.0" /end FUNCTION
/begin FUNCTION CcsPwrLineChpVcc_DELib_StdSensVdMon "9.2.0"
 /begin DEF_CHARACTERISTIC CcsPwrLineChpVcc_numStdSens_C CcsPwrLineChpVcc_numTempErrDef_C CcsPwrLineChpVcc_numtSel_C CcsPwrLineChpVcc_stEnhPhysSRCRls_MAP CcsPwrLineChpVcc_tiEngOnMin_C CcsPwrLineChpVcc_tiTempErrOk_C CcsPwrLineChpVcc_tSnsrMax_f_C CcsPwrLineChpVcc_tSnsrMin_f_C CcsPwrLineChpVcc_uEnhPhysSRCMax_f_MAP CcsPwrLineChpVcc_uEnhPhysSRCMin_f_MAP DDRC_DurDeb.CcsPwrLineChpVcc_tiPhysRngHiDebOk_C DDRC_DurDeb.CcsPwrLineChpVcc_tiPhysRngHiDebDef_C DDRC_DurDeb.CcsPwrLineChpVcc_tiPhysRngLoDebOk_C DDRC_DurDeb.CcsPwrLineChpVcc_tiPhysRngLoDebDef_C DDRC_RatDeb.CcsPwrLineChpVcc_tiPhysRngHiUDRat_C DDRC_RatDeb.CcsPwrLineChpVcc_tiPhysRngLoUDRat_C DFC_CtlMsk2.DFC_CcsPwrLineChpVccPhysRngHi_C DFC_CtlMsk2.DFC_CcsPwrLineChpVccPhysRngLo_C DFC_CtlMsk2.DFC_CcsPwrLineChpVccTmpErr_C DFC_DisblMsk2.DFC_CcsPwrLineChpVccPhysRngHi_C DFC_DisblMsk2.DFC_CcsPwrLineChpVccPhysRngLo_C DFC_DisblMsk2.DFC_CcsPwrLineChpVccTmpErr_C /end DEF_CHARACTERISTIC
 /begin IN_MEASUREMENT CcsPwrLineChpVcc_stSnsrDdCalc CcsPwrLineChpVcc_swtConfStdSensC CcsPwrLineChpVcc_swtConfStdSensSwVersC CcsPwrLineChpVcc_uSens_f CoEng_tiNormal DELib_idxArrSnsr DELib_xArrSnsr DSM_TripChgFinshd Epm_nEng InjCtl_qSetUnBal /end IN_MEASUREMENT
 /begin OUT_MEASUREMENT CcsPwrLineChpVcc_stSnsrActv DDRC_St.DFC_CcsPwrLineChpVccPhysRngHi DDRC_St.DFC_CcsPwrLineChpVccPhysRngLo DFC_st.DFC_CcsPwrLineChpVccPhysRngHi DFC_st.DFC_CcsPwrLineChpVccPhysRngLo DFC_st.DFC_CcsPwrLineChpVccTmpErr DINH_nrActvInhReas.FId_CcsPwrLineChpVccPhysRng DINH_nrActvInhReas.FId_CcsPwrLineChpVccTmpErrCnt DINH_stFId.FId_CcsPwrLineChpVccPhysRng DINH_stFId.FId_CcsPwrLineChpVccTmpErrCnt /end OUT_MEASUREMENT
 /begin LOC_MEASUREMENT CcsPwrLineChpVcc_stMonStdSens CcsPwrLineChpVcc_uDynThresPhysRngHi_f_mp CcsPwrLineChpVcc_uDynThresPhysRngLo_f_mp /end LOC_MEASUREMENT
 FUNCTION_VERSION "9.2.0" /end FUNCTION
/begin FUNCTION CcsPwrLineComChpT_DELib_StdSensDd "10.2.0"
 /begin DEF_CHARACTERISTIC CcsPwrLineComChpT_ADCCal.numSRCTempSel_C CcsPwrLineComChpT_ADCCal.tiSRCMaxDebOK_C CcsPwrLineComChpT_ADCCal.uSRCMax_C CcsPwrLineComChpT_ADCCal.uSRCMin_C CcsPwrLineComChpT_ADCCal.uSRCOpn_C CcsPwrLineComChpT_ADCSensTransf_f_CUR CcsPwrLineComChpT_tiSRCMaxDefDeb_CUR DDRC_DurDeb.CcsPwrLineComChpT_tiSRCMinDebOk_C DDRC_DurDeb.CcsPwrLineComChpT_tiSRCMinDebDef_C DDRC_DurDeb.CcsPwrLineComChpT_tiSRCOpnDebOk_C DDRC_DurDeb.CcsPwrLineComChpT_tiSRCOpnDebDef_C DDRC_RatDeb.CcsPwrLineComChpT_tiSRCMinUDRat_C DDRC_RatDeb.CcsPwrLineComChpT_tiSRCOpnUDRat_C DFC_CtlMsk2.DFC_CcsPwrLineComChpTSRCMin_C DFC_CtlMsk2.DFC_CcsPwrLineComChpTSRCOpn_C DFC_CtlMsk2.DFC_CcsPwrLineComChpTSRCMax_C DFC_DisblMsk2.DFC_CcsPwrLineComChpTSRCMin_C DFC_DisblMsk2.DFC_CcsPwrLineComChpTSRCOpn_C DFC_DisblMsk2.DFC_CcsPwrLineComChpTSRCMax_C /end DEF_CHARACTERISTIC
 /begin REF_CHARACTERISTIC CcsPwrLineComChpT_tiPT1Fil_C CcsPwrLineComChpT_TransStg_f.Dfl_r32_C CcsPwrLineComChpT_TransStg_f.stSensId_C /end REF_CHARACTERISTIC
 /begin IN_MEASUREMENT CcsPwrLineComChpT_FirRead.cntr CcsPwrLineComChpT_FirRead.flgFirstRun CcsPwrLineComChpT_FirRead.idxArr CcsPwrLineComChpT_FirRead.uSum CcsPwrLineComChpT_stSnsrDdReadCalc CcsPwrLineComChpT_swtConfStdSens2C CcsPwrLineComChpT_swtConfStdSensC CcsPwrLineComChpT_swtConfStdSensSwVersC CcsPwrLineComChpT_uRawPT1FltdSens CcsPwrLineComChpT_uRawUnFltd DELib_idxArrSnsr DELib_xArrSnsr /end IN_MEASUREMENT
 /begin OUT_MEASUREMENT CcsPwrLineComChpT_FirCalc.cntrAvrgZr CcsPwrLineComChpT_FirCalc.flgRdDne CcsPwrLineComChpT_FirCalc.uRawAvrg CcsPwrLineComChpT_FirCalc.uRawFir CcsPwrLineComChpT_stSnsrDdCalc CcsPwrLineComChpT_swtSensPres CcsPwrLineComChpT_tiSRCMaxDefDeb CcsPwrLineComChpT_tSensCpl CcsPwrLineComChpT_tSensUnFltd CcsPwrLineComChpT_tSens_f CcsPwrLineComChpT_uRaw CcsPwrLineComChpT_uRaw_f DDRC_St.DFC_CcsPwrLineComChpTSRCMin DDRC_St.DFC_CcsPwrLineComChpTSRCOpn DFC_st.DFC_CcsPwrLineComChpTSRCMin DFC_st.DFC_CcsPwrLineComChpTSRCOpn DFC_st.DFC_CcsPwrLineComChpTSRCMax DINH_nrActvInhReas.FId_CcsPwrLineComChpTEnhdSRCMax DINH_nrActvInhReas.FId_CcsPwrLineComChpTSSpMon DINH_stFId.FId_CcsPwrLineComChpTEnhdSRCMax DINH_stFId.FId_CcsPwrLineComChpTSSpMon /end OUT_MEASUREMENT
 /begin LOC_MEASUREMENT CcsPwrLineComChpT_DDstSnsrState_mp CcsPwrLineComChpT_tRefSnsr_mp CcsPwrLineComChpT_tSensPT1Fltd_mp /end LOC_MEASUREMENT
 FUNCTION_VERSION "10.2.0" /end FUNCTION
/begin FUNCTION CcsPwrLineComChpT_DELib_StdSensDdRead "10.4.0" /begin DEF_CHARACTERISTIC CcsPwrLineComChpT_tiPT1Fil_C /end DEF_CHARACTERISTIC
 /begin IN_MEASUREMENT CcsPwrLineComChpT_FirCalc.cntrAvrgZr CcsPwrLineComChpT_FirCalc.flgRdDne CcsPwrLineComChpT_FirCalc.uRawAvrg CcsPwrLineComChpT_FirCalc.uRawFir CcsPwrLineComChpT_swtConfStdSens2C CcsPwrLineComChpT_swtConfStdSensC /end IN_MEASUREMENT
 /begin OUT_MEASUREMENT CcsPwrLineComChpT_FirRead.cntr CcsPwrLineComChpT_FirRead.flgFirstRun CcsPwrLineComChpT_FirRead.idxArr CcsPwrLineComChpT_FirRead.uSum CcsPwrLineComChpT_stSnsrDdReadCalc CcsPwrLineComChpT_uRawPT1Fltd CcsPwrLineComChpT_uRawPT1FltdSens CcsPwrLineComChpT_uRawUnFltd /end OUT_MEASUREMENT
 FUNCTION_VERSION "10.4.0" /end FUNCTION
/begin FUNCTION CcsPwrLineComChpT_DELib_StdSensDdSENTSlowRead "3.2.0"
 /begin IN_MEASUREMENT CcsPwrLineComChpT_swtConfStdSens2C CcsPwrLineComChpT_swtConfStdSensC CcsPwrLineComChpT_swtConfStdSensSwVersC /end IN_MEASUREMENT
 FUNCTION_VERSION "3.2.0" /end FUNCTION
/begin FUNCTION CcsPwrLineComChpT_DELib_StdSensExtDiag "8.1.0"
 /begin IN_MEASUREMENT CcsPwrLineComChpT_swtConfStdSensC CcsPwrLineComChpT_swtConfStdSensSwVersC DELib_idxArrSnsr DELib_xArrSnsr DSM_TripChgFinshd SyC_stSub /end IN_MEASUREMENT
 FUNCTION_VERSION "8.1.0" /end FUNCTION
/begin FUNCTION CcsPwrLineComChpT_DELib_StdSensInin "8.2.0"
 /begin DEF_CHARACTERISTIC CcsPwrLineComChpT_swtConfStdSens2_C CcsPwrLineComChpT_swtConfStdSensSwVers162_C CcsPwrLineComChpT_swtConfStdSens_C /end DEF_CHARACTERISTIC
 /begin REF_CHARACTERISTIC CcsPwrLineComChpT_tiPT1Fil_C /end REF_CHARACTERISTIC
 /begin OUT_MEASUREMENT CcsPwrLineComChpT_swtConfStdSens2C CcsPwrLineComChpT_swtConfStdSensC CcsPwrLineComChpT_swtConfStdSensSwVersC CcsPwrLineComChpT_swtSensMode /end OUT_MEASUREMENT
 FUNCTION_VERSION "8.2.0" /end FUNCTION
/begin FUNCTION CcsPwrLineComChpT_DELib_StdSensVd "11.0.0"
 /begin DEF_CHARACTERISTIC CcsPwrLineComChpT_DigSensCal.tiDebPos_C CcsPwrLineComChpT_DigSensCal.tiDebNeg_C CcsPwrLineComChpT_dtGradLim_f_C CcsPwrLineComChpT_RmpSlp_f.Pos_C CcsPwrLineComChpT_RmpSlp_f.Neg_C CcsPwrLineComChpT_tDflVal_f_C CcsPwrLineComChpT_tHiLimit_f_C CcsPwrLineComChpT_tiPT1_f_C CcsPwrLineComChpT_tLoLimit_f_C CcsPwrLineComChpT_TransStg_f.Dfl_r32_C CcsPwrLineComChpT_TransStg_f.stSensId_C /end DEF_CHARACTERISTIC
 /begin IN_MEASUREMENT CcsPwrLineComChpT_stSnsrDdCalc CcsPwrLineComChpT_swtConfStdSensC CcsPwrLineComChpT_swtConfStdSensSwVersC CcsPwrLineComChpT_tSens_f /end IN_MEASUREMENT
 /begin OUT_MEASUREMENT CcsPwrLineComChpT_tSensOffsCorrd_f CcsPwrLineComChpT_tUnFlt_f CcsPwrLineComChpT_t_f CcsPwrLineComChpT_t_f_Sq DINH_nrActvInhReas.FId_CcsPwrLineComChpTFrzVal DINH_nrActvInhReas.FId_CcsPwrLineComChpTRplVal DINH_stFId.FId_CcsPwrLineComChpTFrzVal DINH_stFId.FId_CcsPwrLineComChpTRplVal /end OUT_MEASUREMENT
 /begin LOC_MEASUREMENT CcsPwrLineComChpT_tSensGradLim_f_mp /end LOC_MEASUREMENT
 FUNCTION_VERSION "11.0.0" /end FUNCTION
/begin FUNCTION CcsPwrLineComChpT_DELib_StdSensVdMon "9.2.0"
 /begin DEF_CHARACTERISTIC CcsPwrLineComChpT_numStdSens_C CcsPwrLineComChpT_numTempErrDef_C CcsPwrLineComChpT_numtSel_C CcsPwrLineComChpT_stEnhPhysSRCRls_MAP CcsPwrLineComChpT_tEnhPhysSRCMax_f_MAP CcsPwrLineComChpT_tEnhPhysSRCMin_f_MAP CcsPwrLineComChpT_tiEngOnMin_C CcsPwrLineComChpT_tiTempErrOk_C CcsPwrLineComChpT_tSnsrMax_f_C CcsPwrLineComChpT_tSnsrMin_f_C DDRC_DurDeb.CcsPwrLineComChpT_tiPhysRngHiDebOk_C DDRC_DurDeb.CcsPwrLineComChpT_tiPhysRngHiDebDef_C DDRC_DurDeb.CcsPwrLineComChpT_tiPhysRngLoDebOk_C DDRC_DurDeb.CcsPwrLineComChpT_tiPhysRngLoDebDef_C DDRC_RatDeb.CcsPwrLineComChpT_tiPhysRngHiUDRat_C DDRC_RatDeb.CcsPwrLineComChpT_tiPhysRngLoUDRat_C DFC_CtlMsk2.DFC_CcsPwrLineComChpTPhysRngHi_C DFC_CtlMsk2.DFC_CcsPwrLineComChpTPhysRngLo_C DFC_CtlMsk2.DFC_CcsPwrLineComChpTTmpErr_C DFC_DisblMsk2.DFC_CcsPwrLineComChpTPhysRngHi_C DFC_DisblMsk2.DFC_CcsPwrLineComChpTPhysRngLo_C DFC_DisblMsk2.DFC_CcsPwrLineComChpTTmpErr_C /end DEF_CHARACTERISTIC
 /begin IN_MEASUREMENT CcsPwrLineComChpT_stSnsrDdCalc CcsPwrLineComChpT_swtConfStdSensC CcsPwrLineComChpT_swtConfStdSensSwVersC CcsPwrLineComChpT_tSens_f CoEng_tiNormal DELib_idxArrSnsr DELib_xArrSnsr DSM_TripChgFinshd Epm_nEng InjCtl_qSetUnBal /end IN_MEASUREMENT
 /begin OUT_MEASUREMENT CcsPwrLineComChpT_stSnsrActv DDRC_St.DFC_CcsPwrLineComChpTPhysRngHi DDRC_St.DFC_CcsPwrLineComChpTPhysRngLo DFC_st.DFC_CcsPwrLineComChpTPhysRngHi DFC_st.DFC_CcsPwrLineComChpTPhysRngLo DFC_st.DFC_CcsPwrLineComChpTTmpErr DINH_nrActvInhReas.FId_CcsPwrLineComChpTPhysRng DINH_nrActvInhReas.FId_CcsPwrLineComChpTTmpErrCnt DINH_stFId.FId_CcsPwrLineComChpTPhysRng DINH_stFId.FId_CcsPwrLineComChpTTmpErrCnt /end OUT_MEASUREMENT
 /begin LOC_MEASUREMENT CcsPwrLineComChpT_stMonStdSens CcsPwrLineComChpT_tDynThresPhysRngHi_f_mp CcsPwrLineComChpT_tDynThresPhysRngLo_f_mp /end LOC_MEASUREMENT
 FUNCTION_VERSION "9.2.0" /end FUNCTION
/begin FUNCTION CEL_Compu "1.300.0   Arithemetic computation methods and physical units in MSR language" FUNCTION_VERSION "1.300.0" /end FUNCTION
/begin FUNCTION CEL_CompuLcy "1.1.0     Computation methods and SW Units with old DGS naming convention" FUNCTION_VERSION "1.1.0" /end FUNCTION
/begin FUNCTION CEL_Const "1.20.0    DGS central System Constants of the category FIXED" /begin DEF_CHARACTERISTIC medc_datasetid /end DEF_CHARACTERISTIC FUNCTION_VERSION "1.20.0" /end FUNCTION
/begin FUNCTION ChrgCIL_Hmi "5500.2.0  Customer Interface Layer for charging Human-Machine Interface" /begin IN_MEASUREMENT Com_flgChrgnStopAndUnlckReq Com_flgChrgnStopReq /end IN_MEASUREMENT /begin OUT_MEASUREMENT ChrgCIL_stHmiReq /end OUT_MEASUREMENT FUNCTION_VERSION "5500.2.0" /end FUNCTION
/begin FUNCTION ChrgCntct_Ctrl "10.3.0    Charge Contactor - Control DC"
 /begin DEF_CHARACTERISTIC ChrgCntct_iEmgyOpnReplcmt_C ChrgCntct_maskIActMeasdSq_C ChrgCntct_nrElpdOperMaxErr_C ChrgCntct_nrElpdOperMaxWarn_C ChrgCntct_Prm.tiCntctEmgyOffDly_C ChrgCntct_Prm.tiCntctOffDurn_C ChrgCntct_Prm.tiCntctOnDurn_C ChrgCntct_Prm.tiDebVldtCntctOff_C ChrgCntct_Prm.tiDebVldtCntctOn_C ChrgCntct_Prm.tiDwellDurn_C ChrgCntct_Prm.tiInitDly_C ChrgCntct_Prm.tiWaitMaxCntctOff_C ChrgCntct_Prm.tiWaitMaxCntctOn_C ChrgCntct_StMacCntct.ChrgCntct_facMulTbl_C ChrgCntct_StMacCntct.ChrgCntct_facOperIHi_T ChrgCntct_StMacCntct.ChrgCntct_facOperILo_T ChrgCntct_StMacCntct.ChrgCntct_iThdSwtTbl_C DFC_CtlMsk2.DFC_ChrgCntctAllWldd_C DFC_CtlMsk2.DFC_ChrgCntctNegOperErr_C DFC_CtlMsk2.DFC_ChrgCntctNegOperWarn_C DFC_CtlMsk2.DFC_ChrgCntctNegWldd_C DFC_CtlMsk2.DFC_ChrgCntctPosOperErr_C DFC_CtlMsk2.DFC_ChrgCntctPosOperWarn_C DFC_CtlMsk2.DFC_ChrgCntctPosWldd_C DFC_CtlMsk2.DFC_ChrgCntctStuckOpen_C DFC_DisblMsk2.DFC_ChrgCntctAllWldd_C DFC_DisblMsk2.DFC_ChrgCntctNegOperErr_C DFC_DisblMsk2.DFC_ChrgCntctNegOperWarn_C DFC_DisblMsk2.DFC_ChrgCntctNegWldd_C DFC_DisblMsk2.DFC_ChrgCntctPosOperErr_C DFC_DisblMsk2.DFC_ChrgCntctPosOperWarn_C DFC_DisblMsk2.DFC_ChrgCntctPosWldd_C DFC_DisblMsk2.DFC_ChrgCntctStuckOpen_C /end DEF_CHARACTERISTIC
 /begin IN_MEASUREMENT ChrgMod_stChrgnCntctReq ChrgrRly_stDcCntctActNeg ChrgrRly_stDcCntctActPos HvBatt_iActMeasd HvBatt_iActMeasd_Sq /end IN_MEASUREMENT
 /begin OUT_MEASUREMENT ChrgCntct_flgCntctNeg ChrgCntct_flgCntctPos ChrgCntct_nrNegCntctElpdOper ChrgCntct_nrNegCntctOper ChrgCntct_nrPosCntctElpdOper ChrgCntct_nrPosCntctOper ChrgCntct_st DFC_st.DFC_ChrgCntctAllWldd DFC_st.DFC_ChrgCntctNegOperErr DFC_st.DFC_ChrgCntctNegOperWarn DFC_st.DFC_ChrgCntctNegWldd DFC_st.DFC_ChrgCntctPosOperErr DFC_st.DFC_ChrgCntctPosOperWarn DFC_st.DFC_ChrgCntctPosWldd DFC_st.DFC_ChrgCntctStuckOpen /end OUT_MEASUREMENT
 /begin LOC_MEASUREMENT ChrgCntct_flgAllCntctClsd ChrgCntct_flgNegCntctClsd ChrgCntct_flgPosCntctClsd ChrgCntct_flgSnsrErr ChrgCntct_flgTrigNegCnt ChrgCntct_flgTrigPosCnt ChrgCntct_iActMeasd ChrgCntct_NrOper_I.nrNegCntctElpdOper ChrgCntct_NrOper_I.nrNegCntctOper ChrgCntct_NrOper_I.nrPosCntctElpdOper ChrgCntct_NrOper_I.nrPosCntctOper ChrgCntct_StMacCntct.ChrgCntct_facNegLfTiCnt ChrgCntct_StMacCntct.ChrgCntct_facPosLfTiCnt ChrgCntct_StMacCntct.facNegOperIHiLoc ChrgCntct_StMacCntct.facNegOperILoLoc ChrgCntct_StMacCntct.facPosOperIHiLoc ChrgCntct_StMacCntct.facPosOperILoLoc ChrgCntct_StMacCntct.flgOnlyPosCntctClsd ChrgCntct_StMacCntct.iEmgyOpngINeg ChrgCntct_StMacCntct.iEmgyOpngIPos ChrgCntct_StMacCntct.sm ChrgCntct_StMacCntct.stResWldChk ChrgCntct_StMacCntct.tiDeb ChrgCntct_StMacCntct.tiTmr ChrgCntct_stVldnChk /end LOC_MEASUREMENT
 FUNCTION_VERSION "10.3.0" /end FUNCTION
/begin FUNCTION ChrgCom_Ccs "5500.7.0  Charge Communication CCS"
 /begin DEF_CHARACTERISTIC ChrgCom_tiComIniAcExt_C ChrgCom_tiComIniCcsDc_C ChrgCom_tiComSetUpAcExt_C ChrgCom_tiComSetUpCcsDc_C /end DEF_CHARACTERISTIC
 /begin IN_MEASUREMENT ChgrPlug_flgDigComRqrd ChgrPlug_stCtP ChrgPlg_stCcs HLCCcs_flgCcsDcAvl /end IN_MEASUREMENT
 /begin OUT_MEASUREMENT ChrgCom_stAcExt ChrgCom_stCcsDc /end OUT_MEASUREMENT
 /begin LOC_MEASUREMENT ChrgCom_tiComSetUpAcExt ChrgCom_tiComSetUpCcsDc /end LOC_MEASUREMENT
 FUNCTION_VERSION "5500.7.0" /end FUNCTION
/begin FUNCTION ChrgCtrl_GlbDef "5610.1.0  Global definitions for charge control" FUNCTION_VERSION "5610.1.0" /end FUNCTION
/begin FUNCTION ChrgFlow_Plt "5500.8.0  Charge Flow Pilot"
 /begin DEF_CHARACTERISTIC ChrgFlow_flgTogIniEna_C ChrgFlow_tiDlyTogIni_C ChrgFlow_tiTogRst_C /end DEF_CHARACTERISTIC
 /begin IN_MEASUREMENT ChgrPlug_stCtP ChrgMod_flgChrgnRdy ChrgMod_flgChrgnRetry ChrgMod_stMod HLCCcs_flgTogReq HLCCcs_nrTogReq /end IN_MEASUREMENT
 /begin OUT_MEASUREMENT ChrgFlow_flgCtrlPltSwtReq ChrgFlow_nrTogCtrlPltSwtReq /end OUT_MEASUREMENT
 /begin LOC_MEASUREMENT ChrgFlow_flgCtrlPltSwtTogIni ChrgFlow_flgTogReq ChrgFlow_nrTogReq ChrgFlow_stCtrlPltOld /end LOC_MEASUREMENT
 FUNCTION_VERSION "5500.8.0" /end FUNCTION
/begin FUNCTION ChrgMod_Ctrl "5500.6.0  Charge mode control" /begin DEF_CHARACTERISTIC ChrgMod_tiHldBackFinsh_C /end DEF_CHARACTERISTIC
 /begin IN_MEASUREMENT AcExtChrgr_flgChrgnRdy AcExtChrgr_flgChrgnRetry AcExtChrgr_iChrgnMaxAvl AcExtChrgr_iChrgnReq AcExtChrgr_pwrChrgnOut AcExtChrgr_ratSocChrgnStop AcExtChrgr_stChrgn AcExtChrgr_stChrgnReq AcExtChrgr_uChrgnReq ChrgMod_stMod ChrgPlg_stPlg DcChrgnCtrl_flgChrgnRdy DcChrgnCtrl_flgChrgnRetry DcChrgnCtrl_flgIsoMeasmtDiReq DcChrgnCtrl_iChrgnMaxAvl DcChrgnCtrl_iChrgnReq DcChrgnCtrl_pwrChrgnOut DcChrgnCtrl_ratSocChrgnStop DcChrgnCtrl_stChrgn DcChrgnCtrl_stChrgnCntctReq DcChrgnCtrl_stChrgnReq DcChrgnCtrl_uChrgnReq /end IN_MEASUREMENT
 /begin OUT_MEASUREMENT ChrgMod_flgChrgnRdy ChrgMod_flgChrgnRetry ChrgMod_flgIsoMeasmtDiReq ChrgMod_iChrgnMaxAvl ChrgMod_iChrgnReq ChrgMod_pwrChrgnOut ChrgMod_ratSocChrgnStop ChrgMod_stChrgn ChrgMod_stChrgnCntctReq ChrgMod_stChrgnReq ChrgMod_uChrgnReq /end OUT_MEASUREMENT
 /begin LOC_MEASUREMENT ChrgMod_stChrgnLoc ChrgMod_tiHldBackFinsh /end LOC_MEASUREMENT
 FUNCTION_VERSION "5500.6.0" /end FUNCTION
/begin FUNCTION ChrgMod_Sel "5500.5.0  Charge mode select"
 /begin DEF_CHARACTERISTIC DFC_CtlMsk2.DFC_ChrgnUnplRqrd_C DFC_DisblMsk2.DFC_ChrgnUnplRqrd_C /end DEF_CHARACTERISTIC
 /begin IN_MEASUREMENT ChrgCom_stAcExt ChrgCom_stCcsDc ChrgMod_stChrgn ChrgPlg_stPlg /end IN_MEASUREMENT
 /begin OUT_MEASUREMENT ChrgMod_flgUnplRqrd ChrgMod_stMod DFC_st.DFC_ChrgnUnplRqrd DINH_nrActvInhReas.FId_ChrgnUnplRqrd DINH_stFId.FId_ChrgnUnplRqrd /end OUT_MEASUREMENT
 /begin LOC_MEASUREMENT ChrgMod_flgNoChrgnIni ChrgMod_flgNoChrgnPnd ChrgMod_stModSeld /end LOC_MEASUREMENT
 FUNCTION_VERSION "5500.5.0" /end FUNCTION
/begin COMPU_METHOD B_TRUE "" TAB_VERB "%6.3" "" COMPU_TAB_REF B_TRUE /end COMPU_METHOD
/begin COMPU_VTAB B_TRUE "" TAB_VERB 2 0 "FALSE" 1 "TRUE" /end COMPU_VTAB
/begin COMPU_METHOD CALWUP_SY_Compu "" TAB_VERB "%6.3" "" COMPU_TAB_REF CALWUP_SY_Compu /end COMPU_METHOD
/begin COMPU_VTAB CALWUP_SY_Compu "" TAB_VERB 2 0 "no calibration wake up" 1 "calibration wake up" /end COMPU_VTAB
/begin COMPU_METHOD CANIPCORETYPE_SC_Compu "" TAB_VERB "%6.3" "" COMPU_TAB_REF CANIPCORETYPE_SC_Compu /end COMPU_METHOD
/begin COMPU_VTAB CANIPCORETYPE_SC_Compu "" TAB_VERB 2 0 "0" 1 "1" /end COMPU_VTAB
/begin COMPU_METHOD CANNM_SC_Compu "" TAB_VERB "%6.3" "" COMPU_TAB_REF CANNM_SC_Compu /end COMPU_METHOD
/begin COMPU_VTAB CANNM_SC_Compu "" TAB_VERB 2 0 "False" 1 "True" /end COMPU_VTAB
/begin COMPU_METHOD CANSM_SC_Compu "" TAB_VERB "%6.3" "" COMPU_TAB_REF CANSM_SC_Compu /end COMPU_METHOD
/begin COMPU_VTAB CANSM_SC_Compu "" TAB_VERB 2 0 "False" 1 "True" /end COMPU_VTAB
/begin COMPU_METHOD CANTP_SC_Compu "" TAB_VERB "%6.3" "" COMPU_TAB_REF CANTP_SC_Compu /end COMPU_METHOD
/begin COMPU_VTAB CANTP_SC_Compu "" TAB_VERB 2 0 "False" 1 "True" /end COMPU_VTAB
/begin COMPU_METHOD CANTSYN_SC_Compu "" TAB_VERB "%6.3" "" COMPU_TAB_REF CANTSYN_SC_Compu /end COMPU_METHOD
/begin COMPU_VTAB CANTSYN_SC_Compu "" TAB_VERB 2 0 "False" 1 "True" /end COMPU_VTAB
/begin COMPU_METHOD CAN_MDS_SC_Compu "" TAB_VERB "%6.3" "" COMPU_TAB_REF CAN_MDS_SC_Compu /end COMPU_METHOD
/begin COMPU_VTAB CAN_MDS_SC_Compu "" TAB_VERB 2 0 "CAN_MDS_OFF" 1 "CAN_MDS_ON" /end COMPU_VTAB
/begin COMPU_METHOD CARBMDLYR19UPD2016_SC_Compu "" RAT_FUNC "%6.2" "" COEFFS 0 1 0 0 0 1 /end COMPU_METHOD
/begin COMPU_METHOD CAS_I1_SY_Compu "" TAB_VERB "%6.3" "" COMPU_TAB_REF CAS_I1_SY_Compu /end COMPU_METHOD
/begin COMPU_VTAB CAS_I1_SY_Compu "" TAB_VERB 2 0 "NO_SIGNAL" 1 "SIGNAL_AVAILABLE" /end COMPU_VTAB
/begin COMPU_METHOD CAS_I2_SY_Compu "" TAB_VERB "%6.3" "" COMPU_TAB_REF CAS_I2_SY_Compu /end COMPU_METHOD
/begin COMPU_VTAB CAS_I2_SY_Compu "" TAB_VERB 2 0 "NO_SIGNAL" 1 "SIGNAL_AVAILABLE" /end COMPU_VTAB
/begin COMPU_METHOD CAS_O1_SY_Compu "" TAB_VERB "%6.3" "" COMPU_TAB_REF CAS_O1_SY_Compu /end COMPU_METHOD
/begin COMPU_VTAB CAS_O1_SY_Compu "" TAB_VERB 2 0 "NO_SIGNAL" 1 "SIGNAL_AVAILABLE" /end COMPU_VTAB
/begin COMPU_METHOD CAS_O2_SY_Compu "" TAB_VERB "%6.3" "" COMPU_TAB_REF CAS_O2_SY_Compu /end COMPU_METHOD
/begin COMPU_VTAB CAS_O2_SY_Compu "" TAB_VERB 2 0 "NO_SIGNAL" 1 "SIGNAL_AVAILABLE" /end COMPU_VTAB
/begin COMPU_METHOD CBNHEATGSWT_TYPAVL_SC_Compu "" TAB_VERB "%6.3" "" COMPU_TAB_REF CBNHEATGSWT_TYPAVL_SC_Compu /end COMPU_METHOD
/begin COMPU_VTAB CBNHEATGSWT_TYPAVL_SC_Compu "" TAB_VERB 2 0 "False" 1 "True" /end COMPU_VTAB
/begin COMPU_METHOD CCACHPDST_TYPAVL_SY_Compu "" TAB_VERB "%6.3" "" COMPU_TAB_REF CCACHPDST_TYPAVL_SY_Compu /end COMPU_METHOD
/begin COMPU_VTAB CCACHPDST_TYPAVL_SY_Compu "" TAB_VERB 2 0 "False" 1 "True" /end COMPU_VTAB
/begin COMPU_METHOD CCACLPDST_TYPAVL_SY_Compu "" TAB_VERB "%6.3" "" COMPU_TAB_REF CCACLPDST_TYPAVL_SY_Compu /end COMPU_METHOD
/begin COMPU_VTAB CCACLPDST_TYPAVL_SY_Compu "" TAB_VERB 2 0 "False" 1 "True" /end COMPU_VTAB
/begin COMPU_METHOD CCSPWRLINECHPRST_TYPAVL_SC_Compu "" TAB_VERB "%6.3" "" COMPU_TAB_REF CCSPWRLINECHPRST_TYPAVL_SC_Compu /end COMPU_METHOD
/begin COMPU_VTAB CCSPWRLINECHPRST_TYPAVL_SC_Compu "" TAB_VERB 2 0 "False" 1 "True" /end COMPU_VTAB
/begin COMPU_METHOD CCSPWRLINECHPVCCENA_TYPAVL_SC_Compu "" TAB_VERB "%6.3" "" COMPU_TAB_REF CCSPWRLINECHPVCCENA_TYPAVL_SC_Compu /end COMPU_METHOD
/begin COMPU_VTAB CCSPWRLINECHPVCCENA_TYPAVL_SC_Compu "" TAB_VERB 2 0 "False" 1 "True" /end COMPU_VTAB
/begin COMPU_METHOD CCSPWRLINECHPVCC_TYPAVL_SC_Compu "" TAB_VERB "%6.3" "" COMPU_TAB_REF CCSPWRLINECHPVCC_TYPAVL_SC_Compu /end COMPU_METHOD
/begin COMPU_VTAB CCSPWRLINECHPVCC_TYPAVL_SC_Compu "" TAB_VERB 2 0 "False" 1 "True" /end COMPU_VTAB
/begin COMPU_METHOD CCSPWRLINECOMCHPT_TYPAVL_SC_Compu "" TAB_VERB "%6.3" "" COMPU_TAB_REF CCSPWRLINECOMCHPT_TYPAVL_SC_Compu /end COMPU_METHOD
/begin COMPU_VTAB CCSPWRLINECOMCHPT_TYPAVL_SC_Compu "" TAB_VERB 2 0 "False" 1 "True" /end COMPU_VTAB
/begin COMPU_METHOD CDGEN_ENV_SC_Compu "" TAB_VERB "%6.3" "" COMPU_TAB_REF CDGEN_ENV_SC_Compu /end COMPU_METHOD
/begin COMPU_VTAB CDGEN_ENV_SC_Compu "" TAB_VERB 4 0 "CDGEN_ENV_DS" 1 "CDGEN_ENV_GS" 2 "CDGEN_ENV_DGS" 3 "CDGEN_ENV_MDG" /end COMPU_VTAB
/begin COMPU_METHOD CELPRJ_SIMPLEMDLENA_SC_Compu "" TAB_VERB "%6.3" "" COMPU_TAB_REF CELPRJ_SIMPLEMDLENA_SC_Compu /end COMPU_METHOD
/begin COMPU_VTAB CELPRJ_SIMPLEMDLENA_SC_Compu "" TAB_VERB 2 0 "FALSE" 1 "TRUE" /end COMPU_VTAB
/begin COMPU_METHOD CENGDST_TYPAVL_SY_Compu "" TAB_VERB "%6.3" "" COMPU_TAB_REF CENGDST_TYPAVL_SY_Compu /end COMPU_METHOD
/begin COMPU_VTAB CENGDST_TYPAVL_SY_Compu "" TAB_VERB 2 0 "False" 1 "True" /end COMPU_VTAB
/begin COMPU_METHOD CENGUST2_TYPAVL_SC_Compu "" TAB_VERB "%6.3" "" COMPU_TAB_REF CENGUST2_TYPAVL_SC_Compu /end COMPU_METHOD
/begin COMPU_VTAB CENGUST2_TYPAVL_SC_Compu "" TAB_VERB 2 0 "False" 1 "True" /end COMPU_VTAB
/begin COMPU_METHOD CENGUST_TYPAVL_SY_Compu "" TAB_VERB "%6.3" "" COMPU_TAB_REF CENGUST_TYPAVL_SY_Compu /end COMPU_METHOD
/begin COMPU_VTAB CENGUST_TYPAVL_SY_Compu "" TAB_VERB 2 0 "False" 1 "True" /end COMPU_VTAB
/begin COMPU_METHOD CHDT_TYPAVL_SC_Compu "" TAB_VERB "%6.3" "" COMPU_TAB_REF CHDT_TYPAVL_SC_Compu /end COMPU_METHOD
/begin COMPU_VTAB CHDT_TYPAVL_SC_Compu "" TAB_VERB 2 0 "False" 1 "True" /end COMPU_VTAB
/begin COMPU_METHOD CHRCTL_EIAECD_SY_Compu "" TAB_VERB "%6.3" "" COMPU_TAB_REF CHRCTL_EIAECD_SY_Compu /end COMPU_METHOD
/begin COMPU_VTAB CHRCTL_EIAECD_SY_Compu "" TAB_VERB 2 0 "False" 1 "True" /end COMPU_VTAB
/begin COMPU_METHOD CHRGCIL_HMICHRGNSTOP_SC_Compu "" TAB_VERB "%6.3" "" COMPU_TAB_REF CHRGCIL_HMICHRGNSTOP_SC_Compu /end COMPU_METHOD
/begin COMPU_VTAB CHRGCIL_HMICHRGNSTOP_SC_Compu "" TAB_VERB 2 0 "False" 1 "True" /end COMPU_VTAB
/begin COMPU_METHOD CHRGCIL_HMIPLGUNLCK_SC_Compu "" TAB_VERB "%6.3" "" COMPU_TAB_REF CHRGCIL_HMIPLGUNLCK_SC_Compu /end COMPU_METHOD
/begin COMPU_VTAB CHRGCIL_HMIPLGUNLCK_SC_Compu "" TAB_VERB 2 0 "False" 1 "True" /end COMPU_VTAB
/begin COMPU_METHOD CHRGCIL_HMIVEHCENLOCK_SC_Compu "" TAB_VERB "%6.3" "" COMPU_TAB_REF CHRGCIL_HMIVEHCENLOCK_SC_Compu /end COMPU_METHOD
/begin COMPU_VTAB CHRGCIL_HMIVEHCENLOCK_SC_Compu "" TAB_VERB 2 0 "False" 1 "True" /end COMPU_VTAB
/begin COMPU_METHOD ChrgCntct_Ctrl_StCntctMac_sm_VERB "" TAB_VERB "%6.3" "" COMPU_TAB_REF ChrgCntct_Ctrl_StCntctMac_sm_VERB /end COMPU_METHOD
/begin COMPU_VTAB ChrgCntct_Ctrl_StCntctMac_sm_VERB "" TAB_VERB 17 0 "Cntct_OpngIni" 1 "Cntct_ClsdContns" 10 "Cntct_WldChkPrep" 11 "NegOff" 12 "PosOff" 13 "Cntct_Clsd" 14 "Cntct_Clsng" 15 "Cntct_EmgyOpng" 16 "Cntct_Opng" 2 "Cntct_ClsdVldt" 3 "Cntct_ClsngNeg" 4 "Cntct_ClsngPos" 5 "Cntct_EmgyOpngNeg" 6 "Cntct_EmgyOpngPos" 7 "Cntct_Open" 8 "Cntct_OpengAndDiagRprt" 9 "Cntct_WldChkDone" /end COMPU_VTAB
/begin COMPU_METHOD ChrgCntct_st_VERB "" TAB_VERB "%6.3" "" COMPU_TAB_REF ChrgCntct_st_VERB /end COMPU_METHOD
/begin COMPU_VTAB ChrgCntct_st_VERB "" TAB_VERB 7 0 "CHRGCNTCT_OPEND" 1 "CHRGCNTCT_CLSD" 2 "CHRGCNTCT_WLDCHK" 3 "CHRGCNTCT_WLDD" 4 "CHRGCNTCT_PTLWLDD" 5 "CHRGCNTCT_ERR" 6 "CHRGCNTCT_INI" /end COMPU_VTAB
/begin COMPU_METHOD CHRGCTRL_CCSACCTRL_SC_Compu "" TAB_VERB "%6.3" "" COMPU_TAB_REF CHRGCTRL_CCSACCTRL_SC_Compu /end COMPU_METHOD
/begin COMPU_VTAB CHRGCTRL_CCSACCTRL_SC_Compu "" TAB_VERB 2 0 "False" 1 "True" /end COMPU_VTAB
/begin COMPU_METHOD CHRGCTRL_CCSDCCTRL_SC_Compu "" TAB_VERB "%6.3" "" COMPU_TAB_REF CHRGCTRL_CCSDCCTRL_SC_Compu /end COMPU_METHOD
/begin COMPU_VTAB CHRGCTRL_CCSDCCTRL_SC_Compu "" TAB_VERB 2 0 "False" 1 "True" /end COMPU_VTAB
/begin COMPU_METHOD CHRGCTRL_CNTCTCTRL_SC_Compu "" TAB_VERB "%6.3" "" COMPU_TAB_REF CHRGCTRL_CNTCTCTRL_SC_Compu /end COMPU_METHOD
/begin COMPU_VTAB CHRGCTRL_CNTCTCTRL_SC_Compu "" TAB_VERB 2 0 "False" 1 "True" /end COMPU_VTAB
/begin COMPU_METHOD ChrgCtrl_stChrgnCntctReq_VERB "" TAB_VERB "%6.3" "" COMPU_TAB_REF ChrgCtrl_stChrgnCntctReq_VERB /end COMPU_METHOD
/begin COMPU_VTAB ChrgCtrl_stChrgnCntctReq_VERB "" TAB_VERB 3 0 "CHRGCTRL_OPEN" 1 "CHRGCTRL_EMGYOPEN" 2 "CHRGCTRL_CLOSE" /end COMPU_VTAB
/begin COMPU_METHOD ChrgCtrl_stChrgn_VERB "" TAB_VERB "%6.3" "" COMPU_TAB_REF ChrgCtrl_stChrgn_VERB /end COMPU_METHOD
/begin COMPU_VTAB ChrgCtrl_stChrgn_VERB "" TAB_VERB 7 0 "CHRGCTRL_INI" 1 "CHRGCTRL_PREP" 2 "CHRGCTRL_CHRGN" 3 "CHRGCTRL_STOP" 4 "CHRGCTRL_FINSH" 5 "CHRGCTRL_CRITERR" 6 "CHRGCTRL_MNRERR" /end COMPU_VTAB
/begin COMPU_METHOD ChrgCtrl_stMod_VERB "" TAB_VERB "%6.3" "" COMPU_TAB_REF ChrgCtrl_stMod_VERB /end COMPU_METHOD
/begin COMPU_VTAB ChrgCtrl_stMod_VERB "" TAB_VERB 7 0 "CHRGCTRL_MOD_NO_CHRGN" 1 "CHRGCTRL_MOD_AC_EXT" 2 "CHRGCTRL_MOD_CCS_AC" 3 "CHRGCTRL_MOD_CCS_DC" 4 "CHRGCTRL_MOD_CHADEMO" 5 "CHRGCTRL_MOD_CHINA" 9 "CHRGCTRL_MOD_NOT_AVL" /end COMPU_VTAB
/begin COMPU_METHOD CHRGIF_CTRLPLT_SC_Compu "" TAB_VERB "%6.3" "" COMPU_TAB_REF CHRGIF_CTRLPLT_SC_Compu /end COMPU_METHOD
/begin COMPU_VTAB CHRGIF_CTRLPLT_SC_Compu "" TAB_VERB 3 0 "0" 1 "1" 2 "2" /end COMPU_VTAB
/begin COMPU_METHOD CHRGIF_PLGINTLCK_SC_Compu "" TAB_VERB "%6.3" "" COMPU_TAB_REF CHRGIF_PLGINTLCK_SC_Compu /end COMPU_METHOD
/begin COMPU_VTAB CHRGIF_PLGINTLCK_SC_Compu "" TAB_VERB 3 0 "0" 1 "1" 2 "2" /end COMPU_VTAB
/begin COMPU_METHOD CHRGIF_PROXPLT_SC_Compu "" TAB_VERB "%6.3" "" COMPU_TAB_REF CHRGIF_PROXPLT_SC_Compu /end COMPU_METHOD
/begin COMPU_VTAB CHRGIF_PROXPLT_SC_Compu "" TAB_VERB 3 0 "0" 1 "1" 2 "2" /end COMPU_VTAB
/begin COMPU_METHOD ChrgIf_stCom_VERB "" TAB_VERB "%6.3" "" COMPU_TAB_REF ChrgIf_stCom_VERB /end COMPU_METHOD
/begin COMPU_VTAB ChrgIf_stCom_VERB "" TAB_VERB 4 0 "CHRGCOM_INI" 1 "CHRGCOM_PND" 2 "CHRGCOM_AVL" 3 "CHRGCOM_ERR" /end COMPU_VTAB
/begin COMPU_METHOD ChrgIf_stHmiReq_VERB "" TAB_VERB "%6.3" "" COMPU_TAB_REF ChrgIf_stHmiReq_VERB /end COMPU_METHOD
/begin COMPU_VTAB ChrgIf_stHmiReq_VERB "" TAB_VERB 5 0 "CHRGCIL_HMI_NOREQ" 1 "CHRGCIL_HMI_CHRGNSTOP" 2 "CHRGCIL_HMI_CHRGNSTOPUNLCKPLG" 3 "CHRGCIL_HMI_LOCKPLG" 4 "CHRGCIL_HMI_UNLCKPLG" /end COMPU_VTAB
/begin COMPU_METHOD CHRGIF_TMONCCSAC_SC_Compu "" TAB_VERB "%6.3" "" COMPU_TAB_REF CHRGIF_TMONCCSAC_SC_Compu /end COMPU_METHOD
/begin COMPU_VTAB CHRGIF_TMONCCSAC_SC_Compu "" TAB_VERB 3 0 "0" 1 "1" 2 "2" /end COMPU_VTAB
/begin COMPU_METHOD CHRGIF_TMONCCSDC_SC_Compu "" TAB_VERB "%6.3" "" COMPU_TAB_REF CHRGIF_TMONCCSDC_SC_Compu /end COMPU_METHOD
/begin COMPU_VTAB CHRGIF_TMONCCSDC_SC_Compu "" TAB_VERB 3 0 "0" 1 "1" 2 "2" /end COMPU_VTAB
/begin COMPU_METHOD CHRGIF_TMONCHADEMO_SC_Compu "" TAB_VERB "%6.3" "" COMPU_TAB_REF CHRGIF_TMONCHADEMO_SC_Compu /end COMPU_METHOD
/begin COMPU_VTAB CHRGIF_TMONCHADEMO_SC_Compu "" TAB_VERB 3 0 "0" 1 "1" 2 "2" /end COMPU_VTAB
/begin COMPU_METHOD CHRGIF_TMONCHINA_SC_Compu "" TAB_VERB "%6.3" "" COMPU_TAB_REF CHRGIF_TMONCHINA_SC_Compu /end COMPU_METHOD
/begin COMPU_VTAB CHRGIF_TMONCHINA_SC_Compu "" TAB_VERB 3 0 "0" 1 "1" 2 "2" /end COMPU_VTAB
/begin COMPU_METHOD CHRGIF_TMON_SC_Compu "" TAB_VERB "%6.3" "" COMPU_TAB_REF CHRGIF_TMON_SC_Compu /end COMPU_METHOD
/begin COMPU_VTAB CHRGIF_TMON_SC_Compu "" TAB_VERB 3 0 "0" 1 "1" 2 "2" /end COMPU_VTAB
/begin COMPU_METHOD CHRGNFCTSFTY_CCSPLGLOCK_SC_Compu "" TAB_VERB "%6.3" "" COMPU_TAB_REF CHRGNFCTSFTY_CCSPLGLOCK_SC_Compu /end COMPU_METHOD
/begin COMPU_VTAB CHRGNFCTSFTY_CCSPLGLOCK_SC_Compu "" TAB_VERB 2 0 "False" 1 "True" /end COMPU_VTAB
/begin COMPU_METHOD CHRGRSWT_SC_Compu "" TAB_VERB "%6.3" "" COMPU_TAB_REF CHRGRSWT_SC_Compu /end COMPU_METHOD
/begin COMPU_VTAB CHRGRSWT_SC_Compu "" TAB_VERB 3 0 "CHRGRSWT_NOTPRSNT_SC" 1 "CHRGRSWT_HW_SC" 2 "CHRGRSWT_CAN_SC" /end COMPU_VTAB
/begin COMPU_METHOD CHRGSDL_TICALCN_SC_Compu "" TAB_VERB "%6.3" "" COMPU_TAB_REF CHRGSDL_TICALCN_SC_Compu /end COMPU_METHOD
/begin COMPU_VTAB CHRGSDL_TICALCN_SC_Compu "" TAB_VERB 3 0 "0" 1 "1" 2 "2" /end COMPU_VTAB
/begin COMPU_METHOD CHRGSEQIF_ACEXTCHRGR_SC_Compu "" TAB_VERB "%6.3" "" COMPU_TAB_REF CHRGSEQIF_ACEXTCHRGR_SC_Compu /end COMPU_METHOD
/begin COMPU_VTAB CHRGSEQIF_ACEXTCHRGR_SC_Compu "" TAB_VERB 2 0 "0" 1 "1" /end COMPU_VTAB
/begin COMPU_METHOD CHRGSEQIF_CCS_SC_Compu "" TAB_VERB "%6.3" "" COMPU_TAB_REF CHRGSEQIF_CCS_SC_Compu /end COMPU_METHOD
/begin COMPU_VTAB CHRGSEQIF_CCS_SC_Compu "" TAB_VERB 4 0 "0" 1 "1" 2 "2" 3 "3" /end COMPU_VTAB
/begin COMPU_METHOD CHRGSEQIF_CHADEMO_SC_Compu "" TAB_VERB "%6.3" "" COMPU_TAB_REF CHRGSEQIF_CHADEMO_SC_Compu /end COMPU_METHOD
/begin COMPU_VTAB CHRGSEQIF_CHADEMO_SC_Compu "" TAB_VERB 2 0 "0" 1 "1" /end COMPU_VTAB
/begin COMPU_METHOD CHRGSEQIF_CHINAGBT_SC_Compu "" TAB_VERB "%6.3" "" COMPU_TAB_REF CHRGSEQIF_CHINAGBT_SC_Compu /end COMPU_METHOD
/begin COMPU_VTAB CHRGSEQIF_CHINAGBT_SC_Compu "" TAB_VERB 4 0 "0" 1 "1" 2 "2" 3 "3" /end COMPU_VTAB
/begin COMPU_METHOD CHRGTYP_CCS_SC_Compu "" TAB_VERB "%6.3" "" COMPU_TAB_REF CHRGTYP_CCS_SC_Compu /end COMPU_METHOD
/begin COMPU_VTAB CHRGTYP_CCS_SC_Compu "" TAB_VERB 7 0 "0" 1 "1" 2 "2" 3 "3" 4 "4" 5 "5" 9 "9" /end COMPU_VTAB
/begin COMPU_METHOD CJ721_SC_Compu "" TAB_VERB "%6.3" "" COMPU_TAB_REF CJ721_SC_Compu /end COMPU_METHOD
/begin COMPU_VTAB CJ721_SC_Compu "" TAB_VERB 2 0 "no_Cj721" 1 "one_Cj721" /end COMPU_VTAB
/begin COMPU_METHOD CJ722_SC_Compu "" TAB_VERB "%6.3" "" COMPU_TAB_REF CJ722_SC_Compu /end COMPU_METHOD
/begin COMPU_VTAB CJ722_SC_Compu "" TAB_VERB 2 0 "no_Cj722" 1 "one_Cj722" /end COMPU_VTAB
/begin COMPU_METHOD CJ950_SY_Compu "" TAB_VERB "%6.3" "" COMPU_TAB_REF CJ950_SY_Compu /end COMPU_METHOD
/begin COMPU_VTAB CJ950_SY_Compu "" TAB_VERB 5 0 "NO_CJ950" 1 "1_CJ950" 2 "2_CJ950" 3 "3_CJ950" 4 "4_CJ950" /end COMPU_VTAB
/begin COMPU_METHOD CJ960_SC_Compu "" TAB_VERB "%6.3" "" COMPU_TAB_REF CJ960_SC_Compu /end COMPU_METHOD
/begin COMPU_VTAB CJ960_SC_Compu "" TAB_VERB 11 0 "No CJ960" 1 "1 CJ960" 2 "2 CJ960" 3 "3 CJ960" 4 "4 CJ960" 5 "5 CJ960" 6 "6 CJ960" 7 "7 CJ960" 8 "8 CJ960" 9 "9 CJ960" 10 "10 CJ960" /end COMPU_VTAB
/begin COMPU_METHOD CJ970_SC_Compu "" TAB_VERB "%6.3" "" COMPU_TAB_REF CJ970_SC_Compu /end COMPU_METHOD
/begin COMPU_VTAB CJ970_SC_Compu "" TAB_VERB 6 0 "0" 1 "1" 2 "2" 3 "3" 4 "4" 5 "5" /end COMPU_VTAB
/begin COMPU_METHOD CLNTVLV_SY_Compu "" TAB_VERB "%6.3" "" COMPU_TAB_REF CLNTVLV_SY_Compu /end COMPU_METHOD
/begin COMPU_VTAB CLNTVLV_SY_Compu "" TAB_VERB 2 0 "False" 1 "True" /end COMPU_VTAB
/begin COMPU_METHOD CmbNoi "" RAT_FUNC "%6.5" "-" COEFFS 0 1024 0 0 0 1 /end COMPU_METHOD
/begin COMPU_METHOD CMBTYP_SY_Compu "" TAB_VERB "%6.3" "" COMPU_TAB_REF CMBTYP_SY_Compu /end COMPU_METHOD
/begin COMPU_VTAB CMBTYP_SY_Compu "" TAB_VERB 2 0 "CMBTYP_DS" 1 "CMBTYP_GS" /end COMPU_VTAB
/begin COMPU_METHOD CMPRHP2DST_TYPAVL_SC_Compu "" TAB_VERB "%6.3" "" COMPU_TAB_REF CMPRHP2DST_TYPAVL_SC_Compu /end COMPU_METHOD
/begin COMPU_VTAB CMPRHP2DST_TYPAVL_SC_Compu "" TAB_VERB 2 0 "False" 1 "True" /end COMPU_VTAB
/begin COMPU_METHOD Cnd_uS_DIV_Cm_q0p01_COMPU "" RAT_FUNC "%6.4" "µS/Cm" COEFFS 0 100 0 0 0 1 /end COMPU_METHOD
/begin COMPU_METHOD CnvtCoeffCatAir "" RAT_FUNC "%6.4" "J/K/s/m^2" COEFFS 0 50 0 0 0 1 /end COMPU_METHOD
/begin COMPU_METHOD CoeffA "" RAT_FUNC "%6.4" "1/(s*Nm)" COEFFS 0 204.8 0 0 0 1 /end COMPU_METHOD
/begin COMPU_METHOD CoEOMSwt "" RAT_FUNC "%10.9" "-" COEFFS 0 16384000 0 0 0 1 /end COMPU_METHOD
/begin COMPU_METHOD CoEOMSwt_S16 "" RAT_FUNC "%7.6" "-" COEFFS 0 16384 0 0 0 1 /end COMPU_METHOD
/begin COMPU_METHOD COEOM_INJCRVMI1NUMMAP_SY_Compu "" RAT_FUNC "%6.2" "" COEFFS 0 1 0 0 0 1 /end COMPU_METHOD
/begin COMPU_METHOD COEOM_INJCRVMI1NUMSWTDES_SY_Compu "" RAT_FUNC "%6.2" "" COEFFS 0 1 0 0 0 1 /end COMPU_METHOD
/begin COMPU_METHOD COEOM_INJCRVPII1NUMMAP_SY_Compu "" RAT_FUNC "%6.2" "" COEFFS 0 1 0 0 0 1 /end COMPU_METHOD
/begin COMPU_METHOD COEOM_INJCRVPII1NUMSWTDES_SY_Compu "" RAT_FUNC "%6.2" "" COEFFS 0 1 0 0 0 1 /end COMPU_METHOD
/begin COMPU_METHOD COEOM_INJCRVPII2NUMMAP_SY_Compu "" RAT_FUNC "%6.2" "" COEFFS 0 1 0 0 0 1 /end COMPU_METHOD
/begin COMPU_METHOD COEOM_INJCRVPII2NUMSWTDES_SY_Compu "" RAT_FUNC "%6.2" "" COEFFS 0 1 0 0 0 1 /end COMPU_METHOD
/begin COMPU_METHOD COEOM_INJCRVPOI1NUMMAP_SY_Compu "" RAT_FUNC "%6.2" "" COEFFS 0 1 0 0 0 1 /end COMPU_METHOD
/begin COMPU_METHOD COEOM_INJCRVPOI1NUMSWTDES_SY_Compu "" RAT_FUNC "%6.2" "" COEFFS 0 1 0 0 0 1 /end COMPU_METHOD
/begin COMPU_METHOD COEOM_INJCRVPOI2NUMMAP_SY_Compu "" RAT_FUNC "%6.2" "" COEFFS 0 1 0 0 0 1 /end COMPU_METHOD
/begin COMPU_METHOD COEOM_INJCRVPOI2NUMSWTDES_SY_Compu "" RAT_FUNC "%6.2" "" COEFFS 0 1 0 0 0 1 /end COMPU_METHOD
/begin COMPU_METHOD COEOM_INJCRVPOI3NUMMAP_SY_Compu "" RAT_FUNC "%6.2" "" COEFFS 0 1 0 0 0 1 /end COMPU_METHOD
/begin COMPU_METHOD COEOM_INJCRVPOI3NUMSWTDES_SY_Compu "" RAT_FUNC "%6.2" "" COEFFS 0 1 0 0 0 1 /end COMPU_METHOD
/begin COMPU_METHOD COEOM_TYP_SY_Compu "" TAB_VERB "%6.3" "" COMPU_TAB_REF COEOM_TYP_SY_Compu /end COMPU_METHOD
/begin COMPU_VTAB COEOM_TYP_SY_Compu "" TAB_VERB 2 1 "HESRV_SNGLFLW" 2 "HESRV_TWFLW" /end COMPU_VTAB
/begin COMPU_METHOD COMassPerTime "" RAT_FUNC "%6.4" "mg/s" COEFFS 0 20 0 0 0 1 /end COMPU_METHOD
/begin COMPU_METHOD COMM_SC_Compu "" TAB_VERB "%6.3" "" COMPU_TAB_REF COMM_SC_Compu /end COMPU_METHOD
/begin COMPU_VTAB COMM_SC_Compu "" TAB_VERB 2 0 "False" 1 "True" /end COMPU_VTAB
/begin COMPU_METHOD COM_SC_Compu "" TAB_VERB "%6.3" "" COMPU_TAB_REF COM_SC_Compu /end COMPU_METHOD
/begin COMPU_VTAB COM_SC_Compu "" TAB_VERB 2 0 "False" 1 "True" /end COMPU_VTAB
/begin COMPU_METHOD CONDRDSFLDP_TYPAVL_SC_Compu "" TAB_VERB "%6.3" "" COMPU_TAB_REF CONDRDSFLDP_TYPAVL_SC_Compu /end COMPU_METHOD
/begin COMPU_VTAB CONDRDSFLDP_TYPAVL_SC_Compu "" TAB_VERB 2 0 "False" 1 "True" /end COMPU_VTAB
/begin COMPU_METHOD CONDRDSFLDT_TYPAVL_SC_Compu "" TAB_VERB "%6.3" "" COMPU_TAB_REF CONDRDSFLDT_TYPAVL_SC_Compu /end COMPU_METHOD
/begin COMPU_VTAB CONDRDSFLDT_TYPAVL_SC_Compu "" TAB_VERB 2 0 "False" 1 "True" /end COMPU_VTAB
/begin COMPU_METHOD CONDRUSCOOLTT_TYPAVL_SC_Compu "" TAB_VERB "%6.3" "" COMPU_TAB_REF CONDRUSCOOLTT_TYPAVL_SC_Compu /end COMPU_METHOD
/begin COMPU_VTAB CONDRUSCOOLTT_TYPAVL_SC_Compu "" TAB_VERB 2 0 "False" 1 "True" /end COMPU_VTAB
/begin COMPU_METHOD CONDRUSFLDT_TYPAVL_SC_Compu "" TAB_VERB "%6.3" "" COMPU_TAB_REF CONDRUSFLDT_TYPAVL_SC_Compu /end COMPU_METHOD
/begin COMPU_VTAB CONDRUSFLDT_TYPAVL_SC_Compu "" TAB_VERB 2 0 "False" 1 "True" /end COMPU_VTAB
/begin COMPU_METHOD COOLTPIN_TYPAVL_SC_Compu "" TAB_VERB "%6.3" "" COMPU_TAB_REF COOLTPIN_TYPAVL_SC_Compu /end COMPU_METHOD
/begin COMPU_VTAB COOLTPIN_TYPAVL_SC_Compu "" TAB_VERB 2 0 "False" 1 "True" /end COMPU_VTAB
/begin COMPU_METHOD COOLTPOUT_TYPAVL_SC_Compu "" TAB_VERB "%6.3" "" COMPU_TAB_REF COOLTPOUT_TYPAVL_SC_Compu /end COMPU_METHOD
/begin COMPU_VTAB COOLTPOUT_TYPAVL_SC_Compu "" TAB_VERB 2 0 "False" 1 "True" /end COMPU_VTAB
/begin COMPU_METHOD DDRCTime_ms "" RAT_FUNC "%6.1" "ms" COEFFS 0 1 0 0 0 10 /end COMPU_METHOD
/begin COMPU_METHOD DDRC_Ratio "" TAB_VERB "%6.3" "-" COMPU_TAB_REF DDRC_Ratio /end COMPU_METHOD
/begin COMPU_VTAB DDRC_Ratio "" TAB_VERB 4 1 "Ratio1" 2 "Ratio2" 3 "Ratio3" 4 "Ratio4" /end COMPU_VTAB
/begin COMPU_METHOD DELIB_ALLTEMP_VERB_COMPU "" TAB_VERB "%6.3" "" COMPU_TAB_REF DELIB_ALLTEMP_VERB_COMPU /end COMPU_METHOD
/begin COMPU_VTAB DELIB_ALLTEMP_VERB_COMPU "" TAB_VERB 6 85 "ACCHRGRINTKT" 86 "DCCHRGRINTKT" 0 "ENVT" 89 "HEATRCORET" 254 "DFLTEMP" 255 "NOTEMP" /end COMPU_VTAB
/begin COMPU_METHOD DFC_OneToOne "" RAT_FUNC "%6.2" "-" COEFFS 0 1 0 0 0 1 /end COMPU_METHOD
/begin COMPU_METHOD DFES_OneToOne "" RAT_FUNC "%6.2" "-" COEFFS 0 1 0 0 0 1 /end COMPU_METHOD
/begin COMPU_METHOD DINH_ct_Compu "" RAT_FUNC "%6.0" "" COEFFS 0 -1 4096 0 0 1 /end COMPU_METHOD
/begin COMPU_METHOD DtyCyc "" RAT_FUNC "%6.4" "%" COEFFS 0 100 0 0 0 1 /end COMPU_METHOD
/begin COMPU_METHOD EngN "" RAT_FUNC "%6.3" "rpm" COEFFS 0 2 0 0 0 1 /end COMPU_METHOD
/begin COMPU_METHOD InjMass "" RAT_FUNC "%6.4" "mg/hub" COEFFS 0 100 0 0 0 1 /end COMPU_METHOD
/begin COMPU_METHOD OneToOne "" RAT_FUNC "%6.2" "-" COEFFS 0 1 0 0 0 1 /end COMPU_METHOD
/begin COMPU_METHOD Prc "" RAT_FUNC "%6.4" "%" COEFFS 0 81.92 0 0 0 1 /end COMPU_METHOD
/begin COMPU_METHOD q1 "" RAT_FUNC "%6.2" "-" COEFFS 0 1 0 0 0 1 /end COMPU_METHOD
/begin COMPU_METHOD q5Em4 "" RAT_FUNC "%6.5" "-" COEFFS 0 2000 0 0 0 1 /end COMPU_METHOD
/begin COMPU_METHOD RBPtCel_dt_1p0_1 "" RAT_FUNC "%6.2" "K/s" COEFFS 0 1 0 0 0 1 /end COMPU_METHOD
/begin COMPU_METHOD RBPtCel_du_1p0_1 "" RAT_FUNC "%6.2" "V/s" COEFFS 0 1 0 0 0 1 /end COMPU_METHOD
/begin COMPU_METHOD RBPtCel_i_0p03125_1 "" RAT_FUNC "%6.4" "A" COEFFS 0 32 0 0 0 1 /end COMPU_METHOD
/begin COMPU_METHOD RBPtCel_i_0p25_1 "" RAT_FUNC "%6.3" "A" COEFFS 0 4 0 0 0 1 /end COMPU_METHOD
/begin COMPU_METHOD RBPtCel_i_1p0_2 "" RAT_FUNC "%6.2" "A" COEFFS 0 1 0 0 0 1 /end COMPU_METHOD
/begin COMPU_METHOD RBPtCel_pwr_1p0_1 "" RAT_FUNC "%6.2" "W" COEFFS 0 1 0 0 0 1 /end COMPU_METHOD
/begin COMPU_METHOD RBPtCel_pwr_25p0_1 "" RAT_FUNC "%6.1" "W" COEFFS 0 1 0 0 0 25 /end COMPU_METHOD
/begin COMPU_METHOD RBPtCel_r_1p0_1 "" RAT_FUNC "%6.2" "Ohm" COEFFS 0 1 0 0 0 1 /end COMPU_METHOD
/begin COMPU_METHOD RBPtCel_ti_0p01_1 "" RAT_FUNC "%6.4" "s" COEFFS 0 100 0 0 0 1 /end COMPU_METHOD
/begin COMPU_METHOD RBPtCel_ti_0p1_1 "" RAT_FUNC "%6.3" "s" COEFFS 0 10 0 0 0 1 /end COMPU_METHOD
/begin COMPU_METHOD RBPtCel_ti_1p0_2 "" RAT_FUNC "%6.2" "s" COEFFS 0 1 0 0 0 1 /end COMPU_METHOD
/begin COMPU_METHOD RBPtCel_t_1p0_3 "" RAT_FUNC "%6.2" "Deg C" COEFFS 0 1 0 0 0 1 /end COMPU_METHOD
/begin COMPU_METHOD RBPtCel_u_0p1_1 "" RAT_FUNC "%6.3" "V" COEFFS 0 10 0 0 0 1 /end COMPU_METHOD
/begin COMPU_METHOD RBPtCel_u_1p0_1 "" RAT_FUNC "%6.2" "V" COEFFS 0 1 0 0 0 1 /end COMPU_METHOD
/begin COMPU_METHOD RBPtCel_u_1p0_2 "" RAT_FUNC "%6.2" "mV" COEFFS 0 1 0 0 0 1 /end COMPU_METHOD
/begin COMPU_METHOD RBPtEChrDv_stCtP_VERB "" TAB_VERB "%6.3" "" COMPU_TAB_REF RBPtEChrDv_stCtP_VERB /end COMPU_METHOD
/begin COMPU_VTAB RBPtEChrDv_stCtP_VERB "" TAB_VERB 10 0 "ERROR" 1 "IMPLAUSIBLE" 2 "B1" 3 "B2" 4 "C1" 5 "C2" 6 "D1" 7 "D2" 8 "X1" 9 "X2" /end COMPU_VTAB
/begin COMPU_METHOD SigQly_COMPU_VERB "" TAB_VERB "%6.3" "" COMPU_TAB_REF SigQly_COMPU_VERB /end COMPU_METHOD
/begin COMPU_VTAB SigQly_COMPU_VERB "" TAB_VERB 16 0 "SIGQLY_NOTCALC" 1 "SIGQLY_INIT" 2 "SIGQLY_OK" 3 "SIGQLY_MODEL" 4 "SIGQLY_REPLACEMENT" 5 "SIGQLY_FROZEN" 6 "SIGQLY_INVALID" 7 "SIGQLY_RESERVED_7" 8 "SIGQLY_RESERVED_8" 9 "SIGQLY_RESERVED_9" 10 "SIGQLY_RESERVED_10" 11 "SIGQLY_RESERVED_11" 12 "SIGQLY_RESERVED_12" 13 "SIGQLY_RESERVED_13" 14 "SIGQLY_RESERVED_14" 15 "SIGQLY_RESERVED_15" /end COMPU_VTAB
/begin COMPU_METHOD SrvB_SWTmrS16 "" RAT_FUNC "%6.2" "-" COEFFS 0 1 0 0 0 1 /end COMPU_METHOD
/begin COMPU_METHOD Temp_Cels "" RAT_FUNC "%6.1" "deg C" COEFFS 0 10 2731.4 0 0 1 /end COMPU_METHOD
/begin COMPU_METHOD TimeDelay_s "" RAT_FUNC "%6.1" "s" COEFFS 0 0 1 0 0.00023283064365387 0 /end COMPU_METHOD
/begin COMPU_METHOD Time_ms "" RAT_FUNC "%6.1" "ms" COEFFS 0 0.1 0 0 0 1 /end COMPU_METHOD
/begin COMPU_METHOD Time_s "" RAT_FUNC "%6.4" "s" COEFFS 0 100 0 0 0 1 /end COMPU_METHOD
/begin COMPU_METHOD Volt "" RAT_FUNC "%6.3" "mV" COEFFS 0 5 0 0 0 1 /end COMPU_METHOD
/begin COMPU_METHOD Volt_V_q0p03125_COMPU "" RAT_FUNC "%6.4" "V" COEFFS 0 32 0 0 0 1 /end COMPU_METHOD
/begin COMPU_METHOD defaultAscii "" RAT_FUNC "%6.2" "" COEFFS 0 1 0 0 0 1 /end COMPU_METHOD
/begin RECORD_LAYOUT Kw_Wr32 FNC_VALUES 1 FLOAT32_IEEE COLUMN_DIR DIRECT /end RECORD_LAYOUT
/begin RECORD_LAYOUT Kw_Ws16 FNC_VALUES 1 SWORD COLUMN_DIR DIRECT /end RECORD_LAYOUT
/begin RECORD_LAYOUT Kw_Wu32 FNC_VALUES 1 ULONG COLUMN_DIR DIRECT /end RECORD_LAYOUT
/begin RECORD_LAYOUT Kw_Wu8 FNC_VALUES 1 UBYTE COLUMN_DIR DIRECT /end RECORD_LAYOUT
/begin RECORD_LAYOUT RB_Curve_R32_R32_sao NO_AXIS_PTS_X 1 ULONG AXIS_PTS_X 2 FLOAT32_IEEE INDEX_INCR DIRECT FNC_VALUES 3 FLOAT32_IEEE COLUMN_DIR DIRECT STATIC_ADDRESS_OFFSETS /end RECORD_LAYOUT
/begin RECORD_LAYOUT RB_Curve_S16_S16 NO_AXIS_PTS_X 1 SWORD AXIS_PTS_X 2 SWORD INDEX_INCR DIRECT FNC_VALUES 3 SWORD COLUMN_DIR DIRECT /end RECORD_LAYOUT
/begin RECORD_LAYOUT RB_Curve_S16_S32_sao NO_AXIS_PTS_X 1 SWORD AXIS_PTS_X 2 SWORD INDEX_INCR DIRECT FNC_VALUES 3 SLONG COLUMN_DIR DIRECT STATIC_ADDRESS_OFFSETS /end RECORD_LAYOUT
/begin RECORD_LAYOUT RB_Curve_U16_U16 NO_AXIS_PTS_X 1 UWORD AXIS_PTS_X 2 UWORD INDEX_INCR DIRECT FNC_VALUES 3 UWORD COLUMN_DIR DIRECT /end RECORD_LAYOUT
/begin RECORD_LAYOUT RB_Map_S16S16_R32_sao NO_AXIS_PTS_X 1 SWORD NO_AXIS_PTS_Y 2 SWORD AXIS_PTS_X 3 SWORD INDEX_INCR DIRECT AXIS_PTS_Y 4 SWORD INDEX_INCR DIRECT FNC_VALUES 5 FLOAT32_IEEE COLUMN_DIR DIRECT STATIC_ADDRESS_OFFSETS /end RECORD_LAYOUT
/begin RECORD_LAYOUT RB_Map_S16S16_U8_sao NO_AXIS_PTS_X 1 SWORD NO_AXIS_PTS_Y 2 SWORD AXIS_PTS_X 3 SWORD INDEX_INCR DIRECT AXIS_PTS_Y 4 SWORD INDEX_INCR DIRECT FNC_VALUES 5 UBYTE COLUMN_DIR DIRECT STATIC_ADDRESS_OFFSETS /end RECORD_LAYOUT
/begin RECORD_LAYOUT RB_Val_Wr32 FNC_VALUES 1 FLOAT32_IEEE COLUMN_DIR DIRECT /end RECORD_LAYOUT
/begin RECORD_LAYOUT RB_Val_Ws16 FNC_VALUES 1 SWORD COLUMN_DIR DIRECT /end RECORD_LAYOUT
/begin RECORD_LAYOUT RB_Val_Ws32 FNC_VALUES 1 SLONG COLUMN_DIR DIRECT /end RECORD_LAYOUT
/begin RECORD_LAYOUT RB_Val_Wu16 FNC_VALUES 1 UWORD COLUMN_DIR DIRECT /end RECORD_LAYOUT
/begin RECORD_LAYOUT RB_Val_Wu32 FNC_VALUES 1 ULONG COLUMN_DIR DIRECT /end RECORD_LAYOUT
/begin RECORD_LAYOUT RB_Val_Wu8 FNC_VALUES 1 UBYTE COLUMN_DIR DIRECT /end RECORD_LAYOUT
/begin RECORD_LAYOUT ValA_Wu8 FNC_VALUES 1 UBYTE COLUMN_DIR DIRECT /end RECORD_LAYOUT
/begin RECORD_LAYOUT Val_Wr32 FNC_VALUES 1 FLOAT32_IEEE COLUMN_DIR DIRECT /end RECORD_LAYOUT
/begin RECORD_LAYOUT Val_Ws16 FNC_VALUES 1 SWORD COLUMN_DIR DIRECT /end RECORD_LAYOUT
/begin RECORD_LAYOUT Val_Ws32 FNC_VALUES 1 SLONG COLUMN_DIR DIRECT /end RECORD_LAYOUT
/begin RECORD_LAYOUT Val_Wu16 FNC_VALUES 1 UWORD COLUMN_DIR DIRECT /end RECORD_LAYOUT
/begin RECORD_LAYOUT Val_Wu32 FNC_VALUES 1 ULONG COLUMN_DIR DIRECT /end RECORD_LAYOUT
/begin RECORD_LAYOUT Val_Wu8 FNC_VALUES 1 UBYTE COLUMN_DIR DIRECT /end RECORD_LAYOUT
/end MODULE
/end PROJECT

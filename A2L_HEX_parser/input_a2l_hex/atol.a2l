ASAP2_VERSION 1 70
/begin PROJECT MDG1C "VC1CP091_STLA_N_D061I3"
/begin HEADER "" VERSION "VC1CP091_STLA_N_D061I3" PROJECT_NO MDG1C /end HEADER
/begin MODULE DIM ""
/begin MOD_COMMON "" BYTE_ORDER MSB_LAST ALIGNMENT_BYTE 1 ALIGNMENT_WORD 2 ALIGNMENT_LONG 4 ALIGNMENT_INT64 4 ALIGNMENT_FLOAT32_IEEE 4 ALIGNMENT_FLOAT64_IEEE 4 DATA_SIZE 32 /end MOD_COMMON
/begin CHARACTERISTIC DFC_CtlMsk2.DFC_MoFTqPtdAxle_C "" VALUE 0x80241670 Val_Wu8 255.0 DFES_OneToOne 0.00 255.0 FORMAT "%5.1" /end CHARACTERISTIC
/begin CHARACTERISTIC DFC_CtlMsk2.DFC_MoFTqPtdAxleSec_C "" VALUE 0x80241671 Val_Wu8 255.0 DFES_OneToOne 0.00 255.0 FORMAT "%5.1" /end CHARACTERISTIC
/begin CHARACTERISTIC DFC_CtlMsk2.DFC_MoFTqPtdEmPtRels_C "" VALUE 0x80241672 Val_Wu8 255.0 DFES_OneToOne 0.00 255.0 FORMAT "%5.1" /end CHARACTERISTIC
/begin CHARACTERISTIC DFC_CtlMsk2.DFC_MoFTqPtdEmPtRelsSec_C "" VALUE 0x80241673 Val_Wu8 255.0 DFES_OneToOne 0.00 255.0 FORMAT "%5.1" /end CHARACTERISTIC
/begin CHARACTERISTIC DFC_CtlMsk2.DFC_MoFTqPtdEmSign_C "" VALUE 0x80241674 Val_Wu8 255.0 DFES_OneToOne 0.00 255.0 FORMAT "%5.1" /end CHARACTERISTIC
/begin CHARACTERISTIC DFC_CtlMsk2.DFC_MoFTqPtdEmSignSec_C "" VALUE 0x80241675 Val_Wu8 255.0 DFES_OneToOne 0.00 255.0 FORMAT "%5.1" /end CHARACTERISTIC
/begin CHARACTERISTIC DFC_CtlMsk2.DFC_MoFTqPtdEmTq_C "" VALUE 0x80241676 Val_Wu8 255.0 DFES_OneToOne 0.00 255.0 FORMAT "%5.1" /end CHARACTERISTIC
/begin CHARACTERISTIC DFC_CtlMsk2.DFC_MoFTqPtdEmTqSec_C "" VALUE 0x80241677 Val_Wu8 255.0 DFES_OneToOne 0.00 255.0 FORMAT "%5.1" /end CHARACTERISTIC
/begin CHARACTERISTIC DFC_DisblMsk2.DFC_MoFTqPtdAxle_C "" VALUE 0x802491C6 Val_Wu16 65535.00 DFES_OneToOne 0.00 65535.00 FORMAT "%8.2" /end CHARACTERISTIC
/begin CHARACTERISTIC DFC_DisblMsk2.DFC_MoFTqPtdAxleSec_C "" VALUE 0x802491C8 Val_Wu16 65535.00 DFES_OneToOne 0.00 65535.00 FORMAT "%8.2" /end CHARACTERISTIC
/begin CHARACTERISTIC DFC_DisblMsk2.DFC_MoFTqPtdEmPtRels_C "" VALUE 0x802491CA Val_Wu16 65535.00 DFES_OneToOne 0.00 65535.00 FORMAT "%8.2" /end CHARACTERISTIC
/begin CHARACTERISTIC DFC_DisblMsk2.DFC_MoFTqPtdEmPtRelsSec_C "" VALUE 0x802491CC Val_Wu16 65535.00 DFES_OneToOne 0.00 65535.00 FORMAT "%8.2" /end CHARACTERISTIC
/begin CHARACTERISTIC DFC_DisblMsk2.DFC_MoFTqPtdEmSign_C "" VALUE 0x802491CE Val_Wu16 65535.00 DFES_OneToOne 0.00 65535.00 FORMAT "%8.2" /end CHARACTERISTIC
/begin CHARACTERISTIC DFC_DisblMsk2.DFC_MoFTqPtdEmSignSec_C "" VALUE 0x802491D0 Val_Wu16 65535.00 DFES_OneToOne 0.00 65535.00 FORMAT "%8.2" /end CHARACTERISTIC
/begin CHARACTERISTIC DFC_DisblMsk2.DFC_MoFTqPtdEmTq_C "" VALUE 0x802491D2 Val_Wu16 65535.00 DFES_OneToOne 0.00 65535.00 FORMAT "%8.2" /end CHARACTERISTIC
/begin CHARACTERISTIC DFC_DisblMsk2.DFC_MoFTqPtdEmTqSec_C "" VALUE 0x802491D4 Val_Wu16 65535.00 DFES_OneToOne 0.00 65535.00 FORMAT "%8.2" /end CHARACTERISTIC
/begin CHARACTERISTIC MoFPtdEm_tqLoss_C "Initial calibration value for MoFPtdEm_tqLoss" VALUE 0x8026DE86 Val_Ws16 6553.500 Trq -3276.800 3276.700 FORMAT "%8.3" /end CHARACTERISTIC
/begin CHARACTERISTIC MoFRelsMngt_stCrash_C "Calibration for MoFRelsMngt_stCrash" VALUE 0x8026CF16 Val_Wu8 255.0 OneToOne 0.00 255.0 FORMAT "%5.1" /end CHARACTERISTIC
/begin CHARACTERISTIC MoFRelsMngt_stHvbFltLvl_C "Calibration for HvBatt Fault" VALUE 0x8026CF17 Val_Wu8 255.0 OneToOne 0.00 255.0 FORMAT "%5.1" /end CHARACTERISTIC
/begin CHARACTERISTIC MoFRelsMngt_stIvtrIntlckCls_C "Calibration HV Interlock closed" VALUE 0x8026CF18 Val_Wu8 255.0 OneToOne 0.00 255.0 FORMAT "%5.1" /end CHARACTERISTIC
/begin CHARACTERISTIC MoFRelsMngt_stIvtrIntlckOpn_C "Calibration HV Interlock open" VALUE 0x8026CF19 Val_Wu8 255.0 OneToOne 0.00 255.0 FORMAT "%5.1" /end CHARACTERISTIC
/begin CHARACTERISTIC MoFRelsMngt_stModePark_C "Default value for gear lever park position" VALUE 0x8026CF1A Val_Wu8 255.0 OneToOne 0.00 255.0 FORMAT "%5.1" /end CHARACTERISTIC
/begin CHARACTERISTIC MoFRelsMngt_stSwtCfgFltBms_C "Calibration for software configuration for BMS" VALUE 0x8026CF1B Val_Wu8 255.0 OneToOne 0.00 255.0 FORMAT "%5.1" /end CHARACTERISTIC
/begin CHARACTERISTIC MoFRelsMngt_stSwtCfgFltEm_C "Calibration for software confiiguration for Em" VALUE 0x8026CF1C Val_Wu8 255.0 OneToOne 0.00 255.0 FORMAT "%5.1" /end CHARACTERISTIC
/begin CHARACTERISTIC MoFRelsMngt_stSwtCfgPtRels_C "Configuration switch for calculation of powertrain release" VALUE 0x8026CF1D Val_Wu8 255.0 OneToOne 0.00 255.0 FORMAT "%5.1" /end CHARACTERISTIC
/begin CHARACTERISTIC MoFRelsMngt_stSwtCfgPtRstRels_C "Configuration switch for calculation of powertrain release reset" VALUE 0x8026CF1E Val_Wu8 255.0 OneToOne 0.00 255.0 FORMAT "%5.1" /end CHARACTERISTIC
/begin CHARACTERISTIC MoFRelsMngt_vVehDrvThd_C "Speed limit above which a drive train release during driving can be grante" VALUE 0x8026D768 Val_Ws16 327.6700 Vel 0.00 327.6700 FORMAT "%8.4" EXTENDED_LIMITS -327.6800 327.6700 /end CHARACTERISTIC
/begin CHARACTERISTIC MoFRelsMngt_vVehHaltThd_C "Speed limit under which a dirve train release can not be granted since the vehicle is almost in standstill" VALUE 0x8026D76A Val_Ws16 327.6700 Vel 0.00 327.6700 FORMAT "%8.4" EXTENDED_LIMITS -327.6800 327.6700 /end CHARACTERISTIC
/begin CHARACTERISTIC MoFRelsMngt_vVehPlgInsThd_C "Vehicle speed threshold to inhibit power train release condition" VALUE 0x8026D76C Val_Ws16 327.6700 Vel 0.00 327.6700 FORMAT "%8.4" EXTENDED_LIMITS -327.6800 327.6700 /end CHARACTERISTIC
/begin CHARACTERISTIC MoFRelsMngt_vVehSpdThd_C "Calibration for vehicle speed check" VALUE 0x8026D76E Val_Ws16 327.6700 Vel 0.00 327.6700 FORMAT "%8.4" EXTENDED_LIMITS -327.6800 327.6700 /end CHARACTERISTIC
/begin CHARACTERISTIC MoFTqPtdAxleSec_cntrTestComp_C "Diagnosis test counter threshold to heal DFC_MoFTqPtdAxle" VALUE 0x80270617 Val_Wu8 255.0 OneToOne 0.00 255.0 FORMAT "%5.1" /end CHARACTERISTIC
/begin CHARACTERISTIC MoFTqPtdAxleSec_cntrTqCompMax_C "Error threshold in torque comparison on secondary axle level in function monitoring" VALUE 0x8026CF20 Val_Wu8 255.0 OneToOne 0.00 255.0 FORMAT "%5.1" /end CHARACTERISTIC
/begin CHARACTERISTIC MoFTqPtdAxleSec_enaOthTrqCompErr_C "Secondary e-machine or vehicle level torque comparison error consider in torque comparison at secondary axle level" VALUE 0x8026CF21 Val_Wu8 255.0 OneToOne 0.00 255.0 FORMAT "%5.1" /end CHARACTERISTIC
/begin CHARACTERISTIC MoFTqPtdAxleSec_ratTqDifAxleWght_T "Factor of error wheigh in torque comparison on secondary axle level" CURVE 0x8026D770 Mo_DataCurveSstS16WS16 655.3500 fak_q0p01 -327.6800 327.6700 FORMAT "%8.4"
 /begin AXIS_DESCR STD_AXIS MoFTqPtdAxleSec_tqSecAxleCoordLoResl TrqPrp 8 -52428.80 52427.20 FORMAT "%8.2" DEPOSIT ABSOLUTE /end AXIS_DESCR
/end CHARACTERISTIC
/begin CHARACTERISTIC MoFTqPtdAxleSec_tqNegPtdOffs_M "Permitted negative offset for torque limits on secondary axle level" MAP 0x8026D792 Map_Xs16Ys16Ws16 52428.80 TrqPrp -52428.80 0.00 FORMAT "%8.2" EXTENDED_LIMITS -52428.80 52427.20
 /begin AXIS_DESCR STD_AXIS MoFTqPtdAxleSec_tqSecAxleCoordLoResl TrqPrp 8 -52428.80 52427.20 FORMAT "%8.2" DEPOSIT ABSOLUTE /end AXIS_DESCR
 /begin AXIS_DESCR STD_AXIS MoFBas_vVeh Vel 8 -327.6800 327.6700 FORMAT "%8.4" DEPOSIT ABSOLUTE /end AXIS_DESCR
/end CHARACTERISTIC
/begin CHARACTERISTIC MoFTqPtdAxleSec_tqNegStatyLim_C "Permitted negative stationary torque on secondary axle level" VALUE 0x8026D130 Val_Ws32 429496729.500 TrqPrpHigh -214748364.800 214748364.700 FORMAT "%13.3" /end CHARACTERISTIC
/begin CHARACTERISTIC MoFTqPtdAxleSec_tqPosPtdOffs_M "Permitted positive offset for torque limits on secondary axle level" MAP 0x8026D836 Map_Xs16Ys16Ws16 52427.20 TrqPrp 0.00 52427.20 FORMAT "%8.2" EXTENDED_LIMITS -52428.80 52427.20
 /begin AXIS_DESCR STD_AXIS MoFTqPtdAxleSec_tqSecAxleCoordLoResl TrqPrp 8 -52428.80 52427.20 FORMAT "%8.2" DEPOSIT ABSOLUTE /end AXIS_DESCR
 /begin AXIS_DESCR STD_AXIS MoFBas_vVeh Vel 8 -327.6800 327.6700 FORMAT "%8.4" DEPOSIT ABSOLUTE /end AXIS_DESCR
/end CHARACTERISTIC
/begin CHARACTERISTIC MoFTqPtdAxleSec_tqPosStatyLim_C "Permitted positive stationary torque on secondary axle level" VALUE 0x8026D134 Val_Ws32 429496729.500 TrqPrpHigh -214748364.800 214748364.700 FORMAT "%13.3" /end CHARACTERISTIC
/begin CHARACTERISTIC MoFTqPtdAxleSec_tqTiIntegDec_C "Constant for reduction of torque integral on freedom from defects" VALUE 0x8026D138 Val_Ws32 2147483.64700 mdt_q0p001_Nm_s 0.00 2147483.64700 FORMAT "%13.5" EXTENDED_LIMITS -2147483.64800 2147483.64700 /end CHARACTERISTIC
/begin CHARACTERISTIC MoFTqPtdAxleSec_tqTiIntegErr_C "Threshold of error detection in torque integral check" VALUE 0x8026D13C Val_Ws32 2147483.64700 mdt_q0p001_Nm_s 0.00 2147483.64700 FORMAT "%13.5" EXTENDED_LIMITS -2147483.64800 2147483.64700 /end CHARACTERISTIC
/begin CHARACTERISTIC MoFTqPtdAxleSec_tqTiIntegMax_C "Maximum filling level of torque integral check" VALUE 0x8026D140 Val_Ws32 2147483.64700 mdt_q0p001_Nm_s 0.00 2147483.64700 FORMAT "%13.5" EXTENDED_LIMITS -2147483.64800 2147483.64700 /end CHARACTERISTIC
/begin CHARACTERISTIC MoFTqPtdAxle_cntrTestComp_C "Diagnosis test counter threshold to heal DFC_MoFTqPtdAxle" VALUE 0x80270618 Val_Wu8 255.0 OneToOne 0.00 255.0 FORMAT "%5.1" /end CHARACTERISTIC
/begin CHARACTERISTIC MoFTqPtdAxle_cntrTqCompMax_C "Error threshold in torque comparison on axle level in function monitoring" VALUE 0x8026CF22 Val_Wu8 255.0 OneToOne 0.00 255.0 FORMAT "%5.1" /end CHARACTERISTIC
/begin CHARACTERISTIC MoFTqPtdAxle_enaOthTrqCompErr_C "e-machine or vehicle level torque comparison error consider in torque comparison at axle level" VALUE 0x8026CF23 Val_Wu8 255.0 OneToOne 0.00 255.0 FORMAT "%5.1" /end CHARACTERISTIC
/begin CHARACTERISTIC MoFTqPtdAxle_facDistbnRampStepMaxNeg_M "Calibratable map for maximum negative offset step ramp distribution factor" MAP 0x8026DA44 Map_Xs16Ys16Ws16 1.000000 fak_q1p22Em4 0.00 1.000000 FORMAT "%8.6" EXTENDED_LIMITS -4.000000 3.999878
 /begin AXIS_DESCR STD_AXIS NO_INPUT_QUANTITY Vel 5 -327.6800 327.6700 FORMAT "%8.4" DEPOSIT ABSOLUTE /end AXIS_DESCR
 /begin AXIS_DESCR STD_AXIS MoFTqPtdAxle_tqWhlDesLoResl TrqPrp 9 -52428.80 52427.20 FORMAT "%8.2" DEPOSIT ABSOLUTE /end AXIS_DESCR
/end CHARACTERISTIC
/begin CHARACTERISTIC MoFTqPtdAxle_facDistbnRampStepMaxPos_M "Calibratable map for maximum positive offset step ramp distribution factor" MAP 0x8026DABE Map_Xs16Ys16Ws16 1.000000 fak_q1p22Em4 0.00 1.000000 FORMAT "%8.6" EXTENDED_LIMITS -4.000000 3.999878
 /begin AXIS_DESCR STD_AXIS NO_INPUT_QUANTITY Vel 5 -327.6800 327.6700 FORMAT "%8.4" DEPOSIT ABSOLUTE /end AXIS_DESCR
 /begin AXIS_DESCR STD_AXIS MoFTqPtdAxle_tqWhlDesLoResl TrqPrp 9 -52428.80 52427.20 FORMAT "%8.2" DEPOSIT ABSOLUTE /end AXIS_DESCR
/end CHARACTERISTIC
/begin CHARACTERISTIC MoFTqPtdAxle_facTqDistbnIni_C "Initialisation factor during SW reset" VALUE 0x8026DB38 Val_Ws16 1.000000 fak_q1p22Em4 0.00 1.000000 FORMAT "%8.6" EXTENDED_LIMITS -4.000000 3.999878 /end CHARACTERISTIC
/begin CHARACTERISTIC MoFTqPtdAxle_facTqDistbnMax_C "Maximum saturation for strategic torque distribution factor" VALUE 0x8026DB3A Val_Ws16 1.000000 fak_q1p22Em4 0.00 1.000000 FORMAT "%8.6" EXTENDED_LIMITS -4.000000 3.999878 /end CHARACTERISTIC
/begin CHARACTERISTIC MoFTqPtdAxle_facTqDistbnMin_C "Minimum saturation for strategic torque distribution factor" VALUE 0x8026DB3C Val_Ws16 1.000000 fak_q1p22Em4 0.00 1.000000 FORMAT "%8.6" EXTENDED_LIMITS -4.000000 3.999878 /end CHARACTERISTIC
/begin CHARACTERISTIC MoFTqPtdAxle_facTqDistbnRecup_C "Recuperation factor for torque distribution" VALUE 0x8026DB3E Val_Ws16 1.000000 fak_q1p22Em4 0.00 1.000000 FORMAT "%8.6" EXTENDED_LIMITS -4.000000 3.999878 /end CHARACTERISTIC
/begin CHARACTERISTIC MoFTqPtdAxle_flgSecAxlePrsnt_C "Switch to true if drive on second axle is present" VALUE 0x8026CF24 Val_Wu8 1.00000000000 B_TRUE 0.00 1.00000000000 FORMAT "%13.11" /end CHARACTERISTIC
/begin CHARACTERISTIC MoFTqPtdAxle_ratTqDifAxleWght_T "Factor of error wheigh in torque comparison on axle level" CURVE 0x8026D8DA Mo_DataCurveSstS16WS16 655.3500 fak_q0p01 -327.6800 327.6700 FORMAT "%8.4"
 /begin AXIS_DESCR STD_AXIS MoFTqPtdAxle_tqPrimAxleCoordLoResl TrqPrp 8 -52428.80 52427.20 FORMAT "%8.2" DEPOSIT ABSOLUTE /end AXIS_DESCR
/end CHARACTERISTIC
/begin CHARACTERISTIC MoFTqPtdAxle_swtTwoSpdAxl_C "Switch to enable Two speed axle Configuration" VALUE 0x8026CF25 Val_Wu8 1.00000000000 B_TRUE 0.00 1.00000000000 FORMAT "%13.11" /end CHARACTERISTIC
/begin CHARACTERISTIC MoFTqPtdAxle_tqNegPtdOffs_M "Permitted negative offset for torque limits on axle level" MAP 0x8026D8FC Map_Xs16Ys16Ws16 52428.80 TrqPrp -52428.80 0.00 FORMAT "%8.2" EXTENDED_LIMITS -52428.80 52427.20
 /begin AXIS_DESCR STD_AXIS MoFTqPtdAxle_tqPrimAxleCoordLoResl TrqPrp 8 -52428.80 52427.20 FORMAT "%8.2" DEPOSIT ABSOLUTE /end AXIS_DESCR
 /begin AXIS_DESCR STD_AXIS MoFBas_vVeh Vel 8 -327.6800 327.6700 FORMAT "%8.4" DEPOSIT ABSOLUTE /end AXIS_DESCR
/end CHARACTERISTIC
/begin CHARACTERISTIC MoFTqPtdAxle_tqNegStatyLim_C "Permitted negative stationary torque on axle level" VALUE 0x8026D144 Val_Ws32 429496729.500 TrqPrpHigh -214748364.800 214748364.700 FORMAT "%13.3" /end CHARACTERISTIC
/begin CHARACTERISTIC MoFTqPtdAxle_tqPosPtdOffs_M "Permitted positive offset for torque limits on axle level" MAP 0x8026D9A0 Map_Xs16Ys16Ws16 52427.20 TrqPrp 0.00 52427.20 FORMAT "%8.2" EXTENDED_LIMITS -52428.80 52427.20
 /begin AXIS_DESCR STD_AXIS MoFTqPtdAxle_tqPrimAxleCoordLoResl TrqPrp 8 -52428.80 52427.20 FORMAT "%8.2" DEPOSIT ABSOLUTE /end AXIS_DESCR
 /begin AXIS_DESCR STD_AXIS MoFBas_vVeh Vel 8 -327.6800 327.6700 FORMAT "%8.4" DEPOSIT ABSOLUTE /end AXIS_DESCR
/end CHARACTERISTIC
/begin CHARACTERISTIC MoFTqPtdAxle_tqPosStatyLim_C "Permitted positive stationary torque on axle level" VALUE 0x8026D148 Val_Ws32 429496729.500 TrqPrpHigh -214748364.800 214748364.700 FORMAT "%13.3" /end CHARACTERISTIC
/begin CHARACTERISTIC MoFTqPtdAxle_tqPrimNegSlop_C "Parameter for the negative slope of the ramp for primary axle" VALUE 0x8026D158 Val_Ws32 429496729.500 mdt_q0p1_Nm_DIV_s -214748364.800 214748364.700 FORMAT "%13.3" /end CHARACTERISTIC
/begin CHARACTERISTIC MoFTqPtdAxle_tqPrimPosSlop_C "Parameter for the positive slope of the ramp for primary axle" VALUE 0x8026D15C Val_Ws32 429496729.500 mdt_q0p1_Nm_DIV_s -214748364.800 214748364.700 FORMAT "%13.3" /end CHARACTERISTIC
/begin CHARACTERISTIC MoFTqPtdAxle_tqRecupMinPrimAxle_C "Calibration parameter for CRBS minimum torque limit for primary axle" VALUE 0x8026D160 Val_Ws32 429496729.500 TrqPrpHigh -214748364.800 214748364.700 FORMAT "%13.3" /end CHARACTERISTIC
/begin CHARACTERISTIC MoFTqPtdAxle_tqRecupMinSecAxle_C "Calibration parameter for CRBS minimum torque limit for secondary axle" VALUE 0x8026D164 Val_Ws32 429496729.500 TrqPrpHigh -214748364.800 214748364.700 FORMAT "%13.3" /end CHARACTERISTIC
/begin CHARACTERISTIC MoFTqPtdAxle_tqSecNegSlop_C "Parameter for the negative slope of the ramp for secondary axle" VALUE 0x8026D168 Val_Ws32 429496729.500 mdt_q0p1_Nm_DIV_s -214748364.800 214748364.700 FORMAT "%13.3" /end CHARACTERISTIC
/begin CHARACTERISTIC MoFTqPtdAxle_tqSecPosSlop_C "Parameter for the positive slope of the ramp for secondary axle" VALUE 0x8026D16C Val_Ws32 429496729.500 mdt_q0p1_Nm_DIV_s -214748364.800 214748364.700 FORMAT "%13.3" /end CHARACTERISTIC
/begin CHARACTERISTIC MoFTqPtdAxle_tqTiIntegDec_C "Constant for reduction of torque integral on freedom from defects" VALUE 0x8026D14C Val_Ws32 2147483.64700 mdt_q0p001_Nm_s 0.00 2147483.64700 FORMAT "%13.5" EXTENDED_LIMITS -2147483.64800 2147483.64700 /end CHARACTERISTIC
/begin CHARACTERISTIC MoFTqPtdAxle_tqTiIntegErr_C "Threshold of error detection in torque integral check" VALUE 0x8026D150 Val_Ws32 2147483.64700 mdt_q0p001_Nm_s 0.00 2147483.64700 FORMAT "%13.5" EXTENDED_LIMITS -2147483.64800 2147483.64700 /end CHARACTERISTIC
/begin CHARACTERISTIC MoFTqPtdAxle_tqTiIntegMax_C "Maximum filling level of torque integral check" VALUE 0x8026D154 Val_Ws32 2147483.64700 mdt_q0p001_Nm_s 0.00 2147483.64700 FORMAT "%13.5" EXTENDED_LIMITS -2147483.64800 2147483.64700 /end CHARACTERISTIC
/begin CHARACTERISTIC MoFTqPtdAxle_vVehThd_C "Calibration parameter for vehicle speed threshold" VALUE 0x8026DB40 Val_Ws16 655.3500 Vel -327.6800 327.6700 FORMAT "%8.4" /end CHARACTERISTIC
/begin CHARACTERISTIC MoFTqPtdEmSec_cntrErrTqSignMax_C "Error threshold in sign check on secondary e-machine level in function monitoring" VALUE 0x8026CF26 Val_Wu8 255.0 OneToOne 0.00 255.0 FORMAT "%5.1" /end CHARACTERISTIC
/begin CHARACTERISTIC MoFTqPtdEmSec_cntrPtRelsErrMax_C "Error threshold for powertrain release violation" VALUE 0x8026CF27 Val_Wu8 255.0 OneToOne 0.00 255.0 FORMAT "%5.1" /end CHARACTERISTIC
/begin CHARACTERISTIC MoFTqPtdEmSec_cntrTestPtRels_C "Diagnosis test counter threshold to heal DFC_MoFTqPtdEmPtRelsSec." VALUE 0x8027061A Val_Wu8 255.0 OneToOne 0.00 255.0 FORMAT "%5.1" /end CHARACTERISTIC
/begin CHARACTERISTIC MoFTqPtdEmSec_cntrTestSign_C "Diagnosis test counter threshold to heal DFC_MoFTqPtdEmSignSec" VALUE 0x8027061B Val_Wu8 255.0 OneToOne 0.00 255.0 FORMAT "%5.1" /end CHARACTERISTIC
/begin CHARACTERISTIC MoFTqPtdEmSec_cntrTestTq_C "Diagnosis test counter threshold to heal DFC_MoFTqPtdEmTqSec" VALUE 0x8027061C Val_Wu8 255.0 OneToOne 0.00 255.0 FORMAT "%5.1" /end CHARACTERISTIC
/begin CHARACTERISTIC MoFTqPtdEmSec_cntrTqCompMax_C "Error threshold in torque comparison on secondary e-machine level in function monitoring" VALUE 0x8026CF28 Val_Wu8 255.0 OneToOne 0.00 255.0 FORMAT "%5.1" /end CHARACTERISTIC
/begin CHARACTERISTIC MoFTqPtdEmSec_cntrWrgGearSeldMax_C "Error threshold for wrong gear selection in Power train release on secondary e-machine level in function monitoring" VALUE 0x8026CF29 Val_Wu8 255.0 OneToOne 0.00 255.0 FORMAT "%5.1" /end CHARACTERISTIC
/begin CHARACTERISTIC MoFTqPtdEmSec_enaOthTrqCompErr_C "Vehicle or secondary axle level torque comparison error consider in torque comparison at secondary e-machine level" VALUE 0x8026CF2A Val_Wu8 255.0 OneToOne 0.00 255.0 FORMAT "%5.1" /end CHARACTERISTIC
/begin CHARACTERISTIC MoFTqPtdEmSec_nChgGearMaxEm02_C "upper threshold engine speed gear change for EM02" VALUE 0x8026DCDE Val_Ws16 65535.00 nmot_q1 -32768.00 32767.00 FORMAT "%8.2" /end CHARACTERISTIC
/begin CHARACTERISTIC MoFTqPtdEmSec_nChgGearMinEm02_C "lower threshold engine speed gear change for EM02" VALUE 0x8026DCE0 Val_Ws16 65535.00 nmot_q1 -32768.00 32767.00 FORMAT "%8.2" /end CHARACTERISTIC
/begin CHARACTERISTIC MoFTqPtdEmSec_ratTqDifEmWght_T "Factor of error wheigh in torque comparison on secondary e-machine level" CURVE 0x8026DB42 Mo_DataCurveSstS16WS16 655.3500 fak_q0p01 -327.6800 327.6700 FORMAT "%8.4"
 /begin AXIS_DESCR STD_AXIS MoFTqPtdEmSec_tqTranEm02 Trq 8 -3276.800 3276.700 FORMAT "%8.3" DEPOSIT ABSOLUTE /end AXIS_DESCR
/end CHARACTERISTIC
/begin CHARACTERISTIC MoFTqPtdEmSec_swtShftFilOffEm02_C "Switch of gear change filter for EM02" VALUE 0x8026CF2C Val_Wu8 255.0 OneToOne 0.00 255.0 FORMAT "%5.1" /end CHARACTERISTIC
/begin CHARACTERISTIC MoFTqPtdEmSec_tqLoss_C "Intial value for secondary axle EM level torque losses in Function Monitoring" VALUE 0x8026DCDC Val_Ws16 6553.500 Trq -3276.800 3276.700 FORMAT "%8.3" /end CHARACTERISTIC
/begin CHARACTERISTIC MoFTqPtdEmSec_tqNegPtdOffs_M "Permitted negative offset for torque limits on secondary e-machine level" MAP 0x8026DB64 Map_Xs16Ys16Ws16 3276.800 Trq -3276.800 0.00 FORMAT "%8.3" EXTENDED_LIMITS -3276.800 3276.700
 /begin AXIS_DESCR STD_AXIS MoFTqPtdEmSec_tqTranEm02 Trq 8 -3276.800 3276.700 FORMAT "%8.3" DEPOSIT ABSOLUTE /end AXIS_DESCR
 /begin AXIS_DESCR STD_AXIS MoFBas_vVeh Vel 8 -327.6800 327.6700 FORMAT "%8.4" DEPOSIT ABSOLUTE /end AXIS_DESCR
/end CHARACTERISTIC
/begin CHARACTERISTIC MoFTqPtdEmSec_tqNegStatyLim_C "Permitted negative stationary torque on secondary e-machine level" VALUE 0x8026DC08 Val_Ws16 6553.500 Trq -3276.800 3276.700 FORMAT "%8.3" /end CHARACTERISTIC
/begin CHARACTERISTIC MoFTqPtdEmSec_tqPosPtdOffs_M "Permitted positive offset for torque limits on secondary e-machine level" MAP 0x8026DC0A Map_Xs16Ys16Ws16 3276.700 Trq 0.00 3276.700 FORMAT "%8.3" EXTENDED_LIMITS -3276.800 3276.700
 /begin AXIS_DESCR STD_AXIS MoFTqPtdEmSec_tqTranEm02 Trq 8 -3276.800 3276.700 FORMAT "%8.3" DEPOSIT ABSOLUTE /end AXIS_DESCR
 /begin AXIS_DESCR STD_AXIS MoFBas_vVeh Vel 8 -327.6800 327.6700 FORMAT "%8.4" DEPOSIT ABSOLUTE /end AXIS_DESCR
/end CHARACTERISTIC
/begin CHARACTERISTIC MoFTqPtdEmSec_tqPosStatyLim_C "Permitted positive stationary torque on secondary e-machine level" VALUE 0x8026DCAE Val_Ws16 6553.500 Trq -3276.800 3276.700 FORMAT "%8.3" /end CHARACTERISTIC
/begin CHARACTERISTIC MoFTqPtdEmSec_tqPtActvDetdNeut_T "Torque threshold for power train release detected in neutral" CURVE 0x8026DCB0 Mo_DataCurveSstS16WS16 6553.500 Trq -3276.800 3276.700 FORMAT "%8.3"
 /begin AXIS_DESCR STD_AXIS MoFBas_vVehSignd Vel 8 -327.6800 327.6700 FORMAT "%8.4" DEPOSIT ABSOLUTE /end AXIS_DESCR
/end CHARACTERISTIC
/begin CHARACTERISTIC MoFTqPtdEmSec_tqPtActvDetd_C "Torque threshold for error detection of invalid powertrain release" VALUE 0x8026DCD2 Val_Ws16 6553.500 Trq -3276.800 3276.700 FORMAT "%8.3" /end CHARACTERISTIC
/begin CHARACTERISTIC MoFTqPtdEmSec_tqQdrLockErrMax_C "Upper threshold for sign error quadrant 3 in function monitoring" VALUE 0x8026DCD4 Val_Ws16 6553.500 Trq -3276.800 3276.700 FORMAT "%8.3" /end CHARACTERISTIC
/begin CHARACTERISTIC MoFTqPtdEmSec_tqQdrLockErrMin_C "Lower threshold for sign error quadrant 1 in function monitoring" VALUE 0x8026DCD6 Val_Ws16 6553.500 Trq -3276.800 3276.700 FORMAT "%8.3" /end CHARACTERISTIC
/begin CHARACTERISTIC MoFTqPtdEmSec_tqRecuLimnMax_C "Permitted positive recuperation torque on secondary e-machine level in function monitoring" VALUE 0x8026DCD8 Val_Ws16 6553.500 Trq -3276.800 3276.700 FORMAT "%8.3" /end CHARACTERISTIC
/begin CHARACTERISTIC MoFTqPtdEmSec_tqRecuLimnMin_C "Permitted negative recuperation torque on secondary e-machine level in function monitoring" VALUE 0x8026DCDA Val_Ws16 6553.500 Trq -3276.800 3276.700 FORMAT "%8.3" /end CHARACTERISTIC
/begin CHARACTERISTIC MoFTqPtdEmSec_tqTiIntegDec_C "Constant for reduction of torque integral on freedom from defects" VALUE 0x8026D170 Val_Ws32 2147483.64700 mdt_q0p001_Nm_s 0.00 2147483.64700 FORMAT "%13.5" EXTENDED_LIMITS -2147483.64800 2147483.64700 /end CHARACTERISTIC
/begin CHARACTERISTIC MoFTqPtdEmSec_tqTiIntegErr_C "Threshold of error detection in torque integral check" VALUE 0x8026D174 Val_Ws32 2147483.64700 mdt_q0p001_Nm_s 0.00 2147483.64700 FORMAT "%13.5" EXTENDED_LIMITS -2147483.64800 2147483.64700 /end CHARACTERISTIC
/begin CHARACTERISTIC MoFTqPtdEmSec_tqTiIntegMax_C "Maximum filling level of torque integral check" VALUE 0x8026D178 Val_Ws32 2147483.64700 mdt_q0p001_Nm_s 0.00 2147483.64700 FORMAT "%13.5" EXTENDED_LIMITS -2147483.64800 2147483.64700 /end CHARACTERISTIC
/begin CHARACTERISTIC MoFTqPtdEmSec_tTnEm02_C "time constant of EM02 PT1 filter" VALUE 0x8026DCE2 Val_Wu16 655.34000000 zk10msxs_uw_b655p36PT1 0.01000000 655.35000000 FORMAT "%12.8" EXTENDED_LIMITS 0.000000152590219 655.35000000 /end CHARACTERISTIC
/begin CHARACTERISTIC MoFTqPtdEm_cntrErrTqSignMax_C "Error threshold in sign check on e-machine level in function monitoring" VALUE 0x8026CF2E Val_Wu8 255.0 OneToOne 0.00 255.0 FORMAT "%5.1" /end CHARACTERISTIC
/begin CHARACTERISTIC MoFTqPtdEm_cntrPtRelsErrMax_C "Error threshold for powertrain release violation" VALUE 0x8026CF2F Val_Wu8 255.0 OneToOne 0.00 255.0 FORMAT "%5.1" /end CHARACTERISTIC
/begin CHARACTERISTIC MoFTqPtdEm_cntrQdrLockToutErr_C "Maximum allowed countes for locked quadrant Timout error" VALUE 0x8026CF30 Val_Wu8 255.0 OneToOne 0.00 255.0 FORMAT "%5.1" /end CHARACTERISTIC
/begin CHARACTERISTIC MoFTqPtdEm_cntrTestPtRels_C "Diagnosis test counter threshold to heal DFC_MoFTqPtdEmPtRels." VALUE 0x8027061E Val_Wu8 255.0 OneToOne 0.00 255.0 FORMAT "%5.1" /end CHARACTERISTIC
/begin CHARACTERISTIC MoFTqPtdEm_cntrTestSign_C "Diagnosis test counter threshold to heal DFC_MoFTqPtdEmSign" VALUE 0x8027061F Val_Wu8 255.0 OneToOne 0.00 255.0 FORMAT "%5.1" /end CHARACTERISTIC
/begin CHARACTERISTIC MoFTqPtdEm_cntrTestTq_C "Diagnosis test counter threshold to heal DFC_MoFTqPtdEmTq" VALUE 0x80270620 Val_Wu8 255.0 OneToOne 0.00 255.0 FORMAT "%5.1" /end CHARACTERISTIC
/begin CHARACTERISTIC MoFTqPtdEm_cntrTmr1Elpd_C "Calibratable timer 1 duration" VALUE 0x8026DCE4 Val_Wu16 65535.00 OneToOne 0.00 65535.00 FORMAT "%8.2" /end CHARACTERISTIC
/begin CHARACTERISTIC MoFTqPtdEm_cntrTmr2Elpd_C "Calibratable timer 2 duration" VALUE 0x8026DCE6 Val_Wu16 65535.00 OneToOne 0.00 65535.00 FORMAT "%8.2" /end CHARACTERISTIC
/begin CHARACTERISTIC MoFTqPtdEm_cntrTmr3Elpd_C "Calibratable timer 3 duration" VALUE 0x8026DCE8 Val_Wu16 65535.00 OneToOne 0.00 65535.00 FORMAT "%8.2" /end CHARACTERISTIC
/begin CHARACTERISTIC MoFTqPtdEm_cntrTqCompMax_C "Error threshold in torque comparison on e-machine level in function monitoring" VALUE 0x8026CF31 Val_Wu8 255.0 OneToOne 0.00 255.0 FORMAT "%5.1" /end CHARACTERISTIC
/begin CHARACTERISTIC MoFTqPtdEm_enaOthTrqCompErr_C "Vehicle or axle level torque comparison error consider in torque comparison at e-machine level" VALUE 0x8026CF32 Val_Wu8 255.0 OneToOne 0.00 255.0 FORMAT "%5.1" /end CHARACTERISTIC
/begin CHARACTERISTIC MoFTqPtdEm_flgMeclRvsGearPrsntEm01_C "Parameter to enableDisable Mechanical Reverse gear in the system." VALUE 0x8026CF38 Val_Wu8 1.00000000000 B_TRUE 0.00 1.00000000000 FORMAT "%13.11" /end CHARACTERISTIC
/begin CHARACTERISTIC MoFTqPtdEm_flgPrpInhb01Dft_C "Default value for Propulsion inhibit flag when debounced CAN error for propulsion inhibit flag present" VALUE 0x8026CF36 Val_Wu8 1.00000000000 B_TRUE 0.00 1.00000000000 FORMAT "%13.11" /end CHARACTERISTIC
/begin CHARACTERISTIC MoFTqPtdEm_flgRecupInhb01Dft_C "Default value for Recuperation inhibit flag when debounced CAN error for propulsion inhibit flag present" VALUE 0x8026CF37 Val_Wu8 1.00000000000 B_TRUE 0.00 1.00000000000 FORMAT "%13.11" /end CHARACTERISTIC
/begin CHARACTERISTIC MoFTqPtdEm_flgSignChgRvsGearEm01_C "Parameter for sign change required for e-machine speed in Reverse gear" VALUE 0x8026CF39 Val_Wu8 1.00000000000 B_TRUE 0.00 1.00000000000 FORMAT "%13.11" /end CHARACTERISTIC
/begin CHARACTERISTIC MoFTqPtdEm_nChgGearMaxEm01_C "upper threshold engine speed gear change" VALUE 0x8026DE88 Val_Ws16 65535.00 nmot_q1 -32768.00 32767.00 FORMAT "%8.2" /end CHARACTERISTIC
/begin CHARACTERISTIC MoFTqPtdEm_nChgGearMinEm01_C "lower threshold engine speed gear change" VALUE 0x8026DE8A Val_Ws16 65535.00 nmot_q1 -32768.00 32767.00 FORMAT "%8.2" /end CHARACTERISTIC
/begin CHARACTERISTIC MoFTqPtdEm_ratTqDifEmWght_T "Factor of error wheigh in torque comparison on e-machine level" CURVE 0x8026DCEA Mo_DataCurveSstS16WS16 655.3500 fak_q0p01 -327.6800 327.6700 FORMAT "%8.4"
 /begin AXIS_DESCR STD_AXIS MoFTqPtdEm_tqTranEm01 Trq 8 -3276.800 3276.700 FORMAT "%8.3" DEPOSIT ABSOLUTE /end AXIS_DESCR
/end CHARACTERISTIC
/begin CHARACTERISTIC MoFTqPtdEm_stSpdDemMod_C "Speed control mode state." VALUE 0x8026CF33 Val_Wu8 255.0 OneToOne 0.00 255.0 FORMAT "%5.1" /end CHARACTERISTIC
/begin CHARACTERISTIC MoFTqPtdEm_swtDeactvtTmr_C "Calibratable switch to deactivate timers" VALUE 0x8026CF34 Val_Wu8 255.0 OneToOne 0.00 255.0 FORMAT "%5.1" /end CHARACTERISTIC
/begin CHARACTERISTIC MoFTqPtdEm_swtShftFilOffEm01_C "Switch of gear change filter" VALUE 0x8026CF3A Val_Wu8 255.0 OneToOne 0.00 255.0 FORMAT "%5.1" /end CHARACTERISTIC
/begin CHARACTERISTIC MoFTqPtdEm_tqNegPtdOffs_M "Permitted negative offset for torque limits on e-machine level" MAP 0x8026DD0C Map_Xs16Ys16Ws16 3276.800 Trq -3276.800 0.00 FORMAT "%8.3" EXTENDED_LIMITS -3276.800 3276.700
 /begin AXIS_DESCR STD_AXIS MoFTqPtdEm_tqTranEm01 Trq 8 -3276.800 3276.700 FORMAT "%8.3" DEPOSIT ABSOLUTE /end AXIS_DESCR
 /begin AXIS_DESCR STD_AXIS MoFBas_vVeh Vel 8 -327.6800 327.6700 FORMAT "%8.4" DEPOSIT ABSOLUTE /end AXIS_DESCR
/end CHARACTERISTIC
/begin CHARACTERISTIC MoFTqPtdEm_tqNegStatyLim_C "Permitted negative stationary torque on e-machine level" VALUE 0x8026DDB0 Val_Ws16 6553.500 Trq -3276.800 3276.700 FORMAT "%8.3" /end CHARACTERISTIC
/begin CHARACTERISTIC MoFTqPtdEm_tqPosPtdOffs_M "Permitted positive offset for torque limits on e-machine level" MAP 0x8026DDB2 Map_Xs16Ys16Ws16 3276.700 Trq 0.00 3276.700 FORMAT "%8.3" EXTENDED_LIMITS -3276.800 3276.700
 /begin AXIS_DESCR STD_AXIS MoFTqPtdEm_tqTranEm01 Trq 8 -3276.800 3276.700 FORMAT "%8.3" DEPOSIT ABSOLUTE /end AXIS_DESCR
 /begin AXIS_DESCR STD_AXIS MoFBas_vVeh Vel 8 -327.6800 327.6700 FORMAT "%8.4" DEPOSIT ABSOLUTE /end AXIS_DESCR
/end CHARACTERISTIC
/begin CHARACTERISTIC MoFTqPtdEm_tqPosStatyLim_C "Permitted positive stationary torque on e-machine level" VALUE 0x8026DE56 Val_Ws16 6553.500 Trq -3276.800 3276.700 FORMAT "%8.3" /end CHARACTERISTIC
/begin CHARACTERISTIC MoFTqPtdEm_tqPrpHiMax_C "Maximum Wheel torque for Propulsion torqueramping" VALUE 0x8026D18C Val_Ws32 429496729.500 TrqPrpHigh -214748364.800 214748364.700 FORMAT "%13.3" /end CHARACTERISTIC
/begin CHARACTERISTIC MoFTqPtdEm_tqPrpHiMin_C "Minimum Wheel torque for Recuperation torqueramping" VALUE 0x8026D190 Val_Ws32 429496729.500 TrqPrpHigh -214748364.800 214748364.700 FORMAT "%13.3" /end CHARACTERISTIC
/begin CHARACTERISTIC MoFTqPtdEm_tqPrpHiZr_C "Calibration for Zero Torque" VALUE 0x8026D194 Val_Ws32 429496729.500 TrqPrpHigh -214748364.800 214748364.700 FORMAT "%13.3" /end CHARACTERISTIC
/begin CHARACTERISTIC MoFTqPtdEm_tqPtActvDetd_C "Torque threshold for error detection of invalid powertrain release" VALUE 0x8026DE58 Val_Ws16 6553.500 Trq -3276.800 3276.700 FORMAT "%8.3" /end CHARACTERISTIC
/begin CHARACTERISTIC MoFTqPtdEm_tqQdrLockErrMax_C "Upper threshold for sign error quadrant 3 in function monitoring" VALUE 0x8026DE5A Val_Ws16 6553.500 Trq -3276.800 3276.700 FORMAT "%8.3" /end CHARACTERISTIC
/begin CHARACTERISTIC MoFTqPtdEm_tqQdrLockErrMax_T "E-Machine speed dependent Upper torque threshold." CURVE 0x8026DE5C Mo_DataCurveSstS16WS16 6553.500 TrqPrpHigh -3276.800 3276.700 FORMAT "%8.3"
 /begin AXIS_DESCR STD_AXIS MoFEvMngt_nEmPhy01 nmot_q1 4 -32768.00 32767.00 FORMAT "%8.2" DEPOSIT ABSOLUTE /end AXIS_DESCR
/end CHARACTERISTIC
/begin CHARACTERISTIC MoFTqPtdEm_tqQdrLockErrMin_C "Lower threshold for sign error quadrant 1 in function monitoring" VALUE 0x8026DE6E Val_Ws16 6553.500 Trq -3276.800 3276.700 FORMAT "%8.3" /end CHARACTERISTIC
/begin CHARACTERISTIC MoFTqPtdEm_tqQdrLockErrMin_T "E-Machine speed dependent lower torque threshold." CURVE 0x8026DE70 Mo_DataCurveSstS16WS16 6553.500 TrqPrpHigh -3276.800 3276.700 FORMAT "%8.3"
 /begin AXIS_DESCR STD_AXIS MoFEvMngt_nEmPhy01 nmot_q1 4 -32768.00 32767.00 FORMAT "%8.2" DEPOSIT ABSOLUTE /end AXIS_DESCR
/end CHARACTERISTIC
/begin CHARACTERISTIC MoFTqPtdEm_tqRecuLimnMax_C "Permitted positive recuperation torque on e-machine level in function monitoring" VALUE 0x8026DE82 Val_Ws16 6553.500 Trq -3276.800 3276.700 FORMAT "%8.3" /end CHARACTERISTIC
/begin CHARACTERISTIC MoFTqPtdEm_tqRecuLimnMin_C "Permitted negative recuperation torque on e-machine level in function monitoring" VALUE 0x8026DE84 Val_Ws16 6553.500 Trq -3276.800 3276.700 FORMAT "%8.3" /end CHARACTERISTIC
/begin CHARACTERISTIC MoFTqPtdEm_tqStepDwnPropInhb_C "Step Down size for Propulsion Ramp down" VALUE 0x8026D198 Val_Ws32 429496729.500 TrqPrpHigh -214748364.800 214748364.700 FORMAT "%13.3" /end CHARACTERISTIC
/begin CHARACTERISTIC MoFTqPtdEm_tqStepDwnRecupInhb_C "Step Down size for Recuperation Ramp down" VALUE 0x8026D19C Val_Ws32 429496729.500 TrqPrpHigh -214748364.800 214748364.700 FORMAT "%13.3" /end CHARACTERISTIC
/begin CHARACTERISTIC MoFTqPtdEm_tqStepUpPropInhb_C "Step Up size for Propulsion Ramp up" VALUE 0x8026D1A0 Val_Ws32 429496729.500 TrqPrpHigh -214748364.800 214748364.700 FORMAT "%13.3" /end CHARACTERISTIC
/begin CHARACTERISTIC MoFTqPtdEm_tqStepUpRecupInhb_C "Step Down size for Recuperation Ramp up" VALUE 0x8026D1A4 Val_Ws32 429496729.500 TrqPrpHigh -214748364.800 214748364.700 FORMAT "%13.3" /end CHARACTERISTIC
/begin CHARACTERISTIC MoFTqPtdEm_tqThdLim1_C "Calibratable torque threshold limit L2" VALUE 0x8026D17C Val_Ws32 429496729.500 TrqPrpHigh -214748364.800 214748364.700 FORMAT "%13.3" /end CHARACTERISTIC
/begin CHARACTERISTIC MoFTqPtdEm_tqTiIntegDec_C "Constant for reduction of torque integral on freedom from defects" VALUE 0x8026D180 Val_Ws32 2147483.64700 mdt_q0p001_Nm_s 0.00 2147483.64700 FORMAT "%13.5" EXTENDED_LIMITS -2147483.64800 2147483.64700 /end CHARACTERISTIC
/begin CHARACTERISTIC MoFTqPtdEm_tqTiIntegErr_C "Threshold of error detection in torque integral check" VALUE 0x8026D184 Val_Ws32 2147483.64700 mdt_q0p001_Nm_s 0.00 2147483.64700 FORMAT "%13.5" EXTENDED_LIMITS -2147483.64800 2147483.64700 /end CHARACTERISTIC
/begin CHARACTERISTIC MoFTqPtdEm_tqTiIntegMax_C "Maximum filling level of torque integral check" VALUE 0x8026D188 Val_Ws32 2147483.64700 mdt_q0p001_Nm_s 0.00 2147483.64700 FORMAT "%13.5" EXTENDED_LIMITS -2147483.64800 2147483.64700 /end CHARACTERISTIC
/begin CHARACTERISTIC MoFTqPtdEm_tTnEm01_C "time constant pt1" VALUE 0x8026DE8C Val_Wu16 655.34000000 zk10msxs_uw_b655p36PT1 0.01000000 655.35000000 FORMAT "%12.8" EXTENDED_LIMITS 0.000000152590219 655.35000000 /end CHARACTERISTIC
/begin CHARACTERISTIC MoFTqPtdOut_stCfgSwtEnaInvEm01_C "Codeword: Invert the torque to consider the mount position of the EM" VALUE 0x8026CF3C Val_Wu8 255.0 OneToOne 0.00 255.0 FORMAT "%5.1" /end CHARACTERISTIC
/begin CHARACTERISTIC MoFTqPtdOut_stCfgSwtEnaInvEm02_C "Codeword: Invert the torque to consider the mount position of the EM 2" VALUE 0x8026CF3D Val_Wu8 255.0 OneToOne 0.00 255.0 FORMAT "%5.1" /end CHARACTERISTIC
/begin CHARACTERISTIC MoFTqPtdOut_tqLimpHomeLowrLimnEm01Rev_M "Lower accelerator and vehicle speed dependent Limp home torque limitation for EM02 during reverse gear." MAP 0x8026DE8E Map_Xs16Ys16Ws16 6553.500 Trq -3276.800 3276.700 FORMAT "%8.3"
 /begin AXIS_DESCR STD_AXIS MoFAccr_ratAccr Prc 8 -400.0000 399.9878 FORMAT "%8.4" DEPOSIT ABSOLUTE /end AXIS_DESCR
 /begin AXIS_DESCR STD_AXIS MoFBas_vVehSignd Vel 8 -327.6800 327.6700 FORMAT "%8.4" DEPOSIT ABSOLUTE /end AXIS_DESCR
/end CHARACTERISTIC
/begin CHARACTERISTIC MoFTqPtdOut_tqLimpHomeLowrLimnEm01_M "Lower accelerator and vehicle speed dependent torque limit during Limp-Home EM01" MAP 0x8026DF32 Map_Xs16Ys16Ws16 6553.500 Trq -3276.800 3276.700 FORMAT "%8.3"
 /begin AXIS_DESCR STD_AXIS MoFAccr_ratAccr Prc 8 -400.0000 399.9878 FORMAT "%8.4" DEPOSIT ABSOLUTE /end AXIS_DESCR
 /begin AXIS_DESCR STD_AXIS MoFBas_vVehSignd Vel 8 -327.6800 327.6700 FORMAT "%8.4" DEPOSIT ABSOLUTE /end AXIS_DESCR
/end CHARACTERISTIC
/begin CHARACTERISTIC MoFTqPtdOut_tqLimpHomeLowrLimnEm02Rev_M "Lower accelerator and vehicle speed dependent Limp home torque limitation for EM02 during reverse gear" MAP 0x8026DFD6 Map_Xs16Ys16Ws16 6553.500 Trq -3276.800 3276.700 FORMAT "%8.3"
 /begin AXIS_DESCR STD_AXIS MoFAccr_ratAccr Prc 8 -400.0000 399.9878 FORMAT "%8.4" DEPOSIT ABSOLUTE /end AXIS_DESCR
 /begin AXIS_DESCR STD_AXIS MoFBas_vVehSignd Vel 8 -327.6800 327.6700 FORMAT "%8.4" DEPOSIT ABSOLUTE /end AXIS_DESCR
/end CHARACTERISTIC
/begin CHARACTERISTIC MoFTqPtdOut_tqLimpHomeLowrLimnEm02_M "Lower accelerator and vehicle speed dependent Limp home torque limitation for EM02." MAP 0x8026E07A Map_Xs16Ys16Ws16 6553.500 Trq -3276.800 3276.700 FORMAT "%8.3"
 /begin AXIS_DESCR STD_AXIS MoFAccr_ratAccr Prc 8 -400.0000 399.9878 FORMAT "%8.4" DEPOSIT ABSOLUTE /end AXIS_DESCR
 /begin AXIS_DESCR STD_AXIS MoFBas_vVehSignd Vel 8 -327.6800 327.6700 FORMAT "%8.4" DEPOSIT ABSOLUTE /end AXIS_DESCR
/end CHARACTERISTIC
/begin CHARACTERISTIC MoFTqPtdOut_tqLimpHomeUpprLimnEm01Rev_M "Upper accelerator and vehicle speed dependent Limp home torque limitation for EM02 during reverse gear" MAP 0x8026E11E Map_Xs16Ys16Ws16 6553.500 Trq -3276.800 3276.700 FORMAT "%8.3"
 /begin AXIS_DESCR STD_AXIS MoFAccr_ratAccr Prc 8 -400.0000 399.9878 FORMAT "%8.4" DEPOSIT ABSOLUTE /end AXIS_DESCR
 /begin AXIS_DESCR STD_AXIS MoFBas_vVehSignd Vel 8 -327.6800 327.6700 FORMAT "%8.4" DEPOSIT ABSOLUTE /end AXIS_DESCR
/end CHARACTERISTIC
/begin CHARACTERISTIC MoFTqPtdOut_tqLimpHomeUpprLimnEm01_M "Upper accelerator and vehicle speed dependent torque limit during Limp-Home EM01" MAP 0x8026E1C2 Map_Xs16Ys16Ws16 6553.500 Trq -3276.800 3276.700 FORMAT "%8.3"
 /begin AXIS_DESCR STD_AXIS MoFAccr_ratAccr Prc 8 -400.0000 399.9878 FORMAT "%8.4" DEPOSIT ABSOLUTE /end AXIS_DESCR
 /begin AXIS_DESCR STD_AXIS MoFBas_vVehSignd Vel 8 -327.6800 327.6700 FORMAT "%8.4" DEPOSIT ABSOLUTE /end AXIS_DESCR
/end CHARACTERISTIC
/begin CHARACTERISTIC MoFTqPtdOut_tqLimpHomeUpprLimnEm02Rev_M "Upper accelerator and vehicle speed dependent Limp home torque limitation for EM02 during reverse gear" MAP 0x8026E266 Map_Xs16Ys16Ws16 6553.500 Trq -3276.800 3276.700 FORMAT "%8.3"
 /begin AXIS_DESCR STD_AXIS MoFAccr_ratAccr Prc 8 -400.0000 399.9878 FORMAT "%8.4" DEPOSIT ABSOLUTE /end AXIS_DESCR
 /begin AXIS_DESCR STD_AXIS MoFBas_vVehSignd Vel 8 -327.6800 327.6700 FORMAT "%8.4" DEPOSIT ABSOLUTE /end AXIS_DESCR
/end CHARACTERISTIC
/begin CHARACTERISTIC MoFTqPtdOut_tqLimpHomeUpprLimnEm02_M "Upper accelerator and vehicle speed dependent Limp home torque limitation for EM02" MAP 0x8026E30A Map_Xs16Ys16Ws16 6553.500 Trq -3276.800 3276.700 FORMAT "%8.3"
 /begin AXIS_DESCR STD_AXIS MoFAccr_ratAccr Prc 8 -400.0000 399.9878 FORMAT "%8.4" DEPOSIT ABSOLUTE /end AXIS_DESCR
 /begin AXIS_DESCR STD_AXIS MoFBas_vVehSignd Vel 8 -327.6800 327.6700 FORMAT "%8.4" DEPOSIT ABSOLUTE /end AXIS_DESCR
/end CHARACTERISTIC
/begin CHARACTERISTIC MoFTqPtdOut_tqMaxLim_C "Calibration parameter for maximum allowed torque limit on vehicle level" VALUE 0x8026D1A8 Val_Ws32 429496729.500 TrqPrpHigh -214748364.800 214748364.700 FORMAT "%13.3" /end CHARACTERISTIC
/begin MEASUREMENT DFC_st.DFC_MoFTqPtdAxle "" UBYTE DFC_OneToOne 1 100 0.00 255.0 FORMAT "%5.1" ECU_ADDRESS 0x60034D52 /end MEASUREMENT
/begin MEASUREMENT DFC_st.DFC_MoFTqPtdAxleSec "" UBYTE DFC_OneToOne 1 100 0.00 255.0 FORMAT "%5.1" ECU_ADDRESS 0x60034D53 /end MEASUREMENT
/begin MEASUREMENT DFC_st.DFC_MoFTqPtdEmPtRels "" UBYTE DFC_OneToOne 1 100 0.00 255.0 FORMAT "%5.1" ECU_ADDRESS 0x60034D54 /end MEASUREMENT
/begin MEASUREMENT DFC_st.DFC_MoFTqPtdEmPtRelsSec "" UBYTE DFC_OneToOne 1 100 0.00 255.0 FORMAT "%5.1" ECU_ADDRESS 0x60034D55 /end MEASUREMENT
/begin MEASUREMENT DFC_st.DFC_MoFTqPtdEmSign "" UBYTE DFC_OneToOne 1 100 0.00 255.0 FORMAT "%5.1" ECU_ADDRESS 0x60034D56 /end MEASUREMENT
/begin MEASUREMENT DFC_st.DFC_MoFTqPtdEmSignSec "" UBYTE DFC_OneToOne 1 100 0.00 255.0 FORMAT "%5.1" ECU_ADDRESS 0x60034D57 /end MEASUREMENT
/begin MEASUREMENT DFC_st.DFC_MoFTqPtdEmTq "" UBYTE DFC_OneToOne 1 100 0.00 255.0 FORMAT "%5.1" ECU_ADDRESS 0x60034D58 /end MEASUREMENT
/begin MEASUREMENT DFC_st.DFC_MoFTqPtdEmTqSec "" UBYTE DFC_OneToOne 1 100 0.00 255.0 FORMAT "%5.1" ECU_ADDRESS 0x60034D59 /end MEASUREMENT
/begin MEASUREMENT MoFPtdEm_tqLoss "Torque losses in Function Monitoring" SWORD Trq 1 100 -3276.800 3276.700 FORMAT "%8.3" ECU_ADDRESS 0x6002C5B6
 /begin IF_DATA XCPplus 0x0102
  /begin DAQ_EVENT VARIABLE /end DAQ_EVENT
 /end IF_DATA
/end MEASUREMENT
/begin MEASUREMENT MoFPtdEm_tqLossCpl "RAM data redundancy of MoFPtdEm_tqLoss" UWORD OneToOne 1 100 0.00 65535.00 FORMAT "%8.2" ECU_ADDRESS 0x6002BB9A
 /begin IF_DATA XCPplus 0x0102
  /begin DAQ_EVENT VARIABLE /end DAQ_EVENT
 /end IF_DATA
/end MEASUREMENT
/begin MEASUREMENT MoFRelsMngtPtRels_bbLoc1Cpl "complement bitbase in MoFRelsMngtPtRels" UBYTE OneToOne 1 100 0.00 255.0 FORMAT "%5.1" ECU_ADDRESS 0x6002BCC1
 /begin IF_DATA XCPplus 0x0102
  /begin DAQ_EVENT VARIABLE /end DAQ_EVENT
 /end IF_DATA
/end MEASUREMENT
/begin MEASUREMENT MoFRelsMngtPtRels_bbLoc2Cpl "byte to gather local bits for complement check" UBYTE OneToOne 1 100 0.00 255.0 FORMAT "%5.1" ECU_ADDRESS 0x6002BCC0
 /begin IF_DATA XCPplus 0x0102
  /begin DAQ_EVENT VARIABLE /end DAQ_EVENT
 /end IF_DATA
/end MEASUREMENT
/begin MEASUREMENT MoFRelsMngtPtRels_bbLoc3Cpl "RAM data redundancy for MoFRelsMngtPtRels_bbLoc3" UBYTE OneToOne 1 100 0.00 255.0 FORMAT "%5.1" ECU_ADDRESS 0x6002BCBF
 /begin IF_DATA XCPplus 0x0102
  /begin DAQ_EVENT VARIABLE /end DAQ_EVENT
 /end IF_DATA
/end MEASUREMENT
/begin MEASUREMENT MoFRelsMngtPtRels_bbOutCpl "RAM data redundancy for MoFRelsMngtPtRels_bbOut" UBYTE OneToOne 1 100 0.00 255.0 FORMAT "%5.1" ECU_ADDRESS 0x6002BCBE
 /begin IF_DATA XCPplus 0x0102
  /begin DAQ_EVENT VARIABLE /end DAQ_EVENT
 /end IF_DATA
/end MEASUREMENT
/begin MEASUREMENT MoFRelsMngt_flgBrkSt "Selected brake active state" UBYTE B_TRUE 1 100 0.00 1.00000000000 BIT_MASK 0x20 FORMAT "%13.11" ECU_ADDRESS 0x6002C6DD
 /begin IF_DATA XCPplus 0x0102
  /begin DAQ_EVENT VARIABLE /end DAQ_EVENT
 /end IF_DATA
/end MEASUREMENT
/begin MEASUREMENT MoFRelsMngt_flgChrgPlgInsCdn "HV battery charger plugged in condition flag" UBYTE B_TRUE 1 100 0.00 1.00000000000 BIT_MASK 0x8 FORMAT "%13.11" ECU_ADDRESS 0x6002C6DC
 /begin IF_DATA XCPplus 0x0102
  /begin DAQ_EVENT VARIABLE /end DAQ_EVENT
 /end IF_DATA
/end MEASUREMENT
/begin MEASUREMENT MoFRelsMngt_flgCrashEvnt "Flag for MoFRelsMngt_flgCrashEvnt" UBYTE B_TRUE 1 100 0.00 1.00000000000 BIT_MASK 0x4 FORMAT "%13.11" ECU_ADDRESS 0x6002C6DB
 /begin IF_DATA XCPplus 0x0102
  /begin DAQ_EVENT VARIABLE /end DAQ_EVENT
 /end IF_DATA
/end MEASUREMENT
/begin MEASUREMENT MoFRelsMngt_flgDrvDoorOpenCdn "Drive door open condition flag" UBYTE B_TRUE 1 100 0.00 1.00000000000 BIT_MASK 0x4 FORMAT "%13.11" ECU_ADDRESS 0x6002C6DC
 /begin IF_DATA XCPplus 0x0102
  /begin DAQ_EVENT VARIABLE /end DAQ_EVENT
 /end IF_DATA
/end MEASUREMENT
/begin MEASUREMENT MoFRelsMngt_flgDrvInhbCdn "Drive mode inhibited condition flag" UBYTE B_TRUE 1 100 0.00 1.00000000000 BIT_MASK 0x80 FORMAT "%13.11" ECU_ADDRESS 0x6002C6DC
 /begin IF_DATA XCPplus 0x0102
  /begin DAQ_EVENT VARIABLE /end DAQ_EVENT
 /end IF_DATA
/end MEASUREMENT
/begin MEASUREMENT MoFRelsMngt_flgFltBms "Flag set for BMS faults" UBYTE B_TRUE 1 100 0.00 1.00000000000 BIT_MASK 0x8 FORMAT "%13.11" ECU_ADDRESS 0x6002C6DB
 /begin IF_DATA XCPplus 0x0102
  /begin DAQ_EVENT VARIABLE /end DAQ_EVENT
 /end IF_DATA
/end MEASUREMENT
/begin MEASUREMENT MoFRelsMngt_flgFltEm "Flag set for Em(Inverter) Faults" UBYTE B_TRUE 1 100 0.00 1.00000000000 BIT_MASK 0x10 FORMAT "%13.11" ECU_ADDRESS 0x6002C6DB
 /begin IF_DATA XCPplus 0x0102
  /begin DAQ_EVENT VARIABLE /end DAQ_EVENT
 /end IF_DATA
/end MEASUREMENT
/begin MEASUREMENT MoFRelsMngt_flgGear "status gear lever in MoFRelsMngt" UBYTE B_TRUE 1 100 0.00 1.00000000000 BIT_MASK 0x1 FORMAT "%13.11" ECU_ADDRESS 0x6002C6DD
 /begin IF_DATA XCPplus 0x0102
  /begin DAQ_EVENT VARIABLE /end DAQ_EVENT
 /end IF_DATA
/end MEASUREMENT
/begin MEASUREMENT MoFRelsMngt_flgGearCANErr "CAN error flag of gear lever position" UBYTE B_TRUE 1 100 0.00 1.00000000000 BIT_MASK 0x1 FORMAT "%13.11" ECU_ADDRESS 0x6002C6DB
 /begin IF_DATA XCPplus 0x0102
  /begin DAQ_EVENT VARIABLE /end DAQ_EVENT
 /end IF_DATA
/end MEASUREMENT
/begin MEASUREMENT MoFRelsMngt_flgGearLvrParkCdn "Condition flag for plausibilized gear lever in park position" UBYTE B_TRUE 1 100 0.00 1.00000000000 BIT_MASK 0x40 FORMAT "%13.11" ECU_ADDRESS 0x6002C6DC
 /begin IF_DATA XCPplus 0x0102
  /begin DAQ_EVENT VARIABLE /end DAQ_EVENT
 /end IF_DATA
/end MEASUREMENT
/begin MEASUREMENT MoFRelsMngt_flgGearLvrParkChg "Plausibilized gear lever park changed" UBYTE B_TRUE 1 100 0.00 1.00000000000 BIT_MASK 0x1 FORMAT "%13.11" ECU_ADDRESS 0x6002C6DC
 /begin IF_DATA XCPplus 0x0102
  /begin DAQ_EVENT VARIABLE /end DAQ_EVENT
 /end IF_DATA
/end MEASUREMENT
/begin MEASUREMENT MoFRelsMngt_flgGearLvrParkOld "Flag for plausibilized gear lever park from previous raste" UBYTE B_TRUE 1 100 0.00 1.00000000000 BIT_MASK 0x80 FORMAT "%13.11" ECU_ADDRESS 0x6002C6DD
 /begin IF_DATA XCPplus 0x0102
  /begin DAQ_EVENT VARIABLE /end DAQ_EVENT
 /end IF_DATA
/end MEASUREMENT
/begin MEASUREMENT MoFRelsMngt_flgGearNumCdn "Gear lever position from function level condition flag" UBYTE B_TRUE 1 100 0.00 1.00000000000 BIT_MASK 0x20 FORMAT "%13.11" ECU_ADDRESS 0x6002C6DC
 /begin IF_DATA XCPplus 0x0102
  /begin DAQ_EVENT VARIABLE /end DAQ_EVENT
 /end IF_DATA
/end MEASUREMENT
/begin MEASUREMENT MoFRelsMngt_flgGearNumChg "Gear lever position from function level changed" UBYTE B_TRUE 1 100 0.00 1.00000000000 BIT_MASK 0x2 FORMAT "%13.11" ECU_ADDRESS 0x6002C6DC
 /begin IF_DATA XCPplus 0x0102
  /begin DAQ_EVENT VARIABLE /end DAQ_EVENT
 /end IF_DATA
/end MEASUREMENT
/begin MEASUREMENT MoFRelsMngt_flgHvIHvbFltCdn "Flag set for HVBAT and HVIL fault confirm" UBYTE B_TRUE 1 100 0.00 1.00000000000 BIT_MASK 0x20 FORMAT "%13.11" ECU_ADDRESS 0x6002C6DB
 /begin IF_DATA XCPplus 0x0102
  /begin DAQ_EVENT VARIABLE /end DAQ_EVENT
 /end IF_DATA
/end MEASUREMENT
/begin MEASUREMENT MoFRelsMngt_flgHvIntlckSet "Flag set for HVIl fault confirm" UBYTE B_TRUE 1 100 0.00 1.00000000000 BIT_MASK 0x40 FORMAT "%13.11" ECU_ADDRESS 0x6002C6DB
 /begin IF_DATA XCPplus 0x0102
  /begin DAQ_EVENT VARIABLE /end DAQ_EVENT
 /end IF_DATA
/end MEASUREMENT
/begin MEASUREMENT MoFRelsMngt_flgPtActv "State: powertrain release in function monitoring" UBYTE B_TRUE 1 100 0.00 1.00000000000 BIT_MASK 0x1 FORMAT "%13.11" ECU_ADDRESS 0x6002C6D8
 /begin IF_DATA XCPplus 0x0102
  /begin DAQ_EVENT VARIABLE /end DAQ_EVENT
 /end IF_DATA
/end MEASUREMENT
/begin MEASUREMENT MoFRelsMngt_flgPtActvMsg "Message to level1: Powertrain release state from function monitoring" UBYTE B_TRUE 1 100 0.00 1.00000000000 BIT_MASK 0x1 FORMAT "%13.11" ECU_ADDRESS 0x70000238
 /begin IF_DATA XCPplus 0x0102
  /begin DAQ_EVENT VARIABLE /end DAQ_EVENT
 /end IF_DATA
/end MEASUREMENT
/begin MEASUREMENT MoFRelsMngt_flgRelsTrig "drive train release condition in function monitoring" UBYTE B_TRUE 1 100 0.00 1.00000000000 BIT_MASK 0x8 FORMAT "%13.11" ECU_ADDRESS 0x6002C6DD
 /begin IF_DATA XCPplus 0x0102
  /begin DAQ_EVENT VARIABLE /end DAQ_EVENT
 /end IF_DATA
/end MEASUREMENT
/begin MEASUREMENT MoFRelsMngt_flgRstRelsTrig "drive train reset condition in function monitoring" UBYTE B_TRUE 1 100 0.00 1.00000000000 BIT_MASK 0x4 FORMAT "%13.11" ECU_ADDRESS 0x6002C6DD
 /begin IF_DATA XCPplus 0x0102
  /begin DAQ_EVENT VARIABLE /end DAQ_EVENT
 /end IF_DATA
/end MEASUREMENT
/begin MEASUREMENT MoFRelsMngt_flgT15Cdn "Terminal 15 condition flag" UBYTE B_TRUE 1 100 0.00 1.00000000000 BIT_MASK 0x10 FORMAT "%13.11" ECU_ADDRESS 0x6002C6DC
 /begin IF_DATA XCPplus 0x0102
  /begin DAQ_EVENT VARIABLE /end DAQ_EVENT
 /end IF_DATA
/end MEASUREMENT
/begin MEASUREMENT MoFRelsMngt_flgT50RelsCdn "Drive train release condition considering T50" UBYTE B_TRUE 1 100 0.00 1.00000000000 BIT_MASK 0x2 FORMAT "%13.11" ECU_ADDRESS 0x6002C6DB
 /begin IF_DATA XCPplus 0x0102
  /begin DAQ_EVENT VARIABLE /end DAQ_EVENT
 /end IF_DATA
/end MEASUREMENT
/begin MEASUREMENT MoFRelsMngt_flgVehSpdCondRls "status to indicate vehicle speed release condition to inhibit power train release" UBYTE B_TRUE 1 100 0.00 1.00000000000 BIT_MASK 0x40 FORMAT "%13.11" ECU_ADDRESS 0x6002C6DD
 /begin IF_DATA XCPplus 0x0102
  /begin DAQ_EVENT VARIABLE /end DAQ_EVENT
 /end IF_DATA
/end MEASUREMENT
/begin MEASUREMENT MoFRelsMngt_flgVehV "vehicle speed is above calibratable value" UBYTE B_TRUE 1 100 0.00 1.00000000000 BIT_MASK 0x2 FORMAT "%13.11" ECU_ADDRESS 0x6002C6DD
 /begin IF_DATA XCPplus 0x0102
  /begin DAQ_EVENT VARIABLE /end DAQ_EVENT
 /end IF_DATA
/end MEASUREMENT
/begin MEASUREMENT MoFRelsMngt_flgVHyst "movement detection flag" UBYTE B_TRUE 1 100 0.00 1.00000000000 BIT_MASK 0x10 FORMAT "%13.11" ECU_ADDRESS 0x6002C6DD
 /begin IF_DATA XCPplus 0x0102
  /begin DAQ_EVENT VARIABLE /end DAQ_EVENT
 /end IF_DATA
/end MEASUREMENT
/begin MEASUREMENT MoFRelsMngt_stGearNumOld "Flag for gear lever position from previous raster" UBYTE OneToOne 1 100 0.00 255.0 FORMAT "%5.1" ECU_ADDRESS 0x6002C6DA
 /begin IF_DATA XCPplus 0x0102
  /begin DAQ_EVENT VARIABLE /end DAQ_EVENT
 /end IF_DATA
/end MEASUREMENT
/begin MEASUREMENT MoFRelsMngt_stGearNumOldCpl "RAM data redundancy for MoFRelsMngt_stGearNumOld" UBYTE OneToOne 1 100 0.00 255.0 FORMAT "%5.1" ECU_ADDRESS 0x6002BCBD
 /begin IF_DATA XCPplus 0x0102
  /begin DAQ_EVENT VARIABLE /end DAQ_EVENT
 /end IF_DATA
/end MEASUREMENT
/begin MEASUREMENT MoFRelsMngt_stPtAct "power train activ in function monitoring" UBYTE OneToOne 1 100 0.00 255.0 FORMAT "%5.1" ECU_ADDRESS 0x6002C6D9
 /begin IF_DATA XCPplus 0x0102
  /begin DAQ_EVENT VARIABLE /end DAQ_EVENT
 /end IF_DATA
/end MEASUREMENT
/begin MEASUREMENT MoFRelsMngt_stPtActCpl "complement power train activ in function monitoring" UBYTE OneToOne 1 100 0.00 255.0 FORMAT "%5.1" ECU_ADDRESS 0x6002BCBC
 /begin IF_DATA XCPplus 0x0102
  /begin DAQ_EVENT VARIABLE /end DAQ_EVENT
 /end IF_DATA
/end MEASUREMENT
/begin MEASUREMENT MoFTqPtdAxleComp_bbLoc2Cpl "RAM data redundancy for MoFTqPtdAxleComp_bbLoc2" UBYTE OneToOne 1 100 0.00 255.0 FORMAT "%5.1" ECU_ADDRESS 0x6002BC97
 /begin IF_DATA XCPplus 0x0102
  /begin DAQ_EVENT VARIABLE /end DAQ_EVENT
 /end IF_DATA
/end MEASUREMENT
/begin MEASUREMENT MoFTqPtdAxleComp_bbLocCpl "RAM data redundancy for MoFTqPtdAxleComp_bbLoc" UBYTE OneToOne 1 100 0.00 255.0 FORMAT "%5.1" ECU_ADDRESS 0x6002BC96
 /begin IF_DATA XCPplus 0x0102
  /begin DAQ_EVENT VARIABLE /end DAQ_EVENT
 /end IF_DATA
/end MEASUREMENT
/begin MEASUREMENT MoFTqPtdAxleCoorn_bbLoc1Cpl "Complement of Local Bitbasis 1" UBYTE OneToOne 1 100 0.00 255.0 FORMAT "%5.1" ECU_ADDRESS 0x6002BC7D
 /begin IF_DATA XCPplus 0x0102
  /begin DAQ_EVENT VARIABLE /end DAQ_EVENT
 /end IF_DATA
/end MEASUREMENT
/begin MEASUREMENT MoFTqPtdAxleCoorn_bbOutCpl "Complement of MoFTqPtdAxleCoorn_bbOutCpl" UBYTE OneToOne 1 100 0.00 255.0 FORMAT "%5.1" ECU_ADDRESS 0x6002BC7C
 /begin IF_DATA XCPplus 0x0102
  /begin DAQ_EVENT VARIABLE /end DAQ_EVENT
 /end IF_DATA
/end MEASUREMENT
/begin MEASUREMENT MoFTqPtdAxleSecComp_bbLoc2Cpl "Complement of MoFTqPtdAxleSecComp_bbLoc2" UBYTE OneToOne 1 100 0.00 255.0 FORMAT "%5.1" ECU_ADDRESS 0x6002BCBB
 /begin IF_DATA XCPplus 0x0102
  /begin DAQ_EVENT VARIABLE /end DAQ_EVENT
 /end IF_DATA
/end MEASUREMENT
/begin MEASUREMENT MoFTqPtdAxleSecComp_bbLocCpl "Complement of MoFTqPtdAxleSecComp_bbLoc" UBYTE OneToOne 1 100 0.00 255.0 FORMAT "%5.1" ECU_ADDRESS 0x6002BCBA
 /begin IF_DATA XCPplus 0x0102
  /begin DAQ_EVENT VARIABLE /end DAQ_EVENT
 /end IF_DATA
/end MEASUREMENT
/begin MEASUREMENT MoFTqPtdAxleSec_cntrTestComp "Diagnosis test counter to heal DFC_MoFTqPtdAxleSec" UBYTE OneToOne 1 100 0.00 255.0 FORMAT "%5.1" ECU_ADDRESS 0x600230F8
 /begin IF_DATA XCPplus 0x0102
  /begin DAQ_EVENT VARIABLE /end DAQ_EVENT
 /end IF_DATA
/end MEASUREMENT
/begin MEASUREMENT MoFTqPtdAxleSec_cntrTqComp "Debounce counter for torque comparison error on secondary axle level" UBYTE OneToOne 1 100 0.00 255.0 FORMAT "%5.1" ECU_ADDRESS 0x6002C6D5
 /begin IF_DATA XCPplus 0x0102
  /begin DAQ_EVENT VARIABLE /end DAQ_EVENT
 /end IF_DATA
/end MEASUREMENT
/begin MEASUREMENT MoFTqPtdAxleSec_cntrTqCompCpl "Complement of MoFTqPtdAxleSec_cntrTqComp" UBYTE OneToOne 1 100 0.00 255.0 FORMAT "%5.1" ECU_ADDRESS 0x6002BCB9
 /begin IF_DATA XCPplus 0x0102
  /begin DAQ_EVENT VARIABLE /end DAQ_EVENT
 /end IF_DATA
/end MEASUREMENT
/begin MEASUREMENT MoFTqPtdAxleSec_flgClr "Condition clear FCM in function MoFTqPtdAxleSec_Comp" UBYTE B_TRUE 1 100 0.00 1.00000000000 BIT_MASK 0x1 FORMAT "%13.11" ECU_ADDRESS 0x7000011F
 /begin IF_DATA XCPplus 0x0102
  /begin DAQ_EVENT VARIABLE /end DAQ_EVENT
 /end IF_DATA
/end MEASUREMENT
/begin MEASUREMENT MoFTqPtdAxleSec_flgIrrvErrMsg "Irreversible error status for torque error on secondary axle level" UBYTE B_TRUE 1 100 0.00 1.00000000000 BIT_MASK 0x1 FORMAT "%13.11" ECU_ADDRESS 0x70000237
 /begin IF_DATA XCPplus 0x0102
  /begin DAQ_EVENT VARIABLE /end DAQ_EVENT
 /end IF_DATA
/end MEASUREMENT
/begin MEASUREMENT MoFTqPtdAxleSec_flgLwrLimExcd "Error flag: Undercut of permitted lower torque limit" UBYTE B_TRUE 1 100 0.00 1.00000000000 BIT_MASK 0x1 FORMAT "%13.11" ECU_ADDRESS 0x6002C6D7
 /begin IF_DATA XCPplus 0x0102
  /begin DAQ_EVENT VARIABLE /end DAQ_EVENT
 /end IF_DATA
/end MEASUREMENT
/begin MEASUREMENT MoFTqPtdAxleSec_flgOthTrqCompErr "Error flag for torque comparison errors of vehicle and secondary e-machine level which considered at secondary axle level" UBYTE B_TRUE 1 100 0.00 1.00000000000 BIT_MASK 0x1 FORMAT "%13.11" ECU_ADDRESS 0x6002C6D6
 /begin IF_DATA XCPplus 0x0102
  /begin DAQ_EVENT VARIABLE /end DAQ_EVENT
 /end IF_DATA
/end MEASUREMENT
/begin MEASUREMENT MoFTqPtdAxleSec_flgTestMsg "Bit test conditions for diagnosis of fault path DFC_MoFTqPtdAxle" UBYTE B_TRUE 1 100 0.00 1.00000000000 BIT_MASK 0x1 FORMAT "%13.11" ECU_ADDRESS 0x70000236
 /begin IF_DATA XCPplus 0x0102
  /begin DAQ_EVENT VARIABLE /end DAQ_EVENT
 /end IF_DATA
/end MEASUREMENT
/begin MEASUREMENT MoFTqPtdAxleSec_flgTqCompDeb "State: error debouncing in torque comparison on secondary axle level active" UBYTE B_TRUE 1 100 0.00 1.00000000000 BIT_MASK 0x4 FORMAT "%13.11" ECU_ADDRESS 0x6002C6D7
 /begin IF_DATA XCPplus 0x0102
  /begin DAQ_EVENT VARIABLE /end DAQ_EVENT
 /end IF_DATA
/end MEASUREMENT
/begin MEASUREMENT MoFTqPtdAxleSec_flgTqCompErr "Error flag: Error in torque comparison on secondary axle level" UBYTE B_TRUE 1 100 0.00 1.00000000000 BIT_MASK 0x8 FORMAT "%13.11" ECU_ADDRESS 0x6002C6D7
 /begin IF_DATA XCPplus 0x0102
  /begin DAQ_EVENT VARIABLE /end DAQ_EVENT
 /end IF_DATA
/end MEASUREMENT
/begin MEASUREMENT MoFTqPtdAxleSec_flgTqIntegDeb "State: error debouncing in torque integral check on secondary axle level active" UBYTE B_TRUE 1 100 0.00 1.00000000000 BIT_MASK 0x10 FORMAT "%13.11" ECU_ADDRESS 0x6002C6D7
 /begin IF_DATA XCPplus 0x0102
  /begin DAQ_EVENT VARIABLE /end DAQ_EVENT
 /end IF_DATA
/end MEASUREMENT
/begin MEASUREMENT MoFTqPtdAxleSec_flgTqIntegErr "Error flag: Error in torque integral check on secondary axle level" UBYTE B_TRUE 1 100 0.00 1.00000000000 BIT_MASK 0x20 FORMAT "%13.11" ECU_ADDRESS 0x6002C6D7
 /begin IF_DATA XCPplus 0x0102
  /begin DAQ_EVENT VARIABLE /end DAQ_EVENT
 /end IF_DATA
/end MEASUREMENT
/begin MEASUREMENT MoFTqPtdAxleSec_flgTqLimChkErr "Error flag: xceedance of permitted torque limit on secondary axle level" UBYTE B_TRUE 1 100 0.00 1.00000000000 BIT_MASK 0x40 FORMAT "%13.11" ECU_ADDRESS 0x6002C6D7
 /begin IF_DATA XCPplus 0x0102
  /begin DAQ_EVENT VARIABLE /end DAQ_EVENT
 /end IF_DATA
/end MEASUREMENT
/begin MEASUREMENT MoFTqPtdAxleSec_flgTqSecAxleCoordNeg "Status: Coordinated desired torque on secondary axle level in function monitoring is negative" UBYTE B_TRUE 1 100 0.00 1.00000000000 BIT_MASK 0x2 FORMAT "%13.11" ECU_ADDRESS 0x6002C6D7
 /begin IF_DATA XCPplus 0x0102
  /begin DAQ_EVENT VARIABLE /end DAQ_EVENT
 /end IF_DATA
/end MEASUREMENT
/begin MEASUREMENT MoFTqPtdAxleSec_flgUpLimExcd "Error flag: Exceedance of permitted upper torque limit" UBYTE B_TRUE 1 100 0.00 1.00000000000 BIT_MASK 0x80 FORMAT "%13.11" ECU_ADDRESS 0x6002C6D7
 /begin IF_DATA XCPplus 0x0102
  /begin DAQ_EVENT VARIABLE /end DAQ_EVENT
 /end IF_DATA
/end MEASUREMENT
/begin MEASUREMENT MoFTqPtdAxleSec_stErrTqComp "error state of torque comparison on secondary axle level" UBYTE OneToOne 1 100 0.00 255.0 FORMAT "%5.1" ECU_ADDRESS 0x6002C6D4
 /begin IF_DATA XCPplus 0x0102
  /begin DAQ_EVENT VARIABLE /end DAQ_EVENT
 /end IF_DATA
/end MEASUREMENT
/begin MEASUREMENT MoFTqPtdAxleSec_stErrTqCompCpl "Complement of MoFTqPtdAxleSec_stErrTqComp" UBYTE OneToOne 1 100 0.00 255.0 FORMAT "%5.1" ECU_ADDRESS 0x6002BCB8
 /begin IF_DATA XCPplus 0x0102
  /begin DAQ_EVENT VARIABLE /end DAQ_EVENT
 /end IF_DATA
/end MEASUREMENT
/begin MEASUREMENT MoFTqPtdAxleSec_tqDesSecAxle "Secondary axel desired torque." SLONG TrqPrpHigh 1 100 -214748364.800 214748364.700 FORMAT "%13.3" ECU_ADDRESS 0x6002C6C0
 /begin IF_DATA XCPplus 0x0102
  /begin DAQ_EVENT VARIABLE /end DAQ_EVENT
 /end IF_DATA
/end MEASUREMENT
/begin MEASUREMENT MoFTqPtdAxleSec_tqDesSecAxleCpl "Complement of MoFTqPtdAxleSec_tqDesSecAxle" ULONG OneToOne 1 100 0.00 4294967295.00 FORMAT "%13.2" ECU_ADDRESS 0x6002BCB4
 /begin IF_DATA XCPplus 0x0102
  /begin DAQ_EVENT VARIABLE /end DAQ_EVENT
 /end IF_DATA
/end MEASUREMENT
/begin MEASUREMENT MoFTqPtdAxleSec_tqDesSecAxleFil "Secondary axle desired torque after Filter" SLONG TrqPrpHigh 1 100 -214748364.800 214748364.700 FORMAT "%13.3" ECU_ADDRESS 0x6002C6B4
 /begin IF_DATA XCPplus 0x0102
  /begin DAQ_EVENT VARIABLE /end DAQ_EVENT
 /end IF_DATA
/end MEASUREMENT
/begin MEASUREMENT MoFTqPtdAxleSec_tqDesSecAxleFilCpl "RAM data redundancy for MoFTqPtdAxleSec_tqDesSecAxleFil" ULONG OneToOne 1 100 0.00 4294967295.00 FORMAT "%13.2" ECU_ADDRESS 0x6002BC98
 /begin IF_DATA XCPplus 0x0102
  /begin DAQ_EVENT VARIABLE /end DAQ_EVENT
 /end IF_DATA
/end MEASUREMENT
/begin MEASUREMENT MoFTqPtdAxleSec_tqDifAxle "Difference between desired and permitted torque" SLONG TrqPrpHigh 1 100 -214748364.800 214748364.700 FORMAT "%13.3" ECU_ADDRESS 0x6002C6D0
 /begin IF_DATA XCPplus 0x0102
  /begin DAQ_EVENT VARIABLE /end DAQ_EVENT
 /end IF_DATA
/end MEASUREMENT
/begin MEASUREMENT MoFTqPtdAxleSec_tqDifAxleCpl "Complement of MoFTqPtdAxleSec_tqDifAxle" ULONG OneToOne 1 100 0.00 4294967295.00 FORMAT "%13.2" ECU_ADDRESS 0x6002BCB0
 /begin IF_DATA XCPplus 0x0102
  /begin DAQ_EVENT VARIABLE /end DAQ_EVENT
 /end IF_DATA
/end MEASUREMENT
/begin MEASUREMENT MoFTqPtdAxleSec_tqLowrLim "Lower limit of permitted torque on secondary axle level in function monitoring" SLONG TrqPrpHigh 1 100 -214748364.800 214748364.700 FORMAT "%13.3" ECU_ADDRESS 0x6002C6CC
 /begin IF_DATA XCPplus 0x0102
  /begin DAQ_EVENT VARIABLE /end DAQ_EVENT
 /end IF_DATA
/end MEASUREMENT
/begin MEASUREMENT MoFTqPtdAxleSec_tqLowrLimCpl "Complement of MoFTqPtdAxleSec_tqLowrLim" ULONG OneToOne 1 100 0.00 4294967295.00 FORMAT "%13.2" ECU_ADDRESS 0x6002BCAC
 /begin IF_DATA XCPplus 0x0102
  /begin DAQ_EVENT VARIABLE /end DAQ_EVENT
 /end IF_DATA
/end MEASUREMENT
/begin MEASUREMENT MoFTqPtdAxleSec_tqSecAxleCoord "Secondary axle coordinated torque" SLONG TrqPrpHigh 1 100 -214748364.800 214748364.700 FORMAT "%13.3" ECU_ADDRESS 0x6002C6B8
 /begin IF_DATA XCPplus 0x0102
  /begin DAQ_EVENT VARIABLE /end DAQ_EVENT
 /end IF_DATA
/end MEASUREMENT
/begin MEASUREMENT MoFTqPtdAxleSec_tqSecAxleCoordCpl "RAM data redundancy for MoFTqPtdAxleSec_tqSecAxleCoord" ULONG OneToOne 1 100 0.00 4294967295.00 FORMAT "%13.2" ECU_ADDRESS 0x6002BC9C
 /begin IF_DATA XCPplus 0x0102
  /begin DAQ_EVENT VARIABLE /end DAQ_EVENT
 /end IF_DATA
/end MEASUREMENT
/begin MEASUREMENT MoFTqPtdAxleSec_tqSecAxleCoordLoResl "Secondary axle coordinated torque low resolution" SWORD TrqPrp 1 100 -52428.80 52427.20 FORMAT "%8.2" ECU_ADDRESS 0x6002C6BC
 /begin IF_DATA XCPplus 0x0102
  /begin DAQ_EVENT VARIABLE /end DAQ_EVENT
 /end IF_DATA
/end MEASUREMENT
/begin MEASUREMENT MoFTqPtdAxleSec_tqSecAxleCoordLoReslCpl "RAM data redundancy for MoFTqPtdAxleSec_tqSecAxleCoordLoResl" UWORD OneToOne 1 100 0.00 65535.00 FORMAT "%8.2" ECU_ADDRESS 0x6002BCA0
 /begin IF_DATA XCPplus 0x0102
  /begin DAQ_EVENT VARIABLE /end DAQ_EVENT
 /end IF_DATA
/end MEASUREMENT
/begin MEASUREMENT MoFTqPtdAxleSec_tqTiInteg "Integral value of torque comparison on secondary axle level" SLONG mdt_q0p001_Nm_s 1 100 -2147483.64800 2147483.64700 FORMAT "%13.5" ECU_ADDRESS 0x6002C6C8
 /begin IF_DATA XCPplus 0x0102
  /begin DAQ_EVENT VARIABLE /end DAQ_EVENT
 /end IF_DATA
/end MEASUREMENT
/begin MEASUREMENT MoFTqPtdAxleSec_tqTiIntegCpl "Complement of MoFTqPtdAxleSec_tqTiInteg" ULONG OneToOne 1 100 0.00 4294967295.00 FORMAT "%13.2" ECU_ADDRESS 0x6002BCA8
 /begin IF_DATA XCPplus 0x0102
  /begin DAQ_EVENT VARIABLE /end DAQ_EVENT
 /end IF_DATA
/end MEASUREMENT
/begin MEASUREMENT MoFTqPtdAxleSec_tqUpLim "Upper limit of permitted torque on secondary axle level in function monitoring" SLONG TrqPrpHigh 1 100 -214748364.800 214748364.700 FORMAT "%13.3" ECU_ADDRESS 0x6002C6C4
 /begin IF_DATA XCPplus 0x0102
  /begin DAQ_EVENT VARIABLE /end DAQ_EVENT
 /end IF_DATA
/end MEASUREMENT
/begin MEASUREMENT MoFTqPtdAxleSec_tqUpLimCpl "Complement of MoFTqPtdAxleSec_tqUpLim" ULONG OneToOne 1 100 0.00 4294967295.00 FORMAT "%13.2" ECU_ADDRESS 0x6002BCA4
 /begin IF_DATA XCPplus 0x0102
  /begin DAQ_EVENT VARIABLE /end DAQ_EVENT
 /end IF_DATA
/end MEASUREMENT
/begin MEASUREMENT MoFTqPtdAxle_cntrTestComp "Diagnosis test counter to heal DFC_MoFTqPtdAxle" UBYTE OneToOne 1 100 0.00 255.0 FORMAT "%5.1" ECU_ADDRESS 0x600230F7
 /begin IF_DATA XCPplus 0x0102
  /begin DAQ_EVENT VARIABLE /end DAQ_EVENT
 /end IF_DATA
/end MEASUREMENT
/begin MEASUREMENT MoFTqPtdAxle_cntrTqComp "Debounce counter for torque comparison error on axle level" UBYTE OneToOne 1 100 0.00 255.0 FORMAT "%5.1" ECU_ADDRESS 0x6002C6B1
 /begin IF_DATA XCPplus 0x0102
  /begin DAQ_EVENT VARIABLE /end DAQ_EVENT
 /end IF_DATA
/end MEASUREMENT
/begin MEASUREMENT MoFTqPtdAxle_cntrTqCompCpl "RAM data redundancy for MoFTqPtdAxle_cntrTqComp" UBYTE OneToOne 1 100 0.00 255.0 FORMAT "%5.1" ECU_ADDRESS 0x6002BC95
 /begin IF_DATA XCPplus 0x0102
  /begin DAQ_EVENT VARIABLE /end DAQ_EVENT
 /end IF_DATA
/end MEASUREMENT
/begin MEASUREMENT MoFTqPtdAxle_dirPrimAxleRamp "Variable to indicate the direction of the Ramp for primary axle" SWORD OneToOne 1 100 -32768.00 32767.00 FORMAT "%8.2" ECU_ADDRESS 0x6002C646
 /begin IF_DATA XCPplus 0x0102
  /begin DAQ_EVENT VARIABLE /end DAQ_EVENT
 /end IF_DATA
/end MEASUREMENT
/begin MEASUREMENT MoFTqPtdAxle_dirPrimAxleRampCpl "Complement of the variable to indicate the direction of the Ramp for primary axle" UWORD OneToOne 1 100 0.00 65535.00 FORMAT "%8.2" ECU_ADDRESS 0x6002BC2A
 /begin IF_DATA XCPplus 0x0102
  /begin DAQ_EVENT VARIABLE /end DAQ_EVENT
 /end IF_DATA
/end MEASUREMENT
/begin MEASUREMENT MoFTqPtdAxle_dirSecAxleRamp "Variable to indicate the direction of the Ramp for secondary axle" SWORD OneToOne 1 100 -32768.00 32767.00 FORMAT "%8.2" ECU_ADDRESS 0x6002C644
 /begin IF_DATA XCPplus 0x0102
  /begin DAQ_EVENT VARIABLE /end DAQ_EVENT
 /end IF_DATA
/end MEASUREMENT
/begin MEASUREMENT MoFTqPtdAxle_dirSecAxleRampCpl "Complement of the variable to indicate the direction of the Ramp for secondary axle" UWORD OneToOne 1 100 0.00 65535.00 FORMAT "%8.2" ECU_ADDRESS 0x6002BC28
 /begin IF_DATA XCPplus 0x0102
  /begin DAQ_EVENT VARIABLE /end DAQ_EVENT
 /end IF_DATA
/end MEASUREMENT
/begin MEASUREMENT MoFTqPtdAxle_facTqDistbn "Level2 torque distribution factor" SWORD fak_q1p22Em4 1 100 0.00 1.000000 FORMAT "%8.6" ECU_ADDRESS 0x6002C634
 /begin IF_DATA XCPplus 0x0102
  /begin DAQ_EVENT VARIABLE /end DAQ_EVENT
 /end IF_DATA
/end MEASUREMENT
/begin MEASUREMENT MoFTqPtdAxle_facTqDistbnCpl "Complement of Level2 torque distribution facto" UWORD OneToOne 1 100 0.00 65535.00 FORMAT "%8.2" ECU_ADDRESS 0x6002BC1E
 /begin IF_DATA XCPplus 0x0102
  /begin DAQ_EVENT VARIABLE /end DAQ_EVENT
 /end IF_DATA
/end MEASUREMENT
/begin MEASUREMENT MoFTqPtdAxle_facTqDistbnMin "Minimum torque distribution factor" SWORD fak_q1p22Em4 1 100 0.00 1.000000 FORMAT "%8.6" ECU_ADDRESS 0x6002C63A
 /begin IF_DATA XCPplus 0x0102
  /begin DAQ_EVENT VARIABLE /end DAQ_EVENT
 /end IF_DATA
/end MEASUREMENT
/begin MEASUREMENT MoFTqPtdAxle_facTqDistbnMinCpl "Complement of minimum torque distribution factor" UWORD OneToOne 1 100 0.00 65535.00 FORMAT "%8.2" ECU_ADDRESS 0x6002BC1C
 /begin IF_DATA XCPplus 0x0102
  /begin DAQ_EVENT VARIABLE /end DAQ_EVENT
 /end IF_DATA
/end MEASUREMENT
/begin MEASUREMENT MoFTqPtdAxle_facTqNoRecupDistbn "Torque distibution factor if there is no recuperation" SWORD fak_q1p22Em4 1 100 0.00 1.000000 FORMAT "%8.6" ECU_ADDRESS 0x6002C638
 /begin IF_DATA XCPplus 0x0102
  /begin DAQ_EVENT VARIABLE /end DAQ_EVENT
 /end IF_DATA
/end MEASUREMENT
/begin MEASUREMENT MoFTqPtdAxle_facTqNoRecupDistbnCpl "Complement of torque distibution factor if there is no recuperation" UWORD OneToOne 1 100 0.00 65535.00 FORMAT "%8.2" ECU_ADDRESS 0x6002BC1A
 /begin IF_DATA XCPplus 0x0102
  /begin DAQ_EVENT VARIABLE /end DAQ_EVENT
 /end IF_DATA
/end MEASUREMENT
/begin MEASUREMENT MoFTqPtdAxle_flgClr "Condition clear FCM in function MoFTqPtdAxle_Comp" UBYTE B_TRUE 1 100 0.00 1.00000000000 BIT_MASK 0x1 FORMAT "%13.11" ECU_ADDRESS 0x7000011E
 /begin IF_DATA XCPplus 0x0102
  /begin DAQ_EVENT VARIABLE /end DAQ_EVENT
 /end IF_DATA
/end MEASUREMENT
/begin MEASUREMENT MoFTqPtdAxle_flgIrrvErrMsg "Irreversible error status for torque error on axle level" UBYTE B_TRUE 1 100 0.00 1.00000000000 BIT_MASK 0x1 FORMAT "%13.11" ECU_ADDRESS 0x70000235
 /begin IF_DATA XCPplus 0x0102
  /begin DAQ_EVENT VARIABLE /end DAQ_EVENT
 /end IF_DATA
/end MEASUREMENT
/begin MEASUREMENT MoFTqPtdAxle_flgLwrLimExcd "Error flag: Undercut of permitted lower torque limit" UBYTE B_TRUE 1 100 0.00 1.00000000000 BIT_MASK 0x1 FORMAT "%13.11" ECU_ADDRESS 0x6002C6B3
 /begin IF_DATA XCPplus 0x0102
  /begin DAQ_EVENT VARIABLE /end DAQ_EVENT
 /end IF_DATA
/end MEASUREMENT
/begin MEASUREMENT MoFTqPtdAxle_flgOthTrqCompErr "Error flag for torque comparison errors of vehicle and e-machine level which considered at axle level" UBYTE B_TRUE 1 100 0.00 1.00000000000 BIT_MASK 0x1 FORMAT "%13.11" ECU_ADDRESS 0x6002C6B2
 /begin IF_DATA XCPplus 0x0102
  /begin DAQ_EVENT VARIABLE /end DAQ_EVENT
 /end IF_DATA
/end MEASUREMENT
/begin MEASUREMENT MoFTqPtdAxle_flgPrimAxleGearNeutRampActvd "Flag to indicate primary axle neutral gear ramp activation" UBYTE B_TRUE 1 100 0.00 1.00000000000 BIT_MASK 0x2 FORMAT "%13.11" ECU_ADDRESS 0x6002C698
 /begin IF_DATA XCPplus 0x0102
  /begin DAQ_EVENT VARIABLE /end DAQ_EVENT
 /end IF_DATA
/end MEASUREMENT
/begin MEASUREMENT MoFTqPtdAxle_flgPrimGearLvrNeutEdgeRisng "Flag to indicate the rising edge detection when neutral gear is set for primary axle" UBYTE B_TRUE 1 100 0.00 1.00000000000 BIT_MASK 0x4 FORMAT "%13.11" ECU_ADDRESS 0x6002C699
 /begin IF_DATA XCPplus 0x0102
  /begin DAQ_EVENT VARIABLE /end DAQ_EVENT
 /end IF_DATA
/end MEASUREMENT
/begin MEASUREMENT MoFTqPtdAxle_flgPrimGearLvrNeutOld "Flag to indicate the old value of gear lever in neutral for primary axle" UBYTE B_TRUE 1 100 0.00 1.00000000000 BIT_MASK 0x8 FORMAT "%13.11" ECU_ADDRESS 0x6002C699
 /begin IF_DATA XCPplus 0x0102
  /begin DAQ_EVENT VARIABLE /end DAQ_EVENT
 /end IF_DATA
/end MEASUREMENT
/begin MEASUREMENT MoFTqPtdAxle_flgSecAxleGearNeutRampActvd "Flag to indicate secondary axle neutral gear ramp activation" UBYTE B_TRUE 1 100 0.00 1.00000000000 BIT_MASK 0x1 FORMAT "%13.11" ECU_ADDRESS 0x6002C698
 /begin IF_DATA XCPplus 0x0102
  /begin DAQ_EVENT VARIABLE /end DAQ_EVENT
 /end IF_DATA
/end MEASUREMENT
/begin MEASUREMENT MoFTqPtdAxle_flgSecGearLvrNeutEdgeRisng "Flag to indicate the rising edge detection when neutral gear is set for secondary axle" UBYTE B_TRUE 1 100 0.00 1.00000000000 BIT_MASK 0x1 FORMAT "%13.11" ECU_ADDRESS 0x6002C699
 /begin IF_DATA XCPplus 0x0102
  /begin DAQ_EVENT VARIABLE /end DAQ_EVENT
 /end IF_DATA
/end MEASUREMENT
/begin MEASUREMENT MoFTqPtdAxle_flgSecGearLvrNeutOld "Flag to indicate the old value of gear lever in neutral for secondary axle" UBYTE B_TRUE 1 100 0.00 1.00000000000 BIT_MASK 0x2 FORMAT "%13.11" ECU_ADDRESS 0x6002C699
 /begin IF_DATA XCPplus 0x0102
  /begin DAQ_EVENT VARIABLE /end DAQ_EVENT
 /end IF_DATA
/end MEASUREMENT
/begin MEASUREMENT MoFTqPtdAxle_flgTestMsg "Bit test conditions for diagnosis of fault path DFC_MoFTqPtdAxle" UBYTE B_TRUE 1 100 0.00 1.00000000000 BIT_MASK 0x1 FORMAT "%13.11" ECU_ADDRESS 0x70000234
 /begin IF_DATA XCPplus 0x0102
  /begin DAQ_EVENT VARIABLE /end DAQ_EVENT
 /end IF_DATA
/end MEASUREMENT
/begin MEASUREMENT MoFTqPtdAxle_flgTqCompDeb "State: error debouncing in torque comparison on axle level active" UBYTE B_TRUE 1 100 0.00 1.00000000000 BIT_MASK 0x4 FORMAT "%13.11" ECU_ADDRESS 0x6002C6B3
 /begin IF_DATA XCPplus 0x0102
  /begin DAQ_EVENT VARIABLE /end DAQ_EVENT
 /end IF_DATA
/end MEASUREMENT
/begin MEASUREMENT MoFTqPtdAxle_flgTqCompErr "Error flag: Error in torque comparison on axle level" UBYTE B_TRUE 1 100 0.00 1.00000000000 BIT_MASK 0x8 FORMAT "%13.11" ECU_ADDRESS 0x6002C6B3
 /begin IF_DATA XCPplus 0x0102
  /begin DAQ_EVENT VARIABLE /end DAQ_EVENT
 /end IF_DATA
/end MEASUREMENT
/begin MEASUREMENT MoFTqPtdAxle_flgTqIntegDeb "State: error debouncing in torque integral check on axle level active" UBYTE B_TRUE 1 100 0.00 1.00000000000 BIT_MASK 0x10 FORMAT "%13.11" ECU_ADDRESS 0x6002C6B3
 /begin IF_DATA XCPplus 0x0102
  /begin DAQ_EVENT VARIABLE /end DAQ_EVENT
 /end IF_DATA
/end MEASUREMENT
/begin MEASUREMENT MoFTqPtdAxle_flgTqIntegErr "Error flag: Error in torque integral check on axle level" UBYTE B_TRUE 1 100 0.00 1.00000000000 BIT_MASK 0x20 FORMAT "%13.11" ECU_ADDRESS 0x6002C6B3
 /begin IF_DATA XCPplus 0x0102
  /begin DAQ_EVENT VARIABLE /end DAQ_EVENT
 /end IF_DATA
/end MEASUREMENT
/begin MEASUREMENT MoFTqPtdAxle_flgTqLimChkErr "Error flag: xceedance of permitted torque limit on axle level" UBYTE B_TRUE 1 100 0.00 1.00000000000 BIT_MASK 0x40 FORMAT "%13.11" ECU_ADDRESS 0x6002C6B3
 /begin IF_DATA XCPplus 0x0102
  /begin DAQ_EVENT VARIABLE /end DAQ_EVENT
 /end IF_DATA
/end MEASUREMENT
/begin MEASUREMENT MoFTqPtdAxle_flgTqPrimAxleCoordNeg "Status: Coordinated desired torque on axle level in function monitoring is negative" UBYTE B_TRUE 1 100 0.00 1.00000000000 BIT_MASK 0x2 FORMAT "%13.11" ECU_ADDRESS 0x6002C6B3
 /begin IF_DATA XCPplus 0x0102
  /begin DAQ_EVENT VARIABLE /end DAQ_EVENT
 /end IF_DATA
/end MEASUREMENT
/begin MEASUREMENT MoFTqPtdAxle_flgUpLimExcd "Error flag: Exceedance of permitted upper torque limit" UBYTE B_TRUE 1 100 0.00 1.00000000000 BIT_MASK 0x80 FORMAT "%13.11" ECU_ADDRESS 0x6002C6B3
 /begin IF_DATA XCPplus 0x0102
  /begin DAQ_EVENT VARIABLE /end DAQ_EVENT
 /end IF_DATA
/end MEASUREMENT
/begin MEASUREMENT MoFTqPtdAxle_stErrTqComp "error state of torque comparison on axle level" UBYTE OneToOne 1 100 0.00 255.0 FORMAT "%5.1" ECU_ADDRESS 0x6002C6B0
 /begin IF_DATA XCPplus 0x0102
  /begin DAQ_EVENT VARIABLE /end DAQ_EVENT
 /end IF_DATA
/end MEASUREMENT
/begin MEASUREMENT MoFTqPtdAxle_stErrTqCompCpl "RAM data redundancy for MoFTqPtdAxle_stErrTqComp" UBYTE OneToOne 1 100 0.00 255.0 FORMAT "%5.1" ECU_ADDRESS 0x6002BC94
 /begin IF_DATA XCPplus 0x0102
  /begin DAQ_EVENT VARIABLE /end DAQ_EVENT
 /end IF_DATA
/end MEASUREMENT
/begin MEASUREMENT MoFTqPtdAxle_tqBrkDesMaxPrimAxle "Maximum desired processed brake torque for primary axle" SLONG TrqPrpHigh 1 100 -214748364.800 214748364.700 FORMAT "%13.3" ECU_ADDRESS 0x6002C694
 /begin IF_DATA XCPplus 0x0102
  /begin DAQ_EVENT VARIABLE /end DAQ_EVENT
 /end IF_DATA
/end MEASUREMENT
/begin MEASUREMENT MoFTqPtdAxle_tqBrkDesMaxPrimAxleCpl "complement of Maximum desired processed brake torque for primary axle" ULONG OneToOne 1 100 0.00 4294967295.00 FORMAT "%13.2" ECU_ADDRESS 0x6002BC78
 /begin IF_DATA XCPplus 0x0102
  /begin DAQ_EVENT VARIABLE /end DAQ_EVENT
 /end IF_DATA
/end MEASUREMENT
/begin MEASUREMENT MoFTqPtdAxle_tqBrkDesMaxSecAxle "Maximum desired processed brake torque for secondary axle" SLONG TrqPrpHigh 1 100 -214748364.800 214748364.700 FORMAT "%13.3" ECU_ADDRESS 0x6002C690
 /begin IF_DATA XCPplus 0x0102
  /begin DAQ_EVENT VARIABLE /end DAQ_EVENT
 /end IF_DATA
/end MEASUREMENT
/begin MEASUREMENT MoFTqPtdAxle_tqBrkDesMaxSecAxleCpl "Complement of Maximum desired processed brake torque for secondary axle" ULONG OneToOne 1 100 0.00 4294967295.00 FORMAT "%13.2" ECU_ADDRESS 0x6002BC74
 /begin IF_DATA XCPplus 0x0102
  /begin DAQ_EVENT VARIABLE /end DAQ_EVENT
 /end IF_DATA
/end MEASUREMENT
/begin MEASUREMENT MoFTqPtdAxle_tqBrkDesPrimAxle "Desired processed brake torque for primary axle" SLONG TrqPrpHigh 1 100 -214748364.800 214748364.700 FORMAT "%13.3" ECU_ADDRESS 0x6002C68C
 /begin IF_DATA XCPplus 0x0102
  /begin DAQ_EVENT VARIABLE /end DAQ_EVENT
 /end IF_DATA
/end MEASUREMENT
/begin MEASUREMENT MoFTqPtdAxle_tqBrkDesPrimAxleCpl "Complement of Desired processed brake torque for primary axle" ULONG OneToOne 1 100 0.00 4294967295.00 FORMAT "%13.2" ECU_ADDRESS 0x6002BC70
 /begin IF_DATA XCPplus 0x0102
  /begin DAQ_EVENT VARIABLE /end DAQ_EVENT
 /end IF_DATA
/end MEASUREMENT
/begin MEASUREMENT MoFTqPtdAxle_tqBrkDesPrimAxleEval "CRBS Trq Primary Axle Raw Evaluated value" SLONG TrqPrpHigh 1 100 -214748364.800 214748364.700 FORMAT "%13.3" ECU_ADDRESS 0x6002C688
 /begin IF_DATA XCPplus 0x0102
  /begin DAQ_EVENT VARIABLE /end DAQ_EVENT
 /end IF_DATA
/end MEASUREMENT
/begin MEASUREMENT MoFTqPtdAxle_tqBrkDesPrimAxleEvalCpl "Complement of CRBS Trq Primary Axle Raw Evaluated value" ULONG OneToOne 1 100 0.00 4294967295.00 FORMAT "%13.2" ECU_ADDRESS 0x6002BC6C
 /begin IF_DATA XCPplus 0x0102
  /begin DAQ_EVENT VARIABLE /end DAQ_EVENT
 /end IF_DATA
/end MEASUREMENT
/begin MEASUREMENT MoFTqPtdAxle_tqBrkDesPrimAxleLim "Desired processed brake torque limit for primary axle" SLONG TrqPrpHigh 1 100 -214748364.800 214748364.700 FORMAT "%13.3" ECU_ADDRESS 0x6002C684
 /begin IF_DATA XCPplus 0x0102
  /begin DAQ_EVENT VARIABLE /end DAQ_EVENT
 /end IF_DATA
/end MEASUREMENT
/begin MEASUREMENT MoFTqPtdAxle_tqBrkDesPrimAxleLimCpl "Complement of desired processed brake torque limit for primary axle" ULONG OneToOne 1 100 0.00 4294967295.00 FORMAT "%13.2" ECU_ADDRESS 0x6002BC68
 /begin IF_DATA XCPplus 0x0102
  /begin DAQ_EVENT VARIABLE /end DAQ_EVENT
 /end IF_DATA
/end MEASUREMENT
/begin MEASUREMENT MoFTqPtdAxle_tqBrkDesSecAxle "Desired processed brake torque for second axle" SLONG TrqPrpHigh 1 100 -214748364.800 214748364.700 FORMAT "%13.3" ECU_ADDRESS 0x6002C64C
 /begin IF_DATA XCPplus 0x0102
  /begin DAQ_EVENT VARIABLE /end DAQ_EVENT
 /end IF_DATA
/end MEASUREMENT
/begin MEASUREMENT MoFTqPtdAxle_tqBrkDesSecAxleCpl "Complement of Desired processed brake torque for secondary axle" ULONG OneToOne 1 100 0.00 4294967295.00 FORMAT "%13.2" ECU_ADDRESS 0x6002BC64
 /begin IF_DATA XCPplus 0x0102
  /begin DAQ_EVENT VARIABLE /end DAQ_EVENT
 /end IF_DATA
/end MEASUREMENT
/begin MEASUREMENT MoFTqPtdAxle_tqBrkDesSecAxleEval "CRBS Trq secondary Axle Raw Evaluated value" SLONG TrqPrpHigh 1 100 -214748364.800 214748364.700 FORMAT "%13.3" ECU_ADDRESS 0x6002C680
 /begin IF_DATA XCPplus 0x0102
  /begin DAQ_EVENT VARIABLE /end DAQ_EVENT
 /end IF_DATA
/end MEASUREMENT
/begin MEASUREMENT MoFTqPtdAxle_tqBrkDesSecAxleEvalCpl "Complement of CRBS Trq secondary Axle Raw Evaluated value" ULONG OneToOne 1 100 0.00 4294967295.00 FORMAT "%13.2" ECU_ADDRESS 0x6002BC60
 /begin IF_DATA XCPplus 0x0102
  /begin DAQ_EVENT VARIABLE /end DAQ_EVENT
 /end IF_DATA
/end MEASUREMENT
/begin MEASUREMENT MoFTqPtdAxle_tqBrkDesSecAxleLim "Desired processed brake torque limit for secondary axle" SLONG TrqPrpHigh 1 100 -214748364.800 214748364.700 FORMAT "%13.3" ECU_ADDRESS 0x6002C67C
 /begin IF_DATA XCPplus 0x0102
  /begin DAQ_EVENT VARIABLE /end DAQ_EVENT
 /end IF_DATA
/end MEASUREMENT
/begin MEASUREMENT MoFTqPtdAxle_tqBrkDesSecAxleLimCpl "Complement of desired processed brake torque limit for secondary axle" ULONG OneToOne 1 100 0.00 4294967295.00 FORMAT "%13.2" ECU_ADDRESS 0x6002BC5C
 /begin IF_DATA XCPplus 0x0102
  /begin DAQ_EVENT VARIABLE /end DAQ_EVENT
 /end IF_DATA
/end MEASUREMENT
/begin MEASUREMENT MoFTqPtdAxle_tqBrkTqEvRcptPrimAxleLvl1 "Level 1 requested brake torque of the primary axle" SLONG TrqPrpHigh 1 100 -214748364.800 214748364.700 FORMAT "%13.3" ECU_ADDRESS 0x6002C678
 /begin IF_DATA XCPplus 0x0102
  /begin DAQ_EVENT VARIABLE /end DAQ_EVENT
 /end IF_DATA
/end MEASUREMENT
/begin MEASUREMENT MoFTqPtdAxle_tqBrkTqEvRcptPrimAxleLvl1Cpl "Complement of level 1 requested brake torque of the primary axle" ULONG OneToOne 1 100 0.00 4294967295.00 FORMAT "%13.2" ECU_ADDRESS 0x6002BC58
 /begin IF_DATA XCPplus 0x0102
  /begin DAQ_EVENT VARIABLE /end DAQ_EVENT
 /end IF_DATA
/end MEASUREMENT
/begin MEASUREMENT MoFTqPtdAxle_tqBrkTqEvRcptSecAxleLvl1 "Level 1 requested brake torque of the secondary axle" SLONG TrqPrpHigh 1 100 -214748364.800 214748364.700 FORMAT "%13.3" ECU_ADDRESS 0x6002C674
 /begin IF_DATA XCPplus 0x0102
  /begin DAQ_EVENT VARIABLE /end DAQ_EVENT
 /end IF_DATA
/end MEASUREMENT
/begin MEASUREMENT MoFTqPtdAxle_tqBrkTqEvRcptSecAxleLvl1Cpl "Complement of Level 1 requested brake torque of the secondary axle" ULONG OneToOne 1 100 0.00 4294967295.00 FORMAT "%13.2" ECU_ADDRESS 0x6002BC54
 /begin IF_DATA XCPplus 0x0102
  /begin DAQ_EVENT VARIABLE /end DAQ_EVENT
 /end IF_DATA
/end MEASUREMENT
/begin MEASUREMENT MoFTqPtdAxle_tqCrbsRecupMinAllwd "Minimum allowed CRBS recuperation torque" SLONG TrqPrpHigh 1 100 -214748364.800 214748364.700 FORMAT "%13.3" ECU_ADDRESS 0x6002C670
 /begin IF_DATA XCPplus 0x0102
  /begin DAQ_EVENT VARIABLE /end DAQ_EVENT
 /end IF_DATA
/end MEASUREMENT
/begin MEASUREMENT MoFTqPtdAxle_tqCrbsRecupMinAllwdCpl "Complement of minimum allowed CRBS recuperation torque" ULONG OneToOne 1 100 0.00 4294967295.00 FORMAT "%13.2" ECU_ADDRESS 0x6002BC50
 /begin IF_DATA XCPplus 0x0102
  /begin DAQ_EVENT VARIABLE /end DAQ_EVENT
 /end IF_DATA
/end MEASUREMENT
/begin MEASUREMENT MoFTqPtdAxle_tqDesPrimAxle "Torque Desire Axle Level" SLONG TrqPrpHigh 1 100 -214748364.800 214748364.700 FORMAT "%13.3" ECU_ADDRESS 0x6002C69C
 /begin IF_DATA XCPplus 0x0102
  /begin DAQ_EVENT VARIABLE /end DAQ_EVENT
 /end IF_DATA
/end MEASUREMENT
/begin MEASUREMENT MoFTqPtdAxle_tqDesPrimAxleCpl "RAM data redundancy for MoFTqPtdAxle_tqDesPrimAxle" ULONG OneToOne 1 100 0.00 4294967295.00 FORMAT "%13.2" ECU_ADDRESS 0x6002BC90
 /begin IF_DATA XCPplus 0x0102
  /begin DAQ_EVENT VARIABLE /end DAQ_EVENT
 /end IF_DATA
/end MEASUREMENT
/begin MEASUREMENT MoFTqPtdAxle_tqDesPrimAxleFil "Torque Desire Axle Level after Filter" SLONG TrqPrpHigh 1 100 -214748364.800 214748364.700 FORMAT "%13.3" ECU_ADDRESS 0x6002C630
 /begin IF_DATA XCPplus 0x0102
  /begin DAQ_EVENT VARIABLE /end DAQ_EVENT
 /end IF_DATA
/end MEASUREMENT
/begin MEASUREMENT MoFTqPtdAxle_tqDesPrimAxleFilCpl "complement of filtered desired torque on axle level" ULONG OneToOne 1 100 0.00 4294967295.00 FORMAT "%13.2" ECU_ADDRESS 0x6002BC14
 /begin IF_DATA XCPplus 0x0102
  /begin DAQ_EVENT VARIABLE /end DAQ_EVENT
 /end IF_DATA
/end MEASUREMENT
/begin MEASUREMENT MoFTqPtdAxle_tqDesPrimAxleNotFil "Torque desire befor Filter, Axle Level" SLONG TrqPrpHigh 1 100 -214748364.800 214748364.700 FORMAT "%13.3" ECU_ADDRESS 0x6002C640
 /begin IF_DATA XCPplus 0x0102
  /begin DAQ_EVENT VARIABLE /end DAQ_EVENT
 /end IF_DATA
/end MEASUREMENT
/begin MEASUREMENT MoFTqPtdAxle_tqDesPrimAxleNotFilCpl "Complement variable for MoFTqPtdAxle_tqDesPrimAxleNotFil" ULONG OneToOne 1 100 0.00 4294967295.00 FORMAT "%13.2" ECU_ADDRESS 0x6002BC24
 /begin IF_DATA XCPplus 0x0102
  /begin DAQ_EVENT VARIABLE /end DAQ_EVENT
 /end IF_DATA
/end MEASUREMENT
/begin MEASUREMENT MoFTqPtdAxle_tqDesSecAxleNotFil "Torque desire befor Filter, Axle Level" SLONG TrqPrpHigh 1 100 -214748364.800 214748364.700 FORMAT "%13.3" ECU_ADDRESS 0x6002C63C
 /begin IF_DATA XCPplus 0x0102
  /begin DAQ_EVENT VARIABLE /end DAQ_EVENT
 /end IF_DATA
/end MEASUREMENT
/begin MEASUREMENT MoFTqPtdAxle_tqDesSecAxleNotFilCpl "Complement variable for MoFTqPtdAxle_tqDesPrimAxleNotFil" ULONG OneToOne 1 100 0.00 4294967295.00 FORMAT "%13.2" ECU_ADDRESS 0x6002BC20
 /begin IF_DATA XCPplus 0x0102
  /begin DAQ_EVENT VARIABLE /end DAQ_EVENT
 /end IF_DATA
/end MEASUREMENT
/begin MEASUREMENT MoFTqPtdAxle_tqDifAxle "Difference between desired and permitted torque" SLONG TrqPrpHigh 1 100 -214748364.800 214748364.700 FORMAT "%13.3" ECU_ADDRESS 0x6002C6AC
 /begin IF_DATA XCPplus 0x0102
  /begin DAQ_EVENT VARIABLE /end DAQ_EVENT
 /end IF_DATA
/end MEASUREMENT
/begin MEASUREMENT MoFTqPtdAxle_tqDifAxleCpl "RAM data redundancy for MoFTqPtdAxle_tqDifAxle" ULONG OneToOne 1 100 0.00 4294967295.00 FORMAT "%13.2" ECU_ADDRESS 0x6002BC8C
 /begin IF_DATA XCPplus 0x0102
  /begin DAQ_EVENT VARIABLE /end DAQ_EVENT
 /end IF_DATA
/end MEASUREMENT
/begin MEASUREMENT MoFTqPtdAxle_tqLowrLim "Lower limit of permitted torque on axle level in function monitoring" SLONG TrqPrpHigh 1 100 -214748364.800 214748364.700 FORMAT "%13.3" ECU_ADDRESS 0x6002C6A8
 /begin IF_DATA XCPplus 0x0102
  /begin DAQ_EVENT VARIABLE /end DAQ_EVENT
 /end IF_DATA
/end MEASUREMENT
/begin MEASUREMENT MoFTqPtdAxle_tqLowrLimCpl "RAM data redundancy for MoFTqPtdAxle_tqLowrLim" ULONG OneToOne 1 100 0.00 4294967295.00 FORMAT "%13.2" ECU_ADDRESS 0x6002BC88
 /begin IF_DATA XCPplus 0x0102
  /begin DAQ_EVENT VARIABLE /end DAQ_EVENT
 /end IF_DATA
/end MEASUREMENT
/begin MEASUREMENT MoFTqPtdAxle_tqPrimAxleCoord "Coordinated desired torque on axle level in function monitoring" SLONG TrqPrpHigh 1 100 -214748364.800 214748364.700 FORMAT "%13.3" ECU_ADDRESS 0x6002C648
 /begin IF_DATA XCPplus 0x0102
  /begin DAQ_EVENT VARIABLE /end DAQ_EVENT
 /end IF_DATA
/end MEASUREMENT
/begin MEASUREMENT MoFTqPtdAxle_tqPrimAxleCoordCpl "Complement of coordinated desired torque on axle level in function monitoring" ULONG OneToOne 1 100 0.00 4294967295.00 FORMAT "%13.2" ECU_ADDRESS 0x6002BC4C
 /begin IF_DATA XCPplus 0x0102
  /begin DAQ_EVENT VARIABLE /end DAQ_EVENT
 /end IF_DATA
/end MEASUREMENT
/begin MEASUREMENT MoFTqPtdAxle_tqPrimAxleCoordLoResl "Coordinated desired torque on axle level in low resolution in function monitoring" SWORD TrqPrp 1 100 -52428.80 52427.20 FORMAT "%8.2" ECU_ADDRESS 0x6002C69A
 /begin IF_DATA XCPplus 0x0102
  /begin DAQ_EVENT VARIABLE /end DAQ_EVENT
 /end IF_DATA
/end MEASUREMENT
/begin MEASUREMENT MoFTqPtdAxle_tqPrimAxleCoordLoReslCpl "Complement of coordinated desired torque on axle level in low resolution in function monitoring" UWORD OneToOne 1 100 0.00 65535.00 FORMAT "%8.2" ECU_ADDRESS 0x6002BC7E
 /begin IF_DATA XCPplus 0x0102
  /begin DAQ_EVENT VARIABLE /end DAQ_EVENT
 /end IF_DATA
/end MEASUREMENT
/begin MEASUREMENT MoFTqPtdAxle_tqPrimAxleGearNeutRampLimd "Limited ramp torque for primary axle netutral gear" SLONG TrqPrpHigh 1 100 -214748364.800 214748364.700 FORMAT "%13.3" ECU_ADDRESS 0x6002C66C
 /begin IF_DATA XCPplus 0x0102
  /begin DAQ_EVENT VARIABLE /end DAQ_EVENT
 /end IF_DATA
/end MEASUREMENT
/begin MEASUREMENT MoFTqPtdAxle_tqPrimAxleGearNeutRampLimdCpl "Complement of limited ramp torque for primary axle netutral gear" ULONG OneToOne 1 100 0.00 4294967295.00 FORMAT "%13.2" ECU_ADDRESS 0x6002BC48
 /begin IF_DATA XCPplus 0x0102
  /begin DAQ_EVENT VARIABLE /end DAQ_EVENT
 /end IF_DATA
/end MEASUREMENT
/begin MEASUREMENT MoFTqPtdAxle_tqPrimAxleGearNeutRampOutLimd "Limited ramp torque for secondary axle netutral gear" SLONG TrqPrpHigh 1 100 -214748364.800 214748364.700 FORMAT "%13.3" ECU_ADDRESS 0x6002C668
 /begin IF_DATA XCPplus 0x0102
  /begin DAQ_EVENT VARIABLE /end DAQ_EVENT
 /end IF_DATA
/end MEASUREMENT
/begin MEASUREMENT MoFTqPtdAxle_tqPrimAxleGearNeutRampOutLimdCpl "Complement of limited ramp torque for secondary axle netutral gear" ULONG OneToOne 1 100 0.00 4294967295.00 FORMAT "%13.2" ECU_ADDRESS 0x6002BC44
 /begin IF_DATA XCPplus 0x0102
  /begin DAQ_EVENT VARIABLE /end DAQ_EVENT
 /end IF_DATA
/end MEASUREMENT
/begin MEASUREMENT MoFTqPtdAxle_tqPrimBrkgToZr "Breaking to zero torque for primary axle" SLONG TrqPrpHigh 1 100 -214748364.800 214748364.700 FORMAT "%13.3" ECU_ADDRESS 0x6002C664
 /begin IF_DATA XCPplus 0x0102
  /begin DAQ_EVENT VARIABLE /end DAQ_EVENT
 /end IF_DATA
/end MEASUREMENT
/begin MEASUREMENT MoFTqPtdAxle_tqPrimBrkgToZrCpl "Complement of breaking to zero torque for primary axle" ULONG OneToOne 1 100 0.00 4294967295.00 FORMAT "%13.2" ECU_ADDRESS 0x6002BC40
 /begin IF_DATA XCPplus 0x0102
  /begin DAQ_EVENT VARIABLE /end DAQ_EVENT
 /end IF_DATA
/end MEASUREMENT
/begin MEASUREMENT MoFTqPtdAxle_tqRecupPrimAxleLimd "Limited recuperation torque for primary axle" SLONG TrqPrpHigh 1 100 -214748364.800 214748364.700 FORMAT "%13.3" ECU_ADDRESS 0x6002C660
 /begin IF_DATA XCPplus 0x0102
  /begin DAQ_EVENT VARIABLE /end DAQ_EVENT
 /end IF_DATA
/end MEASUREMENT
/begin MEASUREMENT MoFTqPtdAxle_tqRecupPrimAxleLimdCpl "Complement of limited recuperation torque for primary axle" ULONG OneToOne 1 100 0.00 4294967295.00 FORMAT "%13.2" ECU_ADDRESS 0x6002BC3C
 /begin IF_DATA XCPplus 0x0102
  /begin DAQ_EVENT VARIABLE /end DAQ_EVENT
 /end IF_DATA
/end MEASUREMENT
/begin MEASUREMENT MoFTqPtdAxle_tqRecupSecAxleLimd "Limited recuperation torque for secondary axle" SLONG TrqPrpHigh 1 100 -214748364.800 214748364.700 FORMAT "%13.3" ECU_ADDRESS 0x6002C65C
 /begin IF_DATA XCPplus 0x0102
  /begin DAQ_EVENT VARIABLE /end DAQ_EVENT
 /end IF_DATA
/end MEASUREMENT
/begin MEASUREMENT MoFTqPtdAxle_tqRecupSecAxleLimdCpl "Complement of limited recuperation torque for secondary axle" ULONG OneToOne 1 100 0.00 4294967295.00 FORMAT "%13.2" ECU_ADDRESS 0x6002BC38
 /begin IF_DATA XCPplus 0x0102
  /begin DAQ_EVENT VARIABLE /end DAQ_EVENT
 /end IF_DATA
/end MEASUREMENT
/begin MEASUREMENT MoFTqPtdAxle_tqSecAxleGearNeutRampLimd "Limited gear neutral ramp torque for secondary axle" SLONG TrqPrpHigh 1 100 -214748364.800 214748364.700 FORMAT "%13.3" ECU_ADDRESS 0x6002C658
 /begin IF_DATA XCPplus 0x0102
  /begin DAQ_EVENT VARIABLE /end DAQ_EVENT
 /end IF_DATA
/end MEASUREMENT
/begin MEASUREMENT MoFTqPtdAxle_tqSecAxleGearNeutRampLimdCpl "Complement of limited gear neutral ramp torque for secondary axle" ULONG OneToOne 1 100 0.00 4294967295.00 FORMAT "%13.2" ECU_ADDRESS 0x6002BC34
 /begin IF_DATA XCPplus 0x0102
  /begin DAQ_EVENT VARIABLE /end DAQ_EVENT
 /end IF_DATA
/end MEASUREMENT
/begin MEASUREMENT MoFTqPtdAxle_tqSecAxleGearNeutRampOutLimd "Ramp output for secondary axle neutral gear" SLONG TrqPrpHigh 1 100 -214748364.800 214748364.700 FORMAT "%13.3" ECU_ADDRESS 0x6002C654
 /begin IF_DATA XCPplus 0x0102
  /begin DAQ_EVENT VARIABLE /end DAQ_EVENT
 /end IF_DATA
/end MEASUREMENT
/begin MEASUREMENT MoFTqPtdAxle_tqSecAxleGearNeutRampOutLimdCpl "Complement of ramp output for secondary axle neutral gear" ULONG OneToOne 1 100 0.00 4294967295.00 FORMAT "%13.2" ECU_ADDRESS 0x6002BC30
 /begin IF_DATA XCPplus 0x0102
  /begin DAQ_EVENT VARIABLE /end DAQ_EVENT
 /end IF_DATA
/end MEASUREMENT
/begin MEASUREMENT MoFTqPtdAxle_tqTiInteg "Integral value of torque comparison on axle level" SLONG mdt_q0p001_Nm_s 1 100 -2147483.64800 2147483.64700 FORMAT "%13.5" ECU_ADDRESS 0x6002C6A4
 /begin IF_DATA XCPplus 0x0102
  /begin DAQ_EVENT VARIABLE /end DAQ_EVENT
 /end IF_DATA
/end MEASUREMENT
/begin MEASUREMENT MoFTqPtdAxle_tqTiIntegCpl "RAM data redundancy for MoFTqPtdAxle_tqTiInteg" ULONG OneToOne 1 100 0.00 4294967295.00 FORMAT "%13.2" ECU_ADDRESS 0x6002BC84
 /begin IF_DATA XCPplus 0x0102
  /begin DAQ_EVENT VARIABLE /end DAQ_EVENT
 /end IF_DATA
/end MEASUREMENT
/begin MEASUREMENT MoFTqPtdAxle_tqUpLim "Upper limit of permitted torque on axle level in function monitoring" SLONG TrqPrpHigh 1 100 -214748364.800 214748364.700 FORMAT "%13.3" ECU_ADDRESS 0x6002C6A0
 /begin IF_DATA XCPplus 0x0102
  /begin DAQ_EVENT VARIABLE /end DAQ_EVENT
 /end IF_DATA
/end MEASUREMENT
/begin MEASUREMENT MoFTqPtdAxle_tqUpLimCpl "RAM data redundancy for MoFTqPtdAxle_tqUpLim" ULONG OneToOne 1 100 0.00 4294967295.00 FORMAT "%13.2" ECU_ADDRESS 0x6002BC80
 /begin IF_DATA XCPplus 0x0102
  /begin DAQ_EVENT VARIABLE /end DAQ_EVENT
 /end IF_DATA
/end MEASUREMENT
/begin MEASUREMENT MoFTqPtdAxle_tqVcuIntRecup "VCU internal recuperation torque" SLONG TrqPrpHigh 1 100 -214748364.800 214748364.700 FORMAT "%13.3" ECU_ADDRESS 0x6002C650
 /begin IF_DATA XCPplus 0x0102
  /begin DAQ_EVENT VARIABLE /end DAQ_EVENT
 /end IF_DATA
/end MEASUREMENT
/begin MEASUREMENT MoFTqPtdAxle_tqVcuIntRecupCpl "Complement of VCU internal recuperation torque" ULONG OneToOne 1 100 0.00 4294967295.00 FORMAT "%13.2" ECU_ADDRESS 0x6002BC2C
 /begin IF_DATA XCPplus 0x0102
  /begin DAQ_EVENT VARIABLE /end DAQ_EVENT
 /end IF_DATA
/end MEASUREMENT
/begin MEASUREMENT MoFTqPtdAxle_tqWhlDesLoResl "Desired low resolution torque on vehicle level" SWORD TrqPrp 1 100 -52428.80 52427.20 FORMAT "%8.2" ECU_ADDRESS 0x6002C636
 /begin IF_DATA XCPplus 0x0102
  /begin DAQ_EVENT VARIABLE /end DAQ_EVENT
 /end IF_DATA
/end MEASUREMENT
/begin MEASUREMENT MoFTqPtdAxle_tqWhlDesLoReslCpl "Complement of desired low resolution torque on vehicle level" UWORD OneToOne 1 100 0.00 65535.00 FORMAT "%8.2" ECU_ADDRESS 0x6002BC18
 /begin IF_DATA XCPplus 0x0102
  /begin DAQ_EVENT VARIABLE /end DAQ_EVENT
 /end IF_DATA
/end MEASUREMENT
/begin MEASUREMENT MoFTqPtdEmComp_bbLoc1Cpl "RAM data redundancy for MoFTqPtdEmComp_bbLoc1" UBYTE OneToOne 1 100 0.00 255.0 FORMAT "%5.1" ECU_ADDRESS 0x6002BBE6
 /begin IF_DATA XCPplus 0x0102
  /begin DAQ_EVENT VARIABLE /end DAQ_EVENT
 /end IF_DATA
/end MEASUREMENT
/begin MEASUREMENT MoFTqPtdEmComp_bbLoc2Cpl "RAM data redundancy for MoFTqPtdEmComp_bbLoc2" UBYTE OneToOne 1 100 0.00 255.0 FORMAT "%5.1" ECU_ADDRESS 0x6002BBE5
 /begin IF_DATA XCPplus 0x0102
  /begin DAQ_EVENT VARIABLE /end DAQ_EVENT
 /end IF_DATA
/end MEASUREMENT
/begin MEASUREMENT MoFTqPtdEmComp_bbLoc3Cpl "RAM data redundancy for MoFTqPtdEmComp_bbLoc3" UBYTE OneToOne 1 100 0.00 255.0 FORMAT "%5.1" ECU_ADDRESS 0x6002BBE4
 /begin IF_DATA XCPplus 0x0102
  /begin DAQ_EVENT VARIABLE /end DAQ_EVENT
 /end IF_DATA
/end MEASUREMENT
/begin MEASUREMENT MoFTqPtdEmCoorn_bbLoc1Cpl "RAM data redundancy for MoFTqPtdEmCoorn_bbLoc1" UBYTE OneToOne 1 100 0.00 255.0 FORMAT "%5.1" ECU_ADDRESS 0x6002BBC4
 /begin IF_DATA XCPplus 0x0102
  /begin DAQ_EVENT VARIABLE /end DAQ_EVENT
 /end IF_DATA
/end MEASUREMENT
/begin MEASUREMENT MoFTqPtdEmSecComp_bbLoc1Cpl "Complement of MoFTqPtdEmSecComp_bbLoc1" UBYTE OneToOne 1 100 0.00 255.0 FORMAT "%5.1" ECU_ADDRESS 0x6002BC10
 /begin IF_DATA XCPplus 0x0102
  /begin DAQ_EVENT VARIABLE /end DAQ_EVENT
 /end IF_DATA
/end MEASUREMENT
/begin MEASUREMENT MoFTqPtdEmSecComp_bbLoc2Cpl "Complement of MoFTqPtdEmSecComp_bbLoc2" UBYTE OneToOne 1 100 0.00 255.0 FORMAT "%5.1" ECU_ADDRESS 0x6002BC0F
 /begin IF_DATA XCPplus 0x0102
  /begin DAQ_EVENT VARIABLE /end DAQ_EVENT
 /end IF_DATA
/end MEASUREMENT
/begin MEASUREMENT MoFTqPtdEmSecTran_bbOutCpl "RAM data redundancy for MoFTqPtdEmSecTran_bbOut" UBYTE OneToOne 1 100 0.00 255.0 FORMAT "%5.1" ECU_ADDRESS 0x6002BBEF
 /begin IF_DATA XCPplus 0x0102
  /begin DAQ_EVENT VARIABLE /end DAQ_EVENT
 /end IF_DATA
/end MEASUREMENT
/begin MEASUREMENT MoFTqPtdEmSec_cntrErrTqSign "Debounce counter for sign check error on secondary e-machine level" UBYTE OneToOne 1 100 0.00 255.0 FORMAT "%5.1" ECU_ADDRESS 0x6002C62A
 /begin IF_DATA XCPplus 0x0102
  /begin DAQ_EVENT VARIABLE /end DAQ_EVENT
 /end IF_DATA
/end MEASUREMENT
/begin MEASUREMENT MoFTqPtdEmSec_cntrErrTqSignCpl "Complement of MoFTqPtdEmSec_cntrErrTqSign" UBYTE OneToOne 1 100 0.00 255.0 FORMAT "%5.1" ECU_ADDRESS 0x6002BC0E
 /begin IF_DATA XCPplus 0x0102
  /begin DAQ_EVENT VARIABLE /end DAQ_EVENT
 /end IF_DATA
/end MEASUREMENT
/begin MEASUREMENT MoFTqPtdEmSec_cntrPtRelsErr "Error counter for powertrain release violation" UBYTE OneToOne 1 100 0.00 255.0 FORMAT "%5.1" ECU_ADDRESS 0x6002C629
 /begin IF_DATA XCPplus 0x0102
  /begin DAQ_EVENT VARIABLE /end DAQ_EVENT
 /end IF_DATA
/end MEASUREMENT
/begin MEASUREMENT MoFTqPtdEmSec_cntrPtRelsErrCpl "Complement of MoFTqPtdEmSec_cntrPtRelsErr" UBYTE OneToOne 1 100 0.00 255.0 FORMAT "%5.1" ECU_ADDRESS 0x6002BC0D
 /begin IF_DATA XCPplus 0x0102
  /begin DAQ_EVENT VARIABLE /end DAQ_EVENT
 /end IF_DATA
/end MEASUREMENT
/begin MEASUREMENT MoFTqPtdEmSec_cntrTestPtRels "Diagnosis test counter to heal DFC_MoFTqPtdEmPtRelsSec" UBYTE OneToOne 1 100 0.00 255.0 FORMAT "%5.1" ECU_ADDRESS 0x600230F6
 /begin IF_DATA XCPplus 0x0102
  /begin DAQ_EVENT VARIABLE /end DAQ_EVENT
 /end IF_DATA
/end MEASUREMENT
/begin MEASUREMENT MoFTqPtdEmSec_cntrTestSign "Diagnosis test counter to heal DFC_MoFTqPtdEmSignSec" UBYTE OneToOne 1 100 0.00 255.0 FORMAT "%5.1" ECU_ADDRESS 0x600230F5
 /begin IF_DATA XCPplus 0x0102
  /begin DAQ_EVENT VARIABLE /end DAQ_EVENT
 /end IF_DATA
/end MEASUREMENT
/begin MEASUREMENT MoFTqPtdEmSec_cntrTestTq "Diagnosis test counter to heal DFC_MoFTqPtdEmSignSec" UBYTE OneToOne 1 100 0.00 255.0 FORMAT "%5.1" ECU_ADDRESS 0x600230F4
 /begin IF_DATA XCPplus 0x0102
  /begin DAQ_EVENT VARIABLE /end DAQ_EVENT
 /end IF_DATA
/end MEASUREMENT
/begin MEASUREMENT MoFTqPtdEmSec_cntrTqComp "Debounce counter for torque comparison error on secondary e-machine level" UBYTE OneToOne 1 100 0.00 255.0 FORMAT "%5.1" ECU_ADDRESS 0x6002C628
 /begin IF_DATA XCPplus 0x0102
  /begin DAQ_EVENT VARIABLE /end DAQ_EVENT
 /end IF_DATA
/end MEASUREMENT
/begin MEASUREMENT MoFTqPtdEmSec_cntrTqCompCpl "Complement of MoFTqPtdEmSec_cntrTqComp" UBYTE OneToOne 1 100 0.00 255.0 FORMAT "%5.1" ECU_ADDRESS 0x6002BC0C
 /begin IF_DATA XCPplus 0x0102
  /begin DAQ_EVENT VARIABLE /end DAQ_EVENT
 /end IF_DATA
/end MEASUREMENT
/begin MEASUREMENT MoFTqPtdEmSec_cntrWrgGearSeld "Debounce counter for wrong gear selection in Power train release on secondary e-machine level active" UBYTE OneToOne 1 100 0.00 255.0 FORMAT "%5.1" ECU_ADDRESS 0x6002C627
 /begin IF_DATA XCPplus 0x0102
  /begin DAQ_EVENT VARIABLE /end DAQ_EVENT
 /end IF_DATA
/end MEASUREMENT
/begin MEASUREMENT MoFTqPtdEmSec_cntrWrgGearSeldCpl "Complement of MoFTqPtdEmSec_cntrWrgGearSeld" UBYTE OneToOne 1 100 0.00 255.0 FORMAT "%5.1" ECU_ADDRESS 0x6002BC0B
 /begin IF_DATA XCPplus 0x0102
  /begin DAQ_EVENT VARIABLE /end DAQ_EVENT
 /end IF_DATA
/end MEASUREMENT
/begin MEASUREMENT MoFTqPtdEmSec_flgClrPtRels "condition flag to reset DFC_MoFTqPtdEmPtRelsSec." UBYTE B_TRUE 1 100 0.00 1.00000000000 BIT_MASK 0x1 FORMAT "%13.11" ECU_ADDRESS 0x7000011D
 /begin IF_DATA XCPplus 0x0102
  /begin DAQ_EVENT VARIABLE /end DAQ_EVENT
 /end IF_DATA
/end MEASUREMENT
/begin MEASUREMENT MoFTqPtdEmSec_flgClrSign "Condition clear FCM for DFC_MoFTqPtdEmSignSec in function monitoring" UBYTE B_TRUE 1 100 0.00 1.00000000000 BIT_MASK 0x1 FORMAT "%13.11" ECU_ADDRESS 0x7000011C
 /begin IF_DATA XCPplus 0x0102
  /begin DAQ_EVENT VARIABLE /end DAQ_EVENT
 /end IF_DATA
/end MEASUREMENT
/begin MEASUREMENT MoFTqPtdEmSec_flgClrTq "Condition clear FCM for DFC_MoFTqPtdEmTqSec in function monitoring" UBYTE B_TRUE 1 100 0.00 1.00000000000 BIT_MASK 0x1 FORMAT "%13.11" ECU_ADDRESS 0x7000011B
 /begin IF_DATA XCPplus 0x0102
  /begin DAQ_EVENT VARIABLE /end DAQ_EVENT
 /end IF_DATA
/end MEASUREMENT
/begin MEASUREMENT MoFTqPtdEmSec_flgEm02Qdr1Lock "EM02 Quadrant 1 locked" UBYTE B_TRUE 1 100 0.00 1.00000000000 BIT_MASK 0x1 FORMAT "%13.11" ECU_ADDRESS 0x6002C60B
 /begin IF_DATA XCPplus 0x0102
  /begin DAQ_EVENT VARIABLE /end DAQ_EVENT
 /end IF_DATA
/end MEASUREMENT
/begin MEASUREMENT MoFTqPtdEmSec_flgEm02Qdr3Lock "EM02 Quadrant 3 locked" UBYTE B_TRUE 1 100 0.00 1.00000000000 BIT_MASK 0x2 FORMAT "%13.11" ECU_ADDRESS 0x6002C60B
 /begin IF_DATA XCPplus 0x0102
  /begin DAQ_EVENT VARIABLE /end DAQ_EVENT
 /end IF_DATA
/end MEASUREMENT
/begin MEASUREMENT MoFTqPtdEmSec_flgIrrvPtRelsErrMsg "level 1 torque demand but no level 2 drivetrain release (irreversible)" UBYTE B_TRUE 1 100 0.00 1.00000000000 BIT_MASK 0x1 FORMAT "%13.11" ECU_ADDRESS 0x70000233
 /begin IF_DATA XCPplus 0x0102
  /begin DAQ_EVENT VARIABLE /end DAQ_EVENT
 /end IF_DATA
/end MEASUREMENT
/begin MEASUREMENT MoFTqPtdEmSec_flgIrrvSignErrMsg "Irreversible error status for sign check error on secondary e-machine level DFC_MoFTqPtdEmSignSec" UBYTE B_TRUE 1 100 0.00 1.00000000000 BIT_MASK 0x1 FORMAT "%13.11" ECU_ADDRESS 0x70000232
 /begin IF_DATA XCPplus 0x0102
  /begin DAQ_EVENT VARIABLE /end DAQ_EVENT
 /end IF_DATA
/end MEASUREMENT
/begin MEASUREMENT MoFTqPtdEmSec_flgIrrvTqErrMsg "Irreversible error status for torque error on secondary e-machine level DFC_MoFTqPtdEmTqSec" UBYTE B_TRUE 1 100 0.00 1.00000000000 BIT_MASK 0x1 FORMAT "%13.11" ECU_ADDRESS 0x70000231
 /begin IF_DATA XCPplus 0x0102
  /begin DAQ_EVENT VARIABLE /end DAQ_EVENT
 /end IF_DATA
/end MEASUREMENT
/begin MEASUREMENT MoFTqPtdEmSec_flgLwrLimExcd "'Error flag: Undercut of permitted lower torque limit" UBYTE B_TRUE 1 100 0.00 1.00000000000 BIT_MASK 0x1 FORMAT "%13.11" ECU_ADDRESS 0x6002C62C
 /begin IF_DATA XCPplus 0x0102
  /begin DAQ_EVENT VARIABLE /end DAQ_EVENT
 /end IF_DATA
/end MEASUREMENT
/begin MEASUREMENT MoFTqPtdEmSec_flgOthTrqCompErr "Error flag for torque comparison errors of vehicle and axle level which considered at secondary e-machine level" UBYTE B_TRUE 1 100 0.00 1.00000000000 BIT_MASK 0x40 FORMAT "%13.11" ECU_ADDRESS 0x6002C62B
 /begin IF_DATA XCPplus 0x0102
  /begin DAQ_EVENT VARIABLE /end DAQ_EVENT
 /end IF_DATA
/end MEASUREMENT
/begin MEASUREMENT MoFTqPtdEmSec_flgPtActvErr "Error flag for PT active error on secondary e-machine level" UBYTE B_TRUE 1 100 0.00 1.00000000000 BIT_MASK 0x20 FORMAT "%13.11" ECU_ADDRESS 0x6002C62B
 /begin IF_DATA XCPplus 0x0102
  /begin DAQ_EVENT VARIABLE /end DAQ_EVENT
 /end IF_DATA
/end MEASUREMENT
/begin MEASUREMENT MoFTqPtdEmSec_flgQdrMapDeb "State: error debouncing in sign check on secondary e-machine level active" UBYTE B_TRUE 1 100 0.00 1.00000000000 BIT_MASK 0x1 FORMAT "%13.11" ECU_ADDRESS 0x6002C62B
 /begin IF_DATA XCPplus 0x0102
  /begin DAQ_EVENT VARIABLE /end DAQ_EVENT
 /end IF_DATA
/end MEASUREMENT
/begin MEASUREMENT MoFTqPtdEmSec_flgQdrMapErr "Error flag: Error in sign check on secondary e-machine level" UBYTE B_TRUE 1 100 0.00 1.00000000000 BIT_MASK 0x2 FORMAT "%13.11" ECU_ADDRESS 0x6002C62B
 /begin IF_DATA XCPplus 0x0102
  /begin DAQ_EVENT VARIABLE /end DAQ_EVENT
 /end IF_DATA
/end MEASUREMENT
/begin MEASUREMENT MoFTqPtdEmSec_flgTestMsg "Bit test conditions for diagnosis of fault paths DFC_MoFTqPtdEmTqSec and DFC_MoFTqPtdEmSignSec" UBYTE B_TRUE 1 100 0.00 1.00000000000 BIT_MASK 0x1 FORMAT "%13.11" ECU_ADDRESS 0x70000230
 /begin IF_DATA XCPplus 0x0102
  /begin DAQ_EVENT VARIABLE /end DAQ_EVENT
 /end IF_DATA
/end MEASUREMENT
/begin MEASUREMENT MoFTqPtdEmSec_flgTqCompDeb "State: error debouncing in torque comparison on secondary e-machine level active" UBYTE B_TRUE 1 100 0.00 1.00000000000 BIT_MASK 0x4 FORMAT "%13.11" ECU_ADDRESS 0x6002C62C
 /begin IF_DATA XCPplus 0x0102
  /begin DAQ_EVENT VARIABLE /end DAQ_EVENT
 /end IF_DATA
/end MEASUREMENT
/begin MEASUREMENT MoFTqPtdEmSec_flgTqCompErr "Error flag: Error in torque comparison on secondary e-machine level" UBYTE B_TRUE 1 100 0.00 1.00000000000 BIT_MASK 0x8 FORMAT "%13.11" ECU_ADDRESS 0x6002C62C
 /begin IF_DATA XCPplus 0x0102
  /begin DAQ_EVENT VARIABLE /end DAQ_EVENT
 /end IF_DATA
/end MEASUREMENT
/begin MEASUREMENT MoFTqPtdEmSec_flgTqIntegDeb "State: error debouncing in torque integral check on secondary e-machine level active" UBYTE B_TRUE 1 100 0.00 1.00000000000 BIT_MASK 0x10 FORMAT "%13.11" ECU_ADDRESS 0x6002C62C
 /begin IF_DATA XCPplus 0x0102
  /begin DAQ_EVENT VARIABLE /end DAQ_EVENT
 /end IF_DATA
/end MEASUREMENT
/begin MEASUREMENT MoFTqPtdEmSec_flgTqIntegErr "State: error debouncing in torque integral check on secondary e-machine level active" UBYTE B_TRUE 1 100 0.00 1.00000000000 BIT_MASK 0x20 FORMAT "%13.11" ECU_ADDRESS 0x6002C62C
 /begin IF_DATA XCPplus 0x0102
  /begin DAQ_EVENT VARIABLE /end DAQ_EVENT
 /end IF_DATA
/end MEASUREMENT
/begin MEASUREMENT MoFTqPtdEmSec_flgTqLimChkErr "Error flag: Exceedance of permitted torque limit on secondary e-machine level" UBYTE B_TRUE 1 100 0.00 1.00000000000 BIT_MASK 0x40 FORMAT "%13.11" ECU_ADDRESS 0x6002C62C
 /begin IF_DATA XCPplus 0x0102
  /begin DAQ_EVENT VARIABLE /end DAQ_EVENT
 /end IF_DATA
/end MEASUREMENT
/begin MEASUREMENT MoFTqPtdEmSec_flgTqTranEm02Neg "State: Desired torque on secondary e-machine level is negative" UBYTE B_TRUE 1 100 0.00 1.00000000000 BIT_MASK 0x2 FORMAT "%13.11" ECU_ADDRESS 0x6002C62C
 /begin IF_DATA XCPplus 0x0102
  /begin DAQ_EVENT VARIABLE /end DAQ_EVENT
 /end IF_DATA
/end MEASUREMENT
/begin MEASUREMENT MoFTqPtdEmSec_flgUpLimExcd "Error flag: Exceedance of permitted upper torque limit" UBYTE B_TRUE 1 100 0.00 1.00000000000 BIT_MASK 0x80 FORMAT "%13.11" ECU_ADDRESS 0x6002C62C
 /begin IF_DATA XCPplus 0x0102
  /begin DAQ_EVENT VARIABLE /end DAQ_EVENT
 /end IF_DATA
/end MEASUREMENT
/begin MEASUREMENT MoFTqPtdEmSec_flgWrgGearPtActv "flag to indicate wrong gear when powertrain is active" UBYTE B_TRUE 1 100 0.00 1.00000000000 BIT_MASK 0x80 FORMAT "%13.11" ECU_ADDRESS 0x6002C62B
 /begin IF_DATA XCPplus 0x0102
  /begin DAQ_EVENT VARIABLE /end DAQ_EVENT
 /end IF_DATA
/end MEASUREMENT
/begin MEASUREMENT MoFTqPtdEmSec_flgWrgGearSeld "Error flag : flag for wrong gear selection in power train release" UBYTE B_TRUE 1 100 0.00 1.00000000000 BIT_MASK 0x4 FORMAT "%13.11" ECU_ADDRESS 0x6002C62B
 /begin IF_DATA XCPplus 0x0102
  /begin DAQ_EVENT VARIABLE /end DAQ_EVENT
 /end IF_DATA
/end MEASUREMENT
/begin MEASUREMENT MoFTqPtdEmSec_flgWrgGearSeldDeb "State: error debouncing for wrong gear selection in PT release on secondary e-machine level active" UBYTE B_TRUE 1 100 0.00 1.00000000000 BIT_MASK 0x10 FORMAT "%13.11" ECU_ADDRESS 0x6002C62B
 /begin IF_DATA XCPplus 0x0102
  /begin DAQ_EVENT VARIABLE /end DAQ_EVENT
 /end IF_DATA
/end MEASUREMENT
/begin MEASUREMENT MoFTqPtdEmSec_flgWrgGearSeldErr "Flag: wrong gear selection error after debounce in Power train release on secondary e-machine level active" UBYTE B_TRUE 1 100 0.00 1.00000000000 BIT_MASK 0x8 FORMAT "%13.11" ECU_ADDRESS 0x6002C62B
 /begin IF_DATA XCPplus 0x0102
  /begin DAQ_EVENT VARIABLE /end DAQ_EVENT
 /end IF_DATA
/end MEASUREMENT
/begin MEASUREMENT MoFTqPtdEmSec_stErrPtRels "State of powertrain release violation" UBYTE OneToOne 1 100 0.00 255.0 FORMAT "%5.1" ECU_ADDRESS 0x6002C626
 /begin IF_DATA XCPplus 0x0102
  /begin DAQ_EVENT VARIABLE /end DAQ_EVENT
 /end IF_DATA
/end MEASUREMENT
/begin MEASUREMENT MoFTqPtdEmSec_stErrPtRelsCpl "Complement of MoFTqPtdEmSec_stErrPtRels" UBYTE OneToOne 1 100 0.00 255.0 FORMAT "%5.1" ECU_ADDRESS 0x6002BC0A
 /begin IF_DATA XCPplus 0x0102
  /begin DAQ_EVENT VARIABLE /end DAQ_EVENT
 /end IF_DATA
/end MEASUREMENT
/begin MEASUREMENT MoFTqPtdEmSec_stErrSignComp "Error state of sign check on secondary e-machine level" UBYTE OneToOne 1 100 0.00 255.0 FORMAT "%5.1" ECU_ADDRESS 0x6002C625
 /begin IF_DATA XCPplus 0x0102
  /begin DAQ_EVENT VARIABLE /end DAQ_EVENT
 /end IF_DATA
/end MEASUREMENT
/begin MEASUREMENT MoFTqPtdEmSec_stErrSignCompCpl "Complement of MoFTqPtdEmSec_stErrSignComp" UBYTE OneToOne 1 100 0.00 255.0 FORMAT "%5.1" ECU_ADDRESS 0x6002BC09
 /begin IF_DATA XCPplus 0x0102
  /begin DAQ_EVENT VARIABLE /end DAQ_EVENT
 /end IF_DATA
/end MEASUREMENT
/begin MEASUREMENT MoFTqPtdEmSec_stErrTqComp "Error state of torque comparison on secondary e-machine level" UBYTE OneToOne 1 100 0.00 255.0 FORMAT "%5.1" ECU_ADDRESS 0x6002C624
 /begin IF_DATA XCPplus 0x0102
  /begin DAQ_EVENT VARIABLE /end DAQ_EVENT
 /end IF_DATA
/end MEASUREMENT
/begin MEASUREMENT MoFTqPtdEmSec_stErrTqCompCpl "Complement of MoFTqPtdEmSec_stErrTqComp" UBYTE OneToOne 1 100 0.00 255.0 FORMAT "%5.1" ECU_ADDRESS 0x6002BC08
 /begin IF_DATA XCPplus 0x0102
  /begin DAQ_EVENT VARIABLE /end DAQ_EVENT
 /end IF_DATA
/end MEASUREMENT
/begin MEASUREMENT MoFTqPtdEmSec_stSignChgTranEm02 "State Sign Changed for EM02" UBYTE OneToOne 1 100 0.00 255.0 FORMAT "%5.1" ECU_ADDRESS 0x6002C60A
 /begin IF_DATA XCPplus 0x0102
  /begin DAQ_EVENT VARIABLE /end DAQ_EVENT
 /end IF_DATA
/end MEASUREMENT
/begin MEASUREMENT MoFTqPtdEmSec_stSignChgTranEm02Cpl "RAM data redundancy for MoFTqPtdEmSec_stSignChgTranEm02" UBYTE OneToOne 1 100 0.00 255.0 FORMAT "%5.1" ECU_ADDRESS 0x6002BBEE
 /begin IF_DATA XCPplus 0x0102
  /begin DAQ_EVENT VARIABLE /end DAQ_EVENT
 /end IF_DATA
/end MEASUREMENT
/begin MEASUREMENT MoFTqPtdEmSec_tqDesCoornEm02 "Desired torque for secondary axle E-Machine02" SWORD Trq 1 100 -3276.800 3276.700 FORMAT "%8.3" ECU_ADDRESS 0x6002C60E
 /begin IF_DATA XCPplus 0x0102
  /begin DAQ_EVENT VARIABLE /end DAQ_EVENT
 /end IF_DATA
/end MEASUREMENT
/begin MEASUREMENT MoFTqPtdEmSec_tqDesCoornEm02Cpl "RAM data redundancy for MoFTqPtdEmSec_tqDesCoornEm02" UWORD OneToOne 1 100 0.00 65535.00 FORMAT "%8.2" ECU_ADDRESS 0x6002BBF2
 /begin IF_DATA XCPplus 0x0102
  /begin DAQ_EVENT VARIABLE /end DAQ_EVENT
 /end IF_DATA
/end MEASUREMENT
/begin MEASUREMENT MoFTqPtdEmSec_tqDesEm02 "Desired Torque of Electric Machine 2" SWORD Trq 1 100 -3276.800 3276.700 FORMAT "%8.3" ECU_ADDRESS 0x6002C614
 /begin IF_DATA XCPplus 0x0102
  /begin DAQ_EVENT VARIABLE /end DAQ_EVENT
 /end IF_DATA
/end MEASUREMENT
/begin MEASUREMENT MoFTqPtdEmSec_tqDesEm02Cpl "Complement of MoFTqPtdEmSec_tqDesEm02" UWORD OneToOne 1 100 0.00 65535.00 FORMAT "%8.2" ECU_ADDRESS 0x6002BC02
 /begin IF_DATA XCPplus 0x0102
  /begin DAQ_EVENT VARIABLE /end DAQ_EVENT
 /end IF_DATA
/end MEASUREMENT
/begin MEASUREMENT MoFTqPtdEmSec_tqDesEm02PreVal "preliminary torque demand for e-machine 2" SWORD Trq 1 100 -3276.800 3276.700 FORMAT "%8.3" ECU_ADDRESS 0x6002C61E
 /begin IF_DATA XCPplus 0x0102
  /begin DAQ_EVENT VARIABLE /end DAQ_EVENT
 /end IF_DATA
/end MEASUREMENT
/begin MEASUREMENT MoFTqPtdEmSec_tqDesEm02PreValCpl "Complement of MoFTqPtdEmSec_tqDesEm02PreVal" UWORD OneToOne 1 100 0.00 65535.00 FORMAT "%8.2" ECU_ADDRESS 0x6002BC00
 /begin IF_DATA XCPplus 0x0102
  /begin DAQ_EVENT VARIABLE /end DAQ_EVENT
 /end IF_DATA
/end MEASUREMENT
/begin MEASUREMENT MoFTqPtdEmSec_tqDesEm02UpLimd "Desired torque secondary e-machine 1 limited upwards after final torque or sign error in function monitoring" SWORD Trq 1 100 -3276.800 3276.700 FORMAT "%8.3" ECU_ADDRESS 0x6002C61C
 /begin IF_DATA XCPplus 0x0102
  /begin DAQ_EVENT VARIABLE /end DAQ_EVENT
 /end IF_DATA
/end MEASUREMENT
/begin MEASUREMENT MoFTqPtdEmSec_tqDesEm02UpLimdCpl "Complement of MoFTqPtdEmSec_tqDesEm02UpLimd" UWORD OneToOne 1 100 0.00 65535.00 FORMAT "%8.2" ECU_ADDRESS 0x6002BBFE
 /begin IF_DATA XCPplus 0x0102
  /begin DAQ_EVENT VARIABLE /end DAQ_EVENT
 /end IF_DATA
/end MEASUREMENT
/begin MEASUREMENT MoFTqPtdEmSec_tqDesWhl02 "Desired wheel torque for EM02 in function monitoring" SLONG TrqPrpHigh 1 100 -214748364.800 214748364.700 FORMAT "%13.3" ECU_ADDRESS 0x6002C604
 /begin IF_DATA XCPplus 0x0102
  /begin DAQ_EVENT VARIABLE /end DAQ_EVENT
 /end IF_DATA
/end MEASUREMENT
/begin MEASUREMENT MoFTqPtdEmSec_tqDesWhl02Cpl "RAM data redundancy for MoFTqPtdEmSec_tqDesWhl02" ULONG OneToOne 1 100 0.00 4294967295.00 FORMAT "%13.2" ECU_ADDRESS 0x6002BBE8
 /begin IF_DATA XCPplus 0x0102
  /begin DAQ_EVENT VARIABLE /end DAQ_EVENT
 /end IF_DATA
/end MEASUREMENT
/begin MEASUREMENT MoFTqPtdEmSec_tqDesWithEscWhl02 "Desired torque with Esc intervention for secondary axle E-Machine02" SLONG TrqPrpHigh 1 100 -214748364.800 214748364.700 FORMAT "%13.3" ECU_ADDRESS 0x6002C610
 /begin IF_DATA XCPplus 0x0102
  /begin DAQ_EVENT VARIABLE /end DAQ_EVENT
 /end IF_DATA
/end MEASUREMENT
/begin MEASUREMENT MoFTqPtdEmSec_tqDesWithEscWhl02Cpl "RAM data redundancy for MoFTqPtdEmSec_tqDesWithEscWhl02" ULONG OneToOne 1 100 0.00 4294967295.00 FORMAT "%13.2" ECU_ADDRESS 0x6002BBF4
 /begin IF_DATA XCPplus 0x0102
  /begin DAQ_EVENT VARIABLE /end DAQ_EVENT
 /end IF_DATA
/end MEASUREMENT
/begin MEASUREMENT MoFTqPtdEmSec_tqDifEm "Difference between desired and permitted torque" SWORD Trq 1 100 -3276.800 3276.700 FORMAT "%8.3" ECU_ADDRESS 0x6002C61A
 /begin IF_DATA XCPplus 0x0102
  /begin DAQ_EVENT VARIABLE /end DAQ_EVENT
 /end IF_DATA
/end MEASUREMENT
/begin MEASUREMENT MoFTqPtdEmSec_tqDifEmCpl "Complement of MoFTqPtdEmSec_tqDifEm" UWORD OneToOne 1 100 0.00 65535.00 FORMAT "%8.2" ECU_ADDRESS 0x6002BBFC
 /begin IF_DATA XCPplus 0x0102
  /begin DAQ_EVENT VARIABLE /end DAQ_EVENT
 /end IF_DATA
/end MEASUREMENT
/begin MEASUREMENT MoFTqPtdEmSec_tqLoss "Secondary axle EM level torque losses in Function Monitoring" SWORD Trq 1 100 -3276.800 3276.700 FORMAT "%8.3" ECU_ADDRESS 0x6002C60C
 /begin IF_DATA XCPplus 0x0102
  /begin DAQ_EVENT VARIABLE /end DAQ_EVENT
 /end IF_DATA
/end MEASUREMENT
/begin MEASUREMENT MoFTqPtdEmSec_tqLossCpl "RAM data redundancy for MoFTqPtdEmSec_tqLoss" UWORD OneToOne 1 100 0.00 65535.00 FORMAT "%8.2" ECU_ADDRESS 0x6002BBF0
 /begin IF_DATA XCPplus 0x0102
  /begin DAQ_EVENT VARIABLE /end DAQ_EVENT
 /end IF_DATA
/end MEASUREMENT
/begin MEASUREMENT MoFTqPtdEmSec_tqLowrLim "Lower limit of permitted torque on secondary e-machine level in function monitoring" SWORD Trq 1 100 -3276.800 3276.700 FORMAT "%8.3" ECU_ADDRESS 0x6002C618
 /begin IF_DATA XCPplus 0x0102
  /begin DAQ_EVENT VARIABLE /end DAQ_EVENT
 /end IF_DATA
/end MEASUREMENT
/begin MEASUREMENT MoFTqPtdEmSec_tqLowrLimCpl "Complement of MoFTqPtdEmSec_tqLowrLim" UWORD OneToOne 1 100 0.00 65535.00 FORMAT "%8.2" ECU_ADDRESS 0x6002BBFA
 /begin IF_DATA XCPplus 0x0102
  /begin DAQ_EVENT VARIABLE /end DAQ_EVENT
 /end IF_DATA
/end MEASUREMENT
/begin MEASUREMENT MoFTqPtdEmSec_tqTiInteg "Integral value of torque comparison on secondary e-machine level" SLONG mdt_q0p001_Nm_s 1 100 -2147483.64800 2147483.64700 FORMAT "%13.5" ECU_ADDRESS 0x6002C620
 /begin IF_DATA XCPplus 0x0102
  /begin DAQ_EVENT VARIABLE /end DAQ_EVENT
 /end IF_DATA
/end MEASUREMENT
/begin MEASUREMENT MoFTqPtdEmSec_tqTiIntegCpl "Complement of MoFTqPtdEmSec_tqTiInteg" ULONG OneToOne 1 100 0.00 4294967295.00 FORMAT "%13.2" ECU_ADDRESS 0x6002BC04
 /begin IF_DATA XCPplus 0x0102
  /begin DAQ_EVENT VARIABLE /end DAQ_EVENT
 /end IF_DATA
/end MEASUREMENT
/begin MEASUREMENT MoFTqPtdEmSec_tqTranEm02 "Desire torque on EM-Level for EM02" SWORD Trq 1 100 -3276.800 3276.700 FORMAT "%8.3" ECU_ADDRESS 0x6002C608
 /begin IF_DATA XCPplus 0x0102
  /begin DAQ_EVENT VARIABLE /end DAQ_EVENT
 /end IF_DATA
/end MEASUREMENT
/begin MEASUREMENT MoFTqPtdEmSec_tqTranEm02Cpl "RAM data redundancy for MoFTqPtdEmSec_tqTranEm02" UWORD OneToOne 1 100 0.00 65535.00 FORMAT "%8.2" ECU_ADDRESS 0x6002BBEC
 /begin IF_DATA XCPplus 0x0102
  /begin DAQ_EVENT VARIABLE /end DAQ_EVENT
 /end IF_DATA
/end MEASUREMENT
/begin MEASUREMENT MoFTqPtdEmSec_tqUpLim "Upper limit of permitted torque on secondary e-machine level in function monitoring" SWORD Trq 1 100 -3276.800 3276.700 FORMAT "%8.3" ECU_ADDRESS 0x6002C616
 /begin IF_DATA XCPplus 0x0102
  /begin DAQ_EVENT VARIABLE /end DAQ_EVENT
 /end IF_DATA
/end MEASUREMENT
/begin MEASUREMENT MoFTqPtdEmSec_tqUpLimCpl "Complement of MoFTqPtdEmSec_tqUpLim" UWORD OneToOne 1 100 0.00 65535.00 FORMAT "%8.2" ECU_ADDRESS 0x6002BBF8
 /begin IF_DATA XCPplus 0x0102
  /begin DAQ_EVENT VARIABLE /end DAQ_EVENT
 /end IF_DATA
/end MEASUREMENT
/begin MEASUREMENT MoFTqPtdEmTran_bbOutCpl "RAM data redundancy for MoFTqPtdEmTran_bbOut" UBYTE OneToOne 1 100 0.00 255.0 FORMAT "%5.1" ECU_ADDRESS 0x6002BB99
 /begin IF_DATA XCPplus 0x0102
  /begin DAQ_EVENT VARIABLE /end DAQ_EVENT
 /end IF_DATA
/end MEASUREMENT
/begin MEASUREMENT MoFTqPtdEm_cntrErrTqSign "Debounce counter for sign check error on e-machine level" UBYTE OneToOne 1 100 0.00 255.0 FORMAT "%5.1" ECU_ADDRESS 0x6002C5FF
 /begin IF_DATA XCPplus 0x0102
  /begin DAQ_EVENT VARIABLE /end DAQ_EVENT
 /end IF_DATA
/end MEASUREMENT
/begin MEASUREMENT MoFTqPtdEm_cntrErrTqSignCpl "RAM data rendundancy for MoFTqPtdEm_cntrErrTqSign" UBYTE OneToOne 1 100 0.00 255.0 FORMAT "%5.1" ECU_ADDRESS 0x6002BBE3
 /begin IF_DATA XCPplus 0x0102
  /begin DAQ_EVENT VARIABLE /end DAQ_EVENT
 /end IF_DATA
/end MEASUREMENT
/begin MEASUREMENT MoFTqPtdEm_cntrPtRelsErr "Error counter for powertrain release violation" UBYTE OneToOne 1 100 0.00 255.0 FORMAT "%5.1" ECU_ADDRESS 0x6002C5FE
 /begin IF_DATA XCPplus 0x0102
  /begin DAQ_EVENT VARIABLE /end DAQ_EVENT
 /end IF_DATA
/end MEASUREMENT
/begin MEASUREMENT MoFTqPtdEm_cntrPtRelsErrCpl "Complement of Error counter for powertrain release violation" UBYTE OneToOne 1 100 0.00 255.0 FORMAT "%5.1" ECU_ADDRESS 0x6002BBE2
 /begin IF_DATA XCPplus 0x0102
  /begin DAQ_EVENT VARIABLE /end DAQ_EVENT
 /end IF_DATA
/end MEASUREMENT
/begin MEASUREMENT MoFTqPtdEm_cntrQdrLockToutErr "Counter for locked quadrant Timout error" UBYTE OneToOne 1 100 0.00 255.0 FORMAT "%5.1" ECU_ADDRESS 0x6002C5FD
 /begin IF_DATA XCPplus 0x0102
  /begin DAQ_EVENT VARIABLE /end DAQ_EVENT
 /end IF_DATA
/end MEASUREMENT
/begin MEASUREMENT MoFTqPtdEm_cntrQdrLockToutErrCpl "Complement of MoFTqPtdEm_cntrQdrLockToutErr" UBYTE OneToOne 1 100 0.00 255.0 FORMAT "%5.1" ECU_ADDRESS 0x6002BBE1
 /begin IF_DATA XCPplus 0x0102
  /begin DAQ_EVENT VARIABLE /end DAQ_EVENT
 /end IF_DATA
/end MEASUREMENT
/begin MEASUREMENT MoFTqPtdEm_cntrTestPtRels "Diagnosis test counter to heal DFC_MoFTqPtdEmPtRels." UBYTE OneToOne 1 100 0.00 255.0 FORMAT "%5.1" ECU_ADDRESS 0x600230F3
 /begin IF_DATA XCPplus 0x0102
  /begin DAQ_EVENT VARIABLE /end DAQ_EVENT
 /end IF_DATA
/end MEASUREMENT
/begin MEASUREMENT MoFTqPtdEm_cntrTestSign "Diagnosis test counter to heal DFC_MoFTqPtdEmSign" UBYTE OneToOne 1 100 0.00 255.0 FORMAT "%5.1" ECU_ADDRESS 0x600230F2
 /begin IF_DATA XCPplus 0x0102
  /begin DAQ_EVENT VARIABLE /end DAQ_EVENT
 /end IF_DATA
/end MEASUREMENT
/begin MEASUREMENT MoFTqPtdEm_cntrTestTq "Diagnosis test counter to heal DFC_MoFTqPtdEmTq" UBYTE OneToOne 1 100 0.00 255.0 FORMAT "%5.1" ECU_ADDRESS 0x600230F1
 /begin IF_DATA XCPplus 0x0102
  /begin DAQ_EVENT VARIABLE /end DAQ_EVENT
 /end IF_DATA
/end MEASUREMENT
/begin MEASUREMENT MoFTqPtdEm_cntrTmr1Elpd "Debounce counter for timer1 elapsed" UWORD OneToOne 1 100 0.00 65535.00 FORMAT "%8.2" ECU_ADDRESS 0x6002C5F2
 /begin IF_DATA XCPplus 0x0102
  /begin DAQ_EVENT VARIABLE /end DAQ_EVENT
 /end IF_DATA
/end MEASUREMENT
/begin MEASUREMENT MoFTqPtdEm_cntrTmr1ElpdCpl "Complement for debounce counter for timer1 elapsed" UWORD OneToOne 1 100 0.00 65535.00 FORMAT "%8.2" ECU_ADDRESS 0x6002BBD6
 /begin IF_DATA XCPplus 0x0102
  /begin DAQ_EVENT VARIABLE /end DAQ_EVENT
 /end IF_DATA
/end MEASUREMENT
/begin MEASUREMENT MoFTqPtdEm_cntrTmr2Elpd "Debounce counter for timer2 elapsed" UWORD OneToOne 1 100 0.00 65535.00 FORMAT "%8.2" ECU_ADDRESS 0x6002C5F0
 /begin IF_DATA XCPplus 0x0102
  /begin DAQ_EVENT VARIABLE /end DAQ_EVENT
 /end IF_DATA
/end MEASUREMENT
/begin MEASUREMENT MoFTqPtdEm_cntrTmr2ElpdCpl "Complement for debounce counter for timer2 elapsed" UWORD OneToOne 1 100 0.00 65535.00 FORMAT "%8.2" ECU_ADDRESS 0x6002BBD4
 /begin IF_DATA XCPplus 0x0102
  /begin DAQ_EVENT VARIABLE /end DAQ_EVENT
 /end IF_DATA
/end MEASUREMENT
/begin MEASUREMENT MoFTqPtdEm_cntrTmr3Elpd "Debounce counter for timer3 elapsed" UWORD OneToOne 1 100 0.00 65535.00 FORMAT "%8.2" ECU_ADDRESS 0x6002C5EE
 /begin IF_DATA XCPplus 0x0102
  /begin DAQ_EVENT VARIABLE /end DAQ_EVENT
 /end IF_DATA
/end MEASUREMENT
/begin MEASUREMENT MoFTqPtdEm_cntrTmr3ElpdCpl "Complement for debounce counter for timer3 elapsed" UWORD OneToOne 1 100 0.00 65535.00 FORMAT "%8.2" ECU_ADDRESS 0x6002BBD2
 /begin IF_DATA XCPplus 0x0102
  /begin DAQ_EVENT VARIABLE /end DAQ_EVENT
 /end IF_DATA
/end MEASUREMENT
/begin MEASUREMENT MoFTqPtdEm_cntrTqComp "Debounce counter for torque comparison error on e-machine level" UBYTE OneToOne 1 100 0.00 255.0 FORMAT "%5.1" ECU_ADDRESS 0x6002C5FC
 /begin IF_DATA XCPplus 0x0102
  /begin DAQ_EVENT VARIABLE /end DAQ_EVENT
 /end IF_DATA
/end MEASUREMENT
/begin MEASUREMENT MoFTqPtdEm_cntrTqCompCpl "RAM data redundancy for MoFTqPtdEm_cntrTqComp" UBYTE OneToOne 1 100 0.00 255.0 FORMAT "%5.1" ECU_ADDRESS 0x6002BBE0
 /begin IF_DATA XCPplus 0x0102
  /begin DAQ_EVENT VARIABLE /end DAQ_EVENT
 /end IF_DATA
/end MEASUREMENT
/begin MEASUREMENT MoFTqPtdEm_flgClrPtRels "condition flag to reset DFC_MoFTqPtdEmPtRels." UBYTE B_TRUE 1 100 0.00 1.00000000000 BIT_MASK 0x1 FORMAT "%13.11" ECU_ADDRESS 0x7000011A
 /begin IF_DATA XCPplus 0x0102
  /begin DAQ_EVENT VARIABLE /end DAQ_EVENT
 /end IF_DATA
/end MEASUREMENT
/begin MEASUREMENT MoFTqPtdEm_flgClrSign "Condition clear FCM for DFC_MoFTqPtdEmSign in function monitoring" UBYTE B_TRUE 1 100 0.00 1.00000000000 BIT_MASK 0x1 FORMAT "%13.11" ECU_ADDRESS 0x70000119
 /begin IF_DATA XCPplus 0x0102
  /begin DAQ_EVENT VARIABLE /end DAQ_EVENT
 /end IF_DATA
/end MEASUREMENT
/begin MEASUREMENT MoFTqPtdEm_flgClrTq "Condition clear FCM for DFC_MoFTqPtdEmTq in function monitoring" UBYTE B_TRUE 1 100 0.00 1.00000000000 BIT_MASK 0x1 FORMAT "%13.11" ECU_ADDRESS 0x70000118
 /begin IF_DATA XCPplus 0x0102
  /begin DAQ_EVENT VARIABLE /end DAQ_EVENT
 /end IF_DATA
/end MEASUREMENT
/begin MEASUREMENT MoFTqPtdEm_flgEm01Qdr1Lock "EM01 Quadrant 1 locked" UBYTE B_TRUE 1 100 0.00 1.00000000000 BIT_MASK 0x1 FORMAT "%13.11" ECU_ADDRESS 0x6002C5B5
 /begin IF_DATA XCPplus 0x0102
  /begin DAQ_EVENT VARIABLE /end DAQ_EVENT
 /end IF_DATA
/end MEASUREMENT
/begin MEASUREMENT MoFTqPtdEm_flgEm01Qdr3Lock "EM01 Quadrant 3 locked" UBYTE B_TRUE 1 100 0.00 1.00000000000 BIT_MASK 0x2 FORMAT "%13.11" ECU_ADDRESS 0x6002C5B5
 /begin IF_DATA XCPplus 0x0102
  /begin DAQ_EVENT VARIABLE /end DAQ_EVENT
 /end IF_DATA
/end MEASUREMENT
/begin MEASUREMENT MoFTqPtdEm_flgIrrvPtRelsErrMsg "level 1 torque demand but no level 2 drivetrain release (irreversible)" UBYTE B_TRUE 1 100 0.00 1.00000000000 BIT_MASK 0x1 FORMAT "%13.11" ECU_ADDRESS 0x7000022F
 /begin IF_DATA XCPplus 0x0102
  /begin DAQ_EVENT VARIABLE /end DAQ_EVENT
 /end IF_DATA
/end MEASUREMENT
/begin MEASUREMENT MoFTqPtdEm_flgIrrvSignErrMsg "Irreversible error status for sign check error on e-machine level DFC_MoFTqPtdEmSign" UBYTE B_TRUE 1 100 0.00 1.00000000000 BIT_MASK 0x1 FORMAT "%13.11" ECU_ADDRESS 0x7000022E
 /begin IF_DATA XCPplus 0x0102
  /begin DAQ_EVENT VARIABLE /end DAQ_EVENT
 /end IF_DATA
/end MEASUREMENT
/begin MEASUREMENT MoFTqPtdEm_flgIrrvTqErrMsg "Irreversible error status for torque error on e-machine level DFC_MoFTqPtdEmTq" UBYTE B_TRUE 1 100 0.00 1.00000000000 BIT_MASK 0x1 FORMAT "%13.11" ECU_ADDRESS 0x7000022D
 /begin IF_DATA XCPplus 0x0102
  /begin DAQ_EVENT VARIABLE /end DAQ_EVENT
 /end IF_DATA
/end MEASUREMENT
/begin MEASUREMENT MoFTqPtdEm_flgLwrLimExcd "Error flag: Undercut of permitted lower torque limit" UBYTE B_TRUE 1 100 0.00 1.00000000000 BIT_MASK 0x1 FORMAT "%13.11" ECU_ADDRESS 0x6002C602
 /begin IF_DATA XCPplus 0x0102
  /begin DAQ_EVENT VARIABLE /end DAQ_EVENT
 /end IF_DATA
/end MEASUREMENT
/begin MEASUREMENT MoFTqPtdEm_flgOthTrqCompErr "Error flag for torque comparison errors of vehicle and axle level which considered at e-machine level" UBYTE B_TRUE 1 100 0.00 1.00000000000 BIT_MASK 0x40 FORMAT "%13.11" ECU_ADDRESS 0x6002C601
 /begin IF_DATA XCPplus 0x0102
  /begin DAQ_EVENT VARIABLE /end DAQ_EVENT
 /end IF_DATA
/end MEASUREMENT
/begin MEASUREMENT MoFTqPtdEm_flgPrpInhb01 "Level2 Propulsion inhibit flag" UBYTE B_TRUE 1 100 0.00 1.00000000000 BIT_MASK 0x2 FORMAT "%13.11" ECU_ADDRESS 0x6002C5E0
 /begin IF_DATA XCPplus 0x0102
  /begin DAQ_EVENT VARIABLE /end DAQ_EVENT
 /end IF_DATA
/end MEASUREMENT
/begin MEASUREMENT MoFTqPtdEm_flgPtActvErr "Error flag for PT active error on e-machine level" UBYTE B_TRUE 1 100 0.00 1.00000000000 BIT_MASK 0x20 FORMAT "%13.11" ECU_ADDRESS 0x6002C601
 /begin IF_DATA XCPplus 0x0102
  /begin DAQ_EVENT VARIABLE /end DAQ_EVENT
 /end IF_DATA
/end MEASUREMENT
/begin MEASUREMENT MoFTqPtdEm_flgQdrLockRampPtdMsg "Quadrant lock ramp permitted from monitoring" UBYTE B_TRUE 1 100 0.00 1.00000000000 BIT_MASK 0x1 FORMAT "%13.11" ECU_ADDRESS 0x7000022C
 /begin IF_DATA XCPplus 0x0102
  /begin DAQ_EVENT VARIABLE /end DAQ_EVENT
 /end IF_DATA
/end MEASUREMENT
/begin MEASUREMENT MoFTqPtdEm_flgQdrLockTempErr "Flag to indicate locked quadrant temporary error" UBYTE B_TRUE 1 100 0.00 1.00000000000 BIT_MASK 0x1 FORMAT "%13.11" ECU_ADDRESS 0x6002C600
 /begin IF_DATA XCPplus 0x0102
  /begin DAQ_EVENT VARIABLE /end DAQ_EVENT
 /end IF_DATA
/end MEASUREMENT
/begin MEASUREMENT MoFTqPtdEm_flgQdrLockTout "Quadrant lock timeout state" UBYTE B_TRUE 1 100 0.00 1.00000000000 BIT_MASK 0x2 FORMAT "%13.11" ECU_ADDRESS 0x6002C600
 /begin IF_DATA XCPplus 0x0102
  /begin DAQ_EVENT VARIABLE /end DAQ_EVENT
 /end IF_DATA
/end MEASUREMENT
/begin MEASUREMENT MoFTqPtdEm_flgQdrLockToutErr "Quadrant lock timeout Error" UBYTE B_TRUE 1 100 0.00 1.00000000000 BIT_MASK 0x4 FORMAT "%13.11" ECU_ADDRESS 0x6002C600
 /begin IF_DATA XCPplus 0x0102
  /begin DAQ_EVENT VARIABLE /end DAQ_EVENT
 /end IF_DATA
/end MEASUREMENT
/begin MEASUREMENT MoFTqPtdEm_flgQdrMapDeb "State: error debouncing in sign check on e-machine level active" UBYTE B_TRUE 1 100 0.00 1.00000000000 BIT_MASK 0x1 FORMAT "%13.11" ECU_ADDRESS 0x6002C601
 /begin IF_DATA XCPplus 0x0102
  /begin DAQ_EVENT VARIABLE /end DAQ_EVENT
 /end IF_DATA
/end MEASUREMENT
/begin MEASUREMENT MoFTqPtdEm_flgQdrMapErr "Error flag: Error in sign check on e-machine level" UBYTE B_TRUE 1 100 0.00 1.00000000000 BIT_MASK 0x2 FORMAT "%13.11" ECU_ADDRESS 0x6002C601
 /begin IF_DATA XCPplus 0x0102
  /begin DAQ_EVENT VARIABLE /end DAQ_EVENT
 /end IF_DATA
/end MEASUREMENT
/begin MEASUREMENT MoFTqPtdEm_flgRecupInhb01 "Level2 Recuperation inhibit flag" UBYTE B_TRUE 1 100 0.00 1.00000000000 BIT_MASK 0x1 FORMAT "%13.11" ECU_ADDRESS 0x6002C5E0
 /begin IF_DATA XCPplus 0x0102
  /begin DAQ_EVENT VARIABLE /end DAQ_EVENT
 /end IF_DATA
/end MEASUREMENT
/begin MEASUREMENT MoFTqPtdEm_flgTestMsg "Bit test conditions for diagnosis of fault paths DFC_MoFTqPtdEmTq and DFC_MoFTqPtdEmSign" UBYTE B_TRUE 1 100 0.00 1.00000000000 BIT_MASK 0x1 FORMAT "%13.11" ECU_ADDRESS 0x7000022B
 /begin IF_DATA XCPplus 0x0102
  /begin DAQ_EVENT VARIABLE /end DAQ_EVENT
 /end IF_DATA
/end MEASUREMENT
/begin MEASUREMENT MoFTqPtdEm_flgTmr1Elpd "Flag indicating timer1 elapsed status" UBYTE B_TRUE 1 100 0.00 1.00000000000 BIT_MASK 0x8 FORMAT "%13.11" ECU_ADDRESS 0x6002C600
 /begin IF_DATA XCPplus 0x0102
  /begin DAQ_EVENT VARIABLE /end DAQ_EVENT
 /end IF_DATA
/end MEASUREMENT
/begin MEASUREMENT MoFTqPtdEm_flgTmr2Elpd "Flag indicating timer2 elapsed status" UBYTE B_TRUE 1 100 0.00 1.00000000000 BIT_MASK 0x10 FORMAT "%13.11" ECU_ADDRESS 0x6002C600
 /begin IF_DATA XCPplus 0x0102
  /begin DAQ_EVENT VARIABLE /end DAQ_EVENT
 /end IF_DATA
/end MEASUREMENT
/begin MEASUREMENT MoFTqPtdEm_flgTmr3Elpd "Flag indicating timer3 elapsed status" UBYTE B_TRUE 1 100 0.00 1.00000000000 BIT_MASK 0x20 FORMAT "%13.11" ECU_ADDRESS 0x6002C600
 /begin IF_DATA XCPplus 0x0102
  /begin DAQ_EVENT VARIABLE /end DAQ_EVENT
 /end IF_DATA
/end MEASUREMENT
/begin MEASUREMENT MoFTqPtdEm_flgTqCompDeb "State: error debouncing in torque comparison on e-machine level active" UBYTE B_TRUE 1 100 0.00 1.00000000000 BIT_MASK 0x4 FORMAT "%13.11" ECU_ADDRESS 0x6002C602
 /begin IF_DATA XCPplus 0x0102
  /begin DAQ_EVENT VARIABLE /end DAQ_EVENT
 /end IF_DATA
/end MEASUREMENT
/begin MEASUREMENT MoFTqPtdEm_flgTqCompErr "Error flag: Error in torque comparison on e-machine level" UBYTE B_TRUE 1 100 0.00 1.00000000000 BIT_MASK 0x8 FORMAT "%13.11" ECU_ADDRESS 0x6002C602
 /begin IF_DATA XCPplus 0x0102
  /begin DAQ_EVENT VARIABLE /end DAQ_EVENT
 /end IF_DATA
/end MEASUREMENT
/begin MEASUREMENT MoFTqPtdEm_flgTqIntegDeb "State: error debouncing in torque integral check on e-machine level active" UBYTE B_TRUE 1 100 0.00 1.00000000000 BIT_MASK 0x10 FORMAT "%13.11" ECU_ADDRESS 0x6002C602
 /begin IF_DATA XCPplus 0x0102
  /begin DAQ_EVENT VARIABLE /end DAQ_EVENT
 /end IF_DATA
/end MEASUREMENT
/begin MEASUREMENT MoFTqPtdEm_flgTqIntegErr "Error flag: Error in torque integral check on e-machine level" UBYTE B_TRUE 1 100 0.00 1.00000000000 BIT_MASK 0x20 FORMAT "%13.11" ECU_ADDRESS 0x6002C602
 /begin IF_DATA XCPplus 0x0102
  /begin DAQ_EVENT VARIABLE /end DAQ_EVENT
 /end IF_DATA
/end MEASUREMENT
/begin MEASUREMENT MoFTqPtdEm_flgTqLimChkErr "Error flag: Exceedance of permitted torque limit on e-machine level" UBYTE B_TRUE 1 100 0.00 1.00000000000 BIT_MASK 0x40 FORMAT "%13.11" ECU_ADDRESS 0x6002C602
 /begin IF_DATA XCPplus 0x0102
  /begin DAQ_EVENT VARIABLE /end DAQ_EVENT
 /end IF_DATA
/end MEASUREMENT
/begin MEASUREMENT MoFTqPtdEm_flgTqNotPtd "Flag indicating L1 torque larger than threshold for unintended movement from standstill" UBYTE B_TRUE 1 100 0.00 1.00000000000 BIT_MASK 0x40 FORMAT "%13.11" ECU_ADDRESS 0x6002C600
 /begin IF_DATA XCPplus 0x0102
  /begin DAQ_EVENT VARIABLE /end DAQ_EVENT
 /end IF_DATA
/end MEASUREMENT
/begin MEASUREMENT MoFTqPtdEm_flgTqTranEm01Neg "State: Desired torque on e-machine level is negative" UBYTE B_TRUE 1 100 0.00 1.00000000000 BIT_MASK 0x2 FORMAT "%13.11" ECU_ADDRESS 0x6002C602
 /begin IF_DATA XCPplus 0x0102
  /begin DAQ_EVENT VARIABLE /end DAQ_EVENT
 /end IF_DATA
/end MEASUREMENT
/begin MEASUREMENT MoFTqPtdEm_flgUpLimExcd "Error flag: Exceedance of permitted upper torque limit" UBYTE B_TRUE 1 100 0.00 1.00000000000 BIT_MASK 0x80 FORMAT "%13.11" ECU_ADDRESS 0x6002C602
 /begin IF_DATA XCPplus 0x0102
  /begin DAQ_EVENT VARIABLE /end DAQ_EVENT
 /end IF_DATA
/end MEASUREMENT
/begin MEASUREMENT MoFTqPtdEm_flgWrgGearPtActv "flag to indicate wrong gear when powertrain is active" UBYTE B_TRUE 1 100 0.00 1.00000000000 BIT_MASK 0x80 FORMAT "%13.11" ECU_ADDRESS 0x6002C601
 /begin IF_DATA XCPplus 0x0102
  /begin DAQ_EVENT VARIABLE /end DAQ_EVENT
 /end IF_DATA
/end MEASUREMENT
/begin MEASUREMENT MoFTqPtdEm_stErrPtRels "state of powertrain release violation" UBYTE OneToOne 1 100 0.00 255.0 FORMAT "%5.1" ECU_ADDRESS 0x6002C5FA
 /begin IF_DATA XCPplus 0x0102
  /begin DAQ_EVENT VARIABLE /end DAQ_EVENT
 /end IF_DATA
/end MEASUREMENT
/begin MEASUREMENT MoFTqPtdEm_stErrPtRelsCpl "complement of state of powertrain release violation" UBYTE OneToOne 1 100 0.00 255.0 FORMAT "%5.1" ECU_ADDRESS 0x6002BBDF
 /begin IF_DATA XCPplus 0x0102
  /begin DAQ_EVENT VARIABLE /end DAQ_EVENT
 /end IF_DATA
/end MEASUREMENT
/begin MEASUREMENT MoFTqPtdEm_stErrSignComp "error state of sign check on e-machine level" UBYTE OneToOne 1 100 0.00 255.0 FORMAT "%5.1" ECU_ADDRESS 0x6002C5F9
 /begin IF_DATA XCPplus 0x0102
  /begin DAQ_EVENT VARIABLE /end DAQ_EVENT
 /end IF_DATA
/end MEASUREMENT
/begin MEASUREMENT MoFTqPtdEm_stErrSignCompCpl "RAM data redundancy for MoFTqPtdEm_stErrSignComp" UBYTE OneToOne 1 100 0.00 255.0 FORMAT "%5.1" ECU_ADDRESS 0x6002BBDE
 /begin IF_DATA XCPplus 0x0102
  /begin DAQ_EVENT VARIABLE /end DAQ_EVENT
 /end IF_DATA
/end MEASUREMENT
/begin MEASUREMENT MoFTqPtdEm_stErrTqComp "error state of torque comparison on e-machine level" UBYTE OneToOne 1 100 0.00 255.0 FORMAT "%5.1" ECU_ADDRESS 0x6002C5F8
 /begin IF_DATA XCPplus 0x0102
  /begin DAQ_EVENT VARIABLE /end DAQ_EVENT
 /end IF_DATA
/end MEASUREMENT
/begin MEASUREMENT MoFTqPtdEm_stErrTqCompCpl "RAM data redundancy for MoFTqPtdEm_stErrTqComp" UBYTE OneToOne 1 100 0.00 255.0 FORMAT "%5.1" ECU_ADDRESS 0x6002BBDD
 /begin IF_DATA XCPplus 0x0102
  /begin DAQ_EVENT VARIABLE /end DAQ_EVENT
 /end IF_DATA
/end MEASUREMENT
/begin MEASUREMENT MoFTqPtdEm_stRSFFGearChng "RS flipflop gear change status" UBYTE OneToOne 1 100 0.00 255.0 FORMAT "%5.1" ECU_ADDRESS 0x6002C5FB
 /begin IF_DATA XCPplus 0x0102
  /begin DAQ_EVENT VARIABLE /end DAQ_EVENT
 /end IF_DATA
/end MEASUREMENT
/begin MEASUREMENT MoFTqPtdEm_stRSFFGearChngCpl "Complement of RS flipflop gear change status" UBYTE OneToOne 1 100 0.00 255.0 FORMAT "%5.1" ECU_ADDRESS 0x6002BBDC
 /begin IF_DATA XCPplus 0x0102
  /begin DAQ_EVENT VARIABLE /end DAQ_EVENT
 /end IF_DATA
/end MEASUREMENT
/begin MEASUREMENT MoFTqPtdEm_stSignChgTranEm01 "State Sign Changed" UBYTE OneToOne 1 100 0.00 255.0 FORMAT "%5.1" ECU_ADDRESS 0x6002C5B4
 /begin IF_DATA XCPplus 0x0102
  /begin DAQ_EVENT VARIABLE /end DAQ_EVENT
 /end IF_DATA
/end MEASUREMENT
/begin MEASUREMENT MoFTqPtdEm_stSignChgTranEm01Cpl "CPL of MoFTqPtdEm_stSignChgTranEm01" UBYTE OneToOne 1 100 0.00 255.0 FORMAT "%5.1" ECU_ADDRESS 0x6002BB98
 /begin IF_DATA XCPplus 0x0102
  /begin DAQ_EVENT VARIABLE /end DAQ_EVENT
 /end IF_DATA
/end MEASUREMENT
/begin MEASUREMENT MoFTqPtdEm_tqDesCoornEm01 "Desire Torque EM-Level after external interventions" SWORD Trq 1 100 -3276.800 3276.700 FORMAT "%8.3" ECU_ADDRESS 0x6002C5B8
 /begin IF_DATA XCPplus 0x0102
  /begin DAQ_EVENT VARIABLE /end DAQ_EVENT
 /end IF_DATA
/end MEASUREMENT
/begin MEASUREMENT MoFTqPtdEm_tqDesCoornEm01Cpl "RAM data redundancy for MoFTqPtdEm_tqDesCoornEm01" UWORD OneToOne 1 100 0.00 65535.00 FORMAT "%8.2" ECU_ADDRESS 0x6002BB9E
 /begin IF_DATA XCPplus 0x0102
  /begin DAQ_EVENT VARIABLE /end DAQ_EVENT
 /end IF_DATA
/end MEASUREMENT
/begin MEASUREMENT MoFTqPtdEm_tqDesCoornEm01Old "Old value of MoFTqPtdEm_tqDesCoornEm01" SWORD Trq 1 100 -3276.800 3276.700 FORMAT "%8.3" ECU_ADDRESS 0x6002C5BA
 /begin IF_DATA XCPplus 0x0102
  /begin DAQ_EVENT VARIABLE /end DAQ_EVENT
 /end IF_DATA
/end MEASUREMENT
/begin MEASUREMENT MoFTqPtdEm_tqDesCoornEm01OldCpl "Complement of MoFTqPtdEm_tqDesCoornEm01Old" UWORD OneToOne 1 100 0.00 65535.00 FORMAT "%8.2" ECU_ADDRESS 0x6002BB9C
 /begin IF_DATA XCPplus 0x0102
  /begin DAQ_EVENT VARIABLE /end DAQ_EVENT
 /end IF_DATA
/end MEASUREMENT
/begin MEASUREMENT MoFTqPtdEm_tqDesEm01 "Desired Torque of Electric Machine 1" SWORD Trq 1 100 -3276.800 3276.700 FORMAT "%8.3" ECU_ADDRESS 0x6002C5E2
 /begin IF_DATA XCPplus 0x0102
  /begin DAQ_EVENT VARIABLE /end DAQ_EVENT
 /end IF_DATA
/end MEASUREMENT
/begin MEASUREMENT MoFTqPtdEm_tqDesEm01Cpl "RAM data redundancy for MoFTqPtdEm_tqDesEm01" UWORD OneToOne 1 100 0.00 65535.00 FORMAT "%8.2" ECU_ADDRESS 0x6002BBD0
 /begin IF_DATA XCPplus 0x0102
  /begin DAQ_EVENT VARIABLE /end DAQ_EVENT
 /end IF_DATA
/end MEASUREMENT
/begin MEASUREMENT MoFTqPtdEm_tqDesEm01PreVal "preliminary torque demand for e-machine 1" SWORD Trq 1 100 -3276.800 3276.700 FORMAT "%8.3" ECU_ADDRESS 0x6002C5EC
 /begin IF_DATA XCPplus 0x0102
  /begin DAQ_EVENT VARIABLE /end DAQ_EVENT
 /end IF_DATA
/end MEASUREMENT
/begin MEASUREMENT MoFTqPtdEm_tqDesEm01PreValCpl "complement: preliminary torque demand for e-machine 1" UWORD OneToOne 1 100 0.00 65535.00 FORMAT "%8.2" ECU_ADDRESS 0x6002BBCE
 /begin IF_DATA XCPplus 0x0102
  /begin DAQ_EVENT VARIABLE /end DAQ_EVENT
 /end IF_DATA
/end MEASUREMENT
/begin MEASUREMENT MoFTqPtdEm_tqDesEm01UpLimd "Desired torque e-machine 1 limited upwards after final torque or sign error in function monitoring" SWORD Trq 1 100 -3276.800 3276.700 FORMAT "%8.3" ECU_ADDRESS 0x6002C5EA
 /begin IF_DATA XCPplus 0x0102
  /begin DAQ_EVENT VARIABLE /end DAQ_EVENT
 /end IF_DATA
/end MEASUREMENT
/begin MEASUREMENT MoFTqPtdEm_tqDesEm01UpLimdCpl "RAM data redundancy for MoFTqPtdEm_tqDesEm01UpLimd" UWORD OneToOne 1 100 0.00 65535.00 FORMAT "%8.2" ECU_ADDRESS 0x6002BBCC
 /begin IF_DATA XCPplus 0x0102
  /begin DAQ_EVENT VARIABLE /end DAQ_EVENT
 /end IF_DATA
/end MEASUREMENT
/begin MEASUREMENT MoFTqPtdEm_tqDesLvl1PrpInhb01 "Level1 Torque for Propulsion Inhibit" SLONG TrqPrpHigh 1 100 -214748364.800 214748364.700 FORMAT "%13.3" ECU_ADDRESS 0x6002C5DC
 /begin IF_DATA XCPplus 0x0102
  /begin DAQ_EVENT VARIABLE /end DAQ_EVENT
 /end IF_DATA
/end MEASUREMENT
/begin MEASUREMENT MoFTqPtdEm_tqDesLvl1PrpInhb01Cpl "Complement of MoFTqPtdEm_tqDesLvl1PrpInhb01" ULONG OneToOne 1 100 0.00 4294967295.00 FORMAT "%13.2" ECU_ADDRESS 0x6002BBC0
 /begin IF_DATA XCPplus 0x0102
  /begin DAQ_EVENT VARIABLE /end DAQ_EVENT
 /end IF_DATA
/end MEASUREMENT
/begin MEASUREMENT MoFTqPtdEm_tqDesLvl1RecupInhb01 "Level1 Torque for Recuperation Inhibit" SLONG TrqPrpHigh 1 100 -214748364.800 214748364.700 FORMAT "%13.3" ECU_ADDRESS 0x6002C5D8
 /begin IF_DATA XCPplus 0x0102
  /begin DAQ_EVENT VARIABLE /end DAQ_EVENT
 /end IF_DATA
/end MEASUREMENT
/begin MEASUREMENT MoFTqPtdEm_tqDesLvl1RecupInhb01Cpl "Complement of MoFTqPtdEm_tqDesLvl1RecupInhb01" ULONG OneToOne 1 100 0.00 4294967295.00 FORMAT "%13.2" ECU_ADDRESS 0x6002BBBC
 /begin IF_DATA XCPplus 0x0102
  /begin DAQ_EVENT VARIABLE /end DAQ_EVENT
 /end IF_DATA
/end MEASUREMENT
/begin MEASUREMENT MoFTqPtdEm_tqDesWhl01 "Desired wheel torque for EM01 in function monitoring" SLONG TrqPrpHigh 1 100 -214748364.800 214748364.700 FORMAT "%13.3" ECU_ADDRESS 0x6002C598
 /begin IF_DATA XCPplus 0x0102
  /begin DAQ_EVENT VARIABLE /end DAQ_EVENT
 /end IF_DATA
/end MEASUREMENT
/begin MEASUREMENT MoFTqPtdEm_tqDesWhl01Cpl "RAM data redundancy for MoFTqPtdEm_tqDesWhl01" ULONG OneToOne 1 100 0.00 4294967295.00 FORMAT "%13.2" ECU_ADDRESS 0x6002BB7C
 /begin IF_DATA XCPplus 0x0102
  /begin DAQ_EVENT VARIABLE /end DAQ_EVENT
 /end IF_DATA
/end MEASUREMENT
/begin MEASUREMENT MoFTqPtdEm_tqDesWithAllIntv01 "Wheel level torque with all interventions" SLONG TrqPrpHigh 1 100 -214748364.800 214748364.700 FORMAT "%13.3" ECU_ADDRESS 0x6002C5D4
 /begin IF_DATA XCPplus 0x0102
  /begin DAQ_EVENT VARIABLE /end DAQ_EVENT
 /end IF_DATA
/end MEASUREMENT
/begin MEASUREMENT MoFTqPtdEm_tqDesWithAllIntv01Cpl "Complement of MoFTqPtdEm_tqDesWithAllIntv01" ULONG OneToOne 1 100 0.00 4294967295.00 FORMAT "%13.2" ECU_ADDRESS 0x6002BBB8
 /begin IF_DATA XCPplus 0x0102
  /begin DAQ_EVENT VARIABLE /end DAQ_EVENT
 /end IF_DATA
/end MEASUREMENT
/begin MEASUREMENT MoFTqPtdEm_tqDesWithEscWhl01 "Desire Torque EM-Level after ESP interventions" SLONG TrqPrpHigh 1 100 -214748364.800 214748364.700 FORMAT "%13.3" ECU_ADDRESS 0x6002C5D0
 /begin IF_DATA XCPplus 0x0102
  /begin DAQ_EVENT VARIABLE /end DAQ_EVENT
 /end IF_DATA
/end MEASUREMENT
/begin MEASUREMENT MoFTqPtdEm_tqDesWithEscWhl01Cpl "RAM data redundancy for MoFTqPtdEm_tqDesWithEscWhl01" ULONG OneToOne 1 100 0.00 4294967295.00 FORMAT "%13.2" ECU_ADDRESS 0x6002BBB4
 /begin IF_DATA XCPplus 0x0102
  /begin DAQ_EVENT VARIABLE /end DAQ_EVENT
 /end IF_DATA
/end MEASUREMENT
/begin MEASUREMENT MoFTqPtdEm_tqDesWithInhbWhl01 "Wheel level torque with inhibit torque request" SLONG TrqPrpHigh 1 100 -214748364.800 214748364.700 FORMAT "%13.3" ECU_ADDRESS 0x6002C5CC
 /begin IF_DATA XCPplus 0x0102
  /begin DAQ_EVENT VARIABLE /end DAQ_EVENT
 /end IF_DATA
/end MEASUREMENT
/begin MEASUREMENT MoFTqPtdEm_tqDesWithInhbWhl01Cpl "Complement of MoFTqPtdEm_tqDesWithInhbWhl01" ULONG OneToOne 1 100 0.00 4294967295.00 FORMAT "%13.2" ECU_ADDRESS 0x6002BBB0
 /begin IF_DATA XCPplus 0x0102
  /begin DAQ_EVENT VARIABLE /end DAQ_EVENT
 /end IF_DATA
/end MEASUREMENT
/begin MEASUREMENT MoFTqPtdEm_tqDifEm "Difference between desired and permitted torque" SWORD Trq 1 100 -3276.800 3276.700 FORMAT "%8.3" ECU_ADDRESS 0x6002C5E8
 /begin IF_DATA XCPplus 0x0102
  /begin DAQ_EVENT VARIABLE /end DAQ_EVENT
 /end IF_DATA
/end MEASUREMENT
/begin MEASUREMENT MoFTqPtdEm_tqDifEmCpl "RAM data redundancy MoFTqPtdEm_tqDifEm" UWORD OneToOne 1 100 0.00 65535.00 FORMAT "%8.2" ECU_ADDRESS 0x6002BBCA
 /begin IF_DATA XCPplus 0x0102
  /begin DAQ_EVENT VARIABLE /end DAQ_EVENT
 /end IF_DATA
/end MEASUREMENT
/begin MEASUREMENT MoFTqPtdEm_tqLowrLim "Lower limit of permitted torque on e-machine level in function monitoring" SWORD Trq 1 100 -3276.800 3276.700 FORMAT "%8.3" ECU_ADDRESS 0x6002C5E6
 /begin IF_DATA XCPplus 0x0102
  /begin DAQ_EVENT VARIABLE /end DAQ_EVENT
 /end IF_DATA
/end MEASUREMENT
/begin MEASUREMENT MoFTqPtdEm_tqLowrLimCpl "RAM data redundancy for MoFTqPtdEm_tqLowrLim" UWORD OneToOne 1 100 0.00 65535.00 FORMAT "%8.2" ECU_ADDRESS 0x6002BBC8
 /begin IF_DATA XCPplus 0x0102
  /begin DAQ_EVENT VARIABLE /end DAQ_EVENT
 /end IF_DATA
/end MEASUREMENT
/begin MEASUREMENT MoFTqPtdEm_tqPrpInhb01 "Level2 Propulsion inhibit torque" SLONG TrqPrpHigh 1 100 -214748364.800 214748364.700 FORMAT "%13.3" ECU_ADDRESS 0x6002C5C8
 /begin IF_DATA XCPplus 0x0102
  /begin DAQ_EVENT VARIABLE /end DAQ_EVENT
 /end IF_DATA
/end MEASUREMENT
/begin MEASUREMENT MoFTqPtdEm_tqPrpInhb01Cpl "Complement of MoFTqPtdEm_tqPrpInhb01" ULONG OneToOne 1 100 0.00 4294967295.00 FORMAT "%13.2" ECU_ADDRESS 0x6002BBAC
 /begin IF_DATA XCPplus 0x0102
  /begin DAQ_EVENT VARIABLE /end DAQ_EVENT
 /end IF_DATA
/end MEASUREMENT
/begin MEASUREMENT MoFTqPtdEm_tqPrpInhb01Old "Old value of Level2 Propulsion inhibit torque" SLONG TrqPrpHigh 1 100 -214748364.800 214748364.700 FORMAT "%13.3" ECU_ADDRESS 0x6002C5C4
 /begin IF_DATA XCPplus 0x0102
  /begin DAQ_EVENT VARIABLE /end DAQ_EVENT
 /end IF_DATA
/end MEASUREMENT
/begin MEASUREMENT MoFTqPtdEm_tqPrpInhb01OldCpl "Complement of MoFTqPtdEm_tqPrpInhb01Old" ULONG OneToOne 1 100 0.00 4294967295.00 FORMAT "%13.2" ECU_ADDRESS 0x6002BBA8
 /begin IF_DATA XCPplus 0x0102
  /begin DAQ_EVENT VARIABLE /end DAQ_EVENT
 /end IF_DATA
/end MEASUREMENT
/begin MEASUREMENT MoFTqPtdEm_tqRecupInhb01 "Level2 Recuperation inhibit torque" SLONG TrqPrpHigh 1 100 -214748364.800 214748364.700 FORMAT "%13.3" ECU_ADDRESS 0x6002C5C0
 /begin IF_DATA XCPplus 0x0102
  /begin DAQ_EVENT VARIABLE /end DAQ_EVENT
 /end IF_DATA
/end MEASUREMENT
/begin MEASUREMENT MoFTqPtdEm_tqRecupInhb01Cpl "Complement of MoFTqPtdEm_tqRecupInhb01" ULONG OneToOne 1 100 0.00 4294967295.00 FORMAT "%13.2" ECU_ADDRESS 0x6002BBA4
 /begin IF_DATA XCPplus 0x0102
  /begin DAQ_EVENT VARIABLE /end DAQ_EVENT
 /end IF_DATA
/end MEASUREMENT
/begin MEASUREMENT MoFTqPtdEm_tqRecupInhb01Old "Old value of Level2 Recuperation inhibit torque" SLONG TrqPrpHigh 1 100 -214748364.800 214748364.700 FORMAT "%13.3" ECU_ADDRESS 0x6002C5BC
 /begin IF_DATA XCPplus 0x0102
  /begin DAQ_EVENT VARIABLE /end DAQ_EVENT
 /end IF_DATA
/end MEASUREMENT
/begin MEASUREMENT MoFTqPtdEm_tqRecupInhb01OldCpl "Complement of MoFTqPtdEm_tqRecupInhb01Old" ULONG OneToOne 1 100 0.00 4294967295.00 FORMAT "%13.2" ECU_ADDRESS 0x6002BBA0
 /begin IF_DATA XCPplus 0x0102
  /begin DAQ_EVENT VARIABLE /end DAQ_EVENT
 /end IF_DATA
/end MEASUREMENT
/begin MEASUREMENT MoFTqPtdEm_tqTiInteg "Integral value of torque comparison on e-machine level" SLONG mdt_q0p001_Nm_s 1 100 -2147483.64800 2147483.64700 FORMAT "%13.5" ECU_ADDRESS 0x6002C5F4
 /begin IF_DATA XCPplus 0x0102
  /begin DAQ_EVENT VARIABLE /end DAQ_EVENT
 /end IF_DATA
/end MEASUREMENT
/begin MEASUREMENT MoFTqPtdEm_tqTiIntegCpl "RAM data redundancy for MoFTqPtdEm_tqTiInteg" ULONG OneToOne 1 100 0.00 4294967295.00 FORMAT "%13.2" ECU_ADDRESS 0x6002BBD8
 /begin IF_DATA XCPplus 0x0102
  /begin DAQ_EVENT VARIABLE /end DAQ_EVENT
 /end IF_DATA
/end MEASUREMENT
/begin MEASUREMENT MoFTqPtdEm_tqTranEm01 "Desire torque on EM-Level" SWORD Trq 1 100 -3276.800 3276.700 FORMAT "%8.3" ECU_ADDRESS 0x6002C5B2
 /begin IF_DATA XCPplus 0x0102
  /begin DAQ_EVENT VARIABLE /end DAQ_EVENT
 /end IF_DATA
/end MEASUREMENT
/begin MEASUREMENT MoFTqPtdEm_tqTranEm01Cpl "RAM data redundancy for MoFTqPtdEm_tqTranEm01" UWORD OneToOne 1 100 0.00 65535.00 FORMAT "%8.2" ECU_ADDRESS 0x6002BB96
 /begin IF_DATA XCPplus 0x0102
  /begin DAQ_EVENT VARIABLE /end DAQ_EVENT
 /end IF_DATA
/end MEASUREMENT
/begin MEASUREMENT MoFTqPtdEm_tqUpLim "Upper limit of permitted torque on e-machine level in function monitoring" SWORD Trq 1 100 -3276.800 3276.700 FORMAT "%8.3" ECU_ADDRESS 0x6002C5E4
 /begin IF_DATA XCPplus 0x0102
  /begin DAQ_EVENT VARIABLE /end DAQ_EVENT
 /end IF_DATA
/end MEASUREMENT
/begin MEASUREMENT MoFTqPtdEm_tqUpLimCpl "RAM data redundancy for MoFTqPtdEm_tqUpLim" UWORD OneToOne 1 100 0.00 65535.00 FORMAT "%8.2" ECU_ADDRESS 0x6002BBC6
 /begin IF_DATA XCPplus 0x0102
  /begin DAQ_EVENT VARIABLE /end DAQ_EVENT
 /end IF_DATA
/end MEASUREMENT
/begin MEASUREMENT MoFTqPtdEm_Tran_Cls_Em01Cpl_I.MoFTqPtdEm_facShftCpl "Instance-Tran_ComplementCls / CPL of MoFTqPtdEm_facShft" UWORD OneToOne 1 100 0.00 65535.00 FORMAT "%8.2" ECU_ADDRESS 0x6002BB80
 /begin IF_DATA XCPplus 0x0102
  /begin DAQ_EVENT VARIABLE /end DAQ_EVENT
 /end IF_DATA
/end MEASUREMENT
/begin MEASUREMENT MoFTqPtdEm_Tran_Cls_Em01Cpl_I.MoFTqPtdEm_facShftCalcCpl "Instance-Tran_ComplementCls / CPL of MoFTqPtdEm_facShftCalc" UWORD OneToOne 1 100 0.00 65535.00 FORMAT "%8.2" ECU_ADDRESS 0x6002BB82 /end MEASUREMENT
/begin MEASUREMENT MoFTqPtdEm_Tran_Cls_Em01Cpl_I.MoFTqPtdEm_facShftFltCpl "Instance-Tran_ComplementCls / CPL of MoFTqPtdEm_facShftFlt" UWORD OneToOne 1 100 0.00 65535.00 FORMAT "%8.2" ECU_ADDRESS 0x6002BB84
 /begin IF_DATA XCPplus 0x0102
  /begin DAQ_EVENT VARIABLE /end DAQ_EVENT
 /end IF_DATA
/end MEASUREMENT
/begin MEASUREMENT MoFTqPtdEm_Tran_Cls_Em01Cpl_I.MoFTqPtdEm_facShftFltLowCpl "Instance-Tran_ComplementCls / CPL of MoFTqPtdEm_facShftFltLow" UWORD OneToOne 1 100 0.00 65535.00 FORMAT "%8.2" ECU_ADDRESS 0x6002BB86
 /begin IF_DATA XCPplus 0x0102
  /begin DAQ_EVENT VARIABLE /end DAQ_EVENT
 /end IF_DATA
/end MEASUREMENT
/begin MEASUREMENT MoFTqPtdEm_Tran_Cls_Em01Cpl_I.MoFTqPtdEm_nEmPhySignCpl "Instance-Tran_ComplementCls / Complement of sign changed e-machine speed" UWORD OneToOne 1 100 0.00 65535.00 FORMAT "%8.2" ECU_ADDRESS 0x6002BB88 /end MEASUREMENT
/begin MEASUREMENT MoFTqPtdEm_Tran_Cls_Em01Cpl_I.MoFTqPtdEm_stChgGearNCpl "Instance-Tran_ComplementCls / CPL of MoFTqPtdEm_stChgGearN" UBYTE OneToOne 1 100 0.00 255.0 FORMAT "%5.1" ECU_ADDRESS 0x6002BB8A
 /begin IF_DATA XCPplus 0x0102
  /begin DAQ_EVENT VARIABLE /end DAQ_EVENT
 /end IF_DATA
/end MEASUREMENT
/begin MEASUREMENT MoFTqPtdEm_Tran_Cls_Em01Cpl_I.MoFTqPtdEm_stDirChgCpl "Instance-Tran_ComplementCls / complement:flip flop variable to store the last direction state" UBYTE OneToOne 1 100 0.00 255.0 FORMAT "%5.1" ECU_ADDRESS 0x6002BB8B /end MEASUREMENT
/begin MEASUREMENT MoFTqPtdEm_Tran_Cls_Em01Cpl_I.MoFTqPtdEm_stGearChngCpl "Instance-Tran_ComplementCls / Complement of status Gear change" UBYTE OneToOne 1 100 0.00 255.0 FORMAT "%5.1" ECU_ADDRESS 0x6002BB8C /end MEASUREMENT
/begin MEASUREMENT MoFTqPtdEm_Tran_Cls_Em01Cpl_I.MoFTqPtdEm_stGearChngOldCpl "Instance-Tran_ComplementCls / Complement of status gear change Old" UBYTE OneToOne 1 100 0.00 255.0 FORMAT "%5.1" ECU_ADDRESS 0x6002BB8D /end MEASUREMENT
/begin MEASUREMENT MoFTqPtdEm_Tran_Cls_Em01Cpl_I.MoFTqPtdEm_stQdrLockCpl "Instance-Tran_ComplementCls / CPL of MoFTqPtdEm_stQdrLock" UBYTE OneToOne 1 100 0.00 255.0 FORMAT "%5.1" ECU_ADDRESS 0x6002BB8E /end MEASUREMENT
/begin MEASUREMENT MoFTqPtdEm_Tran_Cls_Em01Cpl_I.MoFTqPtdEm_stQdrLockTmpCpl "Instance-Tran_ComplementCls / CPL of MoFTqPtdEm_stQdrLockTmp" UBYTE OneToOne 1 100 0.00 255.0 FORMAT "%5.1" ECU_ADDRESS 0x6002BB8F /end MEASUREMENT
/begin MEASUREMENT MoFTqPtdEm_Tran_Cls_Em01Cpl_I.MoFTqPtdEm_stRSFFGearCpl "Instance-Tran_ComplementCls / Complement of status RS flip flop Gear" UBYTE OneToOne 1 100 0.00 255.0 FORMAT "%5.1" ECU_ADDRESS 0x6002BB90 /end MEASUREMENT
/begin MEASUREMENT MoFTqPtdEm_Tran_Cls_Em01Cpl_I.MoFTqPtdEm_stSignChgTranCpl "Instance-Tran_ComplementCls / CPL for MoFTqPtdEm_Tran_Cls" UBYTE OneToOne 1 100 0.00 255.0 FORMAT "%5.1" ECU_ADDRESS 0x6002BB91 /end MEASUREMENT
/begin MEASUREMENT MoFTqPtdEm_Tran_Cls_Em01Cpl_I.MoFTqPtdEm_tqCoornTranEmCpl "Instance-Tran_ComplementCls / CPL of MoFTqPtdEm_tqCoornTranEm" UWORD OneToOne 1 100 0.00 65535.00 FORMAT "%8.2" ECU_ADDRESS 0x6002BB92 /end MEASUREMENT
/begin MEASUREMENT MoFTqPtdEm_Tran_Cls_Em01Cpl_I.MoFTqPtdEm_tqTranEmCpl "Instance-Tran_ComplementCls / CPL of MoFTqPtdEm_tqTranEm" UWORD OneToOne 1 100 0.00 65535.00 FORMAT "%8.2" ECU_ADDRESS 0x6002BB94 /end MEASUREMENT
/begin MEASUREMENT MoFTqPtdEm_Tran_Cls_Em01_I.MoFTqPtdEm_facShft "Instance-Tran_Cls / factor shift" UWORD FactLow 1 100 0.00 63.99902 FORMAT "%8.5" ECU_ADDRESS 0x6002C59C
 /begin IF_DATA XCPplus 0x0102
  /begin DAQ_EVENT VARIABLE /end DAQ_EVENT
 /end IF_DATA
/end MEASUREMENT
/begin MEASUREMENT MoFTqPtdEm_Tran_Cls_Em01_I.MoFTqPtdEm_facShftCalc "Instance-Tran_Cls / factor shift calculation" UWORD FactLow 1 100 0.00 63.99902 FORMAT "%8.5" ECU_ADDRESS 0x6002C59E
 /begin IF_DATA XCPplus 0x0102
  /begin DAQ_EVENT VARIABLE /end DAQ_EVENT
 /end IF_DATA
/end MEASUREMENT
/begin MEASUREMENT MoFTqPtdEm_Tran_Cls_Em01_I.MoFTqPtdEm_facShftFlt "Instance-Tran_Cls / factor shift filtered" UWORD FactLow 1 100 0.00 63.99902 FORMAT "%8.5" ECU_ADDRESS 0x6002C5A0
 /begin IF_DATA XCPplus 0x0102
  /begin DAQ_EVENT VARIABLE /end DAQ_EVENT
 /end IF_DATA
/end MEASUREMENT
/begin MEASUREMENT MoFTqPtdEm_Tran_Cls_Em01_I.MoFTqPtdEm_facShftFltLow "Instance-Tran_Cls / factor shift low part" UWORD OneToOne 1 100 0.00 65535.00 FORMAT "%8.2" ECU_ADDRESS 0x6002C5A2
 /begin IF_DATA XCPplus 0x0102
  /begin DAQ_EVENT VARIABLE /end DAQ_EVENT
 /end IF_DATA
/end MEASUREMENT
/begin MEASUREMENT MoFTqPtdEm_Tran_Cls_Em01_I.MoFTqPtdEm_nEmPhySign "Instance-Tran_Cls / sign changed e-machine speed" SWORD nmot_q1 1 100 -32768.00 32767.00 FORMAT "%8.2" ECU_ADDRESS 0x6002C5A4
 /begin IF_DATA XCPplus 0x0102
  /begin DAQ_EVENT VARIABLE /end DAQ_EVENT
 /end IF_DATA
/end MEASUREMENT
/begin MEASUREMENT MoFTqPtdEm_Tran_Cls_Em01_I.MoFTqPtdEm_stChgGearN "Instance-Tran_Cls / state change gear N" UBYTE OneToOne 1 100 0.00 255.0 FORMAT "%5.1" ECU_ADDRESS 0x6002C5A6
 /begin IF_DATA XCPplus 0x0102
  /begin DAQ_EVENT VARIABLE /end DAQ_EVENT
 /end IF_DATA
/end MEASUREMENT
/begin MEASUREMENT MoFTqPtdEm_Tran_Cls_Em01_I.MoFTqPtdEm_stDirChg "Instance-Tran_Cls / flip flop variable to store the last direction state" UBYTE OneToOne 1 100 0.00 255.0 FORMAT "%5.1" ECU_ADDRESS 0x6002C5A7
 /begin IF_DATA XCPplus 0x0102
  /begin DAQ_EVENT VARIABLE /end DAQ_EVENT
 /end IF_DATA
/end MEASUREMENT
/begin MEASUREMENT MoFTqPtdEm_Tran_Cls_Em01_I.MoFTqPtdEm_stGearChng "Instance-Tran_Cls / Status gear change" UBYTE OneToOne 1 100 0.00 255.0 FORMAT "%5.1" ECU_ADDRESS 0x6002C5A8
 /begin IF_DATA XCPplus 0x0102
  /begin DAQ_EVENT VARIABLE /end DAQ_EVENT
 /end IF_DATA
/end MEASUREMENT
/begin MEASUREMENT MoFTqPtdEm_Tran_Cls_Em01_I.MoFTqPtdEm_stGearChngOld "Instance-Tran_Cls / Status gear change Old" UBYTE OneToOne 1 100 0.00 255.0 FORMAT "%5.1" ECU_ADDRESS 0x6002C5A9
 /begin IF_DATA XCPplus 0x0102
  /begin DAQ_EVENT VARIABLE /end DAQ_EVENT
 /end IF_DATA
/end MEASUREMENT
/begin MEASUREMENT MoFTqPtdEm_Tran_Cls_Em01_I.MoFTqPtdEm_stQdrLock "Instance-Tran_Cls / state quradrant lock" UBYTE OneToOne 1 100 0.00 255.0 FORMAT "%5.1" ECU_ADDRESS 0x6002C5AA
 /begin IF_DATA XCPplus 0x0102
  /begin DAQ_EVENT VARIABLE /end DAQ_EVENT
 /end IF_DATA
/end MEASUREMENT
/begin MEASUREMENT MoFTqPtdEm_Tran_Cls_Em01_I.MoFTqPtdEm_stQdrLockTmp "Instance-Tran_Cls / state quradrant lock temp." UBYTE OneToOne 1 100 0.00 255.0 FORMAT "%5.1" ECU_ADDRESS 0x6002C5AB
 /begin IF_DATA XCPplus 0x0102
  /begin DAQ_EVENT VARIABLE /end DAQ_EVENT
 /end IF_DATA
/end MEASUREMENT
/begin MEASUREMENT MoFTqPtdEm_Tran_Cls_Em01_I.MoFTqPtdEm_stRSFFGear "Instance-Tran_Cls / Status RS flip flop Gear" UBYTE OneToOne 1 100 0.00 255.0 FORMAT "%5.1" ECU_ADDRESS 0x6002C5AC
 /begin IF_DATA XCPplus 0x0102
  /begin DAQ_EVENT VARIABLE /end DAQ_EVENT
 /end IF_DATA
/end MEASUREMENT
/begin MEASUREMENT MoFTqPtdEm_Tran_Cls_Em01_I.MoFTqPtdEm_stSignChgTran "Instance-Tran_Cls / class for MoFTqPtdEm_Tran" UBYTE OneToOne 1 100 0.00 255.0 FORMAT "%5.1" ECU_ADDRESS 0x6002C5AD
 /begin IF_DATA XCPplus 0x0102
  /begin DAQ_EVENT VARIABLE /end DAQ_EVENT
 /end IF_DATA
/end MEASUREMENT
/begin MEASUREMENT MoFTqPtdEm_Tran_Cls_Em01_I.MoFTqPtdEm_tqCoornTranEm "Instance-Tran_Cls / Main Input Torque MoFTqPtdEm_Tran_Cls" SWORD Trq 1 100 -3276.800 3276.700 FORMAT "%8.3" ECU_ADDRESS 0x6002C5AE
 /begin IF_DATA XCPplus 0x0102
  /begin DAQ_EVENT VARIABLE /end DAQ_EVENT
 /end IF_DATA
/end MEASUREMENT
/begin MEASUREMENT MoFTqPtdEm_Tran_Cls_Em01_I.MoFTqPtdEm_tqTranEm "Instance-Tran_Cls / Main Output Torque MoFTqPtdEm_Tran_Cls" SWORD Trq 1 100 -3276.800 3276.700 FORMAT "%8.3" ECU_ADDRESS 0x6002C5B0
 /begin IF_DATA XCPplus 0x0102
  /begin DAQ_EVENT VARIABLE /end DAQ_EVENT
 /end IF_DATA
/end MEASUREMENT
/begin MEASUREMENT MoFTqPtdOut_tqLimnEm01 "Limited Torque of Electric Machine 1 in function monitoring" SWORD Trq 1 100 -3276.800 3276.700 FORMAT "%8.3" ECU_ADDRESS 0x6002C57E
 /begin IF_DATA XCPplus 0x0102
  /begin DAQ_EVENT VARIABLE /end DAQ_EVENT
 /end IF_DATA
/end MEASUREMENT
/begin MEASUREMENT MoFTqPtdOut_tqLimnEm01Cpl "RAM Data redundancy for MoFTqPtdOut_tqLimnEm01" UWORD OneToOne 1 100 0.00 65535.00 FORMAT "%8.2" ECU_ADDRESS 0x6002BB6A
 /begin IF_DATA XCPplus 0x0102
  /begin DAQ_EVENT VARIABLE /end DAQ_EVENT
 /end IF_DATA
/end MEASUREMENT
/begin MEASUREMENT MoFTqPtdOut_tqLimnEm02 "Limited Torque of Electric Machine 2 in function monitoring" SWORD Trq 1 100 -3276.800 3276.700 FORMAT "%8.3" ECU_ADDRESS 0x6002C57C
 /begin IF_DATA XCPplus 0x0102
  /begin DAQ_EVENT VARIABLE /end DAQ_EVENT
 /end IF_DATA
/end MEASUREMENT
/begin MEASUREMENT MoFTqPtdOut_tqLimnEm02Cpl "RAM Data redundancy for MoFTqPtdOut_tqLimnEm02" UWORD OneToOne 1 100 0.00 65535.00 FORMAT "%8.2" ECU_ADDRESS 0x6002BB68
 /begin IF_DATA XCPplus 0x0102
  /begin DAQ_EVENT VARIABLE /end DAQ_EVENT
 /end IF_DATA
/end MEASUREMENT
/begin MEASUREMENT MoFTqPtdOut_tqLimpHomeLowrLimn "Lower limit limp home torque for both e-machine" SLONG TrqPrpHigh 1 100 -214748364.800 214748364.700 FORMAT "%13.3" ECU_ADDRESS 0x6002C594
 /begin IF_DATA XCPplus 0x0102
  /begin DAQ_EVENT VARIABLE /end DAQ_EVENT
 /end IF_DATA
/end MEASUREMENT
/begin MEASUREMENT MoFTqPtdOut_tqLimpHomeLowrLimnCpl "Complement of lower limit limp home torque for both e-machine" ULONG OneToOne 1 100 0.00 4294967295.00 FORMAT "%13.2" ECU_ADDRESS 0x6002BB78
 /begin IF_DATA XCPplus 0x0102
  /begin DAQ_EVENT VARIABLE /end DAQ_EVENT
 /end IF_DATA
/end MEASUREMENT
/begin MEASUREMENT MoFTqPtdOut_tqLimpHomeLowrLimnEm01 "Lower accelerator and vehicle speed dependent torque limitation during Limp-Home EM01" SWORD Trq 1 100 -3276.800 3276.700 FORMAT "%8.3" ECU_ADDRESS 0x6002C586
 /begin IF_DATA XCPplus 0x0102
  /begin DAQ_EVENT VARIABLE /end DAQ_EVENT
 /end IF_DATA
/end MEASUREMENT
/begin MEASUREMENT MoFTqPtdOut_tqLimpHomeLowrLimnEm01Cpl "Complement: Lower accelerator and vehicle speed dependent torque limitation during Limp-Home EM01" UWORD OneToOne 1 100 0.00 65535.00 FORMAT "%8.2" ECU_ADDRESS 0x6002BB66
 /begin IF_DATA XCPplus 0x0102
  /begin DAQ_EVENT VARIABLE /end DAQ_EVENT
 /end IF_DATA
/end MEASUREMENT
/begin MEASUREMENT MoFTqPtdOut_tqLimpHomeLowrLimnEm02 "Lower torque limit for EM02 during limp home" SWORD Trq 1 100 -3276.800 3276.700 FORMAT "%8.3" ECU_ADDRESS 0x6002C584
 /begin IF_DATA XCPplus 0x0102
  /begin DAQ_EVENT VARIABLE /end DAQ_EVENT
 /end IF_DATA
/end MEASUREMENT
/begin MEASUREMENT MoFTqPtdOut_tqLimpHomeLowrLimnEm02Cpl "RAM data redundancy for MoFTqPtdOut_tqLimpHomeLowrLimnEm02" UWORD OneToOne 1 100 0.00 65535.00 FORMAT "%8.2" ECU_ADDRESS 0x6002BB64
 /begin IF_DATA XCPplus 0x0102
  /begin DAQ_EVENT VARIABLE /end DAQ_EVENT
 /end IF_DATA
/end MEASUREMENT
/begin MEASUREMENT MoFTqPtdOut_tqLimpHomeUpprLimn "Upper limit limp home torque for both e-machine" SLONG TrqPrpHigh 1 100 -214748364.800 214748364.700 FORMAT "%13.3" ECU_ADDRESS 0x6002C590
 /begin IF_DATA XCPplus 0x0102
  /begin DAQ_EVENT VARIABLE /end DAQ_EVENT
 /end IF_DATA
/end MEASUREMENT
/begin MEASUREMENT MoFTqPtdOut_tqLimpHomeUpprLimnCpl "Complement of upper limit limp home torque for both e-machine" ULONG OneToOne 1 100 0.00 4294967295.00 FORMAT "%13.2" ECU_ADDRESS 0x6002BB74
 /begin IF_DATA XCPplus 0x0102
  /begin DAQ_EVENT VARIABLE /end DAQ_EVENT
 /end IF_DATA
/end MEASUREMENT
/begin MEASUREMENT MoFTqPtdOut_tqLimpHomeUpprLimnEm01 "Upper accelerator and vehicle speed dependent torque limitation during Limp-Home EM01" SWORD Trq 1 100 -3276.800 3276.700 FORMAT "%8.3" ECU_ADDRESS 0x6002C582
 /begin IF_DATA XCPplus 0x0102
  /begin DAQ_EVENT VARIABLE /end DAQ_EVENT
 /end IF_DATA
/end MEASUREMENT
/begin MEASUREMENT MoFTqPtdOut_tqLimpHomeUpprLimnEm01Cpl "Complement: Upper accelerator and vehicle speed dependent torque limitation during Limp-Home EM01" UWORD OneToOne 1 100 0.00 65535.00 FORMAT "%8.2" ECU_ADDRESS 0x6002BB62
 /begin IF_DATA XCPplus 0x0102
  /begin DAQ_EVENT VARIABLE /end DAQ_EVENT
 /end IF_DATA
/end MEASUREMENT
/begin MEASUREMENT MoFTqPtdOut_tqLimpHomeUpprLimnEm02 "upper torque limit for EM02 during limp home" SWORD Trq 1 100 -3276.800 3276.700 FORMAT "%8.3" ECU_ADDRESS 0x6002C580
 /begin IF_DATA XCPplus 0x0102
  /begin DAQ_EVENT VARIABLE /end DAQ_EVENT
 /end IF_DATA
/end MEASUREMENT
/begin MEASUREMENT MoFTqPtdOut_tqLimpHomeUpprLimnEm02Cpl "RAM data redundancy for MoFTqPtdOut_tqLimpHomeUpprLimnEm02" UWORD OneToOne 1 100 0.00 65535.00 FORMAT "%8.2" ECU_ADDRESS 0x6002BB60
 /begin IF_DATA XCPplus 0x0102
  /begin DAQ_EVENT VARIABLE /end DAQ_EVENT
 /end IF_DATA
/end MEASUREMENT
/begin MEASUREMENT MoFTqPtdOut_tqLimpHomeVehLowrLimn "Lower limit limp home torque at vehicle level" SLONG TrqPrpHigh 1 100 -214748364.800 214748364.700 FORMAT "%13.3" ECU_ADDRESS 0x6002C58C
 /begin IF_DATA XCPplus 0x0102
  /begin DAQ_EVENT VARIABLE /end DAQ_EVENT
 /end IF_DATA
/end MEASUREMENT
/begin MEASUREMENT MoFTqPtdOut_tqLimpHomeVehLowrLimnCpl "Complement of lower limit limp home torque at vehicle level" ULONG OneToOne 1 100 0.00 4294967295.00 FORMAT "%13.2" ECU_ADDRESS 0x6002BB70
 /begin IF_DATA XCPplus 0x0102
  /begin DAQ_EVENT VARIABLE /end DAQ_EVENT
 /end IF_DATA
/end MEASUREMENT
/begin MEASUREMENT MoFTqPtdOut_tqLimpHomeVehUpprLimn "Upper limit limp home torque at vehicle level" SLONG TrqPrpHigh 1 100 -214748364.800 214748364.700 FORMAT "%13.3" ECU_ADDRESS 0x6002C588
 /begin IF_DATA XCPplus 0x0102
  /begin DAQ_EVENT VARIABLE /end DAQ_EVENT
 /end IF_DATA
/end MEASUREMENT
/begin MEASUREMENT MoFTqPtdOut_tqLimpHomeVehUpprLimnCpl "Complement of upper limit limp home torque at vehicle level" ULONG OneToOne 1 100 0.00 4294967295.00 FORMAT "%13.2" ECU_ADDRESS 0x6002BB6C
 /begin IF_DATA XCPplus 0x0102
  /begin DAQ_EVENT VARIABLE /end DAQ_EVENT
 /end IF_DATA
/end MEASUREMENT
/begin MEASUREMENT MoFTqPtdOut_tqMaxAllwdMsg "Maximum allowed torque at vehicle level" SLONG TrqPrpHigh 1 100 -214748364.800 214748364.700 FORMAT "%13.3" ECU_ADDRESS 0x60000F60
 /begin IF_DATA XCPplus 0x0102
  /begin DAQ_EVENT VARIABLE /end DAQ_EVENT
 /end IF_DATA
/end MEASUREMENT
/begin MEASUREMENT MoFTqPtdOut_tqMinAllwdMsg "Minimum allowed torque at vehicle level" SLONG TrqPrpHigh 1 100 -214748364.800 214748364.700 FORMAT "%13.3" ECU_ADDRESS 0x60000F5C
 /begin IF_DATA XCPplus 0x0102
  /begin DAQ_EVENT VARIABLE /end DAQ_EVENT
 /end IF_DATA
/end MEASUREMENT
/begin FUNCTION MoFRelsMngt_PtRels "17.1.0    Function monitoring Powertrain release"
 /begin DEF_CHARACTERISTIC MoFRelsMngt_stCrash_C MoFRelsMngt_stHvbFltLvl_C MoFRelsMngt_stIvtrIntlckCls_C MoFRelsMngt_stIvtrIntlckOpn_C MoFRelsMngt_stModePark_C MoFRelsMngt_stSwtCfgFltBms_C MoFRelsMngt_stSwtCfgFltEm_C MoFRelsMngt_stSwtCfgPtRels_C MoFRelsMngt_stSwtCfgPtRstRels_C MoFRelsMngt_vVehDrvThd_C MoFRelsMngt_vVehHaltThd_C MoFRelsMngt_vVehPlgInsThd_C MoFRelsMngt_vVehSpdThd_C /end DEF_CHARACTERISTIC
 /begin IN_MEASUREMENT MoFBas_flgErrVSig MoFBas_flgT15 MoFBas_flgT50 MoFBas_vVeh MoFBrk_flgBrkMai MoFBrk_flgBrkRdnt MoFEmgyOff_stCrash MoFEvMngtBms_bbOutFltCfm MoFEvMngtEm_bbOutFltCfm MoFFrm_stAcPlgIns MoFFrm_stDcPlgIns MoFFrm_stGearNum MoFFrm_stGearNumQlfr MoFFrm_stHvbFltLvl MoFFrm_stHvIntlck MoFIn_flgDrvrDoorOpen MoFTrsmAssc_flgGearLvrDrv MoFTrsmAssc_flgGearLvrNeut MoFTrsmAssc_flgGearLvrPark MoFTrsmAssc_flgGearLvrRe Mo_stCplChk Mo_stMoC Mo_stMoCCpl VehCoorn_flgDrvInhb /end IN_MEASUREMENT
 /begin OUT_MEASUREMENT MoFRelsMngt_flgPtActv MoFRelsMngt_flgPtActvMsg /end OUT_MEASUREMENT
 /begin LOC_MEASUREMENT MoFRelsMngtPtRels_bbLoc1Cpl MoFRelsMngtPtRels_bbLoc2Cpl MoFRelsMngtPtRels_bbLoc3Cpl MoFRelsMngtPtRels_bbOutCpl MoFRelsMngt_flgBrkSt MoFRelsMngt_flgChrgPlgInsCdn MoFRelsMngt_flgCrashEvnt MoFRelsMngt_flgDrvDoorOpenCdn MoFRelsMngt_flgDrvInhbCdn MoFRelsMngt_flgFltBms MoFRelsMngt_flgFltEm MoFRelsMngt_flgGear MoFRelsMngt_flgGearCANErr MoFRelsMngt_flgGearLvrParkCdn MoFRelsMngt_flgGearLvrParkChg MoFRelsMngt_flgGearLvrParkOld MoFRelsMngt_flgGearNumCdn MoFRelsMngt_flgGearNumChg MoFRelsMngt_flgHvIHvbFltCdn MoFRelsMngt_flgHvIntlckSet MoFRelsMngt_flgRelsTrig MoFRelsMngt_flgRstRelsTrig MoFRelsMngt_flgT15Cdn MoFRelsMngt_flgT50RelsCdn MoFRelsMngt_flgVehSpdCondRls MoFRelsMngt_flgVehV MoFRelsMngt_flgVHyst MoFRelsMngt_stGearNumOld MoFRelsMngt_stGearNumOldCpl MoFRelsMngt_stPtAct MoFRelsMngt_stPtActCpl /end LOC_MEASUREMENT
 FUNCTION_VERSION "17.1.0" /end FUNCTION
/begin FUNCTION MoFSrv_Lib "24.9.0    Function Monitoring: Service library" /begin IN_MEASUREMENT Mo_stCplChk Mo_stMoC Mo_stMoCCpl /end IN_MEASUREMENT FUNCTION_VERSION "24.9.0" /end FUNCTION
/begin FUNCTION MoFTqPtdAxleSec_Comp "1.2.0     Function monitoring torque comparison secondary axle level"
 /begin DEF_CHARACTERISTIC DFC_CtlMsk2.DFC_MoFTqPtdAxleSec_C DFC_DisblMsk2.DFC_MoFTqPtdAxleSec_C MoFTqPtdAxleSec_cntrTestComp_C MoFTqPtdAxleSec_cntrTqCompMax_C MoFTqPtdAxleSec_enaOthTrqCompErr_C MoFTqPtdAxleSec_ratTqDifAxleWght_T MoFTqPtdAxleSec_tqNegPtdOffs_M MoFTqPtdAxleSec_tqNegStatyLim_C MoFTqPtdAxleSec_tqPosPtdOffs_M MoFTqPtdAxleSec_tqPosStatyLim_C MoFTqPtdAxleSec_tqTiIntegDec_C MoFTqPtdAxleSec_tqTiIntegErr_C MoFTqPtdAxleSec_tqTiIntegMax_C /end DEF_CHARACTERISTIC
 /begin IN_MEASUREMENT MoFBas_vVeh MoFTqPtdAxleSec_tqSecAxleCoord MoFTqPtdEmSec_stErrTqComp MoFTqPtdVeh_stErrTqComp Mo_stCplChk Mo_stMoC Mo_stMoCCpl VehDrvEv_tqSecAxleDes /end IN_MEASUREMENT
 /begin OUT_MEASUREMENT DFC_st.DFC_MoFTqPtdAxleSec MoFTqPtdAxleSec_flgIrrvErrMsg MoFTqPtdAxleSec_flgTestMsg MoFTqPtdAxleSec_stErrTqComp MoFTqPtdAxleSec_tqDesSecAxle /end OUT_MEASUREMENT
 /begin LOC_MEASUREMENT MoFTqPtdAxleSecComp_bbLoc2Cpl MoFTqPtdAxleSecComp_bbLocCpl MoFTqPtdAxleSec_cntrTestComp MoFTqPtdAxleSec_cntrTqComp MoFTqPtdAxleSec_cntrTqCompCpl MoFTqPtdAxleSec_flgClr MoFTqPtdAxleSec_flgLwrLimExcd MoFTqPtdAxleSec_flgOthTrqCompErr MoFTqPtdAxleSec_flgTqCompDeb MoFTqPtdAxleSec_flgTqCompErr MoFTqPtdAxleSec_flgTqIntegDeb MoFTqPtdAxleSec_flgTqIntegErr MoFTqPtdAxleSec_flgTqLimChkErr MoFTqPtdAxleSec_flgTqSecAxleCoordNeg MoFTqPtdAxleSec_flgUpLimExcd MoFTqPtdAxleSec_stErrTqCompCpl MoFTqPtdAxleSec_tqDesSecAxleCpl MoFTqPtdAxleSec_tqDifAxle MoFTqPtdAxleSec_tqDifAxleCpl MoFTqPtdAxleSec_tqLowrLim MoFTqPtdAxleSec_tqLowrLimCpl MoFTqPtdAxleSec_tqSecAxleCoordLoResl MoFTqPtdAxleSec_tqSecAxleCoordLoReslCpl MoFTqPtdAxleSec_tqTiInteg MoFTqPtdAxleSec_tqTiIntegCpl MoFTqPtdAxleSec_tqUpLim MoFTqPtdAxleSec_tqUpLimCpl /end LOC_MEASUREMENT
 FUNCTION_VERSION "1.2.0" /end FUNCTION
/begin FUNCTION MoFTqPtdAxleSec_Coorn "1.3.0     Function monitoring coordination of secondary axle torque"
 /begin IN_MEASUREMENT MoFTqPtdAxleSec_tqDesSecAxleFil MoFTqPtdAxle_tqBrkDesSecAxle Mo_stCplChk Mo_stMoC Mo_stMoCCpl /end IN_MEASUREMENT
 /begin OUT_MEASUREMENT MoFTqPtdAxleSec_tqSecAxleCoord /end OUT_MEASUREMENT
 /begin LOC_MEASUREMENT MoFTqPtdAxleSec_tqSecAxleCoordCpl /end LOC_MEASUREMENT
 FUNCTION_VERSION "1.3.0" /end FUNCTION
/begin FUNCTION MoFTqPtdAxleSec_Fil "1.4.0     Function monitoring permitted secondary axle torque filter"
 /begin IN_MEASUREMENT MoFTqPtdAxle_tqDesSecAxleNotFil Mo_stCplChk Mo_stMoC Mo_stMoCCpl /end IN_MEASUREMENT
 /begin OUT_MEASUREMENT MoFTqPtdAxleSec_tqDesSecAxleFil /end OUT_MEASUREMENT
 /begin LOC_MEASUREMENT MoFTqPtdAxleSec_tqDesSecAxleFilCpl /end LOC_MEASUREMENT
 FUNCTION_VERSION "1.4.0" /end FUNCTION
/begin FUNCTION MoFTqPtdAxle_Comp "5.2.0     Function monitoring Torque comparison axle level"
 /begin DEF_CHARACTERISTIC DFC_CtlMsk2.DFC_MoFTqPtdAxle_C DFC_DisblMsk2.DFC_MoFTqPtdAxle_C MoFTqPtdAxle_cntrTestComp_C MoFTqPtdAxle_cntrTqCompMax_C MoFTqPtdAxle_enaOthTrqCompErr_C MoFTqPtdAxle_ratTqDifAxleWght_T MoFTqPtdAxle_tqNegPtdOffs_M MoFTqPtdAxle_tqNegStatyLim_C MoFTqPtdAxle_tqPosPtdOffs_M MoFTqPtdAxle_tqPosStatyLim_C MoFTqPtdAxle_tqTiIntegDec_C MoFTqPtdAxle_tqTiIntegErr_C MoFTqPtdAxle_tqTiIntegMax_C /end DEF_CHARACTERISTIC
 /begin IN_MEASUREMENT MoFBas_vVeh MoFTqPtdAxle_tqPrimAxleCoord MoFTqPtdEm_stErrTqComp MoFTqPtdVeh_stErrTqComp Mo_stCplChk Mo_stMoC Mo_stMoCCpl VehDrvEv_tqPrimAxleDes /end IN_MEASUREMENT
 /begin OUT_MEASUREMENT DFC_st.DFC_MoFTqPtdAxle MoFTqPtdAxle_flgIrrvErrMsg MoFTqPtdAxle_flgTestMsg MoFTqPtdAxle_stErrTqComp MoFTqPtdAxle_tqDesPrimAxle /end OUT_MEASUREMENT
 /begin LOC_MEASUREMENT MoFTqPtdAxleComp_bbLoc2Cpl MoFTqPtdAxleComp_bbLocCpl MoFTqPtdAxle_cntrTestComp MoFTqPtdAxle_cntrTqComp MoFTqPtdAxle_cntrTqCompCpl MoFTqPtdAxle_flgClr MoFTqPtdAxle_flgLwrLimExcd MoFTqPtdAxle_flgOthTrqCompErr MoFTqPtdAxle_flgTqCompDeb MoFTqPtdAxle_flgTqCompErr MoFTqPtdAxle_flgTqIntegDeb MoFTqPtdAxle_flgTqIntegErr MoFTqPtdAxle_flgTqLimChkErr MoFTqPtdAxle_flgTqPrimAxleCoordNeg MoFTqPtdAxle_flgUpLimExcd MoFTqPtdAxle_stErrTqCompCpl MoFTqPtdAxle_tqDesPrimAxleCpl MoFTqPtdAxle_tqDifAxle MoFTqPtdAxle_tqDifAxleCpl MoFTqPtdAxle_tqLowrLim MoFTqPtdAxle_tqLowrLimCpl MoFTqPtdAxle_tqPrimAxleCoordLoResl MoFTqPtdAxle_tqPrimAxleCoordLoReslCpl MoFTqPtdAxle_tqTiInteg MoFTqPtdAxle_tqTiIntegCpl MoFTqPtdAxle_tqUpLim MoFTqPtdAxle_tqUpLimCpl /end LOC_MEASUREMENT
 FUNCTION_VERSION "5.2.0" /end FUNCTION
/begin FUNCTION MoFTqPtdAxle_Coorn "4.4.1     Function monitoring Coordination of axle torque"
 /begin DEF_CHARACTERISTIC MoFTqPtdAxle_flgSecAxlePrsnt_C MoFTqPtdAxle_tqPrimNegSlop_C MoFTqPtdAxle_tqPrimPosSlop_C MoFTqPtdAxle_tqRecupMinPrimAxle_C MoFTqPtdAxle_tqRecupMinSecAxle_C MoFTqPtdAxle_tqSecNegSlop_C MoFTqPtdAxle_tqSecPosSlop_C /end DEF_CHARACTERISTIC
 /begin IN_MEASUREMENT BrkTqEv_tqRcptPrimAxle BrkTqEv_tqRcptSecAxle CoPT_tqRecupPotlWhlPrim CoPT_tqRecupPotlWhlSec MoFEvMngt_flgBrkgToZrActvd MoFFrm_tqBrkDesPrimAxle MoFFrm_tqBrkDesPrimAxleQlfr MoFFrm_tqBrkDesSecAxle MoFFrm_tqBrkDesSecAxleQlfr MoFTqPtdAxle_tqDesPrimAxleFil MoFTqPtdVeh_tqRecupOnePedlDrvgMin MoFTqPtdVeh_tqWhlDes MoFTrsmAssc_flgGearLvrNeut MoFTrsmAssc_flgGearLvrPark Mo_stCplChk Mo_stMoC Mo_stMoCCpl /end IN_MEASUREMENT
 /begin OUT_MEASUREMENT MoFTqPtdAxle_flgPrimAxleGearNeutRampActvd MoFTqPtdAxle_flgSecAxleGearNeutRampActvd MoFTqPtdAxle_tqBrkDesSecAxle MoFTqPtdAxle_tqPrimAxleCoord /end OUT_MEASUREMENT
 /begin LOC_MEASUREMENT MoFTqPtdAxleCoorn_bbLoc1Cpl MoFTqPtdAxleCoorn_bbOutCpl MoFTqPtdAxle_dirPrimAxleRamp MoFTqPtdAxle_dirPrimAxleRampCpl MoFTqPtdAxle_dirSecAxleRamp MoFTqPtdAxle_dirSecAxleRampCpl MoFTqPtdAxle_flgPrimGearLvrNeutEdgeRisng MoFTqPtdAxle_flgPrimGearLvrNeutOld MoFTqPtdAxle_flgSecGearLvrNeutEdgeRisng MoFTqPtdAxle_flgSecGearLvrNeutOld MoFTqPtdAxle_tqBrkDesMaxPrimAxle MoFTqPtdAxle_tqBrkDesMaxPrimAxleCpl MoFTqPtdAxle_tqBrkDesMaxSecAxle MoFTqPtdAxle_tqBrkDesMaxSecAxleCpl MoFTqPtdAxle_tqBrkDesPrimAxle MoFTqPtdAxle_tqBrkDesPrimAxleCpl MoFTqPtdAxle_tqBrkDesPrimAxleEval MoFTqPtdAxle_tqBrkDesPrimAxleEvalCpl MoFTqPtdAxle_tqBrkDesPrimAxleLim MoFTqPtdAxle_tqBrkDesPrimAxleLimCpl MoFTqPtdAxle_tqBrkDesSecAxleCpl MoFTqPtdAxle_tqBrkDesSecAxleEval MoFTqPtdAxle_tqBrkDesSecAxleEvalCpl MoFTqPtdAxle_tqBrkDesSecAxleLim MoFTqPtdAxle_tqBrkDesSecAxleLimCpl MoFTqPtdAxle_tqBrkTqEvRcptPrimAxleLvl1 MoFTqPtdAxle_tqBrkTqEvRcptPrimAxleLvl1Cpl MoFTqPtdAxle_tqBrkTqEvRcptSecAxleLvl1 MoFTqPtdAxle_tqBrkTqEvRcptSecAxleLvl1Cpl MoFTqPtdAxle_tqCrbsRecupMinAllwd MoFTqPtdAxle_tqCrbsRecupMinAllwdCpl MoFTqPtdAxle_tqPrimAxleCoordCpl MoFTqPtdAxle_tqPrimAxleGearNeutRampLimd MoFTqPtdAxle_tqPrimAxleGearNeutRampLimdCpl MoFTqPtdAxle_tqPrimAxleGearNeutRampOutLimd MoFTqPtdAxle_tqPrimAxleGearNeutRampOutLimdCpl MoFTqPtdAxle_tqPrimBrkgToZr MoFTqPtdAxle_tqPrimBrkgToZrCpl MoFTqPtdAxle_tqRecupPrimAxleLimd MoFTqPtdAxle_tqRecupPrimAxleLimdCpl MoFTqPtdAxle_tqRecupSecAxleLimd MoFTqPtdAxle_tqRecupSecAxleLimdCpl MoFTqPtdAxle_tqSecAxleGearNeutRampLimd MoFTqPtdAxle_tqSecAxleGearNeutRampLimdCpl MoFTqPtdAxle_tqSecAxleGearNeutRampOutLimd MoFTqPtdAxle_tqSecAxleGearNeutRampOutLimdCpl MoFTqPtdAxle_tqVcuIntRecup MoFTqPtdAxle_tqVcuIntRecupCpl /end LOC_MEASUREMENT
 FUNCTION_VERSION "4.4.1" /end FUNCTION
/begin FUNCTION MoFTqPtdAxle_Distbn "3.3.0     Function monitoring Axle torque distribution"
 /begin DEF_CHARACTERISTIC MoFTqPtdAxle_facDistbnRampStepMaxNeg_M MoFTqPtdAxle_facDistbnRampStepMaxPos_M MoFTqPtdAxle_facTqDistbnIni_C MoFTqPtdAxle_facTqDistbnMax_C MoFTqPtdAxle_facTqDistbnMin_C MoFTqPtdAxle_facTqDistbnRecup_C MoFTqPtdAxle_swtTwoSpdAxl_C MoFTqPtdAxle_vVehThd_C /end DEF_CHARACTERISTIC
 /begin IN_MEASUREMENT BrkgToZr_flgPredActvn CoPOM_ratTqDistbn MoFBas_vVeh MoFTqPtdVeh_tqWhlDes Mo_stCplChk Mo_stMoC Mo_stMoCCpl /end IN_MEASUREMENT
 /begin OUT_MEASUREMENT MoFTqPtdAxle_facTqDistbn MoFTqPtdAxle_tqDesPrimAxleNotFil MoFTqPtdAxle_tqDesSecAxleNotFil /end OUT_MEASUREMENT
 /begin LOC_MEASUREMENT MoFTqPtdAxle_facTqDistbnCpl MoFTqPtdAxle_facTqDistbnMin MoFTqPtdAxle_facTqDistbnMinCpl MoFTqPtdAxle_facTqNoRecupDistbn MoFTqPtdAxle_facTqNoRecupDistbnCpl MoFTqPtdAxle_tqDesPrimAxleNotFilCpl MoFTqPtdAxle_tqDesSecAxleNotFilCpl MoFTqPtdAxle_tqWhlDesLoResl MoFTqPtdAxle_tqWhlDesLoReslCpl /end LOC_MEASUREMENT
 FUNCTION_VERSION "3.3.0" /end FUNCTION
/begin FUNCTION MoFTqPtdAxle_Fil "4.3.0     Function monitoring Permitted axle torque filter"
 /begin IN_MEASUREMENT MoFTqPtdAxle_tqDesPrimAxleNotFil Mo_stCplChk Mo_stMoC Mo_stMoCCpl /end IN_MEASUREMENT
 /begin OUT_MEASUREMENT MoFTqPtdAxle_tqDesPrimAxleFil /end OUT_MEASUREMENT
 /begin LOC_MEASUREMENT MoFTqPtdAxle_tqDesPrimAxleFilCpl /end LOC_MEASUREMENT
 FUNCTION_VERSION "4.3.0" /end FUNCTION
/begin FUNCTION MoFTqPtdEmSec_Comp "1.5.1     Function monitoring torque comparison on electrical machine level secondary axle"
 /begin DEF_CHARACTERISTIC DFC_CtlMsk2.DFC_MoFTqPtdEmPtRelsSec_C DFC_CtlMsk2.DFC_MoFTqPtdEmSignSec_C DFC_CtlMsk2.DFC_MoFTqPtdEmTqSec_C DFC_DisblMsk2.DFC_MoFTqPtdEmPtRelsSec_C DFC_DisblMsk2.DFC_MoFTqPtdEmSignSec_C DFC_DisblMsk2.DFC_MoFTqPtdEmTqSec_C MoFTqPtdEmSec_cntrErrTqSignMax_C MoFTqPtdEmSec_cntrPtRelsErrMax_C MoFTqPtdEmSec_cntrTestPtRels_C MoFTqPtdEmSec_cntrTestSign_C MoFTqPtdEmSec_cntrTestTq_C MoFTqPtdEmSec_cntrTqCompMax_C MoFTqPtdEmSec_cntrWrgGearSeldMax_C MoFTqPtdEmSec_enaOthTrqCompErr_C MoFTqPtdEmSec_ratTqDifEmWght_T MoFTqPtdEmSec_tqNegPtdOffs_M MoFTqPtdEmSec_tqNegStatyLim_C MoFTqPtdEmSec_tqPosPtdOffs_M MoFTqPtdEmSec_tqPosStatyLim_C MoFTqPtdEmSec_tqPtActvDetdNeut_T MoFTqPtdEmSec_tqPtActvDetd_C MoFTqPtdEmSec_tqQdrLockErrMax_C MoFTqPtdEmSec_tqQdrLockErrMin_C MoFTqPtdEmSec_tqRecuLimnMax_C MoFTqPtdEmSec_tqRecuLimnMin_C MoFTqPtdEmSec_tqTiIntegDec_C MoFTqPtdEmSec_tqTiIntegErr_C MoFTqPtdEmSec_tqTiIntegMax_C /end DEF_CHARACTERISTIC
 /begin REF_CHARACTERISTIC MoFErrHndlg_stCfgErrHndlgPtRels_C /end REF_CHARACTERISTIC
 /begin IN_MEASUREMENT Emac_tqDesCom02 MoFBas_vVeh MoFBas_vVehSignd MoFDrvrAssc_flgNeutRampActv MoFRelsMngt_flgPtActv MoFTqPtdAxleSec_stErrTqComp MoFTqPtdAxle_flgSecAxleGearNeutRampActvd MoFTqPtdEmSec_flgEm02Qdr1Lock MoFTqPtdEmSec_flgEm02Qdr3Lock MoFTqPtdEmSec_tqTranEm02 MoFTqPtdVeh_flgOnePedlDrvgNeutRampActv MoFTqPtdVeh_stErrTqComp MoFTrsmAssc_flgGearLvrDrv MoFTrsmAssc_flgGearLvrNeut MoFTrsmAssc_flgGearLvrRe Mo_stCplChk Mo_stMoC Mo_stMoCCpl /end IN_MEASUREMENT
 /begin OUT_MEASUREMENT DFC_st.DFC_MoFTqPtdEmPtRelsSec DFC_st.DFC_MoFTqPtdEmSignSec DFC_st.DFC_MoFTqPtdEmTqSec MoFTqPtdEmSec_flgIrrvPtRelsErrMsg MoFTqPtdEmSec_flgIrrvSignErrMsg MoFTqPtdEmSec_flgIrrvTqErrMsg MoFTqPtdEmSec_flgTestMsg MoFTqPtdEmSec_stErrPtRels MoFTqPtdEmSec_stErrSignComp MoFTqPtdEmSec_stErrTqComp MoFTqPtdEmSec_tqDesEm02 /end OUT_MEASUREMENT
 /begin LOC_MEASUREMENT MoFTqPtdEmSecComp_bbLoc1Cpl MoFTqPtdEmSecComp_bbLoc2Cpl MoFTqPtdEmSec_cntrErrTqSign MoFTqPtdEmSec_cntrErrTqSignCpl MoFTqPtdEmSec_cntrPtRelsErr MoFTqPtdEmSec_cntrPtRelsErrCpl MoFTqPtdEmSec_cntrTestPtRels MoFTqPtdEmSec_cntrTestSign MoFTqPtdEmSec_cntrTestTq MoFTqPtdEmSec_cntrTqComp MoFTqPtdEmSec_cntrTqCompCpl MoFTqPtdEmSec_cntrWrgGearSeld MoFTqPtdEmSec_cntrWrgGearSeldCpl MoFTqPtdEmSec_flgClrPtRels MoFTqPtdEmSec_flgClrSign MoFTqPtdEmSec_flgClrTq MoFTqPtdEmSec_flgLwrLimExcd MoFTqPtdEmSec_flgOthTrqCompErr MoFTqPtdEmSec_flgPtActvErr MoFTqPtdEmSec_flgQdrMapDeb MoFTqPtdEmSec_flgQdrMapErr MoFTqPtdEmSec_flgTqCompDeb MoFTqPtdEmSec_flgTqCompErr MoFTqPtdEmSec_flgTqIntegDeb MoFTqPtdEmSec_flgTqIntegErr MoFTqPtdEmSec_flgTqLimChkErr MoFTqPtdEmSec_flgTqTranEm02Neg MoFTqPtdEmSec_flgUpLimExcd MoFTqPtdEmSec_flgWrgGearPtActv MoFTqPtdEmSec_flgWrgGearSeld MoFTqPtdEmSec_flgWrgGearSeldDeb MoFTqPtdEmSec_flgWrgGearSeldErr MoFTqPtdEmSec_stErrPtRelsCpl MoFTqPtdEmSec_stErrSignCompCpl MoFTqPtdEmSec_stErrTqCompCpl MoFTqPtdEmSec_tqDesEm02Cpl MoFTqPtdEmSec_tqDesEm02PreVal MoFTqPtdEmSec_tqDesEm02PreValCpl MoFTqPtdEmSec_tqDesEm02UpLimd MoFTqPtdEmSec_tqDesEm02UpLimdCpl MoFTqPtdEmSec_tqDifEm MoFTqPtdEmSec_tqDifEmCpl MoFTqPtdEmSec_tqLowrLim MoFTqPtdEmSec_tqLowrLimCpl MoFTqPtdEmSec_tqTiInteg MoFTqPtdEmSec_tqTiIntegCpl MoFTqPtdEmSec_tqUpLim MoFTqPtdEmSec_tqUpLimCpl /end LOC_MEASUREMENT
 FUNCTION_VERSION "1.5.1" /end FUNCTION
/begin FUNCTION MoFTqPtdEmSec_Coorn "1.1.0     Function monitoring coordination torque electrical machine secondary axle"
 /begin IN_MEASUREMENT MoFEscAssc_tqEscDCS02 MoFEscAssc_tqEscTCS02 MoFPtSt_ratSecPT MoFTqPtdEmSec_tqDesWhl02 MoFTqPtdEmSec_tqLoss MoFTrsmAssc_tqTrsmDecIntv02 MoFTrsmAssc_tqTrsmIncIntv02 Mo_stCplChk Mo_stMoC Mo_stMoCCpl /end IN_MEASUREMENT
 /begin OUT_MEASUREMENT MoFTqPtdEmSec_tqDesCoornEm02 /end OUT_MEASUREMENT
 /begin LOC_MEASUREMENT MoFTqPtdEmSec_tqDesCoornEm02Cpl MoFTqPtdEmSec_tqDesWithEscWhl02 MoFTqPtdEmSec_tqDesWithEscWhl02Cpl /end LOC_MEASUREMENT
 FUNCTION_VERSION "1.1.0" /end FUNCTION
/begin FUNCTION MoFTqPtdEmSec_Loss "1.1.0     Function monitoring torque losses secondary axle" /begin DEF_CHARACTERISTIC MoFTqPtdEmSec_tqLoss_C /end DEF_CHARACTERISTIC /begin IN_MEASUREMENT Mo_stCplChk Mo_stMoC Mo_stMoCCpl /end IN_MEASUREMENT /begin OUT_MEASUREMENT MoFTqPtdEmSec_tqLoss /end OUT_MEASUREMENT /begin LOC_MEASUREMENT MoFTqPtdEmSec_tqLossCpl /end LOC_MEASUREMENT FUNCTION_VERSION "1.1.0" /end FUNCTION
/begin FUNCTION MoFTqPtdEmSec_Tran "1.1.0     Function monitoring quadrant selection secondary axle"
 /begin DEF_CHARACTERISTIC MoFTqPtdEmSec_nChgGearMaxEm02_C MoFTqPtdEmSec_nChgGearMinEm02_C MoFTqPtdEmSec_swtShftFilOffEm02_C MoFTqPtdEmSec_tTnEm02_C /end DEF_CHARACTERISTIC
 /begin IN_MEASUREMENT MoFEvMngt_nEmPhy02 MoFTqPtdEmSec_tqDesCoornEm02 MoFTrsmAssc_flgGearLvrDrv MoFTrsmAssc_flgGearLvrRe Mo_stCplChk Mo_stMoC Mo_stMoCCpl /end IN_MEASUREMENT
 /begin OUT_MEASUREMENT MoFTqPtdEmSec_flgEm02Qdr1Lock MoFTqPtdEmSec_flgEm02Qdr3Lock MoFTqPtdEmSec_stSignChgTranEm02 MoFTqPtdEmSec_tqTranEm02 /end OUT_MEASUREMENT
 /begin LOC_MEASUREMENT MoFTqPtdEmSecTran_bbOutCpl MoFTqPtdEmSec_stSignChgTranEm02Cpl MoFTqPtdEmSec_tqTranEm02Cpl /end LOC_MEASUREMENT
 FUNCTION_VERSION "1.1.0" /end FUNCTION
/begin FUNCTION MoFTqPtdEmSec_WhlDistbn "1.1.0     Function monitoring wheel torque distribution secondary axle"
 /begin IN_MEASUREMENT MoFTqPtdAxleSec_tqDesSecAxle Mo_stCplChk Mo_stMoC Mo_stMoCCpl /end IN_MEASUREMENT
 /begin OUT_MEASUREMENT MoFTqPtdEmSec_tqDesWhl02 /end OUT_MEASUREMENT
 /begin LOC_MEASUREMENT MoFTqPtdEmSec_tqDesWhl02Cpl /end LOC_MEASUREMENT
 FUNCTION_VERSION "1.1.0" /end FUNCTION
/begin FUNCTION MoFTqPtdEm_Comp "5.6.1     Function monitoring Torque comparison EM level"
 /begin DEF_CHARACTERISTIC DFC_CtlMsk2.DFC_MoFTqPtdEmPtRels_C DFC_CtlMsk2.DFC_MoFTqPtdEmSign_C DFC_CtlMsk2.DFC_MoFTqPtdEmTq_C DFC_DisblMsk2.DFC_MoFTqPtdEmPtRels_C DFC_DisblMsk2.DFC_MoFTqPtdEmSign_C DFC_DisblMsk2.DFC_MoFTqPtdEmTq_C MoFTqPtdEm_cntrErrTqSignMax_C MoFTqPtdEm_cntrPtRelsErrMax_C MoFTqPtdEm_cntrQdrLockToutErr_C MoFTqPtdEm_cntrTestPtRels_C MoFTqPtdEm_cntrTestSign_C MoFTqPtdEm_cntrTestTq_C MoFTqPtdEm_cntrTmr1Elpd_C MoFTqPtdEm_cntrTmr2Elpd_C MoFTqPtdEm_cntrTmr3Elpd_C MoFTqPtdEm_cntrTqCompMax_C MoFTqPtdEm_enaOthTrqCompErr_C MoFTqPtdEm_ratTqDifEmWght_T MoFTqPtdEm_stSpdDemMod_C MoFTqPtdEm_swtDeactvtTmr_C MoFTqPtdEm_tqNegPtdOffs_M MoFTqPtdEm_tqNegStatyLim_C MoFTqPtdEm_tqPosPtdOffs_M MoFTqPtdEm_tqPosStatyLim_C MoFTqPtdEm_tqPtActvDetd_C MoFTqPtdEm_tqQdrLockErrMax_C MoFTqPtdEm_tqQdrLockErrMax_T MoFTqPtdEm_tqQdrLockErrMin_C MoFTqPtdEm_tqQdrLockErrMin_T MoFTqPtdEm_tqRecuLimnMax_C MoFTqPtdEm_tqRecuLimnMin_C MoFTqPtdEm_tqThdLim1_C MoFTqPtdEm_tqTiIntegDec_C MoFTqPtdEm_tqTiIntegErr_C MoFTqPtdEm_tqTiIntegMax_C /end DEF_CHARACTERISTIC
 /begin REF_CHARACTERISTIC MoFErrHndlg_stCfgErrHndlgPtRels_C /end REF_CHARACTERISTIC
 /begin IN_MEASUREMENT Emac_tqDesCom01 MoFBas_vVeh MoFEvMngt_nEmPhy01 MoFEvMngt_stDesEem01 MoFRelsMngt_flgPtActv MoFTqPtdAxle_flgPrimAxleGearNeutRampActvd MoFTqPtdAxle_stErrTqComp MoFTqPtdEm_flgEm01Qdr1Lock MoFTqPtdEm_flgEm01Qdr3Lock MoFTqPtdEm_tqTranEm01 MoFTqPtdVeh_stErrTqComp MoFTqPtdVeh_tqWhlCoord MoFTrsmAssc_flgGearLvrDrv MoFTrsmAssc_flgGearLvrNeut MoFTrsmAssc_flgGearLvrPark MoFTrsmAssc_flgGearLvrRe MoFTrsmAssc_flgGearNrErr Mo_stCplChk Mo_stMoC Mo_stMoCCpl /end IN_MEASUREMENT
 /begin OUT_MEASUREMENT DFC_st.DFC_MoFTqPtdEmPtRels DFC_st.DFC_MoFTqPtdEmSign DFC_st.DFC_MoFTqPtdEmTq MoFTqPtdEm_flgIrrvPtRelsErrMsg MoFTqPtdEm_flgIrrvSignErrMsg MoFTqPtdEm_flgIrrvTqErrMsg MoFTqPtdEm_flgQdrLockRampPtdMsg MoFTqPtdEm_flgTestMsg MoFTqPtdEm_stErrPtRels MoFTqPtdEm_stErrSignComp MoFTqPtdEm_stErrTqComp MoFTqPtdEm_tqDesEm01 /end OUT_MEASUREMENT
 /begin LOC_MEASUREMENT MoFTqPtdEmComp_bbLoc1Cpl MoFTqPtdEmComp_bbLoc2Cpl MoFTqPtdEmComp_bbLoc3Cpl MoFTqPtdEm_cntrErrTqSign MoFTqPtdEm_cntrErrTqSignCpl MoFTqPtdEm_cntrPtRelsErr MoFTqPtdEm_cntrPtRelsErrCpl MoFTqPtdEm_cntrQdrLockToutErr MoFTqPtdEm_cntrQdrLockToutErrCpl MoFTqPtdEm_cntrTestPtRels MoFTqPtdEm_cntrTestSign MoFTqPtdEm_cntrTestTq MoFTqPtdEm_cntrTmr1Elpd MoFTqPtdEm_cntrTmr1ElpdCpl MoFTqPtdEm_cntrTmr2Elpd MoFTqPtdEm_cntrTmr2ElpdCpl MoFTqPtdEm_cntrTmr3Elpd MoFTqPtdEm_cntrTmr3ElpdCpl MoFTqPtdEm_cntrTqComp MoFTqPtdEm_cntrTqCompCpl MoFTqPtdEm_flgClrPtRels MoFTqPtdEm_flgClrSign MoFTqPtdEm_flgClrTq MoFTqPtdEm_flgLwrLimExcd MoFTqPtdEm_flgOthTrqCompErr MoFTqPtdEm_flgPtActvErr MoFTqPtdEm_flgQdrLockTempErr MoFTqPtdEm_flgQdrLockTout MoFTqPtdEm_flgQdrLockToutErr MoFTqPtdEm_flgQdrMapDeb MoFTqPtdEm_flgQdrMapErr MoFTqPtdEm_flgTmr1Elpd MoFTqPtdEm_flgTmr2Elpd MoFTqPtdEm_flgTmr3Elpd MoFTqPtdEm_flgTqCompDeb MoFTqPtdEm_flgTqCompErr MoFTqPtdEm_flgTqIntegDeb MoFTqPtdEm_flgTqIntegErr MoFTqPtdEm_flgTqLimChkErr MoFTqPtdEm_flgTqNotPtd MoFTqPtdEm_flgTqTranEm01Neg MoFTqPtdEm_flgUpLimExcd MoFTqPtdEm_flgWrgGearPtActv MoFTqPtdEm_stErrPtRelsCpl MoFTqPtdEm_stErrSignCompCpl MoFTqPtdEm_stErrTqCompCpl MoFTqPtdEm_stRSFFGearChng MoFTqPtdEm_stRSFFGearChngCpl MoFTqPtdEm_tqDesEm01Cpl MoFTqPtdEm_tqDesEm01PreVal MoFTqPtdEm_tqDesEm01PreValCpl MoFTqPtdEm_tqDesEm01UpLimd MoFTqPtdEm_tqDesEm01UpLimdCpl MoFTqPtdEm_tqDifEm MoFTqPtdEm_tqDifEmCpl MoFTqPtdEm_tqLowrLim MoFTqPtdEm_tqLowrLimCpl MoFTqPtdEm_tqTiInteg MoFTqPtdEm_tqTiIntegCpl MoFTqPtdEm_tqUpLim MoFTqPtdEm_tqUpLimCpl /end LOC_MEASUREMENT
 FUNCTION_VERSION "5.6.1" /end FUNCTION
/begin FUNCTION MoFTqPtdEm_Coorn "5.1.0     Function monitoring Coordination EM-torque"
 /begin DEF_CHARACTERISTIC MoFTqPtdEm_flgPrpInhb01Dft_C MoFTqPtdEm_flgRecupInhb01Dft_C MoFTqPtdEm_tqPrpHiMax_C MoFTqPtdEm_tqPrpHiMin_C MoFTqPtdEm_tqPrpHiZr_C MoFTqPtdEm_tqStepDwnPropInhb_C MoFTqPtdEm_tqStepDwnRecupInhb_C MoFTqPtdEm_tqStepUpPropInhb_C MoFTqPtdEm_tqStepUpRecupInhb_C /end DEF_CHARACTERISTIC
 /begin IN_MEASUREMENT MoFEscAssc_tqEscDCS01 MoFEscAssc_tqEscTCS01 MoFFrm_flgPrpInhb01 MoFFrm_flgRecupInhb01 MoFFrm_stPrpInhb01Qlfr MoFFrm_stRecupInhb01Qlfr MoFPtdEm_tqLoss MoFPtSt_ratPT MoFTqPtdEm_tqDesWhl01 MoFTrsmAssc_tqTrsmDecIntv01 MoFTrsmAssc_tqTrsmIncIntv01 Mo_stCplChk Mo_stMoC Mo_stMoCCpl VMSIEv_tqDesPrpInhb01 VMSIEv_tqDesRecupInhb01 /end IN_MEASUREMENT
 /begin OUT_MEASUREMENT MoFTqPtdEm_tqDesCoornEm01 /end OUT_MEASUREMENT
 /begin LOC_MEASUREMENT MoFTqPtdEmCoorn_bbLoc1Cpl MoFTqPtdEm_flgPrpInhb01 MoFTqPtdEm_flgRecupInhb01 MoFTqPtdEm_tqDesCoornEm01Cpl MoFTqPtdEm_tqDesCoornEm01Old MoFTqPtdEm_tqDesCoornEm01OldCpl MoFTqPtdEm_tqDesLvl1PrpInhb01 MoFTqPtdEm_tqDesLvl1PrpInhb01Cpl MoFTqPtdEm_tqDesLvl1RecupInhb01 MoFTqPtdEm_tqDesLvl1RecupInhb01Cpl MoFTqPtdEm_tqDesWithAllIntv01 MoFTqPtdEm_tqDesWithAllIntv01Cpl MoFTqPtdEm_tqDesWithEscWhl01 MoFTqPtdEm_tqDesWithEscWhl01Cpl MoFTqPtdEm_tqDesWithInhbWhl01 MoFTqPtdEm_tqDesWithInhbWhl01Cpl MoFTqPtdEm_tqPrpInhb01 MoFTqPtdEm_tqPrpInhb01Cpl MoFTqPtdEm_tqPrpInhb01Old MoFTqPtdEm_tqPrpInhb01OldCpl MoFTqPtdEm_tqRecupInhb01 MoFTqPtdEm_tqRecupInhb01Cpl MoFTqPtdEm_tqRecupInhb01Old MoFTqPtdEm_tqRecupInhb01OldCpl /end LOC_MEASUREMENT
 FUNCTION_VERSION "5.1.0" /end FUNCTION
/begin FUNCTION MoFTqPtdEm_Loss "3.0.0     Function monitoring Torque losses" /begin DEF_CHARACTERISTIC MoFPtdEm_tqLoss_C /end DEF_CHARACTERISTIC /begin IN_MEASUREMENT Mo_stCplChk Mo_stMoC Mo_stMoCCpl /end IN_MEASUREMENT /begin OUT_MEASUREMENT MoFPtdEm_tqLoss /end OUT_MEASUREMENT /begin LOC_MEASUREMENT MoFPtdEm_tqLossCpl /end LOC_MEASUREMENT FUNCTION_VERSION "3.0.0" /end FUNCTION
/begin FUNCTION MoFTqPtdEm_Tran "11.0.0    Function monitoring Quadrant selection"
 /begin DEF_CHARACTERISTIC MoFTqPtdEm_flgMeclRvsGearPrsntEm01_C MoFTqPtdEm_flgSignChgRvsGearEm01_C MoFTqPtdEm_nChgGearMaxEm01_C MoFTqPtdEm_nChgGearMinEm01_C MoFTqPtdEm_swtShftFilOffEm01_C MoFTqPtdEm_tTnEm01_C /end DEF_CHARACTERISTIC
 /begin REF_CHARACTERISTIC MoFTrsmAssc_ctRst_C /end REF_CHARACTERISTIC
 /begin IN_MEASUREMENT MoFEvMngt_nEmPhy01 MoFTqPtdEm_tqDesCoornEm01 MoFTrsmAssc_flgGearLvrDrv MoFTrsmAssc_flgGearLvrRe Mo_stCplChk Mo_stMoC Mo_stMoCCpl Reset_Env_ctRst /end IN_MEASUREMENT
 /begin OUT_MEASUREMENT MoFTqPtdEm_flgEm01Qdr1Lock MoFTqPtdEm_flgEm01Qdr3Lock MoFTqPtdEm_stSignChgTranEm01 MoFTqPtdEm_tqTranEm01 /end OUT_MEASUREMENT
 /begin LOC_MEASUREMENT MoFTqPtdEmTran_bbOutCpl MoFTqPtdEm_stSignChgTranEm01Cpl MoFTqPtdEm_tqTranEm01Cpl MoFTqPtdEm_Tran_Cls_Em01Cpl_I.MoFTqPtdEm_facShftCpl MoFTqPtdEm_Tran_Cls_Em01Cpl_I.MoFTqPtdEm_facShftCalcCpl MoFTqPtdEm_Tran_Cls_Em01Cpl_I.MoFTqPtdEm_facShftFltCpl MoFTqPtdEm_Tran_Cls_Em01Cpl_I.MoFTqPtdEm_facShftFltLowCpl MoFTqPtdEm_Tran_Cls_Em01Cpl_I.MoFTqPtdEm_nEmPhySignCpl MoFTqPtdEm_Tran_Cls_Em01Cpl_I.MoFTqPtdEm_stChgGearNCpl MoFTqPtdEm_Tran_Cls_Em01Cpl_I.MoFTqPtdEm_stDirChgCpl MoFTqPtdEm_Tran_Cls_Em01Cpl_I.MoFTqPtdEm_stGearChngCpl MoFTqPtdEm_Tran_Cls_Em01Cpl_I.MoFTqPtdEm_stGearChngOldCpl MoFTqPtdEm_Tran_Cls_Em01Cpl_I.MoFTqPtdEm_stQdrLockCpl MoFTqPtdEm_Tran_Cls_Em01Cpl_I.MoFTqPtdEm_stQdrLockTmpCpl MoFTqPtdEm_Tran_Cls_Em01Cpl_I.MoFTqPtdEm_stRSFFGearCpl MoFTqPtdEm_Tran_Cls_Em01Cpl_I.MoFTqPtdEm_stSignChgTranCpl MoFTqPtdEm_Tran_Cls_Em01Cpl_I.MoFTqPtdEm_tqCoornTranEmCpl MoFTqPtdEm_Tran_Cls_Em01Cpl_I.MoFTqPtdEm_tqTranEmCpl MoFTqPtdEm_Tran_Cls_Em01_I.MoFTqPtdEm_facShft MoFTqPtdEm_Tran_Cls_Em01_I.MoFTqPtdEm_facShftCalc MoFTqPtdEm_Tran_Cls_Em01_I.MoFTqPtdEm_facShftFlt MoFTqPtdEm_Tran_Cls_Em01_I.MoFTqPtdEm_facShftFltLow MoFTqPtdEm_Tran_Cls_Em01_I.MoFTqPtdEm_nEmPhySign MoFTqPtdEm_Tran_Cls_Em01_I.MoFTqPtdEm_stChgGearN MoFTqPtdEm_Tran_Cls_Em01_I.MoFTqPtdEm_stDirChg MoFTqPtdEm_Tran_Cls_Em01_I.MoFTqPtdEm_stGearChng MoFTqPtdEm_Tran_Cls_Em01_I.MoFTqPtdEm_stGearChngOld MoFTqPtdEm_Tran_Cls_Em01_I.MoFTqPtdEm_stQdrLock MoFTqPtdEm_Tran_Cls_Em01_I.MoFTqPtdEm_stQdrLockTmp MoFTqPtdEm_Tran_Cls_Em01_I.MoFTqPtdEm_stRSFFGear MoFTqPtdEm_Tran_Cls_Em01_I.MoFTqPtdEm_stSignChgTran MoFTqPtdEm_Tran_Cls_Em01_I.MoFTqPtdEm_tqCoornTranEm MoFTqPtdEm_Tran_Cls_Em01_I.MoFTqPtdEm_tqTranEm /end LOC_MEASUREMENT
 FUNCTION_VERSION "11.0.0" /end FUNCTION
/begin FUNCTION MoFTqPtdEm_WhlDistbn "4.0.0     Function monitoring Wheel torque distribution"
 /begin IN_MEASUREMENT MoFTqPtdAxle_tqDesPrimAxle Mo_stCplChk Mo_stMoC Mo_stMoCCpl /end IN_MEASUREMENT
 /begin OUT_MEASUREMENT MoFTqPtdEm_tqDesWhl01 /end OUT_MEASUREMENT
 /begin LOC_MEASUREMENT MoFTqPtdEm_tqDesWhl01Cpl /end LOC_MEASUREMENT
 FUNCTION_VERSION "4.0.0" /end FUNCTION
/begin FUNCTION MoFTqPtdOut_Limn "4.3.0     Function monitoring Limitation EM torque"
 /begin DEF_CHARACTERISTIC MoFTqPtdOut_stCfgSwtEnaInvEm01_C MoFTqPtdOut_stCfgSwtEnaInvEm02_C MoFTqPtdOut_tqLimpHomeLowrLimnEm01Rev_M MoFTqPtdOut_tqLimpHomeLowrLimnEm01_M MoFTqPtdOut_tqLimpHomeLowrLimnEm02Rev_M MoFTqPtdOut_tqLimpHomeLowrLimnEm02_M MoFTqPtdOut_tqLimpHomeUpprLimnEm01Rev_M MoFTqPtdOut_tqLimpHomeUpprLimnEm01_M MoFTqPtdOut_tqLimpHomeUpprLimnEm02Rev_M MoFTqPtdOut_tqLimpHomeUpprLimnEm02_M MoFTqPtdOut_tqMaxLim_C /end DEF_CHARACTERISTIC
 /begin IN_MEASUREMENT MoFAccr_ratAccr MoFBas_vVehSignd MoFErrHndlg_stErrReactn MoFPtSt_ratPT MoFTqPtdEmSec_tqDesEm02 MoFTqPtdEm_tqDesEm01 MoFTqPtdVeh_tqRecupOnePedlDrvgMin MoFTrsmAssc_flgGearLvrNeut MoFTrsmAssc_flgGearLvrPark MoFTrsmAssc_flgGearLvrRe Mo_stCplChk Mo_stMoC Mo_stMoCCpl /end IN_MEASUREMENT
 /begin OUT_MEASUREMENT MoFTqPtdOut_tqLimnEm01 MoFTqPtdOut_tqLimnEm02 MoFTqPtdOut_tqMaxAllwdMsg MoFTqPtdOut_tqMinAllwdMsg /end OUT_MEASUREMENT
 /begin LOC_MEASUREMENT MoFTqPtdOut_tqLimnEm01Cpl MoFTqPtdOut_tqLimnEm02Cpl MoFTqPtdOut_tqLimpHomeLowrLimn MoFTqPtdOut_tqLimpHomeLowrLimnCpl MoFTqPtdOut_tqLimpHomeLowrLimnEm01 MoFTqPtdOut_tqLimpHomeLowrLimnEm01Cpl MoFTqPtdOut_tqLimpHomeLowrLimnEm02 MoFTqPtdOut_tqLimpHomeLowrLimnEm02Cpl MoFTqPtdOut_tqLimpHomeUpprLimn MoFTqPtdOut_tqLimpHomeUpprLimnCpl MoFTqPtdOut_tqLimpHomeUpprLimnEm01 MoFTqPtdOut_tqLimpHomeUpprLimnEm01Cpl MoFTqPtdOut_tqLimpHomeUpprLimnEm02 MoFTqPtdOut_tqLimpHomeUpprLimnEm02Cpl MoFTqPtdOut_tqLimpHomeVehLowrLimn MoFTqPtdOut_tqLimpHomeVehLowrLimnCpl MoFTqPtdOut_tqLimpHomeVehUpprLimn MoFTqPtdOut_tqLimpHomeVehUpprLimnCpl /end LOC_MEASUREMENT
 FUNCTION_VERSION "4.3.0" /end FUNCTION
/begin COMPU_METHOD B_TRUE "" TAB_VERB "%6.3" "" COMPU_TAB_REF B_TRUE /end COMPU_METHOD
/begin COMPU_VTAB B_TRUE "" TAB_VERB 2 0 "FALSE" 1 "TRUE" /end COMPU_VTAB
/begin COMPU_METHOD DFC_OneToOne "" RAT_FUNC "%6.2" "-" COEFFS 0 1 0 0 0 1 /end COMPU_METHOD
/begin COMPU_METHOD DFES_OneToOne "" RAT_FUNC "%6.2" "-" COEFFS 0 1 0 0 0 1 /end COMPU_METHOD
/begin COMPU_METHOD FactLow "" RAT_FUNC "%6.5" "-" COEFFS 0 1024 0 0 0 1 /end COMPU_METHOD
/begin COMPU_METHOD fak_q0p01 "" RAT_FUNC "%6.4" "" COEFFS 0 100 0 0 0 1 /end COMPU_METHOD
/begin COMPU_METHOD fak_q1p22Em4 "" RAT_FUNC "%6.5" "-" COEFFS 0 8192 0 0 0 1 /end COMPU_METHOD
/begin COMPU_METHOD mdt_q0p001_Nm_s "" RAT_FUNC "%6.5" "Nm*s" COEFFS 0 1000 0 0 0 1 /end COMPU_METHOD
/begin COMPU_METHOD mdt_q0p1_Nm_DIV_s "" RAT_FUNC "%6.3" "Nm/s" COEFFS 0 10 0 0 0 1 /end COMPU_METHOD
/begin COMPU_METHOD nmot_q1 "" RAT_FUNC "%6.2" "1/min" COEFFS 0 1 0 0 0 1 /end COMPU_METHOD
/begin COMPU_METHOD OneToOne "" RAT_FUNC "%6.2" "-" COEFFS 0 1 0 0 0 1 /end COMPU_METHOD
/begin COMPU_METHOD Prc "" RAT_FUNC "%6.4" "%" COEFFS 0 81.92 0 0 0 1 /end COMPU_METHOD
/begin COMPU_METHOD PreshPa_FnReso "" RAT_FUNC "%6.3" "hPa" COEFFS 0 10 0 0 0 1 /end COMPU_METHOD
/begin COMPU_METHOD PreshPa_HiRes "" RAT_FUNC "%6.4" "hPa" COEFFS 0 100 0 0 0 1 /end COMPU_METHOD
/begin COMPU_METHOD PresInv_hPa "" RAT_FUNC "%10.9" "1/hPa" COEFFS 0 10000000 0 0 0 1 /end COMPU_METHOD
/begin COMPU_METHOD PresRail_sec "" RAT_FUNC "%6.0" "hPa/s" COEFFS 0 0.0025 0 0 0 1 /end COMPU_METHOD
/begin COMPU_METHOD PresRail_Sec_HiRes_COMPU "" RAT_FUNC "%7.0" "hPa/s" COEFFS 0 0.000166666666666667 0 0 0 1 /end COMPU_METHOD
/begin COMPU_METHOD Pres_Rail "" RAT_FUNC "%6.0" "hPa" COEFFS 0 0.01 0 0 0 1 /end COMPU_METHOD
/begin COMPU_METHOD Pres_SI "" RAT_FUNC "%6.0" "Pa" COEFFS 0 0.01 0 0 0 1 /end COMPU_METHOD
/begin COMPU_METHOD PRKGHEATR_TYPAVL_SC_Compu "" TAB_VERB "%6.3" "" COMPU_TAB_REF PRKGHEATR_TYPAVL_SC_Compu /end COMPU_METHOD
/begin COMPU_VTAB PRKGHEATR_TYPAVL_SC_Compu "" TAB_VERB 2 0 "False" 1 "True" /end COMPU_VTAB
/begin COMPU_METHOD PSSC014EU6_SY_Compu "" TAB_VERB "%6.3" "" COMPU_TAB_REF PSSC014EU6_SY_Compu /end COMPU_METHOD
/begin COMPU_VTAB PSSC014EU6_SY_Compu "" TAB_VERB 11 0 "None" 1 "P1110" 2 "P1192" 3 "MEVD1744" 4 "P1318" 5 "P1110_2" 6 "P1615" 7 "MG1CS032" 8 "MG1CA940" 9 "MG1CS051" 10 "VC1CP091" /end COMPU_VTAB
/begin COMPU_METHOD PSSC040EVCUSCVRNT_SC_Compu "" TAB_VERB "%6.3" "" COMPU_TAB_REF PSSC040EVCUSCVRNT_SC_Compu /end COMPU_METHOD
/begin COMPU_VTAB PSSC040EVCUSCVRNT_SC_Compu "" TAB_VERB 4 0 "UNUSED" 1 "ECC21N_2H" 2 "ECC21E_2H" 3 "ECCXE_EOV24_3H_4H" /end COMPU_VTAB
/begin COMPU_METHOD PS_NUMSENS_SY_Compu "" RAT_FUNC "%6.2" "" COEFFS 0 1 0 0 0 1 /end COMPU_METHOD
/begin COMPU_METHOD PTHRVLVDS_TYPAVL_SC_Compu "" TAB_VERB "%6.3" "" COMPU_TAB_REF PTHRVLVDS_TYPAVL_SC_Compu /end COMPU_METHOD
/begin COMPU_VTAB PTHRVLVDS_TYPAVL_SC_Compu "" TAB_VERB 2 0 "False" 1 "True" /end COMPU_VTAB
/begin COMPU_METHOD PTHRVLVUS_SNSR1PRSNT_SC_Compu "" TAB_VERB "%6.3" "" COMPU_TAB_REF PTHRVLVUS_SNSR1PRSNT_SC_Compu /end COMPU_METHOD
/begin COMPU_VTAB PTHRVLVUS_SNSR1PRSNT_SC_Compu "" TAB_VERB 2 0 "False" 1 "True" /end COMPU_VTAB
/begin COMPU_METHOD PTRBNABSLTUS_TYPAVL_SC_Compu "" TAB_VERB "%6.3" "" COMPU_TAB_REF PTRBNABSLTUS_TYPAVL_SC_Compu /end COMPU_METHOD
/begin COMPU_VTAB PTRBNABSLTUS_TYPAVL_SC_Compu "" TAB_VERB 2 0 "False" 1 "True" /end COMPU_VTAB
/begin COMPU_METHOD PTRBNDS_TYPAVL_SY_Compu "" TAB_VERB "%6.3" "" COMPU_TAB_REF PTRBNDS_TYPAVL_SY_Compu /end COMPU_METHOD
/begin COMPU_VTAB PTRBNDS_TYPAVL_SY_Compu "" TAB_VERB 2 0 "False" 1 "True" /end COMPU_VTAB
/begin COMPU_METHOD PTRBNUS_TYPAVL_SY_Compu "" TAB_VERB "%6.3" "" COMPU_TAB_REF PTRBNUS_TYPAVL_SY_Compu /end COMPU_METHOD
/begin COMPU_VTAB PTRBNUS_TYPAVL_SY_Compu "" TAB_VERB 2 0 "False" 1 "True" /end COMPU_VTAB
/begin COMPU_METHOD PWMCTP_TYPAVL_SC_Compu "" TAB_VERB "%6.3" "" COMPU_TAB_REF PWMCTP_TYPAVL_SC_Compu /end COMPU_METHOD
/begin COMPU_VTAB PWMCTP_TYPAVL_SC_Compu "" TAB_VERB 2 0 "False" 1 "True" /end COMPU_VTAB
/begin COMPU_METHOD Pwr "" RAT_FUNC "%6.2" "W" COEFFS 0 0.10610329539459 0 0 0 1 /end COMPU_METHOD
/begin COMPU_METHOD Pwr1 "" RAT_FUNC "%6.3" "W" COEFFS 0 10 0 0 0 1 /end COMPU_METHOD
/begin COMPU_METHOD Pwr2 "" RAT_FUNC "%6.1" "W" COEFFS 0 0.0530516476972949 0 0 0 1 /end COMPU_METHOD
/begin COMPU_METHOD Pwr2Temp_q0p001 "" RAT_FUNC "%6.4" "W/K" COEFFS 0 100 0 0 0 1 /end COMPU_METHOD
/begin COMPU_METHOD Pwr2Temp_q0p1 "" RAT_FUNC "%6.3" "W/K" COEFFS 0 10 0 0 0 1 /end COMPU_METHOD
/begin COMPU_METHOD PWRDISTBNUNITT_TYPAVL_SC_Compu "" TAB_VERB "%6.3" "" COMPU_TAB_REF PWRDISTBNUNITT_TYPAVL_SC_Compu /end COMPU_METHOD
/begin COMPU_VTAB PWRDISTBNUNITT_TYPAVL_SC_Compu "" TAB_VERB 2 0 "False" 1 "True" /end COMPU_VTAB
/begin COMPU_METHOD PwrSq2TempSq_q0p01 "" RAT_FUNC "%6.4" "W^2/K^2" COEFFS 0 100 0 0 0 1 /end COMPU_METHOD
/begin COMPU_METHOD Pwr_kW "" RAT_FUNC "%6.4" "kW" COEFFS 0 100 0 0 0 1 /end COMPU_METHOD
/begin COMPU_METHOD Pwr_q1 "" RAT_FUNC "%6.2" "W" COEFFS 0 1 0 0 0 1 /end COMPU_METHOD
/begin COMPU_METHOD Pwr_W_q4p0_COMPU "" RAT_FUNC "%6.2" "W" COEFFS 0 1 0 0 0 4 /end COMPU_METHOD
/begin COMPU_METHOD P_hPa_q0p078125_COMPU "" RAT_FUNC "%6.4" "hPa" COEFFS 0 12.8 0 0 0 1 /end COMPU_METHOD
/begin COMPU_METHOD QntR "" RAT_FUNC "%6.5" "-" COEFFS 0 1024 0 0 0 1 /end COMPU_METHOD
/begin COMPU_METHOD Qp_mm3_sec "" RAT_FUNC "%6.1" "mm3/s" COEFFS 0 0.1 0 0 0 1 /end COMPU_METHOD
/begin COMPU_METHOD RailHrsEngOn "" RAT_FUNC "%6.0" "h" COEFFS 0 0.01 0 0 0 1 /end COMPU_METHOD
/begin COMPU_METHOD RatAirMass "" RAT_FUNC "%6.4" "-" COEFFS 0 100 0 0 0 1 /end COMPU_METHOD
/begin COMPU_METHOD RatAirMassHigh "" RAT_FUNC "%6.5" "-" COEFFS 0 1000 0 0 0 1 /end COMPU_METHOD
/begin COMPU_METHOD Trq "" RAT_FUNC "%6.3" "Nm" COEFFS 0 10 0 0 0 1 /end COMPU_METHOD
/begin COMPU_METHOD TrqPrp "" RAT_FUNC "%6.2" "Nm" COEFFS 0 0.625 0 0 0 1 /end COMPU_METHOD
/begin COMPU_METHOD TrqPrpHigh "" RAT_FUNC "%6.3" "Nm" COEFFS 0 10 0 0 0 1 /end COMPU_METHOD
/begin COMPU_METHOD Vel "" RAT_FUNC "%6.4" "km/h" COEFFS 0 100 0 0 0 1 /end COMPU_METHOD
/begin COMPU_METHOD zk10msxs_uw_b655p36PT1 "" RAT_FUNC "%6.2" "s" COEFFS 0 0 65536 0 100 1 /end COMPU_METHOD
/begin RECORD_LAYOUT Map_Xs16Ys16Ws16 NO_AXIS_PTS_X 1 SWORD NO_AXIS_PTS_Y 2 SWORD AXIS_PTS_X 3 SWORD INDEX_INCR DIRECT AXIS_PTS_Y 4 SWORD INDEX_INCR DIRECT FNC_VALUES 5 SWORD COLUMN_DIR DIRECT /end RECORD_LAYOUT
/begin RECORD_LAYOUT Mo_DataCurveSstS16WS16 NO_AXIS_PTS_X 1 SWORD AXIS_PTS_X 2 SWORD INDEX_INCR DIRECT FNC_VALUES 3 SWORD COLUMN_DIR DIRECT /end RECORD_LAYOUT
/begin RECORD_LAYOUT Val_Ws16 FNC_VALUES 1 SWORD COLUMN_DIR DIRECT /end RECORD_LAYOUT
/begin RECORD_LAYOUT Val_Ws32 FNC_VALUES 1 SLONG COLUMN_DIR DIRECT /end RECORD_LAYOUT
/begin RECORD_LAYOUT Val_Wu16 FNC_VALUES 1 UWORD COLUMN_DIR DIRECT /end RECORD_LAYOUT
/begin RECORD_LAYOUT Val_Wu8 FNC_VALUES 1 UBYTE COLUMN_DIR DIRECT /end RECORD_LAYOUT
/end MODULE
/end PROJECT

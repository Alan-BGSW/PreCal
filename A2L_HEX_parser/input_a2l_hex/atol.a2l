ASAP2_VERSION 1 70
/begin PROJECT MDG1C "VC1CP091_STLA_N_D061I3"
/begin HEADER "" VERSION "VC1CP091_STLA_N_D061I3" PROJECT_NO MDG1C /end HEADER
/begin MODULE DIM ""
/begin MOD_COMMON "" BYTE_ORDER MSB_LAST ALIGNMENT_BYTE 1 ALIGNMENT_WORD 2 ALIGNMENT_LONG 4 ALIGNMENT_INT64 4 ALIGNMENT_FLOAT32_IEEE 4 ALIGNMENT_FLOAT64_IEEE 4 DATA_SIZE 32 /end MOD_COMMON
/begin CHARACTERISTIC Com_CONTACT_FREIN_PRKGW_GwSubsVal_C "generic calibration for default value of 208 Signal" VALUE 0x8024E680 Val_Wu8 3.000 OneToOne 0.00 3.000 FORMAT "%5.3" EXTENDED_LIMITS 0.00 255.0 /end CHARACTERISTIC
/begin CHARACTERISTIC Com_CONTACT_FREIN_PRKGW_Ini_C "Signal Ini calibration" VALUE 0x8024E681 Val_Wu8 3.000 OneToOne 0.00 3.000 FORMAT "%5.3" EXTENDED_LIMITS 0.00 255.0 /end CHARACTERISTIC
/begin CHARACTERISTIC Com_DCDC_IP_POWERGW_Ini_C "Signal Ini calibration" VALUE 0x8024E682 Val_Wu16 511.0000 OneToOne 0.00 511.0000 FORMAT "%8.4" EXTENDED_LIMITS 0.00 65535.00 /end CHARACTERISTIC
/begin CHARACTERISTIC Com_DCDC_IP_POWERGW_Invld_C "Signal Ini calibration" VALUE 0x8024E684 Val_Wu16 511.0000 OneToOne 0.00 511.0000 FORMAT "%8.4" EXTENDED_LIMITS 0.00 65535.00 /end CHARACTERISTIC
/begin CHARACTERISTIC Com_eCOMP_Power_consumptionGW_Ini_C "Signal Ini calibration" VALUE 0x8024E686 Val_Wu16 511.0000 OneToOne 0.00 511.0000 FORMAT "%8.4" EXTENDED_LIMITS 0.00 65535.00 /end CHARACTERISTIC
/begin CHARACTERISTIC Com_eCOMP_Power_consumptionGW_Invld_C "Signal Ini calibration" VALUE 0x8024E688 Val_Wu16 511.0000 OneToOne 0.00 511.0000 FORMAT "%8.4" EXTENDED_LIMITS 0.00 65535.00 /end CHARACTERISTIC
/begin CHARACTERISTIC Com_HVBAT_BMS_REMAININGBATTCAPACITYGW_Ini_C "Interface is used for calibration" VALUE 0x8024E68C Val_Wu32 4294967295.00 OneToOne 0.00 4294967295.00 FORMAT "%13.2" /end CHARACTERISTIC
/begin CHARACTERISTIC Com_HVBAT_BMS_REMAININGBATTCAPACITYGW_Invld_C "Interface is used for calibration" VALUE 0x8024E690 Val_Wu32 4294967295.00 OneToOne 0.00 4294967295.00 FORMAT "%13.2" /end CHARACTERISTIC
/begin CHARACTERISTIC Com_HVBAT_CHARGING_STATUSGW_Ini_C "Interface is used for calibration" VALUE 0x8024E694 Val_Wu8 7.000 OneToOne 0.00 7.000 FORMAT "%5.3" EXTENDED_LIMITS 0.00 255.0 /end CHARACTERISTIC
/begin CHARACTERISTIC Com_HVBAT_CHARGING_STATUSGW_Invld_C "Interface is used for calibration" VALUE 0x8024E695 Val_Wu8 7.000 OneToOne 0.00 7.000 FORMAT "%5.3" EXTENDED_LIMITS 0.00 255.0 /end CHARACTERISTIC
/begin CHARACTERISTIC Com_HVBAT_SOCGW_Ini_C "Interface is used for calibration" VALUE 0x8024E696 Val_Wu16 1023.000 OneToOne 0.00 1023.000 FORMAT "%8.3" EXTENDED_LIMITS 0.00 65535.00 /end CHARACTERISTIC
/begin CHARACTERISTIC Com_HVBAT_SOCGW_Invld_C "Interface is used for calibration" VALUE 0x8024E698 Val_Wu16 1023.000 OneToOne 0.00 1023.000 FORMAT "%8.3" EXTENDED_LIMITS 0.00 65535.00 /end CHARACTERISTIC
/begin CHARACTERISTIC Com_HVBAT_TEMPERATUREGW_Ini_C "Ini calibration for Com GW buffer for HVBAT_TEMPERATURE signal" VALUE 0x8024E69A Val_Wu16 511.0000 OneToOne 0.00 511.0000 FORMAT "%8.4" EXTENDED_LIMITS 0.00 65535.00 /end CHARACTERISTIC
/begin CHARACTERISTIC Com_HVBAT_TEMPERATUREGW_Invld_C "Invalid calibration for Com GW buffer for HVBAT_TEMPERATURE signal" VALUE 0x8024E69C Val_Wu16 511.0000 OneToOne 0.00 511.0000 FORMAT "%8.4" EXTENDED_LIMITS 0.00 65535.00 /end CHARACTERISTIC
/begin CHARACTERISTIC Com_HVBAT_THERMAL_RUNAWAYGW_Ini_C "calibration parameter for THERMAL_RUNAWAY signal intial value" VALUE 0x8024E69E Val_Wu8 3.000 OneToOne 0.00 3.000 FORMAT "%5.3" EXTENDED_LIMITS 0.00 255.0 /end CHARACTERISTIC
/begin CHARACTERISTIC Com_HVBAT_THERMAL_RUNAWAYGW_Invld_C "calibration parameter for THERMAL_RUNAWAY signal invalid value" VALUE 0x8024E69F Val_Wu8 3.000 OneToOne 0.00 3.000 FORMAT "%5.3" EXTENDED_LIMITS 0.00 255.0 /end CHARACTERISTIC
/begin CHARACTERISTIC Com_HV_BATT_CELL_VOLT_MAXGW_Ini_C "Interface is used for calibration" VALUE 0x8024E6A0 Val_Wu16 16383.00 OneToOne 0.00 16383.00 FORMAT "%8.2" EXTENDED_LIMITS 0.00 65535.00 /end CHARACTERISTIC
/begin CHARACTERISTIC Com_HV_BATT_CELL_VOLT_MAXGW_Invld_C "Interface is used for calibration" VALUE 0x8024E6A2 Val_Wu16 16383.00 OneToOne 0.00 16383.00 FORMAT "%8.2" EXTENDED_LIMITS 0.00 65535.00 /end CHARACTERISTIC
/begin CHARACTERISTIC Com_HV_BATT_CELL_VOLT_MINGW_Ini_C "Interface is used for calibration" VALUE 0x8024E6A4 Val_Wu16 16383.00 OneToOne 0.00 16383.00 FORMAT "%8.2" EXTENDED_LIMITS 0.00 65535.00 /end CHARACTERISTIC
/begin CHARACTERISTIC Com_HV_BATT_CELL_VOLT_MINGW_Invld_C "Interface is used for calibration" VALUE 0x8024E6A6 Val_Wu16 16383.00 OneToOne 0.00 16383.00 FORMAT "%8.2" EXTENDED_LIMITS 0.00 65535.00 /end CHARACTERISTIC
/begin CHARACTERISTIC Com_HV_BATT_INSULATION_RESISTANCEGW_Ini_C "Interface is used for calibration" VALUE 0x8024E6A8 Val_Wu16 65535.00 OneToOne 0.00 65535.00 FORMAT "%8.2" /end CHARACTERISTIC
/begin CHARACTERISTIC Com_HV_BATT_INSULATION_RESISTANCEGW_Invld_C "Interface is used for calibration" VALUE 0x8024E6AA Val_Wu16 65535.00 OneToOne 0.00 65535.00 FORMAT "%8.2" /end CHARACTERISTIC
/begin CHARACTERISTIC Com_HV_BATT_INSUL_FAILUREGW_GwSubsVal_C "calibration parameter for INSUL_FAILURE signal Substituted value for invalid data case" VALUE 0x8024E6AC Val_Wu8 7.000 OneToOne 0.00 7.000 FORMAT "%5.3" EXTENDED_LIMITS 0.00 255.0 /end CHARACTERISTIC
/begin CHARACTERISTIC Com_HV_BATT_INSUL_FAILUREGW_Ini_C "Interface is used for calibration" VALUE 0x8024E6AD Val_Wu8 7.000 OneToOne 0.00 7.000 FORMAT "%5.3" EXTENDED_LIMITS 0.00 255.0 /end CHARACTERISTIC
/begin CHARACTERISTIC Com_HV_BATT_INTERLOCK_LINEGW_GwSubsVal_C "calibration parameter forINTERLOCK_LINEGW signal Substituted value for invalid data case" VALUE 0x8024E6AE Val_Wu8 3.000 OneToOne 0.00 3.000 FORMAT "%5.3" EXTENDED_LIMITS 0.00 255.0 /end CHARACTERISTIC
/begin CHARACTERISTIC Com_HV_BATT_INTERLOCK_LINEGW_Ini_C "Interface is used for calibration" VALUE 0x8024E6AF Val_Wu8 3.000 OneToOne 0.00 3.000 FORMAT "%5.3" EXTENDED_LIMITS 0.00 255.0 /end CHARACTERISTIC
/begin CHARACTERISTIC Com_HV_BATT_MIN_VOLT_WARNGW_GwSubsVal_C "calibration parameter for HV_BATT_MIN_VOLT_WARNGW signal Substituted value for invalid data case" VALUE 0x8024E6B0 Val_Wu8 3.000 OneToOne 0.00 3.000 FORMAT "%5.3" EXTENDED_LIMITS 0.00 255.0 /end CHARACTERISTIC
/begin CHARACTERISTIC Com_HV_BATT_MIN_VOLT_WARNGW_Ini_C "Interface is used for calibration" VALUE 0x8024E6B1 Val_Wu8 3.000 OneToOne 0.00 3.000 FORMAT "%5.3" EXTENDED_LIMITS 0.00 255.0 /end CHARACTERISTIC
/begin CHARACTERISTIC Com_HV_BATT_NB_CELL_VOLT_MAXGW_Ini_C "Interface is used for calibration" VALUE 0x8024E6B2 Val_Wu8 255.0 OneToOne 0.00 255.0 FORMAT "%5.1" /end CHARACTERISTIC
/begin CHARACTERISTIC Com_HV_BATT_NB_CELL_VOLT_MAXGW_Invld_C "Interface is used for calibration" VALUE 0x8024E6B3 Val_Wu8 255.0 OneToOne 0.00 255.0 FORMAT "%5.1" /end CHARACTERISTIC
/begin CHARACTERISTIC Com_HV_BATT_NB_CELL_VOLT_MINGW_Ini_C "Interface is used for calibration" VALUE 0x8024E6B4 Val_Wu8 255.0 OneToOne 0.00 255.0 FORMAT "%5.1" /end CHARACTERISTIC
/begin CHARACTERISTIC Com_HV_BATT_NB_CELL_VOLT_MINGW_Invld_C "Interface is used for calibration" VALUE 0x8024E6B5 Val_Wu8 255.0 OneToOne 0.00 255.0 FORMAT "%5.1" /end CHARACTERISTIC
/begin CHARACTERISTIC Com_HV_BATT_SOC_5C3GW_GwSubsVal_C "calibration parameter for HV_BATT_SOC_5C3 signal Substituted value for invalid data case" VALUE 0x8024E6B6 Val_Wu16 1023.000 OneToOne 0.00 1023.000 FORMAT "%8.3" EXTENDED_LIMITS 0.00 65535.00 /end CHARACTERISTIC
/begin CHARACTERISTIC Com_HV_BATT_SOC_5C3GW_Ini_C "calibration parameter forHV_BATT_SOC_5C3GW signal intial value" VALUE 0x8024E6B8 Val_Wu16 1023.000 OneToOne 0.00 1023.000 FORMAT "%8.3" EXTENDED_LIMITS 0.00 65535.00 /end CHARACTERISTIC
/begin CHARACTERISTIC Com_HV_BATT_SOH_CAPAGW_Ini_C "Interface is used for calibration" VALUE 0x8024E6BA Val_Wu8 127.0 OneToOne 0.00 127.0 FORMAT "%5.1" EXTENDED_LIMITS 0.00 255.0 /end CHARACTERISTIC
/begin CHARACTERISTIC Com_HV_BATT_SOH_CAPAGW_Invld_C "Interface is used for calibration" VALUE 0x8024E6BB Val_Wu8 127.0 OneToOne 0.00 127.0 FORMAT "%5.1" EXTENDED_LIMITS 0.00 255.0 /end CHARACTERISTIC
/begin CHARACTERISTIC Com_HV_BATT_SOH_RESGW_Ini_C "Interface is used for calibration" VALUE 0x8024E6BC Val_Wu8 127.0 OneToOne 0.00 127.0 FORMAT "%5.1" EXTENDED_LIMITS 0.00 255.0 /end CHARACTERISTIC
/begin CHARACTERISTIC Com_HV_BATT_SOH_RESGW_Invld_C "Interface is used for calibration" VALUE 0x8024E6BD Val_Wu8 127.0 OneToOne 0.00 127.0 FORMAT "%5.1" EXTENDED_LIMITS 0.00 255.0 /end CHARACTERISTIC
/begin CHARACTERISTIC Com_INV_MTR_INST_INPUT_POWERGW_Ini_C "Interface is used for calibration" VALUE 0x8024E6BE Val_Wu16 2047.000 OneToOne 0.00 2047.000 FORMAT "%8.3" EXTENDED_LIMITS 0.00 65535.00 /end CHARACTERISTIC
/begin CHARACTERISTIC Com_INV_MTR_INST_INPUT_POWERGW_Invld_C "Interface is used for calibration" VALUE 0x8024E6C0 Val_Wu16 2047.000 OneToOne 0.00 2047.000 FORMAT "%8.3" EXTENDED_LIMITS 0.00 65535.00 /end CHARACTERISTIC
/begin CHARACTERISTIC Com_MAIN_RELAY_ACTUATION_COUNTERGW_Ini_C "Interface is used for calibration" VALUE 0x8024E6C2 Val_Wu16 1023.000 OneToOne 0.00 1023.000 FORMAT "%8.3" EXTENDED_LIMITS 0.00 65535.00 /end CHARACTERISTIC
/begin CHARACTERISTIC Com_MAIN_RELAY_ACTUATION_COUNTERGW_Invld_C "Interface is used for calibration" VALUE 0x8024E6C4 Val_Wu16 1023.000 OneToOne 0.00 1023.000 FORMAT "%8.3" EXTENDED_LIMITS 0.00 65535.00 /end CHARACTERISTIC
/begin CHARACTERISTIC Com_TIME_HV_BATT_OVER_TEMPERATUREGW_Ini_C "Interface is used for calibration" VALUE 0x8024E6C6 Val_Wu16 65535.00 OneToOne 0.00 65535.00 FORMAT "%8.2" /end CHARACTERISTIC
/begin CHARACTERISTIC Com_TIME_HV_BATT_OVER_TEMPERATUREGW_Invld_C "Interface is used for calibration" VALUE 0x8024E6C8 Val_Wu16 65535.00 OneToOne 0.00 65535.00 FORMAT "%8.2" /end CHARACTERISTIC
/begin CHARACTERISTIC Com_TOTAL_HV_BATT_POS_QTY_CURRGW_Ini_C "Interface is used for calibration" VALUE 0x8024E6CA Val_Wu16 4095.000 OneToOne 0.00 4095.000 FORMAT "%8.3" EXTENDED_LIMITS 0.00 65535.00 /end CHARACTERISTIC
/begin CHARACTERISTIC Com_TOTAL_HV_BATT_POS_QTY_CURRGW_Invld_C "Interface is used for calibration" VALUE 0x8024E6CC Val_Wu16 4095.000 OneToOne 0.00 4095.000 FORMAT "%8.3" EXTENDED_LIMITS 0.00 65535.00 /end CHARACTERISTIC
/begin CHARACTERISTIC Com_VITESSE_VEHICULE_ROUESGW_Ini_C "Interface is used for calibration" VALUE 0x8024E6CE Val_Wu16 65535.00 OneToOne 0.00 65535.00 FORMAT "%8.2" /end CHARACTERISTIC
/begin CHARACTERISTIC Com_VITESSE_VEHICULE_ROUESGW_Invld_C "Interface is used for calibration" VALUE 0x8024E6D0 Val_Wu16 65535.00 OneToOne 0.00 65535.00 FORMAT "%8.2" /end CHARACTERISTIC
/begin CHARACTERISTIC Com_VVH_INDISPGW_Ini_C "Interface is used for calibration" VALUE 0x8024E6D2 Val_Wu8 3.000 OneToOne 0.00 3.000 FORMAT "%5.3" EXTENDED_LIMITS 0.00 255.0 /end CHARACTERISTIC
/begin CHARACTERISTIC Com_VVH_INDISPGW_Invld_C "Interface is used for calibration" VALUE 0x8024E6D3 Val_Wu8 3.000 OneToOne 0.00 3.000 FORMAT "%5.3" EXTENDED_LIMITS 0.00 255.0 /end CHARACTERISTIC
/begin CHARACTERISTIC Ext_ctClcProcMax_C "Max value of the 4 bits compute process counter for UC brake , not to trigger an error" VALUE 0x8024E6D4 Val_Wu8 255.0 OneToOne 0.00 255.0 FORMAT "%5.1" /end CHARACTERISTIC
/begin CHARACTERISTIC Ext_ctClcProcMin_C "Min value of the 4 bits compute process counter for UC brake , not to trigger an error" VALUE 0x8024E6D5 Val_Wu8 255.0 OneToOne 0.00 255.0 FORMAT "%5.1" /end CHARACTERISTIC
/begin CHARACTERISTIC HVBAT_ALERT_LOW_BATT_ENERGYGW_GwSubsVal_C "calibration parameter forHVBAT_ALERT_LOW_BATT_ENERGYsignal Substituted value for invalid data case" VALUE 0x8024E6D6 Val_Wu8 3.000 OneToOne 0.00 3.000 FORMAT "%5.3" EXTENDED_LIMITS 0.00 255.0 /end CHARACTERISTIC
/begin CHARACTERISTIC HVBAT_ALERT_LOW_BATT_ENERGYGW_Ini_C "Interface is used forcalibration" VALUE 0x8024E6D7 Val_Wu8 3.000 OneToOne 0.00 3.000 FORMAT "%5.3" EXTENDED_LIMITS 0.00 255.0 /end CHARACTERISTIC
/begin CHARACTERISTIC HV_BATT_TEMP_AVGGW_Ini_C "Interface is used forcalibration" VALUE 0x8024E6D8 Val_Wu8 255.0 OneToOne 0.00 255.0 FORMAT "%5.1" /end CHARACTERISTIC
/begin CHARACTERISTIC HV_BATT_TEMP_AVGGW_Invld_C "IInterface is used forcalibration" VALUE 0x8024E6D9 Val_Wu8 255.0 OneToOne 0.00 255.0 FORMAT "%5.1" /end CHARACTERISTIC
/begin MEASUREMENT ComChrgn_iDcRly "DC current at charge inlet" SWORD RBPtCel_i_0p03125_1 1 100 -1024.000 1023.969 FORMAT "%8.3" ECU_ADDRESS 0x6001FE86
 /begin IF_DATA XCPplus 0x0102
  /begin DAQ_EVENT VARIABLE /end DAQ_EVENT
 /end IF_DATA
/end MEASUREMENT
/begin MEASUREMENT ComChrgn_uDcRly "DC charging voltage" SWORD RBPtCel_u_0p1_1 1 100 -3276.800 3276.700 FORMAT "%8.3" ECU_ADDRESS 0x6001FE84
 /begin IF_DATA XCPplus 0x0102
  /begin DAQ_EVENT VARIABLE /end DAQ_EVENT
 /end IF_DATA
/end MEASUREMENT
/begin MEASUREMENT ComChrgr_flgChrgrErrLvl "" UBYTE OneToOne 1 100 0.00 7.000 FORMAT "%5.3" ECU_ADDRESS 0x6002386C
 /begin IF_DATA XCPplus 0x0102
  /begin DAQ_EVENT VARIABLE /end DAQ_EVENT
 /end IF_DATA
/end MEASUREMENT
/begin MEASUREMENT ComChrgr_iAcMax "Maximum Ac-current" SWORD RBPtCel_i_0p03125_1 1 100 -1024.000 1023.969 FORMAT "%8.3" ECU_ADDRESS 0x6001FE82
 /begin IF_DATA XCPplus 0x0102
  /begin DAQ_EVENT VARIABLE /end DAQ_EVENT
 /end IF_DATA
/end MEASUREMENT
/begin MEASUREMENT ComChrgr_iDcHvAct "ComChrgr_iDcHvAct" SWORD RBPtCel_i_0p03125_1 1 100 -1024.000 1023.969 FORMAT "%8.3" ECU_ADDRESS 0x6001FE80
 /begin IF_DATA XCPplus 0x0102
  /begin DAQ_EVENT VARIABLE /end DAQ_EVENT
 /end IF_DATA
/end MEASUREMENT
/begin MEASUREMENT ComChrgr_pwrInAct "Actual Charger input power" UWORD RBPtCel_pwr_10p0_1 1 100 0.00 655350.0 FORMAT "%8.1" ECU_ADDRESS 0x6001FD24
 /begin IF_DATA XCPplus 0x0102
  /begin DAQ_EVENT VARIABLE /end DAQ_EVENT
 /end IF_DATA
/end MEASUREMENT
/begin MEASUREMENT ComChrgr_pwrOutpCpby "" UWORD RBPtCel_pwr_1p0_1 1 100 0.00 3500.000 FORMAT "%8.3" ECU_ADDRESS 0x6001FD22
 /begin IF_DATA XCPplus 0x0102
  /begin DAQ_EVENT VARIABLE /end DAQ_EVENT
 /end IF_DATA
/end MEASUREMENT
/begin MEASUREMENT ComChrgr_stChrgrRx "" UBYTE OneToOne 1 100 0.00 15.00 FORMAT "%5.2" ECU_ADDRESS 0x6002386B
 /begin IF_DATA XCPplus 0x0102
  /begin DAQ_EVENT VARIABLE /end DAQ_EVENT
 /end IF_DATA
/end MEASUREMENT
/begin MEASUREMENT ComChrgr_stEVLmp "State of EV lamp from OBC" UBYTE OneToOne 1 100 0.00 3.000 FORMAT "%5.3" ECU_ADDRESS 0x6002386A
 /begin IF_DATA XCPplus 0x0102
  /begin DAQ_EVENT VARIABLE /end DAQ_EVENT
 /end IF_DATA
/end MEASUREMENT
/begin MEASUREMENT ComChrgr_stMstWrnLmp "state of Master warning Lamp from OBC" UBYTE OneToOne 1 100 0.00 3.000 FORMAT "%5.3" ECU_ADDRESS 0x60023869
 /begin IF_DATA XCPplus 0x0102
  /begin DAQ_EVENT VARIABLE /end DAQ_EVENT
 /end IF_DATA
/end MEASUREMENT
/begin MEASUREMENT ComChrgr_stSVSLmp "State of SVS Lamp from OBC" UBYTE OneToOne 1 100 0.00 3.000 FORMAT "%5.3" ECU_ADDRESS 0x60023868
 /begin IF_DATA XCPplus 0x0102
  /begin DAQ_EVENT VARIABLE /end DAQ_EVENT
 /end IF_DATA
/end MEASUREMENT
/begin MEASUREMENT ComChrgr_tChrgrMaxAct "Maximum charger temperature (Act)" SWORD RBPtCel_t_0p1_3 1 100 -3276.800 3276.700 FORMAT "%8.3" ECU_ADDRESS 0x6001FE7E
 /begin IF_DATA XCPplus 0x0102
  /begin DAQ_EVENT VARIABLE /end DAQ_EVENT
 /end IF_DATA
/end MEASUREMENT
/begin MEASUREMENT ComChrgr_uAcActL1 "L1 power supply of EVSE" SWORD RBPtCel_u_0p1_1 1 100 -3276.800 3276.700 FORMAT "%8.3" ECU_ADDRESS 0x6001FE7C
 /begin IF_DATA XCPplus 0x0102
  /begin DAQ_EVENT VARIABLE /end DAQ_EVENT
 /end IF_DATA
/end MEASUREMENT
/begin MEASUREMENT ComChrgr_uDcHvAct "ComChrgr_uDcHvAct" SWORD RBPtCel_u_0p1_1 1 100 -3276.800 3276.700 FORMAT "%8.3" ECU_ADDRESS 0x6001FE7A
 /begin IF_DATA XCPplus 0x0102
  /begin DAQ_EVENT VARIABLE /end DAQ_EVENT
 /end IF_DATA
/end MEASUREMENT
/begin MEASUREMENT ComEmac_flgImobAuthent "Immobilizer Authentication flag" UBYTE B_TRUE 1 100 0.00 1.00000000000 BIT_MASK 0x1 FORMAT "%13.11" ECU_ADDRESS 0x6002373F
 /begin IF_DATA XCPplus 0x0102
  /begin DAQ_EVENT VARIABLE /end DAQ_EVENT
 /end IF_DATA
/end MEASUREMENT
/begin MEASUREMENT ComEmac_iDcLnk01 "DC link current, e-machine 01" SWORD Curr_A_q0p03125_COMPU 1 100 -1024.000 1023.969 FORMAT "%8.3" ECU_ADDRESS 0x6001FE78
 /begin IF_DATA XCPplus 0x0102
  /begin DAQ_EVENT VARIABLE /end DAQ_EVENT
 /end IF_DATA
/end MEASUREMENT
/begin MEASUREMENT ComEmac_nAct01 "Actual engine speed, e-machine 01" SWORD nmot_q1 1 100 -32768.00 32767.00 FORMAT "%8.2" ECU_ADDRESS 0x6001FE76
 /begin IF_DATA XCPplus 0x0102
  /begin DAQ_EVENT VARIABLE /end DAQ_EVENT
 /end IF_DATA
/end MEASUREMENT
/begin MEASUREMENT ComEmac_pwrInstnsInpRx "" SWORD q0p1_kW 1 100 -100.0000 100.0000 FORMAT "%8.4" ECU_ADDRESS 0x6001FE74
 /begin IF_DATA XCPplus 0x0102
  /begin DAQ_EVENT VARIABLE /end DAQ_EVENT
 /end IF_DATA
/end MEASUREMENT
/begin MEASUREMENT ComEmac_stActvDcha "Active discharge response" UBYTE OneToOne 1 100 0.00 7.000 FORMAT "%5.3" ECU_ADDRESS 0x60023867
 /begin IF_DATA XCPplus 0x0102
  /begin DAQ_EVENT VARIABLE /end DAQ_EVENT
 /end IF_DATA
/end MEASUREMENT
/begin MEASUREMENT ComEmac_stEVLmp "State of EV lamp from inverter" UBYTE OneToOne 1 100 0.00 3.000 FORMAT "%5.3" ECU_ADDRESS 0x60023866
 /begin IF_DATA XCPplus 0x0102
  /begin DAQ_EVENT VARIABLE /end DAQ_EVENT
 /end IF_DATA
/end MEASUREMENT
/begin MEASUREMENT ComEmac_stHillHld "" UBYTE OneToOne 1 100 0.00 3.000 FORMAT "%5.3" ECU_ADDRESS 0x60023865
 /begin IF_DATA XCPplus 0x0102
  /begin DAQ_EVENT VARIABLE /end DAQ_EVENT
 /end IF_DATA
/end MEASUREMENT
/begin MEASUREMENT ComEmac_stIsoMonSwtAck "Insulation Monitoring Acknowledge Switch" UBYTE OneToOne 1 100 0.00 2.000 FORMAT "%5.3" ECU_ADDRESS 0x60023864
 /begin IF_DATA XCPplus 0x0102
  /begin DAQ_EVENT VARIABLE /end DAQ_EVENT
 /end IF_DATA
/end MEASUREMENT
/begin MEASUREMENT ComEmac_stIvtrOpMod01 "Actual operation state of inverter" UBYTE OneToOne 1 100 0.00 7.000 FORMAT "%5.3" ECU_ADDRESS 0x60023863
 /begin IF_DATA XCPplus 0x0102
  /begin DAQ_EVENT VARIABLE /end DAQ_EVENT
 /end IF_DATA
/end MEASUREMENT
/begin MEASUREMENT ComEmac_stMod01Rx "" UBYTE OneToOne 1 100 0.00 7.000 FORMAT "%5.3" ECU_ADDRESS 0x60023862
 /begin IF_DATA XCPplus 0x0102
  /begin DAQ_EVENT VARIABLE /end DAQ_EVENT
 /end IF_DATA
/end MEASUREMENT
/begin MEASUREMENT ComEmac_stMstWrnLmp "State of Master Warning Lamp from Inverter" UBYTE OneToOne 1 100 0.00 3.000 FORMAT "%5.3" ECU_ADDRESS 0x60023861
 /begin IF_DATA XCPplus 0x0102
  /begin DAQ_EVENT VARIABLE /end DAQ_EVENT
 /end IF_DATA
/end MEASUREMENT
/begin MEASUREMENT ComEmac_stPwrAuthn "power authorization Status" UBYTE B_TRUE 1 100 0.00 1.00000000000 BIT_MASK 0x1 FORMAT "%13.11" ECU_ADDRESS 0x6002373E
 /begin IF_DATA XCPplus 0x0102
  /begin DAQ_EVENT VARIABLE /end DAQ_EVENT
 /end IF_DATA
/end MEASUREMENT
/begin MEASUREMENT ComEmac_stSVSLmp "State of SVS Lamp from Inverter" UBYTE OneToOne 1 100 0.00 3.000 FORMAT "%5.3" ECU_ADDRESS 0x60023860
 /begin IF_DATA XCPplus 0x0102
  /begin DAQ_EVENT VARIABLE /end DAQ_EVENT
 /end IF_DATA
/end MEASUREMENT
/begin MEASUREMENT ComEmac_tInvr01 "Inverter temperature, e-machine 01" SWORD Temp_Cels 1 100 -3549.940 3003.560 FORMAT "%8.3" ECU_ADDRESS 0x6001FE72
 /begin IF_DATA XCPplus 0x0102
  /begin DAQ_EVENT VARIABLE /end DAQ_EVENT
 /end IF_DATA
/end MEASUREMENT
/begin MEASUREMENT ComEmac_tIvtrCooltIn01 "coolant temperature at inverter 1 inlet" SWORD Temp_Cels 1 100 -3549.940 3003.560 FORMAT "%8.3" ECU_ADDRESS 0x6001FE70
 /begin IF_DATA XCPplus 0x0102
  /begin DAQ_EVENT VARIABLE /end DAQ_EVENT
 /end IF_DATA
/end MEASUREMENT
/begin MEASUREMENT ComEmac_tMac01 "Stator temperature, e-machine 01" SWORD Temp_Cels 1 100 -3549.940 3003.560 FORMAT "%8.3" ECU_ADDRESS 0x6001FE6E
 /begin IF_DATA XCPplus 0x0102
  /begin DAQ_EVENT VARIABLE /end DAQ_EVENT
 /end IF_DATA
/end MEASUREMENT
/begin MEASUREMENT ComEmac_tqAbsltMaxRx01 "" SWORD Trq 1 100 -3276.800 3276.700 FORMAT "%8.3" ECU_ADDRESS 0x6001FE6C
 /begin IF_DATA XCPplus 0x0102
  /begin DAQ_EVENT VARIABLE /end DAQ_EVENT
 /end IF_DATA
/end MEASUREMENT
/begin MEASUREMENT ComEmac_tqAbsltMinRx01 "" SWORD Trq 1 100 -3276.800 3276.700 FORMAT "%8.3" ECU_ADDRESS 0x6001FE6A
 /begin IF_DATA XCPplus 0x0102
  /begin DAQ_EVENT VARIABLE /end DAQ_EVENT
 /end IF_DATA
/end MEASUREMENT
/begin MEASUREMENT ComEmac_tqAckd01 "" SWORD RBPtCel_tq_0p1_1 1 100 -143.0000 143.0000 FORMAT "%8.4" ECU_ADDRESS 0x6001FE68
 /begin IF_DATA XCPplus 0x0102
  /begin DAQ_EVENT VARIABLE /end DAQ_EVENT
 /end IF_DATA
/end MEASUREMENT
/begin MEASUREMENT ComEmac_tqAct01 "Actual torque, e-machine 01" SWORD Trq 1 100 -3276.800 3276.700 FORMAT "%8.3" ECU_ADDRESS 0x6001FE66
 /begin IF_DATA XCPplus 0x0102
  /begin DAQ_EVENT VARIABLE /end DAQ_EVENT
 /end IF_DATA
/end MEASUREMENT
/begin MEASUREMENT ComEmac_tqPtd01 "" UBYTE RBPtCel_Perc_1p0_1 1 100 0.00 100.0 FORMAT "%5.1" ECU_ADDRESS 0x6002385F
 /begin IF_DATA XCPplus 0x0102
  /begin DAQ_EVENT VARIABLE /end DAQ_EVENT
 /end IF_DATA
/end MEASUREMENT
/begin MEASUREMENT ComEmac_tqStabnMin "" SWORD Trq 1 100 -3276.800 3276.700 FORMAT "%8.3" ECU_ADDRESS 0x6001FE64
 /begin IF_DATA XCPplus 0x0102
  /begin DAQ_EVENT VARIABLE /end DAQ_EVENT
 /end IF_DATA
/end MEASUREMENT
/begin MEASUREMENT ComEmac_uDcLnk01 "Actual DC link voltage of e-machine 01" SWORD Volt_V_q0p03125_COMPU 1 100 -1024.000 1023.969 FORMAT "%8.3" ECU_ADDRESS 0x6001FE62
 /begin IF_DATA XCPplus 0x0102
  /begin DAQ_EVENT VARIABLE /end DAQ_EVENT
 /end IF_DATA
/end MEASUREMENT
/begin MEASUREMENT Com_bDelDftReq "Request to Erase fault code memory" UBYTE B_TRUE 1 100 0.00 1.00000000000 BIT_MASK 0x1 FORMAT "%13.11" ECU_ADDRESS 0x6002373D
 /begin IF_DATA XCPplus 0x0102
  /begin DAQ_EVENT VARIABLE /end DAQ_EVENT
 /end IF_DATA
/end MEASUREMENT
/begin MEASUREMENT Com_bElIntgDiag "Diagnosis for Electronic integration mode" UBYTE B_TRUE 1 100 0.00 1.00000000000 BIT_MASK 0x1 FORMAT "%13.11" ECU_ADDRESS 0x60023736
 /begin IF_DATA XCPplus 0x0102
  /begin DAQ_EVENT VARIABLE /end DAQ_EVENT
 /end IF_DATA
/end MEASUREMENT
/begin MEASUREMENT Com_bElIntgDiagMod "Diagnosis mode" UBYTE B_TRUE 1 100 0.00 1.00000000000 BIT_MASK 0x1 FORMAT "%13.11" ECU_ADDRESS 0x60023735
 /begin IF_DATA XCPplus 0x0102
  /begin DAQ_EVENT VARIABLE /end DAQ_EVENT
 /end IF_DATA
/end MEASUREMENT
/begin MEASUREMENT Com_bImmoUnlockWkuReq "" UBYTE B_TRUE 1 100 0.00 1.00000000000 BIT_MASK 0x1 FORMAT "%13.11" ECU_ADDRESS 0x6002372C
 /begin IF_DATA XCPplus 0x0102
  /begin DAQ_EVENT VARIABLE /end DAQ_EVENT
 /end IF_DATA
/end MEASUREMENT
/begin MEASUREMENT Com_bInfoReqPtlWkuReq "" UBYTE B_TRUE 1 100 0.00 1.00000000000 BIT_MASK 0x1 FORMAT "%13.11" ECU_ADDRESS 0x60023729
 /begin IF_DATA XCPplus 0x0102
  /begin DAQ_EVENT VARIABLE /end DAQ_EVENT
 /end IF_DATA
/end MEASUREMENT
/begin MEASUREMENT Com_bPreCondElecWkuReq "Preconditioning Enable Wakeup request" UBYTE B_TRUE 1 100 0.00 1.00000000000 BIT_MASK 0x1 FORMAT "%13.11" ECU_ADDRESS 0x60023721
 /begin IF_DATA XCPplus 0x0102
  /begin DAQ_EVENT VARIABLE /end DAQ_EVENT
 /end IF_DATA
/end MEASUREMENT
/begin MEASUREMENT Com_bReFogRlySt_CAN "ASW for REAR_DEFOGGER_RELAY_STATUS" UBYTE B_TRUE 1 100 0.00 1.00000000000 BIT_MASK 0x1 FORMAT "%13.11" ECU_ADDRESS 0x60023716
 /begin IF_DATA XCPplus 0x0102
  /begin DAQ_EVENT VARIABLE /end DAQ_EVENT
 /end IF_DATA
/end MEASUREMENT
/begin MEASUREMENT Com_bRemUnlckWkuReq "" UBYTE B_TRUE 1 100 0.00 1.00000000000 BIT_MASK 0x1 FORMAT "%13.11" ECU_ADDRESS 0x60023715
 /begin IF_DATA XCPplus 0x0102
  /begin DAQ_EVENT VARIABLE /end DAQ_EVENT
 /end IF_DATA
/end MEASUREMENT
/begin MEASUREMENT Com_bStpDlyHMIWkuReq "" UBYTE B_TRUE 1 100 0.00 1.00000000000 BIT_MASK 0x1 FORMAT "%13.11" ECU_ADDRESS 0x6002370F
 /begin IF_DATA XCPplus 0x0102
  /begin DAQ_EVENT VARIABLE /end DAQ_EVENT
 /end IF_DATA
/end MEASUREMENT
/begin MEASUREMENT Com_ctHvbNegCntctrSeg1 "HVBAT Negative Contactor count" ULONG q64 1 100 0.00 100032.000000 FORMAT "%13.6" ECU_ADDRESS 0x60001080
 /begin IF_DATA XCPplus 0x0102
  /begin DAQ_EVENT VARIABLE /end DAQ_EVENT
 /end IF_DATA
/end MEASUREMENT
/begin MEASUREMENT Com_ctHvbNegCntctrSeg2 "HVBAT Negative Contactor count" UWORD q16 1 100 0.00 1008.000 FORMAT "%8.3" ECU_ADDRESS 0x6001FD02
 /begin IF_DATA XCPplus 0x0102
  /begin DAQ_EVENT VARIABLE /end DAQ_EVENT
 /end IF_DATA
/end MEASUREMENT
/begin MEASUREMENT Com_ctHvbNegCntctrSeg3 "HVBAT Negative Contactor count" UWORD q8 1 100 0.00 600.0000 FORMAT "%8.4" ECU_ADDRESS 0x6001FD00
 /begin IF_DATA XCPplus 0x0102
  /begin DAQ_EVENT VARIABLE /end DAQ_EVENT
 /end IF_DATA
/end MEASUREMENT
/begin MEASUREMENT Com_ctHvbNegCntctrSeg4 "HVBAT Negative Contactor count" UBYTE OneToOne 1 100 0.00 20.00 FORMAT "%5.2" ECU_ADDRESS 0x6002384C
 /begin IF_DATA XCPplus 0x0102
  /begin DAQ_EVENT VARIABLE /end DAQ_EVENT
 /end IF_DATA
/end MEASUREMENT
/begin MEASUREMENT Com_ctHvbNegCntctrSeg5 "HVBAT Negative Contactor count" UBYTE OneToOne 1 100 0.00 1.000 FORMAT "%5.3" ECU_ADDRESS 0x6002384B
 /begin IF_DATA XCPplus 0x0102
  /begin DAQ_EVENT VARIABLE /end DAQ_EVENT
 /end IF_DATA
/end MEASUREMENT
/begin MEASUREMENT Com_ctHvbPosCntctrSeg1 "HVBAT Positive Contactor count" ULONG q64 1 100 0.00 100032.000000 FORMAT "%13.6" ECU_ADDRESS 0x6000107C
 /begin IF_DATA XCPplus 0x0102
  /begin DAQ_EVENT VARIABLE /end DAQ_EVENT
 /end IF_DATA
/end MEASUREMENT
/begin MEASUREMENT Com_ctHvbPosCntctrSeg2 "HVBAT Positive Contactor count" UWORD q16 1 100 0.00 1008.000 FORMAT "%8.3" ECU_ADDRESS 0x6001FCFE
 /begin IF_DATA XCPplus 0x0102
  /begin DAQ_EVENT VARIABLE /end DAQ_EVENT
 /end IF_DATA
/end MEASUREMENT
/begin MEASUREMENT Com_ctHvbPosCntctrSeg3 "HVBAT Positive Contactor count" UWORD q8 1 100 0.00 600.0000 FORMAT "%8.4" ECU_ADDRESS 0x6001FCFC
 /begin IF_DATA XCPplus 0x0102
  /begin DAQ_EVENT VARIABLE /end DAQ_EVENT
 /end IF_DATA
/end MEASUREMENT
/begin MEASUREMENT Com_ctHvbPosCntctrSeg4 "HVBAT Positive Contactor count" UBYTE OneToOne 1 100 0.00 20.00 FORMAT "%5.2" ECU_ADDRESS 0x6002384A
 /begin IF_DATA XCPplus 0x0102
  /begin DAQ_EVENT VARIABLE /end DAQ_EVENT
 /end IF_DATA
/end MEASUREMENT
/begin MEASUREMENT Com_ctHvbPosCntctrSeg5 "HVBAT Positive Contactor count" UBYTE OneToOne 1 100 0.00 1.000 FORMAT "%5.3" ECU_ADDRESS 0x60023849
 /begin IF_DATA XCPplus 0x0102
  /begin DAQ_EVENT VARIABLE /end DAQ_EVENT
 /end IF_DATA
/end MEASUREMENT
/begin MEASUREMENT Com_ctHvbPrecCntctrSeg1 "Precharge Contactor count" ULONG q64 1 100 0.00 100032.000000 FORMAT "%13.6" ECU_ADDRESS 0x60001078
 /begin IF_DATA XCPplus 0x0102
  /begin DAQ_EVENT VARIABLE /end DAQ_EVENT
 /end IF_DATA
/end MEASUREMENT
/begin MEASUREMENT Com_ctHvbPrecCntctrSeg2 "Precharge Contactor Count" UWORD q8 1 100 0.00 800.0000 FORMAT "%8.4" ECU_ADDRESS 0x6001FCFA
 /begin IF_DATA XCPplus 0x0102
  /begin DAQ_EVENT VARIABLE /end DAQ_EVENT
 /end IF_DATA
/end MEASUREMENT
/begin MEASUREMENT Com_egyHvbAvl_fRx "HVBattery Remaining energy Rx" UWORD q16_W_h 1 100 0.00 65440.00 FORMAT "%8.2" ECU_ADDRESS 0x6001FCF8
 /begin IF_DATA XCPplus 0x0102
  /begin DAQ_EVENT VARIABLE /end DAQ_EVENT
 /end IF_DATA
/end MEASUREMENT
/begin MEASUREMENT Com_FirstRx_38Dh_IS_DYN_ABR "interface to check if RX function has been valled" UBYTE OneToOne 1 100 0.00 255.0 BIT_MASK 0x1 FORMAT "%5.1" ECU_ADDRESS 0x600231AE /end MEASUREMENT
/begin MEASUREMENT Com_FirstRx_DCDC_INFO_283 "RX indication for0x283 signal" UBYTE OneToOne 1 100 0.00 255.0 BIT_MASK 0x1 FORMAT "%5.1" ECU_ADDRESS 0x600231AD /end MEASUREMENT
/begin MEASUREMENT Com_FirstRx_eCOMP_Information_47B "RX indication for0x47B signal" UBYTE OneToOne 1 100 0.00 255.0 BIT_MASK 0x1 FORMAT "%5.1" ECU_ADDRESS 0x600231AC /end MEASUREMENT
/begin MEASUREMENT Com_FirstRx_HVBAT_205h "interface to check if RX function has been valled" UBYTE OneToOne 1 100 0.00 255.0 BIT_MASK 0x1 FORMAT "%5.1" ECU_ADDRESS 0x600231AB /end MEASUREMENT
/begin MEASUREMENT Com_FirstRx_HVBAT_325h "RX indication for0x325 signal" UBYTE OneToOne 1 100 0.00 255.0 BIT_MASK 0x1 FORMAT "%5.1" ECU_ADDRESS 0x600231AA /end MEASUREMENT
/begin MEASUREMENT Com_FirstRx_HVBAT_535 "interface to check if RX function has been valled" UBYTE OneToOne 1 100 0.00 255.0 BIT_MASK 0x1 FORMAT "%5.1" ECU_ADDRESS 0x600231A9 /end MEASUREMENT
/begin MEASUREMENT Com_FirstRx_HVBAT_665h "interface to check if RX function has been valled" UBYTE OneToOne 1 100 0.00 255.0 BIT_MASK 0x1 FORMAT "%5.1" ECU_ADDRESS 0x600231A8 /end MEASUREMENT
/begin MEASUREMENT Com_FirstRx_HVBAT_675h "interface to check if RX function has been valled" UBYTE OneToOne 1 100 0.00 255.0 BIT_MASK 0x1 FORMAT "%5.1" ECU_ADDRESS 0x600231A7 /end MEASUREMENT
/begin MEASUREMENT Com_FirstRx_HVBAT_THERMAL_5B5 "RX indication for0x5B5 signal" UBYTE OneToOne 1 100 0.00 255.0 BIT_MASK 0x1 FORMAT "%5.1" ECU_ADDRESS 0x600231A6 /end MEASUREMENT
/begin MEASUREMENT Com_FirstRx_HVBAT_VCU_435h "interface to check if RX function has been valled" UBYTE OneToOne 1 100 0.00 255.0 BIT_MASK 0x1 FORMAT "%5.1" ECU_ADDRESS 0x600231A5 /end MEASUREMENT
/begin MEASUREMENT Com_FirstRx_HVBAT_VCU_543 "interface to check if RX function has been valled" UBYTE OneToOne 1 100 0.00 255.0 BIT_MASK 0x1 FORMAT "%5.1" ECU_ADDRESS 0x600231A4 /end MEASUREMENT
/begin MEASUREMENT Com_FirstRx_INV_227h "RX indication for0x227 signal" UBYTE OneToOne 1 100 0.00 255.0 BIT_MASK 0x1 FORMAT "%5.1" ECU_ADDRESS 0x600231A3 /end MEASUREMENT
/begin MEASUREMENT Com_FirstRx_IS_DAT_BSI_412h "interface to check if RX function has been valled" UBYTE OneToOne 1 100 0.00 255.0 BIT_MASK 0x1 FORMAT "%5.1" ECU_ADDRESS 0x600231A2 /end MEASUREMENT
/begin MEASUREMENT Com_flgBrkMai "Main Brake Switch via CAN" UBYTE B_TRUE 1 100 0.00 1.00000000000 BIT_MASK 0x1 FORMAT "%13.11" ECU_ADDRESS 0x6002370E
 /begin IF_DATA XCPplus 0x0102
  /begin DAQ_EVENT VARIABLE /end DAQ_EVENT
 /end IF_DATA
/end MEASUREMENT
/begin MEASUREMENT Com_flgBrkMaiDiag "" UBYTE B_TRUE 1 100 0.00 1.00000000000 BIT_MASK 0x1 FORMAT "%13.11" ECU_ADDRESS 0x6002370D
 /begin IF_DATA XCPplus 0x0102
  /begin DAQ_EVENT VARIABLE /end DAQ_EVENT
 /end IF_DATA
/end MEASUREMENT
/begin MEASUREMENT Com_flgCurMeasmtErr "Flag to indicate current measurement-error" UBYTE B_TRUE 1 100 0.00 1.00000000000 BIT_MASK 0x1 FORMAT "%13.11" ECU_ADDRESS 0x6002370C
 /begin IF_DATA XCPplus 0x0102
  /begin DAQ_EVENT VARIABLE /end DAQ_EVENT
 /end IF_DATA
/end MEASUREMENT
/begin MEASUREMENT Com_flgCurMeasmtSysErr "Flag to indicate current measurement system error" UBYTE B_TRUE 1 100 0.00 1.00000000000 BIT_MASK 0x1 FORMAT "%13.11" ECU_ADDRESS 0x6002370B
 /begin IF_DATA XCPplus 0x0102
  /begin DAQ_EVENT VARIABLE /end DAQ_EVENT
 /end IF_DATA
/end MEASUREMENT
/begin MEASUREMENT Com_flgCurMeasmtVld "Flag to indicate current measurement invalid" UBYTE B_TRUE 1 100 0.00 1.00000000000 BIT_MASK 0x1 FORMAT "%13.11" ECU_ADDRESS 0x6002370A
 /begin IF_DATA XCPplus 0x0102
  /begin DAQ_EVENT VARIABLE /end DAQ_EVENT
 /end IF_DATA
/end MEASUREMENT
/begin MEASUREMENT Com_flgCurRngErr "Flag to indicate IBat current is out of range" UBYTE B_TRUE 1 100 0.00 1.00000000000 BIT_MASK 0x1 FORMAT "%13.11" ECU_ADDRESS 0x60023709
 /begin IF_DATA XCPplus 0x0102
  /begin DAQ_EVENT VARIABLE /end DAQ_EVENT
 /end IF_DATA
/end MEASUREMENT
/begin MEASUREMENT Com_flgEcoNormReqRx "" UBYTE OneToOne 1 100 0.00 3.000 FORMAT "%5.3" ECU_ADDRESS 0x60023848
 /begin IF_DATA XCPplus 0x0102
  /begin DAQ_EVENT VARIABLE /end DAQ_EVENT
 /end IF_DATA
/end MEASUREMENT
/begin MEASUREMENT Com_flgElCmprAbnormSpdFlt "" UBYTE B_TRUE 1 100 0.00 1.00000000000 BIT_MASK 0x1 FORMAT "%13.11" ECU_ADDRESS 0x60023708
 /begin IF_DATA XCPplus 0x0102
  /begin DAQ_EVENT VARIABLE /end DAQ_EVENT
 /end IF_DATA
/end MEASUREMENT
/begin MEASUREMENT Com_flgElCmprCurSampleFailr "" UBYTE B_TRUE 1 100 0.00 1.00000000000 BIT_MASK 0x1 FORMAT "%13.11" ECU_ADDRESS 0x60023707
 /begin IF_DATA XCPplus 0x0102
  /begin DAQ_EVENT VARIABLE /end DAQ_EVENT
 /end IF_DATA
/end MEASUREMENT
/begin MEASUREMENT Com_flgElCmprIgbtFailr "" UBYTE B_TRUE 1 100 0.00 1.00000000000 BIT_MASK 0x1 FORMAT "%13.11" ECU_ADDRESS 0x60023706
 /begin IF_DATA XCPplus 0x0102
  /begin DAQ_EVENT VARIABLE /end DAQ_EVENT
 /end IF_DATA
/end MEASUREMENT
/begin MEASUREMENT Com_flgElCmprLoUSplyFlt "" UBYTE B_TRUE 1 100 0.00 1.00000000000 BIT_MASK 0x1 FORMAT "%13.11" ECU_ADDRESS 0x60023705
 /begin IF_DATA XCPplus 0x0102
  /begin DAQ_EVENT VARIABLE /end DAQ_EVENT
 /end IF_DATA
/end MEASUREMENT
/begin MEASUREMENT Com_flgElCmprLoUUnderUFlt "" UBYTE B_TRUE 1 100 0.00 1.00000000000 BIT_MASK 0x1 FORMAT "%13.11" ECU_ADDRESS 0x60023704
 /begin IF_DATA XCPplus 0x0102
  /begin DAQ_EVENT VARIABLE /end DAQ_EVENT
 /end IF_DATA
/end MEASUREMENT
/begin MEASUREMENT Com_flgElCmprOverCurFlt "" UBYTE B_TRUE 1 100 0.00 1.00000000000 BIT_MASK 0x1 FORMAT "%13.11" ECU_ADDRESS 0x60023703
 /begin IF_DATA XCPplus 0x0102
  /begin DAQ_EVENT VARIABLE /end DAQ_EVENT
 /end IF_DATA
/end MEASUREMENT
/begin MEASUREMENT Com_flgElCmprOverHeatFailr "" UBYTE B_TRUE 1 100 0.00 1.00000000000 BIT_MASK 0x1 FORMAT "%13.11" ECU_ADDRESS 0x60023702
 /begin IF_DATA XCPplus 0x0102
  /begin DAQ_EVENT VARIABLE /end DAQ_EVENT
 /end IF_DATA
/end MEASUREMENT
/begin MEASUREMENT Com_flgElCmprOverLoad "" UBYTE B_TRUE 1 100 0.00 1.00000000000 BIT_MASK 0x1 FORMAT "%13.11" ECU_ADDRESS 0x60023701
 /begin IF_DATA XCPplus 0x0102
  /begin DAQ_EVENT VARIABLE /end DAQ_EVENT
 /end IF_DATA
/end MEASUREMENT
/begin MEASUREMENT Com_flgElCmprOverUFlt "" UBYTE B_TRUE 1 100 0.00 1.00000000000 BIT_MASK 0x1 FORMAT "%13.11" ECU_ADDRESS 0x60023700
 /begin IF_DATA XCPplus 0x0102
  /begin DAQ_EVENT VARIABLE /end DAQ_EVENT
 /end IF_DATA
/end MEASUREMENT
/begin MEASUREMENT Com_flgElCmprOverUMalfct "" UBYTE B_TRUE 1 100 0.00 1.00000000000 BIT_MASK 0x1 FORMAT "%13.11" ECU_ADDRESS 0x600236FF
 /begin IF_DATA XCPplus 0x0102
  /begin DAQ_EVENT VARIABLE /end DAQ_EVENT
 /end IF_DATA
/end MEASUREMENT
/begin MEASUREMENT Com_flgElCmprPhaFailr "" UBYTE B_TRUE 1 100 0.00 1.00000000000 BIT_MASK 0x1 FORMAT "%13.11" ECU_ADDRESS 0x600236FE
 /begin IF_DATA XCPplus 0x0102
  /begin DAQ_EVENT VARIABLE /end DAQ_EVENT
 /end IF_DATA
/end MEASUREMENT
/begin MEASUREMENT Com_flgElCmprStallFailr "" UBYTE B_TRUE 1 100 0.00 1.00000000000 BIT_MASK 0x1 FORMAT "%13.11" ECU_ADDRESS 0x600236FD
 /begin IF_DATA XCPplus 0x0102
  /begin DAQ_EVENT VARIABLE /end DAQ_EVENT
 /end IF_DATA
/end MEASUREMENT
/begin MEASUREMENT Com_flgElCmprTSnsrFailr "" UBYTE B_TRUE 1 100 0.00 1.00000000000 BIT_MASK 0x1 FORMAT "%13.11" ECU_ADDRESS 0x600236FC
 /begin IF_DATA XCPplus 0x0102
  /begin DAQ_EVENT VARIABLE /end DAQ_EVENT
 /end IF_DATA
/end MEASUREMENT
/begin MEASUREMENT Com_flgGearLvrMovmt "" UBYTE B_TRUE 1 100 0.00 1.00000000000 BIT_MASK 0x1 FORMAT "%13.11" ECU_ADDRESS 0x600236FB
 /begin IF_DATA XCPplus 0x0102
  /begin DAQ_EVENT VARIABLE /end DAQ_EVENT
 /end IF_DATA
/end MEASUREMENT
/begin MEASUREMENT Com_flgGunUnlckReq "" UBYTE B_TRUE 1 100 0.00 1.00000000000 BIT_MASK 0x1 FORMAT "%13.11" ECU_ADDRESS 0x600236FA
 /begin IF_DATA XCPplus 0x0102
  /begin DAQ_EVENT VARIABLE /end DAQ_EVENT
 /end IF_DATA
/end MEASUREMENT
/begin MEASUREMENT Com_flgHvBattAuthn "" UBYTE B_TRUE 1 100 0.00 1.00000000000 BIT_MASK 0x1 FORMAT "%13.11" ECU_ADDRESS 0x600236F9
 /begin IF_DATA XCPplus 0x0102
  /begin DAQ_EVENT VARIABLE /end DAQ_EVENT
 /end IF_DATA
/end MEASUREMENT
/begin MEASUREMENT Com_flgPDUProgmFailr "" UBYTE B_TRUE 1 100 0.00 1.00000000000 BIT_MASK 0x1 FORMAT "%13.11" ECU_ADDRESS 0x600236F8
 /begin IF_DATA XCPplus 0x0102
  /begin DAQ_EVENT VARIABLE /end DAQ_EVENT
 /end IF_DATA
/end MEASUREMENT
/begin MEASUREMENT Com_flgRstTripAEE "AFE Reset" UBYTE B_TRUE 1 100 0.00 1.00000000000 BIT_MASK 0x1 FORMAT "%13.11" ECU_ADDRESS 0x600236F7
 /begin IF_DATA XCPplus 0x0102
  /begin DAQ_EVENT VARIABLE /end DAQ_EVENT
 /end IF_DATA
/end MEASUREMENT
/begin MEASUREMENT Com_flgRstTripAEE_A "AEE Trip A" UBYTE B_TRUE 1 100 0.00 1.00000000000 BIT_MASK 0x1 FORMAT "%13.11" ECU_ADDRESS 0x600236F6
 /begin IF_DATA XCPplus 0x0102
  /begin DAQ_EVENT VARIABLE /end DAQ_EVENT
 /end IF_DATA
/end MEASUREMENT
/begin MEASUREMENT Com_flgRstTripAEE_B "AEE Trip B" UBYTE B_TRUE 1 100 0.00 1.00000000000 BIT_MASK 0x1 FORMAT "%13.11" ECU_ADDRESS 0x600236F5
 /begin IF_DATA XCPplus 0x0102
  /begin DAQ_EVENT VARIABLE /end DAQ_EVENT
 /end IF_DATA
/end MEASUREMENT
/begin MEASUREMENT Com_flgTPcbMeasmtErr "Flag to indicate TPcba temperature measurement-error" UBYTE B_TRUE 1 100 0.00 1.00000000000 BIT_MASK 0x1 FORMAT "%13.11" ECU_ADDRESS 0x600236F4
 /begin IF_DATA XCPplus 0x0102
  /begin DAQ_EVENT VARIABLE /end DAQ_EVENT
 /end IF_DATA
/end MEASUREMENT
/begin MEASUREMENT Com_flgTPcbMeasmtVld "Flag to indicate TPcba measurement invalid" UBYTE B_TRUE 1 100 0.00 1.00000000000 BIT_MASK 0x1 FORMAT "%13.11" ECU_ADDRESS 0x600236F3
 /begin IF_DATA XCPplus 0x0102
  /begin DAQ_EVENT VARIABLE /end DAQ_EVENT
 /end IF_DATA
/end MEASUREMENT
/begin MEASUREMENT Com_flgTPcbRngErr "Flag to indicate TPcba out of range error" UBYTE B_TRUE 1 100 0.00 1.00000000000 BIT_MASK 0x1 FORMAT "%13.11" ECU_ADDRESS 0x600236F2
 /begin IF_DATA XCPplus 0x0102
  /begin DAQ_EVENT VARIABLE /end DAQ_EVENT
 /end IF_DATA
/end MEASUREMENT
/begin MEASUREMENT Com_flgTPcbSysErr "Flag to indicate TPbca system error" UBYTE B_TRUE 1 100 0.00 1.00000000000 BIT_MASK 0x1 FORMAT "%13.11" ECU_ADDRESS 0x600236F1
 /begin IF_DATA XCPplus 0x0102
  /begin DAQ_EVENT VARIABLE /end DAQ_EVENT
 /end IF_DATA
/end MEASUREMENT
/begin MEASUREMENT Com_flgTShntMeasmtErr "Flag to indicate TShunt measurement error" UBYTE B_TRUE 1 100 0.00 1.00000000000 BIT_MASK 0x1 FORMAT "%13.11" ECU_ADDRESS 0x600236F0
 /begin IF_DATA XCPplus 0x0102
  /begin DAQ_EVENT VARIABLE /end DAQ_EVENT
 /end IF_DATA
/end MEASUREMENT
/begin MEASUREMENT Com_flgTShntMeasmtVld "Flag to indicate TShunt measurement invalid" UBYTE B_TRUE 1 100 0.00 1.00000000000 BIT_MASK 0x1 FORMAT "%13.11" ECU_ADDRESS 0x600236EF
 /begin IF_DATA XCPplus 0x0102
  /begin DAQ_EVENT VARIABLE /end DAQ_EVENT
 /end IF_DATA
/end MEASUREMENT
/begin MEASUREMENT Com_flgTShntRngErr "Flag to indicate TShunt out of range error" UBYTE B_TRUE 1 100 0.00 1.00000000000 BIT_MASK 0x1 FORMAT "%13.11" ECU_ADDRESS 0x600236EE
 /begin IF_DATA XCPplus 0x0102
  /begin DAQ_EVENT VARIABLE /end DAQ_EVENT
 /end IF_DATA
/end MEASUREMENT
/begin MEASUREMENT Com_flgTShntSysErr "Flag to indicate TShunt system error" UBYTE B_TRUE 1 100 0.00 1.00000000000 BIT_MASK 0x1 FORMAT "%13.11" ECU_ADDRESS 0x600236ED
 /begin IF_DATA XCPplus 0x0102
  /begin DAQ_EVENT VARIABLE /end DAQ_EVENT
 /end IF_DATA
/end MEASUREMENT
/begin MEASUREMENT Com_flgVehSpdAvl "" UBYTE OneToOne 1 100 0.00 3.000 FORMAT "%5.3" ECU_ADDRESS 0x60023847
 /begin IF_DATA XCPplus 0x0102
  /begin DAQ_EVENT VARIABLE /end DAQ_EVENT
 /end IF_DATA
/end MEASUREMENT
/begin MEASUREMENT Com_flgVoltMeasmtErr "Flag to indicate UBusPos measurement error" UBYTE B_TRUE 1 100 0.00 1.00000000000 BIT_MASK 0x1 FORMAT "%13.11" ECU_ADDRESS 0x600236EC
 /begin IF_DATA XCPplus 0x0102
  /begin DAQ_EVENT VARIABLE /end DAQ_EVENT
 /end IF_DATA
/end MEASUREMENT
/begin MEASUREMENT Com_flgVoltMeasmtSysErr "Flag to indicate UBusPos measurement system error" UBYTE B_TRUE 1 100 0.00 1.00000000000 BIT_MASK 0x1 FORMAT "%13.11" ECU_ADDRESS 0x600236EB
 /begin IF_DATA XCPplus 0x0102
  /begin DAQ_EVENT VARIABLE /end DAQ_EVENT
 /end IF_DATA
/end MEASUREMENT
/begin MEASUREMENT Com_flgVoltMeasmtVld "Flag to indicate UBusPos measurement invalid" UBYTE B_TRUE 1 100 0.00 1.00000000000 BIT_MASK 0x1 FORMAT "%13.11" ECU_ADDRESS 0x600236EA
 /begin IF_DATA XCPplus 0x0102
  /begin DAQ_EVENT VARIABLE /end DAQ_EVENT
 /end IF_DATA
/end MEASUREMENT
/begin MEASUREMENT Com_flgVoltRngErr "Flag to indicate UBusPos out of range error" UBYTE B_TRUE 1 100 0.00 1.00000000000 BIT_MASK 0x1 FORMAT "%13.11" ECU_ADDRESS 0x600236E9
 /begin IF_DATA XCPplus 0x0102
  /begin DAQ_EVENT VARIABLE /end DAQ_EVENT
 /end IF_DATA
/end MEASUREMENT
/begin MEASUREMENT Com_GwBuf_CONTACT_FREIN_PRK "buffer interface to hold data" UBYTE OneToOne 1 100 0.00 255.0 FORMAT "%5.1" ECU_ADDRESS 0x60023859
 /begin IF_DATA XCPplus 0x0102
  /begin DAQ_EVENT VARIABLE /end DAQ_EVENT
 /end IF_DATA
/end MEASUREMENT
/begin MEASUREMENT Com_GwBuf_DCDC_IP_POWER "buffer interface to hold data" UWORD OneToOne 1 100 0.00 65535.00 FORMAT "%8.2" ECU_ADDRESS 0x6001FD1C
 /begin IF_DATA XCPplus 0x0102
  /begin DAQ_EVENT VARIABLE /end DAQ_EVENT
 /end IF_DATA
/end MEASUREMENT
/begin MEASUREMENT Com_GwBuf_eCOMP_Power_consumption "buffer interface to hold data" UWORD OneToOne 1 100 0.00 65535.00 FORMAT "%8.2" ECU_ADDRESS 0x6001FD04
 /begin IF_DATA XCPplus 0x0102
  /begin DAQ_EVENT VARIABLE /end DAQ_EVENT
 /end IF_DATA
/end MEASUREMENT
/begin MEASUREMENT Com_GwBuf_HVBAT_ALERT_LOW_BATT_ENERGY "buffer interface to hold data" UBYTE OneToOne 1 100 0.00 255.0 FORMAT "%5.1" ECU_ADDRESS 0x60023858
 /begin IF_DATA XCPplus 0x0102
  /begin DAQ_EVENT VARIABLE /end DAQ_EVENT
 /end IF_DATA
/end MEASUREMENT
/begin MEASUREMENT Com_GwBuf_HVBAT_CHARGING_STATUS "buffer interface to hold data" UBYTE OneToOne 1 100 0.00 255.0 FORMAT "%5.1" ECU_ADDRESS 0x60023857
 /begin IF_DATA XCPplus 0x0102
  /begin DAQ_EVENT VARIABLE /end DAQ_EVENT
 /end IF_DATA
/end MEASUREMENT
/begin MEASUREMENT Com_GwBuf_HVBAT_HVIL_STS "buffer interface to hold data" UBYTE OneToOne 1 100 0.00 255.0 FORMAT "%5.1" ECU_ADDRESS 0x60023856
 /begin IF_DATA XCPplus 0x0102
  /begin DAQ_EVENT VARIABLE /end DAQ_EVENT
 /end IF_DATA
/end MEASUREMENT
/begin MEASUREMENT Com_GwBuf_HVBAT_INSULATION_FAULT "buffer interface to hold data" UBYTE OneToOne 1 100 0.00 255.0 FORMAT "%5.1" ECU_ADDRESS 0x60023855
 /begin IF_DATA XCPplus 0x0102
  /begin DAQ_EVENT VARIABLE /end DAQ_EVENT
 /end IF_DATA
/end MEASUREMENT
/begin MEASUREMENT Com_GwBuf_HVBAT_INSULATION_RESISTANCE "buffer interface to hold data" UWORD OneToOne 1 100 0.00 65535.00 FORMAT "%8.2" ECU_ADDRESS 0x6001FD1A
 /begin IF_DATA XCPplus 0x0102
  /begin DAQ_EVENT VARIABLE /end DAQ_EVENT
 /end IF_DATA
/end MEASUREMENT
/begin MEASUREMENT Com_GwBuf_HVBAT_MAX_CELL_VOLT "buffer interface to hold data" UWORD OneToOne 1 100 0.00 65535.00 FORMAT "%8.2" ECU_ADDRESS 0x6001FD18
 /begin IF_DATA XCPplus 0x0102
  /begin DAQ_EVENT VARIABLE /end DAQ_EVENT
 /end IF_DATA
/end MEASUREMENT
/begin MEASUREMENT Com_GwBuf_HVBAT_MAX_CELL_VOLT_NUM "buffer interface to hold data" UBYTE OneToOne 1 100 0.00 255.0 FORMAT "%5.1" ECU_ADDRESS 0x60023854
 /begin IF_DATA XCPplus 0x0102
  /begin DAQ_EVENT VARIABLE /end DAQ_EVENT
 /end IF_DATA
/end MEASUREMENT
/begin MEASUREMENT Com_GwBuf_HVBAT_MIN_CELL_VOLT "buffer interface to hold data" UWORD OneToOne 1 100 0.00 65535.00 FORMAT "%8.2" ECU_ADDRESS 0x6001FD16
 /begin IF_DATA XCPplus 0x0102
  /begin DAQ_EVENT VARIABLE /end DAQ_EVENT
 /end IF_DATA
/end MEASUREMENT
/begin MEASUREMENT Com_GwBuf_HVBAT_MIN_CELL_VOLT_NUM "buffer interface to hold data" UBYTE OneToOne 1 100 0.00 255.0 FORMAT "%5.1" ECU_ADDRESS 0x60023853
 /begin IF_DATA XCPplus 0x0102
  /begin DAQ_EVENT VARIABLE /end DAQ_EVENT
 /end IF_DATA
/end MEASUREMENT
/begin MEASUREMENT Com_GwBuf_HVBAT_SOC_ACTUAL "Data Buffer for SOC_ACTUAL signal" UWORD OneToOne 1 100 0.00 65535.00 FORMAT "%8.2" ECU_ADDRESS 0x6001FD14
 /begin IF_DATA XCPplus 0x0102
  /begin DAQ_EVENT VARIABLE /end DAQ_EVENT
 /end IF_DATA
/end MEASUREMENT
/begin MEASUREMENT Com_GwBuf_HVBAT_SOC_DISPLAY "buffer interface to hold data" UWORD OneToOne 1 100 0.00 65535.00 FORMAT "%8.2" ECU_ADDRESS 0x6001FD12
 /begin IF_DATA XCPplus 0x0102
  /begin DAQ_EVENT VARIABLE /end DAQ_EVENT
 /end IF_DATA
/end MEASUREMENT
/begin MEASUREMENT Com_GwBuf_HVBAT_SOH "buffer interface to hold data" UBYTE OneToOne 1 100 0.00 255.0 FORMAT "%5.1" ECU_ADDRESS 0x60023852
 /begin IF_DATA XCPplus 0x0102
  /begin DAQ_EVENT VARIABLE /end DAQ_EVENT
 /end IF_DATA
/end MEASUREMENT
/begin MEASUREMENT Com_GwBuf_HVBAT_TEMPERATURE "Com GW buffer for HVBAT_TEMPERATURE signal" UWORD OneToOne 1 100 0.00 65535.00 FORMAT "%8.2" ECU_ADDRESS 0x6001FD10
 /begin IF_DATA XCPplus 0x0102
  /begin DAQ_EVENT VARIABLE /end DAQ_EVENT
 /end IF_DATA
/end MEASUREMENT
/begin MEASUREMENT Com_GwBuf_HVBAT_THERMAL_RUNAWAY "Data Buffer for THERMAL_RUNAWAY signal" UBYTE OneToOne 1 100 0.00 255.0 FORMAT "%5.1" ECU_ADDRESS 0x60023851
 /begin IF_DATA XCPplus 0x0102
  /begin DAQ_EVENT VARIABLE /end DAQ_EVENT
 /end IF_DATA
/end MEASUREMENT
/begin MEASUREMENT Com_GwBuf_HV_BATT_MIN_VOLT_WARN "buffer interface to hold data" UBYTE OneToOne 1 100 0.00 255.0 FORMAT "%5.1" ECU_ADDRESS 0x60023850
 /begin IF_DATA XCPplus 0x0102
  /begin DAQ_EVENT VARIABLE /end DAQ_EVENT
 /end IF_DATA
/end MEASUREMENT
/begin MEASUREMENT Com_GwBuf_HV_BATT_SOH_RES "buffer interface to hold data" UBYTE OneToOne 1 100 0.00 255.0 FORMAT "%5.1" ECU_ADDRESS 0x6002384F
 /begin IF_DATA XCPplus 0x0102
  /begin DAQ_EVENT VARIABLE /end DAQ_EVENT
 /end IF_DATA
/end MEASUREMENT
/begin MEASUREMENT Com_GwBuf_HV_BATT_TEMP_AVG "buffer interface to hold data" UBYTE OneToOne 1 100 0.00 255.0 FORMAT "%5.1" ECU_ADDRESS 0x6002384E
 /begin IF_DATA XCPplus 0x0102
  /begin DAQ_EVENT VARIABLE /end DAQ_EVENT
 /end IF_DATA
/end MEASUREMENT
/begin MEASUREMENT Com_GwBuf_INV_MTR_INST_INPUT_POWER "buffer interface to hold data" UWORD OneToOne 1 100 0.00 65535.00 FORMAT "%8.2" ECU_ADDRESS 0x6001FD0E
 /begin IF_DATA XCPplus 0x0102
  /begin DAQ_EVENT VARIABLE /end DAQ_EVENT
 /end IF_DATA
/end MEASUREMENT
/begin MEASUREMENT Com_GwBuf_MAIN_RELAY_ACTUATION_COUNTER "buffer interface to hold data" UWORD OneToOne 1 100 0.00 65535.00 FORMAT "%8.2" ECU_ADDRESS 0x6001FD0C
 /begin IF_DATA XCPplus 0x0102
  /begin DAQ_EVENT VARIABLE /end DAQ_EVENT
 /end IF_DATA
/end MEASUREMENT
/begin MEASUREMENT Com_GwBuf_TIME_HV_BATT_OVER_TEMPERATURE "buffer interface to hold data" UWORD OneToOne 1 100 0.00 65535.00 FORMAT "%8.2" ECU_ADDRESS 0x6001FD0A
 /begin IF_DATA XCPplus 0x0102
  /begin DAQ_EVENT VARIABLE /end DAQ_EVENT
 /end IF_DATA
/end MEASUREMENT
/begin MEASUREMENT Com_GwBuf_TOTAL_HV_BATT_POS_QTY_CURR "buffer interface to hold data" UWORD OneToOne 1 100 0.00 65535.00 FORMAT "%8.2" ECU_ADDRESS 0x6001FD08
 /begin IF_DATA XCPplus 0x0102
  /begin DAQ_EVENT VARIABLE /end DAQ_EVENT
 /end IF_DATA
/end MEASUREMENT
/begin MEASUREMENT Com_GwBuf_VITESSE_VEHICULE_ROUES "buffer interface to hold data" UWORD OneToOne 1 100 0.00 65535.00 FORMAT "%8.2" ECU_ADDRESS 0x6001FD06
 /begin IF_DATA XCPplus 0x0102
  /begin DAQ_EVENT VARIABLE /end DAQ_EVENT
 /end IF_DATA
/end MEASUREMENT
/begin MEASUREMENT Com_GwBuf_VVH_INDISP "buffer interface to hold data" UBYTE OneToOne 1 100 0.00 255.0 FORMAT "%5.1" ECU_ADDRESS 0x6002384D
 /begin IF_DATA XCPplus 0x0102
  /begin DAQ_EVENT VARIABLE /end DAQ_EVENT
 /end IF_DATA
/end MEASUREMENT
/begin MEASUREMENT Com_Gw_Buf_HVBAT_REMAININGBATTCAPACITY "buffer interface to hold data" ULONG OneToOne 1 100 0.00 4294967295.00 FORMAT "%13.2" ECU_ADDRESS 0x60001084
 /begin IF_DATA XCPplus 0x0102
  /begin DAQ_EVENT VARIABLE /end DAQ_EVENT
 /end IF_DATA
/end MEASUREMENT
/begin MEASUREMENT Com_HvbMaxSnsrTempRx "" SWORD RBPtCel_t_1p0_om40_1 1 100 -40.0000 125.0000 FORMAT "%8.4" ECU_ADDRESS 0x6001FE60
 /begin IF_DATA XCPplus 0x0102
  /begin DAQ_EVENT VARIABLE /end DAQ_EVENT
 /end IF_DATA
/end MEASUREMENT
/begin MEASUREMENT Com_iBattEBS1Rx "" UWORD q1Em3_om1_A 1 100 -1.000000 1.000000 FORMAT "%8.6" ECU_ADDRESS 0x6001FCF6
 /begin IF_DATA XCPplus 0x0102
  /begin DAQ_EVENT VARIABLE /end DAQ_EVENT
 /end IF_DATA
/end MEASUREMENT
/begin MEASUREMENT Com_iBattEBS2Rx "" UWORD q0p01_om200_A 1 100 -200.0000 200.0000 FORMAT "%8.4" ECU_ADDRESS 0x6001FCF4
 /begin IF_DATA XCPplus 0x0102
  /begin DAQ_EVENT VARIABLE /end DAQ_EVENT
 /end IF_DATA
/end MEASUREMENT
/begin MEASUREMENT Com_iBattEBS3Rx "" UWORD q0p1_om1500_A 1 100 -1500.000 1500.000 FORMAT "%8.3" ECU_ADDRESS 0x6001FCF2
 /begin IF_DATA XCPplus 0x0102
  /begin DAQ_EVENT VARIABLE /end DAQ_EVENT
 /end IF_DATA
/end MEASUREMENT
/begin MEASUREMENT Com_iDcdcHvActRvsn1 "Com message DCDC current at HV side Revision 1" SWORD Curr_A_q0p03125_COMPU 1 100 -1024.000 1023.969 FORMAT "%8.3" ECU_ADDRESS 0x6001FE5E
 /begin IF_DATA XCPplus 0x0102
  /begin DAQ_EVENT VARIABLE /end DAQ_EVENT
 /end IF_DATA
/end MEASUREMENT
/begin MEASUREMENT Com_iDcdcLvActRvsn1 "Com message DCDC current at LV side Revision 1" SWORD OneToOne 1 100 -32768.00 32767.00 FORMAT "%8.2" ECU_ADDRESS 0x6001FE5C
 /begin IF_DATA XCPplus 0x0102
  /begin DAQ_EVENT VARIABLE /end DAQ_EVENT
 /end IF_DATA
/end MEASUREMENT
/begin MEASUREMENT Com_iElCmprHvAct "Validity of measured compressor current" UBYTE q0p1_A 1 100 0.00 25.00 FORMAT "%5.2" ECU_ADDRESS 0x60023846
 /begin IF_DATA XCPplus 0x0102
  /begin DAQ_EVENT VARIABLE /end DAQ_EVENT
 /end IF_DATA
/end MEASUREMENT
/begin MEASUREMENT Com_iElCmprPeakPha "" UBYTE q0p05_A 1 100 0.00 12.75 FORMAT "%5.2" ECU_ADDRESS 0x60023845
 /begin IF_DATA XCPplus 0x0102
  /begin DAQ_EVENT VARIABLE /end DAQ_EVENT
 /end IF_DATA
/end MEASUREMENT
/begin MEASUREMENT Com_iHvbActRx "" SWORD q0p1_A 1 100 -3276.800 3276.700 FORMAT "%8.3" ECU_ADDRESS 0x6001FE5A
 /begin IF_DATA XCPplus 0x0102
  /begin DAQ_EVENT VARIABLE /end DAQ_EVENT
 /end IF_DATA
/end MEASUREMENT
/begin MEASUREMENT Com_iHvbChrgMaxSho "Short-term Maximum Charging current of HV Battery" SWORD Curr_A_q0p03125_COMPU 1 100 -1024.000 1023.969 FORMAT "%8.3" ECU_ADDRESS 0x6001FE58
 /begin IF_DATA XCPplus 0x0102
  /begin DAQ_EVENT VARIABLE /end DAQ_EVENT
 /end IF_DATA
/end MEASUREMENT
/begin MEASUREMENT Com_iHvbDchaMaxSho "Short-term Maximum Discharging current of HV Battery" SWORD Curr_A_q0p03125_COMPU 1 100 -1024.000 1023.969 FORMAT "%8.3" ECU_ADDRESS 0x6001FE56
 /begin IF_DATA XCPplus 0x0102
  /begin DAQ_EVENT VARIABLE /end DAQ_EVENT
 /end IF_DATA
/end MEASUREMENT
/begin MEASUREMENT Com_iHvbDes "Maximum charging long term current" SWORD Curr_A_q0p03125_COMPU 1 100 -1024.000 1023.969 FORMAT "%8.3" ECU_ADDRESS 0x6001FE54
 /begin IF_DATA XCPplus 0x0102
  /begin DAQ_EVENT VARIABLE /end DAQ_EVENT
 /end IF_DATA
/end MEASUREMENT
/begin MEASUREMENT Com_iHvbNomChrgn "Max. static DC charging current limit;Static value for charging station, sent once at the beginning. Based on aging, not on Temp or SOC. GBT-BCP" SWORD Curr_A_q0p03125_COMPU 1 100 -1024.000 1023.969 FORMAT "%8.3" ECU_ADDRESS 0x6001FE52
 /begin IF_DATA XCPplus 0x0102
  /begin DAQ_EVENT VARIABLE /end DAQ_EVENT
 /end IF_DATA
/end MEASUREMENT
/begin MEASUREMENT Com_lTotOdometer "Total distance [km]" ULONG Length_km 1 100 0.00 4294967295.00 FORMAT "%13.2" ECU_ADDRESS 0x60001074
 /begin IF_DATA XCPplus 0x0102
  /begin DAQ_EVENT VARIABLE /end DAQ_EVENT
 /end IF_DATA
/end MEASUREMENT
/begin MEASUREMENT Com_nElCmprActl "" SWORD RBPtCel_n_10p0_1 1 100 -32770.00 32770.00 FORMAT "%8.2" ECU_ADDRESS 0x6001FE50
 /begin IF_DATA XCPplus 0x0102
  /begin DAQ_EVENT VARIABLE /end DAQ_EVENT
 /end IF_DATA
/end MEASUREMENT
/begin MEASUREMENT Com_nrSerMaxCell "" UBYTE OneToOne 1 100 1.0 250.0 FORMAT "%5.1" ECU_ADDRESS 0x6002383C
 /begin IF_DATA XCPplus 0x0102
  /begin DAQ_EVENT VARIABLE /end DAQ_EVENT
 /end IF_DATA
/end MEASUREMENT
/begin MEASUREMENT Com_nrSerMinCell "" UBYTE OneToOne 1 100 1.0 250.0 FORMAT "%5.1" ECU_ADDRESS 0x6002383B
 /begin IF_DATA XCPplus 0x0102
  /begin DAQ_EVENT VARIABLE /end DAQ_EVENT
 /end IF_DATA
/end MEASUREMENT
/begin MEASUREMENT Com_pwrDcdcOutpCpby "DCDC output power capability CAN signal" UWORD RBPtCel_pwr_1p0_1 1 100 0.00 3000.000 FORMAT "%8.3" ECU_ADDRESS 0x6001FCF0
 /begin IF_DATA XCPplus 0x0102
  /begin DAQ_EVENT VARIABLE /end DAQ_EVENT
 /end IF_DATA
/end MEASUREMENT
/begin MEASUREMENT Com_pwrElCmprActl "" UWORD q10_W 1 100 0.00 8000.000 FORMAT "%8.3" ECU_ADDRESS 0x6001FCEE
 /begin IF_DATA XCPplus 0x0102
  /begin DAQ_EVENT VARIABLE /end DAQ_EVENT
 /end IF_DATA
/end MEASUREMENT
/begin MEASUREMENT Com_pwrMaxChrgSho "Maximum power short charging" UWORD q0p1_kW 1 100 0.00 160.0000 FORMAT "%8.4" ECU_ADDRESS 0x6001FCEC
 /begin IF_DATA XCPplus 0x0102
  /begin DAQ_EVENT VARIABLE /end DAQ_EVENT
 /end IF_DATA
/end MEASUREMENT
/begin MEASUREMENT Com_pwrMaxDchaSho "Maximum power short discharging" UWORD q0p1_kW 1 100 0.00 160.0000 FORMAT "%8.4" ECU_ADDRESS 0x6001FCEA
 /begin IF_DATA XCPplus 0x0102
  /begin DAQ_EVENT VARIABLE /end DAQ_EVENT
 /end IF_DATA
/end MEASUREMENT
/begin MEASUREMENT Com_qHvbTotCpRx "" SWORD RBPtCel_q_0p125_1 1 100 -4096.000 4095.875 FORMAT "%8.3" ECU_ADDRESS 0x6001FE4E
 /begin IF_DATA XCPplus 0x0102
  /begin DAQ_EVENT VARIABLE /end DAQ_EVENT
 /end IF_DATA
/end MEASUREMENT
/begin MEASUREMENT Com_ratHvbSoc "State of charge of the HV battery" SWORD Prc 1 100 -400.0000 399.9878 FORMAT "%8.4" ECU_ADDRESS 0x6001FE4C
 /begin IF_DATA XCPplus 0x0102
  /begin DAQ_EVENT VARIABLE /end DAQ_EVENT
 /end IF_DATA
/end MEASUREMENT
/begin MEASUREMENT Com_ratHvbSoh "Tansmitted Message HV Battery Health" UBYTE RBPtCel_Perc_1p0_1 1 100 0.00 100.0 FORMAT "%5.1" ECU_ADDRESS 0x6002383A
 /begin IF_DATA XCPplus 0x0102
  /begin DAQ_EVENT VARIABLE /end DAQ_EVENT
 /end IF_DATA
/end MEASUREMENT
/begin MEASUREMENT Com_ratRHvbSoh "Transmitted Message HV Battery Health" UBYTE RBPtCel_Perc_1p0_1 1 100 0.00 100.0 FORMAT "%5.1" ECU_ADDRESS 0x60023839
 /begin IF_DATA XCPplus 0x0102
  /begin DAQ_EVENT VARIABLE /end DAQ_EVENT
 /end IF_DATA
/end MEASUREMENT
/begin MEASUREMENT Com_ratSocLvBatt "Battery SOC received from Ebs sensor" UBYTE RBPtCel_Perc_1p0_1 1 100 0.00 255.0 FORMAT "%5.1" ECU_ADDRESS 0x60023838
 /begin IF_DATA XCPplus 0x0102
  /begin DAQ_EVENT VARIABLE /end DAQ_EVENT
 /end IF_DATA
/end MEASUREMENT
/begin MEASUREMENT Com_rHvbIsoMeasmt "Isolation resolution" UWORD q1_kOhm 1 100 0.00 60000.00 FORMAT "%8.2" ECU_ADDRESS 0x6001FCE8
 /begin IF_DATA XCPplus 0x0102
  /begin DAQ_EVENT VARIABLE /end DAQ_EVENT
 /end IF_DATA
/end MEASUREMENT
/begin MEASUREMENT Com_stABSActv "Status of ABS" UBYTE B_TRUE 1 100 0.00 1.00000000000 BIT_MASK 0x1 FORMAT "%13.11" ECU_ADDRESS 0x600236E8
 /begin IF_DATA XCPplus 0x0102
  /begin DAQ_EVENT VARIABLE /end DAQ_EVENT
 /end IF_DATA
/end MEASUREMENT
/begin MEASUREMENT Com_stAC "Air Conditioner(AC) State" UBYTE OneToOne 1 100 0.00 3.000 FORMAT "%5.3" ECU_ADDRESS 0x60023837
 /begin IF_DATA XCPplus 0x0102
  /begin DAQ_EVENT VARIABLE /end DAQ_EVENT
 /end IF_DATA
/end MEASUREMENT
/begin MEASUREMENT Com_stAirbCrashSev "" UBYTE OneToOne 1 100 0.00 7.000 FORMAT "%5.3" ECU_ADDRESS 0x60023836
 /begin IF_DATA XCPplus 0x0102
  /begin DAQ_EVENT VARIABLE /end DAQ_EVENT
 /end IF_DATA
/end MEASUREMENT
/begin MEASUREMENT Com_stAirbCrashSevCpl "" UBYTE OneToOne 1 100 0.00 7.000 FORMAT "%5.3" ECU_ADDRESS 0x60023835
 /begin IF_DATA XCPplus 0x0102
  /begin DAQ_EVENT VARIABLE /end DAQ_EVENT
 /end IF_DATA
/end MEASUREMENT
/begin MEASUREMENT Com_stAlrtThermRunAwy "" UBYTE OneToOne 1 100 0.00 3.000 FORMAT "%5.3" ECU_ADDRESS 0x60023834
 /begin IF_DATA XCPplus 0x0102
  /begin DAQ_EVENT VARIABLE /end DAQ_EVENT
 /end IF_DATA
/end MEASUREMENT
/begin MEASUREMENT Com_stBlowrRly "Definition of Com_stBlowrRly" UBYTE OneToOne 1 100 0.00 3.000 FORMAT "%5.3" ECU_ADDRESS 0x60023833
 /begin IF_DATA XCPplus 0x0102
  /begin DAQ_EVENT VARIABLE /end DAQ_EVENT
 /end IF_DATA
/end MEASUREMENT
/begin MEASUREMENT Com_stChrgnSpstReq "Charging Spst Request" UBYTE OneToOne 1 100 0.00 3.000 FORMAT "%5.3" ECU_ADDRESS 0x60023830
 /begin IF_DATA XCPplus 0x0102
  /begin DAQ_EVENT VARIABLE /end DAQ_EVENT
 /end IF_DATA
/end MEASUREMENT
/begin MEASUREMENT Com_stDayNight "Com_stDayNight" UBYTE OneToOne 1 100 0.00 1.000 FORMAT "%5.3" ECU_ADDRESS 0x6002382F
 /begin IF_DATA XCPplus 0x0102
  /begin DAQ_EVENT VARIABLE /end DAQ_EVENT
 /end IF_DATA
/end MEASUREMENT
/begin MEASUREMENT Com_stDcdcEVLmp "State of EV Lamp ON from DCDC" UBYTE OneToOne 1 100 0.00 3.000 FORMAT "%5.3" ECU_ADDRESS 0x6002382E
 /begin IF_DATA XCPplus 0x0102
  /begin DAQ_EVENT VARIABLE /end DAQ_EVENT
 /end IF_DATA
/end MEASUREMENT
/begin MEASUREMENT Com_stDcdcFltLvl "DCDC fault level indication" UBYTE OneToOne 1 100 0.00 7.000 FORMAT "%5.3" ECU_ADDRESS 0x6002382D
 /begin IF_DATA XCPplus 0x0102
  /begin DAQ_EVENT VARIABLE /end DAQ_EVENT
 /end IF_DATA
/end MEASUREMENT
/begin MEASUREMENT Com_stDcdcMstWrnLmp "State of Master Warning Lamp ON from DCDC" UBYTE OneToOne 1 100 0.00 3.000 FORMAT "%5.3" ECU_ADDRESS 0x6002382C
 /begin IF_DATA XCPplus 0x0102
  /begin DAQ_EVENT VARIABLE /end DAQ_EVENT
 /end IF_DATA
/end MEASUREMENT
/begin MEASUREMENT Com_stDcdcOperModActRx "" UBYTE OneToOne 1 100 0.00 8.000 FORMAT "%5.3" ECU_ADDRESS 0x6002382B
 /begin IF_DATA XCPplus 0x0102
  /begin DAQ_EVENT VARIABLE /end DAQ_EVENT
 /end IF_DATA
/end MEASUREMENT
/begin MEASUREMENT Com_stDcdcPerfLimnActv "" UBYTE OneToOne 1 100 0.00 3.000 FORMAT "%5.3" ECU_ADDRESS 0x6002382A
 /begin IF_DATA XCPplus 0x0102
  /begin DAQ_EVENT VARIABLE /end DAQ_EVENT
 /end IF_DATA
/end MEASUREMENT
/begin MEASUREMENT Com_stDcdcSVSLmp "State of SVS Lamp ON from DCDC" UBYTE OneToOne 1 100 0.00 3.000 FORMAT "%5.3" ECU_ADDRESS 0x60023829
 /begin IF_DATA XCPplus 0x0102
  /begin DAQ_EVENT VARIABLE /end DAQ_EVENT
 /end IF_DATA
/end MEASUREMENT
/begin MEASUREMENT Com_stDcdcULimReq "Signal quality of LV Output Voltage limit request" UBYTE OneToOne 1 100 0.00 3.000 FORMAT "%5.3" ECU_ADDRESS 0x60023828
 /begin IF_DATA XCPplus 0x0102
  /begin DAQ_EVENT VARIABLE /end DAQ_EVENT
 /end IF_DATA
/end MEASUREMENT
/begin MEASUREMENT Com_stDoor1 "" UBYTE B_TRUE 1 100 0.00 1.00000000000 BIT_MASK 0x1 FORMAT "%13.11" ECU_ADDRESS 0x600236E7
 /begin IF_DATA XCPplus 0x0102
  /begin DAQ_EVENT VARIABLE /end DAQ_EVENT
 /end IF_DATA
/end MEASUREMENT
/begin MEASUREMENT Com_stDoor2 "" UBYTE B_TRUE 1 100 0.00 1.00000000000 BIT_MASK 0x1 FORMAT "%13.11" ECU_ADDRESS 0x600236E6
 /begin IF_DATA XCPplus 0x0102
  /begin DAQ_EVENT VARIABLE /end DAQ_EVENT
 /end IF_DATA
/end MEASUREMENT
/begin MEASUREMENT Com_stDoor3 "" UBYTE B_TRUE 1 100 0.00 1.00000000000 BIT_MASK 0x1 FORMAT "%13.11" ECU_ADDRESS 0x600236E5
 /begin IF_DATA XCPplus 0x0102
  /begin DAQ_EVENT VARIABLE /end DAQ_EVENT
 /end IF_DATA
/end MEASUREMENT
/begin MEASUREMENT Com_stDoor4 "" UBYTE B_TRUE 1 100 0.00 1.00000000000 BIT_MASK 0x1 FORMAT "%13.11" ECU_ADDRESS 0x600236E4
 /begin IF_DATA XCPplus 0x0102
  /begin DAQ_EVENT VARIABLE /end DAQ_EVENT
 /end IF_DATA
/end MEASUREMENT
/begin MEASUREMENT Com_stDrvStBltRx "" UBYTE OneToOne 1 100 0.00 3.000 FORMAT "%5.3" ECU_ADDRESS 0x60023827
 /begin IF_DATA XCPplus 0x0102
  /begin DAQ_EVENT VARIABLE /end DAQ_EVENT
 /end IF_DATA
/end MEASUREMENT
/begin MEASUREMENT Com_stElCmprFltLvl "" UBYTE OneToOne 1 100 0.00 7.000 FORMAT "%5.3" ECU_ADDRESS 0x60023826
 /begin IF_DATA XCPplus 0x0102
  /begin DAQ_EVENT VARIABLE /end DAQ_EVENT
 /end IF_DATA
/end MEASUREMENT
/begin MEASUREMENT Com_stElCmprStat "" UBYTE OneToOne 1 100 0.00 3.000 FORMAT "%5.3" ECU_ADDRESS 0x60023825
 /begin IF_DATA XCPplus 0x0102
  /begin DAQ_EVENT VARIABLE /end DAQ_EVENT
 /end IF_DATA
/end MEASUREMENT
/begin MEASUREMENT Com_steTogFailrLvl "State of etoggle failure level" UBYTE OneToOne 1 100 0.00 3.000 FORMAT "%5.3" ECU_ADDRESS 0x60023807
 /begin IF_DATA XCPplus 0x0102
  /begin DAQ_EVENT VARIABLE /end DAQ_EVENT
 /end IF_DATA
/end MEASUREMENT
/begin MEASUREMENT Com_stEvapTFlt "Evaporator temperature fault status from COM" UBYTE OneToOne 1 100 0.00 3.000 FORMAT "%5.3" ECU_ADDRESS 0x60023824
 /begin IF_DATA XCPplus 0x0102
  /begin DAQ_EVENT VARIABLE /end DAQ_EVENT
 /end IF_DATA
/end MEASUREMENT
/begin MEASUREMENT Com_stGearLvrPos "Gear lever position status" UBYTE OneToOne 1 100 0.00 63.00 FORMAT "%5.2" ECU_ADDRESS 0x60023823
 /begin IF_DATA XCPplus 0x0102
  /begin DAQ_EVENT VARIABLE /end DAQ_EVENT
 /end IF_DATA
/end MEASUREMENT
/begin MEASUREMENT Com_stHvacBlwrFront "Front HVAC Blower status" UBYTE OneToOne 1 100 0.00 7.000 FORMAT "%5.3" ECU_ADDRESS 0x60023822
 /begin IF_DATA XCPplus 0x0102
  /begin DAQ_EVENT VARIABLE /end DAQ_EVENT
 /end IF_DATA
/end MEASUREMENT
/begin MEASUREMENT Com_stHvacKnobPosn "" UBYTE OneToOne 1 100 0.00 15.00 FORMAT "%5.2" ECU_ADDRESS 0x60023821
 /begin IF_DATA XCPplus 0x0102
  /begin DAQ_EVENT VARIABLE /end DAQ_EVENT
 /end IF_DATA
/end MEASUREMENT
/begin MEASUREMENT Com_stHvacPanComFlt "" UBYTE B_TRUE 1 100 0.00 1.00000000000 BIT_MASK 0x1 FORMAT "%13.11" ECU_ADDRESS 0x600236E2
 /begin IF_DATA XCPplus 0x0102
  /begin DAQ_EVENT VARIABLE /end DAQ_EVENT
 /end IF_DATA
/end MEASUREMENT
/begin MEASUREMENT Com_stHvacPanHwFlt "" UBYTE B_TRUE 1 100 0.00 1.00000000000 BIT_MASK 0x1 FORMAT "%13.11" ECU_ADDRESS 0x600236E1
 /begin IF_DATA XCPplus 0x0102
  /begin DAQ_EVENT VARIABLE /end DAQ_EVENT
 /end IF_DATA
/end MEASUREMENT
/begin MEASUREMENT Com_stHvacPanOverUFlt "" UBYTE B_TRUE 1 100 0.00 1.00000000000 BIT_MASK 0x1 FORMAT "%13.11" ECU_ADDRESS 0x600236E0
 /begin IF_DATA XCPplus 0x0102
  /begin DAQ_EVENT VARIABLE /end DAQ_EVENT
 /end IF_DATA
/end MEASUREMENT
/begin MEASUREMENT Com_stHvacPanPotiFlt "" UBYTE OneToOne 1 100 0.00 3.000 FORMAT "%5.3" ECU_ADDRESS 0x60023820
 /begin IF_DATA XCPplus 0x0102
  /begin DAQ_EVENT VARIABLE /end DAQ_EVENT
 /end IF_DATA
/end MEASUREMENT
/begin MEASUREMENT Com_stHvacPanUnderUFlt "" UBYTE B_TRUE 1 100 0.00 1.00000000000 BIT_MASK 0x1 FORMAT "%13.11" ECU_ADDRESS 0x600236DF
 /begin IF_DATA XCPplus 0x0102
  /begin DAQ_EVENT VARIABLE /end DAQ_EVENT
 /end IF_DATA
/end MEASUREMENT
/begin MEASUREMENT Com_stHvBatHiTempWrn "Battery high temperature warning lamp status" UBYTE B_TRUE 1 100 0.00 1.00000000000 BIT_MASK 0x1 FORMAT "%13.11" ECU_ADDRESS 0x600236E3
 /begin IF_DATA XCPplus 0x0102
  /begin DAQ_EVENT VARIABLE /end DAQ_EVENT
 /end IF_DATA
/end MEASUREMENT
/begin MEASUREMENT Com_stHvbChrgFltRx "" UBYTE OneToOne 1 100 0.00 63.00 FORMAT "%5.2" ECU_ADDRESS 0x6002381F
 /begin IF_DATA XCPplus 0x0102
  /begin DAQ_EVENT VARIABLE /end DAQ_EVENT
 /end IF_DATA
/end MEASUREMENT
/begin MEASUREMENT Com_stHvbChrgn "High voltage battery charger status" UBYTE OneToOne 1 100 0.00 7.000 FORMAT "%5.3" ECU_ADDRESS 0x6002381E
 /begin IF_DATA XCPplus 0x0102
  /begin DAQ_EVENT VARIABLE /end DAQ_EVENT
 /end IF_DATA
/end MEASUREMENT
/begin MEASUREMENT Com_stHvbCnctn "" UBYTE OneToOne 1 100 0.00 3.000 FORMAT "%5.3" ECU_ADDRESS 0x6002381D
 /begin IF_DATA XCPplus 0x0102
  /begin DAQ_EVENT VARIABLE /end DAQ_EVENT
 /end IF_DATA
/end MEASUREMENT
/begin MEASUREMENT Com_stHvbDiscnctReas "" UBYTE OneToOne 1 100 0.00 7.000 FORMAT "%5.3" ECU_ADDRESS 0x6002381C
 /begin IF_DATA XCPplus 0x0102
  /begin DAQ_EVENT VARIABLE /end DAQ_EVENT
 /end IF_DATA
/end MEASUREMENT
/begin MEASUREMENT Com_stHvbEVLmp "High voltage batteryEV lamp status" UBYTE OneToOne 1 100 0.00 3.000 FORMAT "%5.3" ECU_ADDRESS 0x6002381B
 /begin IF_DATA XCPplus 0x0102
  /begin DAQ_EVENT VARIABLE /end DAQ_EVENT
 /end IF_DATA
/end MEASUREMENT
/begin MEASUREMENT Com_stHvbFltLvl "Maximum alarm level" UBYTE OneToOne 1 100 0.00 255.0 FORMAT "%5.1" ECU_ADDRESS 0x6002381A
 /begin IF_DATA XCPplus 0x0102
  /begin DAQ_EVENT VARIABLE /end DAQ_EVENT
 /end IF_DATA
/end MEASUREMENT
/begin MEASUREMENT Com_stHvbIntlckRx "" UBYTE OneToOne 1 100 0.00 3.000 FORMAT "%5.3" ECU_ADDRESS 0x60023819
 /begin IF_DATA XCPplus 0x0102
  /begin DAQ_EVENT VARIABLE /end DAQ_EVENT
 /end IF_DATA
/end MEASUREMENT
/begin MEASUREMENT Com_stHvbIsoFltRx "" UBYTE OneToOne 1 100 0.00 7.000 FORMAT "%5.3" ECU_ADDRESS 0x60023818
 /begin IF_DATA XCPplus 0x0102
  /begin DAQ_EVENT VARIABLE /end DAQ_EVENT
 /end IF_DATA
/end MEASUREMENT
/begin MEASUREMENT Com_stHvbIsoMeasmtActv "Active isolation resistance measured in HV battery status" UBYTE OneToOne 1 100 0.00 255.0 FORMAT "%5.1" ECU_ADDRESS 0x60023817
 /begin IF_DATA XCPplus 0x0102
  /begin DAQ_EVENT VARIABLE /end DAQ_EVENT
 /end IF_DATA
/end MEASUREMENT
/begin MEASUREMENT Com_stHvbModRx "" UBYTE OneToOne 1 100 0.00 15.00 FORMAT "%5.2" ECU_ADDRESS 0x60023816
 /begin IF_DATA XCPplus 0x0102
  /begin DAQ_EVENT VARIABLE /end DAQ_EVENT
 /end IF_DATA
/end MEASUREMENT
/begin MEASUREMENT Com_stHvbMstWrnLmp "High voltage battery of master warning lamp status" UBYTE OneToOne 1 100 0.00 3.000 FORMAT "%5.3" ECU_ADDRESS 0x60023815
 /begin IF_DATA XCPplus 0x0102
  /begin DAQ_EVENT VARIABLE /end DAQ_EVENT
 /end IF_DATA
/end MEASUREMENT
/begin MEASUREMENT Com_stHvbNegCntct "" UBYTE OneToOne 1 100 0.00 3.000 FORMAT "%5.3" ECU_ADDRESS 0x60023814
 /begin IF_DATA XCPplus 0x0102
  /begin DAQ_EVENT VARIABLE /end DAQ_EVENT
 /end IF_DATA
/end MEASUREMENT
/begin MEASUREMENT Com_stHvbPosCntct "" UBYTE OneToOne 1 100 0.00 3.000 FORMAT "%5.3" ECU_ADDRESS 0x60023813
 /begin IF_DATA XCPplus 0x0102
  /begin DAQ_EVENT VARIABLE /end DAQ_EVENT
 /end IF_DATA
/end MEASUREMENT
/begin MEASUREMENT Com_stHvbPrecCntct "" UBYTE B_TRUE 1 100 0.00 1.00000000000 BIT_MASK 0x1 FORMAT "%13.11" ECU_ADDRESS 0x600236DE
 /begin IF_DATA XCPplus 0x0102
  /begin DAQ_EVENT VARIABLE /end DAQ_EVENT
 /end IF_DATA
/end MEASUREMENT
/begin MEASUREMENT Com_stHvbSrvPlgRx "" UBYTE OneToOne 1 100 0.00 3.000 FORMAT "%5.3" ECU_ADDRESS 0x60023811
 /begin IF_DATA XCPplus 0x0102
  /begin DAQ_EVENT VARIABLE /end DAQ_EVENT
 /end IF_DATA
/end MEASUREMENT
/begin MEASUREMENT Com_stHvbSVSLmp "" UBYTE OneToOne 1 100 0.00 3.000 FORMAT "%5.3" ECU_ADDRESS 0x60023812
 /begin IF_DATA XCPplus 0x0102
  /begin DAQ_EVENT VARIABLE /end DAQ_EVENT
 /end IF_DATA
/end MEASUREMENT
/begin MEASUREMENT Com_stIBattEBS "" UBYTE OneToOne 1 100 0.00 3.000 FORMAT "%5.3" ECU_ADDRESS 0x60023810
 /begin IF_DATA XCPplus 0x0102
  /begin DAQ_EVENT VARIABLE /end DAQ_EVENT
 /end IF_DATA
/end MEASUREMENT
/begin MEASUREMENT Com_stIgnkeyPos "Ignition key position" UBYTE OneToOne 1 100 0.00 3.000 FORMAT "%5.3" ECU_ADDRESS 0x6002380E
 /begin IF_DATA XCPplus 0x0102
  /begin DAQ_EVENT VARIABLE /end DAQ_EVENT
 /end IF_DATA
/end MEASUREMENT
/begin MEASUREMENT Com_stIIvtrFltLvl01 "" UBYTE OneToOne 1 100 0.00 7.000 FORMAT "%5.3" ECU_ADDRESS 0x6002380F
 /begin IF_DATA XCPplus 0x0102
  /begin DAQ_EVENT VARIABLE /end DAQ_EVENT
 /end IF_DATA
/end MEASUREMENT
/begin MEASUREMENT Com_stMainWkuReq "" UBYTE OneToOne 1 100 0.00 3.000 FORMAT "%5.3" ECU_ADDRESS 0x6002380D
 /begin IF_DATA XCPplus 0x0102
  /begin DAQ_EVENT VARIABLE /end DAQ_EVENT
 /end IF_DATA
/end MEASUREMENT
/begin MEASUREMENT Com_stOffsEm01 "" UBYTE B_TRUE 1 100 0.00 1.00000000000 BIT_MASK 0x1 FORMAT "%13.11" ECU_ADDRESS 0x600236DD
 /begin IF_DATA XCPplus 0x0102
  /begin DAQ_EVENT VARIABLE /end DAQ_EVENT
 /end IF_DATA
/end MEASUREMENT
/begin MEASUREMENT Com_stPrkBrkRx "" UBYTE OneToOne 1 100 0.00 3.000 FORMAT "%5.3" ECU_ADDRESS 0x6002380C
 /begin IF_DATA XCPplus 0x0102
  /begin DAQ_EVENT VARIABLE /end DAQ_EVENT
 /end IF_DATA
/end MEASUREMENT
/begin MEASUREMENT Com_stReFogReq "" UBYTE q1 1 100 0.00 255.0 FORMAT "%5.1" ECU_ADDRESS 0x6002380B
 /begin IF_DATA XCPplus 0x0102
  /begin DAQ_EVENT VARIABLE /end DAQ_EVENT
 /end IF_DATA
/end MEASUREMENT
/begin MEASUREMENT Com_stSocRx "" UBYTE OneToOne 1 100 0.00 3.000 FORMAT "%5.3" ECU_ADDRESS 0x6002380A
 /begin IF_DATA XCPplus 0x0102
  /begin DAQ_EVENT VARIABLE /end DAQ_EVENT
 /end IF_DATA
/end MEASUREMENT
/begin MEASUREMENT Com_stT "Status of battery temperature" UBYTE OneToOne 1 100 0.00 255.0 FORMAT "%5.1" ECU_ADDRESS 0x60023808
 /begin IF_DATA XCPplus 0x0102
  /begin DAQ_EVENT VARIABLE /end DAQ_EVENT
 /end IF_DATA
/end MEASUREMENT
/begin MEASUREMENT Com_stT50 "Status T50" UBYTE OneToOne 1 100 0.00 3.000 FORMAT "%5.3" ECU_ADDRESS 0x60023809
 /begin IF_DATA XCPplus 0x0102
  /begin DAQ_EVENT VARIABLE /end DAQ_EVENT
 /end IF_DATA
/end MEASUREMENT
/begin MEASUREMENT Com_tDcdcAct "Temperature of the DCDC converter in degrees Celcius." SWORD RBPtCel_t_1p0_om40_1 1 100 -32808.00 32727.00 FORMAT "%8.2" ECU_ADDRESS 0x6001FE4A
 /begin IF_DATA XCPplus 0x0102
  /begin DAQ_EVENT VARIABLE /end DAQ_EVENT
 /end IF_DATA
/end MEASUREMENT
/begin MEASUREMENT Com_tDcdcInltCoolt "Temperature of dcdc coolant inlet" SWORD q0p5_DegCgrd 1 100 -40.0000 150.0000 FORMAT "%8.4" ECU_ADDRESS 0x6001FE48
 /begin IF_DATA XCPplus 0x0102
  /begin DAQ_EVENT VARIABLE /end DAQ_EVENT
 /end IF_DATA
/end MEASUREMENT
/begin MEASUREMENT Com_tElCmprActl "" SWORD Temp_Cels_c126 1 100 -40.0000 140.0000 FORMAT "%8.4" ECU_ADDRESS 0x6001FE46
 /begin IF_DATA XCPplus 0x0102
  /begin DAQ_EVENT VARIABLE /end DAQ_EVENT
 /end IF_DATA
/end MEASUREMENT
/begin MEASUREMENT Com_tEnvT "" SWORD Temp_Cels 1 100 -3549.940 3003.560 FORMAT "%8.3" ECU_ADDRESS 0x6001FE44
 /begin IF_DATA XCPplus 0x0102
  /begin DAQ_EVENT VARIABLE /end DAQ_EVENT
 /end IF_DATA
/end MEASUREMENT
/begin MEASUREMENT Com_tEvapT "Signal Evaporation Temperature" SWORD Temp_Cels 1 100 -3549.940 3003.560 FORMAT "%8.3" ECU_ADDRESS 0x6001FE42
 /begin IF_DATA XCPplus 0x0102
  /begin DAQ_EVENT VARIABLE /end DAQ_EVENT
 /end IF_DATA
/end MEASUREMENT
/begin MEASUREMENT Com_tHvbAct "Actual temperature of the high voltage battery" SWORD Temp_Cels 1 100 -3549.940 3003.560 FORMAT "%8.3" ECU_ADDRESS 0x6001FE40
 /begin IF_DATA XCPplus 0x0102
  /begin DAQ_EVENT VARIABLE /end DAQ_EVENT
 /end IF_DATA
/end MEASUREMENT
/begin MEASUREMENT Com_tHvbMax "" SWORD Temp_Cels 1 100 -3549.940 3003.560 FORMAT "%8.3" ECU_ADDRESS 0x6001FE3E
 /begin IF_DATA XCPplus 0x0102
  /begin DAQ_EVENT VARIABLE /end DAQ_EVENT
 /end IF_DATA
/end MEASUREMENT
/begin MEASUREMENT Com_tiCurVehTmr "" ULONG Time_sec_1 1 100 0.00 429496729.300 FORMAT "%13.3" ECU_ADDRESS 0x60001070
 /begin IF_DATA XCPplus 0x0102
  /begin DAQ_EVENT VARIABLE /end DAQ_EVENT
 /end IF_DATA
/end MEASUREMENT
/begin MEASUREMENT Com_tiHvbChrgnHalfRx "" UWORD RBPtCel_ti_1p0_4 1 100 0.00 65535.00 FORMAT "%8.2" ECU_ADDRESS 0x6001FCDA
 /begin IF_DATA XCPplus 0x0102
  /begin DAQ_EVENT VARIABLE /end DAQ_EVENT
 /end IF_DATA
/end MEASUREMENT
/begin MEASUREMENT Com_tLvBatt "Battery temperature from EBS" SWORD RBPtCel_t_1p0om40_1 1 100 -32808.00 32727.00 FORMAT "%8.2" ECU_ADDRESS 0x6001FE3C
 /begin IF_DATA XCPplus 0x0102
  /begin DAQ_EVENT VARIABLE /end DAQ_EVENT
 /end IF_DATA
/end MEASUREMENT
/begin MEASUREMENT Com_uBattEBSRx "" UWORD q0p01_o5_V 1 100 5.00000 18.00000 FORMAT "%8.5" ECU_ADDRESS 0x6001FCC0
 /begin IF_DATA XCPplus 0x0102
  /begin DAQ_EVENT VARIABLE /end DAQ_EVENT
 /end IF_DATA
/end MEASUREMENT
/begin MEASUREMENT Com_uDcdcHvAct "Actual voltage at high voltage side of DCDC" UWORD RBPtCel_u_0p1_1 1 100 0.00 3276.700 FORMAT "%8.3" ECU_ADDRESS 0x6001FCBE
 /begin IF_DATA XCPplus 0x0102
  /begin DAQ_EVENT VARIABLE /end DAQ_EVENT
 /end IF_DATA
/end MEASUREMENT
/begin MEASUREMENT Com_uDcdcLvAct "actual voltage at low voltage side of DCDC" UWORD RBPtCel_u_0p1_1 1 100 0.00 3276.700 FORMAT "%8.3" ECU_ADDRESS 0x6001FCBC
 /begin IF_DATA XCPplus 0x0102
  /begin DAQ_EVENT VARIABLE /end DAQ_EVENT
 /end IF_DATA
/end MEASUREMENT
/begin MEASUREMENT Com_uElCmprHvAct "Actual compressor measured voltage" SWORD q1_V 1 100 -32768.00 32767.00 FORMAT "%8.2" ECU_ADDRESS 0x6001FE3A
 /begin IF_DATA XCPplus 0x0102
  /begin DAQ_EVENT VARIABLE /end DAQ_EVENT
 /end IF_DATA
/end MEASUREMENT
/begin MEASUREMENT Com_uHvbAct "Actual voltage of the HV battery" SWORD Volt_V_q0p03125_COMPU 1 100 -1024.000 1023.969 FORMAT "%8.3" ECU_ADDRESS 0x6001FE38
 /begin IF_DATA XCPplus 0x0102
  /begin DAQ_EVENT VARIABLE /end DAQ_EVENT
 /end IF_DATA
/end MEASUREMENT
/begin MEASUREMENT Com_uHvbDcBus "HV battery DC bus voltage" SWORD Volt_V_q0p03125_COMPU 1 100 0.00 500.0000 FORMAT "%8.4" ECU_ADDRESS 0x6001FE36
 /begin IF_DATA XCPplus 0x0102
  /begin DAQ_EVENT VARIABLE /end DAQ_EVENT
 /end IF_DATA
/end MEASUREMENT
/begin MEASUREMENT Com_uHvbLimHi "Maximum Voltage of HV Battery" SWORD Volt_V_q0p03125_COMPU 1 100 -1024.000 1023.969 FORMAT "%8.3" ECU_ADDRESS 0x6001FE34
 /begin IF_DATA XCPplus 0x0102
  /begin DAQ_EVENT VARIABLE /end DAQ_EVENT
 /end IF_DATA
/end MEASUREMENT
/begin MEASUREMENT Com_uHvbMaxCell "" UWORD q1Em3_V 1 100 0.00 15.00000 FORMAT "%8.5" ECU_ADDRESS 0x6001FCBA
 /begin IF_DATA XCPplus 0x0102
  /begin DAQ_EVENT VARIABLE /end DAQ_EVENT
 /end IF_DATA
/end MEASUREMENT
/begin MEASUREMENT Com_uHvbMinCell "" UWORD q1Em3_V 1 100 0.00 15.00000 FORMAT "%8.5" ECU_ADDRESS 0x6001FCB8
 /begin IF_DATA XCPplus 0x0102
  /begin DAQ_EVENT VARIABLE /end DAQ_EVENT
 /end IF_DATA
/end MEASUREMENT
/begin MEASUREMENT Com_uHvbNomChrgn "Max. static DC charging voltage limit; Schlussspannung; Static, depending on aging of cellsbatterypack (not on SOC, not on Temp)" SWORD Volt_V_q0p03125_COMPU 1 100 -1024.000 1023.969 FORMAT "%8.3" ECU_ADDRESS 0x6001FE32
 /begin IF_DATA XCPplus 0x0102
  /begin DAQ_EVENT VARIABLE /end DAQ_EVENT
 /end IF_DATA
/end MEASUREMENT
/begin MEASUREMENT Com_valOffsEm01 "" UWORD OneToOne 1 100 0.00 65535.00 FORMAT "%8.2" ECU_ADDRESS 0x6001FCB6
 /begin IF_DATA XCPplus 0x0102
  /begin DAQ_EVENT VARIABLE /end DAQ_EVENT
 /end IF_DATA
/end MEASUREMENT
/begin MEASUREMENT Com_vVeh "Vehicle speed from CAN-bus" SWORD Vel 1 100 -327.6800 327.6700 FORMAT "%8.4" ECU_ADDRESS 0x6001FE30
 /begin IF_DATA XCPplus 0x0102
  /begin DAQ_EVENT VARIABLE /end DAQ_EVENT
 /end IF_DATA
/end MEASUREMENT
/begin MEASUREMENT DDRC_St.DFC_Com082hTooShort "" ULONG DFC_OneToOne 1 100 0.00 536870911.000 BIT_MASK 0x1fffffff FORMAT "%13.3" ECU_ADDRESS 0x6001C484 /end MEASUREMENT
/begin MEASUREMENT DDRC_St.DFC_Com092hTooShort "" ULONG DFC_OneToOne 1 100 0.00 536870911.000 BIT_MASK 0x1fffffff FORMAT "%13.3" ECU_ADDRESS 0x6001C488 /end MEASUREMENT
/begin MEASUREMENT DDRC_St.DFC_Com205hAbsent "" ULONG DFC_OneToOne 1 100 0.00 536870911.000 BIT_MASK 0x1fffffff FORMAT "%13.3" ECU_ADDRESS 0x6001C48C /end MEASUREMENT
/begin MEASUREMENT DDRC_St.DFC_Com205hChecksum "" ULONG DFC_OneToOne 1 100 0.00 536870911.000 BIT_MASK 0x1fffffff FORMAT "%13.3" ECU_ADDRESS 0x6001C490 /end MEASUREMENT
/begin MEASUREMENT DDRC_St.DFC_Com205hCounter "" ULONG DFC_OneToOne 1 100 0.00 536870911.000 BIT_MASK 0x1fffffff FORMAT "%13.3" ECU_ADDRESS 0x6001C494 /end MEASUREMENT
/begin MEASUREMENT DDRC_St.DFC_Com205hTooShort "" ULONG DFC_OneToOne 1 100 0.00 536870911.000 BIT_MASK 0x1fffffff FORMAT "%13.3" ECU_ADDRESS 0x6001C498 /end MEASUREMENT
/begin MEASUREMENT DDRC_St.DFC_Com217hAbsent "" ULONG DFC_OneToOne 1 100 0.00 536870911.000 BIT_MASK 0x1fffffff FORMAT "%13.3" ECU_ADDRESS 0x6001C49C /end MEASUREMENT
/begin MEASUREMENT DDRC_St.DFC_Com217hChecksum "" ULONG DFC_OneToOne 1 100 0.00 536870911.000 BIT_MASK 0x1fffffff FORMAT "%13.3" ECU_ADDRESS 0x6001C4A0 /end MEASUREMENT
/begin MEASUREMENT DDRC_St.DFC_Com217hCounter "" ULONG DFC_OneToOne 1 100 0.00 536870911.000 BIT_MASK 0x1fffffff FORMAT "%13.3" ECU_ADDRESS 0x6001C4A4 /end MEASUREMENT
/begin MEASUREMENT DDRC_St.DFC_Com217hTooShort "" ULONG DFC_OneToOne 1 100 0.00 536870911.000 BIT_MASK 0x1fffffff FORMAT "%13.3" ECU_ADDRESS 0x6001C4A8 /end MEASUREMENT
/begin MEASUREMENT DDRC_St.DFC_Com227hAbsent "" ULONG DFC_OneToOne 1 100 0.00 536870911.000 BIT_MASK 0x1fffffff FORMAT "%13.3" ECU_ADDRESS 0x6001C4AC /end MEASUREMENT
/begin MEASUREMENT DDRC_St.DFC_Com227hTooShort "" ULONG DFC_OneToOne 1 100 0.00 536870911.000 BIT_MASK 0x1fffffff FORMAT "%13.3" ECU_ADDRESS 0x6001C4B0 /end MEASUREMENT
/begin MEASUREMENT DDRC_St.DFC_Com237hAbsent "" ULONG DFC_OneToOne 1 100 0.00 536870911.000 BIT_MASK 0x1fffffff FORMAT "%13.3" ECU_ADDRESS 0x6001C4B4 /end MEASUREMENT
/begin MEASUREMENT DDRC_St.DFC_Com237hChecksum "" ULONG DFC_OneToOne 1 100 0.00 536870911.000 BIT_MASK 0x1fffffff FORMAT "%13.3" ECU_ADDRESS 0x6001C4B8 /end MEASUREMENT
/begin MEASUREMENT DDRC_St.DFC_Com237hCounter "" ULONG DFC_OneToOne 1 100 0.00 536870911.000 BIT_MASK 0x1fffffff FORMAT "%13.3" ECU_ADDRESS 0x6001C4BC /end MEASUREMENT
/begin MEASUREMENT DDRC_St.DFC_Com237hTooShort "" ULONG DFC_OneToOne 1 100 0.00 536870911.000 BIT_MASK 0x1fffffff FORMAT "%13.3" ECU_ADDRESS 0x6001C4C0 /end MEASUREMENT
/begin MEASUREMENT DDRC_St.DFC_Com259hAbsent "" ULONG DFC_OneToOne 1 100 0.00 536870911.000 BIT_MASK 0x1fffffff FORMAT "%13.3" ECU_ADDRESS 0x6001C4C4 /end MEASUREMENT
/begin MEASUREMENT DDRC_St.DFC_Com259hChecksum "" ULONG DFC_OneToOne 1 100 0.00 536870911.000 BIT_MASK 0x1fffffff FORMAT "%13.3" ECU_ADDRESS 0x6001C4C8 /end MEASUREMENT
/begin MEASUREMENT DDRC_St.DFC_Com259hCounter "" ULONG DFC_OneToOne 1 100 0.00 536870911.000 BIT_MASK 0x1fffffff FORMAT "%13.3" ECU_ADDRESS 0x6001C4CC /end MEASUREMENT
/begin MEASUREMENT DDRC_St.DFC_Com259hTooShort "" ULONG DFC_OneToOne 1 100 0.00 536870911.000 BIT_MASK 0x1fffffff FORMAT "%13.3" ECU_ADDRESS 0x6001C4D0 /end MEASUREMENT
/begin MEASUREMENT DDRC_St.DFC_Com26hAbsent "" ULONG DFC_OneToOne 1 100 0.00 536870911.000 BIT_MASK 0x1fffffff FORMAT "%13.3" ECU_ADDRESS 0x6001C4D4 /end MEASUREMENT
/begin MEASUREMENT DDRC_St.DFC_Com26hTooShort "" ULONG DFC_OneToOne 1 100 0.00 536870911.000 BIT_MASK 0x1fffffff FORMAT "%13.3" ECU_ADDRESS 0x6001C4D8 /end MEASUREMENT
/begin MEASUREMENT DDRC_St.DFC_Com273hAbsent "" ULONG DFC_OneToOne 1 100 0.00 536870911.000 BIT_MASK 0x1fffffff FORMAT "%13.3" ECU_ADDRESS 0x6001C4DC /end MEASUREMENT
/begin MEASUREMENT DDRC_St.DFC_Com273hChecksum "" ULONG DFC_OneToOne 1 100 0.00 536870911.000 BIT_MASK 0x1fffffff FORMAT "%13.3" ECU_ADDRESS 0x6001C4E0 /end MEASUREMENT
/begin MEASUREMENT DDRC_St.DFC_Com273hCounter "" ULONG DFC_OneToOne 1 100 0.00 536870911.000 BIT_MASK 0x1fffffff FORMAT "%13.3" ECU_ADDRESS 0x6001C4E4 /end MEASUREMENT
/begin MEASUREMENT DDRC_St.DFC_Com273hTooShort "" ULONG DFC_OneToOne 1 100 0.00 536870911.000 BIT_MASK 0x1fffffff FORMAT "%13.3" ECU_ADDRESS 0x6001C4E8 /end MEASUREMENT
/begin MEASUREMENT DDRC_St.DFC_Com275hAbsent "" ULONG DFC_OneToOne 1 100 0.00 536870911.000 BIT_MASK 0x1fffffff FORMAT "%13.3" ECU_ADDRESS 0x6001C4EC /end MEASUREMENT
/begin MEASUREMENT DDRC_St.DFC_Com275hChecksum "" ULONG DFC_OneToOne 1 100 0.00 536870911.000 BIT_MASK 0x1fffffff FORMAT "%13.3" ECU_ADDRESS 0x6001C4F0 /end MEASUREMENT
/begin MEASUREMENT DDRC_St.DFC_Com275hCounter "" ULONG DFC_OneToOne 1 100 0.00 536870911.000 BIT_MASK 0x1fffffff FORMAT "%13.3" ECU_ADDRESS 0x6001C4F4 /end MEASUREMENT
/begin MEASUREMENT DDRC_St.DFC_Com275hTooShort "" ULONG DFC_OneToOne 1 100 0.00 536870911.000 BIT_MASK 0x1fffffff FORMAT "%13.3" ECU_ADDRESS 0x6001C4F8 /end MEASUREMENT
/begin MEASUREMENT DDRC_St.DFC_Com283hAbsent "" ULONG DFC_OneToOne 1 100 0.00 536870911.000 BIT_MASK 0x1fffffff FORMAT "%13.3" ECU_ADDRESS 0x6001C4FC /end MEASUREMENT
/begin MEASUREMENT DDRC_St.DFC_Com283hTooShort "" ULONG DFC_OneToOne 1 100 0.00 536870911.000 BIT_MASK 0x1fffffff FORMAT "%13.3" ECU_ADDRESS 0x6001C500 /end MEASUREMENT
/begin MEASUREMENT DDRC_St.DFC_Com285hAbsent "" ULONG DFC_OneToOne 1 100 0.00 536870911.000 BIT_MASK 0x1fffffff FORMAT "%13.3" ECU_ADDRESS 0x6001C504 /end MEASUREMENT
/begin MEASUREMENT DDRC_St.DFC_Com285hChecksum "" ULONG DFC_OneToOne 1 100 0.00 536870911.000 BIT_MASK 0x1fffffff FORMAT "%13.3" ECU_ADDRESS 0x6001C508 /end MEASUREMENT
/begin MEASUREMENT DDRC_St.DFC_Com285hCounter "" ULONG DFC_OneToOne 1 100 0.00 536870911.000 BIT_MASK 0x1fffffff FORMAT "%13.3" ECU_ADDRESS 0x6001C50C /end MEASUREMENT
/begin MEASUREMENT DDRC_St.DFC_Com285hTooShort "" ULONG DFC_OneToOne 1 100 0.00 536870911.000 BIT_MASK 0x1fffffff FORMAT "%13.3" ECU_ADDRESS 0x6001C510 /end MEASUREMENT
/begin MEASUREMENT DDRC_St.DFC_Com293hAbsent "" ULONG DFC_OneToOne 1 100 0.00 536870911.000 BIT_MASK 0x1fffffff FORMAT "%13.3" ECU_ADDRESS 0x6001C514 /end MEASUREMENT
/begin MEASUREMENT DDRC_St.DFC_Com293hChecksum "" ULONG DFC_OneToOne 1 100 0.00 536870911.000 BIT_MASK 0x1fffffff FORMAT "%13.3" ECU_ADDRESS 0x6001C518 /end MEASUREMENT
/begin MEASUREMENT DDRC_St.DFC_Com293hCounter "" ULONG DFC_OneToOne 1 100 0.00 536870911.000 BIT_MASK 0x1fffffff FORMAT "%13.3" ECU_ADDRESS 0x6001C51C /end MEASUREMENT
/begin MEASUREMENT DDRC_St.DFC_Com293hTooShort "" ULONG DFC_OneToOne 1 100 0.00 536870911.000 BIT_MASK 0x1fffffff FORMAT "%13.3" ECU_ADDRESS 0x6001C520 /end MEASUREMENT
/begin MEASUREMENT DDRC_St.DFC_Com308hAbsent "" ULONG DFC_OneToOne 1 100 0.00 536870911.000 BIT_MASK 0x1fffffff FORMAT "%13.3" ECU_ADDRESS 0x6001C524 /end MEASUREMENT
/begin MEASUREMENT DDRC_St.DFC_Com308hChecksum "" ULONG DFC_OneToOne 1 100 0.00 536870911.000 BIT_MASK 0x1fffffff FORMAT "%13.3" ECU_ADDRESS 0x6001C528 /end MEASUREMENT
/begin MEASUREMENT DDRC_St.DFC_Com308hCounter "" ULONG DFC_OneToOne 1 100 0.00 536870911.000 BIT_MASK 0x1fffffff FORMAT "%13.3" ECU_ADDRESS 0x6001C52C /end MEASUREMENT
/begin MEASUREMENT DDRC_St.DFC_Com308hTooShort "" ULONG DFC_OneToOne 1 100 0.00 536870911.000 BIT_MASK 0x1fffffff FORMAT "%13.3" ECU_ADDRESS 0x6001C530 /end MEASUREMENT
/begin MEASUREMENT DDRC_St.DFC_Com318hAbsent "" ULONG DFC_OneToOne 1 100 0.00 536870911.000 BIT_MASK 0x1fffffff FORMAT "%13.3" ECU_ADDRESS 0x6001C534 /end MEASUREMENT
/begin MEASUREMENT DDRC_St.DFC_Com318hChecksum "" ULONG DFC_OneToOne 1 100 0.00 536870911.000 BIT_MASK 0x1fffffff FORMAT "%13.3" ECU_ADDRESS 0x6001C538 /end MEASUREMENT
/begin MEASUREMENT DDRC_St.DFC_Com318hCounter "" ULONG DFC_OneToOne 1 100 0.00 536870911.000 BIT_MASK 0x1fffffff FORMAT "%13.3" ECU_ADDRESS 0x6001C53C /end MEASUREMENT
/begin MEASUREMENT DDRC_St.DFC_Com318hTooShort "" ULONG DFC_OneToOne 1 100 0.00 536870911.000 BIT_MASK 0x1fffffff FORMAT "%13.3" ECU_ADDRESS 0x6001C540 /end MEASUREMENT
/begin MEASUREMENT DDRC_St.DFC_Com325hAbsent "" ULONG DFC_OneToOne 1 100 0.00 536870911.000 BIT_MASK 0x1fffffff FORMAT "%13.3" ECU_ADDRESS 0x6001C544 /end MEASUREMENT
/begin MEASUREMENT DDRC_St.DFC_Com325hChecksum "" ULONG DFC_OneToOne 1 100 0.00 536870911.000 BIT_MASK 0x1fffffff FORMAT "%13.3" ECU_ADDRESS 0x6001C548 /end MEASUREMENT
/begin MEASUREMENT DDRC_St.DFC_Com325hCounter "" ULONG DFC_OneToOne 1 100 0.00 536870911.000 BIT_MASK 0x1fffffff FORMAT "%13.3" ECU_ADDRESS 0x6001C54C /end MEASUREMENT
/begin MEASUREMENT DDRC_St.DFC_Com325hTooShort "" ULONG DFC_OneToOne 1 100 0.00 536870911.000 BIT_MASK 0x1fffffff FORMAT "%13.3" ECU_ADDRESS 0x6001C550 /end MEASUREMENT
/begin MEASUREMENT DDRC_St.DFC_Com335hAbsent "" ULONG DFC_OneToOne 1 100 0.00 536870911.000 BIT_MASK 0x1fffffff FORMAT "%13.3" ECU_ADDRESS 0x6001C554 /end MEASUREMENT
/begin MEASUREMENT DDRC_St.DFC_Com335hChecksum "" ULONG DFC_OneToOne 1 100 0.00 536870911.000 BIT_MASK 0x1fffffff FORMAT "%13.3" ECU_ADDRESS 0x6001C558 /end MEASUREMENT
/begin MEASUREMENT DDRC_St.DFC_Com335hCounter "" ULONG DFC_OneToOne 1 100 0.00 536870911.000 BIT_MASK 0x1fffffff FORMAT "%13.3" ECU_ADDRESS 0x6001C55C /end MEASUREMENT
/begin MEASUREMENT DDRC_St.DFC_Com335hTooShort "" ULONG DFC_OneToOne 1 100 0.00 536870911.000 BIT_MASK 0x1fffffff FORMAT "%13.3" ECU_ADDRESS 0x6001C560 /end MEASUREMENT
/begin MEASUREMENT DDRC_St.DFC_Com351hAbsent "" ULONG DFC_OneToOne 1 100 0.00 536870911.000 BIT_MASK 0x1fffffff FORMAT "%13.3" ECU_ADDRESS 0x6001C564 /end MEASUREMENT
/begin MEASUREMENT DDRC_St.DFC_Com351hTooShort "" ULONG DFC_OneToOne 1 100 0.00 536870911.000 BIT_MASK 0x1fffffff FORMAT "%13.3" ECU_ADDRESS 0x6001C568 /end MEASUREMENT
/begin MEASUREMENT DDRC_St.DFC_Com38DhAbsent "" ULONG DFC_OneToOne 1 100 0.00 536870911.000 BIT_MASK 0x1fffffff FORMAT "%13.3" ECU_ADDRESS 0x6001C56C /end MEASUREMENT
/begin MEASUREMENT DDRC_St.DFC_Com38DhChecksum "" ULONG DFC_OneToOne 1 100 0.00 536870911.000 BIT_MASK 0x1fffffff FORMAT "%13.3" ECU_ADDRESS 0x6001C570 /end MEASUREMENT
/begin MEASUREMENT DDRC_St.DFC_Com38DhCounter "" ULONG DFC_OneToOne 1 100 0.00 536870911.000 BIT_MASK 0x1fffffff FORMAT "%13.3" ECU_ADDRESS 0x6001C574 /end MEASUREMENT
/begin MEASUREMENT DDRC_St.DFC_Com38DhTooShort "" ULONG DFC_OneToOne 1 100 0.00 536870911.000 BIT_MASK 0x1fffffff FORMAT "%13.3" ECU_ADDRESS 0x6001C578 /end MEASUREMENT
/begin MEASUREMENT DDRC_St.DFC_Com412hAbsent "" ULONG DFC_OneToOne 1 100 0.00 536870911.000 BIT_MASK 0x1fffffff FORMAT "%13.3" ECU_ADDRESS 0x6001C57C /end MEASUREMENT
/begin MEASUREMENT DDRC_St.DFC_Com412hChecksum "" ULONG DFC_OneToOne 1 100 0.00 536870911.000 BIT_MASK 0x1fffffff FORMAT "%13.3" ECU_ADDRESS 0x6001C580 /end MEASUREMENT
/begin MEASUREMENT DDRC_St.DFC_Com412hCounter "" ULONG DFC_OneToOne 1 100 0.00 536870911.000 BIT_MASK 0x1fffffff FORMAT "%13.3" ECU_ADDRESS 0x6001C584 /end MEASUREMENT
/begin MEASUREMENT DDRC_St.DFC_Com412hTooShort "" ULONG DFC_OneToOne 1 100 0.00 536870911.000 BIT_MASK 0x1fffffff FORMAT "%13.3" ECU_ADDRESS 0x6001C588 /end MEASUREMENT
/begin MEASUREMENT DDRC_St.DFC_Com427hAbsent "" ULONG DFC_OneToOne 1 100 0.00 536870911.000 BIT_MASK 0x1fffffff FORMAT "%13.3" ECU_ADDRESS 0x6001C58C /end MEASUREMENT
/begin MEASUREMENT DDRC_St.DFC_Com427hTooShort "" ULONG DFC_OneToOne 1 100 0.00 536870911.000 BIT_MASK 0x1fffffff FORMAT "%13.3" ECU_ADDRESS 0x6001C590 /end MEASUREMENT
/begin MEASUREMENT DDRC_St.DFC_Com432hAbsent "" ULONG DFC_OneToOne 1 100 0.00 536870911.000 BIT_MASK 0x1fffffff FORMAT "%13.3" ECU_ADDRESS 0x6001C594 /end MEASUREMENT
/begin MEASUREMENT DDRC_St.DFC_Com432hChecksum "" ULONG DFC_OneToOne 1 100 0.00 536870911.000 BIT_MASK 0x1fffffff FORMAT "%13.3" ECU_ADDRESS 0x6001C598 /end MEASUREMENT
/begin MEASUREMENT DDRC_St.DFC_Com432hCounter "" ULONG DFC_OneToOne 1 100 0.00 536870911.000 BIT_MASK 0x1fffffff FORMAT "%13.3" ECU_ADDRESS 0x6001C59C /end MEASUREMENT
/begin MEASUREMENT DDRC_St.DFC_Com432hTooShort "" ULONG DFC_OneToOne 1 100 0.00 536870911.000 BIT_MASK 0x1fffffff FORMAT "%13.3" ECU_ADDRESS 0x6001C5A0 /end MEASUREMENT
/begin MEASUREMENT DDRC_St.DFC_Com435hAbsent "" ULONG DFC_OneToOne 1 100 0.00 536870911.000 BIT_MASK 0x1fffffff FORMAT "%13.3" ECU_ADDRESS 0x6001C5A4 /end MEASUREMENT
/begin MEASUREMENT DDRC_St.DFC_Com435hTooShort "" ULONG DFC_OneToOne 1 100 0.00 536870911.000 BIT_MASK 0x1fffffff FORMAT "%13.3" ECU_ADDRESS 0x6001C5A8 /end MEASUREMENT
/begin MEASUREMENT DDRC_St.DFC_Com442hAbsent "" ULONG DFC_OneToOne 1 100 0.00 536870911.000 BIT_MASK 0x1fffffff FORMAT "%13.3" ECU_ADDRESS 0x6001C5AC /end MEASUREMENT
/begin MEASUREMENT DDRC_St.DFC_Com442hTooShort "" ULONG DFC_OneToOne 1 100 0.00 536870911.000 BIT_MASK 0x1fffffff FORMAT "%13.3" ECU_ADDRESS 0x6001C5B0 /end MEASUREMENT
/begin MEASUREMENT DDRC_St.DFC_Com453hAbsent "" ULONG DFC_OneToOne 1 100 0.00 536870911.000 BIT_MASK 0x1fffffff FORMAT "%13.3" ECU_ADDRESS 0x6001C5B4 /end MEASUREMENT
/begin MEASUREMENT DDRC_St.DFC_Com453hTooShort "" ULONG DFC_OneToOne 1 100 0.00 536870911.000 BIT_MASK 0x1fffffff FORMAT "%13.3" ECU_ADDRESS 0x6001C5B8 /end MEASUREMENT
/begin MEASUREMENT DDRC_St.DFC_Com455hAbsent "" ULONG DFC_OneToOne 1 100 0.00 536870911.000 BIT_MASK 0x1fffffff FORMAT "%13.3" ECU_ADDRESS 0x6001C5BC /end MEASUREMENT
/begin MEASUREMENT DDRC_St.DFC_Com455hTooShort "" ULONG DFC_OneToOne 1 100 0.00 536870911.000 BIT_MASK 0x1fffffff FORMAT "%13.3" ECU_ADDRESS 0x6001C5C0 /end MEASUREMENT
/begin MEASUREMENT DDRC_St.DFC_Com463hAbsent "" ULONG DFC_OneToOne 1 100 0.00 536870911.000 BIT_MASK 0x1fffffff FORMAT "%13.3" ECU_ADDRESS 0x6001C5C4 /end MEASUREMENT
/begin MEASUREMENT DDRC_St.DFC_Com463hTooShort "" ULONG DFC_OneToOne 1 100 0.00 536870911.000 BIT_MASK 0x1fffffff FORMAT "%13.3" ECU_ADDRESS 0x6001C5C8 /end MEASUREMENT
/begin MEASUREMENT DDRC_St.DFC_Com473hAbsent "" ULONG DFC_OneToOne 1 100 0.00 536870911.000 BIT_MASK 0x1fffffff FORMAT "%13.3" ECU_ADDRESS 0x6001C5CC /end MEASUREMENT
/begin MEASUREMENT DDRC_St.DFC_Com473hTooShort "" ULONG DFC_OneToOne 1 100 0.00 536870911.000 BIT_MASK 0x1fffffff FORMAT "%13.3" ECU_ADDRESS 0x6001C5D0 /end MEASUREMENT
/begin MEASUREMENT DDRC_St.DFC_Com47BhAbsent "" ULONG DFC_OneToOne 1 100 0.00 536870911.000 BIT_MASK 0x1fffffff FORMAT "%13.3" ECU_ADDRESS 0x6001C5D4 /end MEASUREMENT
/begin MEASUREMENT DDRC_St.DFC_Com47BhTooShort "" ULONG DFC_OneToOne 1 100 0.00 536870911.000 BIT_MASK 0x1fffffff FORMAT "%13.3" ECU_ADDRESS 0x6001C5D8 /end MEASUREMENT
/begin MEASUREMENT DDRC_St.DFC_Com48BhAbsent "" ULONG DFC_OneToOne 1 100 0.00 536870911.000 BIT_MASK 0x1fffffff FORMAT "%13.3" ECU_ADDRESS 0x6001C5DC /end MEASUREMENT
/begin MEASUREMENT DDRC_St.DFC_Com48BhTooShort "" ULONG DFC_OneToOne 1 100 0.00 536870911.000 BIT_MASK 0x1fffffff FORMAT "%13.3" ECU_ADDRESS 0x6001C5E0 /end MEASUREMENT
/begin MEASUREMENT DDRC_St.DFC_Com497hTooShort "" ULONG DFC_OneToOne 1 100 0.00 536870911.000 BIT_MASK 0x1fffffff FORMAT "%13.3" ECU_ADDRESS 0x6001C5E4 /end MEASUREMENT
/begin MEASUREMENT DDRC_St.DFC_Com4F2hAbsent "" ULONG DFC_OneToOne 1 100 0.00 536870911.000 BIT_MASK 0x1fffffff FORMAT "%13.3" ECU_ADDRESS 0x6001C5E8 /end MEASUREMENT
/begin MEASUREMENT DDRC_St.DFC_Com4F2hChecksum "" ULONG DFC_OneToOne 1 100 0.00 536870911.000 BIT_MASK 0x1fffffff FORMAT "%13.3" ECU_ADDRESS 0x6001C5EC /end MEASUREMENT
/begin MEASUREMENT DDRC_St.DFC_Com4F2hCounter "" ULONG DFC_OneToOne 1 100 0.00 536870911.000 BIT_MASK 0x1fffffff FORMAT "%13.3" ECU_ADDRESS 0x6001C5F0 /end MEASUREMENT
/begin MEASUREMENT DDRC_St.DFC_Com4F2hTooShort "" ULONG DFC_OneToOne 1 100 0.00 536870911.000 BIT_MASK 0x1fffffff FORMAT "%13.3" ECU_ADDRESS 0x6001C5F4 /end MEASUREMENT
/begin MEASUREMENT DDRC_St.DFC_Com50DhAbsent "" ULONG DFC_OneToOne 1 100 0.00 536870911.000 BIT_MASK 0x1fffffff FORMAT "%13.3" ECU_ADDRESS 0x6001C5F8 /end MEASUREMENT
/begin MEASUREMENT DDRC_St.DFC_Com50DhTooShort "" ULONG DFC_OneToOne 1 100 0.00 536870911.000 BIT_MASK 0x1fffffff FORMAT "%13.3" ECU_ADDRESS 0x6001C5FC /end MEASUREMENT
/begin MEASUREMENT DDRC_St.DFC_Com535hAbsent "" ULONG DFC_OneToOne 1 100 0.00 536870911.000 BIT_MASK 0x1fffffff FORMAT "%13.3" ECU_ADDRESS 0x6001C600 /end MEASUREMENT
/begin MEASUREMENT DDRC_St.DFC_Com535hTooShort "" ULONG DFC_OneToOne 1 100 0.00 536870911.000 BIT_MASK 0x1fffffff FORMAT "%13.3" ECU_ADDRESS 0x6001C604 /end MEASUREMENT
/begin MEASUREMENT DDRC_St.DFC_Com543hAbsent "" ULONG DFC_OneToOne 1 100 0.00 536870911.000 BIT_MASK 0x1fffffff FORMAT "%13.3" ECU_ADDRESS 0x6001C608 /end MEASUREMENT
/begin MEASUREMENT DDRC_St.DFC_Com543hTooShort "" ULONG DFC_OneToOne 1 100 0.00 536870911.000 BIT_MASK 0x1fffffff FORMAT "%13.3" ECU_ADDRESS 0x6001C60C /end MEASUREMENT
/begin MEASUREMENT DDRC_St.DFC_Com552hAbsent "" ULONG DFC_OneToOne 1 100 0.00 536870911.000 BIT_MASK 0x1fffffff FORMAT "%13.3" ECU_ADDRESS 0x6001C610 /end MEASUREMENT
/begin MEASUREMENT DDRC_St.DFC_Com552hTooShort "" ULONG DFC_OneToOne 1 100 0.00 536870911.000 BIT_MASK 0x1fffffff FORMAT "%13.3" ECU_ADDRESS 0x6001C614 /end MEASUREMENT
/begin MEASUREMENT DDRC_St.DFC_Com583hAbsent "" ULONG DFC_OneToOne 1 100 0.00 536870911.000 BIT_MASK 0x1fffffff FORMAT "%13.3" ECU_ADDRESS 0x6001C618 /end MEASUREMENT
/begin MEASUREMENT DDRC_St.DFC_Com583hTooShort "" ULONG DFC_OneToOne 1 100 0.00 536870911.000 BIT_MASK 0x1fffffff FORMAT "%13.3" ECU_ADDRESS 0x6001C61C /end MEASUREMENT
/begin MEASUREMENT DDRC_St.DFC_Com592hAbsent "" ULONG DFC_OneToOne 1 100 0.00 536870911.000 BIT_MASK 0x1fffffff FORMAT "%13.3" ECU_ADDRESS 0x6001C620 /end MEASUREMENT
/begin MEASUREMENT DDRC_St.DFC_Com592hChecksum "" ULONG DFC_OneToOne 1 100 0.00 536870911.000 BIT_MASK 0x1fffffff FORMAT "%13.3" ECU_ADDRESS 0x6001C624 /end MEASUREMENT
/begin MEASUREMENT DDRC_St.DFC_Com592hCounter "" ULONG DFC_OneToOne 1 100 0.00 536870911.000 BIT_MASK 0x1fffffff FORMAT "%13.3" ECU_ADDRESS 0x6001C628 /end MEASUREMENT
/begin MEASUREMENT DDRC_St.DFC_Com592hTooShort "" ULONG DFC_OneToOne 1 100 0.00 536870911.000 BIT_MASK 0x1fffffff FORMAT "%13.3" ECU_ADDRESS 0x6001C62C /end MEASUREMENT
/begin MEASUREMENT DDRC_St.DFC_Com595hAbsent "" ULONG DFC_OneToOne 1 100 0.00 536870911.000 BIT_MASK 0x1fffffff FORMAT "%13.3" ECU_ADDRESS 0x6001C630 /end MEASUREMENT
/begin MEASUREMENT DDRC_St.DFC_Com595hChecksum "" ULONG DFC_OneToOne 1 100 0.00 536870911.000 BIT_MASK 0x1fffffff FORMAT "%13.3" ECU_ADDRESS 0x6001C634 /end MEASUREMENT
/begin MEASUREMENT DDRC_St.DFC_Com595hCounter "" ULONG DFC_OneToOne 1 100 0.00 536870911.000 BIT_MASK 0x1fffffff FORMAT "%13.3" ECU_ADDRESS 0x6001C638 /end MEASUREMENT
/begin MEASUREMENT DDRC_St.DFC_Com595hTooShort "" ULONG DFC_OneToOne 1 100 0.00 536870911.000 BIT_MASK 0x1fffffff FORMAT "%13.3" ECU_ADDRESS 0x6001C63C /end MEASUREMENT
/begin MEASUREMENT DDRC_St.DFC_Com5B2hAbsent "" ULONG DFC_OneToOne 1 100 0.00 536870911.000 BIT_MASK 0x1fffffff FORMAT "%13.3" ECU_ADDRESS 0x6001C640 /end MEASUREMENT
/begin MEASUREMENT DDRC_St.DFC_Com5B2hTooShort "" ULONG DFC_OneToOne 1 100 0.00 536870911.000 BIT_MASK 0x1fffffff FORMAT "%13.3" ECU_ADDRESS 0x6001C644 /end MEASUREMENT
/begin MEASUREMENT DDRC_St.DFC_Com5B5hAbsent "" ULONG DFC_OneToOne 1 100 0.00 536870911.000 BIT_MASK 0x1fffffff FORMAT "%13.3" ECU_ADDRESS 0x6001C648 /end MEASUREMENT
/begin MEASUREMENT DDRC_St.DFC_Com5B5hChecksum "" ULONG DFC_OneToOne 1 100 0.00 536870911.000 BIT_MASK 0x1fffffff FORMAT "%13.3" ECU_ADDRESS 0x6001C64C /end MEASUREMENT
/begin MEASUREMENT DDRC_St.DFC_Com5B5hCounter "" ULONG DFC_OneToOne 1 100 0.00 536870911.000 BIT_MASK 0x1fffffff FORMAT "%13.3" ECU_ADDRESS 0x6001C650 /end MEASUREMENT
/begin MEASUREMENT DDRC_St.DFC_Com5B5hTooShort "" ULONG DFC_OneToOne 1 100 0.00 536870911.000 BIT_MASK 0x1fffffff FORMAT "%13.3" ECU_ADDRESS 0x6001C654 /end MEASUREMENT
/begin MEASUREMENT DDRC_St.DFC_Com5C7hTooShort "" ULONG DFC_OneToOne 1 100 0.00 536870911.000 BIT_MASK 0x1fffffff FORMAT "%13.3" ECU_ADDRESS 0x6001C658 /end MEASUREMENT
/begin MEASUREMENT DDRC_St.DFC_Com5E7hAbsent "" ULONG DFC_OneToOne 1 100 0.00 536870911.000 BIT_MASK 0x1fffffff FORMAT "%13.3" ECU_ADDRESS 0x6001C65C /end MEASUREMENT
/begin MEASUREMENT DDRC_St.DFC_Com5E7hTooShort "" ULONG DFC_OneToOne 1 100 0.00 536870911.000 BIT_MASK 0x1fffffff FORMAT "%13.3" ECU_ADDRESS 0x6001C660 /end MEASUREMENT
/begin MEASUREMENT DDRC_St.DFC_Com635hTooShort "" ULONG DFC_OneToOne 1 100 0.00 536870911.000 BIT_MASK 0x1fffffff FORMAT "%13.3" ECU_ADDRESS 0x6001C664 /end MEASUREMENT
/begin MEASUREMENT DDRC_St.DFC_Com645hTooShort "" ULONG DFC_OneToOne 1 100 0.00 536870911.000 BIT_MASK 0x1fffffff FORMAT "%13.3" ECU_ADDRESS 0x6001C668 /end MEASUREMENT
/begin MEASUREMENT DDRC_St.DFC_Com663hAbsent "" ULONG DFC_OneToOne 1 100 0.00 536870911.000 BIT_MASK 0x1fffffff FORMAT "%13.3" ECU_ADDRESS 0x6001C66C /end MEASUREMENT
/begin MEASUREMENT DDRC_St.DFC_Com663hTooShort "" ULONG DFC_OneToOne 1 100 0.00 536870911.000 BIT_MASK 0x1fffffff FORMAT "%13.3" ECU_ADDRESS 0x6001C670 /end MEASUREMENT
/begin MEASUREMENT DDRC_St.DFC_Com665hAbsent "" ULONG DFC_OneToOne 1 100 0.00 536870911.000 BIT_MASK 0x1fffffff FORMAT "%13.3" ECU_ADDRESS 0x6001C674 /end MEASUREMENT
/begin MEASUREMENT DDRC_St.DFC_Com665hTooShort "" ULONG DFC_OneToOne 1 100 0.00 536870911.000 BIT_MASK 0x1fffffff FORMAT "%13.3" ECU_ADDRESS 0x6001C678 /end MEASUREMENT
/begin MEASUREMENT DDRC_St.DFC_Com675hAbsent "" ULONG DFC_OneToOne 1 100 0.00 536870911.000 BIT_MASK 0x1fffffff FORMAT "%13.3" ECU_ADDRESS 0x6001C67C /end MEASUREMENT
/begin MEASUREMENT DDRC_St.DFC_Com675hTooShort "" ULONG DFC_OneToOne 1 100 0.00 536870911.000 BIT_MASK 0x1fffffff FORMAT "%13.3" ECU_ADDRESS 0x6001C680 /end MEASUREMENT
/begin MEASUREMENT DDRC_St.DFC_ComFrbd_205h_HVBAT_PACK_CURRENT "" ULONG DFC_OneToOne 1 100 0.00 536870911.000 BIT_MASK 0x1fffffff FORMAT "%13.3" ECU_ADDRESS 0x6001C684 /end MEASUREMENT
/begin MEASUREMENT DDRC_St.DFC_ComFrbd_205h_HVBAT_SOC_DISPLAY "" ULONG DFC_OneToOne 1 100 0.00 536870911.000 BIT_MASK 0x1fffffff FORMAT "%13.3" ECU_ADDRESS 0x6001C688 /end MEASUREMENT
/begin MEASUREMENT DDRC_St.DFC_ComFrbd_205h_HVBAT_VOLTAGE "" ULONG DFC_OneToOne 1 100 0.00 536870911.000 BIT_MASK 0x1fffffff FORMAT "%13.3" ECU_ADDRESS 0x6001C68C /end MEASUREMENT
/begin MEASUREMENT DDRC_St.DFC_ComFrbd_217h_INV_DC_BUS_VOLTAGE "" ULONG DFC_OneToOne 1 100 0.00 536870911.000 BIT_MASK 0x1fffffff FORMAT "%13.3" ECU_ADDRESS 0x6001C690 /end MEASUREMENT
/begin MEASUREMENT DDRC_St.DFC_ComFrbd_217h_INV_MTR_ACTUAL_TRQ "" ULONG DFC_OneToOne 1 100 0.00 536870911.000 BIT_MASK 0x1fffffff FORMAT "%13.3" ECU_ADDRESS 0x6001C694 /end MEASUREMENT
/begin MEASUREMENT DDRC_St.DFC_ComFrbd_217h_INV_MTR_SPEED "" ULONG DFC_OneToOne 1 100 0.00 536870911.000 BIT_MASK 0x1fffffff FORMAT "%13.3" ECU_ADDRESS 0x6001C698 /end MEASUREMENT
/begin MEASUREMENT DDRC_St.DFC_ComFrbd_217h_INV_MTR_TRQ "" ULONG DFC_OneToOne 1 100 0.00 536870911.000 BIT_MASK 0x1fffffff FORMAT "%13.3" ECU_ADDRESS 0x6001C69C /end MEASUREMENT
/begin MEASUREMENT DDRC_St.DFC_ComFrbd_227h_INV_DC_CURRENT "" ULONG DFC_OneToOne 1 100 0.00 536870911.000 BIT_MASK 0x1fffffff FORMAT "%13.3" ECU_ADDRESS 0x6001C6A0 /end MEASUREMENT
/begin MEASUREMENT DDRC_St.DFC_ComFrbd_227h_INV_MOTORING_PEAK_TRQ "" ULONG DFC_OneToOne 1 100 0.00 536870911.000 BIT_MASK 0x1fffffff FORMAT "%13.3" ECU_ADDRESS 0x6001C6A4 /end MEASUREMENT
/begin MEASUREMENT DDRC_St.DFC_ComFrbd_227h_INV_MTR_INST_INPUT_POWER "" ULONG DFC_OneToOne 1 100 0.00 536870911.000 BIT_MASK 0x1fffffff FORMAT "%13.3" ECU_ADDRESS 0x6001C6A8 /end MEASUREMENT
/begin MEASUREMENT DDRC_St.DFC_ComFrbd_227h_INV_REGEN_PEAK_TRQ "" ULONG DFC_OneToOne 1 100 0.00 536870911.000 BIT_MASK 0x1fffffff FORMAT "%13.3" ECU_ADDRESS 0x6001C6AC /end MEASUREMENT
/begin MEASUREMENT DDRC_St.DFC_ComFrbd_237h_INV_ACTIVE_DISCHARGE_STATUS "" ULONG DFC_OneToOne 1 100 0.00 536870911.000 BIT_MASK 0x1fffffff FORMAT "%13.3" ECU_ADDRESS 0x6001C6B0 /end MEASUREMENT
/begin MEASUREMENT DDRC_St.DFC_ComFrbd_237h_INV_CTRL_MODE_ACK "" ULONG DFC_OneToOne 1 100 0.00 536870911.000 BIT_MASK 0x1fffffff FORMAT "%13.3" ECU_ADDRESS 0x6001C6B4 /end MEASUREMENT
/begin MEASUREMENT DDRC_St.DFC_ComFrbd_237h_INV_EV_WARNING "" ULONG DFC_OneToOne 1 100 0.00 536870911.000 BIT_MASK 0x1fffffff FORMAT "%13.3" ECU_ADDRESS 0x6001C6B8 /end MEASUREMENT
/begin MEASUREMENT DDRC_St.DFC_ComFrbd_237h_INV_FAULT_LEVEL "" ULONG DFC_OneToOne 1 100 0.00 536870911.000 BIT_MASK 0x1fffffff FORMAT "%13.3" ECU_ADDRESS 0x6001C6BC /end MEASUREMENT
/begin MEASUREMENT DDRC_St.DFC_ComFrbd_237h_INV_MASTER_STOP "" ULONG DFC_OneToOne 1 100 0.00 536870911.000 BIT_MASK 0x1fffffff FORMAT "%13.3" ECU_ADDRESS 0x6001C6C0 /end MEASUREMENT
/begin MEASUREMENT DDRC_St.DFC_ComFrbd_237h_INV_SERVICE_DUE "" ULONG DFC_OneToOne 1 100 0.00 536870911.000 BIT_MASK 0x1fffffff FORMAT "%13.3" ECU_ADDRESS 0x6001C6C4 /end MEASUREMENT
/begin MEASUREMENT DDRC_St.DFC_ComFrbd_237h_INV_STAB_MIN_TRQ "" ULONG DFC_OneToOne 1 100 0.00 536870911.000 BIT_MASK 0x1fffffff FORMAT "%13.3" ECU_ADDRESS 0x6001C6C8 /end MEASUREMENT
/begin MEASUREMENT DDRC_St.DFC_ComFrbd_259h_TGLM_FAILURE_STATE "" ULONG DFC_OneToOne 1 100 0.00 536870911.000 BIT_MASK 0x1fffffff FORMAT "%13.3" ECU_ADDRESS 0x6001C6CC /end MEASUREMENT
/begin MEASUREMENT DDRC_St.DFC_ComFrbd_259h_TGLM_MODE_PUSH "" ULONG DFC_OneToOne 1 100 0.00 536870911.000 BIT_MASK 0x1fffffff FORMAT "%13.3" ECU_ADDRESS 0x6001C6D0 /end MEASUREMENT
/begin MEASUREMENT DDRC_St.DFC_ComFrbd_259h_TOGGLE_MONOSTABLE_POS "" ULONG DFC_OneToOne 1 100 0.00 536870911.000 BIT_MASK 0x1fffffff FORMAT "%13.3" ECU_ADDRESS 0x6001C6D4 /end MEASUREMENT
/begin MEASUREMENT DDRC_St.DFC_ComFrbd_273h_OBC_outputpower_capability "" ULONG DFC_OneToOne 1 100 0.00 536870911.000 BIT_MASK 0x1fffffff FORMAT "%13.3" ECU_ADDRESS 0x6001C6D8 /end MEASUREMENT
/begin MEASUREMENT DDRC_St.DFC_ComFrbd_275h_HVBAT_DISCHARGE_30S_AVAILABLE_CURRENT "" ULONG DFC_OneToOne 1 100 0.00 536870911.000 BIT_MASK 0x1fffffff FORMAT "%13.3" ECU_ADDRESS 0x6001C6DC /end MEASUREMENT
/begin MEASUREMENT DDRC_St.DFC_ComFrbd_275h_HVBAT_DISCHARGE_30S_AVAILABLE_POWER "" ULONG DFC_OneToOne 1 100 0.00 536870911.000 BIT_MASK 0x1fffffff FORMAT "%13.3" ECU_ADDRESS 0x6001C6E0 /end MEASUREMENT
/begin MEASUREMENT DDRC_St.DFC_ComFrbd_283h_DCDC_IN_CURRENT "" ULONG DFC_OneToOne 1 100 0.00 536870911.000 BIT_MASK 0x1fffffff FORMAT "%13.3" ECU_ADDRESS 0x6001C6E4 /end MEASUREMENT
/begin MEASUREMENT DDRC_St.DFC_ComFrbd_283h_DCDC_IN_VOLTAGE "" ULONG DFC_OneToOne 1 100 0.00 536870911.000 BIT_MASK 0x1fffffff FORMAT "%13.3" ECU_ADDRESS 0x6001C6E8 /end MEASUREMENT
/begin MEASUREMENT DDRC_St.DFC_ComFrbd_283h_DCDC_OUT_CURRENT "" ULONG DFC_OneToOne 1 100 0.00 536870911.000 BIT_MASK 0x1fffffff FORMAT "%13.3" ECU_ADDRESS 0x6001C6EC /end MEASUREMENT
/begin MEASUREMENT DDRC_St.DFC_ComFrbd_283h_DCDC_OUT_VOLTAGE "" ULONG DFC_OneToOne 1 100 0.00 536870911.000 BIT_MASK 0x1fffffff FORMAT "%13.3" ECU_ADDRESS 0x6001C6F0 /end MEASUREMENT
/begin MEASUREMENT DDRC_St.DFC_ComFrbd_285h_HVBAT_REGEN_CHG_30S_CURRENT_LIMIT "" ULONG DFC_OneToOne 1 100 0.00 536870911.000 BIT_MASK 0x1fffffff FORMAT "%13.3" ECU_ADDRESS 0x6001C6F4 /end MEASUREMENT
/begin MEASUREMENT DDRC_St.DFC_ComFrbd_285h_HVBAT_REGEN_CHRG_30S_POWER_LIMIT "" ULONG DFC_OneToOne 1 100 0.00 536870911.000 BIT_MASK 0x1fffffff FORMAT "%13.3" ECU_ADDRESS 0x6001C6F8 /end MEASUREMENT
/begin MEASUREMENT DDRC_St.DFC_ComFrbd_293h_DCDC_outputpower_capability "" ULONG DFC_OneToOne 1 100 0.00 536870911.000 BIT_MASK 0x1fffffff FORMAT "%13.3" ECU_ADDRESS 0x6001C6FC /end MEASUREMENT
/begin MEASUREMENT DDRC_St.DFC_ComFrbd_325h_HVBAT_INSULATION_RESISTANCE "" ULONG DFC_OneToOne 1 100 0.00 536870911.000 BIT_MASK 0x1fffffff FORMAT "%13.3" ECU_ADDRESS 0x6001C700 /end MEASUREMENT
/begin MEASUREMENT DDRC_St.DFC_ComFrbd_325h_HVBAT_TEMPERATURE "" ULONG DFC_OneToOne 1 100 0.00 536870911.000 BIT_MASK 0x1fffffff FORMAT "%13.3" ECU_ADDRESS 0x6001C704 /end MEASUREMENT
/begin MEASUREMENT DDRC_St.DFC_ComFrbd_335h_HVBAT_CHRG_CONTINUOUS_CURR_MAX "" ULONG DFC_OneToOne 1 100 0.00 536870911.000 BIT_MASK 0x1fffffff FORMAT "%13.3" ECU_ADDRESS 0x6001C708 /end MEASUREMENT
/begin MEASUREMENT DDRC_St.DFC_ComFrbd_335h_HVBAT_CHRG_COTINUOUS_CURR_REQ "" ULONG DFC_OneToOne 1 100 0.00 536870911.000 BIT_MASK 0x1fffffff FORMAT "%13.3" ECU_ADDRESS 0x6001C70C /end MEASUREMENT
/begin MEASUREMENT DDRC_St.DFC_ComFrbd_335h_HVBAT_CHRG_MAX_VOLT "" ULONG DFC_OneToOne 1 100 0.00 536870911.000 BIT_MASK 0x1fffffff FORMAT "%13.3" ECU_ADDRESS 0x6001C710 /end MEASUREMENT
/begin MEASUREMENT DDRC_St.DFC_ComFrbd_335h_HVBAT_DC_BUS_VOLTAGE "" ULONG DFC_OneToOne 1 100 0.00 536870911.000 BIT_MASK 0x1fffffff FORMAT "%13.3" ECU_ADDRESS 0x6001C714 /end MEASUREMENT
/begin MEASUREMENT DDRC_St.DFC_ComFrbd_427h_INV_OP_MODE "" ULONG DFC_OneToOne 1 100 0.00 536870911.000 BIT_MASK 0x1fffffff FORMAT "%13.3" ECU_ADDRESS 0x6001C718 /end MEASUREMENT
/begin MEASUREMENT DDRC_St.DFC_ComFrbd_427h_INV_PERMISIBLE_TORQUE "" ULONG DFC_OneToOne 1 100 0.00 536870911.000 BIT_MASK 0x1fffffff FORMAT "%13.3" ECU_ADDRESS 0x6001C71C /end MEASUREMENT
/begin MEASUREMENT DDRC_St.DFC_ComFrbd_435h_HVBAT_MAX_CELL_VOLT "" ULONG DFC_OneToOne 1 100 0.00 536870911.000 BIT_MASK 0x1fffffff FORMAT "%13.3" ECU_ADDRESS 0x6001C720 /end MEASUREMENT
/begin MEASUREMENT DDRC_St.DFC_ComFrbd_435h_HVBAT_MAX_CELL_VOLT_NUM "" ULONG DFC_OneToOne 1 100 0.00 536870911.000 BIT_MASK 0x1fffffff FORMAT "%13.3" ECU_ADDRESS 0x6001C724 /end MEASUREMENT
/begin MEASUREMENT DDRC_St.DFC_ComFrbd_435h_HVBAT_MAX_SENSOR_TEMP "" ULONG DFC_OneToOne 1 100 0.00 536870911.000 BIT_MASK 0x1fffffff FORMAT "%13.3" ECU_ADDRESS 0x6001C728 /end MEASUREMENT
/begin MEASUREMENT DDRC_St.DFC_ComFrbd_435h_HVBAT_MIN_CELL_VOLT "" ULONG DFC_OneToOne 1 100 0.00 536870911.000 BIT_MASK 0x1fffffff FORMAT "%13.3" ECU_ADDRESS 0x6001C72C /end MEASUREMENT
/begin MEASUREMENT DDRC_St.DFC_ComFrbd_435h_HVBAT_MIN_CELL_VOLT_NUM "" ULONG DFC_OneToOne 1 100 0.00 536870911.000 BIT_MASK 0x1fffffff FORMAT "%13.3" ECU_ADDRESS 0x6001C730 /end MEASUREMENT
/begin MEASUREMENT DDRC_St.DFC_ComFrbd_453h_OBC_IN_CURRENT "" ULONG DFC_OneToOne 1 100 0.00 536870911.000 BIT_MASK 0x1fffffff FORMAT "%13.3" ECU_ADDRESS 0x6001C734 /end MEASUREMENT
/begin MEASUREMENT DDRC_St.DFC_ComFrbd_453h_OBC_IN_VOLTAGE "" ULONG DFC_OneToOne 1 100 0.00 536870911.000 BIT_MASK 0x1fffffff FORMAT "%13.3" ECU_ADDRESS 0x6001C738 /end MEASUREMENT
/begin MEASUREMENT DDRC_St.DFC_ComFrbd_453h_OBC_IP_POWER "" ULONG DFC_OneToOne 1 100 0.00 536870911.000 BIT_MASK 0x1fffffff FORMAT "%13.3" ECU_ADDRESS 0x6001C73C /end MEASUREMENT
/begin MEASUREMENT DDRC_St.DFC_ComFrbd_455h_HVBAT_NOMINAL_VOLTAGE "" ULONG DFC_OneToOne 1 100 0.00 536870911.000 BIT_MASK 0x1fffffff FORMAT "%13.3" ECU_ADDRESS 0x6001C740 /end MEASUREMENT
/begin MEASUREMENT DDRC_St.DFC_ComFrbd_463h_OBC_OUT_CURRENT "" ULONG DFC_OneToOne 1 100 0.00 536870911.000 BIT_MASK 0x1fffffff FORMAT "%13.3" ECU_ADDRESS 0x6001C744 /end MEASUREMENT
/begin MEASUREMENT DDRC_St.DFC_ComFrbd_463h_OBC_OUT_VOLTAGE "" ULONG DFC_OneToOne 1 100 0.00 536870911.000 BIT_MASK 0x1fffffff FORMAT "%13.3" ECU_ADDRESS 0x6001C748 /end MEASUREMENT
/begin MEASUREMENT DDRC_St.DFC_ComFrbd_463h_OBC_TEMPERATURE "" ULONG DFC_OneToOne 1 100 0.00 536870911.000 BIT_MASK 0x1fffffff FORMAT "%13.3" ECU_ADDRESS 0x6001C74C /end MEASUREMENT
/begin MEASUREMENT DDRC_St.DFC_ComFrbd_473h_DCDC_Coolant_Temperature "" ULONG DFC_OneToOne 1 100 0.00 536870911.000 BIT_MASK 0x1fffffff FORMAT "%13.3" ECU_ADDRESS 0x6001C750 /end MEASUREMENT
/begin MEASUREMENT DDRC_St.DFC_ComFrbd_473h_DCDC_TEMPERATURE "" ULONG DFC_OneToOne 1 100 0.00 536870911.000 BIT_MASK 0x1fffffff FORMAT "%13.3" ECU_ADDRESS 0x6001C754 /end MEASUREMENT
/begin MEASUREMENT DDRC_St.DFC_ComFrbd_47Bh_eCOMP_BusBarCurrent "" ULONG DFC_OneToOne 1 100 0.00 536870911.000 BIT_MASK 0x1fffffff FORMAT "%13.3" ECU_ADDRESS 0x6001C758 /end MEASUREMENT
/begin MEASUREMENT DDRC_St.DFC_ComFrbd_47Bh_eCOMP_BusBarVoltage "" ULONG DFC_OneToOne 1 100 0.00 536870911.000 BIT_MASK 0x1fffffff FORMAT "%13.3" ECU_ADDRESS 0x6001C75C /end MEASUREMENT
/begin MEASUREMENT DDRC_St.DFC_ComFrbd_47Bh_eCOMP_CompressorSpeed "" ULONG DFC_OneToOne 1 100 0.00 536870911.000 BIT_MASK 0x1fffffff FORMAT "%13.3" ECU_ADDRESS 0x6001C760 /end MEASUREMENT
/begin MEASUREMENT DDRC_St.DFC_ComFrbd_47Bh_eCOMP_IGBT_Temp "" ULONG DFC_OneToOne 1 100 0.00 536870911.000 BIT_MASK 0x1fffffff FORMAT "%13.3" ECU_ADDRESS 0x6001C764 /end MEASUREMENT
/begin MEASUREMENT DDRC_St.DFC_ComFrbd_47Bh_eCOMP_PeakPhaCurrent "" ULONG DFC_OneToOne 1 100 0.00 536870911.000 BIT_MASK 0x1fffffff FORMAT "%13.3" ECU_ADDRESS 0x6001C768 /end MEASUREMENT
/begin MEASUREMENT DDRC_St.DFC_ComFrbd_47Bh_eCOMP_Power_consumption "" ULONG DFC_OneToOne 1 100 0.00 536870911.000 BIT_MASK 0x1fffffff FORMAT "%13.3" ECU_ADDRESS 0x6001C76C /end MEASUREMENT
/begin MEASUREMENT DDRC_St.DFC_ComFrbd_48Bh_eCOMP_Fault_Level "" ULONG DFC_OneToOne 1 100 0.00 536870911.000 BIT_MASK 0x1fffffff FORMAT "%13.3" ECU_ADDRESS 0x6001C770 /end MEASUREMENT
/begin MEASUREMENT DDRC_St.DFC_ComFrbd_4F2h_VALEUR_SOC_ETENDUE "" ULONG DFC_OneToOne 1 100 0.00 536870911.000 BIT_MASK 0x1fffffff FORMAT "%13.3" ECU_ADDRESS 0x6001C774 /end MEASUREMENT
/begin MEASUREMENT DDRC_St.DFC_ComFrbd_535h_HV_BATT_TEMP_AVG "" ULONG DFC_OneToOne 1 100 0.00 536870911.000 BIT_MASK 0x1fffffff FORMAT "%13.3" ECU_ADDRESS 0x6001C778 /end MEASUREMENT
/begin MEASUREMENT DDRC_St.DFC_ComFrbd_543h_HVBAT_RESTBATTENERGY "" ULONG DFC_OneToOne 1 100 0.00 536870911.000 BIT_MASK 0x1fffffff FORMAT "%13.3" ECU_ADDRESS 0x6001C77C /end MEASUREMENT
/begin MEASUREMENT DDRC_St.DFC_ComFrbd_543h_HVBAT_SOH "" ULONG DFC_OneToOne 1 100 0.00 536870911.000 BIT_MASK 0x1fffffff FORMAT "%13.3" ECU_ADDRESS 0x6001C780 /end MEASUREMENT
/begin MEASUREMENT DDRC_St.DFC_ComFrbd_543h_HV_BATT_SOH_RES "" ULONG DFC_OneToOne 1 100 0.00 536870911.000 BIT_MASK 0x1fffffff FORMAT "%13.3" ECU_ADDRESS 0x6001C784 /end MEASUREMENT
/begin MEASUREMENT DDRC_St.DFC_ComFrbd_592h_IBATT_1 "" ULONG DFC_OneToOne 1 100 0.00 536870911.000 BIT_MASK 0x1fffffff FORMAT "%13.3" ECU_ADDRESS 0x6001C788 /end MEASUREMENT
/begin MEASUREMENT DDRC_St.DFC_ComFrbd_592h_IBATT_2 "" ULONG DFC_OneToOne 1 100 0.00 536870911.000 BIT_MASK 0x1fffffff FORMAT "%13.3" ECU_ADDRESS 0x6001C78C /end MEASUREMENT
/begin MEASUREMENT DDRC_St.DFC_ComFrbd_592h_IBATT_3 "" ULONG DFC_OneToOne 1 100 0.00 536870911.000 BIT_MASK 0x1fffffff FORMAT "%13.3" ECU_ADDRESS 0x6001C790 /end MEASUREMENT
/begin MEASUREMENT DDRC_St.DFC_ComFrbd_592h_TEMP_BATT "" ULONG DFC_OneToOne 1 100 0.00 536870911.000 BIT_MASK 0x1fffffff FORMAT "%13.3" ECU_ADDRESS 0x6001C794 /end MEASUREMENT
/begin MEASUREMENT DDRC_St.DFC_ComFrbd_592h_U_BATT_BECB "" ULONG DFC_OneToOne 1 100 0.00 536870911.000 BIT_MASK 0x1fffffff FORMAT "%13.3" ECU_ADDRESS 0x6001C798 /end MEASUREMENT
/begin MEASUREMENT DDRC_St.DFC_ComFrbd_595h_HVBAT_TIME_TO_CHRG_80 "" ULONG DFC_OneToOne 1 100 0.00 536870911.000 BIT_MASK 0x1fffffff FORMAT "%13.3" ECU_ADDRESS 0x6001C79C /end MEASUREMENT
/begin MEASUREMENT DDRC_St.DFC_ComFrbd_5B2h_TEMP_AIR_EXT "" ULONG DFC_OneToOne 1 100 0.00 536870911.000 BIT_MASK 0x1fffffff FORMAT "%13.3" ECU_ADDRESS 0x6001C7A0 /end MEASUREMENT
/begin MEASUREMENT DDRC_St.DFC_ComFrbd_635h_HVBAT_NEG_CONT_COUNT_SEG1 "" ULONG DFC_OneToOne 1 100 0.00 536870911.000 BIT_MASK 0x1fffffff FORMAT "%13.3" ECU_ADDRESS 0x6001C7A4 /end MEASUREMENT
/begin MEASUREMENT DDRC_St.DFC_ComFrbd_635h_HVBAT_NEG_CONT_COUNT_SEG3 "" ULONG DFC_OneToOne 1 100 0.00 536870911.000 BIT_MASK 0x1fffffff FORMAT "%13.3" ECU_ADDRESS 0x6001C7A8 /end MEASUREMENT
/begin MEASUREMENT DDRC_St.DFC_ComFrbd_635h_HVBAT_NEG_CONT_COUNT_SEG4 "" ULONG DFC_OneToOne 1 100 0.00 536870911.000 BIT_MASK 0x1fffffff FORMAT "%13.3" ECU_ADDRESS 0x6001C7AC /end MEASUREMENT
/begin MEASUREMENT DDRC_St.DFC_ComFrbd_635h_HVBAT_PST_CONT_COUNT_SEG1 "" ULONG DFC_OneToOne 1 100 0.00 536870911.000 BIT_MASK 0x1fffffff FORMAT "%13.3" ECU_ADDRESS 0x6001C7B0 /end MEASUREMENT
/begin MEASUREMENT DDRC_St.DFC_ComFrbd_635h_HVBAT_PST_CONT_COUNT_SEG3 "" ULONG DFC_OneToOne 1 100 0.00 536870911.000 BIT_MASK 0x1fffffff FORMAT "%13.3" ECU_ADDRESS 0x6001C7B4 /end MEASUREMENT
/begin MEASUREMENT DDRC_St.DFC_ComFrbd_635h_HVBAT_PST_CONT_COUNT_SEG4 "" ULONG DFC_OneToOne 1 100 0.00 536870911.000 BIT_MASK 0x1fffffff FORMAT "%13.3" ECU_ADDRESS 0x6001C7B8 /end MEASUREMENT
/begin MEASUREMENT DDRC_St.DFC_ComFrbd_645h_HVBAT_PRECHRGE_CONT_COUNT_SEG1 "" ULONG DFC_OneToOne 1 100 0.00 536870911.000 BIT_MASK 0x1fffffff FORMAT "%13.3" ECU_ADDRESS 0x6001C7BC /end MEASUREMENT
/begin MEASUREMENT DDRC_St.DFC_ComFrbd_645h_HVBAT_PRECHRGE_CONT_COUNT_SEG2 "" ULONG DFC_OneToOne 1 100 0.00 536870911.000 BIT_MASK 0x1fffffff FORMAT "%13.3" ECU_ADDRESS 0x6001C7C0 /end MEASUREMENT
/begin MEASUREMENT DDRC_St.DFC_ComFrbd_675h_HVBAT_REMAININGBATTCAPACITY "" ULONG DFC_OneToOne 1 100 0.00 536870911.000 BIT_MASK 0x1fffffff FORMAT "%13.3" ECU_ADDRESS 0x6001C7C4 /end MEASUREMENT
/begin MEASUREMENT DDRC_St.DFC_ComInvld_205h_HVBAT_CHARGING_STATUS "" ULONG DFC_OneToOne 1 100 0.00 536870911.000 BIT_MASK 0x1fffffff FORMAT "%13.3" ECU_ADDRESS 0x6001C7C8 /end MEASUREMENT
/begin MEASUREMENT DDRC_St.DFC_ComInvld_205h_HVBAT_PACK_CURRENT "" ULONG DFC_OneToOne 1 100 0.00 536870911.000 BIT_MASK 0x1fffffff FORMAT "%13.3" ECU_ADDRESS 0x6001C7CC /end MEASUREMENT
/begin MEASUREMENT DDRC_St.DFC_ComInvld_205h_HVBAT_SOC_DISPLAY "" ULONG DFC_OneToOne 1 100 0.00 536870911.000 BIT_MASK 0x1fffffff FORMAT "%13.3" ECU_ADDRESS 0x6001C7D0 /end MEASUREMENT
/begin MEASUREMENT DDRC_St.DFC_ComInvld_205h_HVBAT_VOLTAGE "" ULONG DFC_OneToOne 1 100 0.00 536870911.000 BIT_MASK 0x1fffffff FORMAT "%13.3" ECU_ADDRESS 0x6001C7D4 /end MEASUREMENT
/begin MEASUREMENT DDRC_St.DFC_ComInvld_217h_INV_DC_BUS_VOLTAGE "" ULONG DFC_OneToOne 1 100 0.00 536870911.000 BIT_MASK 0x1fffffff FORMAT "%13.3" ECU_ADDRESS 0x6001C7D8 /end MEASUREMENT
/begin MEASUREMENT DDRC_St.DFC_ComInvld_217h_INV_MTR_ACTUAL_TRQ "" ULONG DFC_OneToOne 1 100 0.00 536870911.000 BIT_MASK 0x1fffffff FORMAT "%13.3" ECU_ADDRESS 0x6001C7DC /end MEASUREMENT
/begin MEASUREMENT DDRC_St.DFC_ComInvld_217h_INV_MTR_SPEED "" ULONG DFC_OneToOne 1 100 0.00 536870911.000 BIT_MASK 0x1fffffff FORMAT "%13.3" ECU_ADDRESS 0x6001C7E0 /end MEASUREMENT
/begin MEASUREMENT DDRC_St.DFC_ComInvld_217h_INV_MTR_TRQ "" ULONG DFC_OneToOne 1 100 0.00 536870911.000 BIT_MASK 0x1fffffff FORMAT "%13.3" ECU_ADDRESS 0x6001C7E4 /end MEASUREMENT
/begin MEASUREMENT DDRC_St.DFC_ComInvld_227h_INV_DC_CURRENT "" ULONG DFC_OneToOne 1 100 0.00 536870911.000 BIT_MASK 0x1fffffff FORMAT "%13.3" ECU_ADDRESS 0x6001C7E8 /end MEASUREMENT
/begin MEASUREMENT DDRC_St.DFC_ComInvld_227h_INV_MOTORING_PEAK_TRQ "" ULONG DFC_OneToOne 1 100 0.00 536870911.000 BIT_MASK 0x1fffffff FORMAT "%13.3" ECU_ADDRESS 0x6001C7EC /end MEASUREMENT
/begin MEASUREMENT DDRC_St.DFC_ComInvld_227h_INV_MTR_INST_INPUT_POWER "" ULONG DFC_OneToOne 1 100 0.00 536870911.000 BIT_MASK 0x1fffffff FORMAT "%13.3" ECU_ADDRESS 0x6001C7F0 /end MEASUREMENT
/begin MEASUREMENT DDRC_St.DFC_ComInvld_227h_INV_REGEN_PEAK_TRQ "" ULONG DFC_OneToOne 1 100 0.00 536870911.000 BIT_MASK 0x1fffffff FORMAT "%13.3" ECU_ADDRESS 0x6001C7F4 /end MEASUREMENT
/begin MEASUREMENT DDRC_St.DFC_ComInvld_237h_INV_ACTIVE_DISCHARGE_STATUS "" ULONG DFC_OneToOne 1 100 0.00 536870911.000 BIT_MASK 0x1fffffff FORMAT "%13.3" ECU_ADDRESS 0x6001C7F8 /end MEASUREMENT
/begin MEASUREMENT DDRC_St.DFC_ComInvld_237h_INV_FAULT_LEVEL "" ULONG DFC_OneToOne 1 100 0.00 536870911.000 BIT_MASK 0x1fffffff FORMAT "%13.3" ECU_ADDRESS 0x6001C7FC /end MEASUREMENT
/begin MEASUREMENT DDRC_St.DFC_ComInvld_237h_INV_STAB_MIN_TRQ "" ULONG DFC_OneToOne 1 100 0.00 536870911.000 BIT_MASK 0x1fffffff FORMAT "%13.3" ECU_ADDRESS 0x6001C800 /end MEASUREMENT
/begin MEASUREMENT DDRC_St.DFC_ComInvld_259h_TGLM_MODE_PUSH "" ULONG DFC_OneToOne 1 100 0.00 536870911.000 BIT_MASK 0x1fffffff FORMAT "%13.3" ECU_ADDRESS 0x6001C804 /end MEASUREMENT
/begin MEASUREMENT DDRC_St.DFC_ComInvld_259h_TOGGLE_MONOSTABLE_POS "" ULONG DFC_OneToOne 1 100 0.00 536870911.000 BIT_MASK 0x1fffffff FORMAT "%13.3" ECU_ADDRESS 0x6001C808 /end MEASUREMENT
/begin MEASUREMENT DDRC_St.DFC_ComInvld_26h_AC_SWITCH_REQ "" ULONG DFC_OneToOne 1 100 0.00 536870911.000 BIT_MASK 0x1fffffff FORMAT "%13.3" ECU_ADDRESS 0x6001C80C /end MEASUREMENT
/begin MEASUREMENT DDRC_St.DFC_ComInvld_26h_BLOWER_POSITION "" ULONG DFC_OneToOne 1 100 0.00 536870911.000 BIT_MASK 0x1fffffff FORMAT "%13.3" ECU_ADDRESS 0x6001C810 /end MEASUREMENT
/begin MEASUREMENT DDRC_St.DFC_ComInvld_26h_EVAP_SENSOR_FAULT "" ULONG DFC_OneToOne 1 100 0.00 536870911.000 BIT_MASK 0x1fffffff FORMAT "%13.3" ECU_ADDRESS 0x6001C814 /end MEASUREMENT
/begin MEASUREMENT DDRC_St.DFC_ComInvld_26h_EVAP_SENSOR_VALUE "" ULONG DFC_OneToOne 1 100 0.00 536870911.000 BIT_MASK 0x1fffffff FORMAT "%13.3" ECU_ADDRESS 0x6001C818 /end MEASUREMENT
/begin MEASUREMENT DDRC_St.DFC_ComInvld_26h_POTENTIOMETER_FAULT "" ULONG DFC_OneToOne 1 100 0.00 536870911.000 BIT_MASK 0x1fffffff FORMAT "%13.3" ECU_ADDRESS 0x6001C81C /end MEASUREMENT
/begin MEASUREMENT DDRC_St.DFC_ComInvld_26h_REAR_DEFOG_REQ "" ULONG DFC_OneToOne 1 100 0.00 536870911.000 BIT_MASK 0x1fffffff FORMAT "%13.3" ECU_ADDRESS 0x6001C820 /end MEASUREMENT
/begin MEASUREMENT DDRC_St.DFC_ComInvld_26h_TEMP_POSITION "" ULONG DFC_OneToOne 1 100 0.00 536870911.000 BIT_MASK 0x1fffffff FORMAT "%13.3" ECU_ADDRESS 0x6001C824 /end MEASUREMENT
/begin MEASUREMENT DDRC_St.DFC_ComInvld_273h_OBC_FAULT_LEVEL "" ULONG DFC_OneToOne 1 100 0.00 536870911.000 BIT_MASK 0x1fffffff FORMAT "%13.3" ECU_ADDRESS 0x6001C828 /end MEASUREMENT
/begin MEASUREMENT DDRC_St.DFC_ComInvld_273h_OBC_outputpower_capability "" ULONG DFC_OneToOne 1 100 0.00 536870911.000 BIT_MASK 0x1fffffff FORMAT "%13.3" ECU_ADDRESS 0x6001C82C /end MEASUREMENT
/begin MEASUREMENT DDRC_St.DFC_ComInvld_275h_HVBAT_DISCHARGE_30S_AVAILABLE_CURRENT "" ULONG DFC_OneToOne 1 100 0.00 536870911.000 BIT_MASK 0x1fffffff FORMAT "%13.3" ECU_ADDRESS 0x6001C830 /end MEASUREMENT
/begin MEASUREMENT DDRC_St.DFC_ComInvld_275h_HVBAT_DISCHARGE_30S_AVAILABLE_POWER "" ULONG DFC_OneToOne 1 100 0.00 536870911.000 BIT_MASK 0x1fffffff FORMAT "%13.3" ECU_ADDRESS 0x6001C834 /end MEASUREMENT
/begin MEASUREMENT DDRC_St.DFC_ComInvld_283h_DCDC_IN_CURRENT "" ULONG DFC_OneToOne 1 100 0.00 536870911.000 BIT_MASK 0x1fffffff FORMAT "%13.3" ECU_ADDRESS 0x6001C838 /end MEASUREMENT
/begin MEASUREMENT DDRC_St.DFC_ComInvld_283h_DCDC_IN_VOLTAGE "" ULONG DFC_OneToOne 1 100 0.00 536870911.000 BIT_MASK 0x1fffffff FORMAT "%13.3" ECU_ADDRESS 0x6001C83C /end MEASUREMENT
/begin MEASUREMENT DDRC_St.DFC_ComInvld_283h_DCDC_OUT_CURRENT "" ULONG DFC_OneToOne 1 100 0.00 536870911.000 BIT_MASK 0x1fffffff FORMAT "%13.3" ECU_ADDRESS 0x6001C840 /end MEASUREMENT
/begin MEASUREMENT DDRC_St.DFC_ComInvld_283h_DCDC_OUT_VOLTAGE "" ULONG DFC_OneToOne 1 100 0.00 536870911.000 BIT_MASK 0x1fffffff FORMAT "%13.3" ECU_ADDRESS 0x6001C844 /end MEASUREMENT
/begin MEASUREMENT DDRC_St.DFC_ComInvld_285h_HVBAT_REGEN_CHG_30S_CURRENT_LIMIT "" ULONG DFC_OneToOne 1 100 0.00 536870911.000 BIT_MASK 0x1fffffff FORMAT "%13.3" ECU_ADDRESS 0x6001C848 /end MEASUREMENT
/begin MEASUREMENT DDRC_St.DFC_ComInvld_285h_HVBAT_REGEN_CHRG_30S_POWER_LIMIT "" ULONG DFC_OneToOne 1 100 0.00 536870911.000 BIT_MASK 0x1fffffff FORMAT "%13.3" ECU_ADDRESS 0x6001C84C /end MEASUREMENT
/begin MEASUREMENT DDRC_St.DFC_ComInvld_293h_DCDC_FAULT_LEVEL "" ULONG DFC_OneToOne 1 100 0.00 536870911.000 BIT_MASK 0x1fffffff FORMAT "%13.3" ECU_ADDRESS 0x6001C850 /end MEASUREMENT
/begin MEASUREMENT DDRC_St.DFC_ComInvld_293h_DCDC_outputpower_capability "" ULONG DFC_OneToOne 1 100 0.00 536870911.000 BIT_MASK 0x1fffffff FORMAT "%13.3" ECU_ADDRESS 0x6001C854 /end MEASUREMENT
/begin MEASUREMENT DDRC_St.DFC_ComInvld_325h_HVBAT_EPLUG_STATUS "" ULONG DFC_OneToOne 1 100 0.00 536870911.000 BIT_MASK 0x1fffffff FORMAT "%13.3" ECU_ADDRESS 0x6001C858 /end MEASUREMENT
/begin MEASUREMENT DDRC_St.DFC_ComInvld_325h_HVBAT_HVIL_STS "" ULONG DFC_OneToOne 1 100 0.00 536870911.000 BIT_MASK 0x1fffffff FORMAT "%13.3" ECU_ADDRESS 0x6001C85C /end MEASUREMENT
/begin MEASUREMENT DDRC_St.DFC_ComInvld_325h_HVBAT_INSULATION_FAULT "" ULONG DFC_OneToOne 1 100 0.00 536870911.000 BIT_MASK 0x1fffffff FORMAT "%13.3" ECU_ADDRESS 0x6001C860 /end MEASUREMENT
/begin MEASUREMENT DDRC_St.DFC_ComInvld_325h_HVBAT_INSULATION_RESISTANCE "" ULONG DFC_OneToOne 1 100 0.00 536870911.000 BIT_MASK 0x1fffffff FORMAT "%13.3" ECU_ADDRESS 0x6001C864 /end MEASUREMENT
/begin MEASUREMENT DDRC_St.DFC_ComInvld_325h_HVBAT_TEMPERATURE "" ULONG DFC_OneToOne 1 100 0.00 536870911.000 BIT_MASK 0x1fffffff FORMAT "%13.3" ECU_ADDRESS 0x6001C868 /end MEASUREMENT
/begin MEASUREMENT DDRC_St.DFC_ComInvld_335h_HVBAT_CHRG_CONTINUOUS_CURR_MAX "" ULONG DFC_OneToOne 1 100 0.00 536870911.000 BIT_MASK 0x1fffffff FORMAT "%13.3" ECU_ADDRESS 0x6001C86C /end MEASUREMENT
/begin MEASUREMENT DDRC_St.DFC_ComInvld_335h_HVBAT_CHRG_COTINUOUS_CURR_REQ "" ULONG DFC_OneToOne 1 100 0.00 536870911.000 BIT_MASK 0x1fffffff FORMAT "%13.3" ECU_ADDRESS 0x6001C870 /end MEASUREMENT
/begin MEASUREMENT DDRC_St.DFC_ComInvld_335h_HVBAT_CHRG_MAX_VOLT "" ULONG DFC_OneToOne 1 100 0.00 536870911.000 BIT_MASK 0x1fffffff FORMAT "%13.3" ECU_ADDRESS 0x6001C874 /end MEASUREMENT
/begin MEASUREMENT DDRC_St.DFC_ComInvld_335h_HVBAT_DC_BUS_VOLTAGE "" ULONG DFC_OneToOne 1 100 0.00 536870911.000 BIT_MASK 0x1fffffff FORMAT "%13.3" ECU_ADDRESS 0x6001C878 /end MEASUREMENT
/begin MEASUREMENT DDRC_St.DFC_ComInvld_38Dh_VITESSE_VEHICULE_ROUES "" ULONG DFC_OneToOne 1 100 0.00 536870911.000 BIT_MASK 0x1fffffff FORMAT "%13.3" ECU_ADDRESS 0x6001C87C /end MEASUREMENT
/begin MEASUREMENT DDRC_St.DFC_ComInvld_38Dh_VVH_INDISP "" ULONG DFC_OneToOne 1 100 0.00 536870911.000 BIT_MASK 0x1fffffff FORMAT "%13.3" ECU_ADDRESS 0x6001C880 /end MEASUREMENT
/begin MEASUREMENT DDRC_St.DFC_ComInvld_427h_INV_COOLANT_TEMP "" ULONG DFC_OneToOne 1 100 0.00 536870911.000 BIT_MASK 0x1fffffff FORMAT "%13.3" ECU_ADDRESS 0x6001C884 /end MEASUREMENT
/begin MEASUREMENT DDRC_St.DFC_ComInvld_427h_INV_MOTOR_TEMP "" ULONG DFC_OneToOne 1 100 0.00 536870911.000 BIT_MASK 0x1fffffff FORMAT "%13.3" ECU_ADDRESS 0x6001C888 /end MEASUREMENT
/begin MEASUREMENT DDRC_St.DFC_ComInvld_427h_INV_OP_MODE "" ULONG DFC_OneToOne 1 100 0.00 536870911.000 BIT_MASK 0x1fffffff FORMAT "%13.3" ECU_ADDRESS 0x6001C88C /end MEASUREMENT
/begin MEASUREMENT DDRC_St.DFC_ComInvld_427h_INV_PERMISIBLE_TORQUE "" ULONG DFC_OneToOne 1 100 0.00 536870911.000 BIT_MASK 0x1fffffff FORMAT "%13.3" ECU_ADDRESS 0x6001C890 /end MEASUREMENT
/begin MEASUREMENT DDRC_St.DFC_ComInvld_427h_INV_TEMP "" ULONG DFC_OneToOne 1 100 0.00 536870911.000 BIT_MASK 0x1fffffff FORMAT "%13.3" ECU_ADDRESS 0x6001C894 /end MEASUREMENT
/begin MEASUREMENT DDRC_St.DFC_ComInvld_432h_REVEIL_PRINCIPAL "" ULONG DFC_OneToOne 1 100 0.00 536870911.000 BIT_MASK 0x1fffffff FORMAT "%13.3" ECU_ADDRESS 0x6001C898 /end MEASUREMENT
/begin MEASUREMENT DDRC_St.DFC_ComInvld_435h_HVBAT_MAX_CELL_VOLT "" ULONG DFC_OneToOne 1 100 0.00 536870911.000 BIT_MASK 0x1fffffff FORMAT "%13.3" ECU_ADDRESS 0x6001C89C /end MEASUREMENT
/begin MEASUREMENT DDRC_St.DFC_ComInvld_435h_HVBAT_MAX_CELL_VOLT_NUM "" ULONG DFC_OneToOne 1 100 0.00 536870911.000 BIT_MASK 0x1fffffff FORMAT "%13.3" ECU_ADDRESS 0x6001C8A0 /end MEASUREMENT
/begin MEASUREMENT DDRC_St.DFC_ComInvld_435h_HVBAT_MAX_SENSOR_TEMP "" ULONG DFC_OneToOne 1 100 0.00 536870911.000 BIT_MASK 0x1fffffff FORMAT "%13.3" ECU_ADDRESS 0x6001C8A4 /end MEASUREMENT
/begin MEASUREMENT DDRC_St.DFC_ComInvld_435h_HVBAT_MIN_CELL_VOLT "" ULONG DFC_OneToOne 1 100 0.00 536870911.000 BIT_MASK 0x1fffffff FORMAT "%13.3" ECU_ADDRESS 0x6001C8A8 /end MEASUREMENT
/begin MEASUREMENT DDRC_St.DFC_ComInvld_435h_HVBAT_MIN_CELL_VOLT_NUM "" ULONG DFC_OneToOne 1 100 0.00 536870911.000 BIT_MASK 0x1fffffff FORMAT "%13.3" ECU_ADDRESS 0x6001C8AC /end MEASUREMENT
/begin MEASUREMENT DDRC_St.DFC_ComInvld_442h_BCCM_BLOWER_RELAY_STS "" ULONG DFC_OneToOne 1 100 0.00 536870911.000 BIT_MASK 0x1fffffff FORMAT "%13.3" ECU_ADDRESS 0x6001C8B0 /end MEASUREMENT
/begin MEASUREMENT DDRC_St.DFC_ComInvld_453h_OBC_IN_CURRENT "" ULONG DFC_OneToOne 1 100 0.00 536870911.000 BIT_MASK 0x1fffffff FORMAT "%13.3" ECU_ADDRESS 0x6001C8B4 /end MEASUREMENT
/begin MEASUREMENT DDRC_St.DFC_ComInvld_453h_OBC_IN_VOLTAGE "" ULONG DFC_OneToOne 1 100 0.00 536870911.000 BIT_MASK 0x1fffffff FORMAT "%13.3" ECU_ADDRESS 0x6001C8B8 /end MEASUREMENT
/begin MEASUREMENT DDRC_St.DFC_ComInvld_453h_OBC_IP_POWER "" ULONG DFC_OneToOne 1 100 0.00 536870911.000 BIT_MASK 0x1fffffff FORMAT "%13.3" ECU_ADDRESS 0x6001C8BC /end MEASUREMENT
/begin MEASUREMENT DDRC_St.DFC_ComInvld_455h_HVBAT_NOMINAL_VOLTAGE "" ULONG DFC_OneToOne 1 100 0.00 536870911.000 BIT_MASK 0x1fffffff FORMAT "%13.3" ECU_ADDRESS 0x6001C8C0 /end MEASUREMENT
/begin MEASUREMENT DDRC_St.DFC_ComInvld_463h_OBC_OUT_CURRENT "" ULONG DFC_OneToOne 1 100 0.00 536870911.000 BIT_MASK 0x1fffffff FORMAT "%13.3" ECU_ADDRESS 0x6001C8C4 /end MEASUREMENT
/begin MEASUREMENT DDRC_St.DFC_ComInvld_463h_OBC_OUT_VOLTAGE "" ULONG DFC_OneToOne 1 100 0.00 536870911.000 BIT_MASK 0x1fffffff FORMAT "%13.3" ECU_ADDRESS 0x6001C8C8 /end MEASUREMENT
/begin MEASUREMENT DDRC_St.DFC_ComInvld_463h_OBC_TEMPERATURE "" ULONG DFC_OneToOne 1 100 0.00 536870911.000 BIT_MASK 0x1fffffff FORMAT "%13.3" ECU_ADDRESS 0x6001C8CC /end MEASUREMENT
/begin MEASUREMENT DDRC_St.DFC_ComInvld_473h_DCDC_Coolant_Temperature "" ULONG DFC_OneToOne 1 100 0.00 536870911.000 BIT_MASK 0x1fffffff FORMAT "%13.3" ECU_ADDRESS 0x6001C8D0 /end MEASUREMENT
/begin MEASUREMENT DDRC_St.DFC_ComInvld_473h_DCDC_TEMPERATURE "" ULONG DFC_OneToOne 1 100 0.00 536870911.000 BIT_MASK 0x1fffffff FORMAT "%13.3" ECU_ADDRESS 0x6001C8D4 /end MEASUREMENT
/begin MEASUREMENT DDRC_St.DFC_ComInvld_47Bh_eCOMP_BusBarCurrent "" ULONG DFC_OneToOne 1 100 0.00 536870911.000 BIT_MASK 0x1fffffff FORMAT "%13.3" ECU_ADDRESS 0x6001C8D8 /end MEASUREMENT
/begin MEASUREMENT DDRC_St.DFC_ComInvld_47Bh_eCOMP_BusBarVoltage "" ULONG DFC_OneToOne 1 100 0.00 536870911.000 BIT_MASK 0x1fffffff FORMAT "%13.3" ECU_ADDRESS 0x6001C8DC /end MEASUREMENT
/begin MEASUREMENT DDRC_St.DFC_ComInvld_47Bh_eCOMP_CompressorSpeed "" ULONG DFC_OneToOne 1 100 0.00 536870911.000 BIT_MASK 0x1fffffff FORMAT "%13.3" ECU_ADDRESS 0x6001C8E0 /end MEASUREMENT
/begin MEASUREMENT DDRC_St.DFC_ComInvld_47Bh_eCOMP_IGBT_Temp "" ULONG DFC_OneToOne 1 100 0.00 536870911.000 BIT_MASK 0x1fffffff FORMAT "%13.3" ECU_ADDRESS 0x6001C8E4 /end MEASUREMENT
/begin MEASUREMENT DDRC_St.DFC_ComInvld_47Bh_eCOMP_PeakPhaCurrent "" ULONG DFC_OneToOne 1 100 0.00 536870911.000 BIT_MASK 0x1fffffff FORMAT "%13.3" ECU_ADDRESS 0x6001C8E8 /end MEASUREMENT
/begin MEASUREMENT DDRC_St.DFC_ComInvld_47Bh_eCOMP_Power_consumption "" ULONG DFC_OneToOne 1 100 0.00 536870911.000 BIT_MASK 0x1fffffff FORMAT "%13.3" ECU_ADDRESS 0x6001C8EC /end MEASUREMENT
/begin MEASUREMENT DDRC_St.DFC_ComInvld_4F2h_STATUS_SOC "" ULONG DFC_OneToOne 1 100 0.00 536870911.000 BIT_MASK 0x1fffffff FORMAT "%13.3" ECU_ADDRESS 0x6001C8F0 /end MEASUREMENT
/begin MEASUREMENT DDRC_St.DFC_ComInvld_4F2h_TEMP_BATT_STATUS "" ULONG DFC_OneToOne 1 100 0.00 536870911.000 BIT_MASK 0x1fffffff FORMAT "%13.3" ECU_ADDRESS 0x6001C8F4 /end MEASUREMENT
/begin MEASUREMENT DDRC_St.DFC_ComInvld_4F2h_VALEUR_SOC_ETENDUE "" ULONG DFC_OneToOne 1 100 0.00 536870911.000 BIT_MASK 0x1fffffff FORMAT "%13.3" ECU_ADDRESS 0x6001C8F8 /end MEASUREMENT
/begin MEASUREMENT DDRC_St.DFC_ComInvld_535h_HV_BATT_TEMP_AVG "" ULONG DFC_OneToOne 1 100 0.00 536870911.000 BIT_MASK 0x1fffffff FORMAT "%13.3" ECU_ADDRESS 0x6001C8FC /end MEASUREMENT
/begin MEASUREMENT DDRC_St.DFC_ComInvld_543h_HVBAT_RESTBATTENERGY "" ULONG DFC_OneToOne 1 100 0.00 536870911.000 BIT_MASK 0x1fffffff FORMAT "%13.3" ECU_ADDRESS 0x6001C900 /end MEASUREMENT
/begin MEASUREMENT DDRC_St.DFC_ComInvld_543h_HVBAT_SOH "" ULONG DFC_OneToOne 1 100 0.00 536870911.000 BIT_MASK 0x1fffffff FORMAT "%13.3" ECU_ADDRESS 0x6001C904 /end MEASUREMENT
/begin MEASUREMENT DDRC_St.DFC_ComInvld_543h_HV_BATT_SOH_RES "" ULONG DFC_OneToOne 1 100 0.00 536870911.000 BIT_MASK 0x1fffffff FORMAT "%13.3" ECU_ADDRESS 0x6001C908 /end MEASUREMENT
/begin MEASUREMENT DDRC_St.DFC_ComInvld_552h_CPT_TEMPOREL "" ULONG DFC_OneToOne 1 100 0.00 536870911.000 BIT_MASK 0x1fffffff FORMAT "%13.3" ECU_ADDRESS 0x6001C90C /end MEASUREMENT
/begin MEASUREMENT DDRC_St.DFC_ComInvld_552h_KILOMETRAGE "" ULONG DFC_OneToOne 1 100 0.00 536870911.000 BIT_MASK 0x1fffffff FORMAT "%13.3" ECU_ADDRESS 0x6001C910 /end MEASUREMENT
/begin MEASUREMENT DDRC_St.DFC_ComInvld_583h_HV_BATT_DISCONT_CSE_OPEN "" ULONG DFC_OneToOne 1 100 0.00 536870911.000 BIT_MASK 0x1fffffff FORMAT "%13.3" ECU_ADDRESS 0x6001C914 /end MEASUREMENT
/begin MEASUREMENT DDRC_St.DFC_ComInvld_592h_CALIBRE_IBATT "" ULONG DFC_OneToOne 1 100 0.00 536870911.000 BIT_MASK 0x1fffffff FORMAT "%13.3" ECU_ADDRESS 0x6001C918 /end MEASUREMENT
/begin MEASUREMENT DDRC_St.DFC_ComInvld_592h_IBATT_1 "" ULONG DFC_OneToOne 1 100 0.00 536870911.000 BIT_MASK 0x1fffffff FORMAT "%13.3" ECU_ADDRESS 0x6001C91C /end MEASUREMENT
/begin MEASUREMENT DDRC_St.DFC_ComInvld_592h_IBATT_2 "" ULONG DFC_OneToOne 1 100 0.00 536870911.000 BIT_MASK 0x1fffffff FORMAT "%13.3" ECU_ADDRESS 0x6001C920 /end MEASUREMENT
/begin MEASUREMENT DDRC_St.DFC_ComInvld_592h_IBATT_3 "" ULONG DFC_OneToOne 1 100 0.00 536870911.000 BIT_MASK 0x1fffffff FORMAT "%13.3" ECU_ADDRESS 0x6001C924 /end MEASUREMENT
/begin MEASUREMENT DDRC_St.DFC_ComInvld_592h_TEMP_BATT "" ULONG DFC_OneToOne 1 100 0.00 536870911.000 BIT_MASK 0x1fffffff FORMAT "%13.3" ECU_ADDRESS 0x6001C928 /end MEASUREMENT
/begin MEASUREMENT DDRC_St.DFC_ComInvld_592h_U_BATT_BECB "" ULONG DFC_OneToOne 1 100 0.00 536870911.000 BIT_MASK 0x1fffffff FORMAT "%13.3" ECU_ADDRESS 0x6001C92C /end MEASUREMENT
/begin MEASUREMENT DDRC_St.DFC_ComInvld_595h_HVBAT_TIME_TO_CHRG_80 "" ULONG DFC_OneToOne 1 100 0.00 536870911.000 BIT_MASK 0x1fffffff FORMAT "%13.3" ECU_ADDRESS 0x6001C930 /end MEASUREMENT
/begin MEASUREMENT DDRC_St.DFC_ComInvld_5B2h_TEMP_AIR_EXT "" ULONG DFC_OneToOne 1 100 0.00 536870911.000 BIT_MASK 0x1fffffff FORMAT "%13.3" ECU_ADDRESS 0x6001C934 /end MEASUREMENT
/begin MEASUREMENT DDRC_St.DFC_ComInvld_5B5h_HVBAT_THERMAL_RUNAWAY "" ULONG DFC_OneToOne 1 100 0.00 536870911.000 BIT_MASK 0x1fffffff FORMAT "%13.3" ECU_ADDRESS 0x6001C938 /end MEASUREMENT
/begin MEASUREMENT DDRC_St.DFC_ComInvld_635h_HVBAT_NEG_CONT_COUNT_SEG1 "" ULONG DFC_OneToOne 1 100 0.00 536870911.000 BIT_MASK 0x1fffffff FORMAT "%13.3" ECU_ADDRESS 0x6001C93C /end MEASUREMENT
/begin MEASUREMENT DDRC_St.DFC_ComInvld_635h_HVBAT_NEG_CONT_COUNT_SEG3 "" ULONG DFC_OneToOne 1 100 0.00 536870911.000 BIT_MASK 0x1fffffff FORMAT "%13.3" ECU_ADDRESS 0x6001C940 /end MEASUREMENT
/begin MEASUREMENT DDRC_St.DFC_ComInvld_635h_HVBAT_NEG_CONT_COUNT_SEG4 "" ULONG DFC_OneToOne 1 100 0.00 536870911.000 BIT_MASK 0x1fffffff FORMAT "%13.3" ECU_ADDRESS 0x6001C944 /end MEASUREMENT
/begin MEASUREMENT DDRC_St.DFC_ComInvld_635h_HVBAT_PST_CONT_COUNT_SEG1 "" ULONG DFC_OneToOne 1 100 0.00 536870911.000 BIT_MASK 0x1fffffff FORMAT "%13.3" ECU_ADDRESS 0x6001C948 /end MEASUREMENT
/begin MEASUREMENT DDRC_St.DFC_ComInvld_635h_HVBAT_PST_CONT_COUNT_SEG3 "" ULONG DFC_OneToOne 1 100 0.00 536870911.000 BIT_MASK 0x1fffffff FORMAT "%13.3" ECU_ADDRESS 0x6001C94C /end MEASUREMENT
/begin MEASUREMENT DDRC_St.DFC_ComInvld_635h_HVBAT_PST_CONT_COUNT_SEG4 "" ULONG DFC_OneToOne 1 100 0.00 536870911.000 BIT_MASK 0x1fffffff FORMAT "%13.3" ECU_ADDRESS 0x6001C950 /end MEASUREMENT
/begin MEASUREMENT DDRC_St.DFC_ComInvld_645h_HVBAT_PRECHRGE_CONT_COUNT_SEG1 "" ULONG DFC_OneToOne 1 100 0.00 536870911.000 BIT_MASK 0x1fffffff FORMAT "%13.3" ECU_ADDRESS 0x6001C954 /end MEASUREMENT
/begin MEASUREMENT DDRC_St.DFC_ComInvld_645h_HVBAT_PRECHRGE_CONT_COUNT_SEG2 "" ULONG DFC_OneToOne 1 100 0.00 536870911.000 BIT_MASK 0x1fffffff FORMAT "%13.3" ECU_ADDRESS 0x6001C958 /end MEASUREMENT
/begin MEASUREMENT DDRC_St.DFC_ComInvld_675h_HVBAT_REMAININGBATTCAPACITY "" ULONG DFC_OneToOne 1 100 0.00 536870911.000 BIT_MASK 0x1fffffff FORMAT "%13.3" ECU_ADDRESS 0x6001C95C /end MEASUREMENT
/begin MEASUREMENT DFC_st.DFC_Com082hTooShort "" UBYTE DFC_OneToOne 1 100 0.00 255.0 FORMAT "%5.1" ECU_ADDRESS 0x60034A84 /end MEASUREMENT
/begin MEASUREMENT DFC_st.DFC_Com092hTooShort "" UBYTE DFC_OneToOne 1 100 0.00 255.0 FORMAT "%5.1" ECU_ADDRESS 0x60034A85 /end MEASUREMENT
/begin MEASUREMENT DFC_st.DFC_Com205hAbsent "" UBYTE DFC_OneToOne 1 100 0.00 255.0 FORMAT "%5.1" ECU_ADDRESS 0x60034A86 /end MEASUREMENT
/begin MEASUREMENT DFC_st.DFC_Com205hChecksum "" UBYTE DFC_OneToOne 1 100 0.00 255.0 FORMAT "%5.1" ECU_ADDRESS 0x60034A87 /end MEASUREMENT
/begin MEASUREMENT DFC_st.DFC_Com205hCounter "" UBYTE DFC_OneToOne 1 100 0.00 255.0 FORMAT "%5.1" ECU_ADDRESS 0x60034A88 /end MEASUREMENT
/begin MEASUREMENT DFC_st.DFC_Com205hTooShort "" UBYTE DFC_OneToOne 1 100 0.00 255.0 FORMAT "%5.1" ECU_ADDRESS 0x60034A89 /end MEASUREMENT
/begin MEASUREMENT DFC_st.DFC_Com217hAbsent "" UBYTE DFC_OneToOne 1 100 0.00 255.0 FORMAT "%5.1" ECU_ADDRESS 0x60034A8A /end MEASUREMENT
/begin MEASUREMENT DFC_st.DFC_Com217hChecksum "" UBYTE DFC_OneToOne 1 100 0.00 255.0 FORMAT "%5.1" ECU_ADDRESS 0x60034A8B /end MEASUREMENT
/begin MEASUREMENT DFC_st.DFC_Com217hCounter "" UBYTE DFC_OneToOne 1 100 0.00 255.0 FORMAT "%5.1" ECU_ADDRESS 0x60034A8C /end MEASUREMENT
/begin MEASUREMENT DFC_st.DFC_Com217hTooShort "" UBYTE DFC_OneToOne 1 100 0.00 255.0 FORMAT "%5.1" ECU_ADDRESS 0x60034A8D /end MEASUREMENT
/begin MEASUREMENT DFC_st.DFC_Com227hAbsent "" UBYTE DFC_OneToOne 1 100 0.00 255.0 FORMAT "%5.1" ECU_ADDRESS 0x60034A8E /end MEASUREMENT
/begin MEASUREMENT DFC_st.DFC_Com227hTooShort "" UBYTE DFC_OneToOne 1 100 0.00 255.0 FORMAT "%5.1" ECU_ADDRESS 0x60034A8F /end MEASUREMENT
/begin MEASUREMENT DFC_st.DFC_Com237hAbsent "" UBYTE DFC_OneToOne 1 100 0.00 255.0 FORMAT "%5.1" ECU_ADDRESS 0x60034A90 /end MEASUREMENT
/begin MEASUREMENT DFC_st.DFC_Com237hChecksum "" UBYTE DFC_OneToOne 1 100 0.00 255.0 FORMAT "%5.1" ECU_ADDRESS 0x60034A91 /end MEASUREMENT
/begin MEASUREMENT DFC_st.DFC_Com237hCounter "" UBYTE DFC_OneToOne 1 100 0.00 255.0 FORMAT "%5.1" ECU_ADDRESS 0x60034A92 /end MEASUREMENT
/begin MEASUREMENT DFC_st.DFC_Com237hTooShort "" UBYTE DFC_OneToOne 1 100 0.00 255.0 FORMAT "%5.1" ECU_ADDRESS 0x60034A93 /end MEASUREMENT
/begin MEASUREMENT DFC_st.DFC_Com259hAbsent "" UBYTE DFC_OneToOne 1 100 0.00 255.0 FORMAT "%5.1" ECU_ADDRESS 0x60034A94 /end MEASUREMENT
/begin MEASUREMENT DFC_st.DFC_Com259hChecksum "" UBYTE DFC_OneToOne 1 100 0.00 255.0 FORMAT "%5.1" ECU_ADDRESS 0x60034A95 /end MEASUREMENT
/begin MEASUREMENT DFC_st.DFC_Com259hCounter "" UBYTE DFC_OneToOne 1 100 0.00 255.0 FORMAT "%5.1" ECU_ADDRESS 0x60034A96 /end MEASUREMENT
/begin MEASUREMENT DFC_st.DFC_Com259hTooShort "" UBYTE DFC_OneToOne 1 100 0.00 255.0 FORMAT "%5.1" ECU_ADDRESS 0x60034A97 /end MEASUREMENT
/begin MEASUREMENT DFC_st.DFC_Com26hAbsent "" UBYTE DFC_OneToOne 1 100 0.00 255.0 FORMAT "%5.1" ECU_ADDRESS 0x60034A98 /end MEASUREMENT
/begin MEASUREMENT DFC_st.DFC_Com26hTooShort "" UBYTE DFC_OneToOne 1 100 0.00 255.0 FORMAT "%5.1" ECU_ADDRESS 0x60034A99 /end MEASUREMENT
/begin MEASUREMENT DFC_st.DFC_Com273hAbsent "" UBYTE DFC_OneToOne 1 100 0.00 255.0 FORMAT "%5.1" ECU_ADDRESS 0x60034A9A /end MEASUREMENT
/begin MEASUREMENT DFC_st.DFC_Com273hChecksum "" UBYTE DFC_OneToOne 1 100 0.00 255.0 FORMAT "%5.1" ECU_ADDRESS 0x60034A9B /end MEASUREMENT
/begin MEASUREMENT DFC_st.DFC_Com273hCounter "" UBYTE DFC_OneToOne 1 100 0.00 255.0 FORMAT "%5.1" ECU_ADDRESS 0x60034A9C /end MEASUREMENT
/begin MEASUREMENT DFC_st.DFC_Com273hTooShort "" UBYTE DFC_OneToOne 1 100 0.00 255.0 FORMAT "%5.1" ECU_ADDRESS 0x60034A9D /end MEASUREMENT
/begin MEASUREMENT DFC_st.DFC_Com275hAbsent "" UBYTE DFC_OneToOne 1 100 0.00 255.0 FORMAT "%5.1" ECU_ADDRESS 0x60034A9E /end MEASUREMENT
/begin MEASUREMENT DFC_st.DFC_Com275hChecksum "" UBYTE DFC_OneToOne 1 100 0.00 255.0 FORMAT "%5.1" ECU_ADDRESS 0x60034A9F /end MEASUREMENT
/begin MEASUREMENT DFC_st.DFC_Com275hCounter "" UBYTE DFC_OneToOne 1 100 0.00 255.0 FORMAT "%5.1" ECU_ADDRESS 0x60034AA0 /end MEASUREMENT
/begin MEASUREMENT DFC_st.DFC_Com275hTooShort "" UBYTE DFC_OneToOne 1 100 0.00 255.0 FORMAT "%5.1" ECU_ADDRESS 0x60034AA1 /end MEASUREMENT
/begin MEASUREMENT DFC_st.DFC_Com283hAbsent "" UBYTE DFC_OneToOne 1 100 0.00 255.0 FORMAT "%5.1" ECU_ADDRESS 0x60034AA2 /end MEASUREMENT
/begin MEASUREMENT DFC_st.DFC_Com283hTooShort "" UBYTE DFC_OneToOne 1 100 0.00 255.0 FORMAT "%5.1" ECU_ADDRESS 0x60034AA3 /end MEASUREMENT
/begin MEASUREMENT DFC_st.DFC_Com285hAbsent "" UBYTE DFC_OneToOne 1 100 0.00 255.0 FORMAT "%5.1" ECU_ADDRESS 0x60034AA4 /end MEASUREMENT
/begin MEASUREMENT DFC_st.DFC_Com285hChecksum "" UBYTE DFC_OneToOne 1 100 0.00 255.0 FORMAT "%5.1" ECU_ADDRESS 0x60034AA5 /end MEASUREMENT
/begin MEASUREMENT DFC_st.DFC_Com285hCounter "" UBYTE DFC_OneToOne 1 100 0.00 255.0 FORMAT "%5.1" ECU_ADDRESS 0x60034AA6 /end MEASUREMENT
/begin MEASUREMENT DFC_st.DFC_Com285hTooShort "" UBYTE DFC_OneToOne 1 100 0.00 255.0 FORMAT "%5.1" ECU_ADDRESS 0x60034AA7 /end MEASUREMENT
/begin MEASUREMENT DFC_st.DFC_Com293hAbsent "" UBYTE DFC_OneToOne 1 100 0.00 255.0 FORMAT "%5.1" ECU_ADDRESS 0x60034AA8 /end MEASUREMENT
/begin MEASUREMENT DFC_st.DFC_Com293hChecksum "" UBYTE DFC_OneToOne 1 100 0.00 255.0 FORMAT "%5.1" ECU_ADDRESS 0x60034AA9 /end MEASUREMENT
/begin MEASUREMENT DFC_st.DFC_Com293hCounter "" UBYTE DFC_OneToOne 1 100 0.00 255.0 FORMAT "%5.1" ECU_ADDRESS 0x60034AAA /end MEASUREMENT
/begin MEASUREMENT DFC_st.DFC_Com293hTooShort "" UBYTE DFC_OneToOne 1 100 0.00 255.0 FORMAT "%5.1" ECU_ADDRESS 0x60034AAB /end MEASUREMENT
/begin MEASUREMENT DFC_st.DFC_Com308hAbsent "" UBYTE DFC_OneToOne 1 100 0.00 255.0 FORMAT "%5.1" ECU_ADDRESS 0x60034AAC /end MEASUREMENT
/begin MEASUREMENT DFC_st.DFC_Com308hChecksum "" UBYTE DFC_OneToOne 1 100 0.00 255.0 FORMAT "%5.1" ECU_ADDRESS 0x60034AAD /end MEASUREMENT
/begin MEASUREMENT DFC_st.DFC_Com308hCounter "" UBYTE DFC_OneToOne 1 100 0.00 255.0 FORMAT "%5.1" ECU_ADDRESS 0x60034AAE /end MEASUREMENT
/begin MEASUREMENT DFC_st.DFC_Com308hTooShort "" UBYTE DFC_OneToOne 1 100 0.00 255.0 FORMAT "%5.1" ECU_ADDRESS 0x60034AAF /end MEASUREMENT
/begin MEASUREMENT DFC_st.DFC_Com318hAbsent "" UBYTE DFC_OneToOne 1 100 0.00 255.0 FORMAT "%5.1" ECU_ADDRESS 0x60034AB0 /end MEASUREMENT
/begin MEASUREMENT DFC_st.DFC_Com318hChecksum "" UBYTE DFC_OneToOne 1 100 0.00 255.0 FORMAT "%5.1" ECU_ADDRESS 0x60034AB1 /end MEASUREMENT
/begin MEASUREMENT DFC_st.DFC_Com318hCounter "" UBYTE DFC_OneToOne 1 100 0.00 255.0 FORMAT "%5.1" ECU_ADDRESS 0x60034AB2 /end MEASUREMENT
/begin MEASUREMENT DFC_st.DFC_Com318hTooShort "" UBYTE DFC_OneToOne 1 100 0.00 255.0 FORMAT "%5.1" ECU_ADDRESS 0x60034AB3 /end MEASUREMENT
/begin MEASUREMENT DFC_st.DFC_Com325hAbsent "" UBYTE DFC_OneToOne 1 100 0.00 255.0 FORMAT "%5.1" ECU_ADDRESS 0x60034AB4 /end MEASUREMENT
/begin MEASUREMENT DFC_st.DFC_Com325hChecksum "" UBYTE DFC_OneToOne 1 100 0.00 255.0 FORMAT "%5.1" ECU_ADDRESS 0x60034AB5 /end MEASUREMENT
/begin MEASUREMENT DFC_st.DFC_Com325hCounter "" UBYTE DFC_OneToOne 1 100 0.00 255.0 FORMAT "%5.1" ECU_ADDRESS 0x60034AB6 /end MEASUREMENT
/begin MEASUREMENT DFC_st.DFC_Com325hTooShort "" UBYTE DFC_OneToOne 1 100 0.00 255.0 FORMAT "%5.1" ECU_ADDRESS 0x60034AB7 /end MEASUREMENT
/begin MEASUREMENT DFC_st.DFC_Com335hAbsent "" UBYTE DFC_OneToOne 1 100 0.00 255.0 FORMAT "%5.1" ECU_ADDRESS 0x60034AB8 /end MEASUREMENT
/begin MEASUREMENT DFC_st.DFC_Com335hChecksum "" UBYTE DFC_OneToOne 1 100 0.00 255.0 FORMAT "%5.1" ECU_ADDRESS 0x60034AB9 /end MEASUREMENT
/begin MEASUREMENT DFC_st.DFC_Com335hCounter "" UBYTE DFC_OneToOne 1 100 0.00 255.0 FORMAT "%5.1" ECU_ADDRESS 0x60034ABA /end MEASUREMENT
/begin MEASUREMENT DFC_st.DFC_Com335hTooShort "" UBYTE DFC_OneToOne 1 100 0.00 255.0 FORMAT "%5.1" ECU_ADDRESS 0x60034ABB /end MEASUREMENT
/begin MEASUREMENT DFC_st.DFC_Com351hAbsent "" UBYTE DFC_OneToOne 1 100 0.00 255.0 FORMAT "%5.1" ECU_ADDRESS 0x60034ABC /end MEASUREMENT
/begin MEASUREMENT DFC_st.DFC_Com351hTooShort "" UBYTE DFC_OneToOne 1 100 0.00 255.0 FORMAT "%5.1" ECU_ADDRESS 0x60034ABD /end MEASUREMENT
/begin MEASUREMENT DFC_st.DFC_Com38DhAbsent "" UBYTE DFC_OneToOne 1 100 0.00 255.0 FORMAT "%5.1" ECU_ADDRESS 0x60034ABE /end MEASUREMENT
/begin MEASUREMENT DFC_st.DFC_Com38DhChecksum "" UBYTE DFC_OneToOne 1 100 0.00 255.0 FORMAT "%5.1" ECU_ADDRESS 0x60034ABF /end MEASUREMENT
/begin MEASUREMENT DFC_st.DFC_Com38DhCounter "" UBYTE DFC_OneToOne 1 100 0.00 255.0 FORMAT "%5.1" ECU_ADDRESS 0x60034AC0 /end MEASUREMENT
/begin MEASUREMENT DFC_st.DFC_Com38DhTooShort "" UBYTE DFC_OneToOne 1 100 0.00 255.0 FORMAT "%5.1" ECU_ADDRESS 0x60034AC1 /end MEASUREMENT
/begin MEASUREMENT DFC_st.DFC_Com412hAbsent "" UBYTE DFC_OneToOne 1 100 0.00 255.0 FORMAT "%5.1" ECU_ADDRESS 0x60034AC2 /end MEASUREMENT
/begin MEASUREMENT DFC_st.DFC_Com412hChecksum "" UBYTE DFC_OneToOne 1 100 0.00 255.0 FORMAT "%5.1" ECU_ADDRESS 0x60034AC3 /end MEASUREMENT
/begin MEASUREMENT DFC_st.DFC_Com412hCounter "" UBYTE DFC_OneToOne 1 100 0.00 255.0 FORMAT "%5.1" ECU_ADDRESS 0x60034AC4 /end MEASUREMENT
/begin MEASUREMENT DFC_st.DFC_Com412hTooShort "" UBYTE DFC_OneToOne 1 100 0.00 255.0 FORMAT "%5.1" ECU_ADDRESS 0x60034AC5 /end MEASUREMENT
/begin MEASUREMENT DFC_st.DFC_Com427hAbsent "" UBYTE DFC_OneToOne 1 100 0.00 255.0 FORMAT "%5.1" ECU_ADDRESS 0x60034AC6 /end MEASUREMENT
/begin MEASUREMENT DFC_st.DFC_Com427hTooShort "" UBYTE DFC_OneToOne 1 100 0.00 255.0 FORMAT "%5.1" ECU_ADDRESS 0x60034AC7 /end MEASUREMENT
/begin MEASUREMENT DFC_st.DFC_Com432hAbsent "" UBYTE DFC_OneToOne 1 100 0.00 255.0 FORMAT "%5.1" ECU_ADDRESS 0x60034AC8 /end MEASUREMENT
/begin MEASUREMENT DFC_st.DFC_Com432hChecksum "" UBYTE DFC_OneToOne 1 100 0.00 255.0 FORMAT "%5.1" ECU_ADDRESS 0x60034AC9 /end MEASUREMENT
/begin MEASUREMENT DFC_st.DFC_Com432hCounter "" UBYTE DFC_OneToOne 1 100 0.00 255.0 FORMAT "%5.1" ECU_ADDRESS 0x60034ACA /end MEASUREMENT
/begin MEASUREMENT DFC_st.DFC_Com432hTooShort "" UBYTE DFC_OneToOne 1 100 0.00 255.0 FORMAT "%5.1" ECU_ADDRESS 0x60034ACB /end MEASUREMENT
/begin MEASUREMENT DFC_st.DFC_Com435hAbsent "" UBYTE DFC_OneToOne 1 100 0.00 255.0 FORMAT "%5.1" ECU_ADDRESS 0x60034ACC /end MEASUREMENT
/begin MEASUREMENT DFC_st.DFC_Com435hTooShort "" UBYTE DFC_OneToOne 1 100 0.00 255.0 FORMAT "%5.1" ECU_ADDRESS 0x60034ACD /end MEASUREMENT
/begin MEASUREMENT DFC_st.DFC_Com442hAbsent "" UBYTE DFC_OneToOne 1 100 0.00 255.0 FORMAT "%5.1" ECU_ADDRESS 0x60034ACE /end MEASUREMENT
/begin MEASUREMENT DFC_st.DFC_Com442hTooShort "" UBYTE DFC_OneToOne 1 100 0.00 255.0 FORMAT "%5.1" ECU_ADDRESS 0x60034ACF /end MEASUREMENT
/begin MEASUREMENT DFC_st.DFC_Com453hAbsent "" UBYTE DFC_OneToOne 1 100 0.00 255.0 FORMAT "%5.1" ECU_ADDRESS 0x60034AD0 /end MEASUREMENT
/begin MEASUREMENT DFC_st.DFC_Com453hTooShort "" UBYTE DFC_OneToOne 1 100 0.00 255.0 FORMAT "%5.1" ECU_ADDRESS 0x60034AD1 /end MEASUREMENT
/begin MEASUREMENT DFC_st.DFC_Com455hAbsent "" UBYTE DFC_OneToOne 1 100 0.00 255.0 FORMAT "%5.1" ECU_ADDRESS 0x60034AD2 /end MEASUREMENT
/begin MEASUREMENT DFC_st.DFC_Com455hTooShort "" UBYTE DFC_OneToOne 1 100 0.00 255.0 FORMAT "%5.1" ECU_ADDRESS 0x60034AD3 /end MEASUREMENT
/begin MEASUREMENT DFC_st.DFC_Com463hAbsent "" UBYTE DFC_OneToOne 1 100 0.00 255.0 FORMAT "%5.1" ECU_ADDRESS 0x60034AD4 /end MEASUREMENT
/begin MEASUREMENT DFC_st.DFC_Com463hTooShort "" UBYTE DFC_OneToOne 1 100 0.00 255.0 FORMAT "%5.1" ECU_ADDRESS 0x60034AD5 /end MEASUREMENT
/begin MEASUREMENT DFC_st.DFC_Com473hAbsent "" UBYTE DFC_OneToOne 1 100 0.00 255.0 FORMAT "%5.1" ECU_ADDRESS 0x60034AD6 /end MEASUREMENT
/begin MEASUREMENT DFC_st.DFC_Com473hTooShort "" UBYTE DFC_OneToOne 1 100 0.00 255.0 FORMAT "%5.1" ECU_ADDRESS 0x60034AD7 /end MEASUREMENT
/begin MEASUREMENT DFC_st.DFC_Com47BhAbsent "" UBYTE DFC_OneToOne 1 100 0.00 255.0 FORMAT "%5.1" ECU_ADDRESS 0x60034AD8 /end MEASUREMENT
/begin MEASUREMENT DFC_st.DFC_Com47BhTooShort "" UBYTE DFC_OneToOne 1 100 0.00 255.0 FORMAT "%5.1" ECU_ADDRESS 0x60034AD9 /end MEASUREMENT
/begin MEASUREMENT DFC_st.DFC_Com48BhAbsent "" UBYTE DFC_OneToOne 1 100 0.00 255.0 FORMAT "%5.1" ECU_ADDRESS 0x60034ADA /end MEASUREMENT
/begin MEASUREMENT DFC_st.DFC_Com48BhTooShort "" UBYTE DFC_OneToOne 1 100 0.00 255.0 FORMAT "%5.1" ECU_ADDRESS 0x60034ADB /end MEASUREMENT
/begin MEASUREMENT DFC_st.DFC_Com497hTooShort "" UBYTE DFC_OneToOne 1 100 0.00 255.0 FORMAT "%5.1" ECU_ADDRESS 0x60034ADC /end MEASUREMENT
/begin MEASUREMENT DFC_st.DFC_Com4F2hAbsent "" UBYTE DFC_OneToOne 1 100 0.00 255.0 FORMAT "%5.1" ECU_ADDRESS 0x60034ADD /end MEASUREMENT
/begin MEASUREMENT DFC_st.DFC_Com4F2hChecksum "" UBYTE DFC_OneToOne 1 100 0.00 255.0 FORMAT "%5.1" ECU_ADDRESS 0x60034ADE /end MEASUREMENT
/begin MEASUREMENT DFC_st.DFC_Com4F2hCounter "" UBYTE DFC_OneToOne 1 100 0.00 255.0 FORMAT "%5.1" ECU_ADDRESS 0x60034ADF /end MEASUREMENT
/begin MEASUREMENT DFC_st.DFC_Com4F2hTooShort "" UBYTE DFC_OneToOne 1 100 0.00 255.0 FORMAT "%5.1" ECU_ADDRESS 0x60034AE0 /end MEASUREMENT
/begin MEASUREMENT DFC_st.DFC_Com50DhAbsent "" UBYTE DFC_OneToOne 1 100 0.00 255.0 FORMAT "%5.1" ECU_ADDRESS 0x60034AE1 /end MEASUREMENT
/begin MEASUREMENT DFC_st.DFC_Com50DhTooShort "" UBYTE DFC_OneToOne 1 100 0.00 255.0 FORMAT "%5.1" ECU_ADDRESS 0x60034AE2 /end MEASUREMENT
/begin MEASUREMENT DFC_st.DFC_Com535hAbsent "" UBYTE DFC_OneToOne 1 100 0.00 255.0 FORMAT "%5.1" ECU_ADDRESS 0x60034AE3 /end MEASUREMENT
/begin MEASUREMENT DFC_st.DFC_Com535hTooShort "" UBYTE DFC_OneToOne 1 100 0.00 255.0 FORMAT "%5.1" ECU_ADDRESS 0x60034AE4 /end MEASUREMENT
/begin MEASUREMENT DFC_st.DFC_Com543hAbsent "" UBYTE DFC_OneToOne 1 100 0.00 255.0 FORMAT "%5.1" ECU_ADDRESS 0x60034AE5 /end MEASUREMENT
/begin MEASUREMENT DFC_st.DFC_Com543hTooShort "" UBYTE DFC_OneToOne 1 100 0.00 255.0 FORMAT "%5.1" ECU_ADDRESS 0x60034AE6 /end MEASUREMENT
/begin MEASUREMENT DFC_st.DFC_Com552hAbsent "" UBYTE DFC_OneToOne 1 100 0.00 255.0 FORMAT "%5.1" ECU_ADDRESS 0x60034AE7 /end MEASUREMENT
/begin MEASUREMENT DFC_st.DFC_Com552hTooShort "" UBYTE DFC_OneToOne 1 100 0.00 255.0 FORMAT "%5.1" ECU_ADDRESS 0x60034AE8 /end MEASUREMENT
/begin MEASUREMENT DFC_st.DFC_Com583hAbsent "" UBYTE DFC_OneToOne 1 100 0.00 255.0 FORMAT "%5.1" ECU_ADDRESS 0x60034AE9 /end MEASUREMENT
/begin MEASUREMENT DFC_st.DFC_Com583hTooShort "" UBYTE DFC_OneToOne 1 100 0.00 255.0 FORMAT "%5.1" ECU_ADDRESS 0x60034AEA /end MEASUREMENT
/begin MEASUREMENT DFC_st.DFC_Com592hAbsent "" UBYTE DFC_OneToOne 1 100 0.00 255.0 FORMAT "%5.1" ECU_ADDRESS 0x60034AEB /end MEASUREMENT
/begin MEASUREMENT DFC_st.DFC_Com592hChecksum "" UBYTE DFC_OneToOne 1 100 0.00 255.0 FORMAT "%5.1" ECU_ADDRESS 0x60034AEC /end MEASUREMENT
/begin MEASUREMENT DFC_st.DFC_Com592hCounter "" UBYTE DFC_OneToOne 1 100 0.00 255.0 FORMAT "%5.1" ECU_ADDRESS 0x60034AED /end MEASUREMENT
/begin MEASUREMENT DFC_st.DFC_Com592hTooShort "" UBYTE DFC_OneToOne 1 100 0.00 255.0 FORMAT "%5.1" ECU_ADDRESS 0x60034AEE /end MEASUREMENT
/begin MEASUREMENT DFC_st.DFC_Com595hAbsent "" UBYTE DFC_OneToOne 1 100 0.00 255.0 FORMAT "%5.1" ECU_ADDRESS 0x60034AEF /end MEASUREMENT
/begin MEASUREMENT DFC_st.DFC_Com595hChecksum "" UBYTE DFC_OneToOne 1 100 0.00 255.0 FORMAT "%5.1" ECU_ADDRESS 0x60034AF0 /end MEASUREMENT
/begin MEASUREMENT DFC_st.DFC_Com595hCounter "" UBYTE DFC_OneToOne 1 100 0.00 255.0 FORMAT "%5.1" ECU_ADDRESS 0x60034AF1 /end MEASUREMENT
/begin MEASUREMENT DFC_st.DFC_Com595hTooShort "" UBYTE DFC_OneToOne 1 100 0.00 255.0 FORMAT "%5.1" ECU_ADDRESS 0x60034AF2 /end MEASUREMENT
/begin MEASUREMENT DFC_st.DFC_Com5B2hAbsent "" UBYTE DFC_OneToOne 1 100 0.00 255.0 FORMAT "%5.1" ECU_ADDRESS 0x60034AF3 /end MEASUREMENT
/begin MEASUREMENT DFC_st.DFC_Com5B2hTooShort "" UBYTE DFC_OneToOne 1 100 0.00 255.0 FORMAT "%5.1" ECU_ADDRESS 0x60034AF4 /end MEASUREMENT
/begin MEASUREMENT DFC_st.DFC_Com5B5hAbsent "" UBYTE DFC_OneToOne 1 100 0.00 255.0 FORMAT "%5.1" ECU_ADDRESS 0x60034AF5 /end MEASUREMENT
/begin MEASUREMENT DFC_st.DFC_Com5B5hChecksum "" UBYTE DFC_OneToOne 1 100 0.00 255.0 FORMAT "%5.1" ECU_ADDRESS 0x60034AF6 /end MEASUREMENT
/begin MEASUREMENT DFC_st.DFC_Com5B5hCounter "" UBYTE DFC_OneToOne 1 100 0.00 255.0 FORMAT "%5.1" ECU_ADDRESS 0x60034AF7 /end MEASUREMENT
/begin MEASUREMENT DFC_st.DFC_Com5B5hTooShort "" UBYTE DFC_OneToOne 1 100 0.00 255.0 FORMAT "%5.1" ECU_ADDRESS 0x60034AF8 /end MEASUREMENT
/begin MEASUREMENT DFC_st.DFC_Com5C7hTooShort "" UBYTE DFC_OneToOne 1 100 0.00 255.0 FORMAT "%5.1" ECU_ADDRESS 0x60034AF9 /end MEASUREMENT
/begin MEASUREMENT DFC_st.DFC_Com5E7hAbsent "" UBYTE DFC_OneToOne 1 100 0.00 255.0 FORMAT "%5.1" ECU_ADDRESS 0x60034AFA /end MEASUREMENT
/begin MEASUREMENT DFC_st.DFC_Com5E7hTooShort "" UBYTE DFC_OneToOne 1 100 0.00 255.0 FORMAT "%5.1" ECU_ADDRESS 0x60034AFB /end MEASUREMENT
/begin MEASUREMENT DFC_st.DFC_Com635hTooShort "" UBYTE DFC_OneToOne 1 100 0.00 255.0 FORMAT "%5.1" ECU_ADDRESS 0x60034AFC /end MEASUREMENT
/begin MEASUREMENT DFC_st.DFC_Com645hTooShort "" UBYTE DFC_OneToOne 1 100 0.00 255.0 FORMAT "%5.1" ECU_ADDRESS 0x60034AFD /end MEASUREMENT
/begin MEASUREMENT DFC_st.DFC_Com663hAbsent "" UBYTE DFC_OneToOne 1 100 0.00 255.0 FORMAT "%5.1" ECU_ADDRESS 0x60034AFE /end MEASUREMENT
/begin MEASUREMENT DFC_st.DFC_Com663hTooShort "" UBYTE DFC_OneToOne 1 100 0.00 255.0 FORMAT "%5.1" ECU_ADDRESS 0x60034AFF /end MEASUREMENT
/begin MEASUREMENT DFC_st.DFC_Com665hAbsent "" UBYTE DFC_OneToOne 1 100 0.00 255.0 FORMAT "%5.1" ECU_ADDRESS 0x60034B00 /end MEASUREMENT
/begin MEASUREMENT DFC_st.DFC_Com665hTooShort "" UBYTE DFC_OneToOne 1 100 0.00 255.0 FORMAT "%5.1" ECU_ADDRESS 0x60034B01 /end MEASUREMENT
/begin MEASUREMENT DINH_nrActvInhReas.FId_bInhComGw_Com_BMS_REMAININGBATTCAPACITY "" UWORD DINH_ct_Compu 1 100 -4095.000 4096.000 BIT_MASK 0x1fff FORMAT "%8.3" ECU_ADDRESS 0x600215CE /end MEASUREMENT
/begin MEASUREMENT DINH_nrActvInhReas.FId_bInhComGw_Com_CONTACT_FREIN_PRK "" UWORD DINH_ct_Compu 1 100 -4095.000 4096.000 BIT_MASK 0x1fff FORMAT "%8.3" ECU_ADDRESS 0x600215D0 /end MEASUREMENT
/begin MEASUREMENT DINH_nrActvInhReas.FId_bInhComGw_Com_DCDC_IP_POWER "" UWORD DINH_ct_Compu 1 100 -4095.000 4096.000 BIT_MASK 0x1fff FORMAT "%8.3" ECU_ADDRESS 0x600215D2 /end MEASUREMENT
/begin MEASUREMENT DINH_nrActvInhReas.FId_bInhComGw_Com_HVBAT_ALERT_LOW_BATT_ENERGY "" UWORD DINH_ct_Compu 1 100 -4095.000 4096.000 BIT_MASK 0x1fff FORMAT "%8.3" ECU_ADDRESS 0x600215D4 /end MEASUREMENT
/begin MEASUREMENT DINH_nrActvInhReas.FId_bInhComGw_Com_HVBAT_CHARGING_STATUS "" UWORD DINH_ct_Compu 1 100 -4095.000 4096.000 BIT_MASK 0x1fff FORMAT "%8.3" ECU_ADDRESS 0x600215D6 /end MEASUREMENT
/begin MEASUREMENT DINH_nrActvInhReas.FId_bInhComGw_Com_HVBAT_SOC "" UWORD DINH_ct_Compu 1 100 -4095.000 4096.000 BIT_MASK 0x1fff FORMAT "%8.3" ECU_ADDRESS 0x600215D8 /end MEASUREMENT
/begin MEASUREMENT DINH_nrActvInhReas.FId_bInhComGw_Com_HVBAT_TEMPERATURE "" UWORD DINH_ct_Compu 1 100 -4095.000 4096.000 BIT_MASK 0x1fff FORMAT "%8.3" ECU_ADDRESS 0x600215DA /end MEASUREMENT
/begin MEASUREMENT DINH_nrActvInhReas.FId_bInhComGw_Com_HVBAT_THERMAL_RUNAWAY "" UWORD DINH_ct_Compu 1 100 -4095.000 4096.000 BIT_MASK 0x1fff FORMAT "%8.3" ECU_ADDRESS 0x600215DC /end MEASUREMENT
/begin MEASUREMENT DINH_nrActvInhReas.FId_bInhComGw_Com_HV_BATT_CELL_VOLT_MAX "" UWORD DINH_ct_Compu 1 100 -4095.000 4096.000 BIT_MASK 0x1fff FORMAT "%8.3" ECU_ADDRESS 0x600215DE /end MEASUREMENT
/begin MEASUREMENT DINH_nrActvInhReas.FId_bInhComGw_Com_HV_BATT_CELL_VOLT_MIN "" UWORD DINH_ct_Compu 1 100 -4095.000 4096.000 BIT_MASK 0x1fff FORMAT "%8.3" ECU_ADDRESS 0x600215E0 /end MEASUREMENT
/begin MEASUREMENT DINH_nrActvInhReas.FId_bInhComGw_Com_HV_BATT_INSULATION_RESISTANCE "" UWORD DINH_ct_Compu 1 100 -4095.000 4096.000 BIT_MASK 0x1fff FORMAT "%8.3" ECU_ADDRESS 0x600215E2 /end MEASUREMENT
/begin MEASUREMENT DINH_nrActvInhReas.FId_bInhComGw_Com_HV_BATT_INSUL_FAILURE "" UWORD DINH_ct_Compu 1 100 -4095.000 4096.000 BIT_MASK 0x1fff FORMAT "%8.3" ECU_ADDRESS 0x600215E4 /end MEASUREMENT
/begin MEASUREMENT DINH_nrActvInhReas.FId_bInhComGw_Com_HV_BATT_INTERLOCK_LINE "" UWORD DINH_ct_Compu 1 100 -4095.000 4096.000 BIT_MASK 0x1fff FORMAT "%8.3" ECU_ADDRESS 0x600215E6 /end MEASUREMENT
/begin MEASUREMENT DINH_nrActvInhReas.FId_bInhComGw_Com_HV_BATT_MIN_VOLT_WARN "" UWORD DINH_ct_Compu 1 100 -4095.000 4096.000 BIT_MASK 0x1fff FORMAT "%8.3" ECU_ADDRESS 0x600215E8 /end MEASUREMENT
/begin MEASUREMENT DINH_nrActvInhReas.FId_bInhComGw_Com_HV_BATT_NB_CELL_VOLT_MAX "" UWORD DINH_ct_Compu 1 100 -4095.000 4096.000 BIT_MASK 0x1fff FORMAT "%8.3" ECU_ADDRESS 0x600215EA /end MEASUREMENT
/begin MEASUREMENT DINH_nrActvInhReas.FId_bInhComGw_Com_HV_BATT_NB_CELL_VOLT_MIN "" UWORD DINH_ct_Compu 1 100 -4095.000 4096.000 BIT_MASK 0x1fff FORMAT "%8.3" ECU_ADDRESS 0x600215EC /end MEASUREMENT
/begin MEASUREMENT DINH_nrActvInhReas.FId_bInhComGw_Com_HV_BATT_SOC "" UWORD DINH_ct_Compu 1 100 -4095.000 4096.000 BIT_MASK 0x1fff FORMAT "%8.3" ECU_ADDRESS 0x600215EE /end MEASUREMENT
/begin MEASUREMENT DINH_nrActvInhReas.FId_bInhComGw_Com_HV_BATT_SOC_5C3 "" UWORD DINH_ct_Compu 1 100 -4095.000 4096.000 BIT_MASK 0x1fff FORMAT "%8.3" ECU_ADDRESS 0x600215F0 /end MEASUREMENT
/begin MEASUREMENT DINH_nrActvInhReas.FId_bInhComGw_Com_HV_BATT_SOH_CAPA "" UWORD DINH_ct_Compu 1 100 -4095.000 4096.000 BIT_MASK 0x1fff FORMAT "%8.3" ECU_ADDRESS 0x600215F2 /end MEASUREMENT
/begin MEASUREMENT DINH_nrActvInhReas.FId_bInhComGw_Com_HV_BATT_SOH_RES "" UWORD DINH_ct_Compu 1 100 -4095.000 4096.000 BIT_MASK 0x1fff FORMAT "%8.3" ECU_ADDRESS 0x600215F4 /end MEASUREMENT
/begin MEASUREMENT DINH_nrActvInhReas.FId_bInhComGw_Com_HV_BATT_TEMP_AVG "" UWORD DINH_ct_Compu 1 100 -4095.000 4096.000 BIT_MASK 0x1fff FORMAT "%8.3" ECU_ADDRESS 0x600215F6 /end MEASUREMENT
/begin MEASUREMENT DINH_nrActvInhReas.FId_bInhComGw_Com_INV_MTR_INST_INPUT_POWER "" UWORD DINH_ct_Compu 1 100 -4095.000 4096.000 BIT_MASK 0x1fff FORMAT "%8.3" ECU_ADDRESS 0x600215F8 /end MEASUREMENT
/begin MEASUREMENT DINH_nrActvInhReas.FId_bInhComGw_Com_PEM_ENGINE_RPM "" UWORD DINH_ct_Compu 1 100 -4095.000 4096.000 BIT_MASK 0x1fff FORMAT "%8.3" ECU_ADDRESS 0x600215FA /end MEASUREMENT
/begin MEASUREMENT DINH_nrActvInhReas.FId_bInhComGw_Com_PEM_ESTIM_TRQ "" UWORD DINH_ct_Compu 1 100 -4095.000 4096.000 BIT_MASK 0x1fff FORMAT "%8.3" ECU_ADDRESS 0x600215FC /end MEASUREMENT
/begin MEASUREMENT DINH_nrActvInhReas.FId_bInhComGw_Com_PEM_INVERTER_TEMP "" UWORD DINH_ct_Compu 1 100 -4095.000 4096.000 BIT_MASK 0x1fff FORMAT "%8.3" ECU_ADDRESS 0x600215FE /end MEASUREMENT
/begin MEASUREMENT DINH_nrActvInhReas.FId_bInhComGw_Com_PEM_INVERTOR_ALERT_TEMP "" UWORD DINH_ct_Compu 1 100 -4095.000 4096.000 BIT_MASK 0x1fff FORMAT "%8.3" ECU_ADDRESS 0x60021600 /end MEASUREMENT
/begin MEASUREMENT DINH_nrActvInhReas.FId_bInhComGw_Com_PEM_OVERTEMP_FAILURE "" UWORD DINH_ct_Compu 1 100 -4095.000 4096.000 BIT_MASK 0x1fff FORMAT "%8.3" ECU_ADDRESS 0x60021602 /end MEASUREMENT
/begin MEASUREMENT DINH_nrActvInhReas.FId_bInhComGw_Com_PEM_STATOR_TEMP "" UWORD DINH_ct_Compu 1 100 -4095.000 4096.000 BIT_MASK 0x1fff FORMAT "%8.3" ECU_ADDRESS 0x60021604 /end MEASUREMENT
/begin MEASUREMENT DINH_nrActvInhReas.FId_bInhComGw_Com_VITESSE_VEHICULE_ROUES "" UWORD DINH_ct_Compu 1 100 -4095.000 4096.000 BIT_MASK 0x1fff FORMAT "%8.3" ECU_ADDRESS 0x60021606 /end MEASUREMENT
/begin MEASUREMENT DINH_nrActvInhReas.FId_bInhComGw_Com_VVH_INDISP "" UWORD DINH_ct_Compu 1 100 -4095.000 4096.000 BIT_MASK 0x1fff FORMAT "%8.3" ECU_ADDRESS 0x60021608 /end MEASUREMENT
/begin MEASUREMENT DINH_nrActvInhReas.FId_bInhComGw_Com_eCOMP_Power_consumption "" UWORD DINH_ct_Compu 1 100 -4095.000 4096.000 BIT_MASK 0x1fff FORMAT "%8.3" ECU_ADDRESS 0x6002160A /end MEASUREMENT
/begin MEASUREMENT DINH_nrActvInhReas.FId_bInhComGw_MAIN_RELAY_ACTUATION_COUNTER "" UWORD DINH_ct_Compu 1 100 -4095.000 4096.000 BIT_MASK 0x1fff FORMAT "%8.3" ECU_ADDRESS 0x6002160C /end MEASUREMENT
/begin MEASUREMENT DINH_nrActvInhReas.FId_bInhComGw_TIME_HV_BATT_OVER_TEMPERATURE "" UWORD DINH_ct_Compu 1 100 -4095.000 4096.000 BIT_MASK 0x1fff FORMAT "%8.3" ECU_ADDRESS 0x6002160E /end MEASUREMENT
/begin MEASUREMENT DINH_nrActvInhReas.FId_bInhComGw_TOTAL_HV_BATT_POS_QTY_CURR "" UWORD DINH_ct_Compu 1 100 -4095.000 4096.000 BIT_MASK 0x1fff FORMAT "%8.3" ECU_ADDRESS 0x60021610 /end MEASUREMENT
/begin MEASUREMENT DINH_stFId.FId_bInhComGw_Com_BMS_REMAININGBATTCAPACITY "" UWORD DFC_OneToOne 1 100 0.00 65535.00 FORMAT "%8.2" ECU_ADDRESS 0x600215CE /end MEASUREMENT
/begin MEASUREMENT DINH_stFId.FId_bInhComGw_Com_CONTACT_FREIN_PRK "" UWORD DFC_OneToOne 1 100 0.00 65535.00 FORMAT "%8.2" ECU_ADDRESS 0x600215D0 /end MEASUREMENT
/begin MEASUREMENT DINH_stFId.FId_bInhComGw_Com_DCDC_IP_POWER "" UWORD DFC_OneToOne 1 100 0.00 65535.00 FORMAT "%8.2" ECU_ADDRESS 0x600215D2 /end MEASUREMENT
/begin MEASUREMENT DINH_stFId.FId_bInhComGw_Com_HVBAT_ALERT_LOW_BATT_ENERGY "" UWORD DFC_OneToOne 1 100 0.00 65535.00 FORMAT "%8.2" ECU_ADDRESS 0x600215D4 /end MEASUREMENT
/begin MEASUREMENT DINH_stFId.FId_bInhComGw_Com_HVBAT_CHARGING_STATUS "" UWORD DFC_OneToOne 1 100 0.00 65535.00 FORMAT "%8.2" ECU_ADDRESS 0x600215D6 /end MEASUREMENT
/begin MEASUREMENT DINH_stFId.FId_bInhComGw_Com_HVBAT_SOC "" UWORD DFC_OneToOne 1 100 0.00 65535.00 FORMAT "%8.2" ECU_ADDRESS 0x600215D8 /end MEASUREMENT
/begin MEASUREMENT DINH_stFId.FId_bInhComGw_Com_HVBAT_TEMPERATURE "" UWORD DFC_OneToOne 1 100 0.00 65535.00 FORMAT "%8.2" ECU_ADDRESS 0x600215DA /end MEASUREMENT
/begin MEASUREMENT DINH_stFId.FId_bInhComGw_Com_HVBAT_THERMAL_RUNAWAY "" UWORD DFC_OneToOne 1 100 0.00 65535.00 FORMAT "%8.2" ECU_ADDRESS 0x600215DC /end MEASUREMENT
/begin MEASUREMENT DINH_stFId.FId_bInhComGw_Com_HV_BATT_CELL_VOLT_MAX "" UWORD DFC_OneToOne 1 100 0.00 65535.00 FORMAT "%8.2" ECU_ADDRESS 0x600215DE /end MEASUREMENT
/begin MEASUREMENT DINH_stFId.FId_bInhComGw_Com_HV_BATT_CELL_VOLT_MIN "" UWORD DFC_OneToOne 1 100 0.00 65535.00 FORMAT "%8.2" ECU_ADDRESS 0x600215E0 /end MEASUREMENT
/begin MEASUREMENT DINH_stFId.FId_bInhComGw_Com_HV_BATT_INSULATION_RESISTANCE "" UWORD DFC_OneToOne 1 100 0.00 65535.00 FORMAT "%8.2" ECU_ADDRESS 0x600215E2 /end MEASUREMENT
/begin MEASUREMENT DINH_stFId.FId_bInhComGw_Com_HV_BATT_INSUL_FAILURE "" UWORD DFC_OneToOne 1 100 0.00 65535.00 FORMAT "%8.2" ECU_ADDRESS 0x600215E4 /end MEASUREMENT
/begin MEASUREMENT DINH_stFId.FId_bInhComGw_Com_HV_BATT_INTERLOCK_LINE "" UWORD DFC_OneToOne 1 100 0.00 65535.00 FORMAT "%8.2" ECU_ADDRESS 0x600215E6 /end MEASUREMENT
/begin MEASUREMENT DINH_stFId.FId_bInhComGw_Com_HV_BATT_MIN_VOLT_WARN "" UWORD DFC_OneToOne 1 100 0.00 65535.00 FORMAT "%8.2" ECU_ADDRESS 0x600215E8 /end MEASUREMENT
/begin MEASUREMENT DINH_stFId.FId_bInhComGw_Com_HV_BATT_NB_CELL_VOLT_MAX "" UWORD DFC_OneToOne 1 100 0.00 65535.00 FORMAT "%8.2" ECU_ADDRESS 0x600215EA /end MEASUREMENT
/begin MEASUREMENT DINH_stFId.FId_bInhComGw_Com_HV_BATT_NB_CELL_VOLT_MIN "" UWORD DFC_OneToOne 1 100 0.00 65535.00 FORMAT "%8.2" ECU_ADDRESS 0x600215EC /end MEASUREMENT
/begin MEASUREMENT DINH_stFId.FId_bInhComGw_Com_HV_BATT_SOC "" UWORD DFC_OneToOne 1 100 0.00 65535.00 FORMAT "%8.2" ECU_ADDRESS 0x600215EE /end MEASUREMENT
/begin MEASUREMENT DINH_stFId.FId_bInhComGw_Com_HV_BATT_SOC_5C3 "" UWORD DFC_OneToOne 1 100 0.00 65535.00 FORMAT "%8.2" ECU_ADDRESS 0x600215F0 /end MEASUREMENT
/begin MEASUREMENT DINH_stFId.FId_bInhComGw_Com_HV_BATT_SOH_CAPA "" UWORD DFC_OneToOne 1 100 0.00 65535.00 FORMAT "%8.2" ECU_ADDRESS 0x600215F2 /end MEASUREMENT
/begin MEASUREMENT DINH_stFId.FId_bInhComGw_Com_HV_BATT_SOH_RES "" UWORD DFC_OneToOne 1 100 0.00 65535.00 FORMAT "%8.2" ECU_ADDRESS 0x600215F4 /end MEASUREMENT
/begin MEASUREMENT DINH_stFId.FId_bInhComGw_Com_HV_BATT_TEMP_AVG "" UWORD DFC_OneToOne 1 100 0.00 65535.00 FORMAT "%8.2" ECU_ADDRESS 0x600215F6 /end MEASUREMENT
/begin MEASUREMENT DINH_stFId.FId_bInhComGw_Com_INV_MTR_INST_INPUT_POWER "" UWORD DFC_OneToOne 1 100 0.00 65535.00 FORMAT "%8.2" ECU_ADDRESS 0x600215F8 /end MEASUREMENT
/begin MEASUREMENT DINH_stFId.FId_bInhComGw_Com_PEM_ENGINE_RPM "" UWORD DFC_OneToOne 1 100 0.00 65535.00 FORMAT "%8.2" ECU_ADDRESS 0x600215FA /end MEASUREMENT
/begin MEASUREMENT DINH_stFId.FId_bInhComGw_Com_PEM_ESTIM_TRQ "" UWORD DFC_OneToOne 1 100 0.00 65535.00 FORMAT "%8.2" ECU_ADDRESS 0x600215FC /end MEASUREMENT
/begin MEASUREMENT DINH_stFId.FId_bInhComGw_Com_PEM_INVERTER_TEMP "" UWORD DFC_OneToOne 1 100 0.00 65535.00 FORMAT "%8.2" ECU_ADDRESS 0x600215FE /end MEASUREMENT
/begin MEASUREMENT DINH_stFId.FId_bInhComGw_Com_PEM_INVERTOR_ALERT_TEMP "" UWORD DFC_OneToOne 1 100 0.00 65535.00 FORMAT "%8.2" ECU_ADDRESS 0x60021600 /end MEASUREMENT
/begin MEASUREMENT DINH_stFId.FId_bInhComGw_Com_PEM_OVERTEMP_FAILURE "" UWORD DFC_OneToOne 1 100 0.00 65535.00 FORMAT "%8.2" ECU_ADDRESS 0x60021602 /end MEASUREMENT
/begin MEASUREMENT DINH_stFId.FId_bInhComGw_Com_PEM_STATOR_TEMP "" UWORD DFC_OneToOne 1 100 0.00 65535.00 FORMAT "%8.2" ECU_ADDRESS 0x60021604 /end MEASUREMENT
/begin MEASUREMENT DINH_stFId.FId_bInhComGw_Com_VITESSE_VEHICULE_ROUES "" UWORD DFC_OneToOne 1 100 0.00 65535.00 FORMAT "%8.2" ECU_ADDRESS 0x60021606 /end MEASUREMENT
/begin MEASUREMENT DINH_stFId.FId_bInhComGw_Com_VVH_INDISP "" UWORD DFC_OneToOne 1 100 0.00 65535.00 FORMAT "%8.2" ECU_ADDRESS 0x60021608 /end MEASUREMENT
/begin MEASUREMENT DINH_stFId.FId_bInhComGw_Com_eCOMP_Power_consumption "" UWORD DFC_OneToOne 1 100 0.00 65535.00 FORMAT "%8.2" ECU_ADDRESS 0x6002160A /end MEASUREMENT
/begin MEASUREMENT DINH_stFId.FId_bInhComGw_MAIN_RELAY_ACTUATION_COUNTER "" UWORD DFC_OneToOne 1 100 0.00 65535.00 FORMAT "%8.2" ECU_ADDRESS 0x6002160C /end MEASUREMENT
/begin MEASUREMENT DINH_stFId.FId_bInhComGw_TIME_HV_BATT_OVER_TEMPERATURE "" UWORD DFC_OneToOne 1 100 0.00 65535.00 FORMAT "%8.2" ECU_ADDRESS 0x6002160E /end MEASUREMENT
/begin MEASUREMENT DINH_stFId.FId_bInhComGw_TOTAL_HV_BATT_POS_QTY_CURR "" UWORD DFC_OneToOne 1 100 0.00 65535.00 FORMAT "%8.2" ECU_ADDRESS 0x60021610 /end MEASUREMENT
/begin MEASUREMENT FRM_bInhComGw_Com_BMS_REMAININGBATTCAPACITY "Interface used to check Fid inhibition" UBYTE OneToOne 1 100 0.00 255.0 BIT_MASK 0x1 FORMAT "%5.1" ECU_ADDRESS 0x600236CF
 /begin IF_DATA XCPplus 0x0102
  /begin DAQ_EVENT VARIABLE /end DAQ_EVENT
 /end IF_DATA
/end MEASUREMENT
/begin MEASUREMENT FRM_bInhComGw_Com_CONTACT_FREIN_PRK "Interface used to check Fid inhibition" UBYTE OneToOne 1 100 0.00 255.0 BIT_MASK 0x1 FORMAT "%5.1" ECU_ADDRESS 0x600236CE
 /begin IF_DATA XCPplus 0x0102
  /begin DAQ_EVENT VARIABLE /end DAQ_EVENT
 /end IF_DATA
/end MEASUREMENT
/begin MEASUREMENT FRM_bInhComGw_Com_DCDC_IP_POWER "Interface used to check Fid inhibition" UBYTE OneToOne 1 100 0.00 255.0 BIT_MASK 0x1 FORMAT "%5.1" ECU_ADDRESS 0x600236CD
 /begin IF_DATA XCPplus 0x0102
  /begin DAQ_EVENT VARIABLE /end DAQ_EVENT
 /end IF_DATA
/end MEASUREMENT
/begin MEASUREMENT FRM_bInhComGw_Com_eCOMP_Power_consumption "Interface used to check Fid inhibition" UBYTE OneToOne 1 100 0.00 255.0 BIT_MASK 0x1 FORMAT "%5.1" ECU_ADDRESS 0x600236BE
 /begin IF_DATA XCPplus 0x0102
  /begin DAQ_EVENT VARIABLE /end DAQ_EVENT
 /end IF_DATA
/end MEASUREMENT
/begin MEASUREMENT FRM_bInhComGw_Com_HVBAT_CHARGING_STATUS "Interface used to check Fid inhibition" UBYTE OneToOne 1 100 0.00 255.0 BIT_MASK 0x1 FORMAT "%5.1" ECU_ADDRESS 0x600236CC
 /begin IF_DATA XCPplus 0x0102
  /begin DAQ_EVENT VARIABLE /end DAQ_EVENT
 /end IF_DATA
/end MEASUREMENT
/begin MEASUREMENT FRM_bInhComGw_Com_HVBAT_SOC "Interface used to check Fid inhibition" UBYTE OneToOne 1 100 0.00 255.0 BIT_MASK 0x1 FORMAT "%5.1" ECU_ADDRESS 0x600236CB
 /begin IF_DATA XCPplus 0x0102
  /begin DAQ_EVENT VARIABLE /end DAQ_EVENT
 /end IF_DATA
/end MEASUREMENT
/begin MEASUREMENT FRM_bInhComGw_Com_HVBAT_TEMPERATURE "Storing FID status for Com GW buffer for HVBAT_TEMPERATURE signal" UBYTE OneToOne 1 100 0.00 255.0 BIT_MASK 0x1 FORMAT "%5.1" ECU_ADDRESS 0x600236CA
 /begin IF_DATA XCPplus 0x0102
  /begin DAQ_EVENT VARIABLE /end DAQ_EVENT
 /end IF_DATA
/end MEASUREMENT
/begin MEASUREMENT FRM_bInhComGw_Com_HVBAT_THERMAL_RUNAWAY "Fault indication parameter for HVBAT_THERMAL_RUNAWAY" UBYTE OneToOne 1 100 0.00 255.0 BIT_MASK 0x1 FORMAT "%5.1" ECU_ADDRESS 0x600236C9
 /begin IF_DATA XCPplus 0x0102
  /begin DAQ_EVENT VARIABLE /end DAQ_EVENT
 /end IF_DATA
/end MEASUREMENT
/begin MEASUREMENT FRM_bInhComGw_Com_HV_BATT_CELL_VOLT_MAX "Interface used to check Fid inhibition" UBYTE OneToOne 1 100 0.00 255.0 BIT_MASK 0x1 FORMAT "%5.1" ECU_ADDRESS 0x600236C8
 /begin IF_DATA XCPplus 0x0102
  /begin DAQ_EVENT VARIABLE /end DAQ_EVENT
 /end IF_DATA
/end MEASUREMENT
/begin MEASUREMENT FRM_bInhComGw_Com_HV_BATT_CELL_VOLT_MIN "Interface used to check Fid inhibition" UBYTE OneToOne 1 100 0.00 255.0 BIT_MASK 0x1 FORMAT "%5.1" ECU_ADDRESS 0x600236C7
 /begin IF_DATA XCPplus 0x0102
  /begin DAQ_EVENT VARIABLE /end DAQ_EVENT
 /end IF_DATA
/end MEASUREMENT
/begin MEASUREMENT FRM_bInhComGw_Com_HV_BATT_INSULATION_RESISTANCE "Interface used to check Fid inhibition" UBYTE OneToOne 1 100 0.00 255.0 BIT_MASK 0x1 FORMAT "%5.1" ECU_ADDRESS 0x600236C6
 /begin IF_DATA XCPplus 0x0102
  /begin DAQ_EVENT VARIABLE /end DAQ_EVENT
 /end IF_DATA
/end MEASUREMENT
/begin MEASUREMENT FRM_bInhComGw_Com_HV_BATT_INSUL_FAILURE "Interface used to check Fid inhibition" UBYTE OneToOne 1 100 0.00 255.0 BIT_MASK 0x1 FORMAT "%5.1" ECU_ADDRESS 0x600236C5
 /begin IF_DATA XCPplus 0x0102
  /begin DAQ_EVENT VARIABLE /end DAQ_EVENT
 /end IF_DATA
/end MEASUREMENT
/begin MEASUREMENT FRM_bInhComGw_Com_HV_BATT_INTERLOCK_LINE "Interface used to check Fid inhibition" UBYTE OneToOne 1 100 0.00 255.0 BIT_MASK 0x1 FORMAT "%5.1" ECU_ADDRESS 0x600236C4
 /begin IF_DATA XCPplus 0x0102
  /begin DAQ_EVENT VARIABLE /end DAQ_EVENT
 /end IF_DATA
/end MEASUREMENT
/begin MEASUREMENT FRM_bInhComGw_Com_HV_BATT_MIN_VOLT_WARN "Interface used to check Fid inhibition" UBYTE OneToOne 1 100 0.00 255.0 BIT_MASK 0x1 FORMAT "%5.1" ECU_ADDRESS 0x600236C3
 /begin IF_DATA XCPplus 0x0102
  /begin DAQ_EVENT VARIABLE /end DAQ_EVENT
 /end IF_DATA
/end MEASUREMENT
/begin MEASUREMENT FRM_bInhComGw_Com_HV_BATT_NB_CELL_VOLT_MAX "Interface used to check Fid inhibition" UBYTE OneToOne 1 100 0.00 255.0 BIT_MASK 0x1 FORMAT "%5.1" ECU_ADDRESS 0x600236C2
 /begin IF_DATA XCPplus 0x0102
  /begin DAQ_EVENT VARIABLE /end DAQ_EVENT
 /end IF_DATA
/end MEASUREMENT
/begin MEASUREMENT FRM_bInhComGw_Com_HV_BATT_NB_CELL_VOLT_MIN "Interface used to check Fid inhibition" UBYTE OneToOne 1 100 0.00 255.0 BIT_MASK 0x1 FORMAT "%5.1" ECU_ADDRESS 0x600236C1
 /begin IF_DATA XCPplus 0x0102
  /begin DAQ_EVENT VARIABLE /end DAQ_EVENT
 /end IF_DATA
/end MEASUREMENT
/begin MEASUREMENT FRM_bInhComGw_Com_HV_BATT_SOC_5C3 "Fault indication parameter forHV_BATT_SOC_5C3" UBYTE OneToOne 1 100 0.00 255.0 BIT_MASK 0x1 FORMAT "%5.1" ECU_ADDRESS 0x600236C0
 /begin IF_DATA XCPplus 0x0102
  /begin DAQ_EVENT VARIABLE /end DAQ_EVENT
 /end IF_DATA
/end MEASUREMENT
/begin MEASUREMENT FRM_bInhComGw_Com_INV_MTR_INST_INPUT_POWER "Interface used to check Fid inhibition" UBYTE OneToOne 1 100 0.00 255.0 BIT_MASK 0x1 FORMAT "%5.1" ECU_ADDRESS 0x600236BF
 /begin IF_DATA XCPplus 0x0102
  /begin DAQ_EVENT VARIABLE /end DAQ_EVENT
 /end IF_DATA
/end MEASUREMENT
/begin MEASUREMENT FRM_bInhComGw_HVBAT_ALERT_LOW_BATT_ENERGY "Interface used to check Fid inhibition" UBYTE OneToOne 1 100 0.00 255.0 BIT_MASK 0x1 FORMAT "%5.1" ECU_ADDRESS 0x600236BD
 /begin IF_DATA XCPplus 0x0102
  /begin DAQ_EVENT VARIABLE /end DAQ_EVENT
 /end IF_DATA
/end MEASUREMENT
/begin MEASUREMENT FRM_bInhComGw_HV_BATT_SOH_CAPA "Interface used to check Fid inhibition" UBYTE OneToOne 1 100 0.00 255.0 BIT_MASK 0x1 FORMAT "%5.1" ECU_ADDRESS 0x600236BC
 /begin IF_DATA XCPplus 0x0102
  /begin DAQ_EVENT VARIABLE /end DAQ_EVENT
 /end IF_DATA
/end MEASUREMENT
/begin MEASUREMENT FRM_bInhComGw_HV_BATT_SOH_RES "Interface used to check Fid inhibition" UBYTE OneToOne 1 100 0.00 255.0 BIT_MASK 0x1 FORMAT "%5.1" ECU_ADDRESS 0x600236BB
 /begin IF_DATA XCPplus 0x0102
  /begin DAQ_EVENT VARIABLE /end DAQ_EVENT
 /end IF_DATA
/end MEASUREMENT
/begin MEASUREMENT FRM_bInhComGw_HV_BATT_TEMP_AVG "Interface used to check Fid inhibition" UBYTE OneToOne 1 100 0.00 255.0 BIT_MASK 0x1 FORMAT "%5.1" ECU_ADDRESS 0x600236BA
 /begin IF_DATA XCPplus 0x0102
  /begin DAQ_EVENT VARIABLE /end DAQ_EVENT
 /end IF_DATA
/end MEASUREMENT
/begin MEASUREMENT FRM_bInhComGw_MAIN_RELAY_ACTUATION_COUNTER "Interface used to check Fid inhibition" UBYTE OneToOne 1 100 0.00 255.0 BIT_MASK 0x1 FORMAT "%5.1" ECU_ADDRESS 0x600236B9
 /begin IF_DATA XCPplus 0x0102
  /begin DAQ_EVENT VARIABLE /end DAQ_EVENT
 /end IF_DATA
/end MEASUREMENT
/begin MEASUREMENT FRM_bInhComGw_TIME_HV_BATT_OVER_TEMPERATURE "Interface used to check Fid inhibition" UBYTE OneToOne 1 100 0.00 255.0 BIT_MASK 0x1 FORMAT "%5.1" ECU_ADDRESS 0x600236B8
 /begin IF_DATA XCPplus 0x0102
  /begin DAQ_EVENT VARIABLE /end DAQ_EVENT
 /end IF_DATA
/end MEASUREMENT
/begin MEASUREMENT FRM_bInhComGw_TOTAL_HV_BATT_POS_QTY_CURR "Interface used to check Fid inhibition" UBYTE OneToOne 1 100 0.00 255.0 BIT_MASK 0x1 FORMAT "%5.1" ECU_ADDRESS 0x600236B7
 /begin IF_DATA XCPplus 0x0102
  /begin DAQ_EVENT VARIABLE /end DAQ_EVENT
 /end IF_DATA
/end MEASUREMENT
/begin MEASUREMENT FRM_bInhComGw_VITESSE_VEHICULE_ROUES "Interface used to check Fid inhibition" UBYTE OneToOne 1 100 0.00 255.0 BIT_MASK 0x1 FORMAT "%5.1" ECU_ADDRESS 0x600236B6
 /begin IF_DATA XCPplus 0x0102
  /begin DAQ_EVENT VARIABLE /end DAQ_EVENT
 /end IF_DATA
/end MEASUREMENT
/begin MEASUREMENT FRM_bInhComGw_VVH_INDISP "Interface used to check Fid inhibition" UBYTE OneToOne 1 100 0.00 255.0 BIT_MASK 0x1 FORMAT "%5.1" ECU_ADDRESS 0x600236B5
 /begin IF_DATA XCPplus 0x0102
  /begin DAQ_EVENT VARIABLE /end DAQ_EVENT
 /end IF_DATA
/end MEASUREMENT
/begin FUNCTION ComScl_Gw "850.3.0   Signal processing of frames from Gateway"
 /begin DEF_CHARACTERISTIC Com_CONTACT_FREIN_PRKGW_GwSubsVal_C Com_CONTACT_FREIN_PRKGW_Ini_C Com_DCDC_IP_POWERGW_Ini_C Com_DCDC_IP_POWERGW_Invld_C Com_eCOMP_Power_consumptionGW_Ini_C Com_eCOMP_Power_consumptionGW_Invld_C Com_HVBAT_BMS_REMAININGBATTCAPACITYGW_Ini_C Com_HVBAT_BMS_REMAININGBATTCAPACITYGW_Invld_C Com_HVBAT_CHARGING_STATUSGW_Ini_C Com_HVBAT_CHARGING_STATUSGW_Invld_C Com_HVBAT_SOCGW_Ini_C Com_HVBAT_SOCGW_Invld_C Com_HVBAT_TEMPERATUREGW_Ini_C Com_HVBAT_TEMPERATUREGW_Invld_C Com_HVBAT_THERMAL_RUNAWAYGW_Ini_C Com_HVBAT_THERMAL_RUNAWAYGW_Invld_C Com_HV_BATT_CELL_VOLT_MAXGW_Ini_C Com_HV_BATT_CELL_VOLT_MAXGW_Invld_C Com_HV_BATT_CELL_VOLT_MINGW_Ini_C Com_HV_BATT_CELL_VOLT_MINGW_Invld_C Com_HV_BATT_INSULATION_RESISTANCEGW_Ini_C Com_HV_BATT_INSULATION_RESISTANCEGW_Invld_C Com_HV_BATT_INSUL_FAILUREGW_GwSubsVal_C Com_HV_BATT_INSUL_FAILUREGW_Ini_C Com_HV_BATT_INTERLOCK_LINEGW_GwSubsVal_C Com_HV_BATT_INTERLOCK_LINEGW_Ini_C Com_HV_BATT_MIN_VOLT_WARNGW_GwSubsVal_C Com_HV_BATT_MIN_VOLT_WARNGW_Ini_C Com_HV_BATT_NB_CELL_VOLT_MAXGW_Ini_C Com_HV_BATT_NB_CELL_VOLT_MAXGW_Invld_C Com_HV_BATT_NB_CELL_VOLT_MINGW_Ini_C Com_HV_BATT_NB_CELL_VOLT_MINGW_Invld_C Com_HV_BATT_SOC_5C3GW_GwSubsVal_C Com_HV_BATT_SOC_5C3GW_Ini_C Com_HV_BATT_SOH_CAPAGW_Ini_C Com_HV_BATT_SOH_CAPAGW_Invld_C Com_HV_BATT_SOH_RESGW_Ini_C Com_HV_BATT_SOH_RESGW_Invld_C Com_INV_MTR_INST_INPUT_POWERGW_Ini_C Com_INV_MTR_INST_INPUT_POWERGW_Invld_C Com_MAIN_RELAY_ACTUATION_COUNTERGW_Ini_C Com_MAIN_RELAY_ACTUATION_COUNTERGW_Invld_C Com_TIME_HV_BATT_OVER_TEMPERATUREGW_Ini_C Com_TIME_HV_BATT_OVER_TEMPERATUREGW_Invld_C Com_TOTAL_HV_BATT_POS_QTY_CURRGW_Ini_C Com_TOTAL_HV_BATT_POS_QTY_CURRGW_Invld_C Com_VITESSE_VEHICULE_ROUESGW_Ini_C Com_VITESSE_VEHICULE_ROUESGW_Invld_C Com_VVH_INDISPGW_Ini_C Com_VVH_INDISPGW_Invld_C Ext_ctClcProcMax_C Ext_ctClcProcMin_C HVBAT_ALERT_LOW_BATT_ENERGYGW_GwSubsVal_C HVBAT_ALERT_LOW_BATT_ENERGYGW_Ini_C HV_BATT_TEMP_AVGGW_Ini_C HV_BATT_TEMP_AVGGW_Invld_C /end DEF_CHARACTERISTIC
 /begin IN_MEASUREMENT ComM_stComModeCANHSN1 ComM_stComModeCANHSN3 ComM_stComModeCANHSN4 /end IN_MEASUREMENT
 /begin OUT_MEASUREMENT Com_FirstRx_38Dh_IS_DYN_ABR Com_FirstRx_DCDC_INFO_283 Com_FirstRx_eCOMP_Information_47B Com_FirstRx_HVBAT_205h Com_FirstRx_HVBAT_325h Com_FirstRx_HVBAT_535 Com_FirstRx_HVBAT_665h Com_FirstRx_HVBAT_675h Com_FirstRx_HVBAT_THERMAL_5B5 Com_FirstRx_HVBAT_VCU_435h Com_FirstRx_HVBAT_VCU_543 Com_FirstRx_INV_227h Com_FirstRx_IS_DAT_BSI_412h Com_GwBuf_CONTACT_FREIN_PRK Com_GwBuf_DCDC_IP_POWER Com_GwBuf_eCOMP_Power_consumption Com_GwBuf_HVBAT_ALERT_LOW_BATT_ENERGY Com_GwBuf_HVBAT_CHARGING_STATUS Com_GwBuf_HVBAT_HVIL_STS Com_GwBuf_HVBAT_INSULATION_FAULT Com_GwBuf_HVBAT_INSULATION_RESISTANCE Com_GwBuf_HVBAT_MAX_CELL_VOLT Com_GwBuf_HVBAT_MAX_CELL_VOLT_NUM Com_GwBuf_HVBAT_MIN_CELL_VOLT Com_GwBuf_HVBAT_MIN_CELL_VOLT_NUM Com_GwBuf_HVBAT_SOC_ACTUAL Com_GwBuf_HVBAT_SOC_DISPLAY Com_GwBuf_HVBAT_SOH Com_GwBuf_HVBAT_TEMPERATURE Com_GwBuf_HVBAT_THERMAL_RUNAWAY Com_GwBuf_HV_BATT_MIN_VOLT_WARN Com_GwBuf_HV_BATT_SOH_RES Com_GwBuf_HV_BATT_TEMP_AVG Com_GwBuf_INV_MTR_INST_INPUT_POWER Com_GwBuf_MAIN_RELAY_ACTUATION_COUNTER Com_GwBuf_TIME_HV_BATT_OVER_TEMPERATURE Com_GwBuf_TOTAL_HV_BATT_POS_QTY_CURR Com_GwBuf_VITESSE_VEHICULE_ROUES Com_GwBuf_VVH_INDISP Com_Gw_Buf_HVBAT_REMAININGBATTCAPACITY DINH_nrActvInhReas.FId_bInhComGw_Com_BMS_REMAININGBATTCAPACITY DINH_nrActvInhReas.FId_bInhComGw_Com_CONTACT_FREIN_PRK DINH_nrActvInhReas.FId_bInhComGw_Com_DCDC_IP_POWER DINH_nrActvInhReas.FId_bInhComGw_Com_HVBAT_ALERT_LOW_BATT_ENERGY DINH_nrActvInhReas.FId_bInhComGw_Com_HVBAT_CHARGING_STATUS DINH_nrActvInhReas.FId_bInhComGw_Com_HVBAT_SOC DINH_nrActvInhReas.FId_bInhComGw_Com_HVBAT_TEMPERATURE DINH_nrActvInhReas.FId_bInhComGw_Com_HVBAT_THERMAL_RUNAWAY DINH_nrActvInhReas.FId_bInhComGw_Com_HV_BATT_CELL_VOLT_MAX DINH_nrActvInhReas.FId_bInhComGw_Com_HV_BATT_CELL_VOLT_MIN DINH_nrActvInhReas.FId_bInhComGw_Com_HV_BATT_INSULATION_RESISTANCE DINH_nrActvInhReas.FId_bInhComGw_Com_HV_BATT_INSUL_FAILURE DINH_nrActvInhReas.FId_bInhComGw_Com_HV_BATT_INTERLOCK_LINE DINH_nrActvInhReas.FId_bInhComGw_Com_HV_BATT_MIN_VOLT_WARN DINH_nrActvInhReas.FId_bInhComGw_Com_HV_BATT_NB_CELL_VOLT_MAX DINH_nrActvInhReas.FId_bInhComGw_Com_HV_BATT_NB_CELL_VOLT_MIN DINH_nrActvInhReas.FId_bInhComGw_Com_HV_BATT_SOC DINH_nrActvInhReas.FId_bInhComGw_Com_HV_BATT_SOC_5C3 DINH_nrActvInhReas.FId_bInhComGw_Com_HV_BATT_SOH_CAPA DINH_nrActvInhReas.FId_bInhComGw_Com_HV_BATT_SOH_RES DINH_nrActvInhReas.FId_bInhComGw_Com_HV_BATT_TEMP_AVG DINH_nrActvInhReas.FId_bInhComGw_Com_INV_MTR_INST_INPUT_POWER DINH_nrActvInhReas.FId_bInhComGw_Com_PEM_ENGINE_RPM DINH_nrActvInhReas.FId_bInhComGw_Com_PEM_ESTIM_TRQ DINH_nrActvInhReas.FId_bInhComGw_Com_PEM_INVERTER_TEMP DINH_nrActvInhReas.FId_bInhComGw_Com_PEM_INVERTOR_ALERT_TEMP DINH_nrActvInhReas.FId_bInhComGw_Com_PEM_OVERTEMP_FAILURE DINH_nrActvInhReas.FId_bInhComGw_Com_PEM_STATOR_TEMP DINH_nrActvInhReas.FId_bInhComGw_Com_VITESSE_VEHICULE_ROUES DINH_nrActvInhReas.FId_bInhComGw_Com_VVH_INDISP DINH_nrActvInhReas.FId_bInhComGw_Com_eCOMP_Power_consumption DINH_nrActvInhReas.FId_bInhComGw_MAIN_RELAY_ACTUATION_COUNTER DINH_nrActvInhReas.FId_bInhComGw_TIME_HV_BATT_OVER_TEMPERATURE DINH_nrActvInhReas.FId_bInhComGw_TOTAL_HV_BATT_POS_QTY_CURR DINH_stFId.FId_bInhComGw_Com_BMS_REMAININGBATTCAPACITY DINH_stFId.FId_bInhComGw_Com_CONTACT_FREIN_PRK DINH_stFId.FId_bInhComGw_Com_DCDC_IP_POWER DINH_stFId.FId_bInhComGw_Com_HVBAT_ALERT_LOW_BATT_ENERGY DINH_stFId.FId_bInhComGw_Com_HVBAT_CHARGING_STATUS DINH_stFId.FId_bInhComGw_Com_HVBAT_SOC DINH_stFId.FId_bInhComGw_Com_HVBAT_TEMPERATURE DINH_stFId.FId_bInhComGw_Com_HVBAT_THERMAL_RUNAWAY DINH_stFId.FId_bInhComGw_Com_HV_BATT_CELL_VOLT_MAX DINH_stFId.FId_bInhComGw_Com_HV_BATT_CELL_VOLT_MIN DINH_stFId.FId_bInhComGw_Com_HV_BATT_INSULATION_RESISTANCE DINH_stFId.FId_bInhComGw_Com_HV_BATT_INSUL_FAILURE DINH_stFId.FId_bInhComGw_Com_HV_BATT_INTERLOCK_LINE DINH_stFId.FId_bInhComGw_Com_HV_BATT_MIN_VOLT_WARN DINH_stFId.FId_bInhComGw_Com_HV_BATT_NB_CELL_VOLT_MAX DINH_stFId.FId_bInhComGw_Com_HV_BATT_NB_CELL_VOLT_MIN DINH_stFId.FId_bInhComGw_Com_HV_BATT_SOC DINH_stFId.FId_bInhComGw_Com_HV_BATT_SOC_5C3 DINH_stFId.FId_bInhComGw_Com_HV_BATT_SOH_CAPA DINH_stFId.FId_bInhComGw_Com_HV_BATT_SOH_RES DINH_stFId.FId_bInhComGw_Com_HV_BATT_TEMP_AVG DINH_stFId.FId_bInhComGw_Com_INV_MTR_INST_INPUT_POWER DINH_stFId.FId_bInhComGw_Com_PEM_ENGINE_RPM DINH_stFId.FId_bInhComGw_Com_PEM_ESTIM_TRQ DINH_stFId.FId_bInhComGw_Com_PEM_INVERTER_TEMP DINH_stFId.FId_bInhComGw_Com_PEM_INVERTOR_ALERT_TEMP DINH_stFId.FId_bInhComGw_Com_PEM_OVERTEMP_FAILURE DINH_stFId.FId_bInhComGw_Com_PEM_STATOR_TEMP DINH_stFId.FId_bInhComGw_Com_VITESSE_VEHICULE_ROUES DINH_stFId.FId_bInhComGw_Com_VVH_INDISP DINH_stFId.FId_bInhComGw_Com_eCOMP_Power_consumption DINH_stFId.FId_bInhComGw_MAIN_RELAY_ACTUATION_COUNTER DINH_stFId.FId_bInhComGw_TIME_HV_BATT_OVER_TEMPERATURE DINH_stFId.FId_bInhComGw_TOTAL_HV_BATT_POS_QTY_CURR FRM_bInhComGw_Com_BMS_REMAININGBATTCAPACITY FRM_bInhComGw_Com_CONTACT_FREIN_PRK FRM_bInhComGw_Com_DCDC_IP_POWER FRM_bInhComGw_Com_eCOMP_Power_consumption FRM_bInhComGw_Com_HVBAT_CHARGING_STATUS FRM_bInhComGw_Com_HVBAT_SOC FRM_bInhComGw_Com_HVBAT_TEMPERATURE FRM_bInhComGw_Com_HVBAT_THERMAL_RUNAWAY FRM_bInhComGw_Com_HV_BATT_CELL_VOLT_MAX FRM_bInhComGw_Com_HV_BATT_CELL_VOLT_MIN FRM_bInhComGw_Com_HV_BATT_INSULATION_RESISTANCE FRM_bInhComGw_Com_HV_BATT_INSUL_FAILURE FRM_bInhComGw_Com_HV_BATT_INTERLOCK_LINE FRM_bInhComGw_Com_HV_BATT_MIN_VOLT_WARN FRM_bInhComGw_Com_HV_BATT_NB_CELL_VOLT_MAX FRM_bInhComGw_Com_HV_BATT_NB_CELL_VOLT_MIN FRM_bInhComGw_Com_HV_BATT_SOC_5C3 FRM_bInhComGw_Com_INV_MTR_INST_INPUT_POWER FRM_bInhComGw_HVBAT_ALERT_LOW_BATT_ENERGY FRM_bInhComGw_HV_BATT_SOH_CAPA FRM_bInhComGw_HV_BATT_SOH_RES FRM_bInhComGw_HV_BATT_TEMP_AVG FRM_bInhComGw_MAIN_RELAY_ACTUATION_COUNTER FRM_bInhComGw_TIME_HV_BATT_OVER_TEMPERATURE FRM_bInhComGw_TOTAL_HV_BATT_POS_QTY_CURR FRM_bInhComGw_VITESSE_VEHICULE_ROUES FRM_bInhComGw_VVH_INDISP /end OUT_MEASUREMENT
 FUNCTION_VERSION "850.3.0" /end FUNCTION
/begin FUNCTION ComScl_NetMtrx "850.8.0   Configuration of network matrix"
 /begin IN_MEASUREMENT ACCmpr_pwrLimMax ACCtl_flgCmprEna ACCtl_nCmprSpdReq APP_rInp BattId_numOrganNature1 BattId_numOrganNature2 BattId_numOrganRef1 BattId_numOrganRef2 BattId_numOrganRef3 BattId_numOrganRef4 BattId_numSerl1 BattId_numSerl2 BattId_numSerl3 BattId_numSerl4 BattId_numSerl5 BattId_numSerl6 BattId_numSerl7 Brk_stRed CanEif_stReqHSN1_CANTx CanEif_stReqHSN3_CANTx CbnHeatgHeatr_cntrRlyLf ChgrPlug_stPlgLockTx ChrgCntct_nrNegCntctElpdOper ChrgCntct_nrPosCntctElpdOper ChrgrRly_stRlyDes ChrgrVal_iChrgrDes ChrgrVal_iGridLimMax ChrgrVal_uHvMax CoDrvPITh_stEPSModeReq ComChrgr_stChrgnEna ComChrg_stMod ComM_stComModeCANHSN1 ComM_stComModeCANHSN3 Com_bAcLedReq Com_bDiagMonSts_DCDC_OBC Com_bDiagMonSts_eBCCM Com_bDiagMonSts_eCOMP Com_bDiagMonSts_HVBAT Com_bDiagMonSts_INV Com_bDiagMonSts_PDU Com_bDiagMuxCAN Com_bGunCntInfoWkuReq Com_bHvBattRchrgWkuReq Com_bMainWkuDiagMonSts Com_bPostOperationWkuReq Com_bReFogRlySt Com_flgBlowrAuthn Com_flgBlowrRlyCtrl Com_flgBrkAlrt Com_flgDrvAwy Com_flgVehSpdQly Com_HvbMaxSnsrTempTx Com_iHvbActTx Com_nElCmprActlTx Com_nIvtrMotAct01 Com_noEditCal Com_noEditSw Com_noVersAdp Com_noVersSw Com_noVersSys Com_noVersSysMnth Com_noVersSysYr Com_noVerSysDay Com_stACTx Com_stBrk Com_stBrkBstPFlt Com_stBrkCntctIndcn Com_stChrgPlg Com_stChrgPlgChrgn Com_stClstrStopIndcn Com_stCmdHvBattCntctr Com_stCmdOffsEM01 Com_stDrvAwyDi Com_stDrvModPosn Com_stElCmprStatTx Com_stElMDesEem Com_stEVLmp Com_stHvacBlwrFront_CAN Com_stHvacKnobPosn_CAN Com_stHvBattOperModDes Com_stMstWrnLmp Com_stNwCmdLIN Com_stPwrLimnLmp Com_stReFogReq_CAN Com_stSrvLmp Com_stVehCoorn Com_TogLedDrv Com_TogLedMod Com_TogLedNeut Com_TogLedRvs Com_tqMotLimMax Com_uHvbActTx Com_valEepOffsEM01 CoPtFH_stPwt DcChrgnRly_ctMaxOperCyc Dcdc_flgDesLvGridULim Dcdc_iLimLvGrid Dcdc_stDesDcdc Dcdc_uDesLvGrid DrvInfo_wTotTripEgy EChrDv_cntPlin Eem_flgFstHvShdwn ElM_stDesEem01 ElTS_egyTotChrgCyc ElTS_ratEmPowChrgn ElTS_ratEmPowDcha ElTS_stChrgCyc Emac_stIsoMonSwtReq Emac_tqDesCom01 Ext_bSyncGPC HvBatt_flgIsoMeasmtDiReq HvBatt_ratSoc HvGrid_pwrMaxDcdc ThermHvac_stRemPrecndn VehCoorn_dstRngPrdcDispTx VehCoorn_wCnsTotWghtAvrgEffTx VehCoorn_wCnsTotWghtTripAvrgEffTx VehCoorn_wCnsWghtAvrgEffTripA VehCoorn_wCnsWghtAvrgEffTripB /end IN_MEASUREMENT
 /begin OUT_MEASUREMENT ComChrgn_iDcRly ComChrgn_uDcRly ComChrgr_flgChrgrErrLvl ComChrgr_iAcMax ComChrgr_iDcHvAct ComChrgr_pwrInAct ComChrgr_pwrOutpCpby ComChrgr_stChrgrRx ComChrgr_stEVLmp ComChrgr_stMstWrnLmp ComChrgr_stSVSLmp ComChrgr_tChrgrMaxAct ComChrgr_uAcActL1 ComChrgr_uDcHvAct ComEmac_flgImobAuthent ComEmac_iDcLnk01 ComEmac_nAct01 ComEmac_pwrInstnsInpRx ComEmac_stActvDcha ComEmac_stEVLmp ComEmac_stHillHld ComEmac_stIsoMonSwtAck ComEmac_stIvtrOpMod01 ComEmac_stMod01Rx ComEmac_stMstWrnLmp ComEmac_stPwrAuthn ComEmac_stSVSLmp ComEmac_tInvr01 ComEmac_tIvtrCooltIn01 ComEmac_tMac01 ComEmac_tqAbsltMaxRx01 ComEmac_tqAbsltMinRx01 ComEmac_tqAckd01 ComEmac_tqAct01 ComEmac_tqPtd01 ComEmac_tqStabnMin ComEmac_uDcLnk01 Com_bDelDftReq Com_bElIntgDiag Com_bElIntgDiagMod Com_bImmoUnlockWkuReq Com_bInfoReqPtlWkuReq Com_bPreCondElecWkuReq Com_bReFogRlySt_CAN Com_bRemUnlckWkuReq Com_bStpDlyHMIWkuReq Com_ctHvbNegCntctrSeg1 Com_ctHvbNegCntctrSeg2 Com_ctHvbNegCntctrSeg3 Com_ctHvbNegCntctrSeg4 Com_ctHvbNegCntctrSeg5 Com_ctHvbPosCntctrSeg1 Com_ctHvbPosCntctrSeg2 Com_ctHvbPosCntctrSeg3 Com_ctHvbPosCntctrSeg4 Com_ctHvbPosCntctrSeg5 Com_ctHvbPrecCntctrSeg1 Com_ctHvbPrecCntctrSeg2 Com_egyHvbAvl_fRx Com_flgBrkMai Com_flgBrkMaiDiag Com_flgCurMeasmtErr Com_flgCurMeasmtSysErr Com_flgCurMeasmtVld Com_flgCurRngErr Com_flgEcoNormReqRx Com_flgElCmprAbnormSpdFlt Com_flgElCmprCurSampleFailr Com_flgElCmprIgbtFailr Com_flgElCmprLoUSplyFlt Com_flgElCmprLoUUnderUFlt Com_flgElCmprOverCurFlt Com_flgElCmprOverHeatFailr Com_flgElCmprOverLoad Com_flgElCmprOverUFlt Com_flgElCmprOverUMalfct Com_flgElCmprPhaFailr Com_flgElCmprStallFailr Com_flgElCmprTSnsrFailr Com_flgGearLvrMovmt Com_flgGunUnlckReq Com_flgHvBattAuthn Com_flgPDUProgmFailr Com_flgRstTripAEE Com_flgRstTripAEE_A Com_flgRstTripAEE_B Com_flgTPcbMeasmtErr Com_flgTPcbMeasmtVld Com_flgTPcbRngErr Com_flgTPcbSysErr Com_flgTShntMeasmtErr Com_flgTShntMeasmtVld Com_flgTShntRngErr Com_flgTShntSysErr Com_flgVehSpdAvl Com_flgVoltMeasmtErr Com_flgVoltMeasmtSysErr Com_flgVoltMeasmtVld Com_flgVoltRngErr Com_HvbMaxSnsrTempRx Com_iBattEBS1Rx Com_iBattEBS2Rx Com_iBattEBS3Rx Com_iDcdcHvActRvsn1 Com_iDcdcLvActRvsn1 Com_iElCmprHvAct Com_iElCmprPeakPha Com_iHvbActRx Com_iHvbChrgMaxSho Com_iHvbDchaMaxSho Com_iHvbDes Com_iHvbNomChrgn Com_lTotOdometer Com_nElCmprActl Com_nrSerMaxCell Com_nrSerMinCell Com_pwrDcdcOutpCpby Com_pwrElCmprActl Com_pwrMaxChrgSho Com_pwrMaxDchaSho Com_qHvbTotCpRx Com_ratHvbSoc Com_ratHvbSoh Com_ratRHvbSoh Com_ratSocLvBatt Com_rHvbIsoMeasmt Com_stABSActv Com_stAC Com_stAirbCrashSev Com_stAirbCrashSevCpl Com_stAlrtThermRunAwy Com_stBlowrRly Com_stChrgnSpstReq Com_stDayNight Com_stDcdcEVLmp Com_stDcdcFltLvl Com_stDcdcMstWrnLmp Com_stDcdcOperModActRx Com_stDcdcPerfLimnActv Com_stDcdcSVSLmp Com_stDcdcULimReq Com_stDoor1 Com_stDoor2 Com_stDoor3 Com_stDoor4 Com_stDrvStBltRx Com_stElCmprFltLvl Com_stElCmprStat Com_steTogFailrLvl Com_stEvapTFlt Com_stGearLvrPos Com_stHvacBlwrFront Com_stHvacKnobPosn Com_stHvacPanComFlt Com_stHvacPanHwFlt Com_stHvacPanOverUFlt Com_stHvacPanPotiFlt Com_stHvacPanUnderUFlt Com_stHvBatHiTempWrn Com_stHvbChrgFltRx Com_stHvbChrgn Com_stHvbCnctn Com_stHvbDiscnctReas Com_stHvbEVLmp Com_stHvbFltLvl Com_stHvbIntlckRx Com_stHvbIsoFltRx Com_stHvbIsoMeasmtActv Com_stHvbModRx Com_stHvbMstWrnLmp Com_stHvbNegCntct Com_stHvbPosCntct Com_stHvbPrecCntct Com_stHvbSrvPlgRx Com_stHvbSVSLmp Com_stIBattEBS Com_stIgnkeyPos Com_stIIvtrFltLvl01 Com_stMainWkuReq Com_stOffsEm01 Com_stPrkBrkRx Com_stReFogReq Com_stSocRx Com_stT Com_stT50 Com_tDcdcAct Com_tDcdcInltCoolt Com_tElCmprActl Com_tEnvT Com_tEvapT Com_tHvbAct Com_tHvbMax Com_tiCurVehTmr Com_tiHvbChrgnHalfRx Com_tLvBatt Com_uBattEBSRx Com_uDcdcHvAct Com_uDcdcLvAct Com_uElCmprHvAct Com_uHvbAct Com_uHvbDcBus Com_uHvbLimHi Com_uHvbMaxCell Com_uHvbMinCell Com_uHvbNomChrgn Com_valOffsEm01 Com_vVeh DDRC_St.DFC_Com082hTooShort DDRC_St.DFC_Com092hTooShort DDRC_St.DFC_Com205hAbsent DDRC_St.DFC_Com205hChecksum DDRC_St.DFC_Com205hCounter DDRC_St.DFC_Com205hTooShort DDRC_St.DFC_Com217hAbsent DDRC_St.DFC_Com217hChecksum DDRC_St.DFC_Com217hCounter DDRC_St.DFC_Com217hTooShort DDRC_St.DFC_Com227hAbsent DDRC_St.DFC_Com227hTooShort DDRC_St.DFC_Com237hAbsent DDRC_St.DFC_Com237hChecksum DDRC_St.DFC_Com237hCounter DDRC_St.DFC_Com237hTooShort DDRC_St.DFC_Com259hAbsent DDRC_St.DFC_Com259hChecksum DDRC_St.DFC_Com259hCounter DDRC_St.DFC_Com259hTooShort DDRC_St.DFC_Com26hAbsent DDRC_St.DFC_Com26hTooShort DDRC_St.DFC_Com273hAbsent DDRC_St.DFC_Com273hChecksum DDRC_St.DFC_Com273hCounter DDRC_St.DFC_Com273hTooShort DDRC_St.DFC_Com275hAbsent DDRC_St.DFC_Com275hChecksum DDRC_St.DFC_Com275hCounter DDRC_St.DFC_Com275hTooShort DDRC_St.DFC_Com283hAbsent DDRC_St.DFC_Com283hTooShort DDRC_St.DFC_Com285hAbsent DDRC_St.DFC_Com285hChecksum DDRC_St.DFC_Com285hCounter DDRC_St.DFC_Com285hTooShort DDRC_St.DFC_Com293hAbsent DDRC_St.DFC_Com293hChecksum DDRC_St.DFC_Com293hCounter DDRC_St.DFC_Com293hTooShort DDRC_St.DFC_Com308hAbsent DDRC_St.DFC_Com308hChecksum DDRC_St.DFC_Com308hCounter DDRC_St.DFC_Com308hTooShort DDRC_St.DFC_Com318hAbsent DDRC_St.DFC_Com318hChecksum DDRC_St.DFC_Com318hCounter DDRC_St.DFC_Com318hTooShort DDRC_St.DFC_Com325hAbsent DDRC_St.DFC_Com325hChecksum DDRC_St.DFC_Com325hCounter DDRC_St.DFC_Com325hTooShort DDRC_St.DFC_Com335hAbsent DDRC_St.DFC_Com335hChecksum DDRC_St.DFC_Com335hCounter DDRC_St.DFC_Com335hTooShort DDRC_St.DFC_Com351hAbsent DDRC_St.DFC_Com351hTooShort DDRC_St.DFC_Com38DhAbsent DDRC_St.DFC_Com38DhChecksum DDRC_St.DFC_Com38DhCounter DDRC_St.DFC_Com38DhTooShort DDRC_St.DFC_Com412hAbsent DDRC_St.DFC_Com412hChecksum DDRC_St.DFC_Com412hCounter DDRC_St.DFC_Com412hTooShort DDRC_St.DFC_Com427hAbsent DDRC_St.DFC_Com427hTooShort DDRC_St.DFC_Com432hAbsent DDRC_St.DFC_Com432hChecksum DDRC_St.DFC_Com432hCounter DDRC_St.DFC_Com432hTooShort DDRC_St.DFC_Com435hAbsent DDRC_St.DFC_Com435hTooShort DDRC_St.DFC_Com442hAbsent DDRC_St.DFC_Com442hTooShort DDRC_St.DFC_Com453hAbsent DDRC_St.DFC_Com453hTooShort DDRC_St.DFC_Com455hAbsent DDRC_St.DFC_Com455hTooShort DDRC_St.DFC_Com463hAbsent DDRC_St.DFC_Com463hTooShort DDRC_St.DFC_Com473hAbsent DDRC_St.DFC_Com473hTooShort DDRC_St.DFC_Com47BhAbsent DDRC_St.DFC_Com47BhTooShort DDRC_St.DFC_Com48BhAbsent DDRC_St.DFC_Com48BhTooShort DDRC_St.DFC_Com497hTooShort DDRC_St.DFC_Com4F2hAbsent DDRC_St.DFC_Com4F2hChecksum DDRC_St.DFC_Com4F2hCounter DDRC_St.DFC_Com4F2hTooShort DDRC_St.DFC_Com50DhAbsent DDRC_St.DFC_Com50DhTooShort DDRC_St.DFC_Com535hAbsent DDRC_St.DFC_Com535hTooShort DDRC_St.DFC_Com543hAbsent DDRC_St.DFC_Com543hTooShort DDRC_St.DFC_Com552hAbsent DDRC_St.DFC_Com552hTooShort DDRC_St.DFC_Com583hAbsent DDRC_St.DFC_Com583hTooShort DDRC_St.DFC_Com592hAbsent DDRC_St.DFC_Com592hChecksum DDRC_St.DFC_Com592hCounter DDRC_St.DFC_Com592hTooShort DDRC_St.DFC_Com595hAbsent DDRC_St.DFC_Com595hChecksum DDRC_St.DFC_Com595hCounter DDRC_St.DFC_Com595hTooShort DDRC_St.DFC_Com5B2hAbsent DDRC_St.DFC_Com5B2hTooShort DDRC_St.DFC_Com5B5hAbsent DDRC_St.DFC_Com5B5hChecksum DDRC_St.DFC_Com5B5hCounter DDRC_St.DFC_Com5B5hTooShort DDRC_St.DFC_Com5C7hTooShort DDRC_St.DFC_Com5E7hAbsent DDRC_St.DFC_Com5E7hTooShort DDRC_St.DFC_Com635hTooShort DDRC_St.DFC_Com645hTooShort DDRC_St.DFC_Com663hAbsent DDRC_St.DFC_Com663hTooShort DDRC_St.DFC_Com665hAbsent DDRC_St.DFC_Com665hTooShort DDRC_St.DFC_Com675hAbsent DDRC_St.DFC_Com675hTooShort DDRC_St.DFC_ComFrbd_205h_HVBAT_PACK_CURRENT DDRC_St.DFC_ComFrbd_205h_HVBAT_SOC_DISPLAY DDRC_St.DFC_ComFrbd_205h_HVBAT_VOLTAGE DDRC_St.DFC_ComFrbd_217h_INV_DC_BUS_VOLTAGE DDRC_St.DFC_ComFrbd_217h_INV_MTR_ACTUAL_TRQ DDRC_St.DFC_ComFrbd_217h_INV_MTR_SPEED DDRC_St.DFC_ComFrbd_217h_INV_MTR_TRQ DDRC_St.DFC_ComFrbd_227h_INV_DC_CURRENT DDRC_St.DFC_ComFrbd_227h_INV_MOTORING_PEAK_TRQ DDRC_St.DFC_ComFrbd_227h_INV_MTR_INST_INPUT_POWER DDRC_St.DFC_ComFrbd_227h_INV_REGEN_PEAK_TRQ DDRC_St.DFC_ComFrbd_237h_INV_ACTIVE_DISCHARGE_STATUS DDRC_St.DFC_ComFrbd_237h_INV_CTRL_MODE_ACK DDRC_St.DFC_ComFrbd_237h_INV_EV_WARNING DDRC_St.DFC_ComFrbd_237h_INV_FAULT_LEVEL DDRC_St.DFC_ComFrbd_237h_INV_MASTER_STOP DDRC_St.DFC_ComFrbd_237h_INV_SERVICE_DUE DDRC_St.DFC_ComFrbd_237h_INV_STAB_MIN_TRQ DDRC_St.DFC_ComFrbd_259h_TGLM_FAILURE_STATE DDRC_St.DFC_ComFrbd_259h_TGLM_MODE_PUSH DDRC_St.DFC_ComFrbd_259h_TOGGLE_MONOSTABLE_POS DDRC_St.DFC_ComFrbd_273h_OBC_outputpower_capability DDRC_St.DFC_ComFrbd_275h_HVBAT_DISCHARGE_30S_AVAILABLE_CURRENT DDRC_St.DFC_ComFrbd_275h_HVBAT_DISCHARGE_30S_AVAILABLE_POWER DDRC_St.DFC_ComFrbd_283h_DCDC_IN_CURRENT DDRC_St.DFC_ComFrbd_283h_DCDC_IN_VOLTAGE DDRC_St.DFC_ComFrbd_283h_DCDC_OUT_CURRENT DDRC_St.DFC_ComFrbd_283h_DCDC_OUT_VOLTAGE DDRC_St.DFC_ComFrbd_285h_HVBAT_REGEN_CHG_30S_CURRENT_LIMIT DDRC_St.DFC_ComFrbd_285h_HVBAT_REGEN_CHRG_30S_POWER_LIMIT DDRC_St.DFC_ComFrbd_293h_DCDC_outputpower_capability DDRC_St.DFC_ComFrbd_325h_HVBAT_INSULATION_RESISTANCE DDRC_St.DFC_ComFrbd_325h_HVBAT_TEMPERATURE DDRC_St.DFC_ComFrbd_335h_HVBAT_CHRG_CONTINUOUS_CURR_MAX DDRC_St.DFC_ComFrbd_335h_HVBAT_CHRG_COTINUOUS_CURR_REQ DDRC_St.DFC_ComFrbd_335h_HVBAT_CHRG_MAX_VOLT DDRC_St.DFC_ComFrbd_335h_HVBAT_DC_BUS_VOLTAGE DDRC_St.DFC_ComFrbd_427h_INV_OP_MODE DDRC_St.DFC_ComFrbd_427h_INV_PERMISIBLE_TORQUE DDRC_St.DFC_ComFrbd_435h_HVBAT_MAX_CELL_VOLT DDRC_St.DFC_ComFrbd_435h_HVBAT_MAX_CELL_VOLT_NUM DDRC_St.DFC_ComFrbd_435h_HVBAT_MAX_SENSOR_TEMP DDRC_St.DFC_ComFrbd_435h_HVBAT_MIN_CELL_VOLT DDRC_St.DFC_ComFrbd_435h_HVBAT_MIN_CELL_VOLT_NUM DDRC_St.DFC_ComFrbd_453h_OBC_IN_CURRENT DDRC_St.DFC_ComFrbd_453h_OBC_IN_VOLTAGE DDRC_St.DFC_ComFrbd_453h_OBC_IP_POWER DDRC_St.DFC_ComFrbd_455h_HVBAT_NOMINAL_VOLTAGE DDRC_St.DFC_ComFrbd_463h_OBC_OUT_CURRENT DDRC_St.DFC_ComFrbd_463h_OBC_OUT_VOLTAGE DDRC_St.DFC_ComFrbd_463h_OBC_TEMPERATURE DDRC_St.DFC_ComFrbd_473h_DCDC_Coolant_Temperature DDRC_St.DFC_ComFrbd_473h_DCDC_TEMPERATURE DDRC_St.DFC_ComFrbd_47Bh_eCOMP_BusBarCurrent DDRC_St.DFC_ComFrbd_47Bh_eCOMP_BusBarVoltage DDRC_St.DFC_ComFrbd_47Bh_eCOMP_CompressorSpeed DDRC_St.DFC_ComFrbd_47Bh_eCOMP_IGBT_Temp DDRC_St.DFC_ComFrbd_47Bh_eCOMP_PeakPhaCurrent DDRC_St.DFC_ComFrbd_47Bh_eCOMP_Power_consumption DDRC_St.DFC_ComFrbd_48Bh_eCOMP_Fault_Level DDRC_St.DFC_ComFrbd_4F2h_VALEUR_SOC_ETENDUE DDRC_St.DFC_ComFrbd_535h_HV_BATT_TEMP_AVG DDRC_St.DFC_ComFrbd_543h_HVBAT_RESTBATTENERGY DDRC_St.DFC_ComFrbd_543h_HVBAT_SOH DDRC_St.DFC_ComFrbd_543h_HV_BATT_SOH_RES DDRC_St.DFC_ComFrbd_592h_IBATT_1 DDRC_St.DFC_ComFrbd_592h_IBATT_2 DDRC_St.DFC_ComFrbd_592h_IBATT_3 DDRC_St.DFC_ComFrbd_592h_TEMP_BATT DDRC_St.DFC_ComFrbd_592h_U_BATT_BECB DDRC_St.DFC_ComFrbd_595h_HVBAT_TIME_TO_CHRG_80 DDRC_St.DFC_ComFrbd_5B2h_TEMP_AIR_EXT DDRC_St.DFC_ComFrbd_635h_HVBAT_NEG_CONT_COUNT_SEG1 DDRC_St.DFC_ComFrbd_635h_HVBAT_NEG_CONT_COUNT_SEG3 DDRC_St.DFC_ComFrbd_635h_HVBAT_NEG_CONT_COUNT_SEG4 DDRC_St.DFC_ComFrbd_635h_HVBAT_PST_CONT_COUNT_SEG1 DDRC_St.DFC_ComFrbd_635h_HVBAT_PST_CONT_COUNT_SEG3 DDRC_St.DFC_ComFrbd_635h_HVBAT_PST_CONT_COUNT_SEG4 DDRC_St.DFC_ComFrbd_645h_HVBAT_PRECHRGE_CONT_COUNT_SEG1 DDRC_St.DFC_ComFrbd_645h_HVBAT_PRECHRGE_CONT_COUNT_SEG2 DDRC_St.DFC_ComFrbd_675h_HVBAT_REMAININGBATTCAPACITY DDRC_St.DFC_ComInvld_205h_HVBAT_CHARGING_STATUS DDRC_St.DFC_ComInvld_205h_HVBAT_PACK_CURRENT DDRC_St.DFC_ComInvld_205h_HVBAT_SOC_DISPLAY DDRC_St.DFC_ComInvld_205h_HVBAT_VOLTAGE DDRC_St.DFC_ComInvld_217h_INV_DC_BUS_VOLTAGE DDRC_St.DFC_ComInvld_217h_INV_MTR_ACTUAL_TRQ DDRC_St.DFC_ComInvld_217h_INV_MTR_SPEED DDRC_St.DFC_ComInvld_217h_INV_MTR_TRQ DDRC_St.DFC_ComInvld_227h_INV_DC_CURRENT DDRC_St.DFC_ComInvld_227h_INV_MOTORING_PEAK_TRQ DDRC_St.DFC_ComInvld_227h_INV_MTR_INST_INPUT_POWER DDRC_St.DFC_ComInvld_227h_INV_REGEN_PEAK_TRQ DDRC_St.DFC_ComInvld_237h_INV_ACTIVE_DISCHARGE_STATUS DDRC_St.DFC_ComInvld_237h_INV_FAULT_LEVEL DDRC_St.DFC_ComInvld_237h_INV_STAB_MIN_TRQ DDRC_St.DFC_ComInvld_259h_TGLM_MODE_PUSH DDRC_St.DFC_ComInvld_259h_TOGGLE_MONOSTABLE_POS DDRC_St.DFC_ComInvld_26h_AC_SWITCH_REQ DDRC_St.DFC_ComInvld_26h_BLOWER_POSITION DDRC_St.DFC_ComInvld_26h_EVAP_SENSOR_FAULT DDRC_St.DFC_ComInvld_26h_EVAP_SENSOR_VALUE DDRC_St.DFC_ComInvld_26h_POTENTIOMETER_FAULT DDRC_St.DFC_ComInvld_26h_REAR_DEFOG_REQ DDRC_St.DFC_ComInvld_26h_TEMP_POSITION DDRC_St.DFC_ComInvld_273h_OBC_FAULT_LEVEL DDRC_St.DFC_ComInvld_273h_OBC_outputpower_capability DDRC_St.DFC_ComInvld_275h_HVBAT_DISCHARGE_30S_AVAILABLE_CURRENT DDRC_St.DFC_ComInvld_275h_HVBAT_DISCHARGE_30S_AVAILABLE_POWER DDRC_St.DFC_ComInvld_283h_DCDC_IN_CURRENT DDRC_St.DFC_ComInvld_283h_DCDC_IN_VOLTAGE DDRC_St.DFC_ComInvld_283h_DCDC_OUT_CURRENT DDRC_St.DFC_ComInvld_283h_DCDC_OUT_VOLTAGE DDRC_St.DFC_ComInvld_285h_HVBAT_REGEN_CHG_30S_CURRENT_LIMIT DDRC_St.DFC_ComInvld_285h_HVBAT_REGEN_CHRG_30S_POWER_LIMIT DDRC_St.DFC_ComInvld_293h_DCDC_FAULT_LEVEL DDRC_St.DFC_ComInvld_293h_DCDC_outputpower_capability DDRC_St.DFC_ComInvld_325h_HVBAT_EPLUG_STATUS DDRC_St.DFC_ComInvld_325h_HVBAT_HVIL_STS DDRC_St.DFC_ComInvld_325h_HVBAT_INSULATION_FAULT DDRC_St.DFC_ComInvld_325h_HVBAT_INSULATION_RESISTANCE DDRC_St.DFC_ComInvld_325h_HVBAT_TEMPERATURE DDRC_St.DFC_ComInvld_335h_HVBAT_CHRG_CONTINUOUS_CURR_MAX DDRC_St.DFC_ComInvld_335h_HVBAT_CHRG_COTINUOUS_CURR_REQ DDRC_St.DFC_ComInvld_335h_HVBAT_CHRG_MAX_VOLT DDRC_St.DFC_ComInvld_335h_HVBAT_DC_BUS_VOLTAGE DDRC_St.DFC_ComInvld_38Dh_VITESSE_VEHICULE_ROUES DDRC_St.DFC_ComInvld_38Dh_VVH_INDISP DDRC_St.DFC_ComInvld_427h_INV_COOLANT_TEMP DDRC_St.DFC_ComInvld_427h_INV_MOTOR_TEMP DDRC_St.DFC_ComInvld_427h_INV_OP_MODE DDRC_St.DFC_ComInvld_427h_INV_PERMISIBLE_TORQUE DDRC_St.DFC_ComInvld_427h_INV_TEMP DDRC_St.DFC_ComInvld_432h_REVEIL_PRINCIPAL DDRC_St.DFC_ComInvld_435h_HVBAT_MAX_CELL_VOLT DDRC_St.DFC_ComInvld_435h_HVBAT_MAX_CELL_VOLT_NUM DDRC_St.DFC_ComInvld_435h_HVBAT_MAX_SENSOR_TEMP DDRC_St.DFC_ComInvld_435h_HVBAT_MIN_CELL_VOLT DDRC_St.DFC_ComInvld_435h_HVBAT_MIN_CELL_VOLT_NUM DDRC_St.DFC_ComInvld_442h_BCCM_BLOWER_RELAY_STS DDRC_St.DFC_ComInvld_453h_OBC_IN_CURRENT DDRC_St.DFC_ComInvld_453h_OBC_IN_VOLTAGE DDRC_St.DFC_ComInvld_453h_OBC_IP_POWER DDRC_St.DFC_ComInvld_455h_HVBAT_NOMINAL_VOLTAGE DDRC_St.DFC_ComInvld_463h_OBC_OUT_CURRENT DDRC_St.DFC_ComInvld_463h_OBC_OUT_VOLTAGE DDRC_St.DFC_ComInvld_463h_OBC_TEMPERATURE DDRC_St.DFC_ComInvld_473h_DCDC_Coolant_Temperature DDRC_St.DFC_ComInvld_473h_DCDC_TEMPERATURE DDRC_St.DFC_ComInvld_47Bh_eCOMP_BusBarCurrent DDRC_St.DFC_ComInvld_47Bh_eCOMP_BusBarVoltage DDRC_St.DFC_ComInvld_47Bh_eCOMP_CompressorSpeed DDRC_St.DFC_ComInvld_47Bh_eCOMP_IGBT_Temp DDRC_St.DFC_ComInvld_47Bh_eCOMP_PeakPhaCurrent DDRC_St.DFC_ComInvld_47Bh_eCOMP_Power_consumption DDRC_St.DFC_ComInvld_4F2h_STATUS_SOC DDRC_St.DFC_ComInvld_4F2h_TEMP_BATT_STATUS DDRC_St.DFC_ComInvld_4F2h_VALEUR_SOC_ETENDUE DDRC_St.DFC_ComInvld_535h_HV_BATT_TEMP_AVG DDRC_St.DFC_ComInvld_543h_HVBAT_RESTBATTENERGY DDRC_St.DFC_ComInvld_543h_HVBAT_SOH DDRC_St.DFC_ComInvld_543h_HV_BATT_SOH_RES DDRC_St.DFC_ComInvld_552h_CPT_TEMPOREL DDRC_St.DFC_ComInvld_552h_KILOMETRAGE DDRC_St.DFC_ComInvld_583h_HV_BATT_DISCONT_CSE_OPEN DDRC_St.DFC_ComInvld_592h_CALIBRE_IBATT DDRC_St.DFC_ComInvld_592h_IBATT_1 DDRC_St.DFC_ComInvld_592h_IBATT_2 DDRC_St.DFC_ComInvld_592h_IBATT_3 DDRC_St.DFC_ComInvld_592h_TEMP_BATT DDRC_St.DFC_ComInvld_592h_U_BATT_BECB DDRC_St.DFC_ComInvld_595h_HVBAT_TIME_TO_CHRG_80 DDRC_St.DFC_ComInvld_5B2h_TEMP_AIR_EXT DDRC_St.DFC_ComInvld_5B5h_HVBAT_THERMAL_RUNAWAY DDRC_St.DFC_ComInvld_635h_HVBAT_NEG_CONT_COUNT_SEG1 DDRC_St.DFC_ComInvld_635h_HVBAT_NEG_CONT_COUNT_SEG3 DDRC_St.DFC_ComInvld_635h_HVBAT_NEG_CONT_COUNT_SEG4 DDRC_St.DFC_ComInvld_635h_HVBAT_PST_CONT_COUNT_SEG1 DDRC_St.DFC_ComInvld_635h_HVBAT_PST_CONT_COUNT_SEG3 DDRC_St.DFC_ComInvld_635h_HVBAT_PST_CONT_COUNT_SEG4 DDRC_St.DFC_ComInvld_645h_HVBAT_PRECHRGE_CONT_COUNT_SEG1 DDRC_St.DFC_ComInvld_645h_HVBAT_PRECHRGE_CONT_COUNT_SEG2 DDRC_St.DFC_ComInvld_675h_HVBAT_REMAININGBATTCAPACITY DFC_st.DFC_Com082hTooShort DFC_st.DFC_Com092hTooShort DFC_st.DFC_Com205hAbsent DFC_st.DFC_Com205hChecksum DFC_st.DFC_Com205hCounter DFC_st.DFC_Com205hTooShort DFC_st.DFC_Com217hAbsent DFC_st.DFC_Com217hChecksum DFC_st.DFC_Com217hCounter DFC_st.DFC_Com217hTooShort DFC_st.DFC_Com227hAbsent DFC_st.DFC_Com227hTooShort DFC_st.DFC_Com237hAbsent DFC_st.DFC_Com237hChecksum DFC_st.DFC_Com237hCounter DFC_st.DFC_Com237hTooShort DFC_st.DFC_Com259hAbsent DFC_st.DFC_Com259hChecksum DFC_st.DFC_Com259hCounter DFC_st.DFC_Com259hTooShort DFC_st.DFC_Com26hAbsent DFC_st.DFC_Com26hTooShort DFC_st.DFC_Com273hAbsent DFC_st.DFC_Com273hChecksum DFC_st.DFC_Com273hCounter DFC_st.DFC_Com273hTooShort DFC_st.DFC_Com275hAbsent DFC_st.DFC_Com275hChecksum DFC_st.DFC_Com275hCounter DFC_st.DFC_Com275hTooShort DFC_st.DFC_Com283hAbsent DFC_st.DFC_Com283hTooShort DFC_st.DFC_Com285hAbsent DFC_st.DFC_Com285hChecksum DFC_st.DFC_Com285hCounter DFC_st.DFC_Com285hTooShort DFC_st.DFC_Com293hAbsent DFC_st.DFC_Com293hChecksum DFC_st.DFC_Com293hCounter DFC_st.DFC_Com293hTooShort DFC_st.DFC_Com308hAbsent DFC_st.DFC_Com308hChecksum DFC_st.DFC_Com308hCounter DFC_st.DFC_Com308hTooShort DFC_st.DFC_Com318hAbsent DFC_st.DFC_Com318hChecksum DFC_st.DFC_Com318hCounter DFC_st.DFC_Com318hTooShort DFC_st.DFC_Com325hAbsent DFC_st.DFC_Com325hChecksum DFC_st.DFC_Com325hCounter DFC_st.DFC_Com325hTooShort DFC_st.DFC_Com335hAbsent DFC_st.DFC_Com335hChecksum DFC_st.DFC_Com335hCounter DFC_st.DFC_Com335hTooShort DFC_st.DFC_Com351hAbsent DFC_st.DFC_Com351hTooShort DFC_st.DFC_Com38DhAbsent DFC_st.DFC_Com38DhChecksum DFC_st.DFC_Com38DhCounter DFC_st.DFC_Com38DhTooShort DFC_st.DFC_Com412hAbsent DFC_st.DFC_Com412hChecksum DFC_st.DFC_Com412hCounter DFC_st.DFC_Com412hTooShort DFC_st.DFC_Com427hAbsent DFC_st.DFC_Com427hTooShort DFC_st.DFC_Com432hAbsent DFC_st.DFC_Com432hChecksum DFC_st.DFC_Com432hCounter DFC_st.DFC_Com432hTooShort DFC_st.DFC_Com435hAbsent DFC_st.DFC_Com435hTooShort DFC_st.DFC_Com442hAbsent DFC_st.DFC_Com442hTooShort DFC_st.DFC_Com453hAbsent DFC_st.DFC_Com453hTooShort DFC_st.DFC_Com455hAbsent DFC_st.DFC_Com455hTooShort DFC_st.DFC_Com463hAbsent DFC_st.DFC_Com463hTooShort DFC_st.DFC_Com473hAbsent DFC_st.DFC_Com473hTooShort DFC_st.DFC_Com47BhAbsent DFC_st.DFC_Com47BhTooShort DFC_st.DFC_Com48BhAbsent DFC_st.DFC_Com48BhTooShort DFC_st.DFC_Com497hTooShort DFC_st.DFC_Com4F2hAbsent DFC_st.DFC_Com4F2hChecksum DFC_st.DFC_Com4F2hCounter DFC_st.DFC_Com4F2hTooShort DFC_st.DFC_Com50DhAbsent DFC_st.DFC_Com50DhTooShort DFC_st.DFC_Com535hAbsent DFC_st.DFC_Com535hTooShort DFC_st.DFC_Com543hAbsent DFC_st.DFC_Com543hTooShort DFC_st.DFC_Com552hAbsent DFC_st.DFC_Com552hTooShort DFC_st.DFC_Com583hAbsent DFC_st.DFC_Com583hTooShort DFC_st.DFC_Com592hAbsent DFC_st.DFC_Com592hChecksum DFC_st.DFC_Com592hCounter DFC_st.DFC_Com592hTooShort DFC_st.DFC_Com595hAbsent DFC_st.DFC_Com595hChecksum DFC_st.DFC_Com595hCounter DFC_st.DFC_Com595hTooShort DFC_st.DFC_Com5B2hAbsent DFC_st.DFC_Com5B2hTooShort DFC_st.DFC_Com5B5hAbsent DFC_st.DFC_Com5B5hChecksum DFC_st.DFC_Com5B5hCounter DFC_st.DFC_Com5B5hTooShort DFC_st.DFC_Com5C7hTooShort DFC_st.DFC_Com5E7hAbsent DFC_st.DFC_Com5E7hTooShort DFC_st.DFC_Com635hTooShort DFC_st.DFC_Com645hTooShort DFC_st.DFC_Com663hAbsent DFC_st.DFC_Com663hTooShort DFC_st.DFC_Com665hAbsent DFC_st.DFC_Com665hTooShort /end OUT_MEASUREMENT
 FUNCTION_VERSION "850.8.0" /end FUNCTION
/begin COMPU_METHOD B_TRUE "" TAB_VERB "%6.3" "" COMPU_TAB_REF B_TRUE /end COMPU_METHOD
/begin COMPU_VTAB B_TRUE "" TAB_VERB 2 0 "FALSE" 1 "TRUE" /end COMPU_VTAB
/begin COMPU_METHOD Curr_A_q0p03125_COMPU "" RAT_FUNC "%6.4" "A" COEFFS 0 32 0 0 0 1 /end COMPU_METHOD
/begin COMPU_METHOD DCCHRGRINTKT_TYPAVL_SC_Compu "" TAB_VERB "%6.3" "" COMPU_TAB_REF DCCHRGRINTKT_TYPAVL_SC_Compu /end COMPU_METHOD
/begin COMPU_VTAB DCCHRGRINTKT_TYPAVL_SC_Compu "" TAB_VERB 2 0 "False" 1 "True" /end COMPU_VTAB
/begin COMPU_METHOD DCDC02USGTYP_SC_Compu "" TAB_VERB "%6.3" "" COMPU_TAB_REF DCDC02USGTYP_SC_Compu /end COMPU_METHOD
/begin COMPU_VTAB DCDC02USGTYP_SC_Compu "" TAB_VERB 3 0 "NotPrs" 1 "Indpdt" 2 "Slv" /end COMPU_VTAB
/begin COMPU_METHOD DFC_OneToOne "" RAT_FUNC "%6.2" "-" COEFFS 0 1 0 0 0 1 /end COMPU_METHOD
/begin COMPU_METHOD DINH_ct_Compu "" RAT_FUNC "%6.0" "" COEFFS 0 -1 4096 0 0 1 /end COMPU_METHOD
/begin COMPU_METHOD Length_km "" RAT_FUNC "%6.2" "km" COEFFS 0 1 0 0 0 1 /end COMPU_METHOD
/begin COMPU_METHOD nmot_q1 "" RAT_FUNC "%6.2" "1/min" COEFFS 0 1 0 0 0 1 /end COMPU_METHOD
/begin COMPU_METHOD OneToOne "" RAT_FUNC "%6.2" "-" COEFFS 0 1 0 0 0 1 /end COMPU_METHOD
/begin COMPU_METHOD Prc "" RAT_FUNC "%6.4" "%" COEFFS 0 81.92 0 0 0 1 /end COMPU_METHOD
/begin COMPU_METHOD q0p01_o5_V "" RAT_FUNC "%6.3" "V" COEFFS 0 100 -500 0 0 1 /end COMPU_METHOD
/begin COMPU_METHOD q0p01_om200_A "" RAT_FUNC "%6.1" "A" COEFFS 0 100 20000 0 0 1 /end COMPU_METHOD
/begin COMPU_METHOD q0p05_A "" RAT_FUNC "%6.4" "A" COEFFS 0 20 0 0 0 1 /end COMPU_METHOD
/begin COMPU_METHOD q0p1_A "" RAT_FUNC "%6.3" "A" COEFFS 0 10 0 0 0 1 /end COMPU_METHOD
/begin COMPU_METHOD q0p1_kW "" RAT_FUNC "%6.3" "kW" COEFFS 0 10 0 0 0 1 /end COMPU_METHOD
/begin COMPU_METHOD q0p1_om1500_A "" RAT_FUNC "%6.0" "A" COEFFS 0 10 15000 0 0 1 /end COMPU_METHOD
/begin COMPU_METHOD q0p5_DegCgrd "" RAT_FUNC "%6.3" "Deg C" COEFFS 0 10 0 0 0 5 /end COMPU_METHOD
/begin COMPU_METHOD q1 "" RAT_FUNC "%6.2" "-" COEFFS 0 1 0 0 0 1 /end COMPU_METHOD
/begin COMPU_METHOD q10_W "" RAT_FUNC "%6.1" "W" COEFFS 0 1 0 0 0 10 /end COMPU_METHOD
/begin COMPU_METHOD q16 "" RAT_FUNC "%6.1" "-" COEFFS 0 1 0 0 0 16 /end COMPU_METHOD
/begin COMPU_METHOD q16_W_h "" RAT_FUNC "%6.1" "Wh" COEFFS 0 1 0 0 0 16 /end COMPU_METHOD
/begin COMPU_METHOD q1Em3_om1_A "" RAT_FUNC "%6.3" "A" COEFFS 0 1000 1000 0 0 1 /end COMPU_METHOD
/begin COMPU_METHOD q1Em3_V "" RAT_FUNC "%6.5" "V" COEFFS 0 1000 0 0 0 1 /end COMPU_METHOD
/begin COMPU_METHOD q1_kOhm "" RAT_FUNC "%6.2" "kOhm" COEFFS 0 1 0 0 0 1 /end COMPU_METHOD
/begin COMPU_METHOD q1_V "" RAT_FUNC "%6.2" "V" COEFFS 0 1 0 0 0 1 /end COMPU_METHOD
/begin COMPU_METHOD q64 "" RAT_FUNC "%6.1" "-" COEFFS 0 1 0 0 0 64 /end COMPU_METHOD
/begin COMPU_METHOD q8 "" RAT_FUNC "%6.2" "-" COEFFS 0 1 0 0 0 8 /end COMPU_METHOD
/begin COMPU_METHOD RBPtCel_i_0p03125_1 "" RAT_FUNC "%6.4" "A" COEFFS 0 32 0 0 0 1 /end COMPU_METHOD
/begin COMPU_METHOD RBPtCel_n_10p0_1 "" RAT_FUNC "%6.1" "rpm" COEFFS 0 1 0 0 0 10 /end COMPU_METHOD
/begin COMPU_METHOD RBPtCel_Perc_1p0_1 "" RAT_FUNC "%6.2" "%" COEFFS 0 1 0 0 0 1 /end COMPU_METHOD
/begin COMPU_METHOD RBPtCel_pwr_10p0_1 "" RAT_FUNC "%6.1" "W" COEFFS 0 1 0 0 0 10 /end COMPU_METHOD
/begin COMPU_METHOD RBPtCel_pwr_1p0_1 "" RAT_FUNC "%6.2" "W" COEFFS 0 1 0 0 0 1 /end COMPU_METHOD
/begin COMPU_METHOD RBPtCel_q_0p125_1 "" RAT_FUNC "%6.3" "Ah" COEFFS 0 8 0 0 0 1 /end COMPU_METHOD
/begin COMPU_METHOD RBPtCel_ti_1p0_4 "" RAT_FUNC "%6.2" "min" COEFFS 0 1 0 0 0 1 /end COMPU_METHOD
/begin COMPU_METHOD RBPtCel_tq_0p1_1 "" RAT_FUNC "%6.3" "Nm" COEFFS 0 10 0 0 0 1 /end COMPU_METHOD
/begin COMPU_METHOD RBPtCel_t_0p1_3 "" RAT_FUNC "%6.3" "Deg C" COEFFS 0 10 0 0 0 1 /end COMPU_METHOD
/begin COMPU_METHOD RBPtCel_t_1p0om40_1 "" RAT_FUNC "%6.2" "Deg C" COEFFS 0 1 40 0 0 1 /end COMPU_METHOD
/begin COMPU_METHOD RBPtCel_t_1p0_om40_1 "" RAT_FUNC "%6.2" "Deg C" COEFFS 0 1 40 0 0 1 /end COMPU_METHOD
/begin COMPU_METHOD RBPtCel_u_0p1_1 "" RAT_FUNC "%6.3" "V" COEFFS 0 10 0 0 0 1 /end COMPU_METHOD
/begin COMPU_METHOD Temp_Cels "" RAT_FUNC "%6.1" "deg C" COEFFS 0 10 2731.4 0 0 1 /end COMPU_METHOD
/begin COMPU_METHOD Temp_Cels_c126 "" RAT_FUNC "%6.2" "deg C" COEFFS 0 1 0 0 0 1 /end COMPU_METHOD
/begin COMPU_METHOD Time_sec_1 "" RAT_FUNC "%6.3" "s" COEFFS 0 10 0 0 0 1 /end COMPU_METHOD
/begin COMPU_METHOD Trq "" RAT_FUNC "%6.3" "Nm" COEFFS 0 10 0 0 0 1 /end COMPU_METHOD
/begin COMPU_METHOD Vel "" RAT_FUNC "%6.4" "km/h" COEFFS 0 100 0 0 0 1 /end COMPU_METHOD
/begin COMPU_METHOD Volt_V_q0p03125_COMPU "" RAT_FUNC "%6.4" "V" COEFFS 0 32 0 0 0 1 /end COMPU_METHOD
/begin RECORD_LAYOUT Val_Wu16 FNC_VALUES 1 UWORD COLUMN_DIR DIRECT /end RECORD_LAYOUT
/begin RECORD_LAYOUT Val_Wu32 FNC_VALUES 1 ULONG COLUMN_DIR DIRECT /end RECORD_LAYOUT
/begin RECORD_LAYOUT Val_Wu8 FNC_VALUES 1 UBYTE COLUMN_DIR DIRECT /end RECORD_LAYOUT
/end MODULE
/end PROJECT
